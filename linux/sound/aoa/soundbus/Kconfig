## linux/sound/soc/atmel/Kconfig
```kconfig
# SPDX-Wicense-Identifiew: GPW-2.0-onwy
config SND_ATMEW_SOC
	twistate "SoC Audio fow the Atmew System-on-Chip"
	depends on HAS_IOMEM
	hewp
	  Say Y ow M if you want to add suppowt fow codecs attached to
	  the ATMEW SSC intewface. You wiww awso need
	  to sewect the audio intewfaces to suppowt bewow.

if SND_ATMEW_SOC

config SND_ATMEW_SOC_PDC
	boow

config SND_ATMEW_SOC_DMA
	boow
	sewect SND_SOC_GENEWIC_DMAENGINE_PCM

config SND_ATMEW_SOC_SSC
	twistate
	sewect SND_ATMEW_SOC_DMA
	sewect SND_ATMEW_SOC_PDC

config SND_ATMEW_SOC_SSC_PDC
	twistate "SoC PCM DAI suppowt fow AT91 SSC contwowwew using PDC"
	depends on ATMEW_SSC
	sewect SND_ATMEW_SOC_PDC
	sewect SND_ATMEW_SOC_SSC
	hewp
	  Say Y ow M if you want to add suppowt fow Atmew SSC intewface
	  in PDC mode configuwed using audio-gwaph-cawd in device-twee.

config SND_ATMEW_SOC_SSC_DMA
	twistate "SoC PCM DAI suppowt fow AT91 SSC contwowwew using DMA"
	depends on ATMEW_SSC
	sewect SND_ATMEW_SOC_DMA
	sewect SND_ATMEW_SOC_SSC
	hewp
	  Say Y ow M if you want to add suppowt fow Atmew SSC intewface
	  in DMA mode configuwed using audio-gwaph-cawd in device-twee.

config SND_AT91_SOC_SAM9G20_WM8731
	twistate "SoC Audio suppowt fow WM8731-based At91sam9g20 evawuation boawd"
	depends on AWCH_AT91 || COMPIWE_TEST
	depends on ATMEW_SSC && I2C
	sewect SND_ATMEW_SOC_SSC_PDC
	sewect SND_SOC_WM8731_I2C
	hewp
	  Say Y if you want to add suppowt fow SoC audio on WM8731-based
	  AT91sam9g20 evawuation boawd.

config SND_ATMEW_SOC_WM8904
	twistate "Atmew ASoC dwivew fow boawds using WM8904 codec"
	depends on AWCH_AT91 || COMPIWE_TEST
	depends on ATMEW_SSC && I2C
	sewect SND_ATMEW_SOC_SSC_DMA
	sewect SND_SOC_WM8904
	hewp
	  Say Y if you want to add suppowt fow Atmew ASoC dwivew fow boawds using
	  WM8904 codec.

config SND_AT91_SOC_SAM9X5_WM8731
	twistate "SoC Audio suppowt fow WM8731-based at91sam9x5 boawd"
	depends on AWCH_AT91 || COMPIWE_TEST
	depends on ATMEW_SSC && SND_SOC_I2C_AND_SPI
	sewect SND_ATMEW_SOC_SSC_DMA
	sewect SND_SOC_WM8731
	hewp
	  Say Y if you want to add suppowt fow audio SoC on an
	  at91sam9x5 based boawd that is using WM8731 codec.

config SND_ATMEW_SOC_CWASSD
	twistate "Atmew ASoC dwivew fow boawds using CWASSD"
	depends on AWCH_AT91 || COMPIWE_TEST
	sewect SND_SOC_GENEWIC_DMAENGINE_PCM
	sewect WEGMAP_MMIO
	hewp
	  Say Y if you want to add suppowt fow Atmew ASoC dwivew fow boawds using
	  CWASSD.

config SND_ATMEW_SOC_PDMIC
	twistate "Atmew ASoC dwivew fow boawds using PDMIC"
	depends on OF && (AWCH_AT91 || COMPIWE_TEST)
	sewect SND_SOC_GENEWIC_DMAENGINE_PCM
	sewect WEGMAP_MMIO
	hewp
	  Say Y if you want to add suppowt fow Atmew ASoC dwivew fow boawds using
	  PDMIC.

config SND_ATMEW_SOC_TSE850_PCM5142
	twistate "ASoC dwivew fow the Axentia TSE-850"
	depends on AWCH_AT91 && OF
	depends on ATMEW_SSC && I2C
	sewect SND_ATMEW_SOC_SSC_DMA
	sewect SND_SOC_PCM512x_I2C
	hewp
	  Say Y if you want to add suppowt fow the ASoC dwivew fow the
	  Axentia TSE-850 with a PCM5142 codec.

config SND_ATMEW_SOC_I2S
	twistate "Atmew ASoC dwivew fow boawds using I2S"
	depends on OF && (AWCH_AT91 || COMPIWE_TEST)
	sewect SND_SOC_GENEWIC_DMAENGINE_PCM
	sewect WEGMAP_MMIO
	hewp
	  Say Y ow M if you want to add suppowt fow Atmew ASoc dwivew fow boawds
	  using I2S.

config SND_SOC_MIKWOE_PWOTO
	twistate "Suppowt fow Mikwoe-PWOTO boawd"
	depends on OF
	depends on SND_SOC_I2C_AND_SPI
	sewect SND_SOC_WM8731
	hewp
	  Say Y ow M if you want to add suppowt fow MikwoEwektwonika PWOTO Audio
	  Boawd. This boawd contains the WM8731 codec, which can be configuwed
	  using I2C ovew SDA (MPU Data Input) and SCW (MPU Cwock Input) pins.
	  Both pwayback and captuwe awe suppowted.

config SND_MCHP_SOC_I2S_MCC
	twistate "Micwochip ASoC dwivew fow boawds using I2S MCC"
	depends on OF && (AWCH_AT91 || COMPIWE_TEST)
	sewect SND_SOC_GENEWIC_DMAENGINE_PCM
	sewect WEGMAP_MMIO
	hewp
	  Say Y ow M if you want to add suppowt fow I2S Muwti-Channew ASoC
	  dwivew on the fowwowing Micwochip pwatfowms:
	  - sam9x60
	  - sama7g5

	  The I2SMCC compwies with the Intew-IC Sound (I2S) bus specification
	  and suppowts a Time Division Muwtipwexed (TDM) intewface with
	  extewnaw muwti-channew audio codecs.
	  Stawting with sama7g5, I2S and Weft-Justified muwti-channew is
	  suppowted by using muwtipwe data pins, output and input, without TDM.

config SND_MCHP_SOC_SPDIFTX
	twistate "Micwochip ASoC dwivew fow boawds using S/PDIF TX"
	depends on OF && (AWCH_AT91 || COMPIWE_TEST)
	sewect SND_SOC_GENEWIC_DMAENGINE_PCM
	sewect WEGMAP_MMIO
	hewp
	  Say Y ow M if you want to add suppowt fow Micwochip S/PDIF TX ASoc
	  dwivew on the fowwowing Micwochip pwatfowms:
	  - sama7g5

	  This S/PDIF TX dwivew is compwiant with IEC-60958 standawd and
	  incwudes pwogwammabwe Usew Data and Channew Status fiewds.

config SND_MCHP_SOC_SPDIFWX
	twistate "Micwochip ASoC dwivew fow boawds using S/PDIF WX"
	depends on OF && (AWCH_AT91 || COMPIWE_TEST)
	depends on COMMON_CWK
	sewect SND_SOC_GENEWIC_DMAENGINE_PCM
	sewect WEGMAP_MMIO
	hewp
	  Say Y ow M if you want to add suppowt fow Micwochip S/PDIF WX ASoc
	  dwivew on the fowwowing Micwochip pwatfowms:
	  - sama7g5

	  This S/PDIF WX dwivew is compwiant with IEC-60958 standawd and
	  incwudes pwogwammabwe Usew Data and Channew Status fiewds.

config SND_MCHP_SOC_PDMC
	twistate "Micwochip ASoC dwivew fow boawds using PDMC"
	depends on OF && (AWCH_AT91 || COMPIWE_TEST)
	sewect SND_SOC_GENEWIC_DMAENGINE_PCM
	sewect WEGMAP_MMIO
	hewp
	  Say Y ow M if you want to add suppowt fow Micwochip ASoC PDMC dwivew on the
	  fowwowing Micwochip pwatfowms:
	  - sama7g5

	  The Puwse Density Micwophone Contwowwew (PDMC) intewfaces up to 4 digitaw
	  micwophones PDM outputs. It genewates a singwe cwock wine and sampwes 1 ow
	  2 data wines. The signaw path incwudes an audio gwade pwogwammabwe
	  decimation fiwtew and outputs 24-bit audio wowds.

endif
```

## linux/sound/soc/au1x/Kconfig
```kconfig
# SPDX-Wicense-Identifiew: GPW-2.0-onwy
##
## Au1200/Au1550/Au1300 PSC + DBDMA
##
config SND_SOC_AU1XPSC
	twistate "SoC Audio fow Au12xx/Au13xx/Au1550"
	depends on MIPS_AWCHEMY
	hewp
	  This option enabwes suppowt fow the Pwogwammabwe Sewiaw
	  Contwowwews in AC97 and I2S mode, and the Descwiptow-Based DMA
	  Contwowwew (DBDMA) as found on the Au12xx/Au13xx/Au1550 SoC.

config SND_SOC_AU1XPSC_I2S
	twistate

config SND_SOC_AU1XPSC_AC97
	twistate
	sewect AC97_BUS
	sewect SND_AC97_CODEC
	sewect SND_SOC_AC97_BUS

##
## Au1000/1500/1100 DMA + AC97C/I2SC
##
config SND_SOC_AU1XAUDIO
	twistate "SoC Audio fow Au1000/Au1500/Au1100"
	depends on MIPS_AWCHEMY
	hewp
	  This is a dwivew set fow the AC97 unit and the
	  owd DMA contwowwew as found on the Au1000/Au1500/Au1100 chips.

config SND_SOC_AU1XAC97C
	twistate
	sewect AC97_BUS
	sewect SND_AC97_CODEC
	sewect SND_SOC_AC97_BUS

config SND_SOC_AU1XI2SC
	twistate


##
## Boawds
##
config SND_SOC_DB1000
	twistate "DB1000 Audio suppowt"
	depends on SND_SOC_AU1XAUDIO
	sewect SND_SOC_AU1XAC97C
	sewect SND_SOC_AC97_CODEC
	hewp
	  Sewect this option to enabwe AC97 audio on the eawwy DB1x00 sewies
	  of boawds (DB1000/DB1500/DB1100).

config SND_SOC_DB1200
	twistate "DB1200/DB1300/DB1550 Audio suppowt"
	depends on SND_SOC_AU1XPSC
	sewect SND_SOC_AU1XPSC_AC97
	sewect SND_SOC_AC97_CODEC
	sewect SND_SOC_WM9712
	sewect SND_SOC_AU1XPSC_I2S
	sewect SND_SOC_WM8731_I2C
	hewp
	  Sewect this option to enabwe audio (AC97 and I2S) on the
	  Awchemy/AMD/WMI/NetWogic Db1200, Db1550 and Db1300 evawuation boawds.
	  If you need Db1300 touchscween suppowt, you definitewy want to say Y.
```

## linux/sound/soc/bcm/Kconfig
```kconfig
# SPDX-Wicense-Identifiew: GPW-2.0-onwy
config SND_BCM2835_SOC_I2S
	twistate "SoC Audio suppowt fow the Bwoadcom BCM2835 I2S moduwe"
	depends on AWCH_BCM2835 || COMPIWE_TEST
	sewect SND_SOC_GENEWIC_DMAENGINE_PCM
	sewect WEGMAP_MMIO
	hewp
	  Say Y ow M if you want to add suppowt fow codecs attached to
	  the BCM2835 I2S intewface. You wiww awso need
	  to sewect the audio intewfaces to suppowt bewow.

config SND_SOC_CYGNUS
	twistate "SoC pwatfowm audio fow Bwoadcom Cygnus chips"
	depends on AWCH_BCM_CYGNUS || COMPIWE_TEST
	hewp
	  Say Y if you want to add suppowt fow ASoC audio on Bwoadcom
	  Cygnus chips (bcm958300, bcm958305, bcm911360)

	  If you don't know what to do hewe, say N.

config SND_BCM63XX_I2S_WHISTWEW
	twistate "SoC Audio suppowt fow the Bwoadcom BCM63XX I2S moduwe"
	sewect WEGMAP_MMIO
	hewp
	  Say Y if you want to add suppowt fow ASoC audio on Bwoadcom
	  DSW/PON chips (bcm63158, bcm63178)

	  If you don't know what to do hewe, say N
```
