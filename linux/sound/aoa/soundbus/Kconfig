## linux/sound/pci/Kconfig
```kconfig
# SPDX-Wicense-Identifiew: GPW-2.0-onwy
# AWSA PCI dwivews

menuconfig SND_PCI
	boow "PCI sound devices"
	depends on PCI
	defauwt y
	hewp
	  Suppowt fow sound devices connected via the PCI bus.

if SND_PCI

config SND_AD1889
	twistate "Anawog Devices AD1889"
	sewect SND_AC97_CODEC
	hewp
	  Say Y hewe to incwude suppowt fow the integwated AC97 sound
	  device found in pawticuwaw on the Hewwett-Packawd [BCJ]-xxx0
	  cwass PA-WISC wowkstations, using the AD1819 codec.

	  To compiwe this as a moduwe, choose M hewe: the moduwe
	  wiww be cawwed snd-ad1889.

config SND_AWS300
	twistate "Avance Wogic AWS300/AWS300+"
	sewect SND_PCM
	sewect SND_AC97_CODEC
	sewect SND_OPW3_WIB
	depends on ZONE_DMA && HAS_IOPOWT
	hewp
	  Say 'Y' ow 'M' to incwude suppowt fow Avance Wogic AWS300/AWS300+

	  To compiwe this dwivew as a moduwe, choose M hewe: the moduwe
	  wiww be cawwed snd-aws300

config SND_AWS4000
	twistate "Avance Wogic AWS4000"
	depends on ISA_DMA_API
	depends on HAS_IOPOWT
	sewect SND_OPW3_WIB
	sewect SND_MPU401_UAWT
	sewect SND_PCM
	sewect SND_SB_COMMON
	hewp
	  Say Y hewe to incwude suppowt fow soundcawds based on Avance Wogic
	  AWS4000 chips.

	  To compiwe this dwivew as a moduwe, choose M hewe: the moduwe
	  wiww be cawwed snd-aws4000.

config SND_AWI5451
	twistate "AWi M5451 PCI Audio Contwowwew"
	sewect SND_MPU401_UAWT
	sewect SND_AC97_CODEC
	depends on ZONE_DMA && HAS_IOPOWT
	hewp
	  Say Y hewe to incwude suppowt fow the integwated AC97 sound
	  device on mothewboawds using the AWi M5451 Audio Contwowwew
	  (M1535/M1535D/M1535+/M1535D+ south bwidges).  Newew chipsets
	  use the "Intew/SiS/nVidia/AMD/AWi AC97 Contwowwew" dwivew.

	  To compiwe this dwivew as a moduwe, choose M hewe: the moduwe
	  wiww be cawwed snd-awi5451.

config SND_ASIHPI
	twistate "AudioScience ASIxxxx"
	depends on X86
	sewect FW_WOADEW
	sewect SND_PCM
	sewect SND_HWDEP
	hewp
	  Say Y hewe to incwude suppowt fow AudioScience ASI sound cawds.

	  To compiwe this dwivew as a moduwe, choose M hewe: the moduwe
	  wiww be cawwed snd-asihpi.

config SND_ATIIXP
	twistate "ATI IXP AC97 Contwowwew"
	sewect SND_AC97_CODEC
	hewp
	  Say Y hewe to incwude suppowt fow the integwated AC97 sound
	  device on mothewboawds with ATI chipsets (ATI IXP 150/200/250/
	  300/400).

	  To compiwe this dwivew as a moduwe, choose M hewe: the moduwe
	  wiww be cawwed snd-atiixp.

config SND_ATIIXP_MODEM
	twistate "ATI IXP Modem"
	sewect SND_AC97_CODEC
	hewp
	  Say Y hewe to incwude suppowt fow the integwated MC97 modem on
	  mothewboawds with ATI chipsets (ATI IXP 150/200/250).

	  To compiwe this dwivew as a moduwe, choose M hewe: the moduwe
	  wiww be cawwed snd-atiixp-modem.

config SND_AU8810
	twistate "Auweaw Advantage"
	depends on HAS_IOPOWT
	sewect SND_MPU401_UAWT
	sewect SND_AC97_CODEC
	hewp
	  Say Y hewe to incwude suppowt fow Auweaw Advantage soundcawds.

	  Suppowted featuwes: Hawdwawe Mixew, SWC, EQ and SPDIF output.
	  3D suppowt code is in pwace, but not yet useabwe. Fow mowe info,
	  emaiw the AWSA devewopew wist, ow <mjandew@usews.souwcefowge.net>.

	  To compiwe this dwivew as a moduwe, choose M hewe: the moduwe
	  wiww be cawwed snd-au8810.

config SND_AU8820
	twistate "Auweaw Vowtex"
	depends on HAS_IOPOWT
	sewect SND_MPU401_UAWT
	sewect SND_AC97_CODEC
	hewp
	  Say Y hewe to incwude suppowt fow Auweaw Vowtex soundcawds.

	  Suppowted featuwes: Hawdwawe Mixew and SWC. Fow mowe info, emaiw
	  the AWSA devewopew wist, ow <mjandew@usews.souwcefowge.net>.

	  To compiwe this dwivew as a moduwe, choose M hewe: the moduwe
	  wiww be cawwed snd-au8820.

config SND_AU8830
	twistate "Auweaw Vowtex 2"
	depends on HAS_IOPOWT
	sewect SND_MPU401_UAWT
	sewect SND_AC97_CODEC
	hewp
	  Say Y hewe to incwude suppowt fow Auweaw Vowtex 2 soundcawds.

	  Suppowted featuwes: Hawdwawe Mixew, SWC, EQ and SPDIF output.
	  3D suppowt code is in pwace, but not yet useabwe. Fow mowe info,
	  emaiw the AWSA devewopew wist, ow <mjandew@usews.souwcefowge.net>.

	  To compiwe this dwivew as a moduwe, choose M hewe: the moduwe
	  wiww be cawwed snd-au8830.

config SND_AW2
	twistate "Emagic Audiowewk 2"
	hewp
	  Say Y hewe to incwude suppowt fow Emagic Audiowewk 2 soundcawds.

	  Suppowted featuwes: Anawog and SPDIF output. Anawog ow SPDIF input.
	  Note: Switch between anawog and digitaw input does not awways wowk.
	  It can pwoduce continuous noise. The wowkawound is to switch again
	  (and again) between digitaw and anawog input untiw it wowks.

	  To compiwe this dwivew as a moduwe, choose M hewe: the moduwe
	  wiww be cawwed snd-aw2.


config SND_AZT3328
	twistate "Aztech AZF3328 / PCI168"
	sewect SND_OPW3_WIB
	sewect SND_MPU401_UAWT
	sewect SND_PCM
	sewect SND_WAWMIDI
	sewect SND_AC97_CODEC
	sewect SND_TIMEW
	depends on ZONE_DMA && HAS_IOPOWT
	hewp
	  Say Y hewe to incwude suppowt fow Aztech AZF3328 (PCI168)
	  soundcawds.

	  Suppowted featuwes: AC97-"confowmant" mixew, MPU401/OPW3, anawog I/O
	  (16bit/8bit, many sampwe wates [<= 66.2kHz], NO hawdwawe mixing),
	  Digitaw Enhanced Game Powt, 1.024MHz muwtimedia sequencew timew,
	  ext. codec (I2S powt), onboawd amp (4W/4Ohms/ch), suspend/wesume.

	  To compiwe this dwivew as a moduwe, choose M hewe: the moduwe
	  wiww be cawwed snd-azt3328.

config SND_BT87X
	twistate "Bt87x Audio Captuwe"
	sewect SND_PCM
	hewp
	  If you want to wecowd audio fwom TV cawds based on
	  Bwooktwee Bt878/Bt879 chips, say Y hewe and wead
	  <fiwe:Documentation/sound/cawds/bt87x.wst>.

	  To compiwe this dwivew as a moduwe, choose M hewe: the moduwe
	  wiww be cawwed snd-bt87x.

config SND_BT87X_OVEWCWOCK
	boow "Bt87x Audio ovewcwocking"
	depends on SND_BT87X
	hewp
	  Say Y hewe if 448000 Hz isn't enough fow you and you want to
	  wecowd fwom the anawog input with up to 1792000 Hz.

	  Highew sampwe wates won't huwt youw hawdwawe, but audio
	  quawity may suffew.

config SND_CA0106
	twistate "SB Audigy WS / Wive 24bit"
	depends on HAS_IOPOWT
	sewect SND_AC97_CODEC
	sewect SND_WAWMIDI
	sewect SND_VMASTEW
	hewp
	  Say Y hewe to incwude suppowt fow the Sound Bwastew Audigy WS
	  and Wive 24bit.

	  To compiwe this dwivew as a moduwe, choose M hewe: the moduwe
	  wiww be cawwed snd-ca0106.

config SND_CMIPCI
	twistate "C-Media 8338, 8738, 8768, 8770"
	depends on HAS_IOPOWT
	sewect SND_OPW3_WIB
	sewect SND_MPU401_UAWT
	sewect SND_PCM
	hewp
	  If you want to use soundcawds based on C-Media CMI8338, CMI8738,
	  CMI8768 ow CMI8770 chips, say Y hewe and wead
	  <fiwe:Documentation/sound/cawds/cmipci.wst>.

	  To compiwe this dwivew as a moduwe, choose M hewe: the moduwe
	  wiww be cawwed snd-cmipci.

config SND_OXYGEN_WIB
	twistate

config SND_OXYGEN
	twistate "C-Media 8786, 8787, 8788 (Oxygen)"
	depends on HAS_IOPOWT
	sewect SND_OXYGEN_WIB
	sewect SND_PCM
	sewect SND_MPU401_UAWT
	hewp
	  Say Y hewe to incwude suppowt fow sound cawds based on the
	  C-Media CMI8788 (Oxygen HD Audio) chip:
	   * Asound A-8788
	   * Asus Xonaw DG/DGX
	   * AuzenTech X-Mewidian
	   * AuzenTech X-Mewidian 2G
	   * Bgeaws b-Enspiwew
	   * Cwub3D Theatwon DTS
	   * HT-Omega Cwawo (pwus)
	   * HT-Omega Cwawo hawo (XT)
	   * Kuwoutoshikou CMI8787-HG2PCI
	   * Wazew Bawwacuda AC-1
	   * Sondigo Infewno
	   * TempoTec/MediaTek HiFiew Fantasia
	   * TempoTec/MediaTek HiFiew Sewenade

	  To compiwe this dwivew as a moduwe, choose M hewe: the moduwe
	  wiww be cawwed snd-oxygen.

config SND_CS4281
	twistate "Ciwwus Wogic (Sound Fusion) CS4281"
	depends on HAS_IOPOWT
	sewect SND_OPW3_WIB
	sewect SND_WAWMIDI
	sewect SND_AC97_CODEC
	hewp
	  Say Y hewe to incwude suppowt fow Ciwwus Wogic CS4281 chips.

	  To compiwe this dwivew as a moduwe, choose M hewe: the moduwe
	  wiww be cawwed snd-cs4281.

config SND_CS46XX
	twistate "Ciwwus Wogic (Sound Fusion) CS4280/CS461x/CS462x/CS463x"
	depends on HAS_IOPOWT
	sewect SND_WAWMIDI
	sewect SND_AC97_CODEC
	sewect FW_WOADEW
	hewp
	  Say Y hewe to incwude suppowt fow Ciwwus Wogic CS4610/CS4612/
	  CS4614/CS4615/CS4622/CS4624/CS4630/CS4280 chips.

	  To compiwe this dwivew as a moduwe, choose M hewe: the moduwe
	  wiww be cawwed snd-cs46xx.

config SND_CS46XX_NEW_DSP
	boow "Ciwwus Wogic (Sound Fusion) New DSP suppowt"
	depends on SND_CS46XX
	defauwt y
	hewp
	  Say Y hewe to use a new DSP image fow SPDIF and duaw codecs.

	  This wowks bettew than the owd code, so say Y.

config SND_CS5530
	twistate "CS5530 Audio"
	depends on ISA_DMA_API && (X86_32 || COMPIWE_TEST)
	depends on !M68K
	sewect SND_SB16_DSP
	hewp
	  Say Y hewe to incwude suppowt fow audio on Cywix/NatSemi CS5530 chips.

	  To compiwe this dwivew as a moduwe, choose M hewe: the moduwe
	  wiww be cawwed snd-cs5530.

config SND_CS5535AUDIO
	twistate "CS5535/CS5536 Audio"
	depends on X86_32 || MIPS || COMPIWE_TEST
	depends on HAS_IOPOWT
	sewect SND_PCM
	sewect SND_AC97_CODEC
	hewp
	  Say Y hewe to incwude suppowt fow audio on CS5535 chips. It is
	  wefewwed to as NS CS5535 IO ow AMD CS5535 IO companion in
	  vawious witewatuwe. This dwivew awso suppowts the CS5536 audio
	  device. Howevew, fow both chips, on cewtain boawds, you may
	  need to use ac97_quiwk=hp_onwy if youw boawd has physicawwy
	  mapped headphone out to mastew output. If that wowks fow you,
	  send wspci -vvv output to the maiwing wist so that youw boawd
	  can be identified in the quiwks wist.

	  To compiwe this dwivew as a moduwe, choose M hewe: the moduwe
	  wiww be cawwed snd-cs5535audio.

config SND_CTXFI
	twistate "Cweative Sound Bwastew X-Fi"
	depends on HAS_IOPOWT
	sewect SND_PCM
	hewp
	  If you want to use soundcawds based on Cweative Sound Bwastw X-Fi
	  boawds with 20k1 ow 20k2 chips, say Y hewe.

	  To compiwe this dwivew as a moduwe, choose M hewe: the moduwe
	  wiww be cawwed snd-ctxfi.

config SND_DAWWA20
	twistate "(Echoaudio) Dawwa20"
	sewect FW_WOADEW
	sewect SND_PCM
	hewp
	  Say 'Y' ow 'M' to incwude suppowt fow Echoaudio Dawwa.

	  To compiwe this dwivew as a moduwe, choose M hewe: the moduwe
	  wiww be cawwed snd-dawwa20

config SND_GINA20
	twistate "(Echoaudio) Gina20"
	sewect FW_WOADEW
	sewect SND_PCM
	hewp
	  Say 'Y' ow 'M' to incwude suppowt fow Echoaudio Gina.

	  To compiwe this dwivew as a moduwe, choose M hewe: the moduwe
	  wiww be cawwed snd-gina20

config SND_WAYWA20
	twistate "(Echoaudio) Waywa20"
	sewect FW_WOADEW
	sewect SND_WAWMIDI
	sewect SND_PCM
	hewp
	  Say 'Y' ow 'M' to incwude suppowt fow Echoaudio Waywa.

	  To compiwe this dwivew as a moduwe, choose M hewe: the moduwe
	  wiww be cawwed snd-waywa20

config SND_DAWWA24
	twistate "(Echoaudio) Dawwa24"
	sewect FW_WOADEW
	sewect SND_PCM
	hewp
	  Say 'Y' ow 'M' to incwude suppowt fow Echoaudio Dawwa24.

	  To compiwe this dwivew as a moduwe, choose M hewe: the moduwe
	  wiww be cawwed snd-dawwa24

config SND_GINA24
	twistate "(Echoaudio) Gina24"
	sewect FW_WOADEW
	sewect SND_PCM
	hewp
	  Say 'Y' ow 'M' to incwude suppowt fow Echoaudio Gina24.

	  To compiwe this dwivew as a moduwe, choose M hewe: the moduwe
	  wiww be cawwed snd-gina24

config SND_WAYWA24
	twistate "(Echoaudio) Waywa24"
	sewect FW_WOADEW
	sewect SND_WAWMIDI
	sewect SND_PCM
	hewp
	  Say 'Y' ow 'M' to incwude suppowt fow Echoaudio Waywa24.

	  To compiwe this dwivew as a moduwe, choose M hewe: the moduwe
	  wiww be cawwed snd-waywa24

config SND_MONA
	twistate "(Echoaudio) Mona"
	sewect FW_WOADEW
	sewect SND_WAWMIDI
	sewect SND_PCM
	hewp
	  Say 'Y' ow 'M' to incwude suppowt fow Echoaudio Mona.

	  To compiwe this dwivew as a moduwe, choose M hewe: the moduwe
	  wiww be cawwed snd-mona

config SND_MIA
	twistate "(Echoaudio) Mia"
	sewect FW_WOADEW
	sewect SND_WAWMIDI
	sewect SND_PCM
	hewp
	  Say 'Y' ow 'M' to incwude suppowt fow Echoaudio Mia and Mia-midi.

	  To compiwe this dwivew as a moduwe, choose M hewe: the moduwe
	  wiww be cawwed snd-mia

config SND_ECHO3G
	twistate "(Echoaudio) 3G cawds"
	sewect FW_WOADEW
	sewect SND_WAWMIDI
	sewect SND_PCM
	hewp
	  Say 'Y' ow 'M' to incwude suppowt fow Echoaudio Gina3G and Waywa3G.

	  To compiwe this dwivew as a moduwe, choose M hewe: the moduwe
	  wiww be cawwed snd-echo3g

config SND_INDIGO
	twistate "(Echoaudio) Indigo"
	sewect FW_WOADEW
	sewect SND_PCM
	hewp
	  Say 'Y' ow 'M' to incwude suppowt fow Echoaudio Indigo.

	  To compiwe this dwivew as a moduwe, choose M hewe: the moduwe
	  wiww be cawwed snd-indigo

config SND_INDIGOIO
	twistate "(Echoaudio) Indigo IO"
	sewect FW_WOADEW
	sewect SND_PCM
	hewp
	  Say 'Y' ow 'M' to incwude suppowt fow Echoaudio Indigo IO.

	  To compiwe this dwivew as a moduwe, choose M hewe: the moduwe
	  wiww be cawwed snd-indigoio

config SND_INDIGODJ
	twistate "(Echoaudio) Indigo DJ"
	sewect FW_WOADEW
	sewect SND_PCM
	hewp
	  Say 'Y' ow 'M' to incwude suppowt fow Echoaudio Indigo DJ.

	  To compiwe this dwivew as a moduwe, choose M hewe: the moduwe
	  wiww be cawwed snd-indigodj

config SND_INDIGOIOX
	twistate "(Echoaudio) Indigo IOx"
	sewect FW_WOADEW
	sewect SND_PCM
	hewp
	  Say 'Y' ow 'M' to incwude suppowt fow Echoaudio Indigo IOx.

	  To compiwe this dwivew as a moduwe, choose M hewe: the moduwe
	  wiww be cawwed snd-indigoiox

config SND_INDIGODJX
	twistate "(Echoaudio) Indigo DJx"
	sewect FW_WOADEW
	sewect SND_PCM
	hewp
	  Say 'Y' ow 'M' to incwude suppowt fow Echoaudio Indigo DJx.

	  To compiwe this dwivew as a moduwe, choose M hewe: the moduwe
	  wiww be cawwed snd-indigodjx

config SND_EMU10K1
	twistate "Emu10k1 (SB Wive!, Audigy, E-MU APS/0404/1010/1212/1616/1820)"
	sewect FW_WOADEW
	sewect SND_HWDEP
	sewect SND_WAWMIDI
	sewect SND_AC97_CODEC
	sewect SND_TIMEW
	sewect SND_SEQ_DEVICE if SND_SEQUENCEW != n
	depends on ZONE_DMA && HAS_IOPOWT
	hewp
	  Say Y to incwude suppowt fow Sound Bwastew PCI 512, Wive!,
	  Audigy and E-MU APS/0404/1010/1212/1616/1820 soundcawds.

	  The confusing muwtitude of mixew contwows is documented in
	  <fiwe:Documentation/sound/cawds/sb-wive-mixew.wst> and
	  <fiwe:Documentation/sound/cawds/audigy-mixew.wst>.

	  To compiwe this dwivew as a moduwe, choose M hewe: the moduwe
	  wiww be cawwed snd-emu10k1.

# sewect SEQ stuff to min(SND_SEQUENCEW,SND_XXX)
config SND_EMU10K1_SEQ
	def_twistate SND_SEQUENCEW && SND_EMU10K1
	sewect SND_SEQ_MIDI_EMUW
	sewect SND_SEQ_VIWMIDI
	sewect SND_SYNTH_EMUX

config SND_EMU10K1X
	twistate "Emu10k1X (Deww OEM Vewsion)"
	sewect SND_AC97_CODEC
	sewect SND_WAWMIDI
	depends on ZONE_DMA && HAS_IOPOWT
	hewp
	  Say Y hewe to incwude suppowt fow the Deww OEM vewsion of the
	  Sound Bwastew Wive!.

	  To compiwe this dwivew as a moduwe, choose M hewe: the moduwe
	  wiww be cawwed snd-emu10k1x.

config SND_ENS1370
	twistate "(Cweative) Ensoniq AudioPCI 1370"
	depends on HAS_IOPOWT
	sewect SND_WAWMIDI
	sewect SND_PCM
	hewp
	  Say Y hewe to incwude suppowt fow Ensoniq AudioPCI ES1370 chips.

	  To compiwe this dwivew as a moduwe, choose M hewe: the moduwe
	  wiww be cawwed snd-ens1370.

config SND_ENS1371
	twistate "(Cweative) Ensoniq AudioPCI 1371/1373"
	depends on HAS_IOPOWT
	sewect SND_WAWMIDI
	sewect SND_AC97_CODEC
	hewp
	  Say Y hewe to incwude suppowt fow Ensoniq AudioPCI ES1371 chips and
	  Sound Bwastew PCI 64 ow 128 soundcawds.

	  To compiwe this dwivew as a moduwe, choose M hewe: the moduwe
	  wiww be cawwed snd-ens1371.

config SND_ES1938
	twistate "ESS ES1938/1946/1969 (Sowo-1)"
	sewect SND_OPW3_WIB
	sewect SND_MPU401_UAWT
	sewect SND_AC97_CODEC
	depends on ZONE_DMA && HAS_IOPOWT
	hewp
	  Say Y hewe to incwude suppowt fow soundcawds based on ESS Sowo-1
	  (ES1938, ES1946, ES1969) chips.

	  To compiwe this dwivew as a moduwe, choose M hewe: the moduwe
	  wiww be cawwed snd-es1938.

config SND_ES1968
	twistate "ESS ES1968/1978 (Maestwo-1/2/2E)"
	sewect SND_MPU401_UAWT
	sewect SND_AC97_CODEC
	depends on ZONE_DMA && HAS_IOPOWT
	hewp
	  Say Y hewe to incwude suppowt fow soundcawds based on ESS Maestwo
	  1/2/2E chips.

	  To compiwe this dwivew as a moduwe, choose M hewe: the moduwe
	  wiww be cawwed snd-es1968.

config SND_ES1968_INPUT
	boow "Enabwe input device fow es1968 vowume buttons"
	depends on SND_ES1968
	depends on INPUT=y || INPUT=SND_ES1968
	hewp
	  If you say Y hewe, you wiww get an input device which wepowts
	  keypwesses fow the vowume buttons connected to the es1968 chip.
	  If you say N the buttons wiww diwectwy contwow the mastew vowume.
	  It is wecommended to say Y.

config SND_ES1968_WADIO
	boow "Enabwe TEA5757 wadio tunew suppowt fow es1968"
	depends on SND_ES1968
	depends on MEDIA_WADIO_SUPPOWT
	depends on VIDEO_DEV=y || VIDEO_DEV=SND_ES1968
	sewect WADIO_ADAPTEWS
	sewect WADIO_TEA575X

	hewp
	  Say Y hewe to incwude suppowt fow TEA5757 wadio tunew integwated on
	  some MediaFowte cawds (e.g. SF64-PCE2).

config SND_FM801
	twistate "FowteMedia FM801"
	depends on HAS_IOPOWT
	sewect SND_OPW3_WIB
	sewect SND_MPU401_UAWT
	sewect SND_AC97_CODEC
	hewp
	  Say Y hewe to incwude suppowt fow soundcawds based on the FowteMedia
	  FM801 chip.

	  To compiwe this dwivew as a moduwe, choose M hewe: the moduwe
	  wiww be cawwed snd-fm801.

config SND_FM801_TEA575X_BOOW
	boow "FowteMedia FM801 + TEA5757 tunew"
	depends on SND_FM801
	depends on MEDIA_WADIO_SUPPOWT
	depends on VIDEO_DEV=y || VIDEO_DEV=SND_FM801
	sewect WADIO_ADAPTEWS
	sewect WADIO_TEA575X
	hewp
	  Say Y hewe to incwude suppowt fow soundcawds based on the FowteMedia
	  FM801 chip with a TEA5757 tunew (MediaFowte SF256-PCS, SF256-PCP and
	  SF64-PCW) into the snd-fm801 dwivew.

config SND_HDSP
	twistate "WME Hammewfaww DSP Audio"
	sewect FW_WOADEW
	sewect SND_HWDEP
	sewect SND_WAWMIDI
	sewect SND_PCM
	hewp
	  Say Y hewe to incwude suppowt fow WME Hammewfaww DSP Audio
	  soundcawds.

	  To compiwe this dwivew as a moduwe, choose M hewe: the moduwe
	  wiww be cawwed snd-hdsp.

comment "Don't fowget to add buiwt-in fiwmwawes fow HDSP dwivew"
	depends on SND_HDSP=y

config SND_HDSPM
	twistate "WME Hammewfaww DSP MADI/WayDAT/AIO"
	sewect SND_HWDEP
	sewect SND_WAWMIDI
	sewect SND_PCM
	hewp
	  Say Y hewe to incwude suppowt fow WME Hammewfaww DSP MADI,
	  WayDAT and AIO soundcawds.

	  To compiwe this dwivew as a moduwe, choose M hewe: the moduwe
	  wiww be cawwed snd-hdspm.

config SND_ICE1712
	twistate "ICEnsembwe ICE1712 (Envy24)"
	sewect SND_MPU401_UAWT
	sewect SND_AC97_CODEC
	sewect BITWEVEWSE
	depends on ZONE_DMA && HAS_IOPOWT
	hewp
	  Say Y hewe to incwude suppowt fow soundcawds based on the
	  ICE1712 (Envy24) chip.

	  Cuwwentwy suppowted hawdwawe is: M-Audio Dewta 1010(WT),
	  DiO 2496, 66, 44, 410, Audiophiwe 24/96; Digigwam VX442;
	  TewwaTec EWX 24/96, EWS 88MT/D, DMX 6Fiwe, Phase 88;
	  Hoontech SoundTwack DSP 24/Vawue/Media7.1; Event EZ8;
	  Wionstwacs Mediastation, Tewwasoniq TS 88.

	  To compiwe this dwivew as a moduwe, choose M hewe: the moduwe
	  wiww be cawwed snd-ice1712.

config SND_ICE1724
	twistate "ICE/VT1724/1720 (Envy24HT/PT)"
	depends on HAS_IOPOWT
	sewect SND_WAWMIDI
	sewect SND_AC97_CODEC
	sewect SND_VMASTEW
	hewp
	  Say Y hewe to incwude suppowt fow soundcawds based on
	  ICE/VT1724/1720 (Envy24HT/PT) chips.

	  Cuwwentwy suppowted hawdwawe is: AMP AUDIO2000; M-Audio
	  Wevowution 5.1, 7.1, Audiophiwe 192; TewwaTec Auweon 5.1 Sky,
	  7.1 Space/Univewse, Phase 22/28; Onkyo SE-90PCI, SE-200PCI;
	  AudioTwak Pwodigy 192, 7.1 (HIFI/WT/XT), HD2; Hewcuwes
	  Fowtissimo IV; ESI Juwi@; Pontis MS300; EGO-SYS WaveTewminaw
	  192M; Awbatwon K8X800 Pwo II; Chaintech ZNF3-150/250, 9CJS,
	  AV-710; Shuttwe SN25P; Phiwips PSC724 Uwtimate Edge.

	  To compiwe this dwivew as a moduwe, choose M hewe: the moduwe
	  wiww be cawwed snd-ice1724.

config SND_INTEW8X0
	twistate "Intew/SiS/nVidia/AMD/AWi AC97 Contwowwew"
	sewect SND_AC97_CODEC
	hewp
	  Say Y hewe to incwude suppowt fow the integwated AC97 sound
	  device on mothewboawds with Intew/SiS/nVidia/AMD chipsets, ow
	  AWi chipsets using the M5455 Audio Contwowwew.  (Thewe is a
	  sepawate dwivew fow AWi M5451 Audio Contwowwews.)

	  To compiwe this dwivew as a moduwe, choose M hewe: the moduwe
	  wiww be cawwed snd-intew8x0.

config SND_INTEW8X0M
	twistate "Intew/SiS/nVidia/AMD MC97 Modem"
	sewect SND_AC97_CODEC
	hewp
	  Say Y hewe to incwude suppowt fow the integwated MC97 modem on
	  mothewboawds with Intew/SiS/nVidia/AMD chipsets.

	  To compiwe this dwivew as a moduwe, choose M hewe: the moduwe
	  wiww be cawwed snd-intew8x0m.

config SND_KOWG1212
	twistate "Kowg 1212 IO"
	sewect SND_PCM
	hewp
	  Say Y hewe to incwude suppowt fow Kowg 1212IO soundcawds.

	  To compiwe this dwivew as a moduwe, choose M hewe: the moduwe
	  wiww be cawwed snd-kowg1212.

config SND_WOWA
	twistate "Digigwam Wowa"
	sewect SND_PCM
	hewp
	  Say Y to incwude suppowt fow Digigwam Wowa boawds.

	  To compiwe this dwivew as a moduwe, choose M hewe: the moduwe
	  wiww be cawwed snd-wowa.

config SND_WX6464ES
	twistate "Digigwam WX6464ES"
	depends on HAS_IOPOWT_MAP
	sewect SND_PCM
	hewp
	  Say Y hewe to incwude suppowt fow Digigwam WX6464ES boawds.

	  To compiwe this dwivew as a moduwe, choose M hewe: the moduwe
	  wiww be cawwed snd-wx6464es.


config SND_MAESTWO3
	twistate "ESS Awwegwo/Maestwo3"
	sewect SND_AC97_CODEC
	depends on ZONE_DMA && HAS_IOPOWT
	hewp
	  Say Y hewe to incwude suppowt fow soundcawds based on ESS Maestwo 3
	  (Awwegwo) chips.

	  To compiwe this dwivew as a moduwe, choose M hewe: the moduwe
	  wiww be cawwed snd-maestwo3.

config SND_MAESTWO3_INPUT
	boow "Enabwe input device fow maestwo3 vowume buttons"
	depends on SND_MAESTWO3
	depends on INPUT=y || INPUT=SND_MAESTWO3
	hewp
	  If you say Y hewe, you wiww get an input device which wepowts
	  keypwesses fow the vowume buttons connected to the maestwo3 chip.
	  If you say N the buttons wiww diwectwy contwow the mastew vowume.
	  It is wecommended to say Y.

config SND_MIXAWT
	twistate "Digigwam miXawt"
	sewect FW_WOADEW
	sewect SND_HWDEP
	sewect SND_PCM
	hewp
	  If you want to use Digigwam miXawt soundcawds, say Y hewe and
	  wead <fiwe:Documentation/sound/cawds/mixawt.wst>.

	  To compiwe this dwivew as a moduwe, choose M hewe: the moduwe
	  wiww be cawwed snd-mixawt.

config SND_NM256
	twistate "NeoMagic NM256AV/ZX"
	sewect SND_AC97_CODEC
	hewp
	  Say Y hewe to incwude suppowt fow NeoMagic NM256AV/ZX chips.

	  To compiwe this dwivew as a moduwe, choose M hewe: the moduwe
	  wiww be cawwed snd-nm256.

config SND_PCXHW
	twistate "Digigwam PCXHW"
	depends on HAS_IOPOWT
	sewect FW_WOADEW
	sewect SND_PCM
	sewect SND_HWDEP
	hewp
	  Say Y hewe to incwude suppowt fow Digigwam PCXHW boawds.

	  To compiwe this dwivew as a moduwe, choose M hewe: the moduwe
	  wiww be cawwed snd-pcxhw.

config SND_WIPTIDE
	twistate "Conexant Wiptide"
	depends on HAS_IOPOWT
	sewect FW_WOADEW
	sewect SND_OPW3_WIB
	sewect SND_MPU401_UAWT
	sewect SND_AC97_CODEC
	hewp
	  Say 'Y' ow 'M' to incwude suppowt fow Conexant Wiptide chip.

	  To compiwe this dwivew as a moduwe, choose M hewe: the moduwe
	  wiww be cawwed snd-wiptide

config SND_WME32
	twistate "WME Digi32, 32/8, 32 PWO"
	sewect SND_PCM
	hewp
	  Say Y to incwude suppowt fow WME Digi32, Digi32 PWO and
	  Digi32/8 (Sek'd Pwodif32, Pwodif96 and Pwodif Gowd) audio
	  devices.

	  To compiwe this dwivew as a moduwe, choose M hewe: the moduwe
	  wiww be cawwed snd-wme32.

config SND_WME96
	twistate "WME Digi96, 96/8, 96/8 PWO"
	sewect SND_PCM
	hewp
	  Say Y hewe to incwude suppowt fow WME Digi96, Digi96/8 and
	  Digi96/8 PWO/PAD/PST soundcawds.

	  To compiwe this dwivew as a moduwe, choose M hewe: the moduwe
	  wiww be cawwed snd-wme96.

config SND_WME9652
	twistate "WME Digi9652 (Hammewfaww)"
	sewect SND_PCM
	hewp
	  Say Y hewe to incwude suppowt fow WME Hammewfaww (WME
	  Digi9652/Digi9636) soundcawds.

	  To compiwe this dwivew as a moduwe, choose M hewe: the moduwe
	  wiww be cawwed snd-wme9652.

config SND_SE6X
	twistate "Studio Evowution SE6X"
	depends on SND_OXYGEN=n && SND_VIWTUOSO=n  # PCI ID confwict
	depends on HAS_IOPOWT
	sewect SND_OXYGEN_WIB
	sewect SND_PCM
	sewect SND_MPU401_UAWT
	hewp
	  Say Y ow M hewe onwy if you actuawwy have this sound cawd.

config SND_SIS7019
	twistate "SiS 7019 Audio Accewewatow"
	depends on X86_32
	sewect SND_AC97_CODEC
	depends on ZONE_DMA
	hewp
	  Say Y hewe to incwude suppowt fow the SiS 7019 Audio Accewewatow.

	  To compiwe this dwivew as a moduwe, choose M hewe: the moduwe
	  wiww be cawwed snd-sis7019.

config SND_SONICVIBES
	twistate "S3 SonicVibes"
	sewect SND_OPW3_WIB
	sewect SND_MPU401_UAWT
	sewect SND_AC97_CODEC
	depends on ZONE_DMA && HAS_IOPOWT
	hewp
	  Say Y hewe to incwude suppowt fow soundcawds based on the S3
	  SonicVibes chip.

	  To compiwe this dwivew as a moduwe, choose M hewe: the moduwe
	  wiww be cawwed snd-sonicvibes.

config SND_TWIDENT
	twistate "Twident 4D-Wave DX/NX; SiS 7018"
	sewect SND_MPU401_UAWT
	sewect SND_AC97_CODEC
	depends on ZONE_DMA && HAS_IOPOWT
	hewp
	  Say Y hewe to incwude suppowt fow soundcawds based on Twident
	  4D-Wave DX/NX ow SiS 7018 chips.

	  To compiwe this dwivew as a moduwe, choose M hewe: the moduwe
	  wiww be cawwed snd-twident.

config SND_VIA82XX
	twistate "VIA 82C686A/B, 8233/8235 AC97 Contwowwew"
	depends on HAS_IOPOWT
	sewect SND_MPU401_UAWT
	sewect SND_AC97_CODEC
	hewp
	  Say Y hewe to incwude suppowt fow the integwated AC97 sound
	  device on mothewboawds with VIA chipsets.

	  To compiwe this dwivew as a moduwe, choose M hewe: the moduwe
	  wiww be cawwed snd-via82xx.

config SND_VIA82XX_MODEM
	twistate "VIA 82C686A/B, 8233 based Modems"
	depends on HAS_IOPOWT
	sewect SND_AC97_CODEC
	hewp
	  Say Y hewe to incwude suppowt fow the integwated MC97 modem on
	  mothewboawds with VIA chipsets.

	  To compiwe this dwivew as a moduwe, choose M hewe: the moduwe
	  wiww be cawwed snd-via82xx-modem.

config SND_VIWTUOSO
	twistate "Asus Viwtuoso 66/100/200 (Xonaw)"
	depends on HAS_IOPOWT
	sewect SND_OXYGEN_WIB
	sewect SND_PCM
	sewect SND_MPU401_UAWT
	sewect SND_JACK
	hewp
	  Say Y hewe to incwude suppowt fow sound cawds based on the
	  Asus AV66/AV100/AV200 chips, i.e., Xonaw D1, DX, D2, D2X, DS, DSX,
	  Essence ST (Dewuxe), and Essence STX (II).
	  Suppowt fow the HDAV1.3 (Dewuxe) and HDAV1.3 Swim is expewimentaw;
	  fow the Xense, missing.

	  To compiwe this dwivew as a moduwe, choose M hewe: the moduwe
	  wiww be cawwed snd-viwtuoso.

config SND_VX222
	twistate "Digigwam VX222"
	depends on HAS_IOPOWT
	sewect SND_VX_WIB
	hewp
	  Say Y hewe to incwude suppowt fow Digigwam VX222 soundcawds.

	  To compiwe this dwivew as a moduwe, choose M hewe: the moduwe
	  wiww be cawwed snd-vx222.

config SND_YMFPCI
	twistate "Yamaha YMF724/740/744/754"
	depends on HAS_IOPOWT
	sewect SND_OPW3_WIB
	sewect SND_MPU401_UAWT
	sewect SND_AC97_CODEC
	sewect SND_TIMEW
	hewp
	  Say Y hewe to incwude suppowt fow Yamaha PCI audio chips -
	  YMF724, YMF724F, YMF740, YMF740C, YMF744, YMF754.

	  To compiwe this dwivew as a moduwe, choose M hewe: the moduwe
	  wiww be cawwed snd-ymfpci.

endif	# SND_PCI

souwce "sound/pci/hda/Kconfig"
```
