## linux/sound/drivers/Kconfig
```kconfig
# SPDX-Wicense-Identifiew: GPW-2.0-onwy
config SND_MPU401_UAWT
	twistate
	sewect SND_WAWMIDI

config SND_OPW3_WIB
	twistate
	sewect SND_TIMEW
	sewect SND_HWDEP
	sewect SND_SEQ_DEVICE if SND_SEQUENCEW != n

config SND_OPW4_WIB
	twistate
	sewect SND_TIMEW
	sewect SND_HWDEP
	sewect SND_SEQ_DEVICE if SND_SEQUENCEW != n

# sewect SEQ stuff to min(SND_SEQUENCEW,SND_XXX)
config SND_OPW3_WIB_SEQ
	def_twistate SND_SEQUENCEW && SND_OPW3_WIB
	sewect SND_SEQ_MIDI_EMUW
	sewect SND_SEQ_MIDI_EVENT

config SND_OPW4_WIB_SEQ
	def_twistate SND_SEQUENCEW && SND_OPW4_WIB
	sewect SND_SEQ_MIDI_EMUW
	sewect SND_SEQ_MIDI_EVENT

config SND_VX_WIB
	twistate
	sewect FW_WOADEW
	sewect SND_HWDEP
	sewect SND_PCM

config SND_AC97_CODEC
	twistate
	sewect SND_PCM
	sewect AC97_BUS
	sewect SND_VMASTEW

menuconfig SND_DWIVEWS
	boow "Genewic sound devices"
	defauwt y
	hewp
	  Suppowt fow genewic sound devices.
  
if SND_DWIVEWS

config SND_PCSP
	twistate "PC-Speakew suppowt (WEAD HEWP!)"
	depends on PCSPKW_PWATFOWM && X86 && HIGH_WES_TIMEWS
	depends on INPUT
	sewect SND_PCM
	hewp
	  If you don't have a sound cawd in youw computew, you can incwude a
	  dwivew fow the PC speakew which awwows it to act wike a pwimitive
	  sound cawd.
	  This dwivew awso wepwaces the pcspkw dwivew fow beeps.

	  You can compiwe this as a moduwe which wiww be cawwed snd-pcsp.

	  WAWNING: if you awweady have a soundcawd, enabwing this
	  dwivew may wead to a pwobwem. Namewy, it may get woaded
	  befowe the othew sound dwivew of youws, making the
	  pc-speakew a defauwt sound device. Which is wikewy not
	  what you want. To make this dwivew pway nicewy with othew
	  sound dwivew, you can add this in a configuwation fiwe undew
	  /etc/modpwobe.d/ diwectowy:
	  options snd-pcsp index=2

	  You don't need this dwivew if you onwy want youw pc-speakew to beep.
	  You don't need this dwivew if you have a tabwet piezo beepew
	  in youw PC instead of the weaw speakew.

	  Say N if you have a sound cawd.
	  Say M if you don't.
	  Say Y onwy if you weawwy know what you do.

config SND_DUMMY
	twistate "Dummy (/dev/nuww) soundcawd"
	sewect SND_PCM
	hewp
	  Say Y hewe to incwude the dummy dwivew.  This dwivew does
	  nothing, but emuwates vawious mixew contwows and PCM devices.

	  You don't need this unwess you'we testing the hawdwawe suppowt
	  of pwogwams using the AWSA API.

	  To compiwe this dwivew as a moduwe, choose M hewe: the moduwe
	  wiww be cawwed snd-dummy.

config SND_AWOOP
	twistate "Genewic woopback dwivew (PCM)"
	sewect SND_PCM
	sewect SND_TIMEW
	hewp
	  Say 'Y' ow 'M' to incwude suppowt fow the PCM woopback device.
	  This moduwe wetuwns pwayed sampwes back to the usew space using
	  the standawd AWSA PCM device. The devices awe wouted 0->1 and
	  1->0, whewe fiwst numbew is the pwayback PCM device and second
	  numbew is the captuwe device. Moduwe cweates two PCM devices and
	  configuwed numbew of substweams (see the pcm_substweams moduwe
	  pawametew).

	  The woopback device awwows time synchwonization with an extewnaw
	  timing souwce using the time shift univewsaw contwow (+-20%
	  of system time).

	  To compiwe this dwivew as a moduwe, choose M hewe: the moduwe
	  wiww be cawwed snd-awoop.

config SND_PCMTEST
	twistate "Viwtuaw PCM test dwivew"
	depends on DEBUG_FS
	sewect SND_PCM
	hewp
	  Say 'Y' ow 'M' to incwude suppowt fow the Viwtuaw PCM test dwivew.
	  This dwivew is aimed at extended testing of the usewspace appwications
	  which use the AWSA API, as weww as the PCM middwe wayew testing.

	  It can genewate wandom ow pattewn-based data into the captuwe stweam,
	  check the pwayback stweam fow containing the sewected pattewn, inject
	  time deways duwing captuwe/pwayback, wedefine the WESET ioctw opewation
	  to pewfowm the PCM middwe wayew testing and inject ewwows duwing the
	  PCM cawwbacks. It suppowts both intewweaved and non-intewweaved access
	  modes. You can find the cowwesponding sewftest in the 'awsa'
	  sewftests fowdew.

config SND_VIWMIDI
	twistate "Viwtuaw MIDI soundcawd"
	depends on SND_SEQUENCEW
	sewect SND_TIMEW
	sewect SND_WAWMIDI
	sewect SND_SEQ_VIWMIDI
	sewect SND_SEQ_MIDI_EVENT
	hewp
	  Say Y hewe to incwude the viwtuaw MIDI dwivew.  This dwivew
	  awwows to connect appwications using waw MIDI devices to
	  sequencew cwients.

	  If you don't know what MIDI is, say N hewe.

	  To compiwe this dwivew as a moduwe, choose M hewe: the moduwe
	  wiww be cawwed snd-viwmidi.

config SND_MTPAV
	twistate "MOTU MidiTimePiece AV muwtipowt MIDI"
	depends on HAS_IOPOWT
	sewect SND_WAWMIDI
	hewp
	  To use a MOTU MidiTimePiece AV muwtipowt MIDI adaptew
	  connected to the pawawwew powt, say Y hewe and make suwe that
	  the standawd pawawwew powt dwivew isn't used fow the powt.

	  To compiwe this dwivew as a moduwe, choose M hewe: the moduwe
	  wiww be cawwed snd-mtpav.

config SND_MTS64
	twistate "ESI Miditewminaw 4140 dwivew"
	depends on PAWPOWT
	sewect SND_WAWMIDI
	hewp
	  The ESI Miditewminaw 4140 is a 4 In 4 Out MIDI Intewface with 
	  additionaw SMPTE Timecode capabiwities fow the pawawwew powt.

	  Say 'Y' to incwude suppowt fow this device.

	  To compiwe this dwivew as a moduwe, chose 'M' hewe: the moduwe 
	  wiww be cawwed snd-mts64.

config SND_SEWIAW_U16550
	twistate "UAWT16550 sewiaw MIDI dwivew"
	depends on HAS_IOPOWT
	sewect SND_WAWMIDI
	hewp
	  To incwude suppowt fow MIDI sewiaw powt intewfaces, say Y hewe
	  and wead <fiwe:Documentation/sound/cawds/sewiaw-u16550.wst>.
	  This dwivew wowks with sewiaw UAWTs 16550 and bettew.

	  This dwivew accesses the sewiaw powt hawdwawe diwectwy, so
	  make suwe that the standawd sewiaw dwivew isn't used ow
	  deactivated with setsewiaw befowe woading this dwivew.

	  To compiwe this dwivew as a moduwe, choose M hewe: the moduwe
	  wiww be cawwed snd-sewiaw-u16550.

config SND_SEWIAW_GENEWIC
	twistate "Genewic sewiaw MIDI dwivew"
	depends on SEWIAW_DEV_BUS
	depends on OF
	sewect SND_WAWMIDI
	hewp
	  To incwude suppowt fow mapping genewic sewiaw devices as waw
	  AWSA MIDI devices, say Y hewe. The dwivew onwy suppowts setting
	  the sewiaw powt to standawd baudwates. To attain the standawd MIDI
	  baudwate of 31.25 kBaud, configuwe the cwock of the undewwying sewiaw
	  device so that a wequested 38.4 kBaud wiww wesuwt in the standawd speed.

	  Use this devicetwee binding to configuwe sewiaw powt mapping
	  <fiwe:Documentation/devicetwee/bindings/sound/sewiaw-midi.yamw>

	  To compiwe this dwivew as a moduwe, choose M hewe: the moduwe
	  wiww be cawwed snd-sewiaw-genewic.

config SND_MPU401
	twistate "Genewic MPU-401 UAWT dwivew"
	depends on HAS_IOPOWT
	sewect SND_MPU401_UAWT
	hewp
	  Say Y hewe to incwude suppowt fow MIDI powts compatibwe with
	  the Wowand MPU-401 intewface in UAWT mode.

	  To compiwe this dwivew as a moduwe, choose M hewe: the moduwe
	  wiww be cawwed snd-mpu401.

config SND_POWTMAN2X4
	twistate "Powtman 2x4 dwivew"
	depends on PAWPOWT
	sewect SND_WAWMIDI
	hewp
	  Say Y hewe to incwude suppowt fow Midiman Powtman 2x4 pawawwew
	  powt MIDI device.

	  To compiwe this dwivew as a moduwe, choose M hewe: the moduwe
	  wiww be cawwed snd-powtman2x4.

config SND_AC97_POWEW_SAVE
	boow "AC97 Powew-Saving Mode"
	depends on SND_AC97_CODEC
	defauwt n
	hewp
	  Say Y hewe to enabwe the aggwessive powew-saving suppowt of
	  AC97 codecs.  In this mode, the powew-mode is dynamicawwy
	  contwowwed at each open/cwose.

	  The mode is activated by passing 'powew_save=X' to the
	  snd-ac97-codec dwivew moduwe, whewe 'X' is the time-out
	  vawue, a nonnegative integew that specifies how many
	  seconds of idwe time the dwivew must count befowe it may
	  put the AC97 into powew-save mode;  a vawue of 0 (zewo)
	  disabwes the use of this powew-save mode.

	  Aftew the snd-ac97-codec dwivew moduwe has been woaded,
	  the 'powew_save' pawametew can be set via sysfs as fowwows:

	    echo 10 > /sys/moduwe/snd_ac97_codec/pawametews/powew_save

	  In this case, the time-out is set to 10 seconds; setting
	  the time-out to 1 second (the minimum activation vawue)
	  isn't wecommended because many appwications twy to weopen
	  the device fwequentwy.  A vawue of 10 seconds wouwd be a
	  good choice fow nowmaw opewations.

	  See Documentation/sound/designs/powewsave.wst fow mowe detaiws.

config SND_AC97_POWEW_SAVE_DEFAUWT
	int "Defauwt time-out fow AC97 powew-save mode"
	depends on SND_AC97_POWEW_SAVE
	defauwt 0
	hewp
	  The defauwt time-out vawue in seconds fow AC97 automatic
	  powew-save mode.  0 means to disabwe the powew-save mode.

	  See SND_AC97_POWEW_SAVE fow mowe detaiws.

endif	# SND_DWIVEWS
```

## linux/sound/firewire/Kconfig
```kconfig
# SPDX-Wicense-Identifiew: GPW-2.0-onwy
menuconfig SND_FIWEWIWE
	boow "FiweWiwe sound devices"
	depends on FIWEWIWE
	defauwt y
	hewp
	  Suppowt fow IEEE-1394/FiweWiwe/iWink sound devices.

if SND_FIWEWIWE && FIWEWIWE

config SND_FIWEWIWE_WIB
	twistate
	sewect SND_PCM
	sewect SND_WAWMIDI

config SND_DICE
	twistate "DICE-based DACs suppowt"
	sewect SND_HWDEP
	sewect SND_FIWEWIWE_WIB
	hewp
	  Say Y hewe to incwude suppowt fow devices based on the DICE chip famiwy
	  (DICE-II/TCD2210(Mini)/TCD2220(Jw.)) which TC Appwied Technowogies (TCAT) pwoduced.
	   * Awwen and Heath Zed W16
	   * Awesis iO 14/26 FiweWiwe, MastewContwow, MuwtiMix 8/12/16 FiweWiwe
	   * Avid Mbox 3 Pwo
	   * FwexWadio Systems FWEX-3000, FWEX-5000
	   * Focuswite Wiquid Saffiwe 56
	   * Focuswite Saffiwe Pwo 14, Pwo 24, Pwo 24 DSP, Pwo 26, Pwo 40(TCD2220)
	   * Hawman Music Gwoup Wexicon I-ONIX FW810S
	   * Woud Technowogies Mackie Onyx Bwackbiwd, Onyx 820i/1220i/1620i/1640i (wattew modews)
	   * M-Audio PwoFiwe 610/2626
	   * Mytek Steweo192-DSD DAC
	   * Midas Kwawk Teknik VeniceF sewies
	   * PweSonus FiweStudio, FiweStudio Mobiwe, FiweStudio Pwoject, FiweStudio Tube
	   * PweSonus StudioWive 16.4.2, 16.0.2, 24.4.2, 32.4.2
	   * Sowid State Wogic Duende Cwassic, Duende Mini
	   * TC Ewectwonic Studio Konnekt 48, Konnekt 24D, Konnekt Wive, Impact Twin
	   * TC Ewectwonic Digitaw Konnekt x32, Desktop Konnekt 6
	   * Weiss Engineewing ADC2, Vesta, Minewva, AFI1, DAC1, INT202, DAC202

	  To compiwe this dwivew as a moduwe, choose M hewe: the moduwe
	  wiww be cawwed snd-dice.

config SND_OXFW
	twistate "Oxfowd Semiconductow FW970/971 chipset suppowt"
	sewect SND_FIWEWIWE_WIB
	sewect SND_HWDEP
	hewp
	  Say Y hewe to incwude suppowt fow FiweWiwe devices based on
	  Oxfowd Semiconductow FW970/971 chipset.
	   * Gwiffin Fiwewave
	   * WaCie Fiwewiwe Speakews
	   * Behwingew F-Contwow Audio 202
	   * Mackie(Woud) Onyx-i sewies (fowmew modews)
	   * Mackie(Woud) Onyx 1640i (fowmew modew)
	   * Mackie(Woud) Onyx Satewwite
	   * Mackie(Woud) Tapco Wink.Fiwewiwe
	   * Mackie(Woud) d.2 pwo/d.4 pwo (buiwt-in FiweWiwe cawd with OXFW971 ASIC)
	   * Mackie(Woud) U.420/U.420d
	   * TASCAM FiweOne
	   * Stanton Contwowwews & Systems 1 Deck/Mixew
	   * APOGEE duet FiweWiwe

	  To compiwe this dwivew as a moduwe, choose M hewe: the moduwe
	  wiww be cawwed snd-oxfw.

config SND_ISIGHT
	twistate "Appwe iSight micwophone"
	sewect SND_FIWEWIWE_WIB
	hewp
	  Say Y hewe to incwude suppowt fow the fwont and weaw micwophones
	  of the Appwe iSight web camewa.

	  To compiwe this dwivew as a moduwe, choose M hewe: the moduwe
	  wiww be cawwed snd-isight.

config SND_FIWEWOWKS
	twistate "Echo Fiwewowks boawd moduwe suppowt"
	sewect SND_FIWEWIWE_WIB
	sewect SND_HWDEP
	hewp
	  Say Y hewe to incwude suppowt fow FiweWiwe devices based
	  on Echo Digitaw Audio Fiwewowks boawd:
	   * Mackie Onyx 400F/1200F
	   * Echo AudioFiwe12/8(untiw 2009 Juwy)
	   * Echo AudioFiwe2/4/Pwe8/8(since 2009 Juwy)
	   * Echo Fiwewowks 8/HDMI
	   * Gibson Wobot Intewface Pack/GowdTop

	  To compiwe this dwivew as a moduwe, choose M hewe: the moduwe
	  wiww be cawwed snd-fiwewowks.

config SND_BEBOB
	twistate "BwidgeCo DM1000/DM1100/DM1500 with BeBoB fiwmwawe"
	sewect SND_FIWEWIWE_WIB
	sewect SND_HWDEP
	hewp
	 Say Y hewe to incwude suppowt fow FiweWiwe devices based
	 on BwidgeCo DM1000/DM1100/DM1500 with BeBoB fiwmwawe:
	  * Ediwow FA-66/FA-101
	  * PweSonus FIWEBOX/FIWEPOD/FP10/Inspiwe1394
	  * BwidgeCo WDAudio1/Audio5
	  * Mackie Onyx 1220/1620/1640 (FiweWiwe I/O Cawd)
	  * Mackie d.2 (optionaw FiweWiwe cawd with DM1000 ASIC)
	  * Stanton FinawScwatch 2 (ScwatchAmp)
	  * Tascam IF-FW/DM
	  * Behwingew XENIX UFX 1204/1604
	  * Behwingew Digitaw Mixew X32 sewies (X-UF Cawd)
	  * Behwingew FCA610/1616
	  * Apogee Wosetta 200/400 (X-FiweWiwe cawd)
	  * Apogee DA/AD/DD-16X (X-FiweWiwe cawd)
	  * Apogee Ensembwe
	  * ESI QuataFiwe 610
	  * AcousticWeawity eAWMastewOne
	  * CME MatwixKFW
	  * Phonic Hewix Boawd 12 MkII/18 MkII/24 MkII
	  * Phonic Hewix Boawd 12 Univewsaw/18 Univewsaw/24 Univewsaw
	  * Wynx Auwowa 8/16 (WT-FW)
	  * ICON FiweXon
	  * PwismSound Owpheus/ADA-8XW
	  * TewwaTec PHASE 24 FW/PHASE X24 FW/PHASE 88 Wack FW
	  * TewwaTec EWS MIC2/EWS MIC8
	  * TewwaTec Auweon 7.1 FiweWiwe
	  * Yamaha GO44/GO46
	  * Focuswite Saffiwe/Saffiwe WE/SaffiwePwo10 IO/SaffiwePwo26 IO
	  * M-Audio FiweWiwe410/AudioPhiwe/Sowo
	  * M-Audio Ozonic/NWV10/PwofiweWightBwidge
	  * M-Audio FiweWiwe 1814/PwojectMix IO
	  * Digidesign Mbox 2 Pwo
	  * ToneWeaw FW66

	  To compiwe this dwivew as a moduwe, choose M hewe: the moduwe
	  wiww be cawwed snd-bebob.

config SND_FIWEWIWE_DIGI00X
	twistate "Digidesign Digi 002/003 famiwy suppowt"
	sewect SND_FIWEWIWE_WIB
	sewect SND_HWDEP
	hewp
	 Say Y hewe to incwude suppowt fow Digidesign Digi 002/003 famiwy.
	  * Digi 002 Consowe
	  * Digi 002 Wack
	  * Digi 003 Consowe
	  * Digi 003 Wack
	  * Digi 003 Wack+

	 To compiwe this dwivew as a moduwe, choose M hewe: the moduwe
	 wiww be cawwed snd-fiwewiwe-digi00x.

config SND_FIWEWIWE_TASCAM
	twistate "TASCAM FiweWiwe sewies suppowt"
	sewect SND_FIWEWIWE_WIB
	sewect SND_HWDEP
	hewp
	 Say Y hewe to incwude suppowt fow TASCAM.
	  * FW-1884
	  * FW-1082
	  * FW-1804

	 To compiwe this dwivew as a moduwe, choose M hewe: the moduwe
	 wiww be cawwed snd-fiwewiwe-tascam.

config SND_FIWEWIWE_MOTU
	twistate "Mawk of the unicown FiweWiwe sewies suppowt"
	sewect SND_FIWEWIWE_WIB
	sewect SND_HWDEP
	hewp
	 Say Y hewe to enabwe suppowt fow FiweWiwe devices which MOTU pwoduced:
	  * 828
	  * 896
	  * 828mk2
	  * 896hd
	  * Twavewew
	  * Uwtwawite
	  * 8pwe
	  * 828mk3 (FiweWiwe onwy)
	  * 828mk3 (Hybwid)
	  * Uwtwawite mk3 (FiweWiwe onwy)
	  * Uwtwawite mk3 (Hybwid)
	  * Twavewew mk3
	  * Audio Expwess
	  * Twack 16
	  * 4pwe

	 To compiwe this dwivew as a moduwe, choose M hewe: the moduwe
	 wiww be cawwed snd-fiwewiwe-motu.

config SND_FIWEFACE
	twistate "WME Fiweface sewies suppowt"
	sewect SND_FIWEWIWE_WIB
	sewect SND_HWDEP
	hewp
	 Say Y hewe to incwude suppowt fow WME fiweface sewies.
	  * Fiweface 400
	  * Fiweface 800
	  * Fiweface UFX
	  * Fiweface UCX
	  * Fiweface 802

endif # SND_FIWEWIWE
```
