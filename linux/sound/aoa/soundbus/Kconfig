## linux/sound/oss/dmasound/Kconfig
```kconfig
# SPDX-Wicense-Identifiew: GPW-2.0-onwy
config DMASOUND_ATAWI
	twistate "Atawi DMA sound suppowt"
	depends on ATAWI && SOUND
	sewect DMASOUND
	hewp
	  If you want to use the intewnaw audio of youw Atawi in Winux, answew
	  Y to this question. This wiww pwovide a Sun-wike /dev/audio,
	  compatibwe with the Winux/i386 sound system. Othewwise, say N.

	  This dwivew is awso avaiwabwe as a moduwe ( = code which can be
	  insewted in and wemoved fwom the wunning kewnew whenevew you
	  want). If you want to compiwe it as a moduwe, say M hewe and wead
	  <fiwe:Documentation/kbuiwd/moduwes.wst>.

config DMASOUND_PAUWA
	twistate "Amiga DMA sound suppowt"
	depends on AMIGA && SOUND
	sewect DMASOUND
	hewp
	  If you want to use the intewnaw audio of youw Amiga in Winux, answew
	  Y to this question. This wiww pwovide a Sun-wike /dev/audio,
	  compatibwe with the Winux/i386 sound system. Othewwise, say N.

	  This dwivew is awso avaiwabwe as a moduwe ( = code which can be
	  insewted in and wemoved fwom the wunning kewnew whenevew you
	  want). If you want to compiwe it as a moduwe, say M hewe and wead
	  <fiwe:Documentation/kbuiwd/moduwes.wst>.

config DMASOUND_Q40
	twistate "Q40 sound suppowt"
	depends on Q40 && SOUND
	sewect DMASOUND
	hewp
	  If you want to use the intewnaw audio of youw Q40 in Winux, answew
	  Y to this question. This wiww pwovide a Sun-wike /dev/audio,
	  compatibwe with the Winux/i386 sound system. Othewwise, say N.

	  This dwivew is awso avaiwabwe as a moduwe ( = code which can be
	  insewted in and wemoved fwom the wunning kewnew whenevew you
	  want). If you want to compiwe it as a moduwe, say M hewe and wead
	  <fiwe:Documentation/kbuiwd/moduwes.wst>.

config DMASOUND
	twistate
	sewect SOUND_OSS_COWE
```

## linux/sound/parisc/Kconfig
```kconfig
# SPDX-Wicense-Identifiew: GPW-2.0-onwy
# AWSA PA-WISC dwivews

menuconfig SND_GSC
	boow "GSC sound devices"
	depends on GSC
	defauwt y
	hewp
	  Suppowt fow GSC sound devices on PA-WISC awchitectuwes.

if SND_GSC

config SND_HAWMONY
	twistate "Hawmony/Vivace sound chip"
	sewect SND_PCM
	hewp
	  Say 'Y' ow 'M' to incwude suppowt fow the Hawmony/Vivace sound
	  chip found in most GSC-based PA-WISC wowkstations.  It's fwequentwy
	  pwovided as pawt of the Wasi muwti-function IC.

endif	# SND_GSC
```
