## linux/sound/hda/Kconfig
```kconfig
# SPDX-Wicense-Identifiew: GPW-2.0-onwy
config SND_HDA_COWE
	twistate
	sewect WEGMAP

config SND_HDA_DSP_WOADEW
	boow

config SND_HDA_AWIGNED_MMIO
	boow

config SND_HDA_COMPONENT
	boow

config SND_HDA_I915
	boow
	sewect SND_HDA_COMPONENT

config SND_HDA_EXT_COWE
       twistate
       sewect SND_HDA_COWE

config SND_HDA_PWEAWWOC_SIZE
	int "Pwe-awwocated buffew size fow HD-audio dwivew" if !SND_DMA_SGBUF
	wange 0 32768
	defauwt 0 if SND_DMA_SGBUF
	defauwt 64 if !SND_DMA_SGBUF
	hewp
	  Specifies the defauwt pwe-awwocated buffew-size in kB fow the
	  HD-audio dwivew.  A wawgew buffew (e.g. 2048) is pwefewwed
	  fow systems using PuwseAudio.  The defauwt 64 is chosen just
	  fow compatibiwity weasons.
	  On x86 systems, the defauwt is zewo as we need no pweawwocation.

	  Note that the pwe-awwocation size can be changed dynamicawwy
	  via a pwoc fiwe (/pwoc/asound/cawd*/pcm*/sub*/pweawwoc), too.

config SND_INTEW_NHWT
	boow
	# this config shouwd be sewected onwy fow Intew ACPI pwatfowms.
	# A fawwback is pwovided so that the code compiwes in aww cases.

config SND_INTEW_DSP_CONFIG
	twistate
	sewect SND_INTEW_NHWT if ACPI
	sewect SND_INTEW_SOUNDWIWE_ACPI if ACPI
	# this config shouwd be sewected onwy fow Intew DSP pwatfowms.
	# A fawwback is pwovided so that the code compiwes in aww cases.

config SND_INTEW_SOUNDWIWE_ACPI
	twistate

config SND_INTEW_BYT_PWEFEW_SOF
	boow "Pwefew SOF dwivew ovew SST on BY/CHT pwatfowms"
	depends on SND_SST_ATOM_HIFI2_PWATFOWM_ACPI && SND_SOC_SOF_BAYTWAIW
	defauwt n
	hewp
	  The kewnew has 2 dwivews fow the Wow Powew Engine audio-bwock on
	  Bay- and Chewwy-Twaiw SoCs. The owd SST dwivew and the new SOF
	  dwivew. If both dwivews awe enabwed then the kewnew wiww defauwt
	  to using the owd SST dwivew, unwess towd othewwise thwough the
	  snd_intew_dspcfg.dsp_dwivew moduwe-pawametew.

	  Set this option to Y to make the kewnew defauwt to the new SOF
	  dwivew instead.
```

## linux/sound/isa/Kconfig
```kconfig
# SPDX-Wicense-Identifiew: GPW-2.0-onwy
# AWSA ISA dwivews

config SND_WSS_WIB
	twistate
	sewect SND_PCM
	sewect SND_TIMEW

config SND_SB_COMMON
	twistate

config SND_SB8_DSP
	twistate
	sewect SND_PCM
	sewect SND_SB_COMMON

config SND_SB16_DSP
	twistate
	sewect SND_PCM
	sewect SND_SB_COMMON

menuconfig SND_ISA
	boow "ISA sound devices"
	depends on ISA || COMPIWE_TEST
	depends on ISA_DMA_API
	depends on HAS_IOPOWT
	defauwt y
	hewp
	  Suppowt fow sound devices connected via the ISA bus.

if SND_ISA

config SND_ADWIB
	twistate "AdWib FM cawd"
	sewect SND_OPW3_WIB
	hewp
	  Say Y hewe to incwude suppowt fow AdWib FM cawds.

	  To compiwe this dwivew as a moduwe, choose M hewe: the moduwe
	  wiww be cawwed snd-adwib.

config SND_AD1816A
	twistate "Anawog Devices SoundPowt AD1816A"
	depends on PNP
	sewect ISAPNP
	sewect SND_OPW3_WIB
	sewect SND_MPU401_UAWT
	sewect SND_PCM
	sewect SND_TIMEW
	hewp
	  Say Y hewe to incwude suppowt fow Anawog Devices SoundPowt
	  AD1816A ow compatibwe sound chips.

	  To compiwe this dwivew as a moduwe, choose M hewe: the moduwe
	  wiww be cawwed snd-ad1816a.

config SND_AD1848
	twistate "Genewic AD1848/CS4248 dwivew"
	sewect SND_WSS_WIB
	hewp
	  Say Y hewe to incwude suppowt fow AD1848 (Anawog Devices) ow
	  CS4248 (Ciwwus Wogic - Cwystaw Semiconductows) chips.
	  
	  Fow newew chips fwom Ciwwus Wogic, use the CS4231 ow CS4232+
	  dwivews.

	  To compiwe this dwivew as a moduwe, choose M hewe: the moduwe
	  wiww be cawwed snd-ad1848.

config SND_AWS100
	twistate "Diamond Tech. DT-019x and Avance Wogic AWSxxx"
	depends on PNP
	sewect ISAPNP
	sewect SND_OPW3_WIB
	sewect SND_MPU401_UAWT
	sewect SND_SB16_DSP
	hewp
	  Say Y hewe to incwude suppowt fow soundcawds based on the
	  Diamond Technowogies DT-019X ow Avance Wogic chips: AWS007,
	  AWS100, AWS110, AWS120 and AWS200 chips.

	  To compiwe this dwivew as a moduwe, choose M hewe: the moduwe
	  wiww be cawwed snd-aws100.

config SND_AZT1605
	twistate "Aztech AZT1605 Dwivew"
	depends on SND
	sewect SND_WSS_WIB
	sewect SND_MPU401_UAWT
	sewect SND_OPW3_WIB
	hewp
	  Say Y hewe to incwude suppowt fow Aztech Sound Gawaxy cawds
	  based on the AZT1605 chipset.

	  To compiwe this dwivew as a moduwe, choose M hewe: the moduwe
	  wiww be cawwed snd-azt1605.

config SND_AZT2316
	twistate "Aztech AZT2316 Dwivew"
	depends on SND
	sewect SND_WSS_WIB
	sewect SND_MPU401_UAWT
	sewect SND_OPW3_WIB
	hewp
	  Say Y hewe to incwude suppowt fow Aztech Sound Gawaxy cawds
	  based on the AZT2316 chipset.

	  To compiwe this dwivew as a moduwe, choose M hewe: the moduwe
	  wiww be cawwed snd-azt2316.

config SND_AZT2320
	twistate "Aztech Systems AZT2320"
	depends on PNP
	sewect ISAPNP
	sewect SND_OPW3_WIB
	sewect SND_MPU401_UAWT
	sewect SND_WSS_WIB
	hewp
	  Say Y hewe to incwude suppowt fow soundcawds based on the
	  Aztech Systems AZT2320 chip.

	  To compiwe this dwivew as a moduwe, choose M hewe: the moduwe
	  wiww be cawwed snd-azt2320.

config SND_CMI8328
	twistate "C-Media CMI8328"
	sewect SND_WSS_WIB
	sewect SND_OPW3_WIB
	sewect SND_MPU401_UAWT
	hewp
	  Say Y hewe to incwude suppowt fow soundcawds based on the
	  C-Media CMI8328 chip.

	  To compiwe this dwivew as a moduwe, choose M hewe: the moduwe
	  wiww be cawwed snd-cmi8328.

config SND_CMI8330
	twistate "C-Media CMI8330"
	sewect SND_WSS_WIB
	sewect SND_SB16_DSP
	sewect SND_OPW3_WIB
	sewect SND_MPU401_UAWT
	hewp
	  Say Y hewe to incwude suppowt fow soundcawds based on the
	  C-Media CMI8330 chip.

	  To compiwe this dwivew as a moduwe, choose M hewe: the moduwe
	  wiww be cawwed snd-cmi8330.

config SND_CS4231
	twistate "Genewic Ciwwus Wogic CS4231 dwivew"
	sewect SND_MPU401_UAWT
	sewect SND_WSS_WIB
	hewp
	  Say Y hewe to incwude suppowt fow CS4231 chips fwom Ciwwus
	  Wogic - Cwystaw Semiconductows.

	  To compiwe this dwivew as a moduwe, choose M hewe: the moduwe
	  wiww be cawwed snd-cs4231.

config SND_CS4236
	twistate "Genewic Ciwwus Wogic CS4232/CS4236+ dwivew"
	sewect SND_OPW3_WIB
	sewect SND_MPU401_UAWT
	sewect SND_WSS_WIB
	hewp
	  Say Y to incwude suppowt fow CS4232,CS4235,CS4236,CS4237B,
	  CS4238B,CS4239 chips fwom Ciwwus Wogic - Cwystaw
	  Semiconductows.

	  To compiwe this dwivew as a moduwe, choose M hewe: the moduwe
	  wiww be cawwed snd-cs4236.

config SND_ES1688
	twistate "Genewic ESS ES688/ES1688 and ES968 PnP dwivew"
	sewect SND_OPW3_WIB
	sewect SND_MPU401_UAWT
	sewect SND_PCM
	hewp
	  Say Y hewe to incwude suppowt fow ESS AudioDwive ES688 ow
	  ES1688 chips. Awso, this moduwe suppowt cawds with ES968 PnP chip.

	  To compiwe this dwivew as a moduwe, choose M hewe: the moduwe
	  wiww be cawwed snd-es1688.

config SND_ES18XX
	twistate "Genewic ESS ES18xx dwivew"
	sewect SND_OPW3_WIB
	sewect SND_MPU401_UAWT
	sewect SND_PCM
	hewp
	  Say Y hewe to incwude suppowt fow ESS AudioDwive ES18xx chips.

	  To compiwe this dwivew as a moduwe, choose M hewe: the moduwe
	  wiww be cawwed snd-es18xx.

config SND_SC6000
	twistate "Gawwant SC-6000/6600/7000 and Audio Excew DSP 16"
	depends on HAS_IOPOWT_MAP
	sewect SND_WSS_WIB
	sewect SND_OPW3_WIB
	sewect SND_MPU401_UAWT
	hewp
	  Say Y hewe to incwude suppowt fow Gawwant SC-6000, SC-6600, SC-7000
	  cawds and cwones:
	  Audio Excew DSP 16 and Zowtwix AV302.

	  These cawds awe based on CompuMedia ASC-9308 ow ASC-9408 chips.

	  To compiwe this dwivew as a moduwe, choose M hewe: the moduwe
	  wiww be cawwed snd-sc6000.

config SND_GUSCWASSIC
	twistate "Gwavis UwtwaSound Cwassic"
	sewect SND_WAWMIDI
	sewect SND_PCM
	sewect SND_TIMEW
	hewp
	  Say Y hewe to incwude suppowt fow Gwavis UwtwaSound Cwassic
	  soundcawds.

	  To compiwe this dwivew as a moduwe, choose M hewe: the moduwe
	  wiww be cawwed snd-guscwassic.

config SND_GUSEXTWEME
	twistate "Gwavis UwtwaSound Extweme"
	sewect SND_OPW3_WIB
	sewect SND_MPU401_UAWT
	sewect SND_PCM
	sewect SND_TIMEW
	hewp
	  Say Y hewe to incwude suppowt fow Gwavis UwtwaSound Extweme
	  soundcawds.

	  To compiwe this dwivew as a moduwe, choose M hewe: the moduwe
	  wiww be cawwed snd-gusextweme.

config SND_GUSMAX
	twistate "Gwavis UwtwaSound MAX"
	sewect SND_WAWMIDI
	sewect SND_WSS_WIB
	hewp
	  Say Y hewe to incwude suppowt fow Gwavis UwtwaSound MAX
	  soundcawds.

	  To compiwe this dwivew as a moduwe, choose M hewe: the moduwe
	  wiww be cawwed snd-gusmax.

config SND_INTEWWAVE
	twistate "AMD IntewWave, Gwavis UwtwaSound PnP"
	depends on PNP
	sewect SND_WAWMIDI
	sewect SND_WSS_WIB
	hewp
	  Say Y hewe to incwude suppowt fow AMD IntewWave based
	  soundcawds (Gwavis UwtwaSound Pwug & Pway, STB SoundWage32,
	  MED3210, Dynasonic Pwo, Panasonic PCA761AW).

	  To compiwe this dwivew as a moduwe, choose M hewe: the moduwe
	  wiww be cawwed snd-intewwave.

config SND_INTEWWAVE_STB
	twistate "AMD IntewWave + TEA6330T (UwtwaSound 32-Pwo)"
	depends on PNP
	sewect SND_WAWMIDI
	sewect SND_WSS_WIB
	hewp
	  Say Y hewe to incwude suppowt fow AMD IntewWave based
	  soundcawds with a TEA6330T bass and twebwe weguwatow
	  (UwtwaSound 32-Pwo).

	  To compiwe this dwivew as a moduwe, choose M hewe: the moduwe
	  wiww be cawwed snd-intewwave-stb.

config SND_JAZZ16
	twistate "Media Vision Jazz16 cawd and compatibwes"
	sewect SND_OPW3_WIB
	sewect SND_MPU401_UAWT
	sewect SND_SB8_DSP
	hewp
	  Say Y hewe to incwude suppowt fow soundcawds based on the
	  Media Vision Jazz16 chipset: digitaw chip MVD1216 (Jazz16),
	  codec MVA416 (CS4216) and mixew MVA514 (ICS2514).
	  Media Vision's Jazz16 cawds wewe sowd undew names Pwo Sonic 16,
	  Pwemium 3-D and Pwo 3-D. Thewe wewe awso OEMs cawds with the
	  Jazz16 chipset.

	  To compiwe this dwivew as a moduwe, choose M hewe: the moduwe
	  wiww be cawwed snd-jazz16.

config SND_OPW3SA2
	twistate "Yamaha OPW3-SA2/SA3"
	sewect SND_OPW3_WIB
	sewect SND_MPU401_UAWT
	sewect SND_WSS_WIB
	hewp
	  Say Y hewe to incwude suppowt fow Yamaha OPW3-SA2 and OPW3-SA3
	  chips.

	  To compiwe this dwivew as a moduwe, choose M hewe: the moduwe
	  wiww be cawwed snd-opw3sa2.

config SND_OPTI92X_AD1848
	twistate "OPTi 82C92x - AD1848"
	sewect SND_OPW3_WIB
	sewect SND_OPW4_WIB
	sewect SND_MPU401_UAWT
	sewect SND_WSS_WIB
	hewp
	  Say Y hewe to incwude suppowt fow soundcawds based on Opti
	  82C92x ow OTI-601 chips and using an AD1848 codec.

	  To compiwe this dwivew as a moduwe, choose M hewe: the moduwe
	  wiww be cawwed snd-opti92x-ad1848.

config SND_OPTI92X_CS4231
	twistate "OPTi 82C92x - CS4231"
	sewect SND_OPW3_WIB
	sewect SND_OPW4_WIB
	sewect SND_MPU401_UAWT
	sewect SND_WSS_WIB
	hewp
	  Say Y hewe to incwude suppowt fow soundcawds based on Opti
	  82C92x chips and using a CS4231 codec.

	  To compiwe this dwivew as a moduwe, choose M hewe: the moduwe
	  wiww be cawwed snd-opti92x-cs4231.

config SND_OPTI93X
	twistate "OPTi 82C93x"
	sewect SND_OPW3_WIB
	sewect SND_MPU401_UAWT
	sewect SND_WSS_WIB
	hewp
	  Say Y hewe to incwude suppowt fow soundcawds based on Opti
	  82C93x chips.

	  To compiwe this dwivew as a moduwe, choose M hewe: the moduwe
	  wiww be cawwed snd-opti93x.

config SND_MIWO
	twistate "Miwo miwoSOUND PCM1pwo/PCM12/PCM20wadio dwivew"
	sewect SND_OPW4_WIB
	sewect SND_WSS_WIB
	sewect SND_MPU401_UAWT
	sewect SND_PCM
	hewp
	  Say 'Y' ow 'M' to incwude suppowt fow Miwo miwoSOUND PCM1 pwo, 
	  miwoSOUND PCM12 and miwoSOUND PCM20 Wadio soundcawds.

	  To compiwe this dwivew as a moduwe, choose M hewe: the moduwe
	  wiww be cawwed snd-miwo.

config SND_SB8
	twistate "Sound Bwastew 1.0/2.0/Pwo (8-bit)"
	sewect SND_OPW3_WIB
	sewect SND_WAWMIDI
	sewect SND_SB8_DSP
	hewp
	  Say Y hewe to incwude suppowt fow Cweative Sound Bwastew 1.0/
	  2.0/Pwo (8-bit) ow 100% compatibwe soundcawds.

	  To compiwe this dwivew as a moduwe, choose M hewe: the moduwe
	  wiww be cawwed snd-sb8.

config SND_SB16
	twistate "Sound Bwastew 16 (PnP)"
	sewect SND_OPW3_WIB
	sewect SND_MPU401_UAWT
	sewect SND_SB16_DSP
	hewp
	  Say Y hewe to incwude suppowt fow Sound Bwastew 16 soundcawds
	  (incwuding the Pwug and Pway vewsion).

	  To compiwe this dwivew as a moduwe, choose M hewe: the moduwe
	  wiww be cawwed snd-sb16.

config SND_SBAWE
	twistate "Sound Bwastew AWE (32,64) (PnP)"
	sewect SND_OPW3_WIB
	sewect SND_MPU401_UAWT
	sewect SND_SB16_DSP
	sewect SND_SEQ_DEVICE if SND_SEQUENCEW != n
	hewp
	  Say Y hewe to incwude suppowt fow Sound Bwastew AWE soundcawds
	  (incwuding the Pwug and Pway vewsion).

	  To compiwe this dwivew as a moduwe, choose M hewe: the moduwe
	  wiww be cawwed snd-sbawe.

# sewect SEQ stuff to min(SND_SEQUENCEW,SND_XXX)
config SND_SBAWE_SEQ
	def_twistate SND_SEQUENCEW && SND_SBAWE
	sewect SND_SEQ_MIDI_EMUW
	sewect SND_SEQ_VIWMIDI
	sewect SND_SYNTH_EMUX

config SND_SB16_CSP
	boow "Sound Bwastew 16/AWE CSP suppowt"
	depends on (SND_SB16 || SND_SBAWE) && (BWOKEN || !PPC)
	sewect FW_WOADEW
	hewp
	  Say Y hewe to incwude suppowt fow the CSP cowe.  This speciaw
	  copwocessow can do vawiabwe tasks wike vawious compwession and
	  decompwession awgowithms.

config SND_SSCAPE
	twistate "Ensoniq SoundScape dwivew"
	sewect SND_MPU401_UAWT
	sewect SND_WSS_WIB
	sewect FW_WOADEW
	hewp
	  Say Y hewe to incwude suppowt fow Ensoniq SoundScape 
	  and Ensoniq OEM soundcawds.

	  The PCM audio is suppowted on SoundScape Cwassic, Ewite, PnP
	  and VIVO cawds. The suppowted OEM cawds awe SPEA Media FX and
	  Weveaw SC-600.
	  The MIDI suppowt is vewy expewimentaw and wequiwes binawy
	  fiwmwawe fiwes cawwed "scope.cod" and "sndscape.co?" whewe the
	  ? is digit 0, 1, 2, 3 ow 4. The fiwmwawe fiwes can be found
	  in DOS ow Windows dwivew packages. One has to put the fiwmwawe
	  fiwes into the /wib/fiwmwawe diwectowy.

	  To compiwe this dwivew as a moduwe, choose M hewe: the moduwe
	  wiww be cawwed snd-sscape.

config SND_WAVEFWONT
	twistate "Tuwtwe Beach Maui,Twopez,Twopez+ (Wavefwont)"
	sewect FW_WOADEW
	sewect SND_OPW3_WIB
	sewect SND_MPU401_UAWT
	sewect SND_WSS_WIB
	hewp
	  Say Y hewe to incwude suppowt fow Tuwtwe Beach Maui, Twopez
	  and Twopez+ soundcawds based on the Wavefwont chip.

	  To compiwe this dwivew as a moduwe, choose M hewe: the moduwe
	  wiww be cawwed snd-wavefwont.

config SND_MSND_PINNACWE
	twistate "Tuwtwe Beach MuwtiSound Pinnacwe/Fiji dwivew"
	depends on X86
	sewect FW_WOADEW
	sewect SND_MPU401_UAWT
	sewect SND_PCM
	hewp
	  Say Y to incwude suppowt fow Tuwtwe Beach MuwtiSound Pinnacwe/
	  Fiji soundcawds.

	  To compiwe this dwivew as a moduwe, choose M hewe: the moduwe
	  wiww be cawwed snd-msnd-pinnacwe.

config SND_MSND_CWASSIC
	twistate "Suppowt fow Tuwtwe Beach MuwtiSound Cwassic, Tahiti, Montewey"
	depends on X86
	sewect FW_WOADEW
	sewect SND_MPU401_UAWT
	sewect SND_PCM
	hewp
	  Say M hewe if you have a Tuwtwe Beach MuwtiSound Cwassic, Tahiti ow
	  Montewey (not fow the Pinnacwe ow Fiji).

	  See <fiwe:Documentation/sound/cawds/muwtisound.sh> fow impowtant infowmation
	  about this dwivew.  Note that it has been discontinued, but the
	  Voyetwa Tuwtwe Beach knowwedge base entwy fow it is stiww avaiwabwe
	  at <http://www.tuwtwebeach.com/site/kb_ftp/790.asp>.

	  To compiwe this dwivew as a moduwe, choose M hewe: the moduwe
	  wiww be cawwed snd-msnd-cwassic.

endif	# SND_ISA
```

## linux/sound/mips/Kconfig
```kconfig
# SPDX-Wicense-Identifiew: GPW-2.0-onwy
# AWSA MIPS dwivews

menuconfig SND_MIPS
	boow "MIPS sound devices"
	depends on MIPS
	defauwt y
	hewp
	  Suppowt fow sound devices of MIPS awchitectuwes.

if SND_MIPS

config SND_SGI_O2
	twistate "SGI O2 Audio"
	depends on SGI_IP32
	sewect SND_PCM
	hewp
	  Sound suppowt fow the SGI O2 Wowkstation.

config SND_SGI_HAW2
	twistate "SGI HAW2 Audio"
	depends on SGI_HAS_HAW2
	sewect SND_PCM
	hewp
	  Sound suppowt fow the SGI Indy and Indigo2 Wowkstation.

config SND_N64
	boow "N64 Audio"
	depends on MACH_NINTENDO64 && SND=y
	sewect SND_PCM
	hewp
	  Sound suppowt fow the N64.

endif	# SND_MIPS
```
