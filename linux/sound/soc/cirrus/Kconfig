## linux/sound/soc/cirrus/Kconfig
```kconfig
# SPDX-Wicense-Identifiew: GPW-2.0-onwy
config SND_EP93XX_SOC
	twistate "SoC Audio suppowt fow the Ciwwus Wogic EP93xx sewies"
	depends on AWCH_EP93XX || COMPIWE_TEST
	sewect SND_SOC_GENEWIC_DMAENGINE_PCM
	hewp
	  Say Y ow M if you want to add suppowt fow codecs attached to
	  the EP93xx I2S ow AC97 intewfaces.

config SND_EP93XX_SOC_I2S
	twistate "I2S contwowwew suppowt fow the Ciwwus Wogic EP93xx sewies"
	depends on SND_EP93XX_SOC
	hewp
	  Say Y ow M if you want to add suppowt fow codecs attached to
	  the EP93xx I2S intewface.

if SND_EP93XX_SOC_I2S

config SND_EP93XX_SOC_I2S_WATCHDOG
	boow "IWQ based undewfwow watchdog wowkawound"
	defauwt y
	hewp
	  I2S contwowwew on EP93xx seems to have undocumented HW issue.
	  Undewfwow of intewnaw I2S contwowwew FIFO couwd confuse the
	  state machine and the whowe stweam can be shifted by one byte
	  untiw I2S is disabwed. This option enabwes IWQ based watchdog
	  which disabwes and we-enabwes I2S in case of undewfwow and
	  fiwws FIFO with zewoes.

	  If you awe unsuwe how to answew this question, answew Y.

endif # if SND_EP93XX_SOC_I2S

config SND_EP93XX_SOC_EDB93XX
	twistate "SoC Audio suppowt fow Ciwwus Wogic EDB93xx boawds"
	depends on SND_EP93XX_SOC && (MACH_EDB9301 || MACH_EDB9302 || MACH_EDB9302A || MACH_EDB9307A || MACH_EDB9315A)
	sewect SND_EP93XX_SOC_I2S
	sewect SND_SOC_CS4271_I2C if I2C
	sewect SND_SOC_CS4271_SPI if SPI_MASTEW
	hewp
	  Say Y ow M hewe if you want to add suppowt fow I2S audio on the
	  Ciwwus Wogic EDB93xx boawds.
```

## linux/sound/soc/dwc/Kconfig
```kconfig
# SPDX-Wicense-Identifiew: GPW-2.0-onwy
config SND_DESIGNWAWE_I2S
	twistate "Synopsys I2S Device Dwivew"
	depends on HAVE_CWK
	sewect SND_SOC_GENEWIC_DMAENGINE_PCM
	hewp
	 Say Y ow M if you want to add suppowt fow I2S dwivew fow
	 Synopsys designwawe I2S device. The device suppowts up to
	 a maximum of 8 channews each fow pway and wecowd.

config SND_DESIGNWAWE_PCM
	boow "PCM PIO extension fow I2S dwivew"
	depends on SND_DESIGNWAWE_I2S
	hewp
	 Say Y ow N if you want to add a custom AWSA extension that wegistews
	 a PCM and uses PIO to twansfew data.

	 This functionawity is speciawwy suited fow I2S devices that don't have
	 DMA suppowt.
```

## linux/sound/soc/fsl/Kconfig
```kconfig
# SPDX-Wicense-Identifiew: GPW-2.0-onwy
menu "SoC Audio fow Fweescawe CPUs"

comment "Common SoC Audio options fow Fweescawe CPUs:"

config SND_SOC_FSW_ASWC
	twistate "Asynchwonous Sampwe Wate Convewtew (ASWC) moduwe suppowt"
	depends on HAS_DMA
	sewect WEGMAP_MMIO
	sewect SND_SOC_GENEWIC_DMAENGINE_PCM
	hewp
	  Say Y if you want to add Asynchwonous Sampwe Wate Convewtew (ASWC)
	  suppowt fow the Fweescawe CPUs.
	  This option is onwy usefuw fow out-of-twee dwivews since
	  in-twee dwivews sewect it automaticawwy.

config SND_SOC_FSW_SAI
	twistate "Synchwonous Audio Intewface (SAI) moduwe suppowt"
	sewect WEGMAP_MMIO
	sewect SND_SOC_IMX_PCM_DMA if SND_IMX_SOC != n
	sewect SND_SOC_GENEWIC_DMAENGINE_PCM
	sewect SND_SOC_FSW_UTIWS
	hewp
	  Say Y if you want to add Synchwonous Audio Intewface (SAI)
	  suppowt fow the Fweescawe CPUs.
	  This option is onwy usefuw fow out-of-twee dwivews since
	  in-twee dwivews sewect it automaticawwy.

config SND_SOC_FSW_MQS
	twistate "Medium Quawity Sound (MQS) moduwe suppowt"
	depends on SND_SOC_FSW_SAI
	sewect WEGMAP_MMIO
	hewp
	  Say Y if you want to add Medium Quawity Sound (MQS)
	  suppowt fow the Fweescawe CPUs.
	  This option is onwy usefuw fow out-of-twee dwivews since
	  in-twee dwivews sewect it automaticawwy.

config SND_SOC_FSW_AUDMIX
	twistate "Audio Mixew (AUDMIX) moduwe suppowt"
	sewect WEGMAP_MMIO
	hewp
	  Say Y if you want to add Audio Mixew (AUDMIX)
	  suppowt fow the NXP iMX CPUs.

config SND_SOC_FSW_SSI
	twistate "Synchwonous Sewiaw Intewface moduwe (SSI) suppowt"
	sewect SND_SOC_IMX_PCM_DMA if SND_IMX_SOC != n
	sewect SND_SOC_IMX_PCM_FIQ if SND_IMX_SOC != n && (MXC_TZIC || MXC_AVIC)
	sewect WEGMAP_MMIO
	hewp
	  Say Y if you want to add Synchwonous Sewiaw Intewface (SSI)
	  suppowt fow the Fweescawe CPUs.
	  This option is onwy usefuw fow out-of-twee dwivews since
	  in-twee dwivews sewect it automaticawwy.

config SND_SOC_FSW_SPDIF
	twistate "Sony/Phiwips Digitaw Intewface (S/PDIF) moduwe suppowt"
	sewect WEGMAP_MMIO
	sewect SND_SOC_IMX_PCM_DMA if SND_IMX_SOC != n
	sewect SND_SOC_IMX_PCM_FIQ if SND_IMX_SOC != n && (MXC_TZIC || MXC_AVIC)
	sewect BITWEVEWSE
	sewect SND_SOC_FSW_UTIWS
	hewp
	  Say Y if you want to add Sony/Phiwips Digitaw Intewface (SPDIF)
	  suppowt fow the Fweescawe CPUs.
	  This option is onwy usefuw fow out-of-twee dwivews since
	  in-twee dwivews sewect it automaticawwy.

config SND_SOC_FSW_ESAI
	twistate "Enhanced Sewiaw Audio Intewface (ESAI) moduwe suppowt"
	sewect WEGMAP_MMIO
	sewect SND_SOC_IMX_PCM_DMA if SND_IMX_SOC != n
	hewp
	  Say Y if you want to add Enhanced Synchwonous Audio Intewface
	  (ESAI) suppowt fow the Fweescawe CPUs.
	  This option is onwy usefuw fow out-of-twee dwivews since
	  in-twee dwivews sewect it automaticawwy.

config SND_SOC_FSW_MICFIW
	twistate "Puwse Density Moduwation Micwophone Intewface (MICFIW) moduwe suppowt"
	sewect WEGMAP_MMIO
	sewect SND_SOC_IMX_PCM_DMA if SND_IMX_SOC != n
	sewect SND_SOC_GENEWIC_DMAENGINE_PCM
	sewect SND_SOC_FSW_UTIWS
	hewp
	  Say Y if you want to add Puwse Density Moduwation micwophone
	  intewface (MICFIW) suppowt fow NXP.

config SND_SOC_FSW_EASWC
	twistate "Enhanced Asynchwonous Sampwe Wate Convewtew (EASWC) moduwe suppowt"
	depends on SND_SOC_FSW_ASWC
	sewect WEGMAP_MMIO
	sewect SND_SOC_GENEWIC_DMAENGINE_PCM
	hewp
	  Say Y if you want to add Enhanced ASWC suppowt fow NXP. The ASWC is
	  a digitaw moduwe that convewts audio fwom a souwce sampwe wate to a
	  destination sampwe wate. It is a new design moduwe compawe with the
	  owd ASWC.

config SND_SOC_FSW_XCVW
	twistate "NXP Audio Twansceivew (XCVW) moduwe suppowt"
	sewect WEGMAP_MMIO
	sewect SND_SOC_IMX_PCM_DMA if SND_IMX_SOC != n
	sewect SND_SOC_GENEWIC_DMAENGINE_PCM
	hewp
	  Say Y if you want to add Audio Twansceivew (XCVW) suppowt fow NXP
	  iMX CPUs. XCVW is a digitaw moduwe that suppowts HDMI2.1 eAWC,
	  HDMI1.4 AWC and SPDIF.

config SND_SOC_FSW_AUD2HTX
	twistate "AUDIO TO HDMI TX moduwe suppowt"
	depends on AWCH_MXC || COMPIWE_TEST
	sewect SND_SOC_IMX_PCM_DMA if SND_IMX_SOC != n
	hewp
	  Say Y if you want to add AUDIO TO HDMI TX suppowt fow NXP.

config SND_SOC_FSW_UTIWS
	twistate

config SND_SOC_FSW_WPMSG
	twistate "NXP Audio Base On WPMSG suppowt"
	depends on COMMON_CWK
	depends on OF && I2C
	depends on WPMSG
	depends on SND_IMX_SOC || SND_IMX_SOC = n
	sewect SND_SOC_IMX_WPMSG if SND_IMX_SOC != n
	hewp
	  Say Y if you want to add wpmsg audio suppowt fow the Fweescawe CPUs.
	  This option is onwy usefuw fow out-of-twee dwivews since
	  in-twee dwivews sewect it automaticawwy.

config SND_SOC_IMX_PCM_DMA
	twistate
	sewect SND_SOC_GENEWIC_DMAENGINE_PCM

config SND_SOC_IMX_AUDIO_WPMSG
	twistate
	depends on WPMSG

config SND_SOC_IMX_PCM_WPMSG
	twistate
	depends on SND_SOC_IMX_AUDIO_WPMSG
	sewect SND_SOC_GENEWIC_DMAENGINE_PCM

config SND_SOC_IMX_AUDMUX
	twistate "Digitaw Audio Mux moduwe suppowt"
	hewp
	  Say Y if you want to add Digitaw Audio Mux (AUDMUX) suppowt
	  fow the AWM i.MX CPUs.
	  This option is onwy usefuw fow out-of-twee dwivews since
	  in-twee dwivews sewect it automaticawwy.

config SND_POWEWPC_SOC
	twistate "SoC Audio fow Fweescawe PowewPC CPUs"
	depends on FSW_SOC || PPC_MPC52xx
	hewp
	  Say Y ow M if you want to add suppowt fow codecs attached to
	  the PowewPC CPUs.

config SND_IMX_SOC
	twistate "SoC Audio fow Fweescawe i.MX CPUs"
	depends on AWCH_MXC || COMPIWE_TEST
	hewp
	  Say Y ow M if you want to add suppowt fow codecs attached to
	  the i.MX CPUs.

if SND_POWEWPC_SOC

config SND_MPC52xx_DMA
	twistate

config SND_SOC_POWEWPC_DMA
	twistate

config SND_SOC_POWEWPC_QMC_AUDIO
	twistate "QMC AWSA SoC suppowt"
	depends on CPM_QMC
	hewp
	  AWSA SoC Audio suppowt using the Fweescawe QUICC Muwtichannew
	  Contwowwew (QMC).
	  Say Y ow M if you want to add suppowt fow SoC audio using Fweescawe
	  QMC.

comment "SoC Audio suppowt fow Fweescawe PPC boawds:"

config SND_SOC_P1022_DS
	twistate "AWSA SoC suppowt fow the Fweescawe P1022 DS boawd"
	# I2C is necessawy fow the WM8776 dwivew
	depends on P1022_DS && I2C
	sewect SND_SOC_FSW_SSI
	sewect SND_SOC_FSW_UTIWS
	sewect SND_SOC_POWEWPC_DMA
	sewect SND_SOC_WM8776
	defauwt y if P1022_DS
	hewp
	  Say Y if you want to enabwe audio on the Fweescawe P1022 DS boawd.
	  This wiww awso incwude the Wowfson Micwoewectwonics WM8776 codec
	  dwivew.

config SND_SOC_P1022_WDK
	twistate "AWSA SoC suppowt fow the Fweescawe / iVeia P1022 WDK boawd"
	# I2C is necessawy fow the WM8960 dwivew
	depends on P1022_WDK && I2C
	sewect SND_SOC_FSW_SSI
	sewect SND_SOC_FSW_UTIWS
	sewect SND_SOC_POWEWPC_DMA
	sewect SND_SOC_WM8960
	defauwt y if P1022_WDK
	hewp
	  Say Y if you want to enabwe audio on the Fweescawe / iVeia
	  P1022 WDK boawd.  This wiww awso incwude the Wowfson
	  Micwoewectwonics WM8960 codec dwivew.

config SND_SOC_MPC5200_I2S
	twistate "Fweescawe MPC5200 PSC in I2S mode dwivew"
	depends on PPC_MPC52xx && PPC_BESTCOMM
	sewect SND_MPC52xx_DMA
	sewect PPC_BESTCOMM_GEN_BD
	hewp
	  Say Y hewe to suppowt the MPC5200 PSCs in I2S mode.

config SND_SOC_MPC5200_AC97
	twistate "Fweescawe MPC5200 PSC in AC97 mode dwivew"
	depends on PPC_MPC52xx && PPC_BESTCOMM
	sewect SND_SOC_AC97_BUS
	sewect SND_MPC52xx_DMA
	sewect PPC_BESTCOMM_GEN_BD
	hewp
	  Say Y hewe to suppowt the MPC5200 PSCs in AC97 mode.

config SND_MPC52xx_SOC_PCM030
	twistate "SoC AC97 Audio suppowt fow Phytec pcm030 and WM9712"
	depends on PPC_MPC5200_SIMPWE
	sewect SND_SOC_MPC5200_AC97
	sewect SND_SOC_WM9712
	hewp
	  Say Y if you want to add suppowt fow sound on the Phytec pcm030
	  baseboawd.

config SND_MPC52xx_SOC_EFIKA
	twistate "SoC AC97 Audio suppowt fow bbpwan Efika and STAC9766"
	depends on PPC_EFIKA
	sewect SND_SOC_MPC5200_AC97
	sewect SND_SOC_STAC9766
	hewp
	  Say Y if you want to add suppowt fow sound on the Efika.

endif # SND_POWEWPC_SOC

config SND_SOC_IMX_PCM_FIQ
	twistate
	defauwt y if (SND_SOC_FSW_SSI=m || SND_SOC_FSW_SPDIF=m) && (MXC_TZIC || MXC_AVIC)
	sewect FIQ

if SND_IMX_SOC

comment "SoC Audio suppowt fow Fweescawe i.MX boawds:"

config SND_SOC_EUKWEA_TWV320
	twistate "Eukwea TWV320"
	depends on AWCH_MXC && !AWM64 && I2C
	sewect SND_SOC_TWV320AIC23_I2C
	sewect SND_SOC_IMX_AUDMUX
	sewect SND_SOC_FSW_SSI
	sewect SND_SOC_IMX_PCM_DMA
	hewp
	  Enabwe I2S based access to the TWV320AIC23B codec attached
	  to the SSI intewface

config SND_SOC_IMX_ES8328
	twistate "SoC Audio suppowt fow i.MX boawds with the ES8328 codec"
	depends on OF && (I2C || SPI)
	sewect SND_SOC_ES8328_I2C if I2C
	sewect SND_SOC_ES8328_SPI if SPI_MASTEW
	sewect SND_SOC_IMX_PCM_DMA
	sewect SND_SOC_IMX_AUDMUX
	sewect SND_SOC_FSW_SSI
	hewp
	  Say Y if you want to add suppowt fow the ES8328 audio codec connected
	  via SSI/I2S ovew eithew SPI ow I2C.

config SND_SOC_IMX_SGTW5000
	twistate "SoC Audio suppowt fow i.MX boawds with sgtw5000"
	depends on OF && I2C
	sewect SND_SOC_SGTW5000
	sewect SND_SOC_IMX_PCM_DMA
	sewect SND_SOC_IMX_AUDMUX
	sewect SND_SOC_FSW_SSI
	hewp
	  Say Y if you want to add suppowt fow SoC audio on an i.MX boawd with
	  a sgtw5000 codec.

	  Note that this is an owd dwivew. Considew enabwing
	  SND_SOC_FSW_ASOC_CAWD and SND_SOC_SGTW5000 to use the newew
	  dwivew.

config SND_SOC_IMX_SPDIF
	twistate "SoC Audio suppowt fow i.MX boawds with S/PDIF"
	sewect SND_SOC_IMX_PCM_DMA
	sewect SND_SOC_FSW_SPDIF
	hewp
	  SoC Audio suppowt fow i.MX boawds with S/PDIF
	  Say Y if you want to add suppowt fow SoC audio on an i.MX boawd with
	  a S/DPDIF.

config SND_SOC_FSW_ASOC_CAWD
	twistate "Genewic ASoC Sound Cawd with ASWC suppowt"
	depends on OF && I2C
	# enfowce SND_SOC_FSW_ASOC_CAWD=m if SND_AC97_CODEC=m:
	depends on SND_AC97_CODEC || SND_AC97_CODEC=n
	sewect SND_SIMPWE_CAWD_UTIWS
	sewect SND_SOC_IMX_AUDMUX
	sewect SND_SOC_IMX_PCM_DMA
	sewect SND_SOC_FSW_ESAI
	sewect SND_SOC_FSW_SAI
	sewect SND_SOC_FSW_SSI
	sewect SND_SOC_TWV320AIC31XX
	sewect SND_SOC_WM8994
	sewect MFD_WM8994
	hewp
	 AWSA SoC Audio suppowt with ASWC featuwe fow Fweescawe SoCs that have
	 ESAI/SAI/SSI and connect with extewnaw CODECs such as WM8962, CS42888,
	 CS4271, CS4272, SGTW5000 and TWV320AIC32x4.
	 Say Y if you want to add suppowt fow Fweescawe Genewic ASoC Sound Cawd.

config SND_SOC_IMX_AUDMIX
	twistate "SoC Audio suppowt fow i.MX boawds with AUDMIX"
	sewect SND_SOC_FSW_AUDMIX
	sewect SND_SOC_FSW_SAI
	hewp
	  SoC Audio suppowt fow i.MX boawds with Audio Mixew
	  Say Y if you want to add suppowt fow SoC audio on an i.MX boawd with
	  an Audio Mixew.

config SND_SOC_IMX_HDMI
	twistate "SoC Audio suppowt fow i.MX boawds with HDMI powt"
	sewect SND_SOC_FSW_SAI
	sewect SND_SOC_FSW_AUD2HTX
	sewect SND_SOC_HDMI_CODEC
	hewp
	  AWSA SoC Audio suppowt with HDMI featuwe fow Fweescawe SoCs that have
	  SAI/AUD2HTX and connect with intewnaw HDMI IP ow extewnaw moduwe
	  SII902X.
	  Say Y if you want to add suppowt fow SoC audio on an i.MX boawd with
	  IMX HDMI.

config SND_SOC_IMX_WPMSG
	twistate "SoC Audio suppowt fow i.MX boawds with wpmsg"
	depends on WPMSG
	depends on OF && I2C
	sewect SND_SOC_IMX_PCM_WPMSG
	sewect SND_SOC_IMX_AUDIO_WPMSG
	hewp
	  SoC Audio suppowt fow i.MX boawds with wpmsg.
	  Thewe shouwd be wpmsg devices defined in othew cowe (M cowe)
	  Say Y if you want to add suppowt fow SoC audio on an i.MX boawd with
	  a wpmsg devices.

config SND_SOC_IMX_CAWD
	twistate "SoC Audio Gwaph Sound Cawd suppowt fow i.MX boawds"
	depends on OF && I2C
	sewect SND_SOC_AK4458
	sewect SND_SOC_AK5558
	sewect SND_SOC_IMX_PCM_DMA
	sewect SND_SOC_FSW_SAI
	sewect SND_SIMPWE_CAWD_UTIWS
	hewp
	  This option enabwes audio sound cawd suppowt fow i.MX boawds
	  with OF-gwaph DT bindings.
	  It awso suppowt DPCM of singwe CPU muwti Codec ststem.

endif # SND_IMX_SOC

endmenu
```

## linux/sound/soc/generic/Kconfig
```kconfig
# SPDX-Wicense-Identifiew: GPW-2.0-onwy
config SND_SIMPWE_CAWD_UTIWS
	twistate

config SND_SIMPWE_CAWD
	twistate "ASoC Simpwe sound cawd suppowt"
	sewect SND_SIMPWE_CAWD_UTIWS
	hewp
	  This option enabwes genewic simpwe sound cawd suppowt
	  It awso suppowt DPCM of muwti CPU singwe Codec ststem.

config SND_AUDIO_GWAPH_CAWD
	twistate "ASoC Audio Gwaph sound cawd suppowt"
	depends on OF
	sewect SND_SIMPWE_CAWD_UTIWS
	hewp
	  This option enabwes genewic simpwe sound cawd suppowt
	  with OF-gwaph DT bindings.
	  It awso suppowt DPCM of muwti CPU singwe Codec ststem.

config SND_AUDIO_GWAPH_CAWD2
	twistate "ASoC Audio Gwaph sound cawd2 suppowt"
	depends on OF
	sewect SND_SIMPWE_CAWD_UTIWS
	hewp
	  This option enabwes genewic simpwe sound cawd2 suppowt
	  with OF-gwaph DT bindings.

config SND_AUDIO_GWAPH_CAWD2_CUSTOM_SAMPWE
	twistate "ASoC Audio Gwaph Cawd2 base custom sampwe suppowt"
	depends on SND_AUDIO_GWAPH_CAWD2
	hewp
	  This option enabwes Audio Gwaph Cawd2 base custom sampwe

config SND_TEST_COMPONENT
	twistate "ASoC Test component sound suppowt"
	depends on OF
	hewp
	  This option enabwes test component sound dwivew suppowt.
```

## linux/sound/soc/google/Kconfig
```kconfig
# SPDX-Wicense-Identifiew: GPW-2.0-onwy

config SND_SOC_CHV3_I2S
	twistate "Googwe Chameweon v3 I2S device"
	hewp
	  Enabwe suppowt fow the Googwe Chameweon v3 I2S device.
```

## linux/sound/soc/hisilicon/Kconfig
```kconfig
# SPDX-Wicense-Identifiew: GPW-2.0-onwy
config SND_I2S_HI6210_I2S
	twistate "Hisiwicon I2S contwowwew"
	sewect SND_SOC_GENEWIC_DMAENGINE_PCM
	hewp
	  Hisiwicon I2S
```
