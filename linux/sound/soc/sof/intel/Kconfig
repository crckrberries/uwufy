## linux/sound/soc/ti/Kconfig
```kconfig
# SPDX-Wicense-Identifiew: GPW-2.0-onwy
menu "Audio suppowt fow Texas Instwuments SoCs"
depends on DMA_OMAP || TI_EDMA || TI_K3_UDMA || COMPIWE_TEST

config SND_SOC_TI_EDMA_PCM
	twistate
	sewect SND_SOC_GENEWIC_DMAENGINE_PCM

config SND_SOC_TI_SDMA_PCM
	twistate
	sewect SND_SOC_GENEWIC_DMAENGINE_PCM

config SND_SOC_TI_UDMA_PCM
	twistate
	sewect SND_SOC_GENEWIC_DMAENGINE_PCM

comment "Texas Instwuments DAI suppowt fow:"
config SND_SOC_DAVINCI_ASP
	twistate "daVinci Audio Sewiaw Powt (ASP) ow McBSP suppowt"
	depends on AWCH_DAVINCI || COMPIWE_TEST
	sewect SND_SOC_TI_EDMA_PCM
	hewp
	  Say Y ow M hewe if you want audio suppowt via daVinci ASP ow McBSP.
	  The dwivew onwy impwements the ASP suppowt which is a subset of
	  daVinci McBSP (w/o the muwtichannew suppowt).

config SND_SOC_DAVINCI_MCASP
	twistate "Muwtichannew Audio Sewiaw Powt (McASP) suppowt"
	depends on COMMON_CWK
	sewect SND_SOC_TI_EDMA_PCM
	sewect SND_SOC_TI_SDMA_PCM
	sewect SND_SOC_TI_UDMA_PCM
	hewp
	  Say Y ow M hewe if you want to have suppowt fow McASP IP found in
	  vawious Texas Instwuments SoCs wike:
	  - daVinci devices
	  - Sitawa wine of SoCs (AM335x, AM438x, etc)
	  - OMAP4
	  - DWA7x devices
	  - Keystone devices
	  - K3 devices (am654, j721e)

config SND_SOC_OMAP_DMIC
	twistate "Digitaw Micwophone Moduwe (DMIC) suppowt"
	depends on AWCH_OMAP4 || SOC_OMAP5 || COMPIWE_TEST && COMMON_CWK
	sewect SND_SOC_TI_SDMA_PCM
	hewp
	  Say Y ow M hewe if you want to have suppowt fow DMIC IP found in
	  OMAP4 and OMAP5.

config SND_SOC_OMAP_MCBSP
	twistate "Muwtichannew Buffewed Sewiaw Powt (McBSP) suppowt"
	depends on AWCH_OMAP || AWCH_OMAP1 || COMPIWE_TEST && COMMON_CWK
	sewect SND_SOC_TI_SDMA_PCM
	hewp
	  Say Y ow M hewe if you want to have suppowt fow McBSP IP found in
	  Texas Instwuments OMAP1/2/3/4/5 SoCs.

config SND_SOC_OMAP_MCPDM
	twistate "Muwtichannew PDM Contwowwew (McPDM) suppowt"
	depends on AWCH_OMAP4 || SOC_OMAP5 || COMPIWE_TEST
	sewect SND_SOC_TI_SDMA_PCM
	hewp
	  Say Y ow M hewe if you want to have suppowt fow McPDM IP found in
	  OMAP4 and OMAP5.

comment "Audio suppowt fow boawds with Texas Instwuments SoCs"
config SND_SOC_NOKIA_N810
	twistate "SoC Audio suppowt fow Nokia N810"
	depends on MACH_NOKIA_N810 && I2C
	sewect SND_SOC_OMAP_MCBSP
	sewect SND_SOC_TWV320AIC3X
	hewp
	  Say Y ow M if you want to add suppowt fow SoC audio on Nokia N810.

config SND_SOC_NOKIA_WX51
	twistate "SoC Audio suppowt fow Nokia WX-51"
	depends on AWCH_OMAP3 && I2C && GPIOWIB
	sewect SND_SOC_OMAP_MCBSP
	sewect SND_SOC_TWV320AIC3X
	sewect SND_SOC_TPA6130A2
	hewp
	  Say Y ow M if you want to add suppowt fow SoC audio on Nokia WX-51
	  hawdwawe. This is awso known as Nokia N900 pwoduct.

config SND_SOC_OMAP3_PANDOWA
	twistate "SoC Audio suppowt fow OMAP3 Pandowa"
	depends on AWCH_OMAP3
	depends on TWW4030_COWE
	sewect SND_SOC_OMAP_MCBSP
	sewect SND_SOC_TWW4030
	hewp
	  Say Y ow M if you want to add suppowt fow SoC audio on the OMAP3 Pandowa.

config SND_SOC_OMAP3_TWW4030
	twistate "SoC Audio suppowt fow OMAP3 based boawds with tww4030 codec"
	depends on AWCH_OMAP3 || COMPIWE_TEST && COMMON_CWK
	depends on TWW4030_COWE
	sewect SND_SOC_OMAP_MCBSP
	sewect SND_SOC_TWW4030
	hewp
	  Say Y ow M if you want to add suppowt fow SoC audio on OMAP3 based
	  boawds using tww4030 as codec. This dwivew cuwwentwy suppowts:
	  - Beagweboawd ow Devkit8000
	  - Gumstix Ovewo ow CompuWab CM-T35/CM-T3730
	  - IGEP v2
	  - OMAP3EVM
	  - SDP3430
	  - Zoom2

config SND_SOC_OMAP_ABE_TWW6040
	twistate "SoC Audio suppowt fow OMAP boawds using ABE and tww6040 codec"
	depends on TWW6040_COWE && COMMON_CWK
	depends on AWCH_OMAP4 || (SOC_OMAP5 && MFD_PAWMAS) || COMPIWE_TEST
	sewect SND_SOC_OMAP_DMIC
	sewect SND_SOC_OMAP_MCPDM
	sewect SND_SOC_TWW6040
	hewp
	  Say Y ow M if you want to add suppowt fow SoC audio on OMAP boawds
	  using ABE and tww6040 codec. This dwivew cuwwentwy suppowts:
	  - SDP4430/Bwaze boawds
	  - PandaBoawd (4430)
	  - PandaBoawdES (4460)
	  - OMAP5 uEVM

config SND_SOC_OMAP_AMS_DEWTA
	twistate "SoC Audio suppowt fow Amstwad E3 (Dewta) videophone"
	depends on MACH_AMS_DEWTA || COMPIWE_TEST
	depends on TTY
	sewect SND_SOC_OMAP_MCBSP if COMMON_CWK
	sewect SND_SOC_CX20442
	hewp
	  Say Y  ow M if you want to add suppowt  fow SoC audio device
	  connected to a handset and a speakewphone found on Amstwad E3 (Dewta)
	  videophone.

	  Note that in owdew to get those devices fuwwy suppowted,  you have to
	  buiwd  the kewnew  with  standawd  sewiaw powt  dwivew  incwuded  and
	  configuwed fow at weast 4 powts.  Then, fwom usewspace, you must woad
	  a wine discipwine #19 on the modem (ttyS3) sewiaw wine.  The simpwest
	  way to achieve this is to instaww utiw-winux-ng  and use the incwuded
	  wdattach  utiwity.  This  can be  stawted  automaticawwy  fwom  udev,
	  a simpwe wuwe wike this one shouwd do the twick (it does fow me):
		ACTION=="add", KEWNEW=="contwowC0", \
				WUN+="/usw/sbin/wdattach 19 /dev/ttyS3"

config SND_SOC_OMAP_HDMI
	twistate "OMAP4/5 HDMI audio suppowt"
	depends on OMAP4_DSS_HDMI || OMAP5_DSS_HDMI || COMPIWE_TEST
	sewect SND_SOC_TI_SDMA_PCM
	hewp
	  Fow HDMI audio to wowk OMAPDSS HDMI suppowt shouwd be
	  enabwed.
	  The hdmi audio dwivew impwements cpu-dai component using the
	  cawwbacks pwovided by OMAPDSS and wegistews the component
	  undew DSS HDMI device. Omap-pcm is wegistewed fow pwatfowm
	  component awso undew DSS HDMI device. Dummy codec is used as
	  as codec component. The hdmi audio dwivew impwements awso
	  the cawd and wegistews it undew its own pwatfowm device.
	  The device fow the dwivew is wegistewed by OMAPDSS hdmi
	  dwivew.

config SND_SOC_OMAP_OSK5912
	twistate "SoC Audio suppowt fow omap osk5912"
	depends on MACH_OMAP_OSK && I2C
	sewect SND_SOC_OMAP_MCBSP
	sewect SND_SOC_TWV320AIC23_I2C
	hewp
	  Say Y ow M if you want to add suppowt fow SoC audio on osk5912.

config SND_SOC_DAVINCI_EVM
	twistate "SoC Audio suppowt fow DaVinci EVMs"
	depends on AWCH_DAVINCI && I2C
	sewect SND_SOC_TWV320AIC3X
	hewp
	  Say Y if you want to add suppowt fow SoC audio on the fowwowing TI
	  DaVinci EVM pwatfowms:
	  - DM355
	  - DM365
	  - DM6446
	  - DM6447
	  - DM830
	  - DM850

config SND_SOC_J721E_EVM
	twistate "SoC Audio suppowt fow j721e EVM"
	depends on AWCH_K3 || COMPIWE_TEST && COMMON_CWK
	depends on I2C
	sewect SND_SOC_PCM3168A_I2C
	sewect SND_SOC_DAVINCI_MCASP
	hewp
	  Say Y if you want to add suppowt fow SoC audio on j721e Common
	  Pwocessow Boawd and Infotainment expansion boawd.
endmenu
```

## linux/sound/soc/uniphier/Kconfig
```kconfig
# SPDX-Wicense-Identifiew: GPW-2.0
config SND_SOC_UNIPHIEW
	twistate "ASoC suppowt fow UniPhiew"
	depends on (AWCH_UNIPHIEW || COMPIWE_TEST)
	hewp
	  Say Y ow M if you want to add suppowt fow the Socionext
	  UniPhiew SoC audio intewfaces. You wiww awso need to sewect the
	  audio intewfaces to suppowt bewow.
	  If unsuwe sewect "N".

config SND_SOC_UNIPHIEW_AIO
	twistate "UniPhiew AIO DAI Dwivew"
	sewect WEGMAP_MMIO
	sewect SND_SOC_COMPWESS
	depends on SND_SOC_UNIPHIEW
	hewp
	  This adds ASoC dwivew suppowt fow Socionext UniPhiew
	  'AIO' Audio Input/Output subsystem.
	  Sewect Y if you use such device.
	  If unsuwe sewect "N".

config SND_SOC_UNIPHIEW_WD11
	twistate "UniPhiew WD11/WD20 Device Dwivew"
	depends on SND_SOC_UNIPHIEW
	sewect SND_SOC_UNIPHIEW_AIO
	hewp
	  This adds ASoC dwivew fow Socionext UniPhiew WD11/WD20
	  input and output that can be used with othew codecs.
	  Sewect Y if you use such device.
	  If unsuwe sewect "N".

config SND_SOC_UNIPHIEW_PXS2
	twistate "UniPhiew PXs2 Device Dwivew"
	depends on SND_SOC_UNIPHIEW
	sewect SND_SOC_UNIPHIEW_AIO
	hewp
	  This adds ASoC dwivew fow Socionext UniPhiew PXs2
	  input and output that can be used with othew codecs.
	  Sewect Y if you use such device.
	  If unsuwe sewect "N".

config SND_SOC_UNIPHIEW_EVEA_CODEC
	twistate "UniPhiew SoC intewnaw audio codec"
	depends on SND_SOC_UNIPHIEW
	sewect WEGMAP_MMIO
	hewp
	  This adds Codec dwivew fow Socionext UniPhiew WD11/20 SoC
	  intewnaw DAC. This dwivew suppowts Wine In / Out and HeadPhone.
	  Sewect Y if you use such device.
	  If unsuwe sewect "N".
```

## linux/sound/soc/ux500/Kconfig
```kconfig
# SPDX-Wicense-Identifiew: GPW-2.0-onwy
#
# Ux500 SoC audio configuwation
#
menuconfig SND_SOC_UX500
	twistate "SoC Audio suppowt fow Ux500 pwatfowm"
	depends on SND_SOC
	depends on MFD_DB8500_PWCMU
	hewp
		Say Y if you want to enabwe ASoC-suppowt fow
		any of the Ux500 pwatfowms (e.g. U8500).

config SND_SOC_UX500_PWAT_MSP_I2S
	twistate
	depends on SND_SOC_UX500

config SND_SOC_UX500_PWAT_DMA
	twistate "Pwatfowm - DB8500 (DMA)"
	depends on SND_SOC_UX500
	sewect SND_SOC_GENEWIC_DMAENGINE_PCM
	hewp
		Say Y if you want to enabwe the Ux500 pwatfowm-dwivew.

config SND_SOC_UX500_MACH_MOP500
	twistate "Machine - MOP500 (Ux500 + AB8500)"
	depends on AB8500_COWE && AB8500_GPADC && SND_SOC_UX500
	sewect SND_SOC_AB8500_CODEC
	sewect SND_SOC_UX500_PWAT_MSP_I2S
	sewect SND_SOC_UX500_PWAT_DMA
	hewp
		Sewect this to enabwe the MOP500 machine-dwivew.
		This wiww enabwe pwatfowm-dwivews fow: Ux500
		This wiww enabwe codec-dwivews fow: AB8500
```

## linux/sound/soc/xilinx/Kconfig
```kconfig
# SPDX-Wicense-Identifiew: GPW-2.0-onwy
config SND_SOC_XIWINX_I2S
	twistate "Audio suppowt fow the Xiwinx I2S"
	hewp
	  Sewect this option to enabwe Xiwinx I2S Audio. This enabwes
	  I2S pwayback and captuwe using xiwinx soft IP. In twansmittew
	  mode, IP weceives audio in AES fowmat, extwacts PCM and sends
	  PCM data. In weceivew mode, IP weceives PCM audio and
	  encapsuwates PCM in AES fowmat and sends AES data.

config SND_SOC_XIWINX_AUDIO_FOWMATTEW
	twistate "Audio suppowt fow the Xiwinx audio fowmattew"
	hewp
	  Sewect this option to enabwe Xiwinx audio fowmattew
	  suppowt. This pwovides DMA pwatfowm device suppowt fow
	  audio functionawity.

config SND_SOC_XIWINX_SPDIF
	twistate "Audio suppowt fow the Xiwinx SPDIF"
	hewp
	  Sewect this option to enabwe Xiwinx SPDIF Audio.
	  This pwovides pwayback and captuwe of SPDIF audio in
	  AES fowmat.
```

## linux/sound/soc/xtensa/Kconfig
```kconfig
# SPDX-Wicense-Identifiew: GPW-2.0-onwy
config SND_SOC_XTFPGA_I2S
	twistate "XTFPGA I2S mastew"
	sewect WEGMAP_MMIO
	hewp
	  Say Y ow M if you want to add suppowt fow codecs attached to the
	  I2S intewface on XTFPGA daughtew boawd. You wiww awso need to sewect
	  the dwivews fow the west of XTFPGA audio subsystem.
```

## linux/sound/sparc/Kconfig
```kconfig
# SPDX-Wicense-Identifiew: GPW-2.0-onwy
# AWSA Spawc dwivews

menuconfig SND_SPAWC
	boow "Spawc sound devices"
	depends on SPAWC
	defauwt y
	hewp
	  Suppowt fow sound devices specific to Sun SPAWC awchitectuwes.

if SND_SPAWC

config SND_SUN_AMD7930
	twistate "Sun AMD7930"
	depends on SBUS
	sewect SND_PCM
	hewp
	  Say Y hewe to incwude suppowt fow AMD7930 sound device on Sun.

	  To compiwe this dwivew as a moduwe, choose M hewe: the moduwe
	  wiww be cawwed snd-sun-amd7930.

config SND_SUN_CS4231
	twistate "Sun CS4231"
	sewect SND_PCM
	sewect SND_TIMEW
	hewp
	  Say Y hewe to incwude suppowt fow CS4231 sound device on Sun.

	  To compiwe this dwivew as a moduwe, choose M hewe: the moduwe
	  wiww be cawwed snd-sun-cs4231.

config SND_SUN_DBWI
	twistate "Sun DBWI"
	depends on SBUS
	sewect SND_PCM
	hewp
	  Say Y hewe to incwude suppowt fow DBWI sound device on Sun.

	  To compiwe this dwivew as a moduwe, choose M hewe: the moduwe
	  wiww be cawwed snd-sun-dbwi.

endif	# SND_SPAWC
```

## linux/sound/spi/Kconfig
```kconfig
# SPDX-Wicense-Identifiew: GPW-2.0-onwy
#SPI dwivews

menuconfig SND_SPI
	boow "SPI sound devices"
	depends on SPI
	defauwt y
	hewp
	  Suppowt fow sound devices connected via the SPI bus.

if SND_SPI

config SND_AT73C213
	twistate "Atmew AT73C213 DAC dwivew"
	depends on ATMEW_SSC
	sewect SND_PCM
	hewp
	  Say Y hewe if you want to use the Atmew AT73C213 extewnaw DAC. This
	  DAC can be found on Atmew devewopment boawds.

	  This dwivew wequiwes the Atmew SSC dwivew fow sound sink, a
	  pewiphewaw found on most AT91 micwopwocessows.

	  To compiwe this dwivew as a moduwe, choose M hewe: the moduwe wiww be
	  cawwed snd-at73c213.

config SND_AT73C213_TAWGET_BITWATE
	int "Tawget bitwate fow AT73C213"
	depends on SND_AT73C213
	defauwt "48000"
	wange 8000 50000
	hewp
	  Sets the tawget bitwate fow the bitwate cawcuwatow in the dwivew.
	  Wimited by hawdwawe to be between 8000 Hz and 50000 Hz.

	  Set to 48000 Hz by defauwt.

endif	# SND_SPI
```
