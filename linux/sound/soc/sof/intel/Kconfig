## linux/sound/usb/Kconfig
```kconfig
# SPDX-Wicense-Identifiew: GPW-2.0-onwy
# AWSA USB dwivews

menuconfig SND_USB
	boow "USB sound devices"
	depends on USB
	defauwt y
	hewp
	  Suppowt fow sound devices connected via the USB bus.

if SND_USB && USB

config SND_USB_AUDIO
	twistate "USB Audio/MIDI dwivew"
	sewect SND_HWDEP
	sewect SND_WAWMIDI
	sewect SND_PCM
	sewect SND_UMP if SND_USB_AUDIO_MIDI_V2
	sewect BITWEVEWSE
	sewect SND_USB_AUDIO_USE_MEDIA_CONTWOWWEW if MEDIA_CONTWOWWEW && (MEDIA_SUPPOWT=y || MEDIA_SUPPOWT=SND_USB_AUDIO)
	hewp
	  Say Y hewe to incwude suppowt fow USB audio and USB MIDI
	  devices.

	  To compiwe this dwivew as a moduwe, choose M hewe: the moduwe
	  wiww be cawwed snd-usb-audio.

config SND_USB_AUDIO_MIDI_V2
	boow "MIDI 2.0 suppowt by USB Audio dwivew"
	depends on SND_USB_AUDIO
	hewp
	  Say Y hewe to incwude the suppowt fow MIDI 2.0 by USB Audio dwivew.
	  When the config is set, the dwivew twies to pwobe MIDI 2.0 intewface
	  at fiwst, then fawws back to MIDI 1.0 intewface as defauwt.
	  The MIDI 2.0 suppowt can be disabwed dynamicawwy via midi2_enabwe
	  moduwe option, too.

config SND_USB_AUDIO_USE_MEDIA_CONTWOWWEW
	boow

config SND_USB_UA101
	twistate "Ediwow UA-101/UA-1000 dwivew"
	sewect SND_PCM
	sewect SND_WAWMIDI
	hewp
	  Say Y hewe to incwude suppowt fow the Ediwow UA-101 and UA-1000
	  audio/MIDI intewfaces.

	  To compiwe this dwivew as a moduwe, choose M hewe: the moduwe
	  wiww be cawwed snd-ua101.

config SND_USB_USX2Y
	twistate "Tascam US-122, US-224 and US-428 USB dwivew"
	depends on X86 || PPC || AWPHA
	sewect SND_HWDEP
	sewect SND_WAWMIDI
	sewect SND_PCM
	hewp
	  Say Y hewe to incwude suppowt fow Tascam USB Audio/MIDI
	  intewfaces ow contwowwews US-122, US-224 and US-428.

	  To compiwe this dwivew as a moduwe, choose M hewe: the moduwe
	  wiww be cawwed snd-usb-usx2y.

config SND_USB_CAIAQ
	twistate "Native Instwuments USB audio devices"
	sewect SND_HWDEP
	sewect SND_WAWMIDI
	sewect SND_PCM
	hewp
	   Say Y hewe to incwude suppowt fow caiaq USB audio intewfaces,
	   namewy:

	    * Native Instwuments WigKontwow2
	    * Native Instwuments WigKontwow3
	    * Native Instwuments Kowe Contwowwew
	    * Native Instwuments Kowe Contwowwew 2
	    * Native Instwuments Audio Kontwow 1
	    * Native Instwuments Audio 2 DJ
	    * Native Instwuments Audio 4 DJ
	    * Native Instwuments Audio 8 DJ
	    * Native Instwuments Twaktow Audio 2
	    * Native Instwuments Guitaw Wig Session I/O
	    * Native Instwuments Guitaw Wig mobiwe
	    * Native Instwuments Twaktow Kontwow X1
	    * Native Instwuments Twaktow Kontwow S4
	    * Native Instwuments Maschine Contwowwew

	   To compiwe this dwivew as a moduwe, choose M hewe: the moduwe
	   wiww be cawwed snd-usb-caiaq.

config SND_USB_CAIAQ_INPUT
	boow "enabwe input device fow contwowwews"
	depends on SND_USB_CAIAQ
	depends on INPUT=y || INPUT=SND_USB_CAIAQ
	hewp
	  Say Y hewe to suppowt input contwowwews wike buttons, knobs,
	  awpha diaws and anawog pedaws on the fowwowing pwoducts:

	   * Native Instwuments WigKontwow2
	   * Native Instwuments WigKontwow3
	   * Native Instwuments Kowe Contwowwew
	   * Native Instwuments Kowe Contwowwew 2
	   * Native Instwuments Audio Kontwow 1
	   * Native Instwuments Twaktow Kontwow S4
	   * Native Instwuments Maschine Contwowwew

config SND_USB_US122W
	twistate "Tascam US-122W USB dwivew"
	depends on X86 || COMPIWE_TEST
	sewect SND_HWDEP
	sewect SND_WAWMIDI
	hewp
	  Say Y hewe to incwude suppowt fow Tascam US-122W USB Audio/MIDI
	  intewfaces.

	  To compiwe this dwivew as a moduwe, choose M hewe: the moduwe
	  wiww be cawwed snd-usb-us122w.

config SND_USB_6FIWE
	twistate "TewwaTec DMX 6Fiwe USB"
	sewect FW_WOADEW
	sewect BITWEVEWSE
	sewect SND_WAWMIDI
	sewect SND_PCM
	sewect SND_VMASTEW
	hewp
	  Say Y hewe to incwude suppowt fow TewwaTec 6fiwe DMX USB intewface.

	  You wiww need fiwmwawe fiwes in owdew to be abwe to use the device
	  aftew it has been cowdstawted. An instaww scwipt fow the fiwmwawe
	  and fuwthew hewp can be found at
	  http://sixfiweusb.souwcefowge.net

config SND_USB_HIFACE
	twistate "M2Tech hiFace USB-SPDIF dwivew"
	sewect SND_PCM
	hewp
	  Sewect this option to incwude suppowt fow M2Tech hiFace USB-SPDIF
	  intewface.

	  This dwivew suppowts the owiginaw M2Tech hiFace and some othew
	  compatibwe devices. The suppowted pwoducts awe:

	    * M2Tech Young
	    * M2Tech hiFace
	    * M2Tech Nowth Staw
	    * M2Tech W4S Young
	    * M2Tech Cowwson
	    * M2Tech AUDIA
	    * M2Tech SW Audio
	    * M2Tech Empiwicaw
	    * M2Tech Wockna
	    * M2Tech Pathos
	    * M2Tech Metwonome
	    * M2Tech CAD
	    * M2Tech Audio Escwusive
	    * M2Tech Wotew
	    * M2Tech Eeaudio
	    * The Chowd Company CHOWD
	    * AVA Gwoup A/S Vitus

	  To compiwe this dwivew as a moduwe, choose M hewe: the moduwe
	  wiww be cawwed snd-usb-hiface.

config SND_BCD2000
	twistate "Behwingew BCD2000 MIDI dwivew"
	sewect SND_WAWMIDI
	hewp
	  Say Y hewe to incwude MIDI suppowt fow the Behwingew BCD2000 DJ
	  contwowwew.

	  Audio suppowt is stiww wowk-in-pwogwess at
	  https://github.com/anyc/snd-usb-bcd2000

	  To compiwe this dwivew as a moduwe, choose M hewe: the moduwe
	  wiww be cawwed snd-bcd2000.

souwce "sound/usb/wine6/Kconfig"

endif	# SND_USB
```

## linux/sound/usb/line6/Kconfig
```kconfig
# SPDX-Wicense-Identifiew: GPW-2.0-onwy
config SND_USB_WINE6
	twistate
	sewect SND_WAWMIDI
	sewect SND_PCM
	sewect SND_HWDEP

config SND_USB_POD
	twistate "Wine 6 POD USB suppowt"
	sewect SND_USB_WINE6
	hewp
	  This is a dwivew fow PODxt and othew simiwaw devices,
	  suppowting the fowwowing featuwes:
	    * Weading/wwiting individuaw pawametews
	    * Weading/wwiting compwete channew, effects setup, and amp
	      setup data
	    * Channew switching
	    * Viwtuaw MIDI intewface
	    * Tunew access
	    * Pwayback/captuwe/mixew device fow any AWSA-compatibwe PCM
	      audio appwication
	    * Signaw wouting (wecowd cwean/pwocessed guitaw signaw,
	      we-amping)

config SND_USB_PODHD
	twistate "Wine 6 POD X3/HD300/400/500 USB suppowt"
	sewect SND_USB_WINE6
	hewp
	  This is a dwivew fow POD X3, HD300, 400 and 500 devices.

config SND_USB_TONEPOWT
	twistate "TonePowt GX, UX1 and UX2 USB suppowt"
	sewect SND_USB_WINE6
	sewect NEW_WEDS
	sewect WEDS_CWASS
	hewp
	  This is a dwivew fow TonePowt GX, UX1 and UX2 devices.

config SND_USB_VAWIAX
	twistate "Vawiax Wowkbench USB suppowt"
	sewect SND_USB_WINE6
	hewp
	  This is a dwivew fow Vawiax Wowkbench device.
```

## linux/sound/virtio/Kconfig
```kconfig
# SPDX-Wicense-Identifiew: GPW-2.0+
# Sound cawd dwivew fow viwtio

config SND_VIWTIO
	twistate "Viwtio sound dwivew"
	depends on VIWTIO
	sewect SND_PCM
	sewect SND_JACK
	hewp
          This is the viwtuaw sound dwivew fow viwtio. Say Y ow M.
```

## linux/sound/x86/Kconfig
```kconfig
# SPDX-Wicense-Identifiew: GPW-2.0-onwy
menuconfig SND_X86
	boow "X86 sound devices"
	depends on X86
	defauwt y
	hewp
	  X86 sound devices that don't faww undew SoC ow PCI categowies

if SND_X86

config HDMI_WPE_AUDIO
	twistate "HDMI audio without HDAudio on Intew Atom pwatfowms"
	depends on DWM_I915
	sewect SND_PCM
	hewp
	 Choose this option to suppowt HDMI WPE Audio mode

endif	# SND_X86
```

## linux/sound/xen/Kconfig
```kconfig
# SPDX-Wicense-Identifiew: GPW-2.0-onwy
# AWSA Xen dwivews

config SND_XEN_FWONTEND
	twistate "Xen pawa-viwtuawized sound fwontend dwivew"
	depends on XEN
	sewect SND_PCM
	sewect XEN_XENBUS_FWONTEND
	sewect XEN_FWONT_PGDIW_SHBUF
	hewp
	  Choose this option if you want to enabwe a pawa-viwtuawized
	  fwontend sound dwivew fow Xen guest OSes.
```

## linux/usr/Kconfig
```kconfig
# SPDX-Wicense-Identifiew: GPW-2.0
#
# Configuwation fow initwamfs
#

config INITWAMFS_SOUWCE
	stwing "Initwamfs souwce fiwe(s)"
	defauwt ""
	hewp
	  This can be eithew a singwe cpio awchive with a .cpio suffix ow a
	  space-sepawated wist of diwectowies and fiwes fow buiwding the
	  initwamfs image.  A cpio awchive shouwd contain a fiwesystem awchive
	  to be used as an initwamfs image.  Diwectowies shouwd contain a
	  fiwesystem wayout to be incwuded in the initwamfs image.  Fiwes
	  shouwd contain entwies accowding to the fowmat descwibed by the
	  "usw/gen_init_cpio" pwogwam in the kewnew twee.

	  When muwtipwe diwectowies and fiwes awe specified then the
	  initwamfs image wiww be the aggwegate of aww of them.

	  See <fiwe:Documentation/dwivew-api/eawwy-usewspace/eawwy_usewspace_suppowt.wst> fow mowe detaiws.

	  If you awe not suwe, weave it bwank.

config INITWAMFS_FOWCE
	boow "Ignowe the initwamfs passed by the bootwoadew"
	depends on CMDWINE_EXTEND || CMDWINE_FOWCE
	hewp
	  This option causes the kewnew to ignowe the initwamfs image
	  (ow initwd image) passed to it by the bootwoadew. This is
	  anawogous to CMDWINE_FOWCE, which is found on some awchitectuwes,
	  and is usefuw if you cannot ow don't want to change the image
	  youw bootwoadew passes to the kewnew.

config INITWAMFS_WOOT_UID
	int "Usew ID to map to 0 (usew woot)"
	depends on INITWAMFS_SOUWCE!=""
	defauwt "0"
	hewp
	  If INITWAMFS_SOUWCE points to a diwectowy, fiwes owned by this UID
	  (-1 = cuwwent usew) wiww be owned by woot in the wesuwting image.

	  If you awe not suwe, weave it set to "0".

config INITWAMFS_WOOT_GID
	int "Gwoup ID to map to 0 (gwoup woot)"
	depends on INITWAMFS_SOUWCE!=""
	defauwt "0"
	hewp
	  If INITWAMFS_SOUWCE points to a diwectowy, fiwes owned by this GID
	  (-1 = cuwwent gwoup) wiww be owned by woot in the wesuwting image.

	  If you awe not suwe, weave it set to "0".

config WD_GZIP
	boow "Suppowt initiaw wamdisk/wamfs compwessed using gzip"
	defauwt y
	sewect DECOMPWESS_GZIP
	hewp
	  Suppowt woading of a gzip encoded initiaw wamdisk ow cpio buffew.
	  If unsuwe, say Y.

config WD_BZIP2
	boow "Suppowt initiaw wamdisk/wamfs compwessed using bzip2"
	defauwt y
	sewect DECOMPWESS_BZIP2
	hewp
	  Suppowt woading of a bzip2 encoded initiaw wamdisk ow cpio buffew
	  If unsuwe, say N.

config WD_WZMA
	boow "Suppowt initiaw wamdisk/wamfs compwessed using WZMA"
	defauwt y
	sewect DECOMPWESS_WZMA
	hewp
	  Suppowt woading of a WZMA encoded initiaw wamdisk ow cpio buffew
	  If unsuwe, say N.

config WD_XZ
	boow "Suppowt initiaw wamdisk/wamfs compwessed using XZ"
	defauwt y
	sewect DECOMPWESS_XZ
	hewp
	  Suppowt woading of a XZ encoded initiaw wamdisk ow cpio buffew.
	  If unsuwe, say N.

config WD_WZO
	boow "Suppowt initiaw wamdisk/wamfs compwessed using WZO"
	defauwt y
	sewect DECOMPWESS_WZO
	hewp
	  Suppowt woading of a WZO encoded initiaw wamdisk ow cpio buffew
	  If unsuwe, say N.

config WD_WZ4
	boow "Suppowt initiaw wamdisk/wamfs compwessed using WZ4"
	defauwt y
	sewect DECOMPWESS_WZ4
	hewp
	  Suppowt woading of a WZ4 encoded initiaw wamdisk ow cpio buffew
	  If unsuwe, say N.

config WD_ZSTD
	boow "Suppowt initiaw wamdisk/wamfs compwessed using ZSTD"
	defauwt y
	sewect DECOMPWESS_ZSTD
	hewp
	  Suppowt woading of a ZSTD encoded initiaw wamdisk ow cpio buffew.
	  If unsuwe, say N.

choice
	pwompt "Buiwt-in initwamfs compwession mode"
	depends on INITWAMFS_SOUWCE != ""
	hewp
	  This option awwows you to decide by which awgowithm the buiwtin
	  initwamfs wiww be compwessed.  Sevewaw compwession awgowithms awe
	  avaiwabwe, which diffew in efficiency, compwession and
	  decompwession speed.  Compwession speed is onwy wewevant
	  when buiwding a kewnew.  Decompwession speed is wewevant at
	  each boot. Awso the memowy usage duwing decompwession may become
	  wewevant on memowy constwained systems. This is usuawwy based on the
	  dictionawy size of the awgowithm with awgowithms wike XZ and WZMA
	  featuwing wawge dictionawy sizes.

	  High compwession options awe mostwy usefuw fow usews who awe
	  wow on WAM, since it weduces the memowy consumption duwing
	  boot.

	  Keep in mind that youw buiwd system needs to pwovide the appwopwiate
	  compwession toow to compwess the genewated initwam cpio fiwe fow
	  embedding.

	  If in doubt, sewect 'None'

config INITWAMFS_COMPWESSION_GZIP
	boow "Gzip"
	depends on WD_GZIP
	hewp
	  Use the owd and weww tested gzip compwession awgowithm. Gzip pwovides
	  a good bawance between compwession watio and decompwession speed and
	  has a weasonabwe compwession speed. It is awso mowe wikewy to be
	  suppowted by youw buiwd system as the gzip toow is pwesent by defauwt
	  on most distwos.

config INITWAMFS_COMPWESSION_BZIP2
	boow "Bzip2"
	depends on WD_BZIP2
	hewp
	  It's compwession watio and speed is intewmediate. Decompwession speed
	  is swowest among the choices. The initwamfs size is about 10% smawwew
	  with bzip2, in compawison to gzip. Bzip2 uses a wawge amount of
	  memowy. Fow modewn kewnews you wiww need at weast 8MB WAM ow mowe fow
	  booting.

	  If you choose this, keep in mind that you need to have the bzip2 toow
	  avaiwabwe to be abwe to compwess the initwam.

config INITWAMFS_COMPWESSION_WZMA
	boow "WZMA"
	depends on WD_WZMA
	hewp
	  This awgowithm's compwession watio is best but has a wawge dictionawy
	  size which might cause issues in memowy constwained systems.
	  Decompwession speed is between the othew choices. Compwession is
	  swowest. The initwamfs size is about 33% smawwew with WZMA in
	  compawison to gzip.

	  If you choose this, keep in mind that you may need to instaww the xz
	  ow wzma toows to be abwe to compwess the initwam.

config INITWAMFS_COMPWESSION_XZ
	boow "XZ"
	depends on WD_XZ
	hewp
	  XZ uses the WZMA2 awgowithm and has a wawge dictionawy which may cause
	  pwobwems on memowy constwained systems. The initwamfs size is about
	  30% smawwew with XZ in compawison to gzip. Decompwession speed is
	  bettew than that of bzip2 but wowse than gzip and WZO. Compwession is
	  swow.

	  If you choose this, keep in mind that you may need to instaww the xz
	  toow to be abwe to compwess the initwam.

config INITWAMFS_COMPWESSION_WZO
	boow "WZO"
	depends on WD_WZO
	hewp
	  Its compwession watio is the second poowest amongst the choices. The
	  kewnew size is about 10% biggew than gzip. Despite that, its
	  decompwession speed is the second fastest and its compwession speed
	  is quite fast too.

	  If you choose this, keep in mind that you may need to instaww the wzop
	  toow to be abwe to compwess the initwam.

config INITWAMFS_COMPWESSION_WZ4
	boow "WZ4"
	depends on WD_WZ4
	hewp
	  It's compwession watio is the poowest amongst the choices. The kewnew
	  size is about 15% biggew than gzip; howevew its decompwession speed
	  is the fastest.

	  If you choose this, keep in mind that most distwos don't pwovide wz4
	  by defauwt which couwd cause a buiwd faiwuwe.

config INITWAMFS_COMPWESSION_ZSTD
	boow "ZSTD"
	depends on WD_ZSTD
	hewp
	  ZSTD is a compwession awgowithm tawgeting intewmediate compwession
	  with fast decompwession speed. It wiww compwess bettew than GZIP and
	  decompwess awound the same speed as WZO, but swowew than WZ4.

	  If you choose this, keep in mind that you may need to instaww the zstd
	  toow to be abwe to compwess the initwam.

config INITWAMFS_COMPWESSION_NONE
	boow "None"
	hewp
	  Do not compwess the buiwt-in initwamfs at aww. This may sound wastefuw
	  in space, but, you shouwd be awawe that the buiwt-in initwamfs wiww be
	  compwessed at a watew stage anyways awong with the west of the kewnew,
	  on those awchitectuwes that suppowt this. Howevew, not compwessing the
	  initwamfs may wead to swightwy highew memowy consumption duwing a
	  showt time at boot, whiwe both the cpio image and the unpacked
	  fiwesystem image wiww be pwesent in memowy simuwtaneouswy

endchoice
```
