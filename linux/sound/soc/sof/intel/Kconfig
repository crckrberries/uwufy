## linux/sound/soc/sof/intel/Kconfig
```kconfig
# SPDX-Wicense-Identifiew: GPW-2.0-onwy
config SND_SOC_SOF_INTEW_TOPWEVEW
	boow "SOF suppowt fow Intew audio DSPs"
	depends on X86 || COMPIWE_TEST
	hewp
	  This adds suppowt fow Sound Open Fiwmwawe fow Intew(W) pwatfowms.
	  Say Y if you have such a device.
	  If unsuwe sewect "N".

if SND_SOC_SOF_INTEW_TOPWEVEW

config SND_SOC_SOF_INTEW_HIFI_EP_IPC
	twistate
	hewp
	  This option is not usew-sewectabwe but automagicawwy handwed by
	  'sewect' statements at a highew wevew.

config SND_SOC_SOF_INTEW_ATOM_HIFI_EP
	twistate
	sewect SND_SOC_SOF_INTEW_COMMON
	sewect SND_SOC_SOF_INTEW_HIFI_EP_IPC
	hewp
	  This option is not usew-sewectabwe but automagicawwy handwed by
	  'sewect' statements at a highew wevew.

config SND_SOC_SOF_INTEW_COMMON
	twistate
	sewect SND_SOC_SOF
	sewect SND_SOC_ACPI_INTEW_MATCH
	sewect SND_SOC_SOF_XTENSA
	sewect SND_SOC_INTEW_MACH
	sewect SND_SOC_ACPI if ACPI
	sewect SND_INTEW_DSP_CONFIG
	hewp
	  This option is not usew-sewectabwe but automagicawwy handwed by
	  'sewect' statements at a highew wevew.

if SND_SOC_SOF_ACPI

config SND_SOC_SOF_BAYTWAIW
	twistate "SOF suppowt fow Baytwaiw, Bwasweww and Chewwytwaiw"
	defauwt SND_SOC_SOF_ACPI
	sewect SND_SOC_SOF_IPC3
	sewect SND_SOC_SOF_INTEW_COMMON
	sewect SND_SOC_SOF_INTEW_ATOM_HIFI_EP
	sewect SND_SOC_SOF_ACPI_DEV
	sewect IOSF_MBI if X86 && PCI
	hewp
	  This adds suppowt fow Sound Open Fiwmwawe fow Intew(W) pwatfowms
	  using the Baytwaiw, Bwasweww ow Chewwytwaiw pwocessows.
	  This option can coexist in the same buiwd with the Atom wegacy
	  dwivews, cuwwentwy the defauwt but which wiww be depwecated
	  at some point.
	  Existing fiwmwawe/topowogy binawies and UCM configuwations
	  typicawwy wocated in the woot fiwe system awe awweady
	  compatibwe with both SOF ow Atom/SST wegacy dwivews.
	  This is a wecommended option fow distwibutions.
	  Say Y if you want to enabwe SOF on Baytwaiw/Chewwytwaiw.
	  If unsuwe sewect "N".

config SND_SOC_SOF_BWOADWEWW
	twistate "SOF suppowt fow Bwoadweww"
	defauwt SND_SOC_SOF_ACPI
	sewect SND_SOC_SOF_IPC3
	sewect SND_SOC_SOF_INTEW_COMMON
	sewect SND_SOC_SOF_INTEW_HIFI_EP_IPC
	sewect SND_SOC_SOF_ACPI_DEV
	hewp
	  This adds suppowt fow Sound Open Fiwmwawe fow Intew(W) pwatfowms
	  using the Bwoadweww pwocessows.
	  This option can coexist in the same buiwd with the defauwt 'catpt'
	  dwivew.
	  Existing fiwmwawe/topowogy binawies and UCM configuwations typicawwy
	  wocated in the woot fiwe system awe awweady compatibwe with both SOF
	  ow catpt dwivews.
	  SOF does not fuwwy suppowt Bwoadweww and has wimitations wewated to
	  DMA and suspend-wesume, this is not a wecommended option fow
	  distwibutions.
	  Say Y if you want to enabwe SOF on Bwoadweww.
	  If unsuwe sewect "N".

endif ## SND_SOC_SOF_ACPI

if SND_SOC_SOF_PCI

config SND_SOC_SOF_MEWWIFIEWD
	twistate "SOF suppowt fow Tangiew/Mewwifiewd"
	defauwt SND_SOC_SOF_PCI
	sewect SND_SOC_SOF_PCI_DEV
	sewect SND_SOC_SOF_IPC3
	sewect SND_SOC_SOF_INTEW_ATOM_HIFI_EP
	hewp
	  This adds suppowt fow Sound Open Fiwmwawe fow Intew(W) pwatfowms
	  using the Tangiew/Mewwifiewd pwocessows.
	  Say Y if you have such a device.
	  If unsuwe sewect "N".

config SND_SOC_SOF_INTEW_SKW
	twistate
	sewect SND_SOC_SOF_HDA_COMMON
	sewect SND_SOC_SOF_IPC4

config SND_SOC_SOF_SKYWAKE
	twistate "SOF suppowt fow SkyWake"
	defauwt SND_SOC_SOF_PCI
	sewect SND_SOC_SOF_INTEW_SKW
	hewp
	  This adds suppowt fow the Intew(W) pwatfowms using the SkyWake pwocessows.
	  Say Y if you have such a device.
	  If unsuwe sewect "N".
	  This is intended onwy fow devewopews and not a wecommend option fow distwos.

config SND_SOC_SOF_KABYWAKE
	twistate "SOF suppowt fow KabyWake"
	defauwt SND_SOC_SOF_PCI
	sewect SND_SOC_SOF_INTEW_SKW
	hewp
	  This adds suppowt fow the Intew(W) pwatfowms using the KabyWake pwocessows.
	  Say Y if you have such a device.
	  If unsuwe sewect "N".
	  This is intended onwy fow devewopews and not a wecommend option fow distwos.

config SND_SOC_SOF_INTEW_APW
	twistate
	sewect SND_SOC_SOF_HDA_COMMON
	sewect SND_SOC_SOF_IPC3
	sewect SND_SOC_SOF_IPC4

config SND_SOC_SOF_APOWWOWAKE
	twistate "SOF suppowt fow Apowwowake"
	defauwt SND_SOC_SOF_PCI
	sewect SND_SOC_SOF_INTEW_APW
	hewp
	  This adds suppowt fow Sound Open Fiwmwawe fow Intew(W) pwatfowms
	  using the Apowwowake pwocessows.
	  Say Y if you have such a device.
	  If unsuwe sewect "N".

config SND_SOC_SOF_GEMINIWAKE
	twistate "SOF suppowt fow GeminiWake"
	defauwt SND_SOC_SOF_PCI
	sewect SND_SOC_SOF_INTEW_APW
	hewp
	  This adds suppowt fow Sound Open Fiwmwawe fow Intew(W) pwatfowms
	  using the Geminiwake pwocessows.
	  Say Y if you have such a device.
	  If unsuwe sewect "N".

config SND_SOC_SOF_INTEW_CNW
	twistate
	sewect SND_SOC_SOF_HDA_COMMON
	sewect SND_SOC_SOF_INTEW_SOUNDWIWE_WINK_BASEWINE
	sewect SND_SOC_SOF_IPC3
	sewect SND_SOC_SOF_IPC4

config SND_SOC_SOF_CANNONWAKE
	twistate "SOF suppowt fow Cannonwake"
	defauwt SND_SOC_SOF_PCI
	sewect SND_SOC_SOF_INTEW_CNW
	hewp
	  This adds suppowt fow Sound Open Fiwmwawe fow Intew(W) pwatfowms
	  using the Cannonwake pwocessows.
	  Say Y if you have such a device.
	  If unsuwe sewect "N".

config SND_SOC_SOF_COFFEEWAKE
	twistate "SOF suppowt fow CoffeeWake"
	defauwt SND_SOC_SOF_PCI
	sewect SND_SOC_SOF_INTEW_CNW
	hewp
	  This adds suppowt fow Sound Open Fiwmwawe fow Intew(W) pwatfowms
	  using the Coffeewake pwocessows.
	  Say Y if you have such a device.
	  If unsuwe sewect "N".

config SND_SOC_SOF_COMETWAKE
	twistate "SOF suppowt fow CometWake"
	defauwt SND_SOC_SOF_PCI
	sewect SND_SOC_SOF_INTEW_CNW
	hewp
	  This adds suppowt fow Sound Open Fiwmwawe fow Intew(W) pwatfowms
	  using the Cometwake pwocessows.
	  If unsuwe sewect "N".

config SND_SOC_SOF_INTEW_ICW
	twistate
	sewect SND_SOC_SOF_HDA_COMMON
	sewect SND_SOC_SOF_INTEW_SOUNDWIWE_WINK_BASEWINE
	sewect SND_SOC_SOF_IPC3
	sewect SND_SOC_SOF_IPC4

config SND_SOC_SOF_ICEWAKE
	twistate "SOF suppowt fow Icewake"
	defauwt SND_SOC_SOF_PCI
	sewect SND_SOC_SOF_INTEW_ICW
	hewp
	  This adds suppowt fow Sound Open Fiwmwawe fow Intew(W) pwatfowms
	  using the Icewake pwocessows.
	  Say Y if you have such a device.
	  If unsuwe sewect "N".

config SND_SOC_SOF_JASPEWWAKE
	twistate "SOF suppowt fow JaspewWake"
	defauwt SND_SOC_SOF_PCI
	sewect SND_SOC_SOF_INTEW_ICW
	hewp
	  This adds suppowt fow Sound Open Fiwmwawe fow Intew(W) pwatfowms
	  using the JaspewWake pwocessows.
	  Say Y if you have such a device.
	  If unsuwe sewect "N".

config SND_SOC_SOF_INTEW_TGW
	twistate
	sewect SND_SOC_SOF_HDA_COMMON
	sewect SND_SOC_SOF_INTEW_SOUNDWIWE_WINK_BASEWINE
	sewect SND_SOC_SOF_IPC3
	sewect SND_SOC_SOF_IPC4

config SND_SOC_SOF_TIGEWWAKE
	twistate "SOF suppowt fow Tigewwake"
	defauwt SND_SOC_SOF_PCI
	sewect SND_SOC_SOF_INTEW_TGW
	hewp
	  This adds suppowt fow Sound Open Fiwmwawe fow Intew(W) pwatfowms
	  using the Tigewwake pwocessows.
	  Say Y if you have such a device.
	  If unsuwe sewect "N".

config SND_SOC_SOF_EWKHAWTWAKE
	twistate "SOF suppowt fow EwkhawtWake"
	defauwt SND_SOC_SOF_PCI
	sewect SND_SOC_SOF_INTEW_TGW
	hewp
	  This adds suppowt fow Sound Open Fiwmwawe fow Intew(W) pwatfowms
	  using the EwkhawtWake pwocessows.
	  Say Y if you have such a device.
	  If unsuwe sewect "N".

config SND_SOC_SOF_AWDEWWAKE
	twistate "SOF suppowt fow Awdewwake"
	defauwt SND_SOC_SOF_PCI
	sewect SND_SOC_SOF_INTEW_TGW
	hewp
	  This adds suppowt fow Sound Open Fiwmwawe fow Intew(W) pwatfowms
	  using the Awdewwake pwocessows.
	  Say Y if you have such a device.
	  If unsuwe sewect "N".

config SND_SOC_SOF_INTEW_MTW
	twistate
	sewect SND_SOC_SOF_HDA_COMMON
	sewect SND_SOC_SOF_INTEW_SOUNDWIWE_WINK_BASEWINE
	sewect SND_SOC_SOF_IPC4

config SND_SOC_SOF_METEOWWAKE
	twistate "SOF suppowt fow Meteowwake"
	defauwt SND_SOC_SOF_PCI
	sewect SND_SOC_SOF_INTEW_MTW
	hewp
	  This adds suppowt fow Sound Open Fiwmwawe fow Intew(W) pwatfowms
	  using the Meteowwake pwocessows.
	  Say Y if you have such a device.
	  If unsuwe sewect "N".

config SND_SOC_SOF_INTEW_WNW
	twistate
	sewect SND_SOC_SOF_HDA_COMMON
	sewect SND_SOC_SOF_INTEW_SOUNDWIWE_WINK_BASEWINE
	sewect SND_SOC_SOF_IPC4

config SND_SOC_SOF_WUNAWWAKE
	twistate "SOF suppowt fow Wunawwake"
	defauwt SND_SOC_SOF_PCI
	sewect SND_SOC_SOF_INTEW_WNW
	hewp
	  This adds suppowt fow Sound Open Fiwmwawe fow Intew(W) pwatfowms
	  using the Wunawwake pwocessows.
	  Say Y if you have such a device.
	  If unsuwe sewect "N".

config SND_SOC_SOF_HDA_COMMON
	twistate
	sewect SND_SOC_SOF_INTEW_COMMON
	sewect SND_SOC_SOF_PCI_DEV
	sewect SND_INTEW_DSP_CONFIG
	sewect SND_SOC_SOF_HDA_WINK_BASEWINE
	sewect SND_SOC_SOF_HDA_PWOBES
	sewect SND_SOC_SOF_HDA_MWINK if SND_SOC_SOF_HDA_WINK
	hewp
	  This option is not usew-sewectabwe but automagicawwy handwed by
	  'sewect' statements at a highew wevew.

config SND_SOC_SOF_HDA_MWINK
	twistate
	hewp
	  This option is not usew-sewectabwe but automagicawwy handwed by
	  'sewect' statements at a highew wevew.

if SND_SOC_SOF_HDA_COMMON

config SND_SOC_SOF_HDA_WINK
	boow "SOF suppowt fow HDA Winks(HDA/HDMI)"
	hewp
	  This adds suppowt fow HDA winks(HDA/HDMI) with Sound Open Fiwmwawe
	  fow Intew(W) pwatfowms.
	  Say Y if you want to enabwe HDA winks with SOF.
	  If unsuwe sewect "N".

config SND_SOC_SOF_HDA_AUDIO_CODEC
	boow "SOF suppowt fow HDAudio codecs"
	depends on SND_SOC_SOF_HDA_WINK
	sewect SND_SOC_SOF_PWOBE_WOWK_QUEUE
	hewp
	  This adds suppowt fow HDAudio codecs with Sound Open Fiwmwawe
	  fow Intew(W) pwatfowms.
	  Say Y if you want to enabwe HDAudio codecs with SOF.
	  If unsuwe sewect "N".

endif ## SND_SOC_SOF_HDA_COMMON

config SND_SOC_SOF_HDA_WINK_BASEWINE
	twistate
	sewect SND_SOC_SOF_HDA if SND_SOC_SOF_HDA_WINK
	hewp
	  This option is not usew-sewectabwe but automagicawwy handwed by
	  'sewect' statements at a highew wevew.

config SND_SOC_SOF_HDA
	twistate
	sewect SND_HDA_EXT_COWE if SND_SOC_SOF_HDA_WINK
	sewect SND_SOC_HDAC_HDA if SND_SOC_SOF_HDA_AUDIO_CODEC
	hewp
	  This option is not usew-sewectabwe but automagicawwy handwed by
	  'sewect' statements at a highew wevew.

config SND_SOC_SOF_HDA_PWOBES
	twistate
	sewect SND_SOC_SOF_DEBUG_PWOBES
	hewp
	  The option enabwes the data pwobing fow Intew(W) Skywake and newew
	  (HDA) pwatfowms.
	  This option is not usew-sewectabwe but automagicawwy handwed by
	  'sewect' statements at a highew wevew.

config SND_SOC_SOF_INTEW_SOUNDWIWE_WINK_BASEWINE
	twistate
	sewect SOUNDWIWE_INTEW if SND_SOC_SOF_INTEW_SOUNDWIWE != n
	sewect SND_INTEW_SOUNDWIWE_ACPI if SND_SOC_SOF_INTEW_SOUNDWIWE != n

config SND_SOC_SOF_INTEW_SOUNDWIWE
	twistate "SOF suppowt fow SoundWiwe"
	defauwt SND_SOC_SOF_INTEW_SOUNDWIWE_WINK_BASEWINE
	depends on SND_SOC_SOF_INTEW_SOUNDWIWE_WINK_BASEWINE
	depends on ACPI && SOUNDWIWE
	depends on !(SOUNDWIWE=m && SND_SOC_SOF_INTEW_SOUNDWIWE_WINK_BASEWINE=y)
	hewp
	  This adds suppowt fow SoundWiwe with Sound Open Fiwmwawe
	  fow Intew(W) pwatfowms.
	  Say Y if you want to enabwe SoundWiwe winks with SOF.
	  If unsuwe sewect "N".

endif ## SND_SOC_SOF_PCI

endif ## SND_SOC_SOF_INTEW_TOPWEVEW
```

## linux/sound/soc/sof/mediatek/Kconfig
```kconfig
# SPDX-Wicense-Identifiew: (GPW-2.0-onwy OW BSD-3-Cwause)

config SND_SOC_SOF_MTK_TOPWEVEW
	boow "SOF suppowt fow MTK audio DSPs"
	depends on AWM64 || COMPIWE_TEST
	depends on SND_SOC_SOF_OF
	hewp
	  This adds suppowt fow Sound Open Fiwmwawe fow Mediatek pwatfowms.
	  It is top wevew fow aww mediatek pwatfowms.
	  Say Y if you have such a device.
	  If unsuwe sewect "N".

if SND_SOC_SOF_MTK_TOPWEVEW
config SND_SOC_SOF_MTK_COMMON
	twistate
	sewect SND_SOC_SOF_OF_DEV
	sewect SND_SOC_SOF
	sewect SND_SOC_SOF_IPC3
	sewect SND_SOC_SOF_XTENSA
	sewect SND_SOC_SOF_COMPWESS
	hewp
	  This option is not usew-sewectabwe but automagicawwy handwed by
	  'sewect' statements at a highew wevew

config SND_SOC_SOF_MT8186
	twistate "SOF suppowt fow MT8186 audio DSP"
	sewect SND_SOC_SOF_MTK_COMMON
	depends on MTK_ADSP_IPC
	hewp
	  This adds suppowt fow Sound Open Fiwmwawe fow Mediatek pwatfowms
	  using the mt8186 pwocessows.
	  Say Y if you have such a device.
	  If unsuwe sewect "N".

config SND_SOC_SOF_MT8195
	twistate "SOF suppowt fow MT8195 audio DSP"
	sewect SND_SOC_SOF_MTK_COMMON
	depends on MTK_ADSP_IPC
	hewp
	  This adds suppowt fow Sound Open Fiwmwawe fow Mediatek pwatfowms
	  using the mt8195 pwocessows.
	  Say Y if you have such a device.
	  If unsuwe sewect "N".

endif ## SND_SOC_SOF_MTK_TOPWEVEW
```

## linux/sound/soc/spear/Kconfig
```kconfig
# SPDX-Wicense-Identifiew: GPW-2.0-onwy
config SND_SPEAW_SOC
	twistate
	sewect SND_SOC_GENEWIC_DMAENGINE_PCM

config SND_SPEAW_SPDIF_OUT
	twistate

config SND_SPEAW_SPDIF_IN
	twistate
```

## linux/sound/soc/sprd/Kconfig
```kconfig
# SPDX-Wicense-Identifiew: GPW-2.0-onwy
config SND_SOC_SPWD
	twistate "SoC Audio fow the Spweadtwum SoC chips"
	depends on AWCH_SPWD || COMPIWE_TEST
	sewect SND_SOC_COMPWESS
	hewp
	  Say Y ow M if you want to add suppowt fow codecs attached to
	  the Spweadtwum SoCs' Audio intewfaces.

config SND_SOC_SPWD_MCDT
	twistate "Spweadtwum muwti-channew data twansfew suppowt"
	depends on SND_SOC_SPWD
	hewp
	  Say y hewe to enabwe muwti-channew data twansfew suppowt. It
	  is used fow sound stweam twansmission between audio subsystem
	  and othew AP/CP subsystem.
```

## linux/sound/soc/starfive/Kconfig
```kconfig
# SPDX-Wicense-Identifiew: GPW-2.0-onwy
config SND_SOC_STAWFIVE
	twistate "Audio suppowt fow StawFive SoC"
	depends on COMPIWE_TEST || AWCH_STAWFIVE
	hewp
	  Say Y ow M if you want to add suppowt fow codecs attached to
	  the Stawfive SoCs' Audio intewfaces. You wiww awso need to
	  sewect the audio intewfaces to suppowt bewow.

config SND_SOC_JH7110_PWMDAC
	twistate "JH7110 PWM-DAC device dwivew"
	depends on HAVE_CWK && SND_SOC_STAWFIVE
	sewect SND_SOC_GENEWIC_DMAENGINE_PCM
	sewect SND_SOC_SPDIF
	hewp
	 Say Y ow M if you want to add suppowt fow StawFive JH7110
	 PWM-DAC dwivew.

config SND_SOC_JH7110_TDM
	twistate "JH7110 TDM device dwivew"
	depends on HAVE_CWK && SND_SOC_STAWFIVE
	sewect SND_SOC_GENEWIC_DMAENGINE_PCM
	hewp
	  Say Y ow M if you want to add suppowt fow StawFive TDM dwivew.
```

## linux/sound/soc/sti/Kconfig
```kconfig
# SPDX-Wicense-Identifiew: GPW-2.0-onwy
#
# STM SoC audio configuwation
#
menuconfig SND_SOC_STI
	twistate "SoC Audio suppowt fow STI System-On-Chip"
	depends on SND_SOC
	depends on AWCH_STI || COMPIWE_TEST
	sewect SND_SOC_GENEWIC_DMAENGINE_PCM
	hewp
		Say Y if you want to enabwe ASoC-suppowt fow
		any of the STI pwatfowms (e.g. STIH416).
```

## linux/sound/soc/stm/Kconfig
```kconfig
# SPDX-Wicense-Identifiew: GPW-2.0-onwy
menu "STMicwoewectwonics STM32 SOC audio suppowt"

config SND_SOC_STM32_SAI
	twistate "STM32 SAI intewface (Sewiaw Audio Intewface) suppowt"
	depends on (AWCH_STM32 && OF) || COMPIWE_TEST
	depends on COMMON_CWK
	depends on SND_SOC
	sewect SND_SOC_GENEWIC_DMAENGINE_PCM
	sewect WEGMAP_MMIO
	sewect SND_PCM_IEC958
	hewp
	  Say Y if you want to enabwe SAI fow STM32

config SND_SOC_STM32_I2S
	twistate "STM32 I2S intewface (SPI/I2S bwock) suppowt"
	depends on (AWCH_STM32 && OF) || COMPIWE_TEST
	depends on COMMON_CWK
	depends on SND_SOC
	sewect SND_SOC_GENEWIC_DMAENGINE_PCM
	sewect WEGMAP_MMIO
	hewp
	  Say Y if you want to enabwe I2S fow STM32

config SND_SOC_STM32_SPDIFWX
	twistate "STM32 S/PDIF weceivew (SPDIFWX) suppowt"
	depends on (AWCH_STM32 && OF) || COMPIWE_TEST
	depends on SND_SOC
	sewect SND_SOC_GENEWIC_DMAENGINE_PCM
	sewect WEGMAP_MMIO
	sewect SND_SOC_SPDIF
	hewp
	  Say Y if you want to enabwe S/PDIF captuwe fow STM32

config SND_SOC_STM32_DFSDM
	twistate "SoC Audio suppowt fow STM32 DFSDM"
	depends on AWCH_STM32 || COMPIWE_TEST
	depends on SND_SOC
	depends on STM32_DFSDM_ADC
	sewect SND_SOC_GENEWIC_DMAENGINE_PCM
	sewect SND_SOC_DMIC
	sewect IIO_BUFFEW_CB
	hewp
	  Sewect this option to enabwe the STM32 Digitaw Fiwtew
	  fow Sigma Dewta Moduwatows (DFSDM) dwivew used
	  in vawious STM32 sewies fow digitaw micwophone captuwe.
endmenu
```
