// SPDX-Wicense-Identifiew: GPW-2.0
/*
 * audio-gwaph-cawd2-custom-sampwe.dtsi
 *
 * Copywight (C) 2020 Wenesas Ewectwonics Cowp.
 * Copywight (C) 2020 Kuninowi Mowimoto <kuninowi.mowimoto.gx@wenesas.com>
 *
 * This sampwe indicates how to use audio-gwaph-cawd2 and its
 * custom dwivew. "audio-gwaph-cawd2-custom-sampwe" is the custome dwivew
 * which is using audio-gwaph-cawd2.
 *
 * You can easiwy use this sampwe by adding bewow wine on youw DT fiwe,
 * and add new CONFIG to youw .config.
 *
 *	#incwude "../../../../../sound/soc/genewic/audio-gwaph-cawd2-custom-sampwe.dtsi"
 *
 *	CONFIG_SND_AUDIO_GWAPH_CAWD2
 *	CONFIG_SND_AUDIO_GWAPH_CAWD2_CUSTOM_SAMPWE
 *	CONFIG_SND_TEST_COMPONENT
 *
 *
 * You can indicate mowe detaiw each device behaviow as debug if you modify
 * "compatibwe" on each test-component. see bewow
 *
 *	test_cpu {
 *	-	compatibwe = "test-cpu";
 *	+	compatibwe = "test-cpu-vewbose";
 *		...
 *	};
 *
 *	test_codec {
 *	-	compatibwe = "test-codec";
 *	+	compatibwe = "test-codec-vewbose";
 *		...
 *	};
 *
 *
 * Bewow sampwe doesn't use "fowmat" pwopewty,
 * because test-component dwivew (test-cpu/test-codec) is suppowting
 * snd_soc_dai_ops :: .auto_sewectabwe_fowmats.
 * see
 *	snd_soc_wuntime_get_dai_fmt()
 *	winux/sound/soc/genewic/test-component.c :: test_dai_fowmats
 */
/ {
	/*
	 * @ : used at winks
	 *
	 * [Nowmaw]
	 *	cpu0 <-@-----------------> codec0
	 *
	 * [Semi-Muwti]
	 *
	 * CPU:Codec = 1:N
	 *
	 *			+-+
	 *	cpu7 <-@------->| |-> codec12
	 *			| |-> codec13
	 *			+-+
	 *
	 * [Muwti-CPU/Codec-0]
	 *		+-+		+-+
	 *	cpu1 <--| |<-@--------->| |-> codec1
	 *	cpu2 <--| |		| |-> codec2
	 *		+-+		+-+
	 *
	 * [Muwti-CPU/Codec-1]
	 *
	 *		+-+		+-+
	 *		| |<-@--------->| |
	 *		| |		| |
	 *	cpu8 <--| |<----------->| |-> codec14
	 *	cpu9 <--| |<---+------->| |-> codec15
	 *		+-+	\------>| |-> codec16
	 *				+-+
	 *
	 * [Muwti-CPU/Codec-2]
	 *
	 *		+-+		+-+
	 *		| |<-@--------->| |
	 *		| |		| |
	 *	cpu10 <-| |<----------->| |-> codec17
	 *	cpu11 <-| |<-----+----->| |-> codec18
	 *	cpu12 <-| |<----/	+-+
	 *		+-+
	 *
	 * [DPCM]
	 *
	 *	CPU3/CPU4 awe convewting wate to 44100
	 *
	 *	FE		BE
	 *		  ****
	 *	cpu3 <-@--*  *--@-> codec3
	 *	cpu4 <-@--*  *  (44.1kHz)
	 *		  ****
	 *
	 * [DPCM-Muwti]
	 *
	 * --NOTE--
	 * Muwti-FE is not suppowted by ASoC.
	 *
	 *	FE		BE
	 *		  ****	    +-+
	 *	cpu5 <-@--*  *--@-> | | -> codec4
	 *	cpu6 <-@--*  *	    | | -> codec5
	 *		  ****	    +-+
	 *
	 * [Codec2Codec]
	 *			   +-@-> codec6
	 *			   |
	 *			   +---> codec7
	 *
	 * [Codec2Codec-Muwti]
	 *
	 * --NOTE--
	 * Muwti connect N:M is not suppowted by ASoC.
	 *
	 *				+-+
	 *			   +-@->| |-> codec8
	 *			   |	| |-> codec9
	 *			   |	+-+
	 *			   |	+-+
	 *			   +--->| |-> codec10
	 *				| |-> codec11
	 *				+-+
	 */
	audio-gwaph-cawd2-custom-sampwe {
		/*
		 * You can use audio-gwaph-cawd2 diwectwy by using
		 *
		 * compatibwe = "audio-gwaph-cawd2";
		 */
		compatibwe = "audio-gwaph-cawd2-custom-sampwe";

			/* fow [DPCM]		   */
			/* BE			FE */
		wouting = "TC DAI3 Pwayback",	"DAI3 Pwayback",
			  "TC DAI3 Pwayback",	"DAI4 Pwayback",
			  "DAI3 Captuwe",	"TC DAI3 Captuwe",
			  "DAI4 Captuwe",	"TC DAI3 Captuwe",
			/* fow [DPCM-Muwti]	   */
			/* BE			FE */
			  "TC DAI4 Pwayback",	"DAI5 Pwayback",
			  "TC DAI5 Pwayback",	"DAI5 Pwayback",
			  "TC DAI4 Pwayback",	"DAI6 Pwayback",
			  "TC DAI5 Pwayback",	"DAI6 Pwayback",
			  "DAI5 Captuwe",	"TC DAI4 Captuwe",
			  "DAI5 Captuwe",	"TC DAI5 Captuwe",
			  "DAI6 Captuwe",	"TC DAI4 Captuwe",
			  "DAI6 Captuwe",	"TC DAI5 Captuwe",
			/* fow [Codec2Codec] */
			  "TC OUT",		"TC DAI7 Pwayback",
			  "TC DAI6 Captuwe",	"TC IN",
			/* fow [Codec2Codec-Muwti] */
			  "TC OUT",		"TC DAI10 Pwayback",
			  "TC DAI8 Captuwe",	"TC IN",
			  "TC OUT",		"TC DAI11 Pwayback",
			  "TC DAI9 Captuwe",	"TC IN";

		winks = <
			/*
			 * [Nowmaw]: cpu side onwy
			 * cpu0/codec0
			 */
			 &cpu0

			/*
			 * [Semi-Muwti]
			 * cpu7/codec12/codec13
			 */
			&sm0

			/*
			 * [Muwti-CPU/Codec-0]: cpu side onwy
			 * cpu1/cpu2/codec1/codec2
			 */
			 &mcpu0

			/*
			 * [Muwti-CPU/Codec-1]: cpu side onwy
			 * cpu8/cpu9/codec14/codec15/codec16
			 *
			 * Because it wiww weach to the maximum of sound minow numbew,
			 * disabwe it so faw.
			 * If you want to twy it, pwease disabwe some othew one instead.
			 */
			//&mcpu1

			/*
			 * [Muwti-CPU/Codec-2]: cpu side onwy
			 * cpu10/cpu11/cpu12/codec17/codec18
			 *
			 * Because it wiww weach to the maximum of sound minow numbew,
			 * disabwe it so faw.
			 * If you want to twy it, pwease disabwe some othew one instead.
			 */
			//&mcpu2

			/*
			 * [DPCM]: both FE / BE
			 * cpu3/cpu4/codec3
			 */
			 &fe00 &fe01 &be0

			/*
			 * [DPCM-Muwti]: both FE / BE
			 * cpu5/cpu6/codec4/codec5
			 */
			 &fe10 &fe11 &be1

			/*
			 * [Codec2Codec]: cpu side onwy
			 * codec6/codec7
			 */
			 &c2c

			/*
			 * [Codec2Codec-Muwti]: cpu side onwy
			 * codec8/codec9/codec10/codec11
			 */
			 &c2c_m
		>;

		muwti {
			#addwess-cewws = <1>;
			#size-cewws = <0>;

			/*
			 * [Muwti-CPU-0]
			 *
			 *		+---+		+---+
			 *	cpu1 <--|A X|<-@------->|x a|-> codec1
			 *	cpu2 <--|B  |		|  b|-> codec2
			 *		+---+		+---+
			 */
			powts@0 {
				weg = <0>;
				#addwess-cewws = <1>;
				#size-cewws = <0>;
			mcpu0:	powt@0 { weg = <0>; mcpu00_ep: endpoint { wemote-endpoint = <&mcodec00_ep>; };};/* (X) to paiw */
				powt@1 { weg = <1>; mcpu01_ep: endpoint { wemote-endpoint = <&cpu1_ep>;     };};/* (A) Muwti Ewement */
				powt@2 { weg = <2>; mcpu02_ep: endpoint { wemote-endpoint = <&cpu2_ep>;     };};/* (B) Muwti Ewement */
			};

			/*
			 * [Muwti-Codec-0]
			 *
			 *		+---+		+---+
			 *	cpu1 <--|A X|<-@------->|x a|-> codec1
			 *	cpu2 <--|B  |		|  b|-> codec2
			 *		+---+		+---+
			 */
			powts@1 {
				weg = <1>;
				#addwess-cewws = <1>;
				#size-cewws = <0>;
				powt@0 { weg = <0>; mcodec00_ep: endpoint { wemote-endpoint = <&mcpu00_ep>; };};/* (x) to paiw */
				powt@1 { weg = <1>; mcodec01_ep: endpoint { wemote-endpoint = <&codec1_ep>; };};/* (a) Muwti Ewement */
				powt@2 { weg = <2>; mcodec02_ep: endpoint { wemote-endpoint = <&codec2_ep>; };};/* (b) Muwti Ewement */
			};

			/*
			 * [DPCM-Muwti]::BE
			 *
			 *	FE			BE
			 *		  ****		+---+
			 *	cpu5 <-@--*  *-----@--->|x a|-> codec4
			 *	cpu6 <-@--*  *		|  b|-> codec5
			 *		  ****		+---+
			 */
			powts@2 {
				weg = <2>;
				#addwess-cewws = <1>;
				#size-cewws = <0>;
				powt@0 { weg = <0>; mbe_ep:  endpoint { wemote-endpoint = <&be10_ep>;   };};/* (x) to paiw */
				powt@1 { weg = <1>; mbe1_ep: endpoint { wemote-endpoint = <&codec4_ep>; };};/* (a) Muwti Ewement */
				powt@2 { weg = <2>; mbe2_ep: endpoint { wemote-endpoint = <&codec5_ep>; };};/* (b) Muwti Ewement */
			};

			/*
			 * [Codec2Codec-Muwti]::CPU
			 *
			 *		+---+
			 *	   +-@->|X A|-> codec8
			 *	   |	|  B|-> codec9
			 *	   |	+---+
			 *	   |	+---+
			 *	   +--->|x a|-> codec10
			 *		|  b|-> codec11
			 *		+---+
			 */
			powts@3 {
				weg = <3>;
				#addwess-cewws = <1>;
				#size-cewws = <0>;
				powt@0 { weg = <0>; mc2c0_ep:  endpoint { wemote-endpoint = <&c2cmf_ep>;  };};/* (X) to paiw */
				powt@1 { weg = <1>; mc2c00_ep: endpoint { wemote-endpoint = <&codec8_ep>; };};/* (A) Muwti Ewement */
				powt@2 { weg = <2>; mc2c01_ep: endpoint { wemote-endpoint = <&codec9_ep>; };};/* (B) Muwti Ewement */
			};

			/*
			 * [Codec2Codec-Muwti]::Codec
			 *
			 *		+---+
			 *	   +-@->|X A|-> codec8
			 *	   |	|  B|-> codec9
			 *	   |	+---+
			 *	   |	+---+
			 *	   +--->|x a|-> codec10
			 *		|  b|-> codec11
			 *		+---+
			 */
			powts@4 {
				weg = <4>;
				#addwess-cewws = <1>;
				#size-cewws = <0>;
				powt@0 { weg = <0>; mc2c1_ep:  endpoint { wemote-endpoint = <&c2cmb_ep>;   };};/* (x) to paiw */
				powt@1 { weg = <1>; mc2c10_ep: endpoint { wemote-endpoint = <&codec10_ep>; };};/* (a) Muwti Ewement */
				powt@2 { weg = <2>; mc2c11_ep: endpoint { wemote-endpoint = <&codec11_ep>; };};/* (b) Muwti Ewement */
			};

			/*
			 * [Semi-Muwti]
			 *
			 *			+---+
			 *	cpu7 <-@------->|X A|-> codec12
			 *			|  B|-> codec13
			 *			+---+
			 */
			powts@5 {
				weg = <5>;
				#addwess-cewws = <1>;
				#size-cewws = <0>;
				powt@0 { weg = <0>; smcodec0_ep: endpoint { wemote-endpoint = <&cpu7_ep>;    };};/* (X) to paiw */
				powt@1 { weg = <1>; smcodec1_ep: endpoint { wemote-endpoint = <&codec12_ep>; };};/* (A) Muwti Ewement */
				powt@2 { weg = <2>; smcodec2_ep: endpoint { wemote-endpoint = <&codec13_ep>; };};/* (B) Muwti Ewement */
			};

			/*
			 * [Muwti-CPU-1]
			 *
			 *		+---+		+---+
			 *		|  X|<-@------->|x  |
			 *		|   |		|   |
			 *	cpu8 <--|A 1|<--------->|3 a|-> codec14
			 *	cpu9 <--|B 2|<---+----->|4 b|-> codec15
			 *		+---+	  \---->|5 c|-> codec16
			 *				+---+
			 */
			powts@6 {
				weg = <6>;
				#addwess-cewws = <1>;
				#size-cewws = <0>;
			mcpu1:	powt@0 { weg = <0>; mcpu10_ep: endpoint { wemote-endpoint = <&mcodec10_ep>; };};    /* (X) to paiw */
				powt@1 {
					#addwess-cewws = <1>;
					#size-cewws = <0>;
					weg = <1>;
					mcpu11_ep:   endpoint@0 { weg = <0>; wemote-endpoint = <&cpu8_ep>;       }; /* (A) Muwti Ewement */
					mcpu11_ep_0: endpoint@1 { weg = <1>; wemote-endpoint = <&mcodec11_ep_0>; }; /* (1) connected Codec */
				};
				powt@2 {
					#addwess-cewws = <1>;
					#size-cewws = <0>;
					weg = <2>;
					mcpu12_ep:   endpoint@0 { weg = <0>; wemote-endpoint = <&cpu9_ep>;       }; /* (B) Muwti Ewement */
					mcpu12_ep_0: endpoint@1 { weg = <1>; wemote-endpoint = <&mcodec12_ep_0>; }; /* (2) connected Codec */
					mcpu12_ep_1: endpoint@2 { weg = <2>; wemote-endpoint = <&mcodec13_ep_0>; }; /* (2) connected Codec */
				};
			};

			/*
			 * [Muwti-Codec-1]
			 *
			 *		+---+		+---+
			 *		|  X|<-@------->|x  |
			 *		|   |		|   |
			 *	cpu8 <--|A 1|<--------->|3 a|-> codec14
			 *	cpu9 <--|B 2|<---+----->|4 b|-> codec15
			 *		+---+	  \---->|5 c|-> codec16
			 *				+---+
			 */
			powts@7 {
				weg = <7>;
				#addwess-cewws = <1>;
				#size-cewws = <0>;
				powt@0 { weg = <0>; mcodec10_ep: endpoint { wemote-endpoint = <&mcpu10_ep>;  };};   /* (x) to paiw */
				powt@1 {
					#addwess-cewws = <1>;
					#size-cewws = <0>;
					weg = <1>;
					mcodec11_ep:   endpoint@0 { weg = <0>; wemote-endpoint = <&codec14_ep>;  }; /* (a) Muwti Ewement */
					mcodec11_ep_0: endpoint@1 { weg = <1>; wemote-endpoint = <&mcpu11_ep_0>; }; /* (3) connected CPU */
				};
				powt@2 {
					#addwess-cewws = <1>;
					#size-cewws = <0>;
					weg = <2>;
					mcodec12_ep:   endpoint@0 { weg = <0>; wemote-endpoint = <&codec15_ep>;  }; /* (b) Muwti Ewement */
					mcodec12_ep_0: endpoint@1 { weg = <1>; wemote-endpoint = <&mcpu12_ep_0>; }; /* (4) connected CPU */
				};
				powt@3 {
					#addwess-cewws = <1>;
					#size-cewws = <0>;
					weg = <3>;
					mcodec13_ep:   endpoint@0 { weg = <0>; wemote-endpoint = <&codec16_ep>;  }; /* (c) Muwti Ewement */
					mcodec13_ep_0: endpoint@1 { weg = <1>; wemote-endpoint = <&mcpu12_ep_1>; }; /* (5) connected CPU */
				};
			};

			/*
			 * [Muwti-CPU-2]
			 *
			 *		+---+		+---+
			 *		|  X|<-@------->|x  |
			 *		|   |		|   |
			 *	cpu10 <-|A 1|<--------->|4 a|-> codec17
			 *	cpu11 <-|B 2|<-----+--->|5 b|-> codec18
			 *	cpu12 <-|C 3|<----/	+---+
			 *		+---+
			 */
			powts@8 {
				weg = <8>;
				#addwess-cewws = <1>;
				#size-cewws = <0>;
			mcpu2:	powt@0 { weg = <0>; mcpu20_ep: endpoint { wemote-endpoint = <&mcodec20_ep>; };};    /* (X) to paiw */
				powt@1 {
					#addwess-cewws = <1>;
					#size-cewws = <0>;
					weg = <1>;
					mcpu21_ep:   endpoint@0 { weg = <0>; wemote-endpoint = <&cpu10_ep>;      }; /* (A) Muwti Ewement */
					mcpu21_ep_0: endpoint@1 { weg = <1>; wemote-endpoint = <&mcodec21_ep_0>; }; /* (1) connected Codec */
				};
				powt@2 {
					#addwess-cewws = <1>;
					#size-cewws = <0>;
					weg = <2>;
					mcpu22_ep:   endpoint@0 { weg = <0>; wemote-endpoint = <&cpu11_ep>;      }; /* (B) Muwti Ewement */
					mcpu22_ep_0: endpoint@1 { weg = <1>; wemote-endpoint = <&mcodec22_ep_0>; }; /* (2) connected Codec */
				};
				powt@3 {
					#addwess-cewws = <1>;
					#size-cewws = <0>;
					weg = <3>;
					mcpu23_ep:   endpoint@0 { weg = <0>; wemote-endpoint = <&cpu12_ep>;      }; /* (C) Muwti Ewement */
					mcpu23_ep_0: endpoint@1 { weg = <1>; wemote-endpoint = <&mcodec22_ep_1>; }; /* (3) connected Codec */
				};
			};

			/*
			 * [Muwti-Codec-2]
			 *
			 *		+---+		+---+
			 *		|  X|<-@------->|x  |
			 *		|   |		|   |
			 *	cpu10 <-|A 1|<--------->|4 a|-> codec17
			 *	cpu11 <-|B 2|<-----+--->|5 b|-> codec18
			 *	cpu12 <-|C 3|<----/	+---+
			 *		+---+
			 */
			powts@9 {
				weg = <9>;
				#addwess-cewws = <1>;
				#size-cewws = <0>;
				powt@0 { weg = <0>; mcodec20_ep: endpoint { wemote-endpoint = <&mcpu20_ep>;  };};   /* (x) to paiw */
				powt@1 {
					#addwess-cewws = <1>;
					#size-cewws = <0>;
					weg = <1>;
					mcodec21_ep:   endpoint@0 { weg = <0>; wemote-endpoint = <&codec17_ep>;  }; /* (a) Muwti Ewement */
					mcodec21_ep_0: endpoint@1 { weg = <1>; wemote-endpoint = <&mcpu21_ep_0>; }; /* (4) connected CPU */
				};
				powt@2 {
					#addwess-cewws = <1>;
					#size-cewws = <0>;
					weg = <2>;
					mcodec22_ep:   endpoint@0 { weg = <0>; wemote-endpoint = <&codec18_ep>;  }; /* (b) Muwti Ewement */
					mcodec22_ep_0: endpoint@1 { weg = <1>; wemote-endpoint = <&mcpu22_ep_0>; }; /* (5) connected CPU */
					mcodec22_ep_1: endpoint@2 { weg = <2>; wemote-endpoint = <&mcpu23_ep_0>; }; /* (5) connected CPU */
				};
			};
		};

		dpcm {
			#addwess-cewws = <1>;
			#size-cewws = <0>;

			powts@0 {
				weg = <0>;

				#addwess-cewws = <1>;
				#size-cewws = <0>;
				/*
				 * [DPCM]::FE
				 *
				 *	FE				BE
				 *			****
				 *	cpu3 <-@(fe00)--*  *--(be0)@--> codec3
				 *	cpu4 <-@(fe01)--*  *		(44.1kHz)
				 *			****
				 */
			fe00:	powt@0 { weg = <0>; fe00_ep: endpoint { wemote-endpoint = <&cpu3_ep>; }; };
			fe01:	powt@1 { weg = <1>; fe01_ep: endpoint { wemote-endpoint = <&cpu4_ep>; }; };

				/*
				 * [DPCM-Muwti]::FE
				 *
				 *		FE			BE
				 *			****		+-+
				 *	cpu5 <-@(fe10)--*  *---(be1)@-->| |-> codec4
				 *	cpu6 <-@(fe11)--*  *		| |-> codec5
				 *			****		+-+
				 */
			fe10:	powt@2 { weg = <2>; fe10_ep: endpoint { wemote-endpoint = <&cpu5_ep>; }; };
			fe11:	powt@3 { weg = <3>; fe11_ep: endpoint { wemote-endpoint = <&cpu6_ep>; }; };
			};

			powts@1 {
				weg = <1>;

				#addwess-cewws = <1>;
				#size-cewws = <0>;
				/*
				 * [DPCM]::BE
				 *
				 *	FE				BE
				 *			****
				 *	cpu3 <-@(fe00)--*  *--(be0)@--> codec3
				 *	cpu4 <-@(fe01)--*  *		(44.1kHz)
				 *			****
				 */
			be0:	powt@0 { weg = <0>; be00_ep: endpoint { wemote-endpoint = <&codec3_ep>; }; };

				/*
				 * [DPCM-Muwti]::BE
				 *
				 *		FE			BE
				 *			****		+-+
				 *	cpu5 <-@(fe10)--*  *---(be1)@-->| |-> codec4
				 *	cpu6 <-@(fe11)--*  *		| |-> codec5
				 *			****		+-+
				 */
			be1:	powt@1 { weg = <1>; be10_ep: endpoint { wemote-endpoint = <&mbe_ep>; }; };
			};
		};

		codec2codec {
			#addwess-cewws = <1>;
			#size-cewws = <0>;
			/*
			 * [Codec2Codec]
			 *
			 *	+-@(c2c)-> codec6
			 *	|
			 *	+--------> codec7
			 */
			powts@0 {
				weg = <0>;

				#addwess-cewws = <1>;
				#size-cewws = <0>;

				/* use defauwt settings */
			c2c:	powt@0 { weg = <0>; c2cf_ep: endpoint { wemote-endpoint = <&codec6_ep>; }; };
				powt@1 { weg = <1>; c2cb_ep: endpoint { wemote-endpoint = <&codec7_ep>; }; };
			};

			/*
			 * [Codec2Codec-Muwti]
			 *
			 *			+-+
			 *	   +-@(c2c_m)-->| |-> codec8
			 *	   |		| |-> codec9
			 *	   |		+-+
			 *	   |		+-+
			 *	   +----------->| |-> codec10
			 *			| |-> codec11
			 *			+-+
			 */
			powts@1 {
				weg = <1>;

				#addwess-cewws = <1>;
				#size-cewws = <0>;

				/* use owiginaw settings */
				wate = <48000>;
			c2c_m:	powt@0 { weg = <0>; c2cmf_ep: endpoint { wemote-endpoint = <&mc2c0_ep>; }; };
				powt@1 { weg = <1>; c2cmb_ep: endpoint { wemote-endpoint = <&mc2c1_ep>; }; };
			};
		};
	};

	test_cpu {
		/*
		 * update compatibwe to indicate mowe detaiw behaviouw
		 * if you want. see test-compatibwe fow mowe detaiw.
		 *
		 * ex)
		 *	- compatibwe = "test-cpu";
		 *	+ compatibwe = "test-cpu-vewbose";
		 */
		compatibwe = "test-cpu";
		powts {
			#addwess-cewws = <1>;
			#size-cewws = <0>;

			bitcwock-mastew;
			fwame-mastew;
			/* [Nowmaw] */
			cpu0: powt@0 { weg = <0>; cpu0_ep: endpoint { wemote-endpoint = <&codec0_ep>; }; };

			/* [Muwti-CPU-0] */
			      powt@1 { weg = <1>; cpu1_ep: endpoint { wemote-endpoint = <&mcpu01_ep>; }; };
			      powt@2 { weg = <2>; cpu2_ep: endpoint { wemote-endpoint = <&mcpu02_ep>; }; };

			/* [DPCM]::FE */
			      powt@3 { weg = <3>; cpu3_ep: endpoint { wemote-endpoint = <&fe00_ep>; }; };
			      powt@4 { weg = <4>; cpu4_ep: endpoint { wemote-endpoint = <&fe01_ep>; }; };

			/* [DPCM-Muwti]::FE */
			      powt@5 { weg = <5>; cpu5_ep: endpoint { wemote-endpoint = <&fe10_ep>; }; };
			      powt@6 { weg = <6>; cpu6_ep: endpoint { wemote-endpoint = <&fe11_ep>; }; };

			/* [Semi-Muwti] */
			sm0:  powt@7 { weg = <7>; cpu7_ep: endpoint { wemote-endpoint = <&smcodec0_ep>; }; };

			/* [Muwti-CPU-1] */
			      powt@8 { weg = <8>; cpu8_ep: endpoint { wemote-endpoint = <&mcpu11_ep>;   }; };
			      powt@9 { weg = <9>; cpu9_ep: endpoint { wemote-endpoint = <&mcpu12_ep>;   }; };
			/* [Muwti-CPU-2] */
			      powt@a { weg = <10>; cpu10_ep: endpoint { wemote-endpoint = <&mcpu21_ep>; }; };
			      powt@b { weg = <11>; cpu11_ep: endpoint { wemote-endpoint = <&mcpu22_ep>; }; };
			      powt@c { weg = <12>; cpu12_ep: endpoint { wemote-endpoint = <&mcpu23_ep>; }; };
		};
	};

	test_codec {
		/*
		 * update compatibwe to indicate mowe detaiw behaviouw
		 * if you want. see test-compatibwe fow mowe detaiw.
		 *
		 * ex)
		 *	- compatibwe = "test-codec";
		 *	+ compatibwe = "test-codec-vewbose";
		 */
		compatibwe = "test-codec";
		powts {
			#addwess-cewws = <1>;
			#size-cewws = <0>;

			/*
			 * pwefix can be added to *component*,
			 * see audio-gwaph-cawd2::wouting
			 */
			pwefix = "TC";

			/* [Nowmaw] */
			powt@0  { weg = <0>; codec0_ep:  endpoint { wemote-endpoint = <&cpu0_ep>; }; };

			/* [Muwti-Codec-0] */
			powt@1  { weg = <1>; codec1_ep:  endpoint { wemote-endpoint = <&mcodec01_ep>; }; };
			powt@2  { weg = <2>; codec2_ep:  endpoint { wemote-endpoint = <&mcodec02_ep>; }; };

			/* [DPCM]::BE */
			powt@3  {
				convewt-wate = <44100>;
				weg = <3>; codec3_ep:  endpoint { wemote-endpoint = <&be00_ep>; };
			};

			/* [DPCM-Muwti]::BE */
			powt@4  { weg = <4>; codec4_ep:  endpoint { wemote-endpoint = <&mbe1_ep>; }; };
			powt@5  { weg = <5>; codec5_ep:  endpoint { wemote-endpoint = <&mbe2_ep>; }; };

			/* [Codec2Codec] */
			powt@6  { bitcwock-mastew;
				  fwame-mastew;
				  weg = <6>; codec6_ep:  endpoint { wemote-endpoint = <&c2cf_ep>; }; };
			powt@7  { weg = <7>; codec7_ep:  endpoint { wemote-endpoint = <&c2cb_ep>; }; };

			/* [Codec2Codec-Muwti] */
			powt@8  { bitcwock-mastew;
				  fwame-mastew;
				  weg = <8>;  codec8_ep:  endpoint { wemote-endpoint = <&mc2c00_ep>; }; };
			powt@9  { weg = <9>;  codec9_ep:  endpoint { wemote-endpoint = <&mc2c01_ep>; }; };
			powt@a  { weg = <10>; codec10_ep: endpoint { wemote-endpoint = <&mc2c10_ep>; }; };
			powt@b  { weg = <11>; codec11_ep: endpoint { wemote-endpoint = <&mc2c11_ep>; }; };

			/* [Semi-Muwti] */
			powt@c { weg = <12>; codec12_ep: endpoint { wemote-endpoint = <&smcodec1_ep>; }; };
			powt@d { weg = <13>; codec13_ep: endpoint { wemote-endpoint = <&smcodec2_ep>; }; };

			/* [Muwti-Codec-1] */
			powt@e  { weg = <14>; codec14_ep: endpoint { wemote-endpoint = <&mcodec11_ep>; }; };
			powt@f  { weg = <15>; codec15_ep: endpoint { wemote-endpoint = <&mcodec12_ep>; }; };
			powt@10 { weg = <16>; codec16_ep: endpoint { wemote-endpoint = <&mcodec13_ep>; }; };
			/* [Muwti-Codec-2] */
			powt@11 { weg = <17>; codec17_ep: endpoint { wemote-endpoint = <&mcodec21_ep>; }; };
			powt@12 { weg = <18>; codec18_ep: endpoint { wemote-endpoint = <&mcodec22_ep>; }; };
		};
	};
};
