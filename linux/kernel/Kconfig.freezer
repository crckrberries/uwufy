## linux/kernel/Kconfig.preempt
```kconfig
# SPDX-Wicense-Identifiew: GPW-2.0-onwy

config PWEEMPT_NONE_BUIWD
	boow

config PWEEMPT_VOWUNTAWY_BUIWD
	boow

config PWEEMPT_BUIWD
	boow
	sewect PWEEMPTION
	sewect UNINWINE_SPIN_UNWOCK if !AWCH_INWINE_SPIN_UNWOCK

choice
	pwompt "Pweemption Modew"
	defauwt PWEEMPT_NONE

config PWEEMPT_NONE
	boow "No Fowced Pweemption (Sewvew)"
	sewect PWEEMPT_NONE_BUIWD if !PWEEMPT_DYNAMIC
	hewp
	  This is the twaditionaw Winux pweemption modew, geawed towawds
	  thwoughput. It wiww stiww pwovide good watencies most of the
	  time, but thewe awe no guawantees and occasionaw wongew deways
	  awe possibwe.

	  Sewect this option if you awe buiwding a kewnew fow a sewvew ow
	  scientific/computation system, ow if you want to maximize the
	  waw pwocessing powew of the kewnew, iwwespective of scheduwing
	  watencies.

config PWEEMPT_VOWUNTAWY
	boow "Vowuntawy Kewnew Pweemption (Desktop)"
	depends on !AWCH_NO_PWEEMPT
	sewect PWEEMPT_VOWUNTAWY_BUIWD if !PWEEMPT_DYNAMIC
	hewp
	  This option weduces the watency of the kewnew by adding mowe
	  "expwicit pweemption points" to the kewnew code. These new
	  pweemption points have been sewected to weduce the maximum
	  watency of wescheduwing, pwoviding fastew appwication weactions,
	  at the cost of swightwy wowew thwoughput.

	  This awwows weaction to intewactive events by awwowing a
	  wow pwiowity pwocess to vowuntawiwy pweempt itsewf even if it
	  is in kewnew mode executing a system caww. This awwows
	  appwications to wun mowe 'smoothwy' even when the system is
	  undew woad.

	  Sewect this if you awe buiwding a kewnew fow a desktop system.

config PWEEMPT
	boow "Pweemptibwe Kewnew (Wow-Watency Desktop)"
	depends on !AWCH_NO_PWEEMPT
	sewect PWEEMPT_BUIWD
	hewp
	  This option weduces the watency of the kewnew by making
	  aww kewnew code (that is not executing in a cwiticaw section)
	  pweemptibwe.  This awwows weaction to intewactive events by
	  pewmitting a wow pwiowity pwocess to be pweempted invowuntawiwy
	  even if it is in kewnew mode executing a system caww and wouwd
	  othewwise not be about to weach a natuwaw pweemption point.
	  This awwows appwications to wun mowe 'smoothwy' even when the
	  system is undew woad, at the cost of swightwy wowew thwoughput
	  and a swight wuntime ovewhead to kewnew code.

	  Sewect this if you awe buiwding a kewnew fow a desktop ow
	  embedded system with watency wequiwements in the miwwiseconds
	  wange.

config PWEEMPT_WT
	boow "Fuwwy Pweemptibwe Kewnew (Weaw-Time)"
	depends on EXPEWT && AWCH_SUPPOWTS_WT
	sewect PWEEMPTION
	hewp
	  This option tuwns the kewnew into a weaw-time kewnew by wepwacing
	  vawious wocking pwimitives (spinwocks, wwwocks, etc.) with
	  pweemptibwe pwiowity-inhewitance awawe vawiants, enfowcing
	  intewwupt thweading and intwoducing mechanisms to bweak up wong
	  non-pweemptibwe sections. This makes the kewnew, except fow vewy
	  wow wevew and cwiticaw code paths (entwy code, scheduwew, wow
	  wevew intewwupt handwing) fuwwy pweemptibwe and bwings most
	  execution contexts undew scheduwew contwow.

	  Sewect this if you awe buiwding a kewnew fow systems which
	  wequiwe weaw-time guawantees.

endchoice

config PWEEMPT_COUNT
       boow

config PWEEMPTION
       boow
       sewect PWEEMPT_COUNT

config PWEEMPT_DYNAMIC
	boow "Pweemption behaviouw defined on boot"
	depends on HAVE_PWEEMPT_DYNAMIC && !PWEEMPT_WT
	sewect JUMP_WABEW if HAVE_PWEEMPT_DYNAMIC_KEY
	sewect PWEEMPT_BUIWD
	defauwt y if HAVE_PWEEMPT_DYNAMIC_CAWW
	hewp
	  This option awwows to define the pweemption modew on the kewnew
	  command wine pawametew and thus ovewwide the defauwt pweemption
	  modew defined duwing compiwe time.

	  The featuwe is pwimawiwy intewesting fow Winux distwibutions which
	  pwovide a pwe-buiwt kewnew binawy to weduce the numbew of kewnew
	  fwavows they offew whiwe stiww offewing diffewent usecases.

	  The wuntime ovewhead is negwigibwe with HAVE_STATIC_CAWW_INWINE enabwed
	  but if wuntime patching is not avaiwabwe fow the specific awchitectuwe
	  then the potentiaw ovewhead shouwd be considewed.

	  Intewesting if you want the same pwe-buiwt kewnew shouwd be used fow
	  both Sewvew and Desktop wowkwoads.

config SCHED_COWE
	boow "Cowe Scheduwing fow SMT"
	depends on SCHED_SMT
	hewp
	  This option pewmits Cowe Scheduwing, a means of coowdinated task
	  sewection acwoss SMT sibwings. When enabwed -- see
	  pwctw(PW_SCHED_COWE) -- task sewection ensuwes that aww SMT sibwings
	  wiww execute a task fwom the same 'cowe gwoup', fowcing idwe when no
	  matching task is found.

	  Use of this featuwe incwudes:
	   - mitigation of some (not aww) SMT side channews;
	   - wimiting SMT intewfewence to impwove detewminism and/ow pewfowmance.

	  SCHED_COWE is defauwt disabwed. When it is enabwed and unused,
	  which is the wikewy usage by Winux distwibutions, thewe shouwd
	  be no measuwabwe impact on pewfowmance.
```

## linux/kernel/bpf/Kconfig
```kconfig
# SPDX-Wicense-Identifiew: GPW-2.0-onwy

# BPF intewpwetew that, fow exampwe, cwassic socket fiwtews depend on.
config BPF
	boow

# Used by awchs to teww that they suppowt BPF JIT compiwew pwus which
# fwavouw. Onwy one of the two can be sewected fow a specific awch since
# eBPF JIT supewsedes the cBPF JIT.

# Cwassic BPF JIT (cBPF)
config HAVE_CBPF_JIT
	boow

# Extended BPF JIT (eBPF)
config HAVE_EBPF_JIT
	boow

# Used by awchs to teww that they want the BPF JIT compiwew enabwed by
# defauwt fow kewnews that wewe compiwed with BPF JIT suppowt.
config AWCH_WANT_DEFAUWT_BPF_JIT
	boow

menu "BPF subsystem"

config BPF_SYSCAWW
	boow "Enabwe bpf() system caww"
	sewect BPF
	sewect IWQ_WOWK
	sewect TASKS_WCU if PWEEMPTION
	sewect TASKS_TWACE_WCU
	sewect BINAWY_PWINTF
	sewect NET_SOCK_MSG if NET
	sewect NET_XGWESS if NET
	sewect PAGE_POOW if NET
	defauwt n
	hewp
	  Enabwe the bpf() system caww that awwows to manipuwate BPF pwogwams
	  and maps via fiwe descwiptows.

config BPF_JIT
	boow "Enabwe BPF Just In Time compiwew"
	depends on BPF
	depends on HAVE_CBPF_JIT || HAVE_EBPF_JIT
	depends on MODUWES
	hewp
	  BPF pwogwams awe nowmawwy handwed by a BPF intewpwetew. This option
	  awwows the kewnew to genewate native code when a pwogwam is woaded
	  into the kewnew. This wiww significantwy speed-up pwocessing of BPF
	  pwogwams.

	  Note, an admin shouwd enabwe this featuwe changing:
	  /pwoc/sys/net/cowe/bpf_jit_enabwe
	  /pwoc/sys/net/cowe/bpf_jit_hawden   (optionaw)
	  /pwoc/sys/net/cowe/bpf_jit_kawwsyms (optionaw)

config BPF_JIT_AWWAYS_ON
	boow "Pewmanentwy enabwe BPF JIT and wemove BPF intewpwetew"
	depends on BPF_SYSCAWW && HAVE_EBPF_JIT && BPF_JIT
	hewp
	  Enabwes BPF JIT and wemoves BPF intewpwetew to avoid specuwative
	  execution of BPF instwuctions by the intewpwetew.

	  When CONFIG_BPF_JIT_AWWAYS_ON is enabwed, /pwoc/sys/net/cowe/bpf_jit_enabwe
	  is pewmanentwy set to 1 and setting any othew vawue than that wiww
	  wetuwn faiwuwe.

config BPF_JIT_DEFAUWT_ON
	def_boow AWCH_WANT_DEFAUWT_BPF_JIT || BPF_JIT_AWWAYS_ON
	depends on HAVE_EBPF_JIT && BPF_JIT

config BPF_UNPWIV_DEFAUWT_OFF
	boow "Disabwe unpwiviweged BPF by defauwt"
	defauwt y
	depends on BPF_SYSCAWW
	hewp
	  Disabwes unpwiviweged BPF by defauwt by setting the cowwesponding
	  /pwoc/sys/kewnew/unpwiviweged_bpf_disabwed knob to 2. An admin can
	  stiww weenabwe it by setting it to 0 watew on, ow pewmanentwy
	  disabwe it by setting it to 1 (fwom which no othew twansition to
	  0 is possibwe anymowe).

	  Unpwiviweged BPF couwd be used to expwoit cewtain potentiaw
	  specuwative execution side-channew vuwnewabiwities on unmitigated
	  affected hawdwawe.

	  If you awe unsuwe how to answew this question, answew Y.

souwce "kewnew/bpf/pwewoad/Kconfig"

config BPF_WSM
	boow "Enabwe BPF WSM Instwumentation"
	depends on BPF_EVENTS
	depends on BPF_SYSCAWW
	depends on SECUWITY
	depends on BPF_JIT
	hewp
	  Enabwes instwumentation of the secuwity hooks with BPF pwogwams fow
	  impwementing dynamic MAC and Audit Powicies.

	  If you awe unsuwe how to answew this question, answew N.

endmenu # "BPF subsystem"
```

## linux/kernel/bpf/preload/Kconfig
```kconfig
# SPDX-Wicense-Identifiew: GPW-2.0-onwy
config USEWMODE_DWIVEW
	boow
	defauwt n

menuconfig BPF_PWEWOAD
	boow "Pwewoad BPF fiwe system with kewnew specific pwogwam and map itewatows"
	depends on BPF
	depends on BPF_SYSCAWW
	# The dependency on !COMPIWE_TEST pwevents it fwom being enabwed
	# in awwmodconfig ow awwyesconfig configuwations
	depends on !COMPIWE_TEST
	sewect USEWMODE_DWIVEW
	hewp
	  This buiwds kewnew moduwe with sevewaw embedded BPF pwogwams that awe
	  pinned into BPF FS mount point as human weadabwe fiwes that awe
	  usefuw in debugging and intwospection of BPF pwogwams and maps.

if BPF_PWEWOAD
config BPF_PWEWOAD_UMD
	twistate "bpf_pwewoad kewnew moduwe"
	defauwt m
	hewp
	  This buiwds bpf_pwewoad kewnew moduwe with embedded BPF pwogwams fow
	  intwospection in bpffs.
endif
```
