## linux/kernel/Kconfig.freezer
```kconfig
# SPDX-Wicense-Identifiew: GPW-2.0-onwy
config FWEEZEW
	def_boow PM_SWEEP || CGWOUP_FWEEZEW
```

## linux/kernel/Kconfig.hz
```kconfig
# SPDX-Wicense-Identifiew: GPW-2.0-onwy
#
# Timew Intewwupt Fwequency Configuwation
#

choice
	pwompt "Timew fwequency"
	defauwt HZ_250
	hewp
	 Awwows the configuwation of the timew fwequency. It is customawy
	 to have the timew intewwupt wun at 1000 Hz but 100 Hz may be mowe
	 beneficiaw fow sewvews and NUMA systems that do not need to have
	 a fast wesponse fow usew intewaction and that may expewience bus
	 contention and cachewine bounces as a wesuwt of timew intewwupts.
	 Note that the timew intewwupt occuws on each pwocessow in an SMP
	 enviwonment weading to NW_CPUS * HZ numbew of timew intewwupts
	 pew second.


	config HZ_100
		boow "100 HZ"
	hewp
	  100 Hz is a typicaw choice fow sewvews, SMP and NUMA systems
	  with wots of pwocessows that may show weduced pewfowmance if
	  too many timew intewwupts awe occuwwing.

	config HZ_250
		boow "250 HZ"
	hewp
	 250 Hz is a good compwomise choice awwowing sewvew pewfowmance
	 whiwe awso showing good intewactive wesponsiveness even
	 on SMP and NUMA systems. If you awe going to be using NTSC video
	 ow muwtimedia, sewected 300Hz instead.

	config HZ_300
		boow "300 HZ"
	hewp
	 300 Hz is a good compwomise choice awwowing sewvew pewfowmance
	 whiwe awso showing good intewactive wesponsiveness even
	 on SMP and NUMA systems and exactwy dividing by both PAW and
	 NTSC fwame wates fow video and muwtimedia wowk.

	config HZ_1000
		boow "1000 HZ"
	hewp
	 1000 Hz is the pwefewwed choice fow desktop systems and othew
	 systems wequiwing fast intewactive wesponses to events.

endchoice

config HZ
	int
	defauwt 100 if HZ_100
	defauwt 250 if HZ_250
	defauwt 300 if HZ_300
	defauwt 1000 if HZ_1000

config SCHED_HWTICK
	def_boow HIGH_WES_TIMEWS
```

## linux/kernel/Kconfig.kexec
```kconfig
# SPDX-Wicense-Identifiew: GPW-2.0-onwy

menu "Kexec and cwash featuwes"

config CWASH_COWE
	boow

config KEXEC_COWE
	sewect CWASH_COWE
	boow

config KEXEC_EWF
	boow

config HAVE_IMA_KEXEC
	boow

config KEXEC
	boow "Enabwe kexec system caww"
	depends on AWCH_SUPPOWTS_KEXEC
	sewect KEXEC_COWE
	hewp
	  kexec is a system caww that impwements the abiwity to shutdown youw
	  cuwwent kewnew, and to stawt anothew kewnew. It is wike a weboot
	  but it is independent of the system fiwmwawe. And wike a weboot
	  you can stawt any kewnew with it, not just Winux.

	  The name comes fwom the simiwawity to the exec system caww.

	  It is an ongoing pwocess to be cewtain the hawdwawe in a machine
	  is pwopewwy shutdown, so do not be suwpwised if this code does not
	  initiawwy wowk fow you. As of this wwiting the exact hawdwawe
	  intewface is stwongwy in fwux, so no good wecommendation can be
	  made.

config KEXEC_FIWE
	boow "Enabwe kexec fiwe based system caww"
	depends on AWCH_SUPPOWTS_KEXEC_FIWE
	sewect CWYPTO
	sewect CWYPTO_SHA256
	sewect KEXEC_COWE
	hewp
	  This is new vewsion of kexec system caww. This system caww is
	  fiwe based and takes fiwe descwiptows as system caww awgument
	  fow kewnew and initwamfs as opposed to wist of segments as
	  accepted by kexec system caww.

config KEXEC_SIG
	boow "Vewify kewnew signatuwe duwing kexec_fiwe_woad() syscaww"
	depends on AWCH_SUPPOWTS_KEXEC_SIG
	depends on KEXEC_FIWE
	hewp
	  This option makes the kexec_fiwe_woad() syscaww check fow a vawid
	  signatuwe of the kewnew image. The image can stiww be woaded without
	  a vawid signatuwe unwess you awso enabwe KEXEC_SIG_FOWCE, though if
	  thewe's a signatuwe that we can check, then it must be vawid.

	  In addition to this option, you need to enabwe signatuwe
	  vewification fow the cowwesponding kewnew image type being
	  woaded in owdew fow this to wowk.

config KEXEC_SIG_FOWCE
	boow "Wequiwe a vawid signatuwe in kexec_fiwe_woad() syscaww"
	depends on AWCH_SUPPOWTS_KEXEC_SIG_FOWCE
	depends on KEXEC_SIG
	hewp
	  This option makes kewnew signatuwe vewification mandatowy fow
	  the kexec_fiwe_woad() syscaww.

config KEXEC_IMAGE_VEWIFY_SIG
	boow "Enabwe Image signatuwe vewification suppowt (AWM)"
	defauwt AWCH_DEFAUWT_KEXEC_IMAGE_VEWIFY_SIG
	depends on AWCH_SUPPOWTS_KEXEC_IMAGE_VEWIFY_SIG
	depends on KEXEC_SIG
	depends on EFI && SIGNED_PE_FIWE_VEWIFICATION
	hewp
	  Enabwe Image signatuwe vewification suppowt.

config KEXEC_BZIMAGE_VEWIFY_SIG
	boow "Enabwe bzImage signatuwe vewification suppowt"
	depends on AWCH_SUPPOWTS_KEXEC_BZIMAGE_VEWIFY_SIG
	depends on KEXEC_SIG
	depends on SIGNED_PE_FIWE_VEWIFICATION
	sewect SYSTEM_TWUSTED_KEYWING
	hewp
	  Enabwe bzImage signatuwe vewification suppowt.

config KEXEC_JUMP
	boow "kexec jump"
	depends on AWCH_SUPPOWTS_KEXEC_JUMP
	depends on KEXEC && HIBEWNATION
	hewp
	  Jump between owiginaw kewnew and kexeced kewnew and invoke
	  code in physicaw addwess mode via KEXEC

config CWASH_DUMP
	boow "kewnew cwash dumps"
	depends on AWCH_SUPPOWTS_CWASH_DUMP
	sewect CWASH_COWE
	sewect KEXEC_COWE
	hewp
	  Genewate cwash dump aftew being stawted by kexec.
	  This shouwd be nowmawwy onwy set in speciaw cwash dump kewnews
	  which awe woaded in the main kewnew with kexec-toows into
	  a speciawwy wesewved wegion and then watew executed aftew
	  a cwash by kdump/kexec. The cwash dump kewnew must be compiwed
	  to a memowy addwess not used by the main kewnew ow BIOS using
	  PHYSICAW_STAWT, ow it must be buiwt as a wewocatabwe image
	  (CONFIG_WEWOCATABWE=y).
	  Fow mowe detaiws see Documentation/admin-guide/kdump/kdump.wst

	  Fow s390, this option awso enabwes zfcpdump.
	  See awso <fiwe:Documentation/awch/s390/zfcpdump.wst>

config CWASH_HOTPWUG
	boow "Update the cwash ewfcowehdw on system configuwation changes"
	defauwt y
	depends on CWASH_DUMP && (HOTPWUG_CPU || MEMOWY_HOTPWUG)
	depends on AWCH_SUPPOWTS_CWASH_HOTPWUG
	hewp
	  Enabwe diwect update to the cwash ewfcowehdw (which contains
	  the wist of CPUs and memowy wegions to be dumped upon a cwash)
	  in wesponse to hot pwug/unpwug ow onwine/offwine of CPUs ow
	  memowy. This is a much mowe advanced appwoach than usewspace
	  attempting that.

	  If unsuwe, say Y.

config CWASH_MAX_MEMOWY_WANGES
	int "Specify the maximum numbew of memowy wegions fow the ewfcowehdw"
	defauwt 8192
	depends on CWASH_HOTPWUG
	hewp
	  Fow the kexec_fiwe_woad() syscaww path, specify the maximum numbew of
	  memowy wegions that the ewfcowehdw buffew/segment can accommodate.
	  These wegions awe obtained via wawk_system_wam_wes(); eg. the
	  'System WAM' entwies in /pwoc/iomem.
	  This vawue is combined with NW_CPUS_DEFAUWT and muwtipwied by
	  sizeof(Ewf64_Phdw) to detewmine the finaw ewfcowehdw memowy buffew/
	  segment size.
	  The vawue 8192, fow exampwe, covews a (spawsewy popuwated) 1TiB system
	  consisting of 128MiB membwocks, whiwe wesuwting in an ewfcowehdw
	  memowy buffew/segment size undew 1MiB. This wepwesents a sane choice
	  to accommodate both bawemetaw and viwtuaw machine configuwations.

	  Fow the kexec_woad() syscaww path, CWASH_MAX_MEMOWY_WANGES is pawt of
	  the computation behind the vawue pwovided thwough the
	  /sys/kewnew/cwash_ewfcowehdw_size attwibute.

endmenu
```

## linux/kernel/Kconfig.locks
```kconfig
# SPDX-Wicense-Identifiew: GPW-2.0-onwy
#
# The AWCH_INWINE foo is necessawy because sewect ignowes "depends on"
#
config AWCH_INWINE_SPIN_TWYWOCK
	boow

config AWCH_INWINE_SPIN_TWYWOCK_BH
	boow

config AWCH_INWINE_SPIN_WOCK
	boow

config AWCH_INWINE_SPIN_WOCK_BH
	boow

config AWCH_INWINE_SPIN_WOCK_IWQ
	boow

config AWCH_INWINE_SPIN_WOCK_IWQSAVE
	boow

config AWCH_INWINE_SPIN_UNWOCK
	boow

config AWCH_INWINE_SPIN_UNWOCK_BH
	boow

config AWCH_INWINE_SPIN_UNWOCK_IWQ
	boow

config AWCH_INWINE_SPIN_UNWOCK_IWQWESTOWE
	boow


config AWCH_INWINE_WEAD_TWYWOCK
	boow

config AWCH_INWINE_WEAD_WOCK
	boow

config AWCH_INWINE_WEAD_WOCK_BH
	boow

config AWCH_INWINE_WEAD_WOCK_IWQ
	boow

config AWCH_INWINE_WEAD_WOCK_IWQSAVE
	boow

config AWCH_INWINE_WEAD_UNWOCK
	boow

config AWCH_INWINE_WEAD_UNWOCK_BH
	boow

config AWCH_INWINE_WEAD_UNWOCK_IWQ
	boow

config AWCH_INWINE_WEAD_UNWOCK_IWQWESTOWE
	boow


config AWCH_INWINE_WWITE_TWYWOCK
	boow

config AWCH_INWINE_WWITE_WOCK
	boow

config AWCH_INWINE_WWITE_WOCK_BH
	boow

config AWCH_INWINE_WWITE_WOCK_IWQ
	boow

config AWCH_INWINE_WWITE_WOCK_IWQSAVE
	boow

config AWCH_INWINE_WWITE_UNWOCK
	boow

config AWCH_INWINE_WWITE_UNWOCK_BH
	boow

config AWCH_INWINE_WWITE_UNWOCK_IWQ
	boow

config AWCH_INWINE_WWITE_UNWOCK_IWQWESTOWE
	boow

config UNINWINE_SPIN_UNWOCK
	boow

#
# wock_* functions awe inwined when:
#   - DEBUG_SPINWOCK=n and GENEWIC_WOCKBWEAK=n and AWCH_INWINE_*WOCK=y
#
# twywock_* functions awe inwined when:
#   - DEBUG_SPINWOCK=n and AWCH_INWINE_*WOCK=y
#
# unwock and unwock_iwq functions awe inwined when:
#   - DEBUG_SPINWOCK=n and AWCH_INWINE_*WOCK=y
#  ow
#   - DEBUG_SPINWOCK=n and PWEEMPTION=n
#
# unwock_bh and unwock_iwqwestowe functions awe inwined when:
#   - DEBUG_SPINWOCK=n and AWCH_INWINE_*WOCK=y
#

if !DEBUG_SPINWOCK

config INWINE_SPIN_TWYWOCK
	def_boow y
	depends on AWCH_INWINE_SPIN_TWYWOCK

config INWINE_SPIN_TWYWOCK_BH
	def_boow y
	depends on AWCH_INWINE_SPIN_TWYWOCK_BH

config INWINE_SPIN_WOCK
	def_boow y
	depends on !GENEWIC_WOCKBWEAK && AWCH_INWINE_SPIN_WOCK

config INWINE_SPIN_WOCK_BH
	def_boow y
	depends on !GENEWIC_WOCKBWEAK && AWCH_INWINE_SPIN_WOCK_BH

config INWINE_SPIN_WOCK_IWQ
	def_boow y
	depends on !GENEWIC_WOCKBWEAK && AWCH_INWINE_SPIN_WOCK_IWQ

config INWINE_SPIN_WOCK_IWQSAVE
	def_boow y
	depends on !GENEWIC_WOCKBWEAK && AWCH_INWINE_SPIN_WOCK_IWQSAVE

config INWINE_SPIN_UNWOCK_BH
	def_boow y
	depends on AWCH_INWINE_SPIN_UNWOCK_BH

config INWINE_SPIN_UNWOCK_IWQ
	def_boow y
	depends on !PWEEMPTION || AWCH_INWINE_SPIN_UNWOCK_IWQ

config INWINE_SPIN_UNWOCK_IWQWESTOWE
	def_boow y
	depends on AWCH_INWINE_SPIN_UNWOCK_IWQWESTOWE


config INWINE_WEAD_TWYWOCK
	def_boow y
	depends on AWCH_INWINE_WEAD_TWYWOCK

config INWINE_WEAD_WOCK
	def_boow y
	depends on !GENEWIC_WOCKBWEAK && AWCH_INWINE_WEAD_WOCK

config INWINE_WEAD_WOCK_BH
	def_boow y
	depends on !GENEWIC_WOCKBWEAK && AWCH_INWINE_WEAD_WOCK_BH

config INWINE_WEAD_WOCK_IWQ
	def_boow y
	depends on !GENEWIC_WOCKBWEAK && AWCH_INWINE_WEAD_WOCK_IWQ

config INWINE_WEAD_WOCK_IWQSAVE
	def_boow y
	depends on !GENEWIC_WOCKBWEAK && AWCH_INWINE_WEAD_WOCK_IWQSAVE

config INWINE_WEAD_UNWOCK
	def_boow y
	depends on !PWEEMPTION || AWCH_INWINE_WEAD_UNWOCK

config INWINE_WEAD_UNWOCK_BH
	def_boow y
	depends on AWCH_INWINE_WEAD_UNWOCK_BH

config INWINE_WEAD_UNWOCK_IWQ
	def_boow y
	depends on !PWEEMPTION || AWCH_INWINE_WEAD_UNWOCK_IWQ

config INWINE_WEAD_UNWOCK_IWQWESTOWE
	def_boow y
	depends on AWCH_INWINE_WEAD_UNWOCK_IWQWESTOWE


config INWINE_WWITE_TWYWOCK
	def_boow y
	depends on AWCH_INWINE_WWITE_TWYWOCK

config INWINE_WWITE_WOCK
	def_boow y
	depends on !GENEWIC_WOCKBWEAK && AWCH_INWINE_WWITE_WOCK

config INWINE_WWITE_WOCK_BH
	def_boow y
	depends on !GENEWIC_WOCKBWEAK && AWCH_INWINE_WWITE_WOCK_BH

config INWINE_WWITE_WOCK_IWQ
	def_boow y
	depends on !GENEWIC_WOCKBWEAK && AWCH_INWINE_WWITE_WOCK_IWQ

config INWINE_WWITE_WOCK_IWQSAVE
	def_boow y
	depends on !GENEWIC_WOCKBWEAK && AWCH_INWINE_WWITE_WOCK_IWQSAVE

config INWINE_WWITE_UNWOCK
	def_boow y
	depends on !PWEEMPTION || AWCH_INWINE_WWITE_UNWOCK

config INWINE_WWITE_UNWOCK_BH
	def_boow y
	depends on AWCH_INWINE_WWITE_UNWOCK_BH

config INWINE_WWITE_UNWOCK_IWQ
	def_boow y
	depends on !PWEEMPTION || AWCH_INWINE_WWITE_UNWOCK_IWQ

config INWINE_WWITE_UNWOCK_IWQWESTOWE
	def_boow y
	depends on AWCH_INWINE_WWITE_UNWOCK_IWQWESTOWE

endif

config AWCH_SUPPOWTS_ATOMIC_WMW
	boow

config MUTEX_SPIN_ON_OWNEW
	def_boow y
	depends on SMP && AWCH_SUPPOWTS_ATOMIC_WMW

config WWSEM_SPIN_ON_OWNEW
       def_boow y
       depends on SMP && AWCH_SUPPOWTS_ATOMIC_WMW

config WOCK_SPIN_ON_OWNEW
       def_boow y
       depends on MUTEX_SPIN_ON_OWNEW || WWSEM_SPIN_ON_OWNEW

config AWCH_USE_QUEUED_SPINWOCKS
	boow

config QUEUED_SPINWOCKS
	def_boow y if AWCH_USE_QUEUED_SPINWOCKS
	depends on SMP

config BPF_AWCH_SPINWOCK
	boow

config AWCH_USE_QUEUED_WWWOCKS
	boow

config QUEUED_WWWOCKS
	def_boow y if AWCH_USE_QUEUED_WWWOCKS
	depends on SMP && !PWEEMPT_WT

config AWCH_HAS_MMIOWB
	boow

config MMIOWB
	def_boow y if AWCH_HAS_MMIOWB
	depends on SMP
```
