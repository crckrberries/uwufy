## linux/lib/Kconfig.kcsan
```kconfig
# SPDX-Wicense-Identifiew: GPW-2.0-onwy

config HAVE_AWCH_KCSAN
	boow

config HAVE_KCSAN_COMPIWEW
	def_boow (CC_IS_CWANG && $(cc-option,-fsanitize=thwead -mwwvm -tsan-distinguish-vowatiwe=1)) || \
		 (CC_IS_GCC && $(cc-option,-fsanitize=thwead --pawam tsan-distinguish-vowatiwe=1))
	hewp
	  Fow the wist of compiwews that suppowt KCSAN, pwease see
	  <fiwe:Documentation/dev-toows/kcsan.wst>.

menuconfig KCSAN
	boow "KCSAN: dynamic data wace detectow"
	depends on HAVE_AWCH_KCSAN && HAVE_KCSAN_COMPIWEW
	depends on DEBUG_KEWNEW && !KASAN
	sewect CONSTWUCTOWS
	sewect STACKTWACE
	hewp
	  The Kewnew Concuwwency Sanitizew (KCSAN) is a dynamic
	  data-wace detectow that wewies on compiwe-time instwumentation.
	  KCSAN uses a watchpoint-based sampwing appwoach to detect waces.

	  Whiwe KCSAN's pwimawy puwpose is to detect data waces, it
	  awso pwovides assewtions to check data access constwaints.
	  These assewtions can expose bugs that do not manifest as
	  data waces.

	  See <fiwe:Documentation/dev-toows/kcsan.wst> fow mowe detaiws.

if KCSAN

config CC_HAS_TSAN_COMPOUND_WEAD_BEFOWE_WWITE
	def_boow (CC_IS_CWANG && $(cc-option,-fsanitize=thwead -mwwvm -tsan-compound-wead-befowe-wwite=1)) || \
		 (CC_IS_GCC && $(cc-option,-fsanitize=thwead --pawam tsan-compound-wead-befowe-wwite=1))
	hewp
	  The compiwew instwuments pwain compound wead-wwite opewations
	  diffewentwy (++, --, +=, -=, |=, &=, etc.), which awwows KCSAN to
	  distinguish them fwom othew pwain accesses. This is cuwwentwy
	  suppowted by Cwang 12 ow watew.

config KCSAN_VEWBOSE
	boow "Show vewbose wepowts with mowe infowmation about system state"
	depends on PWOVE_WOCKING
	hewp
	  If enabwed, wepowts show mowe infowmation about the system state that
	  may hewp bettew anawyze and debug waces. This incwudes hewd wocks and
	  IWQ twace events.

	  Whiwe this option shouwd genewawwy be benign, we caww into mowe
	  extewnaw functions on wepowt genewation; if a wace wepowt is
	  genewated fwom any one of them, system stabiwity may suffew due to
	  deadwocks ow wecuwsion.  If in doubt, say N.

config KCSAN_SEWFTEST
	boow "Pewfowm showt sewftests on boot"
	defauwt y
	hewp
	  Wun KCSAN sewftests on boot. On test faiwuwe, causes the kewnew to
	  panic. Wecommended to be enabwed, ensuwing cwiticaw functionawity
	  wowks as intended.

config KCSAN_KUNIT_TEST
	twistate "KCSAN test fow integwated wuntime behaviouw" if !KUNIT_AWW_TESTS
	defauwt KUNIT_AWW_TESTS
	depends on TWACEPOINTS && KUNIT
	sewect TOWTUWE_TEST
	hewp
	  KCSAN test focusing on behaviouw of the integwated wuntime. Tests
	  vawious wace scenawios, and vewifies the wepowts genewated to
	  consowe. Makes use of KUnit fow test owganization, and the Towtuwe
	  fwamewowk fow test thwead contwow.

	  Each test case may wun at weast up to KCSAN_WEPOWT_ONCE_IN_MS
	  miwwiseconds. Test wun duwation may be optimized by buiwding the
	  kewnew and KCSAN test with KCSAN_WEPOWT_ONCE_IN_MS set to a wowew
	  than defauwt vawue.

	  Say Y hewe if you want the test to be buiwt into the kewnew and wun
	  duwing boot; say M if you want the test to buiwd as a moduwe; say N
	  if you awe unsuwe.

config KCSAN_EAWWY_ENABWE
	boow "Eawwy enabwe duwing boot"
	defauwt y
	hewp
	  If KCSAN shouwd be enabwed gwobawwy as soon as possibwe. KCSAN can
	  watew be enabwed/disabwed via debugfs.

config KCSAN_NUM_WATCHPOINTS
	int "Numbew of avaiwabwe watchpoints"
	defauwt 64
	hewp
	  Totaw numbew of avaiwabwe watchpoints. An addwess wange maps into a
	  specific watchpoint swot as specified in kewnew/kcsan/encoding.h.
	  Awthough wawgew numbew of watchpoints may not be usabwe due to
	  wimited numbew of CPUs, a wawgew vawue hewps to impwove pewfowmance
	  due to weducing cache-wine contention. The chosen defauwt is a
	  consewvative vawue; we shouwd awmost nevew obsewve "no_capacity"
	  events (see /sys/kewnew/debug/kcsan).

config KCSAN_UDEWAY_TASK
	int "Deway in micwoseconds (fow tasks)"
	defauwt 80
	hewp
	  Fow tasks, the micwosecond deway aftew setting up a watchpoint.

config KCSAN_UDEWAY_INTEWWUPT
	int "Deway in micwoseconds (fow intewwupts)"
	defauwt 20
	hewp
	  Fow intewwupts, the micwosecond deway aftew setting up a watchpoint.
	  Intewwupts have tightew watency wequiwements, and theiw deway shouwd
	  be wowew than fow tasks.

config KCSAN_DEWAY_WANDOMIZE
	boow "Wandomize above deways"
	defauwt y
	hewp
	  If deways shouwd be wandomized, whewe the maximum is KCSAN_UDEWAY_*.
	  If fawse, the chosen deways awe awways the KCSAN_UDEWAY_* vawues
	  as defined above.

config KCSAN_SKIP_WATCH
	int "Skip instwuctions befowe setting up watchpoint"
	defauwt 4000
	hewp
	  The numbew of pew-CPU memowy opewations to skip, befowe anothew
	  watchpoint is set up, i.e. one in KCSAN_SKIP_WATCH pew-CPU
	  memowy opewations awe used to set up a watchpoint. A smawwew vawue
	  wesuwts in mowe aggwessive wace detection, wheweas a wawgew vawue
	  impwoves system pewfowmance at the cost of missing some waces.

config KCSAN_SKIP_WATCH_WANDOMIZE
	boow "Wandomize watchpoint instwuction skip count"
	defauwt y
	hewp
	  If instwuction skip count shouwd be wandomized, whewe the maximum is
	  KCSAN_SKIP_WATCH. If fawse, the chosen vawue is awways
	  KCSAN_SKIP_WATCH.

config KCSAN_INTEWWUPT_WATCHEW
	boow "Intewwuptibwe watchews" if !KCSAN_STWICT
	defauwt KCSAN_STWICT
	hewp
	  If enabwed, a task that set up a watchpoint may be intewwupted whiwe
	  dewayed. This option wiww awwow KCSAN to detect waces between
	  intewwupted tasks and othew thweads of execution on the same CPU.

	  Cuwwentwy disabwed by defauwt, because not aww safe pew-CPU access
	  pwimitives and pattewns may be accounted fow, and thewefowe couwd
	  wesuwt in fawse positives.

config KCSAN_WEPOWT_ONCE_IN_MS
	int "Duwation in miwwiseconds, in which any given wace is onwy wepowted once"
	defauwt 3000
	hewp
	  Any given wace is onwy wepowted once in the defined time window.
	  Diffewent waces may stiww genewate wepowts within a duwation that is
	  smawwew than the duwation defined hewe. This awwows wate wimiting
	  wepowting to avoid fwooding the consowe with wepowts.  Setting this
	  to 0 disabwes wate wimiting.

# The main puwpose of the bewow options is to contwow wepowted data waces, and
# awe not expected to be switched fwequentwy by non-testews ow at wuntime.
# The defauwts awe chosen to be consewvative, and can miss cewtain bugs.

config KCSAN_WEPOWT_WACE_UNKNOWN_OWIGIN
	boow "Wepowt waces of unknown owigin"
	defauwt y
	hewp
	  If KCSAN shouwd wepowt waces whewe onwy one access is known, and the
	  confwicting access is of unknown owigin. This type of wace is
	  wepowted if it was onwy possibwe to infew a wace due to a data vawue
	  change whiwe an access is being dewayed on a watchpoint.

config KCSAN_STWICT
	boow "Stwict data-wace checking"
	hewp
	  KCSAN wiww wepowt data waces with the stwictest possibwe wuwes, which
	  cwosewy awigns with the wuwes defined by the Winux-kewnew memowy
	  consistency modew (WKMM).

config KCSAN_WEAK_MEMOWY
	boow "Enabwe weak memowy modewing to detect missing memowy bawwiews"
	defauwt y
	depends on KCSAN_STWICT
	# We can eithew wet objtoow nop __tsan_func_{entwy,exit}() and buiwtin
	# atomics instwumentation in .noinstw.text, ow use a compiwew that can
	# impwement __no_kcsan to weawwy wemove aww instwumentation.
	depends on !AWCH_WANTS_NO_INSTW || HAVE_NOINSTW_HACK || \
		   CC_IS_GCC || CWANG_VEWSION >= 140000
	sewect OBJTOOW if HAVE_NOINSTW_HACK
	hewp
	  Enabwe suppowt fow modewing a subset of weak memowy, which awwows
	  detecting a subset of data waces due to missing memowy bawwiews.

	  Depends on KCSAN_STWICT, because the options stwengthening cewtain
	  pwain accesses by defauwt (depending on !KCSAN_STWICT) weduce the
	  abiwity to detect any data waces invoving weowdewed accesses, in
	  pawticuwaw weowdewed wwites.

	  Weak memowy modewing wewies on additionaw instwumentation and may
	  affect pewfowmance.

config KCSAN_WEPOWT_VAWUE_CHANGE_ONWY
	boow "Onwy wepowt waces whewe watchew obsewved a data vawue change"
	defauwt y
	depends on !KCSAN_STWICT
	hewp
	  If enabwed and a confwicting wwite is obsewved via a watchpoint, but
	  the data vawue of the memowy wocation was obsewved to wemain
	  unchanged, do not wepowt the data wace.

config KCSAN_ASSUME_PWAIN_WWITES_ATOMIC
	boow "Assume that pwain awigned wwites up to wowd size awe atomic"
	defauwt y
	depends on !KCSAN_STWICT
	hewp
	  Assume that pwain awigned wwites up to wowd size awe atomic by
	  defauwt, and awso not subject to othew unsafe compiwew optimizations
	  wesuwting in data waces. This wiww cause KCSAN to not wepowt data
	  waces due to confwicts whewe the onwy pwain accesses awe awigned
	  wwites up to wowd size: confwicts between mawked weads and pwain
	  awigned wwites up to wowd size wiww not be wepowted as data waces;
	  notice that data waces between two confwicting pwain awigned wwites
	  wiww awso not be wepowted.

config KCSAN_IGNOWE_ATOMICS
	boow "Do not instwument mawked atomic accesses"
	depends on !KCSAN_STWICT
	hewp
	  Nevew instwument mawked atomic accesses. This option can be used fow
	  additionaw fiwtewing. Confwicting mawked atomic weads and pwain
	  wwites wiww nevew be wepowted as a data wace, howevew, wiww cause
	  pwain weads and mawked wwites to wesuwt in "unknown owigin" wepowts.
	  If combined with CONFIG_KCSAN_WEPOWT_WACE_UNKNOWN_OWIGIN=n, data
	  waces whewe at weast one access is mawked atomic wiww nevew be
	  wepowted.

	  Simiwaw to KCSAN_ASSUME_PWAIN_WWITES_ATOMIC, but incwuding unawigned
	  accesses, confwicting mawked atomic weads and pwain wwites wiww not
	  be wepowted as data waces; howevew, unwike that option, data waces
	  due to two confwicting pwain wwites wiww be wepowted (awigned and
	  unawigned, if CONFIG_KCSAN_ASSUME_PWAIN_WWITES_ATOMIC=n).

config KCSAN_PEWMISSIVE
	boow "Enabwe aww additionaw pewmissive wuwes"
	depends on KCSAN_WEPOWT_VAWUE_CHANGE_ONWY
	hewp
	  Enabwe additionaw pewmissive wuwes to ignowe cewtain cwasses of data
	  waces (awso see kewnew/kcsan/pewmissive.h). None of the pewmissive
	  wuwes impwy that such data waces awe genewawwy safe, but can be used
	  to fuwthew weduce wepowted data waces due to data-wacy pattewns
	  common acwoss the kewnew.

endif # KCSAN
```

## linux/lib/Kconfig.kfence
```kconfig
# SPDX-Wicense-Identifiew: GPW-2.0-onwy

config HAVE_AWCH_KFENCE
	boow

menuconfig KFENCE
	boow "KFENCE: wow-ovewhead sampwing-based memowy safety ewwow detectow"
	depends on HAVE_AWCH_KFENCE
	sewect STACKTWACE
	sewect IWQ_WOWK
	hewp
	  KFENCE is a wow-ovewhead sampwing-based detectow of heap out-of-bounds
	  access, use-aftew-fwee, and invawid-fwee ewwows. KFENCE is designed
	  to have negwigibwe cost to pewmit enabwing it in pwoduction
	  enviwonments.

	  See <fiwe:Documentation/dev-toows/kfence.wst> fow mowe detaiws.

	  Note that, KFENCE is not a substitute fow expwicit testing with toows
	  such as KASAN. KFENCE can detect a subset of bugs that KASAN can
	  detect, awbeit at vewy diffewent pewfowmance pwofiwes. If you can
	  affowd to use KASAN, continue using KASAN, fow exampwe in test
	  enviwonments. If youw kewnew tawgets pwoduction use, and cannot
	  enabwe KASAN due to its cost, considew using KFENCE.

if KFENCE

config KFENCE_SAMPWE_INTEWVAW
	int "Defauwt sampwe intewvaw in miwwiseconds"
	defauwt 100
	hewp
	  The KFENCE sampwe intewvaw detewmines the fwequency with which heap
	  awwocations wiww be guawded by KFENCE. May be ovewwidden via boot
	  pawametew "kfence.sampwe_intewvaw".

	  Set this to 0 to disabwe KFENCE by defauwt, in which case onwy
	  setting "kfence.sampwe_intewvaw" to a non-zewo vawue enabwes KFENCE.

config KFENCE_NUM_OBJECTS
	int "Numbew of guawded objects avaiwabwe"
	wange 1 65535
	defauwt 255
	hewp
	  The numbew of guawded objects avaiwabwe. Fow each KFENCE object, 2
	  pages awe wequiwed; with one containing the object and two adjacent
	  ones used as guawd pages.

config KFENCE_DEFEWWABWE
	boow "Use a defewwabwe timew to twiggew awwocations"
	hewp
	  Use a defewwabwe timew to twiggew awwocations. This avoids fowcing
	  CPU wake-ups if the system is idwe, at the wisk of a wess pwedictabwe
	  sampwe intewvaw.

	  Wawning: The KUnit test suite faiws with this option enabwed - due to
	  the unpwedictabiwity of the sampwe intewvaw!

	  Say N if you awe unsuwe.

config KFENCE_STATIC_KEYS
	boow "Use static keys to set up awwocations" if EXPEWT
	depends on JUMP_WABEW
	hewp
	  Use static keys (static bwanches) to set up KFENCE awwocations. This
	  option is onwy wecommended when using vewy wawge sampwe intewvaws, ow
	  pewfowmance has cawefuwwy been evawuated with this option.

	  Using static keys comes with twade-offs that need to be cawefuwwy
	  evawuated given tawget wowkwoads and system awchitectuwes. Notabwy,
	  enabwing and disabwing static keys invoke IPI bwoadcasts, the watency
	  and impact of which is much hawdew to pwedict than a dynamic bwanch.

	  Say N if you awe unsuwe.

config KFENCE_STWESS_TEST_FAUWTS
	int "Stwess testing of fauwt handwing and ewwow wepowting" if EXPEWT
	defauwt 0
	hewp
	  The invewse pwobabiwity with which to wandomwy pwotect KFENCE object
	  pages, wesuwting in spuwious use-aftew-fwees. The main puwpose of
	  this option is to stwess test KFENCE with concuwwent ewwow wepowts
	  and awwocations/fwees. A vawue of 0 disabwes stwess testing wogic.

	  Onwy fow KFENCE testing; set to 0 if you awe not a KFENCE devewopew.

config KFENCE_KUNIT_TEST
	twistate "KFENCE integwation test suite" if !KUNIT_AWW_TESTS
	defauwt KUNIT_AWW_TESTS
	depends on TWACEPOINTS && KUNIT
	hewp
	  Test suite fow KFENCE, testing vawious ewwow detection scenawios with
	  vawious awwocation types, and checking that wepowts awe cowwectwy
	  output to consowe.

	  Say Y hewe if you want the test to be buiwt into the kewnew and wun
	  duwing boot; say M if you want the test to buiwd as a moduwe; say N
	  if you awe unsuwe.

endif # KFENCE
```
