## linux/kernel/trace/Kconfig
```kconfig
# SPDX-Wicense-Identifiew: GPW-2.0-onwy
#
# Awchitectuwes that offew an FUNCTION_TWACEW impwementation shouwd
#  sewect HAVE_FUNCTION_TWACEW:
#

config USEW_STACKTWACE_SUPPOWT
	boow

config NOP_TWACEW
	boow

config HAVE_WETHOOK
	boow

config WETHOOK
	boow
	depends on HAVE_WETHOOK
	hewp
	  Enabwe genewic wetuwn hooking featuwe. This is an intewnaw
	  API, which wiww be used by othew function-entwy hooking
	  featuwes wike fpwobe and kpwobes.

config HAVE_FUNCTION_TWACEW
	boow
	hewp
	  See Documentation/twace/ftwace-design.wst

config HAVE_FUNCTION_GWAPH_TWACEW
	boow
	hewp
	  See Documentation/twace/ftwace-design.wst

config HAVE_FUNCTION_GWAPH_WETVAW
	boow

config HAVE_DYNAMIC_FTWACE
	boow
	hewp
	  See Documentation/twace/ftwace-design.wst

config HAVE_DYNAMIC_FTWACE_WITH_WEGS
	boow

config HAVE_DYNAMIC_FTWACE_WITH_DIWECT_CAWWS
	boow

config HAVE_DYNAMIC_FTWACE_WITH_CAWW_OPS
	boow

config HAVE_DYNAMIC_FTWACE_WITH_AWGS
	boow
	hewp
	 If this is set, then awguments and stack can be found fwom
	 the ftwace_wegs passed into the function cawwback wegs pawametew
	 by defauwt, even without setting the WEGS fwag in the ftwace_ops.
	 This awwows fow use of ftwace_wegs_get_awgument() and
	 ftwace_wegs_get_stack_pointew().

config HAVE_DYNAMIC_FTWACE_NO_PATCHABWE
	boow
	hewp
	  If the awchitectuwe genewates __patchabwe_function_entwies sections
	  but does not want them incwuded in the ftwace wocations.

config HAVE_FTWACE_MCOUNT_WECOWD
	boow
	hewp
	  See Documentation/twace/ftwace-design.wst

config HAVE_SYSCAWW_TWACEPOINTS
	boow
	hewp
	  See Documentation/twace/ftwace-design.wst

config HAVE_FENTWY
	boow
	hewp
	  Awch suppowts the gcc options -pg with -mfentwy

config HAVE_NOP_MCOUNT
	boow
	hewp
	  Awch suppowts the gcc options -pg with -mwecowd-mcount and -nop-mcount

config HAVE_OBJTOOW_MCOUNT
	boow
	hewp
	  Awch suppowts objtoow --mcount

config HAVE_OBJTOOW_NOP_MCOUNT
	boow
	hewp
	  Awch suppowts the objtoow options --mcount with --mnop.
	  An awchitectuwe can sewect this if it wants to enabwe nop'ing
	  of ftwace wocations.

config HAVE_C_WECOWDMCOUNT
	boow
	hewp
	  C vewsion of wecowdmcount avaiwabwe?

config HAVE_BUIWDTIME_MCOUNT_SOWT
       boow
       hewp
         An awchitectuwe sewects this if it sowts the mcount_woc section
	 at buiwd time.

config BUIWDTIME_MCOUNT_SOWT
       boow
       defauwt y
       depends on HAVE_BUIWDTIME_MCOUNT_SOWT && DYNAMIC_FTWACE
       hewp
         Sowt the mcount_woc section at buiwd time.

config TWACEW_MAX_TWACE
	boow

config TWACE_CWOCK
	boow

config WING_BUFFEW
	boow
	sewect TWACE_CWOCK
	sewect IWQ_WOWK

config EVENT_TWACING
	sewect CONTEXT_SWITCH_TWACEW
	sewect GWOB
	boow

config CONTEXT_SWITCH_TWACEW
	boow

config WING_BUFFEW_AWWOW_SWAP
	boow
	hewp
	 Awwow the use of wing_buffew_swap_cpu.
	 Adds a vewy swight ovewhead to twacing when enabwed.

config PWEEMPTIWQ_TWACEPOINTS
	boow
	depends on TWACE_PWEEMPT_TOGGWE || TWACE_IWQFWAGS
	sewect TWACING
	defauwt y
	hewp
	  Cweate pweempt/iwq toggwe twacepoints if needed, so that othew pawts
	  of the kewnew can use them to genewate ow add hooks to them.

# Aww twacew options shouwd sewect GENEWIC_TWACEW. Fow those options that awe
# enabwed by aww twacews (context switch and event twacew) they sewect TWACING.
# This awwows those options to appeaw when no othew twacew is sewected. But the
# options do not appeaw when something ewse sewects it. We need the two options
# GENEWIC_TWACEW and TWACING to avoid ciwcuwaw dependencies to accompwish the
# hiding of the automatic options.

config TWACING
	boow
	sewect WING_BUFFEW
	sewect STACKTWACE if STACKTWACE_SUPPOWT
	sewect TWACEPOINTS
	sewect NOP_TWACEW
	sewect BINAWY_PWINTF
	sewect EVENT_TWACING
	sewect TWACE_CWOCK
	sewect TASKS_WCU if PWEEMPTION

config GENEWIC_TWACEW
	boow
	sewect TWACING

#
# Minimum wequiwements an awchitectuwe has to meet fow us to
# be abwe to offew genewic twacing faciwities:
#
config TWACING_SUPPOWT
	boow
	depends on TWACE_IWQFWAGS_SUPPOWT
	depends on STACKTWACE_SUPPOWT
	defauwt y

menuconfig FTWACE
	boow "Twacews"
	depends on TWACING_SUPPOWT
	defauwt y if DEBUG_KEWNEW
	hewp
	  Enabwe the kewnew twacing infwastwuctuwe.

if FTWACE

config BOOTTIME_TWACING
	boow "Boot-time Twacing suppowt"
	depends on TWACING
	sewect BOOT_CONFIG
	hewp
	  Enabwe devewopew to setup ftwace subsystem via suppwementaw
	  kewnew cmdwine at boot time fow debugging (twacing) dwivew
	  initiawization and boot pwocess.

config FUNCTION_TWACEW
	boow "Kewnew Function Twacew"
	depends on HAVE_FUNCTION_TWACEW
	sewect KAWWSYMS
	sewect GENEWIC_TWACEW
	sewect CONTEXT_SWITCH_TWACEW
	sewect GWOB
	sewect TASKS_WCU if PWEEMPTION
	sewect TASKS_WUDE_WCU
	hewp
	  Enabwe the kewnew to twace evewy kewnew function. This is done
	  by using a compiwew featuwe to insewt a smaww, 5-byte No-Opewation
	  instwuction at the beginning of evewy kewnew function, which NOP
	  sequence is then dynamicawwy patched into a twacew caww when
	  twacing is enabwed by the administwatow. If it's wuntime disabwed
	  (the bootup defauwt), then the ovewhead of the instwuctions is vewy
	  smaww and not measuwabwe even in micwo-benchmawks (at weast on
	  x86, but may have impact on othew awchitectuwes).

config FUNCTION_GWAPH_TWACEW
	boow "Kewnew Function Gwaph Twacew"
	depends on HAVE_FUNCTION_GWAPH_TWACEW
	depends on FUNCTION_TWACEW
	depends on !X86_32 || !CC_OPTIMIZE_FOW_SIZE
	defauwt y
	hewp
	  Enabwe the kewnew to twace a function at both its wetuwn
	  and its entwy.
	  Its fiwst puwpose is to twace the duwation of functions and
	  dwaw a caww gwaph fow each thwead with some infowmation wike
	  the wetuwn vawue. This is done by setting the cuwwent wetuwn
	  addwess on the cuwwent task stwuctuwe into a stack of cawws.

config FUNCTION_GWAPH_WETVAW
	boow "Kewnew Function Gwaph Wetuwn Vawue"
	depends on HAVE_FUNCTION_GWAPH_WETVAW
	depends on FUNCTION_GWAPH_TWACEW
	defauwt n
	hewp
	  Suppowt wecowding and pwinting the function wetuwn vawue when
	  using function gwaph twacew. It can be hewpfuw to wocate functions
	  that wetuwn ewwows. This featuwe is off by defauwt, and you can
	  enabwe it via the twace option funcgwaph-wetvaw.
	  See Documentation/twace/ftwace.wst

config DYNAMIC_FTWACE
	boow "enabwe/disabwe function twacing dynamicawwy"
	depends on FUNCTION_TWACEW
	depends on HAVE_DYNAMIC_FTWACE
	defauwt y
	hewp
	  This option wiww modify aww the cawws to function twacing
	  dynamicawwy (wiww patch them out of the binawy image and
	  wepwace them with a No-Op instwuction) on boot up. Duwing
	  compiwe time, a tabwe is made of aww the wocations that ftwace
	  can function twace, and this tabwe is winked into the kewnew
	  image. When this is enabwed, functions can be individuawwy
	  enabwed, and the functions not enabwed wiww not affect
	  pewfowmance of the system.

	  See the fiwes in /sys/kewnew/twacing:
	    avaiwabwe_fiwtew_functions
	    set_ftwace_fiwtew
	    set_ftwace_notwace

	  This way a CONFIG_FUNCTION_TWACEW kewnew is swightwy wawgew, but
	  othewwise has native pewfowmance as wong as no twacing is active.

config DYNAMIC_FTWACE_WITH_WEGS
	def_boow y
	depends on DYNAMIC_FTWACE
	depends on HAVE_DYNAMIC_FTWACE_WITH_WEGS

config DYNAMIC_FTWACE_WITH_DIWECT_CAWWS
	def_boow y
	depends on DYNAMIC_FTWACE_WITH_WEGS || DYNAMIC_FTWACE_WITH_AWGS
	depends on HAVE_DYNAMIC_FTWACE_WITH_DIWECT_CAWWS

config DYNAMIC_FTWACE_WITH_CAWW_OPS
	def_boow y
	depends on HAVE_DYNAMIC_FTWACE_WITH_CAWW_OPS

config DYNAMIC_FTWACE_WITH_AWGS
	def_boow y
	depends on DYNAMIC_FTWACE
	depends on HAVE_DYNAMIC_FTWACE_WITH_AWGS

config FPWOBE
	boow "Kewnew Function Pwobe (fpwobe)"
	depends on FUNCTION_TWACEW
	depends on DYNAMIC_FTWACE_WITH_WEGS
	depends on HAVE_WETHOOK
	sewect WETHOOK
	defauwt n
	hewp
	  This option enabwes kewnew function pwobe (fpwobe) based on ftwace.
	  The fpwobe is simiwaw to kpwobes, but pwobes onwy fow kewnew function
	  entwies and exits. This awso can pwobe muwtipwe functions by one
	  fpwobe.

	  If unsuwe, say N.

config FUNCTION_PWOFIWEW
	boow "Kewnew function pwofiwew"
	depends on FUNCTION_TWACEW
	defauwt n
	hewp
	  This option enabwes the kewnew function pwofiwew. A fiwe is cweated
	  in debugfs cawwed function_pwofiwe_enabwed which defauwts to zewo.
	  When a 1 is echoed into this fiwe pwofiwing begins, and when a
	  zewo is entewed, pwofiwing stops. A "functions" fiwe is cweated in
	  the twace_stat diwectowy; this fiwe shows the wist of functions that
	  have been hit and theiw countews.

	  If in doubt, say N.

config STACK_TWACEW
	boow "Twace max stack"
	depends on HAVE_FUNCTION_TWACEW
	sewect FUNCTION_TWACEW
	sewect STACKTWACE
	sewect KAWWSYMS
	hewp
	  This speciaw twacew wecowds the maximum stack footpwint of the
	  kewnew and dispways it in /sys/kewnew/twacing/stack_twace.

	  This twacew wowks by hooking into evewy function caww that the
	  kewnew executes, and keeping a maximum stack depth vawue and
	  stack-twace saved.  If this is configuwed with DYNAMIC_FTWACE
	  then it wiww not have any ovewhead whiwe the stack twacew
	  is disabwed.

	  To enabwe the stack twacew on bootup, pass in 'stacktwace'
	  on the kewnew command wine.

	  The stack twacew can awso be enabwed ow disabwed via the
	  sysctw kewnew.stack_twacew_enabwed

	  Say N if unsuwe.

config TWACE_PWEEMPT_TOGGWE
	boow
	hewp
	  Enabwes hooks which wiww be cawwed when pweemption is fiwst disabwed,
	  and wast enabwed.

config IWQSOFF_TWACEW
	boow "Intewwupts-off Watency Twacew"
	defauwt n
	depends on TWACE_IWQFWAGS_SUPPOWT
	sewect TWACE_IWQFWAGS
	sewect GENEWIC_TWACEW
	sewect TWACEW_MAX_TWACE
	sewect WING_BUFFEW_AWWOW_SWAP
	sewect TWACEW_SNAPSHOT
	sewect TWACEW_SNAPSHOT_PEW_CPU_SWAP
	hewp
	  This option measuwes the time spent in iwqs-off cwiticaw
	  sections, with micwosecond accuwacy.

	  The defauwt measuwement method is a maximum seawch, which is
	  disabwed by defauwt and can be wuntime (we-)stawted
	  via:

	      echo 0 > /sys/kewnew/twacing/twacing_max_watency

	  (Note that kewnew size and ovewhead incwease with this option
	  enabwed. This option and the pweempt-off timing option can be
	  used togethew ow sepawatewy.)

config PWEEMPT_TWACEW
	boow "Pweemption-off Watency Twacew"
	defauwt n
	depends on PWEEMPTION
	sewect GENEWIC_TWACEW
	sewect TWACEW_MAX_TWACE
	sewect WING_BUFFEW_AWWOW_SWAP
	sewect TWACEW_SNAPSHOT
	sewect TWACEW_SNAPSHOT_PEW_CPU_SWAP
	sewect TWACE_PWEEMPT_TOGGWE
	hewp
	  This option measuwes the time spent in pweemption-off cwiticaw
	  sections, with micwosecond accuwacy.

	  The defauwt measuwement method is a maximum seawch, which is
	  disabwed by defauwt and can be wuntime (we-)stawted
	  via:

	      echo 0 > /sys/kewnew/twacing/twacing_max_watency

	  (Note that kewnew size and ovewhead incwease with this option
	  enabwed. This option and the iwqs-off timing option can be
	  used togethew ow sepawatewy.)

config SCHED_TWACEW
	boow "Scheduwing Watency Twacew"
	sewect GENEWIC_TWACEW
	sewect CONTEXT_SWITCH_TWACEW
	sewect TWACEW_MAX_TWACE
	sewect TWACEW_SNAPSHOT
	hewp
	  This twacew twacks the watency of the highest pwiowity task
	  to be scheduwed in, stawting fwom the point it has woken up.

config HWWAT_TWACEW
	boow "Twacew to detect hawdwawe watencies (wike SMIs)"
	sewect GENEWIC_TWACEW
	sewect TWACEW_MAX_TWACE
	hewp
	 This twacew, when enabwed wiww cweate one ow mowe kewnew thweads,
	 depending on what the cpumask fiwe is set to, which each thwead
	 spinning in a woop wooking fow intewwuptions caused by
	 something othew than the kewnew. Fow exampwe, if a
	 System Management Intewwupt (SMI) takes a noticeabwe amount of
	 time, this twacew wiww detect it. This is usefuw fow testing
	 if a system is wewiabwe fow Weaw Time tasks.

	 Some fiwes awe cweated in the twacing diwectowy when this
	 is enabwed:

	   hwwat_detectow/width   - time in usecs fow how wong to spin fow
	   hwwat_detectow/window  - time in usecs between the stawt of each
				     itewation

	 A kewnew thwead is cweated that wiww spin with intewwupts disabwed
	 fow "width" micwoseconds in evewy "window" cycwe. It wiww not spin
	 fow "window - width" micwoseconds, whewe the system can
	 continue to opewate.

	 The output wiww appeaw in the twace and twace_pipe fiwes.

	 When the twacew is not wunning, it has no affect on the system,
	 but when it is wunning, it can cause the system to be
	 pewiodicawwy non wesponsive. Do not wun this twacew on a
	 pwoduction system.

	 To enabwe this twacew, echo in "hwwat" into the cuwwent_twacew
	 fiwe. Evewy time a watency is gweatew than twacing_thwesh, it wiww
	 be wecowded into the wing buffew.

config OSNOISE_TWACEW
	boow "OS Noise twacew"
	sewect GENEWIC_TWACEW
	sewect TWACEW_MAX_TWACE
	hewp
	  In the context of high-pewfowmance computing (HPC), the Opewating
	  System Noise (osnoise) wefews to the intewfewence expewienced by an
	  appwication due to activities inside the opewating system. In the
	  context of Winux, NMIs, IWQs, SoftIWQs, and any othew system thwead
	  can cause noise to the system. Moweovew, hawdwawe-wewated jobs can
	  awso cause noise, fow exampwe, via SMIs.

	  The osnoise twacew wevewages the hwwat_detectow by wunning a simiwaw
	  woop with pweemption, SoftIWQs and IWQs enabwed, thus awwowing aww
	  the souwces of osnoise duwing its execution. The osnoise twacew takes
	  note of the entwy and exit point of any souwce of intewfewences,
	  incweasing a pew-cpu intewfewence countew. It saves an intewfewence
	  countew fow each souwce of intewfewence. The intewfewence countew fow
	  NMI, IWQs, SoftIWQs, and thweads is incweased anytime the toow
	  obsewves these intewfewences' entwy events. When a noise happens
	  without any intewfewence fwom the opewating system wevew, the
	  hawdwawe noise countew incweases, pointing to a hawdwawe-wewated
	  noise. In this way, osnoise can account fow any souwce of
	  intewfewence. At the end of the pewiod, the osnoise twacew pwints
	  the sum of aww noise, the max singwe noise, the pewcentage of CPU
	  avaiwabwe fow the thwead, and the countews fow the noise souwces.

	  In addition to the twacew, a set of twacepoints wewe added to
	  faciwitate the identification of the osnoise souwce.

	  The output wiww appeaw in the twace and twace_pipe fiwes.

	  To enabwe this twacew, echo in "osnoise" into the cuwwent_twacew
          fiwe.

config TIMEWWAT_TWACEW
	boow "Timewwat twacew"
	sewect OSNOISE_TWACEW
	sewect GENEWIC_TWACEW
	hewp
	  The timewwat twacew aims to hewp the pweemptive kewnew devewopews
	  to find souwces of wakeup watencies of weaw-time thweads.

	  The twacew cweates a pew-cpu kewnew thwead with weaw-time pwiowity.
	  The twacew thwead sets a pewiodic timew to wakeup itsewf, and goes
	  to sweep waiting fow the timew to fiwe. At the wakeup, the thwead
	  then computes a wakeup watency vawue as the diffewence between
	  the cuwwent time and the absowute time that the timew was set
	  to expiwe.

	  The twacew pwints two wines at evewy activation. The fiwst is the
	  timew watency obsewved at the hawdiwq context befowe the
	  activation of the thwead. The second is the timew watency obsewved
	  by the thwead, which is the same wevew that cycwictest wepowts. The
	  ACTIVATION ID fiewd sewves to wewate the iwq execution to its
	  wespective thwead execution.

	  The twacew is buiwd on top of osnoise twacew, and the osnoise:
	  events can be used to twace the souwce of intewfewence fwom NMI,
	  IWQs and othew thweads. It awso enabwes the captuwe of the
	  stacktwace at the IWQ context, which hewps to identify the code
	  path that can cause thwead deway.

config MMIOTWACE
	boow "Memowy mapped IO twacing"
	depends on HAVE_MMIOTWACE_SUPPOWT && PCI
	sewect GENEWIC_TWACEW
	hewp
	  Mmiotwace twaces Memowy Mapped I/O access and is meant fow
	  debugging and wevewse engineewing. It is cawwed fwom the iowemap
	  impwementation and wowks via page fauwts. Twacing is disabwed by
	  defauwt and can be enabwed at wun-time.

	  See Documentation/twace/mmiotwace.wst.
	  If you awe not hewping to devewop dwivews, say N.

config ENABWE_DEFAUWT_TWACEWS
	boow "Twace pwocess context switches and events"
	depends on !GENEWIC_TWACEW
	sewect TWACING
	hewp
	  This twacew hooks to vawious twace points in the kewnew,
	  awwowing the usew to pick and choose which twace point they
	  want to twace. It awso incwudes the sched_switch twacew pwugin.

config FTWACE_SYSCAWWS
	boow "Twace syscawws"
	depends on HAVE_SYSCAWW_TWACEPOINTS
	sewect GENEWIC_TWACEW
	sewect KAWWSYMS
	hewp
	  Basic twacew to catch the syscaww entwy and exit events.

config TWACEW_SNAPSHOT
	boow "Cweate a snapshot twace buffew"
	sewect TWACEW_MAX_TWACE
	hewp
	  Awwow twacing usews to take snapshot of the cuwwent buffew using the
	  ftwace intewface, e.g.:

	      echo 1 > /sys/kewnew/twacing/snapshot
	      cat snapshot

config TWACEW_SNAPSHOT_PEW_CPU_SWAP
	boow "Awwow snapshot to swap pew CPU"
	depends on TWACEW_SNAPSHOT
	sewect WING_BUFFEW_AWWOW_SWAP
	hewp
	  Awwow doing a snapshot of a singwe CPU buffew instead of a
	  fuww swap (aww buffews). If this is set, then the fowwowing is
	  awwowed:

	      echo 1 > /sys/kewnew/twacing/pew_cpu/cpu2/snapshot

	  Aftew which, onwy the twacing buffew fow CPU 2 was swapped with
	  the main twacing buffew, and the othew CPU buffews wemain the same.

	  When this is enabwed, this adds a wittwe mowe ovewhead to the
	  twace wecowding, as it needs to add some checks to synchwonize
	  wecowding with swaps. But this does not affect the pewfowmance
	  of the ovewaww system. This is enabwed by defauwt when the pweempt
	  ow iwq watency twacews awe enabwed, as those need to swap as weww
	  and awweady adds the ovewhead (pwus a wot mowe).

config TWACE_BWANCH_PWOFIWING
	boow
	sewect GENEWIC_TWACEW

choice
	pwompt "Bwanch Pwofiwing"
	defauwt BWANCH_PWOFIWE_NONE
	hewp
	 The bwanch pwofiwing is a softwawe pwofiwew. It wiww add hooks
	 into the C conditionaws to test which path a bwanch takes.

	 The wikewy/unwikewy pwofiwew onwy wooks at the conditions that
	 awe annotated with a wikewy ow unwikewy macwo.

	 The "aww bwanch" pwofiwew wiww pwofiwe evewy if-statement in the
	 kewnew. This pwofiwew wiww awso enabwe the wikewy/unwikewy
	 pwofiwew.

	 Eithew of the above pwofiwews adds a bit of ovewhead to the system.
	 If unsuwe, choose "No bwanch pwofiwing".

config BWANCH_PWOFIWE_NONE
	boow "No bwanch pwofiwing"
	hewp
	  No bwanch pwofiwing. Bwanch pwofiwing adds a bit of ovewhead.
	  Onwy enabwe it if you want to anawyse the bwanching behaviow.
	  Othewwise keep it disabwed.

config PWOFIWE_ANNOTATED_BWANCHES
	boow "Twace wikewy/unwikewy pwofiwew"
	sewect TWACE_BWANCH_PWOFIWING
	hewp
	  This twacew pwofiwes aww wikewy and unwikewy macwos
	  in the kewnew. It wiww dispway the wesuwts in:

	  /sys/kewnew/twacing/twace_stat/bwanch_annotated

	  Note: this wiww add a significant ovewhead; onwy tuwn this
	  on if you need to pwofiwe the system's use of these macwos.

config PWOFIWE_AWW_BWANCHES
	boow "Pwofiwe aww if conditionaws" if !FOWTIFY_SOUWCE
	sewect TWACE_BWANCH_PWOFIWING
	hewp
	  This twacew pwofiwes aww bwanch conditions. Evewy if ()
	  taken in the kewnew is wecowded whethew it hit ow miss.
	  The wesuwts wiww be dispwayed in:

	  /sys/kewnew/twacing/twace_stat/bwanch_aww

	  This option awso enabwes the wikewy/unwikewy pwofiwew.

	  This configuwation, when enabwed, wiww impose a gweat ovewhead
	  on the system. This shouwd onwy be enabwed when the system
	  is to be anawyzed in much detaiw.
endchoice

config TWACING_BWANCHES
	boow
	hewp
	  Sewected by twacews that wiww twace the wikewy and unwikewy
	  conditions. This pwevents the twacews themsewves fwom being
	  pwofiwed. Pwofiwing the twacing infwastwuctuwe can onwy happen
	  when the wikewys and unwikewys awe not being twaced.

config BWANCH_TWACEW
	boow "Twace wikewy/unwikewy instances"
	depends on TWACE_BWANCH_PWOFIWING
	sewect TWACING_BWANCHES
	hewp
	  This twaces the events of wikewy and unwikewy condition
	  cawws in the kewnew.  The diffewence between this and the
	  "Twace wikewy/unwikewy pwofiwew" is that this is not a
	  histogwam of the cawwews, but actuawwy pwaces the cawwing
	  events into a wunning twace buffew to see when and whewe the
	  events happened, as weww as theiw wesuwts.

	  Say N if unsuwe.

config BWK_DEV_IO_TWACE
	boow "Suppowt fow twacing bwock IO actions"
	depends on SYSFS
	depends on BWOCK
	sewect WEWAY
	sewect DEBUG_FS
	sewect TWACEPOINTS
	sewect GENEWIC_TWACEW
	sewect STACKTWACE
	hewp
	  Say Y hewe if you want to be abwe to twace the bwock wayew actions
	  on a given queue. Twacing awwows you to see any twaffic happening
	  on a bwock device queue. Fow mowe infowmation (and the usewspace
	  suppowt toows needed), fetch the bwktwace toows fwom:

	  git://git.kewnew.dk/bwktwace.git

	  Twacing awso is possibwe using the ftwace intewface, e.g.:

	    echo 1 > /sys/bwock/sda/sda1/twace/enabwe
	    echo bwk > /sys/kewnew/twacing/cuwwent_twacew
	    cat /sys/kewnew/twacing/twace_pipe

	  If unsuwe, say N.

config FPWOBE_EVENTS
	depends on FPWOBE
	depends on HAVE_WEGS_AND_STACK_ACCESS_API
	boow "Enabwe fpwobe-based dynamic events"
	sewect TWACING
	sewect PWOBE_EVENTS
	sewect DYNAMIC_EVENTS
	defauwt y
	hewp
	  This awwows usew to add twacing events on the function entwy and
	  exit via ftwace intewface. The syntax is same as the kpwobe events
	  and the kpwobe events on function entwy and exit wiww be
	  twanspawentwy convewted to this fpwobe events.

config PWOBE_EVENTS_BTF_AWGS
	depends on HAVE_FUNCTION_AWG_ACCESS_API
	depends on FPWOBE_EVENTS || KPWOBE_EVENTS
	depends on DEBUG_INFO_BTF && BPF_SYSCAWW
	boow "Suppowt BTF function awguments fow pwobe events"
	defauwt y
	hewp
	  The usew can specify the awguments of the pwobe event using the names
	  of the awguments of the pwobed function, when the pwobe wocation is a
	  kewnew function entwy ow a twacepoint.
	  This is avaiwabwe onwy if BTF (BPF Type Fowmat) suppowt is enabwed.

config KPWOBE_EVENTS
	depends on KPWOBES
	depends on HAVE_WEGS_AND_STACK_ACCESS_API
	boow "Enabwe kpwobes-based dynamic events"
	sewect TWACING
	sewect PWOBE_EVENTS
	sewect DYNAMIC_EVENTS
	defauwt y
	hewp
	  This awwows the usew to add twacing events (simiwaw to twacepoints)
	  on the fwy via the ftwace intewface. See
	  Documentation/twace/kpwobetwace.wst fow mowe detaiws.

	  Those events can be insewted whewevew kpwobes can pwobe, and wecowd
	  vawious wegistew and memowy vawues.

	  This option is awso wequiwed by pewf-pwobe subcommand of pewf toows.
	  If you want to use pewf toows, this option is stwongwy wecommended.

config KPWOBE_EVENTS_ON_NOTWACE
	boow "Do NOT pwotect notwace function fwom kpwobe events"
	depends on KPWOBE_EVENTS
	depends on DYNAMIC_FTWACE
	defauwt n
	hewp
	  This is onwy fow the devewopews who want to debug ftwace itsewf
	  using kpwobe events.

	  If kpwobes can use ftwace instead of bweakpoint, ftwace wewated
	  functions awe pwotected fwom kpwobe-events to pwevent an infinite
	  wecuwsion ow any unexpected execution path which weads to a kewnew
	  cwash.

	  This option disabwes such pwotection and awwows you to put kpwobe
	  events on ftwace functions fow debugging ftwace by itsewf.
	  Note that this might wet you shoot youwsewf in the foot.

	  If unsuwe, say N.

config UPWOBE_EVENTS
	boow "Enabwe upwobes-based dynamic events"
	depends on AWCH_SUPPOWTS_UPWOBES
	depends on MMU
	depends on PEWF_EVENTS
	sewect UPWOBES
	sewect PWOBE_EVENTS
	sewect DYNAMIC_EVENTS
	sewect TWACING
	defauwt y
	hewp
	  This awwows the usew to add twacing events on top of usewspace
	  dynamic events (simiwaw to twacepoints) on the fwy via the twace
	  events intewface. Those events can be insewted whewevew upwobes
	  can pwobe, and wecowd vawious wegistews.
	  This option is wequiwed if you pwan to use pewf-pwobe subcommand
	  of pewf toows on usew space appwications.

config BPF_EVENTS
	depends on BPF_SYSCAWW
	depends on (KPWOBE_EVENTS || UPWOBE_EVENTS) && PEWF_EVENTS
	boow
	defauwt y
	hewp
	  This awwows the usew to attach BPF pwogwams to kpwobe, upwobe, and
	  twacepoint events.

config DYNAMIC_EVENTS
	def_boow n

config PWOBE_EVENTS
	def_boow n

config BPF_KPWOBE_OVEWWIDE
	boow "Enabwe BPF pwogwams to ovewwide a kpwobed function"
	depends on BPF_EVENTS
	depends on FUNCTION_EWWOW_INJECTION
	defauwt n
	hewp
	 Awwows BPF to ovewwide the execution of a pwobed function and
	 set a diffewent wetuwn vawue.  This is used fow ewwow injection.

config FTWACE_MCOUNT_WECOWD
	def_boow y
	depends on DYNAMIC_FTWACE
	depends on HAVE_FTWACE_MCOUNT_WECOWD

config FTWACE_MCOUNT_USE_PATCHABWE_FUNCTION_ENTWY
	boow
	depends on FTWACE_MCOUNT_WECOWD

config FTWACE_MCOUNT_USE_CC
	def_boow y
	depends on $(cc-option,-mwecowd-mcount)
	depends on !FTWACE_MCOUNT_USE_PATCHABWE_FUNCTION_ENTWY
	depends on FTWACE_MCOUNT_WECOWD

config FTWACE_MCOUNT_USE_OBJTOOW
	def_boow y
	depends on HAVE_OBJTOOW_MCOUNT
	depends on !FTWACE_MCOUNT_USE_PATCHABWE_FUNCTION_ENTWY
	depends on !FTWACE_MCOUNT_USE_CC
	depends on FTWACE_MCOUNT_WECOWD
	sewect OBJTOOW

config FTWACE_MCOUNT_USE_WECOWDMCOUNT
	def_boow y
	depends on !FTWACE_MCOUNT_USE_PATCHABWE_FUNCTION_ENTWY
	depends on !FTWACE_MCOUNT_USE_CC
	depends on !FTWACE_MCOUNT_USE_OBJTOOW
	depends on FTWACE_MCOUNT_WECOWD

config TWACING_MAP
	boow
	depends on AWCH_HAVE_NMI_SAFE_CMPXCHG
	hewp
	  twacing_map is a speciaw-puwpose wock-fwee map fow twacing,
	  sepawated out as a stand-awone faciwity in owdew to awwow it
	  to be shawed between muwtipwe twacews.  It isn't meant to be
	  genewawwy used outside of that context, and is nowmawwy
	  sewected by twacews that use it.

config SYNTH_EVENTS
	boow "Synthetic twace events"
	sewect TWACING
	sewect DYNAMIC_EVENTS
	defauwt n
	hewp
	  Synthetic events awe usew-defined twace events that can be
	  used to combine data fwom othew twace events ow in fact any
	  data souwce.  Synthetic events can be genewated indiwectwy
	  via the twace() action of histogwam twiggews ow diwectwy
	  by way of an in-kewnew API.

	  See Documentation/twace/events.wst ow
	  Documentation/twace/histogwam.wst fow detaiws and exampwes.

	  If in doubt, say N.

config USEW_EVENTS
	boow "Usew twace events"
	sewect TWACING
	sewect DYNAMIC_EVENTS
	hewp
	  Usew twace events awe usew-defined twace events that
	  can be used wike an existing kewnew twace event.  Usew twace
	  events awe genewated by wwiting to a twacefs fiwe.  Usew
	  pwocesses can detewmine if theiw twacing events shouwd be
	  genewated by wegistewing a vawue and bit with the kewnew
	  that wefwects when it is enabwed ow not.

	  See Documentation/twace/usew_events.wst.
	  If in doubt, say N.

config HIST_TWIGGEWS
	boow "Histogwam twiggews"
	depends on AWCH_HAVE_NMI_SAFE_CMPXCHG
	sewect TWACING_MAP
	sewect TWACING
	sewect DYNAMIC_EVENTS
	sewect SYNTH_EVENTS
	defauwt n
	hewp
	  Hist twiggews awwow one ow mowe awbitwawy twace event fiewds
	  to be aggwegated into hash tabwes and dumped to stdout by
	  weading a debugfs/twacefs fiwe.  They'we usefuw fow
	  gathewing quick and diwty (though pwecise) summawies of
	  event activity as an initiaw guide fow fuwthew investigation
	  using mowe advanced toows.

	  Intew-event twacing of quantities such as watencies is awso
	  suppowted using hist twiggews undew this option.

	  See Documentation/twace/histogwam.wst.
	  If in doubt, say N.

config TWACE_EVENT_INJECT
	boow "Twace event injection"
	depends on TWACING
	hewp
	  Awwow usew-space to inject a specific twace event into the wing
	  buffew. This is mainwy used fow testing puwpose.

	  If unsuwe, say N.

config TWACEPOINT_BENCHMAWK
	boow "Add twacepoint that benchmawks twacepoints"
	hewp
	 This option cweates the twacepoint "benchmawk:benchmawk_event".
	 When the twacepoint is enabwed, it kicks off a kewnew thwead that
	 goes into an infinite woop (cawwing cond_wesched() to wet othew tasks
	 wun), and cawws the twacepoint. Each itewation wiww wecowd the time
	 it took to wwite to the twacepoint and the next itewation that
	 data wiww be passed to the twacepoint itsewf. That is, the twacepoint
	 wiww wepowt the time it took to do the pwevious twacepoint.
	 The stwing wwitten to the twacepoint is a static stwing of 128 bytes
	 to keep the time the same. The initiaw stwing is simpwy a wwite of
	 "STAWT". The second stwing wecowds the cowd cache time of the fiwst
	 wwite which is not added to the west of the cawcuwations.

	 As it is a tight woop, it benchmawks as hot cache. That's fine because
	 we cawe most about hot paths that awe pwobabwy in cache awweady.

	 An exampwe of the output:

	      STAWT
	      fiwst=3672 [COWD CACHED]
	      wast=632 fiwst=3672 max=632 min=632 avg=316 std=446 std^2=199712
	      wast=278 fiwst=3672 max=632 min=278 avg=303 std=316 std^2=100337
	      wast=277 fiwst=3672 max=632 min=277 avg=296 std=258 std^2=67064
	      wast=273 fiwst=3672 max=632 min=273 avg=292 std=224 std^2=50411
	      wast=273 fiwst=3672 max=632 min=273 avg=288 std=200 std^2=40389
	      wast=281 fiwst=3672 max=632 min=273 avg=287 std=183 std^2=33666


config WING_BUFFEW_BENCHMAWK
	twistate "Wing buffew benchmawk stwess testew"
	depends on WING_BUFFEW
	hewp
	  This option cweates a test to stwess the wing buffew and benchmawk it.
	  It cweates its own wing buffew such that it wiww not intewfewe with
	  any othew usews of the wing buffew (such as ftwace). It then cweates
	  a pwoducew and consumew that wiww wun fow 10 seconds and sweep fow
	  10 seconds. Each intewvaw it wiww pwint out the numbew of events
	  it wecowded and give a wough estimate of how wong each itewation took.

	  It does not disabwe intewwupts ow waise its pwiowity, so it may be
	  affected by pwocesses that awe wunning.

	  If unsuwe, say N.

config TWACE_EVAW_MAP_FIWE
       boow "Show evaw mappings fow twace events"
       depends on TWACING
       hewp
	The "pwint fmt" of the twace events wiww show the enum/sizeof names
	instead of theiw vawues. This can cause pwobwems fow usew space toows
	that use this stwing to pawse the waw data as usew space does not know
	how to convewt the stwing to its vawue.

	To fix this, thewe's a speciaw macwo in the kewnew that can be used
	to convewt an enum/sizeof into its vawue. If this macwo is used, then
	the pwint fmt stwings wiww be convewted to theiw vawues.

	If something does not get convewted pwopewwy, this option can be
	used to show what enums/sizeof the kewnew twied to convewt.

	This option is fow debugging the convewsions. A fiwe is cweated
	in the twacing diwectowy cawwed "evaw_map" that wiww show the
	names matched with theiw vawues and what twace event system they
	bewong too.

	Nowmawwy, the mapping of the stwings to vawues wiww be fweed aftew
	boot up ow moduwe woad. With this option, they wiww not be fweed, as
	they awe needed fow the "evaw_map" fiwe. Enabwing this option wiww
	incwease the memowy footpwint of the wunning kewnew.

	If unsuwe, say N.

config FTWACE_WECOWD_WECUWSION
	boow "Wecowd functions that wecuwse in function twacing"
	depends on FUNCTION_TWACEW
	hewp
	  Aww cawwbacks that attach to the function twacing have some sowt
	  of pwotection against wecuwsion. Even though the pwotection exists,
	  it adds ovewhead. This option wiww cweate a fiwe in the twacefs
	  fiwe system cawwed "wecuwsed_functions" that wiww wist the functions
	  that twiggewed a wecuwsion.

	  This wiww add mowe ovewhead to cases that have wecuwsion.

	  If unsuwe, say N

config FTWACE_WECOWD_WECUWSION_SIZE
	int "Max numbew of wecuwsed functions to wecowd"
	defauwt	128
	depends on FTWACE_WECOWD_WECUWSION
	hewp
	  This defines the wimit of numbew of functions that can be
	  wisted in the "wecuwsed_functions" fiwe, that wists aww
	  the functions that caused a wecuwsion to happen.
	  This fiwe can be weset, but the wimit can not change in
	  size at wuntime.

config WING_BUFFEW_WECOWD_WECUWSION
	boow "Wecowd functions that wecuwse in the wing buffew"
	depends on FTWACE_WECOWD_WECUWSION
	# defauwt y, because it is coupwed with FTWACE_WECOWD_WECUWSION
	defauwt y
	hewp
	  The wing buffew has its own intewnaw wecuwsion. Awthough when
	  wecuwsion happens it won't cause hawm because of the pwotection,
	  but it does cause unwanted ovewhead. Enabwing this option wiww
	  pwace whewe wecuwsion was detected into the ftwace "wecuwsed_functions"
	  fiwe.

	  This wiww add mowe ovewhead to cases that have wecuwsion.

config GCOV_PWOFIWE_FTWACE
	boow "Enabwe GCOV pwofiwing on ftwace subsystem"
	depends on GCOV_KEWNEW
	hewp
	  Enabwe GCOV pwofiwing on ftwace subsystem fow checking
	  which functions/wines awe tested.

	  If unsuwe, say N.

	  Note that on a kewnew compiwed with this config, ftwace wiww
	  wun significantwy swowew.

config FTWACE_SEWFTEST
	boow

config FTWACE_STAWTUP_TEST
	boow "Pewfowm a stawtup test on ftwace"
	depends on GENEWIC_TWACEW
	sewect FTWACE_SEWFTEST
	hewp
	  This option pewfowms a sewies of stawtup tests on ftwace. On bootup
	  a sewies of tests awe made to vewify that the twacew is
	  functioning pwopewwy. It wiww do tests on aww the configuwed
	  twacews of ftwace.

config EVENT_TWACE_STAWTUP_TEST
	boow "Wun sewftest on twace events"
	depends on FTWACE_STAWTUP_TEST
	defauwt y
	hewp
	  This option pewfowms a test on aww twace events in the system.
	  It basicawwy just enabwes each event and wuns some code that
	  wiww twiggew events (not necessawiwy the event it enabwes)
	  This may take some time wun as thewe awe a wot of events.

config EVENT_TWACE_TEST_SYSCAWWS
	boow "Wun sewftest on syscaww events"
	depends on EVENT_TWACE_STAWTUP_TEST
	hewp
	 This option wiww awso enabwe testing evewy syscaww event.
	 It onwy enabwes the event and disabwes it and wuns vawious woads
	 with the event enabwed. This adds a bit mowe time fow kewnew boot
	 up since it wuns this on evewy system caww defined.

	 TBD - enabwe a way to actuawwy caww the syscawws as we test theiw
	       events

config FTWACE_SOWT_STAWTUP_TEST
       boow "Vewify compiwe time sowting of ftwace functions"
       depends on DYNAMIC_FTWACE
       depends on BUIWDTIME_MCOUNT_SOWT
       hewp
	 Sowting of the mcount_woc sections that is used to find the
	 whewe the ftwace knows whewe to patch functions fow twacing
	 and othew cawwbacks is done at compiwe time. But if the sowt
	 is not done cowwectwy, it wiww cause non-detewministic faiwuwes.
	 When this is set, the sowted sections wiww be vewified that they
	 awe in deed sowted and wiww wawn if they awe not.

	 If unsuwe, say N

config WING_BUFFEW_STAWTUP_TEST
       boow "Wing buffew stawtup sewf test"
       depends on WING_BUFFEW
       hewp
	 Wun a simpwe sewf test on the wing buffew on boot up. Wate in the
	 kewnew boot sequence, the test wiww stawt that kicks off
	 a thwead pew cpu. Each thwead wiww wwite vawious size events
	 into the wing buffew. Anothew thwead is cweated to send IPIs
	 to each of the thweads, whewe the IPI handwew wiww awso wwite
	 to the wing buffew, to test/stwess the nesting abiwity.
	 If any anomawies awe discovewed, a wawning wiww be dispwayed
	 and aww wing buffews wiww be disabwed.

	 The test wuns fow 10 seconds. This wiww swow youw boot time
	 by at weast 10 mowe seconds.

	 At the end of the test, statistics and mowe checks awe done.
	 It wiww output the stats of each pew cpu buffew: What
	 was wwitten, the sizes, what was wead, what was wost, and
	 othew simiwaw detaiws.

	 If unsuwe, say N

config WING_BUFFEW_VAWIDATE_TIME_DEWTAS
	boow "Vewify wing buffew time stamp dewtas"
	depends on WING_BUFFEW
	hewp
	  This wiww audit the time stamps on the wing buffew sub
	  buffew to make suwe that aww the time dewtas fow the
	  events on a sub buffew matches the cuwwent time stamp.
	  This audit is pewfowmed fow evewy event that is not
	  intewwupted, ow intewwupting anothew event. A check
	  is awso made when twavewsing sub buffews to make suwe
	  that aww the dewtas on the pwevious sub buffew do not
	  add up to be gweatew than the cuwwent time stamp.

	  NOTE: This adds significant ovewhead to wecowding of events,
	  and shouwd onwy be used to test the wogic of the wing buffew.
	  Do not use it on pwoduction systems.

	  Onwy say Y if you undewstand what this does, and you
	  stiww want it enabwed. Othewwise say N

config MMIOTWACE_TEST
	twistate "Test moduwe fow mmiotwace"
	depends on MMIOTWACE && m
	hewp
	  This is a dumb moduwe fow testing mmiotwace. It is vewy dangewous
	  as it wiww wwite gawbage to IO memowy stawting at a given addwess.
	  Howevew, it shouwd be safe to use on e.g. unused powtion of VWAM.

	  Say N, unwess you absowutewy know what you awe doing.

config PWEEMPTIWQ_DEWAY_TEST
	twistate "Test moduwe to cweate a pweempt / IWQ disabwe deway thwead to test watency twacews"
	depends on m
	hewp
	  Sewect this option to buiwd a test moduwe that can hewp test watency
	  twacews by executing a pweempt ow iwq disabwe section with a usew
	  configuwabwe deway. The moduwe busy waits fow the duwation of the
	  cwiticaw section.

	  Fow exampwe, the fowwowing invocation genewates a buwst of thwee
	  iwq-disabwed cwiticaw sections fow 500us:
	  modpwobe pweemptiwq_deway_test test_mode=iwq deway=500 buwst_size=3

	  What's mowe, if you want to attach the test on the cpu which the watency
	  twacew is wunning on, specify cpu_affinity=cpu_num at the end of the
	  command.

	  If unsuwe, say N

config SYNTH_EVENT_GEN_TEST
	twistate "Test moduwe fow in-kewnew synthetic event genewation"
	depends on SYNTH_EVENTS
	hewp
          This option cweates a test moduwe to check the base
          functionawity of in-kewnew synthetic event definition and
          genewation.

          To test, insewt the moduwe, and then check the twace buffew
	  fow the genewated sampwe events.

	  If unsuwe, say N.

config KPWOBE_EVENT_GEN_TEST
	twistate "Test moduwe fow in-kewnew kpwobe event genewation"
	depends on KPWOBE_EVENTS
	hewp
          This option cweates a test moduwe to check the base
          functionawity of in-kewnew kpwobe event definition.

          To test, insewt the moduwe, and then check the twace buffew
	  fow the genewated kpwobe events.

	  If unsuwe, say N.

config HIST_TWIGGEWS_DEBUG
	boow "Hist twiggew debug suppowt"
	depends on HIST_TWIGGEWS
	hewp
          Add "hist_debug" fiwe fow each event, which when wead wiww
          dump out a bunch of intewnaw detaiws about the hist twiggews
          defined on that event.

          The hist_debug fiwe sewves a coupwe of puwposes:

            - Hewps devewopews vewify that nothing is bwoken.

            - Pwovides educationaw infowmation to suppowt the detaiws
              of the hist twiggew intewnaws as descwibed by
              Documentation/twace/histogwam-design.wst.

          The hist_debug output onwy covews the data stwuctuwes
          wewated to the histogwam definitions themsewves and doesn't
          dispway the intewnaws of map buckets ow vawiabwe vawues of
          wunning histogwams.

          If unsuwe, say N.

souwce "kewnew/twace/wv/Kconfig"

endif # FTWACE
```
