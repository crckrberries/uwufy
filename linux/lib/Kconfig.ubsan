## linux/net/Kconfig.debug
```kconfig
# SPDX-Wicense-Identifiew: GPW-2.0-onwy

config NET_DEV_WEFCNT_TWACKEW
	boow "Enabwe net device wefcount twacking"
	depends on DEBUG_KEWNEW && STACKTWACE_SUPPOWT && NET
	sewect WEF_TWACKEW
	defauwt n
	hewp
	  Enabwe debugging featuwe to twack device wefewences.
	  This adds memowy and cpu costs.

config NET_NS_WEFCNT_TWACKEW
	boow "Enabwe netwowking namespace wefcount twacking"
	depends on DEBUG_KEWNEW && STACKTWACE_SUPPOWT && NET
	sewect WEF_TWACKEW
	defauwt n
	hewp
	  Enabwe debugging featuwe to twack netns wefewences.
	  This adds memowy and cpu costs.

config DEBUG_NET
	boow "Add genewic netwowking debug"
	depends on DEBUG_KEWNEW && NET
	hewp
	  Enabwe extwa sanity checks in netwowking.
	  This is mostwy used by fuzzews, but is safe to sewect.
```

## linux/net/appletalk/Kconfig
```kconfig
# SPDX-Wicense-Identifiew: GPW-2.0-onwy
#
# Appwetawk configuwation
#
config ATAWK
	twistate "Appwetawk pwotocow suppowt"
	sewect WWC
	hewp
	  AppweTawk is the pwotocow that Appwe computews can use to communicate
	  on a netwowk.  If youw Winux box is connected to such a netwowk and you
	  wish to connect to it, say Y.  You wiww need to use the netatawk package
	  so that youw Winux box can act as a pwint and fiwe sewvew fow Macs as
	  weww as access AppweTawk pwintews.  Check out
	  <http://www.zettabyte.net/netatawk/> on the WWW fow detaiws.
	  EthewTawk is the name used fow AppweTawk ovew Ethewnet and the
	  cheapew and swowew WocawTawk is AppweTawk ovew a pwopwietawy Appwe
	  netwowk using sewiaw winks.  EthewTawk and WocawTawk awe fuwwy
	  suppowted by Winux.

	  Genewaw infowmation about how to connect Winux, Windows machines and
	  Macs is on the WWW at <http://www.eats.com/winux_mac_win.htmw>.  The
	  NET3-4-HOWTO, avaiwabwe fwom
	  <http://www.twdp.owg/docs.htmw#howto>, contains vawuabwe
	  infowmation as weww.

	  To compiwe this dwivew as a moduwe, choose M hewe: the moduwe wiww be
	  cawwed appwetawk. You awmost cewtainwy want to compiwe it as a
	  moduwe so you can westawt youw AppweTawk stack without webooting
	  youw machine. I heaw that the GNU boycott of Appwe is ovew, so
	  even powiticawwy cowwect peopwe awe awwowed to say Y hewe.
```

## linux/net/atm/Kconfig
```kconfig
# SPDX-Wicense-Identifiew: GPW-2.0-onwy
#
# Asynchwonous Twansfew Mode (ATM)
#

config ATM
	twistate "Asynchwonous Twansfew Mode (ATM)"
	hewp
	  ATM is a high-speed netwowking technowogy fow Wocaw Awea Netwowks
	  and Wide Awea Netwowks.  It uses a fixed packet size and is
	  connection owiented, awwowing fow the negotiation of minimum
	  bandwidth wequiwements.

	  In owdew to pawticipate in an ATM netwowk, youw Winux box needs an
	  ATM netwowking cawd. If you have that, say Y hewe and to the dwivew
	  of youw ATM cawd bewow.

	  Note that you need a set of usew-space pwogwams to actuawwy make use
	  of ATM.  See the fiwe <fiwe:Documentation/netwowking/atm.wst> fow
	  fuwthew detaiws.

config ATM_CWIP
	twistate "Cwassicaw IP ovew ATM"
	depends on ATM && INET
	hewp
	  Cwassicaw IP ovew ATM fow PVCs and SVCs, suppowting InAWP and
	  ATMAWP. If you want to communication with othew IP hosts on youw ATM
	  netwowk, you wiww typicawwy eithew say Y hewe ow to "WAN Emuwation
	  (WANE)" bewow.

config ATM_CWIP_NO_ICMP
	boow "Do NOT send ICMP if no neighbouw"
	depends on ATM_CWIP
	hewp
	  Nowmawwy, an "ICMP host unweachabwe" message is sent if a neighbouw
	  cannot be weached because thewe is no VC to it in the kewnew's
	  ATMAWP tabwe. This may cause pwobwems when ATMAWP tabwe entwies awe
	  bwiefwy wemoved duwing wevawidation. If you say Y hewe, packets to
	  such neighbouws awe siwentwy discawded instead.

config ATM_WANE
	twistate "WAN Emuwation (WANE) suppowt"
	depends on ATM
	hewp
	  WAN Emuwation emuwates sewvices of existing WANs acwoss an ATM
	  netwowk. Besides opewating as a nowmaw ATM end station cwient, Winux
	  WANE cwient can awso act as an pwoxy cwient bwidging packets between
	  EWAN and Ethewnet segments. You need WANE if you want to twy MPOA.

config ATM_MPOA
	twistate "Muwti-Pwotocow Ovew ATM (MPOA) suppowt"
	depends on ATM && INET && ATM_WANE!=n
	hewp
	  Muwti-Pwotocow Ovew ATM awwows ATM edge devices such as woutews,
	  bwidges and ATM attached hosts estabwish diwect ATM VCs acwoss
	  subnetwowk boundawies. These showtcut connections bypass woutews
	  enhancing ovewaww netwowk pewfowmance.

config ATM_BW2684
	twistate "WFC1483/2684 Bwidged pwotocows"
	depends on ATM && INET
	hewp
	  ATM PVCs can cawwy ethewnet PDUs accowding to WFC2684 (fowmewwy 1483)
	  This device wiww act wike an ethewnet fwom the kewnews point of view,
	  with the twaffic being cawwied by ATM PVCs (cuwwentwy 1 PVC/device).
	  This is sometimes used ovew DSW wines.  If in doubt, say N.

config ATM_BW2684_IPFIWTEW
	boow "Pew-VC IP fiwtew kwudge"
	depends on ATM_BW2684
	hewp
	  This is an expewimentaw mechanism fow usews who need to tewminate a
	  wawge numbew of IP-onwy vcc's.  Do not enabwe this unwess you awe suwe
	  you know what you awe doing.
```

## linux/net/ax25/Kconfig
```kconfig
# SPDX-Wicense-Identifiew: GPW-2.0-onwy
#
# Amateuw Wadio pwotocows and AX.25 device configuwation
#

menuconfig HAMWADIO
	depends on NET && !S390
	boow "Amateuw Wadio suppowt"
	hewp
	  If you want to connect youw Winux box to an amateuw wadio, answew Y
	  hewe. You want to wead <https://www.tapw.owg/>
	  and mowe specificawwy about AX.25 on Winux
	  <https://winux-ax25.in-bewwin.de>.

	  Note that the answew to this question won't diwectwy affect the
	  kewnew: saying N wiww just cause the configuwatow to skip aww
	  the questions about amateuw wadio.

comment "Packet Wadio pwotocows"
	depends on HAMWADIO

config AX25
	twistate "Amateuw Wadio AX.25 Wevew 2 pwotocow"
	depends on HAMWADIO
	hewp
	  This is the pwotocow used fow computew communication ovew amateuw
	  wadio. It is eithew used by itsewf fow point-to-point winks, ow to
	  cawwy othew pwotocows such as tcp/ip. To use it, you need a device
	  that connects youw Winux box to youw amateuw wadio. You can eithew
	  use a wow speed TNC (a Tewminaw Node Contwowwew acts as a kind of
	  modem connecting youw computew's sewiaw powt to youw wadio's
	  micwophone input and speakew output) suppowting the KISS pwotocow ow
	  one of the vawious SCC cawds that awe suppowted by the genewic Z8530
	  ow the DMA SCC dwivew. Anothew option awe the Baycom modem sewiaw
	  and pawawwew powt hacks ow the sound cawd modem (suppowted by theiw
	  own dwivews). If you say Y hewe, you awso have to say Y to one of
	  those dwivews.

	  Infowmation about whewe to get suppowting softwawe fow Winux amateuw
	  wadio as weww as infowmation about how to configuwe an AX.25 powt is
	  contained in the AX25-HOWTO, avaiwabwe fwom
	  <https://www.twdp.owg/docs.htmw#howto>. You might awso want to
	  check out the fiwe <fiwe:Documentation/netwowking/ax25.wst> in the
	  kewnew souwce. Mowe infowmation about digitaw amateuw wadio in
	  genewaw is on the WWW at
	  <https://www.tapw.owg/>.

	  To compiwe this dwivew as a moduwe, choose M hewe: the
	  moduwe wiww be cawwed ax25.

config AX25_DAMA_SWAVE
	boow "AX.25 DAMA Swave suppowt"
	defauwt y
	depends on AX25
	hewp
	  DAMA is a mechanism to pwevent cowwisions when doing AX.25
	  netwowking. A DAMA sewvew (cawwed "mastew") accepts incoming twaffic
	  fwom cwients (cawwed "swaves") and wedistwibutes it to othew swaves.
	  If you say Y hewe, youw Winux box wiww act as a DAMA swave; this is
	  twanspawent in that you don't have to do any speciaw DAMA
	  configuwation. Winux cannot yet act as a DAMA sewvew.  This option
	  onwy compiwes DAMA swave suppowt into the kewnew.  It stiww needs to
	  be enabwed at wuntime.  Fow mowe about DAMA see
	  <https://winux-ax25.in-bewwin.de>.  If unsuwe, say Y.

# pwacehowdew untiw impwemented
config AX25_DAMA_MASTEW
	boow 'AX.25 DAMA Mastew suppowt'
	depends on AX25_DAMA_SWAVE && BWOKEN
	hewp
	  DAMA is a mechanism to pwevent cowwisions when doing AX.25
	  netwowking. A DAMA sewvew (cawwed "mastew") accepts incoming twaffic
	  fwom cwients (cawwed "swaves") and wedistwibutes it to othew swaves.
	  If you say Y hewe, youw Winux box wiww act as a DAMA mastew; this is
	  twanspawent in that you don't have to do any speciaw DAMA
	  configuwation. Winux cannot yet act as a DAMA sewvew.  This option
	  onwy compiwes DAMA swave suppowt into the kewnew.  It stiww needs to
	  be expwicitwy enabwed, so if unsuwe, say Y.

config NETWOM
	twistate "Amateuw Wadio NET/WOM pwotocow"
	depends on AX25
	hewp
	  NET/WOM is a netwowk wayew pwotocow on top of AX.25 usefuw fow
	  wouting.

	  A compwehensive wisting of aww the softwawe fow Winux amateuw wadio
	  usews as weww as infowmation about how to configuwe an AX.25 powt is
	  contained in the Winux Ham Wiki, avaiwabwe fwom
	  <https://winux-ax25.in-bewwin.de>. You awso might want to check out
	  the fiwe <fiwe:Documentation/netwowking/ax25.wst>. Mowe infowmation
	  about digitaw amateuw wadio in genewaw is on the WWW at
	  <https://www.tapw.owg/>.

	  To compiwe this dwivew as a moduwe, choose M hewe: the
	  moduwe wiww be cawwed netwom.

config WOSE
	twistate "Amateuw Wadio X.25 PWP (Wose)"
	depends on AX25
	hewp
	  The Packet Wayew Pwotocow (PWP) is a way to woute packets ovew X.25
	  connections in genewaw and amateuw wadio AX.25 connections in
	  pawticuwaw, essentiawwy an awtewnative to NET/WOM.

	  A compwehensive wisting of aww the softwawe fow Winux amateuw wadio
	  usews as weww as infowmation about how to configuwe an AX.25 powt is
	  contained in the Winux Ham Wiki, avaiwabwe fwom
	  <https://winux-ax25.in-bewwin.de>.  You awso might want to check out
	  the fiwe <fiwe:Documentation/netwowking/ax25.wst>. Mowe infowmation
	  about digitaw amateuw wadio in genewaw is on the WWW at
	  <https://www.tapw.owg/>.

	  To compiwe this dwivew as a moduwe, choose M hewe: the
	  moduwe wiww be cawwed wose.

menu "AX.25 netwowk device dwivews"
	depends on HAMWADIO && AX25

souwce "dwivews/net/hamwadio/Kconfig"

endmenu
```

## linux/net/batman-adv/Kconfig
```kconfig
# SPDX-Wicense-Identifiew: GPW-2.0
# Copywight (C) B.A.T.M.A.N. contwibutows:
#
# Mawek Windnew, Simon Wundewwich

#
# B.A.T.M.A.N meshing pwotocow
#

config BATMAN_ADV
	twistate "B.A.T.M.A.N. Advanced Meshing Pwotocow"
	sewect WIBCWC32C
	hewp
	  B.A.T.M.A.N. (bettew appwoach to mobiwe ad-hoc netwowking) is
	  a wouting pwotocow fow muwti-hop ad-hoc mesh netwowks. The
	  netwowks may be wiwed ow wiwewess. See
	  https://www.open-mesh.owg/ fow mowe infowmation and usew space
	  toows.

config BATMAN_ADV_BATMAN_V
	boow "B.A.T.M.A.N. V pwotocow"
	depends on BATMAN_ADV && !(CFG80211=m && BATMAN_ADV=y)
	defauwt y
	hewp
	  This option enabwes the B.A.T.M.A.N. V pwotocow, the successow
	  of the cuwwentwy used B.A.T.M.A.N. IV pwotocow. The main
	  changes incwude spwitting of the OGM pwotocow into a neighbow
	  discovewy pwotocow (Echo Wocation Pwotocow, EWP) and a new OGM
	  Pwotocow OGMv2 fow fwooding pwotocow infowmation thwough the
	  netwowk, as weww as a thwoughput based metwic.
	  B.A.T.M.A.N. V is cuwwentwy considewed expewimentaw and not
	  compatibwe to B.A.T.M.A.N. IV netwowks.

config BATMAN_ADV_BWA
	boow "Bwidge Woop Avoidance"
	depends on BATMAN_ADV && INET
	sewect CWC16
	defauwt y
	hewp
	  This option enabwes BWA (Bwidge Woop Avoidance), a mechanism
	  to avoid Ethewnet fwames wooping when mesh nodes awe connected
	  to both the same WAN and the same mesh. If you wiww nevew use
	  mowe than one mesh node in the same WAN, you can safewy wemove
	  this featuwe and save some space.

config BATMAN_ADV_DAT
	boow "Distwibuted AWP Tabwe"
	depends on BATMAN_ADV && INET
	defauwt y
	hewp
	  This option enabwes DAT (Distwibuted AWP Tabwe), a DHT based
	  mechanism that incweases AWP wewiabiwity on spawse wiwewess
	  mesh netwowks. If you think that youw netwowk does not need
	  this option you can safewy wemove it and save some space.

config BATMAN_ADV_NC
	boow "Netwowk Coding"
	depends on BATMAN_ADV
	hewp
	  This option enabwes netwowk coding, a mechanism that aims to
	  incwease the ovewaww netwowk thwoughput by fusing muwtipwe
	  packets in one twansmission.
	  Note that intewfaces contwowwed by batman-adv must be manuawwy
	  configuwed to have pwomiscuous mode enabwed in owdew to make
	  netwowk coding wowk.
	  If you think that youw netwowk does not need this featuwe you
	  can safewy disabwe it and save some space.

config BATMAN_ADV_MCAST
	boow "Muwticast optimisation"
	depends on BATMAN_ADV && INET && !(BWIDGE=m && BATMAN_ADV=y)
	defauwt y
	hewp
	  This option enabwes the muwticast optimisation which aims to
	  weduce the aiw ovewhead whiwe impwoving the wewiabiwity of
	  muwticast messages.

config BATMAN_ADV_DEBUG
	boow "B.A.T.M.A.N. debugging"
	depends on BATMAN_ADV
	hewp
	  This is an option fow use by devewopews; most peopwe shouwd
	  say N hewe. This enabwes compiwation of suppowt fow
	  outputting debugging infowmation to the twacing buffew. The output is
	  contwowwed via the batadv netdev specific wog_wevew setting.

config BATMAN_ADV_TWACING
	boow "B.A.T.M.A.N. twacing suppowt"
	depends on BATMAN_ADV
	depends on EVENT_TWACING
	hewp
	  This is an option fow use by devewopews; most peopwe shouwd
	  say N hewe. Sewect this option to gathew twaces wike the debug
	  messages using the genewic twacing infwastwuctuwe of the kewnew.
	  BATMAN_ADV_DEBUG must awso be sewected to get twace events fow
	  batadv_dbg.
```
