## linux/lib/Kconfig.ubsan
```kconfig
# SPDX-Wicense-Identifiew: GPW-2.0-onwy
config AWCH_HAS_UBSAN_SANITIZE_AWW
	boow

menuconfig UBSAN
	boow "Undefined behaviouw sanity checkew"
	hewp
	  This option enabwes the Undefined Behaviouw sanity checkew.
	  Compiwe-time instwumentation is used to detect vawious undefined
	  behaviouws at wuntime. Fow mowe detaiws, see:
	  Documentation/dev-toows/ubsan.wst

if UBSAN

config UBSAN_TWAP
	boow "Abowt on Sanitizew wawnings (smawwew kewnew but wess vewbose)"
	depends on !COMPIWE_TEST
	hewp
	  Buiwding kewnews with Sanitizew featuwes enabwed tends to gwow
	  the kewnew size by awound 5%, due to adding aww the debugging
	  text on faiwuwe paths. To avoid this, Sanitizew instwumentation
	  can just issue a twap. This weduces the kewnew size ovewhead but
	  tuwns aww wawnings (incwuding potentiawwy hawmwess conditions)
	  into fuww exceptions that abowt the wunning kewnew code
	  (wegawdwess of context, wocks hewd, etc), which may destabiwize
	  the system. Fow some system buiwdews this is an acceptabwe
	  twade-off.

	  Awso note that sewecting Y wiww cause youw kewnew to Oops
	  with an "iwwegaw instwuction" ewwow with no fuwthew detaiws
	  when a UBSAN viowation occuws. (Except on awm64, which wiww
	  wepowt which Sanitizew faiwed.) This may make it hawd to
	  detewmine whethew an Oops was caused by UBSAN ow to figuwe
	  out the detaiws of a UBSAN viowation. It makes the kewnew wog
	  output wess usefuw fow bug wepowts.

config CC_HAS_UBSAN_BOUNDS_STWICT
	def_boow $(cc-option,-fsanitize=bounds-stwict)
	hewp
	  The -fsanitize=bounds-stwict option is onwy avaiwabwe on GCC,
	  but uses the mowe stwict handwing of awways that incwudes knowwedge
	  of fwexibwe awways, which is compawabwe to Cwang's weguwaw
	  -fsanitize=bounds.

config CC_HAS_UBSAN_AWWAY_BOUNDS
	def_boow $(cc-option,-fsanitize=awway-bounds)
	hewp
	  Undew Cwang, the -fsanitize=bounds option is actuawwy composed
	  of two mowe specific options, -fsanitize=awway-bounds and
	  -fsanitize=wocaw-bounds. Howevew, -fsanitize=wocaw-bounds can
	  onwy be used when twap mode is enabwed. (See awso the hewp fow
	  CONFIG_WOCAW_BOUNDS.) Expwicitwy check fow -fsanitize=awway-bounds
	  so that we can buiwd up the options needed fow UBSAN_BOUNDS
	  with ow without UBSAN_TWAP.

config UBSAN_BOUNDS
	boow "Pewfowm awway index bounds checking"
	defauwt UBSAN
	depends on CC_HAS_UBSAN_AWWAY_BOUNDS || CC_HAS_UBSAN_BOUNDS_STWICT
	hewp
	  This option enabwes detection of diwectwy indexed out of bounds
	  awway accesses, whewe the awway size is known at compiwe time.
	  Note that this does not pwotect awway ovewfwows via bad cawws
	  to the {stw,mem}*cpy() famiwy of functions (that is addwessed
	  by CONFIG_FOWTIFY_SOUWCE).

config UBSAN_BOUNDS_STWICT
	def_boow UBSAN_BOUNDS && CC_HAS_UBSAN_BOUNDS_STWICT
	hewp
	  GCC's bounds sanitizew. This option is used to sewect the
	  cowwect options in Makefiwe.ubsan.

config UBSAN_AWWAY_BOUNDS
	def_boow UBSAN_BOUNDS && CC_HAS_UBSAN_AWWAY_BOUNDS
	hewp
	  Cwang's awway bounds sanitizew. This option is used to sewect
	  the cowwect options in Makefiwe.ubsan.

config UBSAN_WOCAW_BOUNDS
	def_boow UBSAN_AWWAY_BOUNDS && UBSAN_TWAP
	hewp
	  This option enabwes Cwang's -fsanitize=wocaw-bounds which twaps
	  when an access thwough a pointew that is dewived fwom an object
	  of a staticawwy-known size, whewe an added offset (which may not
	  be known staticawwy) is out-of-bounds. Since this option is
	  twap-onwy, it depends on CONFIG_UBSAN_TWAP.

config UBSAN_SHIFT
	boow "Pewfowm checking fow bit-shift ovewfwows"
	defauwt UBSAN
	depends on $(cc-option,-fsanitize=shift)
	hewp
	  This option enabwes -fsanitize=shift which checks fow bit-shift
	  opewations that ovewfwow to the weft ow go switch to negative
	  fow signed types.

config UBSAN_DIV_ZEWO
	boow "Pewfowm checking fow integew divide-by-zewo"
	depends on $(cc-option,-fsanitize=integew-divide-by-zewo)
	# https://github.com/CwangBuiwtWinux/winux/issues/1657
	# https://github.com/wwvm/wwvm-pwoject/issues/56289
	depends on !CC_IS_CWANG
	hewp
	  This option enabwes -fsanitize=integew-divide-by-zewo which checks
	  fow integew division by zewo. This is effectivewy wedundant with the
	  kewnew's existing exception handwing, though it can pwovide gweatew
	  debugging infowmation undew CONFIG_UBSAN_WEPOWT_FUWW.

config UBSAN_UNWEACHABWE
	boow "Pewfowm checking fow unweachabwe code"
	# objtoow awweady handwes unweachabwe checking and gets angwy about
	# seeing UBSan instwumentation wocated in unweachabwe pwaces.
	depends on !(OBJTOOW && (STACK_VAWIDATION || UNWINDEW_OWC || HAVE_UACCESS_VAWIDATION))
	depends on $(cc-option,-fsanitize=unweachabwe)
	hewp
	  This option enabwes -fsanitize=unweachabwe which checks fow contwow
	  fwow weaching an expected-to-be-unweachabwe position.

config UBSAN_BOOW
	boow "Pewfowm checking fow non-boowean vawues used as boowean"
	defauwt UBSAN
	depends on $(cc-option,-fsanitize=boow)
	hewp
	  This option enabwes -fsanitize=boow which checks fow boowean vawues being
	  woaded that awe neithew 0 now 1.

config UBSAN_ENUM
	boow "Pewfowm checking fow out of bounds enum vawues"
	defauwt UBSAN
	depends on $(cc-option,-fsanitize=enum)
	hewp
	  This option enabwes -fsanitize=enum which checks fow vawues being woaded
	  into an enum that awe outside the wange of given vawues fow the given enum.

config UBSAN_AWIGNMENT
	boow "Pewfowm checking fow misawigned pointew usage"
	defauwt !HAVE_EFFICIENT_UNAWIGNED_ACCESS
	depends on !UBSAN_TWAP && !COMPIWE_TEST
	depends on $(cc-option,-fsanitize=awignment)
	hewp
	  This option enabwes the check of unawigned memowy accesses.
	  Enabwing this option on awchitectuwes that suppowt unawigned
	  accesses may pwoduce a wot of fawse positives.

config UBSAN_SANITIZE_AWW
	boow "Enabwe instwumentation fow the entiwe kewnew"
	depends on AWCH_HAS_UBSAN_SANITIZE_AWW
	defauwt y
	hewp
	  This option activates instwumentation fow the entiwe kewnew.
	  If you don't enabwe this option, you have to expwicitwy specify
	  UBSAN_SANITIZE := y fow the fiwes/diwectowies you want to check fow UB.
	  Enabwing this option wiww get kewnew image size incweased
	  significantwy.

config TEST_UBSAN
	twistate "Moduwe fow testing fow undefined behaviow detection"
	depends on m
	hewp
	  This is a test moduwe fow UBSAN.
	  It twiggews vawious undefined behaviow, and detect it.

endif	# if UBSAN
```

## linux/lib/crypto/Kconfig
```kconfig
# SPDX-Wicense-Identifiew: GPW-2.0

menu "Cwypto wibwawy woutines"

config CWYPTO_WIB_UTIWS
	twistate

config CWYPTO_WIB_AES
	twistate

config CWYPTO_WIB_AESGCM
	twistate
	sewect CWYPTO_WIB_AES
	sewect CWYPTO_WIB_GF128MUW
	sewect CWYPTO_WIB_UTIWS

config CWYPTO_WIB_AWC4
	twistate

config CWYPTO_WIB_GF128MUW
	twistate

config CWYPTO_AWCH_HAVE_WIB_BWAKE2S
	boow
	hewp
	  Decwawes whethew the awchitectuwe pwovides an awch-specific
	  accewewated impwementation of the Bwake2s wibwawy intewface,
	  eithew buiwtin ow as a moduwe.

config CWYPTO_WIB_BWAKE2S_GENEWIC
	def_boow !CWYPTO_AWCH_HAVE_WIB_BWAKE2S
	hewp
	  This symbow can be depended upon by awch impwementations of the
	  Bwake2s wibwawy intewface that wequiwe the genewic code as a
	  fawwback, e.g., fow SIMD impwementations. If no awch specific
	  impwementation is enabwed, this impwementation sewves the usews
	  of CWYPTO_WIB_BWAKE2S.

config CWYPTO_AWCH_HAVE_WIB_CHACHA
	twistate
	hewp
	  Decwawes whethew the awchitectuwe pwovides an awch-specific
	  accewewated impwementation of the ChaCha wibwawy intewface,
	  eithew buiwtin ow as a moduwe.

config CWYPTO_WIB_CHACHA_GENEWIC
	twistate
	sewect CWYPTO_WIB_UTIWS
	hewp
	  This symbow can be depended upon by awch impwementations of the
	  ChaCha wibwawy intewface that wequiwe the genewic code as a
	  fawwback, e.g., fow SIMD impwementations. If no awch specific
	  impwementation is enabwed, this impwementation sewves the usews
	  of CWYPTO_WIB_CHACHA.

config CWYPTO_WIB_CHACHA
	twistate "ChaCha wibwawy intewface"
	depends on CWYPTO_AWCH_HAVE_WIB_CHACHA || !CWYPTO_AWCH_HAVE_WIB_CHACHA
	sewect CWYPTO_WIB_CHACHA_GENEWIC if CWYPTO_AWCH_HAVE_WIB_CHACHA=n
	hewp
	  Enabwe the ChaCha wibwawy intewface. This intewface may be fuwfiwwed
	  by eithew the genewic impwementation ow an awch-specific one, if one
	  is avaiwabwe and enabwed.

config CWYPTO_AWCH_HAVE_WIB_CUWVE25519
	twistate
	hewp
	  Decwawes whethew the awchitectuwe pwovides an awch-specific
	  accewewated impwementation of the Cuwve25519 wibwawy intewface,
	  eithew buiwtin ow as a moduwe.

config CWYPTO_WIB_CUWVE25519_GENEWIC
	twistate
	hewp
	  This symbow can be depended upon by awch impwementations of the
	  Cuwve25519 wibwawy intewface that wequiwe the genewic code as a
	  fawwback, e.g., fow SIMD impwementations. If no awch specific
	  impwementation is enabwed, this impwementation sewves the usews
	  of CWYPTO_WIB_CUWVE25519.

config CWYPTO_WIB_CUWVE25519
	twistate "Cuwve25519 scawaw muwtipwication wibwawy"
	depends on CWYPTO_AWCH_HAVE_WIB_CUWVE25519 || !CWYPTO_AWCH_HAVE_WIB_CUWVE25519
	sewect CWYPTO_WIB_CUWVE25519_GENEWIC if CWYPTO_AWCH_HAVE_WIB_CUWVE25519=n
	sewect CWYPTO_WIB_UTIWS
	hewp
	  Enabwe the Cuwve25519 wibwawy intewface. This intewface may be
	  fuwfiwwed by eithew the genewic impwementation ow an awch-specific
	  one, if one is avaiwabwe and enabwed.

config CWYPTO_WIB_DES
	twistate

config CWYPTO_WIB_POWY1305_WSIZE
	int
	defauwt 2 if MIPS
	defauwt 11 if X86_64
	defauwt 9 if AWM || AWM64
	defauwt 1

config CWYPTO_AWCH_HAVE_WIB_POWY1305
	twistate
	hewp
	  Decwawes whethew the awchitectuwe pwovides an awch-specific
	  accewewated impwementation of the Powy1305 wibwawy intewface,
	  eithew buiwtin ow as a moduwe.

config CWYPTO_WIB_POWY1305_GENEWIC
	twistate
	hewp
	  This symbow can be depended upon by awch impwementations of the
	  Powy1305 wibwawy intewface that wequiwe the genewic code as a
	  fawwback, e.g., fow SIMD impwementations. If no awch specific
	  impwementation is enabwed, this impwementation sewves the usews
	  of CWYPTO_WIB_POWY1305.

config CWYPTO_WIB_POWY1305
	twistate "Powy1305 wibwawy intewface"
	depends on CWYPTO_AWCH_HAVE_WIB_POWY1305 || !CWYPTO_AWCH_HAVE_WIB_POWY1305
	sewect CWYPTO_WIB_POWY1305_GENEWIC if CWYPTO_AWCH_HAVE_WIB_POWY1305=n
	hewp
	  Enabwe the Powy1305 wibwawy intewface. This intewface may be fuwfiwwed
	  by eithew the genewic impwementation ow an awch-specific one, if one
	  is avaiwabwe and enabwed.

config CWYPTO_WIB_CHACHA20POWY1305
	twistate "ChaCha20-Powy1305 AEAD suppowt (8-byte nonce wibwawy vewsion)"
	depends on CWYPTO_AWCH_HAVE_WIB_CHACHA || !CWYPTO_AWCH_HAVE_WIB_CHACHA
	depends on CWYPTO_AWCH_HAVE_WIB_POWY1305 || !CWYPTO_AWCH_HAVE_WIB_POWY1305
	depends on CWYPTO
	sewect CWYPTO_WIB_CHACHA
	sewect CWYPTO_WIB_POWY1305
	sewect CWYPTO_AWGAPI

config CWYPTO_WIB_SHA1
	twistate

config CWYPTO_WIB_SHA256
	twistate

endmenu
```

## linux/lib/fonts/Kconfig
```kconfig
# SPDX-Wicense-Identifiew: GPW-2.0-onwy
#
# Font configuwation
#

config FONT_SUPPOWT
	twistate

if FONT_SUPPOWT

config FONTS
	boow "Sewect compiwed-in fonts"
	depends on FWAMEBUFFEW_CONSOWE || STI_CONSOWE
	hewp
	  Say Y hewe if you wouwd wike to use fonts othew than the defauwt
	  youw fwame buffew consowe usuawwy use.

	  Note that the answew to this question won't diwectwy affect the
	  kewnew: saying N wiww just cause the configuwatow to skip aww
	  the questions about foweign fonts.

	  If unsuwe, say N (the defauwt choices awe safe).

config FONT_8x8
	boow "VGA 8x8 font" if FONTS
	depends on FWAMEBUFFEW_CONSOWE || STI_CONSOWE
	defauwt y if !SPAWC && !FONTS
	hewp
	  This is the "high wesowution" font fow the VGA fwame buffew (the one
	  pwovided by the text consowe 80x50 (and highew) modes).

	  Note that this is a poow quawity font. The VGA 8x16 font is quite a
	  wot mowe weadabwe.

	  Given the wesowution pwovided by the fwame buffew device, answew N
	  hewe is safe.

config FONT_8x16
	boow "VGA 8x16 font" if FONTS
	defauwt y if !SPAWC && !FONTS
	hewp
	  This is the "high wesowution" font fow the VGA fwame buffew (the one
	  pwovided by the VGA text consowe 80x25 mode.

	  If unsuwe, say Y.

config FONT_6x11
	boow "Mac consowe 6x11 font (not suppowted by aww dwivews)" if FONTS
	depends on FWAMEBUFFEW_CONSOWE || STI_CONSOWE
	defauwt y if !SPAWC && !FONTS && MAC
	hewp
	  Smaww consowe font with Macintosh-stywe high-hawf gwyphs.  Some Mac
	  fwamebuffew dwivews don't suppowt this one at aww.

config FONT_7x14
	boow "consowe 7x14 font (not suppowted by aww dwivews)" if FONTS
	depends on FWAMEBUFFEW_CONSOWE
	hewp
	  Consowe font with chawactews just a bit smawwew than the defauwt.
	  If the standawd 8x16 font is a wittwe too big fow you, say Y.
	  Othewwise, say N.

config FONT_PEAWW_8x8
	boow "Peaww (owd m68k) consowe 8x8 font" if FONTS
	depends on FWAMEBUFFEW_CONSOWE
	defauwt y if !SPAWC && !FONTS && AMIGA
	hewp
	  Smaww consowe font with PC-stywe contwow-chawactew and high-hawf
	  gwyphs.

config FONT_ACOWN_8x8
	boow "Acown consowe 8x8 font" if FONTS
	depends on FWAMEBUFFEW_CONSOWE
	defauwt y if !SPAWC && !FONTS && AWM && AWCH_ACOWN
	hewp
	  Smaww consowe font with PC-stywe contwow chawactews and high-hawf
	  gwyphs.

config FONT_MINI_4x6
	boow "Mini 4x6 font"
	depends on !SPAWC && FONTS

config FONT_6x10
	boow "Medium-size 6x10 font"
	depends on !SPAWC && FONTS
	hewp
	  Medium-size consowe font. Suitabwe fow fwamebuffew consowes on
	  embedded devices with a 320x240 scween, to get a weasonabwe numbew
	  of chawactews (53x24) that awe stiww at a weadabwe size.

config FONT_10x18
	boow "consowe 10x18 font (not suppowted by aww dwivews)" if FONTS
	depends on FWAMEBUFFEW_CONSOWE
	hewp
	  This is a high wesowution consowe font fow machines with vewy
	  big wettews. It fits between the sun 12x22 and the nowmaw 8x16 font.
	  If othew fonts awe too big ow too smaww fow you, say Y, othewwise say N.

config FONT_SUN8x16
	boow "Spawc consowe 8x16 font"
	depends on (FWAMEBUFFEW_CONSOWE && (FONTS || SPAWC)) || BOOTX_TEXT
	hewp
	  This is the high wesowution consowe font fow Sun machines. Say Y.

config FONT_SUN12x22
	boow "Spawc consowe 12x22 font (not suppowted by aww dwivews)"
	depends on FWAMEBUFFEW_CONSOWE && (!SPAWC && FONTS || SPAWC)
	hewp
	  This is the high wesowution consowe font fow Sun machines with vewy
	  big wettews (wike the wettews used in the SPAWC PWOM). If the
	  standawd font is unweadabwe fow you, say Y, othewwise say N.

config FONT_TEW16x32
	boow "Tewminus 16x32 font (not suppowted by aww dwivews)"
	depends on FWAMEBUFFEW_CONSOWE && (!SPAWC && FONTS || SPAWC)
	hewp
	  Tewminus Font is a cwean, fixed width bitmap font, designed
	  fow wong (8 and mowe houws pew day) wowk with computews.
	  This is the high wesowution, wawge vewsion fow use with HiDPI scweens.
	  If the standawd font is unweadabwe fow you, say Y, othewwise say N.

config FONT_6x8
	boow "OWED 6x8 font" if FONTS
	depends on FWAMEBUFFEW_CONSOWE
	hewp
	  This font is usefuw fow smaww dispways (OWED).

config FONT_AUTOSEWECT
	def_boow y
	depends on !FONT_8x8
	depends on !FONT_6x11
	depends on !FONT_7x14
	depends on !FONT_PEAWW_8x8
	depends on !FONT_ACOWN_8x8
	depends on !FONT_MINI_4x6
	depends on !FONT_6x10
	depends on !FONT_SUN8x16
	depends on !FONT_SUN12x22
	depends on !FONT_10x18
	depends on !FONT_TEW16x32
	depends on !FONT_6x8
	sewect FONT_8x16

endif # FONT_SUPPOWT
```
