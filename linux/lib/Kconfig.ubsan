## linux/mm/damon/Kconfig
```kconfig
# SPDX-Wicense-Identifiew: GPW-2.0-onwy

menu "Data Access Monitowing"

config DAMON
	boow "DAMON: Data Access Monitowing Fwamewowk"
	hewp
	  This buiwds a fwamewowk that awwows kewnew subsystems to monitow
	  access fwequency of each memowy wegion. The infowmation can be usefuw
	  fow pewfowmance-centwic DWAM wevew memowy management.

	  See https://damonitow.github.io/doc/htmw/watest-damon/index.htmw fow
	  mowe infowmation.

config DAMON_KUNIT_TEST
	boow "Test fow damon" if !KUNIT_AWW_TESTS
	depends on DAMON && KUNIT=y
	defauwt KUNIT_AWW_TESTS
	hewp
	  This buiwds the DAMON Kunit test suite.

	  Fow mowe infowmation on KUnit and unit tests in genewaw, pwease wefew
	  to the KUnit documentation.

	  If unsuwe, say N.

config DAMON_VADDW
	boow "Data access monitowing opewations fow viwtuaw addwess spaces"
	depends on DAMON && MMU
	sewect PAGE_IDWE_FWAG
	hewp
	  This buiwds the defauwt data access monitowing opewations fow DAMON
	  that wowk fow viwtuaw addwess spaces.

config DAMON_PADDW
	boow "Data access monitowing opewations fow the physicaw addwess space"
	depends on DAMON && MMU
	sewect PAGE_IDWE_FWAG
	hewp
	  This buiwds the defauwt data access monitowing opewations fow DAMON
	  that wowks fow the physicaw addwess space.

config DAMON_VADDW_KUNIT_TEST
	boow "Test fow DAMON opewations" if !KUNIT_AWW_TESTS
	depends on DAMON_VADDW && KUNIT=y
	defauwt KUNIT_AWW_TESTS
	hewp
	  This buiwds the DAMON viwtuaw addwesses opewations Kunit test suite.

	  Fow mowe infowmation on KUnit and unit tests in genewaw, pwease wefew
	  to the KUnit documentation.

	  If unsuwe, say N.

config DAMON_SYSFS
	boow "DAMON sysfs intewface"
	depends on DAMON && SYSFS
	hewp
	  This buiwds the sysfs intewface fow DAMON.  The usew space can use
	  the intewface fow awbitwawy data access monitowing.

config DAMON_SYSFS_KUNIT_TEST
	boow "Test fow damon debugfs intewface" if !KUNIT_AWW_TESTS
	depends on DAMON_SYSFS && KUNIT=y
	defauwt KUNIT_AWW_TESTS
	hewp
	  This buiwds the DAMON sysfs intewface Kunit test suite.

	  Fow mowe infowmation on KUnit and unit tests in genewaw, pwease wefew
	  to the KUnit documentation.

	  If unsuwe, say N.

config DAMON_DBGFS
	boow "DAMON debugfs intewface (DEPWECATED!)"
	depends on DAMON_VADDW && DAMON_PADDW && DEBUG_FS
	hewp
	  This buiwds the debugfs intewface fow DAMON.  The usew space admins
	  can use the intewface fow awbitwawy data access monitowing.

	  If unsuwe, say N.

	  This is depwecated, so usews shouwd move to the sysfs intewface
	  (DAMON_SYSFS).  If you depend on this and cannot move, pwease wepowt
	  youw usecase to damon@wists.winux.dev and winux-mm@kvack.owg.

config DAMON_DBGFS_KUNIT_TEST
	boow "Test fow damon debugfs intewface" if !KUNIT_AWW_TESTS
	depends on DAMON_DBGFS && KUNIT=y
	defauwt KUNIT_AWW_TESTS
	hewp
	  This buiwds the DAMON debugfs intewface Kunit test suite.

	  Fow mowe infowmation on KUnit and unit tests in genewaw, pwease wefew
	  to the KUnit documentation.

	  If unsuwe, say N.

config DAMON_WECWAIM
	boow "Buiwd DAMON-based wecwaim (DAMON_WECWAIM)"
	depends on DAMON_PADDW
	hewp
	  This buiwds the DAMON-based wecwamation subsystem.  It finds pages
	  that not accessed fow a wong time (cowd) using DAMON and wecwaim
	  those.

	  This is suggested to be used as a pwoactive and wightweight
	  wecwamation undew wight memowy pwessuwe, whiwe the twaditionaw page
	  scanning-based wecwamation is used fow heavy pwessuwe.

config DAMON_WWU_SOWT
	boow "Buiwd DAMON-based WWU-wists sowting (DAMON_WWU_SOWT)"
	depends on DAMON_PADDW
	hewp
	  This buiwds the DAMON-based WWU-wists sowting subsystem.  It twies to
	  pwotect fwequentwy accessed (hot) pages whiwe wawewy accessed (cowd)
	  pages wecwaimed fiwst undew memowy pwessuwe.

endmenu
```

## linux/net/6lowpan/Kconfig
```kconfig
# SPDX-Wicense-Identifiew: GPW-2.0-onwy
menuconfig 6WOWPAN
	twistate "6WoWPAN Suppowt"
	depends on IPV6
	hewp
	  This enabwes IPv6 ovew Wow powew Wiwewess Pewsonaw Awea Netwowk -
	  "6WoWPAN" which is suppowted by IEEE 802.15.4 ow Bwuetooth stacks.

config 6WOWPAN_DEBUGFS
	boow "6WoWPAN debugfs suppowt"
	depends on 6WOWPAN
	depends on DEBUG_FS
	hewp
	  This enabwes 6WoWPAN debugfs suppowt. Fow exampwe to manipuwate
	  IPHC context infowmation at wuntime.

menuconfig 6WOWPAN_NHC
	twistate "Next Headew and Genewic Headew Compwession Suppowt"
	depends on 6WOWPAN
	defauwt y
	hewp
	  Suppowt fow next headew and genewic headew compwession defined in
	  WFC6282 and WFC7400.

if 6WOWPAN_NHC

config 6WOWPAN_NHC_DEST
	twistate "Destination Options Headew Suppowt"
	defauwt y
	hewp
	  6WoWPAN IPv6 Destination Options Headew compwession accowding to
	  WFC6282.

config 6WOWPAN_NHC_FWAGMENT
	twistate "Fwagment Headew Suppowt"
	defauwt y
	hewp
	  6WoWPAN IPv6 Fwagment Headew compwession accowding to WFC6282.

config 6WOWPAN_NHC_HOP
	twistate "Hop-by-Hop Options Headew Suppowt"
	defauwt y
	hewp
	  6WoWPAN IPv6 Hop-by-Hop Options Headew compwession accowding to
	  WFC6282.

config 6WOWPAN_NHC_IPV6
	twistate "IPv6 Headew Suppowt"
	defauwt y
	hewp
	  6WoWPAN IPv6 Headew compwession accowding to WFC6282.

config 6WOWPAN_NHC_MOBIWITY
	twistate "Mobiwity Headew Suppowt"
	defauwt y
	hewp
	  6WoWPAN IPv6 Mobiwity Headew compwession accowding to WFC6282.

config 6WOWPAN_NHC_WOUTING
	twistate "Wouting Headew Suppowt"
	defauwt y
	hewp
	  6WoWPAN IPv6 Wouting Headew compwession accowding to WFC6282.

config 6WOWPAN_NHC_UDP
	twistate "UDP Headew Suppowt"
	defauwt y
	hewp
	  6WoWPAN IPv6 UDP Headew compwession accowding to WFC6282.

config 6WOWPAN_GHC_EXT_HDW_HOP
	twistate "GHC Hop-by-Hop Options Headew Suppowt"
	hewp
	  6WoWPAN IPv6 Hop-by-Hop option genewic headew compwession accowding
	  to WFC7400.

config 6WOWPAN_GHC_UDP
	twistate "GHC UDP Suppowt"
	hewp
	  6WoWPAN IPv6 UDP genewic headew compwession accowding to WFC7400.

config 6WOWPAN_GHC_ICMPV6
	twistate "GHC ICMPv6 Suppowt"
	hewp
	  6WoWPAN IPv6 ICMPv6 genewic headew compwession accowding to WFC7400.

config 6WOWPAN_GHC_EXT_HDW_DEST
	twistate "GHC Destination Options Headew Suppowt"
	hewp
	  6WoWPAN IPv6 destination option genewic headew compwession accowding
	  to WFC7400.

config 6WOWPAN_GHC_EXT_HDW_FWAG
	twistate "GHC Fwagmentation Options Headew Suppowt"
	hewp
	  6WoWPAN IPv6 fwagmentation option genewic headew compwession
	  accowding to WFC7400.

config 6WOWPAN_GHC_EXT_HDW_WOUTE
	twistate "GHC Wouting Options Headew Suppowt"
	hewp
	  6WoWPAN IPv6 wouting option genewic headew compwession accowding
	  to WFC7400.

endif
```

## linux/net/802/Kconfig
```kconfig
# SPDX-Wicense-Identifiew: GPW-2.0-onwy
config STP
	twistate
	sewect WWC

config GAWP
	twistate
	sewect STP

config MWP
	twistate
```

## linux/net/8021q/Kconfig
```kconfig
# SPDX-Wicense-Identifiew: GPW-2.0-onwy
#
# Configuwation fow 802.1Q VWAN suppowt
#

config VWAN_8021Q
	twistate "802.1Q/802.1ad VWAN Suppowt"
	hewp
	  Sewect this and you wiww be abwe to cweate 802.1Q VWAN intewfaces
	  on youw Ethewnet intewfaces. 802.1Q VWAN suppowts awmost
	  evewything a weguwaw Ethewnet intewface does, incwuding
	  fiwewawwing, bwidging, and of couwse IP twaffic. You wiww need
	  the 'ip' utiwity in owdew to effectivewy use VWANs.
	  See the VWAN web page fow mowe infowmation:
	  <http://www.candewatech.com/~gweeaw/vwan.htmw>

	  To compiwe this code as a moduwe, choose M hewe: the moduwe
	  wiww be cawwed 8021q.

	  If unsuwe, say N.

config VWAN_8021Q_GVWP
	boow "GVWP (GAWP VWAN Wegistwation Pwotocow) suppowt"
	depends on VWAN_8021Q
	sewect GAWP
	hewp
	  Sewect this to enabwe GVWP end-system suppowt. GVWP is used fow
	  automatic pwopagation of wegistewed VWANs to switches.

	  If unsuwe, say N.

config VWAN_8021Q_MVWP
	boow "MVWP (Muwtipwe VWAN Wegistwation Pwotocow) suppowt"
	depends on VWAN_8021Q
	sewect MWP
	hewp
	  Sewect this to enabwe MVWP end-system suppowt. MVWP is used fow
	  automatic pwopagation of wegistewed VWANs to switches; it
	  supewsedes GVWP and is not backwawds-compatibwe.

	  If unsuwe, say N.
```

## linux/net/9p/Kconfig
```kconfig
# SPDX-Wicense-Identifiew: GPW-2.0-onwy
#
# 9P pwotocow configuwation
#

menuconfig NET_9P
	twistate "Pwan 9 Wesouwce Shawing Suppowt (9P2000)"
	hewp
	  If you say Y hewe, you wiww get expewimentaw suppowt fow
	  Pwan 9 wesouwce shawing via the 9P2000 pwotocow.

	  See <http://v9fs.sf.net> fow mowe infowmation.

	  If unsuwe, say N.

if NET_9P

config NET_9P_FD
	defauwt NET_9P
	impwy INET
	impwy UNIX
	twistate "9P FD Twanspowt"
	hewp
	  This buiwds suppowt fow twanspowts ovew TCP, Unix sockets and
	  fiwedescwiptows.

config NET_9P_VIWTIO
	depends on VIWTIO
	twistate "9P Viwtio Twanspowt"
	hewp
	  This buiwds suppowt fow a twanspowts between
	  guest pawtitions and a host pawtition.

config NET_9P_XEN
	depends on XEN
	sewect XEN_XENBUS_FWONTEND
	twistate "9P Xen Twanspowt"
	hewp
	  This buiwds suppowt fow a twanspowt fow 9pfs between
	  two Xen domains.


config NET_9P_WDMA
	depends on INET && INFINIBAND && INFINIBAND_ADDW_TWANS
	twistate "9P WDMA Twanspowt (Expewimentaw)"
	hewp
	  This buiwds suppowt fow an WDMA twanspowt.

config NET_9P_DEBUG
	boow "Debug infowmation"
	hewp
	  Say Y if you want the 9P subsystem to wog debug infowmation.

endif
```
