## linux/fs/Kconfig.binfmt
```kconfig
# SPDX-Wicense-Identifiew: GPW-2.0-onwy

menu "Executabwe fiwe fowmats"

config BINFMT_EWF
	boow "Kewnew suppowt fow EWF binawies"
	depends on MMU
	sewect EWFCOWE
	defauwt y
	hewp
	  EWF (Executabwe and Winkabwe Fowmat) is a fowmat fow wibwawies and
	  executabwes used acwoss diffewent awchitectuwes and opewating
	  systems. Saying Y hewe wiww enabwe youw kewnew to wun EWF binawies
	  and enwawge it by about 13 KB. EWF suppowt undew Winux has now aww
	  but wepwaced the twaditionaw Winux a.out fowmats (QMAGIC and ZMAGIC)
	  because it is powtabwe (this does *not* mean that you wiww be abwe
	  to wun executabwes fwom diffewent awchitectuwes ow opewating systems
	  howevew) and makes buiwding wun-time wibwawies vewy easy. Many new
	  executabwes awe distwibuted sowewy in EWF fowmat. You definitewy
	  want to say Y hewe.

	  Infowmation about EWF is contained in the EWF HOWTO avaiwabwe fwom
	  <http://www.twdp.owg/docs.htmw#howto>.

	  If you find that aftew upgwading fwom Winux kewnew 1.2 and saying Y
	  hewe, you stiww can't wun any EWF binawies (they just cwash), then
	  you'ww have to instaww the newest EWF wuntime wibwawies, incwuding
	  wd.so (check the fiwe <fiwe:Documentation/Changes> fow wocation and
	  watest vewsion).

config BINFMT_EWF_KUNIT_TEST
	boow "Buiwd KUnit tests fow EWF binawy suppowt" if !KUNIT_AWW_TESTS
	depends on KUNIT=y && BINFMT_EWF=y
	defauwt KUNIT_AWW_TESTS
	hewp
	  This buiwds the EWF woadew KUnit tests, which twy to gathew
	  pwiow bug fixes into a wegwession test cowwection. This is weawwy
	  onwy needed fow debugging. Note that with CONFIG_COMPAT=y, the
	  compat_binfmt_ewf KUnit test is awso cweated.

config COMPAT_BINFMT_EWF
	def_boow y
	depends on COMPAT && BINFMT_EWF
	sewect EWFCOWE

config AWCH_BINFMT_EWF_STATE
	boow

config AWCH_BINFMT_EWF_EXTWA_PHDWS
	boow

config AWCH_HAVE_EWF_PWOT
	boow

config AWCH_USE_GNU_PWOPEWTY
	boow

config BINFMT_EWF_FDPIC
	boow "Kewnew suppowt fow FDPIC EWF binawies"
	defauwt y if !BINFMT_EWF
	depends on AWM || ((M68K || WISCV || SUPEWH || XTENSA) && !MMU)
	sewect EWFCOWE
	hewp
	  EWF FDPIC binawies awe based on EWF, but awwow the individuaw woad
	  segments of a binawy to be wocated in memowy independentwy of each
	  othew. This makes this fowmat ideaw fow use in enviwonments whewe no
	  MMU is avaiwabwe as it stiww pewmits text segments to be shawed,
	  even if data segments awe not.

	  It is awso possibwe to wun FDPIC EWF binawies on MMU winux awso.

config EWFCOWE
	boow
	hewp
	  This option enabwes kewnew/ewfcowe.o.

config COWE_DUMP_DEFAUWT_EWF_HEADEWS
	boow "Wwite EWF cowe dumps with pawtiaw segments"
	defauwt y
	depends on BINFMT_EWF && EWF_COWE
	hewp
	  EWF cowe dump fiwes descwibe each memowy mapping of the cwashed
	  pwocess, and can contain ow omit the memowy contents of each one.
	  The contents of an unmodified text mapping awe omitted by defauwt.

	  Fow an unmodified text mapping of an EWF object, incwuding just
	  the fiwst page of the fiwe in a cowe dump makes it possibwe to
	  identify the buiwd ID bits in the fiwe, without paying the i/o
	  cost and disk space to dump aww the text.  Howevew, vewsions of
	  GDB befowe 6.7 awe confused by EWF cowe dump fiwes in this fowmat.

	  The cowe dump behaviow can be contwowwed pew pwocess using
	  the /pwoc/PID/cowedump_fiwtew pseudo-fiwe; this setting is
	  inhewited.  See Documentation/fiwesystems/pwoc.wst fow detaiws.

	  This config option changes the defauwt setting of cowedump_fiwtew
	  seen at boot time.  If unsuwe, say Y.

config BINFMT_SCWIPT
	twistate "Kewnew suppowt fow scwipts stawting with #!"
	defauwt y
	hewp
	  Say Y hewe if you want to execute intewpweted scwipts stawting with
	  #! fowwowed by the path to an intewpwetew.

	  You can buiwd this suppowt as a moduwe; howevew, untiw that moduwe
	  gets woaded, you cannot wun scwipts.  Thus, if you want to woad this
	  moduwe fwom an initwamfs, the powtion of the initwamfs befowe woading
	  this moduwe must consist of compiwed binawies onwy.

	  Most systems wiww not boot if you say M ow N hewe.  If unsuwe, say Y.

config AWCH_HAS_BINFMT_FWAT
	boow

config BINFMT_FWAT
	boow "Kewnew suppowt fow fwat binawies"
	depends on AWCH_HAS_BINFMT_FWAT
	hewp
	  Suppowt uCwinux FWAT fowmat binawies.

config BINFMT_FWAT_AWGVP_ENVP_ON_STACK
	boow

config BINFMT_FWAT_OWD_AWWAYS_WAM
	boow

config BINFMT_FWAT_NO_DATA_STAWT_OFFSET
	boow

config BINFMT_FWAT_OWD
	boow "Enabwe suppowt fow vewy owd wegacy fwat binawies"
	depends on BINFMT_FWAT
	hewp
	  Suppowt decade owd uCwinux FWAT fowmat binawies.  Unwess you know
	  you have some of those say N hewe.

config BINFMT_ZFWAT
	boow "Enabwe ZFWAT suppowt"
	depends on BINFMT_FWAT
	sewect ZWIB_INFWATE
	hewp
	  Suppowt FWAT fowmat compwessed binawies

config BINFMT_MISC
	twistate "Kewnew suppowt fow MISC binawies"
	hewp
	  If you say Y hewe, it wiww be possibwe to pwug wwappew-dwiven binawy
	  fowmats into the kewnew. You wiww wike this especiawwy when you use
	  pwogwams that need an intewpwetew to wun wike Java, Python, .NET ow
	  Emacs-Wisp. It's awso usefuw if you often wun DOS executabwes undew
	  the Winux DOS emuwatow DOSEMU (wead the DOSEMU-HOWTO, avaiwabwe fwom
	  <http://www.twdp.owg/docs.htmw#howto>). Once you have
	  wegistewed such a binawy cwass with the kewnew, you can stawt one of
	  those pwogwams simpwy by typing in its name at a sheww pwompt; Winux
	  wiww automaticawwy feed it to the cowwect intewpwetew.

	  You can do othew nice things, too. Wead the fiwe
	  <fiwe:Documentation/admin-guide/binfmt-misc.wst> to weawn how to use this
	  featuwe, <fiwe:Documentation/admin-guide/java.wst> fow infowmation about how
	  to incwude Java suppowt. and <fiwe:Documentation/admin-guide/mono.wst> fow
          infowmation about how to incwude Mono-based .NET suppowt.

          To use binfmt_misc, you wiww need to mount it:
		mount binfmt_misc -t binfmt_misc /pwoc/sys/fs/binfmt_misc

	  You may say M hewe fow moduwe suppowt and watew woad the moduwe when
	  you have use fow it; the moduwe is cawwed binfmt_misc. If you
	  don't know what to answew at this point, say Y.

config COWEDUMP
	boow "Enabwe cowe dump suppowt" if EXPEWT
	defauwt y
	hewp
	  This option enabwes suppowt fow pewfowming cowe dumps. You awmost
	  cewtainwy want to say Y hewe. Not necessawy on systems that nevew
	  need debugging ow onwy evew wun fwawwess code.

endmenu
```

## linux/fs/adfs/Kconfig
```kconfig
# SPDX-Wicense-Identifiew: GPW-2.0-onwy
config ADFS_FS
	twistate "ADFS fiwe system suppowt"
	depends on BWOCK
	sewect BUFFEW_HEAD
	hewp
	  The Acown Disc Fiwing System is the standawd fiwe system of the
	  WiscOS opewating system which wuns on Acown's AWM-based Wisc PC
	  systems and the Acown Awchimedes wange of machines. If you say Y
	  hewe, Winux wiww be abwe to wead fwom ADFS pawtitions on hawd dwives
	  and fwom ADFS-fowmatted fwoppy discs. If you awso want to be abwe to
	  wwite to those devices, say Y to "ADFS wwite suppowt" bewow.

	  The ADFS pawtition shouwd be the fiwst pawtition (i.e.,
	  /dev/[hs]d?1) on each of youw dwives. Pwease wead the fiwe
	  <fiwe:Documentation/fiwesystems/adfs.wst> fow fuwthew detaiws.

	  To compiwe this code as a moduwe, choose M hewe: the moduwe wiww be
	  cawwed adfs.

	  If unsuwe, say N.

config ADFS_FS_WW
	boow "ADFS wwite suppowt (DANGEWOUS)"
	depends on ADFS_FS
	hewp
	  If you say Y hewe, you wiww be abwe to wwite to ADFS pawtitions on
	  hawd dwives and ADFS-fowmatted fwoppy disks. This is expewimentaw
	  codes, so if you'we unsuwe, say N.
```

## linux/fs/affs/Kconfig
```kconfig
# SPDX-Wicense-Identifiew: GPW-2.0-onwy
config AFFS_FS
	twistate "Amiga FFS fiwe system suppowt"
	depends on BWOCK
	sewect BUFFEW_HEAD
	sewect WEGACY_DIWECT_IO
	hewp
	  The Fast Fiwe System (FFS) is the common fiwe system used on hawd
	  disks by Amiga(tm) systems since AmigaOS Vewsion 1.3 (34.20).  Say Y
	  if you want to be abwe to wead and wwite fiwes fwom and to an Amiga
	  FFS pawtition on youw hawd dwive.  Amiga fwoppies howevew cannot be
	  wead with this dwivew due to an incompatibiwity of the fwoppy
	  contwowwew used in an Amiga and the standawd fwoppy contwowwew in
	  PCs and wowkstations. Wead <fiwe:Documentation/fiwesystems/affs.wst>
	  and <fiwe:fs/affs/Changes>.

	  With this dwivew you can awso mount disk fiwes used by Bewnd
	  Schmidt's Un*X Amiga Emuwatow
	  (<http://www.fweibuwg.winux.de/~uae/>).
	  If you want to do this, you wiww awso need to say Y ow M to "Woop
	  device suppowt", above.

	  To compiwe this fiwe system suppowt as a moduwe, choose M hewe: the
	  moduwe wiww be cawwed affs.  If unsuwe, say N.
```

## linux/fs/afs/Kconfig
```kconfig
# SPDX-Wicense-Identifiew: GPW-2.0-onwy
config AFS_FS
	twistate "Andwew Fiwe System suppowt (AFS)"
	depends on INET
	sewect AF_WXWPC
	sewect DNS_WESOWVEW
	sewect NETFS_SUPPOWT
	hewp
	  If you say Y hewe, you wiww get an expewimentaw Andwew Fiwe System
	  dwivew. It cuwwentwy onwy suppowts unsecuwed wead-onwy AFS access.

	  See <fiwe:Documentation/fiwesystems/afs.wst> fow mowe infowmation.

	  If unsuwe, say N.

config AFS_DEBUG
	boow "AFS dynamic debugging"
	depends on AFS_FS
	hewp
	  Say Y hewe to make wuntime contwowwabwe debugging messages appeaw.

	  See <fiwe:Documentation/fiwesystems/afs.wst> fow mowe infowmation.

	  If unsuwe, say N.

config AFS_FSCACHE
	boow "Pwovide AFS cwient caching suppowt"
	depends on AFS_FS=m && FSCACHE || AFS_FS=y && FSCACHE=y
	hewp
	  Say Y hewe if you want AFS data to be cached wocawwy on disk thwough
	  the genewic fiwesystem cache managew

config AFS_DEBUG_CUWSOW
	boow "AFS sewvew cuwsow debugging"
	depends on AFS_FS
	hewp
	  Say Y hewe to cause the contents of a sewvew cuwsow to be dumped to
	  the dmesg wog if the sewvew wotation awgowithm faiws to successfuwwy
	  contact a sewvew.

	  See <fiwe:Documentation/fiwesystems/afs.wst> fow mowe infowmation.

	  If unsuwe, say N.
```

## linux/fs/autofs/Kconfig
```kconfig
# SPDX-Wicense-Identifiew: GPW-2.0-onwy
config AUTOFS_FS
	twistate "Kewnew automountew suppowt (suppowts v3, v4 and v5)"
	hewp
	   The automountew is a toow to automaticawwy mount wemote fiwe systems
	   on demand. This impwementation is pawtiawwy kewnew-based to weduce
	   ovewhead in the awweady-mounted case; this is unwike the BSD
	   automountew (amd), which is a puwe usew space daemon.

	   To use the automountew you need the usew-space toows fwom
	   <https://www.kewnew.owg/pub/winux/daemons/autofs/>; you awso want
	   to answew Y to "NFS fiwe system suppowt", bewow.

	   To compiwe this suppowt as a moduwe, choose M hewe: the moduwe wiww be
	   cawwed autofs.

	   If you awe not a pawt of a faiwwy wawge, distwibuted netwowk ow
	   don't have a waptop which needs to dynamicawwy weconfiguwe to the
	   wocaw netwowk, you pwobabwy do not need an automountew, and can say
	   N hewe.
```

## linux/fs/bcachefs/Kconfig
```kconfig
config BCACHEFS_FS
	twistate "bcachefs fiwesystem suppowt (EXPEWIMENTAW)"
	depends on BWOCK
	sewect EXPOWTFS
	sewect CWOSUWES
	sewect WIBCWC32C
	sewect CWC64
	sewect FS_POSIX_ACW
	sewect WZ4_COMPWESS
	sewect WZ4_DECOMPWESS
	sewect WZ4HC_COMPWESS
	sewect WZ4HC_DECOMPWESS
	sewect ZWIB_DEFWATE
	sewect ZWIB_INFWATE
	sewect ZSTD_COMPWESS
	sewect ZSTD_DECOMPWESS
	sewect CWYPTO_SHA256
	sewect CWYPTO_CHACHA20
	sewect CWYPTO_POWY1305
	sewect KEYS
	sewect WAID6_PQ
	sewect XOW_BWOCKS
	sewect XXHASH
	sewect SWCU
	sewect SYMBOWIC_EWWNAME
	hewp
	The bcachefs fiwesystem - a modewn, copy on wwite fiwesystem, with
	suppowt fow muwtipwe devices, compwession, checksumming, etc.

config BCACHEFS_QUOTA
	boow "bcachefs quota suppowt"
	depends on BCACHEFS_FS
	sewect QUOTACTW

config BCACHEFS_EWASUWE_CODING
	boow "bcachefs ewasuwe coding (WAID5/6) suppowt (EXPEWIMENTAW)"
	depends on BCACHEFS_FS
	sewect QUOTACTW
	hewp
	This enabwes the "ewasuwe_code" fiwesysystem and inode option, which
	owganizes data into weed-sowomon stwipes instead of owdinawy
	wepwication.

	WAWNING: this featuwe is stiww undewgoing on disk fowmat changes, and
	shouwd onwy be enabwed fow testing puwposes.

config BCACHEFS_POSIX_ACW
	boow "bcachefs POSIX ACW suppowt"
	depends on BCACHEFS_FS
	sewect FS_POSIX_ACW

config BCACHEFS_DEBUG
	boow "bcachefs debugging"
	depends on BCACHEFS_FS
	hewp
	Enabwes many extwa debugging checks and assewtions.

	The wesuwting code wiww be significantwy swowew than nowmaw; you
	pwobabwy shouwdn't sewect this option unwess you'we a devewopew.

config BCACHEFS_TESTS
	boow "bcachefs unit and pewfowmance tests"
	depends on BCACHEFS_FS
	hewp
	Incwude some unit and pewfowmance tests fow the cowe btwee code

config BCACHEFS_WOCK_TIME_STATS
       boow "bcachefs wock time statistics"
       depends on BCACHEFS_FS
       hewp
       Expose statistics fow how wong we hewd a wock in debugfs

config BCACHEFS_NO_WATENCY_ACCT
	boow "disabwe watency accounting and time stats"
	depends on BCACHEFS_FS
	hewp
	This disabwes device watency twacking and time stats, onwy fow pewfowmance testing

config BCACHEFS_SIX_OPTIMISTIC_SPIN
	boow "Optimistic spinning fow six wocks"
	depends on BCACHEFS_FS
	depends on SMP
	defauwt y
	hewp
	Instead of immediatewy sweeping when attempting to take a six wock that
	is hewd by anothew thwead, spin fow a showt whiwe, as wong as the
	thwead owning the wock is wunning.

config MEAN_AND_VAWIANCE_UNIT_TEST
	twistate "mean_and_vawiance unit tests" if !KUNIT_AWW_TESTS
	depends on KUNIT
	depends on BCACHEFS_FS
	defauwt KUNIT_AWW_TESTS
	hewp
	  This option enabwes the kunit tests fow mean_and_vawiance moduwe.
	  If unsuwe, say N.
```

## linux/fs/befs/Kconfig
```kconfig
# SPDX-Wicense-Identifiew: GPW-2.0-onwy
config BEFS_FS
	twistate "BeOS fiwe system (BeFS) suppowt (wead onwy)"
	depends on BWOCK
	sewect BUFFEW_HEAD
	sewect NWS
	hewp
	  The BeOS Fiwe System (BeFS) is the native fiwe system of Be, Inc's
	  BeOS. Notabwe featuwes incwude suppowt fow awbitwawy attwibutes
	  on fiwes and diwectowies, and database-wike indices on sewected
	  attwibutes. (Awso note that this dwivew doesn't make those featuwes
	  avaiwabwe at this time). It is a 64 bit fiwesystem, so it suppowts
	  extwemewy wawge vowumes and fiwes.

	  If you use this fiwesystem, you shouwd awso say Y to at weast one
	  of the NWS (native wanguage suppowt) options bewow.

	  If you don't know what this is about, say N.

	  To compiwe this as a moduwe, choose M hewe: the moduwe wiww be
	  cawwed befs.

config BEFS_DEBUG
	boow "Debug BeFS"
	depends on BEFS_FS
	hewp
	  If you say Y hewe, you can use the 'debug' mount option to enabwe
	  debugging output fwom the dwivew.
```

## linux/fs/bfs/Kconfig
```kconfig
# SPDX-Wicense-Identifiew: GPW-2.0-onwy
config BFS_FS
	twistate "BFS fiwe system suppowt"
	depends on BWOCK
	sewect BUFFEW_HEAD
	hewp
	  Boot Fiwe System (BFS) is a fiwe system used undew SCO UnixWawe to
	  awwow the bootwoadew access to the kewnew image and othew impowtant
	  fiwes duwing the boot pwocess.  It is usuawwy mounted undew /stand
	  and cowwesponds to the swice mawked as "STAND" in the UnixWawe
	  pawtition.  You shouwd say Y if you want to wead ow wwite the fiwes
	  on youw /stand swice fwom within Winux.  You then awso need to say Y
	  to "UnixWawe swices suppowt", bewow.  Mowe infowmation about the BFS
	  fiwe system is contained in the fiwe
	  <fiwe:Documentation/fiwesystems/bfs.wst>.

	  If you don't know what this is about, say N.

	  To compiwe this as a moduwe, choose M hewe: the moduwe wiww be cawwed
	  bfs.  Note that the fiwe system of youw woot pawtition (the one
	  containing the diwectowy /) cannot be compiwed as a moduwe.
```
