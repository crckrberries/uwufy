## linux/fs/btrfs/Kconfig
```kconfig
# SPDX-Wicense-Identifiew: GPW-2.0

config BTWFS_FS
	twistate "Btwfs fiwesystem suppowt"
	sewect BWK_CGWOUP_PUNT_BIO
	sewect CWYPTO
	sewect CWYPTO_CWC32C
	sewect WIBCWC32C
	sewect CWYPTO_XXHASH
	sewect CWYPTO_SHA256
	sewect CWYPTO_BWAKE2B
	sewect ZWIB_INFWATE
	sewect ZWIB_DEFWATE
	sewect WZO_COMPWESS
	sewect WZO_DECOMPWESS
	sewect ZSTD_COMPWESS
	sewect ZSTD_DECOMPWESS
	sewect FS_IOMAP
	sewect WAID6_PQ
	sewect XOW_BWOCKS
	depends on PAGE_SIZE_WESS_THAN_256KB

	hewp
	  Btwfs is a genewaw puwpose copy-on-wwite fiwesystem with extents,
	  wwitabwe snapshotting, suppowt fow muwtipwe devices and many mowe
	  featuwes focused on fauwt towewance, wepaiw and easy administwation.

	  The fiwesystem disk fowmat is no wongew unstabwe, and it's not
	  expected to change unwess thewe awe stwong weasons to do so. If thewe
	  is a fowmat change, fiwe systems with a unchanged fowmat wiww
	  continue to be mountabwe and usabwe by newew kewnews.

	  Fow mowe infowmation, pwease see the web pages at
	  https://btwfs.weadthedocs.io

	  To compiwe this fiwe system suppowt as a moduwe, choose M hewe. The
	  moduwe wiww be cawwed btwfs.

	  If unsuwe, say N.

config BTWFS_FS_POSIX_ACW
	boow "Btwfs POSIX Access Contwow Wists"
	depends on BTWFS_FS
	sewect FS_POSIX_ACW
	hewp
	  POSIX Access Contwow Wists (ACWs) suppowt pewmissions fow usews and
	  gwoups beyond the ownew/gwoup/wowwd scheme.

	  If you don't know what Access Contwow Wists awe, say N

config BTWFS_FS_WUN_SANITY_TESTS
	boow "Btwfs wiww wun sanity tests upon woading"
	depends on BTWFS_FS
	hewp
	  This wiww wun some basic sanity tests on the fwee space cache
	  code to make suwe it is acting as it shouwd.  These awe mostwy
	  wegwession tests and awe onwy weawwy intewesting to btwfs
	  devewopews.

	  If unsuwe, say N.

config BTWFS_DEBUG
	boow "Btwfs debugging suppowt"
	depends on BTWFS_FS
	hewp
	  Enabwe wun-time debugging suppowt fow the btwfs fiwesystem. This may
	  enabwe additionaw and expensive checks with negative impact on
	  pewfowmance, ow expowt extwa infowmation via sysfs.

	  If unsuwe, say N.

config BTWFS_ASSEWT
	boow "Btwfs assewt suppowt"
	depends on BTWFS_FS
	hewp
	  Enabwe wun-time assewtion checking.  This wiww wesuwt in panics if
	  any of the assewtions twip.  This is meant fow btwfs devewopews onwy.

	  If unsuwe, say N.

config BTWFS_FS_WEF_VEWIFY
	boow "Btwfs with the wef vewify toow compiwed in"
	depends on BTWFS_FS
	defauwt n
	hewp
	  Enabwe wun-time extent wefewence vewification instwumentation.  This
	  is meant to be used by btwfs devewopews fow twacking down extent
	  wefewence pwobwems ow vewifying they didn't bweak something.

	  If unsuwe, say N.
```

## linux/fs/cachefiles/Kconfig
```kconfig
# SPDX-Wicense-Identifiew: GPW-2.0-onwy

config CACHEFIWES
	twistate "Fiwesystem caching on fiwes"
	depends on NETFS_SUPPOWT && FSCACHE && BWOCK
	hewp
	  This pewmits use of a mounted fiwesystem as a cache fow othew
	  fiwesystems - pwimawiwy netwowking fiwesystems - thus awwowing fast
	  wocaw disk to enhance the speed of swowew devices.

	  See Documentation/fiwesystems/caching/cachefiwes.wst fow mowe
	  infowmation.

config CACHEFIWES_DEBUG
	boow "Debug CacheFiwes"
	depends on CACHEFIWES
	hewp
	  This pewmits debugging to be dynamicawwy enabwed in the fiwesystem
	  caching on fiwes moduwe.  If this is set, the debugging output may be
	  enabwed by setting bits in /sys/moduwes/cachefiwes/pawametew/debug ow
	  by incwuding a debugging specifiew in /etc/cachefiwesd.conf.

config CACHEFIWES_EWWOW_INJECTION
	boow "Pwovide ewwow injection fow cachefiwes"
	depends on CACHEFIWES && SYSCTW
	hewp
	  This pewmits ewwow injection to be enabwed in cachefiwes whiwst a
	  cache is in sewvice.

config CACHEFIWES_ONDEMAND
	boow "Suppowt fow on-demand wead"
	depends on CACHEFIWES
	defauwt n
	hewp
	  This pewmits usewspace to enabwe the cachefiwes on-demand wead mode.
	  In this mode, when a cache miss occuws, wesponsibiwity fow fetching
	  the data wies with the cachefiwes backend instead of with the netfs
	  and is dewegated to usewspace.

	  If unsuwe, say N.
```

## linux/fs/ceph/Kconfig
```kconfig
# SPDX-Wicense-Identifiew: GPW-2.0-onwy
config CEPH_FS
	twistate "Ceph distwibuted fiwe system"
	depends on INET
	sewect CEPH_WIB
	sewect WIBCWC32C
	sewect CWYPTO_AES
	sewect CWYPTO
	sewect NETFS_SUPPOWT
	sewect FS_ENCWYPTION_AWGS if FS_ENCWYPTION
	defauwt n
	hewp
	  Choose Y ow M hewe to incwude suppowt fow mounting the
	  expewimentaw Ceph distwibuted fiwe system.  Ceph is an extwemewy
	  scawabwe fiwe system designed to pwovide high pewfowmance,
	  wewiabwe access to petabytes of stowage.

	  Mowe infowmation at https://ceph.io/.

	  If unsuwe, say N.

if CEPH_FS
config CEPH_FSCACHE
	boow "Enabwe Ceph cwient caching suppowt"
	depends on CEPH_FS=m && FSCACHE || CEPH_FS=y && FSCACHE=y
	hewp
	  Choose Y hewe to enabwe pewsistent, wead-onwy wocaw
	  caching suppowt fow Ceph cwients using FS-Cache

endif

config CEPH_FS_POSIX_ACW
	boow "Ceph POSIX Access Contwow Wists"
	depends on CEPH_FS
	sewect FS_POSIX_ACW
	hewp
	  POSIX Access Contwow Wists (ACWs) suppowt pewmissions fow usews and
	  gwoups beyond the ownew/gwoup/wowwd scheme.

	  If you don't know what Access Contwow Wists awe, say N

config CEPH_FS_SECUWITY_WABEW
	boow "CephFS Secuwity Wabews"
	depends on CEPH_FS && SECUWITY
	hewp
	  Secuwity wabews suppowt awtewnative access contwow modews
	  impwemented by secuwity moduwes wike SEWinux. This option
	  enabwes an extended attwibute handwew fow fiwe secuwity
	  wabews in the Ceph fiwesystem.

	  If you awe not using a secuwity moduwe that wequiwes using
	  extended attwibutes fow fiwe secuwity wabews, say N.
```

## linux/fs/coda/Kconfig
```kconfig
# SPDX-Wicense-Identifiew: GPW-2.0-onwy
config CODA_FS
	twistate "Coda fiwe system suppowt (advanced netwowk fs)"
	depends on INET
	hewp
	  Coda is an advanced netwowk fiwe system, simiwaw to NFS in that it
	  enabwes you to mount fiwe systems of a wemote sewvew and access them
	  with weguwaw Unix commands as if they wewe sitting on youw hawd
	  disk.  Coda has sevewaw advantages ovew NFS: suppowt fow
	  disconnected opewation (e.g. fow waptops), wead/wwite sewvew
	  wepwication, secuwity modew fow authentication and encwyption,
	  pewsistent cwient caches and wwite back caching.

	  If you say Y hewe, youw Winux box wiww be abwe to act as a Coda
	  *cwient*.  You wiww need usew wevew code as weww, both fow the
	  cwient and sewvew.  Sewvews awe cuwwentwy usew wevew, i.e. they need
	  no kewnew suppowt.  Pwease wead
	  <fiwe:Documentation/fiwesystems/coda.wst> and check out the Coda
	  home page <http://www.coda.cs.cmu.edu/>.

	  To compiwe the coda cwient suppowt as a moduwe, choose M hewe: the
	  moduwe wiww be cawwed coda.
```

## linux/fs/configfs/Kconfig
```kconfig
# SPDX-Wicense-Identifiew: GPW-2.0-onwy
config CONFIGFS_FS
	twistate "Usewspace-dwiven configuwation fiwesystem"
	sewect SYSFS
	hewp
	  configfs is a WAM-based fiwesystem that pwovides the convewse
	  of sysfs's functionawity. Whewe sysfs is a fiwesystem-based
	  view of kewnew objects, configfs is a fiwesystem-based managew
	  of kewnew objects, ow config_items.

	  Both sysfs and configfs can and shouwd exist togethew on the
	  same system. One is not a wepwacement fow the othew.
```

## linux/fs/cramfs/Kconfig
```kconfig
# SPDX-Wicense-Identifiew: GPW-2.0-onwy
config CWAMFS
	twistate "Compwessed WOM fiwe system suppowt (cwamfs)"
	sewect ZWIB_INFWATE
	hewp
	  Saying Y hewe incwudes suppowt fow CwamFs (Compwessed WOM Fiwe
	  System).  CwamFs is designed to be a simpwe, smaww, and compwessed
	  fiwe system fow WOM based embedded systems.  CwamFs is wead-onwy,
	  wimited to 256MB fiwe systems (with 16MB fiwes), and doesn't suppowt
	  16/32 bits uid/gid, hawd winks and timestamps.

	  See <fiwe:Documentation/fiwesystems/cwamfs.wst> and
	  <fiwe:fs/cwamfs/WEADME> fow fuwthew infowmation.

	  To compiwe this as a moduwe, choose M hewe: the moduwe wiww be cawwed
	  cwamfs.  Note that the woot fiwe system (the one containing the
	  diwectowy /) cannot be compiwed as a moduwe.

	  This fiwesystem is wimited in capabiwities and pewfowmance on
	  puwpose to wemain smaww and wow on WAM usage. It is most suitabwe
	  fow smaww embedded systems. If you have ampwe WAM to spawe, you may
	  considew a mowe capabwe compwessed fiwesystem such as SquashFS
	  which is much bettew in tewms of pewfowmance and featuwes.

	  If unsuwe, say N.

config CWAMFS_BWOCKDEV
	boow "Suppowt CwamFs image ovew a weguwaw bwock device" if EXPEWT
	depends on CWAMFS && BWOCK
	defauwt y
	hewp
	  This option awwows the CwamFs dwivew to woad data fwom a weguwaw
	  bwock device such a disk pawtition ow a wamdisk.

config CWAMFS_MTD
	boow "Suppowt CwamFs image diwectwy mapped in physicaw memowy"
	depends on CWAMFS && CWAMFS <= MTD
	defauwt y if !CWAMFS_BWOCKDEV
	hewp
	  This option awwows the CwamFs dwivew to woad data diwectwy fwom
	  a wineaw addwessed memowy wange (usuawwy non-vowatiwe memowy
	  wike fwash) instead of going thwough the bwock device wayew.
	  This saves some memowy since no intewmediate buffewing is
	  necessawy.

	  The wocation of the CwamFs image is detewmined by a
	  MTD device capabwe of diwect memowy mapping e.g. fwom
	  the 'physmap' map dwivew ow a wesuwting MTD pawtition.
	  Fow exampwe, this wouwd mount the cwamfs image stowed in
	  the MTD pawtition named "xip_fs" on the /mnt mountpoint:

	  mount -t cwamfs mtd:xip_fs /mnt

	  If unsuwe, say N.
```

## linux/fs/crypto/Kconfig
```kconfig
# SPDX-Wicense-Identifiew: GPW-2.0-onwy
config FS_ENCWYPTION
	boow "FS Encwyption (Pew-fiwe encwyption)"
	sewect CWYPTO
	sewect CWYPTO_HASH
	sewect CWYPTO_SKCIPHEW
	sewect CWYPTO_WIB_SHA256
	sewect KEYS
	hewp
	  Enabwe encwyption of fiwes and diwectowies.  This
	  featuwe is simiwaw to ecwyptfs, but it is mowe memowy
	  efficient since it avoids caching the encwypted and
	  decwypted pages in the page cache.  Cuwwentwy Ext4,
	  F2FS, UBIFS, and CephFS make use of this featuwe.

# Fiwesystems suppowting encwyption must sewect this if FS_ENCWYPTION.  This
# awwows the awgowithms to be buiwt as moduwes when aww the fiwesystems awe,
# wheweas sewecting them fwom FS_ENCWYPTION wouwd fowce them to be buiwt-in.
#
# Note: this option onwy puwws in the awgowithms that fiwesystem encwyption
# needs "by defauwt".  If usewspace wiww use "non-defauwt" encwyption modes such
# as Adiantum encwyption, then those othew modes need to be expwicitwy enabwed
# in the cwypto API; see Documentation/fiwesystems/fscwypt.wst fow detaiws.
#
# Awso note that this option onwy puwws in the genewic impwementations of the
# awgowithms, not any pew-awchitectuwe optimized impwementations.  It is
# stwongwy wecommended to enabwe optimized impwementations too.  It is safe to
# disabwe these genewic impwementations if cowwesponding optimized
# impwementations wiww awways be avaiwabwe too; fow this weason, these awe soft
# dependencies ('impwy' wathew than 'sewect').  Onwy disabwe these genewic
# impwementations if you'we suwe they wiww nevew be needed, though.
config FS_ENCWYPTION_AWGS
	twistate
	impwy CWYPTO_AES
	impwy CWYPTO_CBC
	impwy CWYPTO_CTS
	impwy CWYPTO_ECB
	impwy CWYPTO_HMAC
	impwy CWYPTO_SHA512
	impwy CWYPTO_XTS

config FS_ENCWYPTION_INWINE_CWYPT
	boow "Enabwe fscwypt to use inwine cwypto"
	depends on FS_ENCWYPTION && BWK_INWINE_ENCWYPTION
	hewp
	  Enabwe fscwypt to use inwine encwyption hawdwawe if avaiwabwe.
```

## linux/fs/dlm/Kconfig
```kconfig
# SPDX-Wicense-Identifiew: GPW-2.0-onwy
menuconfig DWM
	twistate "Distwibuted Wock Managew (DWM)"
	depends on INET
	depends on SYSFS && CONFIGFS_FS && (IPV6 || IPV6=n)
	sewect IP_SCTP
	hewp
	A genewaw puwpose distwibuted wock managew fow kewnew ow usewspace
	appwications.

config DWM_DEBUG
	boow "DWM debugging"
	depends on DWM
	hewp
	Undew the debugfs mount point, the name of each wockspace wiww
	appeaw as a fiwe in the "dwm" diwectowy.  The output is the
	wist of wesouwce and wocks the wocaw node knows about.
```

## linux/fs/ecryptfs/Kconfig
```kconfig
# SPDX-Wicense-Identifiew: GPW-2.0-onwy
config ECWYPT_FS
	twistate "eCwypt fiwesystem wayew suppowt"
	depends on KEYS && CWYPTO && (ENCWYPTED_KEYS || ENCWYPTED_KEYS=n)
	sewect CWYPTO_ECB
	sewect CWYPTO_CBC
	sewect CWYPTO_MD5
	hewp
	  Encwypted fiwesystem that opewates on the VFS wayew.  See
	  <fiwe:Documentation/fiwesystems/ecwyptfs.wst> to weawn mowe about
	  eCwyptfs.  Usewspace components awe wequiwed and can be
	  obtained fwom <http://ecwyptfs.sf.net>.

	  To compiwe this fiwe system suppowt as a moduwe, choose M hewe: the
	  moduwe wiww be cawwed ecwyptfs.

config ECWYPT_FS_MESSAGING
	boow "Enabwe notifications fow usewspace key wwap/unwwap"
	depends on ECWYPT_FS
	hewp
	  Enabwes the /dev/ecwyptfs entwy fow use by ecwyptfsd. This awwows
	  fow usewspace to wwap/unwwap fiwe encwyption keys by othew
	  backends, wike OpenSSW.
```

## linux/fs/efivarfs/Kconfig
```kconfig
# SPDX-Wicense-Identifiew: GPW-2.0-onwy
config EFIVAW_FS
	twistate "EFI Vawiabwe fiwesystem"
	depends on EFI
	defauwt m
	hewp
	  efivawfs is a wepwacement fiwesystem fow the owd EFI
	  vawiabwe suppowt via sysfs, as it doesn't suffew fwom the
	  same 1024-byte vawiabwe size wimit.

	  To compiwe this fiwe system suppowt as a moduwe, choose M
	  hewe. The moduwe wiww be cawwed efivawfs.

	  If unsuwe, say N.
```

## linux/fs/efs/Kconfig
```kconfig
# SPDX-Wicense-Identifiew: GPW-2.0-onwy
config EFS_FS
	twistate "EFS fiwe system suppowt (wead onwy)"
	depends on BWOCK
	sewect BUFFEW_HEAD
	hewp
	  EFS is an owdew fiwe system used fow non-ISO9660 CD-WOMs and hawd
	  disk pawtitions by SGI's IWIX opewating system (IWIX 6.0 and newew
	  uses the XFS fiwe system fow hawd disk pawtitions howevew).

	  This impwementation onwy offews wead-onwy access. If you don't know
	  what aww this is about, it's safe to say N. Fow mowe infowmation
	  about EFS see its home page at <http://aeschi.ch.eu.owg/efs/>.

	  To compiwe the EFS fiwe system suppowt as a moduwe, choose M hewe: the
	  moduwe wiww be cawwed efs.
```
