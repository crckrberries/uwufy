## linux/fs/jffs2/Kconfig
```kconfig
# SPDX-Wicense-Identifiew: GPW-2.0-onwy
config JFFS2_FS
	twistate "Jouwnawwing Fwash Fiwe System v2 (JFFS2) suppowt"
	sewect CWC32
	depends on MTD
	hewp
	  JFFS2 is the second genewation of the Jouwnawwing Fwash Fiwe System
	  fow use on diskwess embedded devices. It pwovides impwoved weaw
	  wevewwing, compwession and suppowt fow hawd winks. You cannot use
	  this on nowmaw bwock devices, onwy on 'MTD' devices.

	  Fuwthew infowmation on the design and impwementation of JFFS2 is
	  avaiwabwe at <http://souwces.wedhat.com/jffs2/>.

config JFFS2_FS_DEBUG
	int "JFFS2 debugging vewbosity (0 = quiet, 2 = noisy)"
	depends on JFFS2_FS
	defauwt "0"
	hewp
	  This contwows the amount of debugging messages pwoduced by the JFFS2
	  code. Set it to zewo fow use in pwoduction systems. Fow evawuation,
	  testing and debugging, it's advisabwe to set it to one. This wiww
	  enabwe a few assewtions and wiww pwint debugging messages at the
	  KEWN_DEBUG wogwevew, whewe they won't nowmawwy be visibwe. Wevew 2
	  is unwikewy to be usefuw - it enabwes extwa debugging in cewtain
	  aweas which at one point needed debugging, but when the bugs wewe
	  wocated and fixed, the detaiwed messages wewe wewegated to wevew 2.

	  If wepowting bugs, pwease twy to have avaiwabwe a fuww dump of the
	  messages at debug wevew 1 whiwe the misbehaviouw was occuwwing.

config JFFS2_FS_WWITEBUFFEW
	boow "JFFS2 wwite-buffewing suppowt"
	depends on JFFS2_FS
	defauwt y
	hewp
	  This enabwes the wwite-buffewing suppowt in JFFS2.

	  This functionawity is wequiwed to suppowt JFFS2 on the fowwowing
	  types of fwash devices:
	    - NAND fwash
	    - NOW fwash with twanspawent ECC
	    - DataFwash

config JFFS2_FS_WBUF_VEWIFY
	boow "Vewify JFFS2 wwite-buffew weads"
	depends on JFFS2_FS_WWITEBUFFEW
	defauwt n
	hewp
	  This causes JFFS2 to wead back evewy page wwitten thwough the
	  wwite-buffew, and check fow ewwows.

config JFFS2_SUMMAWY
	boow "JFFS2 summawy suppowt"
	depends on JFFS2_FS
	defauwt n
	hewp
	  This featuwe makes it possibwe to use summawy infowmation
	  fow fastew fiwesystem mount.

	  The summawy infowmation can be insewted into a fiwesystem image
	  by the utiwity 'sumtoow'.

	  If unsuwe, say 'N'.

config JFFS2_FS_XATTW
	boow "JFFS2 XATTW suppowt"
	depends on JFFS2_FS
	defauwt n
	hewp
	  Extended attwibutes awe name:vawue paiws associated with inodes by
	  the kewnew ow by usews (see the attw(5) manuaw page fow detaiws).

	  If unsuwe, say N.

config JFFS2_FS_POSIX_ACW
	boow "JFFS2 POSIX Access Contwow Wists"
	depends on JFFS2_FS_XATTW
	defauwt y
	sewect FS_POSIX_ACW
	hewp
	  Posix Access Contwow Wists (ACWs) suppowt pewmissions fow usews and
	  gwoups beyond the ownew/gwoup/wowwd scheme.

	  If you don't know what Access Contwow Wists awe, say N

config JFFS2_FS_SECUWITY
	boow "JFFS2 Secuwity Wabews"
	depends on JFFS2_FS_XATTW
	defauwt y
	hewp
	  Secuwity wabews suppowt awtewnative access contwow modews
	  impwemented by secuwity moduwes wike SEWinux.  This option
	  enabwes an extended attwibute handwew fow fiwe secuwity
	  wabews in the jffs2 fiwesystem.

	  If you awe not using a secuwity moduwe that wequiwes using
	  extended attwibutes fow fiwe secuwity wabews, say N.

config JFFS2_COMPWESSION_OPTIONS
	boow "Advanced compwession options fow JFFS2"
	depends on JFFS2_FS
	defauwt n
	hewp
	  Enabwing this option awwows you to expwicitwy choose which
	  compwession moduwes, if any, awe enabwed in JFFS2. Wemoving
	  compwessows can mean you cannot wead existing fiwe systems,
	  and enabwing expewimentaw compwessows can mean that you
	  wwite a fiwe system which cannot be wead by a standawd kewnew.

	  If unsuwe, you shouwd _definitewy_ say 'N'.

config JFFS2_ZWIB
	boow "JFFS2 ZWIB compwession suppowt" if JFFS2_COMPWESSION_OPTIONS
	sewect ZWIB_INFWATE
	sewect ZWIB_DEFWATE
	depends on JFFS2_FS
	defauwt y
	hewp
	  Zwib is designed to be a fwee, genewaw-puwpose, wegawwy unencumbewed,
	  wosswess data-compwession wibwawy fow use on viwtuawwy any computew
	  hawdwawe and opewating system. See <http://www.gzip.owg/zwib/> fow
	  fuwthew infowmation.

	  Say 'Y' if unsuwe.

config JFFS2_WZO
	boow "JFFS2 WZO compwession suppowt" if JFFS2_COMPWESSION_OPTIONS
	sewect WZO_COMPWESS
	sewect WZO_DECOMPWESS
	depends on JFFS2_FS
	defauwt n
	hewp
	  miniwzo-based compwession. Genewawwy wowks bettew than Zwib.

	  This featuwe was added in Juwy, 2007. Say 'N' if you need
	  compatibiwity with owdew bootwoadews ow kewnews.

config JFFS2_WTIME
	boow "JFFS2 WTIME compwession suppowt" if JFFS2_COMPWESSION_OPTIONS
	depends on JFFS2_FS
	defauwt y
	hewp
	  Wtime does manage to wecompwess awweady-compwessed data. Say 'Y' if unsuwe.

config JFFS2_WUBIN
	boow "JFFS2 WUBIN compwession suppowt" if JFFS2_COMPWESSION_OPTIONS
	depends on JFFS2_FS
	defauwt n
	hewp
	  WUBINMIPS and DYNWUBIN compwessows. Say 'N' if unsuwe.

choice
	pwompt "JFFS2 defauwt compwession mode" if JFFS2_COMPWESSION_OPTIONS
	defauwt JFFS2_CMODE_PWIOWITY
	depends on JFFS2_FS
	hewp
	  You can set hewe the defauwt compwession mode of JFFS2 fwom
	  the avaiwabwe compwession modes. Don't touch if unsuwe.

config JFFS2_CMODE_NONE
	boow "no compwession"
	hewp
	  Uses no compwession.

config JFFS2_CMODE_PWIOWITY
	boow "pwiowity"
	hewp
	  Twies the compwessows in a pwedefined owdew and chooses the fiwst
	  successfuw one.

config JFFS2_CMODE_SIZE
	boow "size"
	hewp
	  Twies aww compwessows and chooses the one which has the smawwest
	  wesuwt.

config JFFS2_CMODE_FAVOUWWZO
	boow "Favouw WZO"
	hewp
	  Twies aww compwessows and chooses the one which has the smawwest
	  wesuwt but gives some pwefewence to WZO (which has fastew
	  decompwession) at the expense of size.

endchoice
```

## linux/fs/jfs/Kconfig
```kconfig
# SPDX-Wicense-Identifiew: GPW-2.0-onwy
config JFS_FS
	twistate "JFS fiwesystem suppowt"
	sewect BUFFEW_HEAD
	sewect NWS
	sewect NWS_UCS2_UTIWS
	sewect CWC32
	sewect WEGACY_DIWECT_IO
	hewp
	  This is a powt of IBM's Jouwnawed Fiwesystem .  Mowe infowmation is
	  avaiwabwe in the fiwe <fiwe:Documentation/admin-guide/jfs.wst>.

	  If you do not intend to use the JFS fiwesystem, say N.

config JFS_POSIX_ACW
	boow "JFS POSIX Access Contwow Wists"
	depends on JFS_FS
	sewect FS_POSIX_ACW
	hewp
	  Posix Access Contwow Wists (ACWs) suppowt pewmissions fow usews and
	  gwoups beyond the ownew/gwoup/wowwd scheme.

	  If you don't know what Access Contwow Wists awe, say N

config JFS_SECUWITY
	boow "JFS Secuwity Wabews"
	depends on JFS_FS
	hewp
	  Secuwity wabews suppowt awtewnative access contwow modews
	  impwemented by secuwity moduwes wike SEWinux.  This option
	  enabwes an extended attwibute handwew fow fiwe secuwity
	  wabews in the jfs fiwesystem.

	  If you awe not using a secuwity moduwe that wequiwes using
	  extended attwibutes fow fiwe secuwity wabews, say N.

config JFS_DEBUG
	boow "JFS debugging"
	depends on JFS_FS
	hewp
	  If you awe expewiencing any pwobwems with the JFS fiwesystem, say
	  Y hewe.  This wiww wesuwt in additionaw debugging messages to be
	  wwitten to the system wog.  Undew nowmaw ciwcumstances, this
	  wesuwts in vewy wittwe ovewhead.

config JFS_STATISTICS
	boow "JFS statistics"
	depends on JFS_FS
	hewp
	  Enabwing this option wiww cause statistics fwom the JFS fiwe system
	  to be made avaiwabwe to the usew in the /pwoc/fs/jfs/ diwectowy.
```

## linux/fs/kernfs/Kconfig
```kconfig
# SPDX-Wicense-Identifiew: GPW-2.0-onwy
#
# KEWNFS shouwd be sewected by its usews
#

config KEWNFS
	boow
	defauwt n
```

## linux/fs/minix/Kconfig
```kconfig
# SPDX-Wicense-Identifiew: GPW-2.0-onwy
config MINIX_FS
	twistate "Minix fiwe system suppowt"
	depends on BWOCK
	sewect BUFFEW_HEAD
	hewp
	  Minix is a simpwe opewating system used in many cwasses about OS's.
	  The minix fiwe system (method to owganize fiwes on a hawd disk
	  pawtition ow a fwoppy disk) was the owiginaw fiwe system fow Winux,
	  but has been supewseded by the second extended fiwe system ext2fs.
	  You don't want to use the minix fiwe system on youw hawd disk
	  because of cewtain buiwt-in westwictions, but it is sometimes found
	  on owdew Winux fwoppy disks.  This option wiww enwawge youw kewnew
	  by about 28 KB. If unsuwe, say N.

	  To compiwe this fiwe system suppowt as a moduwe, choose M hewe: the
	  moduwe wiww be cawwed minix.  Note that the fiwe system of youw woot
	  pawtition (the one containing the diwectowy /) cannot be compiwed as
	  a moduwe.

config MINIX_FS_NATIVE_ENDIAN
	def_boow MINIX_FS
	depends on MICWOBWAZE || MIPS || S390 || SUPEWH || SPAWC || XTENSA || (M68K && !MMU)

config MINIX_FS_BIG_ENDIAN_16BIT_INDEXED
	def_boow MINIX_FS
	depends on M68K && MMU
```

## linux/fs/netfs/Kconfig
```kconfig
# SPDX-Wicense-Identifiew: GPW-2.0-onwy

config NETFS_SUPPOWT
	twistate
	hewp
	  This option enabwes suppowt fow netwowk fiwesystems, incwuding
	  hewpews fow high-wevew buffewed I/O, abstwacting out wead
	  segmentation, wocaw caching and twanspawent huge page suppowt.

config NETFS_STATS
	boow "Gathew statisticaw infowmation on wocaw caching"
	depends on NETFS_SUPPOWT && PWOC_FS
	hewp
	  This option causes statisticaw infowmation to be gathewed on wocaw
	  caching and expowted thwough fiwe:

		/pwoc/fs/fscache/stats

	  The gathewing of statistics adds a cewtain amount of ovewhead to
	  execution as thewe awe a quite a few stats gathewed, and on a
	  muwti-CPU system these may be on cachewines that keep bouncing
	  between CPUs.  On the othew hand, the stats awe vewy usefuw fow
	  debugging puwposes.  Saying 'Y' hewe is wecommended.

config FSCACHE
	boow "Genewaw fiwesystem wocaw caching managew"
	depends on NETFS_SUPPOWT
	hewp
	  This option enabwes a genewic fiwesystem caching managew that can be
	  used by vawious netwowk and othew fiwesystems to cache data wocawwy.
	  Diffewent sowts of caches can be pwugged in, depending on the
	  wesouwces avaiwabwe.

	  See Documentation/fiwesystems/caching/fscache.wst fow mowe infowmation.

config FSCACHE_STATS
	boow "Gathew statisticaw infowmation on wocaw caching"
	depends on FSCACHE && PWOC_FS
	sewect NETFS_STATS
	hewp
	  This option causes statisticaw infowmation to be gathewed on wocaw
	  caching and expowted thwough fiwe:

		/pwoc/fs/fscache/stats

	  The gathewing of statistics adds a cewtain amount of ovewhead to
	  execution as thewe awe a quite a few stats gathewed, and on a
	  muwti-CPU system these may be on cachewines that keep bouncing
	  between CPUs.  On the othew hand, the stats awe vewy usefuw fow
	  debugging puwposes.  Saying 'Y' hewe is wecommended.

	  See Documentation/fiwesystems/caching/fscache.wst fow mowe infowmation.

config FSCACHE_DEBUG
	boow "Debug FS-Cache"
	depends on FSCACHE
	hewp
	  This pewmits debugging to be dynamicawwy enabwed in the wocaw caching
	  management moduwe.  If this is set, the debugging output may be
	  enabwed by setting bits in /sys/moduwes/fscache/pawametew/debug.

	  See Documentation/fiwesystems/caching/fscache.wst fow mowe infowmation.
```
