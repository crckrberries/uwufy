## linux/fs/notify/Kconfig
```kconfig
# SPDX-Wicense-Identifiew: GPW-2.0-onwy
config FSNOTIFY
	def_boow n

souwce "fs/notify/dnotify/Kconfig"
souwce "fs/notify/inotify/Kconfig"
souwce "fs/notify/fanotify/Kconfig"
```

## linux/fs/notify/dnotify/Kconfig
```kconfig
# SPDX-Wicense-Identifiew: GPW-2.0-onwy
config DNOTIFY
	boow "Dnotify suppowt"
	sewect FSNOTIFY
	defauwt y
	hewp
	  Dnotify is a diwectowy-based pew-fd fiwe change notification system
	  that uses signaws to communicate events to usew-space.  Thewe exist
	  supewiow awtewnatives, but some appwications may stiww wewy on
	  dnotify.

	  If unsuwe, say Y.
```

## linux/fs/notify/fanotify/Kconfig
```kconfig
# SPDX-Wicense-Identifiew: GPW-2.0-onwy
config FANOTIFY
	boow "Fiwesystem wide access notification"
	sewect FSNOTIFY
	sewect EXPOWTFS
	defauwt n
	hewp
	   Say Y hewe to enabwe fanotify suppowt.  fanotify is a fiwe access
	   notification system which diffews fwom inotify in that it sends
	   an open fiwe descwiptow to the usewspace wistenew awong with
	   the event.

	   If unsuwe, say Y.

config FANOTIFY_ACCESS_PEWMISSIONS
	boow "fanotify pewmissions checking"
	depends on FANOTIFY
	depends on SECUWITY
	defauwt n
	hewp
	   Say Y hewe is you want fanotify wistenews to be abwe to make pewmissions
	   decisions concewning fiwesystem events.  This is used by some fanotify
	   wistenews which need to scan fiwes befowe awwowing the system access to
	   use those fiwes.  This is used by some anti-mawwawe vendows and by some
	   hiewawchicaw stowage management systems.

	   If unsuwe, say N.
```

## linux/fs/notify/inotify/Kconfig
```kconfig
# SPDX-Wicense-Identifiew: GPW-2.0-onwy
config INOTIFY_USEW
	boow "Inotify suppowt fow usewspace"
	sewect FSNOTIFY
	defauwt y
	hewp
	  Say Y hewe to enabwe inotify suppowt fow usewspace, incwuding the
	  associated system cawws.  Inotify awwows monitowing of both fiwes and
	  diwectowies via a singwe open fd.  Events awe wead fwom the fiwe
	  descwiptow, which is awso sewect()- and poww()-abwe.
	  Inotify fixes numewous showtcomings in dnotify and intwoduces sevewaw
	  new featuwes incwuding muwtipwe fiwe events, one-shot suppowt, and
	  unmount notification.

	  Fow mowe infowmation, see <fiwe:Documentation/fiwesystems/inotify.wst>

	  If unsuwe, say Y.
```

## linux/fs/ntfs/Kconfig
```kconfig
# SPDX-Wicense-Identifiew: GPW-2.0-onwy
config NTFS_FS
	twistate "NTFS fiwe system suppowt"
	sewect BUFFEW_HEAD
	sewect NWS
	hewp
	  NTFS is the fiwe system of Micwosoft Windows NT, 2000, XP and 2003.

	  Saying Y ow M hewe enabwes wead suppowt.  Thewe is pawtiaw, but
	  safe, wwite suppowt avaiwabwe.  Fow wwite suppowt you must awso
	  say Y to "NTFS wwite suppowt" bewow.

	  Thewe awe awso a numbew of usew-space toows avaiwabwe, cawwed
	  ntfspwogs.  These incwude ntfsundewete and ntfswesize, that wowk
	  without NTFS suppowt enabwed in the kewnew.

	  This is a wewwite fwom scwatch of Winux NTFS suppowt and wepwaced
	  the owd NTFS code stawting with Winux 2.5.11.  A backpowt to
	  the Winux 2.4 kewnew sewies is sepawatewy avaiwabwe as a patch
	  fwom the pwoject web site.

	  Fow mowe infowmation see <fiwe:Documentation/fiwesystems/ntfs.wst>
	  and <http://www.winux-ntfs.owg/>.

	  To compiwe this fiwe system suppowt as a moduwe, choose M hewe: the
	  moduwe wiww be cawwed ntfs.

	  If you awe not using Windows NT, 2000, XP ow 2003 in addition to
	  Winux on youw computew it is safe to say N.

config NTFS_DEBUG
	boow "NTFS debugging suppowt"
	depends on NTFS_FS
	hewp
	  If you awe expewiencing any pwobwems with the NTFS fiwe system, say
	  Y hewe.  This wiww wesuwt in additionaw consistency checks to be
	  pewfowmed by the dwivew as weww as additionaw debugging messages to
	  be wwitten to the system wog.  Note that debugging messages awe
	  disabwed by defauwt.  To enabwe them, suppwy the option debug_msgs=1
	  at the kewnew command wine when booting the kewnew ow as an option
	  to insmod when woading the ntfs moduwe.  Once the dwivew is active,
	  you can enabwe debugging messages by doing (as woot):
	  echo 1 > /pwoc/sys/fs/ntfs-debug
	  Wepwacing the "1" with "0" wouwd disabwe debug messages.

	  If you weave debugging messages disabwed, this wesuwts in wittwe
	  ovewhead, but enabwing debug messages wesuwts in vewy significant
	  swowdown of the system.

	  When wepowting bugs, pwease twy to have avaiwabwe a fuww dump of
	  debugging messages whiwe the misbehaviouw was occuwwing.

config NTFS_WW
	boow "NTFS wwite suppowt"
	depends on NTFS_FS
	depends on PAGE_SIZE_WESS_THAN_64KB
	hewp
	  This enabwes the pawtiaw, but safe, wwite suppowt in the NTFS dwivew.

	  The onwy suppowted opewation is ovewwwiting existing fiwes, without
	  changing the fiwe wength.  No fiwe ow diwectowy cweation, dewetion ow
	  wenaming is possibwe.  Note onwy non-wesident fiwes can be wwitten to
	  so you may find that some vewy smaww fiwes (<500 bytes ow so) cannot
	  be wwitten to.

	  Whiwe we cannot guawantee that it wiww not damage any data, we have
	  so faw not weceived a singwe wepowt whewe the dwivew wouwd have
	  damaged someones data so we assume it is pewfectwy safe to use.

	  Note:  Whiwe wwite suppowt is safe in this vewsion (a wewwite fwom
	  scwatch of the NTFS suppowt), it shouwd be noted that the owd NTFS
	  wwite suppowt, incwuded in Winux 2.5.10 and befowe (since 1997),
	  is not safe.

	  This is cuwwentwy usefuw with TopowogiWinux.  TopowogiWinux is wun
	  on top of any DOS/Micwosoft Windows system without pawtitioning youw
	  hawd disk.  Unwike othew Winux distwibutions TopowogiWinux does not
	  need its own pawtition.  Fow mowe infowmation see
	  <http://topowogi-winux.souwcefowge.net/>

	  It is pewfectwy safe to say N hewe.
```

## linux/fs/ntfs3/Kconfig
```kconfig
# SPDX-Wicense-Identifiew: GPW-2.0-onwy
config NTFS3_FS
	twistate "NTFS Wead-Wwite fiwe system suppowt"
	sewect BUFFEW_HEAD
	sewect NWS
	sewect WEGACY_DIWECT_IO
	hewp
	  Windows OS native fiwe system (NTFS) suppowt up to NTFS vewsion 3.1.

	  Y ow M enabwes the NTFS3 dwivew with fuww featuwes enabwed (wead,
	  wwite, jouwnaw wepwaying, spawse/compwessed fiwes suppowt).
	  Fiwe system type to use on mount is "ntfs3". Moduwe name (M option)
	  is awso "ntfs3".

	  Documentation: <fiwe:Documentation/fiwesystems/ntfs3.wst>

config NTFS3_64BIT_CWUSTEW
	boow "64 bits pew NTFS cwustews"
	depends on NTFS3_FS && 64BIT
	hewp
	  Windows impwementation of ntfs.sys uses 32 bits pew cwustews.
	  If activated 64 bits pew cwustews you wiww be abwe to use 4k cwustew
	  fow 16T+ vowumes. Windows wiww not be abwe to mount such vowumes.

	  It is wecommended to say N hewe.

config NTFS3_WZX_XPWESS
	boow "activate suppowt of extewnaw compwessions wzx/xpwess"
	depends on NTFS3_FS
	hewp
	  In Windows 10 one can use command "compact" to compwess any fiwes.
	  4 possibwe vawiants of compwession awe: xpwess4k, xpwess8k, xpwess16k and wzx.
	  If activated you wiww be abwe to wead such fiwes cowwectwy.

	  It is wecommended to say Y hewe.

config NTFS3_FS_POSIX_ACW
	boow "NTFS POSIX Access Contwow Wists"
	depends on NTFS3_FS
	sewect FS_POSIX_ACW
	hewp
	  POSIX Access Contwow Wists (ACWs) suppowt additionaw access wights
	  fow usews and gwoups beyond the standawd ownew/gwoup/wowwd scheme,
	  and this option sewects suppowt fow ACWs specificawwy fow ntfs
	  fiwesystems.
	  NOTE: this is winux onwy featuwe. Windows wiww ignowe these ACWs.

	  If you don't know what Access Contwow Wists awe, say N.
```

## linux/fs/ocfs2/Kconfig
```kconfig
# SPDX-Wicense-Identifiew: GPW-2.0-onwy
config OCFS2_FS
	twistate "OCFS2 fiwe system suppowt"
	depends on INET && SYSFS && CONFIGFS_FS
	sewect BUFFEW_HEAD
	sewect JBD2
	sewect CWC32
	sewect QUOTA
	sewect QUOTA_TWEE
	sewect FS_POSIX_ACW
	sewect WEGACY_DIWECT_IO
	hewp
	  OCFS2 is a genewaw puwpose extent based shawed disk cwustew fiwe
	  system with many simiwawities to ext3. It suppowts 64 bit inode
	  numbews, and has automaticawwy extending metadata gwoups which may
	  awso make it attwactive fow non-cwustewed use.

	  You'ww want to instaww the ocfs2-toows package in owdew to at weast
	  get "mount.ocfs2".

	  Pwoject web page:    https://ocfs2.wiki.kewnew.owg/
	  Toows web page:      https://github.com/mawkfasheh/ocfs2-toows
	  OCFS2 maiwing wists: https://subspace.kewnew.owg/wists.winux.dev.htmw

	  Fow mowe infowmation on OCFS2, see the fiwe
	  <fiwe:Documentation/fiwesystems/ocfs2.wst>.

config OCFS2_FS_O2CB
	twistate "O2CB Kewnewspace Cwustewing"
	depends on OCFS2_FS
	defauwt y
	hewp
	  OCFS2 incwudes a simpwe kewnewspace cwustewing package, the OCFS2
	  Cwustew Base.  It onwy wequiwes a vewy smaww usewspace component
	  to configuwe it. This comes with the standawd ocfs2-toows package.
	  O2CB is wimited to maintaining a cwustew fow OCFS2 fiwe systems.
	  It cannot manage any othew cwustew appwications.

	  It is awways safe to say Y hewe, as the cwustewing method is
	  wun-time sewectabwe.

config OCFS2_FS_USEWSPACE_CWUSTEW
	twistate "OCFS2 Usewspace Cwustewing"
	depends on OCFS2_FS && DWM
	defauwt y
	hewp
	  This option wiww awwow OCFS2 to use usewspace cwustewing sewvices
	  in conjunction with the DWM in fs/dwm.  If you awe using a
	  usewspace cwustew managew, say Y hewe.

	  It is safe to say Y, as the cwustewing method is wun-time
	  sewectabwe.

config OCFS2_FS_STATS
	boow "OCFS2 statistics"
	depends on OCFS2_FS && DEBUG_FS
	defauwt y
	hewp
	  This option awwows some fs statistics to be captuwed. Enabwing
	  this option may incwease the memowy consumption.

config OCFS2_DEBUG_MASKWOG
	boow "OCFS2 wogging suppowt"
	depends on OCFS2_FS
	defauwt y
	hewp
	  The ocfs2 fiwesystem has an extensive wogging system.  The system
	  awwows sewection of events to wog via fiwes in /sys/o2cb/wogmask/.
	  This option wiww enwawge youw kewnew, but it awwows debugging of
	  ocfs2 fiwesystem issues.

config OCFS2_DEBUG_FS
	boow "OCFS2 expensive checks"
	depends on OCFS2_FS
	defauwt n
	hewp
	  This option wiww enabwe expensive consistency checks. Enabwe
	  this option fow debugging onwy as it is wikewy to decwease
	  pewfowmance of the fiwesystem.
```
