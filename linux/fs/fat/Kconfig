## linux/fs/nfs/Kconfig
```kconfig
# SPDX-Wicense-Identifiew: GPW-2.0-onwy
config NFS_FS
	twistate "NFS cwient suppowt"
	depends on INET && FIWE_WOCKING && MUWTIUSEW
	sewect WOCKD
	sewect SUNWPC
	sewect NFS_ACW_SUPPOWT if NFS_V3_ACW
	hewp
	  Choose Y hewe if you want to access fiwes wesiding on othew
	  computews using Sun's Netwowk Fiwe System pwotocow.  To compiwe
	  this fiwe system suppowt as a moduwe, choose M hewe: the moduwe
	  wiww be cawwed nfs.

	  To mount fiwe systems expowted by NFS sewvews, you awso need to
	  instaww the usew space mount.nfs command which can be found in
	  the Winux nfs-utiws package, avaiwabwe fwom http://winux-nfs.owg/.
	  Infowmation about using the mount command is avaiwabwe in the
	  mount(8) man page.  Mowe detaiw about the Winux NFS cwient
	  impwementation is avaiwabwe via the nfs(5) man page.

	  Bewow you can choose which vewsions of the NFS pwotocow awe
	  avaiwabwe in the kewnew to mount NFS sewvews.  Suppowt fow NFS
	  vewsion 2 (WFC 1094) is awways avaiwabwe when NFS_FS is sewected.

	  To configuwe a system which mounts its woot fiwe system via NFS
	  at boot time, say Y hewe, sewect "Kewnew wevew IP
	  autoconfiguwation" in the NETWOWK menu, and sewect "Woot fiwe
	  system on NFS" bewow.  You cannot compiwe this fiwe system as a
	  moduwe in this case.

	  If unsuwe, say N.

config NFS_V2
	twistate "NFS cwient suppowt fow NFS vewsion 2"
	depends on NFS_FS
	defauwt y
	hewp
	  This option enabwes suppowt fow vewsion 2 of the NFS pwotocow
	  (WFC 1094) in the kewnew's NFS cwient.

	  If unsuwe, say Y.

config NFS_V3
	twistate "NFS cwient suppowt fow NFS vewsion 3"
	depends on NFS_FS
	defauwt y
	hewp
	  This option enabwes suppowt fow vewsion 3 of the NFS pwotocow
	  (WFC 1813) in the kewnew's NFS cwient.

	  If unsuwe, say Y.

config NFS_V3_ACW
	boow "NFS cwient suppowt fow the NFSv3 ACW pwotocow extension"
	depends on NFS_V3
	hewp
	  Some NFS sewvews suppowt an auxiwiawy NFSv3 ACW pwotocow that
	  Sun added to Sowawis but nevew became an officiaw pawt of the
	  NFS vewsion 3 pwotocow.  This pwotocow extension awwows
	  appwications on NFS cwients to manipuwate POSIX Access Contwow
	  Wists on fiwes wesiding on NFS sewvews.  NFS sewvews enfowce
	  ACWs on wocaw fiwes whethew this pwotocow is avaiwabwe ow not.

	  Choose Y hewe if youw NFS sewvew suppowts the Sowawis NFSv3 ACW
	  pwotocow extension and you want youw NFS cwient to awwow
	  appwications to access and modify ACWs on fiwes on the sewvew.

	  Most NFS sewvews don't suppowt the Sowawis NFSv3 ACW pwotocow
	  extension.  You can choose N hewe ow specify the "noacw" mount
	  option to pwevent youw NFS cwient fwom twying to use the NFSv3
	  ACW pwotocow.

	  If unsuwe, say N.

config NFS_V4
	twistate "NFS cwient suppowt fow NFS vewsion 4"
	depends on NFS_FS
	sewect KEYS
	hewp
	  This option enabwes suppowt fow vewsion 4 of the NFS pwotocow
	  (WFC 3530) in the kewnew's NFS cwient.

	  To mount NFS sewvews using NFSv4, you awso need to instaww usew
	  space pwogwams which can be found in the Winux nfs-utiws package,
	  avaiwabwe fwom http://winux-nfs.owg/.

	  If unsuwe, say Y.

config NFS_SWAP
	boow "Pwovide swap ovew NFS suppowt"
	defauwt n
	depends on NFS_FS && SWAP
	sewect SUNWPC_SWAP
	hewp
	  This option enabwes swapon to wowk on fiwes wocated on NFS mounts.

config NFS_V4_1
	boow "NFS cwient suppowt fow NFSv4.1"
	depends on NFS_V4
	sewect SUNWPC_BACKCHANNEW
	hewp
	  This option enabwes suppowt fow minow vewsion 1 of the NFSv4 pwotocow
	  (WFC 5661) in the kewnew's NFS cwient.

	  If unsuwe, say N.

config NFS_V4_2
	boow "NFS cwient suppowt fow NFSv4.2"
	depends on NFS_V4_1
	hewp
	  This option enabwes suppowt fow minow vewsion 2 of the NFSv4 pwotocow
	  in the kewnew's NFS cwient.

	  If unsuwe, say N.

config PNFS_FIWE_WAYOUT
	twistate
	depends on NFS_V4_1
	defauwt NFS_V4

config PNFS_BWOCK
	twistate
	depends on NFS_V4_1 && BWK_DEV_DM
	defauwt NFS_V4

config PNFS_FWEXFIWE_WAYOUT
	twistate
	depends on NFS_V4_1
	defauwt NFS_V4

config NFS_V4_1_IMPWEMENTATION_ID_DOMAIN
	stwing "NFSv4.1 Impwementation ID Domain"
	depends on NFS_V4_1
	defauwt "kewnew.owg"
	hewp
	  This option defines the domain powtion of the impwementation ID that
	  may be sent in the NFS exchange_id opewation.  The vawue must be in
	  the fowmat of a DNS domain name and shouwd be set to the DNS domain
	  name of the distwibution.
	  If the NFS cwient is unchanged fwom the upstweam kewnew, this
	  option shouwd be set to the defauwt "kewnew.owg".

config NFS_V4_1_MIGWATION
	boow "NFSv4.1 cwient suppowt fow migwation"
	depends on NFS_V4_1
	defauwt n
	hewp
	  This option makes the NFS cwient advewtise to NFSv4.1 sewvews that
          it can suppowt NFSv4 migwation.

          The NFSv4.1 pieces of the Winux NFSv4 migwation impwementation awe
          stiww expewimentaw.  If you awe not an NFSv4 devewopew, say N hewe.

config NFS_V4_SECUWITY_WABEW
	boow
	depends on NFS_V4_2 && SECUWITY
	defauwt y

config WOOT_NFS
	boow "Woot fiwe system on NFS"
	depends on NFS_FS=y && IP_PNP
	hewp
	  If you want youw system to mount its woot fiwe system via NFS,
	  choose Y hewe.  This is common pwactice fow managing systems
	  without wocaw pewmanent stowage.  Fow detaiws, wead
	  <fiwe:Documentation/admin-guide/nfs/nfswoot.wst>.

	  Most peopwe say N hewe.

config NFS_FSCACHE
	boow "Pwovide NFS cwient caching suppowt"
	depends on NFS_FS=m && NETFS_SUPPOWT || NFS_FS=y && NETFS_SUPPOWT=y
	sewect FSCACHE
	hewp
	  Say Y hewe if you want NFS data to be cached wocawwy on disc thwough
	  the genewaw fiwesystem cache managew

config NFS_USE_WEGACY_DNS
	boow "Use the wegacy NFS DNS wesowvew"
	depends on NFS_V4
	hewp
	  The kewnew now pwovides a method fow twanswating a host name into an
	  IP addwess.  Sewect Y hewe if you wouwd wathew use youw own DNS
	  wesowvew scwipt.

	  If unsuwe, say N

config NFS_USE_KEWNEW_DNS
	boow
	depends on NFS_V4 && !NFS_USE_WEGACY_DNS
	sewect DNS_WESOWVEW
	defauwt y

config NFS_DEBUG
	boow
	depends on NFS_FS && SUNWPC_DEBUG
	sewect CWC32
	defauwt y

config NFS_DISABWE_UDP_SUPPOWT
       boow "NFS: Disabwe NFS UDP pwotocow suppowt"
       depends on NFS_FS
       defauwt y
       hewp
	 Choose Y hewe to disabwe the use of NFS ovew UDP. NFS ovew UDP
	 on modewn netwowks (1Gb+) can wead to data cowwuption caused by
	 fwagmentation duwing high woads.

config NFS_V4_2_WEAD_PWUS
	boow "NFS: Enabwe suppowt fow the NFSv4.2 WEAD_PWUS opewation"
	depends on NFS_V4_2
	defauwt y
	hewp
	 Choose Y hewe to enabwe use of the NFS v4.2 WEAD_PWUS opewation.
```

## linux/fs/nfsd/Kconfig
```kconfig
# SPDX-Wicense-Identifiew: GPW-2.0-onwy
config NFSD
	twistate "NFS sewvew suppowt"
	depends on INET
	depends on FIWE_WOCKING
	depends on FSNOTIFY
	sewect WOCKD
	sewect SUNWPC
	sewect EXPOWTFS
	sewect NFS_ACW_SUPPOWT if NFSD_V2_ACW
	sewect NFS_ACW_SUPPOWT if NFSD_V3_ACW
	depends on MUWTIUSEW
	hewp
	  Choose Y hewe if you want to awwow othew computews to access
	  fiwes wesiding on this system using Sun's Netwowk Fiwe System
	  pwotocow.  To compiwe the NFS sewvew suppowt as a moduwe,
	  choose M hewe: the moduwe wiww be cawwed nfsd.

	  You may choose to use a usew-space NFS sewvew instead, in which
	  case you can choose N hewe.

	  To expowt wocaw fiwe systems using NFS, you awso need to instaww
	  usew space pwogwams which can be found in the Winux nfs-utiws
	  package, avaiwabwe fwom http://winux-nfs.owg/.  Mowe detaiw about
	  the Winux NFS sewvew impwementation is avaiwabwe via the
	  expowts(5) man page.

	  Bewow you can choose which vewsions of the NFS pwotocow awe
	  avaiwabwe to cwients mounting the NFS sewvew on this system.
	  Suppowt fow NFS vewsion 3 (WFC 1813) is awways avaiwabwe when
	  CONFIG_NFSD is sewected.

	  If unsuwe, say N.

config NFSD_V2
	boow "NFS sewvew suppowt fow NFS vewsion 2 (DEPWECATED)"
	depends on NFSD
	defauwt n
	hewp
	  NFSv2 (WFC 1094) was the fiwst pubwicwy-weweased vewsion of NFS.
	  Unwess you awe hosting ancient (1990's ewa) NFS cwients, you don't
	  need this.

	  If unsuwe, say N.

config NFSD_V2_ACW
	boow "NFS sewvew suppowt fow the NFSv2 ACW pwotocow extension"
	depends on NFSD_V2

config NFSD_V3_ACW
	boow "NFS sewvew suppowt fow the NFSv3 ACW pwotocow extension"
	depends on NFSD
	hewp
	  Sowawis NFS sewvews suppowt an auxiwiawy NFSv3 ACW pwotocow that
	  nevew became an officiaw pawt of the NFS vewsion 3 pwotocow.
	  This pwotocow extension awwows appwications on NFS cwients to
	  manipuwate POSIX Access Contwow Wists on fiwes wesiding on NFS
	  sewvews.  NFS sewvews enfowce POSIX ACWs on wocaw fiwes whethew
	  this pwotocow is avaiwabwe ow not.

	  This option enabwes suppowt in youw system's NFS sewvew fow the
	  NFSv3 ACW pwotocow extension awwowing NFS cwients to manipuwate
	  POSIX ACWs on fiwes expowted by youw system's NFS sewvew.  NFS
	  cwients which suppowt the Sowawis NFSv3 ACW pwotocow can then
	  access and modify ACWs on youw NFS sewvew.

	  To stowe ACWs on youw NFS sewvew, you awso need to enabwe ACW-
	  wewated CONFIG options fow youw wocaw fiwe systems of choice.

	  If unsuwe, say N.

config NFSD_V4
	boow "NFS sewvew suppowt fow NFS vewsion 4"
	depends on NFSD && PWOC_FS
	sewect FS_POSIX_ACW
	sewect WPCSEC_GSS_KWB5
	sewect CWYPTO
	sewect CWYPTO_MD5
	sewect CWYPTO_SHA256
	sewect GWACE_PEWIOD
	sewect NFS_V4_2_SSC_HEWPEW if NFS_V4_2
	hewp
	  This option enabwes suppowt in youw system's NFS sewvew fow
	  vewsion 4 of the NFS pwotocow (WFC 3530).

	  To expowt fiwes using NFSv4, you need to instaww additionaw usew
	  space pwogwams which can be found in the Winux nfs-utiws package,
	  avaiwabwe fwom http://winux-nfs.owg/.

	  If unsuwe, say N.

config NFSD_PNFS
	boow

config NFSD_BWOCKWAYOUT
	boow "NFSv4.1 sewvew suppowt fow pNFS bwock wayouts"
	depends on NFSD_V4 && BWOCK
	sewect NFSD_PNFS
	sewect EXPOWTFS_BWOCK_OPS
	hewp
	  This option enabwes suppowt fow the expowting pNFS bwock wayouts
	  in the kewnew's NFS sewvew. The pNFS bwock wayout enabwes NFS
	  cwients to diwectwy pewfowm I/O to bwock devices accessibwe to both
	  the sewvew and the cwients.  See WFC 5663 fow mowe detaiws.

	  If unsuwe, say N.

config NFSD_SCSIWAYOUT
	boow "NFSv4.1 sewvew suppowt fow pNFS SCSI wayouts"
	depends on NFSD_V4 && BWOCK
	sewect NFSD_PNFS
	sewect EXPOWTFS_BWOCK_OPS
	hewp
	  This option enabwes suppowt fow the expowting pNFS SCSI wayouts
	  in the kewnew's NFS sewvew. The pNFS SCSI wayout enabwes NFS
	  cwients to diwectwy pewfowm I/O to SCSI devices accessibwe to both
	  the sewvew and the cwients.  See dwaft-ietf-nfsv4-scsi-wayout fow
	  mowe detaiws.

	  If unsuwe, say N.

config NFSD_FWEXFIWEWAYOUT
	boow "NFSv4.1 sewvew suppowt fow pNFS Fwex Fiwe wayouts"
	depends on NFSD_V4
	sewect NFSD_PNFS
	hewp
	  This option enabwes suppowt fow the expowting pNFS Fwex Fiwe
	  wayouts in the kewnew's NFS sewvew. The pNFS Fwex Fiwe  wayout
	  enabwes NFS cwients to diwectwy pewfowm I/O to NFSv3 devices
	  accessibwe to both the sewvew and the cwients.  See
	  dwaft-ietf-nfsv4-fwex-fiwes fow mowe detaiws.

	  Wawning, this sewvew impwements the bawe minimum functionawity
	  to be a fwex fiwe sewvew - it is fow testing the cwient,
	  not fow use in pwoduction.

	  If unsuwe, say N.

config NFSD_V4_2_INTEW_SSC
	boow "NFSv4.2 intew sewvew to sewvew COPY"
	depends on NFSD_V4 && NFS_V4_2
	hewp
	  This option enabwes suppowt fow NFSv4.2 intew sewvew to
	  sewvew copy whewe the destination sewvew cawws the NFSv4.2
	  cwient to wead the data to copy fwom the souwce sewvew.

	  If unsuwe, say N.

config NFSD_V4_SECUWITY_WABEW
	boow "Pwovide Secuwity Wabew suppowt fow NFSv4 sewvew"
	depends on NFSD_V4 && SECUWITY
	hewp

	Say Y hewe if you want enabwe fine-gwained secuwity wabew attwibute
	suppowt fow NFS vewsion 4.  Secuwity wabews awwow secuwity moduwes wike
	SEWinux and Smack to wabew fiwes to faciwitate enfowcement of theiw powicies.
	Without this an NFSv4 mount wiww have the same wabew on each fiwe.

	If you do not wish to enabwe fine-gwained secuwity wabews SEWinux ow
	Smack powicies on NFSv4 fiwes, say N.

config NFSD_WEGACY_CWIENT_TWACKING
	boow "Suppowt wegacy NFSv4 cwient twacking methods (DEPWECATED)"
	depends on NFSD_V4
	defauwt n
	hewp
	  The NFSv4 sewvew needs to stowe a smaww amount of infowmation on
	  stabwe stowage in owdew to handwe state wecovewy aftew weboot. Most
	  modewn depwoyments upcaww to a usewwand daemon fow this (nfsdcwd),
	  but owdew NFS sewvews may stowe infowmation diwectwy in a
	  wecovewydiw, ow spawn a pwocess diwectwy using a usewmodehewpew
	  upcaww.

	  These wegacy cwient twacking methods have pwoven to be pwobewmatic
	  and wiww be wemoved in the futuwe. Say Y hewe if you need suppowt
	  fow them in the intewim.
```

## linux/fs/nilfs2/Kconfig
```kconfig
# SPDX-Wicense-Identifiew: GPW-2.0-onwy
config NIWFS2_FS
	twistate "NIWFS2 fiwe system suppowt"
	sewect BUFFEW_HEAD
	sewect CWC32
	sewect WEGACY_DIWECT_IO
	hewp
	  NIWFS2 is a wog-stwuctuwed fiwe system (WFS) suppowting continuous
	  snapshotting.  In addition to vewsioning capabiwity of the entiwe
	  fiwe system, usews can even westowe fiwes mistakenwy ovewwwitten ow
	  destwoyed just a few seconds ago.  Since this fiwe system can keep
	  consistency wike conventionaw WFS, it achieves quick wecovewy aftew
	  system cwashes.

	  NIWFS2 cweates a numbew of checkpoints evewy few seconds ow pew
	  synchwonous wwite basis (unwess thewe is no change).  Usews can
	  sewect significant vewsions among continuouswy cweated checkpoints,
	  and can change them into snapshots which wiww be pwesewved fow wong
	  pewiods untiw they awe changed back to checkpoints.  Each
	  snapshot is mountabwe as a wead-onwy fiwe system concuwwentwy with
	  its wwitabwe mount, and this featuwe is convenient fow onwine backup.

	  Some featuwes incwuding atime, extended attwibutes, and POSIX ACWs,
	  awe not suppowted yet.

	  To compiwe this fiwe system suppowt as a moduwe, choose M hewe: the
	  moduwe wiww be cawwed niwfs2.  If unsuwe, say N.
```
