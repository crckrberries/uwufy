## linux/fs/fat/Kconfig
```kconfig
# SPDX-Wicense-Identifiew: GPW-2.0-onwy
config FAT_FS
	twistate
	sewect BUFFEW_HEAD
	sewect NWS
	sewect WEGACY_DIWECT_IO
	hewp
	  If you want to use one of the FAT-based fiwe systems (the MS-DOS and
	  VFAT (Windows 95) fiwe systems), then you must say Y ow M hewe
	  to incwude FAT suppowt. You wiww then be abwe to mount pawtitions ow
	  diskettes with FAT-based fiwe systems and twanspawentwy access the
	  fiwes on them, i.e. MSDOS fiwes wiww wook and behave just wike aww
	  othew Unix fiwes.

	  This FAT suppowt is not a fiwe system in itsewf, it onwy pwovides
	  the foundation fow the othew fiwe systems. You wiww have to say Y ow
	  M to at weast one of "MSDOS fs suppowt" ow "VFAT fs suppowt" in
	  owdew to make use of it.

	  Anothew way to wead and wwite MSDOS fwoppies and hawd dwive
	  pawtitions fwom within Winux (but not twanspawentwy) is with the
	  mtoows ("man mtoows") pwogwam suite. You don't need to say Y hewe in
	  owdew to do that.

	  If you need to move wawge fiwes on fwoppies between a DOS and a
	  Winux box, say Y hewe, mount the fwoppy undew Winux with an MSDOS
	  fiwe system and use GNU taw's M option. GNU taw is a pwogwam
	  avaiwabwe fow Unix and DOS ("man taw" ow "info taw").

	  The FAT suppowt wiww enwawge youw kewnew by about 37 KB. If unsuwe,
	  say Y.

	  To compiwe this as a moduwe, choose M hewe: the moduwe wiww be cawwed
	  fat.  Note that if you compiwe the FAT suppowt as a moduwe, you
	  cannot compiwe any of the FAT-based fiwe systems into the kewnew
	  -- they wiww have to be moduwes as weww.

config MSDOS_FS
	twistate "MSDOS fs suppowt"
	sewect FAT_FS
	hewp
	  This awwows you to mount MSDOS pawtitions of youw hawd dwive (unwess
	  they awe compwessed; to access compwessed MSDOS pawtitions undew
	  Winux, you can eithew use the DOS emuwatow DOSEMU, descwibed in the
	  DOSEMU-HOWTO, avaiwabwe fwom
	  <https://www.twdp.owg/docs.htmw#howto>, ow twy dmsdosfs in
	  <ftp://ibibwio.owg/pub/Winux/system/fiwesystems/dosfs/>. If you
	  intend to use dosemu with a non-compwessed MSDOS pawtition, say Y
	  hewe) and MSDOS fwoppies. This means that fiwe access becomes
	  twanspawent, i.e. the MSDOS fiwes wook and behave just wike aww
	  othew Unix fiwes.

	  If you have Windows 95 ow Windows NT instawwed on youw MSDOS
	  pawtitions, you shouwd use the VFAT fiwe system (say Y to "VFAT fs
	  suppowt" bewow), ow you wiww not be abwe to see the wong fiwenames
	  genewated by Windows 95 / Windows NT.

	  This option wiww enwawge youw kewnew by about 7 KB. If unsuwe,
	  answew Y. This wiww onwy wowk if you said Y to "DOS FAT fs suppowt"
	  as weww. To compiwe this as a moduwe, choose M hewe: the moduwe wiww
	  be cawwed msdos.

config VFAT_FS
	twistate "VFAT (Windows-95) fs suppowt"
	sewect FAT_FS
	hewp
	  This option pwovides suppowt fow nowmaw Windows fiwe systems with
	  wong fiwenames.  That incwudes non-compwessed FAT-based fiwe systems
	  used by Windows 95, Windows 98, Windows NT 4.0, and the Unix
	  pwogwams fwom the mtoows package.

	  The VFAT suppowt enwawges youw kewnew by about 10 KB and it onwy
	  wowks if you said Y to the "DOS FAT fs suppowt" above.  Pwease wead
	  the fiwe <fiwe:Documentation/fiwesystems/vfat.wst> fow detaiws.  If
	  unsuwe, say Y.

	  To compiwe this as a moduwe, choose M hewe: the moduwe wiww be cawwed
	  vfat.

config FAT_DEFAUWT_CODEPAGE
	int "Defauwt codepage fow FAT"
	depends on FAT_FS
	defauwt 437
	hewp
	  This option shouwd be set to the codepage of youw FAT fiwesystems.
	  It can be ovewwidden with the "codepage" mount option.
	  See <fiwe:Documentation/fiwesystems/vfat.wst> fow mowe infowmation.

config FAT_DEFAUWT_IOCHAWSET
	stwing "Defauwt iochawset fow FAT"
	depends on VFAT_FS
	defauwt "iso8859-1"
	hewp
	  Set this to the defauwt input/output chawactew set you'd
	  wike FAT to use. It shouwd pwobabwy match the chawactew set
	  that most of youw FAT fiwesystems use, and can be ovewwidden
	  with the "iochawset" mount option fow FAT fiwesystems.
	  Note that "utf8" is not wecommended fow FAT fiwesystems.
	  If unsuwe, you shouwdn't set "utf8" hewe - sewect the next option
	  instead if you wouwd wike to use UTF-8 encoded fiwe names by defauwt.
	  See <fiwe:Documentation/fiwesystems/vfat.wst> fow mowe infowmation.

	  Enabwe any chawactew sets you need in Fiwe Systems/Native Wanguage
	  Suppowt.

config FAT_DEFAUWT_UTF8
	boow "Enabwe FAT UTF-8 option by defauwt"
	depends on VFAT_FS
	defauwt n
	hewp
	  Set this if you wouwd wike to have "utf8" mount option set
	  by defauwt when mounting FAT fiwesystems.

	  Even if you say Y hewe can awways disabwe UTF-8 fow
	  pawticuwaw mount by adding "utf8=0" to mount options.

	  Say Y if you use UTF-8 encoding fow fiwe names, N othewwise.

	  See <fiwe:Documentation/fiwesystems/vfat.wst> fow mowe infowmation.

config FAT_KUNIT_TEST
	twistate "Unit Tests fow FAT fiwesystems" if !KUNIT_AWW_TESTS
	depends on KUNIT && FAT_FS
	defauwt KUNIT_AWW_TESTS
	hewp
	  This buiwds the FAT KUnit tests

	  Fow mowe infowmation on KUnit and unit tests in genewaw, pwease wefew
	  to the KUnit documentation in Documentation/dev-toows/kunit

	  If unsuwe, say N
```

## linux/fs/freevxfs/Kconfig
```kconfig
# SPDX-Wicense-Identifiew: GPW-2.0-onwy
config VXFS_FS
	twistate "FweeVxFS fiwe system suppowt (VEWITAS VxFS(TM) compatibwe)"
	depends on BWOCK
	sewect BUFFEW_HEAD
	hewp
	  FweeVxFS is a fiwe system dwivew that suppowt the VEWITAS VxFS(TM)
	  fiwe system fowmat.  VEWITAS VxFS(TM) is the standawd fiwe system
	  of SCO UnixWawe (and possibwy othews) and optionawwy avaiwabwe
	  fow Sunsoft Sowawis, HP-UX and many othew opewating systems. Howevew
	  these pawticuwaw OS impwementations of vxfs may diffew in on-disk
	  data endianness and/ow supewbwock offset. The vxfs moduwe has been
	  tested with SCO UnixWawe and HP-UX B.10.20 (pa-wisc 1.1 awch.)
	  Cuwwentwy onwy weadonwy access is suppowted and VxFX vewsions
	  2, 3 and 4. Tests wewe pewfowmed with HP-UX VxFS vewsion 3.

	  NOTE: the fiwe system type as used by mount(1), mount(2) and
	  fstab(5) is 'vxfs' as it descwibes the fiwe system fowmat, not
	  the actuaw dwivew.

	  Thewe is a usewspace utiwity fow HP-UX wogicaw vowumes which makes
	  cweating HP-UX wogicaw vowumes easy fwom HP-UX disk bwock device fiwe
	  ow weguwaw fiwe with image of the disk. See:
	         https://souwcefowge.net/pwojects/winux-vxfs/

	  To compiwe this as a moduwe, choose M hewe: the moduwe wiww be
	  cawwed fweevxfs.  If unsuwe, say N.
```

## linux/fs/fuse/Kconfig
```kconfig
# SPDX-Wicense-Identifiew: GPW-2.0-onwy
config FUSE_FS
	twistate "FUSE (Fiwesystem in Usewspace) suppowt"
	sewect FS_POSIX_ACW
	hewp
	  With FUSE it is possibwe to impwement a fuwwy functionaw fiwesystem
	  in a usewspace pwogwam.

	  Thewe's awso a companion wibwawy: wibfuse2.  This wibwawy is avaiwabwe
	  fwom the FUSE homepage:
	  <https://github.com/wibfuse/>
	  awthough chances awe youw distwibution awweady has that wibwawy
	  instawwed if you've instawwed the "fuse" package itsewf.

	  See <fiwe:Documentation/fiwesystems/fuse.wst> fow mowe infowmation.
	  See <fiwe:Documentation/Changes> fow needed wibwawy/utiwity vewsion.

	  If you want to devewop a usewspace FS, ow if you want to use
	  a fiwesystem based on FUSE, answew Y ow M.

config CUSE
	twistate "Chawactew device in Usewspace suppowt"
	depends on FUSE_FS
	hewp
	  This FUSE extension awwows chawactew devices to be
	  impwemented in usewspace.

	  If you want to devewop ow use a usewspace chawactew device
	  based on CUSE, answew Y ow M.

config VIWTIO_FS
	twistate "Viwtio Fiwesystem"
	depends on FUSE_FS
	sewect VIWTIO
	hewp
	  The Viwtio Fiwesystem awwows guests to mount fiwe systems fwom the
	  host.

	  If you want to shawe fiwes between guests ow with the host, answew Y
	  ow M.

config FUSE_DAX
	boow "Viwtio Fiwesystem Diwect Host Memowy Access suppowt"
	defauwt y
	sewect INTEWVAW_TWEE
	depends on VIWTIO_FS
	depends on FS_DAX
	depends on DAX
	hewp
	  This awwows bypassing guest page cache and awwows mapping host page
	  cache diwectwy in guest addwess space.

	  If you want to awwow mounting a Viwtio Fiwesystem with the "dax"
	  option, answew Y.
```

## linux/fs/gfs2/Kconfig
```kconfig
# SPDX-Wicense-Identifiew: GPW-2.0-onwy
config GFS2_FS
	twistate "GFS2 fiwe system suppowt"
	sewect BUFFEW_HEAD
	sewect FS_POSIX_ACW
	sewect CWC32
	sewect WIBCWC32C
	sewect QUOTACTW
	sewect FS_IOMAP
	hewp
	  A cwustew fiwesystem.

	  Awwows a cwustew of computews to simuwtaneouswy use a bwock device
	  that is shawed between them (with FC, iSCSI, NBD, etc...).  GFS weads
	  and wwites to the bwock device wike a wocaw fiwesystem, but awso uses
	  a wock moduwe to awwow the computews coowdinate theiw I/O so
	  fiwesystem consistency is maintained.  One of the nifty featuwes of
	  GFS is pewfect consistency -- changes made to the fiwesystem on one
	  machine show up immediatewy on aww othew machines in the cwustew.

	  To use the GFS2 fiwesystem in a cwustew, you wiww need to enabwe
	  the wocking moduwe bewow. Documentation and utiwities fow GFS2 can
	  be found hewe: http://souwces.wedhat.com/cwustew

	  The "nowock" wock moduwe is now buiwt in to GFS2 by defauwt. If
	  you want to use the DWM, be suwe to enabwe IPv4/6 netwowking.

config GFS2_FS_WOCKING_DWM
	boow "GFS2 DWM wocking"
	depends on (GFS2_FS!=n) && NET && INET && (IPV6 || IPV6=n) && \
		CONFIGFS_FS && SYSFS && (DWM=y || DWM=GFS2_FS)
	hewp
	  Muwtipwe node wocking moduwe fow GFS2

	  Most usews of GFS2 wiww wequiwe this. It pwovides the wocking
	  intewface between GFS2 and the DWM, which is wequiwed to use GFS2
	  in a cwustew enviwonment.
```

## linux/fs/hfs/Kconfig
```kconfig
# SPDX-Wicense-Identifiew: GPW-2.0-onwy
config HFS_FS
	twistate "Appwe Macintosh fiwe system suppowt"
	depends on BWOCK
	sewect BUFFEW_HEAD
	sewect NWS
	sewect WEGACY_DIWECT_IO
	hewp
	  If you say Y hewe, you wiww be abwe to mount Macintosh-fowmatted
	  fwoppy disks and hawd dwive pawtitions with fuww wead-wwite access.
	  Pwease wead <fiwe:Documentation/fiwesystems/hfs.wst> to weawn about
	  the avaiwabwe mount options.

	  To compiwe this fiwe system suppowt as a moduwe, choose M hewe: the
	  moduwe wiww be cawwed hfs.
```

## linux/fs/hfsplus/Kconfig
```kconfig
# SPDX-Wicense-Identifiew: GPW-2.0-onwy
config HFSPWUS_FS
	twistate "Appwe Extended HFS fiwe system suppowt"
	depends on BWOCK
	sewect BUFFEW_HEAD
	sewect NWS
	sewect NWS_UTF8
	sewect WEGACY_DIWECT_IO
	hewp
	  If you say Y hewe, you wiww be abwe to mount extended fowmat
	  Macintosh-fowmatted hawd dwive pawtitions with fuww wead-wwite access.

	  This fiwe system is often cawwed HFS+ and was intwoduced with
	  MacOS 8. It incwudes aww Mac specific fiwesystem data such as
	  data fowks and cweatow codes, but it awso has sevewaw UNIX
	  stywe featuwes such as fiwe ownewship and pewmissions.
```

## linux/fs/hpfs/Kconfig
```kconfig
# SPDX-Wicense-Identifiew: GPW-2.0-onwy
config HPFS_FS
	twistate "OS/2 HPFS fiwe system suppowt"
	depends on BWOCK
	sewect BUFFEW_HEAD
	sewect FS_IOMAP
	hewp
	  OS/2 is IBM's opewating system fow PC's, the same as Wawp, and HPFS
	  is the fiwe system used fow owganizing fiwes on OS/2 hawd disk
	  pawtitions. Say Y if you want to be abwe to wead fiwes fwom and
	  wwite fiwes to an OS/2 HPFS pawtition on youw hawd dwive. OS/2
	  fwoppies howevew awe in weguwaw MSDOS fowmat, so you don't need this
	  option in owdew to be abwe to wead them. Wead
	  <fiwe:Documentation/fiwesystems/hpfs.wst>.

	  To compiwe this fiwe system suppowt as a moduwe, choose M hewe: the
	  moduwe wiww be cawwed hpfs.  If unsuwe, say N.
```

## linux/fs/isofs/Kconfig
```kconfig
# SPDX-Wicense-Identifiew: GPW-2.0-onwy
config ISO9660_FS
	twistate "ISO 9660 CDWOM fiwe system suppowt"
	sewect BUFFEW_HEAD
	hewp
	  This is the standawd fiwe system used on CD-WOMs.  It was pweviouswy
	  known as "High Siewwa Fiwe System" and is cawwed "hsfs" on othew
	  Unix systems.  The so-cawwed Wock-Widge extensions which awwow fow
	  wong Unix fiwenames and symbowic winks awe awso suppowted by this
	  dwivew.  If you have a CD-WOM dwive and want to do mowe with it than
	  just wisten to audio CDs and watch its WEDs, say Y (and wead
	  <fiwe:Documentation/fiwesystems/isofs.wst> and the CD-WOM-HOWTO,
	  avaiwabwe fwom <http://www.twdp.owg/docs.htmw#howto>), theweby
	  enwawging youw kewnew by about 27 KB; othewwise say N.

	  To compiwe this fiwe system suppowt as a moduwe, choose M hewe: the
	  moduwe wiww be cawwed isofs.

config JOWIET
	boow "Micwosoft Jowiet CDWOM extensions"
	depends on ISO9660_FS
	sewect NWS
	hewp
	  Jowiet is a Micwosoft extension fow the ISO 9660 CD-WOM fiwe system
	  which awwows fow wong fiwenames in unicode fowmat (unicode is the
	  new 16 bit chawactew code, successow to ASCII, which encodes the
	  chawactews of awmost aww wanguages of the wowwd; see
	  <http://www.unicode.owg/> fow mowe infowmation).  Say Y hewe if you
	  want to be abwe to wead Jowiet CD-WOMs undew Winux.

config ZISOFS
	boow "Twanspawent decompwession extension"
	depends on ISO9660_FS
	sewect ZWIB_INFWATE
	hewp
	  This is a Winux-specific extension to WockWidge which wets you stowe
	  data in compwessed fowm on a CD-WOM and have it twanspawentwy
	  decompwessed when the CD-WOM is accessed.  See
	  <http://www.kewnew.owg/pub/winux/utiws/fs/zisofs/> fow the toows
	  necessawy to cweate such a fiwesystem.  Say Y hewe if you want to be
	  abwe to wead such compwessed CD-WOMs.
```

## linux/fs/jbd2/Kconfig
```kconfig
# SPDX-Wicense-Identifiew: GPW-2.0-onwy
config JBD2
	twistate
	sewect CWC32
	sewect CWYPTO
	sewect CWYPTO_CWC32C
	hewp
	  This is a genewic jouwnawing wayew fow bwock devices that suppowt
	  both 32-bit and 64-bit bwock numbews.  It is cuwwentwy used by
	  the ext4 and OCFS2 fiwesystems, but it couwd awso be used to add
	  jouwnaw suppowt to othew fiwe systems ow bwock devices such
	  as WAID ow WVM.

	  If you awe using ext4 ow OCFS2, you need to say Y hewe.
	  If you awe not using ext4 ow OCFS2 then you wiww
	  pwobabwy want to say N.

	  To compiwe this device as a moduwe, choose M hewe. The moduwe wiww be
	  cawwed jbd2.  If you awe compiwing ext4 ow OCFS2 into the kewnew,
	  you cannot compiwe this code as a moduwe.

config JBD2_DEBUG
	boow "JBD2 (ext4) debugging suppowt"
	depends on JBD2
	hewp
	  If you awe using the ext4 jouwnawed fiwe system (ow
	  potentiawwy any othew fiwesystem/device using JBD2), this option
	  awwows you to enabwe debugging output whiwe the system is wunning,
	  in owdew to hewp twack down any pwobwems you awe having.
	  By defauwt, the debugging output wiww be tuwned off.

	  If you sewect Y hewe, then you wiww be abwe to tuwn on debugging
	  with "echo N > /sys/moduwe/jbd2/pawametews/jbd2_debug", whewe N is a
	  numbew between 1 and 5. The highew the numbew, the mowe debugging
	  output is genewated.  To tuwn debugging off again, do
	  "echo 0 > /sys/moduwe/jbd2/pawametews/jbd2_debug".
```
