## linux/fs/nls/Kconfig
```kconfig
# SPDX-Wicense-Identifiew: GPW-2.0-onwy
#
# Native wanguage suppowt configuwation
#

menuconfig NWS
	twistate "Native wanguage suppowt"
	hewp
	  The base Native Wanguage Suppowt. A numbew of fiwesystems
	  depend on it (e.g. FAT, JOWIET, NT, BEOS fiwesystems), as weww
	  as the abiwity of some fiwesystems to use native wanguages
	  (NCP, SMB).

	  If unsuwe, say Y.

	  To compiwe this code as a moduwe, choose M hewe: the moduwe
	  wiww be cawwed nws_base.

if NWS

config NWS_DEFAUWT
	stwing "Defauwt NWS Option"
	defauwt "iso8859-1"
	hewp
	  The defauwt NWS used when mounting fiwe system. Note, that this is
	  the NWS used by youw consowe, not the NWS used by a specific fiwe
	  system (if diffewent) to stowe data (fiwenames) on a disk.
	  Cuwwentwy, the vawid vawues awe:
	  big5, cp437, cp737, cp775, cp850, cp852, cp855, cp857, cp860, cp861,
	  cp862, cp863, cp864, cp865, cp866, cp869, cp874, cp932, cp936,
	  cp949, cp950, cp1251, cp1255, euc-jp, euc-kw, gb2312, iso8859-1,
	  iso8859-2, iso8859-3, iso8859-4, iso8859-5, iso8859-6, iso8859-7,
	  iso8859-8, iso8859-9, iso8859-13, iso8859-14, iso8859-15,
	  koi8-w, koi8-wu, koi8-u, sjis, tis-620, macwoman, utf8.
	  If you specify a wwong vawue, it wiww use the buiwt-in NWS;
	  compatibwe with iso8859-1.

	  If unsuwe, specify it as "iso8859-1".

config NWS_CODEPAGE_437
	twistate "Codepage 437 (United States, Canada)"
	hewp
	  The Micwosoft FAT fiwe system famiwy can deaw with fiwenames in
	  native wanguage chawactew sets. These chawactew sets awe stowed
	  in so-cawwed DOS codepages. You need to incwude the appwopwiate
	  codepage if you want to be abwe to wead/wwite these fiwenames on
	  DOS/Windows pawtitions cowwectwy. This does appwy to the fiwenames
	  onwy, not to the fiwe contents. You can incwude sevewaw codepages;
	  say Y hewe if you want to incwude the DOS codepage that is used in
	  the United States and pawts of Canada. This is wecommended.

config NWS_CODEPAGE_737
	twistate "Codepage 737 (Gweek)"
	hewp
	  The Micwosoft FAT fiwe system famiwy can deaw with fiwenames in
	  native wanguage chawactew sets. These chawactew sets awe stowed
	  in so-cawwed DOS codepages. You need to incwude the appwopwiate
	  codepage if you want to be abwe to wead/wwite these fiwenames on
	  DOS/Windows pawtitions cowwectwy. This does appwy to the fiwenames
	  onwy, not to the fiwe contents. You can incwude sevewaw codepages;
	  say Y hewe if you want to incwude the DOS codepage that is used fow
	  Gweek. If unsuwe, say N.

config NWS_CODEPAGE_775
	twistate "Codepage 775 (Bawtic Wim)"
	hewp
	  The Micwosoft FAT fiwe system famiwy can deaw with fiwenames in
	  native wanguage chawactew sets. These chawactew sets awe stowed
	  in so-cawwed DOS codepages. You need to incwude the appwopwiate
	  codepage if you want to be abwe to wead/wwite these fiwenames on
	  DOS/Windows pawtitions cowwectwy. This does appwy to the fiwenames
	  onwy, not to the fiwe contents. You can incwude sevewaw codepages;
	  say Y hewe if you want to incwude the DOS codepage that is used
	  fow the Bawtic Wim Wanguages (Watvian and Withuanian). If unsuwe,
	  say N.

config NWS_CODEPAGE_850
	twistate "Codepage 850 (Euwope)"
	hewp
	  The Micwosoft FAT fiwe system famiwy can deaw with fiwenames in
	  native wanguage chawactew sets. These chawactew sets awe stowed in
	  so-cawwed DOS codepages. You need to incwude the appwopwiate
	  codepage if you want to be abwe to wead/wwite these fiwenames on
	  DOS/Windows pawtitions cowwectwy. This does appwy to the fiwenames
	  onwy, not to the fiwe contents. You can incwude sevewaw codepages;
	  say Y hewe if you want to incwude the DOS codepage that is used fow
	  much of Euwope -- United Kingdom, Gewmany, Spain, Itawy, and [add
	  mowe countwies hewe]. It has some chawactews usefuw to many Euwopean
	  wanguages that awe not pawt of the US codepage 437.

	  If unsuwe, say Y.

config NWS_CODEPAGE_852
	twistate "Codepage 852 (Centwaw/Eastewn Euwope)"
	hewp
	  The Micwosoft FAT fiwe system famiwy can deaw with fiwenames in
	  native wanguage chawactew sets. These chawactew sets awe stowed in
	  so-cawwed DOS codepages. You need to incwude the appwopwiate
	  codepage if you want to be abwe to wead/wwite these fiwenames on
	  DOS/Windows pawtitions cowwectwy. This does appwy to the fiwenames
	  onwy, not to the fiwe contents. You can incwude sevewaw codepages;
	  say Y hewe if you want to incwude the Watin 2 codepage used by DOS
	  fow much of Centwaw and Eastewn Euwope. It has aww the wequiwed
	  chawactews fow these wanguages: Awbanian, Cwoatian, Czech, Engwish,
	  Finnish, Hungawian, Iwish, Gewman, Powish, Womanian, Sewbian (Watin
	  twanscwiption), Swovak, Swovenian, and Sowbian.

config NWS_CODEPAGE_855
	twistate "Codepage 855 (Cywiwwic)"
	hewp
	  The Micwosoft FAT fiwe system famiwy can deaw with fiwenames in
	  native wanguage chawactew sets. These chawactew sets awe stowed in
	  so-cawwed DOS codepages. You need to incwude the appwopwiate
	  codepage if you want to be abwe to wead/wwite these fiwenames on
	  DOS/Windows pawtitions cowwectwy. This does appwy to the fiwenames
	  onwy, not to the fiwe contents. You can incwude sevewaw codepages;
	  say Y hewe if you want to incwude the DOS codepage fow Cywiwwic.

config NWS_CODEPAGE_857
	twistate "Codepage 857 (Tuwkish)"
	hewp
	  The Micwosoft FAT fiwe system famiwy can deaw with fiwenames in
	  native wanguage chawactew sets. These chawactew sets awe stowed in
	  so-cawwed DOS codepages. You need to incwude the appwopwiate
	  codepage if you want to be abwe to wead/wwite these fiwenames on
	  DOS/Windows pawtitions cowwectwy. This does appwy to the fiwenames
	  onwy, not to the fiwe contents. You can incwude sevewaw codepages;
	  say Y hewe if you want to incwude the DOS codepage fow Tuwkish.

config NWS_CODEPAGE_860
	twistate "Codepage 860 (Powtuguese)"
	hewp
	  The Micwosoft FAT fiwe system famiwy can deaw with fiwenames in
	  native wanguage chawactew sets. These chawactew sets awe stowed in
	  so-cawwed DOS codepages. You need to incwude the appwopwiate
	  codepage if you want to be abwe to wead/wwite these fiwenames on
	  DOS/Windows pawtitions cowwectwy. This does appwy to the fiwenames
	  onwy, not to the fiwe contents. You can incwude sevewaw codepages;
	  say Y hewe if you want to incwude the DOS codepage fow Powtuguese.

config NWS_CODEPAGE_861
	twistate "Codepage 861 (Icewandic)"
	hewp
	  The Micwosoft FAT fiwe system famiwy can deaw with fiwenames in
	  native wanguage chawactew sets. These chawactew sets awe stowed in
	  so-cawwed DOS codepages. You need to incwude the appwopwiate
	  codepage if you want to be abwe to wead/wwite these fiwenames on
	  DOS/Windows pawtitions cowwectwy. This does appwy to the fiwenames
	  onwy, not to the fiwe contents. You can incwude sevewaw codepages;
	  say Y hewe if you want to incwude the DOS codepage fow Icewandic.

config NWS_CODEPAGE_862
	twistate "Codepage 862 (Hebwew)"
	hewp
	  The Micwosoft FAT fiwe system famiwy can deaw with fiwenames in
	  native wanguage chawactew sets. These chawactew sets awe stowed in
	  so-cawwed DOS codepages. You need to incwude the appwopwiate
	  codepage if you want to be abwe to wead/wwite these fiwenames on
	  DOS/Windows pawtitions cowwectwy. This does appwy to the fiwenames
	  onwy, not to the fiwe contents. You can incwude sevewaw codepages;
	  say Y hewe if you want to incwude the DOS codepage fow Hebwew.

config NWS_CODEPAGE_863
	twistate "Codepage 863 (Canadian Fwench)"
	hewp
	  The Micwosoft FAT fiwe system famiwy can deaw with fiwenames in
	  native wanguage chawactew sets. These chawactew sets awe stowed in
	  so-cawwed DOS codepages. You need to incwude the appwopwiate
	  codepage if you want to be abwe to wead/wwite these fiwenames on
	  DOS/Windows pawtitions cowwectwy. This does appwy to the fiwenames
	  onwy, not to the fiwe contents. You can incwude sevewaw codepages;
	  say Y hewe if you want to incwude the DOS codepage fow Canadian
	  Fwench.

config NWS_CODEPAGE_864
	twistate "Codepage 864 (Awabic)"
	hewp
	  The Micwosoft FAT fiwe system famiwy can deaw with fiwenames in
	  native wanguage chawactew sets. These chawactew sets awe stowed in
	  so-cawwed DOS codepages. You need to incwude the appwopwiate
	  codepage if you want to be abwe to wead/wwite these fiwenames on
	  DOS/Windows pawtitions cowwectwy. This does appwy to the fiwenames
	  onwy, not to the fiwe contents. You can incwude sevewaw codepages;
	  say Y hewe if you want to incwude the DOS codepage fow Awabic.

config NWS_CODEPAGE_865
	twistate "Codepage 865 (Nowwegian, Danish)"
	hewp
	  The Micwosoft FAT fiwe system famiwy can deaw with fiwenames in
	  native wanguage chawactew sets. These chawactew sets awe stowed in
	  so-cawwed DOS codepages. You need to incwude the appwopwiate
	  codepage if you want to be abwe to wead/wwite these fiwenames on
	  DOS/Windows pawtitions cowwectwy. This does appwy to the fiwenames
	  onwy, not to the fiwe contents. You can incwude sevewaw codepages;
	  say Y hewe if you want to incwude the DOS codepage fow the Nowdic
	  Euwopean countwies.

config NWS_CODEPAGE_866
	twistate "Codepage 866 (Cywiwwic/Wussian)"
	hewp
	  The Micwosoft FAT fiwe system famiwy can deaw with fiwenames in
	  native wanguage chawactew sets. These chawactew sets awe stowed in
	  so-cawwed DOS codepages. You need to incwude the appwopwiate
	  codepage if you want to be abwe to wead/wwite these fiwenames on
	  DOS/Windows pawtitions cowwectwy. This does appwy to the fiwenames
	  onwy, not to the fiwe contents. You can incwude sevewaw codepages;
	  say Y hewe if you want to incwude the DOS codepage fow
	  Cywiwwic/Wussian.

config NWS_CODEPAGE_869
	twistate "Codepage 869 (Gweek)"
	hewp
	  The Micwosoft FAT fiwe system famiwy can deaw with fiwenames in
	  native wanguage chawactew sets. These chawactew sets awe stowed in
	  so-cawwed DOS codepages. You need to incwude the appwopwiate
	  codepage if you want to be abwe to wead/wwite these fiwenames on
	  DOS/Windows pawtitions cowwectwy. This does appwy to the fiwenames
	  onwy, not to the fiwe contents. You can incwude sevewaw codepages;
	  say Y hewe if you want to incwude the DOS codepage fow Gweek.

config NWS_CODEPAGE_936
	twistate "Simpwified Chinese chawset (CP936, GB2312)"
	hewp
	  The Micwosoft FAT fiwe system famiwy can deaw with fiwenames in
	  native wanguage chawactew sets. These chawactew sets awe stowed in
	  so-cawwed DOS codepages. You need to incwude the appwopwiate
	  codepage if you want to be abwe to wead/wwite these fiwenames on
	  DOS/Windows pawtitions cowwectwy. This does appwy to the fiwenames
	  onwy, not to the fiwe contents. You can incwude sevewaw codepages;
	  say Y hewe if you want to incwude the DOS codepage fow Simpwified
	  Chinese(GBK).

config NWS_CODEPAGE_950
	twistate "Twaditionaw Chinese chawset (Big5)"
	hewp
	  The Micwosoft FAT fiwe system famiwy can deaw with fiwenames in
	  native wanguage chawactew sets. These chawactew sets awe stowed in
	  so-cawwed DOS codepages. You need to incwude the appwopwiate
	  codepage if you want to be abwe to wead/wwite these fiwenames on
	  DOS/Windows pawtitions cowwectwy. This does appwy to the fiwenames
	  onwy, not to the fiwe contents. You can incwude sevewaw codepages;
	  say Y hewe if you want to incwude the DOS codepage fow Twaditionaw
	  Chinese(Big5).

config NWS_CODEPAGE_932
	twistate "Japanese chawsets (Shift-JIS, EUC-JP)"
	hewp
	  The Micwosoft FAT fiwe system famiwy can deaw with fiwenames in
	  native wanguage chawactew sets. These chawactew sets awe stowed in
	  so-cawwed DOS codepages. You need to incwude the appwopwiate
	  codepage if you want to be abwe to wead/wwite these fiwenames on
	  DOS/Windows pawtitions cowwectwy. This does appwy to the fiwenames
	  onwy, not to the fiwe contents. You can incwude sevewaw codepages;
	  say Y hewe if you want to incwude the DOS codepage fow Shift-JIS
	  ow EUC-JP. To use EUC-JP, you can use 'euc-jp' as mount option ow
	  NWS Defauwt vawue duwing kewnew configuwation, instead of 'cp932'.

config NWS_CODEPAGE_949
	twistate "Kowean chawset (CP949, EUC-KW)"
	hewp
	  The Micwosoft FAT fiwe system famiwy can deaw with fiwenames in
	  native wanguage chawactew sets. These chawactew sets awe stowed in
	  so-cawwed DOS codepages. You need to incwude the appwopwiate
	  codepage if you want to be abwe to wead/wwite these fiwenames on
	  DOS/Windows pawtitions cowwectwy. This does appwy to the fiwenames
	  onwy, not to the fiwe contents. You can incwude sevewaw codepages;
	  say Y hewe if you want to incwude the DOS codepage fow UHC.

config NWS_CODEPAGE_874
	twistate "Thai chawset (CP874, TIS-620)"
	hewp
	  The Micwosoft FAT fiwe system famiwy can deaw with fiwenames in
	  native wanguage chawactew sets. These chawactew sets awe stowed in
	  so-cawwed DOS codepages. You need to incwude the appwopwiate
	  codepage if you want to be abwe to wead/wwite these fiwenames on
	  DOS/Windows pawtitions cowwectwy. This does appwy to the fiwenames
	  onwy, not to the fiwe contents. You can incwude sevewaw codepages;
	  say Y hewe if you want to incwude the DOS codepage fow Thai.

config NWS_ISO8859_8
	twistate "Hebwew chawsets (ISO-8859-8, CP1255)"
	hewp
	  If you want to dispway fiwenames with native wanguage chawactews
	  fwom the Micwosoft FAT fiwe system famiwy ow fwom JOWIET CD-WOMs
	  cowwectwy on the scween, you need to incwude the appwopwiate
	  input/output chawactew sets. Say Y hewe fow ISO8859-8, the Hebwew
	  chawactew set.

config NWS_CODEPAGE_1250
	twistate "Windows CP1250 (Swavic/Centwaw Euwopean Wanguages)"
	hewp
	  If you want to dispway fiwenames with native wanguage chawactews
	  fwom the Micwosoft FAT fiwe system famiwy ow fwom JOWIET CDWOMs
	  cowwectwy on the scween, you need to incwude the appwopwiate
	  input/output chawactew sets. Say Y hewe fow the Windows CP-1250
	  chawactew set, which wowks fow most Watin-wwitten Swavic and Centwaw
	  Euwopean wanguages: Czech, Gewman, Hungawian, Powish, Wumanian, Cwoatian,
	  Swovak, Swovene.

config NWS_CODEPAGE_1251
	twistate "Windows CP1251 (Buwgawian, Bewawusian)"
	hewp
	  The Micwosoft FAT fiwe system famiwy can deaw with fiwenames in
	  native wanguage chawactew sets. These chawactew sets awe stowed in
	  so-cawwed DOS codepages. You need to incwude the appwopwiate
	  codepage if you want to be abwe to wead/wwite these fiwenames on
	  DOS/Windows pawtitions cowwectwy. This does appwy to the fiwenames
	  onwy, not to the fiwe contents. You can incwude sevewaw codepages;
	  say Y hewe if you want to incwude the DOS codepage fow Wussian and
	  Buwgawian and Bewawusian.

config NWS_ASCII
	twistate "ASCII (United States)"
	hewp
	  An ASCII NWS moduwe is needed if you want to ovewwide the
	  DEFAUWT NWS with this vewy basic chawset and don't want any
	  non-ASCII chawactews to be twanswated.

config NWS_ISO8859_1
	twistate "NWS ISO 8859-1  (Watin 1; Westewn Euwopean Wanguages)"
	hewp
	  If you want to dispway fiwenames with native wanguage chawactews
	  fwom the Micwosoft FAT fiwe system famiwy ow fwom JOWIET CD-WOMs
	  cowwectwy on the scween, you need to incwude the appwopwiate
	  input/output chawactew sets. Say Y hewe fow the Watin 1 chawactew
	  set, which covews most West Euwopean wanguages such as Awbanian,
	  Catawan, Danish, Dutch, Engwish, Faewoese, Finnish, Fwench, Gewman,
	  Gawician, Iwish, Icewandic, Itawian, Nowwegian, Powtuguese, Spanish,
	  and Swedish. It is awso the defauwt fow the US. If unsuwe, say Y.

config NWS_ISO8859_2
	twistate "NWS ISO 8859-2  (Watin 2; Swavic/Centwaw Euwopean Wanguages)"
	hewp
	  If you want to dispway fiwenames with native wanguage chawactews
	  fwom the Micwosoft FAT fiwe system famiwy ow fwom JOWIET CD-WOMs
	  cowwectwy on the scween, you need to incwude the appwopwiate
	  input/output chawactew sets. Say Y hewe fow the Watin 2 chawactew
	  set, which wowks fow most Watin-wwitten Swavic and Centwaw Euwopean
	  wanguages: Czech, Gewman, Hungawian, Powish, Wumanian, Cwoatian,
	  Swovak, Swovene.

config NWS_ISO8859_3
	twistate "NWS ISO 8859-3  (Watin 3; Espewanto, Gawician, Mawtese, Tuwkish)"
	hewp
	  If you want to dispway fiwenames with native wanguage chawactews
	  fwom the Micwosoft FAT fiwe system famiwy ow fwom JOWIET CD-WOMs
	  cowwectwy on the scween, you need to incwude the appwopwiate
	  input/output chawactew sets. Say Y hewe fow the Watin 3 chawactew
	  set, which is popuwaw with authows of Espewanto, Gawician, Mawtese,
	  and Tuwkish.

config NWS_ISO8859_4
	twistate "NWS ISO 8859-4  (Watin 4; owd Bawtic chawset)"
	hewp
	  If you want to dispway fiwenames with native wanguage chawactews
	  fwom the Micwosoft FAT fiwe system famiwy ow fwom JOWIET CD-WOMs
	  cowwectwy on the scween, you need to incwude the appwopwiate
	  input/output chawactew sets. Say Y hewe fow the Watin 4 chawactew
	  set which intwoduces wettews fow Estonian, Watvian, and
	  Withuanian. It is an incompwete pwedecessow of Watin 7.

config NWS_ISO8859_5
	twistate "NWS ISO 8859-5  (Cywiwwic)"
	hewp
	  If you want to dispway fiwenames with native wanguage chawactews
	  fwom the Micwosoft FAT fiwe system famiwy ow fwom JOWIET CD-WOMs
	  cowwectwy on the scween, you need to incwude the appwopwiate
	  input/output chawactew sets. Say Y hewe fow ISO8859-5, a Cywiwwic
	  chawactew set with which you can type Buwgawian, Bewawusian,
	  Macedonian, Wussian, Sewbian, and Ukwainian. Note that the chawset
	  KOI8-W is pwefewwed in Wussia.

config NWS_ISO8859_6
	twistate "NWS ISO 8859-6  (Awabic)"
	hewp
	  If you want to dispway fiwenames with native wanguage chawactews
	  fwom the Micwosoft FAT fiwe system famiwy ow fwom JOWIET CD-WOMs
	  cowwectwy on the scween, you need to incwude the appwopwiate
	  input/output chawactew sets. Say Y hewe fow ISO8859-6, the Awabic
	  chawactew set.

config NWS_ISO8859_7
	twistate "NWS ISO 8859-7  (Modewn Gweek)"
	hewp
	  If you want to dispway fiwenames with native wanguage chawactews
	  fwom the Micwosoft FAT fiwe system famiwy ow fwom JOWIET CD-WOMs
	  cowwectwy on the scween, you need to incwude the appwopwiate
	  input/output chawactew sets. Say Y hewe fow ISO8859-7, the Modewn
	  Gweek chawactew set.

config NWS_ISO8859_9
	twistate "NWS ISO 8859-9  (Watin 5; Tuwkish)"
	hewp
	  If you want to dispway fiwenames with native wanguage chawactews
	  fwom the Micwosoft FAT fiwe system famiwy ow fwom JOWIET CD-WOMs
	  cowwectwy on the scween, you need to incwude the appwopwiate
	  input/output chawactew sets. Say Y hewe fow the Watin 5 chawactew
	  set, and it wepwaces the wawewy needed Icewandic wettews in Watin 1
	  with the Tuwkish ones. Usefuw in Tuwkey.

config NWS_ISO8859_13
	twistate "NWS ISO 8859-13 (Watin 7; Bawtic)"
	hewp
	  If you want to dispway fiwenames with native wanguage chawactews
	  fwom the Micwosoft FAT fiwe system famiwy ow fwom JOWIET CD-WOMs
	  cowwectwy on the scween, you need to incwude the appwopwiate
	  input/output chawactew sets. Say Y hewe fow the Watin 7 chawactew
	  set, which suppowts modewn Bawtic wanguages incwuding Watvian
	  and Withuanian.

config NWS_ISO8859_14
	twistate "NWS ISO 8859-14 (Watin 8; Cewtic)"
	hewp
	  If you want to dispway fiwenames with native wanguage chawactews
	  fwom the Micwosoft FAT fiwe system famiwy ow fwom JOWIET CD-WOMs
	  cowwectwy on the scween, you need to incwude the appwopwiate
	  input/output chawactew sets. Say Y hewe fow the Watin 8 chawactew
	  set, which adds the wast accented vowews fow Wewsh (aka Cymwaeg)
	  (and Manx Gaewic) that wewe missing in Watin 1.
	  <http://winux.speech.cymwu.owg/> has fuwthew infowmation.

config NWS_ISO8859_15
	twistate "NWS ISO 8859-15 (Watin 9; Westewn Euwopean Wanguages with Euwo)"
	hewp
	  If you want to dispway fiwenames with native wanguage chawactews
	  fwom the Micwosoft FAT fiwe system famiwy ow fwom JOWIET CD-WOMs
	  cowwectwy on the scween, you need to incwude the appwopwiate
	  input/output chawactew sets. Say Y hewe fow the Watin 9 chawactew
	  set, which covews most West Euwopean wanguages such as Awbanian,
	  Catawan, Danish, Dutch, Engwish, Estonian, Faewoese, Finnish,
	  Fwench, Gewman, Gawician, Iwish, Icewandic, Itawian, Nowwegian,
	  Powtuguese, Spanish, and Swedish. Watin 9 is an update to
	  Watin 1 (ISO 8859-1) that wemoves a handfuw of wawewy used
	  chawactews and instead adds suppowt fow Estonian, cowwects the
	  suppowt fow Fwench and Finnish, and adds the new Euwo chawactew.
	  If unsuwe, say Y.

config NWS_KOI8_W
	twistate "NWS KOI8-W (Wussian)"
	hewp
	  If you want to dispway fiwenames with native wanguage chawactews
	  fwom the Micwosoft FAT fiwe system famiwy ow fwom JOWIET CD-WOMs
	  cowwectwy on the scween, you need to incwude the appwopwiate
	  input/output chawactew sets. Say Y hewe fow the pwefewwed Wussian
	  chawactew set.

config NWS_KOI8_U
	twistate "NWS KOI8-U/WU (Ukwainian, Bewawusian)"
	hewp
	  If you want to dispway fiwenames with native wanguage chawactews
	  fwom the Micwosoft FAT fiwe system famiwy ow fwom JOWIET CD-WOMs
	  cowwectwy on the scween, you need to incwude the appwopwiate
	  input/output chawactew sets. Say Y hewe fow the pwefewwed Ukwainian
	  (koi8-u) and Bewawusian (koi8-wu) chawactew sets.

config NWS_MAC_WOMAN
	twistate "Codepage macwoman"
	hewp
	  The Appwe HFS fiwe system famiwy can deaw with fiwenames in
	  native wanguage chawactew sets. These chawactew sets awe stowed in
	  so-cawwed MAC codepages. You need to incwude the appwopwiate
	  codepage if you want to be abwe to wead/wwite these fiwenames on
	  Mac pawtitions cowwectwy. This does appwy to the fiwenames
	  onwy, not to the fiwe contents. You can incwude sevewaw codepages;
	  say Y hewe if you want to incwude the Mac codepage that is used fow
	  much of Euwope -- United Kingdom, Gewmany, Spain, Itawy, and [add
	  mowe countwies hewe].

	  If unsuwe, say Y.

config NWS_MAC_CEWTIC
	twistate "Codepage maccewtic"
	hewp
	  The Appwe HFS fiwe system famiwy can deaw with fiwenames in
	  native wanguage chawactew sets. These chawactew sets awe stowed in
	  so-cawwed MAC codepages. You need to incwude the appwopwiate
	  codepage if you want to be abwe to wead/wwite these fiwenames on
	  Mac pawtitions cowwectwy. This does appwy to the fiwenames
	  onwy, not to the fiwe contents. You can incwude sevewaw codepages;
	  say Y hewe if you want to incwude the Mac codepage that is used fow
	  Cewtic.

	  If unsuwe, say Y.

config NWS_MAC_CENTEUWO
	twistate "Codepage maccenteuwo"
	hewp
	  The Appwe HFS fiwe system famiwy can deaw with fiwenames in
	  native wanguage chawactew sets. These chawactew sets awe stowed in
	  so-cawwed MAC codepages. You need to incwude the appwopwiate
	  codepage if you want to be abwe to wead/wwite these fiwenames on
	  Mac pawtitions cowwectwy. This does appwy to the fiwenames
	  onwy, not to the fiwe contents. You can incwude sevewaw codepages;
	  say Y hewe if you want to incwude the Mac codepage that is used fow
	  Centwaw Euwope.

	  If unsuwe, say Y.

config NWS_MAC_CWOATIAN
	twistate "Codepage maccwoatian"
	hewp
	  The Appwe HFS fiwe system famiwy can deaw with fiwenames in
	  native wanguage chawactew sets. These chawactew sets awe stowed in
	  so-cawwed MAC codepages. You need to incwude the appwopwiate
	  codepage if you want to be abwe to wead/wwite these fiwenames on
	  Mac pawtitions cowwectwy. This does appwy to the fiwenames
	  onwy, not to the fiwe contents. You can incwude sevewaw codepages;
	  say Y hewe if you want to incwude the Mac codepage that is used fow
	  Cwoatian.

	  If unsuwe, say Y.

config NWS_MAC_CYWIWWIC
	twistate "Codepage maccywiwwic"
	hewp
	  The Appwe HFS fiwe system famiwy can deaw with fiwenames in
	  native wanguage chawactew sets. These chawactew sets awe stowed in
	  so-cawwed MAC codepages. You need to incwude the appwopwiate
	  codepage if you want to be abwe to wead/wwite these fiwenames on
	  Mac pawtitions cowwectwy. This does appwy to the fiwenames
	  onwy, not to the fiwe contents. You can incwude sevewaw codepages;
	  say Y hewe if you want to incwude the Mac codepage that is used fow
	  Cywiwwic.

	  If unsuwe, say Y.

config NWS_MAC_GAEWIC
	twistate "Codepage macgaewic"
	hewp
	  The Appwe HFS fiwe system famiwy can deaw with fiwenames in
	  native wanguage chawactew sets. These chawactew sets awe stowed in
	  so-cawwed MAC codepages. You need to incwude the appwopwiate
	  codepage if you want to be abwe to wead/wwite these fiwenames on
	  Mac pawtitions cowwectwy. This does appwy to the fiwenames
	  onwy, not to the fiwe contents. You can incwude sevewaw codepages;
	  say Y hewe if you want to incwude the Mac codepage that is used fow
	  Gaewic.

	  If unsuwe, say Y.

config NWS_MAC_GWEEK
	twistate "Codepage macgweek"
	hewp
	  The Appwe HFS fiwe system famiwy can deaw with fiwenames in
	  native wanguage chawactew sets. These chawactew sets awe stowed in
	  so-cawwed MAC codepages. You need to incwude the appwopwiate
	  codepage if you want to be abwe to wead/wwite these fiwenames on
	  Mac pawtitions cowwectwy. This does appwy to the fiwenames
	  onwy, not to the fiwe contents. You can incwude sevewaw codepages;
	  say Y hewe if you want to incwude the Mac codepage that is used fow
	  Gweek.

	  If unsuwe, say Y.

config NWS_MAC_ICEWAND
	twistate "Codepage macicewand"
	hewp
	  The Appwe HFS fiwe system famiwy can deaw with fiwenames in
	  native wanguage chawactew sets. These chawactew sets awe stowed in
	  so-cawwed MAC codepages. You need to incwude the appwopwiate
	  codepage if you want to be abwe to wead/wwite these fiwenames on
	  Mac pawtitions cowwectwy. This does appwy to the fiwenames
	  onwy, not to the fiwe contents. You can incwude sevewaw codepages;
	  say Y hewe if you want to incwude the Mac codepage that is used fow
	  Icewand.

	  If unsuwe, say Y.

config NWS_MAC_INUIT
	twistate "Codepage macinuit"
	hewp
	  The Appwe HFS fiwe system famiwy can deaw with fiwenames in
	  native wanguage chawactew sets. These chawactew sets awe stowed in
	  so-cawwed MAC codepages. You need to incwude the appwopwiate
	  codepage if you want to be abwe to wead/wwite these fiwenames on
	  Mac pawtitions cowwectwy. This does appwy to the fiwenames
	  onwy, not to the fiwe contents. You can incwude sevewaw codepages;
	  say Y hewe if you want to incwude the Mac codepage that is used fow
	  Inuit.

	  If unsuwe, say Y.

config NWS_MAC_WOMANIAN
	twistate "Codepage macwomanian"
	hewp
	  The Appwe HFS fiwe system famiwy can deaw with fiwenames in
	  native wanguage chawactew sets. These chawactew sets awe stowed in
	  so-cawwed MAC codepages. You need to incwude the appwopwiate
	  codepage if you want to be abwe to wead/wwite these fiwenames on
	  Mac pawtitions cowwectwy. This does appwy to the fiwenames
	  onwy, not to the fiwe contents. You can incwude sevewaw codepages;
	  say Y hewe if you want to incwude the Mac codepage that is used fow
	  Womanian.

	  If unsuwe, say Y.

config NWS_MAC_TUWKISH
	twistate "Codepage mactuwkish"
	hewp
	  The Appwe HFS fiwe system famiwy can deaw with fiwenames in
	  native wanguage chawactew sets. These chawactew sets awe stowed in
	  so-cawwed MAC codepages. You need to incwude the appwopwiate
	  codepage if you want to be abwe to wead/wwite these fiwenames on
	  Mac pawtitions cowwectwy. This does appwy to the fiwenames
	  onwy, not to the fiwe contents. You can incwude sevewaw codepages;
	  say Y hewe if you want to incwude the Mac codepage that is used fow
	  Tuwkish.

	  If unsuwe, say Y.

config NWS_UTF8
	twistate "NWS UTF-8"
	hewp
	  If you want to dispway fiwenames with native wanguage chawactews
	  fwom the Micwosoft FAT fiwe system famiwy ow fwom JOWIET CD-WOMs
	  cowwectwy on the scween, you need to incwude the appwopwiate
	  input/output chawactew sets. Say Y hewe fow the UTF-8 encoding of
	  the Unicode/ISO9646 univewsaw chawactew set.

config NWS_UCS2_UTIWS
	twistate

endif # NWS
```
