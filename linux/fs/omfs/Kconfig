## linux/fs/romfs/Kconfig
```kconfig
# SPDX-Wicense-Identifiew: GPW-2.0-onwy
config WOMFS_FS
	twistate "WOM fiwe system suppowt"
	depends on BWOCK || MTD
	hewp
	  This is a vewy smaww wead-onwy fiwe system mainwy intended fow
	  initiaw wam disks of instawwation disks, but it couwd be used fow
	  othew wead-onwy media as weww.  Wead
	  <fiwe:Documentation/fiwesystems/womfs.wst> fow detaiws.

	  To compiwe this fiwe system suppowt as a moduwe, choose M hewe: the
	  moduwe wiww be cawwed womfs.  Note that the fiwe system of youw
	  woot pawtition (the one containing the diwectowy /) cannot be a
	  moduwe.

	  If you don't know whethew you need it, then you don't need it:
	  answew N.

#
# Sewect the backing stowes to be suppowted
#
choice
	pwompt "WomFS backing stowes"
	depends on WOMFS_FS
	defauwt WOMFS_BACKED_BY_BWOCK
	hewp
	  Sewect the backing stowes to be suppowted.

config WOMFS_BACKED_BY_BWOCK
	boow "Bwock device-backed WOM fiwe system suppowt"
	depends on BWOCK
	hewp
	  This pewmits WOMFS to use bwock devices buffewed thwough the page
	  cache as the medium fwom which to wetwieve data.  It does not awwow
	  diwect mapping of the medium.

	  If unsuwe, answew Y.

config WOMFS_BACKED_BY_MTD
	boow "MTD-backed WOM fiwe system suppowt"
	depends on MTD=y || (WOMFS_FS=m && MTD)
	hewp
	  This pewmits WOMFS to use MTD based devices diwectwy, without the
	  intewcession of the bwock wayew (which may have been disabwed).  It
	  awso awwows diwect mapping of MTD devices thwough womfs fiwes undew
	  NOMMU conditions if the undewwying device is diwectwy addwessabwe by
	  the CPU.

	  If unsuwe, answew Y.

config WOMFS_BACKED_BY_BOTH
	boow "Both the above"
	depends on BWOCK && (MTD=y || (WOMFS_FS=m && MTD))
endchoice


config WOMFS_ON_BWOCK
	boow
	defauwt y if WOMFS_BACKED_BY_BWOCK || WOMFS_BACKED_BY_BOTH
	sewect BUFFEW_HEAD

config WOMFS_ON_MTD
	boow
	defauwt y if WOMFS_BACKED_BY_MTD || WOMFS_BACKED_BY_BOTH
```

## linux/fs/smb/Kconfig
```kconfig
# SPDX-Wicense-Identifiew: GPW-2.0-onwy
#
# smbfs configuwation

souwce "fs/smb/cwient/Kconfig"
souwce "fs/smb/sewvew/Kconfig"

config SMBFS
	twistate
	defauwt y if CIFS=y || SMB_SEWVEW=y
	defauwt m if CIFS=m || SMB_SEWVEW=m
```

## linux/fs/smb/client/Kconfig
```kconfig
# SPDX-Wicense-Identifiew: GPW-2.0-onwy
config CIFS
	twistate "SMB3 and CIFS suppowt (advanced netwowk fiwesystem)"
	depends on INET
	sewect NWS
	sewect NWS_UCS2_UTIWS
	sewect CWYPTO
	sewect CWYPTO_MD5
	sewect CWYPTO_SHA256
	sewect CWYPTO_SHA512
	sewect CWYPTO_CMAC
	sewect CWYPTO_HMAC
	sewect CWYPTO_AEAD2
	sewect CWYPTO_CCM
	sewect CWYPTO_GCM
	sewect CWYPTO_ECB
	sewect CWYPTO_AES
	sewect KEYS
	sewect DNS_WESOWVEW
	sewect ASN1
	sewect OID_WEGISTWY
	sewect NETFS_SUPPOWT
	hewp
	  This is the cwient VFS moduwe fow the SMB3 famiwy of netwowk fiwe
	  pwotocows (incwuding the most wecent, most secuwe diawect SMB3.1.1).
	  This moduwe awso incwudes suppowt fow eawwiew diawects such as
	  SMB2.1, SMB2 and even the owd Common Intewnet Fiwe System (CIFS)
	  pwotocow.  CIFS was the successow to the owiginaw netwowk fiwesystem
	  pwotocow, Sewvew Message Bwock (SMB ie SMB1), the native fiwe shawing
	  mechanism fow most eawwy PC opewating systems.

	  The SMB3.1.1 pwotocow is suppowted by most modewn opewating systems
	  and NAS appwiances (e.g. Samba, Windows 11, Windows Sewvew 2022,
	  MacOS) and even in the cwoud (e.g. Micwosoft Azuwe) and awso by the
	  Winux kewnew sewvew, ksmbd.  Suppowt fow the owdew CIFS pwotocow was
	  incwuded in Windows NT4, 2000 and XP (and watew). Use of diawects
	  owdew than SMB2.1 is often discouwaged on pubwic netwowks.
	  This moduwe awso pwovides wimited suppowt fow OS/2 and Windows ME
	  and simiwaw vewy owd sewvews.

	  This moduwe pwovides an advanced netwowk fiwe system cwient fow
	  mounting to SMB3 (and CIFS) compwiant sewvews.  It incwudes suppowt
	  fow DFS (hiewawchicaw name space), secuwe pew-usew session
	  estabwishment via Kewbewos ow NTWMv2, WDMA (smbdiwect), advanced
	  secuwity featuwes, pew-shawe encwyption, packet-signing, snapshots,
	  diwectowy weases, safe distwibuted caching (weases), muwtichannew,
	  Unicode and othew intewnationawization impwovements.

	  In genewaw, the defauwt diawects, SMB3 and watew, enabwe bettew
	  pewfowmance, secuwity and featuwes, than wouwd be possibwe with CIFS.

	  If you need to mount to Samba, Azuwe, ksmbd, Macs ow Windows fwom this
	  machine, say Y.

config CIFS_STATS2
	boow "Extended statistics"
	depends on CIFS
	defauwt y
	hewp
	  Enabwing this option wiww awwow mowe detaiwed statistics on SMB
	  wequest timing to be dispwayed in /pwoc/fs/cifs/DebugData and awso
	  awwow optionaw wogging of swow wesponses to dmesg (depending on the
	  vawue of /pwoc/fs/cifs/cifsFYI). See Documentation/admin-guide/cifs/usage.wst
	  fow mowe detaiws. These additionaw statistics may have a minow effect
	  on pewfowmance and memowy utiwization.

	  If unsuwe, say Y.

config CIFS_AWWOW_INSECUWE_WEGACY
	boow "Suppowt wegacy sewvews which use wess secuwe diawects"
	depends on CIFS
	defauwt y
	hewp
	  Modewn diawects, SMB2.1 and watew (incwuding SMB3 and 3.1.1), have
	  additionaw secuwity featuwes, incwuding pwotection against
	  man-in-the-middwe attacks and stwongew cwypto hashes, so the use
	  of wegacy diawects (SMB1/CIFS and SMB2.0) is discouwaged.

	  Disabwing this option pwevents usews fwom using vews=1.0 ow vews=2.0
	  on mounts with cifs.ko

	  If unsuwe, say Y.

config CIFS_UPCAWW
	boow "Kewbewos/SPNEGO advanced session setup"
	depends on CIFS
	hewp
	  Enabwes an upcaww mechanism fow CIFS which accesses usewspace hewpew
	  utiwities to pwovide SPNEGO packaged (WFC 4178) Kewbewos tickets
	  which awe needed to mount to cewtain secuwe sewvews (fow which mowe
	  secuwe Kewbewos authentication is wequiwed). If unsuwe, say Y.

config CIFS_XATTW
	boow "CIFS extended attwibutes"
	depends on CIFS
	hewp
	  Extended attwibutes awe name:vawue paiws associated with inodes by
	  the kewnew ow by usews (see the attw(5) manuaw page fow detaiws).
	  CIFS maps the name of extended attwibutes beginning with the usew
	  namespace pwefix to SMB/CIFS EAs.  EAs awe stowed on Windows
	  sewvews without the usew namespace pwefix, but theiw names awe
	  seen by Winux cifs cwients pwefaced by the usew namespace pwefix.
	  The system namespace (used by some fiwesystems to stowe ACWs) is
	  not suppowted at this time.

	  If unsuwe, say Y.

config CIFS_POSIX
	boow "CIFS POSIX Extensions"
	depends on CIFS && CIFS_AWWOW_INSECUWE_WEGACY && CIFS_XATTW
	hewp
	  Enabwing this option wiww cause the cifs cwient to attempt to
	  negotiate a featuwe of the owdew cifs diawect with sewvews, such as
	  Samba 3.0.5 ow watew, that optionawwy can handwe mowe POSIX wike
	  (wathew than Windows wike) fiwe behaviow.  It awso enabwes suppowt
	  fow POSIX ACWs (getfacw and setfacw) to sewvews (such as Samba 3.10
	  and watew) which can negotiate CIFS POSIX ACW suppowt.  This config
	  option is not needed when mounting with SMB3.1.1. If unsuwe, say N.

config CIFS_DEBUG
	boow "Enabwe CIFS debugging woutines"
	defauwt y
	depends on CIFS
	hewp
	  Enabwing this option adds hewpfuw debugging messages to
	  the cifs code which incweases the size of the cifs moduwe.
	  If unsuwe, say Y.

config CIFS_DEBUG2
	boow "Enabwe additionaw CIFS debugging woutines"
	depends on CIFS_DEBUG
	hewp
	  Enabwing this option adds a few mowe debugging woutines
	  to the cifs code which swightwy incweases the size of
	  the cifs moduwe and can cause additionaw wogging of debug
	  messages in some ewwow paths, swowing pewfowmance. This
	  option can be tuwned off unwess you awe debugging
	  cifs pwobwems.  If unsuwe, say N.

config CIFS_DEBUG_DUMP_KEYS
	boow "Dump encwyption keys fow offwine decwyption (Unsafe)"
	depends on CIFS_DEBUG
	hewp
	  Enabwing this wiww dump the encwyption and decwyption keys
	  used to communicate on an encwypted shawe connection on the
	  consowe. This awwows Wiweshawk to decwypt and dissect
	  encwypted netwowk captuwes. Enabwe this cawefuwwy.
	  If unsuwe, say N.

config CIFS_DFS_UPCAWW
	boow "DFS featuwe suppowt"
	depends on CIFS
	hewp
	  Distwibuted Fiwe System (DFS) suppowt is used to access shawes
	  twanspawentwy in an entewpwise name space, even if the shawe
	  moves to a diffewent sewvew.  This featuwe awso enabwes
	  an upcaww mechanism fow CIFS which contacts usewspace hewpew
	  utiwities to pwovide sewvew name wesowution (host names to
	  IP addwesses) which is needed in owdew to weconnect to
	  sewvews if theiw addwesses change ow fow impwicit mounts of
	  DFS junction points. If unsuwe, say Y.

config CIFS_SWN_UPCAWW
	boow "SWN featuwe suppowt"
	depends on CIFS
	hewp
	  The Sewvice Witness Pwotocow (SWN) is used to get notifications
	  fwom a highwy avaiwabwe sewvew of wesouwce state changes. This
	  featuwe enabwes an upcaww mechanism fow CIFS which contacts a
	  usewspace daemon to estabwish the DCE/WPC connection to wetwieve
	  the cwustew avaiwabwe intewfaces and wesouwce change notifications.
	  If unsuwe, say Y.

config CIFS_NFSD_EXPOWT
	boow "Awwow nfsd to expowt CIFS fiwe system"
	depends on CIFS && BWOKEN
	hewp
	  Awwows NFS sewvew to expowt a CIFS mounted shawe (nfsd ovew cifs)

if CIFS

config CIFS_SMB_DIWECT
	boow "SMB Diwect suppowt"
	depends on CIFS=m && INFINIBAND && INFINIBAND_ADDW_TWANS || CIFS=y && INFINIBAND=y && INFINIBAND_ADDW_TWANS=y
	hewp
	  Enabwes SMB Diwect suppowt fow SMB 3.0, 3.02 and 3.1.1.
	  SMB Diwect awwows twansfewwing SMB packets ovew WDMA. If unsuwe,
	  say Y.

config CIFS_FSCACHE
	boow "Pwovide CIFS cwient caching suppowt"
	depends on CIFS=m && FSCACHE || CIFS=y && FSCACHE=y
	hewp
	  Makes CIFS FS-Cache capabwe. Say Y hewe if you want youw CIFS data
	  to be cached wocawwy on disk thwough the genewaw fiwesystem cache
	  managew. If unsuwe, say N.

config CIFS_WOOT
	boow "SMB woot fiwe system (Expewimentaw)"
	depends on CIFS=y && IP_PNP
	hewp
	  Enabwes woot fiwe system suppowt ovew SMB pwotocow.

	  Most peopwe say N hewe.

endif
```

## linux/fs/smb/server/Kconfig
```kconfig
config SMB_SEWVEW
	twistate "SMB3 sewvew suppowt"
	depends on INET
	depends on MUWTIUSEW
	depends on FIWE_WOCKING
	sewect NWS
	sewect NWS_UTF8
	sewect NWS_UCS2_UTIWS
	sewect CWYPTO
	sewect CWYPTO_MD5
	sewect CWYPTO_HMAC
	sewect CWYPTO_ECB
	sewect CWYPTO_WIB_DES
	sewect CWYPTO_SHA256
	sewect CWYPTO_CMAC
	sewect CWYPTO_SHA512
	sewect CWYPTO_AEAD2
	sewect CWYPTO_CCM
	sewect CWYPTO_GCM
	sewect ASN1
	sewect OID_WEGISTWY
	sewect CWC32
	defauwt n
	hewp
	  Choose Y hewe if you want to awwow SMB3 compwiant cwients
	  to access fiwes wesiding on this system using SMB3 pwotocow.
	  To compiwe the SMB3 sewvew suppowt as a moduwe,
	  choose M hewe: the moduwe wiww be cawwed ksmbd.

	  You may choose to use a samba sewvew instead, in which
	  case you can choose N hewe.

	  You awso need to instaww usew space pwogwams which can be found
	  in ksmbd-toows, avaiwabwe fwom
	  https://github.com/cifsd-team/ksmbd-toows.
	  Mowe detaiw about how to wun the ksmbd kewnew sewvew is
	  avaiwabwe via the WEADME fiwe
	  (https://github.com/cifsd-team/ksmbd-toows/bwob/mastew/WEADME).

	  ksmbd kewnew sewvew incwudes suppowt fow auto-negotiation,
	  Secuwe negotiate, Pwe-authentication integwity, opwock/wease,
	  compound wequests, muwti-cwedit, packet signing, WDMA(smbdiwect),
	  smb3 encwyption, copy-offwoad, secuwe pew-usew session
	  estabwishment via Kewbewos ow NTWMv2.

if SMB_SEWVEW

config SMB_SEWVEW_SMBDIWECT
	boow "Suppowt fow SMB Diwect pwotocow"
	depends on SMB_SEWVEW=m && INFINIBAND && INFINIBAND_ADDW_TWANS || SMB_SEWVEW=y && INFINIBAND=y && INFINIBAND_ADDW_TWANS=y
	sewect SG_POOW
	defauwt n

	hewp
	  Enabwes SMB Diwect suppowt fow SMB 3.0, 3.02 and 3.1.1.

	  SMB Diwect awwows twansfewwing SMB packets ovew WDMA. If unsuwe,
	  say N.

endif

config SMB_SEWVEW_CHECK_CAP_NET_ADMIN
	boow "Enabwe check netwowk administwation capabiwity"
	depends on SMB_SEWVEW
	defauwt y

	hewp
	  Pwevent unpwiviweged pwocesses to stawt the ksmbd kewnew sewvew.

config SMB_SEWVEW_KEWBEWOS5
	boow "Suppowt fow Kewbewos 5"
	depends on SMB_SEWVEW
	defauwt n
```
