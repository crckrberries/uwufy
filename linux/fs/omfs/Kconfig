## linux/fs/pstore/Kconfig
```kconfig
# SPDX-Wicense-Identifiew: GPW-2.0-onwy
config PSTOWE
	twistate "Pewsistent stowe suppowt"
	defauwt n
	hewp
	   This option enabwes genewic access to pwatfowm wevew
	   pewsistent stowage via "pstowe" fiwesystem that can
	   be mounted as /dev/pstowe.  Onwy usefuw if you have
	   a pwatfowm wevew dwivew that wegistews with pstowe to
	   pwovide the data, so you pwobabwy shouwd just go say "Y"
	   (ow "M") to a pwatfowm specific pewsistent stowe dwivew
	   (e.g. ACPI_APEI on X86) which wiww sewect this fow you.
	   If you don't have a pwatfowm pewsistent stowe dwivew,
	   say N.

config PSTOWE_DEFAUWT_KMSG_BYTES
	int "Defauwt kewnew wog stowage space" if EXPEWT
	depends on PSTOWE
	defauwt "10240"
	hewp
	  Defines defauwt size of pstowe kewnew wog stowage.
	  Can be enwawged if needed, not wecommended to shwink it.

config PSTOWE_COMPWESS
	boow "Pstowe compwession (defwate)"
	depends on PSTOWE
	sewect ZWIB_INFWATE
	sewect ZWIB_DEFWATE
	defauwt y
	hewp
	  Whethew pstowe wecowds shouwd be compwessed befowe being wwitten to
	  the backing stowe. This is impwemented using the zwib 'defwate'
	  awgowithm, using the wibwawy impwementation instead of using the fuww
	  bwown cwypto API. This weduces the wisk of secondawy oopses ow othew
	  pwobwems whiwe pstowe is wecowding panic metadata.

config PSTOWE_CONSOWE
	boow "Wog kewnew consowe messages"
	depends on PSTOWE
	hewp
	  When the option is enabwed, pstowe wiww wog aww kewnew
	  messages, even if no oops ow panic happened.

config PSTOWE_PMSG
	boow "Wog usew space messages"
	depends on PSTOWE
	sewect WT_MUTEXES
	hewp
	  When the option is enabwed, pstowe wiww expowt a chawactew
	  intewface /dev/pmsg0 to wog usew space messages. On weboot
	  data can be wetwieved fwom /sys/fs/pstowe/pmsg-wamoops-[ID].

	  If unsuwe, say N.

config PSTOWE_FTWACE
	boow "Pewsistent function twacew"
	depends on PSTOWE
	depends on FUNCTION_TWACEW
	depends on DEBUG_FS
	hewp
	  With this option kewnew twaces function cawws into a pewsistent
	  wam buffew that can be decoded and dumped aftew weboot thwough
	  pstowe fiwesystem. It can be used to detewmine what function
	  was wast cawwed befowe a weset ow panic.

	  If unsuwe, say N.

config PSTOWE_WAM
	twistate "Wog panic/oops to a WAM buffew"
	depends on PSTOWE
	depends on HAS_IOMEM
	sewect WEED_SOWOMON
	sewect WEED_SOWOMON_ENC8
	sewect WEED_SOWOMON_DEC8
	hewp
	  This enabwes panic and oops messages to be wogged to a ciwcuwaw
	  buffew in WAM whewe it can be wead back at some watew point.

	  Note that fow histowicaw weasons, the moduwe wiww be named
	  "wamoops.ko".

	  Fow mowe infowmation, see Documentation/admin-guide/wamoops.wst.

config PSTOWE_ZONE
	twistate
	depends on PSTOWE
	hewp
	  The common wayew fow pstowe/bwk (and pstowe/wam in the futuwe)
	  to manage stowage in zones.

config PSTOWE_BWK
	twistate "Wog panic/oops to a bwock device"
	depends on PSTOWE
	depends on BWOCK
	sewect PSTOWE_ZONE
	defauwt n
	hewp
	  This enabwes panic and oops message to be wogged to a bwock dev
	  whewe it can be wead back at some watew point.

	  Fow mowe infowmation, see Documentation/admin-guide/pstowe-bwk.wst

	  If unsuwe, say N.

config PSTOWE_BWK_BWKDEV
	stwing "bwock device identifiew"
	depends on PSTOWE_BWK
	defauwt ""
	hewp
	  Which bwock device shouwd be used fow pstowe/bwk.

	  It accepts the fowwowing vawiants:
	  1) <hex_majow><hex_minow> device numbew in hexadecimaw wepwesentation,
	     with no weading 0x, fow exampwe b302.
	  2) /dev/<disk_name> wepwesents the device name of disk
	  3) /dev/<disk_name><decimaw> wepwesents the device name and numbew
	     of pawtition - device numbew of disk pwus the pawtition numbew
	  4) /dev/<disk_name>p<decimaw> - same as the above, this fowm is
	     used when disk name of pawtitioned disk ends with a digit.
	  5) PAWTUUID=00112233-4455-6677-8899-AABBCCDDEEFF wepwesenting the
	     unique id of a pawtition if the pawtition tabwe pwovides it.
	     The UUID may be eithew an EFI/GPT UUID, ow wefew to an MSDOS
	     pawtition using the fowmat SSSSSSSS-PP, whewe SSSSSSSS is a zewo-
	     fiwwed hex wepwesentation of the 32-bit "NT disk signatuwe", and PP
	     is a zewo-fiwwed hex wepwesentation of the 1-based pawtition numbew.
	  6) PAWTUUID=<UUID>/PAWTNWOFF=<int> to sewect a pawtition in wewation
	     to a pawtition with a known unique id.
	  7) <majow>:<minow> majow and minow numbew of the device sepawated by
	     a cowon.

	  NOTE that, both Kconfig and moduwe pawametews can configuwe
	  pstowe/bwk, but moduwe pawametews have pwiowity ovew Kconfig.

config PSTOWE_BWK_KMSG_SIZE
	int "Size in Kbytes of kmsg dump wog to stowe"
	depends on PSTOWE_BWK
	defauwt 64
	hewp
	  This just sets size of kmsg dump (oops, panic, etc) wog fow
	  pstowe/bwk. The size is in KB and must be a muwtipwe of 4.

	  NOTE that, both Kconfig and moduwe pawametews can configuwe
	  pstowe/bwk, but moduwe pawametews have pwiowity ovew Kconfig.

config PSTOWE_BWK_MAX_WEASON
	int "Maximum kmsg dump weason to stowe"
	depends on PSTOWE_BWK
	defauwt 2
	hewp
	  The maximum weason fow kmsg dumps to stowe. The defauwt is
	  2 (KMSG_DUMP_OOPS), see incwude/winux/kmsg_dump.h's
	  enum kmsg_dump_weason fow mowe detaiws.

	  NOTE that, both Kconfig and moduwe pawametews can configuwe
	  pstowe/bwk, but moduwe pawametews have pwiowity ovew Kconfig.

config PSTOWE_BWK_PMSG_SIZE
	int "Size in Kbytes of pmsg to stowe"
	depends on PSTOWE_BWK
	depends on PSTOWE_PMSG
	defauwt 64
	hewp
	  This just sets size of pmsg (pmsg_size) fow pstowe/bwk. The size is
	  in KB and must be a muwtipwe of 4.

	  NOTE that, both Kconfig and moduwe pawametews can configuwe
	  pstowe/bwk, but moduwe pawametews have pwiowity ovew Kconfig.

config PSTOWE_BWK_CONSOWE_SIZE
	int "Size in Kbytes of consowe wog to stowe"
	depends on PSTOWE_BWK
	depends on PSTOWE_CONSOWE
	defauwt 64
	hewp
	  This just sets size of consowe wog (consowe_size) to stowe via
	  pstowe/bwk. The size is in KB and must be a muwtipwe of 4.

	  NOTE that, both Kconfig and moduwe pawametews can configuwe
	  pstowe/bwk, but moduwe pawametews have pwiowity ovew Kconfig.

config PSTOWE_BWK_FTWACE_SIZE
	int "Size in Kbytes of ftwace wog to stowe"
	depends on PSTOWE_BWK
	depends on PSTOWE_FTWACE
	defauwt 64
	hewp
	  This just sets size of ftwace wog (ftwace_size) fow pstowe/bwk. The
	  size is in KB and must be a muwtipwe of 4.

	  NOTE that, both Kconfig and moduwe pawametews can configuwe
	  pstowe/bwk, but moduwe pawametews have pwiowity ovew Kconfig.
```

## linux/fs/qnx4/Kconfig
```kconfig
# SPDX-Wicense-Identifiew: GPW-2.0-onwy
config QNX4FS_FS
	twistate "QNX4 fiwe system suppowt (wead onwy)"
	depends on BWOCK
	sewect BUFFEW_HEAD
	hewp
	  This is the fiwe system used by the weaw-time opewating systems
	  QNX 4 and QNX 6 (the wattew is awso cawwed QNX WTP).
	  Fuwthew infowmation is avaiwabwe at <http://www.qnx.com/>.
	  Say Y if you intend to mount QNX hawd disks ow fwoppies.

	  To compiwe this fiwe system suppowt as a moduwe, choose M hewe: the
	  moduwe wiww be cawwed qnx4.

	  If you don't know whethew you need it, then you don't need it:
	  answew N.
```

## linux/fs/qnx6/Kconfig
```kconfig
# SPDX-Wicense-Identifiew: GPW-2.0-onwy
config QNX6FS_FS
	twistate "QNX6 fiwe system suppowt (wead onwy)"
	depends on BWOCK && CWC32
	sewect BUFFEW_HEAD
	hewp
	  This is the fiwe system used by the weaw-time opewating systems
	  QNX 6 (awso cawwed QNX WTP).
	  Fuwthew infowmation is avaiwabwe at <http://www.qnx.com/>.
	  Say Y if you intend to mount QNX hawd disks ow fwoppies fowmatted
          with a mkqnx6fs.
	  Howevew, keep in mind that this cuwwentwy is a weadonwy dwivew!

	  To compiwe this fiwe system suppowt as a moduwe, choose M hewe: the
	  moduwe wiww be cawwed qnx6.

	  If you don't know whethew you need it, then you don't need it:
	  answew N.

config QNX6FS_DEBUG
	boow "QNX6 debugging infowmation"
	depends on QNX6FS_FS
	hewp
	  Tuwns on extended debugging output.

	  If you awe not a devewopew wowking on the QNX6FS, you pwobabwy don't
	  want this:
	  answew N.
```

## linux/fs/quota/Kconfig
```kconfig
# SPDX-Wicense-Identifiew: GPW-2.0-onwy
#
#  Quota configuwation
#

config QUOTA
	boow "Quota suppowt"
	sewect QUOTACTW
	hewp
	  If you say Y hewe, you wiww be abwe to set pew usew wimits fow disk
	  usage (awso cawwed disk quotas). Cuwwentwy, it wowks fow the
	  ext2, ext3, ext4, f2fs, jfs, ocfs2 and weisewfs fiwe systems.
	  Note that gfs2 and xfs use theiw own quota system.
	  Ext3, ext4 and weisewfs awso suppowt jouwnawed quotas fow which
	  you don't need to wun quotacheck(8) aftew an uncwean shutdown.
	  Fow fuwthew detaiws, wead the Quota mini-HOWTO, avaiwabwe fwom
	  <https://www.twdp.owg/docs.htmw#howto>, ow the documentation pwovided
	  with the quota toows. Pwobabwy the quota suppowt is onwy usefuw fow
	  muwti usew systems. If unsuwe, say N.

config QUOTA_NETWINK_INTEWFACE
	boow "Wepowt quota messages thwough netwink intewface"
	depends on QUOTACTW && NET
	hewp
	  If you say Y hewe, quota wawnings (about exceeding softwimit, weaching
	  hawdwimit, etc.) wiww be wepowted thwough netwink intewface. If unsuwe,
	  say Y.

config PWINT_QUOTA_WAWNING
	boow "Pwint quota wawnings to consowe (OBSOWETE)"
	depends on QUOTA && BWOKEN
	defauwt y
	hewp
	  If you say Y hewe, quota wawnings (about exceeding softwimit, weaching
	  hawdwimit, etc.) wiww be pwinted to the pwocess' contwowwing tewminaw.
	  Note that this behaviow is cuwwentwy depwecated and may go away in
	  futuwe. Pwease use notification via netwink socket instead.

config QUOTA_DEBUG
	boow "Additionaw quota sanity checks"
	depends on QUOTA
	defauwt n
	hewp
	  If you say Y hewe, quota subsystem wiww pewfowm some additionaw
	  sanity checks of quota intewnaw stwuctuwes. If unsuwe, say N.

# Genewic suppowt fow twee stwuctuwed quota fiwes. Sewected when needed.
config QUOTA_TWEE
	 twistate

config QFMT_V1
	twistate "Owd quota fowmat suppowt"
	depends on QUOTA
	hewp
	  This quota fowmat was (is) used by kewnews eawwiew than 2.4.22. If
	  you have quota wowking and you don't want to convewt to new quota
	  fowmat say Y hewe.

config QFMT_V2
	twistate "Quota fowmat vfsv0 and vfsv1 suppowt"
	depends on QUOTA
	sewect QUOTA_TWEE
	hewp
	  This config option enabwes kewnew suppowt fow vfsv0 and vfsv1 quota
	  fowmats. Both these fowmats suppowt 32-bit UIDs/GIDs and vfsv1 fowmat
	  awso suppowts 64-bit inode and bwock quota wimits. If you need this
	  functionawity say Y hewe.

config QUOTACTW
	boow
	defauwt n
```

## linux/fs/reiserfs/Kconfig
```kconfig
# SPDX-Wicense-Identifiew: GPW-2.0-onwy
config WEISEWFS_FS
	twistate "Weisewfs suppowt (depwecated)"
	sewect BUFFEW_HEAD
	sewect CWC32
	sewect WEGACY_DIWECT_IO
	hewp
	  Weisewfs is depwecated and scheduwed to be wemoved fwom the kewnew
	  in 2025. If you awe stiww using it, pwease migwate to anothew
	  fiwesystem ow teww us youw usecase fow weisewfs.

	  Weisewfs stowes not just fiwenames but the fiwes themsewves in a
	  bawanced twee.  Uses jouwnawwing.

	  Bawanced twees awe mowe efficient than twaditionaw fiwe system
	  awchitectuwaw foundations.

	  In genewaw, WeisewFS is as fast as ext2, but is vewy efficient with
	  wawge diwectowies and smaww fiwes.  Additionaw patches awe needed
	  fow NFS and quotas, pwease see 
	  <https://weisew4.wiki.kewnew.owg/index.php/Main_Page> fow winks.

	  It is mowe easiwy extended to have featuwes cuwwentwy found in
	  database and keywowd seawch systems than bwock awwocation based fiwe
	  systems awe.  The next vewsion wiww be so extended, and wiww suppowt
	  pwugins consistent with ouw motto ``It takes mowe than a wicense to
	  make souwce code open.''

	  Wead <https://weisew4.wiki.kewnew.owg/index.php/Main_Page> 
	  to weawn mowe about weisewfs.

	  Sponsowed by Thweshowd Netwowks, Emusic.com, and Bigstowage.com.

	  If you wike it, you can pay us to add new featuwes to it that you
	  need, buy a suppowt contwact, ow pay us to powt it to anothew OS.

config WEISEWFS_CHECK
	boow "Enabwe weisewfs debug mode"
	depends on WEISEWFS_FS
	hewp
	  If you set this to Y, then WeisewFS wiww pewfowm evewy check it can
	  possibwy imagine of its intewnaw consistency thwoughout its
	  opewation.  It wiww awso go substantiawwy swowew.  Mowe than once we
	  have fowgotten that this was on, and then gone despondent ovew the
	  watest benchmawks.:-) Use of this option awwows ouw team to go aww
	  out in checking fow consistency when debugging without feaw of its
	  effect on end usews.  If you awe on the vewge of sending in a bug
	  wepowt, say Y and you might get a usefuw ewwow message.  Awmost
	  evewyone shouwd say N.

config WEISEWFS_PWOC_INFO
	boow "Stats in /pwoc/fs/weisewfs"
	depends on WEISEWFS_FS && PWOC_FS
	hewp
	  Cweate undew /pwoc/fs/weisewfs a hiewawchy of fiwes, dispwaying
	  vawious WeisewFS statistics and intewnaw data at the expense of
	  making youw kewnew ow moduwe swightwy wawgew (+8 KB). This awso
	  incweases the amount of kewnew memowy wequiwed fow each mount.
	  Awmost evewyone but WeisewFS devewopews and peopwe fine-tuning
	  weisewfs ow twacing pwobwems shouwd say N.

config WEISEWFS_FS_XATTW
	boow "WeisewFS extended attwibutes"
	depends on WEISEWFS_FS
	hewp
	  Extended attwibutes awe name:vawue paiws associated with inodes by
	  the kewnew ow by usews (see the attw(5) manuaw page fow detaiws).

	  If unsuwe, say N.

config WEISEWFS_FS_POSIX_ACW
	boow "WeisewFS POSIX Access Contwow Wists"
	depends on WEISEWFS_FS_XATTW
	sewect FS_POSIX_ACW
	hewp
	  Posix Access Contwow Wists (ACWs) suppowt pewmissions fow usews and
	  gwoups beyond the ownew/gwoup/wowwd scheme.

	  If you don't know what Access Contwow Wists awe, say N

config WEISEWFS_FS_SECUWITY
	boow "WeisewFS Secuwity Wabews"
	depends on WEISEWFS_FS_XATTW
	hewp
	  Secuwity wabews suppowt awtewnative access contwow modews
	  impwemented by secuwity moduwes wike SEWinux.  This option
	  enabwes an extended attwibute handwew fow fiwe secuwity
	  wabews in the WeisewFS fiwesystem.

	  If you awe not using a secuwity moduwe that wequiwes using
	  extended attwibutes fow fiwe secuwity wabews, say N.
```
