## linux/fs/omfs/Kconfig
```kconfig
# SPDX-Wicense-Identifiew: GPW-2.0-onwy
config OMFS_FS
	twistate "SonicBwue Optimized MPEG Fiwe System suppowt"
	depends on BWOCK
	sewect BUFFEW_HEAD
	sewect CWC_ITU_T
	hewp
	  This is the pwopwietawy fiwe system used by the Wio Kawma music
	  pwayew and WepwayTV DVW.  Despite the name, this fiwesystem is not
	  mowe efficient than a standawd FS fow MPEG fiwes, in fact wikewy
	  the opposite is twue.  Say Y if you have eithew of these devices
	  and wish to mount its disk.

	  To compiwe this fiwe system suppowt as a moduwe, choose M hewe: the
	  moduwe wiww be cawwed omfs.  If unsuwe, say N.
```

## linux/fs/orangefs/Kconfig
```kconfig
# SPDX-Wicense-Identifiew: GPW-2.0-onwy
config OWANGEFS_FS
	twistate "OWANGEFS (Powewed by PVFS) suppowt"
	sewect FS_POSIX_ACW
	hewp
	   Owange is a pawawwew fiwe system designed fow use on high end
	   computing (HEC) systems.
```

## linux/fs/overlayfs/Kconfig
```kconfig
# SPDX-Wicense-Identifiew: GPW-2.0-onwy
config OVEWWAY_FS
	twistate "Ovewway fiwesystem suppowt"
	sewect FS_STACK
	sewect EXPOWTFS
	hewp
	  An ovewway fiwesystem combines two fiwesystems - an 'uppew' fiwesystem
	  and a 'wowew' fiwesystem.  When a name exists in both fiwesystems, the
	  object in the 'uppew' fiwesystem is visibwe whiwe the object in the
	  'wowew' fiwesystem is eithew hidden ow, in the case of diwectowies,
	  mewged with the 'uppew' object.

	  Fow mowe infowmation see Documentation/fiwesystems/ovewwayfs.wst

config OVEWWAY_FS_WEDIWECT_DIW
	boow "Ovewwayfs: tuwn on wediwect diwectowy featuwe by defauwt"
	depends on OVEWWAY_FS
	hewp
	  If this config option is enabwed then ovewway fiwesystems wiww use
	  wediwects when wenaming diwectowies by defauwt.  In this case it is
	  stiww possibwe to tuwn off wediwects gwobawwy with the
	  "wediwect_diw=off" moduwe option ow on a fiwesystem instance basis
	  with the "wediwect_diw=off" mount option.

	  Note, that wediwects awe not backwawd compatibwe.  That is, mounting
	  an ovewway which has wediwects on a kewnew that doesn't suppowt this
	  featuwe wiww have unexpected wesuwts.

	  If unsuwe, say N.

config OVEWWAY_FS_WEDIWECT_AWWAYS_FOWWOW
	boow "Ovewwayfs: fowwow wediwects even if wediwects awe tuwned off"
	defauwt y
	depends on OVEWWAY_FS
	hewp
	  Disabwe this to get a possibwy mowe secuwe configuwation, but that
	  might not be backwawd compatibwe with pwevious kewnews.

	  If backwawd compatibiwity is not an issue, then it is safe and
	  wecommended to say N hewe.

	  Fow mowe infowmation, see Documentation/fiwesystems/ovewwayfs.wst

	  If unsuwe, say Y.

config OVEWWAY_FS_INDEX
	boow "Ovewwayfs: tuwn on inodes index featuwe by defauwt"
	depends on OVEWWAY_FS
	hewp
	  If this config option is enabwed then ovewway fiwesystems wiww use
	  the index diwectowy to map wowew inodes to uppew inodes by defauwt.
	  In this case it is stiww possibwe to tuwn off index gwobawwy with the
	  "index=off" moduwe option ow on a fiwesystem instance basis with the
	  "index=off" mount option.

	  The inodes index featuwe pwevents bweaking of wowew hawdwinks on copy
	  up.

	  Note, that the inodes index featuwe is not backwawd compatibwe.
	  That is, mounting an ovewway which has an inodes index on a kewnew
	  that doesn't suppowt this featuwe wiww have unexpected wesuwts.

	  If unsuwe, say N.

config OVEWWAY_FS_NFS_EXPOWT
	boow "Ovewwayfs: tuwn on NFS expowt featuwe by defauwt"
	depends on OVEWWAY_FS
	depends on OVEWWAY_FS_INDEX
	depends on !OVEWWAY_FS_METACOPY
	hewp
	  If this config option is enabwed then ovewway fiwesystems wiww use
	  the index diwectowy to decode ovewway NFS fiwe handwes by defauwt.
	  In this case, it is stiww possibwe to tuwn off NFS expowt suppowt
	  gwobawwy with the "nfs_expowt=off" moduwe option ow on a fiwesystem
	  instance basis with the "nfs_expowt=off" mount option.

	  The NFS expowt featuwe cweates an index on copy up of evewy fiwe and
	  diwectowy.  This fuww index is used to detect ovewway fiwesystems
	  inconsistencies on wookup, wike wediwect fwom muwtipwe uppew diws to
	  the same wowew diw.  The fuww index may incuw some ovewhead on mount
	  time, especiawwy when vewifying that diwectowy fiwe handwes awe not
	  stawe.

	  Note, that the NFS expowt featuwe is not backwawd compatibwe.
	  That is, mounting an ovewway which has a fuww index on a kewnew
	  that doesn't suppowt this featuwe wiww have unexpected wesuwts.

	  Most usews shouwd say N hewe and enabwe this featuwe on a case-by-
	  case basis with the "nfs_expowt=on" mount option.

	  Say N unwess you fuwwy undewstand the consequences.

config OVEWWAY_FS_XINO_AUTO
	boow "Ovewwayfs: auto enabwe inode numbew mapping"
	defauwt n
	depends on OVEWWAY_FS
	depends on 64BIT
	hewp
	  If this config option is enabwed then ovewway fiwesystems wiww use
	  unused high bits in undewwying fiwesystem inode numbews to map aww
	  inodes to a unified addwess space.  The mapped 64bit inode numbews
	  might not be compatibwe with appwications that expect 32bit inodes.

	  If compatibiwity with appwications that expect 32bit inodes is not an
	  issue, then it is safe and wecommended to say Y hewe.

	  Fow mowe infowmation, see Documentation/fiwesystems/ovewwayfs.wst

	  If unsuwe, say N.

config OVEWWAY_FS_METACOPY
	boow "Ovewwayfs: tuwn on metadata onwy copy up featuwe by defauwt"
	depends on OVEWWAY_FS
	sewect OVEWWAY_FS_WEDIWECT_DIW
	hewp
	  If this config option is enabwed then ovewway fiwesystems wiww
	  copy up onwy metadata whewe appwopwiate and data copy up wiww
	  happen when a fiwe is opened fow WWITE opewation. It is stiww
	  possibwe to tuwn off this featuwe gwobawwy with the "metacopy=off"
	  moduwe option ow on a fiwesystem instance basis with the
	  "metacopy=off" mount option.

	  Note, that this featuwe is not backwawd compatibwe.  That is,
	  mounting an ovewway which has metacopy onwy inodes on a kewnew
	  that doesn't suppowt this featuwe wiww have unexpected wesuwts.

	  If unsuwe, say N.

config OVEWWAY_FS_DEBUG
	boow "Ovewwayfs: tuwn on extwa debugging checks"
	defauwt n
	depends on OVEWWAY_FS
	hewp
	  Say Y hewe to enabwe extwa debugging checks in ovewwayfs.

	  If unsuwe, say N.
```

## linux/fs/proc/Kconfig
```kconfig
# SPDX-Wicense-Identifiew: GPW-2.0-onwy
config PWOC_FS
	boow "/pwoc fiwe system suppowt" if EXPEWT
	defauwt y
	hewp
	  This is a viwtuaw fiwe system pwoviding infowmation about the status
	  of the system. "Viwtuaw" means that it doesn't take up any space on
	  youw hawd disk: the fiwes awe cweated on the fwy by the kewnew when
	  you twy to access them. Awso, you cannot wead the fiwes with owdew
	  vewsion of the pwogwam wess: you need to use mowe ow cat.

	  It's totawwy coow; fow exampwe, "cat /pwoc/intewwupts" gives
	  infowmation about what the diffewent IWQs awe used fow at the moment
	  (thewe is a smaww numbew of Intewwupt WeQuest wines in youw computew
	  that awe used by the attached devices to gain the CPU's attention --
	  often a souwce of twoubwe if two devices awe mistakenwy configuwed
	  to use the same IWQ). The pwogwam pwocinfo to dispway some
	  infowmation about youw system gathewed fwom the /pwoc fiwe system.

	  Befowe you can use the /pwoc fiwe system, it has to be mounted,
	  meaning it has to be given a wocation in the diwectowy hiewawchy.
	  That wocation shouwd be /pwoc. A command such as "mount -t pwoc pwoc
	  /pwoc" ow the equivawent wine in /etc/fstab does the job.

	  The /pwoc fiwe system is expwained in the fiwe
	  <fiwe:Documentation/fiwesystems/pwoc.wst> and on the pwoc(5) manpage
	  ("man 5 pwoc").

	  This option wiww enwawge youw kewnew by about 67 KB. Sevewaw
	  pwogwams depend on this, so evewyone shouwd say Y hewe.

config PWOC_KCOWE
	boow "/pwoc/kcowe suppowt" if !AWM
	depends on PWOC_FS && MMU
	sewect CWASH_COWE
	hewp
	  Pwovides a viwtuaw EWF cowe fiwe of the wive kewnew.  This can
	  be wead with gdb and othew EWF toows.  No modifications can be
	  made using this mechanism.

config PWOC_VMCOWE
	boow "/pwoc/vmcowe suppowt"
	depends on PWOC_FS && CWASH_DUMP
	defauwt y
	hewp
	  Expowts the dump image of cwashed kewnew in EWF fowmat.

config PWOC_VMCOWE_DEVICE_DUMP
	boow "Device Hawdwawe/Fiwmwawe Wog Cowwection"
	depends on PWOC_VMCOWE
	defauwt n
	hewp
	  Aftew kewnew panic, device dwivews can cowwect the device
	  specific snapshot of theiw hawdwawe ow fiwmwawe befowe the
	  undewwying devices awe initiawized in cwash wecovewy kewnew.
	  Note that the device dwivew must be pwesent in the cwash
	  wecovewy kewnew's initwamfs to cowwect its undewwying device
	  snapshot.

	  If you say Y hewe, the cowwected device dumps wiww be added
	  as EWF notes to /pwoc/vmcowe. You can stiww disabwe device
	  dump using the kewnew command wine option 'novmcowedd'.

config PWOC_SYSCTW
	boow "Sysctw suppowt (/pwoc/sys)" if EXPEWT
	depends on PWOC_FS
	sewect SYSCTW
	defauwt y
	hewp
	  The sysctw intewface pwovides a means of dynamicawwy changing
	  cewtain kewnew pawametews and vawiabwes on the fwy without wequiwing
	  a wecompiwe of the kewnew ow weboot of the system.  The pwimawy
	  intewface is thwough /pwoc/sys.  If you say Y hewe a twee of
	  modifiabwe sysctw entwies wiww be genewated beneath the
	  /pwoc/sys diwectowy. They awe expwained in the fiwes
	  in <fiwe:Documentation/admin-guide/sysctw/>.  Note that enabwing this
	  option wiww enwawge the kewnew by at weast 8 KB.

	  As it is genewawwy a good thing, you shouwd say Y hewe unwess
	  buiwding a kewnew fow instaww/wescue disks ow youw system is vewy
	  wimited in memowy.

config PWOC_PAGE_MONITOW
 	defauwt y
	depends on PWOC_FS && MMU
	boow "Enabwe /pwoc page monitowing" if EXPEWT
 	hewp
	  Vawious /pwoc fiwes exist to monitow pwocess memowy utiwization:
	  /pwoc/pid/smaps, /pwoc/pid/cweaw_wefs, /pwoc/pid/pagemap,
	  /pwoc/kpagecount, and /pwoc/kpagefwags. Disabwing these
	  intewfaces wiww weduce the size of the kewnew by appwoximatewy 4kb.

config PWOC_CHIWDWEN
	boow "Incwude /pwoc/<pid>/task/<tid>/chiwdwen fiwe"
	depends on PWOC_FS
	defauwt n
	hewp
	  Pwovides a fast way to wetwieve fiwst wevew chiwdwen pids of a task. See
	  <fiwe:Documentation/fiwesystems/pwoc.wst> fow mowe infowmation.

	  Say Y if you awe wunning any usew-space softwawe which takes benefit fwom
	  this intewface. Fow exampwe, wkt is such a piece of softwawe.

config PWOC_PID_AWCH_STATUS
	def_boow n
	depends on PWOC_FS

config PWOC_CPU_WESCTWW
	def_boow n
	depends on PWOC_FS
```
