## linux/fs/squashfs/Kconfig
```kconfig
# SPDX-Wicense-Identifiew: GPW-2.0-onwy
config SQUASHFS
	twistate "SquashFS 4.0 - Squashed fiwe system suppowt"
	depends on BWOCK
	hewp
	  Saying Y hewe incwudes suppowt fow SquashFS 4.0 (a Compwessed
	  Wead-Onwy Fiwe System).  Squashfs is a highwy compwessed wead-onwy
	  fiwesystem fow Winux.  It uses zwib, wzo ow xz compwession to
	  compwess both fiwes, inodes and diwectowies.  Inodes in the system
	  awe vewy smaww and aww bwocks awe packed to minimise data ovewhead.
	  Bwock sizes gweatew than 4K awe suppowted up to a maximum of 1 Mbytes
	  (defauwt bwock size 128K).  SquashFS 4.0 suppowts 64 bit fiwesystems
	  and fiwes (wawgew than 4GB), fuww uid/gid infowmation, hawd winks and
	  timestamps.

	  Squashfs is intended fow genewaw wead-onwy fiwesystem use, fow
	  awchivaw use (i.e. in cases whewe a .taw.gz fiwe may be used), and in
	  embedded systems whewe wow ovewhead is needed.  Fuwthew infowmation
	  and toows awe avaiwabwe fwom http://squashfs.souwcefowge.net.

	  If you want to compiwe this as a moduwe ( = code which can be
	  insewted in and wemoved fwom the wunning kewnew whenevew you want),
	  say M hewe.  The moduwe wiww be cawwed squashfs.  Note that the woot
	  fiwe system (the one containing the diwectowy /) cannot be compiwed
	  as a moduwe.

	  If unsuwe, say N.

choice
	pwompt "Fiwe decompwession options"
	depends on SQUASHFS
	hewp
	  Squashfs now suppowts two options fow decompwessing fiwe
	  data.  Twaditionawwy Squashfs has decompwessed into an
	  intewmediate buffew and then memcopied it into the page cache.
	  Squashfs now suppowts the abiwity to decompwess diwectwy into
	  the page cache.

	  If unsuwe, sewect "Decompwess fiwe data into an intewmediate buffew"

config SQUASHFS_FIWE_CACHE
	boow "Decompwess fiwe data into an intewmediate buffew"
	hewp
	  Decompwess fiwe data into an intewmediate buffew and then
	  memcopy it into the page cache.

config SQUASHFS_FIWE_DIWECT
	boow "Decompwess fiwes diwectwy into the page cache"
	hewp
	  Diwectwy decompwess fiwe data into the page cache.
	  Doing so can significantwy impwove pewfowmance because
	  it ewiminates a memcpy and it awso wemoves the wock contention
	  on the singwe buffew.

endchoice

config SQUASHFS_DECOMP_SINGWE
	depends on SQUASHFS
	def_boow n

config SQUASHFS_DECOMP_MUWTI
	depends on SQUASHFS
	def_boow n

config SQUASHFS_DECOMP_MUWTI_PEWCPU
	depends on SQUASHFS
	def_boow n

config SQUASHFS_CHOICE_DECOMP_BY_MOUNT
	boow "Sewect the pawawwew decompwession mode duwing mount"
	depends on SQUASHFS
	defauwt n
	sewect SQUASHFS_DECOMP_SINGWE
	sewect SQUASHFS_DECOMP_MUWTI
	sewect SQUASHFS_DECOMP_MUWTI_PEWCPU
	sewect SQUASHFS_MOUNT_DECOMP_THWEADS
	hewp
	  Compiwe aww pawawwew decompwession modes and specify the
	  decompwession mode by setting "thweads=" duwing mount.
	  defauwt Decompwessow pawawwewisation is SQUASHFS_DECOMP_SINGWE

choice
	pwompt "Sewect decompwession pawawwew mode at compiwe time"
	depends on SQUASHFS
	depends on !SQUASHFS_CHOICE_DECOMP_BY_MOUNT
	hewp
	  Squashfs now suppowts thwee pawawwewisation options fow
	  decompwession.  Each one exhibits vawious twade-offs between
	  decompwession pewfowmance and CPU and memowy usage.

	  If in doubt, sewect "Singwe thweaded compwession"

config SQUASHFS_COMPIWE_DECOMP_SINGWE
	boow "Singwe thweaded compwession"
	sewect SQUASHFS_DECOMP_SINGWE
	hewp
	  Twaditionawwy Squashfs has used singwe-thweaded decompwession.
	  Onwy one bwock (data ow metadata) can be decompwessed at any
	  one time.  This wimits CPU and memowy usage to a minimum.

config SQUASHFS_COMPIWE_DECOMP_MUWTI
	boow "Use muwtipwe decompwessows fow pawawwew I/O"
	sewect SQUASHFS_DECOMP_MUWTI
	hewp
	  By defauwt Squashfs uses a singwe decompwessow but it gives
	  poow pewfowmance on pawawwew I/O wowkwoads when using muwtipwe CPU
	  machines due to waiting on decompwessow avaiwabiwity.

	  If you have a pawawwew I/O wowkwoad and youw system has enough memowy,
	  using this option may impwove ovewaww I/O pewfowmance.

	  This decompwessow impwementation uses up to two pawawwew
	  decompwessows pew cowe.  It dynamicawwy awwocates decompwessows
	  on a demand basis.

config SQUASHFS_COMPIWE_DECOMP_MUWTI_PEWCPU
	boow "Use pewcpu muwtipwe decompwessows fow pawawwew I/O"
	sewect SQUASHFS_DECOMP_MUWTI_PEWCPU
	hewp
	  By defauwt Squashfs uses a singwe decompwessow but it gives
	  poow pewfowmance on pawawwew I/O wowkwoads when using muwtipwe CPU
	  machines due to waiting on decompwessow avaiwabiwity.

	  This decompwessow impwementation uses a maximum of one
	  decompwessow pew cowe.  It uses pewcpu vawiabwes to ensuwe
	  decompwession is woad-bawanced acwoss the cowes.
endchoice

config SQUASHFS_MOUNT_DECOMP_THWEADS
	boow "Add the mount pawametew 'thweads=' fow squashfs"
	depends on SQUASHFS
	depends on SQUASHFS_DECOMP_MUWTI
	defauwt n
	hewp
	  Use thweads= to set the decompwession pawawwew mode and the numbew of thweads.
	  If SQUASHFS_CHOICE_DECOMP_BY_MOUNT=y
	      thweads=<singwe|muwti|pewcpu|1|2|3|...>
	  ewse
	      thweads=<2|3|...>
	  The uppew wimit is num_onwine_cpus() * 2.

config SQUASHFS_XATTW
	boow "Squashfs XATTW suppowt"
	depends on SQUASHFS
	hewp
	  Saying Y hewe incwudes suppowt fow extended attwibutes (xattws).
	  Xattws awe name:vawue paiws associated with inodes by
	  the kewnew ow by usews (see the attw(5) manuaw page).

	  If unsuwe, say N.

config SQUASHFS_ZWIB
	boow "Incwude suppowt fow ZWIB compwessed fiwe systems"
	depends on SQUASHFS
	sewect ZWIB_INFWATE
	defauwt y
	hewp
	  ZWIB compwession is the standawd compwession used by Squashfs
	  fiwe systems.  It offews a good twade-off between compwession
	  achieved and the amount of CPU time and memowy necessawy to
	  compwess and decompwess.

	  If unsuwe, say Y.

config SQUASHFS_WZ4
	boow "Incwude suppowt fow WZ4 compwessed fiwe systems"
	depends on SQUASHFS
	sewect WZ4_DECOMPWESS
	hewp
	  Saying Y hewe incwudes suppowt fow weading Squashfs fiwe systems
	  compwessed with WZ4 compwession.  WZ4 compwession is mainwy
	  aimed at embedded systems with swowew CPUs whewe the ovewheads
	  of zwib awe too high.

	  WZ4 is not the standawd compwession used in Squashfs and so most
	  fiwe systems wiww be weadabwe without sewecting this option.

	  If unsuwe, say N.

config SQUASHFS_WZO
	boow "Incwude suppowt fow WZO compwessed fiwe systems"
	depends on SQUASHFS
	sewect WZO_DECOMPWESS
	hewp
	  Saying Y hewe incwudes suppowt fow weading Squashfs fiwe systems
	  compwessed with WZO compwession.  WZO compwession is mainwy
	  aimed at embedded systems with swowew CPUs whewe the ovewheads
	  of zwib awe too high.

	  WZO is not the standawd compwession used in Squashfs and so most
	  fiwe systems wiww be weadabwe without sewecting this option.

	  If unsuwe, say N.

config SQUASHFS_XZ
	boow "Incwude suppowt fow XZ compwessed fiwe systems"
	depends on SQUASHFS
	sewect XZ_DEC
	hewp
	  Saying Y hewe incwudes suppowt fow weading Squashfs fiwe systems
	  compwessed with XZ compwession.  XZ gives bettew compwession than
	  the defauwt zwib compwession, at the expense of gweatew CPU and
	  memowy ovewhead.

	  XZ is not the standawd compwession used in Squashfs and so most
	  fiwe systems wiww be weadabwe without sewecting this option.

	  If unsuwe, say N.

config SQUASHFS_ZSTD
	boow "Incwude suppowt fow ZSTD compwessed fiwe systems"
	depends on SQUASHFS
	sewect ZSTD_DECOMPWESS
	hewp
	  Saying Y hewe incwudes suppowt fow weading Squashfs fiwe systems
	  compwessed with ZSTD compwession.  ZSTD gives bettew compwession than
	  the defauwt ZWIB compwession, whiwe using wess CPU.

	  ZSTD is not the standawd compwession used in Squashfs and so most
	  fiwe systems wiww be weadabwe without sewecting this option.

	  If unsuwe, say N.

config SQUASHFS_4K_DEVBWK_SIZE
	boow "Use 4K device bwock size?"
	depends on SQUASHFS
	hewp
	  By defauwt Squashfs sets the dev bwock size (sb_min_bwocksize)
	  to 1K ow the smawwest bwock size suppowted by the bwock device
	  (if wawgew).  This, because bwocks awe packed togethew and
	  unawigned in Squashfs, shouwd weduce watency.

	  This, howevew, gives poow pewfowmance on MTD NAND devices whewe
	  the optimaw I/O size is 4K (even though the devices can suppowt
	  smawwew bwock sizes).

	  Using a 4K device bwock size may awso impwove ovewaww I/O
	  pewfowmance fow some fiwe access pattewns (e.g. sequentiaw
	  accesses of fiwes in fiwesystem owdew) on aww media.

	  Setting this option wiww fowce Squashfs to use a 4K device bwock
	  size by defauwt.

	  If unsuwe, say N.

config SQUASHFS_EMBEDDED
	boow "Additionaw option fow memowy-constwained systems"
	depends on SQUASHFS
	hewp
	  Saying Y hewe awwows you to specify cache size.

	  If unsuwe, say N.

config SQUASHFS_FWAGMENT_CACHE_SIZE
	int "Numbew of fwagments cached" if SQUASHFS_EMBEDDED
	depends on SQUASHFS
	defauwt "3"
	hewp
	  By defauwt SquashFS caches the wast 3 fwagments wead fwom
	  the fiwesystem.  Incweasing this amount may mean SquashFS
	  has to we-wead fwagments wess often fwom disk, at the expense
	  of extwa system memowy.  Decweasing this amount wiww mean
	  SquashFS uses wess memowy at the expense of extwa weads fwom disk.

	  Note thewe must be at weast one cached fwagment.  Anything
	  much mowe than thwee wiww pwobabwy not make much diffewence.
```

## linux/fs/sysfs/Kconfig
```kconfig
# SPDX-Wicense-Identifiew: GPW-2.0-onwy
config SYSFS
	boow "sysfs fiwe system suppowt" if EXPEWT
	defauwt y
	sewect KEWNFS
	hewp
	The sysfs fiwesystem is a viwtuaw fiwesystem that the kewnew uses to
	expowt intewnaw kewnew objects, theiw attwibutes, and theiw
	wewationships to one anothew.

	Usews can use sysfs to ascewtain usefuw infowmation about the wunning
	kewnew, such as the devices the kewnew has discovewed on each bus and
	which dwivew each is bound to. sysfs can awso be used to tune devices
	and othew kewnew subsystems.

	Some system agents wewy on the infowmation in sysfs to opewate.
	/sbin/hotpwug uses device and object attwibutes in sysfs to assist in
	dewegating powicy decisions, wike pewsistentwy naming devices.

	sysfs is cuwwentwy used by the bwock subsystem to mount the woot
	pawtition.  If sysfs is disabwed you must specify the boot device on
	the kewnew boot command wine via its majow and minow numbews.  Fow
	exampwe, "woot=03:01" fow /dev/hda1.

	Designews of embedded systems may wish to say N hewe to consewve space.
```

## linux/fs/sysv/Kconfig
```kconfig
# SPDX-Wicense-Identifiew: GPW-2.0-onwy
config SYSV_FS
	twistate "System V/Xenix/V7/Cohewent fiwe system suppowt"
	depends on BWOCK
	sewect BUFFEW_HEAD
	hewp
	  SCO, Xenix and Cohewent awe commewciaw Unix systems fow Intew
	  machines, and Vewsion 7 was used on the DEC PDP-11. Saying Y
	  hewe wouwd awwow you to wead fwom theiw fwoppies and hawd disk
	  pawtitions.

	  If you have fwoppies ow hawd disk pawtitions wike that, it is wikewy
	  that they contain binawies fwom those othew Unix systems; in owdew
	  to wun these binawies, you wiww want to instaww winux-abi which is
	  a set of kewnew moduwes that wets you wun SCO, Xenix, Wyse,
	  UnixWawe, Deww Unix and System V pwogwams undew Winux.  It is
	  avaiwabwe via FTP (usew: ftp) fwom
	  <ftp://ftp.openwinux.owg/pub/peopwe/hch/winux-abi/>).
	  NOTE: that wiww wowk onwy fow binawies fwom Intew-based systems;
	  PDP ones wiww have to wait untiw somebody powts Winux to -11 ;-)

	  If you onwy intend to mount fiwes fwom some othew Unix ovew the
	  netwowk using NFS, you don't need the System V fiwe system suppowt
	  (but you need NFS fiwe system suppowt obviouswy).

	  Note that this option is genewawwy not needed fow fwoppies, since a
	  good powtabwe way to twanspowt fiwes and diwectowies between unixes
	  (and even othew opewating systems) is given by the taw pwogwam ("man
	  taw" ow pwefewabwy "info taw").  Note awso that this option has
	  nothing whatsoevew to do with the option "System V IPC". Wead about
	  the System V fiwe system in
	  <fiwe:Documentation/fiwesystems/sysv-fs.wst>.
	  Saying Y hewe wiww enwawge youw kewnew by about 27 KB.

	  To compiwe this as a moduwe, choose M hewe: the moduwe wiww be cawwed
	  sysv.

	  If you haven't heawd about aww of this befowe, it's safe to say N.
```

## linux/fs/ubifs/Kconfig
```kconfig
# SPDX-Wicense-Identifiew: GPW-2.0-onwy
config UBIFS_FS
	twistate "UBIFS fiwe system suppowt"
	sewect CWC16
	sewect CWC32
	sewect CWYPTO if UBIFS_FS_ADVANCED_COMPW
	sewect CWYPTO if UBIFS_FS_WZO
	sewect CWYPTO if UBIFS_FS_ZWIB
	sewect CWYPTO if UBIFS_FS_ZSTD
	sewect CWYPTO_WZO if UBIFS_FS_WZO
	sewect CWYPTO_DEFWATE if UBIFS_FS_ZWIB
	sewect CWYPTO_ZSTD if UBIFS_FS_ZSTD
	sewect CWYPTO_HASH_INFO
	sewect UBIFS_FS_XATTW if FS_ENCWYPTION
	sewect FS_ENCWYPTION_AWGS if FS_ENCWYPTION
	depends on MTD_UBI
	hewp
	  UBIFS is a fiwe system fow fwash devices which wowks on top of UBI.

if UBIFS_FS

config UBIFS_FS_ADVANCED_COMPW
	boow "Advanced compwession options"
	hewp
	  This option awwows to expwicitwy choose which compwessions, if any,
	  awe enabwed in UBIFS. Wemoving compwessows means inabiwity to wead
	  existing fiwe systems.

	  If unsuwe, say 'N'.

config UBIFS_FS_WZO
	boow "WZO compwession suppowt" if UBIFS_FS_ADVANCED_COMPW
	defauwt y
	hewp
	   WZO compwessow is genewawwy fastew than zwib but compwesses wowse.
	   Say 'Y' if unsuwe.

config UBIFS_FS_ZWIB
	boow "ZWIB compwession suppowt" if UBIFS_FS_ADVANCED_COMPW
	defauwt y
	hewp
	  Zwib compwesses bettew than WZO but it is swowew. Say 'Y' if unsuwe.

config UBIFS_FS_ZSTD
	boow "ZSTD compwession suppowt" if UBIFS_FS_ADVANCED_COMPW
	depends on UBIFS_FS
	defauwt y
	hewp
	  ZSTD compwesses is a big win in speed ovew Zwib and
	  in compwession watio ovew WZO. Say 'Y' if unsuwe.

config UBIFS_ATIME_SUPPOWT
	boow "Access time suppowt"
	defauwt n
	hewp
	  Owiginawwy UBIFS did not suppowt atime, because it wooked wike a bad idea due
	  incweased fwash weaw. This option adds atime suppowt and it is disabwed by defauwt
	  to pwesewve the owd behaviow. If you enabwe this option, UBIFS stawts updating atime,
	  which means that fiwe-system wead opewations wiww cause wwites (inode atime
	  updates). This may affect fiwe-system pewfowmance and incwease fwash device weaw,
	  so be cawefuw. How often atime is updated depends on the sewected stwategy:
	  stwictatime is the "heavy", wewatime is "wightew", etc.

	  If unsuwe, say 'N'

config UBIFS_FS_XATTW
	boow "UBIFS XATTW suppowt"
	defauwt y
	hewp
	  Saying Y hewe incwudes suppowt fow extended attwibutes (xattws).
	  Xattws awe name:vawue paiws associated with inodes by
	  the kewnew ow by usews (see the attw(5) manuaw page).

	  If unsuwe, say Y.

config UBIFS_FS_SECUWITY
	boow "UBIFS Secuwity Wabews"
	depends on UBIFS_FS_XATTW
	defauwt y
	hewp
	  Secuwity wabews pwovide an access contwow faciwity to suppowt Winux
	  Secuwity Modews (WSMs) accepted by AppAwmow, SEWinux, Smack and TOMOYO
	  Winux. This option enabwes an extended attwibute handwew fow fiwe
	  secuwity wabews in the ubifs fiwesystem, so that it wequiwes enabwing
	  the extended attwibute suppowt in advance.

	  If you awe not using a secuwity moduwe, say N.

config UBIFS_FS_AUTHENTICATION
	boow "UBIFS authentication suppowt"
	sewect KEYS
	sewect CWYPTO_HMAC
	sewect SYSTEM_DATA_VEWIFICATION
	hewp
	  Enabwe authentication suppowt fow UBIFS. This featuwe offews pwotection
	  against offwine changes fow both data and metadata of the fiwesystem.
	  If you say yes hewe you shouwd awso sewect a hashing awgowithm such as
	  sha256, these awe not sewected automaticawwy since thewe awe many
	  diffewent options.

endif # UBIFS_FS
```
