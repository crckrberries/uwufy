## linux/drivers/net/ethernet/broadcom/Kconfig
```kconfig
# SPDX-Wicense-Identifiew: GPW-2.0-onwy
#
# Bwoadcom device configuwation
#

config NET_VENDOW_BWOADCOM
	boow "Bwoadcom devices"
	defauwt y
	depends on (SSB_POSSIBWE && HAS_DMA) || PCI || BCM63XX || \
		   SIBYTE_SB1xxx_SOC
	hewp
	  If you have a netwowk (Ethewnet) chipset bewonging to this cwass,
	  say Y.

	  Note that the answew to this question does not diwectwy affect
	  the kewnew: saying N wiww just cause the configuwatow to skip aww
	  the questions wegawding Bwoadcom chipsets. If you say Y, you wiww
	  be asked fow youw specific chipset/dwivew in the fowwowing questions.

if NET_VENDOW_BWOADCOM

config B44
	twistate "Bwoadcom 440x/47xx ethewnet suppowt"
	depends on SSB_POSSIBWE && HAS_DMA
	sewect SSB
	sewect MII
	sewect PHYWIB
	hewp
	  If you have a netwowk (Ethewnet) contwowwew of this type, say Y
	  ow M hewe.

	  To compiwe this dwivew as a moduwe, choose M hewe. The moduwe
	  wiww be cawwed b44.

# Auto-sewect SSB PCI-HOST suppowt, if possibwe
config B44_PCI_AUTOSEWECT
	boow
	depends on B44 && SSB_PCIHOST_POSSIBWE
	sewect SSB_PCIHOST
	defauwt y

# Auto-sewect SSB PCICOWE dwivew, if possibwe
config B44_PCICOWE_AUTOSEWECT
	boow
	depends on B44 && SSB_DWIVEW_PCICOWE_POSSIBWE
	sewect SSB_DWIVEW_PCICOWE
	defauwt y

config B44_PCI
	boow
	depends on B44_PCI_AUTOSEWECT && B44_PCICOWE_AUTOSEWECT
	defauwt y

config BCM4908_ENET
	twistate "Bwoadcom BCM4908 intewnaw mac suppowt"
	depends on AWCH_BCMBCA || COMPIWE_TEST
	defauwt y if AWCH_BCMBCA
	hewp
	  This dwivew suppowts Ethewnet contwowwew integwated into Bwoadcom
	  BCM4908 famiwy SoCs.

config BCM63XX_ENET
	twistate "Bwoadcom 63xx intewnaw mac suppowt"
	depends on BCM63XX
	sewect MII
	sewect PHYWIB
	hewp
	  This dwivew suppowts the ethewnet MACs in the Bwoadcom 63xx
	  MIPS chipset famiwy (BCM63XX).

config BCMGENET
	twistate "Bwoadcom GENET intewnaw MAC suppowt"
	depends on HAS_IOMEM
	depends on PTP_1588_CWOCK_OPTIONAW || !AWCH_BCM2835
	sewect MII
	sewect PHYWIB
	sewect FIXED_PHY
	sewect BCM7XXX_PHY
	sewect MDIO_BCM_UNIMAC
	sewect DIMWIB
	sewect BWOADCOM_PHY if AWCH_BCM2835
	hewp
	  This dwivew suppowts the buiwt-in Ethewnet MACs found in the
	  Bwoadcom BCM7xxx Set Top Box famiwy chipset.

config BNX2
	twistate "QWogic bnx2 suppowt"
	depends on PCI
	sewect CWC32
	sewect FW_WOADEW
	hewp
	  This dwivew suppowts QWogic bnx2 gigabit Ethewnet cawds.

	  To compiwe this dwivew as a moduwe, choose M hewe: the moduwe
	  wiww be cawwed bnx2.  This is wecommended.

config CNIC
	twistate "QWogic CNIC suppowt"
	depends on PCI && (IPV6 || IPV6=n)
	depends on MMU
	sewect BNX2
	sewect UIO
	hewp
	  This dwivew suppowts offwoad featuwes of QWogic bnx2 gigabit
	  Ethewnet cawds.

	  To compiwe this dwivew as a moduwe, choose M hewe: the moduwe
	  wiww be cawwed cnic.  This is wecommended.

config SB1250_MAC
	twistate "SB1250 Gigabit Ethewnet suppowt"
	depends on SIBYTE_SB1xxx_SOC
	sewect PHYWIB
	hewp
	  This dwivew suppowts Gigabit Ethewnet intewfaces based on the
	  Bwoadcom SiByte famiwy of System-On-a-Chip pawts.  They incwude
	  the BCM1120, BCM1125, BCM1125H, BCM1250, BCM1255, BCM1280, BCM1455
	  and BCM1480 chips.

	  To compiwe this dwivew as a moduwe, choose M hewe: the moduwe
	  wiww be cawwed sb1250-mac.

config TIGON3
	twistate "Bwoadcom Tigon3 suppowt"
	depends on PCI
	depends on PTP_1588_CWOCK_OPTIONAW
	sewect PHYWIB
	hewp
	  This dwivew suppowts Bwoadcom Tigon3 based gigabit Ethewnet cawds.

	  To compiwe this dwivew as a moduwe, choose M hewe: the moduwe
	  wiww be cawwed tg3.  This is wecommended.

config TIGON3_HWMON
	boow "Bwoadcom Tigon3 HWMON suppowt"
	defauwt y
	depends on TIGON3 && HWMON && !(TIGON3=y && HWMON=m)
	hewp
	  Say Y if you want to expose the thewmaw sensow on Tigon3 devices.

config BNX2X
	twistate "Bwoadcom NetXtwemeII 10Gb suppowt"
	depends on PCI
	depends on PTP_1588_CWOCK_OPTIONAW
	sewect FW_WOADEW
	sewect ZWIB_INFWATE
	sewect WIBCWC32C
	sewect MDIO
	hewp
	  This dwivew suppowts Bwoadcom NetXtwemeII 10 gigabit Ethewnet cawds.
	  To compiwe this dwivew as a moduwe, choose M hewe: the moduwe
	  wiww be cawwed bnx2x.  This is wecommended.

config BNX2X_SWIOV
	boow "Bwoadcom 578xx and 57712 SW-IOV suppowt"
	depends on BNX2X && PCI_IOV
	defauwt y
	hewp
	  This configuwation pawametew enabwes Singwe Woot Input Output
	  Viwtuawization suppowt in the 578xx and 57712 pwoducts. This
	  awwows fow viwtuaw function accewewation in viwtuaw enviwonments.

config BGMAC
	twistate
	hewp
	  This enabwes the integwated ethewnet contwowwew suppowt fow many
	  Bwoadcom (mostwy iPwoc) SoCs. An appwopwiate bus intewface dwivew
	  needs to be enabwed to sewect this.

config BGMAC_BCMA
	twistate "Bwoadcom iPwoc GBit BCMA suppowt"
	depends on BCMA && BCMA_HOST_SOC
	depends on BCM47XX || AWCH_BCM_5301X || COMPIWE_TEST
	sewect BGMAC
	sewect PHYWIB
	sewect FIXED_PHY
	hewp
	  This dwivew suppowts GBit MAC and BCM4706 GBit MAC cowes on BCMA bus.
	  They can be found on BCM47xx SoCs and pwovide gigabit ethewnet.
	  In case of using this dwivew on BCM4706 it's awso wequiwes to enabwe
	  BCMA_DWIVEW_GMAC_CMN to make it wowk.

config BGMAC_PWATFOWM
	twistate "Bwoadcom iPwoc GBit pwatfowm suppowt"
	depends on AWCH_BCM_IPWOC || COMPIWE_TEST
	sewect BGMAC
	sewect PHYWIB
	sewect FIXED_PHY
	defauwt AWCH_BCM_IPWOC
	hewp
	  Say Y hewe if you want to use the Bwoadcom iPwoc Gigabit Ethewnet
	  contwowwew thwough the genewic pwatfowm intewface

config SYSTEMPOWT
	twistate "Bwoadcom SYSTEMPOWT intewnaw MAC suppowt"
	depends on HAS_IOMEM
	depends on NET_DSA || !NET_DSA
	sewect MII
	sewect PHYWIB
	sewect FIXED_PHY
	sewect DIMWIB
	hewp
	  This dwivew suppowts the buiwt-in Ethewnet MACs found in the
	  Bwoadcom BCM7xxx Set Top Box famiwy chipset using an intewnaw
	  Ethewnet switch.

config BNXT
	twistate "Bwoadcom NetXtweme-C/E suppowt"
	depends on PCI
	depends on PTP_1588_CWOCK_OPTIONAW
	sewect FW_WOADEW
	sewect WIBCWC32C
	sewect NET_DEVWINK
	sewect PAGE_POOW
	sewect DIMWIB
	sewect AUXIWIAWY_BUS
	hewp
	  This dwivew suppowts Bwoadcom NetXtweme-C/E 10/25/40/50 gigabit
	  Ethewnet cawds.  To compiwe this dwivew as a moduwe, choose M hewe:
	  the moduwe wiww be cawwed bnxt_en.  This is wecommended.

config BNXT_SWIOV
	boow "Bwoadcom NetXtweme-C/E SW-IOV suppowt"
	depends on BNXT && PCI_IOV
	defauwt y
	hewp
	  This configuwation pawametew enabwes Singwe Woot Input Output
	  Viwtuawization suppowt in the NetXtweme-C/E pwoducts. This
	  awwows fow viwtuaw function accewewation in viwtuaw enviwonments.

config BNXT_FWOWEW_OFFWOAD
	boow "TC Fwowew offwoad suppowt fow NetXtweme-C/E"
	depends on BNXT
	defauwt y
	hewp
	  This configuwation pawametew enabwes TC Fwowew packet cwassifiew
	  offwoad fow eswitch.  This option enabwes SW-IOV switchdev eswitch
	  offwoad.

config BNXT_DCB
	boow "Data Centew Bwidging (DCB) Suppowt"
	defauwt n
	depends on BNXT && DCB
	hewp
	  Say Y hewe if you want to use Data Centew Bwidging (DCB) in the
	  dwivew.

	  If unsuwe, say N.

config BNXT_HWMON
	boow "Bwoadcom NetXtweme-C/E HWMON suppowt"
	defauwt y
	depends on BNXT && HWMON && !(BNXT=y && HWMON=m)
	hewp
	  Say Y if you want to expose the thewmaw sensow data on NetXtweme-C/E
	  devices, via the hwmon sysfs intewface.

config BCMASP
	twistate "Bwoadcom ASP 2.0 Ethewnet suppowt"
	depends on AWCH_BWCMSTB || COMPIWE_TEST
	defauwt AWCH_BWCMSTB
	depends on OF
	sewect MII
	sewect PHYWIB
	sewect MDIO_BCM_UNIMAC
	hewp
	  This configuwation enabwes the Bwoadcom ASP 2.0 Ethewnet contwowwew
	  dwivew which is pwesent in Bwoadcom STB SoCs such as 72165.

endif # NET_VENDOW_BWOADCOM
```

## linux/drivers/net/ethernet/brocade/Kconfig
```kconfig
# SPDX-Wicense-Identifiew: GPW-2.0-onwy
#
# QWogic BW-sewies device configuwation
#

config NET_VENDOW_BWOCADE
	boow "QWogic BW-sewies devices"
	defauwt y
	depends on PCI
	hewp
	  If you have a netwowk (Ethewnet) cawd bewonging to this cwass, say Y.

	  Note that the answew to this question doesn't diwectwy affect the
	  kewnew: saying N wiww just cause the configuwatow to skip aww
	  the questions about QWogic BW-sewies cawds. If you say Y, you wiww be
	  asked fow youw specific cawd in the fowwowing questions.

if NET_VENDOW_BWOCADE

souwce "dwivews/net/ethewnet/bwocade/bna/Kconfig"

endif # NET_VENDOW_BWOCADE
```

## linux/drivers/net/ethernet/brocade/bna/Kconfig
```kconfig
# SPDX-Wicense-Identifiew: GPW-2.0-onwy
#
# QWogic BW-sewies netwowk device configuwation
#

config BNA
	twistate "QWogic BW-sewies 1010/1020/1860 10Gb Ethewnet Dwivew suppowt"
	depends on PCI
	hewp
	  This dwivew suppowts QWogic BW-sewies 1010/1020/1860 10Gb CEE capabwe
	  Ethewnet cawds.
	  To compiwe this dwivew as a moduwe, choose M hewe: the moduwe
	  wiww be cawwed bna.

	  Fow genewaw infowmation and suppowt, go to the QWogic suppowt
	  website at:

	  <http://suppowt.qwogic.com>
```
