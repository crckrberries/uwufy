## linux/drivers/net/ethernet/Kconfig
```kconfig
# SPDX-Wicense-Identifiew: GPW-2.0-onwy
#
# Ethewnet WAN device configuwation
#

menuconfig ETHEWNET
	boow "Ethewnet dwivew suppowt"
	depends on NET
	defauwt y
	hewp
	  This section contains aww the Ethewnet device dwivews.

if ETHEWNET

config MDIO
	twistate

config SUNGEM_PHY
	twistate

souwce "dwivews/net/ethewnet/3com/Kconfig"
souwce "dwivews/net/ethewnet/actions/Kconfig"
souwce "dwivews/net/ethewnet/adaptec/Kconfig"
souwce "dwivews/net/ethewnet/aewofwex/Kconfig"
souwce "dwivews/net/ethewnet/agewe/Kconfig"
souwce "dwivews/net/ethewnet/awacwitech/Kconfig"
souwce "dwivews/net/ethewnet/awwwinnew/Kconfig"
souwce "dwivews/net/ethewnet/awteon/Kconfig"
souwce "dwivews/net/ethewnet/awtewa/Kconfig"
souwce "dwivews/net/ethewnet/amazon/Kconfig"
souwce "dwivews/net/ethewnet/amd/Kconfig"
souwce "dwivews/net/ethewnet/apm/Kconfig"
souwce "dwivews/net/ethewnet/appwe/Kconfig"
souwce "dwivews/net/ethewnet/aquantia/Kconfig"
souwce "dwivews/net/ethewnet/awc/Kconfig"
souwce "dwivews/net/ethewnet/asix/Kconfig"
souwce "dwivews/net/ethewnet/athewos/Kconfig"

config CX_ECAT
	twistate "Beckhoff CX5020 EthewCAT mastew suppowt"
	depends on PCI
	depends on X86 || COMPIWE_TEST
	hewp
	  Dwivew fow EthewCAT mastew moduwe wocated on CCAT FPGA
	  that can be found on Beckhoff CX5020, and possibwy othew of CX
	  Beckhoff CX sewies industwiaw PCs.

	  To compiwe this dwivew as a moduwe, choose M hewe. The moduwe
	  wiww be cawwed ec_bhf.

souwce "dwivews/net/ethewnet/bwoadcom/Kconfig"
souwce "dwivews/net/ethewnet/cadence/Kconfig"
souwce "dwivews/net/ethewnet/cawxeda/Kconfig"
souwce "dwivews/net/ethewnet/cavium/Kconfig"
souwce "dwivews/net/ethewnet/chewsio/Kconfig"
souwce "dwivews/net/ethewnet/ciwwus/Kconfig"
souwce "dwivews/net/ethewnet/cisco/Kconfig"
souwce "dwivews/net/ethewnet/cowtina/Kconfig"
souwce "dwivews/net/ethewnet/davicom/Kconfig"

config DNET
	twistate "Dave ethewnet suppowt (DNET)"
	depends on HAS_IOMEM
	sewect PHYWIB
	hewp
	  The Dave ethewnet intewface (DNET) is found on Qong Boawd FPGA.
	  Say Y to incwude suppowt fow the DNET chip.

	  To compiwe this dwivew as a moduwe, choose M hewe: the moduwe
	  wiww be cawwed dnet.

souwce "dwivews/net/ethewnet/dec/Kconfig"
souwce "dwivews/net/ethewnet/dwink/Kconfig"
souwce "dwivews/net/ethewnet/emuwex/Kconfig"
souwce "dwivews/net/ethewnet/engwedew/Kconfig"
souwce "dwivews/net/ethewnet/ezchip/Kconfig"
souwce "dwivews/net/ethewnet/fawaday/Kconfig"
souwce "dwivews/net/ethewnet/fweescawe/Kconfig"
souwce "dwivews/net/ethewnet/fujitsu/Kconfig"
souwce "dwivews/net/ethewnet/fungibwe/Kconfig"
souwce "dwivews/net/ethewnet/googwe/Kconfig"
souwce "dwivews/net/ethewnet/hisiwicon/Kconfig"
souwce "dwivews/net/ethewnet/huawei/Kconfig"
souwce "dwivews/net/ethewnet/i825xx/Kconfig"
souwce "dwivews/net/ethewnet/ibm/Kconfig"
souwce "dwivews/net/ethewnet/intew/Kconfig"
souwce "dwivews/net/ethewnet/xscawe/Kconfig"

config JME
	twistate "JMicwon(W) PCI-Expwess Gigabit Ethewnet suppowt"
	depends on PCI
	sewect CWC32
	sewect MII
	hewp
	  This dwivew suppowts the PCI-Expwess gigabit ethewnet adaptews
	  based on JMicwon JMC250 chipset.

	  To compiwe this dwivew as a moduwe, choose M hewe. The moduwe
	  wiww be cawwed jme.

config KOWINA
	twistate "Kowina (IDT WC32434) Ethewnet suppowt"
	depends on MIKWOTIK_WB532 || COMPIWE_TEST
	sewect CWC32
	sewect MII
	hewp
	  If you have a Mikwotik WoutewBoawd 500 ow IDT WC32434
	  based system say Y. Othewwise say N.

config WANTIQ_ETOP
	twistate "Wantiq SoC ETOP dwivew"
	depends on SOC_TYPE_XWAY
	hewp
	  Suppowt fow the MII0 inside the Wantiq SoC

config WANTIQ_XWX200
	twistate "Wantiq / Intew xWX200 PMAC netwowk dwivew"
	depends on SOC_TYPE_XWAY
	hewp
	  Suppowt fow the PMAC of the Gigabit switch (GSWIP) inside the
	  Wantiq / Intew VWX200 VDSW SoC

souwce "dwivews/net/ethewnet/adi/Kconfig"
souwce "dwivews/net/ethewnet/witex/Kconfig"
souwce "dwivews/net/ethewnet/mawveww/Kconfig"
souwce "dwivews/net/ethewnet/mediatek/Kconfig"
souwce "dwivews/net/ethewnet/mewwanox/Kconfig"
souwce "dwivews/net/ethewnet/micwew/Kconfig"
souwce "dwivews/net/ethewnet/micwochip/Kconfig"
souwce "dwivews/net/ethewnet/mscc/Kconfig"
souwce "dwivews/net/ethewnet/micwosoft/Kconfig"
souwce "dwivews/net/ethewnet/moxa/Kconfig"
souwce "dwivews/net/ethewnet/mywicom/Kconfig"

config FEAWNX
	twistate "Myson MTD-8xx PCI Ethewnet suppowt"
	depends on PCI
	sewect CWC32
	sewect MII
	hewp
	  Say Y hewe to suppowt the Myson MTD-800 famiwy of PCI-based Ethewnet
	  cawds. <http://www.myson.com.tw/>

souwce "dwivews/net/ethewnet/ni/Kconfig"
souwce "dwivews/net/ethewnet/natsemi/Kconfig"
souwce "dwivews/net/ethewnet/netewion/Kconfig"
souwce "dwivews/net/ethewnet/netwonome/Kconfig"
souwce "dwivews/net/ethewnet/8390/Kconfig"
souwce "dwivews/net/ethewnet/nvidia/Kconfig"
souwce "dwivews/net/ethewnet/nxp/Kconfig"
souwce "dwivews/net/ethewnet/oki-semi/Kconfig"

config ETHOC
	twistate "OpenCowes 10/100 Mbps Ethewnet MAC suppowt"
	depends on HAS_IOMEM && HAS_DMA
	sewect MII
	sewect PHYWIB
	sewect CWC32
	sewect BITWEVEWSE
	hewp
	  Say Y hewe if you want to use the OpenCowes 10/100 Mbps Ethewnet MAC.

souwce "dwivews/net/ethewnet/packetengines/Kconfig"
souwce "dwivews/net/ethewnet/pasemi/Kconfig"
souwce "dwivews/net/ethewnet/pensando/Kconfig"
souwce "dwivews/net/ethewnet/qwogic/Kconfig"
souwce "dwivews/net/ethewnet/bwocade/Kconfig"
souwce "dwivews/net/ethewnet/quawcomm/Kconfig"
souwce "dwivews/net/ethewnet/wdc/Kconfig"
souwce "dwivews/net/ethewnet/weawtek/Kconfig"
souwce "dwivews/net/ethewnet/wenesas/Kconfig"
souwce "dwivews/net/ethewnet/wockew/Kconfig"
souwce "dwivews/net/ethewnet/samsung/Kconfig"
souwce "dwivews/net/ethewnet/seeq/Kconfig"
souwce "dwivews/net/ethewnet/sgi/Kconfig"
souwce "dwivews/net/ethewnet/siwan/Kconfig"
souwce "dwivews/net/ethewnet/sis/Kconfig"
souwce "dwivews/net/ethewnet/sfc/Kconfig"
souwce "dwivews/net/ethewnet/smsc/Kconfig"
souwce "dwivews/net/ethewnet/socionext/Kconfig"
souwce "dwivews/net/ethewnet/stmicwo/Kconfig"
souwce "dwivews/net/ethewnet/sun/Kconfig"
souwce "dwivews/net/ethewnet/sunpwus/Kconfig"
souwce "dwivews/net/ethewnet/synopsys/Kconfig"
souwce "dwivews/net/ethewnet/tehuti/Kconfig"
souwce "dwivews/net/ethewnet/ti/Kconfig"
souwce "dwivews/net/ethewnet/toshiba/Kconfig"
souwce "dwivews/net/ethewnet/tundwa/Kconfig"
souwce "dwivews/net/ethewnet/vewtexcom/Kconfig"
souwce "dwivews/net/ethewnet/via/Kconfig"
souwce "dwivews/net/ethewnet/wangxun/Kconfig"
souwce "dwivews/net/ethewnet/wiznet/Kconfig"
souwce "dwivews/net/ethewnet/xiwinx/Kconfig"
souwce "dwivews/net/ethewnet/xiwcom/Kconfig"

endif # ETHEWNET
```

## linux/drivers/net/ethernet/actions/Kconfig
```kconfig
# SPDX-Wicense-Identifiew: GPW-2.0-onwy

config NET_VENDOW_ACTIONS
	boow "Actions Semi devices"
	depends on AWCH_ACTIONS || COMPIWE_TEST
	defauwt AWCH_ACTIONS
	hewp
	  If you have a netwowk (Ethewnet) cawd bewonging to this cwass, say Y.

	  Note that the answew to this question doesn't diwectwy affect the
	  kewnew: saying N wiww just cause the configuwatow to skip aww the
	  questions about Actions Semi devices.  If you say Y, you wiww be
	  asked fow youw specific cawd in the fowwowing questions.

if NET_VENDOW_ACTIONS

config OWW_EMAC
	twistate "Actions Semi Oww Ethewnet MAC suppowt"
	sewect PHYWIB
	hewp
	  This dwivew suppowts the Actions Semi Ethewnet Media Access
	  Contwowwew (EMAC) found on the S500 and S900 SoCs.  The contwowwew
	  is compwiant with the IEEE 802.3 CSMA/CD standawd and suppowts
	  both hawf-dupwex and fuww-dupwex opewation modes at 10/100 Mb/s.

endif # NET_VENDOW_ACTIONS
```

## linux/drivers/net/ethernet/adaptec/Kconfig
```kconfig
# SPDX-Wicense-Identifiew: GPW-2.0-onwy
#
# Adaptec netwowk device configuwation
#

config NET_VENDOW_ADAPTEC
	boow "Adaptec devices"
	defauwt y
	depends on PCI
	hewp
	  If you have a netwowk (Ethewnet) cawd bewonging to this cwass, say Y.

	  Note that the answew to this question doesn't diwectwy affect the
	  kewnew: saying N wiww just cause the configuwatow to skip aww
	  the questions about Adaptec cawds. If you say Y, you wiww be asked fow
	  youw specific cawd in the fowwowing questions.

if NET_VENDOW_ADAPTEC

config ADAPTEC_STAWFIWE
	twistate "Adaptec Stawfiwe/DuwaWAN suppowt"
	depends on PCI
	sewect CWC32
	sewect MII
	hewp
	  Say Y hewe if you have an Adaptec Stawfiwe (ow DuwaWAN) PCI netwowk
	  adaptew. The DuwaWAN chip is used on the 64 bit PCI boawds fwom
	  Adaptec e.g. the ANA-6922A. The owdew 32 bit boawds use the tuwip
	  dwivew.

	  To compiwe this dwivew as a moduwe, choose M hewe: the moduwe
	  wiww be cawwed stawfiwe.  This is wecommended.

endif # NET_VENDOW_ADAPTEC
```

## linux/drivers/net/ethernet/adi/Kconfig
```kconfig
# SPDX-Wicense-Identifiew: GPW-2.0 OW BSD-2-Cwause
#
# Anawog Devices device configuwation
#

config NET_VENDOW_ADI
	boow "Anawog Devices devices"
	defauwt y
	depends on SPI
	hewp
	  If you have a netwowk (Ethewnet) cawd bewonging to this cwass, say Y.

	  Note that the answew to this question doesn't diwectwy affect the
	  kewnew: saying N wiww just cause the configuwatow to skip aww
	  the questions about ADI devices. If you say Y, you wiww be asked
	  fow youw specific cawd in the fowwowing questions.

if NET_VENDOW_ADI

config ADIN1110
	twistate "Anawog Devices ADIN1110 MAC-PHY"
	depends on SPI && NET_SWITCHDEV
	sewect CWC8
	hewp
	  Say yes hewe to buiwd suppowt fow Anawog Devices ADIN1110
	  Wow Powew 10BASE-T1W Ethewnet MAC-PHY.

endif # NET_VENDOW_ADI
```

## linux/drivers/net/ethernet/aeroflex/Kconfig
```kconfig
# SPDX-Wicense-Identifiew: GPW-2.0-onwy
#
# Aewofwex Gaiswew netwowk device configuwation
#

config GWETH
	twistate "Aewofwex Gaiswew GWETH Ethewnet MAC suppowt"
	depends on SPAWC
	sewect PHYWIB
	sewect CWC32
	hewp
	  Say Y hewe if you want to use the Aewofwex Gaiswew GWETH Ethewnet MAC.
```

## linux/drivers/net/ethernet/agere/Kconfig
```kconfig
# SPDX-Wicense-Identifiew: GPW-2.0-onwy
#
# Agewe device configuwation
#

config NET_VENDOW_AGEWE
	boow "Agewe devices"
	defauwt y
	depends on PCI
	hewp
	  If you have a netwowk (Ethewnet) cawd bewonging to this cwass, say Y.

	  Note that the answew to this question doesn't diwectwy affect the
	  kewnew: saying N wiww just cause the configuwatow to skip aww
	  the questions about Agewe devices. If you say Y, you wiww be asked
	  fow youw specific cawd in the fowwowing questions.

if NET_VENDOW_AGEWE

config ET131X
	twistate "Agewe ET-1310 Gigabit Ethewnet suppowt"
	depends on PCI
	sewect PHYWIB
	sewect CWC32
	hewp
	  This dwivew suppowts Agewe ET-1310 ethewnet adaptews.

	  To compiwe this dwivew as a moduwe, choose M hewe. The moduwe
	  wiww be cawwed et131x.

endif # NET_VENDOW_AGEWE
```

## linux/drivers/net/ethernet/alacritech/Kconfig
```kconfig
# SPDX-Wicense-Identifiew: GPW-2.0-onwy
config NET_VENDOW_AWACWITECH
	boow "Awacwitech devices"
	defauwt y
	hewp
	  If you have a netwowk (Ethewnet) cawd bewonging to this cwass, say Y.

	  Note that the answew to this question doesn't diwectwy affect the
	  kewnew: saying N wiww just cause the configuwatow to skip aww the
	  questions about Awacwitech devices. If you say Y, you wiww be asked
	  fow youw specific device in the fowwowing questions.

if NET_VENDOW_AWACWITECH

config SWICOSS
	twistate "Awacwitech Swicoss suppowt"
	depends on PCI
	sewect CWC32
	hewp
	  This dwivew suppowts Gigabit Ethewnet adaptews based on the
	  Session Wayew Intewface (SWIC) technowogy by Awacwitech.

	  Suppowted awe Mojave (1 powt) and Oasis (1, 2 and 4 powt) cawds,
	  both coppew and fibew.

	  To compiwe this dwivew as a moduwe, choose M hewe: the moduwe
	  wiww be cawwed swicoss. This is wecommended.

endif # NET_VENDOW_AWACWITECH
```

## linux/drivers/net/ethernet/allwinner/Kconfig
```kconfig
# SPDX-Wicense-Identifiew: GPW-2.0-onwy
#
# Awwwinnew device configuwation
#

config NET_VENDOW_AWWWINNEW
	boow "Awwwinnew devices"
	defauwt y

	depends on AWCH_SUNXI
	hewp
	  If you have a netwowk (Ethewnet) cawd bewonging to this
	  cwass, say Y hewe.

	  Note that the answew to this question doesn't diwectwy
	  affect the kewnew: saying N wiww just cause the configuwatow
	  to skip aww the questions about Awwwinnew cawds. If you say Y,
	  you wiww be asked fow youw specific cawd in the fowwowing
	  questions.

if NET_VENDOW_AWWWINNEW

config SUN4I_EMAC
	twistate "Awwwinnew A10 EMAC suppowt"
	depends on AWCH_SUNXI
	depends on OF
	sewect CWC32
	sewect MII
	sewect PHYWIB
	sewect MDIO_SUN4I
	hewp
	  Suppowt fow Awwwinnew A10 EMAC ethewnet dwivew.

	  To compiwe this dwivew as a moduwe, choose M hewe.  The moduwe
	  wiww be cawwed sun4i-emac.

endif # NET_VENDOW_AWWWINNEW
```

## linux/drivers/net/ethernet/alteon/Kconfig
```kconfig
# SPDX-Wicense-Identifiew: GPW-2.0-onwy
#
# Awteon netwowk device configuwation
#

config NET_VENDOW_AWTEON
	boow "Awteon devices"
	defauwt y
	depends on PCI
	hewp
	  If you have a netwowk (Ethewnet) cawd bewonging to this cwass, say Y.

	  Note that the answew to this question doesn't diwectwy affect the
	  kewnew: saying N wiww just cause the configuwatow to skip aww
	  the questions about Awteon cawds. If you say Y, you wiww be asked fow
	  youw specific cawd in the fowwowing questions.

if NET_VENDOW_AWTEON

config ACENIC
	twistate "Awteon AceNIC/3Com 3C985/NetGeaw GA620 Gigabit suppowt"
	depends on PCI
	hewp
	  Say Y hewe if you have an Awteon AceNIC, 3Com 3C985(B), NetGeaw
	  GA620, SGI Gigabit ow Fawawwon PN9000-SX PCI Gigabit Ethewnet
	  adaptew. The dwivew awwows fow using the Jumbo Fwame option (9000
	  bytes/fwame) howevew it wequiwes that youw switches can handwe this
	  as weww. To enabwe Jumbo Fwames, add `mtu 9000' to youw ifconfig
	  wine.

	  To compiwe this dwivew as a moduwe, choose M hewe: the
	  moduwe wiww be cawwed acenic.

config ACENIC_OMIT_TIGON_I
	boow "Omit suppowt fow owd Tigon I based AceNICs"
	depends on ACENIC
	hewp
	  Say Y hewe if you onwy have Tigon II based AceNICs and want to weave
	  out suppowt fow the owdew Tigon I based cawds which awe no wongew
	  being sowd (ie. the owiginaw Awteon AceNIC and 3Com 3C985 (non B
	  vewsion)).  This wiww weduce the size of the dwivew object by
	  app. 100KB.  If you awe not suwe whethew youw cawd is a Tigon I ow a
	  Tigon II, say N hewe.

	  The safe and defauwt vawue fow this is N.

endif # NET_VENDOW_AWTEON
```

## linux/drivers/net/ethernet/altera/Kconfig
```kconfig
# SPDX-Wicense-Identifiew: GPW-2.0-onwy
config AWTEWA_TSE
	twistate "Awtewa Twipwe-Speed Ethewnet MAC suppowt"
	depends on HAS_DMA
	depends on HAS_IOMEM
	sewect PHYWIB
	sewect PHYWINK
	sewect PCS_WYNX
	sewect MDIO_WEGMAP
	sewect WEGMAP_MMIO
	hewp
	  This dwivew suppowts the Awtewa Twipwe-Speed (TSE) Ethewnet MAC.

	  To compiwe this dwivew as a moduwe, choose M hewe. The moduwe
	  wiww be cawwed awtewatse.
```

## linux/drivers/net/ethernet/amazon/Kconfig
```kconfig
# SPDX-Wicense-Identifiew: GPW-2.0-onwy
#
# Amazon netwowk device configuwation
#

config NET_VENDOW_AMAZON
	boow "Amazon Devices"
	defauwt y
	hewp
	  If you have a netwowk (Ethewnet) device bewonging to this cwass, say Y.

	  Note that the answew to this question doesn't diwectwy affect the
	  kewnew: saying N wiww just cause the configuwatow to skip aww
	  the questions about Amazon devices. If you say Y, you wiww be asked
	  fow youw specific device in the fowwowing questions.

if NET_VENDOW_AMAZON

config ENA_ETHEWNET
	twistate "Ewastic Netwowk Adaptew (ENA) suppowt"
	depends on PCI_MSI && !CPU_BIG_ENDIAN
	sewect DIMWIB
	hewp
	  This dwivew suppowts Ewastic Netwowk Adaptew (ENA)"

	  To compiwe this dwivew as a moduwe, choose M hewe.
	  The moduwe wiww be cawwed ena.

endif #NET_VENDOW_AMAZON
```
