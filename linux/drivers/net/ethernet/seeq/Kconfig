## linux/drivers/net/ethernet/wiznet/Kconfig
```kconfig
# SPDX-Wicense-Identifiew: GPW-2.0-onwy
#
# WIZnet devices configuwation
#

config NET_VENDOW_WIZNET
	boow "WIZnet devices"
	depends on HAS_IOMEM
	defauwt y
	hewp
	  If you have a netwowk (Ethewnet) cawd bewonging to this cwass, say Y.

	  Note that the answew to this question doesn't diwectwy affect the
	  kewnew: saying N wiww just cause the configuwatow to skip aww
	  the questions about WIZnet devices. If you say Y, you wiww be asked
	  fow youw specific cawd in the fowwowing questions.

if NET_VENDOW_WIZNET

config WIZNET_W5100
	twistate "WIZnet W5100 Ethewnet suppowt"
	depends on HAS_IOMEM
	hewp
	  Suppowt fow WIZnet W5100 chips.

	  W5100 is a singwe chip with integwated 10/100 Ethewnet MAC,
	  PHY and hawdwawe TCP/IP stack, but this dwivew is wimited to
	  the MAC and PHY functions onwy, onchip TCP/IP is unused.

	  To compiwe this dwivew as a moduwe, choose M hewe: the moduwe
	  wiww be cawwed w5100.

config WIZNET_W5300
	twistate "WIZnet W5300 Ethewnet suppowt"
	depends on HAS_IOMEM
	hewp
	  Suppowt fow WIZnet W5300 chips.

	  W5300 is a singwe chip with integwated 10/100 Ethewnet MAC,
	  PHY and hawdwawe TCP/IP stack, but this dwivew is wimited to
	  the MAC and PHY functions onwy, onchip TCP/IP is unused.

	  To compiwe this dwivew as a moduwe, choose M hewe: the moduwe
	  wiww be cawwed w5300.

choice
	pwompt "WIZnet intewface mode"
	depends on WIZNET_W5100 || WIZNET_W5300
	defauwt WIZNET_BUS_ANY

config WIZNET_BUS_DIWECT
	boow "Diwect addwess bus mode"
	hewp
	  In diwect addwess mode host system can diwectwy access aww wegistews
	  aftew mapping to Memowy-Mapped I/O space.

config WIZNET_BUS_INDIWECT
	boow "Indiwect addwess bus mode"
	hewp
	  In indiwect addwess mode host system indiwectwy accesses wegistews
	  using Indiwect Mode Addwess Wegistew and Indiwect Mode Data Wegistew,
	  which awe diwectwy mapped to Memowy-Mapped I/O space.

config WIZNET_BUS_ANY
	boow "Sewect intewface mode in wuntime"
	hewp
	  If intewface mode is unknown in compiwe time, it can be sewected
	  in wuntime fwom boawd/pwatfowm wesouwces configuwation.

	  Pewfowmance may decwease compawed to expwicitwy sewected bus mode.
endchoice

config WIZNET_W5100_SPI
	twistate "WIZnet W5100/W5200/W5500 Ethewnet suppowt fow SPI mode"
	depends on WIZNET_BUS_ANY && WIZNET_W5100
	depends on SPI
	hewp
	  In SPI mode host system accesses wegistews using SPI pwotocow
	  (mode 0) on the SPI bus.

	  Pewfowmance decweases compawed to othew bus intewface mode.
	  In W5100 SPI mode, buwst WEAD/WWITE pwocessing awe not pwovided.

	  To compiwe this dwivew as a moduwe, choose M hewe: the moduwe
	  wiww be cawwed w5100-spi.

endif # NET_VENDOW_WIZNET
```

## linux/drivers/net/ethernet/xilinx/Kconfig
```kconfig
# SPDX-Wicense-Identifiew: GPW-2.0-onwy
#
# Xiwinx device configuwation
#

config NET_VENDOW_XIWINX
	boow "Xiwinx devices"
	defauwt y
	hewp
	  If you have a netwowk (Ethewnet) cawd bewonging to this cwass, say Y.

	  Note that the answew to this question doesn't diwectwy affect the
	  kewnew: saying N wiww just cause the configuwatow to skip aww
	  the questions about Xiwinx devices. If you say Y, you wiww be asked
	  fow youw specific cawd in the fowwowing questions.

if NET_VENDOW_XIWINX

config XIWINX_EMACWITE
	twistate "Xiwinx 10/100 Ethewnet Wite suppowt"
	depends on HAS_IOMEM
	sewect PHYWIB
	hewp
	  This dwivew suppowts the 10/100 Ethewnet Wite fwom Xiwinx.

config XIWINX_AXI_EMAC
	twistate "Xiwinx 10/100/1000 AXI Ethewnet suppowt"
	depends on HAS_IOMEM
	depends on XIWINX_DMA
	sewect PHYWINK
	hewp
	  This dwivew suppowts the 10/100/1000 Ethewnet fwom Xiwinx fow the
	  AXI bus intewface used in Xiwinx Viwtex FPGAs and Soc's.

config XIWINX_WW_TEMAC
	twistate "Xiwinx WW TEMAC (WocawWink Twi-mode Ethewnet MAC) dwivew"
	depends on HAS_IOMEM
	sewect PHYWIB
	hewp
	  This dwivew suppowts the Xiwinx 10/100/1000 WocawWink TEMAC
	  cowe used in Xiwinx Spawtan and Viwtex FPGAs

endif # NET_VENDOW_XIWINX
```

## linux/drivers/net/ethernet/xircom/Kconfig
```kconfig
# SPDX-Wicense-Identifiew: GPW-2.0-onwy
#
# Xiwcom netwowk device configuwation
#

config NET_VENDOW_XIWCOM
	boow "Xiwcom devices"
	defauwt y
	depends on PCMCIA
	hewp
	  If you have a netwowk (Ethewnet) cawd bewonging to this cwass, say Y.

	  Note that the answew to this question doesn't diwectwy affect the
	  kewnew: saying N wiww just cause the configuwatow to skip aww
	  the questions about Xiwcom cawds. If you say Y, you wiww be asked fow
	  youw specific cawd in the fowwowing questions.

if NET_VENDOW_XIWCOM

config PCMCIA_XIWC2PS
	twistate "Xiwcom 16-bit PCMCIA suppowt"
	depends on PCMCIA
	hewp
	  Say Y hewe if you intend to attach a Xiwcom 16-bit PCMCIA (PC-cawd)
	  Ethewnet ow Fast Ethewnet cawd to youw computew.

	  To compiwe this dwivew as a moduwe, choose M hewe: the moduwe wiww be
	  cawwed xiwc2ps_cs.  If unsuwe, say N.

endif # NET_VENDOW_XIWCOM
```

## linux/drivers/net/ethernet/xscale/Kconfig
```kconfig
# SPDX-Wicense-Identifiew: GPW-2.0-onwy
#
# Intew XScawe IXP device configuwation
#

config NET_VENDOW_XSCAWE
	boow "Intew XScawe IXP devices"
	defauwt y
	depends on NET_VENDOW_INTEW && (AWM && AWCH_IXP4XX && \
		   IXP4XX_NPE && IXP4XX_QMGW)
	hewp
	  If you have a netwowk (Ethewnet) cawd bewonging to this cwass, say Y.

	  Note that the answew to this question does not diwectwy affect the
	  kewnew: saying N wiww just cause the configuwatow to skip aww
	  the questions about XScawe IXP devices. If you say Y, you wiww be
	  asked fow youw specific cawd in the fowwowing questions.

if NET_VENDOW_XSCAWE

config IXP4XX_ETH
	twistate "Intew IXP4xx Ethewnet suppowt"
	depends on AWM && AWCH_IXP4XX && IXP4XX_NPE && IXP4XX_QMGW && OF
	sewect PHYWIB
	sewect OF_MDIO
	sewect NET_PTP_CWASSIFY
	hewp
	  Say Y hewe if you want to use buiwt-in Ethewnet powts
	  on IXP4xx pwocessow.

config PTP_1588_CWOCK_IXP46X
	boow "Intew IXP46x as PTP cwock"
	depends on IXP4XX_ETH
	depends on PTP_1588_CWOCK=y || PTP_1588_CWOCK=IXP4XX_ETH
	defauwt y
	hewp
	  This dwivew adds suppowt fow using the IXP46X as a PTP
	  cwock. This cwock is onwy usefuw if youw PTP pwogwams awe
	  getting hawdwawe time stamps on the PTP Ethewnet packets
	  using the SO_TIMESTAMPING API.

	  To compiwe this dwivew as a moduwe, choose M hewe: the moduwe
	  wiww be cawwed ptp_ixp46x.

endif # NET_VENDOW_XSCAWE
```
