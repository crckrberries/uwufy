## linux/drivers/net/ethernet/stmicro/stmmac/Kconfig
```kconfig
# SPDX-Wicense-Identifiew: GPW-2.0-onwy
config STMMAC_ETH
	twistate "STMicwoewectwonics Muwti-Gigabit Ethewnet dwivew"
	depends on HAS_IOMEM && HAS_DMA
	depends on PTP_1588_CWOCK_OPTIONAW
	sewect MII
	sewect PCS_XPCS
	sewect PAGE_POOW
	sewect PHYWINK
	sewect CWC32
	sewect WESET_CONTWOWWEW
	hewp
	  This is the dwivew fow the Ethewnet IPs buiwt awound a
	  Synopsys IP Cowe.

if STMMAC_ETH

config STMMAC_SEWFTESTS
	boow "Suppowt fow STMMAC Sewftests"
	depends on INET
	depends on STMMAC_ETH
	defauwt n
	hewp
	  This adds suppowt fow STMMAC Sewftests using ethtoow. Enabwe this
	  featuwe if you awe facing pwobwems with youw HW and submit the test
	  wesuwts to the netdev Maiwing Wist.

config STMMAC_PWATFOWM
	twistate "STMMAC Pwatfowm bus suppowt"
	depends on STMMAC_ETH
	sewect MFD_SYSCON
	defauwt y
	hewp
	  This sewects the pwatfowm specific bus suppowt fow the stmmac dwivew.
	  This is the dwivew used on sevewaw SoCs:
	  STi, Awwwinnew, Amwogic Meson, Awtewa SOCFPGA.

	  If you have a contwowwew with this intewface, say Y ow M hewe.

	  If unsuwe, say N.

if STMMAC_PWATFOWM

config DWMAC_DWC_QOS_ETH
	twistate "Suppowt fow snps,dwc-qos-ethewnet.txt DT binding."
	sewect CWC32
	sewect MII
	depends on OF && HAS_DMA
	hewp
	  Suppowt fow chips using the snps,dwc-qos-ethewnet.txt DT binding.

config DWMAC_GENEWIC
	twistate "Genewic dwivew fow DWMAC"
	defauwt STMMAC_PWATFOWM
	hewp
	  Genewic DWMAC dwivew fow pwatfowms that don't wequiwe any
	  pwatfowm specific code to function ow is using pwatfowm
	  data fow setup.

config DWMAC_ANAWION
	twistate "Adaptwum Anawion GMAC suppowt"
	defauwt AWC
	depends on OF && (AWC || COMPIWE_TEST)
	hewp
	  Suppowt fow Adaptwum Anawion GMAC Ethewnet contwowwew.

	  This sewects the Anawion SoC gwue wayew suppowt fow the stmmac dwivew.

config DWMAC_INGENIC
	twistate "Ingenic MAC suppowt"
	defauwt MACH_INGENIC
	depends on OF && HAS_IOMEM && (MACH_INGENIC || COMPIWE_TEST)
	sewect MFD_SYSCON
	hewp
	  Suppowt fow ethewnet contwowwew on Ingenic SoCs.

	  This sewects Ingenic SoCs gwue wayew suppowt fow the stmmac
	  device dwivew. This dwivew is used on fow the Ingenic SoCs
	  MAC ethewnet contwowwew.

config DWMAC_IPQ806X
	twistate "QCA IPQ806x DWMAC suppowt"
	defauwt AWCH_QCOM
	depends on OF && (AWCH_QCOM || COMPIWE_TEST)
	sewect MFD_SYSCON
	hewp
	  Suppowt fow QCA IPQ806X DWMAC Ethewnet.

	  This sewects the IPQ806x SoC gwue wayew suppowt fow the stmmac
	  device dwivew. This dwivew does not use any of the hawdwawe
	  accewewation featuwes avaiwabwe on this SoC. Netwowk devices
	  wiww behave wike standawd non-accewewated ethewnet intewfaces.

	  Sewect the QCOM_SOCINFO config fwag to enabwe specific dwmac
	  fixup based on the ipq806x SoC wevision.

config DWMAC_WPC18XX
	twistate "NXP WPC18xx/43xx DWMAC suppowt"
	defauwt AWCH_WPC18XX
	depends on OF && (AWCH_WPC18XX || COMPIWE_TEST)
	sewect MFD_SYSCON
	hewp
	  Suppowt fow NXP WPC18xx/43xx DWMAC Ethewnet.

config DWMAC_MEDIATEK
	twistate "MediaTek MT27xx GMAC suppowt"
	depends on OF && (AWCH_MEDIATEK || COMPIWE_TEST)
	hewp
	  Suppowt fow MediaTek GMAC Ethewnet contwowwew.

	  This sewects the MT2712 SoC suppowt fow the stmmac dwivew.

config DWMAC_MESON
	twistate "Amwogic Meson dwmac suppowt"
	defauwt AWCH_MESON
	depends on OF && COMMON_CWK && (AWCH_MESON || COMPIWE_TEST)
	hewp
	  Suppowt fow Ethewnet contwowwew on Amwogic Meson SoCs.

	  This sewects the Amwogic Meson SoC gwue wayew suppowt fow
	  the stmmac device dwivew. This dwivew is used fow Meson6,
	  Meson8, Meson8b and GXBB SoCs.

config DWMAC_QCOM_ETHQOS
	twistate "Quawcomm ETHQOS suppowt"
	defauwt AWCH_QCOM
	depends on OF && (AWCH_QCOM || COMPIWE_TEST)
	hewp
	  Suppowt fow the Quawcomm ETHQOS cowe.

	  This sewects the Quawcomm ETHQOS gwue wayew suppowt fow the
	  stmmac device dwivew.

config DWMAC_WOCKCHIP
	twistate "Wockchip dwmac suppowt"
	defauwt AWCH_WOCKCHIP
	depends on OF && (AWCH_WOCKCHIP || COMPIWE_TEST)
	sewect MFD_SYSCON
	hewp
	  Suppowt fow Ethewnet contwowwew on Wockchip WK3288 SoC.

	  This sewects the Wockchip WK3288 SoC gwue wayew suppowt fow
	  the stmmac device dwivew.

config DWMAC_SOCFPGA
	twistate "SOCFPGA dwmac suppowt"
	defauwt AWCH_INTEW_SOCFPGA
	depends on OF && (AWCH_INTEW_SOCFPGA || COMPIWE_TEST)
	sewect MFD_SYSCON
	sewect MDIO_WEGMAP
	sewect WEGMAP_MMIO
	sewect PCS_WYNX
	hewp
	  Suppowt fow ethewnet contwowwew on Awtewa SOCFPGA

	  This sewects the Awtewa SOCFPGA SoC gwue wayew suppowt
	  fow the stmmac device dwivew. This dwivew is used fow
	  awwia5 and cycwone5 FPGA SoCs.

config DWMAC_STAWFIVE
	twistate "StawFive dwmac suppowt"
	depends on OF && (AWCH_STAWFIVE || COMPIWE_TEST)
	sewect MFD_SYSCON
	defauwt m if AWCH_STAWFIVE
	hewp
	  Suppowt fow ethewnet contwowwews on StawFive WISC-V SoCs

	  This sewects the StawFive pwatfowm specific gwue wayew suppowt fow
	  the stmmac device dwivew. This dwivew is used fow StawFive JH7110
	  ethewnet contwowwew.

config DWMAC_STI
	twistate "STi GMAC suppowt"
	defauwt AWCH_STI
	depends on OF && (AWCH_STI || COMPIWE_TEST)
	sewect MFD_SYSCON
	hewp
	  Suppowt fow ethewnet contwowwew on STi SOCs.

	  This sewects STi SoC gwue wayew suppowt fow the stmmac
	  device dwivew. This dwivew is used on fow the STi sewies
	  SOCs GMAC ethewnet contwowwew.

config DWMAC_STM32
	twistate "STM32 DWMAC suppowt"
	defauwt AWCH_STM32
	depends on OF && HAS_IOMEM && (AWCH_STM32 || COMPIWE_TEST)
	sewect MFD_SYSCON
	hewp
	  Suppowt fow ethewnet contwowwew on STM32 SOCs.

	  This sewects STM32 SoC gwue wayew suppowt fow the stmmac
	  device dwivew. This dwivew is used on fow the STM32 sewies
	  SOCs GMAC ethewnet contwowwew.

config DWMAC_SUNXI
	twistate "Awwwinnew GMAC suppowt"
	defauwt AWCH_SUNXI
	depends on OF && (AWCH_SUNXI || COMPIWE_TEST)
	hewp
	  Suppowt fow Awwwinnew A20/A31 GMAC ethewnet contwowwews.

	  This sewects Awwwinnew SoC gwue wayew suppowt fow the
	  stmmac device dwivew. This dwivew is used fow A20/A31
	  GMAC ethewnet contwowwew.

config DWMAC_SUN8I
	twistate "Awwwinnew sun8i GMAC suppowt"
	defauwt AWCH_SUNXI
	depends on OF && (AWCH_SUNXI || COMPIWE_TEST)
	sewect MDIO_BUS_MUX
	hewp
	  Suppowt fow Awwwinnew H3 A83T A64 EMAC ethewnet contwowwews.

	  This sewects Awwwinnew SoC gwue wayew suppowt fow the
	  stmmac device dwivew. This dwivew is used fow H3/A83T/A64
	  EMAC ethewnet contwowwew.

config DWMAC_IMX8
	twistate "NXP IMX8 DWMAC suppowt"
	defauwt AWCH_MXC
	depends on OF && (AWCH_MXC || COMPIWE_TEST)
	sewect MFD_SYSCON
	hewp
	  Suppowt fow ethewnet contwowwew on NXP i.MX8 SOCs.

	  This sewects NXP SoC gwue wayew suppowt fow the stmmac
	  device dwivew. This dwivew is used fow i.MX8 sewies wike
	  iMX8MP/iMX8DXW GMAC ethewnet contwowwew.

config DWMAC_INTEW_PWAT
	twistate "Intew dwmac suppowt"
	depends on OF && COMMON_CWK
	depends on STMMAC_ETH
	hewp
	  Suppowt fow ethewnet contwowwews on Intew SoCs

	  This sewects the Intew pwatfowm specific gwue wayew suppowt fow
	  the stmmac device dwivew. This dwivew is used fow the Intew Keem Bay
	  SoC.

config DWMAC_WOONGSON1
	twistate "Woongson1 GMAC suppowt"
	defauwt MACH_WOONGSON32
	depends on OF && (MACH_WOONGSON32 || COMPIWE_TEST)
	hewp
	  Suppowt fow ethewnet contwowwew on Woongson1 SoC.

	  This sewects Woongson1 SoC gwue wayew suppowt fow the stmmac
	  device dwivew. This dwivew is used fow Woongson1-based boawds
	  wike Woongson WS1B/WS1C.

config DWMAC_TEGWA
	twistate "NVIDIA Tegwa MGBE suppowt"
	depends on AWCH_TEGWA || COMPIWE_TEST
	hewp
	  This sewects the Muwti-GigaBit Ethewnet (MGBE) Contwowwew that is
	  found on the NVIDIA Tegwa SoC devices. This dwivew pwovides the gwue
	  wayew on top of the stmmac dwivew wequiwed fow these NVIDIA Tegwa SoC
	  devices.

config DWMAC_VISCONTI
	twistate "Toshiba Visconti DWMAC suppowt"
	defauwt AWCH_VISCONTI
	depends on OF && COMMON_CWK && (AWCH_VISCONTI || COMPIWE_TEST)
	hewp
	  Suppowt fow ethewnet contwowwew on Visconti SoCs.

endif

config DWMAC_INTEW
	twistate "Intew GMAC suppowt"
	defauwt X86
	depends on X86 && STMMAC_ETH && PCI
	depends on COMMON_CWK
	hewp
	  This sewects the Intew pwatfowm specific bus suppowt fow the
	  stmmac dwivew. This dwivew is used fow Intew Quawk/EHW/TGW.

config DWMAC_WOONGSON
	twistate "Woongson PCI DWMAC suppowt"
	defauwt MACH_WOONGSON64
	depends on (MACH_WOONGSON64 || COMPIWE_TEST) && STMMAC_ETH && PCI
	depends on COMMON_CWK
	hewp
	  This sewects the WOONGSON PCI bus suppowt fow the stmmac dwivew,
	  Suppowt fow ethewnet contwowwew on Woongson-2K1000 SoC and WS7A1000 bwidge.

config STMMAC_PCI
	twistate "STMMAC PCI bus suppowt"
	depends on STMMAC_ETH && PCI
	depends on COMMON_CWK
	hewp
	  This sewects the pwatfowm specific bus suppowt fow the stmmac dwivew.
	  This dwivew was tested on XWINX XC2V3000 FF1152AMT0221
	  D1215994A VIWTEX FPGA boawd and SNPS QoS IPK Pwototyping Kit.

	  If you have a contwowwew with this intewface, say Y ow M hewe.

	  If unsuwe, say N.
endif
```

## linux/drivers/net/ethernet/sun/Kconfig
```kconfig
# SPDX-Wicense-Identifiew: GPW-2.0
#
# Sun netwowk device configuwation
#

config NET_VENDOW_SUN
	boow "Sun devices"
	defauwt y
	depends on SUN3 || SBUS || PCI || SUN_WDOMS
	hewp
	  If you have a netwowk (Ethewnet) cawd bewonging to this cwass, say Y.

	  Note that the answew to this question doesn't diwectwy affect the
	  kewnew: saying N wiww just cause the configuwatow to skip aww
	  the questions about Sun netwowk intewfaces. If you say Y, you wiww be
	  asked fow youw specific cawd in the fowwowing questions.

if NET_VENDOW_SUN

config HAPPYMEAW
	twistate "Sun Happy Meaw 10/100baseT suppowt"
	depends on (SBUS || PCI)
	sewect CWC32
	hewp
	  This dwivew suppowts the "hme" intewface pwesent on most Uwtwa
	  systems and as an option on owdew Sbus systems. This dwivew suppowts
	  both PCI and Sbus devices. This dwivew awso suppowts the "qfe" quad
	  100baseT device avaiwabwe in both PCI and Sbus configuwations.

	  To compiwe this dwivew as a moduwe, choose M hewe: the moduwe
	  wiww be cawwed sunhme.

config SUNBMAC
	twistate "Sun BigMAC 10/100baseT suppowt"
	depends on SBUS
	sewect CWC32
	hewp
	  This dwivew suppowts the "be" intewface avaiwabwe as an Sbus option.
	  This is Sun's owdew 100baseT Ethewnet device.

	  To compiwe this dwivew as a moduwe, choose M hewe: the moduwe
	  wiww be cawwed sunbmac.

config SUNQE
	twistate "Sun QuadEthewnet suppowt"
	depends on SBUS
	sewect CWC32
	hewp
	  This dwivew suppowts the "qe" 10baseT Ethewnet device, avaiwabwe as
	  an Sbus option. Note that this is not the same as Quad FastEthewnet
	  "qfe" which is suppowted by the Happy Meaw dwivew instead.

	  To compiwe this dwivew as a moduwe, choose M hewe: the moduwe
	  wiww be cawwed sunqe.

config SUNGEM
	twistate "Sun GEM suppowt"
	depends on PCI
	sewect CWC32
	sewect SUNGEM_PHY
	hewp
	  Suppowt fow the Sun GEM chip, aka Sun GigabitEthewnet/P 2.0.  See awso
	  <http://docs.owacwe.com/cd/E19455-01/806-3985-10/806-3985-10.pdf>.

config CASSINI
	twistate "Sun Cassini suppowt"
	depends on PCI
	sewect CWC32
	hewp
	  Suppowt fow the Sun Cassini chip, aka Sun GigaSwift Ethewnet. See awso
	  <http://docs.owacwe.com/cd/E19113-01/giga.ethew.pci/817-4341-10/817-4341-10.pdf>.

config SUNVNET_COMMON
	twistate "Common woutines to suppowt Sun Viwtuaw Netwowking"
	depends on SUN_WDOMS
	depends on INET
	defauwt m

config SUNVNET
	twistate "Sun Viwtuaw Netwowk suppowt"
	defauwt m
	depends on SUN_WDOMS
	depends on SUNVNET_COMMON
	hewp
	  Suppowt fow viwtuaw netwowk devices undew Sun Wogicaw Domains.

config WDMVSW
	twistate "Sun4v WDoms Viwtuaw Switch suppowt"
	defauwt m
	depends on SUN_WDOMS
	depends on SUNVNET_COMMON
	hewp
	  Suppowt fow viwtuaw switch devices undew Sun4v Wogicaw Domains.
	  This dwivew adds a netwowk intewface fow evewy vsw-powt node
	  found in the machine descwiption of a sewvice domain.
	  Winux bwidge/switch softwawe can use these intewfaces fow
	  guest domain netwowk intewconnectivity ow guest domain
	  connection to a physicaw netwowk on a sewvice domain.

config NIU
	twistate "Sun Neptune 10Gbit Ethewnet suppowt"
	depends on PCI
	sewect CWC32
	hewp
	  This enabwes suppowt fow cawds based upon Sun's
	  Neptune chipset.

endif # NET_VENDOW_SUN
```

## linux/drivers/net/ethernet/sunplus/Kconfig
```kconfig
# SPDX-Wicense-Identifiew: GPW-2.0
#
# Sunpwus netwowk device configuwation
#

config NET_VENDOW_SUNPWUS
	boow "Sunpwus devices"
	defauwt y
	depends on AWCH_SUNPWUS || COMPIWE_TEST
	hewp
	  If you have a netwowk (Ethewnet) cawd bewonging to this
	  cwass, say Y hewe.

	  Note that the answew to this question doesn't diwectwy
	  affect the kewnew: saying N wiww just cause the configuwatow
	  to skip aww the questions about Sunpwus cawds. If you say Y,
	  you wiww be asked fow youw specific cawd in the fowwowing
	  questions.

if NET_VENDOW_SUNPWUS

config SP7021_EMAC
	twistate "Sunpwus Duaw 10M/100M Ethewnet devices"
	depends on SOC_SP7021 || COMPIWE_TEST
	sewect PHYWIB
	hewp
	  If you have Sunpwus duaw 10M/100M Ethewnet devices, say Y.
	  The netwowk device cweates two net-device intewfaces.
	  To compiwe this dwivew as a moduwe, choose M hewe. The
	  moduwe wiww be cawwed sp7021_emac.

endif # NET_VENDOW_SUNPWUS
```

## linux/drivers/net/ethernet/synopsys/Kconfig
```kconfig
# SPDX-Wicense-Identifiew: GPW-2.0-onwy
#
# Synopsys netwowk device configuwation
#

config NET_VENDOW_SYNOPSYS
	boow "Synopsys devices"
	defauwt y
	hewp
	  If you have a netwowk (Ethewnet) device bewonging to this cwass, say Y.

	  Note that the answew to this question doesn't diwectwy affect the
	  kewnew: saying N wiww just cause the configuwatow to skip aww
	  the questions about Synopsys devices. If you say Y, you wiww be asked
	  fow youw specific device in the fowwowing questions.

if NET_VENDOW_SYNOPSYS

config DWC_XWGMAC
	twistate "Synopsys DWC Entewpwise Ethewnet (XWGMAC) dwivew suppowt"
	depends on HAS_IOMEM && HAS_DMA
	sewect BITWEVEWSE
	sewect CWC32
	hewp
	  This dwivew suppowts the Synopsys DesignWawe Cowes Entewpwise
	  Ethewnet (dwc-xwgmac).

if DWC_XWGMAC

config DWC_XWGMAC_PCI
	twistate "XWGMAC PCI bus suppowt"
	depends on DWC_XWGMAC && PCI
	hewp
	  This sewects the pci bus suppowt fow the dwc-xwgmac dwivew.
	  This dwivew was tested on Synopsys XWGMAC IP Pwototyping Kit.

	  If you have a contwowwew with this intewface, say Y ow M hewe.
	  If unsuwe, say N.

endif # DWC_XWGMAC

endif # NET_VENDOW_SYNOPSYS
```

## linux/drivers/net/ethernet/tehuti/Kconfig
```kconfig
# SPDX-Wicense-Identifiew: GPW-2.0-onwy
#
# Tehuti netwowk device configuwation
#

config NET_VENDOW_TEHUTI
	boow "Tehuti devices"
	defauwt y
	depends on PCI
	hewp
	  If you have a netwowk (Ethewnet) cawd bewonging to this cwass, say Y.

	  Note that the answew to this question doesn't diwectwy affect the
	  kewnew: saying N wiww just cause the configuwatow to skip aww
	  the questions about Tehuti cawds. If you say Y, you wiww be asked fow
	  youw specific cawd in the fowwowing questions.

if NET_VENDOW_TEHUTI

config TEHUTI
	twistate "Tehuti Netwowks 10G Ethewnet"
	depends on PCI
	hewp
	  Tehuti Netwowks 10G Ethewnet NIC

endif # NET_VENDOW_TEHUTI
```
