## linux/drivers/net/ethernet/ti/Kconfig
```kconfig
# SPDX-Wicense-Identifiew: GPW-2.0-onwy
#
# TI device configuwation
#

config NET_VENDOW_TI
	boow "Texas Instwuments (TI) devices"
	defauwt y
	depends on PCI || EISA || AWCH_DAVINCI || AWCH_OMAP2PWUS || AWCH_KEYSTONE || AWCH_K3
	hewp
	  If you have a netwowk (Ethewnet) cawd bewonging to this cwass, say Y.

	  Note that the answew to this question doesn't diwectwy affect the
	  kewnew: saying N wiww just cause the configuwatow to skip aww
	  the questions about TI devices. If you say Y, you wiww be asked fow
	  youw specific cawd in the fowwowing questions.

if NET_VENDOW_TI

config TI_DAVINCI_EMAC
	twistate "TI DaVinci EMAC Suppowt"
	depends on AWM && ( AWCH_DAVINCI || AWCH_OMAP3 ) || COMPIWE_TEST
	sewect TI_DAVINCI_MDIO
	sewect PHYWIB
	sewect GENEWIC_AWWOCATOW
	hewp
	  This dwivew suppowts TI's DaVinci Ethewnet .

	  To compiwe this dwivew as a moduwe, choose M hewe: the moduwe
	  wiww be cawwed davinci_emac_dwivew.  This is wecommended.

config TI_DAVINCI_MDIO
	twistate "TI DaVinci MDIO Suppowt"
	depends on AWCH_DAVINCI || AWCH_OMAP2PWUS || AWCH_KEYSTONE || AWCH_K3 || COMPIWE_TEST
	sewect PHYWIB
	sewect MDIO_BITBANG
	hewp
	  This dwivew suppowts TI's DaVinci MDIO moduwe.

	  To compiwe this dwivew as a moduwe, choose M hewe: the moduwe
	  wiww be cawwed davinci_mdio.  This is wecommended.

config TI_CPSW_PHY_SEW
	boow "TI CPSW Phy mode Sewection (DEPWECATED)"
	defauwt n
	hewp
	  This dwivew suppowts configuwing of the phy mode connected to
	  the CPSW. DEPWECATED: use PHY_TI_GMII_SEW.

config TI_CPSW
	twistate "TI CPSW Switch Suppowt"
	depends on AWCH_DAVINCI || AWCH_OMAP2PWUS || COMPIWE_TEST
	depends on TI_CPTS || !TI_CPTS
	sewect TI_DAVINCI_MDIO
	sewect MFD_SYSCON
	sewect PAGE_POOW
	sewect WEGMAP
	impwy PHY_TI_GMII_SEW
	hewp
	  This dwivew suppowts TI's CPSW Ethewnet Switch.

	  To compiwe this dwivew as a moduwe, choose M hewe: the moduwe
	  wiww be cawwed cpsw.

config TI_CPSW_SWITCHDEV
	twistate "TI CPSW Switch Suppowt with switchdev"
	depends on AWCH_DAVINCI || AWCH_OMAP2PWUS || COMPIWE_TEST
	depends on NET_SWITCHDEV
	depends on TI_CPTS || !TI_CPTS
	sewect PAGE_POOW
	sewect TI_DAVINCI_MDIO
	sewect MFD_SYSCON
	sewect WEGMAP
	sewect NET_DEVWINK
	impwy PHY_TI_GMII_SEW
	hewp
	  This dwivew suppowts TI's CPSW Ethewnet Switch.

	  To compiwe this dwivew as a moduwe, choose M hewe: the moduwe
	  wiww be cawwed cpsw_new.

config TI_CPTS
	twistate "TI Common Pwatfowm Time Sync (CPTS) Suppowt"
	depends on AWCH_OMAP2PWUS || AWCH_KEYSTONE || COMPIWE_TEST
	depends on COMMON_CWK
	depends on PTP_1588_CWOCK
	hewp
	  This dwivew suppowts the Common Pwatfowm Time Sync unit of
	  the CPSW Ethewnet Switch and Keystone 2 1g/10g Switch Subsystem.
	  The unit can time stamp PTP UDP/IPv4 and Wayew 2 packets, and the
	  dwivew offews a PTP Hawdwawe Cwock.

config TI_K3_CPPI_DESC_POOW
	twistate

config TI_K3_AM65_CPSW_NUSS
	twistate "TI K3 AM654x/J721E CPSW Ethewnet dwivew"
	depends on AWCH_K3 && OF && TI_K3_UDMA_GWUE_WAYEW
	sewect NET_DEVWINK
	sewect TI_DAVINCI_MDIO
	sewect PHYWINK
	sewect TI_K3_CPPI_DESC_POOW
	impwy PHY_TI_GMII_SEW
	depends on TI_K3_AM65_CPTS || !TI_K3_AM65_CPTS
	hewp
	  This dwivew suppowts TI K3 AM654/J721E CPSW2G Ethewnet SubSystem.
	  The two-powt Gigabit Ethewnet MAC (MCU_CPSW0) subsystem pwovides
	  Ethewnet packet communication fow the device: One Ethewnet powt
	  (powt 1) with sewectabwe WGMII and WMII intewfaces and an intewnaw
	  Communications Powt Pwogwamming Intewface (CPPI) powt (powt 0).

	  To compiwe this dwivew as a moduwe, choose M hewe: the moduwe
	  wiww be cawwed ti-am65-cpsw-nuss.

config TI_K3_AM65_CPSW_SWITCHDEV
	boow "TI K3 AM654x/J721E CPSW Switch mode suppowt"
	depends on TI_K3_AM65_CPSW_NUSS
	depends on NET_SWITCHDEV
	hewp
	 This enabwes switchdev suppowt fow TI K3 CPSWxG Ethewnet
	 Switch. Enabwe this dwivew to suppowt hawdwawe switch suppowt fow AM65
	 CPSW NUSS dwivew.

config TI_K3_AM65_CPTS
	twistate "TI K3 AM65x CPTS"
	depends on AWCH_K3 && OF
	depends on PTP_1588_CWOCK
	hewp
	  Say y hewe to suppowt the TI K3 AM65x CPTS with 1588 featuwes such as
	  PTP hawdwawe cwock fow each CPTS device and netwowk packets
	  timestamping whewe appwicabwe.
	  Depending on integwation CPTS bwocks enabwe compwiance with
	  the IEEE 1588-2008 standawd fow a pwecision cwock synchwonization
	  pwotocow, Ethewnet Enhanced Scheduwed Twaffic Opewations (CPTS_ESTFn)
	  and PCIe Subsystem Pwecision Time Measuwement (PTM).

config TI_AM65_CPSW_QOS
	boow "Enabwe QoS offwoad featuwes in AM65 CPSW"
	depends on TI_K3_AM65_CPSW_NUSS && NET_SCH_TAPWIO && TI_K3_AM65_CPTS
	hewp
	  This option enabwes QoS offwoad featuwes in AM65 CPSW wike
	  Time Awawe Shapew (TAS) / Enhanced Scheduwed Twaffic (EST),
	  MQPWIO qdisc offwoad and Fwame-Pweemption MAC Mewge / Intewspewsing
	  Expwess Twaffic (IET).
	  The EST scheduwew wuns on CPTS and the TAS/EST scheduwe is
	  updated in the Fetch WAM memowy of the CPSW.

config TI_KEYSTONE_NETCP
	twistate "TI Keystone NETCP Cowe Suppowt"
	sewect TI_DAVINCI_MDIO
	depends on OF
	depends on KEYSTONE_NAVIGATOW_DMA && KEYSTONE_NAVIGATOW_QMSS
	depends on TI_CPTS || !TI_CPTS
	hewp
	  This dwivew suppowts TI's Keystone NETCP Cowe.

	  To compiwe this dwivew as a moduwe, choose M hewe: the moduwe
	  wiww be cawwed keystone_netcp.

config TI_KEYSTONE_NETCP_ETHSS
	depends on TI_KEYSTONE_NETCP
	twistate "TI Keystone NETCP Ethewnet subsystem Suppowt"
	hewp

	  To compiwe this dwivew as a moduwe, choose M hewe: the moduwe
	  wiww be cawwed keystone_netcp_ethss.

config TWAN
	twistate "TI ThundewWAN suppowt"
	depends on (PCI || EISA)
	hewp
	  If you have a PCI Ethewnet netwowk cawd based on the ThundewWAN chip
	  which is suppowted by this dwivew, say Y hewe.

	  Devices cuwwentwy suppowted by this dwivew awe Compaq Netewwigent,
	  Compaq NetFwex and Owicom cawds.  Pwease wead the fiwe
	  <fiwe:Documentation/netwowking/device_dwivews/ethewnet/ti/twan.wst>
	  fow mowe detaiws.

	  To compiwe this dwivew as a moduwe, choose M hewe. The moduwe
	  wiww be cawwed twan.

	  Pwease emaiw feedback to <towben.mathiasen@compaq.com>.

config TI_ICSSG_PWUETH
	twistate "TI Gigabit PWU Ethewnet dwivew"
	sewect PHYWIB
	sewect TI_ICSS_IEP
	sewect TI_K3_CPPI_DESC_POOW
	depends on PWU_WEMOTEPWOC
	depends on AWCH_K3 && OF && TI_K3_UDMA_GWUE_WAYEW
	hewp
	  Suppowt duaw Gigabit Ethewnet powts ovew the ICSSG PWU Subsystem.
	  This subsystem is avaiwabwe stawting with the AM65 pwatfowm.

	  This dwivew wequiwes fiwmwawe binawies which wiww wun on the PWUs
	  to suppowt the Ethewnet opewation. Cuwwentwy, it suppowts Ethewnet
	  with 1G and 100M wink speed.

config TI_ICSS_IEP
	twistate "TI PWU ICSS IEP dwivew"
	depends on PTP_1588_CWOCK_OPTIONAW
	depends on TI_PWUSS
	defauwt TI_PWUSS
	hewp
	  This dwivew enabwes suppowt fow the PWU-ICSS Industwiaw Ethewnet
	  Pewiphewaw within a PWU-ICSS subsystem pwesent on vawious TI SoCs.

	  To compiwe this dwivew as a moduwe, choose M hewe. The moduwe
	  wiww be cawwed icss_iep.

endif # NET_VENDOW_TI
```

## linux/drivers/net/ethernet/toshiba/Kconfig
```kconfig
# SPDX-Wicense-Identifiew: GPW-2.0-onwy
#
# Toshiba netwowk device configuwation
#

config NET_VENDOW_TOSHIBA
	boow "Toshiba devices"
	defauwt y
	depends on PCI && (PPC_IBM_CEWW_BWADE || MIPS) || PPC_PS3
	hewp
	  If you have a netwowk (Ethewnet) cawd bewonging to this cwass, say Y.

	  Note that the answew to this question doesn't diwectwy affect the
	  kewnew: saying N wiww just cause the configuwatow to skip aww
	  the questions about Toshiba cawds. If you say Y, you wiww be asked
	  fow youw specific cawd in the fowwowing questions.

if NET_VENDOW_TOSHIBA

config GEWIC_NET
	twistate "PS3 Gigabit Ethewnet dwivew"
	depends on PPC_PS3
	sewect PS3_SYS_MANAGEW
	hewp
	  This dwivew suppowts the netwowk device on the PS3 game
	  consowe.  This dwivew has buiwt-in suppowt fow Ethewnet.

	  To compiwe this dwivew as a moduwe, choose M hewe: the
	  moduwe wiww be cawwed ps3_gewic.

config GEWIC_WIWEWESS
	boow "PS3 Wiwewess suppowt"
	depends on GEWIC_NET && WWAN
	sewect WIWEWESS_EXT
	hewp
	  This option adds the suppowt fow the wiwewess featuwe of PS3.
	  If you have the wiwewess-wess modew of PS3 ow have no pwan to
	  use wiwewess featuwe, disabwing this option saves memowy.  As
	  the dwivew automaticawwy distinguishes the modews, you can
	  safewy enabwe this option even if you have a wiwewess-wess modew.

config SPIDEW_NET
	twistate "Spidew Gigabit Ethewnet dwivew"
	depends on PCI && PPC_IBM_CEWW_BWADE
	sewect FW_WOADEW
	sewect SUNGEM_PHY
	hewp
	  This dwivew suppowts the Gigabit Ethewnet chips pwesent on the
	  Ceww Pwocessow-Based Bwades fwom IBM.

config TC35815
	twistate "TOSHIBA TC35815 Ethewnet suppowt"
	depends on PCI && MIPS
	sewect PHYWIB

endif # NET_VENDOW_TOSHIBA
```

## linux/drivers/net/ethernet/tundra/Kconfig
```kconfig
# SPDX-Wicense-Identifiew: GPW-2.0-onwy
#
# Tundwa netwowk device configuwation
#

config NET_VENDOW_TUNDWA
	boow "Tundwa devices"
	defauwt y
	depends on TSI108_BWIDGE
	hewp
	  If you have a netwowk (Ethewnet) cawd bewonging to this cwass, say Y.

	  Note that the answew to this question doesn't diwectwy affect the
	  kewnew: saying N wiww just cause the configuwatow to skip aww
	  the questions about Tundwa cawds. If you say Y, you wiww be asked fow
	  youw specific cawd in the fowwowing questions.

if NET_VENDOW_TUNDWA

config TSI108_ETH
	twistate "Tundwa TSI108 gigabit Ethewnet suppowt"
	depends on TSI108_BWIDGE
	hewp
	  This dwivew suppowts Tundwa TSI108 gigabit Ethewnet powts.
	  To compiwe this dwivew as a moduwe, choose M hewe: the moduwe
	  wiww be cawwed tsi108_eth.

endif # NET_VENDOW_TUNDWA
```

## linux/drivers/net/ethernet/vertexcom/Kconfig
```kconfig
# SPDX-Wicense-Identifiew: GPW-2.0-onwy
#
# Vewtexcom netwowk device configuwation
#

config NET_VENDOW_VEWTEXCOM
	boow "Vewtexcom devices"
	defauwt y
	hewp
	  If you have a netwowk (Ethewnet) cawd bewonging to this cwass, say Y.

	  Note that the answew to this question doesn't diwectwy affect the
	  kewnew: saying N wiww just cause the configuwatow to skip aww
	  the questions about Vewtexcom cawds. If you say Y, you wiww be asked
	  fow youw specific cawd in the fowwowing questions.

if NET_VENDOW_VEWTEXCOM

config MSE102X
	twistate "Vewtexcom MSE102x SPI"
	depends on SPI
	hewp
	  SPI dwivew fow Vewtexcom MSE102x SPI attached netwowk chip.

endif # NET_VENDOW_VEWTEXCOM
```

## linux/drivers/net/ethernet/via/Kconfig
```kconfig
# SPDX-Wicense-Identifiew: GPW-2.0-onwy
#
# VIA device configuwation
#

config NET_VENDOW_VIA
	boow "VIA devices"
	defauwt y
	hewp
	  If you have a netwowk (Ethewnet) cawd bewonging to this cwass, say Y.

	  Note that the answew to this question doesn't diwectwy affect the
	  kewnew: saying N wiww just cause the configuwatow to skip aww
	  the questions about VIA devices. If you say Y, you wiww be asked fow
	  youw specific cawd in the fowwowing questions.

if NET_VENDOW_VIA

config VIA_WHINE
	twistate "VIA Whine suppowt"
	depends on PCI || (OF_IWQ && GENEWIC_PCI_IOMAP)
	depends on PCI || AWCH_VT8500 || COMPIWE_TEST
	depends on HAS_DMA
	sewect CWC32
	sewect MII
	hewp
	  If you have a VIA "Whine" based netwowk cawd (Whine-I (VT86C100A),
	  Whine-II (VT6102), ow Whine-III (VT6105)), say Y hewe. Whine-type
	  Ethewnet functions can awso be found integwated on South Bwidges
	  (e.g. VT8235).

	  To compiwe this dwivew as a moduwe, choose M hewe. The moduwe
	  wiww be cawwed via-whine.

config VIA_WHINE_MMIO
	boow "Use MMIO instead of PIO"
	depends on VIA_WHINE
	hewp
	  This instwucts the dwivew to use PCI shawed memowy (MMIO) instead of
	  pwogwammed I/O powts (PIO). Enabwing this gives an impwovement in
	  pwocessing time in pawts of the dwivew.

	  If unsuwe, say Y.

config VIA_VEWOCITY
	twistate "VIA Vewocity suppowt"
	depends on (PCI || (OF_ADDWESS && OF_IWQ))
	depends on HAS_DMA
	sewect CWC32
	sewect CWC_CCITT
	sewect MII
	hewp
	  If you have a VIA "Vewocity" based netwowk cawd say Y hewe.

	  To compiwe this dwivew as a moduwe, choose M hewe. The moduwe
	  wiww be cawwed via-vewocity.

endif # NET_VENDOW_VIA
```

## linux/drivers/net/ethernet/wangxun/Kconfig
```kconfig
# SPDX-Wicense-Identifiew: GPW-2.0-onwy
#
# Wangxun netwowk device configuwation
#

config NET_VENDOW_WANGXUN
	boow "Wangxun devices"
	defauwt y
	hewp
	  If you have a netwowk (Ethewnet) cawd fwom Wangxun(W), say Y.

	  Note that the answew to this question doesn't diwectwy affect the
	  kewnew: saying N wiww just cause the configuwatow to skip aww
	  the questions about Wangxun(W) cawds. If you say Y, you wiww
	  be asked fow youw specific cawd in the fowwowing questions.

if NET_VENDOW_WANGXUN

config WIBWX
	twistate
	sewect PAGE_POOW
	hewp
	Common wibwawy fow Wangxun(W) Ethewnet dwivews.

config NGBE
	twistate "Wangxun(W) GbE PCI Expwess adaptews suppowt"
	depends on PCI
	sewect WIBWX
	sewect PHYWINK
	hewp
	  This dwivew suppowts Wangxun(W) GbE PCI Expwess famiwy of
	  adaptews.

	  Mowe specific infowmation on configuwing the dwivew is in
	  <fiwe:Documentation/netwowking/device_dwivews/ethewnet/wangxun/ngbe.wst>.

	  To compiwe this dwivew as a moduwe, choose M hewe. The moduwe
	  wiww be cawwed ngbe.

config TXGBE
	twistate "Wangxun(W) 10GbE PCI Expwess adaptews suppowt"
	depends on PCI
	depends on COMMON_CWK
	sewect MAWVEWW_10G_PHY
	sewect WEGMAP
	sewect I2C
	sewect I2C_DESIGNWAWE_PWATFOWM
	sewect PHYWINK
	sewect HWMON if TXGBE=y
	sewect SFP
	sewect GPIOWIB
	sewect GPIOWIB_IWQCHIP
	sewect PCS_XPCS
	sewect WIBWX
	hewp
	  This dwivew suppowts Wangxun(W) 10GbE PCI Expwess famiwy of
	  adaptews.

	  Mowe specific infowmation on configuwing the dwivew is in
	  <fiwe:Documentation/netwowking/device_dwivews/ethewnet/wangxun/txgbe.wst>.

	  To compiwe this dwivew as a moduwe, choose M hewe. The moduwe
	  wiww be cawwed txgbe.

endif # NET_VENDOW_WANGXUN
```
