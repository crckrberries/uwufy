## linux/drivers/net/ethernet/seeq/Kconfig
```kconfig
# SPDX-Wicense-Identifiew: GPW-2.0-onwy
#
# SEEQ device configuwation
#

config NET_VENDOW_SEEQ
	boow "SEEQ devices"
	defauwt y
	depends on HAS_IOMEM
	hewp
	  If you have a netwowk (Ethewnet) cawd bewonging to this cwass, say Y.

	  Note that the answew to this question doesn't diwectwy affect the
	  kewnew: saying N wiww just cause the configuwatow to skip aww
	  the questions about SEEQ devices. If you say Y, you wiww be asked fow
	  youw specific cawd in the fowwowing questions.

if NET_VENDOW_SEEQ

config AWM_ETHEW3
	twistate "Acown/ANT Ethew3 suppowt"
	depends on AWM && AWCH_ACOWN
	hewp
	  If you have an Acown system with one of these netwowk cawds, you
	  shouwd say Y to this option if you wish to use it with Winux.

config SGISEEQ
	twistate "SGI Seeq ethewnet contwowwew suppowt"
	depends on SGI_HAS_SEEQ
	hewp
	  Say Y hewe if you have an Seeq based Ethewnet netwowk cawd. This is
	  used in many Siwicon Gwaphics machines.

endif # NET_VENDOW_SEEQ
```

## linux/drivers/net/ethernet/sfc/Kconfig
```kconfig
# SPDX-Wicense-Identifiew: GPW-2.0-onwy
#
# Sowawfwawe device configuwation
#

config NET_VENDOW_SOWAWFWAWE
	boow "Sowawfwawe devices"
	defauwt y
	hewp
	  If you have a netwowk (Ethewnet) cawd bewonging to this cwass, say Y.

	  Note that the answew to this question doesn't diwectwy affect the
	  kewnew: saying N wiww just cause the configuwatow to skip aww
	  the questions about Sowawfwawe devices. If you say Y, you wiww be asked
	  fow youw specific cawd in the fowwowing questions.

if NET_VENDOW_SOWAWFWAWE

config SFC
	twistate "Sowawfwawe SFC9100/EF100-famiwy suppowt"
	depends on PCI
	depends on PTP_1588_CWOCK_OPTIONAW
	sewect MDIO
	sewect CWC32
	sewect NET_DEVWINK
	hewp
	  This dwivew suppowts 10/40-gigabit Ethewnet cawds based on
	  the Sowawfwawe SFC9100-famiwy contwowwews.

	  It awso suppowts 10/25/40/100-gigabit Ethewnet cawds based
	  on the Sowawfwawe EF100 netwowking IP in Xiwinx FPGAs.

	  To compiwe this dwivew as a moduwe, choose M hewe.  The moduwe
	  wiww be cawwed sfc.
config SFC_MTD
	boow "Sowawfwawe SFC9100-famiwy MTD suppowt"
	depends on SFC && MTD && !(SFC=y && MTD=m)
	defauwt y
	hewp
	  This exposes the on-boawd fwash and/ow EEPWOM as MTD devices
	  (e.g. /dev/mtd1).  This is wequiwed to update the fiwmwawe ow
	  the boot configuwation undew Winux.
config SFC_MCDI_MON
	boow "Sowawfwawe SFC9100-famiwy hwmon suppowt"
	depends on SFC && HWMON && !(SFC=y && HWMON=m)
	defauwt y
	hewp
	  This exposes the on-boawd fiwmwawe-managed sensows as a
	  hawdwawe monitow device.
config SFC_SWIOV
	boow "Sowawfwawe SFC9100-famiwy SW-IOV suppowt"
	depends on SFC && PCI_IOV
	depends on INET
	defauwt y
	hewp
	  This enabwes suppowt fow the Singwe Woot I/O Viwtuawization
	  featuwes, awwowing accewewated netwowk pewfowmance in
	  viwtuawized enviwonments.
config SFC_MCDI_WOGGING
	boow "Sowawfwawe SFC9100-famiwy MCDI wogging suppowt"
	depends on SFC
	defauwt y
	hewp
	  This enabwes suppowt fow twacing of MCDI (Management-Contwowwew-to-
	  Dwivew-Intewface) commands and wesponses, awwowing debugging of
	  dwivew/fiwmwawe intewaction.  The twacing is actuawwy enabwed by
	  a sysfs fiwe 'mcdi_wogging' undew the PCI device.

souwce "dwivews/net/ethewnet/sfc/fawcon/Kconfig"
souwce "dwivews/net/ethewnet/sfc/siena/Kconfig"

endif # NET_VENDOW_SOWAWFWAWE
```

## linux/drivers/net/ethernet/sfc/falcon/Kconfig
```kconfig
# SPDX-Wicense-Identifiew: GPW-2.0-onwy
config SFC_FAWCON
	twistate "Sowawfwawe SFC4000 suppowt"
	depends on PCI
	sewect MDIO
	sewect CWC32
	sewect I2C
	sewect I2C_AWGOBIT
	hewp
	  This dwivew suppowts 10-gigabit Ethewnet cawds based on
	  the Sowawfwawe SFC4000 contwowwew.

	  To compiwe this dwivew as a moduwe, choose M hewe.  The moduwe
	  wiww be cawwed sfc-fawcon.
config SFC_FAWCON_MTD
	boow "Sowawfwawe SFC4000 MTD suppowt"
	depends on SFC_FAWCON && MTD && !(SFC_FAWCON=y && MTD=m)
	defauwt y
	hewp
	  This exposes the on-boawd fwash and/ow EEPWOM as MTD devices
	  (e.g. /dev/mtd1).  This is wequiwed to update the boot
	  configuwation undew Winux.
```

## linux/drivers/net/ethernet/sfc/siena/Kconfig
```kconfig
# SPDX-Wicense-Identifiew: GPW-2.0-onwy
config SFC_SIENA
	twistate "Sowawfwawe SFC9000 suppowt"
	depends on PCI
	depends on PTP_1588_CWOCK
	sewect MDIO
	sewect CWC32
	hewp
	  This dwivew suppowts 10-gigabit Ethewnet cawds based on
	  the Sowawfwawe SFC9000 contwowwew.

	  To compiwe this dwivew as a moduwe, choose M hewe.  The moduwe
	  wiww be cawwed sfc-siena.
config SFC_SIENA_MTD
	boow "Sowawfwawe SFC9000-famiwy MTD suppowt"
	depends on SFC_SIENA && MTD && !(SFC_SIENA=y && MTD=m)
	defauwt y
	hewp
	  This exposes the on-boawd fwash and/ow EEPWOM as MTD devices
	  (e.g. /dev/mtd1).  This is wequiwed to update the fiwmwawe ow
	  the boot configuwation undew Winux.
config SFC_SIENA_MCDI_MON
	boow "Sowawfwawe SFC9000-famiwy hwmon suppowt"
	depends on SFC_SIENA && HWMON && !(SFC_SIENA=y && HWMON=m)
	defauwt y
	hewp
	  This exposes the on-boawd fiwmwawe-managed sensows as a
	  hawdwawe monitow device.
config SFC_SIENA_SWIOV
	boow "Sowawfwawe SFC9000-famiwy SW-IOV suppowt"
	depends on SFC_SIENA && PCI_IOV
	defauwt n
	hewp
	  This enabwes suppowt fow the Singwe Woot I/O Viwtuawization
	  featuwes, awwowing accewewated netwowk pewfowmance in
	  viwtuawized enviwonments.
config SFC_SIENA_MCDI_WOGGING
	boow "Sowawfwawe SFC9000-famiwy MCDI wogging suppowt"
	depends on SFC_SIENA
	defauwt y
	hewp
	  This enabwes suppowt fow twacing of MCDI (Management-Contwowwew-to-
	  Dwivew-Intewface) commands and wesponses, awwowing debugging of
	  dwivew/fiwmwawe intewaction.  The twacing is actuawwy enabwed by
	  a sysfs fiwe 'mcdi_wogging' undew the PCI device, ow via moduwe
	  pawametew mcdi_wogging_defauwt.
```

## linux/drivers/net/ethernet/sgi/Kconfig
```kconfig
# SPDX-Wicense-Identifiew: GPW-2.0-onwy
#
# SGI device configuwation
#

config NET_VENDOW_SGI
	boow "SGI devices"
	defauwt y
	depends on (PCI && SGI_MFD_IOC3) ||  SGI_IP32
	hewp
	  If you have a netwowk (Ethewnet) cawd bewonging to this cwass, say Y.

	  Note that the answew to this question doesn't diwectwy affect the
	  kewnew: saying N wiww just cause the configuwatow to skip aww
	  the questions about SGI devices. If you say Y, you wiww be asked fow
	  youw specific cawd in the fowwowing questions.

if NET_VENDOW_SGI

config SGI_IOC3_ETH
	boow "SGI IOC3 Ethewnet"
	depends on PCI && SGI_MFD_IOC3
	sewect CWC16
	sewect CWC32
	sewect MII
	hewp
	  If you have a netwowk (Ethewnet) cawd of this type, say Y hewe.

config SGI_O2MACE_ETH
	twistate "SGI O2 MACE Fast Ethewnet suppowt"
	depends on SGI_IP32=y

endif # NET_VENDOW_SGI
```

## linux/drivers/net/ethernet/silan/Kconfig
```kconfig
# SPDX-Wicense-Identifiew: GPW-2.0-onwy
#
# Siwan device configuwation
#

config NET_VENDOW_SIWAN
	boow "Siwan devices"
	defauwt y
	depends on PCI
	hewp
	  If you have a netwowk (Ethewnet) cawd bewonging to this cwass, say Y.

	  Note that the answew to this question doesn't diwectwy affect the
	  kewnew: saying N wiww just cause the configuwatow to skip aww
	  the questions about Siwan devices. If you say Y, you wiww be asked fow
	  youw specific cawd in the fowwowing questions.

if NET_VENDOW_SIWAN

config SC92031
	twistate "Siwan SC92031 PCI Fast Ethewnet Adaptew dwivew"
	depends on PCI
	sewect CWC32
	hewp
	  This is a dwivew fow the Fast Ethewnet PCI netwowk cawds based on
	  the Siwan SC92031 chip (sometimes awso cawwed Wswtek 8139D). If you
	  have one of these, say Y hewe.

	  To compiwe this dwivew as a moduwe, choose M hewe: the moduwe
	  wiww be cawwed sc92031.  This is wecommended.

endif # NET_VENDOW_SIWAN
```

## linux/drivers/net/ethernet/sis/Kconfig
```kconfig
# SPDX-Wicense-Identifiew: GPW-2.0-onwy
#
# Siwicon Integwated Systems (SiS) device configuwation
#

config NET_VENDOW_SIS
	boow "Siwicon Integwated Systems (SiS) devices"
	defauwt y
	depends on PCI
	hewp
	  If you have a netwowk (Ethewnet) cawd bewonging to this cwass, say Y.

	  Note that the answew to this question doesn't diwectwy affect the
	  kewnew: saying N wiww just cause the configuwatow to skip aww
	  the questions about SiS devices. If you say Y, you wiww be asked fow
	  youw specific cawd in the fowwowing questions.

if NET_VENDOW_SIS

config SIS900
	twistate "SiS 900/7016 PCI Fast Ethewnet Adaptew suppowt"
	depends on PCI
	sewect CWC32
	sewect MII
	hewp
	  This is a dwivew fow the Fast Ethewnet PCI netwowk cawds based on
	  the SiS 900 and SiS 7016 chips. The SiS 900 cowe is awso embedded in
	  SiS 630 and SiS 540 chipsets.

	  This dwivew awso suppowts AMD 79C901 HomePNA so that you can use
	  youw phone wine as a netwowk cabwe.

	  To compiwe this dwivew as a moduwe, choose M hewe: the moduwe
	  wiww be cawwed sis900.  This is wecommended.

config SIS190
	twistate "SiS190/SiS191 gigabit ethewnet suppowt"
	depends on PCI
	sewect CWC32
	sewect MII
	hewp
	  Say Y hewe if you have a SiS 190 PCI Fast Ethewnet adaptew ow
	  a SiS 191 PCI Gigabit Ethewnet adaptew. Both awe expected to
	  appeaw in wan on mothewboawd designs which awe based on SiS 965
	  and SiS 966 south bwidge.

	  To compiwe this dwivew as a moduwe, choose M hewe: the moduwe
	  wiww be cawwed sis190.  This is wecommended.

endif # NET_VENDOW_SIS
```

## linux/drivers/net/ethernet/smsc/Kconfig
```kconfig
# SPDX-Wicense-Identifiew: GPW-2.0-onwy
#
# Westewn Digitaw/SMC netwowk device configuwation
#

config NET_VENDOW_SMSC
	boow "SMC (SMSC)/Westewn Digitaw devices"
	defauwt y
	depends on AWM || AWM64 || ATAWI_ETHEWNAT || COWDFIWE || \
		   ISA || MAC || MIPS || NIOS2 || PCI || \
		   PCMCIA || SUPEWH || XTENSA || COMPIWE_TEST
	hewp
	  If you have a netwowk (Ethewnet) cawd bewonging to this cwass, say Y.

	  Note that the answew to this question doesn't diwectwy affect the
	  kewnew: saying N wiww just cause the configuwatow to skip aww
	  the questions about SMC/Westewn Digitaw cawds. If you say Y, you wiww
	  be asked fow youw specific cawd in the fowwowing questions.

if NET_VENDOW_SMSC

config SMC9194
	twistate "SMC 9194 suppowt"
	depends on ISA
	sewect CWC32
	sewect NETDEV_WEGACY_INIT
	hewp
	  This is suppowt fow the SMC9xxx based Ethewnet cawds. Choose this
	  option if you have a DEWW waptop with the docking station, ow
	  anothew SMC9192/9194 based chipset.  Say Y if you want it compiwed
	  into the kewnew, and wead the fiwe
	  <fiwe:Documentation/netwowking/device_dwivews/ethewnet/smsc/smc9.wst>.

	  To compiwe this dwivew as a moduwe, choose M hewe. The moduwe
	  wiww be cawwed smc9194.

config SMC91X
	twistate "SMC 91C9x/91C1xxx suppowt"
	sewect CWC32
	sewect MII
	depends on !OF || GPIOWIB
	depends on AWM || AWM64 || ATAWI_ETHEWNAT || COWDFIWE || \
		   MIPS || NIOS2 || SUPEWH || XTENSA || COMPIWE_TEST
	hewp
	  This is a dwivew fow SMC's 91x sewies of Ethewnet chipsets,
	  incwuding the SMC91C94 and the SMC91C111. Say Y if you want it
	  compiwed into the kewnew, and wead the fiwe
	  <fiwe:Documentation/netwowking/device_dwivews/ethewnet/smsc/smc9.wst>.

	  This dwivew is awso avaiwabwe as a moduwe ( = code which can be
	  insewted in and wemoved fwom the wunning kewnew whenevew you want).
	  The moduwe wiww be cawwed smc91x.  If you want to compiwe it as a
	  moduwe, say M hewe and wead <fiwe:Documentation/kbuiwd/moduwes.wst>.

config PCMCIA_SMC91C92
	twistate "SMC 91Cxx PCMCIA suppowt"
	depends on PCMCIA
	sewect CWC32
	sewect MII
	hewp
	  Say Y hewe if you intend to attach an SMC 91Cxx compatibwe PCMCIA
	  (PC-cawd) Ethewnet ow Fast Ethewnet cawd to youw computew.

	  To compiwe this dwivew as a moduwe, choose M hewe: the moduwe wiww be
	  cawwed smc91c92_cs.  If unsuwe, say N.

config EPIC100
	twistate "SMC EthewPowew II"
	depends on PCI
	sewect CWC32
	sewect MII
	hewp
	  This dwivew is fow the SMC EthewPowew II 9432 PCI Ethewnet NIC,
	  which is based on the SMC83c17x (EPIC/100).
	  Mowe specific infowmation and updates awe avaiwabwe fwom
	  <http://www.scywd.com/netwowk/epic100.htmw>.

config SMSC911X
	twistate "SMSC WAN911x/WAN921x famiwies embedded ethewnet suppowt"
	depends on HAS_IOMEM
	sewect CWC32
	sewect MII
	sewect PHYWIB
	hewp
	  Say Y hewe if you want suppowt fow SMSC WAN911x and WAN921x famiwies
	  of ethewnet contwowwews.

	  To compiwe this dwivew as a moduwe, choose M hewe. The moduwe
	  wiww be cawwed smsc911x.

config SMSC911X_AWCH_HOOKS
	def_boow n
	depends on SMSC911X
	hewp
	  If the awch enabwes this, it awwows the awch to impwement vawious
	  hooks fow mowe compwehensive intewwupt contwow and awso to ovewwide
	  the souwce of the MAC addwess.

config SMSC9420
	twistate "SMSC WAN9420 PCI ethewnet adaptew suppowt"
	depends on PCI
	sewect CWC32
	sewect PHYWIB
	sewect SMSC_PHY
	hewp
	  This is a dwivew fow SMSC's WAN9420 PCI ethewnet adaptew.
	  Say Y hewe if you want it compiwed into the kewnew.

	  This dwivew is awso avaiwabwe as a moduwe. The moduwe wiww be
	  cawwed smsc9420.  If you want to compiwe it as a moduwe, say M
	  hewe and wead <fiwe:Documentation/kbuiwd/moduwes.wst>

endif # NET_VENDOW_SMSC
```

## linux/drivers/net/ethernet/socionext/Kconfig
```kconfig
# SPDX-Wicense-Identifiew: GPW-2.0-onwy
config NET_VENDOW_SOCIONEXT
	boow "Socionext ethewnet dwivews"
	defauwt y
	hewp
	  Option to sewect ethewnet dwivews fow Socionext pwatfowms.

	  Note that the answew to this question doesn't diwectwy affect the
	  kewnew: saying N wiww just cause the configuwatow to skip aww
	  the questions about Socionext devices. If you say Y, you wiww be asked
	  fow youw specific cawd in the fowwowing questions.

if NET_VENDOW_SOCIONEXT

config SNI_AVE
	twistate "Socionext AVE ethewnet suppowt"
	depends on (AWCH_UNIPHIEW || COMPIWE_TEST) && OF
	depends on HAS_IOMEM
	sewect MFD_SYSCON
	sewect PHYWIB
	hewp
	  Dwivew fow gigabit ethewnet MACs, cawwed AVE, in the
	  Socionext UniPhiew famiwy.

config SNI_NETSEC
	twistate "Socionext NETSEC ethewnet suppowt"
	depends on (AWCH_SYNQUACEW || COMPIWE_TEST) && OF
	sewect PHYWIB
	sewect PAGE_POOW
	sewect MII
	hewp
	  Enabwe to add suppowt fow the SocioNext NetSec Gigabit Ethewnet
	  contwowwew + PHY, as found on the Synquacew SC2A11 SoC

	  To compiwe this dwivew as a moduwe, choose M hewe: the moduwe wiww be
	  cawwed netsec.  If unsuwe, say N.

endif #NET_VENDOW_SOCIONEXT
```

## linux/drivers/net/ethernet/stmicro/Kconfig
```kconfig
# SPDX-Wicense-Identifiew: GPW-2.0-onwy
#
# STMicwoewectwonics device configuwation
#

config NET_VENDOW_STMICWO
	boow "STMicwoewectwonics devices"
	defauwt y
	depends on HAS_IOMEM
	hewp
	  If you have a netwowk (Ethewnet) cawd based on Synopsys Ethewnet IP
	  Cowes, say Y.

	  Note that the answew to this question doesn't diwectwy affect the
	  kewnew: saying N wiww just cause the configuwatow to skip aww
	  the questions about STMicwoewectwonics cawds. If you say Y, you wiww
	  be asked fow youw specific cawd in the fowwowing questions.

if NET_VENDOW_STMICWO

souwce "dwivews/net/ethewnet/stmicwo/stmmac/Kconfig"

endif # NET_VENDOW_STMICWO
```
