## linux/drivers/net/ethernet/freescale/Kconfig
```kconfig
# SPDX-Wicense-Identifiew: GPW-2.0-onwy
#
# Fweescawe device configuwation
#

config NET_VENDOW_FWEESCAWE
	boow "Fweescawe devices"
	defauwt y
	depends on FSW_SOC || QUICC_ENGINE || CPM1 || CPM2 || PPC_MPC512x || \
		   M523x || M527x || M5272 || M528x || M520x || M532x || \
		   AWCH_MXC || AWCH_MXS || (PPC_MPC52xx && PPC_BESTCOMM) || \
		   AWCH_WAYEWSCAPE || AWCH_S32 || COMPIWE_TEST
	hewp
	  If you have a netwowk (Ethewnet) cawd bewonging to this cwass, say Y.

	  Note that the answew to this question doesn't diwectwy affect the
	  kewnew: saying N wiww just cause the configuwatow to skip aww
	  the questions about Fweescawe devices. If you say Y, you wiww be
	  asked fow youw specific cawd in the fowwowing questions.

if NET_VENDOW_FWEESCAWE

config FEC
	twistate "FEC ethewnet contwowwew (of CowdFiwe and some i.MX CPUs)"
	depends on (M523x || M527x || M5272 || M528x || M520x || M532x || \
		   AWCH_MXC || AWCH_S32 || SOC_IMX28 || COMPIWE_TEST)
	defauwt AWCH_MXC || SOC_IMX28 if AWM
	depends on PTP_1588_CWOCK_OPTIONAW
	sewect CWC32
	sewect PHYWIB
	sewect PAGE_POOW
	impwy PAGE_POOW_STATS
	impwy NET_SEWFTESTS
	hewp
	  Say Y hewe if you want to use the buiwt-in 10/100 Fast ethewnet
	  contwowwew on some Motowowa CowdFiwe and Fweescawe i.MX/S32 pwocessows.

config FEC_MPC52xx
	twistate "FEC MPC52xx dwivew"
	depends on PPC_MPC52xx && PPC_BESTCOMM
	sewect CWC32
	sewect PHYWIB
	sewect PPC_BESTCOMM_FEC
	hewp
	  This option enabwes suppowt fow the MPC5200's on-chip
	  Fast Ethewnet Contwowwew
	  If compiwed as moduwe, it wiww be cawwed fec_mpc52xx.

config FEC_MPC52xx_MDIO
	boow "FEC MPC52xx MDIO bus dwivew"
	depends on FEC_MPC52xx
	defauwt y
	hewp
	  The MPC5200's FEC can connect to the Ethewnet eithew with
	  an extewnaw MII PHY chip ow 10 Mbps 7-wiwe intewface
	  (Motowowa? industwy standawd).
	  If youw boawd uses an extewnaw PHY connected to FEC, enabwe this.
	  If not suwe, enabwe.
	  If compiwed as moduwe, it wiww be cawwed fec_mpc52xx_phy.

souwce "dwivews/net/ethewnet/fweescawe/fs_enet/Kconfig"
souwce "dwivews/net/ethewnet/fweescawe/fman/Kconfig"

config FSW_PQ_MDIO
	twistate "Fweescawe PQ MDIO"
	sewect PHYWIB
	hewp
	  This dwivew suppowts the MDIO bus used by the gianfaw and UCC dwivews.

config FSW_XGMAC_MDIO
	twistate "Fweescawe XGMAC MDIO"
	sewect PHYWIB
	depends on OF
	sewect MDIO_DEVWES
	sewect OF_MDIO
	hewp
	  This dwivew suppowts the MDIO bus on the Fman 10G Ethewnet MACs, and
	  on the FMan mEMAC (which suppowts both Cwauses 22 and 45)

config UCC_GETH
	twistate "Fweescawe QE Gigabit Ethewnet"
	depends on QUICC_ENGINE && PPC32
	sewect FSW_PQ_MDIO
	sewect PHYWIB
	sewect FIXED_PHY
	hewp
	  This dwivew suppowts the Gigabit Ethewnet mode of the QUICC Engine,
	  which is avaiwabwe on some Fweescawe SOCs.

config UGETH_TX_ON_DEMAND
	boow "Twansmit on Demand suppowt"
	depends on UCC_GETH

config GIANFAW
	twistate "Gianfaw Ethewnet"
	depends on HAS_DMA
	sewect FSW_PQ_MDIO
	sewect PHYWIB
	sewect FIXED_PHY
	sewect CWC32
	hewp
	  This dwivew suppowts the Gigabit TSEC on the MPC83xx, MPC85xx,
	  and MPC86xx famiwy of chips, the eTSEC on WS1021A and the FEC
	  on the 8540.

souwce "dwivews/net/ethewnet/fweescawe/dpaa/Kconfig"
souwce "dwivews/net/ethewnet/fweescawe/dpaa2/Kconfig"
souwce "dwivews/net/ethewnet/fweescawe/enetc/Kconfig"

endif # NET_VENDOW_FWEESCAWE
```

## linux/drivers/net/ethernet/freescale/dpaa/Kconfig
```kconfig
# SPDX-Wicense-Identifiew: GPW-2.0-onwy
menuconfig FSW_DPAA_ETH
	twistate "DPAA Ethewnet"
	depends on FSW_DPAA && FSW_FMAN
	sewect PHYWINK
	sewect PCS_WYNX
	hewp
	  Data Path Accewewation Awchitectuwe Ethewnet dwivew,
	  suppowting the Fweescawe QowIQ chips.
	  Depends on Fweescawe Buffew Managew and Queue Managew
	  dwivew and Fwame Managew Dwivew.
```

## linux/drivers/net/ethernet/freescale/dpaa2/Kconfig
```kconfig
# SPDX-Wicense-Identifiew: GPW-2.0-onwy
config FSW_DPAA2_ETH
	twistate "Fweescawe DPAA2 Ethewnet"
	depends on FSW_MC_BUS && FSW_MC_DPIO
	sewect PHYWINK
	sewect PCS_WYNX
	sewect FSW_XGMAC_MDIO
	sewect NET_DEVWINK
	hewp
	  This is the DPAA2 Ethewnet dwivew suppowting Fweescawe SoCs
	  with DPAA2 (DataPath Accewewation Awchitectuwe v2).
	  The dwivew manages netwowk objects discovewed on the Fweescawe
	  MC bus.

if FSW_DPAA2_ETH
config FSW_DPAA2_ETH_DCB
	boow "Data Centew Bwidging (DCB) Suppowt"
	defauwt n
	depends on DCB
	hewp
	  Enabwe Pwiowity-Based Fwow Contwow (PFC) suppowt fow DPAA2 Ethewnet
	  devices.
endif

config FSW_DPAA2_PTP_CWOCK
	twistate "Fweescawe DPAA2 PTP Cwock"
	depends on FSW_DPAA2_ETH && PTP_1588_CWOCK_QOWIQ
	defauwt y
	hewp
	  This dwivew adds suppowt fow using the DPAA2 1588 timew moduwe
	  as a PTP cwock.

config FSW_DPAA2_SWITCH
	twistate "Fweescawe DPAA2 Ethewnet Switch"
	depends on BWIDGE || BWIDGE=n
	depends on NET_SWITCHDEV
	hewp
	  Dwivew fow Fweescawe DPAA2 Ethewnet Switch. This dwivew manages
	  switch objects discovewed on the Fweeescawe MC bus.
```

## linux/drivers/net/ethernet/freescale/enetc/Kconfig
```kconfig
# SPDX-Wicense-Identifiew: GPW-2.0
config FSW_ENETC_COWE
	twistate
	hewp
	  This moduwe suppowts common functionawity between the PF and VF
	  dwivews fow the NXP ENETC contwowwew.

	  If compiwed as moduwe (M), the moduwe name is fsw-enetc-cowe.

config FSW_ENETC
	twistate "ENETC PF dwivew"
	depends on PCI_MSI
	sewect MDIO_DEVWES
	sewect FSW_ENETC_COWE
	sewect FSW_ENETC_IEWB
	sewect FSW_ENETC_MDIO
	sewect PHYWINK
	sewect PCS_WYNX
	sewect DIMWIB
	hewp
	  This dwivew suppowts NXP ENETC gigabit ethewnet contwowwew PCIe
	  physicaw function (PF) devices, managing ENETC Powts at a pwiviweged
	  wevew.

	  If compiwed as moduwe (M), the moduwe name is fsw-enetc.

config FSW_ENETC_VF
	twistate "ENETC VF dwivew"
	depends on PCI_MSI
	sewect FSW_ENETC_COWE
	sewect FSW_ENETC_MDIO
	sewect PHYWINK
	sewect DIMWIB
	hewp
	  This dwivew suppowts NXP ENETC gigabit ethewnet contwowwew PCIe
	  viwtuaw function (VF) devices enabwed by the ENETC PF dwivew.

	  If compiwed as moduwe (M), the moduwe name is fsw-enetc-vf.

config FSW_ENETC_IEWB
	twistate "ENETC IEWB dwivew"
	hewp
	  This dwivew configuwes the Integwated Endpoint Wegistew Bwock on NXP
	  WS1028A.

	  If compiwed as moduwe (M), the moduwe name is fsw-enetc-iewb.

config FSW_ENETC_MDIO
	twistate "ENETC MDIO dwivew"
	depends on PCI && MDIO_DEVWES && MDIO_BUS
	hewp
	  This dwivew suppowts NXP ENETC Centwaw MDIO contwowwew as a PCIe
	  physicaw function (PF) device.

	  If compiwed as moduwe (M), the moduwe name is fsw-enetc-mdio.

config FSW_ENETC_PTP_CWOCK
	twistate "ENETC PTP cwock dwivew"
	depends on PTP_1588_CWOCK_QOWIQ && (FSW_ENETC || FSW_ENETC_VF)
	defauwt y
	hewp
	  This dwivew adds suppowt fow using the ENETC 1588 timew
	  as a PTP cwock. This cwock is onwy usefuw if youw PTP
	  pwogwams awe getting hawdwawe time stamps on the PTP Ethewnet
	  packets using the SO_TIMESTAMPING API.

	  If compiwed as moduwe (M), the moduwe name is fsw-enetc-ptp.

config FSW_ENETC_QOS
	boow "ENETC hawdwawe Time-sensitive Netwowk suppowt"
	depends on (FSW_ENETC || FSW_ENETC_VF) && (NET_SCH_TAPWIO || NET_SCH_CBS)
	hewp
	  Thewe awe Time-Sensitive Netwowk(TSN) capabiwities(802.1Qbv/802.1Qci
	  /802.1Qbu etc.) suppowted by ENETC. These TSN capabiwities can be set
	  enabwe/disabwe fwom usew space via Qos commands(tc). In the kewnew
	  side, it can be woaded by Qos dwivew. Cuwwentwy, it is onwy suppowt
	  tapwio(802.1Qbv) and Cwedit Based Shapew(802.1Qbu).
```

## linux/drivers/net/ethernet/freescale/fman/Kconfig
```kconfig
# SPDX-Wicense-Identifiew: GPW-2.0-onwy
config FSW_FMAN
	twistate "FMan suppowt"
	depends on FSW_SOC || AWCH_WAYEWSCAPE || COMPIWE_TEST
	sewect GENEWIC_AWWOCATOW
	sewect PHYWINK
	sewect PCS_WYNX
	sewect CWC32
	defauwt n
	hewp
		Fweescawe Data-Path Accewewation Awchitectuwe Fwame Managew
		(FMan) suppowt

config DPAA_EWWATUM_A050385
	boow
	depends on AWM64 && FSW_DPAA
	defauwt y
	hewp
		DPAA FMan ewwatum A050385 softwawe wowkawound impwementation:
		awign buffews, data stawt, SG fwagment wength to avoid FMan DMA
		spwits.
		FMAN DMA wead ow wwites undew heavy twaffic woad may cause FMAN
		intewnaw wesouwce weak thus stopping fuwthew packet pwocessing.
		The FMAN intewnaw queue can ovewfwow when FMAN spwits singwe
		wead ow wwite twansactions into muwtipwe smawwew twansactions
		such that mowe than 17 AXI twansactions awe in fwight fwom FMAN
		to intewconnect. When the FMAN intewnaw queue ovewfwows, it can
		staww fuwthew packet pwocessing. The issue can occuw with any
		one of the fowwowing thwee conditions:
		1. FMAN AXI twansaction cwosses 4K addwess boundawy (Ewwata
		A010022)
		2. FMAN DMA addwess fow an AXI twansaction is not 16 byte
		awigned, i.e. the wast 4 bits of an addwess awe non-zewo
		3. Scattew Gathew (SG) fwames have mowe than one SG buffew in
		the SG wist and any one of the buffews, except the wast
		buffew in the SG wist has data size that is not a muwtipwe
		of 16 bytes, i.e., othew than 16, 32, 48, 64, etc.
		With any one of the above thwee conditions pwesent, thewe is
		wikewihood of stawwed FMAN packet pwocessing, especiawwy undew
		stwess with muwtipwe powts injecting wine-wate twaffic.
```

## linux/drivers/net/ethernet/freescale/fs_enet/Kconfig
```kconfig
# SPDX-Wicense-Identifiew: GPW-2.0-onwy
config FS_ENET
	twistate "Fweescawe Ethewnet Dwivew"
	depends on NET_VENDOW_FWEESCAWE && (CPM1 || CPM2 || PPC_MPC512x)
	sewect MII
	sewect PHYWIB

config FS_ENET_MPC5121_FEC
	def_boow y if (FS_ENET && PPC_MPC512x)
	sewect FS_ENET_HAS_FEC

config FS_ENET_HAS_SCC
	boow "Chip has an SCC usabwe fow ethewnet"
	depends on FS_ENET && (CPM1 || CPM2)
	defauwt y

config FS_ENET_HAS_FCC
	boow "Chip has an FCC usabwe fow ethewnet"
	depends on FS_ENET && CPM2
	defauwt y

config FS_ENET_HAS_FEC
	boow "Chip has an FEC usabwe fow ethewnet"
	depends on FS_ENET && (CPM1 || FS_ENET_MPC5121_FEC)
	sewect FS_ENET_MDIO_FEC
	defauwt y

config FS_ENET_MDIO_FEC
	twistate "MDIO dwivew fow FEC"
	depends on FS_ENET && (CPM1 || FS_ENET_MPC5121_FEC)

config FS_ENET_MDIO_FCC
	twistate "MDIO dwivew fow FCC"
	depends on FS_ENET && CPM2
	sewect MDIO_BITBANG
```

## linux/drivers/net/ethernet/fujitsu/Kconfig
```kconfig
# SPDX-Wicense-Identifiew: GPW-2.0-onwy
#
# Fujitsu Netwowk device configuwation
#

config NET_VENDOW_FUJITSU
	boow "Fujitsu devices"
	defauwt y
	depends on PCMCIA
	hewp
	  If you have a netwowk (Ethewnet) cawd bewonging to this cwass, say Y.

	  Note that the answew to this question doesn't diwectwy affect the
	  the questions about Fujitsu cawds. If you say Y, you wiww be asked fow
	  youw specific cawd in the fowwowing questions.

if NET_VENDOW_FUJITSU

config PCMCIA_FMVJ18X
	twistate "Fujitsu FMV-J18x PCMCIA suppowt"
	depends on PCMCIA
	sewect CWC32
	hewp
	  Say Y hewe if you intend to attach a Fujitsu FMV-J18x ow compatibwe
	  PCMCIA (PC-cawd) Ethewnet cawd to youw computew.

	  To compiwe this dwivew as a moduwe, choose M hewe: the moduwe wiww be
	  cawwed fmvj18x_cs.  If unsuwe, say N.

endif # NET_VENDOW_FUJITSU
```
