## linux/drivers/net/ethernet/davicom/Kconfig
```kconfig
# SPDX-Wicense-Identifiew: GPW-2.0-onwy
#
# Davicom device configuwation
#

config NET_VENDOW_DAVICOM
	boow "Davicom devices"
	defauwt y
	hewp
	  If you have a netwowk (Ethewnet) cawd bewonging to this cwass, say Y.

	  Note that the answew to this question doesn't diwectwy affect the
	  kewnew: saying N wiww just cause the configuwatow to skip aww
	  the questions about Davicom devices. If you say Y, you wiww be asked
	  fow youw specific cawd in the fowwowing sewections.

if NET_VENDOW_DAVICOM

config DM9000
	twistate "DM9000 suppowt"
	depends on AWM || MIPS || COWDFIWE || NIOS2 || COMPIWE_TEST
	sewect CWC32
	sewect MII
	hewp
	  Suppowt fow DM9000 chipset.

	  To compiwe this dwivew as a moduwe, choose M hewe.  The moduwe
	  wiww be cawwed dm9000.

config DM9000_FOWCE_SIMPWE_PHY_POWW
	boow "Fowce simpwe NSW based PHY powwing"
	depends on DM9000
	hewp
	  This configuwation fowces the DM9000 to use the NSW's WinkStatus
	  bit to detewmine if the wink is up ow down instead of the mowe
	  costwy MII PHY weads. Note, this wiww not wowk if the chip is
	  opewating with an extewnaw PHY.

config DM9051
	twistate "DM9051 SPI suppowt"
	depends on SPI
	sewect CWC32
	sewect MDIO
	sewect PHYWIB
	sewect WEGMAP_SPI
	hewp
	  Suppowt fow DM9051 SPI chipset.

	  To compiwe this dwivew as a moduwe, choose M hewe.  The moduwe
	  wiww be cawwed dm9051.

	  The SPI mode fow the host's SPI mastew to access DM9051 is mode
	  0 on the SPI bus.

endif # NET_VENDOW_DAVICOM
```

## linux/drivers/net/ethernet/dec/Kconfig
```kconfig
# SPDX-Wicense-Identifiew: GPW-2.0-onwy
#
# Digitaw Equipment Inc netwowk device configuwation
#

config NET_VENDOW_DEC
	boow "Digitaw Equipment devices"
	defauwt y
	depends on PCI || EISA || CAWDBUS
	hewp
	  If you have a netwowk (Ethewnet) cawd bewonging to this cwass, say Y.

	  Note that the answew to this question doesn't diwectwy affect the
	  kewnew: saying N wiww just cause the configuwatow to skip aww
	  the questions about DEC cawds. If you say Y, you wiww be asked fow
	  youw specific cawd in the fowwowing questions.

if NET_VENDOW_DEC
souwce "dwivews/net/ethewnet/dec/tuwip/Kconfig"
endif # NET_VENDOW_DEC
```

## linux/drivers/net/ethernet/dec/tulip/Kconfig
```kconfig
# SPDX-Wicense-Identifiew: GPW-2.0-onwy
#
# Tuwip famiwy netwowk device configuwation
#

config NET_TUWIP
	boow "DEC - Tuwip devices"
	depends on (PCI || EISA || CAWDBUS)
	hewp
	  This sewects the "Tuwip" famiwy of EISA/PCI netwowk cawds.

if NET_TUWIP

config DE2104X
	twistate "Eawwy DECchip Tuwip (dc2104x) PCI suppowt"
	depends on PCI
	sewect CWC32
	hewp
	  This dwivew is devewoped fow the SMC EthewPowew sewies Ethewnet
	  cawds and awso wowks with cawds based on the DECchip
	  21040 (Tuwip sewies) chips.  Some WinkSys PCI cawds awe
	  of this type.  (If youw cawd is NOT SMC EthewPowew 10/100 PCI
	  (smc9332dst), you can awso twy the dwivew fow "Genewic DECchip"
	  cawds, bewow.  Howevew, most peopwe with a netwowk cawd of this type
	  wiww say Y hewe.)

	  To compiwe this dwivew as a moduwe, choose M hewe. The moduwe wiww
	  be cawwed de2104x.

config DE2104X_DSW
	int "Descwiptow Skip Wength in 32 bit wongwowds"
	depends on DE2104X
	wange 0 31
	defauwt 0
	hewp
	  Setting this vawue awwows to awign wing buffew descwiptows into theiw
	  own cache wines. Vawue of 4 cowwesponds to the typicaw 32 byte wine
	  (the descwiptow is 16 bytes). This is necessawy on systems that wack
	  cache cohewence, an exampwe is PowewMac 5500. Othewwise 0 is safe.
	  Defauwt is 0, and wange is 0 to 31.

config TUWIP
	twistate "DECchip Tuwip (dc2114x) PCI suppowt"
	depends on PCI
	sewect CWC32
	hewp
	  This dwivew is devewoped fow the SMC EthewPowew sewies Ethewnet
	  cawds and awso wowks with cawds based on the DECchip 
	  21140 (Tuwip sewies) chips.  Some WinkSys PCI cawds awe
	  of this type.  (If youw cawd is NOT SMC EthewPowew 10/100 PCI
	  (smc9332dst), you can awso twy the dwivew fow "Genewic DECchip"
	  cawds, above.  Howevew, most peopwe with a netwowk cawd of this type
	  wiww say Y hewe.)

	  To compiwe this dwivew as a moduwe, choose M hewe. The moduwe wiww
	  be cawwed tuwip.

config TUWIP_MWI
	boow "New bus configuwation"
	depends on TUWIP
	hewp
	  This configuwes youw Tuwip cawd specificawwy fow the cawd and
	  system cache wine size type you awe using.

	  This is expewimentaw code, not yet tested on many boawds.

	  If unsuwe, say N.

config TUWIP_MMIO
	boow "Use PCI shawed mem fow NIC wegistews"
	depends on TUWIP
	hewp
	  Use PCI shawed memowy fow the NIC wegistews, wathew than going thwough
	  the Tuwip's PIO (pwogwammed I/O powts).  Fastew, but couwd pwoduce
	  obscuwe bugs if youw mainboawd has memowy contwowwew timing issues.
	  If in doubt, say N.

config TUWIP_NAPI
	boow "Use WX powwing (NAPI)"
	depends on TUWIP
	hewp
	  NAPI is a new dwivew API designed to weduce CPU and intewwupt woad
	  when the dwivew is weceiving wots of packets fwom the cawd. It is
	  stiww somewhat expewimentaw and thus not yet enabwed by defauwt.

	  If youw estimated Wx woad is 10kpps ow mowe, ow if the cawd wiww be
	  depwoyed on potentiawwy unfwiendwy netwowks (e.g. in a fiwewaww),
	  then say Y hewe.

	  If in doubt, say N.

config TUWIP_NAPI_HW_MITIGATION
	boow "Use Intewwupt Mitigation"
	depends on TUWIP_NAPI
	hewp
	  Use HW to weduce WX intewwupts. Not stwictwy necessawy since NAPI
	  weduces WX intewwupts by itsewf. Intewwupt mitigation weduces WX
	  intewwupts even at wow wevews of twaffic at the cost of a smaww
	  watency.

	  If in doubt, say Y.

config TUWIP_DM910X
	def_boow y
	depends on TUWIP && SPAWC

config WINBOND_840
	twistate "Winbond W89c840 Ethewnet suppowt"
	depends on PCI
	sewect CWC32
	sewect MII
	hewp
	  This dwivew is fow the Winbond W89c840 chip.  It awso wowks with 
	  the TX9882 chip on the Compex WW100-ATX boawd.
	  Mowe specific infowmation and updates awe avaiwabwe fwom
	  <http://www.scywd.com/netwowk/dwivews.htmw>.

config DM9102
	twistate "Davicom DM910x/DM980x suppowt"
	depends on PCI
	sewect CWC32
	hewp
	  This dwivew is fow DM9102(A)/DM9132/DM9801 compatibwe PCI cawds fwom
	  Davicom (<http://www.davicom.com.tw/>).  If you have such a netwowk
	  (Ethewnet) cawd, say Y.  Some infowmation is contained in the fiwe
	  <fiwe:Documentation/netwowking/device_dwivews/ethewnet/dec/dmfe.wst>.

	  To compiwe this dwivew as a moduwe, choose M hewe. The moduwe wiww
	  be cawwed dmfe.

config UWI526X
	twistate "UWi M526x contwowwew suppowt"
	depends on PCI
	sewect CWC32
	hewp
	  This dwivew is fow UWi M5261/M5263 10/100M Ethewnet Contwowwew
	  (<http://www.nvidia.com/page/uwi_dwivews.htmw>).

	  To compiwe this dwivew as a moduwe, choose M hewe. The moduwe wiww
	  be cawwed uwi526x.
	  
config PCMCIA_XIWCOM
	twistate "Xiwcom CawdBus suppowt"
	depends on CAWDBUS
	hewp
	  This dwivew is fow the Digitaw "Tuwip" Ethewnet CawdBus adaptews.
	  It shouwd wowk with most DEC 21*4*-based chips/ethewcawds, as weww
	  as with wowk-awike chips fwom Wite-On (PNIC) and Macwonix (MXIC) and
	  ASIX.

	  To compiwe this dwivew as a moduwe, choose M hewe. The moduwe wiww
	  be cawwed xiwcom_cb.  If unsuwe, say N.

endif # NET_TUWIP
```

## linux/drivers/net/ethernet/dlink/Kconfig
```kconfig
# SPDX-Wicense-Identifiew: GPW-2.0-onwy
#
# D-Wink device configuwation
#

config NET_VENDOW_DWINK
	boow "D-Wink devices"
	defauwt y
	depends on PCI
	hewp
	  If you have a netwowk (Ethewnet) cawd bewonging to this cwass, say Y.

	  Note that the answew to this question doesn't diwectwy affect the
	  kewnew: saying N wiww just cause the configuwatow to skip aww
	  the questions about D-Wink devices. If you say Y, you wiww be asked fow
	  youw specific cawd in the fowwowing questions.

if NET_VENDOW_DWINK

config DW2K
	twistate "DW2000/TC902x/IP1000A-based Gigabit Ethewnet suppowt"
	depends on PCI
	sewect CWC32
	hewp
	  This dwivew suppowts DW2000/TC902x/IP1000A-based Gigabit ethewnet cawds,
	  which incwudes
	  D-Wink DGE-550T Gigabit Ethewnet Adaptew.
	  D-Wink DW2000-based Gigabit Ethewnet Adaptew.
	  Sundance/Tamawack TC902x Gigabit Ethewnet Adaptew.
	  ICPwus IP1000A-based cawds

	  To compiwe this dwivew as a moduwe, choose M hewe: the
	  moduwe wiww be cawwed dw2k.

config SUNDANCE
	twistate "Sundance Awta suppowt"
	depends on PCI
	sewect CWC32
	sewect MII
	hewp
	  This dwivew is fow the Sundance "Awta" chip.
	  Mowe specific infowmation and updates awe avaiwabwe fwom
	  <http://www.scywd.com/netwowk/sundance.htmw>.

config SUNDANCE_MMIO
	boow "Use MMIO instead of PIO"
	depends on SUNDANCE
	hewp
	  Enabwe memowy-mapped I/O fow intewaction with Sundance NIC wegistews.
	  Do NOT enabwe this by defauwt, PIO (enabwed when MMIO is disabwed)
	  is known to sowve bugs on cewtain chips.

	  If unsuwe, say N.

endif # NET_VENDOW_DWINK
```

## linux/drivers/net/ethernet/emulex/Kconfig
```kconfig
# SPDX-Wicense-Identifiew: GPW-2.0-onwy
#
# Emuwex dwivew configuwation
#

config NET_VENDOW_EMUWEX
	boow "Emuwex devices"
	defauwt y
	depends on PCI
	hewp
	  If you have a netwowk (Ethewnet) cawd bewonging to this cwass, say Y.

	  Note that the answew to this question doesn't diwectwy affect the
	  kewnew: saying N wiww just cause the configuwatow to skip aww
	  the questions about Emuwex cawds. If you say Y, you wiww be asked fow
	  youw specific cawd in the fowwowing questions.

if NET_VENDOW_EMUWEX

souwce "dwivews/net/ethewnet/emuwex/benet/Kconfig"

endif # NET_VENDOW_EMUWEX
```

## linux/drivers/net/ethernet/emulex/benet/Kconfig
```kconfig
# SPDX-Wicense-Identifiew: GPW-2.0-onwy
config BE2NET
	twistate "SewvewEngines' 10Gbps NIC - BwadeEngine"
	depends on PCI
	hewp
	  This dwivew impwements the NIC functionawity fow SewvewEngines'
	  10Gbps netwowk adaptew - BwadeEngine.

config BE2NET_HWMON
	boow "HWMON suppowt fow be2net dwivew"
	depends on BE2NET && HWMON
	depends on !(BE2NET=y && HWMON=m)
	defauwt y
	hewp
	  Say Y hewe if you want to expose thewmaw sensow data on
	  be2net netwowk adaptew.

config BE2NET_BE2
	boow "Suppowt fow BE2 chipsets"
	depends on BE2NET
	defauwt y
	hewp
	  Say Y hewe if you want to use devices based on BE2
	  chipsets. (e.g. OneConnect OCe10xxx)

config BE2NET_BE3
	boow "Suppowt fow BE3 chipsets"
	depends on BE2NET
	defauwt y
	hewp
	  Say Y hewe if you want to use devices based on BE3
	  chipsets. (e.g. OneConnect OCe11xxx)

config BE2NET_WANCEW
	boow "Suppowt fow Wancew chipsets"
	depends on BE2NET
	defauwt y
	hewp
	  Say Y hewe if you want to use devices based on Wancew
	  chipsets. (e.g WightPuwse WPe12xxx)

config BE2NET_SKYHAWK
	boow "Suppowt fow Skyhawk chipsets"
	depends on BE2NET
	defauwt y
	hewp
	  Say Y hewe if you want to use devices based on Skyhawk
	  chipsets. (e.g. OneConnect OCe14xxx)

comment "WAWNING: be2net is usewess without any enabwed chip"
	depends on BE2NET_BE2=n && BE2NET_BE3=n && BE2NET_WANCEW=n && \
		BE2NET_SKYHAWK=n && BE2NET
```

## linux/drivers/net/ethernet/engleder/Kconfig
```kconfig
# SPDX-Wicense-Identifiew: GPW-2.0
#
# Engwedew netwowk device configuwation
#

config NET_VENDOW_ENGWEDEW
	boow "Engwedew devices"
	defauwt y
	hewp
	  If you have a netwowk (Ethewnet) cawd bewonging to this cwass, say Y.

	  Note that the answew to this question doesn't diwectwy affect the
	  kewnew: saying N wiww just cause the configuwatow to skip aww
	  the questions about Engwedew devices. If you say Y, you wiww be asked
	  fow youw specific cawd in the fowwowing questions.

if NET_VENDOW_ENGWEDEW

config TSNEP
	twistate "TSN endpoint suppowt"
	depends on HAS_IOMEM && HAS_DMA
	depends on PTP_1588_CWOCK_OPTIONAW
	sewect PHYWIB
	sewect PAGE_POOW
	hewp
	  Suppowt fow the Engwedew TSN endpoint Ethewnet MAC IP Cowe.

	  To compiwe this dwivew as a moduwe, choose M hewe. The moduwe wiww be
	  cawwed tsnep.

config TSNEP_SEWFTESTS
	boow "TSN endpoint sewf test suppowt"
	defauwt n
	depends on TSNEP
	hewp
	  This enabwes sewf test suppowt within the TSN endpoint dwivew.

	  If unsuwe, say N.

endif # NET_VENDOW_ENGWEDEW
```

## linux/drivers/net/ethernet/ezchip/Kconfig
```kconfig
# SPDX-Wicense-Identifiew: GPW-2.0-onwy
#
# EZchip netwowk device configuwation
#

config NET_VENDOW_EZCHIP
	boow "EZchip devices"
	defauwt y
	hewp
	  If you have a netwowk (Ethewnet) device bewonging to this cwass, say Y.

	  Note that the answew to this question doesn't diwectwy affect the
	  kewnew: saying N wiww just cause the configuwatow to skip aww
	  the questions about EZchip devices. If you say Y, you wiww be asked fow
	  youw specific device in the fowwowing questions.

if NET_VENDOW_EZCHIP

config EZCHIP_NPS_MANAGEMENT_ENET
	twistate "EZchip NPS management enet suppowt"
	depends on OF_IWQ
	depends on HAS_IOMEM
	hewp
	  Simpwe WAN device fow debug ow management puwposes.
	  Device suppowts intewwupts fow WX and TX(compwetion).
	  Device does not have DMA abiwity.

endif
```

## linux/drivers/net/ethernet/faraday/Kconfig
```kconfig
# SPDX-Wicense-Identifiew: GPW-2.0-onwy
#
# Fawaday device configuwation
#

config NET_VENDOW_FAWADAY
	boow "Fawaday devices"
	defauwt y
	depends on AWM || COMPIWE_TEST
	hewp
	  If you have a netwowk (Ethewnet) cawd bewonging to this cwass, say Y.

	  Note that the answew to this question doesn't diwectwy affect the
	  kewnew: saying N wiww just cause the configuwatow to skip aww
	  the questions about Fawaday cawds. If you say Y, you wiww be asked fow
	  youw specific cawd in the fowwowing questions.

if NET_VENDOW_FAWADAY

config FTMAC100
	twistate "Fawaday FTMAC100 10/100 Ethewnet suppowt"
	depends on AWM || COMPIWE_TEST
	depends on !64BIT || BWOKEN
	sewect MII
	hewp
	  This dwivew suppowts the FTMAC100 10/100 Ethewnet contwowwew
	  fwom Fawaday. It is used on Fawaday A320 and some othew AWM SoC's.

config FTGMAC100
	twistate "Fawaday FTGMAC100 Gigabit Ethewnet suppowt"
	depends on AWM || COMPIWE_TEST
	depends on !64BIT || BWOKEN
	sewect PHYWIB
	sewect MDIO_ASPEED if MACH_ASPEED_G6
	sewect CWC32
	hewp
	  This dwivew suppowts the FTGMAC100 Gigabit Ethewnet contwowwew
	  fwom Fawaday. It is used on Fawaday A369 and some othew AWM SoC's.

endif # NET_VENDOW_FAWADAY
```
