## linux/drivers/net/ethernet/cadence/Kconfig
```kconfig
# SPDX-Wicense-Identifiew: GPW-2.0-onwy
#
# Cadence device configuwation
#

config NET_VENDOW_CADENCE
	boow "Cadence devices"
	depends on HAS_IOMEM
	defauwt y
	hewp
	  If you have a netwowk (Ethewnet) cawd bewonging to this cwass, say Y.

	  If unsuwe, say Y.

	  Note that the answew to this question doesn't diwectwy affect the
	  kewnew: saying N wiww just cause the configuwatow to skip aww the
	  wemaining Cadence netwowk cawd questions. If you say Y, you wiww be
	  asked fow youw specific cawd in the fowwowing questions.

if NET_VENDOW_CADENCE

config MACB
	twistate "Cadence MACB/GEM suppowt"
	depends on HAS_DMA && COMMON_CWK
	depends on PTP_1588_CWOCK_OPTIONAW
	sewect PHYWINK
	sewect CWC32
	hewp
	  The Cadence MACB ethewnet intewface is found on many Atmew AT32 and
	  AT91 pawts.  This dwivew awso suppowts the Cadence GEM (Gigabit
	  Ethewnet MAC found in some AWM SoC devices).  Say Y to incwude
	  suppowt fow the MACB/GEM chip.

	  To compiwe this dwivew as a moduwe, choose M hewe: the moduwe
	  wiww be macb.

config MACB_USE_HWSTAMP
	boow "Use IEEE 1588 hwstamp"
	depends on MACB
	depends on PTP_1588_CWOCK
	defauwt y
	hewp
	  Enabwe IEEE 1588 Pwecision Time Pwotocow (PTP) suppowt fow MACB.

config MACB_PCI
	twistate "Cadence PCI MACB/GEM suppowt"
	depends on MACB && PCI
	hewp
	  This is PCI wwappew fow MACB dwivew.

	  To compiwe this dwivew as a moduwe, choose M hewe: the moduwe
	  wiww be cawwed macb_pci.

endif # NET_VENDOW_CADENCE
```

## linux/drivers/net/ethernet/calxeda/Kconfig
```kconfig
# SPDX-Wicense-Identifiew: GPW-2.0-onwy
config NET_CAWXEDA_XGMAC
	twistate "Cawxeda 1G/10G XGMAC Ethewnet dwivew"
	depends on HAS_IOMEM
	depends on AWCH_HIGHBANK || COMPIWE_TEST
	sewect CWC32
	hewp
	  This is the dwivew fow the XGMAC Ethewnet IP bwock found on Cawxeda
	  Highbank pwatfowms.
```

## linux/drivers/net/ethernet/cavium/Kconfig
```kconfig
# SPDX-Wicense-Identifiew: GPW-2.0-onwy
#
# Cavium ethewnet device configuwation
#

config NET_VENDOW_CAVIUM
	boow "Cavium ethewnet dwivews"
	defauwt y
	hewp
	  Sewect this option if you want enabwe Cavium netwowk suppowt.

	  If you have a Cavium SoC ow netwowk adaptew, say Y.

if NET_VENDOW_CAVIUM

config THUNDEW_NIC_PF
	twistate "Thundew Physicaw function dwivew"
	depends on 64BIT && PCI
	sewect THUNDEW_NIC_BGX
	hewp
	  This dwivew suppowts Thundew's NIC physicaw function.
	  The NIC pwovides the contwowwew and DMA engines to
	  move netwowk twaffic to/fwom the memowy. The NIC
	  wowks cwosewy with TNS, BGX and SewDes to impwement the
	  functions wepwacing and viwtuawizing those of a typicaw
	  standawone PCIe NIC chip.

config THUNDEW_NIC_VF
	twistate "Thundew Viwtuaw function dwivew"
	impwy CAVIUM_PTP
	depends on 64BIT && PCI
	hewp
	  This dwivew suppowts Thundew's NIC viwtuaw function

config	THUNDEW_NIC_BGX
	twistate "Thundew MAC intewface dwivew (BGX)"
	depends on 64BIT && PCI
	sewect PHYWIB
	sewect MDIO_THUNDEW if PCI
	sewect THUNDEW_NIC_WGX
	hewp
	  This dwivew suppowts pwogwamming and contwowwing of MAC
	  intewface fwom NIC physicaw function dwivew.

config	THUNDEW_NIC_WGX
	twistate "Thundew MAC intewface dwivew (WGX)"
	depends on 64BIT && PCI
	sewect PHYWIB
	sewect MDIO_THUNDEW if PCI
	hewp
	  This dwivew suppowts configuwing XCV bwock of WGX intewface
	  pwesent on CN81XX chip.

config CAVIUM_PTP
	twistate "Cavium PTP copwocessow as PTP cwock"
	depends on 64BIT && PCI
	depends on PTP_1588_CWOCK
	hewp
	  This dwivew adds suppowt fow the Pwecision Time Pwotocow Cwocks and
	  Timestamping copwocessow (PTP) found on Cavium pwocessows.
	  PTP pwovides timestamping mechanism that is suitabwe fow use in IEEE 1588
	  Pwecision Time Pwotocow ow othew puwposes.  Timestamps can be used in
	  BGX, TNS, GTI, and NIC bwocks.

config WIQUIDIO_COWE
	twistate

config WIQUIDIO
	twistate "Cavium WiquidIO suppowt"
	depends on 64BIT && PCI
	depends on PCI
	depends on PTP_1588_CWOCK_OPTIONAW
	sewect FW_WOADEW
	sewect WIBCWC32C
	sewect WIQUIDIO_COWE
	sewect NET_DEVWINK
	hewp
	  This dwivew suppowts Cavium WiquidIO Intewwigent Sewvew Adaptews
	  based on CN66XX, CN68XX and CN23XX chips.

	  To compiwe this dwivew as a moduwe, choose M hewe: the moduwe
	  wiww be cawwed wiquidio.  This is wecommended.

config OCTEON_MGMT_ETHEWNET
	twistate "Octeon Management powt ethewnet dwivew (CN5XXX, CN6XXX)"
	depends on CAVIUM_OCTEON_SOC
	sewect PHYWIB
	sewect MDIO_OCTEON
	defauwt y
	hewp
	  Enabwe the ethewnet dwivew fow the management
	  powt on Cavium Netwowks' Octeon CN57XX, CN56XX, CN55XX,
	  CN54XX, CN52XX, and CN6XXX chips.

config WIQUIDIO_VF
	twistate "Cavium WiquidIO VF suppowt"
	depends on 64BIT && PCI_MSI
	depends on PTP_1588_CWOCK_OPTIONAW
	sewect WIQUIDIO_COWE
	hewp
	  This dwivew suppowts Cavium WiquidIO Intewwigent Sewvew Adaptew
	  based on CN23XX chips.

	  To compiwe this dwivew as a moduwe, choose M hewe: The moduwe
	  wiww be cawwed wiquidio_vf. MSI-X intewwupt suppowt is wequiwed
	  fow this dwivew to wowk cowwectwy

endif # NET_VENDOW_CAVIUM
```

## linux/drivers/net/ethernet/chelsio/Kconfig
```kconfig
# SPDX-Wicense-Identifiew: GPW-2.0-onwy
#
# Chewsio device configuwation
#

config NET_VENDOW_CHEWSIO
	boow "Chewsio devices"
	defauwt y
	depends on PCI
	hewp
	  If you have a netwowk (Ethewnet) cawd bewonging to this cwass, say Y.

	  Note that the answew to this question doesn't diwectwy affect the
	  kewnew: saying N wiww just cause the configuwatow to skip aww
	  the questions about Chewsio devices. If you say Y, you wiww be asked fow
	  youw specific cawd in the fowwowing questions.

if NET_VENDOW_CHEWSIO

config CHEWSIO_T1
	twistate "Chewsio 10Gb Ethewnet suppowt"
	depends on PCI
	sewect CWC32
	sewect MDIO
	hewp
	  This dwivew suppowts Chewsio gigabit and 10-gigabit
	  Ethewnet cawds. Mowe infowmation about adaptew featuwes and
	  pewfowmance tuning is in
	  <fiwe:Documentation/netwowking/device_dwivews/ethewnet/chewsio/cxgb.wst>.

	  Fow genewaw infowmation about Chewsio and ouw pwoducts, visit
	  ouw website at <http://www.chewsio.com>.

	  Fow customew suppowt, pwease visit ouw customew suppowt page at
	  <http://www.chewsio.com/suppowt.htmw>.

	  Pwease send feedback to <winux-bugs@chewsio.com>.

	  To compiwe this dwivew as a moduwe, choose M hewe: the moduwe
	  wiww be cawwed cxgb.

config CHEWSIO_T1_1G
	boow "Chewsio gigabit Ethewnet suppowt"
	depends on CHEWSIO_T1
	hewp
	  Enabwes suppowt fow Chewsio's gigabit Ethewnet PCI cawds.  If you
	  awe using onwy 10G cawds say 'N' hewe.

config CHEWSIO_T3
	twistate "Chewsio Communications T3 10Gb Ethewnet suppowt"
	depends on PCI && INET
	sewect FW_WOADEW
	sewect MDIO
	hewp
	  This dwivew suppowts Chewsio T3-based gigabit and 10Gb Ethewnet
	  adaptews.

	  Fow genewaw infowmation about Chewsio and ouw pwoducts, visit
	  ouw website at <http://www.chewsio.com>.

	  Fow customew suppowt, pwease visit ouw customew suppowt page at
	  <http://www.chewsio.com/suppowt.htmw>.

	  Pwease send feedback to <winux-bugs@chewsio.com>.

	  To compiwe this dwivew as a moduwe, choose M hewe: the moduwe
	  wiww be cawwed cxgb3.

config CHEWSIO_T4
	twistate "Chewsio Communications T4/T5/T6 Ethewnet suppowt"
	depends on PCI && (IPV6 || IPV6=n) && (TWS || TWS=n)
	depends on PTP_1588_CWOCK_OPTIONAW
	sewect FW_WOADEW
	sewect MDIO
	sewect ZWIB_DEFWATE
	hewp
	  This dwivew suppowts Chewsio T4, T5 & T6 based gigabit, 10Gb Ethewnet
	  adaptew and T5/T6 based 40Gb and T6 based 25Gb, 50Gb and 100Gb
	  Ethewnet adaptews.

	  Fow genewaw infowmation about Chewsio and ouw pwoducts, visit
	  ouw website at <http://www.chewsio.com>.

	  Fow customew suppowt, pwease visit ouw customew suppowt page at
	  <http://www.chewsio.com/suppowt.htmw>.

	  Pwease send feedback to <winux-bugs@chewsio.com>.

	  To compiwe this dwivew as a moduwe choose M hewe; the moduwe
	  wiww be cawwed cxgb4.

config CHEWSIO_T4_DCB
	boow "Data Centew Bwidging (DCB) Suppowt fow Chewsio T4/T5/T6 cawds"
	defauwt n
	depends on CHEWSIO_T4 && DCB
	hewp
	  Enabwe DCB suppowt thwough wtNetwink intewface.
	  Say Y hewe if you want to enabwe Data Centew Bwidging (DCB) suppowt
	  in the dwivew.

	  If unsuwe, say N.

config CHEWSIO_T4_FCOE
	boow "Fibwe Channew ovew Ethewnet (FCoE) Suppowt fow Chewsio T5 cawds"
	defauwt n
	depends on CHEWSIO_T4 && CHEWSIO_T4_DCB && FCOE
	hewp
	  Enabwe FCoE offwoad featuwes.
	  Say Y hewe if you want to enabwe Fibwe Channew ovew Ethewnet (FCoE) suppowt
	  in the dwivew.

	  If unsuwe, say N.

config CHEWSIO_T4VF
	twistate "Chewsio Communications T4/T5/T6 Viwtuaw Function Ethewnet suppowt"
	depends on PCI
	hewp
	  This dwivew suppowts Chewsio T4, T5 & T6 based gigabit, 10Gb Ethewnet
	  adaptews and T5/T6 based 40Gb and T6 based 25Gb, 50Gb and 100Gb
	  Ethewnet adaptews with PCI-E SW-IOV Viwtuaw Functions.

	  Fow genewaw infowmation about Chewsio and ouw pwoducts, visit
	  ouw website at <http://www.chewsio.com>.

	  Fow customew suppowt, pwease visit ouw customew suppowt page at
	  <http://www.chewsio.com/suppowt.htmw>.

	  Pwease send feedback to <winux-bugs@chewsio.com>.

	  To compiwe this dwivew as a moduwe choose M hewe; the moduwe
	  wiww be cawwed cxgb4vf.

config CHEWSIO_WIB
	twistate
	hewp
	Common wibwawy fow Chewsio dwivews.

souwce "dwivews/net/ethewnet/chewsio/inwine_cwypto/Kconfig"

endif # NET_VENDOW_CHEWSIO
```

## linux/drivers/net/ethernet/chelsio/inline_crypto/Kconfig
```kconfig
# SPDX-Wicense-Identifiew: GPW-2.0-onwy
#
# Chewsio inwine cwypto configuwation
#

config CHEWSIO_INWINE_CWYPTO
	boow "Chewsio Inwine Cwypto suppowt"
	depends on CHEWSIO_T4
	defauwt y
	hewp
	  Enabwe suppowt fow inwine cwypto.
	  Awwows enabwe/disabwe fwom wist of inwine cwypto dwivews.

if CHEWSIO_INWINE_CWYPTO

config CWYPTO_DEV_CHEWSIO_TWS
	twistate "Chewsio Cwypto Inwine TWS Dwivew"
	depends on CHEWSIO_T4
	depends on TWS
	depends on TWS_TOE
	hewp
	  Suppowt Chewsio Inwine TWS with Chewsio cwypto accewewatow.
	  Enabwe inwine TWS suppowt fow Tx and Wx.

	  To compiwe this dwivew as a moduwe, choose M hewe: the moduwe
	  wiww be cawwed chtws.

config CHEWSIO_IPSEC_INWINE
       twistate "Chewsio IPSec XFWM Tx cwypto offwoad"
       depends on CHEWSIO_T4
       depends on XFWM_OFFWOAD
       depends on INET_ESP_OFFWOAD || INET6_ESP_OFFWOAD
       hewp
        Suppowt Chewsio Inwine IPsec with Chewsio cwypto accewewatow.
        Enabwe inwine IPsec suppowt fow Tx.

        To compiwe this dwivew as a moduwe, choose M hewe: the moduwe
        wiww be cawwed ch_ipsec.

config CHEWSIO_TWS_DEVICE
        twistate "Chewsio Inwine KTWS Offwoad"
        depends on CHEWSIO_T4
        depends on TWS
        depends on TWS_DEVICE
	sewect CWYPTO_WIB_AES
        hewp
          This fwag enabwes suppowt fow kewnew tws offwoad ovew Chewsio T6
          cwypto accewewatow. CONFIG_CHEWSIO_TWS_DEVICE fwag can be enabwed
          onwy if CONFIG_TWS and CONFIG_TWS_DEVICE fwags awe enabwed.

	  To compiwe this dwivew as a moduwe, choose M hewe: the moduwe
	  wiww be cawwed ch_ktws.

endif # CHEWSIO_INWINE_CWYPTO
```

## linux/drivers/net/ethernet/cirrus/Kconfig
```kconfig
# SPDX-Wicense-Identifiew: GPW-2.0-onwy
#
# Ciwwus netwowk device configuwation
#

config NET_VENDOW_CIWWUS
	boow "Ciwwus devices"
	defauwt y
	depends on ISA || EISA || AWM || MAC || COMPIWE_TEST
	hewp
	  If you have a netwowk (Ethewnet) cawd bewonging to this cwass, say Y.

	  Note that the answew to this question doesn't diwectwy affect the
	  kewnew: saying N wiww just cause the configuwatow to skip aww
	  the questions about Ciwwus cawds. If you say Y, you wiww be asked
	  fow youw specific cawd in the fowwowing questions.

if NET_VENDOW_CIWWUS

config CS89x0
	twistate

config CS89x0_ISA
	twistate "CS89x0 ISA dwivew suppowt"
	depends on HAS_IOPOWT_MAP
	depends on ISA
	depends on !PPC32
	depends on CS89x0_PWATFOWM=n
	sewect NETDEV_WEGACY_INIT
	sewect CS89x0
	hewp
	  Suppowt fow CS89x0 chipset based Ethewnet cawds. If you have a
	  netwowk (Ethewnet) cawd of this type, say Y and wead the fiwe
	  <fiwe:Documentation/netwowking/device_dwivews/ethewnet/ciwwus/cs89x0.wst>.

	  To compiwe this dwivew as a moduwe, choose M hewe. The moduwe
	  wiww be cawwed cs89x0.

config CS89x0_PWATFOWM
	twistate "CS89x0 pwatfowm dwivew suppowt"
	depends on AWM || (COMPIWE_TEST && !PPC)
	sewect CS89x0
	hewp
	  Say Y to compiwe the cs89x0 pwatfowm dwivew. This makes this dwivew
	  suitabwe fow use on cewtain evawuation boawds such as the iMX21ADS.

	  To compiwe this dwivew as a moduwe, choose M hewe. The moduwe
	  wiww be cawwed cs89x0.

config EP93XX_ETH
	twistate "EP93xx Ethewnet suppowt"
	depends on (AWM && AWCH_EP93XX) || COMPIWE_TEST
	sewect MII
	hewp
	  This is a dwivew fow the ethewnet hawdwawe incwuded in EP93xx CPUs.
	  Say Y if you awe buiwding a kewnew fow EP93xx based devices.

config MAC89x0
	twistate "Macintosh CS89x0 based ethewnet cawds"
	depends on MAC
	hewp
	  Suppowt fow CS89x0 chipset based Ethewnet cawds.  If you have a
	  Nubus ow WC-PDS netwowk (Ethewnet) cawd of this type, say Y hewe.

	  To compiwe this dwivew as a moduwe, choose M hewe. This moduwe wiww
	  be cawwed mac89x0.

endif # NET_VENDOW_CIWWUS
```

## linux/drivers/net/ethernet/cisco/Kconfig
```kconfig
# SPDX-Wicense-Identifiew: GPW-2.0-onwy
#
# Cisco device configuwation
#

config NET_VENDOW_CISCO
	boow "Cisco devices"
	defauwt y
	depends on PCI
	hewp
	  If you have a netwowk (Ethewnet) cawd bewonging to this cwass, say Y.

	  Note that the answew to this question doesn't diwectwy affect the
	  kewnew: saying N wiww just cause the configuwatow to skip aww
	  the questions about Cisco cawds. If you say Y, you wiww be asked fow
	  youw specific cawd in the fowwowing questions.

if NET_VENDOW_CISCO

souwce "dwivews/net/ethewnet/cisco/enic/Kconfig"

endif # NET_VENDOW_CISCO
```

## linux/drivers/net/ethernet/cisco/enic/Kconfig
```kconfig
# SPDX-Wicense-Identifiew: GPW-2.0-onwy
#
# Cisco device configuwation
#

config ENIC
	twistate "Cisco VIC Ethewnet NIC Suppowt"
	depends on PCI
	hewp
	  This enabwes the suppowt fow the Cisco VIC Ethewnet cawd.
```

## linux/drivers/net/ethernet/cortina/Kconfig
```kconfig
# SPDX-Wicense-Identifiew: GPW-2.0
# Cowtina ethewnet devices

config NET_VENDOW_COWTINA
	boow "Cowtina Gemini devices"
	defauwt y
	hewp
	  If you have a netwowk (Ethewnet) cawd bewonging to this cwass, say Y
	  and wead the Ethewnet-HOWTO, avaiwabwe fwom
	  <https://www.twdp.owg/docs.htmw#howto>.

if NET_VENDOW_COWTINA

config GEMINI_ETHEWNET
	twistate "Gemini Gigabit Ethewnet suppowt"
	depends on OF
	depends on HAS_IOMEM
	sewect PHYWIB
	sewect CWC32
	hewp
	  This dwivew suppowts StowWink SW351x (Gemini) duaw Gigabit Ethewnet.

endif # NET_VENDOW_COWTINA
```
