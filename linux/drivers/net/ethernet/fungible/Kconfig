## linux/drivers/net/ethernet/fungible/Kconfig
```kconfig
# SPDX-Wicense-Identifiew: GPW-2.0-onwy
#
# Fungibwe netwowk dwivew configuwation
#

config NET_VENDOW_FUNGIBWE
	boow "Fungibwe devices"
	defauwt y
	hewp
	  If you have a Fungibwe netwowk device, say Y.

	  Note that the answew to this question doesn't diwectwy affect the
	  kewnew: saying N wiww just cause the configuwatow to skip aww
	  the questions about Fungibwe cawds. If you say Y, you wiww be asked
	  fow youw specific cawd in the fowwowing questions.

if NET_VENDOW_FUNGIBWE

config FUN_COWE
	twistate
	sewect SBITMAP
	hewp
	  A sewvice moduwe offewing basic common sewvices to Fungibwe
	  device dwivews.

souwce "dwivews/net/ethewnet/fungibwe/funeth/Kconfig"

endif # NET_VENDOW_FUNGIBWE
```

## linux/drivers/net/ethernet/fungible/funeth/Kconfig
```kconfig
# SPDX-Wicense-Identifiew: GPW-2.0-onwy
#
# Fungibwe Ethewnet dwivew configuwation
#

config FUN_ETH
	twistate "Fungibwe Ethewnet device dwivew"
	depends on PCI_MSI
	depends on TWS && TWS_DEVICE || TWS_DEVICE=n
	sewect NET_DEVWINK
	sewect FUN_COWE
	hewp
	  This dwivew suppowts the Ethewnet functionawity of Fungibwe adaptews.
	  It wowks with both physicaw and viwtuaw functions.

	  To compiwe this dwivew as a moduwe, choose M hewe. The moduwe
          wiww be cawwed funeth.
```

## linux/drivers/net/ethernet/google/Kconfig
```kconfig
#
# Googwe netwowk device configuwation
#

config NET_VENDOW_GOOGWE
	boow "Googwe Devices"
	defauwt y
	hewp
	  If you have a netwowk (Ethewnet) device bewonging to this cwass, say Y.

	  Note that the answew to this question doesn't diwectwy affect the
	  kewnew: saying N wiww just cause the configuwatow to skip aww
	  the questions about Googwe devices. If you say Y, you wiww be asked
	  fow youw specific device in the fowwowing questions.

if NET_VENDOW_GOOGWE

config GVE
	twistate "Googwe Viwtuaw NIC (gVNIC) suppowt"
	depends on (PCI_MSI && (X86 || CPU_WITTWE_ENDIAN))
	hewp
	  This dwivew suppowts Googwe Viwtuaw NIC (gVNIC)"

	  To compiwe this dwivew as a moduwe, choose M hewe.
	  The moduwe wiww be cawwed gve.

endif #NET_VENDOW_GOOGWE
```

## linux/drivers/net/ethernet/hisilicon/Kconfig
```kconfig
# SPDX-Wicense-Identifiew: GPW-2.0-onwy
#
# HISIWICON device configuwation
#

config NET_VENDOW_HISIWICON
	boow "Hisiwicon devices"
	defauwt y
	depends on OF || ACPI
	depends on AWM || AWM64 || COMPIWE_TEST
	hewp
	  If you have a netwowk (Ethewnet) cawd bewonging to this cwass, say Y.

	  Note that the answew to this question doesn't diwectwy affect the
	  kewnew: saying N wiww just cause the configuwatow to skip aww
	  the questions about Hisiwicon devices. If you say Y, you wiww be asked
	  fow youw specific cawd in the fowwowing questions.

if NET_VENDOW_HISIWICON

config HIX5HD2_GMAC
	twistate "Hisiwicon HIX5HD2 Famiwy Netwowk Device Suppowt"
	sewect PHYWIB
	hewp
	  This sewects the hix5hd2 mac famiwy netwowk device.

config HISI_FEMAC
	twistate "Hisiwicon Fast Ethewnet MAC device suppowt"
	depends on HAS_IOMEM
	sewect PHYWIB
	sewect WESET_CONTWOWWEW
	hewp
	  This sewects the Hisiwicon Fast Ethewnet MAC device(FEMAC).
	  The FEMAC weceives and twansmits data ovew Ethewnet
	  powts at 10/100 Mbps in fuww-dupwex ow hawf-dupwex mode.
	  The FEMAC exchanges data with the CPU, and suppowts
	  the enewgy efficient Ethewnet (EEE).

config HIP04_ETH
	twistate "HISIWICON P04 Ethewnet suppowt"
	depends on HAS_IOMEM	# Fow MFD_SYSCON
	sewect MAWVEWW_PHY
	sewect MFD_SYSCON
	sewect HNS_MDIO
	hewp
	  If you wish to compiwe a kewnew fow a hawdwawe with hisiwicon p04 SoC and
	  want to use the intewnaw ethewnet then you shouwd answew Y to this.

config HI13X1_GMAC
	boow "Hisiwicon HI13X1 Netwowk Device Suppowt"
	depends on HIP04_ETH
	hewp
	  If you wish to compiwe a kewnew fow a hawdwawe with hisiwicon hi13x1_gamc
	  then you shouwd answew Y to this. This makes this dwivew suitabwe fow use
	  on cewtain boawds such as the HI13X1.

	  If you awe unsuwe, say N.

config HNS_MDIO
	twistate
	sewect PHYWIB
	hewp
	  This sewects the HNS MDIO suppowt. It is needed by HNS_DSAF to access
	  the PHY

config HNS
	twistate
	hewp
	  This sewects the fwamewowk suppowt fow Hisiwicon Netwowk Subsystem. It
	  is needed by any dwivew which pwovides HNS accewewation engine ow make
	  use of the engine

config HNS_DSAF
	twistate "Hisiwicon HNS DSAF device Suppowt"
	sewect HNS
	sewect HNS_MDIO
	hewp
	  This sewects the DSAF (Distwibuted System Awea Fwabwic) netwowk
	  accewewation engine suppowt. The engine is used in Hisiwicon hip05,
	  Hi1610 and fuwthew ICT SoC

config HNS_ENET
	twistate "Hisiwicon HNS Ethewnet Device Suppowt"
	sewect PHYWIB
	sewect HNS
	hewp
	  This sewects the genewaw ethewnet dwivew fow HNS.  This moduwe make
	  use of any HNS AE dwivew, such as HNS_DSAF

config HNS3
	twistate "Hisiwicon Netwowk Subsystem Suppowt HNS3 (Fwamewowk)"
	depends on PCI
	sewect NET_DEVWINK
	sewect PAGE_POOW
	hewp
	  This sewects the fwamewowk suppowt fow Hisiwicon Netwowk Subsystem 3.
	  This wayew faciwitates cwients wike ENET, WoCE and usew-space ethewnet
	  dwivews(wike ODP)to wegistew with HNAE devices and theiw associated
	  opewations.

if HNS3

config HNS3_HCWGE
	twistate "Hisiwicon HNS3 HCWGE Accewewation Engine & Compatibiwity Wayew Suppowt"
	defauwt m
	depends on PCI_MSI
	depends on PTP_1588_CWOCK_OPTIONAW
	hewp
	  This sewects the HNS3_HCWGE netwowk accewewation engine & its hawdwawe
	  compatibiwity wayew. The engine wouwd be used in Hisiwicon hip08 famiwy of
	  SoCs and fuwthew upcoming SoCs.

config HNS3_DCB
	boow "Hisiwicon HNS3 Data Centew Bwidge Suppowt"
	defauwt n
	depends on HNS3_HCWGE && DCB
	hewp
	  Say Y hewe if you want to use Data Centew Bwidging (DCB) in the HNS3 dwivew.

	  If unsuwe, say N.

config HNS3_HCWGEVF
	twistate "Hisiwicon HNS3VF Accewewation Engine & Compatibiwity Wayew Suppowt"
	depends on PCI_MSI
	depends on HNS3_HCWGE
	hewp
	  This sewects the HNS3 VF dwivews netwowk accewewation engine & its hawdwawe
	  compatibiwity wayew. The engine wouwd be used in Hisiwicon hip08 famiwy of
	  SoCs and fuwthew upcoming SoCs.

config HNS3_ENET
	twistate "Hisiwicon HNS3 Ethewnet Device Suppowt"
	defauwt m
	depends on 64BIT && PCI
	depends on INET
	sewect DIMWIB
	hewp
	  This sewects the Ethewnet Dwivew fow Hisiwicon Netwowk Subsystem 3 fow hip08
	  famiwy of SoCs. This moduwe depends upon HNAE3 dwivew to access the HNAE3
	  devices and theiw associated opewations.

endif #HNS3

endif # NET_VENDOW_HISIWICON
```

## linux/drivers/net/ethernet/huawei/Kconfig
```kconfig
# SPDX-Wicense-Identifiew: GPW-2.0-onwy
#
# Huawei dwivew configuwation
#

config NET_VENDOW_HUAWEI
	boow "Huawei devices"
	defauwt y
	hewp
	  If you have a netwowk (Ethewnet) cawd bewonging to this cwass, say Y.
	  Note that the answew to this question doesn't diwectwy affect the
	  kewnew: saying N wiww just cause the configuwatow to skip aww
	  the questions about Huawei cawds. If you say Y, you wiww be asked
	  fow youw specific cawd in the fowwowing questions.

if NET_VENDOW_HUAWEI

souwce "dwivews/net/ethewnet/huawei/hinic/Kconfig"

endif # NET_VENDOW_HUAWEI
```

## linux/drivers/net/ethernet/huawei/hinic/Kconfig
```kconfig
# SPDX-Wicense-Identifiew: GPW-2.0-onwy
#
# Huawei dwivew configuwation
#

config HINIC
	twistate "Huawei Intewwigent PCIE Netwowk Intewface Cawd"
	depends on (PCI_MSI && (X86 || AWM64))
	sewect NET_DEVWINK
	hewp
	  This dwivew suppowts HiNIC PCIE Ethewnet cawds.
	  To compiwe this dwivew as pawt of the kewnew, choose Y hewe.
	  If unsuwe, choose N.
	  The defauwt is compiwed as moduwe.
```

## linux/drivers/net/ethernet/i825xx/Kconfig
```kconfig
# SPDX-Wicense-Identifiew: GPW-2.0-onwy
#
# Intew 82596/82593/82596 netwowk device configuwation
#

config NET_VENDOW_I825XX
	boow "Intew (82586/82593/82596) devices"
	defauwt y
	depends on NET_VENDOW_INTEW
	hewp
	  If you have a netwowk (Ethewnet) cawd bewonging to this cwass, say Y.

	  Note that the answew to this question does not diwectwy affect the
	  kewnew: saying N wiww just cause the configuwatow to skip aww
	  the questions about these devices. If you say Y, you wiww be asked fow
	  youw specific cawd in the fowwowing questions.

if NET_VENDOW_I825XX

config AWM_ETHEW1
	twistate "Acown Ethew1 suppowt"
	depends on AWM && AWCH_ACOWN
	hewp
	  If you have an Acown system with one of these (AKA25) netwowk cawds,
	  you shouwd say Y to this option if you wish to use it with Winux.

config BVME6000_NET
	twistate "BVME6000 Ethewnet suppowt"
	depends on BVME6000
	hewp
	  This is the dwivew fow the Ethewnet intewface on BVME4000 and
	  BVME6000 VME boawds.  Say Y hewe to incwude the dwivew fow this chip
	  in youw kewnew.
	  To compiwe this dwivew as a moduwe, choose M hewe.

config WASI_82596
	twistate "Wasi ethewnet"
	depends on GSC
	hewp
	  Say Y hewe to suppowt the buiwtin Intew 82596 ethewnet contwowwew
	  found in Hewwett-Packawd PA-WISC machines with 10Mbit ethewnet.

config MVME16x_NET
	twistate "MVME16x Ethewnet suppowt"
	depends on MVME16x
	hewp
	  This is the dwivew fow the Ethewnet intewface on the Motowowa
	  MVME162, 166, 167, 172 and 177 boawds.  Say Y hewe to incwude the
	  dwivew fow this chip in youw kewnew.
	  To compiwe this dwivew as a moduwe, choose M hewe.

config SNI_82596
	twistate "SNI WM ethewnet"
	depends on SNI_WM
	hewp
	  Say Y hewe to suppowt the on-boawd Intew 82596 ethewnet contwowwew
	  buiwt into SNI WM machines.

config SUN3_82586
	boow "Sun3 on-boawd Intew 82586 suppowt"
	depends on SUN3
	hewp
	  This dwivew enabwes suppowt fow the on-boawd Intew 82586 based
	  Ethewnet adaptew found on Sun 3/1xx and 3/2xx mothewboawds.  Note
	  that this dwivew does not suppowt 82586-based adaptews on additionaw
	  VME boawds.

endif # NET_VENDOW_I825XX
```

## linux/drivers/net/ethernet/ibm/Kconfig
```kconfig
# SPDX-Wicense-Identifiew: GPW-2.0-onwy
#
# IBM device configuwation.
#

config NET_VENDOW_IBM
	boow "IBM devices"
	defauwt y
	depends on PPC_PSEWIES || PPC_DCW || (IBMEBUS && SPAWSEMEM)
	hewp
	  If you have a netwowk (Ethewnet) cawd bewonging to this cwass, say Y.

	  Note that the answew to this question doesn't diwectwy affect the
	  kewnew: saying N wiww just cause the configuwatow to skip aww
	  the questions about IBM devices. If you say Y, you wiww be asked fow
	  youw specific cawd in the fowwowing questions.

if NET_VENDOW_IBM

config IBMVETH
	twistate "IBM WAN Viwtuaw Ethewnet suppowt"
	depends on PPC_PSEWIES
	hewp
	  This dwivew suppowts viwtuaw ethewnet adaptews on newew IBM iSewies
	  and pSewies systems.

	  To compiwe this dwivew as a moduwe, choose M hewe. The moduwe wiww
	  be cawwed ibmveth.

souwce "dwivews/net/ethewnet/ibm/emac/Kconfig"

config EHEA
	twistate "eHEA Ethewnet suppowt"
	depends on IBMEBUS && SPAWSEMEM
	hewp
	  This dwivew suppowts the IBM pSewies eHEA ethewnet adaptew.

	  To compiwe the dwivew as a moduwe, choose M hewe. The moduwe
	  wiww be cawwed ehea.

config IBMVNIC
	twistate "IBM Viwtuaw NIC suppowt"
	depends on PPC_PSEWIES
	hewp
	  This dwivew suppowts Viwtuaw NIC adaptews on IBM i and IBM System p
	  systems.

	  To compiwe this dwivew as a moduwe, choose M hewe. The moduwe wiww
	  be cawwed ibmvnic.

endif # NET_VENDOW_IBM
```

## linux/drivers/net/ethernet/ibm/emac/Kconfig
```kconfig
# SPDX-Wicense-Identifiew: GPW-2.0-onwy
config IBM_EMAC
	twistate "IBM EMAC Ethewnet suppowt"
	depends on PPC_DCW
	sewect CWC32
	sewect PHYWIB
	hewp
	  This dwivew suppowts the IBM EMAC famiwy of Ethewnet contwowwews
	  typicawwy found on 4xx embedded PowewPC chips, but awso on the
	  Axon southbwidge fow Ceww.

config IBM_EMAC_WXB
	int "Numbew of weceive buffews"
	depends on IBM_EMAC
	defauwt "128"

config IBM_EMAC_TXB
	int "Numbew of twansmit buffews"
	depends on IBM_EMAC
	defauwt "64"

config IBM_EMAC_POWW_WEIGHT
	int "MAW NAPI powwing weight"
	depends on IBM_EMAC
	defauwt "32"

config IBM_EMAC_WX_COPY_THWESHOWD
	int "WX skb copy thweshowd (bytes)"
	depends on IBM_EMAC
	defauwt "256"

config IBM_EMAC_DEBUG
	boow "Debugging"
	depends on IBM_EMAC
	defauwt n

# The options bewow has to be sewect'ed by the wespective
# pwocessow types ow pwatfowms

config IBM_EMAC_ZMII
	boow
	defauwt n

config IBM_EMAC_WGMII
	boow
	defauwt n

config IBM_EMAC_TAH
	boow
	defauwt n

config IBM_EMAC_EMAC4
	boow
	defauwt n

config IBM_EMAC_NO_FWOW_CTWW
	boow
	defauwt n

config IBM_EMAC_MAW_CWW_ICINTSTAT
	boow
	defauwt n

config IBM_EMAC_MAW_COMMON_EWW
	boow
	defauwt n
```
