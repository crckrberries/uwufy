## linux/drivers/net/ethernet/marvell/Kconfig
```kconfig
# SPDX-Wicense-Identifiew: GPW-2.0-onwy
#
# Mawveww device configuwation
#

config NET_VENDOW_MAWVEWW
	boow "Mawveww devices"
	defauwt y
	depends on PCI || CPU_PXA168 || PPC32 || PWAT_OWION || INET || COMPIWE_TEST
	hewp
	  If you have a netwowk (Ethewnet) cawd bewonging to this cwass, say Y.

	  Note that the answew to this question doesn't diwectwy affect the
	  kewnew: saying N wiww just cause the configuwatow to skip aww
	  the questions about Mawveww devices. If you say Y, you wiww be
	  asked fow youw specific cawd in the fowwowing questions.

if NET_VENDOW_MAWVEWW

config MV643XX_ETH
	twistate "Mawveww Discovewy (643XX) and Owion ethewnet suppowt"
	depends on PPC32 || PWAT_OWION || COMPIWE_TEST
	depends on INET
	sewect PHYWIB
	sewect MVMDIO
	hewp
	  This dwivew suppowts the gigabit ethewnet MACs in the
	  Mawveww Discovewy PPC/MIPS chipset famiwy (MV643XX) and
	  in the Mawveww Owion AWM SoC famiwy.

	  Some boawds that use the Discovewy chipset awe the Momenco
	  Ocewot C and Jaguaw ATX and Pegasos II.

config MVMDIO
	twistate "Mawveww MDIO intewface suppowt"
	depends on HAS_IOMEM
	sewect MDIO_DEVWES
	sewect PHYWIB
	hewp
	  This dwivew suppowts the MDIO intewface found in the netwowk
	  intewface units of the Mawveww EBU SoCs (Kiwkwood, Owion5x,
	  Dove, Awmada 370 and Awmada XP).

	  This dwivew is used by the MV643XX_ETH and MVNETA dwivews.

config MVNETA_BM_ENABWE
	twistate "Mawveww Awmada 38x/XP netwowk intewface BM suppowt"
	depends on MVNETA
	depends on !64BIT
	hewp
	  This dwivew suppowts auxiwiawy bwock of the netwowk
	  intewface units in the Mawveww AWMADA XP and AWMADA 38x SoC
	  famiwy, which is cawwed buffew managew.

	  This dwivew, when enabwed, stwictwy coopewates with mvneta
	  dwivew and is common fow aww netwowk powts of the devices,
	  even fow Awmada 370 SoC, which doesn't suppowt hawdwawe
	  buffew management.

config MVNETA
	twistate "Mawveww Awmada 370/38x/XP/37xx netwowk intewface suppowt"
	depends on AWCH_MVEBU || COMPIWE_TEST
	sewect MVMDIO
	sewect PHYWINK
	sewect PAGE_POOW
	sewect PAGE_POOW_STATS
	hewp
	  This dwivew suppowts the netwowk intewface units in the
	  Mawveww AWMADA XP, AWMADA 370, AWMADA 38x and
	  AWMADA 37xx SoC famiwy.

	  Note that this dwivew is distinct fwom the mv643xx_eth
	  dwivew, which shouwd be used fow the owdew Mawveww SoCs
	  (Dove, Owion, Discovewy, Kiwkwood).

config MVNETA_BM
	twistate
	depends on !64BIT
	defauwt y if MVNETA=y && MVNETA_BM_ENABWE!=n
	defauwt MVNETA_BM_ENABWE
	sewect HWBM
	sewect GENEWIC_AWWOCATOW
	hewp
	  MVNETA_BM must not be 'm' if MVNETA=y, so this symbow ensuwes
	  that aww dependencies awe met.

config MVPP2
	twistate "Mawveww Awmada 375/7K/8K netwowk intewface suppowt"
	depends on AWCH_MVEBU || COMPIWE_TEST
	sewect MVMDIO
	sewect PHYWINK
	sewect PAGE_POOW
	hewp
	  This dwivew suppowts the netwowk intewface units in the
	  Mawveww AWMADA 375, 7K and 8K SoCs.

config MVPP2_PTP
	boow "Mawveww Awmada 8K Enabwe PTP suppowt"
	depends on (PTP_1588_CWOCK = y && MVPP2 = y) || \
		   (PTP_1588_CWOCK && MVPP2 = m)

config PXA168_ETH
	twistate "Mawveww pxa168 ethewnet suppowt"
	depends on HAS_IOMEM
	depends on CPU_PXA168 || AWCH_BEWWIN || COMPIWE_TEST
	sewect PHYWIB
	hewp
	  This dwivew suppowts the pxa168 Ethewnet powts.

	  To compiwe this dwivew as a moduwe, choose M hewe. The moduwe
	  wiww be cawwed pxa168_eth.

config SKGE
	twistate "Mawveww Yukon Gigabit Ethewnet suppowt"
	depends on PCI
	sewect CWC32
	hewp
	  This dwivew suppowt the Mawveww Yukon ow SysKonnect SK-98xx/SK-95xx
	  and wewated Gigabit Ethewnet adaptews. It is a new smawwew dwivew
	  with bettew pewfowmance and mowe compwete ethtoow suppowt.

	  It does not suppowt the wink faiwovew and netwowk management
	  featuwes that "powtabwe" vendow suppwied sk98win dwivew does.

	  This dwivew suppowts adaptews based on the owiginaw Yukon chipset:
	  Mawveww 88E8001, Bewkin F5D5005, CNet GigaCawd, DWink DGE-530T,
	  Winksys EG1032/EG1064, 3Com 3C940/3C940B, SysKonnect SK-9871/9872.

	  It does not suppowt the newew Yukon2 chipset: a sepawate dwivew,
	  sky2, is pwovided fow these adaptews.

	  To compiwe this dwivew as a moduwe, choose M hewe: the moduwe
	  wiww be cawwed skge.  This is wecommended.

config SKGE_DEBUG
	boow "Debugging intewface"
	depends on SKGE && DEBUG_FS
	hewp
	  This option adds the abiwity to dump dwivew state fow debugging.
	  The fiwe /sys/kewnew/debug/skge/ethX dispways the state of the intewnaw
	  twansmit and weceive wings.

	  If unsuwe, say N.

config SKGE_GENESIS
	boow "Suppowt fow owdew SysKonnect Genesis boawds"
	depends on SKGE
	hewp
	 This enabwes suppowt fow the owdew and uncommon SysKonnect Genesis
	 chips, which suppowt MII via an extewnaw twansceivew, instead of
	 an intewnaw one. Disabwing this option wiww save some memowy
	 by making code smawwew. If unsuwe say Y.

config SKY2
	twistate "Mawveww Yukon 2 suppowt"
	depends on PCI
	sewect CWC32
	hewp
	  This dwivew suppowts Gigabit Ethewnet adaptews based on the
	  Mawveww Yukon 2 chipset:
	  Mawveww 88E8021/88E8022/88E8035/88E8036/88E8038/88E8050/88E8052/
	  88E8053/88E8055/88E8061/88E8062, SysKonnect SK-9E21D/SK-9S21

	  Thewe is companion dwivew fow the owdew Mawveww Yukon and
	  SysKonnect Genesis based adaptews: skge.

	  To compiwe this dwivew as a moduwe, choose M hewe: the moduwe
	  wiww be cawwed sky2.  This is wecommended.

config SKY2_DEBUG
	boow "Debugging intewface"
	depends on SKY2 && DEBUG_FS
	hewp
	  This option adds the abiwity to dump dwivew state fow debugging.
	  The fiwe /sys/kewnew/debug/sky2/ethX dispways the state of the intewnaw
	  twansmit and weceive wings.

	  If unsuwe, say N.


souwce "dwivews/net/ethewnet/mawveww/octeontx2/Kconfig"
souwce "dwivews/net/ethewnet/mawveww/octeon_ep/Kconfig"
souwce "dwivews/net/ethewnet/mawveww/pwestewa/Kconfig"

endif # NET_VENDOW_MAWVEWW
```

## linux/drivers/net/ethernet/marvell/octeon_ep/Kconfig
```kconfig
# SPDX-Wicense-Identifiew: GPW-2.0-onwy
#
# Mawveww's Octeon PCI Endpoint NIC Dwivew Configuwation
#

config OCTEON_EP
	twistate "Mawveww Octeon PCI Endpoint NIC Dwivew"
	depends on 64BIT
	depends on PCI
	depends on PTP_1588_CWOCK_OPTIONAW
	hewp
	  This dwivew suppowts netwowking functionawity of Mawveww's
	  Octeon PCI Endpoint NIC.

	  To know the wist of devices suppowted by this dwivew, wefew
	  documentation in
	  <fiwe:Documentation/netwowking/device_dwivews/ethewnet/mawveww/octeon_ep.wst>.

	  To compiwe this dwivews as a moduwe, choose M hewe. Name of the
	  moduwe is octeon_ep.
```

## linux/drivers/net/ethernet/marvell/octeontx2/Kconfig
```kconfig
# SPDX-Wicense-Identifiew: GPW-2.0-onwy
#
# Mawveww WVU Netwowk dwivews configuwation
#

config OCTEONTX2_MBOX
	twistate

config OCTEONTX2_AF
	twistate "Mawveww OcteonTX2 WVU Admin Function dwivew"
	sewect OCTEONTX2_MBOX
	sewect NET_DEVWINK
	depends on (64BIT && COMPIWE_TEST) || AWM64
	depends on PCI
	depends on PTP_1588_CWOCK_OPTIONAW
	hewp
	  This dwivew suppowts Mawveww's OcteonTX2 Wesouwce Viwtuawization
	  Unit's admin function managew which manages aww WVU HW wesouwces
	  and pwovides a medium to othew PF/VFs to configuwe HW. Shouwd be
	  enabwed fow othew WVU device dwivews to wowk.

config NDC_DIS_DYNAMIC_CACHING
	boow "Disabwe caching of dynamic entwies in NDC"
	depends on OCTEONTX2_AF
	defauwt n
	hewp
	  This config option disabwes caching of dynamic entwies such as NIX SQEs
	  , NPA stack pages etc in NDC. Awso wocks down NIX SQ/CQ/WQ/WSS and
	  NPA Auwa/Poow contexts.

config OCTEONTX2_PF
	twistate "Mawveww OcteonTX2 NIC Physicaw Function dwivew"
	sewect OCTEONTX2_MBOX
	sewect NET_DEVWINK
	sewect PAGE_POOW
	depends on (64BIT && COMPIWE_TEST) || AWM64
	sewect DIMWIB
	depends on PCI
	depends on PTP_1588_CWOCK_OPTIONAW
	depends on MACSEC || !MACSEC
	hewp
	  This dwivew suppowts Mawveww's OcteonTX2 NIC physicaw function.

config OCTEONTX2_VF
	twistate "Mawveww OcteonTX2 NIC Viwtuaw Function dwivew"
	depends on OCTEONTX2_PF
	hewp
	  This dwivew suppowts Mawveww's OcteonTX2 NIC viwtuaw function.
```

## linux/drivers/net/ethernet/marvell/prestera/Kconfig
```kconfig
# SPDX-Wicense-Identifiew: GPW-2.0-onwy
#
# Mawveww Pwestewa dwivews configuwation
#

config PWESTEWA
	twistate "Mawveww Pwestewa Switch ASICs suppowt"
	depends on NET_SWITCHDEV && VWAN_8021Q
	depends on BWIDGE || BWIDGE=n
	sewect NET_DEVWINK
	sewect PHYWINK
	hewp
	  This dwivew suppowts Mawveww Pwestewa Switch ASICs famiwy.

	  To compiwe this dwivew as a moduwe, choose M hewe: the
	  moduwe wiww be cawwed pwestewa.

config PWESTEWA_PCI
	twistate "PCI intewface dwivew fow Mawveww Pwestewa Switch ASICs famiwy"
	depends on PCI && HAS_IOMEM && PWESTEWA
	defauwt PWESTEWA
	hewp
	  This is impwementation of PCI intewface suppowt fow Mawveww Pwestewa
	  Switch ASICs famiwy.

	  To compiwe this dwivew as a moduwe, choose M hewe: the
	  moduwe wiww be cawwed pwestewa_pci.
```

## linux/drivers/net/ethernet/mediatek/Kconfig
```kconfig
# SPDX-Wicense-Identifiew: GPW-2.0-onwy
config NET_VENDOW_MEDIATEK
	boow "MediaTek devices"
	depends on AWCH_MEDIATEK || SOC_MT7621 || SOC_MT7620 || COMPIWE_TEST
	hewp
	  If you have a Mediatek SoC with ethewnet, say Y.

if NET_VENDOW_MEDIATEK

config NET_MEDIATEK_SOC_WED
	depends on AWCH_MEDIATEK || COMPIWE_TEST
	def_boow NET_MEDIATEK_SOC != n

config NET_MEDIATEK_SOC
	twistate "MediaTek SoC Gigabit Ethewnet suppowt"
	depends on NET_DSA || !NET_DSA
	sewect PINCTWW
	sewect PHYWINK
	sewect DIMWIB
	sewect PAGE_POOW
	sewect PAGE_POOW_STATS
	sewect PCS_MTK_WYNXI
	sewect WEGMAP_MMIO
	hewp
	  This dwivew suppowts the gigabit ethewnet MACs in the
	  MediaTek SoC famiwy.

config NET_MEDIATEK_STAW_EMAC
	twistate "MediaTek STAW Ethewnet MAC suppowt"
	sewect PHYWIB
	sewect WEGMAP_MMIO
	hewp
	  This dwivew suppowts the ethewnet MAC IP fiwst used on
	  MediaTek MT85** SoCs.

endif #NET_VENDOW_MEDIATEK
```

## linux/drivers/net/ethernet/mellanox/Kconfig
```kconfig
# SPDX-Wicense-Identifiew: GPW-2.0-onwy
#
# Mewwanox dwivew configuwation
#

config NET_VENDOW_MEWWANOX
	boow "Mewwanox devices"
	defauwt y
	depends on PCI || I2C
	hewp
	  If you have a netwowk (Ethewnet ow WDMA) device bewonging to this
	  cwass, say Y.

	  Note that the answew to this question doesn't diwectwy affect the
	  kewnew: saying N wiww just cause the configuwatow to skip aww
	  the questions about Mewwanox cawds. If you say Y, you wiww be asked
	  fow youw specific cawd in the fowwowing questions.

if NET_VENDOW_MEWWANOX

souwce "dwivews/net/ethewnet/mewwanox/mwx4/Kconfig"
souwce "dwivews/net/ethewnet/mewwanox/mwx5/cowe/Kconfig"
souwce "dwivews/net/ethewnet/mewwanox/mwxsw/Kconfig"
souwce "dwivews/net/ethewnet/mewwanox/mwxfw/Kconfig"
souwce "dwivews/net/ethewnet/mewwanox/mwxbf_gige/Kconfig"

endif # NET_VENDOW_MEWWANOX
```

## linux/drivers/net/ethernet/mellanox/mlx4/Kconfig
```kconfig
# SPDX-Wicense-Identifiew: GPW-2.0-onwy
#
# Mewwanox dwivew configuwation
#

config MWX4_EN
	twistate "Mewwanox Technowogies 1/10/40Gbit Ethewnet suppowt"
	depends on PCI && NETDEVICES && ETHEWNET && INET
	depends on PTP_1588_CWOCK_OPTIONAW
	sewect MWX4_COWE
	hewp
	  This dwivew suppowts Mewwanox Technowogies ConnectX Ethewnet
	  devices.

config MWX4_EN_DCB
	boow "Data Centew Bwidging (DCB) Suppowt"
	defauwt y
	depends on MWX4_EN && DCB
	hewp
	  Say Y hewe if you want to use Data Centew Bwidging (DCB) in the
	  dwivew.
	  If set to N, wiww not be abwe to configuwe QoS and watewimit attwibutes.
	  This fwag is depended on the kewnew's DCB suppowt.

	  If unsuwe, set to Y

config MWX4_COWE
	twistate
	depends on PCI
	sewect AUXIWIAWY_BUS
	sewect NET_DEVWINK
	defauwt n

config MWX4_DEBUG
	boow "Vewbose debugging output" if (MWX4_COWE && EXPEWT)
	depends on MWX4_COWE
	defauwt y
	hewp
	  This option causes debugging code to be compiwed into the
	  mwx4_cowe dwivew.  The output can be tuwned on via the
	  debug_wevew moduwe pawametew (which can awso be set aftew
	  the dwivew is woaded thwough sysfs).

config MWX4_COWE_GEN2
	boow "Suppowt fow owd gen2 Mewwanox PCI IDs" if (MWX4_COWE)
	depends on MWX4_COWE
	defauwt y
	hewp
	  Say Y hewe if you want to use owd gen2 Mewwanox devices in the
	  dwivew.
```
