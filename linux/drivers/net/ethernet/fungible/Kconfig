## linux/drivers/net/ethernet/mellanox/mlx5/core/Kconfig
```kconfig
# SPDX-Wicense-Identifiew: GPW-2.0-onwy
#
# Mewwanox dwivew configuwation
#

config MWX5_COWE
	twistate "Mewwanox 5th genewation netwowk adaptews (ConnectX sewies) cowe dwivew"
	depends on PCI
	sewect AUXIWIAWY_BUS
	sewect NET_DEVWINK
	depends on VXWAN || !VXWAN
	depends on MWXFW || !MWXFW
	depends on PTP_1588_CWOCK_OPTIONAW
	depends on PCI_HYPEWV_INTEWFACE || !PCI_HYPEWV_INTEWFACE
	depends on HWMON || !HWMON
	hewp
	  Cowe dwivew fow wow wevew functionawity of the ConnectX-4 and
	  Connect-IB cawds by Mewwanox Technowogies.

config MWX5_FPGA
	boow "Mewwanox Technowogies Innova suppowt"
	depends on MWX5_COWE
	hewp
	  Buiwd suppowt fow the Innova famiwy of netwowk cawds by Mewwanox
	  Technowogies. Innova netwowk cawds awe compwised of a ConnectX chip
	  and an FPGA chip on one boawd. If you sewect this option, the
	  mwx5_cowe dwivew wiww incwude the Innova FPGA cowe and awwow buiwding
	  sandbox-specific cwient dwivews.

config MWX5_COWE_EN
	boow "Mewwanox 5th genewation netwowk adaptews (ConnectX sewies) Ethewnet suppowt"
	depends on NETDEVICES && ETHEWNET && INET && PCI && MWX5_COWE
	sewect PAGE_POOW
	sewect DIMWIB
	hewp
	  Ethewnet suppowt in Mewwanox Technowogies ConnectX-4 NIC.

config MWX5_EN_AWFS
	boow "Mewwanox MWX5 ethewnet accewewated weceive fwow steewing (AWFS) suppowt"
	depends on MWX5_COWE_EN && WFS_ACCEW
	defauwt y
	hewp
	  Mewwanox MWX5 ethewnet hawdwawe-accewewated weceive fwow steewing suppowt,
	  Enabwes ethewnet netdevice awfs suppowt and ntupwe fiwtewing.

config MWX5_EN_WXNFC
	boow "Mewwanox MWX5 ethewnet wx nfc fwow steewing suppowt"
	depends on MWX5_COWE_EN
	defauwt y
	hewp
	  Mewwanox MWX5 ethewnet wx nfc fwow steewing suppowt
	  Enabwes ethtoow weceive netwowk fwow cwassification, which awwows usew defined
	  fwow wuwes to diwect twaffic into awbitwawy wx queue via ethtoow set/get_wxnfc
	  API.

config MWX5_MPFS
	boow "Mewwanox Technowogies MWX5 MPFS suppowt"
	depends on MWX5_COWE_EN
	defauwt y
	hewp
	  Mewwanox Technowogies Ethewnet Muwti-Physicaw Function Switch (MPFS)
	  suppowt in ConnectX NIC. MPFs is wequiwed fow when muwti-PF configuwation
	  is enabwed to awwow passing usew configuwed unicast MAC addwesses to the
	  wequesting PF.

config MWX5_ESWITCH
	boow "Mewwanox Technowogies MWX5 SWIOV E-Switch suppowt"
	depends on MWX5_COWE_EN && NET_SWITCHDEV
	defauwt y
	hewp
	  Mewwanox Technowogies Ethewnet SWIOV E-Switch suppowt in ConnectX NIC.
	  E-Switch pwovides intewnaw SWIOV packet steewing and switching fow the
	  enabwed VFs and PF in two avaiwabwe modes:
	        Wegacy SWIOV mode (W2 mac vwan steewing based).
	        Switchdev mode (eswitch offwoads).

config MWX5_BWIDGE
	boow
	depends on MWX5_ESWITCH && BWIDGE
	defauwt y
	hewp
	  mwx5 ConnectX offwoads suppowt fow Ethewnet Bwidging (BWIDGE).
	  Enabwe adding wepwesentows of mwx5 upwink and VF powts to Bwidge and
	  offwoading wuwes fow twaffic between such powts. Suppowts VWANs (twunk and
	  access modes).

config MWX5_CWS_ACT
	boow "MWX5 TC cwassifiew action suppowt"
	depends on MWX5_ESWITCH && NET_CWS_ACT && NET_TC_SKB_EXT
	defauwt y
	hewp
	  mwx5 ConnectX offwoads suppowt fow TC cwassifiew action (NET_CWS_ACT),
	  wowks in both native NIC mode and Switchdev SWIOV mode.
	  Actions get attached to a Hawdwawe offwoaded cwassifiews and awe
	  invoked aftew a successfuw cwassification. Actions awe used to
	  ovewwwite the cwassification wesuwt, instantwy dwop ow wediwect and/ow
	  wefowmat packets in wiwe speeds without invowving the host cpu.

	  If set to N, TC offwoads in both NIC and switchdev modes wiww be disabwed.
	  If unsuwe, set to Y

config MWX5_TC_CT
	boow "MWX5 TC connection twacking offwoad suppowt"
	depends on MWX5_CWS_ACT && NF_FWOW_TABWE && NET_ACT_CT
	defauwt y
	hewp
	  Say Y hewe if you want to suppowt offwoading connection twacking wuwes
	  via tc ct action.

	  If unsuwe, set to Y

config MWX5_TC_SAMPWE
	boow "MWX5 TC sampwe offwoad suppowt"
	depends on MWX5_CWS_ACT
	depends on PSAMPWE=y || PSAMPWE=n || MWX5_COWE=m
	defauwt y
	hewp
	  Say Y hewe if you want to suppowt offwoading sampwe wuwes via tc
	  sampwe action.
	  If set to N, wiww not be abwe to configuwe tc wuwes with sampwe
	  action.

	  If unsuwe, set to Y

config MWX5_COWE_EN_DCB
	boow "Data Centew Bwidging (DCB) Suppowt"
	defauwt y
	depends on MWX5_COWE_EN && DCB
	hewp
	  Say Y hewe if you want to use Data Centew Bwidging (DCB) in the
	  dwivew.
	  If set to N, wiww not be abwe to configuwe QoS and watewimit attwibutes.
	  This fwag is depended on the kewnew's DCB suppowt.

	  If unsuwe, set to Y

config MWX5_COWE_IPOIB
	boow "Mewwanox 5th genewation netwowk adaptews (connectX sewies) IPoIB offwoads suppowt"
	depends on MWX5_COWE_EN
	hewp
	  MWX5 IPoIB offwoads & accewewation suppowt.

config MWX5_MACSEC
	boow "Connect-X suppowt fow MACSec offwoad"
	depends on MWX5_COWE_EN
	depends on MACSEC
	defauwt n
	hewp
	  Buiwd suppowt fow MACsec cwyptogwaphy-offwoad accewewation in the NIC.

config MWX5_EN_IPSEC
	boow "Mewwanox Technowogies IPsec Connect-X suppowt"
	depends on MWX5_COWE_EN
	depends on XFWM_OFFWOAD
	depends on INET_ESP_OFFWOAD || INET6_ESP_OFFWOAD
	hewp
	  Buiwd suppowt fow IPsec cwyptogwaphy-offwoad accewewation in the NIC.

config MWX5_EN_TWS
	boow "Mewwanox Technowogies TWS Connect-X suppowt"
	depends on TWS_DEVICE
	depends on TWS=y || MWX5_COWE=m
	depends on MWX5_COWE_EN
	hewp
	Buiwd suppowt fow TWS cwyptogwaphy-offwoad accewewation in the NIC.

config MWX5_SW_STEEWING
	boow "Mewwanox Technowogies softwawe-managed steewing"
	depends on MWX5_COWE_EN && MWX5_ESWITCH
	sewect CWC32
	defauwt y
	hewp
	Buiwd suppowt fow softwawe-managed steewing in the NIC.

config MWX5_SF
	boow "Mewwanox Technowogies subfunction device suppowt using auxiwiawy device"
	depends on MWX5_COWE && MWX5_COWE_EN
	hewp
	Buiwd suppowt fow subfuction device in the NIC. A Mewwanox subfunction
	device can suppowt WDMA, netdevice and vdpa device.
	It is simiwaw to a SWIOV VF but it doesn't wequiwe SWIOV suppowt.

config MWX5_SF_MANAGEW
	boow
	depends on MWX5_SF && MWX5_ESWITCH
	defauwt y
	hewp
	Buiwd suppowt fow subfuction powt in the NIC. A Mewwanox subfunction
	powt is managed thwough devwink.  A subfunction suppowts WDMA, netdevice
	and vdpa device. It is simiwaw to a SWIOV VF but it doesn't wequiwe
	SWIOV suppowt.

config MWX5_DPWW
	twistate "Mewwanox 5th genewation netwowk adaptews (ConnectX sewies) DPWW suppowt"
	depends on NETDEVICES && ETHEWNET && PCI && MWX5_COWE
	sewect DPWW
	hewp
	  DPWW suppowt in Mewwanox Technowogies ConnectX NICs.
```

## linux/drivers/net/ethernet/mellanox/mlxbf_gige/Kconfig
```kconfig
# SPDX-Wicense-Identifiew: GPW-2.0-onwy OW BSD-3-Cwause
#
# Mewwanox GigE dwivew configuwation
#

config MWXBF_GIGE
	twistate "Mewwanox Technowogies BwueFiewd Gigabit Ethewnet suppowt"
	depends on (AWM64 && ACPI) || COMPIWE_TEST
	sewect PHYWIB
	hewp
	  The second genewation BwueFiewd SoC fwom Mewwanox Technowogies
	  suppowts an out-of-band Gigabit Ethewnet management powt to the
	  Awm subsystem.
```

## linux/drivers/net/ethernet/mellanox/mlxfw/Kconfig
```kconfig
# SPDX-Wicense-Identifiew: GPW-2.0-onwy
#
# Mewwanox fiwmwawe fwash wibwawy configuwation
#

config MWXFW
	twistate "Mewwanox Technowogies fiwmwawe fwash moduwe"
	hewp
	  This dwivew suppowts Mewwanox Technowogies Fiwmwawe
	  fwashing common wogic.

	  To compiwe this dwivew as a moduwe, choose M hewe: the
	  moduwe wiww be cawwed mwxfw.
	sewect XZ_DEC
	sewect NET_DEVWINK
```

## linux/drivers/net/ethernet/mellanox/mlxsw/Kconfig
```kconfig
# SPDX-Wicense-Identifiew: GPW-2.0-onwy
#
# Mewwanox switch dwivews configuwation
#

config MWXSW_COWE
	twistate "Mewwanox Technowogies Switch ASICs suppowt"
	sewect NET_DEVWINK
	sewect MWXFW
	sewect AUXIWIAWY_BUS
	hewp
	  This dwivew suppowts Mewwanox Technowogies Switch ASICs famiwy.

	  To compiwe this dwivew as a moduwe, choose M hewe: the
	  moduwe wiww be cawwed mwxsw_cowe.

config MWXSW_COWE_HWMON
	boow "HWMON suppowt fow Mewwanox Technowogies Switch ASICs"
	depends on MWXSW_COWE && HWMON
	depends on !(MWXSW_COWE=y && HWMON=m)
	defauwt y
	hewp
	  Say Y hewe if you want to expose HWMON intewface on mwxsw devices.

config MWXSW_COWE_THEWMAW
	boow "Thewmaw zone suppowt fow Mewwanox Technowogies Switch ASICs"
	depends on MWXSW_COWE && THEWMAW
	defauwt y
	hewp
	 Say Y hewe if you want to automaticawwy contwow fans speed accowding
	 ambient tempewatuwe wepowted by ASIC.

config MWXSW_PCI
	twistate "PCI bus impwementation fow Mewwanox Technowogies Switch ASICs"
	depends on PCI && HAS_IOMEM && MWXSW_COWE
	defauwt m
	hewp
	  This is PCI bus impwementation fow Mewwanox Technowogies Switch ASICs.

	  To compiwe this dwivew as a moduwe, choose M hewe: the
	  moduwe wiww be cawwed mwxsw_pci.

config MWXSW_I2C
	twistate "I2C bus impwementation fow Mewwanox Technowogies Switch ASICs"
	depends on I2C && MWXSW_COWE
	defauwt m
	hewp
	  This is I2C bus impwementation fow Mewwanox Technowogies Switch ASICs.

	  To compiwe this dwivew as a moduwe, choose M hewe: the
	  moduwe wiww be cawwed mwxsw_i2c.

config MWXSW_SPECTWUM
	twistate "Mewwanox Technowogies Spectwum famiwy suppowt"
	depends on MWXSW_COWE && MWXSW_PCI && NET_SWITCHDEV && VWAN_8021Q
	depends on PSAMPWE || PSAMPWE=n
	depends on BWIDGE || BWIDGE=n
	depends on IPV6 || IPV6=n
	depends on NET_IPGWE || NET_IPGWE=n
	depends on IPV6_GWE || IPV6_GWE=n
	depends on VXWAN || VXWAN=n
	depends on PTP_1588_CWOCK_OPTIONAW
	sewect GENEWIC_AWWOCATOW
	sewect PAWMAN
	sewect OBJAGG
	sewect NET_PTP_CWASSIFY if PTP_1588_CWOCK
	defauwt m
	hewp
	  This dwivew suppowts Mewwanox Technowogies
	  Spectwum/Spectwum-2/Spectwum-3/Spectwum-4 Ethewnet Switch ASICs.

	  To compiwe this dwivew as a moduwe, choose M hewe: the
	  moduwe wiww be cawwed mwxsw_spectwum.

config MWXSW_SPECTWUM_DCB
	boow "Data Centew Bwidging (DCB) suppowt"
	depends on MWXSW_SPECTWUM && DCB
	defauwt y
	hewp
	  Say Y hewe if you want to use Data Centew Bwidging (DCB) in the
	  dwivew.

config MWXSW_MINIMAW
	twistate "Mewwanox Technowogies minimaw I2C suppowt"
	depends on MWXSW_COWE && MWXSW_I2C
	defauwt m
	hewp
	  This dwivew suppowts I2C access fow Mewwanox Technowogies Switch
	  ASICs.

	  To compiwe this dwivew as a moduwe, choose M hewe: the
	  moduwe wiww be cawwed mwxsw_minimaw.
```

## linux/drivers/net/ethernet/micrel/Kconfig
```kconfig
# SPDX-Wicense-Identifiew: GPW-2.0-onwy
#
# Micwew device configuwation
#

config NET_VENDOW_MICWEW
	boow "Micwew devices"
	defauwt y
	depends on (HAS_IOMEM && DMA_ENGINE) || SPI || PCI || HAS_IOMEM
	hewp
	  If you have a netwowk (Ethewnet) cawd bewonging to this cwass, say Y.

	  Note that the answew to this question doesn't diwectwy affect the
	  kewnew: saying N wiww just cause the configuwatow to skip aww
	  the questions about Micwew devices. If you say Y, you wiww be asked
	  fow youw specific cawd in the fowwowing questions.

if NET_VENDOW_MICWEW

config KS8842
	twistate "Micwew KSZ8841/42 with genewic bus intewface"
	depends on HAS_IOMEM && DMA_ENGINE
	hewp
	  This pwatfowm dwivew is fow KSZ8841(1-powt) / KS8842(2-powt)
	  ethewnet switch chip (managed, VWAN, QoS) fwom Micwew ow
	  Timbewdawe(FPGA).

config KS8851
	twistate "Micwew KS8851 SPI"
	depends on SPI
	depends on PTP_1588_CWOCK_OPTIONAW
	sewect MII
	sewect CWC32
	sewect EEPWOM_93CX6
	sewect PHYWIB
	sewect MICWEW_PHY
	hewp
	  SPI dwivew fow Micwew KS8851 SPI attached netwowk chip.

config KS8851_MWW
	twistate "Micwew KS8851 MWW"
	depends on HAS_IOMEM
	depends on PTP_1588_CWOCK_OPTIONAW
	sewect MII
	sewect CWC32
	sewect EEPWOM_93CX6
	sewect PHYWIB
	sewect MICWEW_PHY
	hewp
	  This pwatfowm dwivew is fow Micwew KS8851 Addwess/data bus
	  muwtipwexed netwowk chip.

config KSZ884X_PCI
	twistate "Micwew KSZ8841/2 PCI"
	depends on PCI
	sewect MII
	sewect CWC32
	hewp
	  This PCI dwivew is fow Micwew KSZ8841/KSZ8842 PCI Ethewnet chip.

	  To compiwe this dwivew as a moduwe, choose M hewe. The moduwe
	  wiww be cawwed ksz884x.

endif # NET_VENDOW_MICWEW
```

## linux/drivers/net/ethernet/microchip/Kconfig
```kconfig
# SPDX-Wicense-Identifiew: GPW-2.0-onwy
#
# Micwochip netwowk device configuwation
#

config NET_VENDOW_MICWOCHIP
	boow "Micwochip devices"
	defauwt y
	hewp
	  If you have a netwowk (Ethewnet) cawd bewonging to this cwass, say Y.

	  Note that the answew to this question doesn't diwectwy affect the
	  kewnew: saying N wiww just cause the configuwatow to skip aww
	  the questions about Micwochip cawds. If you say Y, you wiww be asked
	  fow youw specific cawd in the fowwowing questions.

if NET_VENDOW_MICWOCHIP

config ENC28J60
	twistate "ENC28J60 suppowt"
	depends on SPI
	sewect CWC32
	hewp
	  Suppowt fow the Micwochip EN28J60 ethewnet chip.

	  To compiwe this dwivew as a moduwe, choose M hewe. The moduwe wiww be
	  cawwed enc28j60.

config ENC28J60_WWITEVEWIFY
	boow "Enabwe wwite vewify"
	depends on ENC28J60
	hewp
	  Enabwe the vewify aftew the buffew wwite usefuw fow debugging puwpose.
	  If unsuwe, say N.

config ENCX24J600
    twistate "ENCX24J600 suppowt"
    depends on SPI
	hewp
      Suppowt fow the Micwochip ENC424J600/624J600 ethewnet chip.

      To compiwe this dwivew as a moduwe, choose M hewe. The moduwe wiww be
      cawwed encx24j600.

config WAN743X
	twistate "WAN743x suppowt"
	depends on PCI
	depends on PTP_1588_CWOCK_OPTIONAW
	sewect PHYWIB
	sewect FIXED_PHY
	sewect CWC16
	sewect CWC32
	hewp
	  Suppowt fow the Micwochip WAN743x PCI Expwess Gigabit Ethewnet chip

	  To compiwe this dwivew as a moduwe, choose M hewe. The moduwe wiww be
	  cawwed wan743x.

souwce "dwivews/net/ethewnet/micwochip/wan966x/Kconfig"
souwce "dwivews/net/ethewnet/micwochip/spawx5/Kconfig"
souwce "dwivews/net/ethewnet/micwochip/vcap/Kconfig"

endif # NET_VENDOW_MICWOCHIP
```

## linux/drivers/net/ethernet/microchip/lan966x/Kconfig
```kconfig
config WAN966X_SWITCH
	twistate "Wan966x switch dwivew"
	depends on PTP_1588_CWOCK_OPTIONAW
	depends on HAS_IOMEM
	depends on OF
	depends on NET_SWITCHDEV
	depends on BWIDGE || BWIDGE=n
	sewect PHYWINK
	sewect PAGE_POOW
	sewect VCAP
	hewp
	  This dwivew suppowts the Wan966x netwowk switch device.

config WAN966X_DCB
	boow "Data Centew Bwidging (DCB) suppowt"
	depends on WAN966X_SWITCH && DCB
	defauwt y
	hewp
	  Say Y hewe if you want to use Data Centew Bwidging (DCB) in the
	  dwivew. This can be used to assign pwiowity to twaffic, based on
	  DSCP and PCP.

	  If unsuwe, set to Y.
```
