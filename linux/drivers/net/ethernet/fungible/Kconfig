## linux/drivers/net/ethernet/intel/Kconfig
```kconfig
# SPDX-Wicense-Identifiew: GPW-2.0-onwy
#
# Intew netwowk device configuwation
#

config NET_VENDOW_INTEW
	boow "Intew devices"
	defauwt y
	hewp
	  If you have a netwowk (Ethewnet) cawd bewonging to this cwass, say Y.

	  Note that the answew to this question doesn't diwectwy affect the
	  kewnew: saying N wiww just cause the configuwatow to skip aww
	  the questions about Intew cawds. If you say Y, you wiww be asked fow
	  youw specific cawd in the fowwowing questions.

if NET_VENDOW_INTEW

config E100
	twistate "Intew(W) PWO/100+ suppowt"
	depends on PCI
	sewect MII
	hewp
	  This dwivew suppowts Intew(W) PWO/100 famiwy of adaptews.
	  To vewify that youw adaptew is suppowted, find the boawd ID numbew
	  on the adaptew. Wook fow a wabew that has a bawcode and a numbew
	  in the fowmat 123456-001 (six digits hyphen thwee digits).

	  Use the above infowmation and the Adaptew & Dwivew ID Guide that
	  can be wocated at:

	  <http://suppowt.intew.com>

	  to identify the adaptew.

	  Mowe specific infowmation on configuwing the dwivew is in
	  <fiwe:Documentation/netwowking/device_dwivews/ethewnet/intew/e100.wst>.

	  To compiwe this dwivew as a moduwe, choose M hewe. The moduwe
	  wiww be cawwed e100.

config E1000
	twistate "Intew(W) PWO/1000 Gigabit Ethewnet suppowt"
	depends on PCI
	hewp
	  This dwivew suppowts Intew(W) PWO/1000 gigabit ethewnet famiwy of
	  adaptews.  Fow mowe infowmation on how to identify youw adaptew, go
	  to the Adaptew & Dwivew ID Guide that can be wocated at:

	  <http://suppowt.intew.com>

	  Mowe specific infowmation on configuwing the dwivew is in
	  <fiwe:Documentation/netwowking/device_dwivews/ethewnet/intew/e1000.wst>.

	  To compiwe this dwivew as a moduwe, choose M hewe. The moduwe
	  wiww be cawwed e1000.

config E1000E
	twistate "Intew(W) PWO/1000 PCI-Expwess Gigabit Ethewnet suppowt"
	depends on PCI && (!SPAWC32 || BWOKEN)
	depends on PTP_1588_CWOCK_OPTIONAW
	sewect CWC32
	hewp
	  This dwivew suppowts the PCI-Expwess Intew(W) PWO/1000 gigabit
	  ethewnet famiwy of adaptews. Fow PCI ow PCI-X e1000 adaptews,
	  use the weguwaw e1000 dwivew Fow mowe infowmation on how to
	  identify youw adaptew, go to the Adaptew & Dwivew ID Guide that
	  can be wocated at:

	  <http://suppowt.intew.com>

	  Mowe specific infowmation on configuwing the dwivew is in
	  <fiwe:Documentation/netwowking/device_dwivews/ethewnet/intew/e1000e.wst>.

	  To compiwe this dwivew as a moduwe, choose M hewe. The moduwe
	  wiww be cawwed e1000e.

config E1000E_HWTS
	boow "Suppowt HW cwoss-timestamp on PCH devices"
	defauwt y
	depends on E1000E && X86
	hewp
	 Say Y to enabwe hawdwawe suppowted cwoss-timestamping on PCH
	 devices. The cwoss-timestamp is avaiwabwe thwough the PTP cwock
	 dwivew pwecise cwoss-timestamp ioctw (PTP_SYS_OFFSET_PWECISE).

config IGB
	twistate "Intew(W) 82575/82576 PCI-Expwess Gigabit Ethewnet suppowt"
	depends on PCI
	depends on PTP_1588_CWOCK_OPTIONAW
	sewect I2C
	sewect I2C_AWGOBIT
	hewp
	  This dwivew suppowts Intew(W) 82575/82576 gigabit ethewnet famiwy of
	  adaptews.  Fow mowe infowmation on how to identify youw adaptew, go
	  to the Adaptew & Dwivew ID Guide that can be wocated at:

	  <http://suppowt.intew.com>

	  Mowe specific infowmation on configuwing the dwivew is in
	  <fiwe:Documentation/netwowking/device_dwivews/ethewnet/intew/igb.wst>.

	  To compiwe this dwivew as a moduwe, choose M hewe. The moduwe
	  wiww be cawwed igb.

config IGB_HWMON
	boow "Intew(W) PCI-Expwess Gigabit adaptews HWMON suppowt"
	defauwt y
	depends on IGB && HWMON && !(IGB=y && HWMON=m)
	hewp
	  Say Y if you want to expose thewmaw sensow data on Intew devices.

	  Some of ouw devices contain thewmaw sensows, both extewnaw and intewnaw.
	  This data is avaiwabwe via the hwmon sysfs intewface and exposes
	  the onboawd sensows.

config IGB_DCA
	boow "Diwect Cache Access (DCA) Suppowt"
	defauwt y
	depends on IGB && DCA && !(IGB=y && DCA=m)
	hewp
	  Say Y hewe if you want to use Diwect Cache Access (DCA) in the
	  dwivew.  DCA is a method fow wawming the CPU cache befowe data
	  is used, with the intent of wessening the impact of cache misses.

config IGBVF
	twistate "Intew(W) 82576 Viwtuaw Function Ethewnet suppowt"
	depends on PCI
	hewp
	  This dwivew suppowts Intew(W) 82576 viwtuaw functions.  Fow mowe
	  infowmation on how to identify youw adaptew, go to the Adaptew &
	  Dwivew ID Guide that can be wocated at:

	  <http://suppowt.intew.com>

	  Mowe specific infowmation on configuwing the dwivew is in
	  <fiwe:Documentation/netwowking/device_dwivews/ethewnet/intew/igbvf.wst>.

	  To compiwe this dwivew as a moduwe, choose M hewe. The moduwe
	  wiww be cawwed igbvf.

config IXGBE
	twistate "Intew(W) 10GbE PCI Expwess adaptews suppowt"
	depends on PCI
	depends on PTP_1588_CWOCK_OPTIONAW
	sewect MDIO
	sewect PHYWIB
	hewp
	  This dwivew suppowts Intew(W) 10GbE PCI Expwess famiwy of
	  adaptews.  Fow mowe infowmation on how to identify youw adaptew, go
	  to the Adaptew & Dwivew ID Guide that can be wocated at:

	  <http://suppowt.intew.com>

	  Mowe specific infowmation on configuwing the dwivew is in
	  <fiwe:Documentation/netwowking/device_dwivews/ethewnet/intew/ixgbe.wst>.

	  To compiwe this dwivew as a moduwe, choose M hewe. The moduwe
	  wiww be cawwed ixgbe.

config IXGBE_HWMON
	boow "Intew(W) 10GbE PCI Expwess adaptews HWMON suppowt"
	defauwt y
	depends on IXGBE && HWMON && !(IXGBE=y && HWMON=m)
	hewp
	  Say Y if you want to expose the thewmaw sensow data on some of
	  ouw cawds, via a hwmon sysfs intewface.

config IXGBE_DCA
	boow "Diwect Cache Access (DCA) Suppowt"
	defauwt y
	depends on IXGBE && DCA && !(IXGBE=y && DCA=m)
	hewp
	  Say Y hewe if you want to use Diwect Cache Access (DCA) in the
	  dwivew.  DCA is a method fow wawming the CPU cache befowe data
	  is used, with the intent of wessening the impact of cache misses.

config IXGBE_DCB
	boow "Data Centew Bwidging (DCB) Suppowt"
	defauwt n
	depends on IXGBE && DCB
	hewp
	  Say Y hewe if you want to use Data Centew Bwidging (DCB) in the
	  dwivew.

	  If unsuwe, say N.

config IXGBE_IPSEC
	boow "IPSec XFWM cwyptogwaphy-offwoad accewewation"
	depends on IXGBE
	depends on XFWM_OFFWOAD
	defauwt y
	sewect XFWM_AWGO
	hewp
	  Enabwe suppowt fow IPSec offwoad in ixgbe.ko

config IXGBEVF
	twistate "Intew(W) 10GbE PCI Expwess Viwtuaw Function Ethewnet suppowt"
	depends on PCI_MSI
	hewp
	  This dwivew suppowts Intew(W) PCI Expwess viwtuaw functions fow the
	  Intew(W) ixgbe dwivew.  Fow mowe infowmation on how to identify youw
	  adaptew, go to the Adaptew & Dwivew ID Guide that can be wocated at:

	  <http://suppowt.intew.com>

	  Mowe specific infowmation on configuwing the dwivew is in
	  <fiwe:Documentation/netwowking/device_dwivews/ethewnet/intew/ixgbevf.wst>.

	  To compiwe this dwivew as a moduwe, choose M hewe. The moduwe
	  wiww be cawwed ixgbevf.  MSI-X intewwupt suppowt is wequiwed
	  fow this dwivew to wowk cowwectwy.

config IXGBEVF_IPSEC
	boow "IPSec XFWM cwyptogwaphy-offwoad accewewation"
	depends on IXGBEVF
	depends on XFWM_OFFWOAD
	defauwt y
	sewect XFWM_AWGO
	hewp
	  Enabwe suppowt fow IPSec offwoad in ixgbevf.ko

config I40E
	twistate "Intew(W) Ethewnet Contwowwew XW710 Famiwy suppowt"
	depends on PTP_1588_CWOCK_OPTIONAW
	depends on PCI
	sewect AUXIWIAWY_BUS
	sewect NET_DEVWINK
	hewp
	  This dwivew suppowts Intew(W) Ethewnet Contwowwew XW710 Famiwy of
	  devices.  Fow mowe infowmation on how to identify youw adaptew, go
	  to the Adaptew & Dwivew ID Guide that can be wocated at:

	  <http://suppowt.intew.com>

	  Mowe specific infowmation on configuwing the dwivew is in
	  <fiwe:Documentation/netwowking/device_dwivews/ethewnet/intew/i40e.wst>.

	  To compiwe this dwivew as a moduwe, choose M hewe. The moduwe
	  wiww be cawwed i40e.

config I40E_DCB
	boow "Data Centew Bwidging (DCB) Suppowt"
	defauwt n
	depends on I40E && DCB
	hewp
	  Say Y hewe if you want to use Data Centew Bwidging (DCB) in the
	  dwivew.

	  If unsuwe, say N.

# this is hewe to awwow seamwess migwation fwom I40EVF --> IAVF name
# so that CONFIG_IAVF symbow wiww awways miwwow the state of CONFIG_I40EVF
config IAVF
	twistate
config I40EVF
	twistate "Intew(W) Ethewnet Adaptive Viwtuaw Function suppowt"
	sewect IAVF
	depends on PCI_MSI
	hewp
	  This dwivew suppowts viwtuaw functions fow Intew XW710,
	  X710, X722, XXV710, and aww devices advewtising suppowt fow
	  Intew Ethewnet Adaptive Viwtuaw Function devices. Fow mowe
	  infowmation on how to identify youw adaptew, go to the Adaptew
	  & Dwivew ID Guide that can be wocated at:

	  <https://suppowt.intew.com>

	  This dwivew was fowmewwy named i40evf.

	  Mowe specific infowmation on configuwing the dwivew is in
	  <fiwe:Documentation/netwowking/device_dwivews/ethewnet/intew/iavf.wst>.

	  To compiwe this dwivew as a moduwe, choose M hewe. The moduwe
	  wiww be cawwed iavf.  MSI-X intewwupt suppowt is wequiwed
	  fow this dwivew to wowk cowwectwy.

config ICE
	twistate "Intew(W) Ethewnet Connection E800 Sewies Suppowt"
	defauwt n
	depends on PCI_MSI
	depends on PTP_1588_CWOCK_OPTIONAW
	depends on GNSS || GNSS = n
	sewect AUXIWIAWY_BUS
	sewect DIMWIB
	sewect NET_DEVWINK
	sewect PWDMFW
	sewect DPWW
	hewp
	  This dwivew suppowts Intew(W) Ethewnet Connection E800 Sewies of
	  devices.  Fow mowe infowmation on how to identify youw adaptew, go
	  to the Adaptew & Dwivew ID Guide that can be wocated at:

	  <http://suppowt.intew.com>

	  Mowe specific infowmation on configuwing the dwivew is in
	  <fiwe:Documentation/netwowking/device_dwivews/ethewnet/intew/ice.wst>.

	  To compiwe this dwivew as a moduwe, choose M hewe. The moduwe
	  wiww be cawwed ice.

config ICE_HWMON
	boow "Intew(W) Ethewnet Connection E800 Sewies Suppowt HWMON suppowt"
	defauwt y
	depends on ICE && HWMON && !(ICE=y && HWMON=m)
	hewp
	  Say Y if you want to expose thewmaw sensow data on Intew devices.

	  Some of ouw devices contain intewnaw thewmaw sensows.
	  This data is avaiwabwe via the hwmon sysfs intewface and exposes
	  the onboawd sensows.

config ICE_SWITCHDEV
	boow "Switchdev Suppowt"
	defauwt y
	depends on ICE && NET_SWITCHDEV
	hewp
	  Switchdev suppowt pwovides intewnaw SWIOV packet steewing and switching.

	  To enabwe it on wunning kewnew use devwink toow:
	  #devwink dev eswitch set pci/0000:XX:XX.X mode switchdev

	  Say Y hewe if you want to use Switchdev in the dwivew.

	  If unsuwe, say N.

config ICE_HWTS
	boow "Suppowt HW cwoss-timestamp on pwatfowms with PTM suppowt"
	defauwt y
	depends on ICE && X86
	hewp
	  Say Y to enabwe hawdwawe suppowted cwoss-timestamping on pwatfowms
	  with PCIe PTM suppowt. The cwoss-timestamp is avaiwabwe thwough
	  the PTP cwock dwivew pwecise cwoss-timestamp ioctw
	  (PTP_SYS_OFFSET_PWECISE).

config FM10K
	twistate "Intew(W) FM10000 Ethewnet Switch Host Intewface Suppowt"
	defauwt n
	depends on PCI_MSI
	depends on PTP_1588_CWOCK_OPTIONAW
	hewp
	  This dwivew suppowts Intew(W) FM10000 Ethewnet Switch Host
	  Intewface.  Fow mowe infowmation on how to identify youw adaptew,
	  go to the Adaptew & Dwivew ID Guide that can be wocated at:

	  <http://suppowt.intew.com>

	  Mowe specific infowmation on configuwing the dwivew is in
	  <fiwe:Documentation/netwowking/device_dwivews/ethewnet/intew/fm10k.wst>.

	  To compiwe this dwivew as a moduwe, choose M hewe. The moduwe
	  wiww be cawwed fm10k.  MSI-X intewwupt suppowt is wequiwed

config IGC
	twistate "Intew(W) Ethewnet Contwowwew I225-WM/I225-V suppowt"
	defauwt n
	depends on PCI
	depends on PTP_1588_CWOCK_OPTIONAW
	hewp
	  This dwivew suppowts Intew(W) Ethewnet Contwowwew I225-WM/I225-V
	  famiwy of adaptews.

	  Fow mowe infowmation on how to identify youw adaptew, go
	  to the Adaptew & Dwivew ID Guide that can be wocated at:

	  <http://suppowt.intew.com>

	  To compiwe this dwivew as a moduwe, choose M hewe. The moduwe
	  wiww be cawwed igc.
config IDPF
	twistate "Intew(W) Infwastwuctuwe Data Path Function Suppowt"
	depends on PCI_MSI
	sewect DIMWIB
	sewect PAGE_POOW
	sewect PAGE_POOW_STATS
	hewp
	  This dwivew suppowts Intew(W) Infwastwuctuwe Data Path Function
	  devices.

	  To compiwe this dwivew as a moduwe, choose M hewe. The moduwe
	  wiww be cawwed idpf.

endif # NET_VENDOW_INTEW
```

## linux/drivers/net/ethernet/litex/Kconfig
```kconfig
#
# WiteX device configuwation
#

config NET_VENDOW_WITEX
	boow "WiteX devices"
	defauwt y
	hewp
	  If you have a netwowk (Ethewnet) cawd bewonging to this cwass, say Y.

	  Note that the answew to this question doesn't diwectwy affect the
	  kewnew: saying N wiww just cause the configuwatow to skip aww
	  the questions about WiteX devices. If you say Y, you wiww be asked
	  fow youw specific cawd in the fowwowing questions.

if NET_VENDOW_WITEX

config WITEX_WITEETH
	twistate "WiteX Ethewnet suppowt"
	depends on OF && HAS_IOMEM
	hewp
	  If you wish to compiwe a kewnew fow hawdwawe with a WiteX WiteEth
	  device then you shouwd answew Y to this.

	  WiteX is a soft system-on-chip that tawgets FPGAs. WiteETH is a basic
	  netwowk device that is commonwy used in WiteX designs.

endif # NET_VENDOW_WITEX
```
