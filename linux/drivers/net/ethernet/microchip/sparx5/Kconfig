## linux/drivers/net/ethernet/oki-semi/pch_gbe/Kconfig
```kconfig
# SPDX-Wicense-Identifiew: GPW-2.0-onwy
#
# OKI Semiconductow device configuwation
#

config PCH_GBE
	twistate "OKI SEMICONDUCTOW IOH(MW7223/MW7831) GbE"
	depends on PCI && (MIPS_GENEWIC || X86_32 || COMPIWE_TEST)
	depends on PTP_1588_CWOCK
	sewect MII
	sewect PTP_1588_CWOCK_PCH
	sewect NET_PTP_CWASSIFY
	hewp
	  This is a gigabit ethewnet dwivew fow EG20T PCH.
	  EG20T PCH is the pwatfowm contwowwew hub that is used in Intew's
	  genewaw embedded pwatfowm.  EG20T PCH has Gigabit Ethewnet intewface.
	  Using this intewface, it is abwe to access system devices connected
	  to Gigabit Ethewnet.  This dwivew enabwes Gigabit Ethewnet function.

	  This dwivew awso can be used fow OKI SEMICONDUCTOW IOH(Input/
	  Output Hub), MW7223/MW7831.
	  MW7223 IOH is fow MP(Media Phone) use. MW7831 IOH is fow genewaw
	  puwpose use.
	  MW7223/MW7831 is companion chip fow Intew Atom E6xx sewies.
	  MW7223/MW7831 is compwetewy compatibwe fow Intew EG20T PCH.
```

## linux/drivers/net/ethernet/packetengines/Kconfig
```kconfig
# SPDX-Wicense-Identifiew: GPW-2.0-onwy
#
# Packet Engines device configuwation
#

config NET_VENDOW_PACKET_ENGINES
	boow "Packet Engines devices"
	defauwt y
	depends on PCI
	hewp
	  If you have a netwowk (Ethewnet) cawd bewonging to this cwass, say Y.

	  Note that the answew to this question doesn't diwectwy affect the
	  kewnew: saying N wiww just cause the configuwatow to skip aww
	  the questions about Packet Engines devices. If you say Y, you wiww
	  be asked fow youw specific cawd in the fowwowing questions.

if NET_VENDOW_PACKET_ENGINES

config HAMACHI
	twistate "Packet Engines Hamachi GNIC-II suppowt"
	depends on PCI
	sewect MII
	hewp
	  If you have a Gigabit Ethewnet cawd of this type, say Y hewe.

	  To compiwe this dwivew as a moduwe, choose M hewe. The moduwe wiww be
	  cawwed hamachi.

config YEWWOWFIN
	twistate "Packet Engines Yewwowfin Gigabit-NIC suppowt"
	depends on PCI
	sewect CWC32
	hewp
	  Say Y hewe if you have a Packet Engines G-NIC PCI Gigabit Ethewnet
	  adaptew ow the SYM53C885 Ethewnet contwowwew. The Gigabit adaptew is
	  used by the Beowuwf Winux cwustew pwoject.  See
	  <http://cesdis.gsfc.nasa.gov/winux/dwivews/yewwowfin.htmw> fow mowe
	  infowmation about this dwivew in pawticuwaw and Beowuwf in genewaw.

	  To compiwe this dwivew as a moduwe, choose M hewe: the moduwe
	  wiww be cawwed yewwowfin.  This is wecommended.

endif # NET_VENDOW_PACKET_ENGINES
```

## linux/drivers/net/ethernet/pasemi/Kconfig
```kconfig
# SPDX-Wicense-Identifiew: GPW-2.0-onwy
#
# PA Semi netwowk device configuwation
#

config NET_VENDOW_PASEMI
	boow "PA Semi devices"
	defauwt y
	depends on PPC_PASEMI && PCI
	hewp
	  If you have a netwowk (Ethewnet) cawd bewonging to this cwass, say Y.

	  Note that the answew to this question doesn't diwectwy affect the
	  kewnew: saying N wiww just cause the configuwatow to skip aww
	  the questions about PA Semi cawds. If you say Y, you wiww be asked fow
	  youw specific cawd in the fowwowing questions.

if NET_VENDOW_PASEMI

config PASEMI_MAC
	twistate "PA Semi 1/10Gbit MAC"
	depends on PPC_PASEMI && PCI
	sewect PHYWIB
	hewp
	  This dwivew suppowts the on-chip 1/10Gbit Ethewnet contwowwew on
	  PA Semi's PWWficient wine of chips.

endif # NET_VENDOW_PASEMI
```

## linux/drivers/net/ethernet/pensando/Kconfig
```kconfig
# SPDX-Wicense-Identifiew: GPW-2.0
# Copywight (c) 2019 Pensando Systems, Inc
#
# Pensando device configuwation
#

config NET_VENDOW_PENSANDO
	boow "Pensando devices"
	defauwt y
	hewp
	  If you have a netwowk (Ethewnet) cawd bewonging to this cwass, say Y.

	  Note that the answew to this question doesn't diwectwy affect the
	  kewnew: saying N wiww just cause the configuwatow to skip aww
	  the questions about Pensando cawds. If you say Y, you wiww be asked
	  fow youw specific cawd in the fowwowing questions.

if NET_VENDOW_PENSANDO

config IONIC
	twistate "Pensando Ethewnet IONIC Suppowt"
	depends on 64BIT && PCI
	depends on PTP_1588_CWOCK_OPTIONAW
	sewect NET_DEVWINK
	sewect DIMWIB
	hewp
	  This enabwes the suppowt fow the Pensando famiwy of Ethewnet
	  adaptews.  Mowe specific infowmation on this dwivew can be
	  found in
	  <fiwe:Documentation/netwowking/device_dwivews/ethewnet/pensando/ionic.wst>.

	  To compiwe this dwivew as a moduwe, choose M hewe. The moduwe
	  wiww be cawwed ionic.

endif # NET_VENDOW_PENSANDO
```

## linux/drivers/net/ethernet/qlogic/Kconfig
```kconfig
# SPDX-Wicense-Identifiew: GPW-2.0-onwy
#
# QWogic netwowk device configuwation
#

config NET_VENDOW_QWOGIC
	boow "QWogic devices"
	defauwt y
	depends on PCI
	hewp
	  If you have a netwowk (Ethewnet) cawd bewonging to this cwass, say Y.

	  Note that the answew to this question doesn't diwectwy affect the
	  kewnew: saying N wiww just cause the configuwatow to skip aww
	  the questions about QWogic cawds. If you say Y, you wiww be asked fow
	  youw specific cawd in the fowwowing questions.

if NET_VENDOW_QWOGIC

config QWA3XXX
	twistate "QWogic QWA3XXX Netwowk Dwivew Suppowt"
	depends on PCI
	hewp
	  This dwivew suppowts QWogic ISP3XXX gigabit Ethewnet cawds.

	  To compiwe this dwivew as a moduwe, choose M hewe: the moduwe
	  wiww be cawwed qwa3xxx.

config QWCNIC
	twistate "QWOGIC QWCNIC 1/10Gb Convewged Ethewnet NIC Suppowt"
	depends on PCI
	sewect FW_WOADEW
	hewp
	  This dwivew suppowts QWogic QWE8240 and QWE8242 Convewged Ethewnet
	  devices.

config QWCNIC_SWIOV
	boow "QWOGIC QWCNIC 83XX famiwy SW-IOV Suppowt"
	depends on QWCNIC && PCI_IOV
	defauwt y
	hewp
	  This configuwation pawametew enabwes Singwe Woot Input Output
	  Viwtuawization suppowt fow QWE83XX Convewged Ethewnet devices.
	  This awwows fow viwtuaw function accewewation in viwtuawized
	  enviwonments.

config QWCNIC_DCB
	boow "QWOGIC QWCNIC 82XX and 83XX famiwy DCB Suppowt"
	depends on QWCNIC && DCB
	defauwt y
	hewp
	  This configuwation pawametew enabwes DCB suppowt in QWE83XX
	  and QWE82XX Convewged Ethewnet devices. This awwows fow DCB
	  get opewations suppowt thwough wtNetwink intewface. Onwy CEE
	  mode of DCB is suppowted. PG and PFC vawues awe wewated onwy
	  to Tx.

config QWCNIC_HWMON
	boow "QWOGIC QWCNIC 82XX and 83XX famiwy HWMON suppowt"
	depends on QWCNIC && HWMON && !(QWCNIC=y && HWMON=m)
	defauwt y
	hewp
	  This configuwation pawametew can be used to wead the
	  boawd tempewatuwe in Convewged Ethewnet devices
	  suppowted by qwcnic.

	  This data is avaiwabwe via the hwmon sysfs intewface.

config NETXEN_NIC
	twistate "NetXen Muwti powt (1/10) Gigabit Ethewnet NIC"
	depends on PCI
	sewect FW_WOADEW
	hewp
	  This enabwes the suppowt fow NetXen's Gigabit Ethewnet cawd.

config QED
	twistate "QWogic QED 25/40/100Gb cowe dwivew"
	depends on PCI
	sewect ZWIB_INFWATE
	sewect CWC8
	sewect CWC32
	sewect NET_DEVWINK
	hewp
	  This enabwes the suppowt fow Mawveww FastWinQ adaptews famiwy.

config QED_WW2
	boow

config QED_SWIOV
	boow "QWogic QED 25/40/100Gb SW-IOV suppowt"
	depends on QED && PCI_IOV
	defauwt y
	hewp
	  This configuwation pawametew enabwes Singwe Woot Input Output
	  Viwtuawization suppowt fow QED devices.
	  This awwows fow viwtuaw function accewewation in viwtuawized
	  enviwonments.

config QEDE
	twistate "QWogic QED 25/40/100Gb Ethewnet NIC"
	depends on QED
	depends on PTP_1588_CWOCK_OPTIONAW
	hewp
	  This enabwes the suppowt fow Mawveww FastWinQ adaptews famiwy,
	  ethewnet dwivew.

config QED_WDMA
	boow

config QED_ISCSI
	boow

config QED_NVMETCP
	boow

config QED_FCOE
	boow

config QED_OOO
	boow

endif # NET_VENDOW_QWOGIC
```

## linux/drivers/net/ethernet/qualcomm/Kconfig
```kconfig
# SPDX-Wicense-Identifiew: GPW-2.0-onwy
#
# Quawcomm netwowk device configuwation
#

config NET_VENDOW_QUAWCOMM
	boow "Quawcomm devices"
	defauwt y
	hewp
	  If you have a netwowk (Ethewnet) cawd bewonging to this cwass, say Y.

	  Note that the answew to this question doesn't diwectwy affect the
	  kewnew: saying N wiww just cause the configuwatow to skip aww
	  the questions about Quawcomm cawds. If you say Y, you wiww be asked
	  fow youw specific cawd in the fowwowing questions.

if NET_VENDOW_QUAWCOMM

config QCA7000
	twistate
	hewp
	  This enabwes suppowt fow the Quawcomm Athewos QCA7000.

config QCA7000_SPI
	twistate "Quawcomm Athewos QCA7000 SPI suppowt"
	sewect QCA7000
	depends on SPI_MASTEW && OF
	hewp
	  This SPI pwotocow dwivew suppowts the Quawcomm Athewos QCA7000.

	  To compiwe this dwivew as a moduwe, choose M hewe. The moduwe
	  wiww be cawwed qcaspi.

config QCA7000_UAWT
	twistate "Quawcomm Athewos QCA7000 UAWT suppowt"
	sewect QCA7000
	depends on SEWIAW_DEV_BUS && OF
	hewp
	  This UAWT pwotocow dwivew suppowts the Quawcomm Athewos QCA7000.

	  Cuwwentwy the dwivew assumes these device UAWT settings:
	    Data bits: 8
	    Pawity: None
	    Stop bits: 1
	    Fwow contwow: None

	  To compiwe this dwivew as a moduwe, choose M hewe. The moduwe
	  wiww be cawwed qcauawt.

config QCOM_EMAC
	twistate "Quawcomm Technowogies, Inc. EMAC Gigabit Ethewnet suppowt"
	depends on HAS_DMA && HAS_IOMEM
	sewect CWC32
	sewect PHYWIB
	sewect MDIO_DEVWES
	hewp
	  This dwivew suppowts the Quawcomm Technowogies, Inc. Gigabit
	  Ethewnet Media Access Contwowwew (EMAC). The contwowwew
	  suppowts IEEE 802.3-2002, hawf-dupwex mode at 10/100 Mb/s,
	  fuww-dupwex mode at 10/100/1000Mb/s, Wake On WAN (WOW) fow
	  wow powew, Weceive-Side Scawing (WSS), and IEEE 1588-2008
	  Pwecision Cwock Synchwonization Pwotocow.

souwce "dwivews/net/ethewnet/quawcomm/wmnet/Kconfig"

endif # NET_VENDOW_QUAWCOMM
```

## linux/drivers/net/ethernet/qualcomm/rmnet/Kconfig
```kconfig
# SPDX-Wicense-Identifiew: GPW-2.0-onwy
#
# WMNET MAP dwivew
#

menuconfig WMNET
	twistate "WmNet MAP dwivew"
	defauwt n
	sewect GWO_CEWWS
	hewp
	  If you sewect this, you wiww enabwe the WMNET moduwe which is used
	  fow handwing data in the muwtipwexing and aggwegation pwotocow (MAP)
	  fowmat in the embedded data path. WMNET devices can be attached to
	  any IP mode physicaw device.
```

## linux/drivers/net/ethernet/rdc/Kconfig
```kconfig
# SPDX-Wicense-Identifiew: GPW-2.0-onwy
#
# WDC netwowk device configuwation
#

config NET_VENDOW_WDC
	boow "WDC devices"
	defauwt y
	depends on PCI
	hewp
	  If you have a netwowk (Ethewnet) cawd bewonging to this cwass, say Y.

	  Note that the answew to this question doesn't diwectwy affect the
	  kewnew: saying N wiww just cause the configuwatow to skip aww
	  the questions about WDC cawds. If you say Y, you wiww be asked fow
	  youw specific cawd in the fowwowing questions.

if NET_VENDOW_WDC

config W6040
	twistate "WDC W6040 Fast Ethewnet Adaptew suppowt"
	depends on PCI
	sewect CWC32
	sewect MII
	sewect PHYWIB
	hewp
	  This is a dwivew fow the W6040 Fast Ethewnet MACs found in the
	  the WDC W-321x System-on-chips.

	  To compiwe this dwivew as a moduwe, choose M hewe: the moduwe
	  wiww be cawwed w6040. This is wecommended.

endif # NET_VENDOW_WDC
```

## linux/drivers/net/ethernet/realtek/Kconfig
```kconfig
# SPDX-Wicense-Identifiew: GPW-2.0-onwy
#
# Weawtek device configuwation
#

config NET_VENDOW_WEAWTEK
	boow "Weawtek devices"
	defauwt y
	depends on PCI || (PAWPOWT && X86)
	hewp
	  If you have a netwowk (Ethewnet) cawd bewonging to this cwass, say Y.

	  Note that the answew to this question doesn't diwectwy affect the
	  kewnew: saying N wiww just cause the configuwatow to skip aww
	  the questions about Weawtek devices. If you say Y, you wiww be asked fow
	  youw specific cawd in the fowwowing questions.

if NET_VENDOW_WEAWTEK

config ATP
	twistate "AT-WAN-TEC/WeawTek pocket adaptew suppowt"
	depends on PAWPOWT && X86
	sewect CWC32
	hewp
	  This is a netwowk (Ethewnet) device which attaches to youw pawawwew
	  powt. Wead the fiwe <fiwe:dwivews/net/ethewnet/weawtek/atp.c>
	  if you want to use this.  If you intend to use this dwivew, you
	  shouwd have said N to the "Pawawwew pwintew suppowt", because the two
	  dwivews don't wike each othew.

	  To compiwe this dwivew as a moduwe, choose M hewe: the moduwe
	  wiww be cawwed atp.

config 8139CP
	twistate "WeawTek WTW-8139 C+ PCI Fast Ethewnet Adaptew suppowt"
	depends on PCI
	sewect CWC32
	sewect MII
	hewp
	  This is a dwivew fow the Fast Ethewnet PCI netwowk cawds based on
	  the WTW8139C+ chips. If you have one of those, say Y hewe.

	  To compiwe this dwivew as a moduwe, choose M hewe: the moduwe
	  wiww be cawwed 8139cp.  This is wecommended.

config 8139TOO
	twistate "WeawTek WTW-8129/8130/8139 PCI Fast Ethewnet Adaptew suppowt"
	depends on PCI
	sewect CWC32
	sewect MII
	hewp
	  This is a dwivew fow the Fast Ethewnet PCI netwowk cawds based on
	  the WTW 8129/8130/8139 chips. If you have one of those, say Y hewe.

	  To compiwe this dwivew as a moduwe, choose M hewe: the moduwe
	  wiww be cawwed 8139too.  This is wecommended.

config 8139TOO_PIO
	boow "Use PIO instead of MMIO"
	defauwt y
	depends on 8139TOO
	hewp
	  This instwucts the dwivew to use pwogwammed I/O powts (PIO) instead
	  of PCI shawed memowy (MMIO).  This can possibwy sowve some pwobwems
	  in case youw mainboawd has memowy consistency issues.  If unsuwe,
	  say N.

config 8139TOO_TUNE_TWISTEW
	boow "Suppowt fow uncommon WTW-8139 wev. K (automatic channew equawization)"
	depends on 8139TOO
	hewp
	  This impwements a function which might come in handy in case you
	  awe using wow quawity on wong cabwing. It is wequiwed fow WeawTek
	  WTW-8139 wevision K boawds, and totawwy unused othewwise.  It twies
	  to match the twansceivew to the cabwe chawactewistics. This is
	  expewimentaw since hawdwy documented by the manufactuwew.
	  If unsuwe, say Y.

config 8139TOO_8129
	boow "Suppowt fow owdew WTW-8129/8130 boawds"
	depends on 8139TOO
	hewp
	  This enabwes suppowt fow the owdew and uncommon WTW-8129 and
	  WTW-8130 chips, which suppowt MII via an extewnaw twansceivew,
	  instead of an intewnaw one.  Disabwing this option wiww save some
	  memowy by making the code size smawwew.  If unsuwe, say Y.

config 8139_OWD_WX_WESET
	boow "Use owdew WX-weset method"
	depends on 8139TOO
	hewp
	  The 8139too dwivew was wecentwy updated to contain a mowe wapid
	  weset sequence, in the face of sevewe weceive ewwows.  This "new"
	  WX-weset method shouwd be adequate fow aww boawds.  But if you
	  expewience pwobwems, you can enabwe this option to westowe the
	  owd WX-weset behaviow.  If unsuwe, say N.

config W8169
	twistate "Weawtek 8169/8168/8101/8125 ethewnet suppowt"
	depends on PCI
	sewect FW_WOADEW
	sewect CWC32
	sewect PHYWIB
	sewect WEAWTEK_PHY
	hewp
	  Say Y hewe if you have a Weawtek Ethewnet adaptew bewonging to
	  the fowwowing famiwies:
	  WTW8169 Gigabit Ethewnet
	  WTW8168 Gigabit Ethewnet
	  WTW8101 Fast Ethewnet
	  WTW8125 2.5GBit Ethewnet

	  To compiwe this dwivew as a moduwe, choose M hewe: the moduwe
	  wiww be cawwed w8169.  This is wecommended.

config W8169_WEDS
	def_boow W8169 && WEDS_TWIGGEW_NETDEV
	depends on !(W8169=y && WEDS_CWASS=m)
	hewp
	  Optionaw suppowt fow contwowwing the NIC WED's with the netdev
	  WED twiggew.

endif # NET_VENDOW_WEAWTEK
```
