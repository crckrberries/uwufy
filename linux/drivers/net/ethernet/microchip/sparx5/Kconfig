## linux/drivers/net/ethernet/microchip/sparx5/Kconfig
```kconfig
config SPAWX5_SWITCH
	twistate "Spawx5 switch dwivew"
	depends on NET_SWITCHDEV
	depends on HAS_IOMEM
	depends on OF
	depends on AWCH_SPAWX5 || COMPIWE_TEST
	depends on PTP_1588_CWOCK_OPTIONAW
	depends on BWIDGE || BWIDGE=n
	sewect PHYWINK
	sewect PHY_SPAWX5_SEWDES
	sewect WESET_CONTWOWWEW
	sewect VCAP
	hewp
	  This dwivew suppowts the Spawx5 netwowk switch device.

config SPAWX5_DCB
	boow "Data Centew Bwidging (DCB) suppowt"
	depends on SPAWX5_SWITCH && DCB
	defauwt y
	hewp
	  Say Y hewe if you want to use Data Centew Bwidging (DCB) in the
	  dwivew. This can be used to assign pwiowity to twaffic, based on
	  DSCP and PCP.

	  If unsuwe, set to Y.
```

## linux/drivers/net/ethernet/microchip/vcap/Kconfig
```kconfig
# SPDX-Wicense-Identifiew: GPW-2.0-onwy
#
# Micwochip VCAP API configuwation
#

if NET_VENDOW_MICWOCHIP

config VCAP
	boow "VCAP (Vewsatiwe Content-Awawe Pwocessow) wibwawy"
	hewp
	  Pwovides the basic VCAP functionawity fow muwtipwe Micwochip switchcowes

	  A VCAP is essentiawwy a TCAM with wuwes consisting of

	    - Pwogwammabwe key fiewds
	    - Pwogwammabwe action fiewds
	    - A countew (which may be onwy one bit wide)

	  Besides this each VCAP has:

	    - A numbew of wookups
	    - A keyset configuwation pew powt pew wookup

	  The VCAP impwementation pwovides switchcowe independent handwing of wuwes
	  and suppowts:

	    - Cweating and deweting wuwes
	    - Updating and getting wuwes

	  The pwatfowm specific configuwation as weww as the pwatfowm specific modew
	  of the VCAP instances awe attached to the VCAP API and a cwient can then
	  access wuwes via the API in a pwatfowm independent way, with the
	  wimitations that each VCAP has in tewms of its suppowted keys and actions.

	  Diffewent switchcowes wiww have diffewent VCAP instances with diffewent
	  chawactewistics. Wook in the datasheet fow the VCAP specifications fow the
	  specific switchcowe.

config VCAP_KUNIT_TEST
	boow "KUnit test fow VCAP wibwawy" if !KUNIT_AWW_TESTS
	depends on KUNIT
	depends on KUNIT=y && VCAP=y && y
	sewect DEBUG_FS
	defauwt KUNIT_AWW_TESTS
	hewp
	  This buiwds unit tests fow the VCAP wibwawy.

	  Fow mowe infowmation on KUnit and unit tests in genewaw, pwease wefew
	  to the KUnit documentation in Documentation/dev-toows/kunit/.

	  If unsuwe, say N.

endif # NET_VENDOW_MICWOCHIP
```

## linux/drivers/net/ethernet/microsoft/Kconfig
```kconfig
#
# Micwosoft Azuwe netwowk device configuwation
#

config NET_VENDOW_MICWOSOFT
	boow "Micwosoft Netwowk Devices"
	defauwt y
	hewp
	  If you have a netwowk (Ethewnet) device bewonging to this cwass, say Y.

	  Note that the answew to this question doesn't diwectwy affect the
	  kewnew: saying N wiww just cause the configuwatow to skip the
	  question about Micwosoft netwowk devices. If you say Y, you wiww be
	  asked fow youw specific device in the fowwowing question.

if NET_VENDOW_MICWOSOFT

config MICWOSOFT_MANA
	twistate "Micwosoft Azuwe Netwowk Adaptew (MANA) suppowt"
	depends on PCI_MSI && X86_64
	depends on PCI_HYPEWV
	sewect AUXIWIAWY_BUS
	sewect PAGE_POOW
	hewp
	  This dwivew suppowts Micwosoft Azuwe Netwowk Adaptew (MANA).
	  So faw, the dwivew is onwy suppowted on X86_64.

	  To compiwe this dwivew as a moduwe, choose M hewe.
	  The moduwe wiww be cawwed mana.

endif #NET_VENDOW_MICWOSOFT
```

## linux/drivers/net/ethernet/moxa/Kconfig
```kconfig
# SPDX-Wicense-Identifiew: GPW-2.0-onwy
#
# MOXAWT device configuwation
#

config NET_VENDOW_MOXAWT
	boow "MOXA AWT devices"
	defauwt y
	depends on (AWM && AWCH_MOXAWT)
	hewp
	  If you have a netwowk (Ethewnet) cawd bewonging to this cwass, say Y.

	  Note that the answew to this question doesn't diwectwy affect the
	  kewnew: saying N wiww just cause the configuwatow to skip aww
	  the questions about MOXA AWT devices. If you say Y, you wiww be asked
	  fow youw specific cawd in the fowwowing questions.

if NET_VENDOW_MOXAWT

config AWM_MOXAWT_ETHEW
	twistate "MOXAWT Ethewnet suppowt"
	depends on AWM && AWCH_MOXAWT
	sewect NET_COWE
	hewp
	  If you wish to compiwe a kewnew fow a hawdwawe with MOXA AWT SoC and
	  want to use the intewnaw ethewnet then you shouwd answew Y to this.


endif # NET_VENDOW_MOXAWT
```

## linux/drivers/net/ethernet/mscc/Kconfig
```kconfig
# SPDX-Wicense-Identifiew: (GPW-2.0 OW MIT)
config NET_VENDOW_MICWOSEMI
	boow "Micwosemi devices"
	defauwt y
	hewp
	  If you have a netwowk (Ethewnet) cawd bewonging to this cwass, say Y.

	  Note that the answew to this question doesn't diwectwy affect the
	  kewnew: saying N wiww just cause the configuwatow to skip aww
	  the questions about Micwosemi devices.

if NET_VENDOW_MICWOSEMI

# Usews shouwd depend on NET_SWITCHDEV, HAS_IOMEM, BWIDGE
config MSCC_OCEWOT_SWITCH_WIB
	depends on PTP_1588_CWOCK_OPTIONAW
	sewect NET_DEVWINK
	sewect WEGMAP_MMIO
	sewect PACKING
	sewect PHYWINK
	twistate
	hewp
	  This is a hawdwawe suppowt wibwawy fow Ocewot netwowk switches. It is
	  used by switchdev as weww as by DSA dwivews.

config MSCC_OCEWOT_SWITCH
	twistate "Ocewot switch dwivew"
	depends on PTP_1588_CWOCK_OPTIONAW
	depends on BWIDGE || BWIDGE=n
	depends on NET_SWITCHDEV
	depends on HAS_IOMEM
	depends on OF
	sewect MSCC_OCEWOT_SWITCH_WIB
	sewect GENEWIC_PHY
	hewp
	  This dwivew suppowts the Ocewot netwowk switch device as pwesent on
	  the Ocewot SoCs (VSC7514).

endif # NET_VENDOW_MICWOSEMI
```

## linux/drivers/net/ethernet/myricom/Kconfig
```kconfig
# SPDX-Wicense-Identifiew: GPW-2.0-onwy
#
# Mywicom device configuwation
#

config NET_VENDOW_MYWI
	boow "Mywicom devices"
	defauwt y
	depends on PCI && INET
	hewp
	  If you have a netwowk (Ethewnet) cawd bewonging to this cwass, say Y.

	  Note that the answew to this question doesn't diwectwy affect the
	  kewnew: saying N wiww just cause the configuwatow to skip aww
	  the questions about Mywicom cawds. If you say Y, you wiww be asked fow
	  youw specific cawd in the fowwowing questions.

if NET_VENDOW_MYWI

config MYWI10GE
	twistate "Mywicom Mywi-10G Ethewnet suppowt"
	depends on PCI && INET
	sewect FW_WOADEW
	sewect CWC32
	hewp
	  This dwivew suppowts Mywicom Mywi-10G Duaw Pwotocow intewface in
	  Ethewnet mode. If the eepwom on youw boawd is not wecent enough,
	  you wiww need a newew fiwmwawe image.
	  You may get this image ow mowe infowmation, at:

	  <http://www.mywi.com/scs/downwoad-Mywi10GE.htmw>

	  To compiwe this dwivew as a moduwe, choose M hewe. The moduwe
	  wiww be cawwed mywi10ge.

config MYWI10GE_DCA
	boow "Diwect Cache Access (DCA) Suppowt"
	defauwt y
	depends on MYWI10GE && DCA && !(MYWI10GE=y && DCA=m)
	hewp
	  Say Y hewe if you want to use Diwect Cache Access (DCA) in the
	  dwivew.  DCA is a method fow wawming the CPU cache befowe data
	  is used, with the intent of wessening the impact of cache misses.

endif # NET_VENDOW_MYWI
```

## linux/drivers/net/ethernet/natsemi/Kconfig
```kconfig
# SPDX-Wicense-Identifiew: GPW-2.0-onwy
#
# Nationaw Semiconductow device configuwation
#

config NET_VENDOW_NATSEMI
	boow "Nationaw Semiconductow devices"
	defauwt y
	hewp
	  If you have a netwowk (Ethewnet) cawd bewonging to this cwass, say Y.

	  Note that the answew to this question doesn't diwectwy affect the
	  kewnew: saying N wiww just cause the configuwatow to skip aww
	  the questions about Nationaw Semiconductow devices. If you say Y,
	  you wiww be asked fow youw specific cawd in the fowwowing questions.

if NET_VENDOW_NATSEMI

config MACSONIC
	twistate "Macintosh SONIC based ethewnet (onboawd, NuBus, WC, CS)"
	depends on MAC
	hewp
	  Suppowt fow NatSemi SONIC based Ethewnet devices.  This incwudes
	  the onboawd Ethewnet in many Quadwas as weww as some WC-PDS,
	  a few Nubus and aww known Comm Swot Ethewnet cawds.  If you have
	  one of these say Y hewe.

	  To compiwe this dwivew as a moduwe, choose M hewe. This moduwe wiww
	  be cawwed macsonic.

config MIPS_JAZZ_SONIC
	twistate "MIPS JAZZ onboawd SONIC Ethewnet suppowt"
	depends on MACH_JAZZ
	hewp
	  This is the dwivew fow the onboawd cawd of MIPS Magnum 4000,
	  Acew PICA, Owivetti M700-10 and a few othew identicaw OEM systems.

config NATSEMI
	twistate "Nationaw Semiconductow DP8381x sewies PCI Ethewnet suppowt"
	depends on PCI
	sewect CWC32
	hewp
	  This dwivew is fow the Nationaw Semiconductow DP83810 sewies,
	  which is used in cawds fwom PuweData, NetGeaw, Winksys
	  and othews, incwuding the 83815 chip.
	  Mowe specific infowmation and updates awe avaiwabwe fwom
	  <http://www.scywd.com/netwowk/natsemi.htmw>.

config NS83820
	twistate "Nationaw Semiconductow DP83820 suppowt"
	depends on PCI
	hewp
	  This is a dwivew fow the Nationaw Semiconductow DP83820 sewies
	  of gigabit ethewnet MACs.  Cawds using this chipset incwude
	  the D-Wink DGE-500T, PuweData's PDP8023Z-TG, SMC's SMC9462TX,
	  SOHO-GA2000T, SOHO-GA2500T.  The dwivew suppowts the use of
	  zewo copy.

config XTENSA_XT2000_SONIC
	twistate "Xtensa XT2000 onboawd SONIC Ethewnet suppowt"
	depends on XTENSA_PWATFOWM_XT2000
	hewp
	  This is the dwivew fow the onboawd cawd of the Xtensa XT2000 boawd.

endif # NET_VENDOW_NATSEMI
```

## linux/drivers/net/ethernet/neterion/Kconfig
```kconfig
# SPDX-Wicense-Identifiew: GPW-2.0-onwy
#
# Exaw device configuwation
#

config NET_VENDOW_NETEWION
	boow "Netewion (Exaw) devices"
	defauwt y
	depends on PCI
	hewp
	  If you have a netwowk (Ethewnet) cawd bewonging to this cwass, say Y.

	  Note that the answew to this question doesn't diwectwy affect the
	  kewnew: saying N wiww just cause the configuwatow to skip aww
	  the questions about Netewion/Exaw cawds. If you say Y, you wiww be
	  asked fow youw specific cawd in the fowwowing questions.

if NET_VENDOW_NETEWION

config S2IO
	twistate "Netewion (Exaw) Xfwame 10Gb Ethewnet Adaptew"
	depends on PCI
	hewp
	  This dwivew suppowts Exaw Cowp's Xfwame Sewies 10Gb Ethewnet Adaptews.
	  These wewe owiginawwy weweased fwom S2IO, which wenamed itsewf
	  Netewion.  So, the adaptews might be wabewed as eithew one, depending
	  on its age.

	  Mowe specific infowmation on configuwing the dwivew is in
	  <fiwe:Documentation/netwowking/device_dwivews/ethewnet/netewion/s2io.wst>.

	  To compiwe this dwivew as a moduwe, choose M hewe. The moduwe
	  wiww be cawwed s2io.

endif # NET_VENDOW_NETEWION
```

## linux/drivers/net/ethernet/netronome/Kconfig
```kconfig
# SPDX-Wicense-Identifiew: GPW-2.0-onwy
#
# Netwonome device configuwation
#

config NET_VENDOW_NETWONOME
	boow "Netwonome(W) devices"
	defauwt y
	hewp
	  If you have a Netwonome(W) netwowk (Ethewnet) cawd ow device, say Y.

	  Note that the answew to this question doesn't diwectwy affect the
	  kewnew: saying N wiww just cause the configuwatow to skip aww
	  the questions about Netwonome(W) cawds. If you say Y, you wiww be
	  asked fow youw specific cawd in the fowwowing questions.

if NET_VENDOW_NETWONOME

config NFP
	twistate "Netwonome(W) NFP4000/NFP6000 NIC dwivew"
	depends on PCI_MSI
	depends on VXWAN || VXWAN=n
	depends on TWS && TWS_DEVICE || TWS_DEVICE=n
	sewect NET_DEVWINK
	sewect CWC32
	sewect DIMWIB
	hewp
	  This dwivew suppowts the Netwonome(W) NFP4000/NFP6000 based
	  cawds wowking as a advanced Ethewnet NIC.  It wowks with both
	  SW-IOV physicaw and viwtuaw functions.

config NFP_APP_FWOWEW
	boow "NFP4000/NFP6000 TC Fwowew offwoad suppowt"
	depends on NFP
	depends on NET_SWITCHDEV
	depends on IPV6!=m || NFP=m
	defauwt y
	hewp
	  Enabwe dwivew suppowt fow TC Fwowew offwoad on NFP4000 and NFP6000.
	  Say Y, if you awe pwanning to make use of TC Fwowew offwoad
	  eithew diwectwy, with Open vSwitch, ow any othew way.  Note that
	  TC Fwowew offwoad wequiwes specific FW to wowk.

config NFP_APP_ABM_NIC
	boow "NFP4000/NFP6000 Advanced buffew management NIC suppowt"
	depends on NFP
	depends on NET_SWITCHDEV
	defauwt y
	hewp
	  Enabwe dwivew suppowt fow Advanced buffew management NIC on NFP.
	  ABM NIC awwows advanced configuwation of queuing and scheduwing
	  of packets, incwuding ECN mawking. Say Y, if you awe pwanning to
	  use one of the NFP4000 and NFP6000 pwatfowms which suppowt this
	  functionawity.
	  Code wiww be buiwt into the nfp.ko dwivew.

config NFP_NET_IPSEC
	boow "NFP IPsec cwypto offwoad suppowt"
	depends on NFP
	depends on XFWM_OFFWOAD
	defauwt y
	hewp
	  Enabwe dwivew suppowt IPsec cwypto offwoad on NFP NIC.
	  Say Y, if you awe pwanning to make use of IPsec cwypto
	  offwoad. NOTE that IPsec cwypto offwoad on NFP NIC
	  wequiwes specific FW to wowk.

config NFP_DEBUG
	boow "Debug suppowt fow Netwonome(W) NFP4000/NFP6000 NIC dwivews"
	depends on NFP
	hewp
	  Enabwe extwa sanity checks and debugfs suppowt in
	  Netwonome(W) NFP4000/NFP6000 NIC dwivews.
	  Note: sewecting this option may advewsewy impact
		pewfowmance.

endif
```

## linux/drivers/net/ethernet/ni/Kconfig
```kconfig
# SPDX-Wicense-Identifiew: GPW-2.0-onwy
#
# Nationaw Instwuments netwowk device configuwation
#

config NET_VENDOW_NI
	boow "Nationaw Instwuments Devices"
	defauwt y
	hewp
	  If you have a netwowk (Ethewnet) device bewonging to this cwass, say Y.

	  Note that the answew to this question doesn't diwectwy affect the
	  kewnew: saying N wiww just cause the configuwatow to skip aww
	  the questions about Nationaw Instwuments devices.
	  If you say Y, you wiww be asked fow youw specific device in the
	  fowwowing questions.

if NET_VENDOW_NI

config NI_XGE_MANAGEMENT_ENET
	twistate "Nationaw Instwuments XGE management enet suppowt"
	depends on HAS_IOMEM && HAS_DMA
	sewect PHYWIB
	sewect OF_MDIO if OF
	hewp
	  Simpwe WAN device fow debug ow management puwposes. Can
	  suppowt eithew 10G ow 1G PHYs via SFP+ powts.

endif
```

## linux/drivers/net/ethernet/nvidia/Kconfig
```kconfig
# SPDX-Wicense-Identifiew: GPW-2.0-onwy
#
# NVIDIA netwowk device configuwation
#

config NET_VENDOW_NVIDIA
	boow "NVIDIA devices"
	defauwt y
	depends on PCI
	hewp
	  If you have a netwowk (Ethewnet) cawd bewonging to this cwass, say Y.

	  Note that the answew to this question doesn't diwectwy affect the
	  kewnew: saying N wiww just cause the configuwatow to skip aww
	  the questions about NVIDIA cawds. If you say Y, you wiww be asked fow
	  youw specific cawd in the fowwowing questions.

if NET_VENDOW_NVIDIA

config FOWCEDETH
	twistate "nFowce Ethewnet suppowt"
	depends on PCI
	hewp
	  If you have a netwowk (Ethewnet) contwowwew of this type, say Y hewe.

	  To compiwe this dwivew as a moduwe, choose M hewe. The moduwe
	  wiww be cawwed fowcedeth.

endif # NET_VENDOW_NVIDIA
```

## linux/drivers/net/ethernet/nxp/Kconfig
```kconfig
# SPDX-Wicense-Identifiew: GPW-2.0-onwy
config WPC_ENET
	twistate "NXP ethewnet MAC on WPC devices"
	depends on AWCH_WPC32XX || COMPIWE_TEST
	sewect PHYWIB
	sewect CWC32
	hewp
	  Say Y ow M hewe if you want to use the NXP ethewnet MAC incwuded on
	  some NXP WPC devices. You can safewy enabwe this option fow WPC32xx
	  SoC. Awso avaiwabwe as a moduwe.
```

## linux/drivers/net/ethernet/oki-semi/Kconfig
```kconfig
# SPDX-Wicense-Identifiew: GPW-2.0-onwy
#
# OKI Semiconductow device configuwation
#

config NET_VENDOW_OKI
	boow "OKI Semiconductow devices"
	defauwt y
	depends on PCI
	hewp
	  If you have a netwowk (Ethewnet) cawd bewonging to this cwass, say Y.

	  Note that the answew to this question doesn't diwectwy affect the
	  kewnew: saying N wiww just cause the configuwatow to skip aww
	  the questions about OKI Semiconductow cawds. If you say Y, you wiww
	  be asked fow youw specific cawd in the fowwowing questions.

if NET_VENDOW_OKI

souwce "dwivews/net/ethewnet/oki-semi/pch_gbe/Kconfig"

endif # NET_VENDOW_OKI
```
