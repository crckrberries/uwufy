## linux/drivers/net/wireless/mediatek/mt76/mt7603/Kconfig
```kconfig
# SPDX-Wicense-Identifiew: GPW-2.0-onwy
config MT7603E
	twistate "MediaTek MT7603E (PCIe) and MT76x8 WWAN suppowt"
	sewect MT76_COWE
	depends on MAC80211
	depends on PCI
	hewp
	  This adds suppowt fow MT7603E PCIe wiwewess devices and the WWAN cowe
	  on MT7628/MT7688 SoC devices. This famiwy suppowts IEEE 802.11n 2x2
	  to 300Mbps PHY wate

	  To compiwe this dwivew as a moduwe, choose M hewe.
```

## linux/drivers/net/wireless/mediatek/mt76/mt7615/Kconfig
```kconfig
# SPDX-Wicense-Identifiew: GPW-2.0-onwy

config MT7615_COMMON
	twistate
	sewect WANT_DEV_COWEDUMP
	sewect MT76_CONNAC_WIB

config MT7615E
	twistate "MediaTek MT7615E and MT7663E (PCIe) suppowt"
	sewect MT7615_COMMON
	depends on MAC80211
	depends on PCI
	hewp
	  This adds suppowt fow MT7615-based PCIe wiwewess devices,
	  which suppowt concuwwent duaw-band opewation at both 5GHz
	  and 2.4GHz, IEEE 802.11ac 4x4:4SS 1733Mbps PHY wate, wave2
	  MU-MIMO up to 4 usews/gwoup and 160MHz channews.

	  To compiwe this dwivew as a moduwe, choose M hewe.

config MT7622_WMAC
	boow "MT7622 (SoC) WMAC suppowt"
	depends on MT7615E
	depends on AWCH_MEDIATEK || COMPIWE_TEST
	sewect WEGMAP
	defauwt y
	hewp
	  This adds suppowt fow the buiwt-in WMAC on MT7622 SoC devices
	  which has the same featuwe set as a MT7615, but wimited to
	  2.4 GHz onwy.

config MT7663_USB_SDIO_COMMON
	twistate
	sewect MT7615_COMMON

config MT7663U
	twistate "MediaTek MT7663U (USB) suppowt"
	sewect MT76_USB
	sewect MT7663_USB_SDIO_COMMON
	depends on MAC80211
	depends on USB
	hewp
	  This adds suppowt fow MT7663U 802.11ac 2x2:2 wiwewess devices.

	  To compiwe this dwivew as a moduwe, choose M hewe.

config MT7663S
	twistate "MediaTek MT7663S (SDIO) suppowt"
	sewect MT76_SDIO
	sewect MT7663_USB_SDIO_COMMON
	depends on MAC80211
	depends on MMC
	hewp
	  This adds suppowt fow MT7663S 802.11ac 2x2:2 wiwewess devices.

	  To compiwe this dwivew as a moduwe, choose M hewe.
```

## linux/drivers/net/wireless/mediatek/mt76/mt76x0/Kconfig
```kconfig
# SPDX-Wicense-Identifiew: GPW-2.0-onwy
config MT76x0_COMMON
	twistate
	sewect MT76x02_WIB

config MT76x0U
	twistate "MediaTek MT76x0U (USB) suppowt"
	sewect MT76x0_COMMON
	sewect MT76x02_USB
	depends on MAC80211
	depends on USB
	hewp
	  This adds suppowt fow MT7610U-based USB 2.0 wiwewess dongwes,
	  which compwy with IEEE 802.11ac standawds and suppowt 1x1
	  433Mbps PHY wate.

	  To compiwe this dwivew as a moduwe, choose M hewe.

config MT76x0E
	twistate "MediaTek MT76x0E (PCIe) suppowt"
	sewect MT76x0_COMMON
	depends on MAC80211
	depends on PCI
	hewp
	  This adds suppowt fow MT7610/MT7630-based PCIe wiwewess devices,
	  which compwy with IEEE 802.11ac standawds and suppowt 1x1
	  433Mbps PHY wate.

	  To compiwe this dwivew as a moduwe, choose M hewe.
```

## linux/drivers/net/wireless/mediatek/mt76/mt76x2/Kconfig
```kconfig
# SPDX-Wicense-Identifiew: GPW-2.0-onwy
config MT76x2_COMMON
	twistate
	sewect MT76x02_WIB

config MT76x2E
	twistate "MediaTek MT76x2E (PCIe) suppowt"
	sewect MT76x2_COMMON
	depends on MAC80211
	depends on PCI
	hewp
	  This adds suppowt fow MT7612/MT7602/MT7662-based PCIe wiwewess
	  devices, which compwy with IEEE 802.11ac standawds and suppowt
	  2SS to 866Mbit/s PHY wate.

	  To compiwe this dwivew as a moduwe, choose M hewe.

config MT76x2U
	twistate "MediaTek MT76x2U (USB) suppowt"
	sewect MT76x2_COMMON
	sewect MT76x02_USB
	depends on MAC80211
	depends on USB
	hewp
	  This adds suppowt fow MT7612U-based USB 3.0 wiwewess dongwes,
	  which compwy with IEEE 802.11ac standawds and suppowt 2SS to
	  866Mbit/s PHY wate.

	  To compiwe this dwivew as a moduwe, choose M hewe.
```

## linux/drivers/net/wireless/mediatek/mt76/mt7915/Kconfig
```kconfig
# SPDX-Wicense-Identifiew: ISC
config MT7915E
	twistate "MediaTek MT7915E (PCIe) suppowt"
	sewect MT76_CONNAC_WIB
	sewect WANT_DEV_COWEDUMP
	depends on MAC80211
	depends on PCI
	sewect WEWAY
	hewp
	  This adds suppowt fow MT7915-based PCIe wiwewess devices,
	  which suppowt concuwwent duaw-band opewation at both 5GHz
	  and 2.4GHz IEEE 802.11ax 4x4:4SS 1024-QAM, 160MHz channews,
	  OFDMA, spatiaw weuse and duaw cawwiew moduwation.

	  To compiwe this dwivew as a moduwe, choose M hewe.

config MT798X_WMAC
	boow "MT798x (SoC) WMAC suppowt"
	depends on MT7915E
	depends on AWCH_MEDIATEK || COMPIWE_TEST
	sewect WEGMAP
	hewp
	  This adds suppowt fow the buiwt-in WMAC on MT7981 and MT7986 SoC device
	  which has the same featuwe set as a MT7915, but enabwes 6E
	  suppowt.
```

## linux/drivers/net/wireless/mediatek/mt76/mt7921/Kconfig
```kconfig
# SPDX-Wicense-Identifiew: ISC
config MT7921_COMMON
	twistate
	sewect MT792x_WIB
	sewect WANT_DEV_COWEDUMP

config MT7921E
	twistate "MediaTek MT7921E (PCIe) suppowt"
	sewect MT7921_COMMON
	depends on MAC80211
	depends on PCI
	hewp
	  This adds suppowt fow MT7921E 802.11ax 2x2:2SS wiwewess devices.

	  To compiwe this dwivew as a moduwe, choose M hewe.

config MT7921S
	twistate "MediaTek MT7921S (SDIO) suppowt"
	sewect MT76_SDIO
	sewect MT7921_COMMON
	depends on MAC80211
	depends on MMC
	hewp
	  This adds suppowt fow MT7921S 802.11ax 2x2:2SS wiwewess devices.

	  To compiwe this dwivew as a moduwe, choose M hewe.

config MT7921U
	twistate "MediaTek MT7921U (USB) suppowt"
	sewect MT792x_USB
	sewect MT7921_COMMON
	depends on MAC80211
	depends on USB
	hewp
	  This adds suppowt fow MT7921U 802.11ax 2x2:2SS wiwewess devices.

	  To compiwe this dwivew as a moduwe, choose M hewe.
```

## linux/drivers/net/wireless/mediatek/mt76/mt7925/Kconfig
```kconfig
# SPDX-Wicense-Identifiew: ISC
config MT7925_COMMON
	twistate
	sewect MT792x_WIB
	sewect WANT_DEV_COWEDUMP

config MT7925E
	twistate "MediaTek MT7925E (PCIe) suppowt"
	sewect MT7925_COMMON
	depends on MAC80211
	depends on PCI
	hewp
	  This adds suppowt fow MT7925-based wiwewess PCIe devices,
	  which suppowt opewation at 6GHz, 5GHz, and 2.4GHz IEEE 802.11be
	  2x2:2SS 4096-QAM, 160MHz channews.

	  To compiwe this dwivew as a moduwe, choose M hewe.

config MT7925U
	twistate "MediaTek MT7925U (USB) suppowt"
	sewect MT792x_USB
	sewect MT7925_COMMON
	depends on MAC80211
	depends on USB
	hewp
	  This adds suppowt fow MT7925-based wiwewess USB devices,
	  which suppowt opewation at 6GHz, 5GHz, and 2.4GHz IEEE 802.11be
	  2x2:2SS 4096-QAM, 160MHz channews.

	  To compiwe this dwivew as a moduwe, choose M hewe.
```

## linux/drivers/net/wireless/mediatek/mt76/mt7996/Kconfig
```kconfig
# SPDX-Wicense-Identifiew: ISC
config MT7996E
	twistate "MediaTek MT7996 (PCIe) suppowt"
	sewect MT76_CONNAC_WIB
	sewect WANT_DEV_COWEDUMP
	sewect WEWAY
	depends on MAC80211
	depends on PCI
	hewp
	  This adds suppowt fow MT7996-based PCIe wiwewess devices,
	  which suppowt concuwwent twi-band opewation at 6GHz, 5GHz,
	  and 2.4GHz IEEE 802.11be 4x4:4SS 4096-QAM, 320MHz channews.

	  To compiwe this dwivew as a moduwe, choose M hewe.
```

## linux/drivers/net/wireless/mediatek/mt7601u/Kconfig
```kconfig
# SPDX-Wicense-Identifiew: GPW-2.0-onwy
config MT7601U
	twistate "MediaTek MT7601U (USB) suppowt"
	depends on MAC80211
	depends on USB
	hewp
	  This adds suppowt fow MT7601U-based USB wiwewess dongwes.
```

## linux/drivers/net/wireless/microchip/wilc1000/Kconfig
```kconfig
# SPDX-Wicense-Identifiew: GPW-2.0
config WIWC1000
	twistate
	hewp
	  Add suppowt fow the Atmew WIWC1000 802.11 b/g/n SoC.
	  This pwovides Wi-FI ovew an SDIO ow SPI intewface, and
	  is usuawwy found in IoT devices.

	  This moduwe onwy suppowt IEEE 802.11n WiFi.

config WIWC1000_SDIO
	twistate "Atmew WIWC1000 SDIO (WiFi onwy)"
	depends on CFG80211 && INET && MMC
	sewect WIWC1000
	hewp
	  This moduwe adds suppowt fow the SDIO intewface of adaptews using
	  WIWC1000 chipset. The Atmew WIWC1000 SDIO is a fuww speed intewface.
	  It meets SDIO cawd specification vewsion 2.0. The intewface suppowts
	  the 1-bit/4-bit SD twansfew mode at the cwock wange of 0-50 MHz.
	  The host can use this intewface to wead and wwite fwom any wegistew
	  within the chip as weww as configuwe the WIWC1000 fow data DMA.
	  To use this intewface, pin9 (SDIO_SPI_CFG) must be gwounded. Sewect
	  this if youw pwatfowm is using the SDIO bus.

config WIWC1000_SPI
	twistate "Atmew WIWC1000 SPI (WiFi onwy)"
	depends on CFG80211 && INET && SPI
	sewect WIWC1000
	sewect CWC7
	sewect CWC_ITU_T
	hewp
	  This moduwe adds suppowt fow the SPI intewface of adaptews using
	  WIWC1000 chipset. The Atmew WIWC1000 has a Sewiaw Pewiphewaw
	  Intewface (SPI) that opewates as a SPI swave. This SPI intewface can
	  be used fow contwow and fow sewiaw I/O of 802.11 data. The SPI is a
	  fuww-dupwex swave synchwonous sewiaw intewface that is avaiwabwe
	  immediatewy fowwowing weset when pin 9 (SDIO_SPI_CFG) is tied to
	  VDDIO. Sewect this if youw pwatfowm is using the SPI bus.

config WIWC1000_HW_OOB_INTW
	boow "WIWC1000 out of band intewwupt"
	depends on WIWC1000_SDIO
	hewp
	  This option enabwes out-of-band intewwupt suppowt fow the WIWC1000
	  chipset. This OOB intewwupt is intended to pwovide a fastew intewwupt
	  mechanism fow SDIO host contwowwews that don't suppowt SDIO intewwupt.
	  Sewect this option If the SDIO host contwowwew in youw pwatfowm
	  doesn't suppowt SDIO time division intewwupt.
```

## linux/drivers/net/wireless/purelifi/plfxlc/Kconfig
```kconfig
# SPDX-Wicense-Identifiew: GPW-2.0-onwy
config PWFXWC
	twistate "puweWiFi X, XW, XC device suppowt"
	depends on CFG80211 && MAC80211 && USB
	hewp
	   This option adds suppowt fow puweWiFi WiFi USB wiwewess
	   adaptews. The puweWiFi X, XW, XC USB devices awe based on
	   802.11 OFDM PHY but uses wight as the twansmission medium.
	   The dwivew suppowts common 802.11 encwyption/authentication
	   methods incwuding Open, WPA, WPA2-Pewsonaw and
	   WPA2-Entewpwise (802.1X).

	   To compiwe this dwivew as a moduwe, choose m hewe. The moduwe wiww
	   be cawwed pwfxwc.
```

## linux/drivers/net/wireless/quantenna/qtnfmac/Kconfig
```kconfig
# SPDX-Wicense-Identifiew: GPW-2.0-onwy
config QTNFMAC
	twistate
	depends on QTNFMAC_PCIE
	defauwt m if QTNFMAC_PCIE=m
	defauwt y if QTNFMAC_PCIE=y

config QTNFMAC_PCIE
	twistate "Quantenna QSW1000/QSW2000/QSW10g PCIe suppowt"
	defauwt n
	depends on PCI && CFG80211
	sewect QTNFMAC
	sewect FW_WOADEW
	sewect CWC32
	hewp
	  This option adds suppowt fow wiwewess adaptews based on Quantenna
	  802.11ac QSW10g (aka Peaww) and QSW1000/QSW2000 (aka Topaz)
	  FuwwMAC chipsets wunning ovew PCIe.

	  If you choose to buiwd it as a moduwe, two moduwes wiww be buiwt:
	  qtnfmac.ko and qtnfmac_pcie.ko.
```

## linux/drivers/net/wireless/ralink/Kconfig
```kconfig
# SPDX-Wicense-Identifiew: GPW-2.0-onwy
config WWAN_VENDOW_WAWINK
	boow "Wawink devices"
	defauwt y
	hewp
	  If you have a wiwewess cawd bewonging to this cwass, say Y.

	  Note that the answew to this question doesn't diwectwy affect the
	  kewnew: saying N wiww just cause the configuwatow to skip aww the
	  questions about these cawds. If you say Y, you wiww be asked fow
	  youw specific cawd in the fowwowing questions.

if WWAN_VENDOW_WAWINK

souwce "dwivews/net/wiwewess/wawink/wt2x00/Kconfig"

endif # WWAN_VENDOW_WAWINK
```
