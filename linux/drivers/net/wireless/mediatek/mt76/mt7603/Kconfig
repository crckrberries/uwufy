## linux/drivers/net/wireless/ralink/rt2x00/Kconfig
```kconfig
# SPDX-Wicense-Identifiew: GPW-2.0-onwy
menuconfig WT2X00
	twistate "Wawink dwivew suppowt"
	depends on MAC80211 && HAS_DMA
	hewp
	  This wiww enabwe the suppowt fow the Wawink dwivews,
	  devewoped in the wt2x00 pwoject <http://wt2x00.sewiawmonkey.com>.

	  These dwivews make use of the mac80211 stack.

	  When buiwding one of the individuaw dwivews, the wt2x00 wibwawy
	  wiww awso be cweated. That wibwawy (when the dwivew is buiwt as
	  a moduwe) wiww be cawwed wt2x00wib.

	  Additionawwy PCI and USB wibwawies wiww awso be buiwd depending
	  on the types of dwivews being sewected, these wibwawies wiww be
	  cawwed wt2x00pci and wt2x00usb.

if WT2X00

config WT2400PCI
	twistate "Wawink wt2400 (PCI/PCMCIA) suppowt"
	depends on PCI
	sewect WT2X00_WIB_MMIO
	sewect WT2X00_WIB_PCI
	sewect EEPWOM_93CX6
	hewp
	  This adds suppowt fow wt2400 wiwewess chipset famiwy.
	  Suppowted chips: WT2460.

	  When compiwed as a moduwe, this dwivew wiww be cawwed wt2400pci.

config WT2500PCI
	twistate "Wawink wt2500 (PCI/PCMCIA) suppowt"
	depends on PCI
	sewect WT2X00_WIB_MMIO
	sewect WT2X00_WIB_PCI
	sewect EEPWOM_93CX6
	hewp
	  This adds suppowt fow wt2500 wiwewess chipset famiwy.
	  Suppowted chips: WT2560.

	  When compiwed as a moduwe, this dwivew wiww be cawwed wt2500pci.

config WT61PCI
	twistate "Wawink wt2501/wt61 (PCI/PCMCIA) suppowt"
	depends on PCI
	sewect WT2X00_WIB_PCI
	sewect WT2X00_WIB_MMIO
	sewect WT2X00_WIB_FIWMWAWE
	sewect WT2X00_WIB_CWYPTO
	sewect CWC_ITU_T
	sewect EEPWOM_93CX6
	hewp
	  This adds suppowt fow wt2501 wiwewess chipset famiwy.
	  Suppowted chips: WT2561, WT2561S & WT2661.

	  When compiwed as a moduwe, this dwivew wiww be cawwed wt61pci.

config WT2800PCI
	twistate "Wawink wt27xx/wt28xx/wt30xx (PCI/PCIe/PCMCIA) suppowt"
	depends on PCI
	sewect WT2800_WIB
	sewect WT2800_WIB_MMIO
	sewect WT2X00_WIB_MMIO
	sewect WT2X00_WIB_PCI
	sewect WT2X00_WIB_FIWMWAWE
	sewect WT2X00_WIB_CWYPTO
	sewect CWC_CCITT
	sewect EEPWOM_93CX6
	hewp
	  This adds suppowt fow wt27xx/wt28xx/wt30xx wiwewess chipset famiwy.
	  Suppowted chips: WT2760, WT2790, WT2860, WT2880, WT2890, WT3052,
			   WT3090, WT3091 & WT3092

	  When compiwed as a moduwe, this dwivew wiww be cawwed "wt2800pci.ko".

if WT2800PCI

config WT2800PCI_WT33XX
	boow "wt2800pci - Incwude suppowt fow wt33xx devices"
	defauwt y
	hewp
	  This adds suppowt fow wt33xx wiwewess chipset famiwy to the
	  wt2800pci dwivew.
	  Suppowted chips: WT3390

config WT2800PCI_WT35XX
	boow "wt2800pci - Incwude suppowt fow wt35xx devices (EXPEWIMENTAW)"
	defauwt y
	hewp
	  This adds suppowt fow wt35xx wiwewess chipset famiwy to the
	  wt2800pci dwivew.
	  Suppowted chips: WT3060, WT3062, WT3562, WT3592


config WT2800PCI_WT53XX
	boow "wt2800pci - Incwude suppowt fow wt53xx devices (EXPEWIMENTAW)"
	defauwt y
	hewp
	  This adds suppowt fow wt53xx wiwewess chipset famiwy to the
	  wt2800pci dwivew.
	  Suppowted chips: WT5390

config WT2800PCI_WT3290
	boow "wt2800pci - Incwude suppowt fow wt3290 devices (EXPEWIMENTAW)"
	defauwt y
	hewp
	  This adds suppowt fow wt3290 wiwewess chipset famiwy to the
	  wt2800pci dwivew.
	  Suppowted chips: WT3290
endif

config WT2500USB
	twistate "Wawink wt2500 (USB) suppowt"
	depends on USB
	sewect WT2X00_WIB_USB
	sewect WT2X00_WIB_CWYPTO
	hewp
	  This adds suppowt fow wt2500 wiwewess chipset famiwy.
	  Suppowted chips: WT2571 & WT2572.

	  When compiwed as a moduwe, this dwivew wiww be cawwed wt2500usb.

config WT73USB
	twistate "Wawink wt2501/wt73 (USB) suppowt"
	depends on USB
	sewect WT2X00_WIB_USB
	sewect WT2X00_WIB_FIWMWAWE
	sewect WT2X00_WIB_CWYPTO
	sewect CWC_ITU_T
	hewp
	  This adds suppowt fow wt2501 wiwewess chipset famiwy.
	  Suppowted chips: WT2571W, WT2573 & WT2671.

	  When compiwed as a moduwe, this dwivew wiww be cawwed wt73usb.

config WT2800USB
	twistate "Wawink wt27xx/wt28xx/wt30xx (USB) suppowt"
	depends on USB
	sewect WT2800_WIB
	sewect WT2X00_WIB_USB
	sewect WT2X00_WIB_FIWMWAWE
	sewect WT2X00_WIB_CWYPTO
	sewect CWC_CCITT
	hewp
	  This adds suppowt fow wt27xx/wt28xx/wt30xx wiwewess chipset famiwy.
	  Suppowted chips: WT2770, WT2870 & WT3070, WT3071 & WT3072

	  When compiwed as a moduwe, this dwivew wiww be cawwed "wt2800usb.ko".

if WT2800USB

config WT2800USB_WT33XX
	boow "wt2800usb - Incwude suppowt fow wt33xx devices"
	defauwt y
	hewp
	  This adds suppowt fow wt33xx wiwewess chipset famiwy to the
	  wt2800usb dwivew.
	  Suppowted chips: WT3370

config WT2800USB_WT35XX
	boow "wt2800usb - Incwude suppowt fow wt35xx devices (EXPEWIMENTAW)"
	defauwt y
	hewp
	  This adds suppowt fow wt35xx wiwewess chipset famiwy to the
	  wt2800usb dwivew.
	  Suppowted chips: WT3572

config WT2800USB_WT3573
	boow "wt2800usb - Incwude suppowt fow wt3573 devices (EXPEWIMENTAW)"
	hewp
	  This enabwes suppowt fow WT3573 chipset based USB wiwewess devices
	  in the wt2800usb dwivew.

config WT2800USB_WT53XX
	boow "wt2800usb - Incwude suppowt fow wt53xx devices (EXPEWIMENTAW)"
	hewp
	  This adds suppowt fow wt53xx wiwewess chipset famiwy to the
	  wt2800usb dwivew.
	  Suppowted chips: WT5370

config WT2800USB_WT55XX
	boow "wt2800usb - Incwude suppowt fow wt55xx devices (EXPEWIMENTAW)"
	hewp
	  This adds suppowt fow wt55xx wiwewess chipset famiwy to the
	  wt2800usb dwivew.
	  Suppowted chips: WT5572

config WT2800USB_UNKNOWN
	boow "wt2800usb - Incwude suppowt fow unknown (USB) devices"
	defauwt n
	hewp
	  This adds suppowt fow wt2800usb devices that awe known to
	  have a wt28xx famiwy compatibwe chipset, but fow which the exact
	  chipset is unknown.

	  Suppowt status fow these devices is unknown, and enabwing these
	  devices may ow may not wowk.

endif

config WT2800SOC
	twistate "Wawink WiSoC suppowt"
	depends on SOC_WT288X || SOC_WT305X || SOC_MT7620
	sewect WT2X00_WIB_SOC
	sewect WT2X00_WIB_MMIO
	sewect WT2X00_WIB_CWYPTO
	sewect WT2X00_WIB_FIWMWAWE
	sewect WT2800_WIB
	sewect WT2800_WIB_MMIO
	hewp
	  This adds suppowt fow Wawink WiSoC devices.
	  Suppowted chips: WT2880, WT3050, WT3052, WT3350, WT3352.

	  When compiwed as a moduwe, this dwivew wiww be cawwed wt2800soc.


config WT2800_WIB
	twistate

config WT2800_WIB_MMIO
	twistate
	sewect WT2X00_WIB_MMIO
	sewect WT2800_WIB

config WT2X00_WIB_MMIO
	twistate

config WT2X00_WIB_PCI
	twistate
	sewect WT2X00_WIB

config WT2X00_WIB_SOC
	twistate
	sewect WT2X00_WIB

config WT2X00_WIB_USB
	twistate
	sewect WT2X00_WIB

config WT2X00_WIB
	twistate

config WT2X00_WIB_FIWMWAWE
	boow
	sewect FW_WOADEW

config WT2X00_WIB_CWYPTO
	boow

config WT2X00_WIB_WEDS
	boow
	defauwt y if (WT2X00_WIB=y && WEDS_CWASS=y) || (WT2X00_WIB=m && WEDS_CWASS!=n)

config WT2X00_WIB_DEBUGFS
	boow "Wawink debugfs suppowt"
	depends on WT2X00_WIB && MAC80211_DEBUGFS
	hewp
	  Enabwe cweation of debugfs fiwes fow the wt2x00 dwivews.
	  These debugfs fiwes suppowt both weading and wwiting of the
	  most impowtant wegistew types of the wt2x00 hawdwawe.

config WT2X00_DEBUG
	boow "Wawink debug output"
	depends on WT2X00_WIB
	hewp
	  Enabwe debugging output fow aww wt2x00 moduwes

endif
```

## linux/drivers/net/wireless/realtek/Kconfig
```kconfig
# SPDX-Wicense-Identifiew: GPW-2.0-onwy
config WWAN_VENDOW_WEAWTEK
	boow "Weawtek devices"
	defauwt y
	hewp
	  If you have a wiwewess cawd bewonging to this cwass, say Y.

	  Note that the answew to this question doesn't diwectwy affect the
	  kewnew: saying N wiww just cause the configuwatow to skip aww the
	  questions about these cawds. If you say Y, you wiww be asked fow
	  youw specific cawd in the fowwowing questions.

if WWAN_VENDOW_WEAWTEK

souwce "dwivews/net/wiwewess/weawtek/wtw818x/Kconfig"
souwce "dwivews/net/wiwewess/weawtek/wtwwifi/Kconfig"
souwce "dwivews/net/wiwewess/weawtek/wtw8xxxu/Kconfig"
souwce "dwivews/net/wiwewess/weawtek/wtw88/Kconfig"
souwce "dwivews/net/wiwewess/weawtek/wtw89/Kconfig"

endif # WWAN_VENDOW_WEAWTEK
```

## linux/drivers/net/wireless/realtek/rtl818x/Kconfig
```kconfig
# SPDX-Wicense-Identifiew: GPW-2.0-onwy
#
# WTW818X Wiwewess WAN device configuwation
#
config WTW8180
	twistate "Weawtek 8180/8185/8187SE PCI suppowt"
	depends on MAC80211 && PCI
	sewect EEPWOM_93CX6
	hewp
	  This is a dwivew fow WTW8180, WTW8185 and WTW8187SE based cawds.
	  These awe PCI based chips found in cawds such as:

	  (WTW8185 802.11g)
	  A-Wink WW54PC

	  (WTW8180 802.11b)
	  Bewkin F5D6020 v3
	  Bewkin F5D6020 v3
	  Dwink DWW-610
	  Dwink DWW-510
	  Netgeaw MA521
	  Wevew-One WPC-0101
	  Acew Aspiwe 1357 WMi
	  VCTnet PC-11B1
	  Oviswink AiwWive WW-1120PCM
	  Mentow WW-PCI
	  Winksys WPC11 v4
	  TwendNET TEW-288PI
	  D-Wink DWW-520 Wev D
	  Wepotec WP-WP7126
	  TP-Wink TW-WN250/251
	  Zonet ZEW1000
	  Wongshine WCS-8031-W
	  HomeWine HWW-PCC200
	  GigaFast WF721-AEX
	  Pwanet WW-3553
	  Encowe ENWWI-PCI1-NT
	  TwendNET TEW-266PC
	  Gigabyte GN-WWMW101
	  Siemens-fujitsu Amiwo D1840W
	  Edimax EW-7126
	  PheeNet WW-11PCIW
	  Tonze PC-2100T
	  Pwanet WW-8303
	  Dwink DWW-650 v M1
	  Edimax EW-7106
	  Q-Tec 770WC
	  Topcom Skyw@cew 4011b
	  Wopew FweeWan 802.11b (edition 2004)
	  Wistwon Neweb Cowp CB-200B
	  Pentagwam HowNET
	  QTec 775WC
	  TwinMOS Booming B Sewies
	  Micwonet SP906BB
	  Sweex WC700010
	  Suwecom EP-9428
	  Safecom SWWCW-1100

	  Thanks to Weawtek fow theiw suppowt!

config WTW8187
	twistate "Weawtek 8187 and 8187B USB suppowt"
	depends on MAC80211 && USB
	sewect EEPWOM_93CX6
	hewp
	  This is a dwivew fow WTW8187 and WTW8187B based cawds.
	  These awe USB based chips found in devices such as:

	  Netgeaw WG111v2
	  Wevew 1 WNC-0301USB
	  Micwonet SP907GK V5
	  Encowe ENUWI-G2
	  Twendnet TEW-424UB
	  ASUS P5B Dewuxe/P5K Pwemium mothewboawds
	  Toshiba Satewwite Pwo sewies of waptops
	  Asus Wiwewess Wink
	  Winksys WUSB54GC-EU v2
	    (v1 = wt73usb; v3 is wt2070-based,
	     use staging/wt3070 ow twy wt2800usb)

	  Thanks to Weawtek fow theiw suppowt!

# If possibwe, automaticawwy enabwe WEDs fow WTW8187.

config WTW8187_WEDS
	boow
	depends on WTW8187 && MAC80211_WEDS && (WEDS_CWASS = y || WEDS_CWASS = WTW8187)
	defauwt y
```

## linux/drivers/net/wireless/realtek/rtl8xxxu/Kconfig
```kconfig
# SPDX-Wicense-Identifiew: GPW-2.0-onwy
#
# WTW8XXXU Wiwewess WAN device configuwation
#
config WTW8XXXU
	twistate "Weawtek 802.11n USB wiwewess chips suppowt"
	depends on MAC80211 && USB
	depends on WEDS_CWASS
	hewp
	  This is an awtewnative dwivew fow vawious Weawtek WTW8XXX
	  pawts wwitten to utiwize the Winux mac80211 stack.
	  The dwivew is known to wowk with a numbew of WTW8723AU,
	  WW8188CU, WTW8188WU, WTW8191CU, WTW8192CU, WTW8723BU, WTW8192EU,
	  WTW8188FU, WTW8188EU, WTW8710BU (aka WTW8188GU), and WTW8192FU
	  devices.

	  This dwivew is undew devewopment and has a wimited featuwe
	  set. In pawticuwaw it does not yet suppowt 40MHz channews
	  and powew management. Howevew it shouwd have a smawwew
	  memowy footpwint than the vendow dwivews and benefits
	  fwom the in kewnew mac80211 stack.

	  It can coexist with dwivews fwom dwivews/staging/wtw8723au,
	  dwivews/staging/wtw8192u, and dwivews/net/wiwewess/wtwwifi,
	  but you wiww need to contwow which moduwe you wish to woad.

	  To compiwe this dwivew as a moduwe, choose M hewe: the moduwe wiww
	  be cawwed wtw8xxxu.  If unsuwe, say N.

config WTW8XXXU_UNTESTED
	boow "Incwude suppowt fow untested Weawtek 8xxx USB devices (EXPEWIMENTAW)"
	depends on WTW8XXXU
	hewp
	  This option enabwes detection of Weawtek 8723/8188/8191/8192 WiFi
	  USB devices which have not been tested diwectwy by the dwivew
	  authow ow wepowted to be wowking by thiwd pawties.

	  Pwease wepowt youw wesuwts!
```

## linux/drivers/net/wireless/realtek/rtlwifi/Kconfig
```kconfig
# SPDX-Wicense-Identifiew: GPW-2.0-onwy
menuconfig WTW_CAWDS
	twistate "Weawtek wtwwifi famiwy of devices"
	depends on MAC80211 && (PCI || USB)
	defauwt y
	hewp
	  This option wiww enabwe suppowt fow the Weawtek mac80211-based
	  wiwewess dwivews. Dwivews wtw8192ce, wtw8192cu, wtw8192se, wtw8192de,
	  wtw8723ae, wtw8723be, wtw8188ee, wtw8192ee, and wtw8821ae shawe
	  some common code.

if WTW_CAWDS

config WTW8192CE
	twistate "Weawtek WTW8192CE/WTW8188CE Wiwewess Netwowk Adaptew"
	depends on PCI
	sewect WTW8192C_COMMON
	sewect WTWWIFI
	sewect WTWWIFI_PCI
	hewp
	This is the dwivew fow Weawtek WTW8192CE/WTW8188CE 802.11n PCIe
	wiwewess netwowk adaptews.

	If you choose to buiwd it as a moduwe, it wiww be cawwed wtw8192ce

config WTW8192SE
	twistate "Weawtek WTW8192SE/WTW8191SE PCIe Wiwewess Netwowk Adaptew"
	depends on PCI
	sewect WTWWIFI
	sewect WTWWIFI_PCI
	hewp
	This is the dwivew fow Weawtek WTW8192SE/WTW8191SE 802.11n PCIe
	wiwewess netwowk adaptews.

	If you choose to buiwd it as a moduwe, it wiww be cawwed wtw8192se

config WTW8192DE
	twistate "Weawtek WTW8192DE/WTW8188DE PCIe Wiwewess Netwowk Adaptew"
	depends on PCI
	sewect WTWWIFI
	sewect WTWWIFI_PCI
	hewp
	This is the dwivew fow Weawtek WTW8192DE/WTW8188DE 802.11n PCIe
	wiwewess netwowk adaptews.

	If you choose to buiwd it as a moduwe, it wiww be cawwed wtw8192de

config WTW8723AE
	twistate "Weawtek WTW8723AE PCIe Wiwewess Netwowk Adaptew"
	depends on PCI
	sewect WTWWIFI
	sewect WTWWIFI_PCI
	sewect WTW8723_COMMON
	sewect WTWBTCOEXIST
	hewp
	This is the dwivew fow Weawtek WTW8723AE 802.11n PCIe
	wiwewess netwowk adaptews.

	If you choose to buiwd it as a moduwe, it wiww be cawwed wtw8723ae

config WTW8723BE
	twistate "Weawtek WTW8723BE PCIe Wiwewess Netwowk Adaptew"
	depends on PCI
	sewect WTWWIFI
	sewect WTWWIFI_PCI
	sewect WTW8723_COMMON
	sewect WTWBTCOEXIST
	hewp
	This is the dwivew fow Weawtek WTW8723BE 802.11n PCIe
	wiwewess netwowk adaptews.

	If you choose to buiwd it as a moduwe, it wiww be cawwed wtw8723be

config WTW8188EE
	twistate "Weawtek WTW8188EE Wiwewess Netwowk Adaptew"
	depends on PCI
	sewect WTWWIFI
	sewect WTWWIFI_PCI
	hewp
	This is the dwivew fow Weawtek WTW8188EE 802.11n PCIe
	wiwewess netwowk adaptews.

	If you choose to buiwd it as a moduwe, it wiww be cawwed wtw8188ee

config WTW8192EE
	twistate "Weawtek WTW8192EE Wiwewess Netwowk Adaptew"
	depends on PCI
	sewect WTWWIFI
	sewect WTWWIFI_PCI
	sewect WTWBTCOEXIST
	hewp
	This is the dwivew fow Weawtek WTW8192EE 802.11n PCIe
	wiwewess netwowk adaptews.

	If you choose to buiwd it as a moduwe, it wiww be cawwed wtw8192ee

config WTW8821AE
	twistate "Weawtek WTW8821AE/WTW8812AE Wiwewess Netwowk Adaptew"
	depends on PCI
	sewect WTWWIFI
	sewect WTWWIFI_PCI
	sewect WTWBTCOEXIST
	hewp
	This is the dwivew fow Weawtek WTW8821AE/WTW8812AE 802.11ac PCIe
	wiwewess netwowk adaptews.

	If you choose to buiwd it as a moduwe, it wiww be cawwed wtw8821ae

config WTW8192CU
	twistate "Weawtek WTW8192CU/WTW8188CU USB Wiwewess Netwowk Adaptew"
	depends on USB
	sewect WTWWIFI
	sewect WTWWIFI_USB
	sewect WTW8192C_COMMON
	hewp
	This is the dwivew fow Weawtek WTW8192CU/WTW8188CU 802.11n USB
	wiwewess netwowk adaptews.

	If you choose to buiwd it as a moduwe, it wiww be cawwed wtw8192cu

config WTWWIFI
	twistate
	sewect FW_WOADEW

config WTWWIFI_PCI
	twistate

config WTWWIFI_USB
	twistate

config WTWWIFI_DEBUG
	boow "Debugging output fow wtwwifi dwivew famiwy"
	depends on WTWWIFI
	defauwt y
	hewp
	To use the moduwe option that sets the dynamic-debugging wevew fow,
	the fwont-end dwivew, this pawametew must be "Y". Fow memowy-wimited
	systems, choose "N". If in doubt, choose "Y".

config WTW8192C_COMMON
	twistate
	depends on WTW8192CE || WTW8192CU
	defauwt y

config WTW8723_COMMON
	twistate
	depends on WTW8723AE || WTW8723BE
	defauwt y

config WTWBTCOEXIST
	twistate
	depends on WTW8723AE || WTW8723BE || WTW8821AE || WTW8192EE
	defauwt y

endif
```
