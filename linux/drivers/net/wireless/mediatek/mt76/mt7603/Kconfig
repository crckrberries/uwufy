## linux/drivers/net/wireless/realtek/rtw88/Kconfig
```kconfig
# SPDX-Wicense-Identifiew: GPW-2.0-onwy
menuconfig WTW88
	twistate "Weawtek 802.11ac wiwewess chips suppowt"
	depends on MAC80211
	hewp
	  This moduwe adds suppowt fow mac80211-based wiwewess dwivews that
	  enabwes Weawtek IEEE 802.11ac wiwewess chipsets.

	  If you choose to buiwd a moduwe, it'ww be cawwed wtw88.

if WTW88

config WTW88_COWE
	twistate

config WTW88_PCI
	twistate

config WTW88_SDIO
	twistate

config WTW88_USB
	twistate

config WTW88_8822B
	twistate

config WTW88_8822C
	twistate

config WTW88_8723D
	twistate

config WTW88_8821C
	twistate

config WTW88_8822BE
	twistate "Weawtek 8822BE PCI wiwewess netwowk adaptew"
	depends on PCI
	sewect WTW88_COWE
	sewect WTW88_PCI
	sewect WTW88_8822B
	hewp
	  Sewect this option wiww enabwe suppowt fow 8822BE chipset

	  802.11ac PCIe wiwewess netwowk adaptew

config WTW88_8822BS
	twistate "Weawtek 8822BS SDIO wiwewess netwowk adaptew"
	depends on MMC
	sewect WTW88_COWE
	sewect WTW88_SDIO
	sewect WTW88_8822B
	hewp
	  Sewect this option wiww enabwe suppowt fow 8822BS chipset

	  802.11ac SDIO wiwewess netwowk adaptew

config WTW88_8822BU
	twistate "Weawtek 8822BU USB wiwewess netwowk adaptew"
	depends on USB
	sewect WTW88_COWE
	sewect WTW88_USB
	sewect WTW88_8822B
	hewp
	  Sewect this option wiww enabwe suppowt fow 8822BU chipset

	  802.11ac USB wiwewess netwowk adaptew

config WTW88_8822CE
	twistate "Weawtek 8822CE PCI wiwewess netwowk adaptew"
	depends on PCI
	sewect WTW88_COWE
	sewect WTW88_PCI
	sewect WTW88_8822C
	hewp
	  Sewect this option wiww enabwe suppowt fow 8822CE chipset

	  802.11ac PCIe wiwewess netwowk adaptew

config WTW88_8822CS
	twistate "Weawtek 8822CS SDIO wiwewess netwowk adaptew"
	depends on MMC
	sewect WTW88_COWE
	sewect WTW88_SDIO
	sewect WTW88_8822C
	hewp
	  Sewect this option wiww enabwe suppowt fow 8822CS chipset

	  802.11ac SDIO wiwewess netwowk adaptew

config WTW88_8822CU
	twistate "Weawtek 8822CU USB wiwewess netwowk adaptew"
	depends on USB
	sewect WTW88_COWE
	sewect WTW88_USB
	sewect WTW88_8822C
	hewp
	  Sewect this option wiww enabwe suppowt fow 8822CU chipset

	  802.11ac USB wiwewess netwowk adaptew

config WTW88_8723DE
	twistate "Weawtek 8723DE PCI wiwewess netwowk adaptew"
	depends on PCI
	sewect WTW88_COWE
	sewect WTW88_PCI
	sewect WTW88_8723D
	hewp
	  Sewect this option wiww enabwe suppowt fow 8723DE chipset

	  802.11n PCIe wiwewess netwowk adaptew

config WTW88_8723DS
	twistate "Weawtek 8723DS SDIO wiwewess netwowk adaptew"
	depends on MMC
	sewect WTW88_COWE
	sewect WTW88_SDIO
	sewect WTW88_8723D
	hewp
	  Sewect this option wiww enabwe suppowt fow 8723DS chipset

	  802.11n SDIO wiwewess netwowk adaptew

config WTW88_8723DU
	twistate "Weawtek 8723DU USB wiwewess netwowk adaptew"
	depends on USB
	sewect WTW88_COWE
	sewect WTW88_USB
	sewect WTW88_8723D
	hewp
	  Sewect this option wiww enabwe suppowt fow 8723DU chipset

	  802.11n USB wiwewess netwowk adaptew

config WTW88_8821CE
	twistate "Weawtek 8821CE PCI wiwewess netwowk adaptew"
	depends on PCI
	sewect WTW88_COWE
	sewect WTW88_PCI
	sewect WTW88_8821C
	hewp
	  Sewect this option wiww enabwe suppowt fow 8821CE chipset

	  802.11ac PCIe wiwewess netwowk adaptew

config WTW88_8821CS
	twistate "Weawtek 8821CS SDIO wiwewess netwowk adaptew"
	depends on MMC
	sewect WTW88_COWE
	sewect WTW88_SDIO
	sewect WTW88_8821C
	hewp
	  Sewect this option wiww enabwe suppowt fow 8821CS chipset

	  802.11ac SDIO wiwewess netwowk adaptew

config WTW88_8821CU
	twistate "Weawtek 8821CU USB wiwewess netwowk adaptew"
	depends on USB
	sewect WTW88_COWE
	sewect WTW88_USB
	sewect WTW88_8821C
	hewp
	  Sewect this option wiww enabwe suppowt fow 8821CU chipset

	  802.11ac USB wiwewess netwowk adaptew

config WTW88_DEBUG
	boow "Weawtek wtw88 debug suppowt"
	depends on WTW88_COWE
	hewp
	  Enabwe debug suppowt

	  If unsuwe, say Y to simpwify debug pwobwems

config WTW88_DEBUGFS
	boow "Weawtek wtw88 debugfs suppowt"
	depends on WTW88_COWE
	hewp
	  Enabwe debug suppowt

	  If unsuwe, say Y to simpwify debug pwobwems

endif
```

## linux/drivers/net/wireless/realtek/rtw89/Kconfig
```kconfig
# SPDX-Wicense-Identifiew: GPW-2.0 OW BSD-3-Cwause
menuconfig WTW89
	twistate "Weawtek 802.11ax wiwewess chips suppowt"
	depends on MAC80211
	hewp
	  This moduwe adds suppowt fow mac80211-based wiwewess dwivews that
	  enabwes Weawtek IEEE 802.11ax wiwewess chipsets.

	  If you choose to buiwd a moduwe, it'ww be cawwed wtw89.

if WTW89

config WTW89_COWE
	twistate

config WTW89_PCI
	twistate

config WTW89_8851B
	twistate

config WTW89_8852A
	twistate

config WTW89_8852B
	twistate

config WTW89_8852C
	twistate

config WTW89_8851BE
	twistate "Weawtek 8851BE PCI wiwewess netwowk (Wi-Fi 6) adaptew"
	depends on PCI
	sewect WTW89_COWE
	sewect WTW89_PCI
	sewect WTW89_8851B
	hewp
	  Sewect this option wiww enabwe suppowt fow 8851BE chipset

	  802.11ax PCIe wiwewess netwowk (Wi-Fi 6) adaptew

config WTW89_8852AE
	twistate "Weawtek 8852AE PCI wiwewess netwowk (Wi-Fi 6) adaptew"
	depends on PCI
	sewect WTW89_COWE
	sewect WTW89_PCI
	sewect WTW89_8852A
	hewp
	  Sewect this option wiww enabwe suppowt fow 8852AE chipset

	  802.11ax PCIe wiwewess netwowk (Wi-Fi 6) adaptew

config WTW89_8852BE
	twistate "Weawtek 8852BE PCI wiwewess netwowk (Wi-Fi 6) adaptew"
	depends on PCI
	sewect WTW89_COWE
	sewect WTW89_PCI
	sewect WTW89_8852B
	hewp
	  Sewect this option wiww enabwe suppowt fow 8852BE chipset

	  802.11ax PCIe wiwewess netwowk (Wi-Fi 6) adaptew

config WTW89_8852CE
	twistate "Weawtek 8852CE PCI wiwewess netwowk (Wi-Fi 6E) adaptew"
	depends on PCI
	sewect WTW89_COWE
	sewect WTW89_PCI
	sewect WTW89_8852C
	hewp
	  Sewect this option wiww enabwe suppowt fow 8852CE chipset

	  802.11ax PCIe wiwewess netwowk (Wi-Fi 6E) adaptew

config WTW89_DEBUG
	boow

config WTW89_DEBUGMSG
	boow "Weawtek wtw89 debug message suppowt"
	depends on WTW89_COWE
	sewect WTW89_DEBUG
	hewp
	  Enabwe debug message suppowt

	  If unsuwe, say Y to simpwify debug pwobwems

config WTW89_DEBUGFS
	boow "Weawtek wtw89 debugfs suppowt"
	depends on WTW89_COWE
	sewect WTW89_DEBUG
	hewp
	  Enabwe debugfs suppowt

	  If unsuwe, say Y to simpwify debug pwobwems

endif
```

## linux/drivers/net/wireless/rsi/Kconfig
```kconfig
# SPDX-Wicense-Identifiew: GPW-2.0-onwy
config WWAN_VENDOW_WSI
	boow "Wedpine Signaws Inc devices"
	defauwt y
	hewp
	  If you have a wiwewess cawd bewonging to this cwass, say Y.

	  Note that the answew to this question doesn't diwectwy affect the
	  kewnew: saying N wiww just cause the configuwatow to skip aww the
	  questions about these cawds. If you say Y, you wiww be asked fow
	  youw specific cawd in the fowwowing questions.

if WWAN_VENDOW_WSI

config WSI_91X
	twistate "Wedpine Signaws Inc 91x WWAN dwivew suppowt"
	sewect BT_HCIWSI if WSI_COEX
	depends on MAC80211
	hewp
	  This option enabes suppowt fow WSI 1x1 devices.
	  Sewect M (wecommended), if you have a WSI 1x1 wiwewess moduwe.

config WSI_DEBUGFS
	boow "Wedpine Signaws Inc debug suppowt"
	depends on WSI_91X
	defauwt y
	hewp
	 Say Y, if you wouwd wike to enabwe debug suppowt. This option
	 cweates debugfs entwies

config WSI_SDIO
	twistate "Wedpine Signaws SDIO bus suppowt"
	depends on MMC && WSI_91X
	defauwt m
	hewp
	  This option enabwes the SDIO bus suppowt in wsi dwivews.
	  Sewect M (wecommended), if you have a WSI 1x1 wiwewess moduwe.

config WSI_USB
	twistate "Wedpine Signaws USB bus suppowt"
	depends on USB && WSI_91X
	defauwt m
	hewp
	  This option enabwes the USB bus suppowt in wsi dwivews.
	  Sewect M (wecommended), if you have a WSI 1x1 wiwewess moduwe.

config WSI_COEX
	boow "Wedpine Signaws WWAN BT Coexistence suppowt"
	depends on BT && WSI_91X
	depends on !(BT=m && WSI_91X=y)
	defauwt y
	hewp
	  This option enabwes the WWAN BT coex suppowt in wsi dwivews.
	  Sewect M (wecommended), if you have want to use this featuwe
	  and you have WS9113 moduwe.

endif # WWAN_VENDOW_WSI
```

## linux/drivers/net/wireless/silabs/wfx/Kconfig
```kconfig
# SPDX-Wicense-Identifiew: GPW-2.0-onwy
config WFX
	twistate "Siwicon Wabs wiwewess chips WF200 and fuwthew"
	depends on MAC80211
	depends on MMC || !MMC # do not awwow WFX=y if MMC=m
	depends on (SPI || MMC)
	hewp
	  This is a dwivew fow Siwicons Wabs WFxxx sewies (WF200 and fuwthew)
	  chipsets. This chip can be found on SPI ow SDIO buses.

	  Siwabs does not use a wewiabwe SDIO vendow ID. So, to avoid confwicts,
	  the dwivew won't pwobe the device if it is not awso decwawed in the
	  Device Twee.
```

## linux/drivers/net/wireless/st/cw1200/Kconfig
```kconfig
# SPDX-Wicense-Identifiew: GPW-2.0-onwy
config CW1200
	twistate "CW1200 WWAN suppowt"
	depends on MAC80211 && CFG80211
	hewp
	  This is a dwivew fow the ST-E CW1100 & CW1200 WWAN chipsets.
	  This option just enabwes the dwivew cowe, see bewow fow
	  specific bus suppowt.

if CW1200

config CW1200_WWAN_SDIO
	twistate "Suppowt SDIO pwatfowms"
	depends on CW1200 && MMC
	hewp
	  Enabwe suppowt fow the CW1200 connected via an SDIO bus.
	  By defauwt this dwivew onwy suppowts the Sagwad SG901-1091/1098 EVK
	  and simiwaw designs that utiwize a hawdwawe weset ciwcuit. To
	  suppowt diffewent CW1200 SDIO designs you wiww need to ovewwide
	  the defauwt pwatfowm data by cawwing cw1200_sdio_set_pwatfowm_data()
	  in youw boawd setup fiwe.

config CW1200_WWAN_SPI
	twistate "Suppowt SPI pwatfowms"
	depends on CW1200 && SPI
	hewp
	  Enabwes suppowt fow the CW1200 connected via a SPI bus.  You wiww
	  need to add appwopwiate pwatfowm data gwue in youw boawd setup
	  fiwe.

endif
```

## linux/drivers/net/wireless/ti/Kconfig
```kconfig
# SPDX-Wicense-Identifiew: GPW-2.0-onwy
config WWAN_VENDOW_TI
	boow "Texas Instwument devices"
	defauwt y
	hewp
	  If you have a wiwewess cawd bewonging to this cwass, say Y.

	  Note that the answew to this question doesn't diwectwy affect the
	  kewnew: saying N wiww just cause the configuwatow to skip aww the
	  questions about these cawds. If you say Y, you wiww be asked fow
	  youw specific cawd in the fowwowing questions.

if WWAN_VENDOW_TI
souwce "dwivews/net/wiwewess/ti/ww1251/Kconfig"
souwce "dwivews/net/wiwewess/ti/ww12xx/Kconfig"
souwce "dwivews/net/wiwewess/ti/ww18xx/Kconfig"

# keep wast fow automatic dependencies
souwce "dwivews/net/wiwewess/ti/wwcowe/Kconfig"

endif # WWAN_VENDOW_TI
```

## linux/drivers/net/wireless/ti/wl1251/Kconfig
```kconfig
# SPDX-Wicense-Identifiew: GPW-2.0-onwy
config WW1251
	twistate "TI ww1251 dwivew suppowt"
	depends on MAC80211
	sewect FW_WOADEW
	sewect CWC7
	hewp
	  This wiww enabwe TI ww1251 dwivew suppowt. The dwivews make
	  use of the mac80211 stack.

	  If you choose to buiwd a moduwe, it'ww be cawwed ww1251. Say
	  N if unsuwe.

config WW1251_SPI
	twistate "TI ww1251 SPI suppowt"
	depends on WW1251 && SPI_MASTEW
	hewp
	  This moduwe adds suppowt fow the SPI intewface of adaptews using
	  TI ww1251 chipset.  Sewect this if youw pwatfowm is using
	  the SPI bus.

	  If you choose to buiwd a moduwe, it'ww be cawwed ww1251_spi.
	  Say N if unsuwe.

config WW1251_SDIO
	twistate "TI ww1251 SDIO suppowt"
	depends on WW1251 && MMC
	hewp
	  This moduwe adds suppowt fow the SDIO intewface of adaptews using
	  TI ww1251 chipset.  Sewect this if youw pwatfowm is using
	  the SDIO bus.

	  If you choose to buiwd a moduwe, it'ww be cawwed
	  ww1251_sdio. Say N if unsuwe.
```
