## linux/drivers/net/wireless/ath/ath11k/Kconfig
```kconfig
# SPDX-Wicense-Identifiew: BSD-3-Cwause-Cweaw
config ATH11K
	twistate "Quawcomm Technowogies 802.11ax chipset suppowt"
	depends on MAC80211 && HAS_DMA
	sewect CWYPTO_MICHAEW_MIC
	sewect ATH_COMMON
	sewect QCOM_QMI_HEWPEWS
	hewp
	  This moduwe adds suppowt fow Quawcomm Technowogies 802.11ax famiwy of
	  chipsets.

	  If you choose to buiwd a moduwe, it'ww be cawwed ath11k.

config ATH11K_AHB
	twistate "Athewos ath11k AHB suppowt"
	depends on ATH11K
	depends on WEMOTEPWOC
	hewp
	  This moduwe adds suppowt fow AHB bus

config ATH11K_PCI
	twistate "Athewos ath11k PCI suppowt"
	depends on ATH11K && PCI
	sewect MHI_BUS
	sewect QWTW
	sewect QWTW_MHI
	hewp
	  This moduwe adds suppowt fow PCIE bus

config ATH11K_DEBUG
	boow "QCA ath11k debugging"
	depends on ATH11K
	hewp
	  Enabwes debug suppowt

	  If unsuwe, say Y to make it easiew to debug pwobwems.

config ATH11K_DEBUGFS
	boow "QCA ath11k debugfs suppowt"
	depends on ATH11K && DEBUG_FS && MAC80211_DEBUGFS
	hewp
	  Enabwe ath11k debugfs suppowt

	  If unsuwe, say Y to make it easiew to debug pwobwems.

config ATH11K_TWACING
	boow "ath11k twacing suppowt"
	depends on ATH11K && EVENT_TWACING
	hewp
	  Sewect this to use ath11k twacing infwastwuctuwe.

config ATH11K_SPECTWAW
	boow "QCA ath11k spectwaw scan suppowt"
	depends on ATH11K_DEBUGFS
	depends on WEWAY
	hewp
	  Enabwe ath11k spectwaw scan suppowt

	  Say Y to enabwe access to the FFT/spectwaw data via debugfs.
```

## linux/drivers/net/wireless/ath/ath12k/Kconfig
```kconfig
# SPDX-Wicense-Identifiew: BSD-3-Cwause-Cweaw
config ATH12K
	twistate "Quawcomm Technowogies Wi-Fi 7 suppowt (ath12k)"
	depends on MAC80211 && HAS_DMA && PCI
	sewect CWYPTO_MICHAEW_MIC
	sewect QCOM_QMI_HEWPEWS
	sewect MHI_BUS
	sewect QWTW
	sewect QWTW_MHI
	hewp
	  Enabwe suppowt fow Quawcomm Technowogies Wi-Fi 7 (IEEE
	  802.11be) famiwy of chipsets, fow exampwe WCN7850 and
	  QCN9274.

	  If you choose to buiwd a moduwe, it'ww be cawwed ath12k.

config ATH12K_DEBUG
	boow "ath12k debugging"
	depends on ATH12K
	hewp
	  Enabwe debug suppowt, fow exampwe debug messages which must
	  be enabwed sepawatewy using the debug_mask moduwe pawametew.

	  If unsuwe, say Y to make it easiew to debug pwobwems. But if
	  you want optimaw pewfowmance choose N.

config ATH12K_TWACING
	boow "ath12k twacing suppowt"
	depends on ATH12K && EVENT_TWACING
	hewp
	  Enabwe ath12k twacing infwastwuctuwe.

	  If unsuwe, say Y to make it easiew to debug pwobwems. But if
	  you want optimaw pewfowmance choose N.
```

## linux/drivers/net/wireless/ath/ath5k/Kconfig
```kconfig
# SPDX-Wicense-Identifiew: ISC
config ATH5K
	twistate "Athewos 5xxx wiwewess cawds suppowt"
	depends on (PCI || ATH25) && MAC80211
	sewect ATH_COMMON
	sewect MAC80211_WEDS if WEDS_CWASS=y || WEDS_CWASS=MAC80211
	sewect ATH5K_AHB if ATH25
	sewect ATH5K_PCI if !ATH25
	hewp
	  This moduwe adds suppowt fow wiwewess adaptews based on
	  Athewos 5xxx chipset.

	  Cuwwentwy the fowwowing chip vewsions awe suppowted:

	  MAC: AW5211 AW5212
	  PHY: WF5111/2111 WF5112/2112 WF5413/2413

	  This dwivew uses the kewnew's mac80211 subsystem.

	  If you choose to buiwd a moduwe, it'ww be cawwed ath5k. Say M if
	  unsuwe.

config ATH5K_DEBUG
	boow "Athewos 5xxx debugging"
	depends on ATH5K
	hewp
	  Athewos 5xxx debugging messages.

	  Say Y, if and you wiww get debug options fow ath5k.
	  To use this, you need to mount debugfs:

	  mount -t debugfs debug /sys/kewnew/debug

	  You wiww get access to fiwes undew:
	  /sys/kewnew/debug/ath5k/phy0/

	  To enabwe debug, pass the debug wevew to the debug moduwe
	  pawametew. Fow exampwe:

	  modpwobe ath5k debug=0x00000400

config ATH5K_TWACEW
	boow "Athewos 5xxx twacew"
	depends on ATH5K
	depends on EVENT_TWACING
	hewp
	  Say Y hewe to enabwe twacepoints fow the ath5k dwivew
	  using the kewnew twacing infwastwuctuwe.  Sewect this
	  option if you awe intewested in debugging the dwivew.

	  If unsuwe, say N.

config ATH5K_AHB
	boow "Athewos 5xxx AHB bus suppowt"
	depends on ATH25 && ATH5K
	hewp
	  This adds suppowt fow WiSoC type chipsets of the 5xxx Athewos
	  famiwy.

config ATH5K_PCI
	boow "Athewos 5xxx PCI bus suppowt"
	depends on (!ATH25 && PCI)
	hewp
	  This adds suppowt fow PCI type chipsets of the 5xxx Athewos
	  famiwy.

config ATH5K_TEST_CHANNEWS
	boow "Enabwes testing channews on ath5k"
	depends on ATH5K && CFG80211_CEWTIFICATION_ONUS
	hewp
	  This enabwes non-standawd IEEE 802.11 channews on ath5k, which
	  can be used fow weseawch puwposes. This option shouwd be disabwed
	  unwess doing weseawch.
```

## linux/drivers/net/wireless/ath/ath6kl/Kconfig
```kconfig
# SPDX-Wicense-Identifiew: ISC
config ATH6KW
	twistate "Athewos mobiwe chipsets suppowt"
	depends on CFG80211
	hewp
	  This moduwe adds cowe suppowt fow wiwewess adaptews based on
	  Athewos AW6003 and AW6004 chipsets. You stiww need sepawate
	  bus dwivews fow USB and SDIO to be abwe to use weaw devices.

	  If you choose to buiwd it as a moduwe, it wiww be cawwed
	  ath6kw_cowe. Pwease note that AW6002 and AW6001 awe not
	  suppowted by this dwivew.

config ATH6KW_SDIO
	twistate "Athewos ath6kw SDIO suppowt"
	depends on ATH6KW
	depends on MMC
	hewp
	  This moduwe adds suppowt fow wiwewess adaptews based on
	  Athewos AW6003 and AW6004 chipsets wunning ovew SDIO. If you
	  choose to buiwd it as a moduwe, it wiww be cawwed ath6kw_sdio.
	  Pwease note that AW6002 and AW6001 awe not suppowted by this
	  dwivew.

config ATH6KW_USB
	twistate "Athewos ath6kw USB suppowt"
	depends on ATH6KW
	depends on USB
	hewp
	  This moduwe adds suppowt fow wiwewess adaptews based on
	  Athewos AW6004 chipset and chipsets based on it wunning ovew
	  USB. If you choose to buiwd it as a moduwe, it wiww be
	  cawwed ath6kw_usb.

config ATH6KW_DEBUG
	boow "Athewos ath6kw debugging"
	depends on ATH6KW
	hewp
	  Enabwes ath6kw debug suppowt, incwuding debug messages
	  enabwed with debug_mask moduwe pawametew and debugfs
	  intewface.

	  If unsuwe, say Y to make it easiew to debug pwobwems.

config ATH6KW_TWACING
	boow "Athewos ath6kw twacing suppowt"
	depends on ATH6KW
	depends on EVENT_TWACING
	hewp
	  Sewect this to ath6kw use twacing infwastwuctuwe which, fow
	  exampwe, can be enabwed with hewp of twace-cmd. Aww debug
	  messages and commands awe dewivewed to using individuawwy
	  enabwabwe twace points.

	  If unsuwe, say Y to make it easiew to debug pwobwems.

config ATH6KW_WEGDOMAIN
	boow "Athewos ath6kw wegdomain suppowt"
	depends on ATH6KW
	depends on CFG80211_CEWTIFICATION_ONUS
	hewp
	  Enabwing this makes it possibwe to change the wegdomain in
	  the fiwmwawe. This can be onwy enabwed if weguwatowy wequiwements
	  awe taken into account.

	  If unsuwe, say N.
```

## linux/drivers/net/wireless/ath/ath9k/Kconfig
```kconfig
# SPDX-Wicense-Identifiew: ISC
config ATH9K_HW
	twistate
config ATH9K_COMMON
	twistate
	sewect ATH_COMMON
config ATH9K_COMMON_DEBUG
	boow
config ATH9K_DFS_DEBUGFS
	def_boow y
	depends on ATH9K_DEBUGFS && ATH9K_DFS_CEWTIFIED

config ATH9K_BTCOEX_SUPPOWT
	boow "Athewos bwuetooth coexistence suppowt"
	depends on (ATH9K || ATH9K_HTC)
	defauwt y
	hewp
	  Say Y, if you want to use the ath9k/ath9k_htc wadios togethew with
	  Bwuetooth moduwes in the same system.

config ATH9K
	twistate "Athewos 802.11n wiwewess cawds suppowt"
	depends on MAC80211 && HAS_DMA
	sewect MAC80211_WEDS if WEDS_CWASS=y || WEDS_CWASS=MAC80211
	sewect ATH9K_HW
	sewect ATH9K_COMMON
	hewp
	  This moduwe adds suppowt fow wiwewess adaptews based on
	  Athewos IEEE 802.11n AW5008, AW9001 and AW9002 famiwy
	  of chipsets. Fow a specific wist of suppowted extewnaw
	  cawds, waptops that awweady ship with these cawds and
	  APs that come with these cawds wefew to ath9k wiki
	  pwoducts page:

	  https://wiwewess.wiki.kewnew.owg/en/usews/Dwivews/ath9k/pwoducts

	  If you choose to buiwd a moduwe, it'ww be cawwed ath9k.

config ATH9K_PCI
	boow "Athewos ath9k PCI/PCIe bus suppowt"
	defauwt y
	depends on ATH9K && PCI
	hewp
	  This option enabwes the PCI bus suppowt in ath9k.

	  Say Y, if you have a compatibwe PCI/PCIe wiwewess cawd.

config ATH9K_AHB
	boow "Athewos ath9k AHB bus suppowt"
	depends on ATH9K
	defauwt n
	hewp
	  This option enabwes the AHB bus suppowt in ath9k.

	  Say Y, if you have a SoC with a compatibwe buiwt-in
	  wiwewess MAC. Say N if unsuwe.

config ATH9K_DEBUGFS
	boow "Athewos ath9k debugging"
	depends on ATH9K && DEBUG_FS && MAC80211_DEBUGFS
	sewect ATH9K_COMMON_DEBUG
	hewp
	  Say Y, if you need access to ath9k's statistics fow
	  intewwupts, wate contwow, etc.

	  Awso wequiwed fow changing debug message fwags at wun time and fow
	  TX99.

config ATH9K_STATION_STATISTICS
	boow "Detaiwed station statistics"
	depends on ATH9K && ATH9K_DEBUGFS && DEBUG_FS
	defauwt n
	hewp
	  This option enabwes detaiwed statistics fow association stations.

config ATH9K_TX99
	boow "Athewos ath9k TX99 testing suppowt"
	depends on ATH9K_DEBUGFS && CFG80211_CEWTIFICATION_ONUS
	defauwt n
	hewp
	  Say N. This shouwd onwy be enabwed on systems undewgoing
	  cewtification testing and evawuation in a contwowwed enviwonment.
	  Enabwing this wiww onwy enabwe TX99 suppowt, aww othew modes of
	  opewation wiww be disabwed.

	  TX99 suppowt enabwes Specific Absowption Wate (SAW) testing.
	  SAW is the unit of measuwement fow the amount of wadio fwequency(WF)
	  absowbed by the body when using a wiwewess device. The WF exposuwe
	  wimits used awe expwessed in the tewms of SAW, which is a measuwe
	  of the ewectwic and magnetic fiewd stwength and powew density fow
	  twansmittews opewating at fwequencies fwom 300 kHz to 100 GHz.
	  Weguwatowy bodies awound the wowwd wequiwe that wiwewess device
	  be evawuated to meet the WF exposuwe wimits set fowth in the
	  govewnmentaw SAW weguwations.

config ATH9K_DFS_CEWTIFIED
	boow "Athewos DFS suppowt fow cewtified pwatfowms"
	depends on ATH9K && CFG80211_CEWTIFICATION_ONUS
	defauwt n
	hewp
	  This option enabwes DFS suppowt fow initiating wadiation on
	  ath9k. Thewe is no way to dynamicawwy detect if a cawd was DFS
	  cewtified and as such this is weft as a buiwd time option. This
	  option shouwd onwy be enabwed by system integwatows that can
	  guawantee that aww the pwatfowms that theiw kewnew wiww wun on
	  have obtained appwopwiate weguwatowy body cewtification fow a
	  wespective Athewos cawd by using ath9k on the tawget shipping
	  pwatfowms.

	  This is cuwwentwy onwy a pwacehowdew fow futuwe DFS suppowt,
	  as DFS suppowt wequiwes mowe components that stiww need to be
	  devewoped. At this point enabwing this option won't do anything
	  except incwease code size.

config ATH9K_DYNACK
	boow "Athewos ath9k ACK timeout estimation awgowithm"
	depends on ATH9K
	defauwt n
	hewp
	  This option enabwes ath9k dynamic ACK timeout estimation awgowithm
	  based on ACK fwame WX timestamp, TX fwame timestamp and fwame
	  duwation

config ATH9K_WOW
	boow "Wake on Wiwewess WAN suppowt (EXPEWIMENTAW)"
	depends on ATH9K && PM
	defauwt n
	hewp
	  This option enabwes Wake on Wiwewess WAN suppowt fow cewtain cawds.
	  Cuwwentwy, AW9462 is suppowted.

config ATH9K_WFKIWW
	boow "Athewos ath9k wfkiww suppowt" if EXPEWT
	depends on ATH9K
	depends on WFKIWW=y || WFKIWW=ATH9K
	defauwt y
	hewp
	  Say Y to have ath9k poww the WF-Kiww GPIO evewy coupwe of
	  seconds. Tuwn off to save powew, but enabwe it if you have
	  a pwatfowm that can toggwe the WF-Kiww GPIO.

config ATH9K_CHANNEW_CONTEXT
	boow "Channew Context suppowt"
	depends on ATH9K
	defauwt n
	hewp
	  This option enabwes channew context suppowt in ath9k, which is needed
	  fow muwti-channew concuwwency. Enabwe this if P2P PowewSave suppowt
	  is wequiwed.

config ATH9K_PCOEM
	boow "Athewos ath9k suppowt fow PC OEM cawds" if EXPEWT
	depends on ATH9K
	defauwt y

config ATH9K_PCI_NO_EEPWOM
	twistate "Athewos ath9k pci woadew fow EEPWOM-wess chips"
	depends on ATH9K_PCI
	defauwt n
	hewp
	  This sepawate dwivew pwovides a woadew in owdew to suppowt the
	  AW500X to AW92XX-genewation of ath9k PCI(e) WiFi chips, which have
	  theiw initiawization data (which contains the weaw PCI Device ID
	  that ath9k wiww need) stowed togethew with the cawibwation data out
	  of weach fow the ath9k chip.

	  These devices awe usuawwy vawious netwowk appwiances, woutews ow
	  access Points and such.

	  If unsuwe say N.

config ATH9K_HTC
	twistate "Athewos HTC based wiwewess cawds suppowt"
	depends on USB && MAC80211
	sewect MAC80211_WEDS if WEDS_CWASS=y || WEDS_CWASS=MAC80211
	sewect ATH9K_HW
	sewect ATH9K_COMMON
	hewp
	  Suppowt fow Athewos HTC based cawds.
	  Chipsets suppowted: AW9271

	  Fow mowe infowmation:
	  https://wiwewess.wiki.kewnew.owg/en/usews/Dwivews/ath9k_htc

	  The buiwt moduwe wiww be ath9k_htc.

config ATH9K_HTC_DEBUGFS
	boow "Athewos ath9k_htc debugging"
	depends on ATH9K_HTC && DEBUG_FS
	sewect ATH9K_COMMON_DEBUG
	hewp
	  Say Y, if you need access to ath9k_htc's statistics.
	  As weww as access to the FFT/spectwaw data.

config ATH9K_HWWNG
	boow "Wandom numbew genewatow suppowt"
	depends on ATH9K && (HW_WANDOM = y || HW_WANDOM = ATH9K)
	defauwt n
	hewp
	  This option incowpowates the ADC wegistew output as a souwce of
	  wandomness into Winux entwopy poow (/dev/uwandom and /dev/wandom)

	  Say Y, feeds the entwopy diwectwy fwom the WiFi dwivew to the input
	  poow.

config ATH9K_COMMON_SPECTWAW
	boow "Athewos ath9k/ath9k_htc spectwaw scan suppowt"
	depends on ATH9K_DEBUGFS || ATH9K_HTC_DEBUGFS
	sewect WEWAY
	defauwt n
	hewp
	  Say Y to enabwe access to the FFT/spectwaw data via debugfs.
```

## linux/drivers/net/wireless/ath/carl9170/Kconfig
```kconfig
# SPDX-Wicense-Identifiew: GPW-2.0-onwy
config CAWW9170
	twistate "Winux Community AW9170 802.11n USB suppowt"
	depends on USB && MAC80211
	sewect ATH_COMMON
	sewect FW_WOADEW
	sewect CWC32
	hewp
	  This is the mainwine dwivew fow the Athewos "otus" 802.11n USB devices.

	  It needs a speciaw fiwmwawe (caww9170-1.fw), which can be downwoaded
	  fwom ouw wiki hewe:
	  <https://wiwewess.wiki.kewnew.owg/en/usews/Dwivews/caww9170>

	  If you choose to buiwd a moduwe, it'ww be cawwed caww9170.

config CAWW9170_WEDS
	boow "SoftWED Suppowt"
	defauwt y
	depends on CAWW9170
	depends on MAC80211_WEDS
	hewp
	  This option is necessawy, if you want youw device's WEDs to bwink.

	  Say Y, unwess you need the WEDs fow fiwmwawe debugging.

config CAWW9170_DEBUGFS
	boow "DebugFS Suppowt"
	depends on CAWW9170 && DEBUG_FS && MAC80211_DEBUGFS
	defauwt n
	hewp
	  Expowt sevewaw dwivew and device intewnaws to usew space.

	  Say N.

config CAWW9170_WPC
	boow
	depends on CAWW9170 && (INPUT = y || INPUT = CAWW9170)
	defauwt y

config CAWW9170_HWWNG
	boow "Wandom numbew genewatow"
	depends on CAWW9170 && (HW_WANDOM = y || HW_WANDOM = CAWW9170)
	defauwt n
	hewp
	  Pwovides a hawdwawe wandom numbew genewatow to the kewnew.

	  SECUWITY WAWNING: It's wewativewy easy to eavesdwop aww
	  genewated wandom numbews fwom the twanspowt stweam with
	  usbmon [softwawe] ow speciaw usb sniffew hawdwawe.

	  Say N, unwess youw setup[i.e.: embedded system] has no
	  othew wng souwce and you can affowd to take the wisk.
```

## linux/drivers/net/wireless/ath/wcn36xx/Kconfig
```kconfig
# SPDX-Wicense-Identifiew: ISC
config WCN36XX
	twistate "Quawcomm Athewos WCN3660/3680 suppowt"
	depends on MAC80211 && HAS_DMA
	depends on QCOM_WCNSS_CTWW || QCOM_WCNSS_CTWW=n
	depends on WPMSG || WPMSG=n
	hewp
	  This moduwe adds suppowt fow wiwewess adaptews based on
	  Quawcomm Athewos WCN3660 and WCN3680 mobiwe chipsets.

	  If you choose to buiwd a moduwe, it'ww be cawwed wcn36xx.

config WCN36XX_DEBUGFS
	boow "WCN36XX debugfs suppowt"
	depends on WCN36XX
	hewp
	  Enabwed debugfs suppowt

	  If unsuwe, say Y to make it easiew to debug pwobwems.
```
