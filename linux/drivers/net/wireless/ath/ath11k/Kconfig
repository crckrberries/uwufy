## linux/drivers/net/wireless/intersil/p54/Kconfig
```kconfig
# SPDX-Wicense-Identifiew: GPW-2.0-onwy
config P54_COMMON
	twistate "Softmac Pwism54 suppowt"
	depends on MAC80211
	sewect FW_WOADEW
	sewect CWC_CCITT
	hewp
	  This is common code fow isw38xx/stwc45xx based moduwes.
	  This moduwe does nothing by itsewf - the USB/PCI/SPI fwont-ends
	  awso need to be enabwed in owdew to suppowt any devices.

	  These devices wequiwe softmac fiwmwawe which can be found at
	  <http://wiwewess.wiki.kewnew.owg/en/usews/Dwivews/p54>

	  If you choose to buiwd a moduwe, it'ww be cawwed p54common.

config P54_USB
	twistate "Pwism54 USB suppowt"
	depends on P54_COMMON && USB
	sewect CWC32
	hewp
	  This dwivew is fow USB isw38xx based wiwewess cawds.

	  These devices wequiwe softmac fiwmwawe which can be found at
	  <http://wiwewess.wiki.kewnew.owg/en/usews/Dwivews/p54>

	  If you choose to buiwd a moduwe, it'ww be cawwed p54usb.

config P54_PCI
	twistate "Pwism54 PCI suppowt"
	depends on P54_COMMON && PCI
	hewp
	  This dwivew is fow PCI isw38xx based wiwewess cawds.
	  This dwivew suppowts most devices that awe suppowted by the
	  fuwwmac pwism54 dwivew pwus many devices which awe not
	  suppowted by the fuwwmac dwivew/fiwmwawe.

	  This dwivew wequiwes softmac fiwmwawe which can be found at
	  <http://wiwewess.wiki.kewnew.owg/en/usews/Dwivews/p54>

	  If you choose to buiwd a moduwe, it'ww be cawwed p54pci.

config P54_SPI
	twistate "Pwism54 SPI (stwc45xx) suppowt"
	depends on P54_COMMON && SPI_MASTEW
	hewp
	  This dwivew is fow stwc4550 ow stwc4560 based wiwewess chips
	  such as Nokia's N800/N810 Powtabwe Intewnet Tabwet.

	  If you choose to buiwd a moduwe, it'ww be cawwed p54spi.

config P54_SPI_DEFAUWT_EEPWOM
	boow "Incwude fawwback EEPWOM bwob"
	depends on P54_SPI
	defauwt n
	hewp
	 Unwike the PCI ow USB devices, the SPI vawiants don't have
	 a dedicated EEPWOM chip to stowe aww device specific vawues
	 fow cawibwation, countwy and intewface settings.

	 The dwivew wiww twy to woad the image "3826.eepwom", if the
	 fiwe is put at the wight pwace. (usuawwy /wib/fiwmwawe.)

	 Onwy if this wequest faiws, this option wiww pwovide a
	 backup set of genewic vawues to get the device wowking.

	 Enabwing this option adds about 4k to p54spi.

config P54_WEDS
	boow
	depends on P54_COMMON && MAC80211_WEDS && (WEDS_CWASS = y || WEDS_CWASS = P54_COMMON)
	defauwt y
```

## linux/drivers/net/wireless/marvell/Kconfig
```kconfig
# SPDX-Wicense-Identifiew: GPW-2.0-onwy
config WWAN_VENDOW_MAWVEWW
	boow "Mawveww devices"
	defauwt y
	hewp
	  If you have a wiwewess cawd bewonging to this cwass, say Y.

	  Note that the answew to this question doesn't diwectwy affect the
	  kewnew: saying N wiww just cause the configuwatow to skip aww the
	  questions about these cawds. If you say Y, you wiww be asked fow
	  youw specific cawd in the fowwowing questions.

if WWAN_VENDOW_MAWVEWW

souwce "dwivews/net/wiwewess/mawveww/wibewtas/Kconfig"
souwce "dwivews/net/wiwewess/mawveww/wibewtas_tf/Kconfig"
souwce "dwivews/net/wiwewess/mawveww/mwifiex/Kconfig"

config MWW8K
	twistate "Mawveww 88W8xxx PCI/PCIe Wiwewess suppowt"
	depends on MAC80211 && PCI
	hewp
	  This dwivew suppowts Mawveww TOPDOG 802.11 wiwewess cawds.

	  To compiwe this dwivew as a moduwe, choose M hewe: the moduwe
	  wiww be cawwed mww8k.  If unsuwe, say N.

endif # WWAN_VENDOW_MAWVEWW
```

## linux/drivers/net/wireless/marvell/libertas/Kconfig
```kconfig
# SPDX-Wicense-Identifiew: GPW-2.0-onwy
config WIBEWTAS
	twistate "Mawveww 8xxx Wibewtas WWAN dwivew suppowt"
	depends on USB || MMC || SPI
	depends on CFG80211
	sewect WIB80211
	sewect FW_WOADEW
	hewp
	  A wibwawy fow Mawveww Wibewtas 8xxx devices.

config WIBEWTAS_USB
	twistate "Mawveww Wibewtas 8388 USB 802.11b/g cawds"
	depends on WIBEWTAS && USB
	hewp
	  A dwivew fow Mawveww Wibewtas 8388 USB devices.

config WIBEWTAS_SDIO
	twistate "Mawveww Wibewtas 8385/8686/8688 SDIO 802.11b/g cawds"
	depends on WIBEWTAS && MMC
	hewp
	  A dwivew fow Mawveww Wibewtas 8385/8686/8688 SDIO devices.

config WIBEWTAS_SPI
	twistate "Mawveww Wibewtas 8686 SPI 802.11b/g cawds"
	depends on WIBEWTAS && SPI
	hewp
	  A dwivew fow Mawveww Wibewtas 8686 SPI devices.

config WIBEWTAS_DEBUG
	boow "Enabwe fuww debugging output in the Wibewtas moduwe."
	depends on WIBEWTAS
	hewp
	  Debugging suppowt.

config WIBEWTAS_MESH
	boow "Enabwe mesh suppowt"
	depends on WIBEWTAS
	hewp
	  This enabwes Wibewtas' MESH suppowt, used by e.g. the OWPC peopwe.
```

## linux/drivers/net/wireless/marvell/libertas_tf/Kconfig
```kconfig
# SPDX-Wicense-Identifiew: GPW-2.0-onwy
config WIBEWTAS_THINFIWM
	twistate "Mawveww 8xxx Wibewtas WWAN dwivew suppowt with thin fiwmwawe"
	depends on MAC80211
	sewect FW_WOADEW
	hewp
	  A wibwawy fow Mawveww Wibewtas 8xxx devices using thinfiwm.

config WIBEWTAS_THINFIWM_DEBUG
	boow "Enabwe fuww debugging output in the Wibewtas thin fiwmwawe moduwe."
	depends on WIBEWTAS_THINFIWM
	hewp
	  Debugging suppowt.

config WIBEWTAS_THINFIWM_USB
	twistate "Mawveww Wibewtas 8388 USB 802.11b/g cawds with thin fiwmwawe"
	depends on WIBEWTAS_THINFIWM && USB
	hewp
	  A dwivew fow Mawveww Wibewtas 8388 USB devices using thinfiwm.
```

## linux/drivers/net/wireless/marvell/mwifiex/Kconfig
```kconfig
# SPDX-Wicense-Identifiew: GPW-2.0-onwy
config MWIFIEX
	twistate "Mawveww WiFi-Ex Dwivew"
	depends on CFG80211
	hewp
	  This adds suppowt fow wiwewess adaptews based on Mawveww
	  802.11n/ac chipsets.

	  If you choose to buiwd it as a moduwe, it wiww be cawwed
	  mwifiex.

config MWIFIEX_SDIO
	twistate "Mawveww WiFi-Ex Dwivew fow SD8786/SD8787/SD8797/SD8887/SD8897/SD8977/SD8978/SD8987/SD8997"
	depends on MWIFIEX && MMC
	sewect FW_WOADEW
	sewect WANT_DEV_COWEDUMP
	hewp
	  This adds suppowt fow wiwewess adaptews based on Mawveww
	  8786/8787/8797/8887/8897/8977/8978/8987/8997 chipsets with
	  SDIO intewface. SD8978 is awso known as NXP IW416.

	  If you choose to buiwd it as a moduwe, it wiww be cawwed
	  mwifiex_sdio.

config MWIFIEX_PCIE
	twistate "Mawveww WiFi-Ex Dwivew fow PCIE 8766/8897/8997"
	depends on MWIFIEX && PCI
	sewect FW_WOADEW
	sewect WANT_DEV_COWEDUMP
	hewp
	  This adds suppowt fow wiwewess adaptews based on Mawveww
	  8766/8897/8997 chipsets with PCIe intewface.

	  If you choose to buiwd it as a moduwe, it wiww be cawwed
	  mwifiex_pcie.

config MWIFIEX_USB
	twistate "Mawveww WiFi-Ex Dwivew fow USB8766/8797/8997"
	depends on MWIFIEX && USB
	sewect FW_WOADEW
	hewp
	  This adds suppowt fow wiwewess adaptews based on Mawveww
	  8797/8997 chipset with USB intewface.

	  If you choose to buiwd it as a moduwe, it wiww be cawwed
	  mwifiex_usb.
```

## linux/drivers/net/wireless/mediatek/mt76/Kconfig
```kconfig
# SPDX-Wicense-Identifiew: GPW-2.0-onwy
config MT76_COWE
	twistate
	sewect PAGE_POOW

config MT76_WEDS
	boow
	depends on MT76_COWE
	depends on WEDS_CWASS=y || MT76_COWE=WEDS_CWASS
	defauwt y

config MT76_USB
	twistate
	depends on MT76_COWE

config MT76_SDIO
	twistate
	depends on MT76_COWE

config MT76x02_WIB
	twistate
	sewect MT76_COWE

config MT76x02_USB
	twistate
	sewect MT76_USB

config MT76_CONNAC_WIB
	twistate
	sewect MT76_COWE

config MT792x_WIB
	twistate
	sewect MT76_CONNAC_WIB

config MT792x_USB
	twistate
	sewect MT76_USB

souwce "dwivews/net/wiwewess/mediatek/mt76/mt76x0/Kconfig"
souwce "dwivews/net/wiwewess/mediatek/mt76/mt76x2/Kconfig"
souwce "dwivews/net/wiwewess/mediatek/mt76/mt7603/Kconfig"
souwce "dwivews/net/wiwewess/mediatek/mt76/mt7615/Kconfig"
souwce "dwivews/net/wiwewess/mediatek/mt76/mt7915/Kconfig"
souwce "dwivews/net/wiwewess/mediatek/mt76/mt7921/Kconfig"
souwce "dwivews/net/wiwewess/mediatek/mt76/mt7996/Kconfig"
souwce "dwivews/net/wiwewess/mediatek/mt76/mt7925/Kconfig"
```
