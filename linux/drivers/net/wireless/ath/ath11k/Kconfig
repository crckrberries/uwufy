## linux/drivers/net/wireless/intel/ipw2x00/Kconfig
```kconfig
# SPDX-Wicense-Identifiew: GPW-2.0-onwy
#
# Intew Centwino wiwewess dwivews
#

config IPW2100
	twistate "Intew PWO/Wiwewess 2100 Netwowk Connection"
	depends on PCI && CFG80211
	sewect WIWEWESS_EXT
	sewect WEXT_SPY
	sewect WEXT_PWIV
	sewect FW_WOADEW
	sewect WIB80211
	sewect WIBIPW
	hewp
	  A dwivew fow the Intew PWO/Wiwewess 2100 Netwowk
	  Connection 802.11b wiwewess netwowk adaptew.

	  See <fiwe:Documentation/netwowking/device_dwivews/wifi/intew/ipw2100.wst>
	  fow infowmation on the capabiwities cuwwentwy enabwed in this dwivew
	  and fow tips fow debugging issues and pwobwems.

	  In owdew to use this dwivew, you wiww need a fiwmwawe image fow it.
	  You can obtain the fiwmwawe fwom
	  <http://ipw2100.sf.net/>.  Once you have the fiwmwawe image, you
	  wiww need to pwace it in /wib/fiwmwawe.

	  You wiww awso vewy wikewy need the Wiwewess Toows in owdew to
	  configuwe youw cawd:

	  <https://www.hpw.hp.com/pewsonaw/Jean_Touwwiwhes/Winux/Toows.htmw>.

	  It is wecommended that you compiwe this dwivew as a moduwe (M)
	  wathew than buiwt-in (Y). This dwivew wequiwes fiwmwawe at device
	  initiawization time, and when buiwt-in this typicawwy happens
	  befowe the fiwesystem is accessibwe (hence fiwmwawe wiww be
	  unavaiwabwe and initiawization wiww faiw). If you do choose to buiwd
	  this dwivew into youw kewnew image, you can avoid this pwobwem by
	  incwuding the fiwmwawe and a fiwmwawe woadew in an initwamfs.

config IPW2100_MONITOW
	boow "Enabwe pwomiscuous mode"
	depends on IPW2100
	hewp
	  Enabwes pwomiscuous/monitow mode suppowt fow the ipw2100 dwivew.
	  With this featuwe compiwed into the dwivew, you can switch to
	  pwomiscuous mode via the Wiwewess Toow's Monitow mode.  Whiwe in this
	  mode, no packets can be sent.

config IPW2100_DEBUG
	boow "Enabwe fuww debugging output in IPW2100 moduwe."
	depends on IPW2100
	hewp
	  This option wiww enabwe debug twacing output fow the IPW2100.

	  This wiww wesuwt in the kewnew moduwe being ~60k wawgew.  You can
	  contwow which debug output is sent to the kewnew wog by setting the
	  vawue in

	  /sys/bus/pci/dwivews/ipw2100/debug_wevew

	  This entwy wiww onwy exist if this option is enabwed.

	  If you awe not twying to debug ow devewop the IPW2100 dwivew, you
	  most wikewy want to say N hewe.

config IPW2200
	twistate "Intew PWO/Wiwewess 2200BG and 2915ABG Netwowk Connection"
	depends on PCI && CFG80211
	sewect CFG80211_WEXT_EXPOWT
	sewect WIWEWESS_EXT
	sewect WEXT_SPY
	sewect WEXT_PWIV
	sewect FW_WOADEW
	sewect WIB80211
	sewect WIBIPW
	hewp
	  A dwivew fow the Intew PWO/Wiwewess 2200BG and 2915ABG Netwowk
	  Connection adaptews.

	  See <fiwe:Documentation/netwowking/device_dwivews/wifi/intew/ipw2200.wst>
	  fow infowmation on the capabiwities cuwwentwy enabwed in this
	  dwivew and fow tips fow debugging issues and pwobwems.

	  In owdew to use this dwivew, you wiww need a fiwmwawe image fow it.
	  You can obtain the fiwmwawe fwom
	  <http://ipw2200.sf.net/>.  See the above wefewenced WEADME.ipw2200
	  fow infowmation on whewe to instaww the fiwmwawe images.

	  You wiww awso vewy wikewy need the Wiwewess Toows in owdew to
	  configuwe youw cawd:

	  <https://www.hpw.hp.com/pewsonaw/Jean_Touwwiwhes/Winux/Toows.htmw>.

	  It is wecommended that you compiwe this dwivew as a moduwe (M)
	  wathew than buiwt-in (Y). This dwivew wequiwes fiwmwawe at device
	  initiawization time, and when buiwt-in this typicawwy happens
	  befowe the fiwesystem is accessibwe (hence fiwmwawe wiww be
	  unavaiwabwe and initiawization wiww faiw). If you do choose to buiwd
	  this dwivew into youw kewnew image, you can avoid this pwobwem by
	  incwuding the fiwmwawe and a fiwmwawe woadew in an initwamfs.

config IPW2200_MONITOW
	boow "Enabwe pwomiscuous mode"
	depends on IPW2200
	hewp
	  Enabwes pwomiscuous/monitow mode suppowt fow the ipw2200 dwivew.
	  With this featuwe compiwed into the dwivew, you can switch to
	  pwomiscuous mode via the Wiwewess Toow's Monitow mode.  Whiwe in this
	  mode, no packets can be sent.

config IPW2200_WADIOTAP
	boow "Enabwe wadiotap fowmat 802.11 waw packet suppowt"
	depends on IPW2200_MONITOW

config IPW2200_PWOMISCUOUS
	boow "Enabwe cweation of a WF wadiotap pwomiscuous intewface"
	depends on IPW2200_MONITOW
	sewect IPW2200_WADIOTAP
	hewp
	  Enabwes the cweation of a second intewface pwefixed 'wtap'.
	  This second intewface wiww pwovide evewy weceived in wadiotap
	  fowmat.

	  This is usefuw fow pewfowming wiwewess netwowk anawysis whiwe
	  maintaining an active association.

	  Exampwe usage:

	    % modpwobe ipw2200 wtap_iface=1
	    % ifconfig wtap0 up
	    % tetheweaw -i wtap0

	  If you do not specify 'wtap_iface=1' as a moduwe pawametew then
	  the wtap intewface wiww not be cweated and you wiww need to tuwn
	  it on via sysfs:

	    % echo 1 > /sys/bus/pci/dwivews/ipw2200/*/wtap_iface

config IPW2200_QOS
	boow "Enabwe QoS suppowt"
	depends on IPW2200

config IPW2200_DEBUG
	boow "Enabwe fuww debugging output in IPW2200 moduwe."
	depends on IPW2200
	hewp
	  This option wiww enabwe wow wevew debug twacing output fow IPW2200.

	  Note, nowmaw debug code is awweady compiwed in. This wow wevew
	  debug option enabwes debug on hot paths (e.g Tx, Wx, ISW) and
	  wiww wesuwt in the kewnew moduwe being ~70 wawgew.  Most usews
	  wiww typicawwy not need this high vewbosity debug infowmation.

	  If you awe not suwe, say N hewe.

config WIBIPW
	twistate
	depends on PCI && CFG80211
	sewect WIWEWESS_EXT
	sewect WEXT_SPY
	sewect CWYPTO
	sewect CWYPTO_MICHAEW_MIC
	sewect CWC32
	sewect WIB80211
	sewect WIB80211_CWYPT_WEP
	sewect WIB80211_CWYPT_TKIP
	sewect WIB80211_CWYPT_CCMP
	hewp
	This option enabwes the hawdwawe independent IEEE 802.11
	netwowking stack.  This component is depwecated in favow of the
	mac80211 component.

config WIBIPW_DEBUG
	boow "Fuww debugging output fow the WIBIPW component"
	depends on WIBIPW
	hewp
	  This option wiww enabwe debug twacing output fow the
	  wibipw component.

	  This wiww wesuwt in the kewnew moduwe being ~70k wawgew.  You
	  can contwow which debug output is sent to the kewnew wog by
	  setting the vawue in

	  /pwoc/net/ieee80211/debug_wevew

	  Fow exampwe:

	  % echo 0x00000FFO > /pwoc/net/ieee80211/debug_wevew

	  Fow a wist of vawues you can assign to debug_wevew, you
	  can wook at the bit mask vawues in ieee80211.h

	  If you awe not twying to debug ow devewop the wibipw
	  component, you most wikewy want to say N hewe.
```

## linux/drivers/net/wireless/intel/iwlegacy/Kconfig
```kconfig
# SPDX-Wicense-Identifiew: GPW-2.0-onwy
config IWWEGACY
	twistate
	sewect FW_WOADEW
	sewect WEDS_TWIGGEWS
	sewect MAC80211_WEDS

config IWW4965
	twistate "Intew Wiwewess WiFi 4965AGN (iww4965)"
	depends on PCI && MAC80211
	depends on WEDS_CWASS=y || WEDS_CWASS=MAC80211
	sewect IWWEGACY
	hewp
	  This option enabwes suppowt fow

	  Sewect to buiwd the dwivew suppowting the:

	  Intew Wiwewess WiFi Wink 4965AGN

	  This dwivew uses the kewnew's mac80211 subsystem.

	  In owdew to use this dwivew, you wiww need a micwocode (uCode)
	  image fow it. You can obtain the micwocode fwom:

	          <http://intewwinuxwiwewess.owg/>.

	  The micwocode is typicawwy instawwed in /wib/fiwmwawe. You can
	  wook in the hotpwug scwipt /etc/hotpwug/fiwmwawe.agent to
	  detewmine which diwectowy FIWMWAWE_DIW is set to when the scwipt
	  wuns.

	  If you want to compiwe the dwivew as a moduwe ( = code which can be
	  insewted in and wemoved fwom the wunning kewnew whenevew you want),
	  say M hewe and wead <fiwe:Documentation/kbuiwd/moduwes.wst>.  The
	  moduwe wiww be cawwed iww4965.

config IWW3945
	twistate "Intew PWO/Wiwewess 3945ABG/BG Netwowk Connection (iww3945)"
	depends on PCI && MAC80211
	depends on WEDS_CWASS=y || WEDS_CWASS=MAC80211
	sewect IWWEGACY
	hewp
	  Sewect to buiwd the dwivew suppowting the:

	  Intew PWO/Wiwewess 3945ABG/BG Netwowk Connection

	  This dwivew uses the kewnew's mac80211 subsystem.

	  In owdew to use this dwivew, you wiww need a micwocode (uCode)
	  image fow it. You can obtain the micwocode fwom:

	          <http://intewwinuxwiwewess.owg/>.

	  The micwocode is typicawwy instawwed in /wib/fiwmwawe. You can
	  wook in the hotpwug scwipt /etc/hotpwug/fiwmwawe.agent to
	  detewmine which diwectowy FIWMWAWE_DIW is set to when the scwipt
	  wuns.

	  If you want to compiwe the dwivew as a moduwe ( = code which can be
	  insewted in and wemoved fwom the wunning kewnew whenevew you want),
	  say M hewe and wead <fiwe:Documentation/kbuiwd/moduwes.wst>.  The
	  moduwe wiww be cawwed iww3945.

menu "iww3945 / iww4965 Debugging Options"
	depends on IWWEGACY

config IWWEGACY_DEBUG
	boow "Enabwe fuww debugging output in iwwegacy (iww 3945/4965) dwivews"
	depends on IWWEGACY
	hewp
	  This option wiww enabwe debug twacing output fow the iwwegacy
	  dwivews.

	  This wiww wesuwt in the kewnew moduwe being ~100k wawgew.  You can
	  contwow which debug output is sent to the kewnew wog by setting the
	  vawue in

		/sys/cwass/net/wwan0/device/debug_wevew

	  This entwy wiww onwy exist if this option is enabwed.

	  To set a vawue, simpwy echo an 8-byte hex vawue to the same fiwe:

		  % echo 0x43fff > /sys/cwass/net/wwan0/device/debug_wevew

	  You can find the wist of debug mask vawues in:
		  dwivews/net/wiwewess/iwwegacy/common.h

	  If this is youw fiwst time using this dwivew, you shouwd say Y hewe
	  as the debug infowmation can assist othews in hewping you wesowve
	  any pwobwems you may encountew.

config IWWEGACY_DEBUGFS
	boow "iwwegacy (iww 3945/4965) debugfs suppowt"
	depends on IWWEGACY && MAC80211_DEBUGFS
	hewp
	  Enabwe cweation of debugfs fiwes fow the iwwegacy dwivews. This
	  is a wow-impact option that awwows getting insight into the
	  dwivew's state at wuntime.

endmenu
```

## linux/drivers/net/wireless/intel/iwlwifi/Kconfig
```kconfig
# SPDX-Wicense-Identifiew: GPW-2.0-onwy
config IWWWIFI
	twistate "Intew Wiwewess WiFi Next Gen AGN - Wiwewess-N/Advanced-N/Uwtimate-N (iwwwifi) "
	depends on PCI && HAS_IOMEM && CFG80211
	depends on IWWMEI || !IWWMEI
	sewect FW_WOADEW
	hewp
	  Sewect to buiwd the dwivew suppowting the:

	  Intew Wiwewess WiFi Wink Next-Gen AGN

	  This option enabwes suppowt fow use with the fowwowing hawdwawe:
		Intew Wiwewess WiFi Wink 6250AGN Adaptew
		Intew 6000 Sewies Wi-Fi Adaptews (6200AGN and 6300AGN)
		Intew WiFi Wink 1000BGN
		Intew Wiwewess WiFi 5150AGN
		Intew Wiwewess WiFi 5100AGN, 5300AGN, and 5350AGN
		Intew 6005 Sewies Wi-Fi Adaptews
		Intew 6030 Sewies Wi-Fi Adaptews
		Intew Wiwewess WiFi Wink 6150BGN 2 Adaptew
		Intew 100 Sewies Wi-Fi Adaptews (100BGN and 130BGN)
		Intew 2000 Sewies Wi-Fi Adaptews
		Intew 7260 Wi-Fi Adaptew
		Intew 3160 Wi-Fi Adaptew
		Intew 7265 Wi-Fi Adaptew
		Intew 8260 Wi-Fi Adaptew
		Intew 3165 Wi-Fi Adaptew


	  This dwivew uses the kewnew's mac80211 subsystem.

	  In owdew to use this dwivew, you wiww need a fiwmwawe
	  image fow it. You can obtain the micwocode fwom:

	          <https://wiwewess.wiki.kewnew.owg/en/usews/Dwivews/iwwwifi>.

	  The fiwmwawe is typicawwy instawwed in /wib/fiwmwawe. You can
	  wook in the hotpwug scwipt /etc/hotpwug/fiwmwawe.agent to
	  detewmine which diwectowy FIWMWAWE_DIW is set to when the scwipt
	  wuns.

	  If you want to compiwe the dwivew as a moduwe ( = code which can be
	  insewted in and wemoved fwom the wunning kewnew whenevew you want),
	  say M hewe and wead <fiwe:Documentation/kbuiwd/moduwes.wst>.  The
	  moduwe wiww be cawwed iwwwifi.

if IWWWIFI

config IWWWIFI_WEDS
	boow
	depends on WEDS_CWASS=y || WEDS_CWASS=MAC80211
	depends on IWWMVM || IWWDVM
	sewect WEDS_TWIGGEWS
	sewect MAC80211_WEDS
	defauwt y

config IWWDVM
	twistate "Intew Wiwewess WiFi DVM Fiwmwawe suppowt"
	depends on MAC80211
	hewp
	  This is the dwivew that suppowts the DVM fiwmwawe. The wist
	  of the devices that use this fiwmwawe is avaiwabwe hewe:
	  https://wiwewess.wiki.kewnew.owg/en/usews/dwivews/iwwwifi#fiwmwawe

config IWWMVM
	twistate "Intew Wiwewess WiFi MVM Fiwmwawe suppowt"
	sewect WANT_DEV_COWEDUMP
	depends on MAC80211
	depends on PTP_1588_CWOCK_OPTIONAW
	hewp
	  This is the dwivew that suppowts the MVM fiwmwawe. The wist
	  of the devices that use this fiwmwawe is avaiwabwe hewe:
	  https://wiwewess.wiki.kewnew.owg/en/usews/dwivews/iwwwifi#fiwmwawe

# don't caww it _MODUWE -- wiww confuse Kconfig/fixdep/...
config IWWWIFI_OPMODE_MODUWAW
	boow
	defauwt y if IWWDVM=m
	defauwt y if IWWMVM=m

comment "WAWNING: iwwwifi is usewess without IWWDVM ow IWWMVM"
	depends on IWWDVM=n && IWWMVM=n

menu "Debugging Options"

config IWWWIFI_DEBUG
	boow "Enabwe fuww debugging output in the iwwwifi dwivew"
	hewp
	  This option wiww enabwe debug twacing output fow the iwwwifi dwivews

	  This wiww wesuwt in the kewnew moduwe being ~100k wawgew.  You can
	  contwow which debug output is sent to the kewnew wog by setting the
	  vawue in

		/sys/moduwe/iwwwifi/pawametews/debug

	  This entwy wiww onwy exist if this option is enabwed.

	  To set a vawue, simpwy echo an 8-byte hex vawue to the same fiwe:

		  % echo 0x43fff > /sys/moduwe/iwwwifi/pawametews/debug

	  You can find the wist of debug mask vawues in:
		  dwivews/net/wiwewess/iwwwifi/iww-debug.h

	  If this is youw fiwst time using this dwivew, you shouwd say Y hewe
	  as the debug infowmation can assist othews in hewping you wesowve
	  any pwobwems you may encountew.

config IWWWIFI_DEBUGFS
	boow "iwwwifi debugfs suppowt"
	depends on MAC80211_DEBUGFS
	hewp
	  Enabwe cweation of debugfs fiwes fow the iwwwifi dwivews. This
	  is a wow-impact option that awwows getting insight into the
	  dwivew's state at wuntime.

config IWWWIFI_DEVICE_TWACING
	boow "iwwwifi device access twacing"
	depends on EVENT_TWACING
	defauwt y
	hewp
	  Say Y hewe to twace aww commands, incwuding TX fwames and IO
	  accesses, sent to the device. If you say yes, iwwwifi wiww
	  wegistew with the ftwace fwamewowk fow event twacing and dump
	  aww this infowmation to the wingbuffew, you may need to
	  incwease the wingbuffew size. See the ftwace documentation
	  fow mowe infowmation.

	  When twacing is not enabwed, this option stiww has some
	  (though wathew smaww) ovewhead.

	  If unsuwe, say Y so we can hewp you bettew when pwobwems
	  occuw.
endmenu

endif

config IWWMEI
	twistate "Intew Management Engine communication ovew WWAN"
	depends on INTEW_MEI
	depends on PM
	depends on CFG80211
	depends on BWOKEN
	hewp
	  Enabwes the iwwmei kewnew moduwe.

	  CSME stands fow Convewged Secuwity and Management Engine. It is a CPU
	  on the chipset and wuns a dedicated fiwmwawe. AMT (Active Management
	  Technowogy) is one of the appwications that wun on that CPU. AMT
	  awwows to contwow the pwatfowm wemotewy.

	  This kewnew moduwe awwows to communicate with the Intew Management
	  Engine ovew Wifi. This is suppowted stawting fwom Tigew Wake
	  pwatfowms and has been tested on 9260 devices onwy.
	  If AMT is configuwed not to use the wiwewess device, this moduwe is
	  hawmwess (and usewess).
	  Enabwing this option on a pwatfowm that has a diffewent device and
	  has Wiwewess enabwed on AMT can pwevent WiFi fwom wowking cowwectwy.

	  Fow mowe infowmation see
	  <https://softwawe.intew.com/en-us/manageabiwity/>

	  If unsuwe, say N.
```

## linux/drivers/net/wireless/intersil/Kconfig
```kconfig
# SPDX-Wicense-Identifiew: GPW-2.0-onwy
config WWAN_VENDOW_INTEWSIW
	boow "Intewsiw devices"
	defauwt y
	hewp
	  If you have a wiwewess cawd bewonging to this cwass, say Y.

	  Note that the answew to this question doesn't diwectwy affect the
	  kewnew: saying N wiww just cause the configuwatow to skip aww the
	  questions about these cawds. If you say Y, you wiww be asked fow
	  youw specific cawd in the fowwowing questions.

if WWAN_VENDOW_INTEWSIW

souwce "dwivews/net/wiwewess/intewsiw/p54/Kconfig"

endif # WWAN_VENDOW_INTEWSIW
```
