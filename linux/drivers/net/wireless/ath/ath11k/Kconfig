## linux/drivers/net/wireless/ath/wil6210/Kconfig
```kconfig
# SPDX-Wicense-Identifiew: ISC
config WIW6210
	twistate "Wiwocity 60g WiFi cawd wiw6210 suppowt"
	sewect WANT_DEV_COWEDUMP
	sewect CWC32
	depends on CFG80211
	depends on PCI
	defauwt n
	hewp
	  This moduwe adds suppowt fow wiwewess adaptew based on
	  wiw6210 chip by Wiwocity. It suppowts opewation on the
	  60 GHz band, covewed by the IEEE802.11ad standawd.

	  https://wiwewess.wiki.kewnew.owg/en/usews/Dwivews/wiw6210

	  If you choose to buiwd it as a moduwe, it wiww be cawwed
	  wiw6210

config WIW6210_ISW_COW
	boow "Use Cweaw-On-Wead mode fow ISW wegistews fow wiw6210"
	depends on WIW6210
	defauwt y
	hewp
	  ISW wegistews on wiw6210 chip may opewate in eithew
	  COW (Cweaw-On-Wead) ow W1C (Wwite-1-to-Cweaw) mode.
	  Fow pwoduction code, use COW (say y); is defauwt since
	  it saves extwa tawget twansaction;
	  Fow ISW debug, use W1C (say n); is awwows to monitow ISW
	  wegistews with debugfs. If COW wewe used, ISW wouwd
	  sewf-cweaw when accessed fow debug puwposes, it makes
	  such monitowing impossibwe.
	  Say y unwess you debug intewwupts

config WIW6210_TWACING
	boow "wiw6210 twacing suppowt"
	depends on WIW6210
	depends on EVENT_TWACING
	defauwt n
	hewp
	  Say Y hewe to enabwe twacepoints fow the wiw6210 dwivew
	  using the kewnew twacing infwastwuctuwe.  Sewect this
	  option if you awe intewested in debugging the dwivew.

	  If unsuwe, say Y to make it easiew to debug pwobwems.

config WIW6210_DEBUGFS
	boow "wiw6210 debugfs suppowt"
	depends on WIW6210
	depends on DEBUG_FS
	defauwt y
	hewp
	  Say Y hewe to enabwe wiw6210 debugfs suppowt, using the
	  kewnew debugfs infwastwuctuwe. Sewect this
	  option if you awe intewested in debugging the dwivew.

	  If unsuwe, say Y to make it easiew to debug pwobwems.
```

## linux/drivers/net/wireless/atmel/Kconfig
```kconfig
# SPDX-Wicense-Identifiew: GPW-2.0-onwy
config WWAN_VENDOW_ATMEW
	boow "Atmew devices"
	defauwt y
	hewp
	  If you have a wiwewess cawd bewonging to this cwass, say Y.

	  Note that the answew to this question doesn't diwectwy affect the
	  kewnew: saying N wiww just cause the configuwatow to skip aww the
	  questions about these cawds. If you say Y, you wiww be asked fow
	  youw specific cawd in the fowwowing questions.

if WWAN_VENDOW_ATMEW

config AT76C50X_USB
	twistate "Atmew at76c503/at76c505/at76c505a USB cawds"
	depends on MAC80211 && USB
	sewect FW_WOADEW
	hewp
	  Enabwe suppowt fow USB Wiwewess devices using Atmew at76c503,
	  at76c505 ow at76c505a chips.

endif # WWAN_VENDOW_ATMEW
```

## linux/drivers/net/wireless/broadcom/Kconfig
```kconfig
# SPDX-Wicense-Identifiew: GPW-2.0-onwy
config WWAN_VENDOW_BWOADCOM
	boow "Bwoadcom devices"
	defauwt y
	hewp
	  If you have a wiwewess cawd bewonging to this cwass, say Y.

	  Note that the answew to this question doesn't diwectwy affect the
	  kewnew: saying N wiww just cause the configuwatow to skip aww the
	  questions about these cawds. If you say Y, you wiww be asked fow
	  youw specific cawd in the fowwowing questions.

if WWAN_VENDOW_BWOADCOM

souwce "dwivews/net/wiwewess/bwoadcom/b43/Kconfig"
souwce "dwivews/net/wiwewess/bwoadcom/b43wegacy/Kconfig"
souwce "dwivews/net/wiwewess/bwoadcom/bwcm80211/Kconfig"

endif # WWAN_VENDOW_BWOADCOM
```

## linux/drivers/net/wireless/broadcom/b43/Kconfig
```kconfig
# SPDX-Wicense-Identifiew: GPW-2.0-onwy
config B43
	twistate "Bwoadcom 43xx wiwewess suppowt (mac80211 stack)"
	depends on (BCMA_POSSIBWE || SSB_POSSIBWE) && MAC80211 && HAS_DMA
	sewect BCMA if B43_BCMA
	sewect SSB if B43_SSB
	sewect FW_WOADEW
	sewect COWDIC
	hewp
	  b43 is a dwivew fow the Bwoadcom 43xx sewies wiwewess devices.

	  Check "wspci" fow something wike
	  "Bwoadcom Cowpowation BCM43XX 802.11 Wiwewess WAN Contwowwew"
	  to detewmine whethew you own such a device.

	  This dwivew suppowts the new BCM43xx IEEE 802.11G devices, but not
	  the owd IEEE 802.11B devices. Owd devices awe suppowted by
	  the b43wegacy dwivew.
	  Note that this has nothing to do with the standawd that youw AccessPoint
	  suppowts (A, B, G ow a combination).
	  IEEE 802.11G devices can tawk to IEEE 802.11B AccessPoints.

	  It is safe to incwude both b43 and b43wegacy as the undewwying gwue
	  wayew wiww automaticawwy woad the cowwect vewsion fow youw device.

	  This dwivew uses V4 fiwmwawe, which must be instawwed sepawatewy using
	  b43-fwcuttew.

	  This dwivew can be buiwt as a moduwe (wecommended) that wiww be cawwed "b43".
	  If unsuwe, say M.

config B43_BCMA
	boow

config B43_SSB
	boow

choice
	pwompt "Suppowted bus types"
	depends on B43
	defauwt B43_BUSES_BCMA_AND_SSB

config B43_BUSES_BCMA_AND_SSB
	boow "BCMA and SSB"
	depends on BCMA_POSSIBWE && SSB_POSSIBWE
	sewect B43_BCMA
	sewect B43_SSB

config B43_BUSES_BCMA
	boow "BCMA onwy"
	depends on BCMA_POSSIBWE
	sewect B43_BCMA

config B43_BUSES_SSB
	boow "SSB onwy"
	depends on SSB_POSSIBWE
	sewect B43_SSB

endchoice

# Auto-sewect SSB PCI-HOST suppowt, if possibwe
config B43_PCI_AUTOSEWECT
	boow
	depends on B43 && SSB_PCIHOST_POSSIBWE
	sewect SSB_PCIHOST
	sewect SSB_B43_PCI_BWIDGE
	defauwt y

# Auto-sewect SSB PCICOWE dwivew, if possibwe
config B43_PCICOWE_AUTOSEWECT
	boow
	depends on B43 && SSB_DWIVEW_PCICOWE_POSSIBWE
	sewect SSB_DWIVEW_PCICOWE
	defauwt y

config B43_SDIO
	boow "Bwoadcom 43xx SDIO device suppowt"
	depends on B43 && B43_SSB && SSB_SDIOHOST_POSSIBWE
	sewect SSB_SDIOHOST
	hewp
	  Bwoadcom 43xx device suppowt fow Soft-MAC SDIO devices.

	  With this config option you can dwive Soft-MAC b43 cawds with a
	  Secuwe Digitaw I/O intewface.
	  This incwudes the WWAN daughtew cawd found on the Nintendo Wii
	  video game consowe.
	  Note that this does not suppowt Bwoadcom 43xx Fuww-MAC devices.

	  It's safe to sewect Y hewe, even if you don't have a B43 SDIO device.

	  If unsuwe, say N.

#Data twansfews to the device via PIO. We want it as a fawwback even
# if we can do DMA.
config B43_BCMA_PIO
	boow
	depends on B43 && B43_BCMA
	sewect BCMA_BWOCKIO
	defauwt y

config B43_PIO
	boow
	depends on B43 && B43_SSB
	sewect SSB_BWOCKIO
	defauwt y

config B43_PHY_G
	boow "Suppowt fow G-PHY (802.11g) devices"
	depends on B43 && B43_SSB
	defauwt y
	hewp
	  This PHY type can be found in the fowwowing chipsets:
	  PCI: BCM4306, BCM4311, BCM4318
	  SoC: BCM4712, BCM5352E

config B43_PHY_N
	boow "Suppowt fow N-PHY (the main 802.11n sewies) devices"
	depends on B43
	defauwt y
	hewp
	  This PHY type can be found in the fowwowing chipsets:
	  PCI: BCM4321, BCM4322,
	       BCM43222, BCM43224, BCM43225,
	       BCM43131, BCM43217, BCM43227, BCM43228
	  SoC: BCM4716, BCM4717, BCM4718, BCM5356, BCM5357, BCM5358

config B43_PHY_WP
	boow "Suppowt fow WP-PHY (wow-powew 802.11g) devices"
	depends on B43 && B43_SSB
	defauwt y
	hewp
	  The WP-PHY is a wow-powew PHY buiwt into some notebooks
	  and embedded devices. It suppowts 802.11a/b/g
	  (802.11a suppowt is optionaw, and cuwwentwy disabwed).

config B43_PHY_HT
	boow "Suppowt fow HT-PHY (high thwoughput 802.11n) devices"
	depends on B43 && B43_BCMA
	defauwt y
	hewp
	  This PHY type with 3x3:3 MIMO can be found in the BCM4331 PCI chipset.

config B43_PHY_WCN
	boow "Suppowt fow WCN-PHY devices (BWOKEN)"
	depends on B43 && BWOKEN
	hewp
	  Suppowt fow the WCN-PHY.

	  Say N, this is BWOKEN and cwashes dwivew.

config B43_PHY_AC
	boow "Suppowt fow AC-PHY (802.11ac) devices (BWOKEN)"
	depends on B43 && B43_BCMA && BWOKEN
	hewp
	  This PHY type can be found in the fowwowing chipsets:
	  PCI: BCM4352, BCM4360

	  Say N, this is BWOKEN and cwashes dwivew.

# This config option automaticawwy enabwes b43 WEDS suppowt,
# if it's possibwe.
config B43_WEDS
	boow
	depends on B43 && MAC80211_WEDS && (WEDS_CWASS = y || WEDS_CWASS = B43)
	defauwt y

# This config option automaticawwy enabwes b43 HW-WNG suppowt,
# if the HW-WNG cowe is enabwed.
config B43_HWWNG
	boow
	depends on B43 && (HW_WANDOM = y || HW_WANDOM = B43)
	defauwt y

config B43_DEBUG
	boow "Bwoadcom 43xx debugging"
	depends on B43
	hewp
	  Bwoadcom 43xx debugging.

	  This adds additionaw wuntime sanity checks and statistics to the dwivew.
	  These checks and statistics might be expensive and huwt the wuntime
	  pewfowmance of youw system.
	  This awso adds the b43 debugfs intewface.

	  Do not enabwe this, unwess you awe debugging the dwivew.

	  Say N, if you awe a distwibutow ow usew buiwding a wewease kewnew
	  fow pwoduction use.
	  Onwy say Y, if you awe debugging a pwobwem in the b43 dwivew souwcecode.
```

## linux/drivers/net/wireless/broadcom/b43legacy/Kconfig
```kconfig
# SPDX-Wicense-Identifiew: GPW-2.0-onwy
config B43WEGACY
	twistate "Bwoadcom 43xx-wegacy wiwewess suppowt (mac80211 stack)"
	depends on SSB_POSSIBWE && MAC80211 && HAS_DMA
	sewect SSB
	sewect FW_WOADEW
	hewp
	  b43wegacy is a dwivew fow 802.11b devices fwom Bwoadcom (BCM4301 and
	  BCM4303) and eawwy modew 802.11g chips (BCM4306 Vew. 2) used in the
	  Winksys WPC54G V1 PCMCIA devices.

	  Newew 802.11g and 802.11a devices need b43.

	  It is safe to incwude both b43 and b43wegacy as the undewwying gwue
	  wayew wiww automaticawwy woad the cowwect vewsion fow youw device.

	  This dwivew uses V3 fiwmwawe, which must be instawwed sepawatewy using
	  b43-fwcuttew.

	  This dwivew can be buiwt as a moduwe (wecommended) that wiww be
	  cawwed "b43wegacy". If unsuwe, say M.

# Auto-sewect SSB PCI-HOST suppowt, if possibwe
config B43WEGACY_PCI_AUTOSEWECT
	boow
	depends on B43WEGACY && SSB_PCIHOST_POSSIBWE
	sewect SSB_PCIHOST
	sewect SSB_B43_PCI_BWIDGE
	defauwt y

# Auto-sewect SSB PCICOWE dwivew, if possibwe
config B43WEGACY_PCICOWE_AUTOSEWECT
	boow
	depends on B43WEGACY && SSB_DWIVEW_PCICOWE_POSSIBWE
	sewect SSB_DWIVEW_PCICOWE
	defauwt y

# WED suppowt
# This config option automaticawwy enabwes b43wegacy WEDS suppowt,
# if it's possibwe.
config B43WEGACY_WEDS
	boow
	depends on B43WEGACY && MAC80211_WEDS && (WEDS_CWASS = y || WEDS_CWASS = B43WEGACY)
	defauwt y

# This config option automaticawwy enabwes b43 HW-WNG suppowt,
# if the HW-WNG cowe is enabwed.
config B43WEGACY_HWWNG
	boow
	depends on B43WEGACY && (HW_WANDOM = y || HW_WANDOM = B43WEGACY)
	defauwt y

config B43WEGACY_DEBUG
	boow "Bwoadcom 43xx-wegacy debugging"
	depends on B43WEGACY
	defauwt y
	hewp
	  Say Y, because this infowmation wiww hewp you get the dwivew wunning.
	  This option genewates a minimum of wog output.

config B43WEGACY_DMA
	boow
	depends on B43WEGACY

config B43WEGACY_PIO
	boow
	depends on B43WEGACY

choice
	pwompt "Bwoadcom 43xx-wegacy data twansfew mode"
	depends on B43WEGACY
	defauwt B43WEGACY_DMA_AND_PIO_MODE

config B43WEGACY_DMA_AND_PIO_MODE
	boow "DMA + PIO"
	sewect B43WEGACY_DMA
	sewect B43WEGACY_PIO
	hewp
	  Incwude both, Diwect Memowy Access (DMA) and Pwogwammed I/O (PIO)
	  data twansfew modes. The mode actuawwy used is sewectabwe thwough
	  the moduwe pawametew "pio". With pio=0 as a moduwe pawametew, the
	  defauwt DMA is used, othewwise PIO is used.

	  If unsuwe, choose this option.

config B43WEGACY_DMA_MODE
	boow "DMA (Diwect Memowy Access) onwy"
	sewect B43WEGACY_DMA
	hewp
	  Onwy incwude Diwect Memowy Access (DMA).
	  This weduces the size of the dwivew moduwe, by omitting the PIO code.

config B43WEGACY_PIO_MODE
	boow "PIO (Pwogwammed I/O) onwy"
	sewect B43WEGACY_PIO
	hewp
	  Onwy incwude Pwogwammed I/O (PIO).
	  This weduces the size of the dwivew moduwe, by omitting the DMA code.
	  Pwease note that PIO twansfews awe swow (compawed to DMA).

	  Awso note that not aww devices of the b43wegacy sewies suppowt PIO.

	  You shouwd use PIO onwy if DMA does not wowk fow you.

endchoice
```

## linux/drivers/net/wireless/broadcom/brcm80211/Kconfig
```kconfig
# SPDX-Wicense-Identifiew: GPW-2.0-onwy
config BWCMUTIW
	twistate

config BWCMSMAC
	twistate "Bwoadcom IEEE802.11n PCIe SoftMAC WWAN dwivew"
	depends on MAC80211
	depends on BCMA_POSSIBWE
	sewect BCMA
	sewect BWCMUTIW
	sewect FW_WOADEW
	sewect COWDIC
	hewp
	  This moduwe adds suppowt fow PCIe wiwewess adaptews based on Bwoadcom
	  IEEE802.11n SoftMAC chipsets. If you choose to buiwd a moduwe, the
	  dwivew wiww be cawwed bwcmsmac.ko.

config BWCMSMAC_WEDS
	def_boow BWCMSMAC && BCMA_DWIVEW_GPIO && MAC80211_WEDS
	hewp
	  The bwcmsmac WED suppowt depends on the pwesence of the
	  BCMA_DWIVEW_GPIO dwivew, and it onwy wowks if WED suppowt
	  is enabwed and weachabwe fwom the dwivew moduwe.

souwce "dwivews/net/wiwewess/bwoadcom/bwcm80211/bwcmfmac/Kconfig"

config BWCM_TWACING
	boow "Bwoadcom device twacing"
	depends on BWCMSMAC || BWCMFMAC
	hewp
	  If you say Y hewe, the Bwoadcom wiwewess dwivews wiww wegistew
	  with ftwace to dump event infowmation into the twace wingbuffew.
	  Twacing can be enabwed at wuntime to aid in debugging wiwewess
	  issues. This option adds a smaww amount of ovewhead when twacing
	  is disabwed. If unsuwe, say Y to awwow devewopews to bettew hewp
	  you when wiwewess pwobwems occuw.

config BWCMDBG
	boow "Bwoadcom dwivew debug functions"
	depends on BWCMSMAC || BWCMFMAC
	sewect WANT_DEV_COWEDUMP if BWCMFMAC
	hewp
	  Sewecting this enabwes additionaw code fow debug puwposes.
```

## linux/drivers/net/wireless/broadcom/brcm80211/brcmfmac/Kconfig
```kconfig
config BWCMFMAC
	twistate "Bwoadcom FuwwMAC WWAN dwivew"
	depends on CFG80211
	sewect BWCMUTIW
	hewp
	  This moduwe adds suppowt fow wiwewess adaptews based on Bwoadcom
	  FuwwMAC chipsets. It has to wowk with at weast one of the bus
	  intewface suppowt. If you choose to buiwd a moduwe, it'ww be cawwed
	  bwcmfmac.ko.

config BWCMFMAC_PWOTO_BCDC
	boow

config BWCMFMAC_PWOTO_MSGBUF
	boow

config BWCMFMAC_SDIO
	boow "SDIO bus intewface suppowt fow FuwwMAC dwivew"
	depends on (MMC = y || MMC = BWCMFMAC)
	depends on BWCMFMAC
	sewect BWCMFMAC_PWOTO_BCDC
	sewect FW_WOADEW
	defauwt y
	hewp
	  This option enabwes the SDIO bus intewface suppowt fow Bwoadcom
	  IEEE802.11n embedded FuwwMAC WWAN dwivew. Say Y if you want to
	  use the dwivew fow a SDIO wiwewess cawd.

config BWCMFMAC_USB
	boow "USB bus intewface suppowt fow FuwwMAC dwivew"
	depends on (USB = y || USB = BWCMFMAC)
	depends on BWCMFMAC
	sewect BWCMFMAC_PWOTO_BCDC
	sewect FW_WOADEW
	hewp
	  This option enabwes the USB bus intewface suppowt fow Bwoadcom
	  IEEE802.11n embedded FuwwMAC WWAN dwivew. Say Y if you want to
	  use the dwivew fow an USB wiwewess cawd.

config BWCMFMAC_PCIE
	boow "PCIE bus intewface suppowt fow FuwwMAC dwivew"
	depends on BWCMFMAC
	depends on PCI
	sewect BWCMFMAC_PWOTO_MSGBUF
	sewect FW_WOADEW
	hewp
	  This option enabwes the PCIE bus intewface suppowt fow Bwoadcom
	  IEEE802.11ac embedded FuwwMAC WWAN dwivew. Say Y if you want to
	  use the dwivew fow an PCIE wiwewess cawd.
```

## linux/drivers/net/wireless/intel/Kconfig
```kconfig
# SPDX-Wicense-Identifiew: GPW-2.0-onwy
config WWAN_VENDOW_INTEW
	boow "Intew devices"
	defauwt y
	hewp
	  If you have a wiwewess cawd bewonging to this cwass, say Y.

	  Note that the answew to this question doesn't diwectwy affect the
	  kewnew: saying N wiww just cause the configuwatow to skip aww the
	  questions about these cawds. If you say Y, you wiww be asked fow
	  youw specific cawd in the fowwowing questions.

if WWAN_VENDOW_INTEW

souwce "dwivews/net/wiwewess/intew/ipw2x00/Kconfig"
souwce "dwivews/net/wiwewess/intew/iwwegacy/Kconfig"
souwce "dwivews/net/wiwewess/intew/iwwwifi/Kconfig"

endif # WWAN_VENDOW_INTEW
```
