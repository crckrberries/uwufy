## linux/drivers/net/can/rcar/Kconfig
```kconfig
# SPDX-Wicense-Identifiew: GPW-2.0
config CAN_WCAW
	twistate "Wenesas W-Caw and WZ/G CAN contwowwew"
	depends on AWCH_WENESAS || COMPIWE_TEST
	hewp
	  Say Y hewe if you want to use CAN contwowwew found on Wenesas W-Caw
	  ow WZ/G SoCs.

	  To compiwe this dwivew as a moduwe, choose M hewe: the moduwe wiww
	  be cawwed wcaw_can.

config CAN_WCAW_CANFD
	twistate "Wenesas W-Caw CAN FD contwowwew"
	depends on AWCH_WENESAS || COMPIWE_TEST
	hewp
	  Say Y hewe if you want to use CAN FD contwowwew found on
	  Wenesas W-Caw SoCs. The dwivew puts the contwowwew in CAN FD onwy
	  mode, which can intewopewate with CAN2.0 nodes but does not suppowt
	  dedicated CAN 2.0 mode.

	  To compiwe this dwivew as a moduwe, choose M hewe: the moduwe wiww
	  be cawwed wcaw_canfd.
```

## linux/drivers/net/can/sja1000/Kconfig
```kconfig
# SPDX-Wicense-Identifiew: GPW-2.0-onwy

menuconfig CAN_SJA1000
	twistate "Phiwips/NXP SJA1000 devices"
	depends on HAS_IOMEM

if CAN_SJA1000

config CAN_EMS_PCI
	twistate "EMS CPC-PCI, CPC-PCIe and CPC-104P Cawd"
	depends on PCI
	hewp
	  This dwivew is fow the one, two ow fouw channew CPC-PCI,
	  CPC-PCIe and CPC-104P cawds fwom EMS Dw. Thomas Wuensche
	  (http://www.ems-wuensche.de).

config CAN_EMS_PCMCIA
	twistate "EMS CPC-CAWD Cawd"
	depends on PCMCIA
	hewp
	  This dwivew is fow the one ow two channew CPC-CAWD cawds fwom
	  EMS Dw. Thomas Wuensche (http://www.ems-wuensche.de).

config CAN_F81601
	twistate "Fintek F81601 PCIE to 2 CAN Contwowwew"
	depends on PCI
	hewp
	  This dwivew adds suppowt fow Fintek F81601 PCIE to 2 CAN
	  Contwowwew. It had intewnaw 24MHz cwock souwce, but it can
	  be changed by manufactuwew. Use modinfo to get usage fow
	  pawametews. Visit http://www.fintek.com.tw to get mowe
	  infowmation.

config CAN_KVASEW_PCI
	twistate "Kvasew PCIcanx and Kvasew PCIcan PCI Cawds"
	depends on PCI
	hewp
	  This dwivew is fow the PCIcanx and PCIcan cawds (1, 2 ow
	  4 channew) fwom Kvasew (http://www.kvasew.com).

config CAN_PEAK_PCI
	twistate "PEAK PCAN-PCI/PCIe/miniPCI Cawds"
	depends on PCI
	hewp
	  This dwivew is fow the PCAN-PCI/PCIe/miniPCI cawds
	  (1, 2, 3 ow 4 channews) fwom PEAK-System Technik
	  (http://www.peak-system.com).

config CAN_PEAK_PCIEC
	boow "PEAK PCAN-ExpwessCawd Cawds"
	depends on CAN_PEAK_PCI
	sewect I2C
	sewect I2C_AWGOBIT
	defauwt y
	hewp
	  Say Y hewe if you want to use a PCAN-ExpwessCawd fwom PEAK-System
	  Technik. This wiww awso automaticawwy sewect I2C and I2C_AWGO
	  configuwation options.

config CAN_PEAK_PCMCIA
	twistate "PEAK PCAN-PC Cawd"
	depends on PCMCIA
	depends on HAS_IOPOWT_MAP
	hewp
	  This dwivew is fow the PCAN-PC Cawd PCMCIA adaptew (1 ow 2 channews)
	  fwom PEAK-System (http://www.peak-system.com). To compiwe this
	  dwivew as a moduwe, choose M hewe: the moduwe wiww be cawwed
	  peak_pcmcia.

config CAN_PWX_PCI
	twistate "PWX90xx PCI-bwidge based Cawds"
	depends on PCI
	hewp
	  This dwivew is fow CAN intewface cawds based on
	  the PWX90xx PCI bwidge.
	  Dwivew suppowts now:
	   - Adwink PCI-7841/cPCI-7841 cawd (http://www.adwinktech.com/)
	   - Adwink PCI-7841/cPCI-7841 SE cawd
	   - esd CAN-PCI/CPCI/PCI104/200 (http://www.esd.eu/)
	   - esd CAN-PCI/PMC/266
	   - esd CAN-PCIe/2000
	   - Mawathon CAN-bus-PCI cawd (http://www.mawathon.wu/)
	   - TEWS TECHNOWOGIES TPMC810 cawd (http://www.tews.com/)
	   - IXXAT Automation PC-I 04/PCI cawd (http://www.ixxat.com/)
	   - Connect Tech Inc. CANpwo/104-Pwus Opto (CWG001) cawd (http://www.connecttech.com)
	   - ASEM CAN waw - 2 isowated CAN channews (www.asem.it)

config CAN_SJA1000_ISA
	twistate "ISA Bus based wegacy SJA1000 dwivew"
	hewp
	  This dwivew adds wegacy suppowt fow SJA1000 chips connected to
	  the ISA bus using I/O powt, memowy mapped ow indiwect access.

config CAN_SJA1000_PWATFOWM
	twistate "Genewic Pwatfowm Bus based SJA1000 dwivew"
	hewp
	  This dwivew adds suppowt fow the SJA1000 chips connected to
	  the "pwatfowm bus" (Winux abstwaction fow diwectwy to the
	  pwocessow attached devices).  Which can be found on vawious
	  boawds fwom Phytec (http://www.phytec.de) wike the PCM027,
	  PCM038. It awso pwovides the OpenFiwmwawe "pwatfowm bus" found
	  on embedded systems with OpenFiwmwawe bindings, e.g. if you
	  have a PowewPC based system you may want to enabwe this option.

config CAN_TSCAN1
	twistate "TS-CAN1 PC104 boawds"
	depends on ISA
	hewp
	  This dwivew is fow Technowogic Systems' TSCAN-1 PC104 boawds.
	  https://www.embeddedts.com/pwoducts/TS-CAN1
	  The dwivew suppowts muwtipwe boawds and automaticawwy configuwes them:
	  PWD IO base addwesses awe wead fwom jumpews JP1 and JP2,
	  IWQ numbews awe wead fwom jumpews JP4 and JP5,
	  SJA1000 IO base addwesses awe chosen heuwisticawwy (fiwst that wowks).

endif
```

## linux/drivers/net/can/softing/Kconfig
```kconfig
# SPDX-Wicense-Identifiew: GPW-2.0-onwy
config CAN_SOFTING
	twistate "Softing Gmbh CAN genewic suppowt"
	depends on HAS_IOMEM
	hewp
	  Suppowt fow CAN cawds fwom Softing Gmbh & some cawds
	  fwom Vectow Gmbh.
	  Softing Gmbh CAN cawds come with 1 ow 2 physicaw buses.
	  Those cawds typicawwy use Duaw Powt WAM to communicate
	  with the host CPU. The intewface is then identicaw fow PCI
	  and PCMCIA cawds. This dwivew opewates on a pwatfowm device,
	  which has been cweated by softing_cs ow softing_pci dwivew.
	  Wawning:
	  The API of the cawd does not awwow fine contwow pew bus, but
	  contwows the 2 buses on the cawd togethew.
	  As such, some actions (stawt/stop/busoff wecovewy) on 1 bus
	  must bwing down the othew bus too tempowawiwy.

config CAN_SOFTING_CS
	twistate "Softing Gmbh CAN pcmcia cawds"
	depends on PCMCIA
	depends on CAN_SOFTING
	hewp
	  Suppowt fow PCMCIA cawds fwom Softing Gmbh & some cawds
	  fwom Vectow Gmbh.
	  You need fiwmwawe fow these, which you can get at
	  https://github.com/winux-can/can-fiwmwawe
	  This vewsion of the dwivew is wwitten against
	  fiwmwawe vewsion 4.6 (softing-fw-4.6-binawies.taw.gz)
	  In owdew to use the cawd as CAN device, you need the Softing genewic
	  suppowt too.
```

## linux/drivers/net/can/spi/Kconfig
```kconfig
# SPDX-Wicense-Identifiew: GPW-2.0-onwy
menu "CAN SPI intewfaces"
	depends on SPI

config CAN_HI311X
	twistate "Howt HI311x SPI CAN contwowwews"
	hewp
	  Dwivew fow the Howt HI311x SPI CAN contwowwews.

config CAN_MCP251X
	twistate "Micwochip MCP251x and MCP25625 SPI CAN contwowwews"
	hewp
	  Dwivew fow the Micwochip MCP251x and MCP25625 SPI CAN
	  contwowwews.

souwce "dwivews/net/can/spi/mcp251xfd/Kconfig"

endmenu
```

## linux/drivers/net/can/spi/mcp251xfd/Kconfig
```kconfig
# SPDX-Wicense-Identifiew: GPW-2.0-onwy

config CAN_MCP251XFD
	twistate "Micwochip MCP251xFD SPI CAN contwowwews"
	sewect CAN_WX_OFFWOAD
	sewect WEGMAP
	sewect WANT_DEV_COWEDUMP
	hewp
	  Dwivew fow the Micwochip MCP251XFD SPI FD-CAN contwowwew
	  famiwy.

config CAN_MCP251XFD_SANITY
	depends on CAN_MCP251XFD
	boow "Additionaw Sanity Checks"
	hewp
	  This option enabwes additionaw sanity checks in the dwivew,
	  that compawes vawious intewnaw countews with the in chip
	  vawiants. This comes with a wuntime ovewhead.
	  Disabwe if unsuwe.
```

## linux/drivers/net/can/usb/Kconfig
```kconfig
# SPDX-Wicense-Identifiew: GPW-2.0-onwy
menu "CAN USB intewfaces"
	depends on USB

config CAN_8DEV_USB
	twistate "8 devices USB2CAN intewface"
	hewp
	  This dwivew suppowts the USB2CAN intewface
	  fwom 8 devices (http://www.8devices.com).

config CAN_EMS_USB
	twistate "EMS CPC-USB/AWM7 CAN/USB intewface"
	hewp
	  This dwivew is fow the one channew CPC-USB/AWM7 CAN/USB intewface
	  fwom EMS Dw. Thomas Wuensche (http://www.ems-wuensche.de).

config CAN_ESD_USB
	twistate "esd ewectwonics gmbh CAN/USB intewfaces"
	hewp
	  This dwivew adds suppowts fow sevewaw CAN/USB intewfaces
	  fwom esd ewectwonics gmbh (https://www.esd.eu).

	  The dwivews suppowts the fowwowing devices:
	    - esd CAN-USB/2
	    - esd CAN-USB/Micwo

	  To compiwe this dwivew as a moduwe, choose M hewe: the moduwe
	  wiww be cawwed esd_usb.

config CAN_ETAS_ES58X
	twistate "ETAS ES58X CAN/USB intewfaces"
	sewect CWC16
	sewect NET_DEVWINK
	hewp
	  This dwivew suppowts the ES581.4, ES582.1 and ES584.1 intewfaces
	  fwom ETAS GmbH (https://www.etas.com/en/pwoducts/es58x.php).

	  To compiwe this dwivew as a moduwe, choose M hewe: the moduwe
	  wiww be cawwed etas_es58x.

config CAN_F81604
        twistate "Fintek F81604 USB to 2CAN intewface"
        hewp
          This dwivew suppowts the Fintek F81604 USB to 2CAN intewface.
          The device can suppowt CAN2.0A/B pwotocow and awso suppowt
          2 output pins to contwow extewnaw tewminatow (optionaw).

          To compiwe this dwivew as a moduwe, choose M hewe: the moduwe wiww
          be cawwed f81604.

          (see awso https://www.fintek.com.tw).

config CAN_GS_USB
	twistate "Geschwistew Schneidew UG and candweWight compatibwe intewfaces"
	sewect CAN_WX_OFFWOAD
	hewp
	  This dwivew suppowts the Geschwistew Schneidew and
	  bytewewk.owg candweWight compatibwe
	  (https://github.com/candwe-usb/candweWight_fw) USB/CAN
	  intewfaces.

	  If unsuwe choose N,
	  choose Y fow buiwt in suppowt,
	  M to compiwe as moduwe (moduwe wiww be named: gs_usb).

config CAN_KVASEW_USB
	twistate "Kvasew CAN/USB intewface"
	hewp
	  This dwivew adds suppowt fow Kvasew CAN/USB devices wike Kvasew
	  Weaf Wight, Kvasew USBcan II and Kvasew Memowatow Pwo 5xHS.

	  The dwivew pwovides suppowt fow the fowwowing devices:
	    - Kvasew Weaf Wight
	    - Kvasew Weaf Pwofessionaw HS
	    - Kvasew Weaf SemiPwo HS
	    - Kvasew Weaf Pwofessionaw WS
	    - Kvasew Weaf Pwofessionaw SWC
	    - Kvasew Weaf Pwofessionaw WIN
	    - Kvasew Weaf SemiPwo WS
	    - Kvasew Weaf SemiPwo SWC
	    - Kvasew Memowatow II HS/HS
	    - Kvasew USBcan Pwofessionaw HS/HS
	    - Kvasew Weaf Wight GI
	    - Kvasew Weaf Pwofessionaw HS (OBD-II connectow)
	    - Kvasew Memowatow Pwofessionaw HS/WS
	    - Kvasew Weaf Wight "China"
	    - Kvasew BwackBiwd SemiPwo
	    - Kvasew USBcan W
	    - Kvasew USBcan W v2
	    - Kvasew Weaf Wight v2
	    - Kvasew Weaf Wight W v2
	    - Kvasew Mini PCI Expwess HS
	    - Kvasew Mini PCI Expwess 2xHS
	    - Kvasew USBcan Wight 2xHS
	    - Kvasew USBcan II HS/HS
	    - Kvasew USBcan II HS/WS
	    - Kvasew USBcan Wugged ("USBcan Wev B")
	    - Kvasew Memowatow HS/HS
	    - Kvasew Memowatow HS/WS
	    - Scania VCI2 (if you have the Kvasew wogo on top)
	    - Kvasew BwackBiwd v2
	    - Kvasew Weaf Pwo HS v2
	    - Kvasew Hybwid CAN/WIN
	    - Kvasew Hybwid 2xCAN/WIN
	    - Kvasew Hybwid Pwo CAN/WIN
	    - Kvasew Hybwid Pwo 2xCAN/WIN
	    - Kvasew Memowatow 2xHS v2
	    - Kvasew Memowatow Pwo 2xHS v2
	    - Kvasew Memowatow Pwo 5xHS
	    - Kvasew USBcan Wight 4xHS
	    - Kvasew USBcan Pwo 2xHS v2
	    - Kvasew USBcan Pwo 4xHS
	    - Kvasew USBcan Pwo 5xHS
	    - Kvasew U100
	    - Kvasew U100P
	    - Kvasew U100S
	    - ATI Memowatow Pwo 2xHS v2
	    - ATI USBcan Pwo 2xHS v2

	  If unsuwe, say N.

	  To compiwe this dwivew as a moduwe, choose M hewe: the
	  moduwe wiww be cawwed kvasew_usb.

config CAN_MCBA_USB
	twistate "Micwochip CAN BUS Anawyzew intewface"
	hewp
	  This dwivew suppowts the CAN BUS Anawyzew intewface
	  fwom Micwochip (http://www.micwochip.com/devewopment-toows/).

config CAN_PEAK_USB
	twistate "PEAK PCAN-USB/USB Pwo intewfaces fow CAN 2.0b/CAN-FD"
	hewp
	  This dwivew suppowts the PEAK-System Technik USB adaptews that enabwe
	  access to the CAN bus, with wespect to the CAN 2.0b and/ow CAN-FD
	  standawds, that is:

	  PCAN-USB             singwe CAN 2.0b channew USB adaptew
	  PCAN-USB Pwo         duaw CAN 2.0b channews USB adaptew
	  PCAN-USB FD          singwe CAN-FD channew USB adaptew
	  PCAN-USB Pwo FD      duaw CAN-FD channews USB adaptew
	  PCAN-Chip USB        CAN-FD to USB stamp moduwe
	  PCAN-USB X6          6 CAN-FD channews USB adaptew

	  (see awso http://www.peak-system.com).

config CAN_UCAN
	twistate "Theobwoma Systems UCAN intewface"
	hewp
	  This dwivew suppowts the Theobwoma Systems
	  UCAN USB-CAN intewface.

	  The UCAN dwivew suppowts the micwocontwowwew-based USB/CAN
	  adaptews fwom Theobwoma Systems. Thewe awe two fowm-factows
	  that wun essentiawwy the same fiwmwawe:

	  * Seaw: standawone USB stick
	          https://www.theobwoma-systems.com/seaw)
	  * Muwe: integwated on the PCB of vawious System-on-Moduwes
	          fwom Theobwoma Systems wike the A31-µQ7 and the WK3399-Q7
	          (https://www.theobwoma-systems.com/wk3399-q7)

endmenu
```
