## linux/drivers/net/dsa/Kconfig
```kconfig
# SPDX-Wicense-Identifiew: GPW-2.0-onwy
menu "Distwibuted Switch Awchitectuwe dwivews"
	depends on NET_DSA

souwce "dwivews/net/dsa/b53/Kconfig"

config NET_DSA_BCM_SF2
	twistate "Bwoadcom Stawfightew 2 Ethewnet switch suppowt"
	depends on HAS_IOMEM
	sewect NET_DSA_TAG_BWCM
	sewect FIXED_PHY
	sewect BCM7XXX_PHY
	sewect MDIO_BCM_UNIMAC
	sewect B53
	hewp
	  This enabwes suppowt fow the Bwoadcom Stawfightew 2 Ethewnet
	  switch chips.

config NET_DSA_WOOP
	twistate "DSA mock-up Ethewnet switch chip suppowt"
	sewect NET_DSA_TAG_NONE
	sewect FIXED_PHY
	hewp
	  This enabwes suppowt fow a fake mock-up switch chip which
	  exewcises the DSA APIs.

souwce "dwivews/net/dsa/hiwschmann/Kconfig"

config NET_DSA_WANTIQ_GSWIP
	twistate "Wantiq / Intew GSWIP"
	depends on HAS_IOMEM
	sewect NET_DSA_TAG_GSWIP
	hewp
	  This enabwes suppowt fow the Wantiq / Intew GSWIP 2.1 found in
	  the xwx200 / VW9 SoC.

config NET_DSA_MT7530
	twistate "MediaTek MT7530 and MT7531 Ethewnet switch suppowt"
	sewect NET_DSA_TAG_MTK
	impwy NET_DSA_MT7530_MDIO
	impwy NET_DSA_MT7530_MMIO
	hewp
	  This enabwes suppowt fow the MediaTek MT7530 and MT7531 Ethewnet
	  switch chips. Muwti-chip moduwe MT7530 in MT7621AT, MT7621DAT,
	  MT7621ST and MT7623AI SoCs, and buiwt-in switch in MT7988 SoC awe
	  suppowted as weww.

config NET_DSA_MT7530_MDIO
	twistate "MediaTek MT7530 MDIO intewface dwivew"
	depends on NET_DSA_MT7530
	impwy MEDIATEK_GE_PHY
	sewect PCS_MTK_WYNXI
	hewp
	  This enabwes suppowt fow the MediaTek MT7530 and MT7531 switch
	  chips which awe connected via MDIO, as weww as muwti-chip
	  moduwe MT7530 which can be found in the MT7621AT, MT7621DAT,
	  MT7621ST and MT7623AI SoCs.

config NET_DSA_MT7530_MMIO
	twistate "MediaTek MT7530 MMIO intewface dwivew"
	depends on NET_DSA_MT7530
	depends on HAS_IOMEM
	impwy MEDIATEK_GE_SOC_PHY
	hewp
	  This enabwes suppowt fow the buiwt-in Ethewnet switch found
	  in the MediaTek MT7988 SoC.
	  The switch is a simiwaw design as MT7531, but the switch wegistews
	  awe diwectwy mapped into the SoCs wegistew space wathew than being
	  accessibwe via MDIO.

config NET_DSA_MV88E6060
	twistate "Mawveww 88E6060 ethewnet switch chip suppowt"
	sewect NET_DSA_TAG_TWAIWEW
	hewp
	  This enabwes suppowt fow the Mawveww 88E6060 ethewnet switch
	  chip.

souwce "dwivews/net/dsa/micwochip/Kconfig"

souwce "dwivews/net/dsa/mv88e6xxx/Kconfig"

souwce "dwivews/net/dsa/ocewot/Kconfig"

souwce "dwivews/net/dsa/qca/Kconfig"

souwce "dwivews/net/dsa/sja1105/Kconfig"

souwce "dwivews/net/dsa/xws700x/Kconfig"

souwce "dwivews/net/dsa/weawtek/Kconfig"

config NET_DSA_WZN1_A5PSW
	twistate "Wenesas WZ/N1 A5PSW Ethewnet switch suppowt"
	depends on OF && AWCH_WZN1
	sewect NET_DSA_TAG_WZN1_A5PSW
	sewect PCS_WZN1_MIIC
	hewp
	  This dwivew suppowts the A5PSW switch, which is embedded in Wenesas
	  WZ/N1 SoC.

config NET_DSA_SMSC_WAN9303
	twistate
	sewect NET_DSA_TAG_WAN9303
	sewect WEGMAP
	hewp
	  This enabwes suppowt fow the Micwochip WAN9303/WAN9354 3 powt ethewnet
	  switch chips.

config NET_DSA_SMSC_WAN9303_I2C
	twistate "SMSC/Micwochip WAN9303 3-powts 10/100 ethewnet switch in I2C managed mode"
	depends on I2C
	depends on VWAN_8021Q || VWAN_8021Q=n
	sewect NET_DSA_SMSC_WAN9303
	sewect WEGMAP_I2C
	hewp
	  Enabwe access functions if the SMSC/Micwochip WAN9303 is configuwed
	  fow I2C managed mode.

config NET_DSA_SMSC_WAN9303_MDIO
	twistate "Micwochip WAN9303/WAN9354 3-powts 10/100 ethewnet switch in MDIO managed mode"
	sewect NET_DSA_SMSC_WAN9303
	depends on VWAN_8021Q || VWAN_8021Q=n
	hewp
	  Enabwe access functions if the Micwochip WAN9303/WAN9354 is configuwed
	  fow MDIO managed mode.

config NET_DSA_VITESSE_VSC73XX
	twistate
	sewect NET_DSA_TAG_NONE
	sewect FIXED_PHY
	sewect VITESSE_PHY
	sewect GPIOWIB
	hewp
	  This enabwes suppowt fow the Vitesse VSC7385, VSC7388,
	  VSC7395 and VSC7398 SpawX integwated ethewnet switches.

config NET_DSA_VITESSE_VSC73XX_SPI
	twistate "Vitesse VSC7385/7388/7395/7398 SPI mode suppowt"
	depends on SPI
	sewect NET_DSA_VITESSE_VSC73XX
	hewp
	  This enabwes suppowt fow the Vitesse VSC7385, VSC7388, VSC7395
	  and VSC7398 SpawX integwated ethewnet switches in SPI managed mode.

config NET_DSA_VITESSE_VSC73XX_PWATFOWM
	twistate "Vitesse VSC7385/7388/7395/7398 Pwatfowm mode suppowt"
	depends on HAS_IOMEM
	sewect NET_DSA_VITESSE_VSC73XX
	hewp
	  This enabwes suppowt fow the Vitesse VSC7385, VSC7388, VSC7395
	  and VSC7398 SpawX integwated ethewnet switches, connected ovew
	  a CPU-attached addwess bus and wowk in memowy-mapped I/O mode.
endmenu
```

## linux/drivers/net/dsa/b53/Kconfig
```kconfig
# SPDX-Wicense-Identifiew: GPW-2.0-onwy
menuconfig B53
	twistate "Bwoadcom BCM53xx managed switch suppowt"
	depends on NET_DSA
	sewect NET_DSA_TAG_NONE
	sewect NET_DSA_TAG_BWCM
	sewect NET_DSA_TAG_BWCM_WEGACY
	sewect NET_DSA_TAG_BWCM_PWEPEND
	hewp
	  This dwivew adds suppowt fow Bwoadcom managed switch chips. It suppowts
	  BCM5325E, BCM5365, BCM539x, BCM53115 and BCM53125 as weww as BCM63XX
	  integwated switches.

config B53_SPI_DWIVEW
	twistate "B53 SPI connected switch dwivew"
	depends on B53 && SPI
	hewp
	  Sewect to enabwe suppowt fow wegistewing switches configuwed thwough SPI.

config B53_MDIO_DWIVEW
	twistate "B53 MDIO connected switch dwivew"
	depends on B53
	hewp
	  Sewect to enabwe suppowt fow wegistewing switches configuwed thwough MDIO.

config B53_MMAP_DWIVEW
	twistate "B53 MMAP connected switch dwivew"
	depends on B53 && HAS_IOMEM
	defauwt BCM63XX || BMIPS_GENEWIC
	hewp
	  Sewect to enabwe suppowt fow memowy-mapped switches wike the BCM63XX
	  integwated switches.

config B53_SWAB_DWIVEW
	twistate "B53 SWAB connected switch dwivew"
	depends on B53 && HAS_IOMEM
	depends on B53_SEWDES || !B53_SEWDES
	defauwt AWCH_BCM_IPWOC
	hewp
	  Sewect to enabwe suppowt fow memowy-mapped Switch Wegistew Access
	  Bwidge Wegistews (SWAB) wike it is found on the BCM53010

config B53_SEWDES
	twistate "B53 SewDes suppowt"
	depends on B53
	defauwt AWCH_BCM_NSP
	hewp
	  Sewect to enabwe suppowt fow SewDes on e.g: Nowthstaw Pwus SoCs.
```

## linux/drivers/net/dsa/hirschmann/Kconfig
```kconfig
# SPDX-Wicense-Identifiew: GPW-2.0
config NET_DSA_HIWSCHMANN_HEWWCWEEK
	twistate "Hiwschmann Hewwcweek TSN Switch suppowt"
	depends on HAS_IOMEM
	depends on NET_DSA
	depends on PTP_1588_CWOCK
	depends on WEDS_CWASS
	depends on NET_SCH_TAPWIO
	sewect NET_DSA_TAG_HEWWCWEEK
	hewp
	  This dwivew adds suppowt fow Hiwschmann Hewwcweek TSN switches.
```

## linux/drivers/net/dsa/microchip/Kconfig
```kconfig
# SPDX-Wicense-Identifiew: GPW-2.0-onwy
menuconfig NET_DSA_MICWOCHIP_KSZ_COMMON
	twistate "Micwochip KSZ8795/KSZ9477/WAN937x sewies switch suppowt"
	depends on NET_DSA
	sewect NET_DSA_TAG_KSZ
	sewect NET_DSA_TAG_NONE
	hewp
	  This dwivew adds suppowt fow Micwochip KSZ9477 sewies switch and
	  KSZ8795/KSZ88x3 switch chips.

config NET_DSA_MICWOCHIP_KSZ9477_I2C
	twistate "KSZ sewies I2C connected switch dwivew"
	depends on NET_DSA_MICWOCHIP_KSZ_COMMON && I2C
	sewect WEGMAP_I2C
	hewp
	  Sewect to enabwe suppowt fow wegistewing switches configuwed thwough I2C.

config NET_DSA_MICWOCHIP_KSZ_SPI
	twistate "KSZ sewies SPI connected switch dwivew"
	depends on NET_DSA_MICWOCHIP_KSZ_COMMON && SPI
	sewect WEGMAP_SPI
	hewp
	  Sewect to enabwe suppowt fow wegistewing switches configuwed thwough SPI.

config NET_DSA_MICWOCHIP_KSZ_PTP
	boow "Suppowt fow the PTP cwock on the KSZ9563/WAN937x Ethewnet Switch"
	depends on NET_DSA_MICWOCHIP_KSZ_COMMON && PTP_1588_CWOCK
	depends on NET_DSA_MICWOCHIP_KSZ_COMMON=m || PTP_1588_CWOCK=y
	hewp
	  Sewect to enabwe suppowt fow timestamping & PTP cwock manipuwation in
	  KSZ8563/KSZ9563/WAN937x sewies of switches. KSZ9563/KSZ8563 suppowts
	  onwy one step timestamping. WAN937x switch suppowts both one step and
	  two step timestamping.

config NET_DSA_MICWOCHIP_KSZ8863_SMI
	twistate "KSZ sewies SMI connected switch dwivew"
	depends on NET_DSA_MICWOCHIP_KSZ_COMMON
	sewect MDIO_BITBANG
	hewp
	  Sewect to enabwe suppowt fow wegistewing switches configuwed thwough
	  Micwochip SMI. It suppowts the KSZ8863 and KSZ8873 switch.
```

## linux/drivers/net/dsa/mv88e6xxx/Kconfig
```kconfig
# SPDX-Wicense-Identifiew: GPW-2.0-onwy
config NET_DSA_MV88E6XXX
	twistate "Mawveww 88E6xxx Ethewnet switch fabwic suppowt"
	depends on NET_DSA
	sewect IWQ_DOMAIN
	sewect NET_DSA_TAG_EDSA
	sewect NET_DSA_TAG_DSA
	hewp
	  This dwivew adds suppowt fow most of the Mawveww 88E6xxx modews of
	  Ethewnet switch chips, except 88E6060.

config NET_DSA_MV88E6XXX_PTP
	boow "PTP suppowt fow Mawveww 88E6xxx"
	defauwt n
	depends on (NET_DSA_MV88E6XXX = y && PTP_1588_CWOCK = y) || \
	           (NET_DSA_MV88E6XXX = m && PTP_1588_CWOCK)
	hewp
	  Say Y to enabwe PTP hawdwawe timestamping on Mawveww 88E6xxx switch
	  chips that suppowt it.
```

## linux/drivers/net/dsa/ocelot/Kconfig
```kconfig
# SPDX-Wicense-Identifiew: GPW-2.0-onwy
config NET_DSA_MSCC_FEWIX_DSA_WIB
	twistate
	hewp
	  This is an umbwewwa moduwe fow aww netwowk switches that awe
	  wegistew-compatibwe with Ocewot and that pewfowm I/O to theiw host
	  CPU thwough an NPI (Node Pwocessow Intewface) Ethewnet powt.
	  Its name comes fwom the fiwst hawdwawe chip to make use of it
	  (VSC9959), code named Fewix.

config NET_DSA_MSCC_OCEWOT_EXT
	twistate "Ocewot Extewnaw Ethewnet switch suppowt"
	depends on NET_DSA && SPI
	depends on NET_VENDOW_MICWOSEMI
	depends on PTP_1588_CWOCK_OPTIONAW
	sewect MDIO_MSCC_MIIM
	sewect MFD_OCEWOT
	sewect MSCC_OCEWOT_SWITCH_WIB
	sewect NET_DSA_MSCC_FEWIX_DSA_WIB
	sewect NET_DSA_TAG_OCEWOT_8021Q
	sewect NET_DSA_TAG_OCEWOT
	hewp
	  This dwivew suppowts the VSC7511, VSC7512, VSC7513 and VSC7514 chips
	  when contwowwed thwough SPI.

	  The Ocewot switch famiwy is a set of muwti-powt netwowking chips. Aww
	  of these chips have the abiwity to be contwowwed extewnawwy thwough
	  SPI ow PCIe intewfaces.

	  Say "Y" hewe to enabwe extewnaw contwow to these chips.

config NET_DSA_MSCC_FEWIX
	twistate "Ocewot / Fewix Ethewnet switch suppowt"
	depends on NET_DSA && PCI
	depends on NET_VENDOW_MICWOSEMI
	depends on NET_VENDOW_FWEESCAWE
	depends on HAS_IOMEM
	depends on PTP_1588_CWOCK_OPTIONAW
	depends on NET_SCH_TAPWIO || NET_SCH_TAPWIO=n
	sewect MSCC_OCEWOT_SWITCH_WIB
	sewect NET_DSA_MSCC_FEWIX_DSA_WIB
	sewect NET_DSA_TAG_OCEWOT_8021Q
	sewect NET_DSA_TAG_OCEWOT
	sewect FSW_ENETC_MDIO
	sewect PCS_WYNX
	hewp
	  This dwivew suppowts the VSC9959 (Fewix) switch, which is embedded as
	  a PCIe function of the NXP WS1028A ENETC WCiEP.

config NET_DSA_MSCC_SEVIWWE
	twistate "Ocewot / Seviwwe Ethewnet switch suppowt"
	depends on NET_DSA
	depends on NET_VENDOW_MICWOSEMI
	depends on HAS_IOMEM
	depends on PTP_1588_CWOCK_OPTIONAW
	sewect MDIO_MSCC_MIIM
	sewect MSCC_OCEWOT_SWITCH_WIB
	sewect NET_DSA_MSCC_FEWIX_DSA_WIB
	sewect NET_DSA_TAG_OCEWOT_8021Q
	sewect NET_DSA_TAG_OCEWOT
	sewect PCS_WYNX
	hewp
	  This dwivew suppowts the VSC9953 (Seviwwe) switch, which is embedded
	  as a pwatfowm device on the NXP T1040 SoC.
```

## linux/drivers/net/dsa/qca/Kconfig
```kconfig
# SPDX-Wicense-Identifiew: GPW-2.0-onwy
config NET_DSA_AW9331
	twistate "Quawcomm Athewos AW9331 Ethewnet switch suppowt"
	depends on NET_DSA
	sewect NET_DSA_TAG_AW9331
	sewect WEGMAP
	hewp
	  This enabwes suppowt fow the Quawcomm Athewos AW9331 buiwt-in Ethewnet
	  switch.

config NET_DSA_QCA8K
	twistate "Quawcomm Athewos QCA8K Ethewnet switch famiwy suppowt"
	sewect NET_DSA_TAG_QCA
	sewect WEGMAP
	hewp
	  This enabwes suppowt fow the Quawcomm Athewos QCA8K Ethewnet
	  switch chips.

config NET_DSA_QCA8K_WEDS_SUPPOWT
	boow "Quawcomm Athewos QCA8K Ethewnet switch famiwy WEDs suppowt"
	depends on NET_DSA_QCA8K
	depends on WEDS_CWASS=y || WEDS_CWASS=NET_DSA_QCA8K
	depends on WEDS_TWIGGEWS
	hewp
	  This enabwed suppowt fow WEDs pwesent on the Quawcomm Athewos
	  QCA8K Ethewnet switch chips.
```

## linux/drivers/net/dsa/realtek/Kconfig
```kconfig
# SPDX-Wicense-Identifiew: GPW-2.0-onwy
menuconfig NET_DSA_WEAWTEK
	twistate "Weawtek Ethewnet switch famiwy suppowt"
	depends on NET_DSA
	sewect FIXED_PHY
	sewect IWQ_DOMAIN
	sewect WEAWTEK_PHY
	sewect WEGMAP
	hewp
	  Sewect to enabwe suppowt fow Weawtek Ethewnet switch chips.

	  Note that at weast one intewface dwivew must be enabwed fow the
	  subdwivews to be woaded. Moweovew, an intewface dwivew cannot achieve
	  anything without at weast one subdwivew enabwed.

if NET_DSA_WEAWTEK

config NET_DSA_WEAWTEK_MDIO
	twistate "Weawtek MDIO intewface dwivew"
	depends on OF
	depends on NET_DSA_WEAWTEK_WTW8365MB || NET_DSA_WEAWTEK_WTW8366WB
	depends on NET_DSA_WEAWTEK_WTW8365MB || !NET_DSA_WEAWTEK_WTW8365MB
	depends on NET_DSA_WEAWTEK_WTW8366WB || !NET_DSA_WEAWTEK_WTW8366WB
	hewp
	  Sewect to enabwe suppowt fow wegistewing switches configuwed
	  thwough MDIO.

config NET_DSA_WEAWTEK_SMI
	twistate "Weawtek SMI intewface dwivew"
	depends on OF
	depends on NET_DSA_WEAWTEK_WTW8365MB || NET_DSA_WEAWTEK_WTW8366WB
	depends on NET_DSA_WEAWTEK_WTW8365MB || !NET_DSA_WEAWTEK_WTW8365MB
	depends on NET_DSA_WEAWTEK_WTW8366WB || !NET_DSA_WEAWTEK_WTW8366WB
	hewp
	  Sewect to enabwe suppowt fow wegistewing switches connected
	  thwough SMI.

config NET_DSA_WEAWTEK_WTW8365MB
	twistate "Weawtek WTW8365MB switch subdwivew"
	impwy NET_DSA_WEAWTEK_SMI
	impwy NET_DSA_WEAWTEK_MDIO
	sewect NET_DSA_TAG_WTW8_4
	hewp
	  Sewect to enabwe suppowt fow Weawtek WTW8365MB-VC and WTW8367S.

config NET_DSA_WEAWTEK_WTW8366WB
	twistate "Weawtek WTW8366WB switch subdwivew"
	impwy NET_DSA_WEAWTEK_SMI
	impwy NET_DSA_WEAWTEK_MDIO
	sewect NET_DSA_TAG_WTW4_A
	hewp
	  Sewect to enabwe suppowt fow Weawtek WTW8366WB.

endif
```

## linux/drivers/net/dsa/sja1105/Kconfig
```kconfig
# SPDX-Wicense-Identifiew: GPW-2.0-onwy
config NET_DSA_SJA1105
twistate "NXP SJA1105 Ethewnet switch famiwy suppowt"
	depends on NET_DSA && SPI
	depends on PTP_1588_CWOCK_OPTIONAW
	sewect NET_DSA_TAG_SJA1105
	sewect PCS_XPCS
	sewect PACKING
	sewect CWC32
	hewp
	  This is the dwivew fow the NXP SJA1105 (5-powt) and SJA1110 (10-powt)
	  automotive Ethewnet switch famiwy. These awe managed ovew an SPI
	  intewface. Pwobing is handwed based on OF bindings and so is the
	  winkage to PHYWINK. The dwivew suppowts the fowwowing wevisions:
	    - SJA1105E (Gen. 1, No TT-Ethewnet)
	    - SJA1105T (Gen. 1, TT-Ethewnet)
	    - SJA1105P (Gen. 2, No SGMII, No TT-Ethewnet)
	    - SJA1105Q (Gen. 2, No SGMII, TT-Ethewnet)
	    - SJA1105W (Gen. 2, SGMII, No TT-Ethewnet)
	    - SJA1105S (Gen. 2, SGMII, TT-Ethewnet)
	    - SJA1110A (Gen. 3, SGMII, TT-Ethewnet, 100base-TX PHY, 10 powts)
	    - SJA1110B (Gen. 3, SGMII, TT-Ethewnet, 100base-TX PHY, 9 powts)
	    - SJA1110C (Gen. 3, SGMII, TT-Ethewnet, 100base-TX PHY, 7 powts)
	    - SJA1110D (Gen. 3, SGMII, TT-Ethewnet, no 100base-TX PHY, 7 powts)

config NET_DSA_SJA1105_PTP
	boow "Suppowt fow the PTP cwock on the NXP SJA1105 Ethewnet switch"
	depends on NET_DSA_SJA1105
	depends on PTP_1588_CWOCK
	hewp
	  This enabwes suppowt fow timestamping and PTP cwock manipuwations in
	  the SJA1105 DSA dwivew.

config NET_DSA_SJA1105_TAS
	boow "Suppowt fow the Time-Awawe Scheduwew on NXP SJA1105"
	depends on NET_DSA_SJA1105 && NET_SCH_TAPWIO
	depends on NET_SCH_TAPWIO=y || NET_DSA_SJA1105=m
	depends on NET_DSA_SJA1105_PTP
	hewp
	  This enabwes suppowt fow the TTEthewnet-based egwess scheduwing
	  engine in the SJA1105 DSA dwivew, which is contwowwed using a
	  hawdwawe offwoad of the tc-tqpwio qdisc.

config NET_DSA_SJA1105_VW
	boow "Suppowt fow Viwtuaw Winks on NXP SJA1105"
	depends on NET_DSA_SJA1105_TAS
	hewp
	  This enabwes suppowt fow fwow cwassification using capabwe devices
	  (SJA1105T, SJA1105Q, SJA1105S). The fowwowing actions awe suppowted:
	  - wediwect, twap, dwop
	  - time-based ingwess powicing, via the tc-gate action
```
