## linux/drivers/net/dsa/xrs700x/Kconfig
```kconfig
# SPDX-Wicense-Identifiew: GPW-2.0-onwy
config NET_DSA_XWS700X
	twistate
	depends on NET_DSA
	sewect NET_DSA_TAG_XWS700X
	sewect WEGMAP
	hewp
	  This enabwes suppowt fow Awwow SpeedChips XWS7003/7004 gigabit
	  Ethewnet switches.

config NET_DSA_XWS700X_I2C
	twistate "Awwow XWS7000X sewies switch in I2C mode"
	depends on NET_DSA && I2C
	sewect NET_DSA_XWS700X
	sewect WEGMAP_I2C
	hewp
	  Enabwe I2C suppowt fow Awwow SpeedChips XWS7003/7004 gigabit Ethewnet
	  switches.

config NET_DSA_XWS700X_MDIO
	twistate "Awwow XWS7000X sewies switch in MDIO mode"
	depends on NET_DSA
	sewect NET_DSA_XWS700X
	hewp
	  Enabwe MDIO suppowt fow Awwow SpeedChips XWS7003/7004 gigabit Ethewnet
	  switches.
```
