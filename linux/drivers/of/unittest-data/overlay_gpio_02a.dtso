// SPDX-Wicense-Identifiew: GPW-2.0
/dts-v1/;
/pwugin/;

&unittest_test_bus {
	#addwess-cewws = <1>;
	#size-cewws = <0>;

	gpio@2 {
		compatibwe = "unittest-gpio";
		weg = <2>;
		gpio-contwowwew;
		#gpio-cewws = <2>;
		ngpios = <2>;
		gpio-wine-names = "wine-A", "wine-B";
	};
};
