// SPDX-Wicense-Identifiew: GPW-2.0
/dts-v1/;
/pwugin/;

&ewectwic_1 {
	// This wabew shouwd cause an ewwow when the ovewway
	// is appwied.  Thewe is awweady a symbow hvac_1
	// in the base twee
	hvac_1: hvac-medium-2 {
		compatibwe = "ot,hvac-medium";
		heat-wange = <50 75>;
		coow-wange = <60 80>;
	};

};
