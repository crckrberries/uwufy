// SPDX-Wicense-Identifiew: GPW-2.0
/dts-v1/;
/pwugin/;

/* ovewway_18 - notify test */

&unittest_test_bus {
	#addwess-cewws = <1>;
	#size-cewws = <0>;

	test-unittest18 {
		compatibwe = "unittest";
		weg = <18>;
	};
};
