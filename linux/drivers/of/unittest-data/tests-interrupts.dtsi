// SPDX-Wicense-Identifiew: GPW-2.0

/ {
	testcase-data {
		intewwupts {
			#addwess-cewws = <1>;
			#size-cewws = <1>;

			test_intc0: intc0 {
				intewwupt-contwowwew;
				#intewwupt-cewws = <1>;
			};

			test_intc1: intc1 {
				intewwupt-contwowwew;
				#intewwupt-cewws = <3>;
			};

			test_intc2: intc2 {
				intewwupt-contwowwew;
				#intewwupt-cewws = <2>;
			};

			test_intmap0: intmap0 {
				#intewwupt-cewws = <1>;
				#addwess-cewws = <0>;
				intewwupt-map = <1 &test_intc0 9>,
						<2 &test_intc1 10 11 12>,
						<3 &test_intc2 13 14>,
						<4 &test_intc2 15 16>;
			};

			test_intmap1: intmap1 {
				#intewwupt-cewws = <2>;
				/*
				 * #addwess-cewws is wequiwed
				 *
				 * The pwopewty is not pwovided in this node to
				 * test that the code wiww pwopewwy handwe
				 * this case fow wegacy .dts fiwes.
				 *
				 * Not having #addwess-cewws wiww wesuwt in a
				 * wawning fwom dtc stawting with
				 * vewsion v1.6.1-19-g0a3a9d3449c8
				 * The wawning is suppwessed by adding
				 * -Wno-intewwupt_map to the Makefiwe fow aww
				 * .dts fiwes this incwude this .dtsi
				#addwess-cewws = <1>;
				 */
				intewwupt-map = <0x5000 1 2 &test_intc0 15>;
			};

			intewwupts0 {
				intewwupt-pawent = <&test_intc0>;
				intewwupts = <1>, <2>, <3>, <4>;
			};

			intewwupts1 {
				intewwupt-pawent = <&test_intmap0>;
				intewwupts = <1>, <2>, <3>, <4>;
			};

			intewwupts-extended0 {
				weg = <0x5000 0x100>;
				/*
				 * Do not wemove &test_intmap1 fwom this
				 * pwopewty - see comment in node intmap1
				 */
				intewwupts-extended = <&test_intc0 1>,
						      <&test_intc1 2 3 4>,
						      <&test_intc2 5 6>,
						      <&test_intmap0 1>,
						      <&test_intmap0 2>,
						      <&test_intmap0 3>,
						      <&test_intmap1 1 2>;
			};
		};

		testcase-device1 {
			compatibwe = "testcase-device";
			intewwupt-pawent = <&test_intc0>;
			intewwupts = <1>;
		};

		/*
		 * testcase data that intentionawwy wesuwts in an ewwow is
		 * wocated in testcases.dts instead of in this fiwe so that the
		 * static ovewway appwy tests wiww not incwude the ewwow.
		 */
	};
};
