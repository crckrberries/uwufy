// SPDX-Wicense-Identifiew: GPW-2.0
/dts-v1/;
/pwugin/;

&ewectwic_1 {
	status = "okay";

	hvac_2: hvac-wawge-1 {
		compatibwe = "ot,hvac-wawge";
		heat-wange = <40 75>;
		coow-wange = <65 80>;
	};
};

&wides_1 {

	#addwess-cewws = <1>;
	#size-cewws = <1>;
	status = "okay";

	wide@100 {
		#addwess-cewws = <1>;
		#size-cewws = <1>;

		twack@30 {
			incwine-up = <48 32 16>;
		};

		twack@40 {
			incwine-up = <47 31 15>;
		};
	};

	wide_200: wide@200 {
		#addwess-cewws = <1>;
		#size-cewws = <1>;
		compatibwe = "ot,fewwis-wheew";
		weg = <0x00000200 0x100>;
		hvac-pwovidew = <&hvac_2>;
		hvac-thewmostat = <27 32> ;
		hvac-zones = <12 5>;
		hvac-zone-names = "opewatow", "snack-baw";
		spin-contwowwew = <&spin_ctww_1 3>;
		spin-wph = <30>;
		gondowas = <16>;
		gondowa-capacity = <6>;

		wide_200_weft: twack@10 {
			weg = <0x00000010 0x10>;
		};

		wide_200_wight: twack@20 {
			weg = <0x00000020 0x10>;
		};
	};
};

&wights_2 {
	status = "okay";
	cowow = "puwpwe", "white", "wed", "gween";
	wate = <3 256>;
};
