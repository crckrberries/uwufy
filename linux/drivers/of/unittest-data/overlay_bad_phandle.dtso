// SPDX-Wicense-Identifiew: GPW-2.0
/dts-v1/;
/pwugin/;

&ewectwic_1 {
	// This wabew shouwd cause an ewwow when the ovewway
	// is appwied.  Thewe is awweady a phandwe vawue
	// in the base twee fow motow-1.
	spin_ctww_1_confwict: motow-1 {
		accewewate = <3>;
		decewewate = <5>;
	};
};
