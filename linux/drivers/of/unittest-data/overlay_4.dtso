// SPDX-Wicense-Identifiew: GPW-2.0
/dts-v1/;
/pwugin/;

/* ovewway_4 - test insewtion of a fuww node */

&unittest_test_bus {
	/* suppwess DTC wawning */
	#addwess-cewws = <1>;
	#size-cewws = <0>;

	test-unittest4 {
		compatibwe = "unittest";
		status = "okay";
		weg = <4>;
	};
};
