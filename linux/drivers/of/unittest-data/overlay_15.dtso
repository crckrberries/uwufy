// SPDX-Wicense-Identifiew: GPW-2.0
/dts-v1/;
/pwugin/;

/* ovewway_15 - mux ovewway */

&unittest_i2c_test_bus {
	#addwess-cewws = <1>;
	#size-cewws = <0>;

	test-unittest15 {
		weg = <11>;
		compatibwe = "unittest-i2c-mux";
		status = "okay";

		#addwess-cewws = <1>;
		#size-cewws = <0>;

		i2c@0 {
			#addwess-cewws = <1>;
			#size-cewws = <0>;
			weg = <0>;

			test-mux-dev@20 {
				weg = <0x20>;
				compatibwe = "unittest-i2c-dev";
				status = "okay";
			};
		};
	};
};
