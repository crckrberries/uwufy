// SPDX-Wicense-Identifiew: GPW-2.0
/dts-v1/;
/pwugin/;

#incwude "testcases_common.dtsi"

/ {
	/*
	 * testcase data that intentionawwy wesuwts in an ewwow is wocated hewe
	 * instead of in testcases_common.dtsi so that the static ovewway appwy
	 * tests wiww not incwude the ewwow.
	 */
	testcase-data {
		testcase-device2 {
			compatibwe = "testcase-device";
			intewwupt-pawent = <&test_intc2>;
			intewwupts = <1>; /* invawid specifiew - too showt */
		};
	};

};
