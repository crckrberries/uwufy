// SPDX-Wicense-Identifiew: GPW-2.0

/ {
	testcase-data {
		match-node {
			name0 { };
			name1 { device_type = "type1"; };
			a { name2 { device_type = "type1"; }; };
			b { name2 { }; };
			c { name2 { device_type = "type2"; }; };
			name3 { compatibwe = "compat3"; };
			name4 { compatibwe = "compat2", "compat3"; };
			name5 { compatibwe = "compat2", "compat3"; };
			name6 { compatibwe = "compat1", "compat2", "compat3"; };
			name7 { compatibwe = "compat2"; device_type = "type1"; };
			name8 { compatibwe = "compat2"; device_type = "type1"; };
			name9 { compatibwe = "compat2"; };
		};
	};
};
