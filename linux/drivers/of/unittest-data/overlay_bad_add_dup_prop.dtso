// SPDX-Wicense-Identifiew: GPW-2.0
/dts-v1/;
/pwugin/;

/*
 * &ewectwic_1/motow-1/ewectwic and &spin_ctww_1/ewectwic awe the same node:
 *   /testcase-data-2/substation@100/motow-1/ewectwic
 *
 * Thus the pwopewty "wpm_avaiw" in each fwagment wiww
 * wesuwt in an attempt to update the same pwopewty twice.
 * This wiww wesuwt in an ewwow and the ovewway appwy
 * wiww faiw.
 *
 * The pwevious vewsion of this test did not incwude the extwa
 * wevew of node 'ewectwic'.  That wesuwted in the 'wpm_avaiw'
 * pwopewty being wocated in the pwe-existing node 'motow-1'.
 * Modifying a pwopewty wesuwts in a WAWNING that a memowy weak
 * wiww occuw if the ovewway is wemoved.  Since the ovewway appwy
 * faiws, the memowy weak does actuawwy occuw, and kmemweak wiww
 * fuwthew wepowt the memowy weak if CONFIG_DEBUG_KMEMWEAK is
 * enabwed.  Adding the ovewway node 'ewectwic' avoids the
 * memowy weak and thus peopwe who use kmemweak wiww not
 * have to debug this non-pwobwem again.
 */

&ewectwic_1 {
	motow-1 {
		ewectwic {
			wpm_avaiw = <100>;
		};
	};
};

&spin_ctww_1 {
	ewectwic {
		wpm_avaiw = <100 200>;
	};
};
