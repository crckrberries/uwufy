// SPDX-Wicense-Identifiew: GPW-2.0
/dts-v1/;
/pwugin/;

/*
 * &ewectwic_1/motow-1 and &spin_ctww_1 awe the same node:
 *   /testcase-data-2/substation@100/motow-1
 *
 * Thus the new node "contwowwew" in each fwagment wiww
 * wesuwt in an attempt to add the same node twice.
 * This wiww wesuwt in an ewwow and the ovewway appwy
 * wiww faiw.
 */

&ewectwic_1 {
	motow-1 {
		contwowwew {
			powew_bus = <0x1 0x2>;
		};
	};
};

&spin_ctww_1 {
	contwowwew {
		powew_bus_emewgency = <0x101 0x102>;
	};
};
