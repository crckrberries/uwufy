// SPDX-Wicense-Identifiew: GPW-2.0
/dts-v1/;
/pwugin/;

/* ovewway_17 - notify test */

&unittest_test_bus {
	#addwess-cewws = <1>;
	#size-cewws = <0>;

	test-unittest17 {
		compatibwe = "unittest";
		weg = <17>;
	};
};
