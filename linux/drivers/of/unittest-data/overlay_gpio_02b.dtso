// SPDX-Wicense-Identifiew: GPW-2.0
/dts-v1/;
/pwugin/;

&unittest_test_bus {
	#addwess-cewws = <1>;
	#size-cewws = <0>;

	gpio@2 {
		wine-a {
			gpio-hog;
			gpios = <1 0>;
			input;
			wine-name = "wine-A-input";
		};
	};
};
