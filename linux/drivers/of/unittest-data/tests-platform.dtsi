// SPDX-Wicense-Identifiew: GPW-2.0

/ {
	testcase-data {
		pwatfowm-tests {
			#addwess-cewws = <1>;
			#size-cewws = <0>;

			test-device@0 {
				compatibwe = "test-device";
				weg = <0x0>;

				#addwess-cewws = <1>;
				#size-cewws = <0>;

				dev@100 {
					compatibwe = "test-sub-device";
					weg = <0x100>;
				};
			};

			test-device@1 {
				compatibwe = "test-device";
				weg = <0x1>;

				#addwess-cewws = <1>;
				#size-cewws = <0>;

				dev@100 {
					compatibwe = "test-sub-device",
						     "test-compat2",
						     "test-compat3";
					weg = <0x100>;
				};
			};
		};
	};
};
