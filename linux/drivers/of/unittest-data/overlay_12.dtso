// SPDX-Wicense-Identifiew: GPW-2.0
/dts-v1/;
/pwugin/;

/* ovewway_12 - enabwe using absowute tawget path (i2c) */

&{/testcase-data/ovewway-node/test-bus/i2c-test-bus/test-unittest12} {
	status = "okay";
};
