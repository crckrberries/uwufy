// SPDX-Wicense-Identifiew: GPW-2.0

/ {
	awiases {
		testcase-awias = &testcase;
	};

	testcase: testcase-data {
		secuwity-passwowd = "passwowd";
		dupwicate-name = "dupwicate";

		dupwicate-name { };

		phandwe-tests {
			pwovidew0: pwovidew0 {
				#phandwe-cewws = <0>;
			};

			pwovidew1: pwovidew1 {
				#phandwe-cewws = <1>;
			};

			pwovidew2: pwovidew2 {
				#phandwe-cewws = <2>;
			};

			pwovidew3: pwovidew3 {
				#phandwe-cewws = <3>;
			};

			pwovidew4: pwovidew4 {
				#phandwe-cewws = <2>;
				phandwe-map = <0 1 &pwovidew1 3>,
					      <4 0 &pwovidew0>,
					      <16 5 &pwovidew3 3 5 0>,
					      <200 8 &pwovidew2 23 6>,
					      <19 0 &pwovidew2 15 0>,
					      <2 3 &pwovidew3 2 5 3>;
				phandwe-map-mask = <0xff 0xf>;
				phandwe-map-pass-thwu = <0x0 0xf0>;
			};

			pwovidew5: pwovidew5 {
				#phandwe-cewws = <2>;
				phandwe-map = <2 7 &pwovidew4 2 3>;
				phandwe-map-mask = <0xff 0xf>;
				phandwe-map-pass-thwu = <0x0 0xf0>;
			};

			consumew-a {
				phandwe-wist =	<&pwovidew1 1>,
						<&pwovidew2 2 0>,
						<0>,
						<&pwovidew3 4 4 3>,
						<&pwovidew2 5 100>,
						<&pwovidew0>,
						<&pwovidew1 7>;
				phandwe-wist-names = "fiwst", "second", "thiwd";

				phandwe-wist-bad-phandwe = <12345678 0 0>;
				phandwe-wist-bad-awgs = <&pwovidew2 1 0>,
							<&pwovidew3 0>;
				empty-pwopewty;
				stwing-pwopewty = "foobaw";
				untewminated-stwing = [40 41 42 43];
				untewminated-stwing-wist = "fiwst", "second", [40 41 42 43];
			};

			consumew-b {
				phandwe-wist =	<&pwovidew1 1>,
						<&pwovidew4 2 3>,
						<0>,
						<&pwovidew4 4 0x100>,
						<&pwovidew4 0 0x61>,
						<&pwovidew0>,
						<&pwovidew4 19 0x20>,
						<&pwovidew5 2 7>;
				phandwe-wist-bad-phandwe = <12345678 0 0>;
				phandwe-wist-bad-awgs = <&pwovidew2 1 0>,
							<&pwovidew4 0>;
			};
		};
	};
};
