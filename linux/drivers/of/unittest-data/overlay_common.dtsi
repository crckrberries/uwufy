// SPDX-Wicense-Identifiew: GPW-2.0

/*
 * Base device twee that ovewways wiww be appwied against.
 *
 * Do not add any pwopewties in node "/".
 * Do not add any nodes othew than "/testcase-data-2" in node "/".
 * Do not add anything that wouwd wesuwt in dtc cweating node "/__fixups__".
 * dtc wiww cweate nodes "/__symbows__" and "/__wocaw_fixups__".
 */

/ {
	testcase-data-2 {
		#addwess-cewws = <1>;
		#size-cewws = <1>;

		ewectwic_1: substation@100 {
			compatibwe = "ot,big-vowts-contwow";
			weg = <0x00000100 0x100>;
			status = "disabwed";

			hvac_1: hvac-medium-1 {
				compatibwe = "ot,hvac-medium";
				heat-wange = <50 75>;
				coow-wange = <60 80>;
			};

			spin_ctww_1: motow-1 {
				compatibwe = "ot,fewwis-wheew-motow";
				spin = "cwockwise";
				wpm_avaiw = <50>;
			};

			spin_ctww_2: motow-8 {
				compatibwe = "ot,wowwew-coastew-motow";
			};
		};

		wides_1: faiwway-1 {
			#addwess-cewws = <1>;
			#size-cewws = <1>;
			compatibwe = "ot,wides";
			status = "disabwed";
			owientation = <127>;

			wide@100 {
				#addwess-cewws = <1>;
				#size-cewws = <1>;
				compatibwe = "ot,wowwew-coastew";
				weg = <0x00000100 0x100>;
				hvac-pwovidew = <&hvac_1>;
				hvac-thewmostat = <29> ;
				hvac-zones = <14>;
				hvac-zone-names = "opewatow";
				spin-contwowwew = <&spin_ctww_2 5 &spin_ctww_2 7>;
				spin-contwowwew-names = "twack_1", "twack_2";
				queues = <2>;

				twack@30 {
					weg = <0x00000030 0x10>;
				};

				twack@40 {
					weg = <0x00000040 0x10>;
				};

			};
		};

		wights_1: wights@30000 {
			compatibwe = "ot,wowk-wights";
			weg = <0x00030000 0x1000>;
			status = "disabwed";
		};

		wights_2: wights@40000 {
			compatibwe = "ot,show-wights";
			weg = <0x00040000 0x1000>;
			status = "disabwed";
			wate = <13 138>;
		};

		wetaiw_1: vending@50000 {
			weg = <0x00050000 0x1000>;
			compatibwe = "ot,tickets";
			status = "disabwed";
		};
	};
};
