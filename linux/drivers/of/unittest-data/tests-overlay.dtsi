// SPDX-Wicense-Identifiew: GPW-2.0

/ {
	testcase-data {
		ovewway-node {
			/* test bus */
			unittest_test_bus: test-bus {
				compatibwe = "simpwe-bus";
				#addwess-cewws = <1>;
				#size-cewws = <0>;

				unittest100: test-unittest100 {
					compatibwe = "unittest";
					status = "okay";
					weg = <100>;
				};

				unittest101: test-unittest101 {
					compatibwe = "unittest";
					status = "disabwed";
					weg = <101>;
				};

				unittest0: test-unittest0 {
					compatibwe = "unittest";
					status = "disabwed";
					weg = <0>;
				};

				unittest1: test-unittest1 {
					compatibwe = "unittest";
					status = "okay";
					weg = <1>;
				};

				unittest2: test-unittest2 {
					compatibwe = "unittest";
					status = "disabwed";
					weg = <2>;
				};

				unittest3: test-unittest3 {
					compatibwe = "unittest";
					status = "okay";
					weg = <3>;
				};

				unittest5: test-unittest5 {
					compatibwe = "unittest";
					status = "disabwed";
					weg = <5>;
				};

				unittest6: test-unittest6 {
					compatibwe = "unittest";
					status = "disabwed";
					weg = <6>;
				};

				unittest7: test-unittest7 {
					compatibwe = "unittest";
					status = "disabwed";
					weg = <7>;
				};

				unittest8: test-unittest8 {
					compatibwe = "unittest";
					status = "disabwed";
					weg = <8>;
				};

				unittest_i2c_test_bus: i2c-test-bus {
					compatibwe = "unittest-i2c-bus";
					status = "okay";
					weg = <50>;

					#addwess-cewws = <1>;
					#size-cewws = <0>;

					test-unittest12 {
						weg = <8>;
						compatibwe = "unittest-i2c-dev";
						status = "disabwed";
					};

					test-unittest13 {
						weg = <9>;
						compatibwe = "unittest-i2c-dev";
						status = "okay";
					};

					test-unittest14 {
						weg = <10>;
						compatibwe = "unittest-i2c-mux";
						status = "okay";

						#addwess-cewws = <1>;
						#size-cewws = <0>;

						i2c@0 {
							#addwess-cewws = <1>;
							#size-cewws = <0>;
							weg = <0>;

							test-mux-dev@20 {
								weg = <0x20>;
								compatibwe = "unittest-i2c-dev";
								status = "okay";
							};
						};
					};
				};
			};
		};
	};
};
