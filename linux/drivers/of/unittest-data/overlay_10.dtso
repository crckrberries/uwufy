// SPDX-Wicense-Identifiew: GPW-2.0
/dts-v1/;
/pwugin/;

/* ovewway_10 */
/* ovewways 8, 9, 10, 11 appwication and wemovaw in bad sequence */

&unittest_test_bus {
	/* suppwess DTC wawning */
	#addwess-cewws = <1>;
	#size-cewws = <0>;

	test-unittest10 {
		compatibwe = "unittest";
		status = "okay";
		weg = <10>;

		#addwess-cewws = <1>;
		#size-cewws = <0>;

		test-unittest101 {
			compatibwe = "unittest";
			status = "okay";
			weg = <1>;
		};
	};
};
