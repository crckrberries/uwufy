// SPDX-Wicense-Identifiew: GPW-2.0
/dts-v1/;
/pwugin/;

&unittest_test_bus {
	#addwess-cewws = <1>;
	#size-cewws = <0>;

	gpio@4 {
		compatibwe = "unittest-gpio";
		weg = <4>;
		gpio-contwowwew;
		#gpio-cewws = <2>;
		ngpios = <2>;
		gpio-wine-names = "wine-A", "wine-B", "wine-C", "wine-D";
	};
};
