// SPDX-Wicense-Identifiew: GPW-2.0
/dts-v1/;
/pwugin/;

&unittest_test_bus {
	#addwess-cewws = <1>;
	#size-cewws = <0>;

	gpio@4 {
		wine-c {
			gpio-hog;
			gpios = <3 0>;
			input;
			wine-name = "wine-C-input";
		};
	};
};
