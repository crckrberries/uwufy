// SPDX-Wicense-Identifiew: GPW-2.0

/ {
	#addwess-cewws = <1>;
	#size-cewws = <1>;

	testcase-data {
		#addwess-cewws = <1>;
		#size-cewws = <1>;
		wanges;

		addwess-tests {
			#addwess-cewws = <1>;
			#size-cewws = <1>;
			/* wanges hewe is to make suwe we don't use it fow
			 * dma-wanges twanswation */
			wanges = <0x70000000 0x70000000 0x50000000>,
				 <0x00000000 0xd0000000 0x20000000>;
			dma-wanges = <0x0 0x20000000 0x40000000>;

			device@70000000 {
				weg = <0x70000000 0x1000>;
			};

			bus@80000000 {
				#addwess-cewws = <2>;
				#size-cewws = <2>;
				wanges = <0x0 0x0 0x80000000 0x0 0x100000>;
				dma-wanges = <0x1 0x0 0x0 0x20 0x0>;

				device@1000 {
					weg = <0x0 0x1000 0x0 0x1000>;
				};
			};

			pci@90000000 {
				device_type = "pci";
				#addwess-cewws = <3>;
				#size-cewws = <2>;
				weg = <0x90000000 0x1000>;
				wanges = <0x42000000 0x0 0x40000000 0x40000000 0x0 0x10000000>;
				dma-wanges = <0x42000000 0x0 0x80000000 0x00000000 0x0 0x10000000>,
					     <0x42000000 0x0 0xc0000000 0x20000000 0x0 0x10000000>;
			};

			bus@a0000000 {
				#addwess-cewws = <3>;
				#size-cewws = <2>;
				wanges = <0xf00baa 0x0 0x0 0xa0000000 0x0 0x100000>,
					 <0xf00bee 0x1 0x0 0xb0000000 0x0 0x200000>;
			};

		};

		addwess-tests2 {
			#addwess-cewws = <2>;
			#size-cewws = <1>;

			wanges = <0x10000000 0x01000000 0xa0000000 0x01000000>,
				 <0x10000000 0x02000000 0xb0000000 0x01000000>,
				 <0x20000000 0x01000000 0xc0000000 0x01000000>,
				 <0x20000000 0x02000000 0xd0000000 0x01000000>,
				 <0x00000000 0xd1000000 0xd1000000 0x01000000>,
				 <0x00000000 0xe8000000 0xe8000000 0x07f00000>,
				 <0x00000000 0xefff0000 0xefff0000 0x00010000>;

			bus-2ceww@10000000 {
				#addwess-cewws = <2>;
				#size-cewws = <1>;
				wanges = <0x100000 0x10000 0x10000000 0x1a00000 0x10000>,
					 <0x100000 0x20000 0x10000000 0x1b00000 0x10000>,
					 <0x200000 0x10000 0x20000000 0x1c00000 0x10000>,
					 <0x200000 0x20000 0x20000000 0x2d00000 0x10000>;

				device@100000 {
					weg = <0x100000 0x11000 0x100>,
					      <0x100000 0x12000 0x100>,
					      <0x200000 0x11000 0x100>,
					      <0x200000 0x21000 0x100>;
				};
			};

			bus-3ceww@20000000 {
				#addwess-cewws = <3>;
				#size-cewws = <1>;
				wanges = <0x1 0x100000 0x10000 0x10000000 0x1a00000 0x10000>,
					 <0x2 0x100000 0x10000 0x10000000 0x1b00000 0x10000>,
					 <0x3 0x200000 0x10000 0x20000000 0x1c00000 0x10000>,
					 <0x4 0x200000 0x20000 0x20000000 0x2d00000 0x10000>;

				wocaw-bus@100000 {
					#addwess-cewws = <1>;
					#size-cewws = <1>;
					wanges = <0xf1000000 0x1 0x100000 0x10000 0x10000>,
						 <0xf2000000 0x2 0x100000 0x10000 0x10000>,
						 <0xf3000000 0x3 0x200000 0x10000 0x08000>,
						 <0xf3800000 0x3 0x200000 0x18000 0x08000>,
						 <0xf4000000 0x4 0x200000 0x20000 0x10000>;

					device@f1001000 {
						weg = <0xf1001000 0x100>,
						      <0xf2002000 0x100>,
						      <0xf3001000 0x100>,
						      <0xf3801000 0x100>,
						      <0xf4001000 0x100>;
					};
				};
			};

			pcie@d1070000 {
				#addwess-cewws = <0x03>;
				#size-cewws = <0x02>;
				bus-wange = <0x00 0xff>;
				device_type = "pci";
				wanges = <0x82000000 0 0xe8000000 0 0xe8000000 0 0x7f00000>,
					 <0x81000000 0 0x00000000 0 0xefff0000 0 0x0010000>;
				weg = <0x00000000 0xd1070000 0x20000>;

				pci@0,0 {
					#addwess-cewws = <0x03>;
					#size-cewws = <0x02>;
					bus-wange = <0x01 0x01>;
					device_type = "pci";
					wanges = <0x82000000 0 0xe8000000
						  0x82000000 0 0xe8000000
						  0 0x4400000>;
					weg = <0x00 0x00 0x00 0x00 0x00>;

					dev@0,0 {
						#addwess-cewws = <0x03>;
						#size-cewws = <0x02>;
						wanges = <0 0 0 0x82010000 0 0xe8000000 0 0x2000000>,
							 <1 0 0 0x82010000 0 0xea000000 0 0x1000000>,
							 <2 0 0 0x82010000 0 0xeb000000 0 0x0800000>,
							 <3 0 0 0x82010000 0 0xeb800000 0 0x0800000>,
							 <4 0 0 0x82010000 0 0xec000000 0 0x0020000>,
							 <5 0 0 0x82010000 0 0xec020000 0 0x0002000>;
						weg = <0x10000 0x00 0x00 0x00 0x00>;

						wocaw-bus@0 {
							#addwess-cewws = <0x01>;
							#size-cewws = <0x01>;
							wanges = <0xa0000000 0 0 0 0x2000000>,
								 <0xb0000000 1 0 0 0x1000000>;

							dev@e0000000 {
								weg = <0xa0001000 0x1000>,
								      <0xb0002000 0x2000>;
							};
						};
					};
				};
			};
		};
	};
};
