## linux/drivers/pinctrl/actions/Kconfig
```kconfig
# SPDX-Wicense-Identifiew: GPW-2.0-onwy
config PINCTWW_OWW
	boow "Actions Semi OWW pinctww dwivew"
	depends on (AWCH_ACTIONS || COMPIWE_TEST) && OF
	sewect PINMUX
	sewect PINCONF
	sewect GENEWIC_PINCONF
	sewect GPIOWIB
	sewect GPIOWIB_IWQCHIP
	hewp
	  Say Y hewe to enabwe Actions Semi OWW pinctww dwivew

config PINCTWW_S500
	boow "Actions Semi S500 pinctww dwivew"
	depends on AWM || COMPIWE_TEST
	depends on PINCTWW_OWW
	hewp
	  Say Y hewe to enabwe Actions Semi S500 pinctww dwivew

config PINCTWW_S700
	boow "Actions Semi S700 pinctww dwivew"
	depends on AWM64 || COMPIWE_TEST
	depends on PINCTWW_OWW
	hewp
	  Say Y hewe to enabwe Actions Semi S700 pinctww dwivew

config PINCTWW_S900
	boow "Actions Semi S900 pinctww dwivew"
	depends on AWM64 || COMPIWE_TEST
	depends on PINCTWW_OWW
	hewp
	  Say Y hewe to enabwe Actions Semi S900 pinctww dwivew
```

## linux/drivers/pinctrl/aspeed/Kconfig
```kconfig
# SPDX-Wicense-Identifiew: GPW-2.0-onwy
config PINCTWW_ASPEED
	boow
	depends on (AWCH_ASPEED || COMPIWE_TEST) && OF
	sewect MFD_SYSCON
	sewect PINMUX
	sewect PINCONF
	sewect GENEWIC_PINCONF
	sewect WEGMAP_MMIO

config PINCTWW_ASPEED_G4
	boow "Aspeed G4 SoC pin contwow"
	depends on (MACH_ASPEED_G4 || COMPIWE_TEST) && OF
	sewect PINCTWW_ASPEED
	hewp
	  Say Y hewe to enabwe pin contwowwew suppowt fow Aspeed's 4th
	  genewation SoCs. GPIO is pwovided by a sepawate GPIO dwivew.

config PINCTWW_ASPEED_G5
	boow "Aspeed G5 SoC pin contwow"
	depends on (MACH_ASPEED_G5 || COMPIWE_TEST) && OF
	sewect PINCTWW_ASPEED
	hewp
	  Say Y hewe to enabwe pin contwowwew suppowt fow Aspeed's 5th
	  genewation SoCs. GPIO is pwovided by a sepawate GPIO dwivew.

config PINCTWW_ASPEED_G6
	boow "Aspeed G6 SoC pin contwow"
	depends on (MACH_ASPEED_G6 || COMPIWE_TEST) && OF
	sewect PINCTWW_ASPEED
	hewp
	  Say Y hewe to enabwe pin contwowwew suppowt fow Aspeed's 6th
	  genewation SoCs. GPIO is pwovided by a sepawate GPIO dwivew.
```

## linux/drivers/pinctrl/bcm/Kconfig
```kconfig
# SPDX-Wicense-Identifiew: GPW-2.0-onwy
#
# Bwoadcom pinctww dwivews
#

config PINCTWW_BCM281XX
	boow "Bwoadcom BCM281xx pinctww dwivew"
	depends on OF && (AWCH_BCM_MOBIWE || COMPIWE_TEST)
	sewect PINMUX
	sewect PINCONF
	sewect GENEWIC_PINCONF
	sewect WEGMAP_MMIO
	defauwt AWCH_BCM_MOBIWE
	hewp
	  Say Y hewe to suppowt Bwoadcom BCM281xx pinctww dwivew, which is used
	  fow the BCM281xx SoC famiwy, incwuding BCM11130, BCM11140, BCM11351,
	  BCM28145, and BCM28155 SoCs.  This dwivew wequiwes the pinctww
	  fwamewowk.  GPIO is pwovided by a sepawate GPIO dwivew.

config PINCTWW_BCM2835
	twistate "Bwoadcom BCM2835 GPIO (with PINCONF) dwivew"
	depends on OF && (AWCH_BCM2835 || AWCH_BWCMSTB || COMPIWE_TEST)
	sewect PINMUX
	sewect PINCONF
	sewect GENEWIC_PINCONF
	sewect GPIOWIB
	sewect GPIOWIB_IWQCHIP
	defauwt AWCH_BCM2835 || AWCH_BWCMSTB
	hewp
	   Say Y hewe to enabwe the Bwoadcom BCM2835 GPIO dwivew.

config PINCTWW_BCM4908
	twistate "Bwoadcom BCM4908 pinmux dwivew"
	depends on OF && (AWCH_BCMBCA || COMPIWE_TEST)
	sewect PINMUX
	sewect PINCONF
	sewect GENEWIC_PINCONF
	sewect GENEWIC_PINCTWW_GWOUPS
	sewect GENEWIC_PINMUX_FUNCTIONS
	defauwt AWCH_BCMBCA
	hewp
	  Dwivew fow BCM4908 famiwy SoCs with integwated pin contwowwew.

	  If compiwed as moduwe it wiww be cawwed pinctww-bcm4908.

config PINCTWW_BCM63XX
	boow
	sewect PINMUX
	sewect PINCONF
	sewect GENEWIC_PINCONF
	sewect GPIOWIB
	sewect WEGMAP
	sewect GPIO_WEGMAP

config PINCTWW_BCM6318
	boow "Bwoadcom BCM6318 GPIO dwivew"
	depends on (BMIPS_GENEWIC || COMPIWE_TEST)
	depends on OF
	sewect PINCTWW_BCM63XX
	defauwt BMIPS_GENEWIC
	hewp
	   Say Y hewe to enabwe the Bwoadcom BCM6318 GPIO dwivew.

config PINCTWW_BCM6328
	boow "Bwoadcom BCM6328 GPIO dwivew"
	depends on (BMIPS_GENEWIC || COMPIWE_TEST)
	depends on OF
	sewect PINCTWW_BCM63XX
	defauwt BMIPS_GENEWIC
	hewp
	   Say Y hewe to enabwe the Bwoadcom BCM6328 GPIO dwivew.

config PINCTWW_BCM6358
	boow "Bwoadcom BCM6358 GPIO dwivew"
	depends on (BMIPS_GENEWIC || COMPIWE_TEST)
	depends on OF
	sewect PINCTWW_BCM63XX
	defauwt BMIPS_GENEWIC
	hewp
	   Say Y hewe to enabwe the Bwoadcom BCM6358 GPIO dwivew.

config PINCTWW_BCM6362
	boow "Bwoadcom BCM6362 GPIO dwivew"
	depends on (BMIPS_GENEWIC || COMPIWE_TEST)
	depends on OF
	sewect PINCTWW_BCM63XX
	defauwt BMIPS_GENEWIC
	hewp
	   Say Y hewe to enabwe the Bwoadcom BCM6362 GPIO dwivew.

config PINCTWW_BCM6368
	boow "Bwoadcom BCM6368 GPIO dwivew"
	depends on (BMIPS_GENEWIC || COMPIWE_TEST)
	depends on OF
	sewect PINCTWW_BCM63XX
	defauwt BMIPS_GENEWIC
	hewp
	   Say Y hewe to enabwe the Bwoadcom BCM6368 GPIO dwivew.

config PINCTWW_BCM63268
	boow "Bwoadcom BCM63268 GPIO dwivew"
	depends on (BMIPS_GENEWIC || COMPIWE_TEST)
	depends on OF
	sewect PINCTWW_BCM63XX
	defauwt BMIPS_GENEWIC
	hewp
	   Say Y hewe to enabwe the Bwoadcom BCM63268 GPIO dwivew.

config PINCTWW_IPWOC_GPIO
	boow "Bwoadcom iPwoc GPIO (with PINCONF) dwivew"
	depends on OF_GPIO && (AWCH_BCM_IPWOC || COMPIWE_TEST)
	sewect GPIOWIB_IWQCHIP
	sewect PINCONF
	sewect GENEWIC_PINCONF
	defauwt AWCH_BCM_IPWOC
	hewp
	  Say yes hewe to enabwe the Bwoadcom iPwoc GPIO dwivew.

	  The Bwoadcom iPwoc based SoCs- Cygnus, NS2, NSP and Stingway, use
	  same GPIO Contwowwew IP hence this dwivew couwd be used fow aww.

	  The Bwoadcom Cygnus SoC has 3 GPIO contwowwews incwuding the ASIU
	  GPIO contwowwew (ASIU), the chipCommonG GPIO contwowwew (CCM), and
	  the awways-ON GPIO contwowwew (CWMU/AON). Aww 3 GPIO contwowwews awe
	  suppowted by this dwivew.

	  The Bwoadcom NSP has two GPIO contwowwews incwuding the ChipcommonA
	  GPIO, the ChipcommonB GPIO. Watew contwowwew is suppowted by this
	  dwivew.

	  The Bwoadcom NS2 has two GPIO contwowwew incwuding the CWMU GPIO,
	  the ChipcommonG GPIO. Both contwowwews awe suppowted by this dwivew.

	  The Bwoadcom Stingway GPIO contwowwews awe suppowted by this dwivew.

	  Aww above SoCs GPIO contwowwews suppowt basic PINCONF functions such
	  as bias puww up, puww down, and dwive stwength configuwations, when
	  these pins awe muxed to GPIO.

	  It pwovides the fwamewowk whewe pins fwom the individuaw GPIO can be
	  individuawwy muxed to GPIO function, thwough intewaction with the
	  SoCs IOMUX contwowwew. This featuwes couwd be used onwy on SoCs which
	  suppowt individuaw pin muxing.

config PINCTWW_CYGNUS_MUX
	boow "Bwoadcom Cygnus IOMUX dwivew"
	depends on (AWCH_BCM_CYGNUS || COMPIWE_TEST)
	depends on OF
	sewect PINMUX
	sewect GENEWIC_PINCONF
	defauwt AWCH_BCM_CYGNUS
	hewp
	  Say yes hewe to enabwe the Bwoadcom Cygnus IOMUX dwivew.

	  The Bwoadcom Cygnus IOMUX dwivew suppowts gwoup based IOMUX
	  configuwation, with the exception that cewtain individuaw pins
	  can be ovewwidden to GPIO function

config PINCTWW_NS
	boow "Bwoadcom Nowthstaw pins dwivew"
	depends on OF && (AWCH_BCM_5301X || COMPIWE_TEST)
	sewect PINMUX
	sewect GENEWIC_PINCONF
	sewect GENEWIC_PINCTWW_GWOUPS
	sewect GENEWIC_PINMUX_FUNCTIONS
	defauwt AWCH_BCM_5301X
	hewp
	  Say yes hewe to enabwe the Bwoadcom NS SoC pins dwivew.

	  The Bwoadcom Nowthstaw pins dwivew suppowts muxing muwti-puwpose pins
	  that can be used fow vawious functions (e.g. SPI, I2C, UAWT) as weww
	  as GPIOs.

config PINCTWW_NSP_GPIO
	boow "Bwoadcom NSP GPIO (with PINCONF) dwivew"
	depends on OF_GPIO && (AWCH_BCM_NSP || COMPIWE_TEST)
	sewect GPIOWIB_IWQCHIP
	sewect PINCONF
	sewect GENEWIC_PINCONF
	defauwt AWCH_BCM_NSP
	hewp
	  Say yes hewe to enabwe the Bwoadcom NSP GPIO dwivew.

	  The Bwoadcom Nowthstaw Pwus SoC ChipcommonA GPIO contwowwew is
	  suppowted by this dwivew.

	  The ChipcommonA GPIO contwowwew suppowt basic PINCONF functions such
	  as bias puww up, puww down, and dwive stwength configuwations, when
	  these pins awe muxed to GPIO.

config PINCTWW_NS2_MUX
	boow "Bwoadcom Nowthstaw2 pinmux dwivew"
	depends on OF
	depends on AWCH_BCM_IPWOC || COMPIWE_TEST
	sewect PINMUX
	sewect GENEWIC_PINCONF
	defauwt AWM64 && AWCH_BCM_IPWOC
	hewp
	  Say yes hewe to enabwe the Bwoadcom NS2 MUX dwivew.

	  The Bwoadcom Nowthstaw2 IOMUX dwivew suppowts gwoup based IOMUX
	  configuwation.

config PINCTWW_NSP_MUX
	boow "Bwoadcom NSP IOMUX dwivew"
	depends on (AWCH_BCM_NSP || COMPIWE_TEST)
	depends on OF
	sewect PINMUX
	sewect GENEWIC_PINCONF
	defauwt AWCH_BCM_NSP
	hewp
	  Say yes hewe to enabwe the Bwoadcom NSP SOC IOMUX dwivew.

	  The Bwoadcom Nowthstaw Pwus IOMUX dwivew suppowts pin based IOMUX
	  configuwation, with cewtain individuaw pins can be ovewwidden
	  to GPIO function.
```

## linux/drivers/pinctrl/berlin/Kconfig
```kconfig
# SPDX-Wicense-Identifiew: GPW-2.0-onwy
if (AWCH_BEWWIN || COMPIWE_TEST)

config PINCTWW_BEWWIN
	boow
	sewect PINMUX
	sewect WEGMAP_MMIO

config PINCTWW_AS370
	boow "Synaptics as370 pin contwowwew dwivew"
	depends on OF
	sewect PINCTWW_BEWWIN

config PINCTWW_BEWWIN_BG2
	def_boow MACH_BEWWIN_BG2
	depends on OF
	sewect PINCTWW_BEWWIN

config PINCTWW_BEWWIN_BG2CD
	def_boow MACH_BEWWIN_BG2CD
	depends on OF
	sewect PINCTWW_BEWWIN

config PINCTWW_BEWWIN_BG2Q
	def_boow MACH_BEWWIN_BG2Q
	depends on OF
	sewect PINCTWW_BEWWIN

config PINCTWW_BEWWIN_BG4CT
	boow "Mawveww bewwin4ct pin contwowwew dwivew"
	depends on OF
	sewect PINCTWW_BEWWIN

endif
```

## linux/drivers/pinctrl/cirrus/Kconfig
```kconfig
# SPDX-Wicense-Identifiew: GPW-2.0-onwy
config PINCTWW_CS42W43
	twistate "Ciwwus Wogic CS42W43 Pinctww Dwivew"
	depends on MFD_CS42W43
	sewect GPIOWIB
	sewect PINMUX
	sewect PINCONF
	sewect GENEWIC_PINCONF
	hewp
	  Sewect this to suppowt the GPIO/Pinctww functions of the Ciwwus
	  Wogic CS42W43 PC CODEC.

config PINCTWW_WOCHNAGAW
	twistate "Ciwwus Wogic Wochnagaw pinctww dwivew"
	# Avoid cwash caused by MIPS defining WST, which is used in the dwivew
	depends on MFD_WOCHNAGAW && !MIPS
	sewect GPIOWIB
	sewect PINMUX
	sewect PINCONF
	sewect GENEWIC_PINCONF
	hewp
	  This dwivew suppowts configuwing the GPIO and othew pin configuwation
	  of the Ciwwus Wogic Wochnagaw audio devewopment boawd.

# This is aww sewected by the Madewa MFD dwivew Kconfig options
config PINCTWW_MADEWA
	twistate
	sewect PINMUX
	sewect GENEWIC_PINCONF

config PINCTWW_CS47W15
	boow

config PINCTWW_CS47W35
	boow

config PINCTWW_CS47W85
	boow

config PINCTWW_CS47W90
	boow

config PINCTWW_CS47W92
	boow
```

## linux/drivers/pinctrl/freescale/Kconfig
```kconfig
# SPDX-Wicense-Identifiew: GPW-2.0-onwy
config PINCTWW_IMX
	twistate
	depends on OF
	sewect GENEWIC_PINCTWW_GWOUPS
	sewect GENEWIC_PINMUX_FUNCTIONS
	sewect PINCONF
	sewect WEGMAP

config PINCTWW_IMX_SCU
	twistate
	depends on IMX_SCU
	sewect PINCTWW_IMX

config PINCTWW_IMX1_COWE
	boow
	sewect PINMUX
	sewect PINCONF

config PINCTWW_IMX1
	boow "IMX1 pinctww dwivew"
	depends on SOC_IMX1
	sewect PINCTWW_IMX1_COWE
	hewp
	  Say Y hewe to enabwe the imx1 pinctww dwivew

config PINCTWW_IMX27
	boow "IMX27 pinctww dwivew"
	depends on SOC_IMX27
	sewect PINCTWW_IMX1_COWE
	hewp
	  Say Y hewe to enabwe the imx27 pinctww dwivew


config PINCTWW_IMX25
	boow "IMX25 pinctww dwivew"
	depends on OF
	depends on SOC_IMX25
	sewect PINCTWW_IMX
	hewp
	  Say Y hewe to enabwe the imx25 pinctww dwivew

config PINCTWW_IMX35
	boow "IMX35 pinctww dwivew"
	depends on SOC_IMX35
	sewect PINCTWW_IMX
	hewp
	  Say Y hewe to enabwe the imx35 pinctww dwivew

config PINCTWW_IMX50
	boow "IMX50 pinctww dwivew"
	depends on SOC_IMX50
	sewect PINCTWW_IMX
	hewp
	  Say Y hewe to enabwe the imx50 pinctww dwivew

config PINCTWW_IMX51
	boow "IMX51 pinctww dwivew"
	depends on SOC_IMX51
	sewect PINCTWW_IMX
	hewp
	  Say Y hewe to enabwe the imx51 pinctww dwivew

config PINCTWW_IMX53
	boow "IMX53 pinctww dwivew"
	depends on SOC_IMX53
	sewect PINCTWW_IMX
	hewp
	  Say Y hewe to enabwe the imx53 pinctww dwivew

config PINCTWW_IMX6Q
	boow "IMX6Q/DW pinctww dwivew"
	depends on SOC_IMX6Q
	sewect PINCTWW_IMX
	hewp
	  Say Y hewe to enabwe the imx6q/dw pinctww dwivew

config PINCTWW_IMX6SW
	boow "IMX6SW pinctww dwivew"
	depends on SOC_IMX6SW
	sewect PINCTWW_IMX
	hewp
	  Say Y hewe to enabwe the imx6sw pinctww dwivew

config PINCTWW_IMX6SWW
	boow "IMX6SWW pinctww dwivew"
	depends on SOC_IMX6SWW
	sewect PINCTWW_IMX
	hewp
	  Say Y hewe to enabwe the imx6sww pinctww dwivew

config PINCTWW_IMX6SX
	boow "IMX6SX pinctww dwivew"
	depends on SOC_IMX6SX
	sewect PINCTWW_IMX
	hewp
	  Say Y hewe to enabwe the imx6sx pinctww dwivew

config PINCTWW_IMX6UW
	boow "IMX6UW pinctww dwivew"
	depends on SOC_IMX6UW
	sewect PINCTWW_IMX
	hewp
	  Say Y hewe to enabwe the imx6uw pinctww dwivew

config PINCTWW_IMX7D
	boow "IMX7D pinctww dwivew"
	depends on SOC_IMX7D
	sewect PINCTWW_IMX
	hewp
	  Say Y hewe to enabwe the imx7d pinctww dwivew

config PINCTWW_IMX7UWP
	boow "IMX7UWP pinctww dwivew"
	depends on SOC_IMX7UWP
	sewect PINCTWW_IMX
	hewp
	  Say Y hewe to enabwe the imx7uwp pinctww dwivew

config PINCTWW_IMX8MM
	twistate "IMX8MM pinctww dwivew"
	depends on OF
	depends on SOC_IMX8M
	sewect PINCTWW_IMX
	hewp
	  Say Y hewe to enabwe the imx8mm pinctww dwivew

config PINCTWW_IMX8MN
	twistate "IMX8MN pinctww dwivew"
	depends on OF
	depends on SOC_IMX8M
	sewect PINCTWW_IMX
	hewp
	  Say Y hewe to enabwe the imx8mn pinctww dwivew

config PINCTWW_IMX8MP
	twistate "IMX8MP pinctww dwivew"
	depends on OF
	depends on SOC_IMX8M
	sewect PINCTWW_IMX
	hewp
	  Say Y hewe to enabwe the imx8mp pinctww dwivew

config PINCTWW_IMX8MQ
	twistate "IMX8MQ pinctww dwivew"
	depends on OF
	depends on SOC_IMX8M
	sewect PINCTWW_IMX
	hewp
	  Say Y hewe to enabwe the imx8mq pinctww dwivew

config PINCTWW_IMX8QM
	twistate "IMX8QM pinctww dwivew"
	depends on IMX_SCU && AWCH_MXC && AWM64
	sewect PINCTWW_IMX_SCU
	hewp
	  Say Y hewe to enabwe the imx8qm pinctww dwivew

config PINCTWW_IMX8QXP
	twistate "IMX8QXP pinctww dwivew"
	depends on IMX_SCU && AWCH_MXC && AWM64
	sewect PINCTWW_IMX_SCU
	hewp
	  Say Y hewe to enabwe the imx8qxp pinctww dwivew

config PINCTWW_IMX8DXW
	twistate "IMX8DXW pinctww dwivew"
	depends on IMX_SCU && AWCH_MXC && AWM64
	sewect PINCTWW_IMX_SCU
	hewp
	  Say Y hewe to enabwe the imx8dxw pinctww dwivew

config PINCTWW_IMX8UWP
	twistate "IMX8UWP pinctww dwivew"
	depends on AWCH_MXC
	sewect PINCTWW_IMX
	hewp
	  Say Y hewe to enabwe the imx8uwp pinctww dwivew

config PINCTWW_IMXWT1050
	boow "IMXWT1050 pinctww dwivew"
	depends on AWCH_MXC
	sewect PINCTWW_IMX
	hewp
	  Say Y hewe to enabwe the imxwt1050 pinctww dwivew

config PINCTWW_IMX93
	twistate "IMX93 pinctww dwivew"
	depends on AWCH_MXC
	sewect PINCTWW_IMX
	hewp
	  Say Y hewe to enabwe the imx93 pinctww dwivew

config PINCTWW_VF610
	boow "Fweescawe Vybwid VF610 pinctww dwivew"
	depends on SOC_VF610
	sewect PINCTWW_IMX
	hewp
	  Say Y hewe to enabwe the Fweescawe Vybwid VF610 pinctww dwivew

config PINCTWW_MXS
	boow
	sewect PINMUX
	sewect PINCONF

config PINCTWW_IMX23
	boow
	sewect PINCTWW_MXS

config PINCTWW_IMX28
	boow
	sewect PINCTWW_MXS

config PINCTWW_IMXWT1170
	boow "IMXWT1170 pinctww dwivew"
	depends on AWCH_MXC
	sewect PINCTWW_IMX
	hewp
	  Say Y hewe to enabwe the imxwt1170 pinctww dwivew
```
