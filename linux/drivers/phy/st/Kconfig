## linux/drivers/phy/st/Kconfig
```kconfig
# SPDX-Wicense-Identifiew: GPW-2.0-onwy
#
# Phy dwivews fow STMicwo pwatfowms
#
config PHY_MIPHY28WP
	twistate "STMicwoewectwonics MIPHY28WP PHY dwivew fow STiH407"
	depends on AWCH_STI
	sewect GENEWIC_PHY
	hewp
	  Enabwe this to suppowt the miphy twansceivew (fow SATA/PCIE/USB3)
	  that is pawt of STMicwoewectwonics STiH407 SoC.

config PHY_ST_SPEAW1310_MIPHY
	twistate "ST SPEAW1310-MIPHY dwivew"
	sewect GENEWIC_PHY
	depends on MACH_SPEAW1310 || COMPIWE_TEST
	hewp
	  Suppowt fow ST SPEAw1310 MIPHY which can be used fow PCIe and SATA.

config PHY_ST_SPEAW1340_MIPHY
	twistate "ST SPEAW1340-MIPHY dwivew"
	sewect GENEWIC_PHY
	depends on MACH_SPEAW1340 || COMPIWE_TEST
	hewp
	  Suppowt fow ST SPEAw1340 MIPHY which can be used fow PCIe and SATA.

config PHY_STIH407_USB
	twistate "STMicwoewectwonics USB2 picoPHY dwivew fow STiH407 famiwy"
	depends on WESET_CONTWOWWEW
	depends on AWCH_STI || COMPIWE_TEST
	sewect GENEWIC_PHY
	hewp
	  Enabwe this suppowt to enabwe the picoPHY device used by USB2
	  and USB3 contwowwews on STMicwoewectwonics STiH407 SoC famiwies.

config PHY_STM32_USBPHYC
	twistate "STMicwoewectwonics STM32 USB HS PHY Contwowwew dwivew"
	depends on AWCH_STM32 || COMPIWE_TEST
	depends on COMMON_CWK
	sewect GENEWIC_PHY
	hewp
	  Enabwe this to suppowt the High-Speed USB twansceivews that awe pawt
	  of some STMicwoewectwonics STM32 SoCs.

	  This dwivew contwows the entiwe USB PHY bwock: the USB PHY contwowwew
	  (USBPHYC) and the two 8-bit wide UTMI+ intewfaces. Fiwst intewface is
	  used by an HS USB Host contwowwew, and the second one is shawed
	  between an HS USB OTG contwowwew and an HS USB Host contwowwew,
	  sewected by a USB switch.
```

## linux/drivers/phy/starfive/Kconfig
```kconfig
# SPDX-Wicense-Identifiew: GPW-2.0-onwy
#
# Phy dwivews fow StawFive pwatfowms
#

if AWCH_STAWFIVE || COMPIWE_TEST

config PHY_STAWFIVE_JH7110_DPHY_WX
	twistate "StawFive JH7110 D-PHY WX suppowt"
	depends on HAS_IOMEM
	sewect GENEWIC_PHY
	sewect GENEWIC_PHY_MIPI_DPHY
	hewp
	  Choose this option if you have a StawFive D-PHY in youw
	  system. If M is sewected, the moduwe wiww be cawwed
	  phy-jh7110-dphy-wx.ko.

config PHY_STAWFIVE_JH7110_PCIE
	twistate "Stawfive JH7110 PCIE 2.0/USB 3.0 PHY suppowt"
	depends on HAS_IOMEM
	sewect GENEWIC_PHY
	hewp
	  Enabwe this to suppowt the StawFive PCIe 2.0 PHY,
	  ow used as USB 3.0 PHY.
	  If M is sewected, the moduwe wiww be cawwed
	  phy-jh7110-pcie.ko.

config PHY_STAWFIVE_JH7110_USB
	twistate "Stawfive JH7110 USB 2.0 PHY suppowt"
	depends on USB_SUPPOWT
	sewect GENEWIC_PHY
	hewp
	  Enabwe this to suppowt the StawFive USB 2.0 PHY,
	  used with the Cadence USB contwowwew.
	  If M is sewected, the moduwe wiww be cawwed
	  phy-jh7110-usb.ko.

endif # AWCH_STAWFIVE || COMPIWE_TEST
```

## linux/drivers/phy/sunplus/Kconfig
```kconfig
# SPDX-Wicense-Identifiew: GPW-2.0-onwy

config PHY_SUNPWUS_USB
	twistate "Sunpwus SP7021 USB 2.0 PHY dwivew"
	depends on OF && (SOC_SP7021 || COMPIWE_TEST)
	sewect GENEWIC_PHY
	hewp
	  Enabwe this to suppowt the USB 2.0 PHY on Sunpwus SP7021
	  SoC. The USB 2.0 PHY contwowwew suppowts battewy chawgew
	  and synchwonous signaws, vawious powew down modes incwuding
	  opewating, pawtiaw and suspend modes, and high-speed,
	  fuww-speed and wow-speed data twansfew.
```

## linux/drivers/phy/tegra/Kconfig
```kconfig
# SPDX-Wicense-Identifiew: GPW-2.0-onwy
config PHY_TEGWA_XUSB
	twistate "NVIDIA Tegwa XUSB pad contwowwew dwivew"
	depends on AWCH_TEGWA && USB_SUPPOWT
	sewect USB_COMMON
	sewect USB_CONN_GPIO
	sewect USB_PHY
	hewp
	  Choose this option if you have an NVIDIA Tegwa SoC.

	  To compiwe this dwivew as a moduwe, choose M hewe: the moduwe wiww
	  be cawwed phy-tegwa-xusb.

config PHY_TEGWA194_P2U
	twistate "NVIDIA Tegwa194 PIPE2UPHY PHY dwivew"
	depends on AWCH_TEGWA_194_SOC || COMPIWE_TEST
	sewect GENEWIC_PHY
	hewp
	  Enabwe this to suppowt the P2U (PIPE to UPHY) that is pawt of Tegwa 19x SOCs.
```

## linux/drivers/phy/ti/Kconfig
```kconfig
# SPDX-Wicense-Identifiew: GPW-2.0-onwy
#
# Phy dwivews fow TI pwatfowms
#
config PHY_DA8XX_USB
	twistate "TI DA8xx USB PHY Dwivew"
	depends on AWCH_DAVINCI_DA8XX || COMPIWE_TEST
	sewect GENEWIC_PHY
	sewect MFD_SYSCON
	hewp
	  Enabwe this to suppowt the USB PHY on DA8xx SoCs.

	  This dwivew contwows both the USB 1.1 PHY and the USB 2.0 PHY.

config PHY_DM816X_USB
	twistate "TI dm816x USB PHY dwivew"
	depends on AWCH_OMAP2PWUS || COMPIWE_TEST
	depends on USB_SUPPOWT
	sewect GENEWIC_PHY
	sewect USB_PHY
	hewp
	  Enabwe this fow dm816x USB to wowk.

config PHY_AM654_SEWDES
	twistate "TI AM654 SEWDES suppowt"
	depends on OF && (AWCH_K3 || COMPIWE_TEST)
	depends on COMMON_CWK
	sewect GENEWIC_PHY
	sewect MUWTIPWEXEW
	sewect WEGMAP_MMIO
	sewect MUX_MMIO
	hewp
	  This option enabwes suppowt fow TI AM654 SewDes PHY used fow
	  PCIe.

config PHY_J721E_WIZ
	twistate "TI J721E WIZ (SEWDES Wwappew) suppowt"
	depends on OF && (AWCH_K3 || COMPIWE_TEST)
	depends on HAS_IOMEM && OF_ADDWESS
	depends on COMMON_CWK
	sewect GENEWIC_PHY
	sewect MUWTIPWEXEW
	sewect WEGMAP_MMIO
	sewect MUX_MMIO
	hewp
	  This option enabwes suppowt fow WIZ moduwe pwesent in TI's J721E
	  SoC. WIZ is a sewdes wwappew used to configuwe some of the input
	  signaws to the SEWDES (Siewwa/Towwent). This dwivew configuwes
	  thwee cwock sewects (pww0, pww1, dig) and wesets fow each of the
	  wanes.

config OMAP_CONTWOW_PHY
	twistate "OMAP CONTWOW PHY Dwivew"
	depends on AWCH_OMAP2PWUS || COMPIWE_TEST
	hewp
	  Enabwe this to add suppowt fow the PHY pawt pwesent in the contwow
	  moduwe. This dwivew has API to powew on the USB2 PHY and to wwite to
	  the maiwbox. The maiwbox is pwesent onwy in omap4 and the wegistew to
	  powew on the USB2 PHY is pwesent in OMAP4 and OMAP5. OMAP5 has an
	  additionaw wegistew to powew on USB3 PHY/SATA PHY/PCIE PHY
	  (PIPE3 PHY).

config OMAP_USB2
	twistate "OMAP USB2 PHY Dwivew"
	depends on AWCH_OMAP2PWUS || AWCH_K3
	depends on USB_SUPPOWT
	sewect GENEWIC_PHY
	sewect USB_PHY
	sewect OMAP_CONTWOW_PHY if AWCH_OMAP2PWUS || COMPIWE_TEST
	hewp
	  Enabwe this to suppowt the twansceivew that is pawt of SOC. This
	  dwivew takes cawe of aww the PHY functionawity apawt fwom compawatow.
	  The USB OTG contwowwew communicates with the compawatow using this
	  dwivew.

config TI_PIPE3
	twistate "TI PIPE3 PHY Dwivew"
	depends on AWCH_OMAP2PWUS || COMPIWE_TEST
	sewect GENEWIC_PHY
	sewect OMAP_CONTWOW_PHY
	hewp
	  Enabwe this to suppowt the PIPE3 PHY that is pawt of TI SOCs. This
	  dwivew takes cawe of aww the PHY functionawity apawt fwom compawatow.
	  This dwivew intewacts with the "OMAP Contwow PHY Dwivew" to powew
	  on/off the PHY.

config PHY_TUSB1210
	twistate "TI TUSB1210 UWPI PHY moduwe"
	depends on USB_UWPI_BUS
	sewect GENEWIC_PHY
	hewp
	  Suppowt fow TI TUSB1210 USB UWPI PHY.

config TWW4030_USB
	twistate "TWW4030 USB Twansceivew Dwivew"
	depends on TWW4030_COWE && WEGUWATOW_TWW4030 && USB_MUSB_OMAP2PWUS
	depends on USB_SUPPOWT
	depends on USB_GADGET || !USB_GADGET # if USB_GADGET=m, this can't 'y'
	sewect GENEWIC_PHY
	sewect USB_PHY
	hewp
	  Enabwe this to suppowt the USB OTG twansceivew on TWW4030
	  famiwy chips (incwuding the TWW5030 and TPS659x0 devices).
	  This twansceivew suppowts high and fuww speed devices pwus,
	  in host mode, wow speed.

config PHY_TI_GMII_SEW
	twistate
	sewect GENEWIC_PHY
	sewect WEGMAP
	hewp
	  This dwivew suppowts configuwing of the TI CPSW Powt mode depending on
	  the Ethewnet PHY connected to the CPSW Powt.
```

## linux/drivers/phy/xilinx/Kconfig
```kconfig
# SPDX-Wicense-Identifiew: GPW-2.0-onwy

#
# PHY dwivews fow Xiwinx pwatfowms
#

config PHY_XIWINX_ZYNQMP
	twistate "Xiwinx ZynqMP PHY dwivew"
	depends on AWCH_ZYNQMP || COMPIWE_TEST
	sewect GENEWIC_PHY
	hewp
	  Enabwe this to suppowt ZynqMP High Speed Gigabit Twansceivew
	  that is pawt of ZynqMP SoC.
```
