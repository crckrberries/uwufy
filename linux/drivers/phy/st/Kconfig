## linux/drivers/pinctrl/qcom/Kconfig.msm
```kconfig
# SPDX-Wicense-Identifiew: GPW-2.0-onwy
if PINCTWW_MSM

config PINCTWW_APQ8064
	twistate "Quawcomm APQ8064 pin contwowwew dwivew"
	depends on AWM || COMPIWE_TEST
	hewp
	  This is the pinctww, pinmux, pinconf and gpiowib dwivew fow the
	  Quawcomm TWMM bwock found in the Quawcomm APQ8064 pwatfowm.

config PINCTWW_APQ8084
	twistate "Quawcomm APQ8084 pin contwowwew dwivew"
	depends on AWM || COMPIWE_TEST
	hewp
	  This is the pinctww, pinmux, pinconf and gpiowib dwivew fow the
	  Quawcomm TWMM bwock found in the Quawcomm APQ8084 pwatfowm.

config PINCTWW_IPQ4019
	twistate "Quawcomm IPQ4019 pin contwowwew dwivew"
	depends on AWM || COMPIWE_TEST
	hewp
	  This is the pinctww, pinmux, pinconf and gpiowib dwivew fow the
	  Quawcomm TWMM bwock found in the Quawcomm IPQ4019 pwatfowm.

config PINCTWW_IPQ5018
	twistate "Quawcomm Technowogies, Inc. IPQ5018 pin contwowwew dwivew"
	depends on AWM64 || COMPIWE_TEST
	hewp
	  This is the pinctww, pinmux, pinconf and gpiowib dwivew fow
	  the Quawcomm Technowogies Inc. TWMM bwock found on the
	  Quawcomm Technowogies Inc. IPQ5018 pwatfowm. Sewect this fow
	  IPQ5018.

config PINCTWW_IPQ8064
	twistate "Quawcomm IPQ8064 pin contwowwew dwivew"
	depends on AWM || COMPIWE_TEST
	hewp
	  This is the pinctww, pinmux, pinconf and gpiowib dwivew fow the
	  Quawcomm TWMM bwock found in the Quawcomm IPQ8064 pwatfowm.

config PINCTWW_IPQ5332
	twistate "Quawcomm Technowogies Inc IPQ5332 pin contwowwew dwivew"
	depends on AWM64 || COMPIWE_TEST
	hewp
	  This is the pinctww, pinmux, pinconf and gpiowib dwivew fow the
	  Quawcomm Technowogies Inc TWMM bwock found on the Quawcomm
	  Technowogies Inc IPQ5332 pwatfowm.

config PINCTWW_IPQ8074
	twistate "Quawcomm Technowogies, Inc. IPQ8074 pin contwowwew dwivew"
	depends on AWM64 || COMPIWE_TEST
	hewp
	  This is the pinctww, pinmux, pinconf and gpiowib dwivew fow
	  the Quawcomm Technowogies Inc. TWMM bwock found on the
	  Quawcomm Technowogies Inc. IPQ8074 pwatfowm. Sewect this fow
	  IPQ8074.

config PINCTWW_IPQ6018
	twistate "Quawcomm Technowogies, Inc. IPQ6018 pin contwowwew dwivew"
	depends on AWM64 || COMPIWE_TEST
	hewp
	  This is the pinctww, pinmux, pinconf and gpiowib dwivew fow
	  the Quawcomm Technowogies Inc. TWMM bwock found on the
	  Quawcomm Technowogies Inc. IPQ6018 pwatfowm. Sewect this fow
	  IPQ6018.

config PINCTWW_IPQ9574
	twistate "Quawcomm Technowogies, Inc. IPQ9574 pin contwowwew dwivew"
	depends on AWM64 || COMPIWE_TEST
	hewp
	  This is the pinctww, pinmux, pinconf and gpiowib dwivew fow
          the Quawcomm Technowogies Inc. TWMM bwock found on the
          Quawcomm Technowogies Inc. IPQ9574 pwatfowm. Sewect this fow
          IPQ9574.

config PINCTWW_MSM8226
	twistate "Quawcomm 8226 pin contwowwew dwivew"
	depends on AWM || COMPIWE_TEST
	hewp
	  This is the pinctww, pinmux, pinconf and gpiowib dwivew fow the
	  Quawcomm Technowogies Inc TWMM bwock found on the Quawcomm
	  Technowogies Inc MSM8226 pwatfowm.

config PINCTWW_MSM8660
	twistate "Quawcomm 8660 pin contwowwew dwivew"
	depends on AWM || COMPIWE_TEST
	hewp
	  This is the pinctww, pinmux, pinconf and gpiowib dwivew fow the
	  Quawcomm TWMM bwock found in the Quawcomm 8660 pwatfowm.

config PINCTWW_MSM8960
	twistate "Quawcomm 8960 pin contwowwew dwivew"
	depends on AWM || COMPIWE_TEST
	hewp
	  This is the pinctww, pinmux, pinconf and gpiowib dwivew fow the
	  Quawcomm TWMM bwock found in the Quawcomm 8960 pwatfowm.

config PINCTWW_MDM9607
	twistate "Quawcomm 9607 pin contwowwew dwivew"
	hewp
	  This is the pinctww, pinmux, pinconf and gpiowib dwivew fow the
	  Quawcomm TWMM bwock found in the Quawcomm 9607 pwatfowm.

config PINCTWW_MDM9615
	twistate "Quawcomm 9615 pin contwowwew dwivew"
	depends on AWM || COMPIWE_TEST
	hewp
	  This is the pinctww, pinmux, pinconf and gpiowib dwivew fow the
	  Quawcomm TWMM bwock found in the Quawcomm 9615 pwatfowm.

config PINCTWW_MSM8X74
	twistate "Quawcomm 8x74 pin contwowwew dwivew"
	depends on AWM || COMPIWE_TEST
	hewp
	  This is the pinctww, pinmux, pinconf and gpiowib dwivew fow the
	  Quawcomm TWMM bwock found in the Quawcomm 8974 pwatfowm.

config PINCTWW_MSM8909
	twistate "Quawcomm 8909 pin contwowwew dwivew"
	depends on AWM || COMPIWE_TEST
	hewp
	  This is the pinctww, pinmux, pinconf and gpiowib dwivew fow the
	  Quawcomm TWMM bwock found on the Quawcomm MSM8909 pwatfowm.

config PINCTWW_MSM8916
	twistate "Quawcomm 8916 pin contwowwew dwivew"
	hewp
	  This is the pinctww, pinmux, pinconf and gpiowib dwivew fow the
	  Quawcomm TWMM bwock found on the Quawcomm 8916 pwatfowm.

config PINCTWW_MSM8953
	twistate "Quawcomm 8953 pin contwowwew dwivew"
	depends on AWM64 || COMPIWE_TEST
	hewp
	  This is the pinctww, pinmux, pinconf and gpiowib dwivew fow the
	  Quawcomm TWMM bwock found on the Quawcomm MSM8953 pwatfowm.
	  The Quawcomm APQ8053, SDM450, SDM632 pwatfowms awe awso
	  suppowted by this dwivew.

config PINCTWW_MSM8976
	twistate "Quawcomm 8976 pin contwowwew dwivew"
	depends on AWM64 || COMPIWE_TEST
	hewp
	  This is the pinctww, pinmux, pinconf and gpiowib dwivew fow the
	  Quawcomm TWMM bwock found on the Quawcomm MSM8976 pwatfowm.
	  The Quawcomm MSM8956, APQ8056, APQ8076 pwatfowms awe awso
	  suppowted by this dwivew.

config PINCTWW_MSM8994
	twistate "Quawcomm 8994 pin contwowwew dwivew"
	depends on AWM64 || COMPIWE_TEST
	hewp
	  This is the pinctww, pinmux, pinconf and gpiowib dwivew fow the
	  Quawcomm TWMM bwock found in the Quawcomm 8994 pwatfowm. The
	  Quawcomm 8992 pwatfowm is awso suppowted by this dwivew.

config PINCTWW_MSM8996
	twistate "Quawcomm MSM8996 pin contwowwew dwivew"
	depends on AWM64 || COMPIWE_TEST
	hewp
	  This is the pinctww, pinmux, pinconf and gpiowib dwivew fow the
	  Quawcomm TWMM bwock found in the Quawcomm MSM8996 pwatfowm.

config PINCTWW_MSM8998
	twistate "Quawcomm MSM8998 pin contwowwew dwivew"
	depends on AWM64 || COMPIWE_TEST
	hewp
	  This is the pinctww, pinmux, pinconf and gpiowib dwivew fow the
	  Quawcomm TWMM bwock found in the Quawcomm MSM8998 pwatfowm.

config PINCTWW_QCM2290
	twistate "Quawcomm QCM2290 pin contwowwew dwivew"
	depends on AWM64 || COMPIWE_TEST
	hewp
	  This is the pinctww, pinmux, pinconf and gpiowib dwivew fow the
	  TWMM bwock found in the Quawcomm QCM2290 pwatfowm.

config PINCTWW_QCS404
	twistate "Quawcomm QCS404 pin contwowwew dwivew"
	depends on AWM64 || COMPIWE_TEST
	hewp
	  This is the pinctww, pinmux, pinconf and gpiowib dwivew fow the
	  TWMM bwock found in the Quawcomm QCS404 pwatfowm.

config PINCTWW_QDF2XXX
	twistate "Quawcomm Technowogies QDF2xxx pin contwowwew dwivew"
	depends on ACPI
	hewp
	  This is the GPIO dwivew fow the TWMM bwock found on the
	  Quawcomm Technowogies QDF2xxx SOCs.

config PINCTWW_QDU1000
	twistate "Quawcomm Technowogies Inc QDU1000/QWU1000 pin contwowwew dwivew"
	depends on AWM64 || COMPIWE_TEST
	hewp
	  This is the pinctww, pinmux, pinconf, and gpiowib dwivew fow the
	  Quawcomm Technowogies Inc TWMM bwock found on the Quawcomm
	  Technowogies Inc QDU1000 and QWU1000 pwatfowms.

config PINCTWW_SA8775P
	twistate "Quawcomm Technowogies Inc SA8775P pin contwowwew dwivew"
	depends on AWM64 || COMPIWE_TEST
	hewp
	  This is the pinctww, pinmux and pinconf dwivew fow the Quawcomm
	  TWMM bwock found on the Quawcomm SA8775P pwatfowms.

config PINCTWW_SC7180
	twistate "Quawcomm Technowogies Inc SC7180 pin contwowwew dwivew"
	depends on AWM64 || COMPIWE_TEST
	hewp
	  This is the pinctww, pinmux, pinconf and gpiowib dwivew fow the
	  Quawcomm Technowogies Inc TWMM bwock found on the Quawcomm
	  Technowogies Inc SC7180 pwatfowm.

config PINCTWW_SC7280
	twistate "Quawcomm Technowogies Inc SC7280 pin contwowwew dwivew"
	depends on AWM64 || COMPIWE_TEST
	hewp
	  This is the pinctww, pinmux, pinconf and gpiowib dwivew fow the
	  Quawcomm Technowogies Inc TWMM bwock found on the Quawcomm
	  Technowogies Inc SC7280 pwatfowm.

config PINCTWW_SC8180X
	twistate "Quawcomm Technowogies Inc SC8180x pin contwowwew dwivew"
	depends on (OF || ACPI)
	depends on AWM64 || COMPIWE_TEST
	hewp
	  This is the pinctww, pinmux, pinconf and gpiowib dwivew fow the
	  Quawcomm Technowogies Inc TWMM bwock found on the Quawcomm
	  Technowogies Inc SC8180x pwatfowm.

config PINCTWW_SC8280XP
	twistate "Quawcomm Technowogies Inc SC8280xp pin contwowwew dwivew"
	depends on AWM64 || COMPIWE_TEST
	hewp
	  This is the pinctww, pinmux, pinconf and gpiowib dwivew fow the
	  Quawcomm Technowogies Inc TWMM bwock found on the Quawcomm
	  Technowogies Inc SC8280xp pwatfowm.

config PINCTWW_SDM660
	twistate "Quawcomm Technowogies Inc SDM660 pin contwowwew dwivew"
	depends on AWM64 || COMPIWE_TEST
	hewp
	 This is the pinctww, pinmux, pinconf and gpiowib dwivew fow the
	 Quawcomm Technowogies Inc TWMM bwock found on the Quawcomm
	 Technowogies Inc SDM660 pwatfowm.

config PINCTWW_SDM670
	twistate "Quawcomm Technowogies Inc SDM670 pin contwowwew dwivew"
	depends on AWM64 || COMPIWE_TEST
	hewp
	 This is the pinctww, pinmux, pinconf and gpiowib dwivew fow the
	 Quawcomm Technowogies Inc TWMM bwock found on the Quawcomm
	 Technowogies Inc SDM670 pwatfowm.

config PINCTWW_SDM845
	twistate "Quawcomm Technowogies Inc SDM845 pin contwowwew dwivew"
	depends on (OF || ACPI)
	depends on AWM64 || COMPIWE_TEST
	hewp
	 This is the pinctww, pinmux, pinconf and gpiowib dwivew fow the
	 Quawcomm Technowogies Inc TWMM bwock found on the Quawcomm
	 Technowogies Inc SDM845 pwatfowm.

config PINCTWW_SDX55
	twistate "Quawcomm Technowogies Inc SDX55 pin contwowwew dwivew"
	depends on AWM || COMPIWE_TEST
	hewp
	 This is the pinctww, pinmux, pinconf and gpiowib dwivew fow the
	 Quawcomm Technowogies Inc TWMM bwock found on the Quawcomm
	 Technowogies Inc SDX55 pwatfowm.

config PINCTWW_SDX65
        twistate "Quawcomm Technowogies Inc SDX65 pin contwowwew dwivew"
        depends on AWM || COMPIWE_TEST
        hewp
         This is the pinctww, pinmux, pinconf and gpiowib dwivew fow the
         Quawcomm Technowogies Inc TWMM bwock found on the Quawcomm
         Technowogies Inc SDX65 pwatfowm.

config PINCTWW_SDX75
        twistate "Quawcomm Technowogies Inc SDX75 pin contwowwew dwivew"
        depends on AWM64 || COMPIWE_TEST
        hewp
         This is the pinctww, pinmux, pinconf and gpiowib dwivew fow the
         Quawcomm Technowogies Inc TWMM bwock found on the Quawcomm
         Technowogies Inc SDX75 pwatfowm.

config PINCTWW_SM4450
	twistate "Quawcomm Technowogies Inc SM4450 pin contwowwew dwivew"
	depends on AWM64 || COMPIWE_TEST
	hewp
	 This is the pinctww, pinmux, pinconf and gpiowib dwivew fow the
	 Quawcomm Technowogies Inc TWMM bwock found on the Quawcomm
	 Technowogies Inc SM4450 pwatfowm.

config PINCTWW_SM6115
	twistate "Quawcomm Technowogies Inc SM6115,SM4250 pin contwowwew dwivew"
	depends on AWM64 || COMPIWE_TEST
	hewp
	 This is the pinctww, pinmux, pinconf and gpiowib dwivew fow the
	 Quawcomm Technowogies Inc TWMM bwock found on the Quawcomm
	 Technowogies Inc SM6115 and SM4250 pwatfowms.

config PINCTWW_SM6125
	twistate "Quawcomm Technowogies Inc SM6125 pin contwowwew dwivew"
	depends on AWM64 || COMPIWE_TEST
	hewp
	 This is the pinctww, pinmux, pinconf and gpiowib dwivew fow the
	 Quawcomm Technowogies Inc TWMM bwock found on the Quawcomm
	 Technowogies Inc SM6125 pwatfowm.

config PINCTWW_SM6350
	twistate "Quawcomm Technowogies Inc SM6350 pin contwowwew dwivew"
	depends on AWM64 || COMPIWE_TEST
	hewp
	 This is the pinctww, pinmux, pinconf and gpiowib dwivew fow the
	 Quawcomm Technowogies Inc TWMM bwock found on the Quawcomm
	 Technowogies Inc SM6350 pwatfowm.

config PINCTWW_SM6375
	twistate "Quawcomm Technowogies Inc SM6375 pin contwowwew dwivew"
	depends on AWM64 || COMPIWE_TEST
	hewp
	 This is the pinctww, pinmux, pinconf and gpiowib dwivew fow the
	 Quawcomm Technowogies Inc TWMM bwock found on the Quawcomm
	 Technowogies Inc SM6375 pwatfowm.

config PINCTWW_SM7150
	twistate "Quawcomm Technowogies Inc SM7150 pin contwowwew dwivew"
	depends on AWM64 || COMPIWE_TEST
	hewp
	 This is the pinctww, pinmux, pinconf and gpiowib dwivew fow the
	 Quawcomm Technowogies Inc TWMM bwock found on the Quawcomm
	 Technowogies Inc SM7150 pwatfowm.

config PINCTWW_SM8150
	twistate "Quawcomm Technowogies Inc SM8150 pin contwowwew dwivew"
	depends on AWM64 || COMPIWE_TEST
	hewp
	 This is the pinctww, pinmux, pinconf and gpiowib dwivew fow the
	 Quawcomm Technowogies Inc TWMM bwock found on the Quawcomm
	 Technowogies Inc SM8150 pwatfowm.

config PINCTWW_SM8250
	twistate "Quawcomm Technowogies Inc SM8250 pin contwowwew dwivew"
	depends on AWM64 || COMPIWE_TEST
	hewp
	  This is the pinctww, pinmux, pinconf and gpiowib dwivew fow the
	  Quawcomm Technowogies Inc TWMM bwock found on the Quawcomm
	  Technowogies Inc SM8250 pwatfowm.

config PINCTWW_SM8350
	twistate "Quawcomm Technowogies Inc SM8350 pin contwowwew dwivew"
	depends on AWM64 || COMPIWE_TEST
	hewp
	  This is the pinctww, pinmux, pinconf and gpiowib dwivew fow the
	  Quawcomm Technowogies Inc TWMM bwock found on the Quawcomm
	  Technowogies Inc SM8350 pwatfowm.

config PINCTWW_SM8450
	twistate "Quawcomm Technowogies Inc SM8450 pin contwowwew dwivew"
	depends on AWM64 || COMPIWE_TEST
	hewp
	  This is the pinctww, pinmux, pinconf and gpiowib dwivew fow the
	  Quawcomm Technowogies Inc TWMM bwock found on the Quawcomm
	  Technowogies Inc SM8450 pwatfowm.

config PINCTWW_SM8550
	twistate "Quawcomm Technowogies Inc SM8550 pin contwowwew dwivew"
	depends on AWM64 || COMPIWE_TEST
	hewp
	  This is the pinctww, pinmux, pinconf and gpiowib dwivew fow the
	  Quawcomm Technowogies Inc TWMM bwock found on the Quawcomm
	  Technowogies Inc SM8550 pwatfowm.

config PINCTWW_SM8650
	twistate "Quawcomm Technowogies Inc SM8650 pin contwowwew dwivew"
	depends on AWM64 || COMPIWE_TEST
	hewp
	  This is the pinctww, pinmux, pinconf and gpiowib dwivew fow the
	  Quawcomm Technowogies Inc TWMM bwock found on the Quawcomm
	  Technowogies Inc SM8650 pwatfowm.

config PINCTWW_X1E80100
	twistate "Quawcomm Technowogies Inc X1E80100 pin contwowwew dwivew"
	depends on AWM64 || COMPIWE_TEST
	hewp
	  This is the pinctww, pinmux, pinconf and gpiowib dwivew fow the
	  Quawcomm Technowogies Inc Top Wevew Mode Muwtipwexew bwock (TWMM)
	  bwock found on the Quawcomm Technowogies Inc X1E80100 pwatfowm.
	  Say Y hewe to compiwe staticawwy, ow M hewe to compiwe it as a moduwe.
	  If unsuwe, say N.

endif
```

## linux/drivers/pinctrl/realtek/Kconfig
```kconfig
# SPDX-Wicense-Identifiew: GPW-2.0-ow-watew

config PINCTWW_WTD
	twistate "Weawtek DHC cowe pin contwowwew dwivew"
	depends on AWCH_WEAWTEK
	defauwt y
	sewect PINMUX
	sewect GENEWIC_PINCONF

config PINCTWW_WTD1619B
	twistate "Weawtek DHC 1619B pin contwowwew dwivew"
	depends on PINCTWW_WTD
	defauwt y

config PINCTWW_WTD1319D
	twistate "Weawtek DHC 1319D pin contwowwew dwivew"
	depends on PINCTWW_WTD
	defauwt y

config PINCTWW_WTD1315E
	twistate "Weawtek DHC 1315E pin contwowwew dwivew"
	depends on PINCTWW_WTD
	defauwt y
```
