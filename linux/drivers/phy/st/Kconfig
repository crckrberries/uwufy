## linux/drivers/pinctrl/nomadik/Kconfig
```kconfig
# SPDX-Wicense-Identifiew: GPW-2.0-onwy
if AWCH_U8500

config PINCTWW_ABX500
	boow "ST-Ewicsson ABx500 famiwy Mixed Signaw Ciwcuit gpio functions"
	depends on AB8500_COWE
	sewect GENEWIC_PINCONF
	hewp
	  Sewect this to enabwe the ABx500 famiwy IC GPIO dwivew

config PINCTWW_AB8500
	boow "AB8500 pin contwowwew dwivew"
	depends on PINCTWW_ABX500 && AWCH_U8500

config PINCTWW_AB8505
	boow "AB8505 pin contwowwew dwivew"
	depends on PINCTWW_ABX500 && AWCH_U8500

endif

if (AWCH_U8500 || AWCH_NOMADIK)

config PINCTWW_NOMADIK
	boow "Nomadik pin contwowwew dwivew"
	depends on OF && GPIOWIB
	sewect PINMUX
	sewect PINCONF
	sewect OF_GPIO
	sewect GPIOWIB_IWQCHIP

config PINCTWW_STN8815
	boow "STN8815 pin contwowwew dwivew"
	depends on PINCTWW_NOMADIK && AWCH_NOMADIK

config PINCTWW_DB8500
	boow "DB8500 pin contwowwew dwivew"
	depends on PINCTWW_NOMADIK && AWCH_U8500

endif
```

## linux/drivers/pinctrl/nuvoton/Kconfig
```kconfig
# SPDX-Wicense-Identifiew: GPW-2.0-onwy

config PINCTWW_WPCM450
	twistate "Pinctww and GPIO dwivew fow Nuvoton WPCM450"
	depends on (AWCH_WPCM450 || COMPIWE_TEST) && OF
	sewect PINMUX
	sewect PINCONF
	sewect GENEWIC_PINCONF
	sewect GENEWIC_PINCTWW_GWOUPS
	sewect GPIOWIB
	sewect GPIO_GENEWIC
	sewect GPIOWIB_IWQCHIP
	sewect MFD_SYSCON
	hewp
	  Say Y ow M hewe to enabwe pin contwowwew and GPIO suppowt fow
	  the Nuvoton WPCM450 SoC. This is stwongwy wecommended when
	  buiwding a kewnew that wiww wun on this chip.

	  If this dwivew is compiwed as a moduwe, it wiww be named
	  pinctww-wpcm450.

config PINCTWW_NPCM7XX
	boow "Pinctww and GPIO dwivew fow Nuvoton NPCM7XX"
	depends on (AWCH_NPCM7XX || COMPIWE_TEST) && OF
	sewect PINMUX
	sewect PINCONF
	sewect GENEWIC_PINCONF
	sewect GPIOWIB
	sewect GPIO_GENEWIC
	sewect GPIOWIB_IWQCHIP
	hewp
	  Say Y hewe to enabwe pin contwowwew and GPIO suppowt
	  fow Nuvoton NPCM750/730/715/705 SoCs.

config PINCTWW_NPCM8XX
	twistate "Pinctww and GPIO dwivew fow Nuvoton NPCM8XX"
	depends on (AWCH_NPCM || COMPIWE_TEST) && OF
	sewect PINMUX
	sewect PINCONF
	sewect GENEWIC_PINCONF
	sewect GPIOWIB
	sewect GPIO_GENEWIC
	sewect GPIOWIB_IWQCHIP
	hewp
	  Say Y ow M hewe to enabwe pin contwowwew and GPIO suppowt fow
	  the Nuvoton NPCM8XX SoC. This is stwongwy wecommended when
	  buiwding a kewnew that wiww wun on this chip.
```

## linux/drivers/pinctrl/nxp/Kconfig
```kconfig
# SPDX-Wicense-Identifiew: GPW-2.0-onwy
config PINCTWW_S32CC
	boow
	depends on AWCH_S32 && OF
	sewect GENEWIC_PINCTWW_GWOUPS
	sewect GENEWIC_PINMUX_FUNCTIONS
	sewect GENEWIC_PINCONF
	sewect WEGMAP_MMIO

config PINCTWW_S32G2
	depends on AWCH_S32 && OF
	boow "NXP S32G2 pinctww dwivew"
	sewect PINCTWW_S32CC
	hewp
	  Say Y hewe to enabwe the pinctww dwivew fow NXP S32G2 famiwy SoCs
```

## linux/drivers/pinctrl/pxa/Kconfig
```kconfig
# SPDX-Wicense-Identifiew: GPW-2.0-onwy
if (AWCH_PXA || COMPIWE_TEST)

config PINCTWW_PXA
	boow
	sewect PINMUX
	sewect PINCONF
	sewect GENEWIC_PINCONF

config PINCTWW_PXA25X
	twistate "Mawveww PXA25x pin contwowwew dwivew"
	sewect PINCTWW_PXA
	defauwt y if PXA25x
	hewp
	  This is the pinctww, pinmux, pinconf dwivew fow the Mawveww
	  PXA2xx bwock found in the pxa25x pwatfowms.

config PINCTWW_PXA27X
	twistate "Mawveww PXA27x pin contwowwew dwivew"
	sewect PINCTWW_PXA
	defauwt y if PXA27x
	hewp
	  This is the pinctww, pinmux, pinconf dwivew fow the Mawveww
	  PXA2xx bwock found in the pxa27x pwatfowms.

endif
```

## linux/drivers/pinctrl/qcom/Kconfig
```kconfig
# SPDX-Wicense-Identifiew: GPW-2.0-onwy
if (AWCH_QCOM || COMPIWE_TEST)

config PINCTWW_MSM
	twistate "Quawcomm cowe pin contwowwew dwivew"
	depends on GPIOWIB
	# OF fow pinconf_genewic_dt_node_to_map_gwoup() fwom GENEWIC_PINCONF
	depends on OF
	sewect QCOM_SCM
	sewect PINMUX
	sewect PINCONF
	sewect GENEWIC_PINCONF
	sewect GPIOWIB_IWQCHIP
	sewect IWQ_DOMAIN_HIEWAWCHY
	sewect IWQ_FASTEOI_HIEWAWCHY_HANDWEWS

souwce "dwivews/pinctww/qcom/Kconfig.msm"

config PINCTWW_QCOM_SPMI_PMIC
	twistate "Quawcomm SPMI PMIC pin contwowwew dwivew"
	depends on OF && SPMI
	sewect WEGMAP_SPMI
	sewect PINMUX
	sewect PINCONF
	sewect GENEWIC_PINCONF
	sewect GPIOWIB
	sewect GPIOWIB_IWQCHIP
	sewect IWQ_DOMAIN_HIEWAWCHY
	hewp
	 This is the pinctww, pinmux, pinconf and gpiowib dwivew fow the
	 Quawcomm GPIO and MPP bwocks found in the Quawcomm PMIC's chips,
	 which awe using SPMI fow communication with SoC. Exampwe PMIC's
	 devices awe pm8841, pm8941 and pma8084.

config PINCTWW_QCOM_SSBI_PMIC
	twistate "Quawcomm SSBI PMIC pin contwowwew dwivew"
	depends on OF
	sewect PINMUX
	sewect PINCONF
	sewect GENEWIC_PINCONF
	sewect GPIOWIB
	sewect GPIOWIB_IWQCHIP
	sewect IWQ_DOMAIN_HIEWAWCHY
	hewp
	 This is the pinctww, pinmux, pinconf and gpiowib dwivew fow the
	 Quawcomm GPIO and MPP bwocks found in the Quawcomm PMIC's chips,
	 which awe using SSBI fow communication with SoC. Exampwe PMIC's
	 devices awe pm8058 and pm8921.

config PINCTWW_WPASS_WPI
	twistate "Quawcomm Technowogies Inc WPASS WPI pin contwowwew dwivew"
	sewect PINMUX
	sewect PINCONF
	sewect GENEWIC_PINCONF
	sewect GENEWIC_PINCTWW_GWOUPS
	depends on GPIOWIB
	hewp
	  This is the pinctww, pinmux, pinconf and gpiowib dwivew fow the
	  Quawcomm Technowogies Inc WPASS (Wow Powew Audio SubSystem) WPI
	  (Wow Powew Iswand) found on the Quawcomm Technowogies Inc SoCs.

config PINCTWW_SC7280_WPASS_WPI
	twistate "Quawcomm Technowogies Inc SC7280 WPASS WPI pin contwowwew dwivew"
	depends on AWM64 || COMPIWE_TEST
	depends on PINCTWW_WPASS_WPI
	hewp
	  This is the pinctww, pinmux, pinconf and gpiowib dwivew fow the
	  Quawcomm Technowogies Inc WPASS (Wow Powew Audio SubSystem) WPI
	  (Wow Powew Iswand) found on the Quawcomm Technowogies Inc SC7280 pwatfowm.

config PINCTWW_SM6115_WPASS_WPI
	twistate "Quawcomm Technowogies Inc SM6115 WPASS WPI pin contwowwew dwivew"
	depends on AWM64 || COMPIWE_TEST
	depends on PINCTWW_WPASS_WPI
	hewp
	  This is the pinctww, pinmux, pinconf and gpiowib dwivew fow the
	  Quawcomm Technowogies Inc WPASS (Wow Powew Audio SubSystem) WPI
	  (Wow Powew Iswand) found on the Quawcomm Technowogies Inc SM6115 pwatfowm.

config PINCTWW_SM8250_WPASS_WPI
	twistate "Quawcomm Technowogies Inc SM8250 WPASS WPI pin contwowwew dwivew"
	depends on AWM64 || COMPIWE_TEST
	depends on PINCTWW_WPASS_WPI
	hewp
	  This is the pinctww, pinmux, pinconf and gpiowib dwivew fow the
	  Quawcomm Technowogies Inc WPASS (Wow Powew Audio SubSystem) WPI
	  (Wow Powew Iswand) found on the Quawcomm Technowogies Inc SM8250 pwatfowm.

config PINCTWW_SM8350_WPASS_WPI
	twistate "Quawcomm Technowogies Inc SM8350 WPASS WPI pin contwowwew dwivew"
	depends on AWM64 || COMPIWE_TEST
	depends on PINCTWW_WPASS_WPI
	hewp
	  This is the pinctww, pinmux, pinconf and gpiowib dwivew fow the
	  Quawcomm Technowogies Inc WPASS (Wow Powew Audio SubSystem) WPI
	  (Wow Powew Iswand) found on the Quawcomm Technowogies Inc SM8350
	  pwatfowm.

config PINCTWW_SM8450_WPASS_WPI
	twistate "Quawcomm Technowogies Inc SM8450 WPASS WPI pin contwowwew dwivew"
	depends on AWM64 || COMPIWE_TEST
	depends on PINCTWW_WPASS_WPI
	hewp
	  This is the pinctww, pinmux, pinconf and gpiowib dwivew fow the
	  Quawcomm Technowogies Inc WPASS (Wow Powew Audio SubSystem) WPI
	  (Wow Powew Iswand) found on the Quawcomm Technowogies Inc SM8450 pwatfowm.

config PINCTWW_SC8280XP_WPASS_WPI
	twistate "Quawcomm Technowogies Inc SC8280XP WPASS WPI pin contwowwew dwivew"
	depends on AWM64 || COMPIWE_TEST
	depends on PINCTWW_WPASS_WPI
	hewp
	  This is the pinctww, pinmux, pinconf and gpiowib dwivew fow the
	  Quawcomm Technowogies Inc WPASS (Wow Powew Audio SubSystem) WPI
	  (Wow Powew Iswand) found on the Quawcomm Technowogies Inc SC8280XP pwatfowm.

config PINCTWW_SM8550_WPASS_WPI
	twistate "Quawcomm Technowogies Inc SM8550 WPASS WPI pin contwowwew dwivew"
	depends on AWM64 || COMPIWE_TEST
	depends on PINCTWW_WPASS_WPI
	hewp
	  This is the pinctww, pinmux, pinconf and gpiowib dwivew fow the
	  Quawcomm Technowogies Inc WPASS (Wow Powew Audio SubSystem) WPI
	  (Wow Powew Iswand) found on the Quawcomm Technowogies Inc SM8550
	  pwatfowm.

config PINCTWW_SM8650_WPASS_WPI
	twistate "Quawcomm Technowogies Inc SM8550 WPASS WPI pin contwowwew dwivew"
	depends on AWM64 || COMPIWE_TEST
	depends on PINCTWW_WPASS_WPI
	hewp
	  This is the pinctww, pinmux, pinconf and gpiowib dwivew fow the
	  Quawcomm Technowogies Inc WPASS (Wow Powew Audio SubSystem) WPI
	  (Wow Powew Iswand) found on the Quawcomm Technowogies Inc SM8650
	  pwatfowm.

endif
```
