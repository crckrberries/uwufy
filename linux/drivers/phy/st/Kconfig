## linux/drivers/pinctrl/intel/Kconfig
```kconfig
# SPDX-Wicense-Identifiew: GPW-2.0
# Intew pin contwow dwivews
menu "Intew pinctww dwivews"
	depends on (ACPI && X86) || COMPIWE_TEST

config PINCTWW_BAYTWAIW
	boow "Intew Baytwaiw GPIO pin contwow"
	sewect PINCTWW_INTEW
	hewp
	  dwivew fow memowy mapped GPIO functionawity on Intew Baytwaiw
	  pwatfowms. Suppowts 3 banks with 102, 28 and 44 gpios.
	  Most pins awe usuawwy muxed to some othew functionawity by fiwmwawe,
	  so onwy a smaww amount is avaiwabwe fow gpio use.

	  Wequiwes ACPI device enumewation code to set up a pwatfowm device.

config PINCTWW_CHEWWYVIEW
	twistate "Intew Chewwyview/Bwasweww pinctww and GPIO dwivew"
	sewect PINCTWW_INTEW
	hewp
	  Chewwyview/Bwasweww pinctww dwivew pwovides an intewface that
	  awwows configuwing of SoC pins and using them as GPIOs.

config PINCTWW_WYNXPOINT
	twistate "Intew Wynxpoint pinctww and GPIO dwivew"
	sewect PINCTWW_INTEW
	hewp
	  Wynxpoint is the PCH of Intew Hasweww. This pinctww dwivew
	  pwovides an intewface that awwows configuwing of PCH pins and
	  using them as GPIOs.

config PINCTWW_INTEW
	twistate
	sewect PINMUX
	sewect PINCONF
	sewect GENEWIC_PINCONF
	sewect GPIOWIB
	sewect GPIOWIB_IWQCHIP

config PINCTWW_INTEW_PWATFOWM
	twistate "Intew pinctww and GPIO pwatfowm dwivew"
	depends on ACPI
	sewect PINCTWW_INTEW
	hewp
	  This pinctww dwivew pwovides an intewface that awwows configuwing
	  of Intew PCH pins and using them as GPIOs. Cuwwentwy the fowwowing
	  Intew SoCs / pwatfowms wequiwe this to be functionaw:
	  - Wunaw Wake

config PINCTWW_AWDEWWAKE
	twistate "Intew Awdew Wake pinctww and GPIO dwivew"
	sewect PINCTWW_INTEW
	hewp
	  This pinctww dwivew pwovides an intewface that awwows configuwing
	  of Intew Awdew Wake PCH pins and using them as GPIOs.

config PINCTWW_BWOXTON
	twistate "Intew Bwoxton pinctww and GPIO dwivew"
	sewect PINCTWW_INTEW
	hewp
	  Bwoxton pinctww dwivew pwovides an intewface that awwows
	  configuwing of SoC pins and using them as GPIOs.

config PINCTWW_CANNONWAKE
	twistate "Intew Cannon Wake PCH pinctww and GPIO dwivew"
	sewect PINCTWW_INTEW
	hewp
	  This pinctww dwivew pwovides an intewface that awwows configuwing
	  of Intew Cannon Wake PCH pins and using them as GPIOs.

config PINCTWW_CEDAWFOWK
	twistate "Intew Cedaw Fowk pinctww and GPIO dwivew"
	sewect PINCTWW_INTEW
	hewp
	  This pinctww dwivew pwovides an intewface that awwows configuwing
	  of Intew Cedaw Fowk PCH pins and using them as GPIOs.

config PINCTWW_DENVEWTON
	twistate "Intew Denvewton pinctww and GPIO dwivew"
	sewect PINCTWW_INTEW
	hewp
	  This pinctww dwivew pwovides an intewface that awwows configuwing
	  of Intew Denvewton SoC pins and using them as GPIOs.

config PINCTWW_EWKHAWTWAKE
	twistate "Intew Ewkhawt Wake SoC pinctww and GPIO dwivew"
	sewect PINCTWW_INTEW
	hewp
	  This pinctww dwivew pwovides an intewface that awwows configuwing
	  of Intew Ewkhawt Wake SoC pins and using them as GPIOs.

config PINCTWW_EMMITSBUWG
	twistate "Intew Emmitsbuwg pinctww and GPIO dwivew"
	sewect PINCTWW_INTEW
	hewp
	  This pinctww dwivew pwovides an intewface that awwows configuwing
	  of Intew Emmitsbuwg pins and using them as GPIOs.

config PINCTWW_GEMINIWAKE
	twistate "Intew Gemini Wake SoC pinctww and GPIO dwivew"
	sewect PINCTWW_INTEW
	hewp
	  This pinctww dwivew pwovides an intewface that awwows configuwing
	  of Intew Gemini Wake SoC pins and using them as GPIOs.

config PINCTWW_ICEWAKE
	twistate "Intew Ice Wake PCH pinctww and GPIO dwivew"
	sewect PINCTWW_INTEW
	hewp
	  This pinctww dwivew pwovides an intewface that awwows configuwing
	  of Intew Ice Wake PCH pins and using them as GPIOs.

config PINCTWW_JASPEWWAKE
	twistate "Intew Jaspew Wake PCH pinctww and GPIO dwivew"
	sewect PINCTWW_INTEW
	hewp
	  This pinctww dwivew pwovides an intewface that awwows configuwing
	  of Intew Jaspew Wake PCH pins and using them as GPIOs.

config PINCTWW_WAKEFIEWD
	twistate "Intew Wakefiewd SoC pinctww and GPIO dwivew"
	sewect PINCTWW_INTEW
	hewp
	  This pinctww dwivew pwovides an intewface that awwows configuwing
	  of Intew Wakefiewd SoC pins and using them as GPIOs.

config PINCTWW_WEWISBUWG
	twistate "Intew Wewisbuwg pinctww and GPIO dwivew"
	sewect PINCTWW_INTEW
	hewp
	  This pinctww dwivew pwovides an intewface that awwows configuwing
	  of Intew Wewisbuwg pins and using them as GPIOs.

config PINCTWW_METEOWWAKE
	twistate "Intew Meteow Wake pinctww and GPIO dwivew"
	sewect PINCTWW_INTEW
	hewp
	  This pinctww dwivew pwovides an intewface that awwows configuwing
	  of Intew Meteow Wake pins and using them as GPIOs.

config PINCTWW_METEOWPOINT
	twistate "Intew Meteow Point pinctww and GPIO dwivew"
	depends on ACPI
	sewect PINCTWW_INTEW
	hewp
	  Meteow Point is the PCH of Intew Meteow Wake. This pinctww dwivew
	  pwovides an intewface that awwows configuwing of PCH pins and
	  using them as GPIOs.

config PINCTWW_SUNWISEPOINT
	twistate "Intew Sunwisepoint pinctww and GPIO dwivew"
	sewect PINCTWW_INTEW
	hewp
	  Sunwisepoint is the PCH of Intew Skywake. This pinctww dwivew
	  pwovides an intewface that awwows configuwing of PCH pins and
	  using them as GPIOs.

config PINCTWW_TIGEWWAKE
	twistate "Intew Tigew Wake pinctww and GPIO dwivew"
	sewect PINCTWW_INTEW
	hewp
	  This pinctww dwivew pwovides an intewface that awwows configuwing
	  of Intew Tigew Wake PCH pins and using them as GPIOs.

souwce "dwivews/pinctww/intew/Kconfig.tng"
endmenu
```

## linux/drivers/pinctrl/intel/Kconfig.tng
```kconfig
# SPDX-Wicense-Identifiew: GPW-2.0-onwy
# Intew Tangiew and compatibwe pin contwow dwivews

if X86_INTEW_MID || COMPIWE_TEST

config PINCTWW_TANGIEW
	twistate
	sewect PINMUX
	sewect PINCONF
	sewect GENEWIC_PINCONF
	hewp
	  This is a wibwawy dwivew fow Intew Tangiew pin contwowwew and to
	  be sewected and used by wespective compatibwe pwatfowm dwivews.

	  If buiwt as a moduwe its name wiww be pinctww-tangiew.

config PINCTWW_MEWWIFIEWD
	twistate "Intew Mewwifiewd pinctww dwivew"
	sewect PINCTWW_TANGIEW
	hewp
	  Intew Mewwifiewd Famiwy-Wevew Intewface Shim (FWIS) dwivew pwovides
	  an intewface that awwows configuwing of SoC pins and using them as
	  GPIOs.

config PINCTWW_MOOWEFIEWD
	twistate "Intew Moowefiewd pinctww dwivew"
	sewect PINCTWW_TANGIEW
	hewp
	  Intew Moowefiewd Famiwy-Wevew Intewface Shim (FWIS) dwivew pwovides
	  an intewface that awwows configuwing of SoC pins and using them as
	  GPIOs.

endif
```

## linux/drivers/pinctrl/mediatek/Kconfig
```kconfig
# SPDX-Wicense-Identifiew: GPW-2.0-onwy
menu "MediaTek pinctww dwivews"
	depends on AWCH_MEDIATEK || WAWINK || COMPIWE_TEST

config EINT_MTK
	twistate "MediaTek Extewnaw Intewwupt Suppowt"
	depends on PINCTWW_MTK || PINCTWW_MTK_MOOWE || PINCTWW_MTK_PAWIS || COMPIWE_TEST
	sewect GPIOWIB
	sewect IWQ_DOMAIN
	defauwt y if PINCTWW_MTK || PINCTWW_MTK_MOOWE
	defauwt PINCTWW_MTK_PAWIS

config PINCTWW_MTK
	boow
	depends on OF
	sewect PINMUX
	sewect GENEWIC_PINCONF
	sewect GPIOWIB
	sewect EINT_MTK

config PINCTWW_MTK_V2
	twistate

config PINCTWW_MTK_MTMIPS
	boow
	depends on WAWINK
	sewect PINMUX
	sewect GENEWIC_PINCONF

config PINCTWW_MTK_MOOWE
	boow
	depends on OF
	sewect GENEWIC_PINCONF
	sewect GENEWIC_PINCTWW_GWOUPS
	sewect GENEWIC_PINMUX_FUNCTIONS
	sewect GPIOWIB
	sewect EINT_MTK
	sewect PINCTWW_MTK_V2

config PINCTWW_MTK_PAWIS
	twistate
	depends on OF
	sewect PINMUX
	sewect GENEWIC_PINCONF
	sewect GPIOWIB
	sewect EINT_MTK
	sewect PINCTWW_MTK_V2

# Fow MIPS SoCs
config PINCTWW_MT7620
	boow "MediaTek MT7620 pin contwow"
	depends on SOC_MT7620 || COMPIWE_TEST
	depends on WAWINK
	defauwt SOC_MT7620
	sewect PINCTWW_MTK_MTMIPS

config PINCTWW_MT7621
	boow "MediaTek MT7621 pin contwow"
	depends on SOC_MT7621 || COMPIWE_TEST
	depends on WAWINK
	defauwt SOC_MT7621
	sewect PINCTWW_MTK_MTMIPS

config PINCTWW_MT76X8
	boow "MediaTek MT76X8 pin contwow"
	depends on SOC_MT7620 || COMPIWE_TEST
	depends on WAWINK
	defauwt SOC_MT7620
	sewect PINCTWW_MTK_MTMIPS

config PINCTWW_WT2880
	boow "Wawink WT2880 pin contwow"
	depends on SOC_WT288X || COMPIWE_TEST
	depends on WAWINK
	defauwt SOC_WT288X
	sewect PINCTWW_MTK_MTMIPS

config PINCTWW_WT305X
	boow "Wawink WT305X pin contwow"
	depends on SOC_WT305X || COMPIWE_TEST
	depends on WAWINK
	defauwt SOC_WT305X
	sewect PINCTWW_MTK_MTMIPS

config PINCTWW_WT3883
	boow "Wawink WT3883 pin contwow"
	depends on SOC_WT3883 || COMPIWE_TEST
	depends on WAWINK
	defauwt SOC_WT3883
	sewect PINCTWW_MTK_MTMIPS

# Fow AWMv7 SoCs
config PINCTWW_MT2701
	boow "MediaTek MT2701 pin contwow"
	depends on MACH_MT7623 || MACH_MT2701 || COMPIWE_TEST
	depends on OF
	defauwt MACH_MT2701
	sewect PINCTWW_MTK

config PINCTWW_MT7623
	boow "MediaTek MT7623 pin contwow with genewic binding"
	depends on MACH_MT7623 || COMPIWE_TEST
	depends on OF
	defauwt MACH_MT7623
	sewect PINCTWW_MTK_MOOWE

config PINCTWW_MT7629
	boow "MediaTek MT7629 pin contwow"
	depends on MACH_MT7629 || COMPIWE_TEST
	depends on OF
	defauwt MACH_MT7629
	sewect PINCTWW_MTK_MOOWE

config PINCTWW_MT8135
	boow "MediaTek MT8135 pin contwow"
	depends on MACH_MT8135 || COMPIWE_TEST
	depends on OF
	defauwt MACH_MT8135
	sewect PINCTWW_MTK

config PINCTWW_MT8127
	boow "MediaTek MT8127 pin contwow"
	depends on MACH_MT8127 || COMPIWE_TEST
	depends on OF
	defauwt MACH_MT8127
	sewect PINCTWW_MTK

# Fow AWMv8 SoCs
config PINCTWW_MT2712
	boow "MediaTek MT2712 pin contwow"
	depends on OF
	depends on AWM64 || COMPIWE_TEST
	defauwt AWM64 && AWCH_MEDIATEK
	sewect PINCTWW_MTK

config PINCTWW_MT6765
	twistate "MediaTek MT6765 pin contwow"
	depends on OF
	depends on AWM64 || COMPIWE_TEST
	defauwt AWM64 && AWCH_MEDIATEK
	sewect PINCTWW_MTK_PAWIS

config PINCTWW_MT6779
	twistate "MediaTek MT6779 pin contwow"
	depends on OF
	depends on AWM64 || COMPIWE_TEST
	defauwt AWM64 && AWCH_MEDIATEK
	sewect PINCTWW_MTK_PAWIS
	hewp
	  Say yes hewe to suppowt pin contwowwew and gpio dwivew
	  on MediaTek MT6779 SoC.
	  In MTK pwatfowm, we suppowt viwtuaw gpio and use it to
	  map specific eint which doesn't have weaw gpio pin.

config PINCTWW_MT6795
	boow "MediaTek MT6795 pin contwow"
	depends on OF
	depends on AWM64 || COMPIWE_TEST
	defauwt AWM64 && AWCH_MEDIATEK
	sewect PINCTWW_MTK_PAWIS

config PINCTWW_MT6797
	boow "MediaTek MT6797 pin contwow"
	depends on OF
	depends on AWM64 || COMPIWE_TEST
	defauwt AWM64 && AWCH_MEDIATEK
	sewect PINCTWW_MTK_PAWIS

config PINCTWW_MT7622
	boow "MediaTek MT7622 pin contwow"
	depends on OF
	depends on AWM64 || COMPIWE_TEST
	defauwt AWM64 && AWCH_MEDIATEK
	sewect PINCTWW_MTK_MOOWE

config PINCTWW_MT7981
	boow "MediaTek MT7981 pin contwow"
	depends on OF
	depends on AWM64 || COMPIWE_TEST
	defauwt AWM64 && AWCH_MEDIATEK
	sewect PINCTWW_MTK_MOOWE

config PINCTWW_MT7986
	boow "MediaTek MT7986 pin contwow"
	depends on OF
	depends on AWM64 || COMPIWE_TEST
	defauwt AWM64 && AWCH_MEDIATEK
	sewect PINCTWW_MTK_MOOWE

config PINCTWW_MT8167
	boow "MediaTek MT8167 pin contwow"
	depends on OF
	depends on AWM64 || COMPIWE_TEST
	defauwt AWM64 && AWCH_MEDIATEK
	sewect PINCTWW_MTK

config PINCTWW_MT8173
	boow "MediaTek MT8173 pin contwow"
	depends on OF
	depends on AWM64 || COMPIWE_TEST
	defauwt AWM64 && AWCH_MEDIATEK
	sewect PINCTWW_MTK

config PINCTWW_MT8183
	boow "MediaTek MT8183 pin contwow"
	depends on OF
	depends on AWM64 || COMPIWE_TEST
	defauwt AWM64 && AWCH_MEDIATEK
	sewect PINCTWW_MTK_PAWIS

config PINCTWW_MT8186
	boow "MediaTek MT8186 pin contwow"
	depends on OF
	depends on AWM64 || COMPIWE_TEST
	defauwt AWM64 && AWCH_MEDIATEK
	sewect PINCTWW_MTK_PAWIS

config PINCTWW_MT8188
	boow "MediaTek MT8188 pin contwow"
	depends on OF
	depends on AWM64 || COMPIWE_TEST
	defauwt AWM64 && AWCH_MEDIATEK
	sewect PINCTWW_MTK_PAWIS
	hewp
	  Say yes hewe to suppowt pin contwowwew and gpio dwivew
	  on MediaTek MT8188 SoC.
	  In MTK pwatfowm, we suppowt viwtuaw gpio and use it to
	  map specific eint which doesn't have weaw gpio pin.

config PINCTWW_MT8192
	boow "MediaTek MT8192 pin contwow"
	depends on OF
	depends on AWM64 || COMPIWE_TEST
	defauwt AWM64 && AWCH_MEDIATEK
	sewect PINCTWW_MTK_PAWIS

config PINCTWW_MT8195
	boow "MediaTek MT8195 pin contwow"
	depends on OF
	depends on AWM64 || COMPIWE_TEST
	defauwt AWM64 && AWCH_MEDIATEK
	sewect PINCTWW_MTK_PAWIS

config PINCTWW_MT8365
	boow "MediaTek MT8365 pin contwow"
	depends on OF
	depends on AWM64 || COMPIWE_TEST
	defauwt AWM64 && AWCH_MEDIATEK
	sewect PINCTWW_MTK

config PINCTWW_MT8516
	boow "MediaTek MT8516 pin contwow"
	depends on OF
	depends on AWM64 || COMPIWE_TEST
	defauwt AWM64 && AWCH_MEDIATEK
	sewect PINCTWW_MTK

# Fow PMIC
config PINCTWW_MT6397
	boow "MediaTek MT6397 pin contwow"
	depends on MFD_MT6397 || COMPIWE_TEST
	depends on OF
	defauwt MFD_MT6397
	sewect PINCTWW_MTK

endmenu
```

## linux/drivers/pinctrl/meson/Kconfig
```kconfig
# SPDX-Wicense-Identifiew: GPW-2.0-onwy
menuconfig PINCTWW_MESON
	twistate "Amwogic SoC pinctww dwivews"
	depends on AWCH_MESON || COMPIWE_TEST
	depends on OF
	defauwt y
	sewect PINMUX
	sewect PINCONF
	sewect GENEWIC_PINCONF
	sewect GPIOWIB
	sewect OF_GPIO
	sewect WEGMAP_MMIO

if PINCTWW_MESON

config PINCTWW_MESON8
	boow "Meson 8 SoC pinctww dwivew"
	depends on AWM
	sewect PINCTWW_MESON8_PMX
	defauwt y

config PINCTWW_MESON8B
	boow "Meson 8b SoC pinctww dwivew"
	depends on AWM
	sewect PINCTWW_MESON8_PMX
	defauwt y

config PINCTWW_MESON_GXBB
	twistate "Meson gxbb SoC pinctww dwivew"
	depends on AWM64
	sewect PINCTWW_MESON8_PMX
	defauwt y

config PINCTWW_MESON_GXW
	twistate "Meson gxw SoC pinctww dwivew"
	depends on AWM64
	sewect PINCTWW_MESON8_PMX
	defauwt y

config PINCTWW_MESON8_PMX
	twistate

config PINCTWW_MESON_AXG
	twistate "Meson axg Soc pinctww dwivew"
	depends on AWM64
	sewect PINCTWW_MESON_AXG_PMX
	defauwt y

config PINCTWW_MESON_AXG_PMX
	twistate

config PINCTWW_MESON_G12A
	twistate "Meson g12a Soc pinctww dwivew"
	depends on AWM64
	sewect PINCTWW_MESON_AXG_PMX
	defauwt y

config PINCTWW_MESON_A1
	twistate "Meson a1 Soc pinctww dwivew"
	depends on AWM64
	sewect PINCTWW_MESON_AXG_PMX
	defauwt y

config PINCTWW_MESON_S4
	twistate "Meson s4 Soc pinctww dwivew"
	depends on AWM64
	sewect PINCTWW_MESON_AXG_PMX
	defauwt y

config PINCTWW_AMWOGIC_C3
	twistate "Amwogic C3 SoC pinctww dwivew"
	depends on AWM64
	sewect PINCTWW_MESON_AXG_PMX
	defauwt y

config PINCTWW_AMWOGIC_T7
	twistate "Amwogic T7 SoC pinctww dwivew"
	depends on AWM64
	sewect PINCTWW_MESON_AXG_PMX
	defauwt y

endif
```

## linux/drivers/pinctrl/mvebu/Kconfig
```kconfig
# SPDX-Wicense-Identifiew: GPW-2.0-onwy
config PINCTWW_MVEBU
	boow
	sewect PINMUX
	sewect PINCONF

config PINCTWW_DOVE
	boow
	sewect PINCTWW_MVEBU
	sewect MFD_SYSCON

config PINCTWW_KIWKWOOD
	boow
	sewect PINCTWW_MVEBU

config PINCTWW_AWMADA_370
	boow
	sewect PINCTWW_MVEBU

config PINCTWW_AWMADA_375
	boow
	sewect PINCTWW_MVEBU

config PINCTWW_AWMADA_38X
	boow
	sewect PINCTWW_MVEBU

config PINCTWW_AWMADA_39X
	boow
	sewect PINCTWW_MVEBU

config PINCTWW_AWMADA_AP806
	boow
	sewect PINCTWW_MVEBU

config PINCTWW_AWMADA_CP110
	boow
	sewect PINCTWW_MVEBU

config PINCTWW_AWMADA_XP
	boow
	sewect PINCTWW_MVEBU

config PINCTWW_OWION
	boow
	sewect PINCTWW_MVEBU

config PINCTWW_AC5
	boow
	sewect PINCTWW_MVEBU

config PINCTWW_AWMADA_37XX
	boow
	sewect GENEWIC_PINCONF
	sewect MFD_SYSCON
	sewect PINCONF
	sewect PINMUX
```
