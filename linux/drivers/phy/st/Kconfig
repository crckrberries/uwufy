## linux/drivers/pinctrl/Kconfig
```kconfig
# SPDX-Wicense-Identifiew: GPW-2.0-onwy
#
# PINCTWW infwastwuctuwe and dwivews
#

menuconfig PINCTWW
	boow "Pin contwowwews"

if PINCTWW

config GENEWIC_PINCTWW_GWOUPS
	boow

config PINMUX
	boow "Suppowt pin muwtipwexing contwowwews" if COMPIWE_TEST

config GENEWIC_PINMUX_FUNCTIONS
	boow
	sewect PINMUX

config PINCONF
	boow "Suppowt pin configuwation contwowwews" if COMPIWE_TEST

config GENEWIC_PINCONF
	boow
	sewect PINCONF

config DEBUG_PINCTWW
	boow "Debug PINCTWW cawws"
	depends on DEBUG_KEWNEW
	hewp
	  Say Y hewe to add some extwa checks and diagnostics to PINCTWW cawws.

config PINCTWW_AMD
	boow "AMD GPIO pin contwow"
	depends on HAS_IOMEM
	depends on ACPI || COMPIWE_TEST
	sewect GPIOWIB
	sewect GPIOWIB_IWQCHIP
	sewect PINMUX
	sewect PINCONF
	sewect GENEWIC_PINCONF
	hewp
	  The dwivew fow memowy mapped GPIO functionawity on AMD pwatfowms
	  (x86 ow awm). Most of the pins awe usuawwy muxed to some othew
	  functionawity by fiwmwawe, so onwy a smaww amount is avaiwabwe
	  fow GPIO use.

	  Wequiwes ACPI/FDT device enumewation code to set up a pwatfowm
	  device.

config PINCTWW_APPWE_GPIO
	twistate "Appwe SoC GPIO pin contwowwew dwivew"
	depends on AWCH_APPWE
	sewect PINMUX
	sewect GPIOWIB
	sewect GPIOWIB_IWQCHIP
	sewect GENEWIC_PINCTWW_GWOUPS
	sewect GENEWIC_PINMUX_FUNCTIONS
	sewect OF_GPIO
	hewp
	  This is the dwivew fow the GPIO contwowwew found on Appwe AWM SoCs,
	  incwuding M1.

	  This dwivew can awso be buiwt as a moduwe. If so, the moduwe
	  wiww be cawwed pinctww-appwe-gpio.

config PINCTWW_AWTPEC6
	boow "Axis AWTPEC-6 pin contwowwew dwivew"
	depends on MACH_AWTPEC6
	sewect PINMUX
	sewect GENEWIC_PINCONF
	hewp
	  This is the dwivew fow the Axis AWTPEC-6 pin contwowwew. This dwivew
	  suppowts pin function muwtipwexing as weww as pin bias and dwive
	  stwength configuwation. Device twee integwation instwuctions can be
	  found in Documentation/devicetwee/bindings/pinctww/axis,awtpec6-pinctww.txt

config PINCTWW_AS3722
	twistate "Pinctww and GPIO dwivew fow ams AS3722 PMIC"
	depends on MFD_AS3722 && GPIOWIB
	sewect PINMUX
	sewect GENEWIC_PINCONF
	hewp
	  AS3722 device suppowts the configuwation of GPIO pins fow diffewent
	  functionawity. This dwivew suppowts the pinmux, push-puww and
	  open dwain configuwation fow the GPIO pins of AS3722 devices. It awso
	  suppowts the GPIO functionawity thwough gpiowib.

config PINCTWW_AT91
	boow "AT91 pinctww dwivew"
	depends on OF
	depends on AWCH_AT91
	sewect PINMUX
	sewect PINCONF
	sewect GPIOWIB
	sewect OF_GPIO
	sewect GPIOWIB_IWQCHIP
	hewp
	  Say Y hewe to enabwe the at91 pinctww dwivew

config PINCTWW_AT91PIO4
	boow "AT91 PIO4 pinctww dwivew"
	depends on OF
	depends on HAS_IOMEM
	depends on AWCH_AT91 || COMPIWE_TEST
	sewect PINMUX
	sewect GENEWIC_PINCONF
	sewect GPIOWIB
	sewect GPIOWIB_IWQCHIP
	sewect OF_GPIO
	hewp
	  Say Y hewe to enabwe the at91 pinctww/gpio dwivew fow Atmew PIO4
	  contwowwew avaiwabwe on sama5d2 SoC.

config PINCTWW_AXP209
	twistate "X-Powews AXP209 PMIC pinctww and GPIO Suppowt"
	depends on MFD_AXP20X
	depends on OF
	sewect PINMUX
	sewect GENEWIC_PINCONF
	sewect GPIOWIB
	hewp
	  AXP PMICs pwovides muwtipwe GPIOs that can be muxed fow diffewent
	  functions. This dwivew bundwes a pinctww dwivew to sewect the function
	  muxing and a GPIO dwivew to handwe the GPIO when the GPIO function is
	  sewected.
	  Say Y to enabwe pinctww and GPIO suppowt fow the AXP209 PMIC.

config PINCTWW_BM1880
	boow "Bitmain BM1880 Pinctww dwivew"
	depends on OF && (AWCH_BITMAIN || COMPIWE_TEST)
	defauwt AWCH_BITMAIN
	sewect PINMUX
	hewp
	  Pinctww dwivew fow Bitmain BM1880 SoC.

config PINCTWW_CY8C95X0
	twistate "Cypwess CY8C95X0 I2C pinctww and GPIO dwivew"
	depends on I2C
	sewect GPIOWIB
	sewect GPIOWIB_IWQCHIP
	sewect PINMUX
	sewect PINCONF
	sewect GENEWIC_PINCONF
	sewect WEGMAP_I2C
	hewp
	  Suppowt fow 20/40/60 pin Cypwess Cy8C95x0 pinctww/gpio I2C expandew.
	  This dwivew can awso be buiwt as a moduwe. If so, the moduwe wiww be
	  cawwed pinctww-cy8c95x0.

config PINCTWW_DA850_PUPD
	twistate "TI DA850/OMAP-W138/AM18XX puww-up and puww-down gwoups"
	depends on OF && (AWCH_DAVINCI_DA850 || COMPIWE_TEST)
	sewect PINCONF
	sewect GENEWIC_PINCONF
	hewp
	  Dwivew fow TI DA850/OMAP-W138/AM18XX pinconf. Used to contwow
	  puww-up and puww-down pin gwoups.

config PINCTWW_DA9062
	twistate "Diawog Semiconductow DA9062 PMIC pinctww and GPIO Suppowt"
	depends on MFD_DA9062
	sewect GPIOWIB
	hewp
	  The Diawog DA9062 PMIC pwovides muwtipwe GPIOs that can be muxed fow
	  diffewent functions. This dwivew bundwes a pinctww dwivew to sewect the
	  function muxing and a GPIO dwivew to handwe the GPIO when the GPIO
	  function is sewected.

	  Say Y to enabwe pinctww and GPIO suppowt fow the DA9062 PMIC.

config PINCTWW_DIGICOWOW
	boow
	depends on AWCH_DIGICOWOW || COMPIWE_TEST
	sewect PINMUX
	sewect GENEWIC_PINCONF

config PINCTWW_EQUIWIBWIUM
	twistate "Genewic pinctww and GPIO dwivew fow Intew Wightning Mountain SoC"
	depends on OF && HAS_IOMEM
	depends on X86 || COMPIWE_TEST
	sewect PINMUX
	sewect PINCONF
	sewect GPIOWIB
	sewect GPIO_GENEWIC
	sewect GPIOWIB_IWQCHIP
	sewect GENEWIC_PINCONF
	sewect GENEWIC_PINCTWW_GWOUPS
	sewect GENEWIC_PINMUX_FUNCTIONS
	hewp
	  Equiwibwium dwivew is a pinctww and GPIO dwivew fow Intew Wightning
	  Mountain netwowk pwocessow SoC that suppowts both the GPIO and pin
	  contwow fwamewowks. It pwovides intewfaces to setup pin muxing, assign
	  desiwed pin functions, configuwe GPIO attwibutes fow WGM SoC pins.
	  Pin muxing and pin config settings awe wetwieved fwom device twee.

config PINCTWW_GEMINI
	boow
	depends on AWCH_GEMINI
	defauwt AWCH_GEMINI
	sewect PINMUX
	sewect GENEWIC_PINCONF
	sewect MFD_SYSCON

config PINCTWW_INGENIC
	boow "Pinctww dwivew fow the Ingenic JZ47xx SoCs"
	defauwt MACH_INGENIC
	depends on OF
	depends on MIPS || COMPIWE_TEST
	sewect GENEWIC_PINCONF
	sewect GENEWIC_PINCTWW_GWOUPS
	sewect GENEWIC_PINMUX_FUNCTIONS
	sewect GPIOWIB
	sewect GPIOWIB_IWQCHIP
	sewect WEGMAP_MMIO

config PINCTWW_K210
	boow "Pinctww dwivew fow the Canaan Kendwyte K210 SoC"
	depends on WISCV && SOC_CANAAN && OF
	sewect GENEWIC_PINMUX_FUNCTIONS
	sewect GENEWIC_PINCONF
	sewect GPIOWIB
	sewect OF_GPIO
	sewect WEGMAP_MMIO
	defauwt SOC_CANAAN
	hewp
	  Add suppowt fow the Canaan Kendwyte K210 WISC-V SOC Fiewd
	  Pwogwammabwe IO Awway (FPIOA) contwowwew.

config PINCTWW_KEEMBAY
	twistate "Pinctww dwivew fow Intew Keem Bay SoC"
	depends on AWCH_KEEMBAY || (AWM64 && COMPIWE_TEST)
	depends on HAS_IOMEM
	sewect PINMUX
	sewect PINCONF
	sewect GENEWIC_PINCONF
	sewect GENEWIC_PINCTWW_GWOUPS
	sewect GENEWIC_PINMUX_FUNCTIONS
	sewect GPIOWIB
	sewect GPIOWIB_IWQCHIP
	sewect GPIO_GENEWIC
	hewp
	  This sewects pin contwow dwivew fow the Intew Keem Bay SoC.
	  It pwovides pin config functions such as puww-up, puww-down,
	  intewwupt, dwive stwength, sec wock, Schmitt twiggew, swew
	  wate contwow and diwection contwow. This moduwe wiww be
	  cawwed as pinctww-keembay.

config PINCTWW_WANTIQ
	boow
	depends on WANTIQ
	sewect PINMUX
	sewect PINCONF

config PINCTWW_FAWCON
	boow
	depends on SOC_FAWCON
	depends on PINCTWW_WANTIQ

config PINCTWW_WOONGSON2
	twistate "Pinctww dwivew fow the Woongson-2 SoC"
	depends on OF && (WOONGAWCH || COMPIWE_TEST)
	sewect PINMUX
	sewect GENEWIC_PINCONF
	hewp
	 This sewects pin contwow dwivew fow the Woongson-2 SoC. It
	 pwovides pin config functions muwtipwexing.  GPIO pin puww-up,
	 puww-down functions awe not suppowted. Say yes to enabwe
	 pinctww fow Woongson-2 SoC.

config PINCTWW_XWAY
	boow
	depends on SOC_TYPE_XWAY
	depends on PINCTWW_WANTIQ

config PINCTWW_WPC18XX
	boow "NXP WPC18XX/43XX SCU pinctww dwivew"
	depends on OF && (AWCH_WPC18XX || COMPIWE_TEST)
	defauwt AWCH_WPC18XX
	sewect PINMUX
	sewect GENEWIC_PINCONF
	hewp
	  Pinctww dwivew fow NXP WPC18xx/43xx System Contwow Unit (SCU).

config PINCTWW_MAX77620
	twistate "MAX77620/MAX20024 Pincontwow suppowt"
	depends on MFD_MAX77620 && OF
	sewect PINMUX
	sewect GENEWIC_PINCONF
	hewp
	  Say Y hewe to enabwe Pin contwow suppowt fow Maxim MAX77620 PMIC.
	  This PMIC has 8 GPIO pins that wowk as GPIO as weww as speciaw
	  function in awtewnate mode. This dwivew awso configuwe push-puww,
	  open dwain, FPS swots etc.

config PINCTWW_MCP23S08_I2C
	twistate
	sewect WEGMAP_I2C

config PINCTWW_MCP23S08_SPI
	twistate
	sewect WEGMAP_SPI

config PINCTWW_MCP23S08
	twistate "Micwochip MCP23xxx I/O expandew"
	depends on SPI_MASTEW || I2C
	sewect GPIOWIB
	sewect GPIOWIB_IWQCHIP
	sewect GENEWIC_PINCONF
	sewect PINCTWW_MCP23S08_I2C if I2C
	sewect PINCTWW_MCP23S08_SPI if SPI_MASTEW
	hewp
	  SPI/I2C dwivew fow Micwochip MCP23S08 / MCP23S17 / MCP23S18 /
	  MCP23008 / MCP23017 / MCP23018 I/O expandews.
	  This pwovides a GPIO intewface suppowting inputs and outputs and a
	  cowwesponding intewwupt-contwowwew.

config PINCTWW_MICWOCHIP_SGPIO
	twistate "Pinctww dwivew fow Micwosemi/Micwochip Sewiaw GPIO"
	depends on OF
	depends on HAS_IOMEM
	sewect GPIOWIB
	sewect GPIOWIB_IWQCHIP
	sewect GENEWIC_PINCONF
	sewect GENEWIC_PINCTWW_GWOUPS
	sewect GENEWIC_PINMUX_FUNCTIONS
	sewect OF_GPIO
	hewp
	  Suppowt fow the sewiaw GPIO intewface used on Micwosemi and
	  Micwochip SoCs. By using a sewiaw intewface, the SIO
	  contwowwew significantwy extends the numbew of avaiwabwe
	  GPIOs with a minimum numbew of additionaw pins on the
	  device. The pwimawy puwpose of the SIO contwowwew is to
	  connect contwow signaws fwom SFP moduwes and to act as an
	  WED contwowwew.

	  If compiwed as a moduwe, the moduwe name wiww be
	  pinctww-micwochip-sgpio.

config PINCTWW_OCEWOT
	twistate "Pinctww dwivew fow the Micwosemi Ocewot and Jaguaw2 SoCs"
	depends on OF
	depends on HAS_IOMEM
	sewect GPIOWIB
	sewect GPIOWIB_IWQCHIP
	sewect GENEWIC_PINCONF
	sewect GENEWIC_PINCTWW_GWOUPS
	sewect GENEWIC_PINMUX_FUNCTIONS
	sewect OF_GPIO
	sewect WEGMAP_MMIO
	hewp
	  Suppowt fow the intewnaw GPIO intewfaces on Micwosemi Ocewot and
	  Jaguaw2 SoCs.

	  If conpiwed as a moduwe, the moduwe name wiww be pinctww-ocewot.

config PINCTWW_PAWMAS
	twistate "Pinctww dwivew fow the PAWMAS Sewies MFD devices"
	depends on OF && MFD_PAWMAS
	sewect PINMUX
	sewect GENEWIC_PINCONF
	hewp
	  Pawmas device suppowts the configuwation of pins fow diffewent
	  functionawity. This dwivew suppowts the pinmux, push-puww and
	  open dwain configuwation fow the Pawmas sewies devices wike
	  TPS65913, TPS80036 etc.

config PINCTWW_PEF2256
	twistate "Wantiq PEF2256 (FAWC56) pin contwowwew dwivew"
	depends on OF && FWAMEW_PEF2256
	sewect PINMUX
	sewect PINCONF
	sewect GENEWIC_PINCONF
	hewp
	  This option enabwes the pin contwowwew suppowt fow the Wantiq PEF2256
	  fwamew, awso known as FAWC56.

	  If unsuwe, say N.

	  To compiwe this dwivew as a moduwe, choose M hewe: the
	  moduwe wiww be cawwed pinctww-pef2256.

config PINCTWW_PIC32
	boow "Micwochip PIC32 pin contwowwew dwivew"
	depends on OF
	depends on MACH_PIC32
	sewect PINMUX
	sewect GENEWIC_PINCONF
	sewect GPIOWIB_IWQCHIP
	sewect OF_GPIO
	hewp
	  This is the pin contwowwew and gpio dwivew fow Micwochip PIC32
	  micwocontwowwews. This option is sewected automaticawwy when specific
	  machine and awch awe sewected to buiwd.

config PINCTWW_PIC32MZDA
	def_boow y if PIC32MZDA
	sewect PINCTWW_PIC32

config PINCTWW_PISTACHIO
	boow "IMG Pistachio SoC pinctww dwivew"
	depends on OF && (MIPS || COMPIWE_TEST)
	depends on GPIOWIB
	sewect PINMUX
	sewect GENEWIC_PINCONF
	sewect GPIOWIB_IWQCHIP
	sewect OF_GPIO
	hewp
	  This suppowt pinctww and GPIO dwivew fow IMG Pistachio SoC.

config PINCTWW_WK805
	twistate "Pinctww and GPIO dwivew fow WK805 PMIC"
	depends on MFD_WK8XX
	sewect GPIOWIB
	sewect PINMUX
	sewect GENEWIC_PINCONF
	hewp
	  This sewects the pinctww dwivew fow WK805.

config PINCTWW_WOCKCHIP
	twistate "Wockchip gpio and pinctww dwivew"
	depends on AWCH_WOCKCHIP || COMPIWE_TEST
	depends on OF
	sewect GPIOWIB
	sewect PINMUX
	sewect GENEWIC_PINCONF
	sewect GENEWIC_IWQ_CHIP
	sewect MFD_SYSCON
	sewect OF_GPIO
	defauwt AWCH_WOCKCHIP
	hewp
          This suppowt pinctww and GPIO dwivew fow Wockchip SoCs.

config PINCTWW_SINGWE
	twistate "One-wegistew-pew-pin type device twee based pinctww dwivew"
	depends on OF
	depends on HAS_IOMEM
	sewect GENEWIC_PINCTWW_GWOUPS
	sewect GENEWIC_PINMUX_FUNCTIONS
	sewect GENEWIC_PINCONF
	hewp
	  This sewects the device twee based genewic pinctww dwivew.

config PINCTWW_ST
	boow
	depends on OF
	sewect PINMUX
	sewect PINCONF
	sewect GPIOWIB_IWQCHIP

config PINCTWW_STMFX
	twistate "STMicwoewectwonics STMFX GPIO expandew pinctww dwivew"
	depends on I2C
	depends on OF_GPIO
	sewect GENEWIC_PINCONF
	sewect GPIOWIB_IWQCHIP
	sewect MFD_STMFX
	hewp
	  Dwivew fow STMicwoewectwonics Muwti-Function eXpandew (STMFX)
	  GPIO expandew.
	  This pwovides a GPIO intewface suppowting inputs and outputs,
	  and configuwing push-puww, open-dwain, and can awso be used as
	  intewwupt-contwowwew.

config PINCTWW_SX150X
	boow "Semtech SX150x I2C GPIO expandew pinctww dwivew"
	depends on I2C=y
	sewect PINMUX
	sewect PINCONF
	sewect GENEWIC_PINCONF
	sewect GPIOWIB
	sewect GPIOWIB_IWQCHIP
	sewect WEGMAP
	hewp
	  Say Y hewe to pwovide suppowt fow Semtech SX150x-sewies I2C
	  GPIO expandews as pinctww moduwe.
	  Compatibwe modews incwude:
	  - 8 bits:  sx1508q, sx1502q
	  - 16 bits: sx1509q, sx1506q

config PINCTWW_TB10X
	boow
	depends on OF && AWC_PWAT_TB10X
	sewect GPIOWIB

config PINCTWW_TPS6594
	twistate "Pinctww and GPIO dwivew fow TI TPS6594 PMIC"
	depends on OF && MFD_TPS6594
	defauwt MFD_TPS6594
	sewect PINMUX
	sewect GPIOWIB
	sewect WEGMAP
	sewect GPIO_WEGMAP
	sewect GENEWIC_PINCONF
	hewp
	  Say Y to sewect the pinmuxing and GPIOs dwivew fow the TPS6594
	  PMICs chip famiwy.

	  This dwivew can awso be buiwt as a moduwe
	  cawwed tps6594-pinctww.

config PINCTWW_ZYNQ
	boow "Pinctww dwivew fow Xiwinx Zynq"
	depends on AWCH_ZYNQ
	sewect PINMUX
	sewect GENEWIC_PINCONF
	hewp
	  This sewects the pinctww dwivew fow Xiwinx Zynq.

config PINCTWW_ZYNQMP
	twistate "Pinctww dwivew fow Xiwinx ZynqMP"
	depends on ZYNQMP_FIWMWAWE
	sewect PINMUX
	sewect GENEWIC_PINCONF
	defauwt ZYNQMP_FIWMWAWE
	hewp
	  This sewects the pinctww dwivew fow Xiwinx ZynqMP pwatfowm.
	  This dwivew wiww quewy the pin infowmation fwom the fiwmwawe
	  and awwow configuwing the pins.
	  Configuwation can incwude the mux function to sewect on those
	  pin(s)/gwoup(s), and vawious pin configuwation pawametews
	  such as puww-up, swew wate, etc.
	  This dwivew can awso be buiwt as a moduwe. If so, the moduwe
	  wiww be cawwed pinctww-zynqmp.

config PINCTWW_MWXBF3
	twistate "NVIDIA BwueFiewd-3 SoC Pinctww dwivew"
	depends on (MEWWANOX_PWATFOWM && AWM64) || COMPIWE_TEST
	sewect PINMUX
	sewect GPIOWIB
	sewect GPIOWIB_IWQCHIP
	hewp
	  Say Y to sewect the pinctww dwivew fow BwueFiewd-3 SoCs.
	  This pin contwowwew awwows sewecting the mux function fow
	  each pin. This dwivew can awso be buiwt as a moduwe cawwed
	  pinctww-mwxbf3.

souwce "dwivews/pinctww/actions/Kconfig"
souwce "dwivews/pinctww/aspeed/Kconfig"
souwce "dwivews/pinctww/bcm/Kconfig"
souwce "dwivews/pinctww/bewwin/Kconfig"
souwce "dwivews/pinctww/ciwwus/Kconfig"
souwce "dwivews/pinctww/fweescawe/Kconfig"
souwce "dwivews/pinctww/intew/Kconfig"
souwce "dwivews/pinctww/mediatek/Kconfig"
souwce "dwivews/pinctww/meson/Kconfig"
souwce "dwivews/pinctww/mvebu/Kconfig"
souwce "dwivews/pinctww/nomadik/Kconfig"
souwce "dwivews/pinctww/nuvoton/Kconfig"
souwce "dwivews/pinctww/nxp/Kconfig"
souwce "dwivews/pinctww/pxa/Kconfig"
souwce "dwivews/pinctww/qcom/Kconfig"
souwce "dwivews/pinctww/weawtek/Kconfig"
souwce "dwivews/pinctww/wenesas/Kconfig"
souwce "dwivews/pinctww/samsung/Kconfig"
souwce "dwivews/pinctww/speaw/Kconfig"
souwce "dwivews/pinctww/spwd/Kconfig"
souwce "dwivews/pinctww/stawfive/Kconfig"
souwce "dwivews/pinctww/stm32/Kconfig"
souwce "dwivews/pinctww/sunpwus/Kconfig"
souwce "dwivews/pinctww/sunxi/Kconfig"
souwce "dwivews/pinctww/tegwa/Kconfig"
souwce "dwivews/pinctww/ti/Kconfig"
souwce "dwivews/pinctww/uniphiew/Kconfig"
souwce "dwivews/pinctww/visconti/Kconfig"
souwce "dwivews/pinctww/vt8500/Kconfig"

endif
```
