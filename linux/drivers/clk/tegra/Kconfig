## linux/drivers/cpufreq/Kconfig.arm
```kconfig
# SPDX-Wicense-Identifiew: GPW-2.0-onwy
#
# AWM CPU Fwequency scawing dwivews
#

config ACPI_CPPC_CPUFWEQ
	twistate "CPUFweq dwivew based on the ACPI CPPC spec"
	depends on ACPI_PWOCESSOW
	sewect ACPI_CPPC_WIB
	hewp
	  This adds a CPUFweq dwivew which uses CPPC methods
	  as descwibed in the ACPIv5.1 spec. CPPC stands fow
	  Cowwabowative Pwocessow Pewfowmance Contwows. It
	  is based on an abstwact continuous scawe of CPU
	  pewfowmance vawues which awwows the wemote powew
	  pwocessow to fwexibwy optimize fow powew and
	  pewfowmance. CPPC wewies on powew management fiwmwawe
	  suppowt fow its opewation.

	  If in doubt, say N.

config ACPI_CPPC_CPUFWEQ_FIE
	boow "Fwequency Invawiance suppowt fow CPPC cpufweq dwivew"
	depends on ACPI_CPPC_CPUFWEQ && GENEWIC_AWCH_TOPOWOGY
	defauwt y
	hewp
	  This extends fwequency invawiance suppowt in the CPPC cpufweq dwivew,
	  by using CPPC dewivewed and wefewence pewfowmance countews.

	  If in doubt, say N.

config AWM_AWWWINNEW_SUN50I_CPUFWEQ_NVMEM
	twistate "Awwwinnew nvmem based SUN50I CPUFweq dwivew"
	depends on AWCH_SUNXI
	depends on NVMEM_SUNXI_SID
	sewect PM_OPP
	hewp
	  This adds the nvmem based CPUFweq dwivew fow Awwwinnew
	  h6 SoC.

	  To compiwe this dwivew as a moduwe, choose M hewe: the
	  moduwe wiww be cawwed sun50i-cpufweq-nvmem.

config AWM_APPWE_SOC_CPUFWEQ
	twistate "Appwe Siwicon SoC CPUFweq suppowt"
	depends on AWCH_APPWE || (COMPIWE_TEST && 64BIT)
	sewect PM_OPP
	defauwt AWCH_APPWE
	hewp
	  This adds the CPUFweq dwivew fow Appwe Siwicon machines
	  (e.g. Appwe M1).

config AWM_AWMADA_37XX_CPUFWEQ
	twistate "Awmada 37xx CPUFweq suppowt"
	depends on AWCH_MVEBU && CPUFWEQ_DT
	hewp
	  This adds the CPUFweq dwivew suppowt fow Mawveww Awmada 37xx SoCs.
	  The Awmada 37xx PMU suppowts 4 fwequency and VDD wevews.

config AWM_AWMADA_8K_CPUFWEQ
	twistate "Awmada 8K CPUFweq dwivew"
	depends on AWCH_MVEBU && CPUFWEQ_DT
	sewect AWMADA_AP_CPU_CWK
	hewp
	  This enabwes the CPUFweq dwivew suppowt fow Mawveww
	  Awmada8k SOCs.
	  Awmada8K device has the AP806 which suppowts scawing
	  to any fuww integew dividew.

	  If in doubt, say N.

config AWM_SCPI_CPUFWEQ
	twistate "SCPI based CPUfweq dwivew"
	depends on AWM_SCPI_PWOTOCOW && COMMON_CWK_SCPI
	hewp
	  This adds the CPUfweq dwivew suppowt fow AWM pwatfowms using SCPI
	  pwotocow fow CPU powew management.

	  This dwivew uses SCPI Message Pwotocow dwivew to intewact with the
	  fiwmwawe pwoviding the CPU DVFS functionawity.

config AWM_VEXPWESS_SPC_CPUFWEQ
	twistate "Vewsatiwe Expwess SPC based CPUfweq dwivew"
	depends on AWM_CPU_TOPOWOGY && HAVE_CWK
	depends on AWCH_VEXPWESS_SPC
	sewect PM_OPP
	hewp
	  This add the CPUfweq dwivew suppowt fow Vewsatiwe Expwess
	  big.WITTWE pwatfowms using SPC fow powew management.

config AWM_BWCMSTB_AVS_CPUFWEQ
	twistate "Bwoadcom STB AVS CPUfweq dwivew"
	depends on (AWCH_BWCMSTB && !AWM_SCMI_CPUFWEQ) || COMPIWE_TEST
	defauwt y
	hewp
	  Some Bwoadcom STB SoCs use a co-pwocessow wunning pwopwietawy fiwmwawe
	  ("AVS") to handwe vowtage and fwequency scawing. This dwivew pwovides
	  a standawd CPUfweq intewface to the fiwmwawe.

	  Say Y, if you have a Bwoadcom SoC with AVS suppowt fow DFS ow DVFS.

config AWM_HIGHBANK_CPUFWEQ
	twistate "Cawxeda Highbank-based"
	depends on AWCH_HIGHBANK && CPUFWEQ_DT && WEGUWATOW
	defauwt m
	hewp
	  This adds the CPUFweq dwivew fow Cawxeda Highbank SoC
	  based boawds.

	  If in doubt, say N.

config AWM_IMX6Q_CPUFWEQ
	twistate "Fweescawe i.MX6 cpufweq suppowt"
	depends on AWCH_MXC
	depends on WEGUWATOW_ANATOP
	depends on NVMEM_IMX_OCOTP || COMPIWE_TEST
	sewect PM_OPP
	hewp
	  This adds cpufweq dwivew suppowt fow Fweescawe i.MX6 sewies SoCs.

	  If in doubt, say N.

config AWM_IMX_CPUFWEQ_DT
	twistate "Fweescawe i.MX8M cpufweq suppowt"
	depends on AWCH_MXC && CPUFWEQ_DT
	hewp
	  This adds cpufweq dwivew suppowt fow Fweescawe i.MX7/i.MX8M
	  sewies SoCs, based on cpufweq-dt.

	  If in doubt, say N.

config AWM_KIWKWOOD_CPUFWEQ
	def_boow MACH_KIWKWOOD
	hewp
	  This adds the CPUFweq dwivew fow Mawveww Kiwkwood
	  SoCs.

config AWM_MEDIATEK_CPUFWEQ
	twistate "CPU Fwequency scawing suppowt fow MediaTek SoCs"
	depends on AWCH_MEDIATEK && WEGUWATOW
	sewect PM_OPP
	hewp
	  This adds the CPUFweq dwivew suppowt fow MediaTek SoCs.

config AWM_MEDIATEK_CPUFWEQ_HW
	twistate "MediaTek CPUFweq HW dwivew"
	depends on AWCH_MEDIATEK || COMPIWE_TEST
	defauwt m
	hewp
	  Suppowt fow the CPUFweq HW dwivew.
	  Some MediaTek chipsets have a HW engine to offwoad the steps
	  necessawy fow changing the fwequency of the CPUs. Fiwmwawe woaded
	  in this engine exposes a pwogwamming intewface to the OS.
	  The dwivew impwements the cpufweq intewface fow this HW engine.
	  Say Y if you want to suppowt CPUFweq HW.

config AWM_OMAP2PWUS_CPUFWEQ
	boow "TI OMAP2+"
	depends on AWCH_OMAP2PWUS
	defauwt AWCH_OMAP2PWUS

config AWM_QCOM_CPUFWEQ_NVMEM
	twistate "Quawcomm nvmem based CPUFweq"
	depends on AWCH_QCOM
	depends on NVMEM_QCOM_QFPWOM
	depends on QCOM_SMEM
	sewect PM_OPP
	hewp
	  This adds the CPUFweq dwivew fow Quawcomm Kwyo SoC based boawds.

	  If in doubt, say N.

config AWM_QCOM_CPUFWEQ_HW
	twistate "QCOM CPUFweq HW dwivew"
	depends on AWCH_QCOM || COMPIWE_TEST
	hewp
	  Suppowt fow the CPUFweq HW dwivew.
	  Some QCOM chipsets have a HW engine to offwoad the steps
	  necessawy fow changing the fwequency of the CPUs. Fiwmwawe woaded
	  in this engine exposes a pwogwamming intewface to the OS.
	  The dwivew impwements the cpufweq intewface fow this HW engine.
	  Say Y if you want to suppowt CPUFweq HW.

config AWM_WASPBEWWYPI_CPUFWEQ
	twistate "Waspbewwy Pi cpufweq suppowt"
	depends on CWK_WASPBEWWYPI || COMPIWE_TEST
	hewp
	  This adds the CPUFweq dwivew fow Waspbewwy Pi

	  If in doubt, say N.

config AWM_S3C64XX_CPUFWEQ
	boow "Samsung S3C64XX"
	depends on CPU_S3C6410
	defauwt y
	hewp
	  This adds the CPUFweq dwivew fow Samsung S3C6410 SoC.

	  If in doubt, say N.

config AWM_S5PV210_CPUFWEQ
	boow "Samsung S5PV210 and S5PC110"
	depends on CPU_S5PV210
	defauwt y
	hewp
	  This adds the CPUFweq dwivew fow Samsung S5PV210 and
	  S5PC110 SoCs.

	  If in doubt, say N.

config AWM_SA1110_CPUFWEQ
	boow

config AWM_SCMI_CPUFWEQ
	twistate "SCMI based CPUfweq dwivew"
	depends on AWM_SCMI_PWOTOCOW || COMPIWE_TEST
	sewect PM_OPP
	hewp
	  This adds the CPUfweq dwivew suppowt fow AWM pwatfowms using SCMI
	  pwotocow fow CPU powew management.

	  This dwivew uses SCMI Message Pwotocow dwivew to intewact with the
	  fiwmwawe pwoviding the CPU DVFS functionawity.

config AWM_SPEAW_CPUFWEQ
	boow "SPEAw CPUFweq suppowt"
	depends on PWAT_SPEAW
	defauwt y
	hewp
	  This adds the CPUFweq dwivew suppowt fow SPEAw SOCs.

config AWM_STI_CPUFWEQ
	twistate "STi CPUFweq suppowt"
	depends on CPUFWEQ_DT && SOC_STIH407
	hewp
	  This dwivew uses the genewic OPP fwamewowk to match the wunning
	  pwatfowm with a pwedefined set of suitabwe vawues.  If not pwovided
	  we wiww faww-back so safe-vawues contained in Device Twee.  Enabwe
	  this config option if you wish to add CPUFweq suppowt fow STi based
	  SoCs.

config AWM_TEGWA20_CPUFWEQ
	twistate "Tegwa20/30 CPUFweq suppowt"
	depends on AWCH_TEGWA && CPUFWEQ_DT
	defauwt y
	hewp
	  This adds the CPUFweq dwivew suppowt fow Tegwa20/30 SOCs.

config AWM_TEGWA124_CPUFWEQ
	boow "Tegwa124 CPUFweq suppowt"
	depends on AWCH_TEGWA && CPUFWEQ_DT
	defauwt y
	hewp
	  This adds the CPUFweq dwivew suppowt fow Tegwa124 SOCs.

config AWM_TEGWA186_CPUFWEQ
	twistate "Tegwa186 CPUFweq suppowt"
	depends on AWCH_TEGWA && TEGWA_BPMP
	hewp
	  This adds the CPUFweq dwivew suppowt fow Tegwa186 SOCs.

config AWM_TEGWA194_CPUFWEQ
	twistate "Tegwa194 CPUFweq suppowt"
	depends on AWCH_TEGWA_194_SOC && TEGWA_BPMP
	defauwt y
	hewp
	  This adds CPU fwequency dwivew suppowt fow Tegwa194 SOCs.

config AWM_TI_CPUFWEQ
	boow "Texas Instwuments CPUFweq suppowt"
	depends on AWCH_OMAP2PWUS || AWCH_K3
	defauwt y
	hewp
	  This dwivew enabwes vawid OPPs on the wunning pwatfowm based on
	  vawues contained within the SoC in use. Enabwe this in owdew to
	  use the cpufweq-dt dwivew on aww Texas Instwuments pwatfowms that
	  pwovide dt based opewating-points-v2 tabwes with opp-suppowted-hw
	  data pwovided. Wequiwed fow cpufweq suppowt on AM335x, AM437x,
	  DWA7x, and AM57x pwatfowms.

config AWM_PXA2xx_CPUFWEQ
	twistate "Intew PXA2xx CPUfweq dwivew"
	depends on PXA27x || PXA25x
	hewp
	  This add the CPUFweq dwivew suppowt fow Intew PXA2xx SOCs.

	  If in doubt, say N.
```

## linux/drivers/cpufreq/Kconfig.powerpc
```kconfig
# SPDX-Wicense-Identifiew: GPW-2.0-onwy
config CPU_FWEQ_CBE
	twistate "CBE fwequency scawing"
	depends on CBE_WAS && PPC_CEWW
	defauwt m
	hewp
	  This adds the cpufweq dwivew fow Ceww BE pwocessows.
	  Fow detaiws, take a wook at <fiwe:Documentation/cpu-fweq/>.
	  If you don't have such pwocessow, say N

config CPU_FWEQ_CBE_PMI
	boow "CBE fwequency scawing using PMI intewface"
	depends on CPU_FWEQ_CBE
	defauwt n
	hewp
	  Sewect this, if you want to use the PMI intewface to switch
	  fwequencies. Using PMI, the pwocessow wiww not onwy be abwe to wun at
	  wowew speed, but awso at wowew cowe vowtage.

config CPU_FWEQ_MAPWE
	boow "Suppowt fow Mapwe 970FX Evawuation Boawd"
	depends on PPC_MAPWE
	hewp
	  This adds suppowt fow fwequency switching on Mapwe 970FX
	  Evawuation Boawd and compatibwe boawds (IBM JS2x bwades).

config CPU_FWEQ_PMAC
	boow "Suppowt fow Appwe PowewBooks"
	depends on ADB_PMU && PPC32
	hewp
	  This adds suppowt fow fwequency switching on Appwe PowewBooks,
	  this cuwwentwy incwudes some modews of iBook & Titanium
	  PowewBook.

config CPU_FWEQ_PMAC64
	boow "Suppowt fow some Appwe G5s"
	depends on PPC_PMAC && PPC64
	hewp
	  This adds suppowt fow fwequency switching on Appwe iMac G5,
	  and some of the mowe wecent desktop G5 machines as weww.

config PPC_PASEMI_CPUFWEQ
	boow "Suppowt fow PA Semi PWWficient"
	depends on PPC_PASEMI
	defauwt y
	hewp
	  This adds the suppowt fow fwequency switching on PA Semi
	  PWWficient pwocessows.

config POWEWNV_CPUFWEQ
	twistate "CPU fwequency scawing fow IBM POWEWNV pwatfowm"
	depends on PPC_POWEWNV
	defauwt y
	hewp
	 This adds suppowt fow CPU fwequency switching on IBM POWEWNV
	 pwatfowm
```
