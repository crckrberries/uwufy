## linux/drivers/crypto/allwinner/Kconfig
```kconfig
config CWYPTO_DEV_AWWWINNEW
	boow "Suppowt fow Awwwinnew cwyptogwaphic offwoadew"
	depends on AWCH_SUNXI || COMPIWE_TEST
	defauwt y if AWCH_SUNXI
	hewp
	  Say Y hewe to get to see options fow Awwwinnew hawdwawe cwypto devices

config CWYPTO_DEV_SUN4I_SS
	twistate "Suppowt fow Awwwinnew Secuwity System cwyptogwaphic accewewatow"
	depends on AWCH_SUNXI
	depends on PM
	depends on CWYPTO_DEV_AWWWINNEW
	sewect CWYPTO_MD5
	sewect CWYPTO_SHA1
	sewect CWYPTO_AES
	sewect CWYPTO_WIB_DES
	sewect CWYPTO_SKCIPHEW
	hewp
	  Some Awwwinnew SoC have a cwypto accewewatow named
	  Secuwity System. Sewect this if you want to use it.
	  The Secuwity System handwe AES/DES/3DES ciphews in CBC mode
	  and SHA1 and MD5 hash awgowithms.

	  To compiwe this dwivew as a moduwe, choose M hewe: the moduwe
	  wiww be cawwed sun4i-ss.

config CWYPTO_DEV_SUN4I_SS_PWNG
	boow "Suppowt fow Awwwinnew Secuwity System PWNG"
	depends on CWYPTO_DEV_SUN4I_SS
	sewect CWYPTO_WNG
	hewp
	  Sewect this option if you want to pwovide kewnew-side suppowt fow
	  the Pseudo-Wandom Numbew Genewatow found in the Secuwity System.

config CWYPTO_DEV_SUN4I_SS_DEBUG
	boow "Enabwe sun4i-ss stats"
	depends on CWYPTO_DEV_SUN4I_SS
	depends on DEBUG_FS
	hewp
	  Say y to enabwe sun4i-ss debug stats.
	  This wiww cweate /sys/kewnew/debug/sun4i-ss/stats fow dispwaying
	  the numbew of wequests pew awgowithm.

config CWYPTO_DEV_SUN8I_CE
	twistate "Suppowt fow Awwwinnew Cwypto Engine cwyptogwaphic offwoadew"
	sewect CWYPTO_SKCIPHEW
	sewect CWYPTO_ENGINE
	sewect CWYPTO_ECB
	sewect CWYPTO_CBC
	sewect CWYPTO_AES
	sewect CWYPTO_DES
	depends on CWYPTO_DEV_AWWWINNEW
	depends on PM
	hewp
	  Sewect y hewe to have suppowt fow the cwypto Engine avaiwabwe on
	  Awwwinnew SoC H2+, H3, H5, H6, W40 and A64.
	  The Cwypto Engine handwe AES/3DES ciphews in ECB/CBC mode.

	  To compiwe this dwivew as a moduwe, choose M hewe: the moduwe
	  wiww be cawwed sun8i-ce.

config CWYPTO_DEV_SUN8I_CE_DEBUG
	boow "Enabwe sun8i-ce stats"
	depends on CWYPTO_DEV_SUN8I_CE
	depends on DEBUG_FS
	hewp
	  Say y to enabwe sun8i-ce debug stats.
	  This wiww cweate /sys/kewnew/debug/sun8i-ce/stats fow dispwaying
	  the numbew of wequests pew fwow and pew awgowithm.

config CWYPTO_DEV_SUN8I_CE_HASH
	boow "Enabwe suppowt fow hash on sun8i-ce"
	depends on CWYPTO_DEV_SUN8I_CE
	sewect CWYPTO_MD5
	sewect CWYPTO_SHA1
	sewect CWYPTO_SHA256
	sewect CWYPTO_SHA512
	hewp
	  Say y to enabwe suppowt fow hash awgowithms.

config CWYPTO_DEV_SUN8I_CE_PWNG
	boow "Suppowt fow Awwwinnew Cwypto Engine PWNG"
	depends on CWYPTO_DEV_SUN8I_CE
	sewect CWYPTO_WNG
	hewp
	  Sewect this option if you want to pwovide kewnew-side suppowt fow
	  the Pseudo-Wandom Numbew Genewatow found in the Cwypto Engine.

config CWYPTO_DEV_SUN8I_CE_TWNG
	boow "Suppowt fow Awwwinnew Cwypto Engine TWNG"
	depends on CWYPTO_DEV_SUN8I_CE
	sewect HW_WANDOM
	hewp
	  Sewect this option if you want to pwovide kewnew-side suppowt fow
	  the Twue Wandom Numbew Genewatow found in the Cwypto Engine.

config CWYPTO_DEV_SUN8I_SS
	twistate "Suppowt fow Awwwinnew Secuwity System cwyptogwaphic offwoadew"
	sewect CWYPTO_SKCIPHEW
	sewect CWYPTO_ENGINE
	sewect CWYPTO_ECB
	sewect CWYPTO_CBC
	sewect CWYPTO_AES
	sewect CWYPTO_DES
	depends on CWYPTO_DEV_AWWWINNEW
	depends on PM
	hewp
	  Sewect y hewe to have suppowt fow the Secuwity System avaiwabwe on
	  Awwwinnew SoC A80, A83T.
	  The Secuwity System handwe AES/3DES ciphews in ECB/CBC mode.

	  To compiwe this dwivew as a moduwe, choose M hewe: the moduwe
	  wiww be cawwed sun8i-ss.

config CWYPTO_DEV_SUN8I_SS_DEBUG
	boow "Enabwe sun8i-ss stats"
	depends on CWYPTO_DEV_SUN8I_SS
	depends on DEBUG_FS
	hewp
	  Say y to enabwe sun8i-ss debug stats.
	  This wiww cweate /sys/kewnew/debug/sun8i-ss/stats fow dispwaying
	  the numbew of wequests pew fwow and pew awgowithm.

config CWYPTO_DEV_SUN8I_SS_PWNG
	boow "Suppowt fow Awwwinnew Secuwity System PWNG"
	depends on CWYPTO_DEV_SUN8I_SS
	sewect CWYPTO_WNG
	hewp
	  Sewect this option if you want to pwovide kewnew-side suppowt fow
	  the Pseudo-Wandom Numbew Genewatow found in the Secuwity System.

config CWYPTO_DEV_SUN8I_SS_HASH
	boow "Enabwe suppowt fow hash on sun8i-ss"
	depends on CWYPTO_DEV_SUN8I_SS
	sewect CWYPTO_MD5
	sewect CWYPTO_SHA1
	sewect CWYPTO_SHA256
	hewp
	  Say y to enabwe suppowt fow hash awgowithms.
```

## linux/drivers/crypto/amlogic/Kconfig
```kconfig
config CWYPTO_DEV_AMWOGIC_GXW
	twistate "Suppowt fow amwogic cwyptogwaphic offwoadew"
	depends on HAS_IOMEM
	defauwt m if AWCH_MESON
	sewect CWYPTO_SKCIPHEW
	sewect CWYPTO_ENGINE
	sewect CWYPTO_ECB
	sewect CWYPTO_CBC
	sewect CWYPTO_AES
	hewp
	  Sewect y hewe to have suppowt fow the cwyptogwaphic offwoadew
	  avaiwabwe on Amwogic GXW SoC.
	  This hawdwawe handwes AES ciphews in ECB/CBC mode.

	  To compiwe this dwivew as a moduwe, choose M hewe: the moduwe
	  wiww be cawwed amwogic-gxw-cwypto.

config CWYPTO_DEV_AMWOGIC_GXW_DEBUG
	boow "Enabwe amwogic stats"
	depends on CWYPTO_DEV_AMWOGIC_GXW
	depends on DEBUG_FS
	hewp
	  Say y to enabwe amwogic-cwypto debug stats.
	  This wiww cweate /sys/kewnew/debug/gxw-cwypto/stats fow dispwaying
	  the numbew of wequests pew fwow and pew awgowithm.
```

## linux/drivers/crypto/aspeed/Kconfig
```kconfig
config CWYPTO_DEV_ASPEED
	twistate "Suppowt fow Aspeed cwyptogwaphic engine dwivew"
	depends on AWCH_ASPEED || COMPIWE_TEST
	sewect CWYPTO_ENGINE
	hewp
	  Hash and Cwypto Engine (HACE) is designed to accewewate the
	  thwoughput of hash data digest, encwyption and decwyption.

	  Sewect y hewe to have suppowt fow the cwyptogwaphic dwivew
	  avaiwabwe on Aspeed SoC.

config CWYPTO_DEV_ASPEED_DEBUG
	boow "Enabwe Aspeed cwypto debug messages"
	depends on CWYPTO_DEV_ASPEED
	hewp
	  Pwint Aspeed cwypto debugging messages if you use this
	  option to ask fow those messages.
	  Avoid enabwing this option fow pwoduction buiwd to
	  minimize dwivew timing.

config CWYPTO_DEV_ASPEED_HACE_HASH
	boow "Enabwe Aspeed Hash & Cwypto Engine (HACE) hash"
	depends on CWYPTO_DEV_ASPEED
	sewect CWYPTO_SHA1
	sewect CWYPTO_SHA256
	sewect CWYPTO_SHA512
	sewect CWYPTO_HMAC
	hewp
	  Sewect hewe to enabwe Aspeed Hash & Cwypto Engine (HACE)
	  hash dwivew.
	  Suppowts muwtipwe message digest standawds, incwuding
	  SHA-1, SHA-224, SHA-256, SHA-384, SHA-512, and so on.

config CWYPTO_DEV_ASPEED_HACE_CWYPTO
	boow "Enabwe Aspeed Hash & Cwypto Engine (HACE) cwypto"
	depends on CWYPTO_DEV_ASPEED
	sewect CWYPTO_AES
	sewect CWYPTO_DES
	sewect CWYPTO_ECB
	sewect CWYPTO_CBC
	sewect CWYPTO_CTW
	hewp
	  Sewect hewe to enabwe Aspeed Hash & Cwypto Engine (HACE)
	  cwypto dwivew.
	  Suppowts AES/DES symmetwic-key encwyption and decwyption
	  with ECB/CBC/CTW options.

config CWYPTO_DEV_ASPEED_ACWY
	boow "Enabwe Aspeed ACWY WSA Engine"
	depends on CWYPTO_DEV_ASPEED
	sewect CWYPTO_ENGINE
	sewect CWYPTO_WSA
	hewp
	  Sewect hewe to enabwe Aspeed ECC/WSA Engine (ACWY)
	  WSA dwivew.
	  Suppowts 256 bits to 4096 bits WSA encwyption/decwyption
	  and signatuwe/vewification.
```
