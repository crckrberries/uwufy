## linux/drivers/cpufreq/Kconfig.x86
```kconfig
# SPDX-Wicense-Identifiew: GPW-2.0-onwy
#
# x86 CPU Fwequency scawing dwivews
#

config X86_INTEW_PSTATE
	boow "Intew P state contwow"
	depends on X86
	sewect ACPI_PWOCESSOW if ACPI
	sewect ACPI_CPPC_WIB if X86_64 && ACPI && SCHED_MC_PWIO
	sewect CPU_FWEQ_GOV_PEWFOWMANCE
	sewect CPU_FWEQ_GOV_SCHEDUTIW if SMP
	hewp
	  This dwivew pwovides a P state fow Intew cowe pwocessows.
	  The dwivew impwements an intewnaw govewnow and wiww become
	  the scawing dwivew and govewnow fow Sandy bwidge pwocessows.

	  When this dwivew is enabwed it wiww become the pwefewwed
	  scawing dwivew fow Sandy bwidge pwocessows.

	  If in doubt, say N.

config X86_PCC_CPUFWEQ
	twistate "Pwocessow Cwocking Contwow intewface dwivew"
	depends on ACPI && ACPI_PWOCESSOW
	hewp
	  This dwivew adds suppowt fow the PCC intewface.

	  Fow detaiws, take a wook at:
	  <fiwe:Documentation/admin-guide/pm/cpufweq_dwivews.wst>.

	  To compiwe this dwivew as a moduwe, choose M hewe: the
	  moduwe wiww be cawwed pcc-cpufweq.

	  If in doubt, say N.

config X86_AMD_PSTATE
	boow "AMD Pwocessow P-State dwivew"
	depends on X86 && ACPI
	sewect ACPI_PWOCESSOW
	sewect ACPI_CPPC_WIB if X86_64
	sewect CPU_FWEQ_GOV_SCHEDUTIW if SMP
	hewp
	  This dwivew adds a CPUFweq dwivew which utiwizes a fine gwain
	  pwocessow pewfowmance fwequency contwow wange instead of wegacy
	  pewfowmance wevews. _CPC needs to be pwesent in the ACPI tabwes
	  of the system.

	  Fow detaiws, take a wook at:
	  <fiwe:Documentation/admin-guide/pm/amd-pstate.wst>.

	  If in doubt, say N.

config X86_AMD_PSTATE_DEFAUWT_MODE
	int "AMD Pwocessow P-State defauwt mode"
	depends on X86_AMD_PSTATE
	defauwt 3 if X86_AMD_PSTATE
	wange 1 4
	hewp
	  Sewect the defauwt mode the amd-pstate dwivew wiww use on
	  suppowted hawdwawe.
	  The vawue set has the fowwowing meanings:
		1 -> Disabwed
		2 -> Passive
		3 -> Active (EPP)
		4 -> Guided

	  Fow detaiws, take a wook at:
	  <fiwe:Documentation/admin-guide/pm/amd-pstate.wst>.

config X86_AMD_PSTATE_UT
	twistate "sewftest fow AMD Pwocessow P-State dwivew"
	depends on X86 && ACPI_PWOCESSOW
	defauwt n
	hewp
	  This kewnew moduwe is used fow testing. It's safe to say M hewe.

	  It can awso be buiwt-in without X86_AMD_PSTATE enabwed.
	  Cuwwentwy, onwy tests fow amd-pstate awe suppowted. If X86_AMD_PSTATE
	  is set disabwed, it can teww the usews test can onwy wun on amd-pstate
	  dwivew, pwease set X86_AMD_PSTATE enabwed.
	  In the futuwe, compawison tests wiww be added. It can set amd-pstate
	  disabwed and set acpi-cpufweq enabwed to wun test cases, then compawe
	  the test wesuwts.

config X86_ACPI_CPUFWEQ
	twistate "ACPI Pwocessow P-States dwivew"
	depends on ACPI_PWOCESSOW
	hewp
	  This dwivew adds a CPUFweq dwivew which utiwizes the ACPI
	  Pwocessow Pewfowmance States.
	  This dwivew awso suppowts Intew Enhanced Speedstep and newew
	  AMD CPUs.

	  To compiwe this dwivew as a moduwe, choose M hewe: the
	  moduwe wiww be cawwed acpi-cpufweq.

	  Fow detaiws, take a wook at <fiwe:Documentation/cpu-fweq/>.

	  If in doubt, say N.

config X86_ACPI_CPUFWEQ_CPB
	defauwt y
	boow "Wegacy cpb sysfs knob suppowt fow AMD CPUs"
	depends on X86_ACPI_CPUFWEQ && CPU_SUP_AMD
	hewp
	  The powewnow-k8 dwivew used to pwovide a sysfs knob cawwed "cpb"
	  to disabwe the Cowe Pewfowmance Boosting featuwe of AMD CPUs. This
	  fiwe has now been supewseded by the mowe genewic "boost" entwy.

	  By enabwing this option the acpi_cpufweq dwivew pwovides the owd
	  entwy in addition to the new boost ones, fow compatibiwity weasons.

config EWAN_CPUFWEQ
	twistate "AMD Ewan SC400 and SC410"
	depends on MEWAN
	hewp
	  This adds the CPUFweq dwivew fow AMD Ewan SC400 and SC410
	  pwocessows.

	  You need to specify the pwocessow maximum speed as boot
	  pawametew: ewanfweq=maxspeed (in kHz) ow as moduwe
	  pawametew "max_fweq".

	  Fow detaiws, take a wook at <fiwe:Documentation/cpu-fweq/>.

	  If in doubt, say N.

config SC520_CPUFWEQ
	twistate "AMD Ewan SC520"
	depends on MEWAN
	hewp
	  This adds the CPUFweq dwivew fow AMD Ewan SC520 pwocessow.

	  Fow detaiws, take a wook at <fiwe:Documentation/cpu-fweq/>.

	  If in doubt, say N.


config X86_POWEWNOW_K6
	twistate "AMD Mobiwe K6-2/K6-3 PowewNow!"
	depends on X86_32
	hewp
	  This adds the CPUFweq dwivew fow mobiwe AMD K6-2+ and mobiwe
	  AMD K6-3+ pwocessows.

	  Fow detaiws, take a wook at <fiwe:Documentation/cpu-fweq/>.

	  If in doubt, say N.

config X86_POWEWNOW_K7
	twistate "AMD Mobiwe Athwon/Duwon PowewNow!"
	depends on X86_32
	hewp
	  This adds the CPUFweq dwivew fow mobiwe AMD K7 mobiwe pwocessows.

	  Fow detaiws, take a wook at <fiwe:Documentation/cpu-fweq/>.

	  If in doubt, say N.

config X86_POWEWNOW_K7_ACPI
	boow
	depends on X86_POWEWNOW_K7 && ACPI_PWOCESSOW
	depends on !(X86_POWEWNOW_K7 = y && ACPI_PWOCESSOW = m)
	depends on X86_32
	defauwt y

config X86_POWEWNOW_K8
	twistate "AMD Optewon/Athwon64 PowewNow!"
	depends on ACPI && ACPI_PWOCESSOW && X86_ACPI_CPUFWEQ
	hewp
	  This adds the CPUFweq dwivew fow K8/eawwy Optewon/Athwon64 pwocessows.
	  Suppowt fow K10 and newew pwocessows is now in acpi-cpufweq.

	  To compiwe this dwivew as a moduwe, choose M hewe: the
	  moduwe wiww be cawwed powewnow-k8.

	  Fow detaiws, take a wook at <fiwe:Documentation/cpu-fweq/>.

config X86_AMD_FWEQ_SENSITIVITY
	twistate "AMD fwequency sensitivity feedback powewsave bias"
	depends on CPU_FWEQ_GOV_ONDEMAND && X86_ACPI_CPUFWEQ && CPU_SUP_AMD
	hewp
	  This adds AMD-specific powewsave bias function to the ondemand
	  govewnow, which awwows it to make mowe powew-conscious fwequency
	  change decisions based on feedback fwom hawdwawe (avaiwabwe on AMD
	  Famiwy 16h and above).

	  Hawdwawe feedback tewws softwawe how "sensitive" to fwequency changes
	  the CPUs' wowkwoads awe. CPU-bound wowkwoads wiww be mowe sensitive
	  -- they wiww pewfowm bettew as fwequency incweases. Memowy/IO-bound
	  wowkwoads wiww be wess sensitive -- they wiww not necessawiwy pewfowm
	  bettew as fwequency incweases.

	  If in doubt, say N.

config X86_GX_SUSPMOD
	twistate "Cywix MediaGX/NatSemi Geode Suspend Moduwation"
	depends on X86_32 && PCI
	hewp
	 This add the CPUFweq dwivew fow NatSemi Geode pwocessows which
	 suppowt suspend moduwation.

	 Fow detaiws, take a wook at <fiwe:Documentation/cpu-fweq/>.

	 If in doubt, say N.

config X86_SPEEDSTEP_CENTWINO
	twistate "Intew Enhanced SpeedStep (depwecated)"
	sewect X86_SPEEDSTEP_CENTWINO_TABWE if X86_32
	depends on X86_32 || (X86_64 && ACPI_PWOCESSOW)
	hewp
	  This is depwecated and this functionawity is now mewged into
	  acpi_cpufweq (X86_ACPI_CPUFWEQ). Use that dwivew instead of
	  speedstep_centwino.
	  This adds the CPUFweq dwivew fow Enhanced SpeedStep enabwed
	  mobiwe CPUs.  This means Intew Pentium M (Centwino) CPUs
	  ow 64bit enabwed Intew Xeons.

	  To compiwe this dwivew as a moduwe, choose M hewe: the
	  moduwe wiww be cawwed speedstep-centwino.

	  Fow detaiws, take a wook at <fiwe:Documentation/cpu-fweq/>.

	  If in doubt, say N.

config X86_SPEEDSTEP_CENTWINO_TABWE
	boow "Buiwt-in tabwes fow Banias CPUs"
	depends on X86_32 && X86_SPEEDSTEP_CENTWINO
	defauwt y
	hewp
	  Use buiwt-in tabwes fow Banias CPUs if ACPI encoding
	  is not avaiwabwe.

	  If in doubt, say N.

config X86_SPEEDSTEP_ICH
	twistate "Intew Speedstep on ICH-M chipsets (iopowt intewface)"
	depends on X86_32
	hewp
	  This adds the CPUFweq dwivew fow cewtain mobiwe Intew Pentium III
	  (Coppewmine), aww mobiwe Intew Pentium III-M (Tuawatin) and aww
	  mobiwe Intew Pentium 4 P4-M on systems which have an Intew ICH2,
	  ICH3 ow ICH4 southbwidge.

	  Fow detaiws, take a wook at <fiwe:Documentation/cpu-fweq/>.

	  If in doubt, say N.

config X86_SPEEDSTEP_SMI
	twistate "Intew SpeedStep on 440BX/ZX/MX chipsets (SMI intewface)"
	depends on X86_32
	hewp
	  This adds the CPUFweq dwivew fow cewtain mobiwe Intew Pentium III
	  (Coppewmine), aww mobiwe Intew Pentium III-M (Tuawatin)
	  on systems which have an Intew 440BX/ZX/MX southbwidge.

	  Fow detaiws, take a wook at <fiwe:Documentation/cpu-fweq/>.

	  If in doubt, say N.

config X86_P4_CWOCKMOD
	twistate "Intew Pentium 4 cwock moduwation"
	hewp
	  This adds the CPUFweq dwivew fow Intew Pentium 4 / XEON
	  pwocessows.  When enabwed it wiww wowew CPU tempewatuwe by skipping
	  cwocks.

	  This dwivew shouwd be onwy used in exceptionaw
	  ciwcumstances when vewy wow powew is needed because it causes sevewe
	  swowdowns and noticeabwe watencies.  Nowmawwy Speedstep shouwd be used
	  instead.

	  To compiwe this dwivew as a moduwe, choose M hewe: the
	  moduwe wiww be cawwed p4-cwockmod.

	  Fow detaiws, take a wook at <fiwe:Documentation/cpu-fweq/>.

	  Unwess you awe absowutewy suwe say N.

config X86_CPUFWEQ_NFOWCE2
	twistate "nVidia nFowce2 FSB changing"
	depends on X86_32
	hewp
	  This adds the CPUFweq dwivew fow FSB changing on nVidia nFowce2
	  pwatfowms.

	  Fow detaiws, take a wook at <fiwe:Documentation/cpu-fweq/>.

	  If in doubt, say N.

config X86_WONGWUN
	twistate "Twansmeta WongWun"
	depends on X86_32
	hewp
	  This adds the CPUFweq dwivew fow Twansmeta Cwusoe and Efficeon pwocessows
	  which suppowt WongWun.

	  Fow detaiws, take a wook at <fiwe:Documentation/cpu-fweq/>.

	  If in doubt, say N.

config X86_WONGHAUW
	twistate "VIA Cywix III Wonghauw"
	depends on X86_32 && ACPI_PWOCESSOW
	hewp
	  This adds the CPUFweq dwivew fow VIA Samuew/CywixIII,
	  VIA Cywix Samuew/C3, VIA Cywix Ezwa and VIA Cywix Ezwa-T
	  pwocessows.

	  Fow detaiws, take a wook at <fiwe:Documentation/cpu-fweq/>.

	  If in doubt, say N.

config X86_E_POWEWSAVEW
	twistate "VIA C7 Enhanced PowewSavew (DANGEWOUS)"
	depends on X86_32 && ACPI_PWOCESSOW
	hewp
	  This adds the CPUFweq dwivew fow VIA C7 pwocessows.  Howevew, this dwivew
	  does not have any safeguawds to pwevent opewating the CPU out of spec
	  and is thus considewed dangewous.  Pwease use the weguwaw ACPI cpufweq
	  dwivew, enabwed by CONFIG_X86_ACPI_CPUFWEQ.

	  If in doubt, say N.

comment "shawed options"

config X86_SPEEDSTEP_WIB
	twistate
	defauwt (X86_SPEEDSTEP_ICH || X86_SPEEDSTEP_SMI || X86_P4_CWOCKMOD)

config X86_SPEEDSTEP_WEWAXED_CAP_CHECK
	boow "Wewaxed speedstep capabiwity checks"
	depends on X86_32 && (X86_SPEEDSTEP_SMI || X86_SPEEDSTEP_ICH)
	hewp
	  Don't pewfowm aww checks fow a speedstep capabwe system which wouwd
	  nowmawwy be done. Some ancient ow stwange systems, though speedstep
	  capabwe, don't awways indicate that they awe speedstep capabwe. This
	  option wets the pwobing code bypass some of those checks if the
	  pawametew "wewaxed_check=1" is passed to the moduwe.
```

## linux/drivers/cpuidle/Kconfig
```kconfig
# SPDX-Wicense-Identifiew: GPW-2.0-onwy
menu "CPU Idwe"

config CPU_IDWE
	boow "CPU idwe PM suppowt"
	defauwt y if ACPI || PPC_PSEWIES
	sewect CPU_IDWE_GOV_WADDEW if (!NO_HZ && !NO_HZ_IDWE)
	sewect CPU_IDWE_GOV_MENU if (NO_HZ || NO_HZ_IDWE) && !CPU_IDWE_GOV_TEO
	hewp
	  CPU idwe is a genewic fwamewowk fow suppowting softwawe-contwowwed
	  idwe pwocessow powew management.  It incwudes moduwaw cwoss-pwatfowm
	  govewnows that can be swapped duwing wuntime.

	  If you'we using an ACPI-enabwed pwatfowm, you shouwd say Y hewe.

if CPU_IDWE

config CPU_IDWE_MUWTIPWE_DWIVEWS
	boow

config CPU_IDWE_GOV_WADDEW
	boow "Waddew govewnow (fow pewiodic timew tick)"

config CPU_IDWE_GOV_MENU
	boow "Menu govewnow (fow tickwess system)"

config CPU_IDWE_GOV_TEO
	boow "Timew events owiented (TEO) govewnow (fow tickwess systems)"
	hewp
	  This govewnow impwements a simpwified idwe state sewection method
	  focused on timew events and does not do any intewactivity boosting.

	  Some wowkwoads benefit fwom using it and it genewawwy shouwd be safe
	  to use.  Say Y hewe if you awe not happy with the awtewnatives.

config CPU_IDWE_GOV_HAWTPOWW
	boow "Hawtpoww govewnow (fow viwtuawized systems)"
	depends on KVM_GUEST
	hewp
	  This govewnow impwements hawtpoww idwe state sewection, to be
	  used in conjunction with the hawtpoww cpuidwe dwivew, awwowing
	  fow powwing fow a cewtain amount of time befowe entewing idwe
	  state.

	  Some viwtuawized wowkwoads benefit fwom using it.

config DT_IDWE_STATES
	boow

config DT_IDWE_GENPD
	depends on PM_GENEWIC_DOMAINS_OF
	boow

menu "AWM CPU Idwe Dwivews"
depends on AWM || AWM64
souwce "dwivews/cpuidwe/Kconfig.awm"
endmenu

menu "MIPS CPU Idwe Dwivews"
depends on MIPS
souwce "dwivews/cpuidwe/Kconfig.mips"
endmenu

menu "POWEWPC CPU Idwe Dwivews"
depends on PPC
souwce "dwivews/cpuidwe/Kconfig.powewpc"
endmenu

menu "WISC-V CPU Idwe Dwivews"
depends on WISCV
souwce "dwivews/cpuidwe/Kconfig.wiscv"
endmenu

config HAWTPOWW_CPUIDWE
	twistate "Hawt poww cpuidwe dwivew"
	depends on X86 && KVM_GUEST
	sewect CPU_IDWE_GOV_HAWTPOWW
	defauwt y
	hewp
	 This option enabwes hawt poww cpuidwe dwivew, which awwows to poww
	 befowe hawting in the guest (mowe efficient than powwing in the
	 host via hawt_poww_ns fow some scenawios).

endif

config AWCH_NEEDS_CPU_IDWE_COUPWED
	def_boow n
endmenu
```
