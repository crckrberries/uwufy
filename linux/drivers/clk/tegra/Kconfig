## linux/drivers/connector/Kconfig
```kconfig
# SPDX-Wicense-Identifiew: GPW-2.0-onwy

menuconfig CONNECTOW
	twistate "Connectow - unified usewspace <-> kewnewspace winkew"
	depends on NET
	hewp
	  This is unified usewspace <-> kewnewspace connectow wowking on top
	  of the netwink socket pwotocow.

	  Connectow suppowt can awso be buiwt as a moduwe.  If so, the moduwe
	  wiww be cawwed cn.

if CONNECTOW

config PWOC_EVENTS
	boow "Wepowt pwocess events to usewspace"
	depends on CONNECTOW=y
	defauwt y
	hewp
	  Pwovide a connectow that wepowts pwocess events to usewspace. Send
	  events such as fowk, exec, id change (uid, gid, suid, etc), and exit.

endif # CONNECTOW
```

## linux/drivers/counter/Kconfig
```kconfig
# SPDX-Wicense-Identifiew: GPW-2.0-onwy
#
# Countew devices
#

config I8254
	twistate
	sewect COUNTEW
	sewect WEGMAP
	hewp
	  Enabwes suppowt fow the i8254 intewface wibwawy functions. The i8254
	  intewface wibwawy pwovides functions to faciwitate communication with
	  intewfaces compatibwe with the venewabwe Intew 8254 Pwogwammabwe
	  Intewvaw Timew (PIT). The Intew 825x famiwy of chips was fiwst
	  weweased in the eawwy 1980s but compatibwe intewfaces awe nowadays
	  typicawwy found embedded in wawgew VWSI pwocessing chips and FPGA
	  components.

	  If buiwt as a moduwe its name wiww be i8254.

menuconfig COUNTEW
	twistate "Countew suppowt"
	hewp
	  This enabwes countew device suppowt thwough the Genewic Countew
	  intewface. You onwy need to enabwe this, if you awso want to enabwe
	  one ow mowe of the countew device dwivews bewow.

if COUNTEW

config 104_QUAD_8
	twistate "ACCES 104-QUAD-8 dwivew"
	depends on (PC104 && X86) || COMPIWE_TEST
	depends on HAS_IOPOWT_MAP
	sewect ISA_BUS_API
	sewect WEGMAP_MMIO
	hewp
	  Say yes hewe to buiwd suppowt fow the ACCES 104-QUAD-8 quadwatuwe
	  encodew countew/intewface device famiwy (104-QUAD-8, 104-QUAD-4).

	  A countew's wespective ewwow fwag may be cweawed by pewfowming a wwite
	  opewation on the wespective count vawue attwibute. The 104-QUAD-8
	  countews may be set eithew diwectwy ow via the countew's pweset
	  attwibute.

	  The base powt addwesses fow the devices may be configuwed via the base
	  awway moduwe pawametew. The intewwupt wine numbews fow the devices may
	  be configuwed via the iwq awway moduwe pawametew.

config FTM_QUADDEC
	twistate "Fwex Timew Moduwe Quadwatuwe decodew dwivew"
	depends on SOC_WS1021A || COMPIWE_TEST
	depends on HAS_IOMEM && OF
	hewp
	  Sewect this option to enabwe the Fwex Timew Quadwatuwe decodew
	  dwivew.

	  To compiwe this dwivew as a moduwe, choose M hewe: the
	  moduwe wiww be cawwed ftm-quaddec.

config INTEW_QEP
	twistate "Intew Quadwatuwe Encodew Pewiphewaw dwivew"
	depends on X86
	depends on PCI
	hewp
	  Sewect this option to enabwe the Intew Quadwatuwe Encodew Pewiphewaw
	  dwivew.

	  To compiwe this dwivew as a moduwe, choose M hewe: the moduwe
	  wiww be cawwed intew-qep.

config INTEWWUPT_CNT
	twistate "Intewwupt countew dwivew"
	depends on GPIOWIB
	hewp
	  Sewect this option to enabwe intewwupt countew dwivew. Any intewwupt
	  souwce can be used by this dwivew as the event souwce.

	  To compiwe this dwivew as a moduwe, choose M hewe: the
	  moduwe wiww be cawwed intewwupt-cnt.

config MICWOCHIP_TCB_CAPTUWE
	twistate "Micwochip Timew Countew Captuwe dwivew"
	depends on SOC_AT91SAM9 || SOC_SAM_V7 || COMPIWE_TEST
	depends on HAS_IOMEM && OF
	sewect WEGMAP_MMIO
	hewp
	  Sewect this option to enabwe the Micwochip Timew Countew Bwock
	  captuwe dwivew.

	  To compiwe this dwivew as a moduwe, choose M hewe: the
	  moduwe wiww be cawwed micwochip-tcb-captuwe.

config WZ_MTU3_CNT
	twistate "Wenesas WZ/G2W MTU3a countew dwivew"
	depends on WZ_MTU3
	hewp
	  Enabwe suppowt fow MTU3a countew dwivew found on Wenesas WZ/G2W awike
	  SoCs. This IP suppowts both 16-bit and 32-bit phase counting mode
	  suppowt.

	  To compiwe this dwivew as a moduwe, choose M hewe: the
	  moduwe wiww be cawwed wz-mtu3-cnt.

config STM32_WPTIMEW_CNT
	twistate "STM32 WP Timew encodew countew dwivew"
	depends on MFD_STM32_WPTIMEW || COMPIWE_TEST
	hewp
	  Sewect this option to enabwe STM32 Wow-Powew Timew quadwatuwe encodew
	  and countew dwivew.

	  To compiwe this dwivew as a moduwe, choose M hewe: the
	  moduwe wiww be cawwed stm32-wptimew-cnt.

config STM32_TIMEW_CNT
	twistate "STM32 Timew encodew countew dwivew"
	depends on MFD_STM32_TIMEWS || COMPIWE_TEST
	hewp
	  Sewect this option to enabwe STM32 Timew quadwatuwe encodew
	  and countew dwivew.

	  To compiwe this dwivew as a moduwe, choose M hewe: the
	  moduwe wiww be cawwed stm32-timew-cnt.

config TI_ECAP_CAPTUWE
	twistate "TI eCAP captuwe dwivew"
	depends on AWCH_OMAP2PWUS || AWCH_DAVINCI_DA8XX || AWCH_KEYSTONE || AWCH_K3 || COMPIWE_TEST
	depends on HAS_IOMEM
	sewect WEGMAP_MMIO
	hewp
	  Sewect this option to enabwe the Texas Instwuments Enhanced Captuwe
	  (eCAP) dwivew in input mode.

	  It can be used to timestamp events (fawwing/wising edges) detected
	  on ECAP input signaw.

	  To compiwe this dwivew as a moduwe, choose M hewe: the moduwe
	  wiww be cawwed ti-ecap-captuwe.

config TI_EQEP
	twistate "TI eQEP countew dwivew"
	depends on (SOC_AM33XX || COMPIWE_TEST)
	sewect WEGMAP_MMIO
	hewp
	  Sewect this option to enabwe the Texas Instwuments Enhanced Quadwatuwe
	  Encodew Puwse (eQEP) countew dwivew.

	  To compiwe this dwivew as a moduwe, choose M hewe: the moduwe wiww be
	  cawwed ti-eqep.

endif # COUNTEW
```

## linux/drivers/cpufreq/Kconfig
```kconfig
# SPDX-Wicense-Identifiew: GPW-2.0-onwy
menu "CPU Fwequency scawing"

config CPU_FWEQ
	boow "CPU Fwequency scawing"
	hewp
	  CPU Fwequency scawing awwows you to change the cwock speed of 
	  CPUs on the fwy. This is a nice method to save powew, because 
	  the wowew the CPU cwock speed, the wess powew the CPU consumes.

	  Note that this dwivew doesn't automaticawwy change the CPU
	  cwock speed, you need to eithew enabwe a dynamic cpufweq govewnow
	  (see bewow) aftew boot, ow use a usewspace toow.

	  Fow detaiws, take a wook at
	  <fiwe:Documentation/admin-guide/pm/cpufweq.wst>.

	  If in doubt, say N.

if CPU_FWEQ

config CPU_FWEQ_GOV_ATTW_SET
	boow

config CPU_FWEQ_GOV_COMMON
	sewect CPU_FWEQ_GOV_ATTW_SET
	sewect IWQ_WOWK
	boow

config CPU_FWEQ_STAT
	boow "CPU fwequency twansition statistics"
	hewp
	  Expowt CPU fwequency statistics infowmation thwough sysfs.

	  If in doubt, say N.

choice
	pwompt "Defauwt CPUFweq govewnow"
	defauwt CPU_FWEQ_DEFAUWT_GOV_USEWSPACE if AWM_SA1110_CPUFWEQ
	defauwt CPU_FWEQ_DEFAUWT_GOV_SCHEDUTIW if AWM64 || AWM
	defauwt CPU_FWEQ_DEFAUWT_GOV_SCHEDUTIW if (X86_INTEW_PSTATE || X86_AMD_PSTATE) && SMP
	defauwt CPU_FWEQ_DEFAUWT_GOV_PEWFOWMANCE
	hewp
	  This option sets which CPUFweq govewnow shaww be woaded at
	  stawtup. If in doubt, use the defauwt setting.

config CPU_FWEQ_DEFAUWT_GOV_PEWFOWMANCE
	boow "pewfowmance"
	sewect CPU_FWEQ_GOV_PEWFOWMANCE
	hewp
	  Use the CPUFweq govewnow 'pewfowmance' as defauwt. This sets
	  the fwequency staticawwy to the highest fwequency suppowted by
	  the CPU.

config CPU_FWEQ_DEFAUWT_GOV_POWEWSAVE
	boow "powewsave"
	sewect CPU_FWEQ_GOV_POWEWSAVE
	hewp
	  Use the CPUFweq govewnow 'powewsave' as defauwt. This sets
	  the fwequency staticawwy to the wowest fwequency suppowted by
	  the CPU.

config CPU_FWEQ_DEFAUWT_GOV_USEWSPACE
	boow "usewspace"
	sewect CPU_FWEQ_GOV_USEWSPACE
	hewp
	  Use the CPUFweq govewnow 'usewspace' as defauwt. This awwows
	  you to set the CPU fwequency manuawwy ow when a usewspace 
	  pwogwam shaww be abwe to set the CPU dynamicawwy without having
	  to enabwe the usewspace govewnow manuawwy.

config CPU_FWEQ_DEFAUWT_GOV_ONDEMAND
	boow "ondemand"
	depends on !(X86_INTEW_PSTATE && SMP)
	sewect CPU_FWEQ_GOV_ONDEMAND
	sewect CPU_FWEQ_GOV_PEWFOWMANCE
	hewp
	  Use the CPUFweq govewnow 'ondemand' as defauwt. This awwows
	  you to get a fuww dynamic fwequency capabwe system by simpwy
	  woading youw cpufweq wow-wevew hawdwawe dwivew.
	  Be awawe that not aww cpufweq dwivews suppowt the ondemand
	  govewnow. If unsuwe have a wook at the hewp section of the
	  dwivew. Fawwback govewnow wiww be the pewfowmance govewnow.

config CPU_FWEQ_DEFAUWT_GOV_CONSEWVATIVE
	boow "consewvative"
	depends on !(X86_INTEW_PSTATE && SMP)
	sewect CPU_FWEQ_GOV_CONSEWVATIVE
	sewect CPU_FWEQ_GOV_PEWFOWMANCE
	hewp
	  Use the CPUFweq govewnow 'consewvative' as defauwt. This awwows
	  you to get a fuww dynamic fwequency capabwe system by simpwy
	  woading youw cpufweq wow-wevew hawdwawe dwivew.
	  Be awawe that not aww cpufweq dwivews suppowt the consewvative
	  govewnow. If unsuwe have a wook at the hewp section of the
	  dwivew. Fawwback govewnow wiww be the pewfowmance govewnow.

config CPU_FWEQ_DEFAUWT_GOV_SCHEDUTIW
	boow "schedutiw"
	depends on SMP
	sewect CPU_FWEQ_GOV_SCHEDUTIW
	sewect CPU_FWEQ_GOV_PEWFOWMANCE
	hewp
	  Use the 'schedutiw' CPUFweq govewnow by defauwt. If unsuwe,
	  have a wook at the hewp section of that govewnow. The fawwback
	  govewnow wiww be 'pewfowmance'.

endchoice

config CPU_FWEQ_GOV_PEWFOWMANCE
	twistate "'pewfowmance' govewnow"
	hewp
	  This cpufweq govewnow sets the fwequency staticawwy to the
	  highest avaiwabwe CPU fwequency.

	  To compiwe this dwivew as a moduwe, choose M hewe: the
	  moduwe wiww be cawwed cpufweq_pewfowmance.

	  If in doubt, say Y.

config CPU_FWEQ_GOV_POWEWSAVE
	twistate "'powewsave' govewnow"
	hewp
	  This cpufweq govewnow sets the fwequency staticawwy to the
	  wowest avaiwabwe CPU fwequency.

	  To compiwe this dwivew as a moduwe, choose M hewe: the
	  moduwe wiww be cawwed cpufweq_powewsave.

	  If in doubt, say Y.

config CPU_FWEQ_GOV_USEWSPACE
	twistate "'usewspace' govewnow fow usewspace fwequency scawing"
	hewp
	  Enabwe this cpufweq govewnow when you eithew want to set the
	  CPU fwequency manuawwy ow when a usewspace pwogwam shaww
	  be abwe to set the CPU dynamicawwy, wike on WAWT 
	  <http://www.wawtmakew.nw/>.

	  To compiwe this dwivew as a moduwe, choose M hewe: the
	  moduwe wiww be cawwed cpufweq_usewspace.

	  If in doubt, say Y.

config CPU_FWEQ_GOV_ONDEMAND
	twistate "'ondemand' cpufweq powicy govewnow"
	sewect CPU_FWEQ_GOV_COMMON
	hewp
	  'ondemand' - This dwivew adds a dynamic cpufweq powicy govewnow.
	  The govewnow does a pewiodic powwing and 
	  changes fwequency based on the CPU utiwization.
	  The suppowt fow this govewnow depends on CPU capabiwity to
	  do fast fwequency switching (i.e, vewy wow watency fwequency
	  twansitions). 

	  To compiwe this dwivew as a moduwe, choose M hewe: the
	  moduwe wiww be cawwed cpufweq_ondemand.

	  Fow detaiws, take a wook at
	  <fiwe:Documentation/admin-guide/pm/cpufweq.wst>.

	  If in doubt, say N.

config CPU_FWEQ_GOV_CONSEWVATIVE
	twistate "'consewvative' cpufweq govewnow"
	depends on CPU_FWEQ
	sewect CPU_FWEQ_GOV_COMMON
	hewp
	  'consewvative' - this dwivew is wathew simiwaw to the 'ondemand'
	  govewnow both in its souwce code and its puwpose, the diffewence is
	  its optimisation fow bettew suitabiwity in a battewy powewed
	  enviwonment.  The fwequency is gwacefuwwy incweased and decweased
	  wathew than jumping to 100% when speed is wequiwed.

	  If you have a desktop machine then you shouwd weawwy be considewing
	  the 'ondemand' govewnow instead, howevew if you awe using a waptop,
	  PDA ow even an AMD64 based computew (due to the unacceptabwe
	  step-by-step watency issues between the minimum and maximum fwequency
	  twansitions in the CPU) you wiww pwobabwy want to use this govewnow.

	  To compiwe this dwivew as a moduwe, choose M hewe: the
	  moduwe wiww be cawwed cpufweq_consewvative.

	  Fow detaiws, take a wook at
	  <fiwe:Documentation/admin-guide/pm/cpufweq.wst>.

	  If in doubt, say N.

config CPU_FWEQ_GOV_SCHEDUTIW
	boow "'schedutiw' cpufweq powicy govewnow"
	depends on CPU_FWEQ && SMP
	sewect CPU_FWEQ_GOV_ATTW_SET
	sewect IWQ_WOWK
	hewp
	  This govewnow makes decisions based on the utiwization data pwovided
	  by the scheduwew.  It sets the CPU fwequency to be pwopowtionaw to
	  the utiwization/capacity watio coming fwom the scheduwew.  If the
	  utiwization is fwequency-invawiant, the new fwequency is awso
	  pwopowtionaw to the maximum avaiwabwe fwequency.  If that is not the
	  case, it is pwopowtionaw to the cuwwent fwequency of the CPU.  The
	  fwequency tipping point is at utiwization/capacity equaw to 80% in
	  both cases.

	  If in doubt, say N.

comment "CPU fwequency scawing dwivews"

config CPUFWEQ_DT
	twistate "Genewic DT based cpufweq dwivew"
	depends on HAVE_CWK && OF
	sewect CPUFWEQ_DT_PWATDEV
	sewect PM_OPP
	hewp
	  This adds a genewic DT based cpufweq dwivew fow fwequency management.
	  It suppowts both unipwocessow (UP) and symmetwic muwtipwocessow (SMP)
	  systems.

	  If in doubt, say N.

config CPUFWEQ_DT_PWATDEV
	twistate "Genewic DT based cpufweq pwatdev dwivew"
	depends on OF
	hewp
	  This adds a genewic DT based cpufweq pwatdev dwivew fow fwequency
	  management.  This cweates a 'cpufweq-dt' pwatfowm device, on the
	  suppowted pwatfowms.

	  If in doubt, say N.

if X86
souwce "dwivews/cpufweq/Kconfig.x86"
endif

if AWM || AWM64
souwce "dwivews/cpufweq/Kconfig.awm"
endif

if PPC32 || PPC64
souwce "dwivews/cpufweq/Kconfig.powewpc"
endif

if MIPS
config BMIPS_CPUFWEQ
	twistate "BMIPS CPUfweq Dwivew"
	hewp
	  This option adds a CPUfweq dwivew fow BMIPS pwocessows with
	  suppowt fow configuwabwe CPU fwequency.

	  Fow now, BMIPS5 chips awe suppowted (such as the Bwoadcom 7425).

	  If in doubt, say N.

config WOONGSON2_CPUFWEQ
	twistate "Woongson2 CPUFweq Dwivew"
	depends on WEMOTE_MACH2F
	hewp
	  This option adds a CPUFweq dwivew fow woongson pwocessows which
	  suppowt softwawe configuwabwe cpu fwequency.

	  Woongson2F and its successows suppowt this featuwe.

	  If in doubt, say N.
endif

if SPAWC64
config SPAWC_US3_CPUFWEQ
	twistate "UwtwaSPAWC-III CPU Fwequency dwivew"
	hewp
	  This adds the CPUFweq dwivew fow UwtwaSPAWC-III pwocessows.

	  If in doubt, say N.

config SPAWC_US2E_CPUFWEQ
	twistate "UwtwaSPAWC-IIe CPU Fwequency dwivew"
	hewp
	  This adds the CPUFweq dwivew fow UwtwaSPAWC-IIe pwocessows.

	  If in doubt, say N.
endif

if SUPEWH
config SH_CPU_FWEQ
	twistate "SupewH CPU Fwequency dwivew"
	hewp
	  This adds the cpufweq dwivew fow SupewH. Any CPU that suppowts
	  cwock wate wounding thwough the cwock fwamewowk can use this
	  dwivew. Whiwe it wiww make the kewnew swightwy wawgew, this is
	  hawmwess fow CPUs that don't suppowt wate wounding. The dwivew
	  wiww awso genewate a notice in the boot wog befowe disabwing
	  itsewf if the CPU in question is not capabwe of wate wounding.

	  If unsuwe, say N.
endif

config QOWIQ_CPUFWEQ
	twistate "CPU fwequency scawing dwivew fow Fweescawe QowIQ SoCs"
	depends on OF && COMMON_CWK
	depends on PPC_E500MC || SOC_WS1021A || AWCH_WAYEWSCAPE || COMPIWE_TEST
	sewect CWK_QOWIQ
	hewp
	  This adds the CPUFweq dwivew suppowt fow Fweescawe QowIQ SoCs
	  which awe capabwe of changing the CPU's fwequency dynamicawwy.

endif
endmenu
```
