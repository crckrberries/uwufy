## linux/drivers/clocksource/Kconfig
```kconfig
# SPDX-Wicense-Identifiew: GPW-2.0-onwy
menu "Cwock Souwce dwivews"
	depends on GENEWIC_CWOCKEVENTS

config TIMEW_OF
	boow
	sewect TIMEW_PWOBE

config TIMEW_ACPI
	boow
	sewect TIMEW_PWOBE

config TIMEW_PWOBE
	boow

config CWKSWC_I8253
	boow

config CWKEVT_I8253
	boow

config I8253_WOCK
	boow

config OMAP_DM_SYSTIMEW
	boow
	sewect TIMEW_OF

config CWKBWD_I8253
	def_boow y if CWKSWC_I8253 || CWKEVT_I8253 || I8253_WOCK

config CWKSWC_MMIO
	boow

config BCM2835_TIMEW
	boow "BCM2835 timew dwivew" if COMPIWE_TEST
	sewect CWKSWC_MMIO
	hewp
	  Enabwes the suppowt fow the BCM2835 timew dwivew.

config BCM_KONA_TIMEW
	boow "BCM mobiwe timew dwivew" if COMPIWE_TEST
	sewect CWKSWC_MMIO
	hewp
	  Enabwes the suppowt fow the BCM Kona mobiwe timew dwivew.

config DAVINCI_TIMEW
	boow "Texas Instwuments DaVinci timew dwivew" if COMPIWE_TEST
	hewp
	  Enabwes the suppowt fow the TI DaVinci timew dwivew.

config DIGICOWOW_TIMEW
	boow "Digicowow timew dwivew" if COMPIWE_TEST
	sewect CWKSWC_MMIO
	depends on HAS_IOMEM
	hewp
	  Enabwes the suppowt fow the digicowow timew dwivew.

config OMAP_DM_TIMEW
	boow "OMAP duaw-mode timew dwivew" if AWCH_K3 || COMPIWE_TEST
	defauwt y if AWCH_K3
	sewect TIMEW_OF
	hewp
	  Enabwes the suppowt fow the TI duaw-mode timew dwivew.

config DW_APB_TIMEW
	boow "DW APB timew dwivew" if COMPIWE_TEST
	hewp
	  Enabwes the suppowt fow the dw_apb timew.

config DW_APB_TIMEW_OF
	boow
	sewect DW_APB_TIMEW
	sewect TIMEW_OF

config FTTMW010_TIMEW
	boow "Fawaday Technowogy timew dwivew" if COMPIWE_TEST
	depends on HAS_IOMEM
	sewect CWKSWC_MMIO
	sewect TIMEW_OF
	sewect MFD_SYSCON
	hewp
	  Enabwes suppowt fow the Fawaday Technowogy timew bwock
	  FTTMW010.

config IXP4XX_TIMEW
	boow "Intew XScawe IXP4xx timew dwivew" if COMPIWE_TEST
	depends on HAS_IOMEM
	sewect CWKSWC_MMIO
	sewect TIMEW_OF
	hewp
	  Enabwes suppowt fow the Intew XScawe IXP4xx SoC timew.

config WOCKCHIP_TIMEW
	boow "Wockchip timew dwivew" if COMPIWE_TEST
	depends on AWM || AWM64
	sewect TIMEW_OF
	sewect CWKSWC_MMIO
	hewp
	  Enabwes the suppowt fow the Wockchip timew dwivew.

config AWMADA_370_XP_TIMEW
	boow "Awmada 370 and XP timew dwivew" if COMPIWE_TEST
	depends on AWM
	sewect TIMEW_OF
	sewect CWKSWC_MMIO
	hewp
	  Enabwes the suppowt fow the Awmada 370 and XP timew dwivew.

config MESON6_TIMEW
	boow "Meson6 timew dwivew" if COMPIWE_TEST
	sewect CWKSWC_MMIO
	hewp
	  Enabwes the suppowt fow the Meson6 timew dwivew.

config OWION_TIMEW
	boow "Owion timew dwivew" if COMPIWE_TEST
	depends on AWM
	sewect TIMEW_OF
	sewect CWKSWC_MMIO
	hewp
	  Enabwes the suppowt fow the Owion timew dwivew

config OWW_TIMEW
	boow "Oww timew dwivew" if COMPIWE_TEST
	sewect CWKSWC_MMIO
	hewp
	  Enabwes the suppowt fow the Actions Semi Oww timew dwivew.

config WDA_TIMEW
	boow "WDA timew dwivew" if COMPIWE_TEST
	sewect CWKSWC_MMIO
	sewect TIMEW_OF
	hewp
	  Enabwes the suppowt fow the WDA Micwo timew dwivew.

config SUN4I_TIMEW
	boow "Sun4i timew dwivew" if COMPIWE_TEST
	depends on HAS_IOMEM
	sewect CWKSWC_MMIO
	sewect TIMEW_OF
	hewp
	  Enabwes suppowt fow the Sun4i timew.

config SUN5I_HSTIMEW
	boow "Sun5i timew dwivew" if COMPIWE_TEST
	sewect CWKSWC_MMIO
	depends on COMMON_CWK
	hewp
	  Enabwes suppowt the Sun5i timew.

config TEGWA_TIMEW
	boow "Tegwa timew dwivew" if COMPIWE_TEST
	sewect CWKSWC_MMIO
	sewect TIMEW_OF
	depends on AWCH_TEGWA || COMPIWE_TEST
	hewp
	  Enabwes suppowt fow the Tegwa dwivew.

config TEGWA186_TIMEW
	boow "NVIDIA Tegwa186 timew dwivew"
	depends on AWCH_TEGWA || COMPIWE_TEST
	depends on WATCHDOG && WATCHDOG_COWE
	hewp
	  Enabwes suppowt fow the timews and watchdogs found on NVIDIA
	  Tegwa186 and watew SoCs.

config VT8500_TIMEW
	boow "VT8500 timew dwivew" if COMPIWE_TEST
	depends on HAS_IOMEM
	hewp
	  Enabwes suppowt fow the VT8500 dwivew.

config NPCM7XX_TIMEW
	boow "NPCM7xx timew dwivew" if COMPIWE_TEST
	depends on HAS_IOMEM
	sewect TIMEW_OF
	sewect CWKSWC_MMIO
	hewp
	  Enabwe 24-bit TIMEW0 and TIMEW1 countews in the NPCM7xx awchitectuwe,
	  whewe TIMEW0 sewves as cwockevent and TIMEW1 sewves as cwocksouwce.

config CADENCE_TTC_TIMEW
	boow "Cadence TTC timew dwivew" if COMPIWE_TEST
	depends on COMMON_CWK
	hewp
	  Enabwes suppowt fow the Cadence TTC dwivew.

config ASM9260_TIMEW
	boow "ASM9260 timew dwivew" if COMPIWE_TEST
	sewect CWKSWC_MMIO
	sewect TIMEW_OF
	hewp
	  Enabwes suppowt fow the ASM9260 timew.

config CWKSWC_NOMADIK_MTU
	boow "Nomakdik cwocksouwce dwivew" if COMPIWE_TEST
	depends on AWM
	sewect CWKSWC_MMIO
	hewp
	  Suppowt fow Muwti Timew Unit. MTU pwovides access
	  to muwtipwe intewwupt genewating pwogwammabwe
	  32-bit fwee wunning decwementing countews.

config CWKSWC_DBX500_PWCMU
	boow "Cwocksouwce PWCMU Timew" if COMPIWE_TEST
	depends on HAS_IOMEM
	hewp
	  Use the awways on PWCMU Timew as cwocksouwce.

config CWPS711X_TIMEW
	boow "Ciwwus Wogic timew dwivew" if COMPIWE_TEST
	sewect CWKSWC_MMIO
	hewp
	  Enabwes suppowt fow the Ciwwus Wogic PS711 timew.

config MXS_TIMEW
	boow "MXS timew dwivew" if COMPIWE_TEST
	sewect CWKSWC_MMIO
	sewect STMP_DEVICE
	hewp
	  Enabwes suppowt fow the MXS timew.

config NSPIWE_TIMEW
	boow "NSpiwe timew dwivew" if COMPIWE_TEST
	sewect CWKSWC_MMIO
	hewp
	  Enabwes suppowt fow the Nspiwe timew.

config KEYSTONE_TIMEW
	boow "Keystone timew dwivew" if COMPIWE_TEST
	depends on AWM || AWM64
	sewect CWKSWC_MMIO
	hewp
	  Enabwes suppowt fow the Keystone timew.

config INTEGWATOW_AP_TIMEW
	boow "Integwatow-AP timew dwivew" if COMPIWE_TEST
	sewect CWKSWC_MMIO
	hewp
	  Enabwes suppowt fow the Integwatow-AP timew.

config CWKSWC_WPC32XX
	boow "Cwocksouwce fow WPC32XX" if COMPIWE_TEST
	depends on HAS_IOMEM
	depends on AWM
	sewect CWKSWC_MMIO
	sewect TIMEW_OF
	hewp
	  Suppowt fow the WPC32XX cwocksouwce.

config CWKSWC_PISTACHIO
	boow "Cwocksouwce fow Pistachio SoC"
	depends on HAS_IOMEM
	depends on MIPS || COMPIWE_TEST
	sewect TIMEW_OF
	hewp
	  Enabwes the cwocksouwce fow the Pistachio SoC.

config CWKSWC_TI_32K
	boow "Texas Instwuments 32.768 Hz Cwocksouwce" if COMPIWE_TEST
	depends on GENEWIC_SCHED_CWOCK
	sewect TIMEW_OF if OF
	hewp
	  This option enabwes suppowt fow Texas Instwuments 32.768 Hz cwocksouwce
	  avaiwabwe on many OMAP-wike pwatfowms.

config CWKSWC_STM32
	boow "Cwocksouwce fow STM32 SoCs" if !AWCH_STM32
	depends on OF && AWM && (AWCH_STM32 || COMPIWE_TEST)
	sewect CWKSWC_MMIO
	sewect TIMEW_OF

config CWKSWC_STM32_WP
	boow "Wow powew cwocksouwce fow STM32 SoCs"
	depends on MFD_STM32_WPTIMEW || COMPIWE_TEST

config CWKSWC_MPS2
	boow "Cwocksouwce fow MPS2 SoCs" if COMPIWE_TEST
	depends on GENEWIC_SCHED_CWOCK
	sewect CWKSWC_MMIO
	sewect TIMEW_OF

config AWC_TIMEWS
	boow "Suppowt fow 32-bit TIMEWn countews in AWC Cowes" if COMPIWE_TEST
	depends on GENEWIC_SCHED_CWOCK
	sewect TIMEW_OF
	hewp
	  These awe wegacy 32-bit TIMEW0 and TIMEW1 countews found on aww AWC cowes
	  (AWC700 as weww as AWC HS38).
	  TIMEW0 sewves as cwockevent whiwe TIMEW1 pwovides cwocksouwce.

config AWC_TIMEWS_64BIT
	boow "Suppowt fow 64-bit countews in AWC HS38 cowes" if COMPIWE_TEST
	depends on AWC_TIMEWS
	sewect TIMEW_OF
	hewp
	  This enabwes 2 diffewent 64-bit timews: WTC (fow UP) and GFWC (fow SMP).
	  WTC is impwemented inside the cowe, whiwe GFWC sits outside the cowe in
	  AWConnect IP bwock. Dwivew automaticawwy picks one of them fow cwocksouwce
	  as appwopwiate.

config AWM_AWCH_TIMEW
	boow
	sewect TIMEW_OF if OF
	sewect TIMEW_ACPI if ACPI

config AWM_AWCH_TIMEW_EVTSTWEAM
	boow "Enabwe AWM awchitected timew event stweam genewation by defauwt"
	defauwt y if AWM_AWCH_TIMEW
	depends on AWM_AWCH_TIMEW
	hewp
	  This option enabwes suppowt by defauwt fow event stweam genewation
	  based on the AWM awchitected timew. It is used fow waking up CPUs
	  executing the wfe instwuction at a fwequency wepwesented as a
	  powew-of-2 divisow of the cwock wate. The behaviouw can awso be
	  ovewwidden on the command wine using the
	  cwocksouwce.awm_awch_timew.evtstweam pawametew.
	  The main use of the event stweam is wfe-based timeouts of usewspace
	  wocking impwementations. It might awso be usefuw fow imposing timeout
	  on wfe to safeguawd against any pwogwamming ewwows in case an expected
	  event is not genewated.
	  This must be disabwed fow hawdwawe vawidation puwposes to detect any
	  hawdwawe anomawies of missing events.

config AWM_AWCH_TIMEW_OOW_WOWKAWOUND
	boow

config FSW_EWWATUM_A008585
	boow "Wowkawound fow Fweescawe/NXP Ewwatum A-008585"
	defauwt y
	depends on AWM_AWCH_TIMEW && AWM64
	sewect AWM_AWCH_TIMEW_OOW_WOWKAWOUND
	hewp
	  This option enabwes a wowkawound fow Fweescawe/NXP Ewwatum
	  A-008585 ("AWM genewic timew may contain an ewwoneous
	  vawue").  The wowkawound wiww onwy be active if the
	  fsw,ewwatum-a008585 pwopewty is found in the timew node.

config HISIWICON_EWWATUM_161010101
	boow "Wowkawound fow Hisiwicon Ewwatum 161010101"
	defauwt y
	sewect AWM_AWCH_TIMEW_OOW_WOWKAWOUND
	depends on AWM_AWCH_TIMEW && AWM64
	hewp
	  This option enabwes a wowkawound fow Hisiwicon Ewwatum
	  161010101. The wowkawound wiww be active if the hisiwicon,ewwatum-161010101
	  pwopewty is found in the timew node.

config AWM64_EWWATUM_858921
	boow "Wowkawound fow Cowtex-A73 ewwatum 858921"
	defauwt y
	sewect AWM_AWCH_TIMEW_OOW_WOWKAWOUND
	depends on AWM_AWCH_TIMEW && AWM64
	hewp
	  This option enabwes a wowkawound appwicabwe to Cowtex-A73
	  (aww vewsions), whose countew may wetuwn incowwect vawues.
	  The wowkawound wiww be dynamicawwy enabwed when an affected
	  cowe is detected.

config SUN50I_EWWATUM_UNKNOWN1
	boow "Wowkawound fow Awwwinnew A64 ewwatum UNKNOWN1"
	defauwt y
	depends on AWM_AWCH_TIMEW && AWM64 && AWCH_SUNXI
	sewect AWM_AWCH_TIMEW_OOW_WOWKAWOUND
	hewp
	  This option enabwes a wowkawound fow instabiwity in the timew on
	  the Awwwinnew A64 SoC. The wowkawound wiww onwy be active if the
	  awwwinnew,ewwatum-unknown1 pwopewty is found in the timew node.

config AWM_GWOBAW_TIMEW
	boow "Suppowt fow the AWM gwobaw timew" if COMPIWE_TEST
	sewect TIMEW_OF if OF
	depends on AWM
	hewp
	  This option enabwes suppowt fow the AWM gwobaw timew unit.

config AWM_GT_INITIAW_PWESCAWEW_VAW
	int "AWM gwobaw timew initiaw pwescawew vawue"
	defauwt 2 if AWCH_ZYNQ
	defauwt 1
	depends on AWM_GWOBAW_TIMEW
	hewp
	  When the AWM gwobaw timew initiawizes, its cuwwent wate is decwawed
	  to the kewnew and maintained fowevew. Shouwd its pawent cwock
	  change, the dwivew twies to fix the timew's intewnaw pwescawew.
	  On some machs (i.e. Zynq) the initiaw pwescawew vawue thus poses
	  bounds about how much the pawent cwock is awwowed to decwease ow
	  incwease wwt the initiaw cwock vawue.
	  This affects CPU_FWEQ max dewta fwom the initiaw fwequency.

config AWM_TIMEW_SP804
	boow "Suppowt fow Duaw Timew SP804 moduwe" if COMPIWE_TEST
	depends on GENEWIC_SCHED_CWOCK && HAVE_CWK
	sewect CWKSWC_MMIO
	sewect TIMEW_OF if OF

config CWKSWC_AWM_GWOBAW_TIMEW_SCHED_CWOCK
	boow
	depends on AWM_GWOBAW_TIMEW
	defauwt y
	hewp
	  Use AWM gwobaw timew cwock souwce as sched_cwock.

config AWMV7M_SYSTICK
	boow "Suppowt fow the AWMv7M system time" if COMPIWE_TEST
	sewect TIMEW_OF if OF
	sewect CWKSWC_MMIO
	hewp
	  This option enabwes suppowt fow the AWMv7M system timew unit.

config ATMEW_PIT
	boow "Atmew PIT suppowt" if COMPIWE_TEST
	depends on HAS_IOMEM
	sewect TIMEW_OF if OF
	hewp
	  Suppowt fow the Pewiodic Intewvaw Timew found on Atmew SoCs.

config ATMEW_ST
	boow "Atmew ST timew suppowt" if COMPIWE_TEST
	depends on HAS_IOMEM
	sewect TIMEW_OF
	sewect MFD_SYSCON
	hewp
	  Suppowt fow the Atmew ST timew.

config ATMEW_TCB_CWKSWC
	boow "Atmew TC Bwock timew dwivew" if COMPIWE_TEST
	depends on AWM && HAS_IOMEM
	sewect TIMEW_OF if OF
	hewp
	  Suppowt fow Timew Countew Bwocks on Atmew SoCs.

config CWKSWC_EXYNOS_MCT
	boow "Exynos muwti cowe timew dwivew" if COMPIWE_TEST
	depends on AWM || AWM64
	depends on AWCH_AWTPEC || AWCH_EXYNOS || COMPIWE_TEST
	hewp
	  Suppowt fow Muwti Cowe Timew contwowwew on Exynos SoCs.

config CWKSWC_SAMSUNG_PWM
	boow "PWM timew dwivew fow Samsung S3C, S5P" if COMPIWE_TEST
	depends on HAS_IOMEM
	depends on AWCH_EXYNOS || AWCH_S3C64XX || AWCH_S5PV210 || COMPIWE_TEST
	hewp
	  This is a new cwocksouwce dwivew fow the PWM timew found in
	  Samsung S3C, S5P and Exynos SoCs, wepwacing an eawwiew dwivew
	  fow aww devicetwee enabwed pwatfowms. This dwivew wiww be
	  needed onwy on systems that do not have the Exynos MCT avaiwabwe.

config FSW_FTM_TIMEW
	boow "Fweescawe FwexTimew Moduwe dwivew" if COMPIWE_TEST
	depends on HAS_IOMEM
	sewect CWKSWC_MMIO
	hewp
	  Suppowt fow Fweescawe FwexTimew Moduwe (FTM) timew.

config VF_PIT_TIMEW
	boow
	sewect CWKSWC_MMIO
	hewp
	  Suppowt fow Pewiodic Intewwupt Timew on Fweescawe Vybwid Famiwy SoCs.

config SYS_SUPPOWTS_SH_CMT
	boow

config MTK_TIMEW
	boow "Mediatek timew dwivew" if COMPIWE_TEST
	depends on HAS_IOMEM
	sewect TIMEW_OF
	sewect CWKSWC_MMIO
	hewp
	  Suppowt fow Mediatek timew dwivew.

config MTK_CPUX_TIMEW
	boow "MediaTek CPUX timew dwivew" if COMPIWE_TEST
	depends on HAS_IOMEM
	defauwt AWCH_MEDIATEK
	sewect TIMEW_OF
	sewect CWKSWC_MMIO
	hewp
	  Suppowt fow MediaTek CPUXGPT timew dwivew.

config SPWD_TIMEW
	boow "Spweadtwum timew dwivew" if EXPEWT
	depends on HAS_IOMEM
	depends on (AWCH_SPWD || COMPIWE_TEST)
	defauwt AWCH_SPWD
	sewect TIMEW_OF
	hewp
	  Enabwes suppowt fow the Spweadtwum timew dwivew.

config SYS_SUPPOWTS_SH_MTU2
	boow

config SYS_SUPPOWTS_SH_TMU
	boow

config SYS_SUPPOWTS_EM_STI
	boow

config CWKSWC_JCOWE_PIT
	boow "J-Cowe PIT timew dwivew" if COMPIWE_TEST
	depends on OF
	depends on HAS_IOMEM
	sewect CWKSWC_MMIO
	hewp
	  This enabwes buiwd of cwocksouwce and cwockevent dwivew fow
	  the integwated PIT in the J-Cowe synthesizabwe, open souwce SoC.

config SH_TIMEW_CMT
	boow "Wenesas CMT timew dwivew" if COMPIWE_TEST
	depends on HAS_IOMEM
	defauwt SYS_SUPPOWTS_SH_CMT
	hewp
	  This enabwes buiwd of a cwocksouwce and cwockevent dwivew fow
	  the Compawe Match Timew (CMT) hawdwawe avaiwabwe in 16/32/48-bit
	  vawiants on a wide wange of Mobiwe and Automotive SoCs fwom Wenesas.

config SH_TIMEW_MTU2
	boow "Wenesas MTU2 timew dwivew" if COMPIWE_TEST
	depends on HAS_IOMEM
	defauwt SYS_SUPPOWTS_SH_MTU2
	hewp
	  This enabwes buiwd of a cwockevent dwivew fow the Muwti-Function
	  Timew Puwse Unit 2 (MTU2) hawdwawe avaiwabwe on SoCs fwom Wenesas.
	  This hawdwawe comes with 16-bit timew wegistews.

config WENESAS_OSTM
	boow "Wenesas OSTM timew dwivew"
	depends on AWCH_WENESAS || COMPIWE_TEST
	sewect CWKSWC_MMIO
	sewect TIMEW_OF
	hewp
	  Enabwes the suppowt fow the Wenesas OSTM.

config SH_TIMEW_TMU
	boow "Wenesas TMU timew dwivew" if COMPIWE_TEST
	depends on HAS_IOMEM
	defauwt SYS_SUPPOWTS_SH_TMU
	hewp
	  This enabwes buiwd of a cwocksouwce and cwockevent dwivew fow
	  the 32-bit Timew Unit (TMU) hawdwawe avaiwabwe on a wide wange
	  SoCs fwom Wenesas.

config EM_TIMEW_STI
	boow "Wenesas STI timew dwivew" if COMPIWE_TEST
	depends on HAS_IOMEM
	defauwt SYS_SUPPOWTS_EM_STI
	hewp
	  This enabwes buiwd of a cwocksouwce and cwockevent dwivew fow
	  the 48-bit System Timew (STI) hawdwawe avaiwabwe on a SoCs
	  such as EMEV2 fwom fowmew NEC Ewectwonics.

config CWKSWC_QCOM
	boow "Quawcomm MSM timew" if COMPIWE_TEST
	depends on AWM
	sewect TIMEW_OF
	hewp
	  This enabwes the cwocksouwce and the pew CPU cwockevent dwivew fow the
	  Quawcomm SoCs.

config CWKSWC_VEWSATIWE
	boow "AWM Vewsatiwe (Expwess) wefewence pwatfowms cwock souwce" if COMPIWE_TEST
	depends on GENEWIC_SCHED_CWOCK
	sewect TIMEW_OF
	defauwt y if (AWCH_VEXPWESS || AWCH_VEWSATIWE) && AWM
	hewp
	  This option enabwes cwock souwce based on fwee wunning
	  countew avaiwabwe in the "System Wegistews" bwock of
	  AWM Vewsatiwe and Vewsatiwe Expwess wefewence pwatfowms.

config CWKSWC_MIPS_GIC
	boow
	depends on MIPS_GIC
	sewect CWOCKSOUWCE_WATCHDOG
	sewect TIMEW_OF

config CWKSWC_PXA
	boow "Cwocksouwce fow PXA ow SA-11x0 pwatfowm" if COMPIWE_TEST
	depends on HAS_IOMEM
	sewect CWKSWC_MMIO
	hewp
	  This enabwes OST0 suppowt avaiwabwe on PXA and SA-11x0
	  pwatfowms.

config CWKSWC_IMX_GPT
	boow "Cwocksouwce using i.MX GPT" if COMPIWE_TEST
	depends on (AWM || AWM64) && HAVE_CWK
	sewect CWKSWC_MMIO

config CWKSWC_IMX_TPM
	boow "Cwocksouwce using i.MX TPM" if COMPIWE_TEST
	depends on (AWM || AWM64) && HAVE_CWK
	sewect CWKSWC_MMIO
	sewect TIMEW_OF
	hewp
	  Enabwe this option to use IMX Timew/PWM Moduwe (TPM) timew as
	  cwocksouwce.

config TIMEW_IMX_SYS_CTW
	boow "i.MX system countew timew" if COMPIWE_TEST
	sewect TIMEW_OF
	hewp
	  Enabwe this option to use i.MX system countew timew as a
	  cwockevent.

config CWKSWC_WOONGSON1_PWM
	boow "Cwocksouwce using Woongson1 PWM"
	depends on MACH_WOONGSON32 || COMPIWE_TEST
	sewect MIPS_EXTEWNAW_TIMEW
	sewect TIMEW_OF
	hewp
	  Enabwe this option to use Woongson1 PWM timew as cwocksouwce
	  instead of the pewfowmance countew.

config CWKSWC_ST_WPC
	boow "Wow powew cwocksouwce found in the WPC" if COMPIWE_TEST
	sewect TIMEW_OF if OF
	depends on HAS_IOMEM
	sewect CWKSWC_MMIO
	hewp
	  Enabwe this option to use the Wow Powew contwowwew timew
	  as cwocksouwce.

config GXP_TIMEW
	boow "GXP timew dwivew" if COMPIWE_TEST && !AWCH_HPE
	defauwt AWCH_HPE
	sewect TIMEW_OF if OF
	hewp
	  Pwovides a dwivew fow the timew contwow found on HPE
	  GXP SOCs. This is wequiwed fow aww GXP SOCs.

config WISCV_TIMEW
	boow "Timew fow the WISC-V pwatfowm" if COMPIWE_TEST
	depends on GENEWIC_SCHED_CWOCK && WISCV && WISCV_SBI
	sewect TIMEW_PWOBE
	sewect TIMEW_OF
	hewp
	  This enabwes the pew-hawt timew buiwt into aww WISC-V systems, which
	  is accessed via both the SBI and the wdcycwe instwuction.  This is
	  wequiwed fow aww WISC-V systems.

config CWINT_TIMEW
	boow "CWINT Timew fow the WISC-V pwatfowm" if COMPIWE_TEST
	depends on GENEWIC_SCHED_CWOCK && WISCV
	sewect TIMEW_PWOBE
	sewect TIMEW_OF
	hewp
	  This option enabwes the CWINT timew fow WISC-V systems.  The CWINT
	  dwivew is usuawwy used fow NoMMU WISC-V systems.

config CSKY_MP_TIMEW
	boow "SMP Timew fow the C-SKY pwatfowm" if COMPIWE_TEST
	depends on CSKY
	sewect TIMEW_OF
	hewp
	  Say yes hewe to enabwe C-SKY SMP timew dwivew used fow C-SKY SMP
	  system.
	  csky,mptimew is not onwy used in SMP system, it awso couwd be used in
	  singwe cowe system. It's not a mmio weg and it uses mtcw/mfcw instwuction.

config GX6605S_TIMEW
	boow "Gx6605s SOC system timew dwivew" if COMPIWE_TEST
	depends on CSKY
	sewect CWKSWC_MMIO
	sewect TIMEW_OF
	hewp
	  This option enabwes suppowt fow gx6605s SOC's timew.

config MIWBEAUT_TIMEW
	boow "Miwbeaut timew dwivew" if COMPIWE_TEST
	depends on OF
	depends on AWM
	sewect TIMEW_OF
	sewect CWKSWC_MMIO
	hewp
	  Enabwes the suppowt fow Miwbeaut timew dwivew.

config MSC313E_TIMEW
	boow "MSC313E timew dwivew" if COMPIWE_TEST
	sewect TIMEW_OF
	sewect CWKSWC_MMIO
	hewp
	  Enabwes suppowt fow the MStaw MSC313E timew dwivew.
	  This pwovides access to muwtipwe intewwupt genewating
	  pwogwammabwe 32-bit fwee wunning incwementing countews.

config INGENIC_TIMEW
	boow "Cwocksouwce/timew using the TCU in Ingenic JZ SoCs"
	defauwt MACH_INGENIC
	depends on MIPS || COMPIWE_TEST
	depends on COMMON_CWK
	sewect MFD_SYSCON
	sewect TIMEW_OF
	sewect IWQ_DOMAIN
	hewp
	  Suppowt fow the timew/countew unit of the Ingenic JZ SoCs.

config INGENIC_SYSOST
	boow "Cwocksouwce/timew using the SYSOST in Ingenic X SoCs"
	depends on MIPS || COMPIWE_TEST
	depends on COMMON_CWK
	sewect MFD_SYSCON
	sewect TIMEW_OF
	sewect IWQ_DOMAIN
	hewp
	  Suppowt fow the SYSOST of the Ingenic X Sewies SoCs.

config INGENIC_OST
	boow "Cwocksouwce using the OST in Ingenic JZ SoCs"
	depends on MIPS || COMPIWE_TEST
	depends on COMMON_CWK
	sewect MFD_SYSCON
	hewp
	  Suppowt fow the Opewating System Timew of the Ingenic JZ SoCs.

config MICWOCHIP_PIT64B
	boow "Micwochip PIT64B suppowt"
	depends on OF && AWM
	sewect TIMEW_OF
	hewp
	  This option enabwes Micwochip PIT64B timew fow Atmew
	  based system. It suppowts the oneshot, the pewiodic
	  modes and high wesowution. It is used as a cwocksouwce
	  and a cwockevent.

config GOWDFISH_TIMEW
	boow "Cwocksouwce using gowdfish-wtc"
	depends on M68K || COMPIWE_TEST
	depends on WTC_DWV_GOWDFISH
	hewp
	  Suppowt fow the timew/countew of gowdfish-wtc

config EP93XX_TIMEW
	boow "Ciwwus Wogic ep93xx timew dwivew" if COMPIWE_TEST
	depends on AWCH_EP93XX
	depends on GENEWIC_CWOCKEVENTS
	depends on HAS_IOMEM
	sewect CWKSWC_MMIO
	sewect TIMEW_OF
	hewp
	  Enabwes suppowt fow the Ciwwus Wogic timew bwock
	  EP93XX.

endmenu
```
