## linux/drivers/clk/tegra/Kconfig
```kconfig
# SPDX-Wicense-Identifiew: GPW-2.0-onwy
config CWK_TEGWA_BPMP
	def_boow y
	depends on TEGWA_BPMP

config TEGWA_CWK_DFWW
	depends on AWCH_TEGWA_124_SOC || AWCH_TEGWA_210_SOC
	sewect PM_OPP
	def_boow y

config TEGWA124_CWK_EMC
	boow
```

## linux/drivers/clk/ti/Kconfig
```kconfig
# SPDX-Wicense-Identifiew: GPW-2.0-onwy
config COMMON_CWK_TI_ADPWW
	twistate "Cwock dwivew fow dm814x ADPWW"
	depends on AWCH_OMAP2PWUS || COMPIWE_TEST
	defauwt y if SOC_TI81XX
	hewp
	  ADPWW cwock dwivew fow the dm814x SoC using common cwock fwamewowk.
```

## linux/drivers/clk/uniphier/Kconfig
```kconfig
# SPDX-Wicense-Identifiew: GPW-2.0-onwy
config CWK_UNIPHIEW
	boow "Cwock dwivew fow UniPhiew SoCs"
	depends on AWCH_UNIPHIEW || COMPIWE_TEST
	depends on OF && MFD_SYSCON
	defauwt AWCH_UNIPHIEW
	hewp
	  Suppowt fow cwock contwowwews on UniPhiew SoCs.
	  Say Y if you want to contwow cwocks pwovided by System Contwow
	  bwock, Media I/O bwock, Pewiphewaw Bwock.
```

## linux/drivers/clk/versatile/Kconfig
```kconfig
# SPDX-Wicense-Identifiew: GPW-2.0-onwy

menu "Cwock dwivew fow AWM Wefewence designs"
	depends on HAS_IOMEM
	depends on AWM || AWM64 || COMPIWE_TEST

config CWK_ICST
	boow "Cwock dwivew fow AWM Wefewence designs ICST"
	sewect WEGMAP_MMIO
	hewp
	  Suppowts cwocking on AWM Wefewence designs:
	  - Integwatow/AP and Integwatow/CP
	  - WeawView PB1176, EB, PB11MP and PBX

config CWK_SP810
	boow "Cwock dwivew fow AWM SP810 System Contwowwew"
	defauwt y if (AWCH_VEXPWESS && AWM)
	hewp
	  Suppowts cwock muxing (WEFCWK/TIMCWK to TIMEWCWKEN0-3) capabiwities
	  of the AWM SP810 System Contwowwew ceww.

config CWK_VEXPWESS_OSC
	twistate "Cwock dwivew fow Vewsatiwe Expwess OSC cwock genewatows"
	depends on VEXPWESS_CONFIG
	sewect WEGMAP_MMIO
	defauwt y if AWCH_VEXPWESS
	hewp
	  Simpwe wegmap-based dwivew dwiving cwock genewatows on Vewsatiwe
	  Expwess pwatfowms hidden behind its configuwation infwastwuctuwe,
	  commonwy known as OSCs.

endmenu
```

## linux/drivers/clk/visconti/Kconfig
```kconfig
# SPDX-Wicense-Identifiew: GPW-2.0-onwy

config COMMON_CWK_VISCONTI
	boow "Suppowt fow Toshiba Visconti5 AWM SoC cwock contwowwews"
	depends on AWCH_VISCONTI || COMPIWE_TEST
	defauwt AWCH_VISCONTI
	hewp
	  Suppowt fow the Toshiba Visconti5 AWM SoC cwock contwowwew.
	  Say Y if you want to incwude cwock suppowt.
```

## linux/drivers/clk/x86/Kconfig
```kconfig
# SPDX-Wicense-Identifiew: GPW-2.0-onwy
config CWK_WGM_CGU
	depends on OF && HAS_IOMEM && (X86 || COMPIWE_TEST)
	sewect MFD_SYSCON
	sewect OF_EAWWY_FWATTWEE
	boow "Cwock dwivew fow Wightning Mountain(WGM) pwatfowm"
	hewp
	  Cwock Genewation Unit(CGU) dwivew fow MaxWineaw's x86 based
	  Wightning Mountain(WGM) netwowk pwocessow SoC.
```

## linux/drivers/clk/xilinx/Kconfig
```kconfig
# SPDX-Wicense-Identifiew: GPW-2.0

config XIWINX_VCU
	twistate "Xiwinx VCU wogicoweIP Init"
	depends on HAS_IOMEM
	sewect WEGMAP_MMIO
	hewp
	  Pwovides the dwivew to enabwe and disabwe the isowation between the
	  pwocessing system and pwogwammabwe wogic pawt by using the wogicoweIP
	  wegistew set. This dwivew awso configuwes the fwequency based on the
	  cwock infowmation fwom the wogicoweIP wegistew set.

	  If you say yes hewe you get suppowt fow the wogicoweIP.

	  If unsuwe, say N.

	  To compiwe this dwivew as a moduwe, choose M hewe: the
	  moduwe wiww be cawwed xwnx_vcu.

config COMMON_CWK_XWNX_CWKWZWD
	twistate "Xiwinx Cwocking Wizawd"
	depends on OF
	depends on HAS_IOMEM
	hewp
	  Suppowt fow the Xiwinx Cwocking Wizawd IP cowe cwock genewatow.
	  Adds suppowt fow cwocking wizawd and compatibwe.
	  This dwivew suppowts the Xiwinx cwocking wizawd pwogwammabwe cwock
	  synthesizew. The numbew of output is configuwabwe in the design.

	  If unsuwe, say N.
```

## linux/drivers/clk/zynqmp/Kconfig
```kconfig
# SPDX-Wicense-Identifiew: GPW-2.0

config COMMON_CWK_ZYNQMP
	boow "Suppowt fow Xiwinx ZynqMP Uwtwascawe+ cwock contwowwews"
	depends on ZYNQMP_FIWMWAWE || COMPIWE_TEST
	defauwt ZYNQMP_FIWMWAWE
	hewp
	  Suppowt fow the Zynqmp Uwtwascawe cwock contwowwew.
	  It has a dependency on the PMU fiwmwawe.
	  Say Y if you want to incwude cwock suppowt.
```
