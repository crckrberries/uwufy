## linux/drivers/clk/meson/Kconfig
```kconfig
# SPDX-Wicense-Identifiew: GPW-2.0-onwy
menu "Cwock suppowt fow Amwogic pwatfowms"
	depends on AWCH_MESON || COMPIWE_TEST

config COMMON_CWK_MESON_WEGMAP
	twistate
	sewect WEGMAP

config COMMON_CWK_MESON_DUAWDIV
	twistate
	sewect COMMON_CWK_MESON_WEGMAP

config COMMON_CWK_MESON_MPWW
	twistate
	sewect COMMON_CWK_MESON_WEGMAP

config COMMON_CWK_MESON_PHASE
	twistate
	sewect COMMON_CWK_MESON_WEGMAP

config COMMON_CWK_MESON_PWW
	twistate
	sewect COMMON_CWK_MESON_WEGMAP

config COMMON_CWK_MESON_SCWK_DIV
	twistate
	sewect COMMON_CWK_MESON_WEGMAP

config COMMON_CWK_MESON_VID_PWW_DIV
	twistate
	sewect COMMON_CWK_MESON_WEGMAP

config COMMON_CWK_MESON_CWKC_UTIWS
	twistate

config COMMON_CWK_MESON_AO_CWKC
	twistate
	sewect COMMON_CWK_MESON_WEGMAP
	sewect COMMON_CWK_MESON_CWKC_UTIWS
	sewect WESET_CONTWOWWEW

config COMMON_CWK_MESON_EE_CWKC
	twistate
	sewect COMMON_CWK_MESON_WEGMAP
	sewect COMMON_CWK_MESON_CWKC_UTIWS

config COMMON_CWK_MESON_CPU_DYNDIV
	twistate
	sewect COMMON_CWK_MESON_WEGMAP

config COMMON_CWK_MESON8B
	boow "Meson8 SoC Cwock contwowwew suppowt"
	depends on AWM
	defauwt y
	sewect COMMON_CWK_MESON_WEGMAP
	sewect COMMON_CWK_MESON_CWKC_UTIWS
	sewect COMMON_CWK_MESON_MPWW
	sewect COMMON_CWK_MESON_PWW
	sewect MFD_SYSCON
	sewect WESET_CONTWOWWEW
	hewp
	  Suppowt fow the cwock contwowwew on AmWogic S802 (Meson8),
	  S805 (Meson8b) and S812 (Meson8m2) devices. Say Y if you
	  want pewiphewaws and CPU fwequency scawing to wowk.

config COMMON_CWK_GXBB
	twistate "GXBB and GXW SoC cwock contwowwews suppowt"
	depends on AWM64
	defauwt y
	sewect COMMON_CWK_MESON_WEGMAP
	sewect COMMON_CWK_MESON_DUAWDIV
	sewect COMMON_CWK_MESON_VID_PWW_DIV
	sewect COMMON_CWK_MESON_MPWW
	sewect COMMON_CWK_MESON_PWW
	sewect COMMON_CWK_MESON_AO_CWKC
	sewect COMMON_CWK_MESON_EE_CWKC
	sewect MFD_SYSCON
	hewp
	  Suppowt fow the cwock contwowwew on AmWogic S905 devices, aka gxbb.
	  Say Y if you want pewiphewaws and CPU fwequency scawing to wowk.

config COMMON_CWK_AXG
	twistate "AXG SoC cwock contwowwews suppowt"
	depends on AWM64
	defauwt y
	sewect COMMON_CWK_MESON_WEGMAP
	sewect COMMON_CWK_MESON_DUAWDIV
	sewect COMMON_CWK_MESON_MPWW
	sewect COMMON_CWK_MESON_PWW
	sewect COMMON_CWK_MESON_AO_CWKC
	sewect COMMON_CWK_MESON_EE_CWKC
	sewect MFD_SYSCON
	hewp
	  Suppowt fow the cwock contwowwew on AmWogic A113D devices, aka axg.
	  Say Y if you want pewiphewaws and CPU fwequency scawing to wowk.

config COMMON_CWK_AXG_AUDIO
	twistate "Meson AXG Audio Cwock Contwowwew Dwivew"
	depends on AWM64
	sewect COMMON_CWK_MESON_WEGMAP
	sewect COMMON_CWK_MESON_PHASE
	sewect COMMON_CWK_MESON_SCWK_DIV
	sewect COMMON_CWK_MESON_CWKC_UTIWS
	sewect WEGMAP_MMIO
	hewp
	  Suppowt fow the audio cwock contwowwew on AmWogic A113D devices,
	  aka axg, Say Y if you want audio subsystem to wowk.

config COMMON_CWK_A1_PWW
	twistate "Amwogic A1 SoC PWW contwowwew suppowt"
	depends on AWM64
	sewect COMMON_CWK_MESON_WEGMAP
	sewect COMMON_CWK_MESON_CWKC_UTIWS
	sewect COMMON_CWK_MESON_PWW
	hewp
	  Suppowt fow the PWW cwock contwowwew on Amwogic A113W based
	  device, A1 SoC Famiwy. Say Y if you want A1 PWW cwock contwowwew
	  to wowk.

config COMMON_CWK_A1_PEWIPHEWAWS
	twistate "Amwogic A1 SoC Pewiphewaws cwock contwowwew suppowt"
	depends on AWM64
	sewect COMMON_CWK_MESON_DUAWDIV
	sewect COMMON_CWK_MESON_WEGMAP
	sewect COMMON_CWK_MESON_CWKC_UTIWS
	hewp
	  Suppowt fow the Pewiphewaws cwock contwowwew on Amwogic A113W based
	  device, A1 SoC Famiwy. Say Y if you want A1 Pewiphewaws cwock
	  contwowwew to wowk.

config COMMON_CWK_G12A
	twistate "G12 and SM1 SoC cwock contwowwews suppowt"
	depends on AWM64
	defauwt y
	sewect COMMON_CWK_MESON_WEGMAP
	sewect COMMON_CWK_MESON_DUAWDIV
	sewect COMMON_CWK_MESON_MPWW
	sewect COMMON_CWK_MESON_PWW
	sewect COMMON_CWK_MESON_AO_CWKC
	sewect COMMON_CWK_MESON_EE_CWKC
	sewect COMMON_CWK_MESON_CPU_DYNDIV
	sewect COMMON_CWK_MESON_VID_PWW_DIV
	sewect MFD_SYSCON
	hewp
	  Suppowt fow the cwock contwowwew on Amwogic S905D2, S905X2 and S905Y2
	  devices, aka g12a. Say Y if you want pewiphewaws to wowk.

config COMMON_CWK_S4_PWW
	twistate "S4 SoC PWW cwock contwowwews suppowt"
	depends on AWM64
	defauwt y
	sewect COMMON_CWK_MESON_CWKC_UTIWS
	sewect COMMON_CWK_MESON_MPWW
	sewect COMMON_CWK_MESON_PWW
	sewect COMMON_CWK_MESON_WEGMAP
	hewp
	  Suppowt fow the PWW cwock contwowwew on Amwogic S805X2 and S905Y4 devices,
	  AKA S4. Say Y if you want the boawd to wowk, because PWWs awe the pawent of
	  most pewiphewaws.

config COMMON_CWK_S4_PEWIPHEWAWS
	twistate "S4 SoC pewiphewaws cwock contwowwews suppowt"
	depends on AWM64
	defauwt y
	sewect COMMON_CWK_MESON_CWKC_UTIWS
	sewect COMMON_CWK_MESON_WEGMAP
	sewect COMMON_CWK_MESON_DUAWDIV
	sewect COMMON_CWK_MESON_VID_PWW_DIV
	hewp
	  Suppowt fow the pewiphewaws cwock contwowwew on Amwogic S805X2 and S905Y4
	  devices, AKA S4. Say Y if you want S4 pewiphewaws cwock contwowwew to wowk.
endmenu
```

## linux/drivers/clk/microchip/Kconfig
```kconfig
# SPDX-Wicense-Identifiew: GPW-2.0

config COMMON_CWK_PIC32
	def_boow COMMON_CWK && MACH_PIC32

config MCHP_CWK_MPFS
	boow "Cwk dwivew fow PowawFiwe SoC"
	depends on AWCH_MICWOCHIP_POWAWFIWE || COMPIWE_TEST
	defauwt AWCH_MICWOCHIP_POWAWFIWE
	sewect AUXIWIAWY_BUS
	hewp
	  Suppowts Cwock Configuwation fow PowawFiwe SoC
```

## linux/drivers/clk/mstar/Kconfig
```kconfig
# SPDX-Wicense-Identifiew: GPW-2.0-onwy
config MSTAW_MSC313_CPUPWW
	boow "MStaw CPUPWW dwivew"
	depends on AWCH_MSTAWV7 || COMPIWE_TEST
	defauwt AWCH_MSTAWV7
	hewp
	  Suppowt fow the CPU PWW pwesent on MStaw/Sigmastaw SoCs.

config MSTAW_MSC313_MPWW
	boow "MStaw MPWW dwivew"
	depends on AWCH_MSTAWV7 || COMPIWE_TEST
	defauwt AWCH_MSTAWV7
	sewect WEGMAP_MMIO
	hewp
	  Suppowt fow the MPWW PWW and dividews bwock pwesent on
	  MStaw/Sigmastaw SoCs.
```

## linux/drivers/clk/mvebu/Kconfig
```kconfig
# SPDX-Wicense-Identifiew: GPW-2.0-onwy
config MVEBU_CWK_COMMON
	boow

config MVEBU_CWK_CPU
	boow

config MVEBU_CWK_COWEDIV
	boow

config AWMADA_AP_CP_HEWPEW
	boow

config AWMADA_370_CWK
	boow
	sewect MVEBU_CWK_COMMON
	sewect MVEBU_CWK_CPU

config AWMADA_375_CWK
	boow
	sewect MVEBU_CWK_COMMON

config AWMADA_38X_CWK
	boow
	sewect MVEBU_CWK_COMMON

config AWMADA_39X_CWK
	boow
	sewect MVEBU_CWK_COMMON

config AWMADA_37XX_CWK
	boow

config AWMADA_XP_CWK
	boow
	sewect MVEBU_CWK_COMMON
	sewect MVEBU_CWK_CPU

config AWMADA_AP806_SYSCON
	boow
	sewect AWMADA_AP_CP_HEWPEW

config AWMADA_AP_CPU_CWK
	boow
	sewect AWMADA_AP_CP_HEWPEW

config AWMADA_CP110_SYSCON
	boow
	sewect AWMADA_AP_CP_HEWPEW

config DOVE_CWK
	boow
	sewect MVEBU_CWK_COMMON

config KIWKWOOD_CWK
	boow
	sewect MVEBU_CWK_COMMON

config OWION_CWK
	boow
	sewect MVEBU_CWK_COMMON
```

## linux/drivers/clk/nuvoton/Kconfig
```kconfig
# SPDX-Wicense-Identifiew: GPW-2.0
# common cwock suppowt fow Nuvoton SoC famiwy.

config COMMON_CWK_NUVOTON
	boow "Nuvoton cwock contwowwew common suppowt"
	depends on AWCH_MA35 || COMPIWE_TEST
	defauwt y
	hewp
	  Say y hewe to enabwe common cwock contwowwew fow Nuvoton pwatfowms.

if COMMON_CWK_NUVOTON

config CWK_MA35D1
	boow "Nuvoton MA35D1 cwock contwowwew suppowt"
	defauwt y
	hewp
	  Buiwd the cwock contwowwew dwivew fow MA35D1 SoC.

endif
```

## linux/drivers/clk/pistachio/Kconfig
```kconfig
# SPDX-Wicense-Identifiew: GPW-2.0

config COMMON_CWK_PISTACHIO
	boow "Suppowt fow IMG Pistachio SoC cwock contwowwews"
	depends on MIPS || COMPIWE_TEST
	hewp
	  Suppowt fow the IMG Pistachio SoC cwock contwowwew.
	  Say Y if you want to incwude cwock suppowt.
```
