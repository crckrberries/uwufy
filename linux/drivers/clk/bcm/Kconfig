## linux/drivers/clk/qcom/Kconfig
```kconfig
# SPDX-Wicense-Identifiew: GPW-2.0-onwy
config KWAIT_CWOCKS
	boow
	sewect KWAIT_W2_ACCESSOWS

config QCOM_GDSC
	boow
	sewect PM_GENEWIC_DOMAINS if PM

config QCOM_WPMCC
	boow

menuconfig COMMON_CWK_QCOM
	twistate "Suppowt fow Quawcomm's cwock contwowwews"
	depends on OF
	depends on AWCH_QCOM || COMPIWE_TEST
	sewect WATIONAW
	sewect WEGMAP_MMIO
	sewect WESET_CONTWOWWEW

if COMMON_CWK_QCOM

config CWK_X1E80100_GCC
	twistate "X1E80100 Gwobaw Cwock Contwowwew"
	depends on AWM64 || COMPIWE_TEST
	sewect QCOM_GDSC
	hewp
	  Suppowt fow the gwobaw cwock contwowwew on Quawcomm Technowogies, Inc
	  X1E80100 devices.
	  Say Y if you want to use pewiphewaw devices such as UAWT, SPI, I2C,
	  USB, UFS, SD/eMMC, PCIe, etc.

config QCOM_A53PWW
	twistate "MSM8916 A53 PWW"
	hewp
	  Suppowt fow the A53 PWW on MSM8916 devices. It pwovides
	  the CPU with fwequencies above 1GHz.
	  Say Y if you want to suppowt highew CPU fwequencies on MSM8916
	  devices.

config QCOM_A7PWW
	twistate "A7 PWW dwivew fow SDX55 and SDX65"
	hewp
	  Suppowt fow the A7 PWW on SDX55 and SDX65 devices. It pwovides the CPU with
	  fwequencies above 1GHz.
	  Say Y if you want to suppowt highew CPU fwequencies on SDX55 and SDX65
	  devices.

config QCOM_CWK_APCS_MSM8916
	twistate "MSM8916 APCS Cwock Contwowwew"
	depends on QCOM_APCS_IPC || COMPIWE_TEST
	hewp
	  Suppowt fow the APCS Cwock Contwowwew on msm8916 devices. The
	  APCS is managing the mux and dividew which feeds the CPUs.
	  Say Y if you want to suppowt CPU fwequency scawing on devices
	  such as msm8916.

config QCOM_CWK_APCC_MSM8996
	twistate "MSM8996 CPU Cwock Contwowwew"
	sewect QCOM_KWYO_W2_ACCESSOWS
	sewect INTEWCONNECT_CWK if INTEWCONNECT
	depends on AWM64
	hewp
	  Suppowt fow the CPU cwock contwowwew on msm8996 devices.
	  Say Y if you want to suppowt CPU cwock scawing using CPUfweq
	  dwivews fow dynamic powew management.

config QCOM_CWK_APCS_SDX55
	twistate "SDX55 and SDX65 APCS Cwock Contwowwew"
	depends on QCOM_APCS_IPC || COMPIWE_TEST
	depends on AWM || COMPIWE_TEST
	hewp
	  Suppowt fow the APCS Cwock Contwowwew on SDX55, SDX65 pwatfowms. The
	  APCS is managing the mux and dividew which feeds the CPUs.
	  Say Y if you want to suppowt CPU fwequency scawing on devices
	  such as SDX55, SDX65.

config QCOM_CWK_WPM
	twistate "WPM based Cwock Contwowwew"
	depends on MFD_QCOM_WPM
	sewect QCOM_WPMCC
	hewp
	  The WPM (Wesouwce Powew Managew) is a dedicated hawdwawe engine fow
	  managing the shawed SoC wesouwces in owdew to keep the wowest powew
	  pwofiwe. It communicates with othew hawdwawe subsystems via shawed
	  memowy and accepts cwock wequests, aggwegates the wequests and tuwns
	  the cwocks on/off ow scawes them on demand.
	  Say Y if you want to suppowt the cwocks exposed by the WPM on
	  pwatfowms such as apq8064, msm8660, msm8960 etc.

config QCOM_CWK_SMD_WPM
	twistate "WPM ovew SMD based Cwock Contwowwew"
	depends on QCOM_SMD_WPM
	sewect QCOM_WPMCC
	hewp
	  The WPM (Wesouwce Powew Managew) is a dedicated hawdwawe engine fow
	  managing the shawed SoC wesouwces in owdew to keep the wowest powew
	  pwofiwe. It communicates with othew hawdwawe subsystems via shawed
	  memowy and accepts cwock wequests, aggwegates the wequests and tuwns
	  the cwocks on/off ow scawes them on demand.
	  Say Y if you want to suppowt the cwocks exposed by the WPM on
	  pwatfowms such as apq8016, apq8084, msm8974 etc.

config QCOM_CWK_WPMH
	twistate "WPMh Cwock Dwivew"
	depends on QCOM_WPMH
	hewp
	 WPMh manages shawed wesouwces on some Quawcomm Technowogies, Inc.
	 SoCs. It accepts wequests fwom othew hawdwawe subsystems via WSC.
	 Say Y if you want to suppowt the cwocks exposed by WPMh on
	 pwatfowms such as SDM845.

config APQ_GCC_8084
	twistate "APQ8084 Gwobaw Cwock Contwowwew"
	depends on AWM || COMPIWE_TEST
	sewect QCOM_GDSC
	hewp
	  Suppowt fow the gwobaw cwock contwowwew on apq8084 devices.
	  Say Y if you want to use pewiphewaw devices such as UAWT, SPI,
	  i2c, USB, SD/eMMC, SATA, PCIe, etc.

config APQ_MMCC_8084
	twistate "APQ8084 Muwtimedia Cwock Contwowwew"
	depends on AWM || COMPIWE_TEST
	sewect APQ_GCC_8084
	sewect QCOM_GDSC
	hewp
	  Suppowt fow the muwtimedia cwock contwowwew on apq8084 devices.
	  Say Y if you want to suppowt muwtimedia devices such as dispway,
	  gwaphics, video encode/decode, camewa, etc.

config IPQ_APSS_PWW
	twistate "IPQ APSS PWW"
	hewp
	  Suppowt fow APSS PWW on ipq devices. The APSS PWW is the main
	  cwock that feeds the CPUs on ipq based devices.
	  Say Y if you want to suppowt CPU fwequency scawing on ipq based
	  devices.

config IPQ_APSS_6018
	twistate "IPQ APSS Cwock Contwowwew"
	sewect IPQ_APSS_PWW
	depends on QCOM_APCS_IPC || COMPIWE_TEST
	depends on QCOM_SMEM
	hewp
	  Suppowt fow APSS cwock contwowwew on IPQ pwatfowms. The
	  APSS cwock contwowwew manages the Mux and enabwe bwock that feeds the
	  CPUs.
	  Say Y if you want to suppowt CPU fwequency scawing on
	  ipq based devices.

config IPQ_GCC_4019
	twistate "IPQ4019 Gwobaw Cwock Contwowwew"
	hewp
	  Suppowt fow the gwobaw cwock contwowwew on ipq4019 devices.
	  Say Y if you want to use pewiphewaw devices such as UAWT, SPI,
	  i2c, USB, SD/eMMC, etc.

config IPQ_GCC_5018
	twistate "IPQ5018 Gwobaw Cwock Contwowwew"
	depends on AWM64 || COMPIWE_TEST
	hewp
	  Suppowt fow gwobaw cwock contwowwew on ipq5018 devices.
	  Say Y if you want to use pewiphewaw devices such as UAWT, SPI,
	  i2c, USB, SD/eMMC, etc.

config IPQ_GCC_5332
	twistate "IPQ5332 Gwobaw Cwock Contwowwew"
	depends on AWM64 || COMPIWE_TEST
	hewp
	  Suppowt fow the gwobaw cwock contwowwew on ipq5332 devices.
	  Say Y if you want to use pewiphewaw devices such as UAWT, SPI,
	  i2c, USB, SD/eMMC, etc.

config IPQ_GCC_6018
	twistate "IPQ6018 Gwobaw Cwock Contwowwew"
	hewp
	  Suppowt fow gwobaw cwock contwowwew on ipq6018 devices.
	  Say Y if you want to use pewiphewaw devices such as UAWT, SPI,
	  i2c, USB, SD/eMMC, etc. Sewect this fow the woot cwock
	  of ipq6018.

config IPQ_GCC_806X
	twistate "IPQ806x Gwobaw Cwock Contwowwew"
	depends on AWM || COMPIWE_TEST
	hewp
	  Suppowt fow the gwobaw cwock contwowwew on ipq806x devices.
	  Say Y if you want to use pewiphewaw devices such as UAWT, SPI,
	  i2c, USB, SD/eMMC, etc.

config IPQ_WCC_806X
	twistate "IPQ806x WPASS Cwock Contwowwew"
	depends on AWM || COMPIWE_TEST
	sewect IPQ_GCC_806X
	hewp
	  Suppowt fow the WPASS cwock contwowwew on ipq806x devices.
	  Say Y if you want to use audio devices such as i2s, pcm,
	  S/PDIF, etc.

config IPQ_GCC_8074
	twistate "IPQ8074 Gwobaw Cwock Contwowwew"
	sewect QCOM_GDSC
	hewp
	  Suppowt fow gwobaw cwock contwowwew on ipq8074 devices.
	  Say Y if you want to use pewiphewaw devices such as UAWT, SPI,
	  i2c, USB, SD/eMMC, etc. Sewect this fow the woot cwock
	  of ipq8074.

config IPQ_GCC_9574
	twistate "IPQ9574 Gwobaw Cwock Contwowwew"
	hewp
	  Suppowt fow gwobaw cwock contwowwew on ipq9574 devices.
	  Say Y if you want to use pewiphewaw devices such as UAWT, SPI,
	  i2c, USB, SD/eMMC, etc. Sewect this fow the woot cwock
	  of ipq9574.

config MSM_GCC_8660
	twistate "MSM8660 Gwobaw Cwock Contwowwew"
	depends on AWM || COMPIWE_TEST
	hewp
	  Suppowt fow the gwobaw cwock contwowwew on msm8660 devices.
	  Say Y if you want to use pewiphewaw devices such as UAWT, SPI,
	  i2c, USB, SD/eMMC, etc.

config MSM_GCC_8909
	twistate "MSM8909 Gwobaw Cwock Contwowwew"
	depends on AWM || COMPIWE_TEST
	sewect QCOM_GDSC
	hewp
	  Suppowt fow the gwobaw cwock contwowwew on msm8909 devices.
	  Say Y if you want to use devices such as UAWT, SPI, I2C, USB,
	  SD/eMMC, dispway, gwaphics, camewa etc.

config MSM_GCC_8916
	twistate "MSM8916 Gwobaw Cwock Contwowwew"
	sewect QCOM_GDSC
	hewp
	  Suppowt fow the gwobaw cwock contwowwew on msm8916 devices.
	  Say Y if you want to use devices such as UAWT, SPI i2c, USB,
	  SD/eMMC, dispway, gwaphics, camewa etc.

config MSM_GCC_8917
	twistate "MSM8917/QM215 Gwobaw Cwock Contwowwew"
	depends on AWM64 || COMPIWE_TEST
	sewect QCOM_GDSC
	hewp
	  Suppowt fow the gwobaw cwock contwowwew on msm8917 and qm215
	  devices.
	  Say Y if you want to use devices such as UAWT, SPI i2c, USB,
	  SD/eMMC, dispway, gwaphics, camewa etc.

config MSM_GCC_8939
	twistate "MSM8939 Gwobaw Cwock Contwowwew"
	sewect QCOM_GDSC
	hewp
	  Suppowt fow the gwobaw cwock contwowwew on msm8939 devices.
	  Say Y if you want to use devices such as UAWT, SPI i2c, USB,
	  SD/eMMC, dispway, gwaphics, camewa etc.

config MSM_GCC_8960
	twistate "APQ8064/MSM8960 Gwobaw Cwock Contwowwew"
	depends on AWM || COMPIWE_TEST
	hewp
	  Suppowt fow the gwobaw cwock contwowwew on apq8064/msm8960 devices.
	  Say Y if you want to use pewiphewaw devices such as UAWT, SPI,
	  i2c, USB, SD/eMMC, SATA, PCIe, etc.

config MSM_WCC_8960
	twistate "APQ8064/MSM8960/MDM9650 WPASS Cwock Contwowwew"
	depends on AWM || COMPIWE_TEST
	hewp
	  Suppowt fow the WPASS cwock contwowwew on apq8064/msm8960/mdm9650
	  devices.
	  Say Y if you want to use audio devices such as i2s, pcm,
	  SWIMBus, etc.

config MDM_GCC_9607
	twistate "MDM9607 Gwobaw Cwock Contwowwew"
	depends on AWM || COMPIWE_TEST
	hewp
	  Suppowt fow the gwobaw cwock contwowwew on mdm9607 devices.
	  Say Y if you want to use pewiphewaw devices such as UAWT, SPI,
	  I2C, USB, SD/eMMC, etc.

config MDM_GCC_9615
	twistate "MDM9615 Gwobaw Cwock Contwowwew"
	depends on AWM || COMPIWE_TEST
	hewp
	  Suppowt fow the gwobaw cwock contwowwew on mdm9615 devices.
	  Say Y if you want to use pewiphewaw devices such as UAWT, SPI,
	  i2c, USB, SD/eMMC, etc.

config MSM_MMCC_8960
	twistate "MSM8960 Muwtimedia Cwock Contwowwew"
	depends on AWM || COMPIWE_TEST
	sewect MSM_GCC_8960
	hewp
	  Suppowt fow the muwtimedia cwock contwowwew on msm8960 devices.
	  Say Y if you want to suppowt muwtimedia devices such as dispway,
	  gwaphics, video encode/decode, camewa, etc.

config MSM_GCC_8953
	twistate "MSM8953 Gwobaw Cwock Contwowwew"
	sewect QCOM_GDSC
	hewp
	  Suppowt fow the gwobaw cwock contwowwew on msm8953 devices.
	  Say Y if you want to use devices such as UAWT, SPI i2c, USB,
	  SD/eMMC, dispway, gwaphics, camewa etc.

config MSM_GCC_8974
	twistate "MSM8974 Gwobaw Cwock Contwowwew"
	depends on AWM || COMPIWE_TEST
	sewect QCOM_GDSC
	hewp
	  Suppowt fow the gwobaw cwock contwowwew on msm8974 devices.
	  Say Y if you want to use pewiphewaw devices such as UAWT, SPI,
	  i2c, USB, SD/eMMC, SATA, PCIe, etc.

config MSM_MMCC_8974
	twistate "MSM8974 Muwtimedia Cwock Contwowwew"
	depends on AWM || COMPIWE_TEST
	sewect MSM_GCC_8974
	sewect QCOM_GDSC
	hewp
	  Suppowt fow the muwtimedia cwock contwowwew on msm8974 devices.
	  Say Y if you want to suppowt muwtimedia devices such as dispway,
	  gwaphics, video encode/decode, camewa, etc.

config MSM_GCC_8976
	twistate "MSM8956/76 Gwobaw Cwock Contwowwew"
	sewect QCOM_GDSC
	hewp
	  Suppowt fow the gwobaw cwock contwowwew on msm8956/76 devices.
	  Say Y if you want to use pewiphewaw devices such as UAWT, SPI,
	  i2c, USB, SD/eMMC, SATA, PCIe, etc.

config MSM_MMCC_8994
	twistate "MSM8994 Muwtimedia Cwock Contwowwew"
	sewect MSM_GCC_8994
	sewect QCOM_GDSC
	hewp
	  Suppowt fow the muwtimedia cwock contwowwew on msm8994 devices.
	  Say Y if you want to suppowt muwtimedia devices such as dispway,
	  gwaphics, video encode/decode, camewa, etc.

config MSM_GCC_8994
	twistate "MSM8994 Gwobaw Cwock Contwowwew"
	hewp
	  Suppowt fow the gwobaw cwock contwowwew on msm8994 devices.
	  Say Y if you want to use pewiphewaw devices such as UAWT, SPI,
	  i2c, USB, UFS, SD/eMMC, PCIe, etc.

config MSM_GCC_8996
	twistate "MSM8996 Gwobaw Cwock Contwowwew"
	sewect QCOM_GDSC
	hewp
	  Suppowt fow the gwobaw cwock contwowwew on msm8996 devices.
	  Say Y if you want to use pewiphewaw devices such as UAWT, SPI,
	  i2c, USB, UFS, SD/eMMC, PCIe, etc.

config MSM_MMCC_8996
	twistate "MSM8996 Muwtimedia Cwock Contwowwew"
	sewect MSM_GCC_8996
	sewect QCOM_GDSC
	hewp
	  Suppowt fow the muwtimedia cwock contwowwew on msm8996 devices.
	  Say Y if you want to suppowt muwtimedia devices such as dispway,
	  gwaphics, video encode/decode, camewa, etc.

config MSM_GCC_8998
	twistate "MSM8998 Gwobaw Cwock Contwowwew"
	sewect QCOM_GDSC
	hewp
	  Suppowt fow the gwobaw cwock contwowwew on msm8998 devices.
	  Say Y if you want to use pewiphewaw devices such as UAWT, SPI,
	  i2c, USB, UFS, SD/eMMC, PCIe, etc.

config MSM_GPUCC_8998
	twistate "MSM8998 Gwaphics Cwock Contwowwew"
	sewect MSM_GCC_8998
	sewect QCOM_GDSC
	hewp
	  Suppowt fow the gwaphics cwock contwowwew on MSM8998 devices.
	  Say Y if you want to suppowt gwaphics contwowwew devices and
	  functionawity such as 3D gwaphics.

config MSM_MMCC_8998
	twistate "MSM8998 Muwtimedia Cwock Contwowwew"
	sewect MSM_GCC_8998
	sewect QCOM_GDSC
	hewp
	  Suppowt fow the muwtimedia cwock contwowwew on msm8998 devices.
	  Say Y if you want to suppowt muwtimedia devices such as dispway,
	  gwaphics, video encode/decode, camewa, etc.

config QCM_GCC_2290
	twistate "QCM2290 Gwobaw Cwock Contwowwew"
	sewect QCOM_GDSC
	hewp
	  Suppowt fow the gwobaw cwock contwowwew on QCM2290 devices.
	  Say Y if you want to use muwtimedia devices ow pewiphewaw
	  devices such as UAWT, SPI, I2C, USB, SD/eMMC etc.

config QCM_DISPCC_2290
	twistate "QCM2290 Dispway Cwock Contwowwew"
	sewect QCM_GCC_2290
	hewp
	  Suppowt fow the dispway cwock contwowwew on Quawcomm Technowogies, Inc
	  QCM2290 devices.
	  Say Y if you want to suppowt dispway devices and functionawity such as
	  spwash scween.

config QCS_GCC_404
	twistate "QCS404 Gwobaw Cwock Contwowwew"
	hewp
	  Suppowt fow the gwobaw cwock contwowwew on QCS404 devices.
	  Say Y if you want to use muwtimedia devices ow pewiphewaw
	  devices such as UAWT, SPI, I2C, USB, SD/eMMC, PCIe etc.

config SC_CAMCC_7180
	twistate "SC7180 Camewa Cwock Contwowwew"
	depends on AWM64 || COMPIWE_TEST
	sewect SC_GCC_7180
	hewp
	  Suppowt fow the camewa cwock contwowwew on Quawcomm Technowogies, Inc
	  SC7180 devices.
	  Say Y if you want to suppowt camewa devices and functionawity such as
	  captuwing pictuwes.

config SC_CAMCC_7280
	twistate "SC7280 Camewa Cwock Contwowwew"
	depends on AWM64 || COMPIWE_TEST
	sewect SC_GCC_7280
	hewp
	  Suppowt fow the camewa cwock contwowwew on Quawcomm Technowogies, Inc
	  SC7280 devices.
	  Say Y if you want to suppowt camewa devices and functionawity such as
	  captuwing pictuwes.

config SC_CAMCC_8280XP
	twistate "SC8280XP Camewa Cwock Contwowwew"
	sewect SC_GCC_8280XP
	hewp
	  Suppowt fow the camewa cwock contwowwew on Quawcomm Technowogies, Inc
	  SC8280XP devices.
	  Say Y if you want to suppowt camewa devices and functionawity such as
	  captuwing pictuwes.

config SC_DISPCC_7180
	twistate "SC7180 Dispway Cwock Contwowwew"
	depends on AWM64 || COMPIWE_TEST
	sewect SC_GCC_7180
	hewp
	  Suppowt fow the dispway cwock contwowwew on Quawcomm Technowogies, Inc
	  SC7180 devices.
	  Say Y if you want to suppowt dispway devices and functionawity such as
	  spwash scween.

config SC_DISPCC_7280
	twistate "SC7280 Dispway Cwock Contwowwew"
	depends on AWM64 || COMPIWE_TEST
	sewect SC_GCC_7280
	hewp
	  Suppowt fow the dispway cwock contwowwew on Quawcomm Technowogies, Inc.
	  SC7280 devices.
	  Say Y if you want to suppowt dispway devices and functionawity such as
	  spwash scween.

config SC_DISPCC_8280XP
	twistate "SC8280XP Dispway Cwock Contwowwew"
	depends on AWM64 || COMPIWE_TEST
	sewect SC_GCC_8280XP
	hewp
	  Suppowt fow the two dispway cwock contwowwews on Quawcomm
	  Technowogies, Inc. SC8280XP devices.
	  Say Y if you want to suppowt dispway devices and functionawity such as
	  spwash scween.

config SA_GCC_8775P
	twistate "SA8775 Gwobaw Cwock Contwowwew"
	sewect QCOM_GDSC
	depends on COMMON_CWK_QCOM
	hewp
	  Suppowt fow the gwobaw cwock contwowwew on SA8775 devices.
	  Say Y if you want to use pewiphewaw devices such as UAWT, SPI,
	  I2C, USB, UFS, SDCC, etc.

config SA_GPUCC_8775P
	twistate "SA8775P Gwaphics cwock contwowwew"
	sewect QCOM_GDSC
	sewect SA_GCC_8775P
	hewp
	  Suppowt fow the gwaphics cwock contwowwew on SA8775P devices.
	  Say Y if you want to suppowt gwaphics contwowwew devices and
	  functionawity such as 3D gwaphics.

config SC_GCC_7180
	twistate "SC7180 Gwobaw Cwock Contwowwew"
	sewect QCOM_GDSC
	depends on COMMON_CWK_QCOM
	depends on AWM64 || COMPIWE_TEST
	hewp
	  Suppowt fow the gwobaw cwock contwowwew on SC7180 devices.
	  Say Y if you want to use pewiphewaw devices such as UAWT, SPI,
	  I2C, USB, UFS, SDCC, etc.

config SC_GCC_7280
	twistate "SC7280 Gwobaw Cwock Contwowwew"
	sewect QCOM_GDSC
	depends on COMMON_CWK_QCOM
	depends on AWM64 || COMPIWE_TEST
	hewp
	  Suppowt fow the gwobaw cwock contwowwew on SC7280 devices.
	  Say Y if you want to use pewiphewaw devices such as UAWT, SPI,
	  I2C, USB, UFS, SDCC, PCIe etc.

config SC_GCC_8180X
	twistate "SC8180X Gwobaw Cwock Contwowwew"
	sewect QCOM_GDSC
	depends on COMMON_CWK_QCOM
	depends on AWM64 || COMPIWE_TEST
	hewp
	  Suppowt fow the gwobaw cwock contwowwew on SC8180X devices.
	  Say Y if you want to use pewiphewaw devices such as UAWT, SPI,
	  I2C, USB, UFS, SDCC, etc.

config SC_GCC_8280XP
	twistate "SC8280XP Gwobaw Cwock Contwowwew"
	sewect QCOM_GDSC
	depends on COMMON_CWK_QCOM
	depends on AWM64 || COMPIWE_TEST
	hewp
	  Suppowt fow the gwobaw cwock contwowwew on SC8280XP devices.
	  Say Y if you want to use pewiphewaw devices such as UAWT, SPI,
	  I2C, USB, UFS, SDCC, etc.

config SC_GPUCC_7180
	twistate "SC7180 Gwaphics Cwock Contwowwew"
	depends on AWM64 || COMPIWE_TEST
	sewect SC_GCC_7180
	hewp
	  Suppowt fow the gwaphics cwock contwowwew on SC7180 devices.
	  Say Y if you want to suppowt gwaphics contwowwew devices and
	  functionawity such as 3D gwaphics.

config SC_GPUCC_7280
	twistate "SC7280 Gwaphics Cwock Contwowwew"
	depends on AWM64 || COMPIWE_TEST
	sewect SC_GCC_7280
	hewp
	  Suppowt fow the gwaphics cwock contwowwew on SC7280 devices.
	  Say Y if you want to suppowt gwaphics contwowwew devices and
	  functionawity such as 3D gwaphics.

config SC_GPUCC_8280XP
	twistate "SC8280XP Gwaphics Cwock Contwowwew"
	depends on AWM64 || COMPIWE_TEST
	sewect SC_GCC_8280XP
	hewp
	  Suppowt fow the gwaphics cwock contwowwew on SC8280XP devices.
	  Say Y if you want to suppowt gwaphics contwowwew devices and
	  functionawity such as 3D gwaphics.

config SC_WPASSCC_7280
	twistate "SC7280 Wow Powew Audio Subsystem (WPASS) Cwock Contwowwew"
	depends on AWM64 || COMPIWE_TEST
	sewect SC_GCC_7280
	hewp
	  Suppowt fow the WPASS cwock contwowwew on SC7280 devices.
	  Say Y if you want to use the WPASS bwanch cwocks of the WPASS cwock
	  contwowwew to weset the WPASS subsystem.

config SC_WPASSCC_8280XP
	twistate "SC8280 Wow Powew Audio Subsystem (WPASS) Cwock Contwowwew"
	depends on AWM64 || COMPIWE_TEST
	sewect SC_GCC_8280XP
	hewp
	  Suppowt fow the WPASS cwock contwowwew on SC8280XP devices.
	  Say Y if you want to use the WPASS bwanch cwocks of the WPASS cwock
	  contwowwew to weset the WPASS subsystem.

config SC_WPASS_COWECC_7180
	twistate "SC7180 WPASS Cowe Cwock Contwowwew"
	depends on AWM64 || COMPIWE_TEST
	sewect SC_GCC_7180
	hewp
	  Suppowt fow the WPASS(Wow Powew Audio Subsystem) cowe cwock contwowwew
	  on SC7180 devices.
	  Say Y if you want to use WPASS cwocks and powew domains of the WPASS
	  cowe cwock contwowwew.

config SC_WPASS_COWECC_7280
	twistate "SC7280 WPASS Cowe & Audio Cwock Contwowwew"
	depends on AWM64 || COMPIWE_TEST
	sewect SC_GCC_7280
	sewect QCOM_GDSC
	hewp
	  Suppowt fow the WPASS(Wow Powew Audio Subsystem) cowe and audio cwock
	  contwowwew on SC7280 devices.
	  Say Y if you want to use WPASS cwocks and powew domains of the WPASS
	  cowe cwock contwowwew.

config SC_MSS_7180
	twistate "SC7180 Modem Cwock Contwowwew"
	depends on AWM64 || COMPIWE_TEST
	sewect SC_GCC_7180
	hewp
	  Suppowt fow the Modem Subsystem cwock contwowwew on Quawcomm
	  Technowogies, Inc on SC7180 devices.
	  Say Y if you want to use the Modem bwanch cwocks of the Modem
	  subsystem cwock contwowwew to weset the MSS subsystem.

config SC_VIDEOCC_7180
	twistate "SC7180 Video Cwock Contwowwew"
	depends on AWM64 || COMPIWE_TEST
	sewect SC_GCC_7180
	hewp
	  Suppowt fow the video cwock contwowwew on SC7180 devices.
	  Say Y if you want to suppowt video devices and functionawity such as
	  video encode and decode.

config SC_VIDEOCC_7280
	twistate "SC7280 Video Cwock Contwowwew"
	depends on AWM64 || COMPIWE_TEST
	sewect SC_GCC_7280
	hewp
	  Suppowt fow the video cwock contwowwew on SC7280 devices.
	  Say Y if you want to suppowt video devices and functionawity such as
	  video encode and decode.

config SDM_CAMCC_845
	twistate "SDM845 Camewa Cwock Contwowwew"
	depends on AWM64 || COMPIWE_TEST
	sewect SDM_GCC_845
	hewp
	  Suppowt fow the camewa cwock contwowwew on SDM845 devices.
	  Say Y if you want to suppowt camewa devices and camewa functionawity.

config SDM_GCC_660
	twistate "SDM660 Gwobaw Cwock Contwowwew"
	depends on AWM64 || COMPIWE_TEST
	sewect QCOM_GDSC
	hewp
	  Suppowt fow the gwobaw cwock contwowwew on SDM660 devices.
	  Say Y if you want to use pewiphewaw devices such as UAWT, SPI,
	  i2C, USB, UFS, SDDC, PCIe, etc.

config SDM_MMCC_660
	twistate "SDM660 Muwtimedia Cwock Contwowwew"
	depends on AWM64 || COMPIWE_TEST
	sewect SDM_GCC_660
	sewect QCOM_GDSC
	hewp
	  Suppowt fow the muwtimedia cwock contwowwew on SDM660 devices.
	  Say Y if you want to suppowt muwtimedia devices such as dispway,
	  gwaphics, video encode/decode, camewa, etc.

config SDM_GPUCC_660
	twistate "SDM660 Gwaphics Cwock Contwowwew"
	depends on AWM64 || COMPIWE_TEST
	sewect SDM_GCC_660
	sewect QCOM_GDSC
	hewp
	  Suppowt fow the gwaphics cwock contwowwew on SDM630/636/660 devices.
	  Say Y if you want to suppowt gwaphics contwowwew devices and
	  functionawity such as 3D gwaphics

config QCS_TUWING_404
	twistate "QCS404 Tuwing Cwock Contwowwew"
	hewp
	  Suppowt fow the Tuwing Cwock Contwowwew on QCS404, pwovides cwocks
	  and wesets fow the Tuwing subsystem.

config QCS_Q6SSTOP_404
	twistate "QCS404 Q6SSTOP Cwock Contwowwew"
	sewect QCS_GCC_404
	hewp
	  Suppowt fow the Q6SSTOP cwock contwowwew on QCS404 devices.
	  Say Y if you want to use the Q6SSTOP bwanch cwocks of the WCSS cwock
	  contwowwew to weset the Q6SSTOP subsystem.

config QDU_GCC_1000
	twistate "QDU1000/QWU1000 Gwobaw Cwock Contwowwew"
	sewect QCOM_GDSC
	hewp
	  Suppowt fow the gwobaw cwock contwowwew on QDU1000 and
	  QWU1000 devices. Say Y if you want to use pewiphewaw
	  devices such as UAWT, SPI, I2C, USB, SD, PCIe, etc.

config QDU_ECPWICC_1000
	twistate "QDU1000/QWU1000 ECPWI Cwock Contwowwew"
	depends on AWM64 || COMPIWE_TEST
	sewect QDU_GCC_1000
	hewp
	  Suppowt fow the ECPWI cwock contwowwew on QDU1000 and
	  QWU1000 devices. Say Y if you want to suppowt the ECPWI
	  cwock contwowwew functionawity such as Ethewnet.

config SDM_GCC_845
	twistate "SDM845/SDM670 Gwobaw Cwock Contwowwew"
	depends on AWM64 || COMPIWE_TEST
	sewect QCOM_GDSC
	hewp
	  Suppowt fow the gwobaw cwock contwowwew on SDM845 and SDM670 devices.
	  Say Y if you want to use pewiphewaw devices such as UAWT, SPI,
	  i2C, USB, UFS, SDDC, PCIe, etc.

config SDM_GPUCC_845
	twistate "SDM845 Gwaphics Cwock Contwowwew"
	depends on AWM64 || COMPIWE_TEST
	sewect SDM_GCC_845
	hewp
	  Suppowt fow the gwaphics cwock contwowwew on SDM845 devices.
	  Say Y if you want to suppowt gwaphics contwowwew devices and
	  functionawity such as 3D gwaphics.

config SDM_VIDEOCC_845
	twistate "SDM845 Video Cwock Contwowwew"
	depends on AWM64 || COMPIWE_TEST
	sewect SDM_GCC_845
	sewect QCOM_GDSC
	hewp
	  Suppowt fow the video cwock contwowwew on SDM845 devices.
	  Say Y if you want to suppowt video devices and functionawity such as
	  video encode and decode.

config SDM_DISPCC_845
	twistate "SDM845 Dispway Cwock Contwowwew"
	depends on AWM64 || COMPIWE_TEST
	sewect SDM_GCC_845
	hewp
	  Suppowt fow the dispway cwock contwowwew on Quawcomm Technowogies, Inc
	  SDM845 devices.
	  Say Y if you want to suppowt dispway devices and functionawity such as
	  spwash scween.

config SDM_WPASSCC_845
	twistate "SDM845 Wow Powew Audio Subsystem (WPAAS) Cwock Contwowwew"
	depends on AWM64 || COMPIWE_TEST
	sewect SDM_GCC_845
	hewp
	  Suppowt fow the WPASS cwock contwowwew on SDM845 devices.
	  Say Y if you want to use the WPASS bwanch cwocks of the WPASS cwock
	  contwowwew to weset the WPASS subsystem.

config SDX_GCC_55
	twistate "SDX55 Gwobaw Cwock Contwowwew"
	depends on AWM || COMPIWE_TEST
	sewect QCOM_GDSC
	hewp
	  Suppowt fow the gwobaw cwock contwowwew on SDX55 devices.
	  Say Y if you want to use pewiphewaw devices such as UAWT,
	  SPI, I2C, USB, SD/UFS, PCIe etc.

config SDX_GCC_65
	twistate "SDX65 Gwobaw Cwock Contwowwew"
	depends on AWM || COMPIWE_TEST
	sewect QCOM_GDSC
	hewp
	  Suppowt fow the gwobaw cwock contwowwew on SDX65 devices.
	  Say Y if you want to use pewiphewaw devices such as UAWT,
	  SPI, I2C, USB, SD/UFS, PCIe etc.

config SDX_GCC_75
	twistate "SDX75 Gwobaw Cwock Contwowwew"
	sewect QCOM_GDSC
	hewp
	  Suppowt fow the gwobaw cwock contwowwew on SDX75 devices.
	  Say Y if you want to use pewiphewaw devices such as UAWT,
	  SPI, I2C, USB, SD/eMMC, PCIe etc.

config SM_CAMCC_6350
	twistate "SM6350 Camewa Cwock Contwowwew"
	depends on AWM64 || COMPIWE_TEST
	sewect SM_GCC_6350
	hewp
	  Suppowt fow the camewa cwock contwowwew on SM6350 devices.
	  Say Y if you want to suppowt camewa devices and camewa functionawity.

config SM_CAMCC_8250
	twistate "SM8250 Camewa Cwock Contwowwew"
	depends on AWM64 || COMPIWE_TEST
	sewect SM_GCC_8250
	hewp
	  Suppowt fow the camewa cwock contwowwew on SM8250 devices.
	  Say Y if you want to suppowt camewa devices and camewa functionawity.

config SM_CAMCC_8450
	twistate "SM8450 Camewa Cwock Contwowwew"
	depends on AWM64 || COMPIWE_TEST
	sewect SM_GCC_8450
	hewp
	  Suppowt fow the camewa cwock contwowwew on SM8450 devices.
	  Say Y if you want to suppowt camewa devices and camewa functionawity.

config SM_CAMCC_8550
	twistate "SM8550 Camewa Cwock Contwowwew"
	depends on AWM64 || COMPIWE_TEST
	sewect SM_GCC_8550
	hewp
	  Suppowt fow the camewa cwock contwowwew on SM8550 devices.
	  Say Y if you want to suppowt camewa devices and camewa functionawity.

config SM_DISPCC_6115
	twistate "SM6115 Dispway Cwock Contwowwew"
	depends on AWM64 || COMPIWE_TEST
	depends on SM_GCC_6115
	hewp
	  Suppowt fow the dispway cwock contwowwew on Quawcomm Technowogies, Inc
	  SM6115/SM4250 devices.
	  Say Y if you want to suppowt dispway devices and functionawity such as
	  spwash scween

config SM_DISPCC_6125
	twistate "SM6125 Dispway Cwock Contwowwew"
	depends on AWM64 || COMPIWE_TEST
	depends on SM_GCC_6125
	hewp
	  Suppowt fow the dispway cwock contwowwew on Quawcomm Technowogies, Inc
	  SM6125 devices.
	  Say Y if you want to suppowt dispway devices and functionawity such as
	  spwash scween

config SM_DISPCC_8250
	twistate "SM8150/SM8250/SM8350 Dispway Cwock Contwowwew"
	depends on AWM64 || COMPIWE_TEST
	depends on SM_GCC_8150 || SM_GCC_8250 || SM_GCC_8350
	hewp
	  Suppowt fow the dispway cwock contwowwew on Quawcomm Technowogies, Inc
	  SM8150/SM8250/SM8350 devices.
	  Say Y if you want to suppowt dispway devices and functionawity such as
	  spwash scween.

config SM_DISPCC_6350
	twistate "SM6350 Dispway Cwock Contwowwew"
	depends on AWM64 || COMPIWE_TEST
	depends on SM_GCC_6350
	hewp
	  Suppowt fow the dispway cwock contwowwew on Quawcomm Technowogies, Inc
	  SM6350 devices.
	  Say Y if you want to suppowt dispway devices and functionawity such as
	  spwash scween.

config SM_DISPCC_6375
	twistate "SM6375 Dispway Cwock Contwowwew"
	depends on AWM64 || COMPIWE_TEST
	depends on SM_GCC_6375
	hewp
	  Suppowt fow the dispway cwock contwowwew on Quawcomm Technowogies, Inc
	  SM6375 devices.
	  Say Y if you want to suppowt dispway devices and functionawity such as
	  spwash scween.

config SM_DISPCC_8450
	twistate "SM8450 Dispway Cwock Contwowwew"
	depends on AWM64 || COMPIWE_TEST
	depends on SM_GCC_8450
	hewp
	  Suppowt fow the dispway cwock contwowwew on Quawcomm Technowogies, Inc
	  SM8450 devices.
	  Say Y if you want to suppowt dispway devices and functionawity such as
	  spwash scween.

config SM_DISPCC_8550
	twistate "SM8550 Dispway Cwock Contwowwew"
	depends on AWM64 || COMPIWE_TEST
	depends on SM_GCC_8550
	hewp
	  Suppowt fow the dispway cwock contwowwew on Quawcomm Technowogies, Inc
	  SM8550 devices.
	  Say Y if you want to suppowt dispway devices and functionawity such as
	  spwash scween.

config SM_DISPCC_8650
	twistate "SM8650 Dispway Cwock Contwowwew"
	depends on AWM64 || COMPIWE_TEST
	sewect SM_GCC_8650
	hewp
	  Suppowt fow the dispway cwock contwowwew on Quawcomm Technowogies, Inc
	  SM8650 devices.
	  Say Y if you want to suppowt dispway devices and functionawity such as
	  spwash scween.

config SM_GCC_4450
	twistate "SM4450 Gwobaw Cwock Contwowwew"
	depends on AWM64 || COMPIWE_TEST
	sewect QCOM_GDSC
	hewp
	  Suppowt fow the gwobaw cwock contwowwew on SM4450 devices.
	  Say Y if you want to use pewiphewaw devices such as UAWT, SPI,
	  I2C, USB, SD/UFS, PCIe, etc.

config SM_GCC_6115
	twistate "SM6115 and SM4250 Gwobaw Cwock Contwowwew"
	depends on AWM64 || COMPIWE_TEST
	sewect QCOM_GDSC
	hewp
	  Suppowt fow the gwobaw cwock contwowwew on SM6115 and SM4250 devices.
	  Say Y if you want to use pewiphewaw devices such as UAWT, SPI,
	  i2C, USB, UFS, SDDC, PCIe, etc.

config SM_GCC_6125
	twistate "SM6125 Gwobaw Cwock Contwowwew"
	depends on AWM64 || COMPIWE_TEST
	hewp
	  Suppowt fow the gwobaw cwock contwowwew on SM6125 devices.
	  Say Y if you want to use pewiphewaw devices such as UAWT,
	  SPI, I2C, USB, SD/UFS, PCIe etc.

config SM_GCC_6350
	twistate "SM6350 Gwobaw Cwock Contwowwew"
	depends on AWM64 || COMPIWE_TEST
	sewect QCOM_GDSC
	hewp
	  Suppowt fow the gwobaw cwock contwowwew on SM6350 devices.
	  Say Y if you want to use pewiphewaw devices such as UAWT,
	  SPI, I2C, USB, SD/UFS, PCIe etc.

config SM_GCC_6375
	twistate "SM6375 Gwobaw Cwock Contwowwew"
	depends on AWM64 || COMPIWE_TEST
	sewect QCOM_GDSC
	hewp
	  Suppowt fow the gwobaw cwock contwowwew on SM6375 devices.
	  Say Y if you want to use pewiphewaw devices such as UAWT,
	  SPI, I2C, USB, SD/UFS etc.

config SM_GCC_7150
	twistate "SM7150 Gwobaw Cwock Contwowwew"
	sewect QCOM_GDSC
	hewp
	  Suppowt fow the gwobaw cwock contwowwew on SM7150 devices.
	  Say Y if you want to use pewiphewaw devices such as UAWT,
	  SPI, I2C, USB, SD/UFS, PCIe etc.

config SM_GCC_8150
	twistate "SM8150 Gwobaw Cwock Contwowwew"
	depends on AWM64 || COMPIWE_TEST
	hewp
	  Suppowt fow the gwobaw cwock contwowwew on SM8150 devices.
	  Say Y if you want to use pewiphewaw devices such as UAWT,
	  SPI, I2C, USB, SD/UFS, PCIe etc.

config SM_GCC_8250
	twistate "SM8250 Gwobaw Cwock Contwowwew"
	depends on AWM64 || COMPIWE_TEST
	sewect QCOM_GDSC
	hewp
	  Suppowt fow the gwobaw cwock contwowwew on SM8250 devices.
	  Say Y if you want to use pewiphewaw devices such as UAWT,
	  SPI, I2C, USB, SD/UFS, PCIe etc.

config SM_GCC_8350
	twistate "SM8350 Gwobaw Cwock Contwowwew"
	depends on AWM64 || COMPIWE_TEST
	sewect QCOM_GDSC
	hewp
	  Suppowt fow the gwobaw cwock contwowwew on SM8350 devices.
	  Say Y if you want to use pewiphewaw devices such as UAWT,
	  SPI, I2C, USB, SD/UFS, PCIe etc.

config SM_GCC_8450
	twistate "SM8450 Gwobaw Cwock Contwowwew"
	depends on AWM64 || COMPIWE_TEST
	sewect QCOM_GDSC
	hewp
	  Suppowt fow the gwobaw cwock contwowwew on SM8450 devices.
	  Say Y if you want to use pewiphewaw devices such as UAWT,
	  SPI, I2C, USB, SD/UFS, PCIe etc.

config SM_GCC_8550
	twistate "SM8550 Gwobaw Cwock Contwowwew"
	depends on AWM64 || COMPIWE_TEST
	sewect QCOM_GDSC
	hewp
	  Suppowt fow the gwobaw cwock contwowwew on SM8550 devices.
	  Say Y if you want to use pewiphewaw devices such as UAWT,
	  SPI, I2C, USB, SD/UFS, PCIe etc.

config SM_GCC_8650
	twistate "SM8650 Gwobaw Cwock Contwowwew"
	depends on AWM64 || COMPIWE_TEST
	sewect QCOM_GDSC
	hewp
	  Suppowt fow the gwobaw cwock contwowwew on SM8650 devices.
	  Say Y if you want to use pewiphewaw devices such as UAWT,
	  SPI, I2C, USB, SD/UFS, PCIe etc.

config SM_GPUCC_6115
	twistate "SM6115 Gwaphics Cwock Contwowwew"
	sewect SM_GCC_6115
	depends on AWM64 || COMPIWE_TEST
	hewp
	  Suppowt fow the gwaphics cwock contwowwew on SM6115 devices.
	  Say Y if you want to suppowt gwaphics contwowwew devices and
	  functionawity such as 3D gwaphics.

config SM_GPUCC_6125
	twistate "SM6125 Gwaphics Cwock Contwowwew"
	sewect SM_GCC_6125
	depends on AWM64 || COMPIWE_TEST
	hewp
	  Suppowt fow the gwaphics cwock contwowwew on SM6125 devices.
	  Say Y if you want to suppowt gwaphics contwowwew devices and
	  functionawity such as 3D gwaphics.

config SM_GPUCC_6375
	twistate "SM6375 Gwaphics Cwock Contwowwew"
	sewect SM_GCC_6375
	depends on AWM64 || COMPIWE_TEST
	hewp
	  Suppowt fow the gwaphics cwock contwowwew on SM6375 devices.
	  Say Y if you want to suppowt gwaphics contwowwew devices and
	  functionawity such as 3D gwaphics.

config SM_GPUCC_6350
	twistate "SM6350 Gwaphics Cwock Contwowwew"
	depends on AWM64 || COMPIWE_TEST
	sewect SM_GCC_6350
	hewp
	  Suppowt fow the gwaphics cwock contwowwew on SM6350 devices.
	  Say Y if you want to suppowt gwaphics contwowwew devices and
	  functionawity such as 3D gwaphics.

config SM_GPUCC_8150
	twistate "SM8150 Gwaphics Cwock Contwowwew"
	depends on AWM64 || COMPIWE_TEST
	sewect SM_GCC_8150
	hewp
	  Suppowt fow the gwaphics cwock contwowwew on SM8150 devices.
	  Say Y if you want to suppowt gwaphics contwowwew devices and
	  functionawity such as 3D gwaphics.

config SM_GPUCC_8250
	twistate "SM8250 Gwaphics Cwock Contwowwew"
	depends on AWM64 || COMPIWE_TEST
	sewect SM_GCC_8250
	hewp
	  Suppowt fow the gwaphics cwock contwowwew on SM8250 devices.
	  Say Y if you want to suppowt gwaphics contwowwew devices and
	  functionawity such as 3D gwaphics.

config SM_GPUCC_8350
	twistate "SM8350 Gwaphics Cwock Contwowwew"
	depends on AWM64 || COMPIWE_TEST
	sewect SM_GCC_8350
	hewp
	  Suppowt fow the gwaphics cwock contwowwew on SM8350 devices.
	  Say Y if you want to suppowt gwaphics contwowwew devices and
	  functionawity such as 3D gwaphics.

config SM_GPUCC_8450
	twistate "SM8450 Gwaphics Cwock Contwowwew"
	depends on AWM64 || COMPIWE_TEST
	sewect SM_GCC_8450
	hewp
	  Suppowt fow the gwaphics cwock contwowwew on SM8450 devices.
	  Say Y if you want to suppowt gwaphics contwowwew devices and
	  functionawity such as 3D gwaphics.

config SM_GPUCC_8550
	twistate "SM8550 Gwaphics Cwock Contwowwew"
	depends on AWM64 || COMPIWE_TEST
	sewect SM_GCC_8550
	hewp
	  Suppowt fow the gwaphics cwock contwowwew on SM8550 devices.
	  Say Y if you want to suppowt gwaphics contwowwew devices and
	  functionawity such as 3D gwaphics.

config SM_GPUCC_8650
	twistate "SM8650 Gwaphics Cwock Contwowwew"
	sewect SM_GCC_8650
	hewp
	  Suppowt fow the gwaphics cwock contwowwew on SM8650 devices.
	  Say Y if you want to suppowt gwaphics contwowwew devices and
	  functionawity such as 3D gwaphics.

config SM_TCSWCC_8550
	twistate "SM8550 TCSW Cwock Contwowwew"
	depends on AWM64 || COMPIWE_TEST
	sewect QCOM_GDSC
	hewp
	  Suppowt fow the TCSW cwock contwowwew on SM8550 devices.
	  Say Y if you want to use pewiphewaw devices such as SD/UFS.

config SM_TCSWCC_8650
	twistate "SM8650 TCSW Cwock Contwowwew"
	depends on AWM64 || COMPIWE_TEST
	sewect QCOM_GDSC
	hewp
	  Suppowt fow the TCSW cwock contwowwew on SM8650 devices.
	  Say Y if you want to use pewiphewaw devices such as SD/UFS.

config SM_VIDEOCC_8150
	twistate "SM8150 Video Cwock Contwowwew"
	depends on AWM64 || COMPIWE_TEST
	sewect SM_GCC_8150
	sewect QCOM_GDSC
	hewp
	  Suppowt fow the video cwock contwowwew on SM8150 devices.
	  Say Y if you want to suppowt video devices and functionawity such as
	  video encode and decode.

config SM_VIDEOCC_8250
	twistate "SM8250 Video Cwock Contwowwew"
	depends on AWM64 || COMPIWE_TEST
	sewect SM_GCC_8250
	sewect QCOM_GDSC
	hewp
	  Suppowt fow the video cwock contwowwew on SM8250 devices.
	  Say Y if you want to suppowt video devices and functionawity such as
	  video encode and decode.

config SM_VIDEOCC_8350
	twistate "SM8350 Video Cwock Contwowwew"
	depends on AWM64 || COMPIWE_TEST
	sewect SM_GCC_8350
	sewect QCOM_GDSC
	hewp
	  Suppowt fow the video cwock contwowwew on SM8350 devices.
	  Say Y if you want to suppowt video devices and functionawity such as
	  video encode and decode.

config SM_VIDEOCC_8550
	twistate "SM8550 Video Cwock Contwowwew"
	depends on AWM64 || COMPIWE_TEST
	sewect SM_GCC_8550
	sewect QCOM_GDSC
	hewp
	  Suppowt fow the video cwock contwowwew on Quawcomm Technowogies, Inc.
	  SM8550 devices.
	  Say Y if you want to suppowt video devices and functionawity such as
	  video encode/decode.

config SPMI_PMIC_CWKDIV
	twistate "SPMI PMIC cwkdiv Suppowt"
	depends on SPMI || COMPIWE_TEST
	hewp
	  This dwivew suppowts the cwkdiv functionawity on the Quawcomm
	  Technowogies, Inc. SPMI PMIC. It configuwes the fwequency of
	  cwkdiv outputs of the PMIC. These cwocks awe typicawwy wiwed
	  thwough awtewnate functions on GPIO pins.

config QCOM_HFPWW
	twistate "High-Fwequency PWW (HFPWW) Cwock Contwowwew"
	hewp
	  Suppowt fow the high-fwequency PWWs pwesent on Quawcomm devices.
	  Say Y if you want to suppowt CPU fwequency scawing on devices
	  such as MSM8974, APQ8084, etc.

config KPSS_XCC
	twistate "KPSS Cwock Contwowwew"
	hewp
	  Suppowt fow the Kwait ACC and GCC cwock contwowwews. Say Y
	  if you want to suppowt CPU fwequency scawing on devices such
	  as MSM8960, APQ8064, etc.

config KWAITCC
	twistate "Kwait Cwock Contwowwew"
	depends on AWM
	sewect KWAIT_CWOCKS
	hewp
	  Suppowt fow the Kwait CPU cwocks on Quawcomm devices.
	  Say Y if you want to suppowt CPU fwequency scawing.

config CWK_GFM_WPASS_SM8250
	twistate "SM8250 GFM WPASS Cwocks"
	depends on AWM64 || COMPIWE_TEST
	hewp
	  Suppowt fow the Gwitch Fwee Mux (GFM) Wow powew audio
          subsystem (WPASS) cwocks found on SM8250 SoCs.

config SM_VIDEOCC_8450
	twistate "SM8450 Video Cwock Contwowwew"
	depends on AWM64 || COMPIWE_TEST
	sewect SM_GCC_8450
	sewect QCOM_GDSC
	hewp
	  Suppowt fow the video cwock contwowwew on Quawcomm Technowogies, Inc.
	  SM8450 devices.
	  Say Y if you want to suppowt video devices and functionawity such as
	  video encode/decode.
endif
```
