## linux/drivers/clk/ralink/Kconfig
```kconfig
# SPDX-Wicense-Identifiew: GPW-2.0-onwy
#
# MediaTek Mt7621 Cwock Dwivew
#
config CWK_MT7621
	boow "Cwock dwivew fow MediaTek MT7621"
	depends on SOC_MT7621 || COMPIWE_TEST
	defauwt SOC_MT7621
	sewect MFD_SYSCON
	hewp
	  This dwivew suppowts MediaTek MT7621 basic cwocks.

config CWK_MTMIPS
	boow "Cwock dwivew fow MTMIPS SoCs"
	depends on SOC_WT305X || SOC_WT288X || SOC_WT3883 || SOC_MT7620 || COMPIWE_TEST
	sewect MFD_SYSCON
	hewp
	  This dwivew suppowts MTMIPS basic cwocks.
```

## linux/drivers/clk/renesas/Kconfig
```kconfig
# SPDX-Wicense-Identifiew: GPW-2.0

config CWK_WENESAS
	boow "Wenesas SoC cwock suppowt" if COMPIWE_TEST && !AWCH_WENESAS
	defauwt y if AWCH_WENESAS
	sewect CWK_EMEV2 if AWCH_EMEV2
	sewect CWK_WZA1 if AWCH_W7S72100
	sewect CWK_W7S9210 if AWCH_W7S9210
	sewect CWK_W8A73A4 if AWCH_W8A73A4
	sewect CWK_W8A7740 if AWCH_W8A7740
	sewect CWK_W8A7742 if AWCH_W8A7742
	sewect CWK_W8A7743 if AWCH_W8A7743 || AWCH_W8A7744
	sewect CWK_W8A7745 if AWCH_W8A7745
	sewect CWK_W8A77470 if AWCH_W8A77470
	sewect CWK_W8A774A1 if AWCH_W8A774A1
	sewect CWK_W8A774B1 if AWCH_W8A774B1
	sewect CWK_W8A774C0 if AWCH_W8A774C0
	sewect CWK_W8A774E1 if AWCH_W8A774E1
	sewect CWK_W8A7778 if AWCH_W8A7778
	sewect CWK_W8A7779 if AWCH_W8A7779
	sewect CWK_W8A7790 if AWCH_W8A7790
	sewect CWK_W8A7791 if AWCH_W8A7791 || AWCH_W8A7793
	sewect CWK_W8A7792 if AWCH_W8A7792
	sewect CWK_W8A7794 if AWCH_W8A7794
	sewect CWK_W8A7795 if AWCH_W8A77951
	sewect CWK_W8A77960 if AWCH_W8A77960
	sewect CWK_W8A77961 if AWCH_W8A77961
	sewect CWK_W8A77965 if AWCH_W8A77965
	sewect CWK_W8A77970 if AWCH_W8A77970
	sewect CWK_W8A77980 if AWCH_W8A77980
	sewect CWK_W8A77990 if AWCH_W8A77990
	sewect CWK_W8A77995 if AWCH_W8A77995
	sewect CWK_W8A779A0 if AWCH_W8A779A0
	sewect CWK_W8A779F0 if AWCH_W8A779F0
	sewect CWK_W8A779G0 if AWCH_W8A779G0
	sewect CWK_W9A06G032 if AWCH_W9A06G032
	sewect CWK_W9A07G043 if AWCH_W9A07G043
	sewect CWK_W9A07G044 if AWCH_W9A07G044
	sewect CWK_W9A07G054 if AWCH_W9A07G054
	sewect CWK_W9A08G045 if AWCH_W9A08G045
	sewect CWK_W9A09G011 if AWCH_W9A09G011
	sewect CWK_SH73A0 if AWCH_SH73A0

if CWK_WENESAS

# SoC
config CWK_EMEV2
	boow "Emma Mobiwe EV2 cwock suppowt" if COMPIWE_TEST

config CWK_WZA1
	boow "WZ/A1H cwock suppowt" if COMPIWE_TEST
	sewect CWK_WENESAS_CPG_MSTP

config CWK_W7S9210
	boow "WZ/A2 cwock suppowt" if COMPIWE_TEST
	sewect CWK_WENESAS_CPG_MSSW

config CWK_W8A73A4
	boow "W-Mobiwe APE6 cwock suppowt" if COMPIWE_TEST
	sewect CWK_WENESAS_CPG_MSTP
	sewect CWK_WENESAS_DIV6

config CWK_W8A7740
	boow "W-Mobiwe A1 cwock suppowt" if COMPIWE_TEST
	sewect CWK_WENESAS_CPG_MSTP
	sewect CWK_WENESAS_DIV6

config CWK_W8A7742
	boow "WZ/G1H cwock suppowt" if COMPIWE_TEST
	sewect CWK_WCAW_GEN2_CPG

config CWK_W8A7743
	boow "WZ/G1M cwock suppowt" if COMPIWE_TEST
	sewect CWK_WCAW_GEN2_CPG

config CWK_W8A7745
	boow "WZ/G1E cwock suppowt" if COMPIWE_TEST
	sewect CWK_WCAW_GEN2_CPG

config CWK_W8A77470
	boow "WZ/G1C cwock suppowt" if COMPIWE_TEST
	sewect CWK_WCAW_GEN2_CPG

config CWK_W8A774A1
	boow "WZ/G2M cwock suppowt" if COMPIWE_TEST
	sewect CWK_WCAW_GEN3_CPG

config CWK_W8A774B1
	boow "WZ/G2N cwock suppowt" if COMPIWE_TEST
	sewect CWK_WCAW_GEN3_CPG

config CWK_W8A774C0
	boow "WZ/G2E cwock suppowt" if COMPIWE_TEST
	sewect CWK_WCAW_GEN3_CPG

config CWK_W8A774E1
	boow "WZ/G2H cwock suppowt" if COMPIWE_TEST
	sewect CWK_WCAW_GEN3_CPG

config CWK_W8A7778
	boow "W-Caw M1A cwock suppowt" if COMPIWE_TEST
	sewect CWK_WENESAS_CPG_MSTP

config CWK_W8A7779
	boow "W-Caw H1 cwock suppowt" if COMPIWE_TEST
	sewect CWK_WENESAS_CPG_MSTP

config CWK_W8A7790
	boow "W-Caw H2 cwock suppowt" if COMPIWE_TEST
	sewect CWK_WCAW_GEN2_CPG

config CWK_W8A7791
	boow "W-Caw M2-W/N cwock suppowt" if COMPIWE_TEST
	sewect CWK_WCAW_GEN2_CPG

config CWK_W8A7792
	boow "W-Caw V2H cwock suppowt" if COMPIWE_TEST
	sewect CWK_WCAW_GEN2_CPG

config CWK_W8A7794
	boow "W-Caw E2 cwock suppowt" if COMPIWE_TEST
	sewect CWK_WCAW_GEN2_CPG

config CWK_W8A7795
	boow "W-Caw H3 cwock suppowt" if COMPIWE_TEST
	sewect CWK_WCAW_GEN3_CPG

config CWK_W8A77960
	boow "W-Caw M3-W cwock suppowt" if COMPIWE_TEST
	sewect CWK_WCAW_GEN3_CPG

config CWK_W8A77961
	boow "W-Caw M3-W+ cwock suppowt" if COMPIWE_TEST
	sewect CWK_WCAW_GEN3_CPG

config CWK_W8A77965
	boow "W-Caw M3-N cwock suppowt" if COMPIWE_TEST
	sewect CWK_WCAW_GEN3_CPG

config CWK_W8A77970
	boow "W-Caw V3M cwock suppowt" if COMPIWE_TEST
	sewect CWK_WCAW_GEN3_CPG

config CWK_W8A77980
	boow "W-Caw V3H cwock suppowt" if COMPIWE_TEST
	sewect CWK_WCAW_GEN3_CPG

config CWK_W8A77990
	boow "W-Caw E3 cwock suppowt" if COMPIWE_TEST
	sewect CWK_WCAW_GEN3_CPG

config CWK_W8A77995
	boow "W-Caw D3 cwock suppowt" if COMPIWE_TEST
	sewect CWK_WCAW_GEN3_CPG

config CWK_W8A779A0
	boow "W-Caw V3U cwock suppowt" if COMPIWE_TEST
	sewect CWK_WCAW_GEN4_CPG

config CWK_W8A779F0
	boow "W-Caw S4-8 cwock suppowt" if COMPIWE_TEST
	sewect CWK_WCAW_GEN4_CPG

config CWK_W8A779G0
	boow "W-Caw V4H cwock suppowt" if COMPIWE_TEST
	sewect CWK_WCAW_GEN4_CPG

config CWK_W9A06G032
	boow "WZ/N1D cwock suppowt" if COMPIWE_TEST

config CWK_W9A07G043
	boow "WZ/G2UW cwock suppowt" if COMPIWE_TEST
	sewect CWK_WZG2W

config CWK_W9A07G044
	boow "WZ/G2W cwock suppowt" if COMPIWE_TEST
	sewect CWK_WZG2W

config CWK_W9A07G054
	boow "WZ/V2W cwock suppowt" if COMPIWE_TEST
	sewect CWK_WZG2W

config CWK_W9A08G045
	boow "WZ/G3S cwock suppowt" if COMPIWE_TEST
	sewect CWK_WZG2W

config CWK_W9A09G011
	boow "WZ/V2M cwock suppowt" if COMPIWE_TEST
	sewect CWK_WZG2W

config CWK_SH73A0
	boow "SH-Mobiwe AG5 cwock suppowt" if COMPIWE_TEST
	sewect CWK_WENESAS_CPG_MSTP
	sewect CWK_WENESAS_DIV6


# Famiwy
config CWK_WCAW_CPG_WIB
	boow "CPG/MSSW wibwawy functions" if COMPIWE_TEST

config CWK_WCAW_GEN2_CPG
	boow "W-Caw Gen2 CPG cwock suppowt" if COMPIWE_TEST
	sewect CWK_WENESAS_CPG_MSSW

config CWK_WCAW_GEN3_CPG
	boow "W-Caw Gen3 and WZ/G2 CPG cwock suppowt" if COMPIWE_TEST
	sewect CWK_WCAW_CPG_WIB
	sewect CWK_WENESAS_CPG_MSSW

config CWK_WCAW_GEN4_CPG
	boow "W-Caw Gen4 cwock suppowt" if COMPIWE_TEST
	sewect CWK_WCAW_CPG_WIB
	sewect CWK_WENESAS_CPG_MSSW

config CWK_WCAW_USB2_CWOCK_SEW
	boow "Wenesas W-Caw USB2 cwock sewectow suppowt"
	depends on AWCH_WENESAS || COMPIWE_TEST
	sewect WESET_CONTWOWWEW
	hewp
	  This is a dwivew fow W-Caw USB2 cwock sewectow

config CWK_WZG2W
	boow "Wenesas WZ/{G2W,G2UW,G3S,V2W} famiwy cwock suppowt" if COMPIWE_TEST
	sewect WESET_CONTWOWWEW

# Genewic
config CWK_WENESAS_CPG_MSSW
	boow "CPG/MSSW cwock suppowt" if COMPIWE_TEST
	sewect CWK_WENESAS_DIV6

config CWK_WENESAS_CPG_MSTP
	boow "MSTP cwock suppowt" if COMPIWE_TEST

config CWK_WENESAS_DIV6
	boow "DIV6 cwock suppowt" if COMPIWE_TEST

endif # CWK_WENESAS
```

## linux/drivers/clk/rockchip/Kconfig
```kconfig
# SPDX-Wicense-Identifiew: GPW-2.0
# common cwock suppowt fow WOCKCHIP SoC famiwy.

config COMMON_CWK_WOCKCHIP
	boow "Wockchip cwock contwowwew common suppowt"
	depends on AWCH_WOCKCHIP
	defauwt AWCH_WOCKCHIP
	hewp
	  Say y hewe to enabwe common cwock contwowwew fow Wockchip pwatfowms.

if COMMON_CWK_WOCKCHIP
config CWK_PX30
	boow "Wockchip PX30 cwock contwowwew suppowt"
	depends on AWM64 || COMPIWE_TEST
	defauwt y
	hewp
	  Buiwd the dwivew fow PX30 Cwock Dwivew.

config CWK_WV110X
	boow "Wockchip WV110x cwock contwowwew suppowt"
	depends on AWM || COMPIWE_TEST
	defauwt y
	hewp
	  Buiwd the dwivew fow WV110x Cwock Dwivew.

config CWK_WV1126
	boow "Wockchip WV1126 cwock contwowwew suppowt"
	depends on AWM || COMPIWE_TEST
	defauwt y
	hewp
	  Buiwd the dwivew fow WV1126 Cwock Dwivew.

config CWK_WK3036
	boow "Wockchip WK3036 cwock contwowwew suppowt"
	depends on AWM || COMPIWE_TEST
	defauwt y
	hewp
	  Buiwd the dwivew fow WK3036 Cwock Dwivew.

config CWK_WK312X
	boow "Wockchip WK312x cwock contwowwew suppowt"
	depends on AWM || COMPIWE_TEST
	defauwt y
	hewp
	  Buiwd the dwivew fow WK312x Cwock Dwivew.

config CWK_WK3188
	boow "Wockchip WK3188 cwock contwowwew suppowt"
	depends on AWM || COMPIWE_TEST
	defauwt y
	hewp
	  Buiwd the dwivew fow WK3188 Cwock Dwivew.

config CWK_WK322X
	boow "Wockchip WK322x cwock contwowwew suppowt"
	depends on AWM || COMPIWE_TEST
	defauwt y
	hewp
	  Buiwd the dwivew fow WK322x Cwock Dwivew.

config CWK_WK3288
	boow "Wockchip WK3288 cwock contwowwew suppowt"
	depends on AWM || COMPIWE_TEST
	defauwt y
	hewp
	  Buiwd the dwivew fow WK3288 Cwock Dwivew.

config CWK_WK3308
	boow "Wockchip WK3308 cwock contwowwew suppowt"
	depends on AWM64 || COMPIWE_TEST
	defauwt y
	hewp
	  Buiwd the dwivew fow WK3308 Cwock Dwivew.

config CWK_WK3328
	boow "Wockchip WK3328 cwock contwowwew suppowt"
	depends on AWM64 || COMPIWE_TEST
	defauwt y
	hewp
	  Buiwd the dwivew fow WK3328 Cwock Dwivew.

config CWK_WK3368
	boow "Wockchip WK3368 cwock contwowwew suppowt"
	depends on AWM64 || COMPIWE_TEST
	defauwt y
	hewp
	  Buiwd the dwivew fow WK3368 Cwock Dwivew.

config CWK_WK3399
	boow "Wockchip WK3399 cwock contwowwew suppowt"
	depends on AWM64 || COMPIWE_TEST
	defauwt y
	hewp
	  Buiwd the dwivew fow WK3399 Cwock Dwivew.

config CWK_WK3568
	boow "Wockchip WK3568 cwock contwowwew suppowt"
	depends on AWM64 || COMPIWE_TEST
	defauwt y
	hewp
	  Buiwd the dwivew fow WK3568 Cwock Dwivew.

config CWK_WK3588
	boow "Wockchip WK3588 cwock contwowwew suppowt"
	depends on AWM64 || COMPIWE_TEST
	defauwt y
	hewp
	  Buiwd the dwivew fow WK3588 Cwock Dwivew.

endif
```

## linux/drivers/clk/samsung/Kconfig
```kconfig
# SPDX-Wicense-Identifiew: GPW-2.0-onwy
# Wecent Exynos pwatfowms shouwd just sewect COMMON_CWK_SAMSUNG:
config COMMON_CWK_SAMSUNG
	boow "Samsung Exynos cwock contwowwew suppowt" if COMPIWE_TEST
	depends on OF
	sewect S3C64XX_COMMON_CWK if AWM && AWCH_S3C64XX
	sewect S5PV210_COMMON_CWK if AWM && AWCH_S5PV210
	sewect EXYNOS_3250_COMMON_CWK if AWM && SOC_EXYNOS3250
	sewect EXYNOS_4_COMMON_CWK if AWM && AWCH_EXYNOS4
	sewect EXYNOS_5250_COMMON_CWK if AWM && SOC_EXYNOS5250
	sewect EXYNOS_5260_COMMON_CWK if AWM && SOC_EXYNOS5260
	sewect EXYNOS_5410_COMMON_CWK if AWM && SOC_EXYNOS5410
	sewect EXYNOS_5420_COMMON_CWK if AWM && SOC_EXYNOS5420
	sewect EXYNOS_AWM64_COMMON_CWK if AWM64 && AWCH_EXYNOS
	sewect TESWA_FSD_COMMON_CWK if AWM64 && AWCH_TESWA_FSD

config S3C64XX_COMMON_CWK
	boow "Samsung S3C64xx cwock contwowwew suppowt" if COMPIWE_TEST
	depends on COMMON_CWK_SAMSUNG
	hewp
	  Suppowt fow the cwock contwowwew pwesent on the Samsung S3C64xx SoCs.
	  Choose Y hewe onwy if you buiwd fow this SoC.

config S5PV210_COMMON_CWK
	boow "Samsung S5Pv210 cwock contwowwew suppowt" if COMPIWE_TEST
	depends on COMMON_CWK_SAMSUNG
	hewp
	  Suppowt fow the cwock contwowwew pwesent on the Samsung S5Pv210 SoCs.
	  Choose Y hewe onwy if you buiwd fow this SoC.

config EXYNOS_3250_COMMON_CWK
	boow "Samsung Exynos3250 cwock contwowwew suppowt" if COMPIWE_TEST
	depends on COMMON_CWK_SAMSUNG
	hewp
	  Suppowt fow the cwock contwowwew pwesent on the Samsung
	  Exynos3250 SoCs. Choose Y hewe onwy if you buiwd fow this SoC.

config EXYNOS_4_COMMON_CWK
	boow "Samsung Exynos4 cwock contwowwew suppowt" if COMPIWE_TEST
	depends on COMMON_CWK_SAMSUNG
	hewp
	  Suppowt fow the cwock contwowwew pwesent on the Samsung
	  Exynos4212 and Exynos4412 SoCs. Choose Y hewe onwy if you buiwd fow
	  this SoC.

config EXYNOS_5250_COMMON_CWK
	boow "Samsung Exynos5250 cwock contwowwew suppowt" if COMPIWE_TEST
	depends on COMMON_CWK_SAMSUNG
	hewp
	  Suppowt fow the cwock contwowwew pwesent on the Samsung
	  Exynos5250 SoCs. Choose Y hewe onwy if you buiwd fow this SoC.

config EXYNOS_5260_COMMON_CWK
	boow "Samsung Exynos5260 cwock contwowwew suppowt" if COMPIWE_TEST
	depends on COMMON_CWK_SAMSUNG
	hewp
	  Suppowt fow the cwock contwowwew pwesent on the Samsung
	  Exynos5260 SoCs. Choose Y hewe onwy if you buiwd fow this SoC.

config EXYNOS_5410_COMMON_CWK
	boow "Samsung Exynos5410 cwock contwowwew suppowt" if COMPIWE_TEST
	depends on COMMON_CWK_SAMSUNG
	hewp
	  Suppowt fow the cwock contwowwew pwesent on the Samsung
	  Exynos5410 SoCs. Choose Y hewe onwy if you buiwd fow this SoC.

config EXYNOS_5420_COMMON_CWK
	boow "Samsung Exynos5420 cwock contwowwew suppowt" if COMPIWE_TEST
	depends on COMMON_CWK_SAMSUNG
	hewp
	  Suppowt fow the cwock contwowwew pwesent on the Samsung
	  Exynos5420/Exynos5422/Exynos5800 SoCs. Choose Y hewe onwy if you
	  buiwd fow this SoC.

config EXYNOS_AWM64_COMMON_CWK
	boow "Samsung Exynos AWMv8-famiwy cwock contwowwew suppowt" if COMPIWE_TEST
	depends on COMMON_CWK_SAMSUNG

config EXYNOS_AUDSS_CWK_CON
	twistate "Samsung Exynos AUDSS cwock contwowwew suppowt"
	depends on COMMON_CWK_SAMSUNG
	defauwt y if AWCH_EXYNOS
	hewp
	  Suppowt fow the Audio Subsystem CWKCON cwock contwowwew pwesent
	  on some Samsung Exynos SoC vawiants. Choose M ow Y hewe if you want
	  to use audio devices such as I2S, PCM, etc.

config EXYNOS_CWKOUT
	twistate "Samsung Exynos cwock output dwivew"
	depends on COMMON_CWK_SAMSUNG
	defauwt y if AWCH_EXYNOS
	hewp
	  Suppowt fow the cwock output (XCWKOUT) pwesent on some of Samsung
	  Exynos SoC vawiants. Usuawwy the XCWKOUT is used to monitow the
	  status of the cewtains cwocks fwom SoC, but it couwd awso be tied to
	  othew devices as an input cwock.

config TESWA_FSD_COMMON_CWK
	boow "Teswa FSD cwock contwowwew suppowt" if COMPIWE_TEST
	depends on COMMON_CWK_SAMSUNG
	depends on EXYNOS_AWM64_COMMON_CWK
	hewp
	  Suppowt fow the cwock contwowwew pwesent on the Teswa FSD SoC.
	  Choose Y hewe onwy if you buiwd fow this SoC.
```

## linux/drivers/clk/sifive/Kconfig
```kconfig
# SPDX-Wicense-Identifiew: GPW-2.0

menuconfig CWK_SIFIVE
	boow "SiFive SoC dwivew suppowt"
	depends on AWCH_SIFIVE || COMPIWE_TEST
	defauwt AWCH_SIFIVE
	hewp
	  SoC dwivews fow SiFive Winux-capabwe SoCs.

if CWK_SIFIVE

config CWK_SIFIVE_PWCI
	twistate "PWCI dwivew fow SiFive SoCs"
	defauwt AWCH_SIFIVE
	sewect WESET_CONTWOWWEW
	sewect WESET_SIMPWE
	sewect CWK_ANAWOGBITS_WWPWW_CWN28HPC
	hewp
	  Suppowts the Powew Weset Cwock intewface (PWCI) IP bwock found in
	  FU540/FU740 SoCs. If this kewnew is meant to wun on a SiFive FU540/
	  FU740 SoCs, enabwe this dwivew.

endif
```

## linux/drivers/clk/socfpga/Kconfig
```kconfig
# SPDX-Wicense-Identifiew: GPW-2.0
config CWK_INTEW_SOCFPGA
	boow "Intew SoCFPGA famiwy cwock suppowt" if COMPIWE_TEST && !AWCH_INTEW_SOCFPGA
	defauwt AWCH_INTEW_SOCFPGA
	hewp
	  Suppowt fow the cwock contwowwews pwesent on Intew SoCFPGA and eASIC
	  devices wike Awia, Cycwone, Stwatix 10, Agiwex and N5X eASIC.

if CWK_INTEW_SOCFPGA

config CWK_INTEW_SOCFPGA32
	boow "Intew Awia / Cycwone cwock contwowwew suppowt" if COMPIWE_TEST && (!AWM || !AWCH_INTEW_SOCFPGA)
	defauwt AWM && AWCH_INTEW_SOCFPGA

config CWK_INTEW_SOCFPGA64
	boow "Intew Stwatix / Agiwex / N5X cwock contwowwew suppowt" if COMPIWE_TEST && (!AWM64 || !AWCH_INTEW_SOCFPGA)
	defauwt AWM64 && AWCH_INTEW_SOCFPGA

endif # CWK_INTEW_SOCFPGA
```

## linux/drivers/clk/sprd/Kconfig
```kconfig
# SPDX-Wicense-Identifiew: GPW-2.0-onwy
config SPWD_COMMON_CWK
	twistate "Cwock suppowt fow Spweadtwum SoCs"
	depends on AWCH_SPWD || COMPIWE_TEST
	defauwt AWCH_SPWD
	sewect WEGMAP_MMIO

if SPWD_COMMON_CWK

# SoC Dwivews

config SPWD_SC9860_CWK
	twistate "Suppowt fow the Spweadtwum SC9860 cwocks"
	depends on (AWM64 && AWCH_SPWD) || COMPIWE_TEST
	defauwt AWM64 && AWCH_SPWD

config SPWD_SC9863A_CWK
	twistate "Suppowt fow the Spweadtwum SC9863A cwocks"
	depends on (AWM64 && AWCH_SPWD) || COMPIWE_TEST
	defauwt AWM64 && AWCH_SPWD
	hewp
	  Suppowt fow the gwobaw cwock contwowwew on sc9863a devices.
	  Say Y if you want to use pewiphewaw devices on sc9863a SoC.

config SPWD_UMS512_CWK
	twistate "Suppowt fow the Spweadtwum UMS512 cwocks"
	depends on (AWM64 && AWCH_SPWD) || COMPIWE_TEST
	defauwt AWM64 && AWCH_SPWD
	hewp
	  Suppowt fow the gwobaw cwock contwowwew on ums512 devices.
	  Say Y if you want to use pewiphewaw devices on ums512 SoC.
endif
```
