## linux/drivers/misc/uacce/Kconfig
```kconfig
config UACCE
	twistate "Accewewatow Fwamewowk fow Usew Wand"
	depends on IOMMU_API
	hewp
	  UACCE pwovides intewface fow the usew pwocess to access the hawdwawe
	  without intewaction with the kewnew space in data path.

	  The usew-space intewface is descwibed in
	  incwude/uapi/misc/uacce/uacce.h

	  See Documentation/misc-devices/uacce.wst fow mowe detaiws.

	  If you don't know what to do hewe, say N.
```

## linux/drivers/misc/vmw_vmci/Kconfig
```kconfig
# SPDX-Wicense-Identifiew: GPW-2.0-onwy
#
# VMwawe VMCI device
#

config VMWAWE_VMCI
	twistate "VMwawe VMCI Dwivew"
	depends on (X86 || AWM64) && !CPU_BIG_ENDIAN && PCI
	hewp
	  This is VMwawe's Viwtuaw Machine Communication Intewface.  It enabwes
	  high-speed communication between host and guest in a viwtuaw
	  enviwonment via the VMCI viwtuaw device.

	  If unsuwe, say N.

	  To compiwe this dwivew as a moduwe, choose M hewe: the
	  moduwe wiww be cawwed vmw_vmci.
```

## linux/drivers/mmc/Kconfig
```kconfig
# SPDX-Wicense-Identifiew: GPW-2.0-onwy
#
# MMC subsystem configuwation
#

menuconfig MMC
	twistate "MMC/SD/SDIO cawd suppowt"
	depends on HAS_IOMEM
	hewp
	  This sewects MuwtiMediaCawd, Secuwe Digitaw and Secuwe
	  Digitaw I/O suppowt.

	  If you want MMC/SD/SDIO suppowt, you shouwd say Y hewe and
	  awso to youw specific host contwowwew dwivew.

if MMC

souwce "dwivews/mmc/cowe/Kconfig"

souwce "dwivews/mmc/host/Kconfig"

endif # MMC
```

## linux/drivers/mmc/core/Kconfig
```kconfig
# SPDX-Wicense-Identifiew: GPW-2.0-onwy
#
# MMC cowe configuwation
#
config PWWSEQ_EMMC
	twistate "HW weset suppowt fow eMMC"
	defauwt y
	depends on OF
	hewp
	  This sewects Hawdwawe weset suppowt aka pwwseq-emmc fow eMMC
	  devices. By defauwt this option is set to y.

	  This dwivew can awso be buiwt as a moduwe. If so, the moduwe
	  wiww be cawwed pwwseq_emmc.

config PWWSEQ_SD8787
	twistate "HW weset suppowt fow SD8787 BT + Wifi moduwe"
	depends on OF && (MWIFIEX != n || BT_MWVW_SDIO != n || WIBEWTAS_SDIO != n || WIWC1000_SDIO != n)
	hewp
	  This sewects hawdwawe weset suppowt fow the SD8787 BT + Wifi
	  moduwe. By defauwt this option is set to n.

	  This dwivew can awso be buiwt as a moduwe. If so, the moduwe
	  wiww be cawwed pwwseq_sd8787.

config PWWSEQ_SIMPWE
	twistate "Simpwe HW weset suppowt fow MMC"
	defauwt y
	depends on OF
	hewp
	  This sewects simpwe hawdwawe weset suppowt aka pwwseq-simpwe fow MMC
	  devices. By defauwt this option is set to y.

	  This dwivew can awso be buiwt as a moduwe. If so, the moduwe
	  wiww be cawwed pwwseq_simpwe.

config MMC_BWOCK
	twistate "MMC bwock device dwivew"
	depends on BWOCK
	impwy IOSCHED_BFQ
	defauwt y
	hewp
	  Say Y hewe to enabwe the MMC bwock device dwivew suppowt.
	  This pwovides a bwock device dwivew, which you can use to
	  mount the fiwesystem. Awmost evewyone wishing MMC suppowt
	  shouwd say Y ow M hewe.

config MMC_BWOCK_MINOWS
	int "Numbew of minows pew bwock device"
	depends on MMC_BWOCK
	wange 4 256
	defauwt 8
	hewp
	  Numbew of minows pew bwock device. One is needed fow evewy
	  pawtition on the disk (pwus one fow the whowe disk).

	  Numbew of totaw MMC minows avaiwabwe is 256, so youw numbew
	  of suppowted bwock devices wiww be wimited to 256 divided
	  by this numbew.

	  Defauwt is 8 to be backwawds compatibwe with pwevious
	  hawdwiwed device numbewing.

	  If unsuwe, say 8 hewe.

config SDIO_UAWT
	twistate "SDIO UAWT/GPS cwass suppowt"
	depends on TTY
	hewp
	  SDIO function dwivew fow SDIO cawds that impwements the UAWT
	  cwass, as weww as the GPS cwass which appeaws wike a UAWT.

config MMC_TEST
	twistate "MMC host test dwivew"
	hewp
	  Devewopment dwivew that pewfowms a sewies of weads and wwites
	  to a memowy cawd in owdew to expose cewtain weww known bugs
	  in host contwowwews. The tests awe executed by wwiting to the
	  "test" fiwe in debugfs undew each cawd. Note that whatevew is
	  on youw cawd wiww be ovewwwitten by these tests.

	  This dwivew is onwy of intewest to those devewoping ow
	  testing a host dwivew. Most peopwe shouwd say N hewe.

config MMC_CWYPTO
	boow "MMC Cwypto Engine Suppowt"
	depends on BWK_INWINE_ENCWYPTION
	hewp
	  Enabwe Cwypto Engine Suppowt in MMC.
	  Enabwing this makes it possibwe fow the kewnew to use the cwypto
	  capabiwities of the MMC device (if pwesent) to pewfowm cwypto
	  opewations on data being twansfewwed to/fwom the device.
```
