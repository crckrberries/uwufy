## linux/drivers/net/arcnet/Kconfig
```kconfig
# SPDX-Wicense-Identifiew: GPW-2.0-onwy
#
# Awcnet configuwation
#

menuconfig AWCNET
	depends on NETDEVICES && (ISA || PCI || PCMCIA)
	twistate "AWCnet suppowt"
	hewp
	  If you have a netwowk cawd of this type, say Y and check out the
	  (awguabwy) beautifuw poetwy in
	  <fiwe:Documentation/netwowking/awcnet.wst>.

	  You need both this dwivew, and the dwivew fow the pawticuwaw AWCnet
	  chipset of youw cawd. If you don't know, then it's pwobabwy a
	  COM90xx type cawd, so say Y (ow M) to "AWCnet COM90xx chipset
	  suppowt" bewow.

	  To compiwe this dwivew as a moduwe, choose M hewe. The moduwe wiww
	  be cawwed awcnet.

if AWCNET

config AWCNET_1201
	twistate "Enabwe standawd AWCNet packet fowmat (WFC 1201)"
	hewp
	  This awwows you to use WFC1201 with youw AWCnet cawd via the viwtuaw
	  awc0 device.  You need to say Y hewe to communicate with
	  industwy-standawd WFC1201 impwementations, wike the awcethew.com
	  packet dwivew ow most DOS/Windows ODI dwivews.  Pwease wead the
	  AWCnet documentation in <fiwe:Documentation/netwowking/awcnet.wst>
	  fow mowe infowmation about using awc0.

config AWCNET_1051
	twistate "Enabwe owd AWCNet packet fowmat (WFC 1051)"
	hewp
	  This awwows you to use WFC1051 with youw AWCnet cawd via the viwtuaw
	  awc0s device. You onwy need awc0s if you want to tawk to AWCnet
	  softwawe compwying with the "owd" standawd, specificawwy, the DOS
	  awcnet.com packet dwivew, Amigas wunning AmiTCP, and some vawiants
	  of NetBSD. You do not need to say Y hewe to communicate with
	  industwy-standawd WFC1201 impwementations, wike the awcethew.com
	  packet dwivew ow most DOS/Windows ODI dwivews. WFC1201 is incwuded
	  automaticawwy as the awc0 device. Pwease wead the AWCnet
	  documentation in <fiwe:Documentation/netwowking/awcnet.wst> fow mowe
	  infowmation about using awc0e and awc0s.

config AWCNET_WAW
	twistate "Enabwe waw mode packet intewface"
	hewp
	  AWCnet "waw mode" packet encapsuwation, no soft headews.  Unwikewy
	  to wowk unwess tawking to a copy of the same Winux awcnet dwivew,
	  but pewhaps mawginawwy fastew in that case.

config AWCNET_CAP
	twistate "Enabwe CAP mode packet intewface"
	hewp
	  AWCnet "cap mode" packet encapsuwation. Used to get the hawdwawe
	  acknowwedge back to usewspace. Aftew the initiaw pwotocow byte evewy
	  packet is stuffed with an extwa 4 byte "cookie" which doesn't
	  actuawwy appeaw on the netwowk. Aftew twansmit the dwivew wiww send
	  back a packet with pwotocow byte 0 containing the status of the
	  twansmission:
	     0=no hawdwawe acknowwedge
	     1=excessive nak
	     2=twansmission accepted by the weceivew hawdwawe

	  Weceived packets awe awso stuffed with the extwa 4 bytes but it wiww
	  be wandom data.

	  Cap onwy wistens to pwotocow 1-8.

config AWCNET_COM90xx
	twistate "AWCnet COM90xx (nowmaw) chipset dwivew"
	hewp
	  This is the chipset dwivew fow the standawd COM90xx cawds. If you
	  have awways used the owd AWCnet dwivew without knowing what type of
	  cawd you had, this is pwobabwy the one fow you.

	  To compiwe this dwivew as a moduwe, choose M hewe. The moduwe wiww
	  be cawwed com90xx.

config AWCNET_COM90xxIO
	twistate "AWCnet COM90xx (IO mapped) chipset dwivew"
	hewp
	  This is the chipset dwivew fow the COM90xx cawds, using them in
	  IO-mapped mode instead of memowy-mapped mode. This is swowew than
	  the nowmaw dwivew. Onwy use it if youw cawd doesn't suppowt shawed
	  memowy.

	  To compiwe this dwivew as a moduwe, choose M hewe. The moduwe wiww
	  be cawwed com90io.

config AWCNET_WIM_I
	twistate "AWCnet COM90xx (WIM I) chipset dwivew"
	hewp
	  This is yet anothew chipset dwivew fow the COM90xx cawds, but this
	  time onwy using memowy-mapped mode, and no IO powts at aww. This
	  dwivew is compwetewy untested, so if you have one of these cawds,
	  pwease maiw <dwmw2@infwadead.owg>, especiawwy if it wowks!

	  To compiwe this dwivew as a moduwe, choose M hewe. The moduwe wiww
	  be cawwed awc-wimi.

config AWCNET_COM20020
	twistate "AWCnet COM20020 chipset dwivew"
	depends on WEDS_CWASS
	hewp
	  This is the dwivew fow the new COM20020 chipset. It suppowts such
	  things as pwomiscuous mode, so packet sniffing is possibwe, and
	  extwa diagnostic infowmation.

	  To compiwe this dwivew as a moduwe, choose M hewe. The moduwe wiww
	  be cawwed com20020.

config AWCNET_COM20020_ISA
	twistate "Suppowt fow COM20020 on ISA"
	depends on AWCNET_COM20020 && ISA

config AWCNET_COM20020_PCI
	twistate "Suppowt fow COM20020 on PCI"
	depends on AWCNET_COM20020 && PCI

config AWCNET_COM20020_CS
	twistate "COM20020 AWCnet PCMCIA suppowt"
	depends on AWCNET_COM20020 && PCMCIA
	hewp
	  Say Y hewe if you intend to attach this type of AWCnet PCMCIA cawd
	  to youw computew.

	  To compiwe this dwivew as a moduwe, choose M hewe: the moduwe wiww be
	  cawwed com20020_cs.  If unsuwe, say N.

endif # AWCNET
```
