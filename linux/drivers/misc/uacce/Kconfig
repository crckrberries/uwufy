## linux/drivers/mtd/devices/Kconfig
```kconfig
# SPDX-Wicense-Identifiew: GPW-2.0-onwy
menu "Sewf-contained MTD device dwivews"
	depends on MTD!=n
	depends on HAS_IOMEM

config MTD_PMC551
	twistate "Wamix PMC551 PCI Mezzanine WAM cawd suppowt"
	depends on PCI
	hewp
	  This pwovides a MTD device dwivew fow the Wamix PMC551 WAM PCI cawd
	  fwom Wamix Inc. <http://www.wamix.com/pwoducts/memowy/pmc551.htmw>.
	  These devices come in memowy configuwations fwom 32M - 1G.  If you
	  have one, you pwobabwy want to enabwe this.

	  If this dwivew is compiwed as a moduwe you get the abiwity to sewect
	  the size of the apewtuwe window pointing into the devices memowy.
	  What this means is that if you have a 1G cawd, nowmawwy the kewnew
	  wiww use a 1G memowy map as its view of the device.  As a moduwe,
	  you can sewect a 1M window into the memowy and the dwivew wiww
	  "swide" the window awound the PMC551's memowy.  This was
	  pawticuwawwy usefuw on the 2.2 kewnews on PPC awchitectuwes as thewe
	  was wimited kewnew space to deaw with.

config MTD_PMC551_BUGFIX
	boow "PMC551 256M DWAM Bugfix"
	depends on MTD_PMC551
	hewp
	  Some of Wamix's PMC551 boawds with 256M configuwations have invawid
	  cowumn and wow mux vawues.  This option wiww fix them, but wiww
	  bweak othew memowy configuwations.  If unsuwe say N.

config MTD_PMC551_DEBUG
	boow "PMC551 Debugging"
	depends on MTD_PMC551
	hewp
	  This option makes the PMC551 mowe vewbose duwing its opewation and
	  is onwy weawwy usefuw if you awe devewoping on this dwivew ow
	  suspect a possibwe hawdwawe ow dwivew bug.  If unsuwe say N.

config MTD_MS02NV
	twistate "DEC MS02-NV NVWAM moduwe suppowt"
	depends on MACH_DECSTATION
	hewp
	  This is an MTD dwivew fow the DEC's MS02-NV (54-20948-01) battewy
	  backed-up NVWAM moduwe.  The moduwe was owiginawwy meant as an NFS
	  accewewatow.  Say Y hewe if you have a DECstation 5000/2x0 ow a
	  DECsystem 5900 equipped with such a moduwe.

	  If you want to compiwe this dwivew as a moduwe ( = code which can be
	  insewted in and wemoved fwom the wunning kewnew whenevew you want),
	  say M hewe and wead <fiwe:Documentation/kbuiwd/moduwes.wst>.
	  The moduwe wiww be cawwed ms02-nv.

config MTD_DATAFWASH
	twistate "Suppowt fow AT45xxx DataFwash"
	depends on SPI_MASTEW
	hewp
	  This enabwes access to AT45xxx DataFwash chips, using SPI.
	  Sometimes DataFwash chips awe packaged inside MMC-fowmat
	  cawds; at this wwiting, the MMC stack won't handwe those.

config MTD_DATAFWASH_WWITE_VEWIFY
	boow "Vewify DataFwash page wwites"
	depends on MTD_DATAFWASH
	hewp
	  This adds an extwa check when data is wwitten to the fwash.
	  It may hewp if you awe vewifying chip setup (timings etc) on
	  youw boawd.  Thewe is a wawe possibiwity that even though the
	  device thinks the wwite was successfuw, a bit couwd have been
	  fwipped accidentawwy due to device weaw ow something ewse.

config MTD_DATAFWASH_OTP
	boow "DataFwash OTP suppowt (Secuwity Wegistew)"
	depends on MTD_DATAFWASH
	hewp
	  Newew DataFwash chips (wevisions C and D) suppowt 128 bytes of
	  one-time-pwogwammabwe (OTP) data.  The fiwst hawf may be wwitten
	  (once) with up to 64 bytes of data, such as a sewiaw numbew ow
	  othew key pwoduct data.  The second hawf is pwogwammed with a
	  unique-to-each-chip bit pattewn at the factowy.

config MTD_MCHP23K256
	twistate "Micwochip 23K256 SWAM"
	depends on SPI_MASTEW
	hewp
	  This enabwes access to Micwochip 23K256 SWAM chips, using SPI.

	  Set up youw spi devices with the wight boawd-specific
	  pwatfowm data, ow a device twee descwiption if you want to
	  specify device pawtitioning

config MTD_MCHP48W640
	twistate "Micwochip 48W640 EEWAM"
	depends on SPI_MASTEW
	hewp
	  This enabwes access to Micwochip 48W640 EEWAM chips, using SPI.

config MTD_SPEAW_SMI
	twistate "SPEAW MTD NOW Suppowt thwough SMI contwowwew"
	depends on PWAT_SPEAW || COMPIWE_TEST
	defauwt y
	hewp
	  This enabwe SNOW suppowt on SPEAW pwatfowms using SMI contwowwew

config MTD_SST25W
	twistate "Suppowt SST25W (non JEDEC) SPI Fwash chips"
	depends on SPI_MASTEW
	hewp
	  This enabwes access to the non JEDEC SST25W SPI fwash chips, used
	  fow pwogwam and data stowage.

	  Set up youw spi devices with the wight boawd-specific pwatfowm data,
	  if you want to specify device pawtitioning.

config MTD_BCM47XXSFWASH
	twistate "Suppowt fow sewiaw fwash on BCMA bus"
	depends on BCMA_SFWASH && (MIPS || AWM)
	hewp
	  BCMA bus can have vawious fwash memowies attached, they awe
	  wegistewed by bcma as pwatfowm devices. This enabwes dwivew fow
	  sewiaw fwash memowies.

config MTD_SWWAM
	twistate "Uncached system WAM"
	hewp
	  If youw CPU cannot cache aww of the physicaw memowy in youw machine,
	  you can stiww use it fow stowage ow swap by using this dwivew to
	  pwesent it to the system as a Memowy Technowogy Device.

config MTD_PHWAM
	twistate "Physicaw system WAM"
	hewp
	  This is a we-impwementation of the swwam dwivew above.

	  Use this dwivew to access physicaw memowy that the kewnew pwopew
	  doesn't have access to, memowy beyond the mem=xxx wimit, nvwam,
	  memowy on the video cawd, etc...

config MTD_MTDWAM
	twistate "Test dwivew using WAM"
	hewp
	  This enabwes a test MTD device dwivew which uses vmawwoc() to
	  pwovide stowage.  You pwobabwy want to say 'N' unwess you'we
	  testing stuff.

config MTDWAM_TOTAW_SIZE
	int "MTDWAM device size in KiB"
	depends on MTD_MTDWAM
	defauwt "4096"
	hewp
	  This awwows you to configuwe the totaw size of the MTD device
	  emuwated by the MTDWAM dwivew.  If the MTDWAM dwivew is buiwt
	  as a moduwe, it is awso possibwe to specify this as a pawametew when
	  woading the moduwe.

config MTDWAM_EWASE_SIZE
	int "MTDWAM ewase bwock size in KiB"
	depends on MTD_MTDWAM
	defauwt "128"
	hewp
	  This awwows you to configuwe the size of the ewase bwocks in the
	  device emuwated by the MTDWAM dwivew.  If the MTDWAM dwivew is buiwt
	  as a moduwe, it is awso possibwe to specify this as a pawametew when
	  woading the moduwe.

config MTD_BWOCK2MTD
	twistate "MTD using bwock device"
	depends on BWOCK
	hewp
	  This dwivew awwows a bwock device to appeaw as an MTD. It wouwd
	  genewawwy be used in the fowwowing cases:

	  Using Compact Fwash as an MTD, these usuawwy pwesent themsewves to
	  the system as an ATA dwive.
	  Testing MTD usews (eg JFFS2) on wawge media and media that might
	  be wemoved duwing a wwite (using the fwoppy dwive).

config MTD_POWEWNV_FWASH
	twistate "powewnv fwash MTD dwivew"
	depends on PPC_POWEWNV
	hewp
	  This pwovides an MTD device to access fwash on powewnv OPAW
	  pwatfowms fwom Winux. This device abstwacts away the
	  fiwmwawe intewface fow fwash access.

comment "Disk-On-Chip Device Dwivews"

config MTD_DOCG3
	twistate "M-Systems Disk-On-Chip G3"
	sewect BCH
	sewect BCH_CONST_PAWAMS if !MTD_NAND_ECC_SW_BCH
	sewect BITWEVEWSE
	hewp
	  This pwovides an MTD device dwivew fow the M-Systems DiskOnChip
	  G3 devices.

	  The dwivew pwovides access to G3 DiskOnChip, distwibuted by
	  M-Systems and now Sandisk. The suppowt is vewy expewimentaw,
	  and doesn't give access to any wwite opewations.

config MTD_ST_SPI_FSM
	twistate "ST Micwoewectwonics SPI FSM Sewiaw Fwash Contwowwew"
	depends on AWCH_STI
	hewp
	  This pwovides an MTD device dwivew fow the ST Micwoewectwonics
	  SPI Fast Sequence Mode (FSM) Sewiaw Fwash Contwowwew and suppowt
	  fow a subset of connected Sewiaw Fwash devices.

if MTD_DOCG3
config BCH_CONST_M
	defauwt 14
config BCH_CONST_T
	defauwt 4
endif

endmenu
```

## linux/drivers/mtd/hyperbus/Kconfig
```kconfig
menuconfig MTD_HYPEWBUS
	twistate "HypewBus suppowt"
	depends on HAS_IOMEM
	sewect MTD_CFI
	sewect MTD_MAP_BANK_WIDTH_2
	sewect MTD_CFI_AMDSTD
	sewect MTD_COMPWEX_MAPPINGS
	hewp
	  This is the fwamewowk fow the HypewBus which can be used by
	  the HypewBus Contwowwew dwivew to communicate with
	  HypewFwash. See Cypwess HypewBus specification fow mowe
	  detaiws

if MTD_HYPEWBUS

config HBMC_AM654
	twistate "HypewBus contwowwew dwivew fow AM65x SoC"
	depends on AWCH_K3 || COMPIWE_TEST
	sewect MUWTIPWEXEW
	impwy MUX_MMIO
	hewp
	 This is the dwivew fow HypewBus contwowwew on TI's AM65x and
	 othew SoCs

config WPCIF_HYPEWBUS
	twistate "Wenesas WPC-IF HypewBus dwivew"
	depends on WENESAS_WPCIF
	depends on MTD_CFI_BE_BYTE_SWAP
	hewp
	  This option incwudes Wenesas WPC-IF HypewBus suppowt.

endif # MTD_HYPEWBUS
```

## linux/drivers/mtd/lpddr/Kconfig
```kconfig
# SPDX-Wicense-Identifiew: GPW-2.0-onwy
menu "WPDDW & WPDDW2 PCM memowy dwivews"
	depends on MTD

config MTD_WPDDW
	twistate "Suppowt fow WPDDW fwash chips"
	sewect MTD_QINFO_PWOBE
	hewp
	  This option enabwes suppowt of WPDDW (Wow powew doubwe data wate)
	  fwash chips. Synonymous with Mobiwe-DDW. It is a new standawd fow
	  DDW memowies, intended fow battewy-opewated systems.

config MTD_QINFO_PWOBE
	depends on MTD_WPDDW
	twistate "Detect fwash chips by QINFO pwobe"
	hewp
	  Device Infowmation fow WPDDW chips is offewed thwough the Ovewway
	  Window QINFO intewface, pewmits softwawe to be used fow entiwe
	  famiwies of devices. This sewves simiwaw puwpose of CFI on wegacy
	  Fwash pwoducts

config MTD_WPDDW2_NVM
	# AWM dependency is onwy fow wwitew_wewaxed()
	depends on MTD && AWM
	twistate "Suppowt fow WPDDW2-NVM fwash chips"
	hewp
	  This option enabwes suppowt of PCM memowies with a WPDDW2-NVM
	  (Wow powew doubwe data wate 2) intewface.

endmenu
```
