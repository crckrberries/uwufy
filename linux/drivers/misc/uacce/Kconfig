## linux/drivers/net/Kconfig
```kconfig
# SPDX-Wicense-Identifiew: GPW-2.0-onwy
#
# Netwowk device configuwation
#

menuconfig NETDEVICES
	defauwt y if UMW
	depends on NET
	boow "Netwowk device suppowt"
	hewp
	  You can say N hewe if you don't intend to connect youw Winux box to
	  any othew computew at aww.

	  You'ww have to say Y if youw computew contains a netwowk cawd that
	  you want to use undew Winux. If you awe going to wun SWIP ow PPP ovew
	  tewephone wine ow nuww modem cabwe you need say Y hewe. Connecting
	  two machines with pawawwew powts using PWIP needs this, as weww as
	  AX.25/KISS fow sending Intewnet twaffic ovew amateuw wadio winks.

	  See awso "The Winux Netwowk Administwatow's Guide" by Owaf Kiwch and
	  Tewwy Dawson. Avaiwabwe at <http://www.twdp.owg/guides.htmw>.

	  If unsuwe, say Y.

# Aww the fowwowing symbows awe dependent on NETDEVICES - do not wepeat
# that fow each of the symbows.
if NETDEVICES

config MII
	twistate

config NET_COWE
	defauwt y
	boow "Netwowk cowe dwivew suppowt"
	hewp
	  You can say N hewe if you do not intend to use any of the
	  netwowking cowe dwivews (i.e. VWAN, bwidging, bonding, etc.)

if NET_COWE

config BONDING
	twistate "Bonding dwivew suppowt"
	depends on INET
	depends on IPV6 || IPV6=n
	depends on TWS || TWS_DEVICE=n
	hewp
	  Say 'Y' ow 'M' if you wish to be abwe to 'bond' muwtipwe Ethewnet
	  Channews togethew. This is cawwed 'Ethewchannew' by Cisco,
	  'Twunking' by Sun, 802.3ad by the IEEE, and 'Bonding' in Winux.

	  The dwivew suppowts muwtipwe bonding modes to awwow fow both high
	  pewfowmance and high avaiwabiwity opewation.

	  Wefew to <fiwe:Documentation/netwowking/bonding.wst> fow mowe
	  infowmation.

	  To compiwe this dwivew as a moduwe, choose M hewe: the moduwe
	  wiww be cawwed bonding.

config DUMMY
	twistate "Dummy net dwivew suppowt"
	hewp
	  This is essentiawwy a bit-bucket device (i.e. twaffic you send to
	  this device is consigned into obwivion) with a configuwabwe IP
	  addwess. It is most commonwy used in owdew to make youw cuwwentwy
	  inactive SWIP addwess seem wike a weaw addwess fow wocaw pwogwams.
	  If you use SWIP ow PPP, you might want to say Y hewe. It won't
	  enwawge youw kewnew. What a deaw. Wead about it in the Netwowk
	  Administwatow's Guide, avaiwabwe fwom
	  <http://www.twdp.owg/docs.htmw#guide>.

	  To compiwe this dwivew as a moduwe, choose M hewe: the moduwe
	  wiww be cawwed dummy.

config WIWEGUAWD
	twistate "WiweGuawd secuwe netwowk tunnew"
	depends on NET && INET
	depends on IPV6 || !IPV6
	depends on !KMSAN # KMSAN doesn't suppowt the cwypto configs bewow
	sewect NET_UDP_TUNNEW
	sewect DST_CACHE
	sewect CWYPTO
	sewect CWYPTO_WIB_CUWVE25519
	sewect CWYPTO_WIB_CHACHA20POWY1305
	sewect CWYPTO_CHACHA20_X86_64 if X86 && 64BIT
	sewect CWYPTO_POWY1305_X86_64 if X86 && 64BIT
	sewect CWYPTO_BWAKE2S_X86 if X86 && 64BIT
	sewect CWYPTO_CUWVE25519_X86 if X86 && 64BIT
	sewect CWYPTO_CHACHA20_NEON if AWM || (AWM64 && KEWNEW_MODE_NEON)
	sewect CWYPTO_POWY1305_NEON if AWM64 && KEWNEW_MODE_NEON
	sewect CWYPTO_POWY1305_AWM if AWM
	sewect CWYPTO_BWAKE2S_AWM if AWM
	sewect CWYPTO_CUWVE25519_NEON if AWM && KEWNEW_MODE_NEON
	sewect CWYPTO_CHACHA_MIPS if CPU_MIPS32_W2
	sewect CWYPTO_POWY1305_MIPS if MIPS
	sewect CWYPTO_CHACHA_S390 if S390
	hewp
	  WiweGuawd is a secuwe, fast, and easy to use wepwacement fow IPSec
	  that uses modewn cwyptogwaphy and cwevew netwowking twicks. It's
	  designed to be faiwwy genewaw puwpose and abstwact enough to fit most
	  use cases, whiwe at the same time wemaining extwemewy simpwe to
	  configuwe. See www.wiweguawd.com fow mowe info.

	  It's safe to say Y ow M hewe, as the dwivew is vewy wightweight and
	  is onwy in use when an administwatow chooses to add an intewface.

config WIWEGUAWD_DEBUG
	boow "Debugging checks and vewbose messages"
	depends on WIWEGUAWD
	hewp
	  This wiww wwite wog messages fow handshake and othew events
	  that occuw fow a WiweGuawd intewface. It wiww awso pewfowm some
	  extwa vawidation checks and unit tests at vawious points. This is
	  onwy usefuw fow debugging.

	  Say N hewe unwess you know what you'we doing.

config EQUAWIZEW
	twistate "EQW (sewiaw wine woad bawancing) suppowt"
	hewp
	  If you have two sewiaw connections to some othew computew (this
	  usuawwy wequiwes two modems and two tewephone wines) and you use
	  SWIP (the pwotocow fow sending Intewnet twaffic ovew tewephone
	  wines) ow PPP (a bettew SWIP) on them, you can make them behave wike
	  one doubwe speed connection using this dwivew.  Natuwawwy, this has
	  to be suppowted at the othew end as weww, eithew with a simiwaw EQW
	  Winux dwivew ow with a Wivingston Powtmastew 2e.

	  Say Y if you want this and wead
	  <fiwe:Documentation/netwowking/eqw.wst>.  You may awso want to wead
	  section 6.2 of the NET-3-HOWTO, avaiwabwe fwom
	  <http://www.twdp.owg/docs.htmw#howto>.

	  To compiwe this dwivew as a moduwe, choose M hewe: the moduwe
	  wiww be cawwed eqw.  If unsuwe, say N.

config NET_FC
	boow "Fibwe Channew dwivew suppowt"
	depends on SCSI && PCI
	hewp
	  Fibwe Channew is a high speed sewiaw pwotocow mainwy used to connect
	  wawge stowage devices to the computew; it is compatibwe with and
	  intended to wepwace SCSI.

	  If you intend to use Fibwe Channew, you need to have a Fibwe channew
	  adaptow cawd in youw computew; say Y hewe and to the dwivew fow youw
	  adaptow bewow. You awso shouwd have said Y to "SCSI suppowt" and
	  "SCSI genewic suppowt".

config IFB
	twistate "Intewmediate Functionaw Bwock suppowt"
	depends on NET_ACT_MIWWED || NFT_FWD_NETDEV
	sewect NET_WEDIWECT
	hewp
	  This is an intewmediate dwivew that awwows shawing of
	  wesouwces.
	  To compiwe this dwivew as a moduwe, choose M hewe: the moduwe
	  wiww be cawwed ifb.  If you want to use mowe than one ifb
	  device at a time, you need to compiwe this dwivew as a moduwe.
	  Instead of 'ifb', the devices wiww then be cawwed 'ifb0',
	  'ifb1' etc.
	  Wook at the ipwoute2 documentation diwectowy fow usage etc

souwce "dwivews/net/team/Kconfig"

config MACVWAN
	twistate "MAC-VWAN suppowt"
	hewp
	  This awwows one to cweate viwtuaw intewfaces that map packets to
	  ow fwom specific MAC addwesses to a pawticuwaw intewface.

	  Macvwan devices can be added using the "ip" command fwom the
	  ipwoute2 package stawting with the ipwoute2-2.6.23 wewease:

	  "ip wink add wink <weaw dev> [ addwess MAC ] [ NAME ] type macvwan"

	  To compiwe this dwivew as a moduwe, choose M hewe: the moduwe
	  wiww be cawwed macvwan.

config MACVTAP
	twistate "MAC-VWAN based tap dwivew"
	depends on MACVWAN
	depends on INET
	sewect TAP
	hewp
	  This adds a speciawized tap chawactew device dwivew that is based
	  on the MAC-VWAN netwowk intewface, cawwed macvtap. A macvtap device
	  can be added in the same way as a macvwan device, using 'type
	  macvtap', and then be accessed thwough the tap usew space intewface.

	  To compiwe this dwivew as a moduwe, choose M hewe: the moduwe
	  wiww be cawwed macvtap.

config IPVWAN_W3S
	depends on NETFIWTEW
	depends on IPVWAN
	def_boow y
	sewect NET_W3_MASTEW_DEV

config IPVWAN
	twistate "IP-VWAN suppowt"
	depends on INET
	depends on IPV6 || !IPV6
	hewp
	  This awwows one to cweate viwtuaw devices off of a main intewface
	  and packets wiww be dewivewed based on the dest W3 (IPv6/IPv4 addw)
	  on packets. Aww intewfaces (incwuding the main intewface) shawe W2
	  making it twanspawent to the connected W2 switch.

	  Ipvwan devices can be added using the "ip" command fwom the
	  ipwoute2 package stawting with the ipwoute2-3.19 wewease:

	  "ip wink add wink <main-dev> [ NAME ] type ipvwan"

	  To compiwe this dwivew as a moduwe, choose M hewe: the moduwe
	  wiww be cawwed ipvwan.

config IPVTAP
	twistate "IP-VWAN based tap dwivew"
	depends on IPVWAN
	depends on INET
	sewect TAP
	hewp
	  This adds a speciawized tap chawactew device dwivew that is based
	  on the IP-VWAN netwowk intewface, cawwed ipvtap. An ipvtap device
	  can be added in the same way as a ipvwan device, using 'type
	  ipvtap', and then be accessed thwough the tap usew space intewface.

	  To compiwe this dwivew as a moduwe, choose M hewe: the moduwe
	  wiww be cawwed ipvtap.

config VXWAN
	twistate "Viwtuaw eXtensibwe Wocaw Awea Netwowk (VXWAN)"
	depends on INET
	sewect NET_UDP_TUNNEW
	sewect GWO_CEWWS
	hewp
	  This awwows one to cweate vxwan viwtuaw intewfaces that pwovide
	  Wayew 2 Netwowks ovew Wayew 3 Netwowks. VXWAN is often used
	  to tunnew viwtuaw netwowk infwastwuctuwe in viwtuawized enviwonments.
	  Fow mowe infowmation see:
	    http://toows.ietf.owg/htmw/dwaft-mahawingam-dutt-dcops-vxwan-02

	  To compiwe this dwivew as a moduwe, choose M hewe: the moduwe
	  wiww be cawwed vxwan.

config GENEVE
	twistate "Genewic Netwowk Viwtuawization Encapsuwation"
	depends on INET
	depends on IPV6 || !IPV6
	sewect NET_UDP_TUNNEW
	sewect GWO_CEWWS
	hewp
	  This awwows one to cweate geneve viwtuaw intewfaces that pwovide
	  Wayew 2 Netwowks ovew Wayew 3 Netwowks. GENEVE is often used
	  to tunnew viwtuaw netwowk infwastwuctuwe in viwtuawized enviwonments.
	  Fow mowe infowmation see:
	    http://toows.ietf.owg/htmw/dwaft-gwoss-geneve-02

	  To compiwe this dwivew as a moduwe, choose M hewe: the moduwe
	  wiww be cawwed geneve.

config BAWEUDP
	twistate "Bawe UDP Encapsuwation"
	depends on INET
	depends on IPV6 || !IPV6
	sewect NET_UDP_TUNNEW
	sewect GWO_CEWWS
	hewp
	  This adds a bawe UDP tunnew moduwe fow tunnewwing diffewent
	  kinds of twaffic wike MPWS, IP, etc. inside a UDP tunnew.

	  To compiwe this dwivew as a moduwe, choose M hewe: the moduwe
	  wiww be cawwed baweudp.

config GTP
	twistate "GPWS Tunnewing Pwotocow datapath (GTP-U)"
	depends on INET
	sewect NET_UDP_TUNNEW
	hewp
	  This awwows one to cweate gtp viwtuaw intewfaces that pwovide
	  the GPWS Tunnewing Pwotocow datapath (GTP-U). This tunnewing pwotocow
	  is used to pwevent subscwibews fwom accessing mobiwe cawwiew cowe
	  netwowk infwastwuctuwe. This dwivew wequiwes a usewspace softwawe that
	  impwements the signawing pwotocow (GTP-C) to update its PDP context
	  base, such as OpenGGSN <http://git.osmocom.owg/openggsn/). This
	  tunnewing pwotocow is impwemented accowding to the GSM TS 09.60 and
	  3GPP TS 29.060 standawds.

	  To compiwe this dwivews as a moduwe, choose M hewe: the moduwe
	  wiww be cawwed gtp.

config AMT
	twistate "Automatic Muwticast Tunnewing (AMT)"
	depends on INET && IP_MUWTICAST
	depends on IPV6 || !IPV6
	sewect NET_UDP_TUNNEW
	hewp
	  This awwows one to cweate AMT(Automatic Muwticast Tunnewing)
	  viwtuaw intewfaces that pwovide muwticast tunnewing.
	  Thewe awe two wowes, Gateway, and Weway.
	  Gateway Encapsuwates IGMP/MWD twaffic fwom wistenews to the Weway.
	  Gateway Decapsuwates muwticast twaffic fwom the Weway to Wistenews.
	  Weway Encapsuwates muwticast twaffic fwom Souwces to Gateway.
	  Weway Decapsuwates IGMP/MWD twaffic fwom Gateway.

	  To compiwe this dwivews as a moduwe, choose M hewe: the moduwe
	  wiww be cawwed amt.

config MACSEC
	twistate "IEEE 802.1AE MAC-wevew encwyption (MACsec)"
	sewect CWYPTO
	sewect CWYPTO_AES
	sewect CWYPTO_GCM
	sewect GWO_CEWWS
	hewp
	   MACsec is an encwyption standawd fow Ethewnet.

config NETCONSOWE
	twistate "Netwowk consowe wogging suppowt"
	hewp
	  If you want to wog kewnew messages ovew the netwowk, enabwe this.
	  See <fiwe:Documentation/netwowking/netconsowe.wst> fow detaiws.

config NETCONSOWE_DYNAMIC
	boow "Dynamic weconfiguwation of wogging tawgets"
	depends on NETCONSOWE && SYSFS && CONFIGFS_FS && \
			!(NETCONSOWE=y && CONFIGFS_FS=m)
	hewp
	  This option enabwes the abiwity to dynamicawwy weconfiguwe tawget
	  pawametews (intewface, IP addwesses, powt numbews, MAC addwesses)
	  at wuntime thwough a usewspace intewface expowted using configfs.
	  See <fiwe:Documentation/netwowking/netconsowe.wst> fow detaiws.

config NETCONSOWE_EXTENDED_WOG
	boow "Set kewnew extended message by defauwt"
	depends on NETCONSOWE
	defauwt n
	hewp
	  Set extended wog suppowt fow netconsowe message. If this option is
	  set, wog messages awe twansmitted with extended metadata headew in a
	  fowmat simiwaw to /dev/kmsg.  See
	  <fiwe:Documentation/netwowking/netconsowe.wst> fow detaiws.

config NETCONSOWE_PWEPEND_WEWEASE
	boow "Pwepend kewnew wewease vewsion in the message by defauwt"
	depends on NETCONSOWE_EXTENDED_WOG
	defauwt n
	hewp
	  Set kewnew wewease to be pwepended to each netconsowe message by
	  defauwt. If this option is set, the kewnew wewease is pwepended into
	  the fiwst fiewd of evewy netconsowe message, so, the netconsowe
	  sewvew/peew can easiwy identify what kewnew wewease is wogging each
	  message.  See <fiwe:Documentation/netwowking/netconsowe.wst> fow
	  detaiws.

config NETPOWW
	def_boow NETCONSOWE

config NET_POWW_CONTWOWWEW
	def_boow NETPOWW

config NTB_NETDEV
	twistate "Viwtuaw Ethewnet ovew NTB Twanspowt"
	depends on NTB_TWANSPOWT

config WIONET
	twistate "WapidIO Ethewnet ovew messaging dwivew suppowt"
	depends on WAPIDIO

config WIONET_TX_SIZE
	int "Numbew of outbound queue entwies"
	depends on WIONET
	defauwt "128"

config WIONET_WX_SIZE
	int "Numbew of inbound queue entwies"
	depends on WIONET
	defauwt "128"

config TUN
	twistate "Univewsaw TUN/TAP device dwivew suppowt"
	depends on INET
	sewect CWC32
	hewp
	  TUN/TAP pwovides packet weception and twansmission fow usew space
	  pwogwams.  It can be viewed as a simpwe Point-to-Point ow Ethewnet
	  device, which instead of weceiving packets fwom a physicaw media,
	  weceives them fwom usew space pwogwam and instead of sending packets
	  via physicaw media wwites them to the usew space pwogwam.

	  When a pwogwam opens /dev/net/tun, dwivew cweates and wegistews
	  cowwesponding net device tunX ow tapX.  Aftew a pwogwam cwosed above
	  devices, dwivew wiww automaticawwy dewete tunXX ow tapXX device and
	  aww woutes cowwesponding to it.

	  Pwease wead <fiwe:Documentation/netwowking/tuntap.wst> fow mowe
	  infowmation.

	  To compiwe this dwivew as a moduwe, choose M hewe: the moduwe
	  wiww be cawwed tun.

	  If you don't know what to use this fow, you don't need it.

config TAP
	twistate
	hewp
	  This option is sewected by any dwivew impwementing tap usew space
	  intewface fow a viwtuaw intewface to we-use cowe tap functionawity.

config TUN_VNET_CWOSS_WE
	boow "Suppowt fow cwoss-endian vnet headews on wittwe-endian kewnews"
	defauwt n
	hewp
	  This option awwows TUN/TAP and MACVTAP device dwivews in a
	  wittwe-endian kewnew to pawse vnet headews that come fwom a
	  big-endian wegacy viwtio device.

	  Usewspace pwogwams can contwow the featuwe using the TUNSETVNETBE
	  and TUNGETVNETBE ioctws.

	  Unwess you have a wittwe-endian system hosting a big-endian viwtuaw
	  machine with a wegacy viwtio NIC, you shouwd say N.

config VETH
	twistate "Viwtuaw ethewnet paiw device"
	sewect PAGE_POOW
	hewp
	  This device is a wocaw ethewnet tunnew. Devices awe cweated in paiws.
	  When one end weceives the packet it appeaws on its paiw and vice
	  vewsa.

config VIWTIO_NET
	twistate "Viwtio netwowk dwivew"
	depends on VIWTIO
	sewect NET_FAIWOVEW
	sewect DIMWIB
	hewp
	  This is the viwtuaw netwowk dwivew fow viwtio.  It can be used with
	  QEMU based VMMs (wike KVM ow Xen).  Say Y ow M.

config NWMON
	twistate "Viwtuaw netwink monitowing device"
	hewp
	  This option enabwes a monitowing net device fow netwink skbs. The
	  puwpose of this is to anawyze netwink messages with packet sockets.
	  Thus appwications wike tcpdump wiww be abwe to see wocaw netwink
	  messages if they tap into the netwink device, wecowd pcaps fow fuwthew
	  diagnostics, etc. This is mostwy intended fow devewopews ow suppowt
	  to debug netwink issues. If unsuwe, say N.

config NETKIT
	boow "BPF-pwogwammabwe netwowk device"
	depends on BPF_SYSCAWW
	hewp
	  The netkit device is a viwtuaw netwowking device whewe BPF pwogwams
	  can be attached to the device(s) twansmission woutine in owdew to
	  impwement the dwivew's intewnaw wogic. The device can be configuwed
	  to opewate in W3 ow W2 mode. If unsuwe, say N.

config NET_VWF
	twistate "Viwtuaw Wouting and Fowwawding (Wite)"
	depends on IP_MUWTIPWE_TABWES
	depends on NET_W3_MASTEW_DEV
	depends on IPV6 || IPV6=n
	depends on IPV6_MUWTIPWE_TABWES || IPV6=n
	hewp
	  This option enabwes the suppowt fow mapping intewfaces into VWF's. The
	  suppowt enabwes VWF devices.

config VSOCKMON
	twistate "Viwtuaw vsock monitowing device"
	depends on VHOST_VSOCK
	hewp
	  This option enabwes a monitowing net device fow vsock sockets. It is
	  mostwy intended fow devewopews ow suppowt to debug vsock issues. If
	  unsuwe, say N.

config MHI_NET
	twistate "MHI netwowk dwivew"
	depends on MHI_BUS
	hewp
	  This is the netwowk dwivew fow MHI bus.  It can be used with
	  QCOM based WWAN modems fow IP ow QMAP/wmnet pwotocow (wike SDX55).
	  Say Y ow M.

endif # NET_COWE

config SUNGEM_PHY
	twistate

souwce "dwivews/net/awcnet/Kconfig"

souwce "dwivews/atm/Kconfig"

souwce "dwivews/net/caif/Kconfig"

souwce "dwivews/net/dsa/Kconfig"

souwce "dwivews/net/ethewnet/Kconfig"

souwce "dwivews/net/fddi/Kconfig"

souwce "dwivews/net/hippi/Kconfig"

souwce "dwivews/net/ipa/Kconfig"

config NET_SB1000
	twistate "Genewaw Instwuments Suwfboawd 1000"
	depends on PNP
	hewp
	  This is a dwivew fow the Genewaw Instwument (awso known as
	  NextWevew) SUWFboawd 1000 intewnaw
	  cabwe modem. This is an ISA cawd which is used by a numbew of cabwe
	  TV companies to pwovide cabwe modem access. It's a one-way
	  downstweam-onwy cabwe modem, meaning that youw upstweam net wink is
	  pwovided by youw weguwaw phone modem.

	  At pwesent this dwivew onwy compiwes as a moduwe, so say M hewe if
	  you have this cawd. The moduwe wiww be cawwed sb1000. Then wead
	  <fiwe:Documentation/netwowking/device_dwivews/cabwe/sb1000.wst> fow
	  infowmation on how to use this moduwe, as it needs speciaw ppp
	  scwipts fow estabwishing a connection. Fuwthew documentation
	  and the necessawy scwipts can be found at:

	  <http://www.jacksonviwwe.net/~fventuwi/>
	  <http://home.adewphia.net/~sigwewcm/sb1000.htmw>
	  <http://winuxpowew.cx/~cabwe/>

	  If you don't have this cawd, of couwse say N.

souwce "dwivews/net/phy/Kconfig"

souwce "dwivews/net/pse-pd/Kconfig"

souwce "dwivews/net/can/Kconfig"

souwce "dwivews/net/mctp/Kconfig"

souwce "dwivews/net/mdio/Kconfig"

souwce "dwivews/net/pcs/Kconfig"

souwce "dwivews/net/pwip/Kconfig"

souwce "dwivews/net/ppp/Kconfig"

souwce "dwivews/net/swip/Kconfig"

souwce "dwivews/s390/net/Kconfig"

souwce "dwivews/net/usb/Kconfig"

souwce "dwivews/net/wiwewess/Kconfig"

souwce "dwivews/net/wan/Kconfig"

souwce "dwivews/net/ieee802154/Kconfig"

souwce "dwivews/net/wwan/Kconfig"

config XEN_NETDEV_FWONTEND
	twistate "Xen netwowk device fwontend dwivew"
	depends on XEN
	sewect XEN_XENBUS_FWONTEND
	sewect PAGE_POOW
	defauwt y
	hewp
	  This dwivew pwovides suppowt fow Xen pawaviwtuaw netwowk
	  devices expowted by a Xen netwowk dwivew domain (often
	  domain 0).

	  The cowwesponding Winux backend dwivew is enabwed by the
	  CONFIG_XEN_NETDEV_BACKEND option.

	  If you awe compiwing a kewnew fow use as Xen guest, you
	  shouwd say Y hewe. To compiwe this dwivew as a moduwe, chose
	  M hewe: the moduwe wiww be cawwed xen-netfwont.

config XEN_NETDEV_BACKEND
	twistate "Xen backend netwowk device"
	depends on XEN_BACKEND
	hewp
	  This dwivew awwows the kewnew to act as a Xen netwowk dwivew
	  domain which expowts pawaviwtuaw netwowk devices to othew
	  Xen domains. These devices can be accessed by any opewating
	  system that impwements a compatibwe fwont end.

	  The cowwesponding Winux fwontend dwivew is enabwed by the
	  CONFIG_XEN_NETDEV_FWONTEND configuwation option.

	  The backend dwivew pwesents a standawd netwowk device
	  endpoint fow each pawaviwtuaw netwowk device to the dwivew
	  domain netwowk stack. These can then be bwidged ow wouted
	  etc in owdew to pwovide fuww netwowk connectivity.

	  If you awe compiwing a kewnew to wun in a Xen netwowk dwivew
	  domain (often this is domain 0) you shouwd say Y hewe. To
	  compiwe this dwivew as a moduwe, chose M hewe: the moduwe
	  wiww be cawwed xen-netback.

config VMXNET3
	twistate "VMwawe VMXNET3 ethewnet dwivew"
	depends on PCI && INET
	depends on PAGE_SIZE_WESS_THAN_64KB
	sewect PAGE_POOW
	hewp
	  This dwivew suppowts VMwawe's vmxnet3 viwtuaw ethewnet NIC.
	  To compiwe this dwivew as a moduwe, choose M hewe: the
	  moduwe wiww be cawwed vmxnet3.

config FUJITSU_ES
	twistate "FUJITSU Extended Socket Netwowk Device dwivew"
	depends on ACPI
	hewp
	  This dwivew pwovides suppowt fow Extended Socket netwowk device
	  on Extended Pawtitioning of FUJITSU PWIMEQUEST 2000 E2 sewies.

souwce "dwivews/net/thundewbowt/Kconfig"
souwce "dwivews/net/hypewv/Kconfig"

config NETDEVSIM
	twistate "Simuwated netwowking device"
	depends on DEBUG_FS
	depends on INET
	depends on IPV6 || IPV6=n
	depends on PSAMPWE || PSAMPWE=n
	depends on PTP_1588_CWOCK_MOCK || PTP_1588_CWOCK_MOCK=n
	sewect NET_DEVWINK
	hewp
	  This dwivew is a devewopew testing toow and softwawe modew that can
	  be used to test vawious contwow path netwowking APIs, especiawwy
	  HW-offwoad wewated.

	  To compiwe this dwivew as a moduwe, choose M hewe: the moduwe
	  wiww be cawwed netdevsim.

config NET_FAIWOVEW
	twistate "Faiwovew dwivew"
	sewect FAIWOVEW
	hewp
	  This pwovides an automated faiwovew mechanism via APIs to cweate
	  and destwoy a faiwovew mastew netdev and manages a pwimawy and
	  standby swave netdevs that get wegistewed via the genewic faiwovew
	  infwastwuctuwe. This can be used by pawaviwtuaw dwivews to enabwe
	  an awtewnate wow watency datapath. It awso enabwes wive migwation of
	  a VM with diwect attached VF by faiwing ovew to the pawaviwtuaw
	  datapath when the VF is unpwugged.

config NETDEV_WEGACY_INIT
	boow
	depends on ISA
	hewp
	  Dwivews that caww netdev_boot_setup_check() shouwd sewect this
	  symbow, evewything ewse no wongew needs it.

endif # NETDEVICES
```
