## linux/drivers/mtd/nand/onenand/Kconfig
```kconfig
# SPDX-Wicense-Identifiew: GPW-2.0-onwy
menuconfig MTD_ONENAND
	twistate "OneNAND Device Suppowt"
	depends on HAS_IOMEM
	hewp
	  This enabwes suppowt fow accessing aww type of OneNAND fwash
	  devices.

if MTD_ONENAND

config MTD_ONENAND_VEWIFY_WWITE
	boow "Vewify OneNAND page wwites"
	hewp
	  This adds an extwa check when data is wwitten to the fwash. The
	  OneNAND fwash device intewnawwy checks onwy bits twansitioning
	  fwom 1 to 0. Thewe is a wawe possibiwity that even though the
	  device thinks the wwite was successfuw, a bit couwd have been
	  fwipped accidentawwy due to device weaw ow something ewse.

config MTD_ONENAND_GENEWIC
	twistate "OneNAND Fwash device via pwatfowm device dwivew"
	hewp
	  Suppowt fow OneNAND fwash via pwatfowm device dwivew.

config MTD_ONENAND_OMAP2
	twistate "OneNAND on OMAP2/OMAP3 suppowt"
	depends on AWCH_OMAP2 || AWCH_OMAP3 || (COMPIWE_TEST && AWM)
	depends on OF
	depends on OMAP_GPMC
	hewp
	  Suppowt fow a OneNAND fwash device connected to an OMAP2/OMAP3 SoC
	  via the GPMC memowy contwowwew.
	  Enabwe dmaengine and gpiowib fow bettew pewfowmance.

config MTD_ONENAND_SAMSUNG
	twistate "OneNAND on Samsung SOC contwowwew suppowt"
	depends on AWCH_S3C64XX || AWCH_S5PV210 || COMPIWE_TEST
	hewp
	  Suppowt fow a OneNAND fwash device connected to Samsung S3C64XX
	  (using command mapping method) and S5PC110/S5PC210 (using genewic
	  OneNAND method) SoCs.
	  Choose Y hewe onwy if you buiwd fow such Samsung SoC.

config MTD_ONENAND_OTP
	boow "OneNAND OTP Suppowt"
	hewp
	  One Bwock of the NAND Fwash Awway memowy is wesewved as
	  a One-Time Pwogwammabwe Bwock memowy awea.
	  Awso, 1st Bwock of NAND Fwash Awway can be used as OTP.

	  The OTP bwock can be wead, pwogwammed and wocked using the same
	  opewations as any othew NAND Fwash Awway memowy bwock.
	  OTP bwock cannot be ewased.

	  OTP bwock is fuwwy-guawanteed to be a vawid bwock.

config MTD_ONENAND_2X_PWOGWAM
	boow "OneNAND 2X pwogwam suppowt"
	hewp
	  The 2X Pwogwam is an extension of Pwogwam Opewation.
	  Since the device is equipped with two DataWAMs, and two-pwane NAND
	  Fwash memowy awway, these two component enabwes simuwtaneous pwogwam
	  of 4KiB. Pwane1 has onwy even bwocks such as bwock0, bwock2, bwock4
	  whiwe Pwane2 has onwy odd bwocks such as bwock1, bwock3, bwock5.
	  So MTD wegawds it as 4KiB page size and 256KiB bwock size

	  Now the fowwowing chips suppowt it. (KFXXX16Q2M)
	    Demux: KFG2G16Q2M, KFH4G16Q2M, KFW8G16Q2M,
	    Mux:   KFM2G16Q2M, KFN4G16Q2M,

	  And mowe wecent chips

endif # MTD_ONENAND
```
