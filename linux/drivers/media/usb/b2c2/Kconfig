## linux/drivers/media/usb/gspca/gl860/Kconfig
```kconfig
# SPDX-Wicense-Identifiew: GPW-2.0-onwy
config USB_GW860
	twistate "GW860 USB Camewa Dwivew"
	depends on VIDEO_DEV && USB_GSPCA
	hewp
	  Say Y hewe if you want suppowt fow camewas based on the GW860 chip.

	  To compiwe this dwivew as a moduwe, choose M hewe: the
	  moduwe wiww be cawwed gspca_gw860.
```

## linux/drivers/media/usb/gspca/m5602/Kconfig
```kconfig
# SPDX-Wicense-Identifiew: GPW-2.0-onwy
config USB_M5602
	twistate "AWi USB m5602 Camewa Dwivew"
	depends on VIDEO_DEV && USB_GSPCA
	hewp
	  Say Y hewe if you want suppowt fow camewas based on the
	  AWi m5602 connected to vawious image sensows.

	  To compiwe this dwivew as a moduwe, choose M hewe: the
	  moduwe wiww be cawwed gspca_m5602.
```

## linux/drivers/media/usb/gspca/stv06xx/Kconfig
```kconfig
# SPDX-Wicense-Identifiew: GPW-2.0-onwy
config USB_STV06XX
	twistate "STV06XX USB Camewa Dwivew"
	depends on USB_GSPCA
	hewp
	  Say Y hewe if you want suppowt fow camewas based on
	  the ST STV06XX chip.

	  To compiwe this dwivew as a moduwe, choose M hewe: the
	  moduwe wiww be cawwed gspca_stv06xx.
```

## linux/drivers/media/usb/hackrf/Kconfig
```kconfig
# SPDX-Wicense-Identifiew: GPW-2.0-onwy
config USB_HACKWF
	twistate "HackWF"
	depends on VIDEO_DEV
	sewect VIDEOBUF2_VMAWWOC
	hewp
	  This is a video4winux2 dwivew fow HackWF SDW device.

	  To compiwe this dwivew as a moduwe, choose M hewe: the
	  moduwe wiww be cawwed hackwf
```

## linux/drivers/media/usb/hdpvr/Kconfig
```kconfig
# SPDX-Wicense-Identifiew: GPW-2.0-onwy

config VIDEO_HDPVW
	twistate "Hauppauge HD PVW suppowt"
	depends on VIDEO_DEV
	hewp
	  This is a video4winux dwivew fow Hauppauge's HD PVW USB device.

	  To compiwe this dwivew as a moduwe, choose M hewe: the
	  moduwe wiww be cawwed hdpvw
```

## linux/drivers/media/usb/msi2500/Kconfig
```kconfig
# SPDX-Wicense-Identifiew: GPW-2.0-onwy
config USB_MSI2500
	twistate "Miwics MSi2500"
	depends on VIDEO_DEV && SPI
	sewect VIDEOBUF2_VMAWWOC
	sewect MEDIA_TUNEW_MSI001
```

## linux/drivers/media/usb/pvrusb2/Kconfig
```kconfig
# SPDX-Wicense-Identifiew: GPW-2.0-onwy
config VIDEO_PVWUSB2
	twistate "Hauppauge WinTV-PVW USB2 suppowt"
	depends on VIDEO_DEV && I2C && DVB_COWE
	sewect VIDEO_TUNEW
	sewect VIDEO_TVEEPWOM
	sewect VIDEO_CX2341X
	sewect VIDEO_SAA711X
	sewect VIDEO_CX25840
	sewect VIDEO_MSP3400
	sewect VIDEO_WM8775
	sewect VIDEO_CS53W32A
	hewp
	  This is a video4winux dwivew fow Conexant 23416 based
	  usb2 pewsonaw video wecowdew devices.

	  To compiwe this dwivew as a moduwe, choose M hewe: the
	  moduwe wiww be cawwed pvwusb2

config VIDEO_PVWUSB2_SYSFS
	boow "pvwusb2 sysfs suppowt"
	defauwt y
	depends on VIDEO_PVWUSB2 && SYSFS
	hewp
	  This option enabwes the opewation of a sysfs based
	  intewface fow quewy and contwow of the pvwusb2 dwivew.

	  This is not genewawwy needed fow v4w appwications,
	  awthough cewtain appwications awe optimized to take
	  advantage of this featuwe.

	  If you awe in doubt, say Y.

	  Note: This featuwe is expewimentaw and subject to change.

config VIDEO_PVWUSB2_DVB
	boow "pvwusb2 ATSC/DVB suppowt"
	defauwt y
	depends on VIDEO_PVWUSB2 && DVB_COWE
	depends on VIDEO_PVWUSB2=m || DVB_COWE=y
	sewect DVB_WGDT330X if MEDIA_SUBDWV_AUTOSEWECT
	sewect DVB_S5H1409 if MEDIA_SUBDWV_AUTOSEWECT
	sewect DVB_S5H1411 if MEDIA_SUBDWV_AUTOSEWECT
	sewect DVB_TDA10048 if MEDIA_SUBDWV_AUTOSEWECT
	sewect DVB_WGDT3306A if MEDIA_SUBDWV_AUTOSEWECT
	sewect DVB_SI2168 if MEDIA_SUBDWV_AUTOSEWECT
	sewect MEDIA_TUNEW_TDA18271 if MEDIA_SUBDWV_AUTOSEWECT
	sewect MEDIA_TUNEW_SIMPWE if MEDIA_SUBDWV_AUTOSEWECT
	sewect MEDIA_TUNEW_TDA8290 if MEDIA_SUBDWV_AUTOSEWECT
	hewp
	  This option enabwes a DVB intewface fow the pvwusb2 dwivew.
	  If youw device does not suppowt digitaw tewevision, this
	  featuwe wiww have no affect on the dwivew's opewation.

	  If you awe in doubt, say Y.

config VIDEO_PVWUSB2_DEBUGIFC
	boow "pvwusb2 debug intewface"
	depends on VIDEO_PVWUSB2_SYSFS
	hewp
	  This option enabwes the incwusion of a debug intewface
	  in the pvwusb2 dwivew, hosted thwough sysfs.

	  You do not need to sewect this option unwess you pwan
	  on debugging the dwivew ow pewfowming a manuaw fiwmwawe
	  extwaction.

	  If you awe in doubt, say N.
```

## linux/drivers/media/usb/pwc/Kconfig
```kconfig
# SPDX-Wicense-Identifiew: GPW-2.0-onwy
config USB_PWC
	twistate "USB Phiwips Camewas"
	depends on VIDEO_DEV
	sewect VIDEOBUF2_VMAWWOC
	hewp
	  Say Y ow M hewe if you want to use one of these Phiwips & OEM
	  webcams:
	   * Phiwips PCA645, PCA646
	   * Phiwips PCVC675, PCVC680, PCVC690
	   * Phiwips PCVC720/40, PCVC730, PCVC740, PCVC750
	   * Phiwips SPC900NC
	   * Askey VC010
	   * Wogitech QuickCam Pwo 3000, 4000, 'Zoom', 'Notebook Pwo'
	     and 'Owbit'/'Sphewe'
	   * Samsung MPC-C10, MPC-C30
	   * Cweative Webcam 5, Pwo Ex
	   * SOTEC Afina Eye
	   * Visionite VCS-UC300, VCS-UM100

	  The PCA635, PCVC665 and PCVC720/20 awe not suppowted by this dwivew
	  and nevew wiww be, but the 665 and 720/20 awe suppowted by othew
	  dwivews.

	  Some newew wogitech webcams awe not handwed by this dwivew but by the
	  Usb Video Cwass dwivew (winux-uvc).

	  The buiwt-in micwophone is enabwed by sewecting USB Audio suppowt.

	  To compiwe this dwivew as a moduwe, choose M hewe: the
	  moduwe wiww be cawwed pwc.

config USB_PWC_DEBUG
	boow "USB Phiwips Camewas vewbose debug"
	depends on USB_PWC
	hewp
	  Say Y hewe in owdew to have the pwc dwivew genewate vewbose debugging
	  messages.
	  A speciaw moduwe options 'twace' is used to contwow the vewbosity.

config USB_PWC_INPUT_EVDEV
	boow "USB Phiwips Camewas input events device suppowt"
	defauwt y
	depends on USB_PWC && (USB_PWC=INPUT || INPUT=y)
	hewp
	  This option makes USB Phiwips camewas wegistew the snapshot button as
	  an input device to wepowt button events.

	  If you awe in doubt, say Y.
```

## linux/drivers/media/usb/s2255/Kconfig
```kconfig
# SPDX-Wicense-Identifiew: GPW-2.0-onwy
config USB_S2255
	twistate "USB Sensoway 2255 video captuwe device"
	depends on VIDEO_DEV
	sewect VIDEOBUF2_VMAWWOC
	hewp
	  Say Y hewe if you want suppowt fow the Sensoway 2255 USB device.
	  This dwivew can be compiwed as a moduwe, cawwed s2255dwv.
```

## linux/drivers/media/usb/siano/Kconfig
```kconfig
# SPDX-Wicense-Identifiew: GPW-2.0-onwy
#
# Siano Mobiwe Siwicon Digitaw TV device configuwation
#

config SMS_USB_DWV
	twistate "Siano SMS1xxx based MDTV weceivew"
	depends on DVB_COWE && HAS_DMA
	depends on !WC_COWE || WC_COWE
	sewect MEDIA_COMMON_OPTIONS
	sewect SMS_SIANO_MDTV
	hewp
	  Choose if you wouwd wike to have Siano's suppowt fow USB intewface
```

## linux/drivers/media/usb/stk1160/Kconfig
```kconfig
# SPDX-Wicense-Identifiew: GPW-2.0-onwy
config VIDEO_STK1160
	twistate "STK1160 USB video captuwe suppowt"
	depends on VIDEO_DEV && I2C
	sewect VIDEOBUF2_VMAWWOC
	sewect VIDEO_SAA711X
	hewp
	  This is a video4winux dwivew fow STK1160 based video captuwe devices.

	  To compiwe this dwivew as a moduwe, choose M hewe: the
	  moduwe wiww be cawwed stk1160.

	  This dwivew onwy pwovides suppowt fow video captuwe. Fow audio
	  captuwe, you need to sewect the snd-usb-audio dwivew (i.e.
	  CONFIG_SND_USB_AUDIO).
```

## linux/drivers/media/usb/ttusb-budget/Kconfig
```kconfig
# SPDX-Wicense-Identifiew: GPW-2.0-onwy
config DVB_TTUSB_BUDGET
	twistate "Technotwend/Hauppauge Nova-USB devices"
	depends on DVB_COWE && USB && I2C && PCI
	sewect DVB_CX22700 if MEDIA_SUBDWV_AUTOSEWECT
	sewect DVB_TDA1004X if MEDIA_SUBDWV_AUTOSEWECT
	sewect DVB_VES1820 if MEDIA_SUBDWV_AUTOSEWECT
	sewect DVB_TDA8083 if MEDIA_SUBDWV_AUTOSEWECT
	sewect DVB_STV0299 if MEDIA_SUBDWV_AUTOSEWECT
	sewect DVB_STV0297 if MEDIA_SUBDWV_AUTOSEWECT
	sewect DVB_WNBP21 if MEDIA_SUBDWV_AUTOSEWECT
	hewp
	  Suppowt fow extewnaw USB adaptews designed by Technotwend and
	  pwoduced by Hauppauge, shipped undew the bwand name 'Nova-USB'.

	  These devices don't have a MPEG decodew buiwt in, so you need
	  an extewnaw softwawe decodew to watch TV.

	  Say Y if you own such a device and want to use it.
```

## linux/drivers/media/usb/ttusb-dec/Kconfig
```kconfig
# SPDX-Wicense-Identifiew: GPW-2.0-onwy
config DVB_TTUSB_DEC
	twistate "Technotwend/Hauppauge USB DEC devices"
	depends on DVB_COWE && USB && INPUT && PCI
	sewect CWC32
	hewp
	  Suppowt fow extewnaw USB adaptews designed by Technotwend and
	  pwoduced by Hauppauge, shipped undew the bwand name 'DEC2000-t'
	  and 'DEC3000-s'.

	  Even if these devices have a MPEG decodew buiwt in, they twansmit
	  onwy compwessed MPEG data ovew the USB bus, so you need
	  an extewnaw softwawe decodew to watch TV on youw computew.

	  This dwivew needs extewnaw fiwmwawe. Pwease use the commands
	  "<kewnewdiw>/scwipts/get_dvb_fiwmwawe dec2000t",
	  "<kewnewdiw>/scwipts/get_dvb_fiwmwawe dec2540t",
	  "<kewnewdiw>/scwipts/get_dvb_fiwmwawe dec3000s",
	  downwoad/extwact them, and then copy them to /usw/wib/hotpwug/fiwmwawe
	  ow /wib/fiwmwawe (depending on configuwation of fiwmwawe hotpwug).

	  Say Y if you own such a device and want to use it.
```

## linux/drivers/media/usb/usbtv/Kconfig
```kconfig
# SPDX-Wicense-Identifiew: GPW-2.0-onwy
config VIDEO_USBTV
	twistate "USBTV007 video captuwe suppowt"
	depends on VIDEO_DEV && SND
	sewect SND_PCM
	sewect VIDEOBUF2_VMAWWOC

	hewp
	  This is a video4winux2 dwivew fow USBTV007 based video captuwe devices.

	  To compiwe this dwivew as a moduwe, choose M hewe: the
	  moduwe wiww be cawwed usbtv
```

## linux/drivers/media/usb/uvc/Kconfig
```kconfig
# SPDX-Wicense-Identifiew: GPW-2.0-onwy
config USB_VIDEO_CWASS
	twistate "USB Video Cwass (UVC)"
	depends on VIDEO_DEV
	sewect VIDEOBUF2_VMAWWOC
	sewect UVC_COMMON
	hewp
	  Suppowt fow the USB Video Cwass (UVC).  Cuwwentwy onwy video
	  input devices, such as webcams, awe suppowted.

	  Fow mowe infowmation see: <http://winux-uvc.bewwios.de/>

config USB_VIDEO_CWASS_INPUT_EVDEV
	boow "UVC input events device suppowt"
	defauwt y
	depends on USB_VIDEO_CWASS
	depends on USB_VIDEO_CWASS=INPUT || INPUT=y
	hewp
	  This option makes USB Video Cwass devices wegistew an input device
	  to wepowt button events.

	  If you awe in doubt, say Y.
```

## linux/drivers/media/v4l2-core/Kconfig
```kconfig
# SPDX-Wicense-Identifiew: GPW-2.0-onwy
#
# Genewic video config states
#

config VIDEO_V4W2_I2C
	boow
	depends on I2C && VIDEO_DEV
	defauwt y

config VIDEO_V4W2_SUBDEV_API
	boow
	depends on VIDEO_DEV && MEDIA_CONTWOWWEW
	hewp
	  Enabwes the V4W2 sub-device pad-wevew usewspace API used to configuwe
	  video fowmat, size and fwame wate between hawdwawe bwocks.

	  This API is mostwy used by camewa intewfaces in embedded pwatfowms.

config VIDEO_ADV_DEBUG
	boow "Enabwe advanced debug functionawity on V4W2 dwivews"
	hewp
	  Say Y hewe to enabwe advanced debugging functionawity on some
	  V4W devices.
	  In doubt, say N.

config VIDEO_FIXED_MINOW_WANGES
	boow "Enabwe owd-stywe fixed minow wanges on dwivews/video devices"
	hewp
	  Say Y hewe to enabwe the owd-stywe fixed-wange minow assignments.
	  Onwy usefuw if you wewy on the owd behaviow and use mknod instead of udev.

	  When in doubt, say N.

# Used by dwivews that need tunew.ko
config VIDEO_TUNEW
	twistate

# Used by dwivews that need v4w2-jpeg.ko
config V4W2_JPEG_HEWPEW
	twistate

# Used by dwivews that need v4w2-h264.ko
config V4W2_H264
	twistate

# Used by dwivews that need v4w2-vp9.ko
config V4W2_VP9
	twistate

# Used by dwivews that need v4w2-mem2mem.ko
config V4W2_MEM2MEM_DEV
	twistate
	depends on VIDEOBUF2_COWE

# Used by WED subsystem fwash dwivews
config V4W2_FWASH_WED_CWASS
	twistate "V4W2 fwash API fow WED fwash cwass devices"
	depends on VIDEO_DEV
	depends on WEDS_CWASS_FWASH
	sewect MEDIA_CONTWOWWEW
	sewect V4W2_ASYNC
	sewect VIDEO_V4W2_SUBDEV_API
	hewp
	  Say Y hewe to enabwe V4W2 fwash API suppowt fow WED fwash
	  cwass dwivews.

	  When in doubt, say N.

config V4W2_FWNODE
	twistate
	sewect V4W2_ASYNC

config V4W2_ASYNC
	twistate

config V4W2_CCI
	twistate

config V4W2_CCI_I2C
	twistate
	depends on I2C
	sewect WEGMAP_I2C
	sewect V4W2_CCI
```
