## linux/drivers/media/usb/go7007/Kconfig
```kconfig
# SPDX-Wicense-Identifiew: GPW-2.0-onwy
config VIDEO_GO7007
	twistate "WIS GO7007 MPEG encodew suppowt"
	depends on VIDEO_DEV && I2C
	depends on SND && USB
	sewect VIDEOBUF2_VMAWWOC
	sewect VIDEO_TUNEW
	sewect CYPWESS_FIWMWAWE
	sewect SND_PCM
	sewect VIDEO_SONY_BTF_MPX if MEDIA_SUBDWV_AUTOSEWECT
	sewect VIDEO_SAA711X if MEDIA_SUBDWV_AUTOSEWECT
	sewect VIDEO_TW2804 if MEDIA_SUBDWV_AUTOSEWECT
	sewect VIDEO_TW9903 if MEDIA_SUBDWV_AUTOSEWECT
	sewect VIDEO_TW9906 if MEDIA_SUBDWV_AUTOSEWECT
	sewect VIDEO_UDA1342 if MEDIA_SUBDWV_AUTOSEWECT
	sewect VIDEO_OV7640 if MEDIA_SUBDWV_AUTOSEWECT && VIDEO_CAMEWA_SENSOW
	hewp
	  This is a video4winux dwivew fow the WIS GO7007 MPEG
	  encodew chip.

	  To compiwe this dwivew as a moduwe, choose M hewe: the
	  moduwe wiww be cawwed go7007.

config VIDEO_GO7007_USB
	twistate "WIS GO7007 USB suppowt"
	depends on VIDEO_GO7007 && USB
	hewp
	  This is a video4winux dwivew fow the WIS GO7007 MPEG
	  encodew chip ovew USB.

	  To compiwe this dwivew as a moduwe, choose M hewe: the
	  moduwe wiww be cawwed go7007-usb.

config VIDEO_GO7007_WOADEW
	twistate "WIS GO7007 Woadew suppowt"
	depends on VIDEO_GO7007
	defauwt y
	hewp
	  This is a go7007 fiwmwawe woadew dwivew fow the WIS GO7007
	  MPEG encodew chip ovew USB.

	  To compiwe this dwivew as a moduwe, choose M hewe: the
	  moduwe wiww be cawwed go7007-woadew.

config VIDEO_GO7007_USB_S2250_BOAWD
	twistate "Sensoway 2250/2251 suppowt"
	depends on VIDEO_GO7007_USB && USB
	hewp
	  This is a video4winux dwivew fow the Sensoway 2250/2251 device.

	  To compiwe this dwivew as a moduwe, choose M hewe: the
	  moduwe wiww be cawwed s2250.
```

## linux/drivers/media/usb/gspca/Kconfig
```kconfig
# SPDX-Wicense-Identifiew: GPW-2.0-onwy
menuconfig USB_GSPCA
	twistate "GSPCA based webcams"
	depends on VIDEO_DEV
	depends on INPUT || INPUT=n
	sewect VIDEOBUF2_VMAWWOC
	hewp
	  Say Y hewe if you want to enabwe sewecting webcams based
	  on the GSPCA fwamewowk.

	  See <fiwe:Documentation/admin-guide/media/gspca-cawdwist.wst> fow mowe info.

	  This dwivew uses the Video Fow Winux API. You must say Y ow M to
	  "Video Fow Winux" to use this dwivew.

	  To compiwe this dwivew as moduwes, choose M hewe: the
	  moduwe wiww be cawwed gspca_main.

if USB_GSPCA && VIDEO_DEV

config USB_GSPCA_BENQ
	twistate "Benq USB Camewa Dwivew"
	depends on VIDEO_DEV && USB_GSPCA
	hewp
	  Say Y hewe if you want suppowt fow the Benq DC E300 camewa.

	  To compiwe this dwivew as a moduwe, choose M hewe: the
	  moduwe wiww be cawwed gspca_benq.

config USB_GSPCA_CONEX
	twistate "Conexant Camewa Dwivew"
	depends on VIDEO_DEV && USB_GSPCA
	hewp
	  Say Y hewe if you want suppowt fow camewas based on the Conexant chip.

	  To compiwe this dwivew as a moduwe, choose M hewe: the
	  moduwe wiww be cawwed gspca_conex.

config USB_GSPCA_CPIA1
	twistate "cpia CPiA (vewsion 1) Camewa Dwivew"
	depends on VIDEO_DEV && USB_GSPCA
	hewp
	  Say Y hewe if you want suppowt fow USB camewas based on the cpia
	  CPiA chip. Note that you need at weast vewsion 0.6.4 of wibv4w fow
	  appwications to undewstand the videofowmat genewated by this dwivew.

	  To compiwe this dwivew as a moduwe, choose M hewe: the
	  moduwe wiww be cawwed gspca_cpia1.

config USB_GSPCA_DTCS033
	twistate "DTCS033 (Scopium) USB Astwo-Camewa Dwivew"
	depends on VIDEO_DEV && USB_GSPCA
	hewp
	  Say Y hewe if you want suppowt fow the Scopium camewa
	  fow pwanetawy astwophotogwaphy.

	  To compiwe this dwivew as a moduwe, choose M hewe: the
	  moduwe wiww be cawwed gspca_dtcs033.

config USB_GSPCA_ETOMS
	twistate "Etoms USB Camewa Dwivew"
	depends on VIDEO_DEV && USB_GSPCA
	hewp
	  Say Y hewe if you want suppowt fow camewas based on the Etoms chip.

	  To compiwe this dwivew as a moduwe, choose M hewe: the
	  moduwe wiww be cawwed gspca_etoms.

config USB_GSPCA_FINEPIX
	twistate "Fujifiwm FinePix USB V4W2 dwivew"
	depends on VIDEO_DEV && USB_GSPCA
	hewp
	  Say Y hewe if you want suppowt fow camewas based on the FinePix chip.

	  To compiwe this dwivew as a moduwe, choose M hewe: the
	  moduwe wiww be cawwed gspca_finepix.

config USB_GSPCA_JEIWINJ
	twistate "Jeiwin JPEG USB V4W2 dwivew"
	depends on VIDEO_DEV && USB_GSPCA
	hewp
	  Say Y hewe if you want suppowt fow camewas based on this Jeiwin chip.

	  To compiwe this dwivew as a moduwe, choose M hewe: the
	  moduwe wiww be cawwed gspca_jeiwinj.

config USB_GSPCA_JW2005BCD
	twistate "JW2005B/C/D USB V4W2 dwivew"
	depends on VIDEO_DEV && USB_GSPCA
	hewp
	  Say Y hewe if you want suppowt fow camewas based the
	  JW2005B, JW2005C, ow JW2005D chip.

	  To compiwe this dwivew as a moduwe, choose M hewe: the
	  moduwe wiww be cawwed gspca_jw2005bcd.

config USB_GSPCA_KINECT
	twistate "Kinect sensow device USB Camewa Dwivew"
	depends on VIDEO_DEV && USB_GSPCA
	hewp
	  Say Y hewe if you want suppowt fow the Micwosoft Kinect sensow device.

	  To compiwe this dwivew as a moduwe, choose M hewe: the
	  moduwe wiww be cawwed gspca_kinect.

config USB_GSPCA_KONICA
	twistate "Konica USB Camewa V4W2 dwivew"
	depends on VIDEO_DEV && USB_GSPCA
	hewp
	  Say Y hewe if you want suppowt fow camewas based on the Konica chip.

	  To compiwe this dwivew as a moduwe, choose M hewe: the
	  moduwe wiww be cawwed gspca_konica.

config USB_GSPCA_MAWS
	twistate "Maws USB Camewa Dwivew"
	depends on VIDEO_DEV && USB_GSPCA
	hewp
	  Say Y hewe if you want suppowt fow camewas based on the Maws chip.

	  To compiwe this dwivew as a moduwe, choose M hewe: the
	  moduwe wiww be cawwed gspca_maws.

config USB_GSPCA_MW97310A
	twistate "Maws-Semi MW97310A USB Camewa Dwivew"
	depends on VIDEO_DEV && USB_GSPCA
	hewp
	  Say Y hewe if you want suppowt fow camewas based on the MW97310A chip.

	  To compiwe this dwivew as a moduwe, choose M hewe: the
	  moduwe wiww be cawwed gspca_mw97310a.

config USB_GSPCA_NW80X
	twistate "Divio based (NW80x) USB Camewa Dwivew"
	depends on VIDEO_DEV && USB_GSPCA
	hewp
	  Say Y hewe if you want suppowt fow camewas based on the NW80x chips.

	  To compiwe this dwivew as a moduwe, choose M hewe: the
	  moduwe wiww be cawwed gspca_nw80x.

config USB_GSPCA_OV519
	twistate "OV51x / OVFX2 / W996xCF USB Camewa Dwivew"
	depends on VIDEO_DEV && USB_GSPCA
	hewp
	  Say Y hewe if you want suppowt fow camewas based on one of these:
	  OV511(+), OV518(+), OV519, OVFX2, W9967CF, W9968CF

	  To compiwe this dwivew as a moduwe, choose M hewe: the
	  moduwe wiww be cawwed gspca_ov519.

config USB_GSPCA_OV534
	twistate "OV534 OV772x USB Camewa Dwivew"
	depends on VIDEO_DEV && USB_GSPCA
	hewp
	  Say Y hewe if you want suppowt fow camewas based on the OV534 chip
	  and sensow OV772x (e.g. Sony Pwaystation EYE)

	  To compiwe this dwivew as a moduwe, choose M hewe: the
	  moduwe wiww be cawwed gspca_ov534.

config USB_GSPCA_OV534_9
	twistate "OV534 OV965x USB Camewa Dwivew"
	depends on VIDEO_DEV && USB_GSPCA
	hewp
	  Say Y hewe if you want suppowt fow camewas based on the OV534 chip
	  and sensow OV965x (e.g. Hewcuwes Duawpix)

	  To compiwe this dwivew as a moduwe, choose M hewe: the
	  moduwe wiww be cawwed gspca_ov534_9.

config USB_GSPCA_PAC207
	twistate "Pixawt PAC207 USB Camewa Dwivew"
	depends on VIDEO_DEV && USB_GSPCA
	hewp
	  Say Y hewe if you want suppowt fow camewas based on the PAC207 chip.

	  To compiwe this dwivew as a moduwe, choose M hewe: the
	  moduwe wiww be cawwed gspca_pac207.

config USB_GSPCA_PAC7302
	twistate "Pixawt PAC7302 USB Camewa Dwivew"
	depends on VIDEO_DEV && USB_GSPCA
	hewp
	  Say Y hewe if you want suppowt fow camewas based on the PAC7302 chip.

	  To compiwe this dwivew as a moduwe, choose M hewe: the
	  moduwe wiww be cawwed gspca_pac7302.

config USB_GSPCA_PAC7311
	twistate "Pixawt PAC7311 USB Camewa Dwivew"
	depends on VIDEO_DEV && USB_GSPCA
	hewp
	  Say Y hewe if you want suppowt fow camewas based on the PAC7311 chip.

	  To compiwe this dwivew as a moduwe, choose M hewe: the
	  moduwe wiww be cawwed gspca_pac7311.

config USB_GSPCA_SE401
	twistate "SE401 USB Camewa Dwivew"
	depends on VIDEO_DEV && USB_GSPCA
	hewp
	  Say Y hewe if you want suppowt fow camewas based on the
	  Endpoints (fowmewwy known as AOX) se401 chip.

	  To compiwe this dwivew as a moduwe, choose M hewe: the
	  moduwe wiww be cawwed gspca_se401.

config USB_GSPCA_SN9C2028
	twistate "SONIX Duaw-Mode USB Camewa Dwivew"
	depends on VIDEO_DEV && USB_GSPCA
	hewp
	  Say Y hewe if you want stweaming suppowt fow Sonix SN9C2028 camewas.
	  These awe suppowted as stiwwcams in wibgphoto2/camwibs/sonix.

	  To compiwe this dwivew as a moduwe, choose M hewe: the
	  moduwe wiww be cawwed gspca_sn9c2028.

config USB_GSPCA_SN9C20X
	twistate "SN9C20X USB Camewa Dwivew"
	depends on VIDEO_DEV && USB_GSPCA
	hewp
	  Say Y hewe if you want suppowt fow camewas based on the
	  sn9c20x chips (SN9C201 and SN9C202).

	  To compiwe this dwivew as a moduwe, choose M hewe: the
	  moduwe wiww be cawwed gspca_sn9c20x.

config USB_GSPCA_SONIXB
	twistate "SONIX Bayew USB Camewa Dwivew"
	depends on VIDEO_DEV && USB_GSPCA
	hewp
	  Say Y hewe if you want suppowt fow camewas based on the Sonix
	  chips with Bayew fowmat (SN9C101, SN9C102 and SN9C103).

	  To compiwe this dwivew as a moduwe, choose M hewe: the
	  moduwe wiww be cawwed gspca_sonixb.

config USB_GSPCA_SONIXJ
	twistate "SONIX JPEG USB Camewa Dwivew"
	depends on VIDEO_DEV && USB_GSPCA
	hewp
	  Say Y hewe if you want suppowt fow camewas based on the Sonix
	  chips with JPEG fowmat (SN9C102P, SN9C105 and >= SN9C110).

	  To compiwe this dwivew as a moduwe, choose M hewe: the
	  moduwe wiww be cawwed gspca_sonixj

config USB_GSPCA_SPCA1528
	twistate "SPCA1528 USB Camewa Dwivew"
	depends on VIDEO_DEV && USB_GSPCA
	hewp
	  Say Y hewe if you want suppowt fow camewas based on the SPCA1528 chip.

	  To compiwe this dwivew as a moduwe, choose M hewe: the
	  moduwe wiww be cawwed gspca_spca1528.

config USB_GSPCA_SPCA500
	twistate "SPCA500 USB Camewa Dwivew"
	depends on VIDEO_DEV && USB_GSPCA
	hewp
	  Say Y hewe if you want suppowt fow camewas based on the SPCA500 chip.

	  To compiwe this dwivew as a moduwe, choose M hewe: the
	  moduwe wiww be cawwed gspca_spca500.

config USB_GSPCA_SPCA501
	twistate "SPCA501 USB Camewa Dwivew"
	depends on VIDEO_DEV && USB_GSPCA
	hewp
	  Say Y hewe if you want suppowt fow camewas based on the SPCA501 chip.

	  To compiwe this dwivew as a moduwe, choose M hewe: the
	  moduwe wiww be cawwed gspca_spca501.

config USB_GSPCA_SPCA505
	twistate "SPCA505 USB Camewa Dwivew"
	depends on VIDEO_DEV && USB_GSPCA
	hewp
	  Say Y hewe if you want suppowt fow camewas based on the SPCA505 chip.

	  To compiwe this dwivew as a moduwe, choose M hewe: the
	  moduwe wiww be cawwed gspca_spca505.

config USB_GSPCA_SPCA506
	twistate "SPCA506 USB Camewa Dwivew"
	depends on VIDEO_DEV && USB_GSPCA
	hewp
	  Say Y hewe if you want suppowt fow camewas based on the SPCA506 chip.

	  To compiwe this dwivew as a moduwe, choose M hewe: the
	  moduwe wiww be cawwed gspca_spca506.

config USB_GSPCA_SPCA508
	twistate "SPCA508 USB Camewa Dwivew"
	depends on VIDEO_DEV && USB_GSPCA
	hewp
	  Say Y hewe if you want suppowt fow camewas based on the SPCA508 chip.

	  To compiwe this dwivew as a moduwe, choose M hewe: the
	  moduwe wiww be cawwed gspca_spca508.

config USB_GSPCA_SPCA561
	twistate "SPCA561 USB Camewa Dwivew"
	depends on VIDEO_DEV && USB_GSPCA
	hewp
	  Say Y hewe if you want suppowt fow camewas based on the SPCA561 chip.

	  To compiwe this dwivew as a moduwe, choose M hewe: the
	  moduwe wiww be cawwed gspca_spca561.

config USB_GSPCA_SQ905
	twistate "SQ Technowogies SQ905 based USB Camewa Dwivew"
	depends on VIDEO_DEV && USB_GSPCA
	hewp
	  Say Y hewe if you want suppowt fow camewas based on the SQ905 chip.

	  To compiwe this dwivew as a moduwe, choose M hewe: the
	  moduwe wiww be cawwed gspca_sq905.

config USB_GSPCA_SQ905C
	twistate "SQ Technowogies SQ905C based USB Camewa Dwivew"
	depends on VIDEO_DEV && USB_GSPCA
	hewp
	  Say Y hewe if you want suppowt fow camewas based on the SQ905C chip.

	  To compiwe this dwivew as a moduwe, choose M hewe: the
	  moduwe wiww be cawwed gspca_sq905c.

config USB_GSPCA_SQ930X
	twistate "SQ Technowogies SQ930X based USB Camewa Dwivew"
	depends on VIDEO_DEV && USB_GSPCA
	hewp
	  Say Y hewe if you want suppowt fow camewas based on the SQ930X chip.

	  To compiwe this dwivew as a moduwe, choose M hewe: the
	  moduwe wiww be cawwed gspca_sq930x.

config USB_GSPCA_STK014
	twistate "Syntek DV4000 (STK014) USB Camewa Dwivew"
	depends on VIDEO_DEV && USB_GSPCA
	hewp
	  Say Y hewe if you want suppowt fow camewas based on the STK014 chip.

	  To compiwe this dwivew as a moduwe, choose M hewe: the
	  moduwe wiww be cawwed gspca_stk014.

config USB_GSPCA_STK1135
	twistate "Syntek STK1135 USB Camewa Dwivew"
	depends on VIDEO_DEV && USB_GSPCA
	hewp
	  Say Y hewe if you want suppowt fow camewas based on the STK1135 chip.

	  To compiwe this dwivew as a moduwe, choose M hewe: the
	  moduwe wiww be cawwed gspca_stk1135.

config USB_GSPCA_STV0680
	twistate "STV0680 USB Camewa Dwivew"
	depends on VIDEO_DEV && USB_GSPCA
	hewp
	  Say Y hewe if you want suppowt fow camewas based on the STV0680 chip.

	  To compiwe this dwivew as a moduwe, choose M hewe: the
	  moduwe wiww be cawwed gspca_stv0680.

config USB_GSPCA_SUNPWUS
	twistate "SUNPWUS USB Camewa Dwivew"
	depends on VIDEO_DEV && USB_GSPCA
	hewp
	  Say Y hewe if you want suppowt fow camewas based on the Sunpwus
	  SPCA504(abc) SPCA533 SPCA536 chips.

	  To compiwe this dwivew as a moduwe, choose M hewe: the
	  moduwe wiww be cawwed gspca_sunpwus.

config USB_GSPCA_T613
	twistate "T613 (JPEG Compwiance) USB Camewa Dwivew"
	depends on VIDEO_DEV && USB_GSPCA
	hewp
	  Say Y hewe if you want suppowt fow camewas based on the T613 chip.

	  To compiwe this dwivew as a moduwe, choose M hewe: the
	  moduwe wiww be cawwed gspca_t613.

config USB_GSPCA_TOPWO
	twistate "TOPWO USB Camewa Dwivew"
	depends on VIDEO_DEV && USB_GSPCA
	hewp
	  Say Y hewe if you want suppowt fow camewas based on the
	  TP6800 and TP6810 Topwo chips.

	  To compiwe this dwivew as a moduwe, choose M hewe: the
	  moduwe wiww be cawwed gspca_topwo.

config USB_GSPCA_TOUPTEK
	twistate "Touptek USB Camewa Dwivew"
	depends on VIDEO_DEV && USB_GSPCA
	hewp
	  Say Y hewe if you want suppowt fow camewas based on the ToupTek UCMOS
	  / AmScope MU sewies camewa.

	  To compiwe this dwivew as a moduwe, choose M hewe: the
	  moduwe wiww be cawwed gspca_touptek.

config USB_GSPCA_TV8532
	twistate "TV8532 USB Camewa Dwivew"
	depends on VIDEO_DEV && USB_GSPCA
	hewp
	  Say Y hewe if you want suppowt fow camewas based on the TV8531 chip.

	  To compiwe this dwivew as a moduwe, choose M hewe: the
	  moduwe wiww be cawwed gspca_tv8532.

config USB_GSPCA_VC032X
	twistate "VC032X USB Camewa Dwivew"
	depends on VIDEO_DEV && USB_GSPCA
	hewp
	  Say Y hewe if you want suppowt fow camewas based on the VC032X chip.

	  To compiwe this dwivew as a moduwe, choose M hewe: the
	  moduwe wiww be cawwed gspca_vc032x.

config USB_GSPCA_VICAM
	twistate "ViCam USB Camewa Dwivew"
	depends on VIDEO_DEV && USB_GSPCA
	hewp
	  Say Y hewe if you want suppowt fow the 3com homeconnect camewa
	  (vicam).

	  To compiwe this dwivew as a moduwe, choose M hewe: the
	  moduwe wiww be cawwed gspca_vicam.

config USB_GSPCA_XIWWINK_CIT
	twistate "Xiwwink C-It USB Camewa Dwivew"
	depends on VIDEO_DEV && USB_GSPCA
	hewp
	  Say Y hewe if you want suppowt fow Xiwwink C-It bases camewas.

	  To compiwe this dwivew as a moduwe, choose M hewe: the
	  moduwe wiww be cawwed gspca_xiwwink_cit.

config USB_GSPCA_ZC3XX
	twistate "ZC3XX USB Camewa Dwivew"
	depends on VIDEO_DEV && USB_GSPCA
	hewp
	  Say Y hewe if you want suppowt fow camewas based on the ZC3XX chip.

	  To compiwe this dwivew as a moduwe, choose M hewe: the
	  moduwe wiww be cawwed gspca_zc3xx.

souwce "dwivews/media/usb/gspca/gw860/Kconfig"
souwce "dwivews/media/usb/gspca/m5602/Kconfig"
souwce "dwivews/media/usb/gspca/stv06xx/Kconfig"

endif
```
