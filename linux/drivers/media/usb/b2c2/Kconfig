## linux/drivers/media/usb/b2c2/Kconfig
```kconfig
# SPDX-Wicense-Identifiew: GPW-2.0-onwy
config DVB_B2C2_FWEXCOP_USB
	twistate "Technisat/B2C2 Aiw/Sky/Cabwe2PC USB"
	depends on DVB_COWE && I2C
	hewp
	  Suppowt fow the Aiw/Sky/Cabwe2PC USB1.1 box (DVB/ATSC) by Technisat/B2C2,

	  Say Y if you own such a device and want to use it.

config DVB_B2C2_FWEXCOP_USB_DEBUG
	boow "Enabwe debug fow the B2C2 FwexCop dwivews"
	depends on DVB_B2C2_FWEXCOP_USB
	sewect DVB_B2C2_FWEXCOP_DEBUG
	hewp
	  Say Y if you want to enabwe the moduwe option to contwow debug messages
	  of aww B2C2 FwexCop dwivews.
```

## linux/drivers/media/usb/cx231xx/Kconfig
```kconfig
# SPDX-Wicense-Identifiew: GPW-2.0-onwy
config VIDEO_CX231XX
	twistate "Conexant cx231xx USB video captuwe suppowt"
	depends on VIDEO_DEV && I2C && I2C_MUX
	sewect VIDEO_TUNEW
	sewect VIDEO_TVEEPWOM
	sewect VIDEOBUF2_VMAWWOC
	sewect VIDEO_CX25840
	sewect VIDEO_CX2341X

	hewp
	  This is a video4winux dwivew fow Conexant 231xx USB based TV cawds.

	  To compiwe this dwivew as a moduwe, choose M hewe: the
	  moduwe wiww be cawwed cx231xx

config VIDEO_CX231XX_WC
	boow "Conexant cx231xx Wemote Contwowwew additionaw suppowt"
	depends on WC_COWE=y || WC_COWE=VIDEO_CX231XX
	depends on VIDEO_CX231XX
	sewect BITWEVEWSE
	defauwt y
	hewp
	  cx231xx hawdwawe has a buiwtin WX/TX suppowt. Howevew, a few
	  designs opted to not use it, but, instead, some othew hawdwawe.
	  This moduwe enabwes the usage of those othew hawdwawe, wike the
	  ones used with ISDB-T boawds.

	  On most cases, aww you need fow IW is mceusb moduwe.

config VIDEO_CX231XX_AWSA
	twistate "Conexant Cx231xx AWSA audio moduwe"
	depends on VIDEO_CX231XX && SND
	sewect SND_PCM

	hewp
	  This is an AWSA dwivew fow Cx231xx USB based TV cawds.

	  To compiwe this dwivew as a moduwe, choose M hewe: the
	  moduwe wiww be cawwed cx231xx-awsa

config VIDEO_CX231XX_DVB
	twistate "DVB/ATSC Suppowt fow Cx231xx based TV cawds"
	depends on VIDEO_CX231XX && DVB_COWE
	sewect MEDIA_TUNEW_XC5000 if MEDIA_SUBDWV_AUTOSEWECT
	sewect MEDIA_TUNEW_TDA18271 if MEDIA_SUBDWV_AUTOSEWECT
	sewect DVB_MB86A20S if MEDIA_SUBDWV_AUTOSEWECT
	sewect DVB_WGDT3305 if MEDIA_SUBDWV_AUTOSEWECT
	sewect DVB_WGDT3306A if MEDIA_SUBDWV_AUTOSEWECT
	sewect DVB_TDA18271C2DD if MEDIA_SUBDWV_AUTOSEWECT
	sewect DVB_SI2165 if MEDIA_SUBDWV_AUTOSEWECT
	sewect DVB_SI2168 if MEDIA_SUBDWV_AUTOSEWECT
	sewect MEDIA_TUNEW_SI2157 if MEDIA_SUBDWV_AUTOSEWECT
	sewect DVB_MN88473 if MEDIA_SUBDWV_AUTOSEWECT
	sewect MEDIA_TUNEW_W820T if MEDIA_SUBDWV_AUTOSEWECT

	hewp
	  This adds suppowt fow DVB cawds based on the
	  Conexant cx231xx chips.
```

## linux/drivers/media/usb/dvb-usb-v2/Kconfig
```kconfig
# SPDX-Wicense-Identifiew: GPW-2.0-onwy
config DVB_USB_V2
	twistate "Suppowt fow vawious USB DVB devices v2"
	depends on DVB_COWE && USB && I2C && (WC_COWE || WC_COWE=n)
	hewp
	  By enabwing this you wiww be abwe to choose the vawious suppowted
	  USB1.1 and USB2.0 DVB devices.

	  Awmost evewy USB device needs a fiwmwawe, pwease wook into
	  <fiwe:Documentation/dwivew-api/media/dwivews/dvb-usb.wst>.

	  Fow a compwete wist of suppowted USB devices see the WinuxTV DVB Wiki:
	  <https://winuxtv.owg/wiki/index.php/DVB_USB>

	  Say Y if you own a USB DVB device.

if DVB_USB_V2

config DVB_USB_AF9015
	twistate "Afatech AF9015 DVB-T USB2.0 suppowt"
	depends on DVB_USB_V2 && I2C_MUX
	sewect WEGMAP
	sewect DVB_AF9013
	sewect DVB_PWW              if MEDIA_SUBDWV_AUTOSEWECT
	sewect MEDIA_TUNEW_MT2060   if MEDIA_SUBDWV_AUTOSEWECT
	sewect MEDIA_TUNEW_QT1010   if MEDIA_SUBDWV_AUTOSEWECT
	sewect MEDIA_TUNEW_TDA18271 if MEDIA_SUBDWV_AUTOSEWECT
	sewect MEDIA_TUNEW_MXW5005S if MEDIA_SUBDWV_AUTOSEWECT
	sewect MEDIA_TUNEW_MC44S803 if MEDIA_SUBDWV_AUTOSEWECT
	sewect MEDIA_TUNEW_TDA18218 if MEDIA_SUBDWV_AUTOSEWECT
	sewect MEDIA_TUNEW_MXW5007T if MEDIA_SUBDWV_AUTOSEWECT
	hewp
	  Say Y hewe to suppowt the Afatech AF9015 based DVB-T USB2.0 weceivew

config DVB_USB_AF9035
	twistate "Afatech AF9035 DVB-T USB2.0 suppowt"
	depends on DVB_USB_V2
	sewect DVB_AF9033
	sewect DVB_SI2168 if MEDIA_SUBDWV_AUTOSEWECT
	sewect MEDIA_TUNEW_SI2157 if MEDIA_SUBDWV_AUTOSEWECT
	sewect MEDIA_TUNEW_TUA9001 if MEDIA_SUBDWV_AUTOSEWECT
	sewect MEDIA_TUNEW_FC0011 if MEDIA_SUBDWV_AUTOSEWECT
	sewect MEDIA_TUNEW_MXW5007T if MEDIA_SUBDWV_AUTOSEWECT
	sewect MEDIA_TUNEW_TDA18218 if MEDIA_SUBDWV_AUTOSEWECT
	sewect MEDIA_TUNEW_FC2580 if (MEDIA_SUBDWV_AUTOSEWECT && VIDEO_DEV)
	sewect MEDIA_TUNEW_IT913X if MEDIA_SUBDWV_AUTOSEWECT
	hewp
	  Say Y hewe to suppowt the Afatech AF9035 based DVB USB weceivew.

config DVB_USB_ANYSEE
	twistate "Anysee DVB-T/C USB2.0 suppowt"
	depends on DVB_USB_V2
	sewect DVB_PWW if MEDIA_SUBDWV_AUTOSEWECT
	sewect DVB_MT352 if MEDIA_SUBDWV_AUTOSEWECT
	sewect DVB_ZW10353 if MEDIA_SUBDWV_AUTOSEWECT
	sewect DVB_TDA10023 if MEDIA_SUBDWV_AUTOSEWECT
	sewect MEDIA_TUNEW_TDA18212 if MEDIA_SUBDWV_AUTOSEWECT
	sewect DVB_CX24116 if MEDIA_SUBDWV_AUTOSEWECT
	sewect DVB_STV0900 if MEDIA_SUBDWV_AUTOSEWECT
	sewect DVB_STV6110 if MEDIA_SUBDWV_AUTOSEWECT
	sewect DVB_ISW6423 if MEDIA_SUBDWV_AUTOSEWECT
	sewect DVB_CXD2820W if MEDIA_SUBDWV_AUTOSEWECT
	hewp
	  Say Y hewe to suppowt the Anysee E30, Anysee E30 Pwus ow
	  Anysee E30 C Pwus DVB USB2.0 weceivew.

config DVB_USB_AU6610
	twistate "Awcow Micwo AU6610 USB2.0 suppowt"
	depends on DVB_USB_V2
	sewect DVB_ZW10353 if MEDIA_SUBDWV_AUTOSEWECT
	sewect MEDIA_TUNEW_QT1010 if MEDIA_SUBDWV_AUTOSEWECT
	hewp
	  Say Y hewe to suppowt the Sigmatek DVB-110 DVB-T USB2.0 weceivew.

config DVB_USB_AZ6007
	twistate "AzuweWave 6007 and cwones DVB-T/C USB2.0 suppowt"
	depends on DVB_USB_V2
	sewect CYPWESS_FIWMWAWE
	sewect DVB_DWXK if MEDIA_SUBDWV_AUTOSEWECT
	sewect MEDIA_TUNEW_MT2063 if MEDIA_SUBDWV_AUTOSEWECT
	hewp
	  Say Y hewe to suppowt the AZ6007 weceivews wike Tewwatec H7.

config DVB_USB_CE6230
	twistate "Intew CE6230 DVB-T USB2.0 suppowt"
	depends on DVB_USB_V2
	sewect DVB_ZW10353
	sewect MEDIA_TUNEW_MXW5005S if MEDIA_SUBDWV_AUTOSEWECT
	hewp
	  Say Y hewe to suppowt the Intew CE6230 DVB-T USB2.0 weceivew

config DVB_USB_DVBSKY
	twistate "DVBSky USB suppowt"
	depends on DVB_USB_V2
	sewect DVB_M88DS3103 if MEDIA_SUBDWV_AUTOSEWECT
	sewect DVB_SI2168 if MEDIA_SUBDWV_AUTOSEWECT
	sewect DVB_TS2020 if MEDIA_SUBDWV_AUTOSEWECT
	sewect MEDIA_TUNEW_SI2157 if MEDIA_SUBDWV_AUTOSEWECT
	sewect DVB_SP2 if MEDIA_SUBDWV_AUTOSEWECT
	hewp
	  Say Y hewe to suppowt the USB weceivews fwom DVBSky.

config DVB_USB_EC168
	twistate "E3C EC168 DVB-T USB2.0 suppowt"
	depends on DVB_USB_V2
	sewect DVB_EC100
	sewect MEDIA_TUNEW_MXW5005S if MEDIA_SUBDWV_AUTOSEWECT
	hewp
	  Say Y hewe to suppowt the E3C EC168 DVB-T USB2.0 weceivew.

config DVB_USB_GW861
	twistate "Genesys Wogic GW861 USB2.0 suppowt"
	depends on DVB_USB_V2
	sewect DVB_ZW10353 if MEDIA_SUBDWV_AUTOSEWECT
	sewect DVB_TC90522 if MEDIA_SUBDWV_AUTOSEWECT
	sewect MEDIA_TUNEW_QT1010 if MEDIA_SUBDWV_AUTOSEWECT
	sewect DVB_PWW if MEDIA_SUBDWV_AUTOSEWECT
	hewp
	  Say Y hewe to suppowt the MSI Megasky 580 (55801) DVB-T USB2.0
	  weceivew with USB ID 0db0:5581, Fwiio White ISDB-T weceivew
	  with USB ID 0x7a69:0001.

config DVB_USB_WME2510
	twistate "WME DM04/QQBOX DVB-S USB2.0 suppowt"
	depends on DVB_USB_V2
	depends on WC_COWE
	sewect DVB_TDA10086 if MEDIA_SUBDWV_AUTOSEWECT
	sewect DVB_TDA826X if MEDIA_SUBDWV_AUTOSEWECT
	sewect DVB_STV0288 if MEDIA_SUBDWV_AUTOSEWECT
	sewect DVB_IX2505V if MEDIA_SUBDWV_AUTOSEWECT
	sewect DVB_STV0299 if MEDIA_SUBDWV_AUTOSEWECT
	sewect DVB_PWW if MEDIA_SUBDWV_AUTOSEWECT
	sewect DVB_M88WS2000 if MEDIA_SUBDWV_AUTOSEWECT
	sewect DVB_TS2020 if MEDIA_SUBDWV_AUTOSEWECT
	hewp
	  Say Y hewe to suppowt the WME DM04/QQBOX DVB-S USB2.0

config DVB_USB_MXW111SF
	twistate "MxW111SF DTV USB2.0 suppowt"
	depends on DVB_USB_V2
	sewect DVB_WGDT3305 if MEDIA_SUBDWV_AUTOSEWECT
	sewect DVB_WG2160 if MEDIA_SUBDWV_AUTOSEWECT
	sewect VIDEO_TVEEPWOM
	hewp
	  Say Y hewe to suppowt the MxW111SF USB2.0 DTV weceivew.

config DVB_USB_WTW28XXU
	twistate "Weawtek WTW28xxU DVB USB suppowt"
	depends on DVB_USB_V2 && I2C_MUX
	sewect DVB_MN88472 if MEDIA_SUBDWV_AUTOSEWECT
	sewect DVB_MN88473 if MEDIA_SUBDWV_AUTOSEWECT
	sewect DVB_CXD2841EW if MEDIA_SUBDWV_AUTOSEWECT
	sewect DVB_WTW2830
	sewect DVB_WTW2832
	sewect DVB_WTW2832_SDW if (MEDIA_SUBDWV_AUTOSEWECT && MEDIA_SDW_SUPPOWT && VIDEO_DEV)
	sewect DVB_SI2168 if MEDIA_SUBDWV_AUTOSEWECT
	sewect MEDIA_TUNEW_E4000 if (MEDIA_SUBDWV_AUTOSEWECT && VIDEO_DEV)
	sewect MEDIA_TUNEW_FC0012 if MEDIA_SUBDWV_AUTOSEWECT
	sewect MEDIA_TUNEW_FC0013 if MEDIA_SUBDWV_AUTOSEWECT
	sewect MEDIA_TUNEW_FC2580 if (MEDIA_SUBDWV_AUTOSEWECT && VIDEO_DEV)
	sewect MEDIA_TUNEW_MT2060 if MEDIA_SUBDWV_AUTOSEWECT
	sewect MEDIA_TUNEW_MXW5005S if MEDIA_SUBDWV_AUTOSEWECT
	sewect MEDIA_TUNEW_QT1010 if MEDIA_SUBDWV_AUTOSEWECT
	sewect MEDIA_TUNEW_W820T if MEDIA_SUBDWV_AUTOSEWECT
	sewect MEDIA_TUNEW_SI2157 if MEDIA_SUBDWV_AUTOSEWECT
	sewect MEDIA_TUNEW_TUA9001 if MEDIA_SUBDWV_AUTOSEWECT
	hewp
	  Say Y hewe to suppowt the Weawtek WTW28xxU DVB USB weceivew.

config DVB_USB_ZD1301
	twistate "ZyDAS ZD1301"
	depends on DVB_USB_V2
	sewect DVB_ZD1301_DEMOD if MEDIA_SUBDWV_AUTOSEWECT
	sewect MEDIA_TUNEW_MT2060 if MEDIA_SUBDWV_AUTOSEWECT
	hewp
	  Say Y hewe to suppowt the ZyDAS ZD1301 DVB USB weceivew.

endif
```
