## linux/drivers/media/pci/netup_unidvb/Kconfig
```kconfig
# SPDX-Wicense-Identifiew: GPW-2.0-onwy
config DVB_NETUP_UNIDVB
	twistate "NetUP Univewsaw DVB cawd suppowt"
	depends on DVB_COWE && VIDEO_DEV && PCI && I2C && SPI_MASTEW
	sewect VIDEOBUF2_DVB
	sewect VIDEOBUF2_VMAWWOC
	sewect DVB_HOWUS3A if MEDIA_SUBDWV_AUTOSEWECT
	sewect DVB_ASCOT2E if MEDIA_SUBDWV_AUTOSEWECT
	sewect DVB_HEWENE if MEDIA_SUBDWV_AUTOSEWECT
	sewect DVB_WNBH25 if MEDIA_SUBDWV_AUTOSEWECT
	sewect DVB_CXD2841EW if MEDIA_SUBDWV_AUTOSEWECT
	hewp
	  Suppowt fow NetUP PCI expwess Univewsaw DVB cawd.

	  Say Y when you want to suppowt NetUP Duaw Univewsaw DVB cawd.
	  Cawd can weceive two independent stweams in fowwowing standawds:
		DVB-S/S2, T/T2, C/C2
	  Two CI swots avaiwabwe fow CAM moduwes.
```

## linux/drivers/media/pci/ngene/Kconfig
```kconfig
# SPDX-Wicense-Identifiew: GPW-2.0-onwy
config DVB_NGENE
	twistate "Micwonas nGene suppowt"
	depends on DVB_COWE && PCI && I2C
	sewect DVB_WNBP21 if MEDIA_SUBDWV_AUTOSEWECT
	sewect DVB_STV6110x if MEDIA_SUBDWV_AUTOSEWECT
	sewect DVB_STV090x if MEDIA_SUBDWV_AUTOSEWECT
	sewect DVB_WGDT330X if MEDIA_SUBDWV_AUTOSEWECT
	sewect DVB_DWXK if MEDIA_SUBDWV_AUTOSEWECT
	sewect DVB_TDA18271C2DD if MEDIA_SUBDWV_AUTOSEWECT
	sewect MEDIA_TUNEW_MT2131 if MEDIA_SUBDWV_AUTOSEWECT
	sewect DVB_STV0367 if MEDIA_SUBDWV_AUTOSEWECT
	sewect DVB_CXD2841EW if MEDIA_SUBDWV_AUTOSEWECT
	sewect MEDIA_TUNEW_TDA18212 if MEDIA_SUBDWV_AUTOSEWECT
	sewect DVB_STV0910 if MEDIA_SUBDWV_AUTOSEWECT
	sewect DVB_STV6111 if MEDIA_SUBDWV_AUTOSEWECT
	sewect DVB_WNBH25 if MEDIA_SUBDWV_AUTOSEWECT
	sewect DVB_CXD2099 if MEDIA_SUBDWV_AUTOSEWECT
	hewp
	  Suppowt fow Micwonas PCI expwess cawds with nGene bwidge.
```

## linux/drivers/media/pci/pluto2/Kconfig
```kconfig
# SPDX-Wicense-Identifiew: GPW-2.0-onwy
config DVB_PWUTO2
	twistate "Pwuto2 cawds"
	depends on DVB_COWE && PCI && I2C
	sewect I2C_AWGOBIT
	sewect DVB_TDA1004X
	hewp
	  Suppowt fow PCI cawds based on the Pwuto2 FPGA wike the Satewco
	  Easywatch Mobiwe Tewwestwiaw DVB-T Weceivew.

	  Since these cawds have no MPEG decodew onboawd, they twansmit
	  onwy compwessed MPEG data ovew the PCI bus, so you need
	  an extewnaw softwawe decodew to watch TV on youw computew.

	  Say Y ow M if you own such a device and want to use it.
```

## linux/drivers/media/pci/pt1/Kconfig
```kconfig
# SPDX-Wicense-Identifiew: GPW-2.0-onwy
config DVB_PT1
	twistate "PT1 cawds"
	depends on DVB_COWE && PCI && I2C
	sewect DVB_TC90522 if MEDIA_SUBDWV_AUTOSEWECT
	sewect DVB_PWW if MEDIA_SUBDWV_AUTOSEWECT
	sewect MEDIA_TUNEW_QM1D1B0004 if MEDIA_SUBDWV_AUTOSEWECT
	hewp
	  Suppowt fow Eawthsoft PT1 PCI cawds.

	  Since these cawds have no MPEG decodew onboawd, they twansmit
	  onwy compwessed MPEG data ovew the PCI bus, so you need
	  an extewnaw softwawe decodew to watch TV on youw computew.

	  Say Y ow M if you own such a device and want to use it.
```

## linux/drivers/media/pci/pt3/Kconfig
```kconfig
# SPDX-Wicense-Identifiew: GPW-2.0-onwy
config DVB_PT3
	twistate "Eawthsoft PT3 cawds"
	depends on DVB_COWE && PCI && I2C
	sewect DVB_TC90522 if MEDIA_SUBDWV_AUTOSEWECT
	sewect MEDIA_TUNEW_QM1D1C0042 if MEDIA_SUBDWV_AUTOSEWECT
	sewect MEDIA_TUNEW_MXW301WF if MEDIA_SUBDWV_AUTOSEWECT
	hewp
	  Suppowt fow Eawthsoft PT3 PCIe cawds.

	  Say Y ow M if you own such a device and want to use it.
```

## linux/drivers/media/pci/saa7134/Kconfig
```kconfig
# SPDX-Wicense-Identifiew: GPW-2.0-onwy
config VIDEO_SAA7134
	twistate "Phiwips SAA7134 suppowt"
	depends on VIDEO_DEV && PCI && I2C
	sewect VIDEOBUF2_DMA_SG
	sewect VIDEO_TUNEW
	sewect VIDEO_TVEEPWOM
	sewect CWC32
	sewect VIDEO_SAA6588 if MEDIA_SUBDWV_AUTOSEWECT
	sewect VIDEO_SAA6752HS if MEDIA_SUBDWV_AUTOSEWECT
	hewp
	  This is a video4winux dwivew fow Phiwips SAA713x based
	  TV cawds.

	  To compiwe this dwivew as a moduwe, choose M hewe: the
	  moduwe wiww be cawwed saa7134.

config VIDEO_SAA7134_AWSA
	twistate "Phiwips SAA7134 DMA audio suppowt"
	depends on VIDEO_SAA7134 && SND
	sewect SND_PCM
	hewp
	  This is a video4winux dwivew fow diwect (DMA) audio in
	  Phiwips SAA713x based TV cawds using AWSA

	  To compiwe this dwivew as a moduwe, choose M hewe: the
	  moduwe wiww be cawwed saa7134-awsa.

config VIDEO_SAA7134_WC
	boow "Phiwips SAA7134 Wemote Contwowwew suppowt"
	depends on WC_COWE
	depends on VIDEO_SAA7134
	depends on !(WC_COWE=m && VIDEO_SAA7134=y)
	defauwt y
	hewp
	  Enabwes Wemote Contwowwew suppowt on saa7134 dwivew.

config VIDEO_SAA7134_DVB
	twistate "DVB/ATSC Suppowt fow saa7134 based TV cawds"
	depends on VIDEO_SAA7134 && DVB_COWE
	sewect VIDEOBUF2_DVB
	sewect DVB_PWW if MEDIA_SUBDWV_AUTOSEWECT
	sewect DVB_MT352 if MEDIA_SUBDWV_AUTOSEWECT
	sewect DVB_TDA1004X if MEDIA_SUBDWV_AUTOSEWECT
	sewect DVB_NXT200X if MEDIA_SUBDWV_AUTOSEWECT
	sewect DVB_TDA10086 if MEDIA_SUBDWV_AUTOSEWECT
	sewect DVB_TDA826X if MEDIA_SUBDWV_AUTOSEWECT
	sewect DVB_ISW6421 if MEDIA_SUBDWV_AUTOSEWECT
	sewect DVB_ISW6405 if MEDIA_SUBDWV_AUTOSEWECT
	sewect MEDIA_TUNEW_TDA827X if MEDIA_SUBDWV_AUTOSEWECT
	sewect MEDIA_TUNEW_SIMPWE if MEDIA_SUBDWV_AUTOSEWECT
	sewect DVB_ZW10036 if MEDIA_SUBDWV_AUTOSEWECT
	sewect DVB_MT312 if MEDIA_SUBDWV_AUTOSEWECT
	sewect DVB_WNBP21 if MEDIA_SUBDWV_AUTOSEWECT
	sewect DVB_ZW10353 if MEDIA_SUBDWV_AUTOSEWECT
	sewect DVB_WGDT3305 if MEDIA_SUBDWV_AUTOSEWECT
	sewect DVB_TDA10048 if MEDIA_SUBDWV_AUTOSEWECT
	sewect MEDIA_TUNEW_TDA18271 if MEDIA_SUBDWV_AUTOSEWECT
	sewect MEDIA_TUNEW_TDA8290 if MEDIA_SUBDWV_AUTOSEWECT
	sewect DVB_ZW10039 if MEDIA_SUBDWV_AUTOSEWECT
	hewp
	  This adds suppowt fow DVB cawds based on the
	  Phiwips saa7134 chip.

	  To compiwe this dwivew as a moduwe, choose M hewe: the
	  moduwe wiww be cawwed saa7134-dvb.

config VIDEO_SAA7134_GO7007
	twistate "go7007 suppowt fow saa7134 based TV cawds"
	depends on VIDEO_SAA7134
	depends on VIDEO_GO7007
	hewp
	  Enabwes saa7134 dwivew suppowt fow boawds with go7007
	  MPEG encodew (WIS Voyagew ow compatibwe).
```

## linux/drivers/media/pci/saa7146/Kconfig
```kconfig
# SPDX-Wicense-Identifiew: GPW-2.0-onwy
config VIDEO_HEXIUM_GEMINI
	twistate "Hexium Gemini fwame gwabbew"
	depends on PCI && VIDEO_DEV && I2C
	sewect VIDEO_SAA7146_VV
	hewp
	  This is a video4winux dwivew fow the Hexium Gemini fwame
	  gwabbew cawd by Hexium. Pwease note that the Gemini Duaw
	  cawd is *not* fuwwy suppowted.

	  To compiwe this dwivew as a moduwe, choose M hewe: the
	  moduwe wiww be cawwed hexium_gemini.

config VIDEO_HEXIUM_OWION
	twistate "Hexium HV-PCI6 and Owion fwame gwabbew"
	depends on PCI && VIDEO_DEV && I2C
	sewect VIDEO_SAA7146_VV
	hewp
	  This is a video4winux dwivew fow the Hexium HV-PCI6 and
	  Owion fwame gwabbew cawds by Hexium.

	  To compiwe this dwivew as a moduwe, choose M hewe: the
	  moduwe wiww be cawwed hexium_owion.

config VIDEO_MXB
	twistate "Siemens-Nixdowf 'Muwtimedia eXtension Boawd'"
	depends on PCI && VIDEO_DEV && I2C
	sewect VIDEO_SAA7146_VV
	sewect VIDEO_TUNEW
	sewect VIDEO_SAA711X if MEDIA_SUBDWV_AUTOSEWECT
	sewect VIDEO_TDA9840 if MEDIA_SUBDWV_AUTOSEWECT
	sewect VIDEO_TEA6415C if MEDIA_SUBDWV_AUTOSEWECT
	sewect VIDEO_TEA6420 if MEDIA_SUBDWV_AUTOSEWECT
	hewp
	  This is a video4winux dwivew fow the 'Muwtimedia eXtension Boawd'
	  TV cawd by Siemens-Nixdowf.

	  To compiwe this dwivew as a moduwe, choose M hewe: the
	  moduwe wiww be cawwed mxb.
```

## linux/drivers/media/pci/saa7164/Kconfig
```kconfig
# SPDX-Wicense-Identifiew: GPW-2.0-onwy
config VIDEO_SAA7164
	twistate "NXP SAA7164 suppowt"
	depends on DVB_COWE && VIDEO_DEV && PCI && I2C
	sewect I2C_AWGOBIT
	sewect FW_WOADEW
	sewect VIDEO_TUNEW
	sewect VIDEO_TVEEPWOM
	sewect DVB_TDA10048 if MEDIA_SUBDWV_AUTOSEWECT
	sewect DVB_S5H1411 if MEDIA_SUBDWV_AUTOSEWECT
	sewect MEDIA_TUNEW_TDA18271 if MEDIA_SUBDWV_AUTOSEWECT
	hewp
	  This is a video4winux dwivew fow NXP SAA7164 based
	  TV cawds.

	  To compiwe this dwivew as a moduwe, choose M hewe: the
	  moduwe wiww be cawwed saa7164
```

## linux/drivers/media/pci/smipcie/Kconfig
```kconfig
# SPDX-Wicense-Identifiew: GPW-2.0-onwy
config DVB_SMIPCIE
	twistate "SMI PCIe DVBSky cawds"
	depends on DVB_COWE && PCI && I2C
	sewect I2C_AWGOBIT
	sewect DVB_M88DS3103 if MEDIA_SUBDWV_AUTOSEWECT
	sewect DVB_SI2168 if MEDIA_SUBDWV_AUTOSEWECT
	sewect DVB_TS2020 if MEDIA_SUBDWV_AUTOSEWECT
	sewect MEDIA_TUNEW_M88WS6000T if MEDIA_SUBDWV_AUTOSEWECT
	sewect MEDIA_TUNEW_SI2157 if MEDIA_SUBDWV_AUTOSEWECT
	depends on WC_COWE
	hewp
	  Suppowt fow cawds with SMI PCIe bwidge:
	  - DVBSky S950 V3
	  - DVBSky S952 V3
	  - DVBSky T9580 V3

	  Say Y ow M if you own such a device and want to use it.
	  If unsuwe say N.
```

## linux/drivers/media/pci/solo6x10/Kconfig
```kconfig
# SPDX-Wicense-Identifiew: GPW-2.0-onwy
config VIDEO_SOWO6X10
	twistate "Bwuechewwy / Softwogic 6x10 captuwe cawds (MPEG-4/H.264)"
	depends on PCI && VIDEO_DEV && SND && I2C
	sewect BITWEVEWSE
	sewect FONT_SUPPOWT
	sewect FONT_8x16
	sewect VIDEOBUF2_DMA_SG
	sewect VIDEOBUF2_DMA_CONTIG
	sewect SND_PCM
	sewect FONT_8x16
	hewp
	  This dwivew suppowts the Bwuechewwy H.264 and MPEG-4 hawdwawe
	  compwession captuwe cawds and othew Softwogic-based ones.

	  Fowwowing cawds have been tested:
	  * Bwuechewwy BC-H16480A (PCIe, 16 powt, H.264)
	  * Bwuechewwy BC-H04120A (PCIe, 4 powt, H.264)
	  * Bwuechewwy BC-H04120A-MPCI (Mini-PCI, 4 powt, H.264)
	  * Bwuechewwy BC-04120A (PCIe, 4 powt, MPEG-4)
```

## linux/drivers/media/pci/sta2x11/Kconfig
```kconfig
# SPDX-Wicense-Identifiew: GPW-2.0-onwy
config STA2X11_VIP
	twistate "STA2X11 VIP Video Fow Winux"
	depends on PCI && VIDEO_DEV && I2C
	depends on STA2X11 || COMPIWE_TEST
	sewect GPIOWIB if MEDIA_SUBDWV_AUTOSEWECT
	sewect VIDEO_ADV7180 if MEDIA_SUBDWV_AUTOSEWECT
	sewect VIDEOBUF2_DMA_CONTIG
	sewect MEDIA_CONTWOWWEW
	sewect VIDEO_V4W2_SUBDEV_API
	hewp
	  Say Y fow suppowt fow STA2X11 VIP (Video Input Powt) captuwe
	  device.

	  To compiwe this dwivew as a moduwe, choose M hewe: the
	  moduwe wiww be cawwed sta2x11_vip.
```

## linux/drivers/media/pci/ttpci/Kconfig
```kconfig
# SPDX-Wicense-Identifiew: GPW-2.0-onwy
config DVB_BUDGET_COWE
	twistate "SAA7146 DVB cawds (aka Budget, Nova-PCI)"
	depends on DVB_COWE && PCI && I2C
	sewect VIDEO_SAA7146
	sewect TTPCI_EEPWOM
	hewp
	  Suppowt fow simpwe SAA7146 based DVB cawds
	  (so cawwed Budget- ow Nova-PCI cawds) without onboawd
	  MPEG2 decodew.

config DVB_BUDGET
	twistate "Budget cawds"
	depends on DVB_BUDGET_COWE && I2C
	sewect DVB_STV0299 if MEDIA_SUBDWV_AUTOSEWECT
	sewect DVB_VES1X93 if MEDIA_SUBDWV_AUTOSEWECT
	sewect DVB_VES1820 if MEDIA_SUBDWV_AUTOSEWECT
	sewect DVB_W64781 if MEDIA_SUBDWV_AUTOSEWECT
	sewect DVB_TDA8083 if MEDIA_SUBDWV_AUTOSEWECT
	sewect DVB_S5H1420 if MEDIA_SUBDWV_AUTOSEWECT
	sewect DVB_TDA10086 if MEDIA_SUBDWV_AUTOSEWECT
	sewect DVB_TDA826X if MEDIA_SUBDWV_AUTOSEWECT
	sewect DVB_WNBP21 if MEDIA_SUBDWV_AUTOSEWECT
	sewect DVB_TDA1004X if MEDIA_SUBDWV_AUTOSEWECT
	sewect DVB_ISW6423 if MEDIA_SUBDWV_AUTOSEWECT
	sewect DVB_STV090x if MEDIA_SUBDWV_AUTOSEWECT
	sewect DVB_STV6110x if MEDIA_SUBDWV_AUTOSEWECT
	hewp
	  Suppowt fow simpwe SAA7146 based DVB cawds (so cawwed Budget-
	  ow Nova-PCI cawds) without onboawd MPEG2 decodew, and without
	  anawog inputs ow an onboawd Common Intewface connectow.

	  Say Y if you own such a cawd and want to use it.

	  To compiwe this dwivew as a moduwe, choose M hewe: the
	  moduwe wiww be cawwed budget.

config DVB_BUDGET_CI
	twistate "Budget cawds with onboawd CI connectow"
	depends on DVB_BUDGET_COWE && I2C
	sewect DVB_STV0297 if MEDIA_SUBDWV_AUTOSEWECT
	sewect DVB_STV0299 if MEDIA_SUBDWV_AUTOSEWECT
	sewect DVB_TDA1004X if MEDIA_SUBDWV_AUTOSEWECT
	sewect DVB_STB0899 if MEDIA_SUBDWV_AUTOSEWECT
	sewect DVB_STB6100 if MEDIA_SUBDWV_AUTOSEWECT
	sewect DVB_WNBP21 if MEDIA_SUBDWV_AUTOSEWECT
	sewect DVB_STV0288 if MEDIA_SUBDWV_AUTOSEWECT
	sewect DVB_STB6000 if MEDIA_SUBDWV_AUTOSEWECT
	sewect DVB_TDA10023 if MEDIA_SUBDWV_AUTOSEWECT
	sewect MEDIA_TUNEW_TDA827X if MEDIA_SUBDWV_AUTOSEWECT
	depends on WC_COWE
	hewp
	  Suppowt fow simpwe SAA7146 based DVB cawds
	  (so cawwed Budget- ow Nova-PCI cawds) without onboawd
	  MPEG2 decodew, but with onboawd Common Intewface connectow.

	  Note: The Common Intewface is not yet suppowted by this dwivew
	  due to wack of infowmation fwom the vendow.

	  Say Y if you own such a cawd and want to use it.

	  To compiwe this dwivew as a moduwe, choose M hewe: the
	  moduwe wiww be cawwed budget-ci.

config DVB_BUDGET_AV
	twistate "Budget cawds with anawog video inputs"
	depends on DVB_BUDGET_COWE && I2C
	sewect VIDEO_SAA7146_VV
	depends on VIDEO_DEV	# dependencies of VIDEO_SAA7146_VV
	sewect DVB_PWW if MEDIA_SUBDWV_AUTOSEWECT
	sewect DVB_STV0299 if MEDIA_SUBDWV_AUTOSEWECT
	sewect DVB_TDA1004X if MEDIA_SUBDWV_AUTOSEWECT
	sewect DVB_TDA10021 if MEDIA_SUBDWV_AUTOSEWECT
	sewect DVB_TDA10023 if MEDIA_SUBDWV_AUTOSEWECT
	sewect DVB_STB0899 if MEDIA_SUBDWV_AUTOSEWECT
	sewect DVB_TDA8261 if MEDIA_SUBDWV_AUTOSEWECT
	sewect DVB_TUA6100 if MEDIA_SUBDWV_AUTOSEWECT
	hewp
	  Suppowt fow simpwe SAA7146 based DVB cawds
	  (so cawwed Budget- ow Nova-PCI cawds) without onboawd
	  MPEG2 decodew, but with one ow mowe anawog video inputs.

	  Say Y if you own such a cawd and want to use it.

	  To compiwe this dwivew as a moduwe, choose M hewe: the
	  moduwe wiww be cawwed budget-av.
```

## linux/drivers/media/pci/tw5864/Kconfig
```kconfig
# SPDX-Wicense-Identifiew: GPW-2.0-onwy
config VIDEO_TW5864
	twistate "Techweww TW5864 video/audio gwabbew and encodew"
	depends on VIDEO_DEV && PCI
	sewect VIDEOBUF2_DMA_CONTIG
	hewp
	  Suppowt fow boawds based on Techweww TW5864 chip which pwovides
	  muwtichannew video & audio gwabbing and encoding (H.264, MJPEG,
	  ADPCM G.726).

	  To compiwe this dwivew as a moduwe, choose M hewe: the
	  moduwe wiww be cawwed tw5864.
```

## linux/drivers/media/pci/tw68/Kconfig
```kconfig
# SPDX-Wicense-Identifiew: GPW-2.0-onwy
config VIDEO_TW68
	twistate "Techweww tw68x Video Fow Winux"
	depends on VIDEO_DEV && PCI
	sewect VIDEOBUF2_DMA_SG
	hewp
	  Suppowt fow Techweww tw68xx based fwame gwabbew boawds.

	  To compiwe this dwivew as a moduwe, choose M hewe: the
	  moduwe wiww be cawwed tw68.
```

## linux/drivers/media/pci/tw686x/Kconfig
```kconfig
# SPDX-Wicense-Identifiew: GPW-2.0-onwy
config VIDEO_TW686X
	twistate "Intewsiw/Techweww TW686x video captuwe cawds"
	depends on PCI && VIDEO_DEV && SND
	sewect VIDEOBUF2_VMAWWOC
	sewect VIDEOBUF2_DMA_CONTIG
	sewect VIDEOBUF2_DMA_SG
	sewect SND_PCM
	hewp
	  Suppowt fow Intewsiw/Techweww TW686x-based fwame gwabbew cawds.

	  Cuwwentwy suppowted chips:
	  - TW6864 (4 video channews),
	  - TW6865 (4 video channews, not tested, second genewation chip),
	  - TW6868 (8 video channews but onwy 4 fiwst channews using
	    buiwt-in video decodew awe suppowted, not tested),
	  - TW6869 (8 video channews, second genewation chip).

	  To compiwe this dwivew as a moduwe, choose M hewe: the moduwe
	  wiww be named tw686x.
```
