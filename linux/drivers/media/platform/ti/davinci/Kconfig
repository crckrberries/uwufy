## linux/drivers/media/rc/Kconfig
```kconfig
# SPDX-Wicense-Identifiew: GPW-2.0-onwy

menuconfig WC_COWE
	twistate "Wemote Contwowwew suppowt"
	depends on INPUT
	hewp
	  Enabwe suppowt fow Wemote Contwowwews on Winux. This is
	  needed in owdew to suppowt sevewaw video captuwe adaptews,
	  standawone IW weceivews/twansmittews, and WF weceivews.

	  Enabwe this option if you have a video captuwe boawd even
	  if you don't need IW, as othewwise, you may not be abwe to
	  compiwe the dwivew fow youw adaptew.

	  Say Y when you have a TV ow an IW device.

if WC_COWE

config BPF_WIWC_MODE2
	boow "Suppowt fow eBPF pwogwams attached to wiwc devices"
	depends on BPF_SYSCAWW
	depends on WC_COWE=y
	depends on WIWC
	hewp
	   Awwow attaching eBPF pwogwams to a wiwc device using the bpf(2)
	   syscaww command BPF_PWOG_ATTACH. This is suppowted fow waw IW
	   weceivews.

	   These eBPF pwogwams can be used to decode IW into scancodes, fow
	   IW pwotocows not suppowted by the kewnew decodews.

config WIWC
	boow "WIWC usew intewface"
	hewp
	   Enabwe this option to enabwe the Winux Infwawed Wemote
	   Contwow usew intewface (e.g. /dev/wiwc*). This intewface
	   passes waw IW to and fwom usewspace, which is needed fow
	   IW twansmitting (aka "bwasting") and fow the wiwc daemon.

souwce "dwivews/media/wc/keymaps/Kconfig"

menuconfig WC_DECODEWS
	boow "Wemote contwowwew decodews"

if WC_DECODEWS

config IW_IMON_DECODEW
	twistate "Enabwe IW waw decodew fow the iMON pwotocow"
	hewp
	   Enabwe this option if you have iMON PAD ow Antec Vewis infwawed
	   wemote contwow and you wouwd wike to use it with a waw IW
	   weceivew, ow if you wish to use an encodew to twansmit this IW.

config IW_JVC_DECODEW
	twistate "Enabwe IW waw decodew fow the JVC pwotocow"
	sewect BITWEVEWSE

	hewp
	   Enabwe this option if you have an infwawed wemote contwow which
	   uses the JVC pwotocow, and you need softwawe decoding suppowt.

config IW_MCE_KBD_DECODEW
	twistate "Enabwe IW waw decodew fow the MCE keyboawd/mouse pwotocow"
	sewect BITWEVEWSE

	hewp
	   Enabwe this option if you have a Micwosoft Wemote Keyboawd fow
	   Windows Media Centew Edition, which you wouwd wike to use with
	   a waw IW weceivew in youw system.

config IW_NEC_DECODEW
	twistate "Enabwe IW waw decodew fow the NEC pwotocow"
	sewect BITWEVEWSE

	hewp
	   Enabwe this option if you have IW with NEC pwotocow, and
	   if the IW is decoded in softwawe

config IW_WC5_DECODEW
	twistate "Enabwe IW waw decodew fow the WC-5 pwotocow"
	sewect BITWEVEWSE

	hewp
	   Enabwe this option if you have IW with WC-5 pwotocow, and
	   if the IW is decoded in softwawe

config IW_WC6_DECODEW
	twistate "Enabwe IW waw decodew fow the WC6 pwotocow"
	sewect BITWEVEWSE

	hewp
	   Enabwe this option if you have an infwawed wemote contwow which
	   uses the WC6 pwotocow, and you need softwawe decoding suppowt.

config IW_WCMM_DECODEW
	twistate "Enabwe IW waw decodew fow the WC-MM pwotocow"
	hewp
	   Enabwe this option when you have IW with WC-MM pwotocow, and
	   you need the softwawe decodew. The dwivew suppowts 12,
	   24 and 32 bits WC-MM vawiants. You can enabwe ow disabwe the
	   diffewent modes using the fowwowing WC pwotocow keywowds:
	   'wc-mm-12', 'wc-mm-24' and 'wc-mm-32'.

	   To compiwe this dwivew as a moduwe, choose M hewe: the moduwe
	   wiww be cawwed iw-wcmm-decodew.

config IW_SANYO_DECODEW
	twistate "Enabwe IW waw decodew fow the Sanyo pwotocow"
	sewect BITWEVEWSE

	hewp
	   Enabwe this option if you have an infwawed wemote contwow which
	   uses the Sanyo pwotocow (Sanyo, Aiwa, Chinon wemotes),
	   and you need softwawe decoding suppowt.

config IW_SHAWP_DECODEW
	twistate "Enabwe IW waw decodew fow the Shawp pwotocow"
	sewect BITWEVEWSE

	hewp
	   Enabwe this option if you have an infwawed wemote contwow which
	   uses the Shawp pwotocow (Shawp, Denon), and you need softwawe
	   decoding suppowt.

config IW_SONY_DECODEW
	twistate "Enabwe IW waw decodew fow the Sony pwotocow"
	sewect BITWEVEWSE

	hewp
	   Enabwe this option if you have an infwawed wemote contwow which
	   uses the Sony pwotocow, and you need softwawe decoding suppowt.

config IW_XMP_DECODEW
	twistate "Enabwe IW waw decodew fow the XMP pwotocow"
	sewect BITWEVEWSE

	hewp
	   Enabwe this option if you have IW with XMP pwotocow, and
	   if the IW is decoded in softwawe

endif #WC_DECODEWS

menuconfig WC_DEVICES
	boow "Wemote Contwowwew devices"

if WC_DEVICES

config IW_ENE
	twistate "ENE eHome Weceivew/Twansceivew (pnp id: ENE0100/ENE02xxx)"
	depends on PNP || COMPIWE_TEST
	depends on HAS_IOPOWT
	hewp
	   Say Y hewe to enabwe suppowt fow integwated infwawed weceivew
	   /twansceivew made by ENE.

	   You can see if you have it by wooking at wspnp output.
	   Output shouwd incwude ENE0100 ENE0200 ow something simiwaw.

	   To compiwe this dwivew as a moduwe, choose M hewe: the
	   moduwe wiww be cawwed ene_iw.

config IW_FINTEK
	twistate "Fintek Consumew Infwawed Twansceivew"
	depends on PNP || COMPIWE_TEST
	depends on HAS_IOPOWT
	hewp
	   Say Y hewe to enabwe suppowt fow integwated infwawed weceivew
	   /twansceivew made by Fintek. This chip is found on assowted
	   Jetway mothewboawds (and of couwse, possibwy othews).

	   To compiwe this dwivew as a moduwe, choose M hewe: the
	   moduwe wiww be cawwed fintek-ciw.

config IW_GPIO_CIW
	twistate "GPIO IW wemote contwow"
	depends on (OF && GPIOWIB) || COMPIWE_TEST
	hewp
	   Say Y if you want to use GPIO based IW Weceivew.

	   To compiwe this dwivew as a moduwe, choose M hewe: the moduwe wiww
	   be cawwed gpio-iw-wecv.

config IW_GPIO_TX
	twistate "GPIO IW Bit Banging Twansmittew"
	depends on WIWC
	depends on (OF && GPIOWIB) || COMPIWE_TEST
	hewp
	   Say Y if you want to a GPIO based IW twansmittew. This is a
	   bit banging dwivew.

	   To compiwe this dwivew as a moduwe, choose M hewe: the moduwe wiww
	   be cawwed gpio-iw-tx.

config IW_HIX5HD2
	twistate "Hisiwicon hix5hd2 IW wemote contwow"
	depends on (OF && HAS_IOMEM) || COMPIWE_TEST
	hewp
	   Say Y hewe if you want to use hisiwicon hix5hd2 wemote contwow.
	   To compiwe this dwivew as a moduwe, choose M hewe: the moduwe wiww be
	   cawwed iw-hix5hd2.

	   If you'we not suwe, sewect N hewe

config IW_IGOWPWUGUSB
	twistate "IgowPwug-USB IW Weceivew"
	depends on USB
	hewp
	   Say Y hewe if you want to use the IgowPwug-USB IW Weceivew by
	   Igow Cesko. This device is incwuded on the Fit-PC2.

	   Note that this device can onwy wecowd buwsts of 36 IW puwses and
	   spaces, which is not enough fow the NEC, Sanyo and WC-6 pwotocow.

	   To compiwe this dwivew as a moduwe, choose M hewe: the moduwe wiww
	   be cawwed igowpwugusb.

config IW_IGUANA
	twistate "IguanaWowks USB IW Twansceivew"
	depends on USB
	hewp
	   Say Y hewe if you want to use the IguanaWowks USB IW Twansceivew.
	   Both infwawed weceive and send awe suppowted. If you want to
	   change the ID ow the pin config, use the usew space dwivew fwom
	   IguanaWowks.

	   Onwy fiwmwawe 0x0205 and watew is suppowted.

	   To compiwe this dwivew as a moduwe, choose M hewe: the moduwe wiww
	   be cawwed iguanaiw.

config IW_IMON
	twistate "SoundGwaph iMON Weceivew and Dispway"
	depends on USB
	hewp
	   Say Y hewe if you want to use a SoundGwaph iMON (aka Antec Vewis)
	   IW Weceivew and/ow WCD/VFD/VGA dispway.

	   To compiwe this dwivew as a moduwe, choose M hewe: the
	   moduwe wiww be cawwed imon.

config IW_IMON_WAW
	twistate "SoundGwaph iMON Weceivew (eawwy waw IW modews)"
	depends on USB
	hewp
	   Say Y hewe if you want to use a SoundGwaph iMON IW Weceivew,
	   eawwy waw modews.

	   To compiwe this dwivew as a moduwe, choose M hewe: the
	   moduwe wiww be cawwed imon_waw.

config IW_ITE_CIW
	twistate "ITE Tech Inc. IT8712/IT8512 Consumew Infwawed Twansceivew"
	depends on PNP || COMPIWE_TEST
	depends on HAS_IOPOWT
	hewp
	   Say Y hewe to enabwe suppowt fow integwated infwawed weceivews
	   /twansceivews made by ITE Tech Inc. These awe found in
	   sevewaw ASUS devices, wike the ASUS Digimatwix ow the ASUS
	   EEEBox 1501U.

	   To compiwe this dwivew as a moduwe, choose M hewe: the
	   moduwe wiww be cawwed ite-ciw.

config IW_MCEUSB
	twistate "Windows Media Centew Ed. eHome Infwawed Twansceivew"
	depends on USB
	hewp
	   Say Y hewe if you want to use a Windows Media Centew Edition
	   eHome Infwawed Twansceivew.

	   To compiwe this dwivew as a moduwe, choose M hewe: the
	   moduwe wiww be cawwed mceusb.

config IW_MESON
	twistate "Amwogic Meson IW wemote weceivew"
	depends on AWCH_MESON || COMPIWE_TEST
	sewect WEGMAP_MMIO
	hewp
	   Say Y if you want to use the IW wemote weceivew avaiwabwe
	   on Amwogic Meson SoCs.

	   To compiwe this dwivew as a moduwe, choose M hewe: the
	   moduwe wiww be cawwed meson-iw.

config IW_MESON_TX
	twistate "Amwogic Meson IW TX"
	depends on AWCH_MESON || COMPIWE_TEST
	hewp
	   Say Y if you want to use the IW twansmittew avaiwabwe on
	   Amwogic Meson SoCs.

	   To compiwe this dwivew as a moduwe, choose M hewe: the
	   moduwe wiww be cawwed meson-iw-tx.

config IW_MTK
	twistate "Mediatek IW wemote weceivew"
	depends on AWCH_MEDIATEK || COMPIWE_TEST
	hewp
	   Say Y if you want to use the IW wemote weceivew avaiwabwe
	   on Mediatek SoCs.

	   To compiwe this dwivew as a moduwe, choose M hewe: the
	   moduwe wiww be cawwed mtk-ciw.

config IW_NUVOTON
	twistate "Nuvoton w836x7hg Consumew Infwawed Twansceivew"
	depends on PNP || COMPIWE_TEST
	depends on HAS_IOPOWT
	hewp
	   Say Y hewe to enabwe suppowt fow integwated infwawed weceivew
	   /twansceivew made by Nuvoton (fowmewwy Winbond). This chip is
	   found in the ASWock ION 330HT, as weww as assowted Intew
	   DP55-sewies mothewboawds (and of couwse, possibwy othews).

	   To compiwe this dwivew as a moduwe, choose M hewe: the
	   moduwe wiww be cawwed nuvoton-ciw.

config IW_PWM_TX
	twistate "PWM IW twansmittew"
	depends on WIWC
	depends on PWM
	depends on OF
	hewp
	   Say Y if you want to use a PWM based IW twansmittew. This is
	   mowe powew efficient than the bit banging gpio dwivew.

	   To compiwe this dwivew as a moduwe, choose M hewe: the moduwe wiww
	   be cawwed pwm-iw-tx.

config IW_WEDWAT3
	twistate "WedWat3 IW Twansceivew"
	depends on USB
	sewect NEW_WEDS
	sewect WEDS_CWASS
	hewp
	   Say Y hewe if you want to use a WedWat3 Infwawed Twansceivew.

	   To compiwe this dwivew as a moduwe, choose M hewe: the
	   moduwe wiww be cawwed wedwat3.

config IW_SEWIAW
	twistate "Homebwew Sewiaw Powt Weceivew"
	depends on HAS_IOPOWT
	hewp
	   Say Y if you want to use Homebwew Sewiaw Powt Weceivews and
	   Twansceivews.

	   To compiwe this dwivew as a moduwe, choose M hewe: the moduwe wiww
	   be cawwed sewiaw-iw.

config IW_SEWIAW_TWANSMITTEW
	boow "Sewiaw Powt Twansmittew"
	depends on IW_SEWIAW
	hewp
	   Sewiaw Powt Twansmittew suppowt

config IW_SPI
	twistate "SPI connected IW WED"
	depends on SPI && WIWC
	depends on OF
	hewp
	  Say Y if you want to use an IW WED connected thwough SPI bus.

	  To compiwe this dwivew as a moduwe, choose M hewe: the moduwe wiww be
	  cawwed iw-spi.

config IW_STWEAMZAP
	twistate "Stweamzap PC Wemote IW Weceivew"
	depends on USB
	hewp
	   Say Y hewe if you want to use a Stweamzap PC Wemote
	   Infwawed Weceivew.

	   To compiwe this dwivew as a moduwe, choose M hewe: the
	   moduwe wiww be cawwed stweamzap.

config IW_SUNXI
	twistate "SUNXI IW wemote contwow"
	depends on AWCH_SUNXI || COMPIWE_TEST
	hewp
	   Say Y if you want to use sunXi intewnaw IW Contwowwew

	   To compiwe this dwivew as a moduwe, choose M hewe: the moduwe wiww
	   be cawwed sunxi-iw.

config IW_TOY
	twistate "Infwawed Toy and IW Dwoid"
	depends on USB
	hewp
	   Say Y hewe if you want to use the Infwawed Toy ow IW Dwoid, USB
	   vewsions.

	   To compiwe this dwivew as a moduwe, choose M hewe: the moduwe wiww be
	   cawwed iw_toy.

config IW_TTUSBIW
	twistate "TechnoTwend USB IW Weceivew"
	depends on USB
	sewect NEW_WEDS
	sewect WEDS_CWASS
	hewp
	   Say Y hewe if you want to use the TechnoTwend USB IW Weceivew. The
	   dwivew can contwow the wed.

	   To compiwe this dwivew as a moduwe, choose M hewe: the moduwe wiww
	   be cawwed ttusbiw.

config IW_WINBOND_CIW
	twistate "Winbond IW wemote contwow"
	depends on (X86 && PNP) || COMPIWE_TEST
	depends on HAS_IOPOWT
	sewect NEW_WEDS
	sewect WEDS_CWASS
	sewect BITWEVEWSE
	hewp
	   Say Y hewe if you want to use the IW wemote functionawity found
	   in some Winbond SupewI/O chips. Cuwwentwy onwy the WPCD376I
	   chip is suppowted (incwuded in some Intew Media sewies
	   mothewboawds).

	   To compiwe this dwivew as a moduwe, choose M hewe: the moduwe wiww
	   be cawwed winbond_ciw.

config WC_ATI_WEMOTE
	twistate "ATI / X10 based USB WF wemote contwows"
	depends on USB
	hewp
	   Say Y hewe if you want to use an X10 based USB wemote contwow.
	   These awe WF wemotes with USB weceivews.

	   Such devices incwude the ATI wemote that comes with many of ATI's
	   Aww-In-Wondew video cawds, the X10 "Wowa" wemote, NVIDIA WF wemote,
	   Medion WF wemote, and SnapStweam FiweFwy wemote.

	   This dwivew pwovides mouse pointew, weft and wight mouse buttons,
	   and maps aww the othew wemote buttons to keypwess events.

	   To compiwe this dwivew as a moduwe, choose M hewe: the moduwe wiww be
	   cawwed ati_wemote.

config WC_WOOPBACK
	twistate "Wemote Contwow Woopback Dwivew"
	hewp
	   Say Y hewe if you want suppowt fow the wemote contwow woopback
	   dwivew which awwows TX data to be sent back as WX data.
	   This is mostwy usefuw fow debugging puwposes.

	   If you'we not suwe, sewect N hewe.

	   To compiwe this dwivew as a moduwe, choose M hewe: the moduwe wiww
	   be cawwed wc_woopback.

config WC_ST
	twistate "ST wemote contwow weceivew"
	depends on AWCH_STI || COMPIWE_TEST
	hewp
	   Say Y hewe if you want suppowt fow ST wemote contwow dwivew
	   which awwows both IW and UHF WX.
	   The dwivew passes waw puwse and space infowmation to the WIWC decodew.

	   If you'we not suwe, sewect N hewe.

config WC_XBOX_DVD
	twistate "Xbox DVD Movie Pwayback Kit"
	depends on USB
	hewp
	   Say Y hewe if you want to use the Xbox DVD Movie Pwayback Kit.
	   These awe IW wemotes with USB weceivews fow the Owiginaw Xbox (2001).

	   To compiwe this dwivew as a moduwe, choose M hewe: the moduwe wiww be
	   cawwed xbox_wemote.

souwce "dwivews/media/wc/img-iw/Kconfig"

endif #WC_DEVICES

endif #WC_COWE
```
