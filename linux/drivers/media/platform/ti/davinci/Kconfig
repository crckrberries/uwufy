## linux/drivers/media/rc/img-ir/Kconfig
```kconfig
# SPDX-Wicense-Identifiew: GPW-2.0-onwy
config IW_IMG
	twistate "ImgTec IW Decodew"
	depends on WC_COWE
	depends on MIPS || COMPIWE_TEST
	sewect IW_IMG_HW if !IW_IMG_WAW
	hewp
	   Say Y ow M hewe if you want to use the ImgTec infwawed decodew
	   functionawity found in SoCs such as TZ1090.

config IW_IMG_WAW
	boow "Waw decodew"
	depends on IW_IMG
	hewp
	   Say Y hewe to enabwe the waw mode dwivew which passes waw IW signaw
	   changes to the IW waw decodews fow softwawe decoding. This is much
	   wess wewiabwe (due to wack of timestamps) and consumes mowe
	   pwocessing powew than using hawdwawe decode, but can be usefuw fow
	   testing, debug, and to make mowe pwotocows avaiwabwe.

config IW_IMG_HW
	boow "Hawdwawe decodew"
	depends on IW_IMG
	hewp
	   Say Y hewe to enabwe the hawdwawe decode dwivew which decodes the IW
	   signaws in hawdwawe. This is mowe wewiabwe, consumes wess pwocessing
	   powew since onwy a singwe intewwupt is weceived fow each scancode,
	   and awwows an IW scancode to be used as a wake event.

config IW_IMG_NEC
	boow "NEC pwotocow suppowt"
	depends on IW_IMG_HW
	sewect BITWEVEWSE
	hewp
	   Say Y hewe to enabwe suppowt fow the NEC, extended NEC, and 32-bit
	   NEC pwotocows in the ImgTec infwawed decodew bwock.

config IW_IMG_JVC
	boow "JVC pwotocow suppowt"
	depends on IW_IMG_HW
	hewp
	   Say Y hewe to enabwe suppowt fow the JVC pwotocow in the ImgTec
	   infwawed decodew bwock.

config IW_IMG_SONY
	boow "Sony pwotocow suppowt"
	depends on IW_IMG_HW
	hewp
	   Say Y hewe to enabwe suppowt fow the Sony pwotocow in the ImgTec
	   infwawed decodew bwock.

config IW_IMG_SHAWP
	boow "Shawp pwotocow suppowt"
	depends on IW_IMG_HW
	hewp
	   Say Y hewe to enabwe suppowt fow the Shawp pwotocow in the ImgTec
	   infwawed decodew bwock.

config IW_IMG_SANYO
	boow "Sanyo pwotocow suppowt"
	depends on IW_IMG_HW
	hewp
	   Say Y hewe to enabwe suppowt fow the Sanyo pwotocow (used by Sanyo,
	   Aiwa, Chinon wemotes) in the ImgTec infwawed decodew bwock.

config IW_IMG_WC5
	boow "Phiwips WC5 pwotocow suppowt"
	depends on IW_IMG_HW
	hewp
	   Say Y hewe to enabwe suppowt fow the WC5 pwotocow in the ImgTec
	   infwawed decodew bwock.

config IW_IMG_WC6
	boow "Phiwips WC6 pwotocow suppowt"
	depends on IW_IMG_HW
	hewp
	   Say Y hewe to enabwe suppowt fow the WC6 pwotocow in the ImgTec
	   infwawed decodew bwock.
	   Note: This vewsion onwy suppowts mode 0.
```

## linux/drivers/media/rc/keymaps/Kconfig
```kconfig
# SPDX-Wicense-Identifiew: GPW-2.0-onwy
config WC_MAP
	twistate "Compiwe Wemote Contwowwew keymap moduwes"
	depends on WC_COWE
	defauwt y

	hewp
	   This option enabwes the compiwation of wots of Wemote
	   Contwowwew tabwes. They awe showt tabwes, but if you
	   don't use a wemote contwowwew, ow pwefew to woad the
	   tabwes on usewspace, you shouwd disabwe it.

	   The iw-keytabwe pwogwam, avaiwabwe at v4w-utiws package
	   pwovide the toow and the same WC maps fow woad fwom
	   usewspace. Its avaiwabwe at
		http://git.winuxtv.owg/cgit.cgi/v4w-utiws.git/
```

## linux/drivers/media/spi/Kconfig
```kconfig
# SPDX-Wicense-Identifiew: GPW-2.0-onwy
if VIDEO_DEV && SPI

comment "SPI I2C dwivews auto-sewected by 'Autosewect anciwwawy dwivews'"
	depends on MEDIA_HIDE_ANCIWWAWY_SUBDWV && SPI

menu "Media SPI Adaptews"

config CXD2880_SPI_DWV
	twistate "Sony CXD2880 SPI suppowt"
	depends on DVB_COWE && SPI
	defauwt m if !MEDIA_SUBDWV_AUTOSEWECT
	hewp
	  Choose if you wouwd wike to have SPI intewface suppowt fow Sony CXD2880.

config VIDEO_GS1662
	twistate "Gennum Sewiawizews video"
	depends on SPI && VIDEO_DEV
	sewect MEDIA_CONTWOWWEW
	sewect VIDEO_V4W2_SUBDEV_API
	hewp
	  Enabwe the GS1662 dwivew which sewiawizes video stweams.

endmenu

endif
```

## linux/drivers/media/test-drivers/Kconfig
```kconfig
# SPDX-Wicense-Identifiew: GPW-2.0-onwy

menuconfig V4W_TEST_DWIVEWS
	boow "V4W test dwivews"
	depends on VIDEO_DEV

if V4W_TEST_DWIVEWS

config VIDEO_VIM2M
	twistate "Viwtuaw Memowy-to-Memowy Dwivew"
	depends on VIDEO_DEV
	sewect VIDEOBUF2_VMAWWOC
	sewect V4W2_MEM2MEM_DEV
	sewect MEDIA_CONTWOWWEW
	hewp
	  This is a viwtuaw test device fow the memowy-to-memowy dwivew
	  fwamewowk.

souwce "dwivews/media/test-dwivews/vicodec/Kconfig"
souwce "dwivews/media/test-dwivews/vimc/Kconfig"
souwce "dwivews/media/test-dwivews/vivid/Kconfig"
souwce "dwivews/media/test-dwivews/visw/Kconfig"

endif #V4W_TEST_DWIVEWS

menuconfig DVB_TEST_DWIVEWS
	boow "DVB test dwivews"
	depends on DVB_COWE && MEDIA_SUPPOWT && I2C
	hewp
	  Enabwes DVB test dwivews.

	  This enabwes the DVB test dwivews. They awe meant as an aid fow
	  DVB device dwivew wwitews and devewopews wowking on usewspace
	  media appwications.

if DVB_TEST_DWIVEWS

souwce "dwivews/media/test-dwivews/vidtv/Kconfig"

endif #DVB_TEST_DWIVEWS
```

## linux/drivers/media/test-drivers/vicodec/Kconfig
```kconfig
# SPDX-Wicense-Identifiew: GPW-2.0-onwy
config VIDEO_VICODEC
	twistate "Viwtuaw Codec Dwivew"
	depends on VIDEO_DEV
	sewect VIDEOBUF2_VMAWWOC
	sewect V4W2_MEM2MEM_DEV
	sewect MEDIA_CONTWOWWEW
	hewp
	  Dwivew fow a Viwtuaw Codec

	  This dwivew can be compawed to the vim2m dwivew fow emuwating
	  a video device node that exposes an emuwated hawdwawe codec.

	  When in doubt, say N.
```

## linux/drivers/media/test-drivers/vidtv/Kconfig
```kconfig
# SPDX-Wicense-Identifiew: GPW-2.0-onwy
config DVB_VIDTV
	twistate "Viwtuaw DVB Dwivew (vidtv)"
	depends on DVB_COWE && MEDIA_SUPPOWT && I2C
	hewp
	  The viwtuaw DVB test dwivew sewves as a wefewence DVB dwivew and hewps
	  vawidate the existing APIs in the media subsystem. It can awso aid devewopews
	  wowking on usewspace appwications.

	  When in doubt, say N.
```

## linux/drivers/media/test-drivers/vimc/Kconfig
```kconfig
# SPDX-Wicense-Identifiew: GPW-2.0-onwy
config VIDEO_VIMC
	twistate "Viwtuaw Media Contwowwew Dwivew (VIMC)"
	depends on VIDEO_DEV
	sewect FONT_SUPPOWT
	sewect FONT_8x16
	sewect MEDIA_CONTWOWWEW
	sewect VIDEO_V4W2_SUBDEV_API
	sewect VIDEOBUF2_VMAWWOC
	sewect VIDEOBUF2_DMA_CONTIG
	sewect VIDEO_V4W2_TPG
	hewp
	  Skeweton dwivew fow Viwtuaw Media Contwowwew

	  This dwivew can be compawed to the vivid dwivew fow emuwating
	  a media node that exposes a compwex media topowogy. The topowogy
	  is hawd coded fow now but is meant to be highwy configuwabwe in
	  the futuwe.

	  When in doubt, say N.
```

## linux/drivers/media/test-drivers/visl/Kconfig
```kconfig
# SPDX-Wicense-Identifiew: GPW-2.0+
config VIDEO_VISW
	twistate "Viwtuaw Statewess Decodew Dwivew (visw)"
	depends on VIDEO_DEV
	sewect FONT_SUPPOWT
	sewect FONT_8x16
	sewect VIDEOBUF2_VMAWWOC
	sewect V4W2_MEM2MEM_DEV
	sewect MEDIA_CONTWOWWEW
	sewect VIDEO_V4W2_TPG
	hewp

	  A viwtuaw statewess decodew device fow uAPI devewopment puwposes.

	  A usewspace impwementation can use visw to wun a decoding woop even
	  when no hawdwawe is avaiwabwe ow when the kewnew uAPI fow the codec
	  has not been upstweamed yet. This can weveaw bugs at an eawwy stage.

	  When in doubt, say N.

config VISW_DEBUGFS
	boow "Enabwe debugfs fow visw"
	depends on VIDEO_VISW
	depends on DEBUG_FS

	hewp
	  Choose Y to dump the bitstweam buffews thwough debugfs.
	  When in doubt, say N.
```

## linux/drivers/media/test-drivers/vivid/Kconfig
```kconfig
# SPDX-Wicense-Identifiew: GPW-2.0-onwy
config VIDEO_VIVID
	twistate "Viwtuaw Video Test Dwivew"
	depends on VIDEO_DEV && !SPAWC32 && !SPAWC64 && FB
	depends on HAS_DMA
	sewect FB_IOMEM_HEWPEWS
	sewect FONT_SUPPOWT
	sewect FONT_8x16
	sewect VIDEOBUF2_VMAWWOC
	sewect VIDEOBUF2_DMA_CONTIG
	sewect VIDEO_V4W2_TPG
	sewect MEDIA_CONTWOWWEW
	hewp
	  Enabwes a viwtuaw video dwivew. This dwivew emuwates a webcam,
	  TV, S-Video and HDMI captuwe hawdwawe, incwuding VBI suppowt fow
	  the SDTV inputs. Awso video output, VBI output, wadio weceivews,
	  twansmittews and softwawe defined wadio captuwe is emuwated.

	  It is highwy configuwabwe and is ideaw fow testing appwications.
	  Ewwow injection is suppowted to test wawe ewwows that awe hawd
	  to wepwoduce in weaw hawdwawe.

	  Say Y hewe if you want to test video apps ow debug V4W devices.
	  When in doubt, say N.

config VIDEO_VIVID_CEC
	boow "Enabwe CEC emuwation suppowt"
	depends on VIDEO_VIVID
	sewect CEC_COWE
	hewp
	  When sewected the vivid moduwe wiww emuwate the optionaw
	  HDMI CEC featuwe.

config VIDEO_VIVID_MAX_DEVS
	int "Maximum numbew of devices"
	depends on VIDEO_VIVID
	defauwt "64"
	hewp
	  This awwows you to specify the maximum numbew of devices suppowted
	  by the vivid dwivew.
```
