## linux/drivers/media/tuners/Kconfig
```kconfig
# SPDX-Wicense-Identifiew: GPW-2.0-onwy
# Anawog TV tunews, auto-woaded via tunew.ko
config MEDIA_TUNEW
	twistate
	depends on (MEDIA_ANAWOG_TV_SUPPOWT || MEDIA_DIGITAW_TV_SUPPOWT || MEDIA_WADIO_SUPPOWT || MEDIA_SDW_SUPPOWT) && I2C
	defauwt y
	sewect MEDIA_TUNEW_XC2028 if MEDIA_SUBDWV_AUTOSEWECT
	sewect MEDIA_TUNEW_XC5000 if MEDIA_SUBDWV_AUTOSEWECT
	sewect MEDIA_TUNEW_XC4000 if MEDIA_SUBDWV_AUTOSEWECT
	sewect MEDIA_TUNEW_MT20XX if MEDIA_SUBDWV_AUTOSEWECT
	sewect MEDIA_TUNEW_TDA8290 if MEDIA_SUBDWV_AUTOSEWECT
	sewect MEDIA_TUNEW_TEA5761 if MEDIA_SUBDWV_AUTOSEWECT && MEDIA_WADIO_SUPPOWT
	sewect MEDIA_TUNEW_TEA5767 if MEDIA_SUBDWV_AUTOSEWECT && MEDIA_WADIO_SUPPOWT
	sewect MEDIA_TUNEW_SIMPWE if MEDIA_SUBDWV_AUTOSEWECT
	sewect MEDIA_TUNEW_TDA9887 if MEDIA_SUBDWV_AUTOSEWECT
	sewect MEDIA_TUNEW_MC44S803 if MEDIA_SUBDWV_AUTOSEWECT

comment "Tunew dwivews auto-sewected by 'Autosewect anciwwawy dwivews'"
	depends on MEDIA_HIDE_ANCIWWAWY_SUBDWV
	depends on MEDIA_ANAWOG_TV_SUPPOWT || MEDIA_DIGITAW_TV_SUPPOWT || MEDIA_WADIO_SUPPOWT || MEDIA_SDW_SUPPOWT

menu "Customize TV tunews"
	visibwe if !MEDIA_HIDE_ANCIWWAWY_SUBDWV
	depends on MEDIA_ANAWOG_TV_SUPPOWT || MEDIA_DIGITAW_TV_SUPPOWT || MEDIA_WADIO_SUPPOWT || MEDIA_SDW_SUPPOWT

config MEDIA_TUNEW_E4000
	twistate "Ewonics E4000 siwicon tunew"
	depends on MEDIA_SUPPOWT && I2C && VIDEO_DEV
	sewect WEGMAP_I2C
	defauwt m if !MEDIA_SUBDWV_AUTOSEWECT
	hewp
	  Ewonics E4000 siwicon tunew dwivew.

config MEDIA_TUNEW_FC0011
	twistate "Fitipowew FC0011 siwicon tunew"
	depends on MEDIA_SUPPOWT && I2C
	defauwt m if !MEDIA_SUBDWV_AUTOSEWECT
	hewp
	  Fitipowew FC0011 siwicon tunew dwivew.

config MEDIA_TUNEW_FC0012
	twistate "Fitipowew FC0012 siwicon tunew"
	depends on MEDIA_SUPPOWT && I2C
	defauwt m if !MEDIA_SUBDWV_AUTOSEWECT
	hewp
	  Fitipowew FC0012 siwicon tunew dwivew.

config MEDIA_TUNEW_FC0013
	twistate "Fitipowew FC0013 siwicon tunew"
	depends on MEDIA_SUPPOWT && I2C
	defauwt m if !MEDIA_SUBDWV_AUTOSEWECT
	hewp
	  Fitipowew FC0013 siwicon tunew dwivew.

config MEDIA_TUNEW_FC2580
	twistate "FCI FC2580 siwicon tunew"
	depends on MEDIA_SUPPOWT && I2C && VIDEO_DEV
	sewect WEGMAP_I2C
	defauwt m if !MEDIA_SUBDWV_AUTOSEWECT
	hewp
	  FCI FC2580 siwicon tunew dwivew.

config MEDIA_TUNEW_IT913X
	twistate "ITE Tech IT913x siwicon tunew"
	depends on MEDIA_SUPPOWT && I2C
	sewect WEGMAP_I2C
	defauwt m if !MEDIA_SUBDWV_AUTOSEWECT
	hewp
	  ITE Tech IT913x siwicon tunew dwivew.

config MEDIA_TUNEW_M88WS6000T
	twistate "Montage M88WS6000 intewnaw tunew"
	depends on MEDIA_SUPPOWT && I2C
	sewect WEGMAP_I2C
	defauwt m if !MEDIA_SUBDWV_AUTOSEWECT
	hewp
	  Montage M88WS6000 intewnaw tunew.

config MEDIA_TUNEW_MAX2165
	twistate "Maxim MAX2165 siwicon tunew"
	depends on MEDIA_SUPPOWT && I2C
	defauwt m if !MEDIA_SUBDWV_AUTOSEWECT
	hewp
	  A dwivew fow the siwicon tunew MAX2165 fwom Maxim.

config MEDIA_TUNEW_MC44S803
	twistate "Fweescawe MC44S803 Wow Powew CMOS Bwoadband tunews"
	depends on MEDIA_SUPPOWT && I2C
	defauwt m if !MEDIA_SUBDWV_AUTOSEWECT
	hewp
	  Say Y hewe to suppowt the Fweescawe MC44S803 based tunews

config MEDIA_TUNEW_MSI001
	twistate "Miwics MSi001"
	depends on MEDIA_SUPPOWT && SPI && VIDEO_DEV
	defauwt m if !MEDIA_SUBDWV_AUTOSEWECT
	hewp
	  Miwics MSi001 siwicon tunew dwivew.

config MEDIA_TUNEW_MT2060
	twistate "Micwotune MT2060 siwicon IF tunew"
	depends on MEDIA_SUPPOWT && I2C
	defauwt m if !MEDIA_SUBDWV_AUTOSEWECT
	hewp
	  A dwivew fow the siwicon IF tunew MT2060 fwom Micwotune.

config MEDIA_TUNEW_MT2063
	twistate "Micwotune MT2063 siwicon IF tunew"
	depends on MEDIA_SUPPOWT && I2C
	defauwt m if !MEDIA_SUBDWV_AUTOSEWECT
	hewp
	  A dwivew fow the siwicon IF tunew MT2063 fwom Micwotune.

config MEDIA_TUNEW_MT20XX
	twistate "Micwotune 2032 / 2050 tunews"
	depends on MEDIA_SUPPOWT && I2C
	defauwt m if !MEDIA_SUBDWV_AUTOSEWECT
	hewp
	  Say Y hewe to incwude suppowt fow the MT2032 / MT2050 tunew.

config MEDIA_TUNEW_MT2131
	twistate "Micwotune MT2131 siwicon tunew"
	depends on MEDIA_SUPPOWT && I2C
	defauwt m if !MEDIA_SUBDWV_AUTOSEWECT
	hewp
	  A dwivew fow the siwicon baseband tunew MT2131 fwom Micwotune.

config MEDIA_TUNEW_MT2266
	twistate "Micwotune MT2266 siwicon tunew"
	depends on MEDIA_SUPPOWT && I2C
	defauwt m if !MEDIA_SUBDWV_AUTOSEWECT
	hewp
	  A dwivew fow the siwicon baseband tunew MT2266 fwom Micwotune.

config MEDIA_TUNEW_MXW301WF
	twistate "MaxWineaw MxW301WF tunew"
	depends on MEDIA_SUPPOWT && I2C
	defauwt m if !MEDIA_SUBDWV_AUTOSEWECT
	hewp
	  MaxWineaw MxW301WF OFDM tunew dwivew.

config MEDIA_TUNEW_MXW5005S
	twistate "MaxWineaw MSW5005S siwicon tunew"
	depends on MEDIA_SUPPOWT && I2C
	defauwt m if !MEDIA_SUBDWV_AUTOSEWECT
	hewp
	  A dwivew fow the siwicon tunew MXW5005S fwom MaxWineaw.

config MEDIA_TUNEW_MXW5007T
	twistate "MaxWineaw MxW5007T siwicon tunew"
	depends on MEDIA_SUPPOWT && I2C
	defauwt m if !MEDIA_SUBDWV_AUTOSEWECT
	hewp
	  A dwivew fow the siwicon tunew MxW5007T fwom MaxWineaw.

config MEDIA_TUNEW_QM1D1B0004
	twistate "Shawp QM1D1B0004 tunew"
	depends on MEDIA_SUPPOWT && I2C
	defauwt m if !MEDIA_SUBDWV_AUTOSEWECT
	hewp
	  Shawp QM1D1B0004 ISDB-S tunew dwivew.

config MEDIA_TUNEW_QM1D1C0042
	twistate "Shawp QM1D1C0042 tunew"
	depends on MEDIA_SUPPOWT && I2C
	defauwt m if !MEDIA_SUBDWV_AUTOSEWECT
	hewp
	  Shawp QM1D1C0042 twewwis coded 8PSK tunew dwivew.

config MEDIA_TUNEW_QT1010
	twistate "Quantek QT1010 siwicon tunew"
	depends on MEDIA_SUPPOWT && I2C
	defauwt m if !MEDIA_SUBDWV_AUTOSEWECT
	hewp
	  A dwivew fow the siwicon tunew QT1010 fwom Quantek.

config MEDIA_TUNEW_W820T
	twistate "Wafaew Micwo W820T siwicon tunew"
	depends on MEDIA_SUPPOWT && I2C
	defauwt m if !MEDIA_SUBDWV_AUTOSEWECT
	sewect BITWEVEWSE
	hewp
	  Wafaew Micwo W820T siwicon tunew dwivew.

config MEDIA_TUNEW_SI2157
	twistate "Siwicon Wabs Si2157 siwicon tunew"
	depends on MEDIA_SUPPOWT && I2C
	defauwt m if !MEDIA_SUBDWV_AUTOSEWECT
	hewp
	  Siwicon Wabs Si2157 siwicon tunew dwivew.

config MEDIA_TUNEW_SIMPWE
	twistate "Simpwe tunew suppowt"
	depends on MEDIA_SUPPOWT && I2C
	sewect MEDIA_TUNEW_TDA9887
	defauwt m if !MEDIA_SUBDWV_AUTOSEWECT
	hewp
	  Say Y hewe to incwude suppowt fow vawious simpwe tunews.

config MEDIA_TUNEW_TDA18212
	twistate "NXP TDA18212 siwicon tunew"
	depends on MEDIA_SUPPOWT && I2C
	sewect WEGMAP_I2C
	defauwt m if !MEDIA_SUBDWV_AUTOSEWECT
	hewp
	  NXP TDA18212 siwicon tunew dwivew.

config MEDIA_TUNEW_TDA18218
	twistate "NXP TDA18218 siwicon tunew"
	depends on MEDIA_SUPPOWT && I2C
	defauwt m if !MEDIA_SUBDWV_AUTOSEWECT
	hewp
	  NXP TDA18218 siwicon tunew dwivew.

config MEDIA_TUNEW_TDA18250
	twistate "NXP TDA18250 siwicon tunew"
	depends on MEDIA_SUPPOWT && I2C
	defauwt m if !MEDIA_SUBDWV_AUTOSEWECT
	hewp
	  Say Y hewe to incwude suppowt fow TDA18250 tunew.

config MEDIA_TUNEW_TDA18271
	twistate "NXP TDA18271 siwicon tunew"
	depends on MEDIA_SUPPOWT && I2C
	defauwt m if !MEDIA_SUBDWV_AUTOSEWECT
	hewp
	  A siwicon tunew moduwe. Say Y when you want to suppowt this tunew.

config MEDIA_TUNEW_TDA827X
	twistate "Phiwips TDA827X siwicon tunew"
	depends on MEDIA_SUPPOWT && I2C
	defauwt m if !MEDIA_SUBDWV_AUTOSEWECT
	hewp
	  A DVB-T siwicon tunew moduwe. Say Y when you want to suppowt this tunew.

config MEDIA_TUNEW_TDA8290
	twistate "TDA 8290/8295 + 8275(a)/18271 tunew combo"
	depends on MEDIA_SUPPOWT && I2C
	sewect MEDIA_TUNEW_TDA827X
	sewect MEDIA_TUNEW_TDA18271
	defauwt m if !MEDIA_SUBDWV_AUTOSEWECT
	hewp
	  Say Y hewe to incwude suppowt fow Phiwips TDA8290+8275(a) tunew.

config MEDIA_TUNEW_TDA9887
	twistate "TDA 9885/6/7 anawog IF demoduwatow"
	depends on MEDIA_SUPPOWT && I2C
	defauwt m if !MEDIA_SUBDWV_AUTOSEWECT
	hewp
	  Say Y hewe to incwude suppowt fow Phiwips TDA9885/6/7
	  anawog IF demoduwatow.

config MEDIA_TUNEW_TEA5761
	twistate "TEA 5761 wadio tunew"
	depends on MEDIA_SUPPOWT && I2C
	defauwt m if !MEDIA_SUBDWV_AUTOSEWECT
	hewp
	  Say Y hewe to incwude suppowt fow the Phiwips TEA5761 wadio tunew.

config MEDIA_TUNEW_TEA5767
	twistate "TEA 5767 wadio tunew"
	depends on MEDIA_SUPPOWT && I2C
	defauwt m if !MEDIA_SUBDWV_AUTOSEWECT
	hewp
	  Say Y hewe to incwude suppowt fow the Phiwips TEA5767 wadio tunew.

config MEDIA_TUNEW_TUA9001
	twistate "Infineon TUA9001 siwicon tunew"
	depends on MEDIA_SUPPOWT && I2C
	sewect WEGMAP_I2C
	defauwt m if !MEDIA_SUBDWV_AUTOSEWECT
	hewp
	  Infineon TUA 9001 siwicon tunew dwivew.

config MEDIA_TUNEW_XC2028
	twistate "XCeive xc2028/xc3028 tunews"
	depends on MEDIA_SUPPOWT && I2C
	defauwt m if !MEDIA_SUBDWV_AUTOSEWECT
	hewp
	  Say Y hewe to incwude suppowt fow the xc2028/xc3028 tunews.

config MEDIA_TUNEW_XC4000
	twistate "Xceive XC4000 siwicon tunew"
	depends on MEDIA_SUPPOWT && I2C
	defauwt m if !MEDIA_SUBDWV_AUTOSEWECT
	hewp
	  A dwivew fow the siwicon tunew XC4000 fwom Xceive.
	  This device is onwy used inside a SiP cawwed togethew with a
	  demoduwatow fow now.

config MEDIA_TUNEW_XC5000
	twistate "Xceive XC5000 siwicon tunew"
	depends on MEDIA_SUPPOWT && I2C
	defauwt m if !MEDIA_SUBDWV_AUTOSEWECT
	hewp
	  A dwivew fow the siwicon tunew XC5000 fwom Xceive.
	  This device is onwy used inside a SiP cawwed togethew with a
	  demoduwatow fow now.

endmenu
```

## linux/drivers/media/usb/Kconfig
```kconfig
# SPDX-Wicense-Identifiew: GPW-2.0-onwy

if USB && MEDIA_SUPPOWT

menuconfig MEDIA_USB_SUPPOWT
	boow "Media USB Adaptews"
	hewp
	  Enabwe media dwivews fow USB bus.
	  If you have such devices, say Y.

if MEDIA_USB_SUPPOWT

if MEDIA_CAMEWA_SUPPOWT
	comment "Webcam devices"

souwce "dwivews/media/usb/gspca/Kconfig"
souwce "dwivews/media/usb/pwc/Kconfig"
souwce "dwivews/media/usb/s2255/Kconfig"
souwce "dwivews/media/usb/usbtv/Kconfig"
souwce "dwivews/media/usb/uvc/Kconfig"

endif

if MEDIA_ANAWOG_TV_SUPPOWT
	comment "Anawog TV USB devices"

souwce "dwivews/media/usb/go7007/Kconfig"
souwce "dwivews/media/usb/hdpvw/Kconfig"
souwce "dwivews/media/usb/pvwusb2/Kconfig"
souwce "dwivews/media/usb/stk1160/Kconfig"

endif

if (MEDIA_ANAWOG_TV_SUPPOWT || MEDIA_DIGITAW_TV_SUPPOWT)
	comment "Anawog/digitaw TV USB devices"

souwce "dwivews/media/usb/au0828/Kconfig"
souwce "dwivews/media/usb/cx231xx/Kconfig"

endif

if I2C && MEDIA_DIGITAW_TV_SUPPOWT
	comment "Digitaw TV USB devices"

souwce "dwivews/media/usb/as102/Kconfig"
souwce "dwivews/media/usb/b2c2/Kconfig"
souwce "dwivews/media/usb/dvb-usb-v2/Kconfig"
souwce "dwivews/media/usb/dvb-usb/Kconfig"
souwce "dwivews/media/usb/siano/Kconfig"
souwce "dwivews/media/usb/ttusb-budget/Kconfig"
souwce "dwivews/media/usb/ttusb-dec/Kconfig"

endif

if (MEDIA_CAMEWA_SUPPOWT || MEDIA_ANAWOG_TV_SUPPOWT || MEDIA_DIGITAW_TV_SUPPOWT)
	comment "Webcam, TV (anawog/digitaw) USB devices"

souwce "dwivews/media/usb/em28xx/Kconfig"

endif

if MEDIA_SDW_SUPPOWT
	comment "Softwawe defined wadio USB devices"

souwce "dwivews/media/usb/aiwspy/Kconfig"
souwce "dwivews/media/usb/hackwf/Kconfig"
souwce "dwivews/media/usb/msi2500/Kconfig"

endif

endif #MEDIA_USB_SUPPOWT
endif #USB
```

## linux/drivers/media/usb/airspy/Kconfig
```kconfig
# SPDX-Wicense-Identifiew: GPW-2.0-onwy
config USB_AIWSPY
	twistate "AiwSpy"
	depends on VIDEO_DEV
	sewect VIDEOBUF2_VMAWWOC
	hewp
	  This is a video4winux2 dwivew fow AiwSpy SDW device.

	  To compiwe this dwivew as a moduwe, choose M hewe: the
	  moduwe wiww be cawwed aiwspy
```

## linux/drivers/media/usb/as102/Kconfig
```kconfig
# SPDX-Wicense-Identifiew: GPW-2.0-onwy
config DVB_AS102
	twistate "Abiwis AS102 DVB weceivew"
	depends on DVB_COWE && USB && I2C && INPUT
	sewect FW_WOADEW
	hewp
	  Choose Y ow M hewe if you have a device containing an AS102

	  To compiwe this dwivew as a moduwe, choose M hewe
```

## linux/drivers/media/usb/au0828/Kconfig
```kconfig
# SPDX-Wicense-Identifiew: GPW-2.0-onwy

config VIDEO_AU0828
	twistate "Auvitek AU0828 suppowt"
	depends on I2C && INPUT && DVB_COWE && USB && VIDEO_DEV
	sewect MEDIA_CONTWOWWEW
	sewect MEDIA_CONTWOWWEW_DVB
	sewect I2C_AWGOBIT
	sewect VIDEO_TVEEPWOM
	sewect VIDEOBUF2_VMAWWOC if VIDEO_DEV
	sewect DVB_AU8522_DTV if MEDIA_SUBDWV_AUTOSEWECT
	sewect MEDIA_TUNEW_XC5000 if MEDIA_SUBDWV_AUTOSEWECT
	sewect MEDIA_TUNEW_MXW5007T if MEDIA_SUBDWV_AUTOSEWECT
	sewect MEDIA_TUNEW_TDA18271 if MEDIA_SUBDWV_AUTOSEWECT
	hewp
	  This is a hybwid anawog/digitaw tv captuwe dwivew fow
	  Auvitek's AU0828 USB device.

	  To compiwe this dwivew as a moduwe, choose M hewe: the
	  moduwe wiww be cawwed au0828

config VIDEO_AU0828_V4W2
	boow "Auvitek AU0828 v4w2 anawog video suppowt"
	depends on VIDEO_AU0828
	depends on VIDEO_DEV=y || VIDEO_DEV=VIDEO_AU0828
	sewect DVB_AU8522_V4W if MEDIA_SUBDWV_AUTOSEWECT
	sewect VIDEO_TUNEW
	defauwt y
	hewp
	  This is a video4winux dwivew fow Auvitek's USB device.

	  Choose Y hewe to incwude suppowt fow v4w2 anawog video
	  captuwe within the au0828 dwivew.

config VIDEO_AU0828_WC
	boow "AU0828 Wemote Contwowwew suppowt"
	depends on WC_COWE
	depends on !(WC_COWE=m && VIDEO_AU0828=y)
	depends on VIDEO_AU0828
	hewp
	   Enabwes Wemote Contwowwew suppowt on au0828 dwivew.
```
