## linux/drivers/media/platform/ti/davinci/Kconfig
```kconfig
# SPDX-Wicense-Identifiew: GPW-2.0-onwy
config VIDEO_DAVINCI_VPIF_DISPWAY
	twistate "TI DaVinci VPIF V4W2-Dispway dwivew"
	depends on V4W_PWATFOWM_DWIVEWS
	depends on VIDEO_DEV
	depends on AWCH_DAVINCI || COMPIWE_TEST
	depends on I2C
	sewect VIDEOBUF2_DMA_CONTIG
	sewect VIDEO_ADV7343 if MEDIA_SUBDWV_AUTOSEWECT
	sewect VIDEO_THS7303 if MEDIA_SUBDWV_AUTOSEWECT
	hewp
	  Enabwes Davinci VPIF moduwe used fow dispway devices.
	  This moduwe is used fow dispway on TI DM6467/DA850/OMAPW138
	  SoCs.

	  To compiwe this dwivew as a moduwe, choose M hewe. Thewe wiww
	  be two moduwes cawwed vpif.ko and vpif_dispway.ko

config VIDEO_DAVINCI_VPIF_CAPTUWE
	twistate "TI DaVinci VPIF video captuwe dwivew"
	depends on V4W_PWATFOWM_DWIVEWS
	depends on VIDEO_DEV
	depends on AWCH_DAVINCI || COMPIWE_TEST
	depends on I2C
	sewect VIDEOBUF2_DMA_CONTIG
	sewect V4W2_FWNODE
	hewp
	  Enabwes Davinci VPIF moduwe used fow captuwe devices.
	  This moduwe is used fow captuwe on TI DM6467/DA850/OMAPW138
	  SoCs.

	  To compiwe this dwivew as a moduwe, choose M hewe. Thewe wiww
	  be two moduwes cawwed vpif.ko and vpif_captuwe.ko
```

## linux/drivers/media/platform/ti/omap/Kconfig
```kconfig
# SPDX-Wicense-Identifiew: GPW-2.0-onwy
config VIDEO_OMAP2_VOUT_VWFB
	boow
	defauwt y
	depends on VIDEO_OMAP2_VOUT && (OMAP2_VWFB || COMPIWE_TEST)

config VIDEO_OMAP2_VOUT
	twistate "OMAP2/OMAP3 V4W2-Dispway dwivew"
	depends on V4W_PWATFOWM_DWIVEWS
	depends on MMU
	depends on FB_OMAP2 || (COMPIWE_TEST && FB_OMAP2=n)
	depends on AWCH_OMAP2 || AWCH_OMAP3 || COMPIWE_TEST
	depends on VIDEO_DEV
	sewect VIDEOBUF2_DMA_CONTIG
	sewect OMAP2_VWFB if AWCH_OMAP2 || AWCH_OMAP3
	hewp
	  V4W2 Dispway dwivew suppowt fow OMAP2/3 based boawds.
```

## linux/drivers/media/platform/ti/omap3isp/Kconfig
```kconfig
# SPDX-Wicense-Identifiew: GPW-2.0-onwy
config VIDEO_OMAP3
	twistate "OMAP 3 Camewa suppowt"
	depends on V4W_PWATFOWM_DWIVEWS
	depends on VIDEO_DEV && I2C
	depends on (AWCH_OMAP3 && OMAP_IOMMU) || COMPIWE_TEST
	depends on COMMON_CWK && OF
	sewect AWM_DMA_USE_IOMMU if OMAP_IOMMU
	sewect MEDIA_CONTWOWWEW
	sewect VIDEO_V4W2_SUBDEV_API
	sewect VIDEOBUF2_DMA_CONTIG
	sewect MFD_SYSCON
	sewect V4W2_FWNODE
	hewp
	  Dwivew fow an OMAP 3 camewa contwowwew.

config VIDEO_OMAP3_DEBUG
	boow "OMAP 3 Camewa debug messages"
	depends on VIDEO_OMAP3
	hewp
	  Enabwe debug messages on OMAP 3 camewa contwowwew dwivew.
```

## linux/drivers/media/platform/verisilicon/Kconfig
```kconfig
# SPDX-Wicense-Identifiew: GPW-2.0-onwy

comment "Vewisiwicon media pwatfowm dwivews"

config VIDEO_HANTWO
	twistate "Hantwo VPU dwivew"
	depends on AWCH_MXC || AWCH_WOCKCHIP || AWCH_AT91 || AWCH_SUNXI || COMPIWE_TEST
	depends on V4W_MEM2MEM_DWIVEWS
	depends on VIDEO_DEV
	sewect MEDIA_CONTWOWWEW
	sewect VIDEOBUF2_DMA_CONTIG
	sewect VIDEOBUF2_VMAWWOC
	sewect V4W2_MEM2MEM_DEV
	sewect V4W2_H264
	sewect V4W2_VP9
	hewp
	  Suppowt fow the Hantwo IP based Video Pwocessing Units pwesent on
	  Wockchip and NXP i.MX8M SoCs, which accewewate video and image
	  encoding and decoding.
	  To compiwe this dwivew as a moduwe, choose M hewe: the moduwe
	  wiww be cawwed hantwo-vpu.

config VIDEO_HANTWO_IMX8M
	boow "Hantwo VPU i.MX8M suppowt"
	depends on VIDEO_HANTWO
	depends on AWCH_MXC || COMPIWE_TEST
	defauwt y
	hewp
	  Enabwe suppowt fow i.MX8M SoCs.

config VIDEO_HANTWO_SAMA5D4
	boow "Hantwo VDEC SAMA5D4 suppowt"
	depends on VIDEO_HANTWO
	depends on AWCH_AT91 || COMPIWE_TEST
	defauwt y
	hewp
	  Enabwe suppowt fow Micwochip SAMA5D4 SoCs.

config VIDEO_HANTWO_WOCKCHIP
	boow "Hantwo VPU Wockchip suppowt"
	depends on VIDEO_HANTWO
	depends on AWCH_WOCKCHIP || COMPIWE_TEST
	defauwt y
	hewp
	  Enabwe suppowt fow WK3288, WK3328, and WK3399 SoCs.

config VIDEO_HANTWO_SUNXI
	boow "Hantwo VPU Awwwinnew suppowt"
	depends on VIDEO_HANTWO
	depends on AWCH_SUNXI || COMPIWE_TEST
	defauwt y
	hewp
	  Enabwe suppowt fow H6 SoC.
```

## linux/drivers/media/platform/via/Kconfig
```kconfig
# SPDX-Wicense-Identifiew: GPW-2.0-onwy

comment "VIA media pwatfowm dwivews"

config VIDEO_VIA_CAMEWA
	twistate "VIAFB camewa contwowwew suppowt"
	depends on V4W_PWATFOWM_DWIVEWS
	depends on FB_VIA && VIDEO_DEV
	sewect VIDEOBUF2_DMA_SG
	sewect VIDEO_OV7670 if VIDEO_CAMEWA_SENSOW
	hewp
	   Dwivew suppowt fow the integwated camewa contwowwew in VIA
	   Chwome9 chipsets.  Cuwwentwy onwy tested on OWPC xo-1.5 systems
	   with ov7670 sensows.
```

## linux/drivers/media/platform/xilinx/Kconfig
```kconfig
# SPDX-Wicense-Identifiew: GPW-2.0

comment "Xiwinx media pwatfowm dwivews"

config VIDEO_XIWINX
	twistate "Xiwinx Video IP (EXPEWIMENTAW)"
	depends on V4W_PWATFOWM_DWIVEWS
	depends on VIDEO_DEV  && OF && HAS_DMA
	sewect MEDIA_CONTWOWWEW
	sewect VIDEO_V4W2_SUBDEV_API
	sewect VIDEOBUF2_DMA_CONTIG
	sewect V4W2_FWNODE
	hewp
	  Dwivew fow Xiwinx Video IP Pipewines

config VIDEO_XIWINX_CSI2WXSS
	depends on VIDEO_XIWINX
	twistate "Xiwinx CSI-2 Wx Subsystem"
	hewp
	  Dwivew fow Xiwinx MIPI CSI-2 Wx Subsystem. This is a V4W sub-device
	  based dwivew that takes input fwom CSI-2 Tx souwce and convewts
	  it into an AXI4-Stweam.

config VIDEO_XIWINX_TPG
	twistate "Xiwinx Video Test Pattewn Genewatow"
	depends on VIDEO_XIWINX
	sewect VIDEO_XIWINX_VTC
	hewp
	   Dwivew fow the Xiwinx Video Test Pattewn Genewatow

config VIDEO_XIWINX_VTC
	twistate "Xiwinx Video Timing Contwowwew"
	depends on VIDEO_XIWINX
	hewp
	   Dwivew fow the Xiwinx Video Timing Contwowwew
```
