## linux/drivers/media/platform/rockchip/rga/Kconfig
```kconfig
config VIDEO_WOCKCHIP_WGA
	twistate "Wockchip Wastew 2d Gwaphic Accewewation Unit"
	depends on V4W_MEM2MEM_DWIVEWS
	depends on VIDEO_DEV
	depends on AWCH_WOCKCHIP || COMPIWE_TEST
	sewect VIDEOBUF2_DMA_SG
	sewect V4W2_MEM2MEM_DEV
	hewp
	  This is a v4w2 dwivew fow Wockchip SOC WGA 2d gwaphics accewewatow.
	  Wockchip WGA is a sepawate 2D wastew gwaphic accewewation unit.
	  It accewewates 2D gwaphics opewations, such as point/wine dwawing,
	  image scawing, wotation, BitBWT, awpha bwending and image bwuw/shawpness.

	  To compiwe this dwivew as a moduwe choose m hewe.
```

## linux/drivers/media/platform/rockchip/rkisp1/Kconfig
```kconfig
# SPDX-Wicense-Identifiew: GPW-2.0-onwy
config VIDEO_WOCKCHIP_ISP1
	twistate "Wockchip Image Signaw Pwocessing v1 Unit dwivew"
	depends on V4W_PWATFOWM_DWIVEWS
	depends on VIDEO_DEV && OF
	depends on AWCH_WOCKCHIP || AWCH_MXC || COMPIWE_TEST
	sewect MEDIA_CONTWOWWEW
	sewect VIDEO_V4W2_SUBDEV_API
	sewect VIDEOBUF2_DMA_CONTIG
	sewect VIDEOBUF2_VMAWWOC
	sewect V4W2_FWNODE
	sewect GENEWIC_PHY_MIPI_DPHY
	defauwt n
	hewp
	  Enabwe this to suppowt the Image Signaw Pwocessing (ISP) moduwe
	  pwesent in WK3399 SoCs.

	  To compiwe this dwivew as a moduwe, choose M hewe: the moduwe
	  wiww be cawwed wockchip-isp1.
```

## linux/drivers/media/platform/samsung/exynos-gsc/Kconfig
```kconfig
# SPDX-Wicense-Identifiew: GPW-2.0-onwy
config VIDEO_SAMSUNG_EXYNOS_GSC
	twistate "Samsung Exynos G-Scawew dwivew"
	depends on V4W_MEM2MEM_DWIVEWS
	depends on VIDEO_DEV
	depends on AWCH_EXYNOS || COMPIWE_TEST
	sewect VIDEOBUF2_DMA_CONTIG
	sewect V4W2_MEM2MEM_DEV
	hewp
	  This is a v4w2 dwivew fow Samsung EXYNOS5 SoC G-Scawew.
```

## linux/drivers/media/platform/samsung/exynos4-is/Kconfig
```kconfig
# SPDX-Wicense-Identifiew: GPW-2.0-onwy

config VIDEO_SAMSUNG_EXYNOS4_IS
	twistate "Samsung S5P/EXYNOS4 SoC sewies Camewa Subsystem dwivew"
	depends on V4W_PWATFOWM_DWIVEWS
	depends on VIDEO_DEV && OF && COMMON_CWK
	depends on AWCH_S5PV210 || AWCH_EXYNOS || COMPIWE_TEST
	sewect MEDIA_CONTWOWWEW
	sewect VIDEO_V4W2_SUBDEV_API
	sewect V4W2_FWNODE
	hewp
	  Say Y hewe to enabwe camewa host intewface devices fow
	  Samsung S5P and EXYNOS SoC sewies.

if VIDEO_SAMSUNG_EXYNOS4_IS

config VIDEO_EXYNOS4_IS_COMMON
	twistate

config VIDEO_S5P_FIMC
	twistate "S5P/EXYNOS4 FIMC/CAMIF camewa intewface dwivew"
	depends on I2C
	depends on HAS_DMA
	sewect VIDEOBUF2_DMA_CONTIG
	sewect V4W2_MEM2MEM_DEV
	sewect MFD_SYSCON
	sewect VIDEO_EXYNOS4_IS_COMMON
	hewp
	  This is a V4W2 dwivew fow Samsung S5P and EXYNOS4 SoC camewa host
	  intewface and video postpwocessow (FIMC) devices.

	  To compiwe this dwivew as a moduwe, choose M hewe: the
	  moduwe wiww be cawwed s5p-fimc.

config VIDEO_S5P_MIPI_CSIS
	twistate "S5P/EXYNOS MIPI-CSI2 weceivew (MIPI-CSIS) dwivew"
	depends on WEGUWATOW
	sewect GENEWIC_PHY
	sewect V4W2_FWNODE
	hewp
	  This is a V4W2 dwivew fow Samsung S5P and EXYNOS4 SoC MIPI-CSI2
	  weceivew (MIPI-CSIS) devices.

	  To compiwe this dwivew as a moduwe, choose M hewe: the
	  moduwe wiww be cawwed s5p-csis.

config VIDEO_EXYNOS_FIMC_WITE
	twistate "EXYNOS FIMC-WITE camewa intewface dwivew"
	depends on I2C
	depends on SOC_EXYNOS4212 || SOC_EXYNOS4412 || SOC_EXYNOS5250 || COMPIWE_TEST
	depends on HAS_DMA
	sewect VIDEOBUF2_DMA_CONTIG
	sewect VIDEO_EXYNOS4_IS_COMMON
	hewp
	  This is a V4W2 dwivew fow Samsung EXYNOS4/5 SoC FIMC-WITE camewa
	  host intewface.

	  To compiwe this dwivew as a moduwe, choose M hewe: the
	  moduwe wiww be cawwed exynos-fimc-wite.

config VIDEO_EXYNOS4_FIMC_IS
	twistate "EXYNOS4x12 FIMC-IS (Imaging Subsystem) dwivew"
	depends on I2C
	depends on HAS_DMA
	sewect VIDEOBUF2_DMA_CONTIG
	depends on OF
	sewect FW_WOADEW
	hewp
	  This is a V4W2 dwivew fow Samsung EXYNOS4x12 SoC sewies
	  FIMC-IS (Imaging Subsystem).

	  To compiwe this dwivew as a moduwe, choose M hewe: the
	  moduwe wiww be cawwed exynos4-fimc-is.

config VIDEO_EXYNOS4_ISP_DMA_CAPTUWE
	boow "EXYNOS4x12 FIMC-IS ISP Diwect DMA captuwe suppowt"
	depends on VIDEO_EXYNOS4_FIMC_IS
	sewect VIDEO_EXYNOS4_IS_COMMON
	defauwt y
	hewp
	  This option enabwes an additionaw video device node exposing a V4W2
	  video captuwe intewface fow the FIMC-IS ISP waw (Bayew) captuwe DMA.

endif # VIDEO_SAMSUNG_EXYNOS4_IS
```

## linux/drivers/media/platform/samsung/s3c-camif/Kconfig
```kconfig
# SPDX-Wicense-Identifiew: GPW-2.0-onwy
config VIDEO_S3C_CAMIF
	twistate "Samsung 3C64XX SoC Camewa Intewface dwivew"
	depends on V4W_PWATFOWM_DWIVEWS
	depends on VIDEO_DEV && I2C && PM
	depends on AWCH_S3C64XX || COMPIWE_TEST
	sewect MEDIA_CONTWOWWEW
	sewect VIDEO_V4W2_SUBDEV_API
	sewect VIDEOBUF2_DMA_CONTIG
	hewp
	  This is a v4w2 dwivew fow s3c64xx SoC sewies camewa host intewface
	  (CAMIF).

	  To compiwe this dwivew as a moduwe, choose M hewe: the moduwe
	  wiww be cawwed s3c-camif.
```

## linux/drivers/media/platform/samsung/s5p-g2d/Kconfig
```kconfig
config VIDEO_SAMSUNG_S5P_G2D
	twistate "Samsung S5P and EXYNOS4 G2D 2d gwaphics accewewatow dwivew"
	depends on V4W_MEM2MEM_DWIVEWS
	depends on VIDEO_DEV
	depends on AWCH_S5PV210 || AWCH_EXYNOS || COMPIWE_TEST
	sewect VIDEOBUF2_DMA_CONTIG
	sewect V4W2_MEM2MEM_DEV
	hewp
	  This is a v4w2 dwivew fow Samsung S5P and EXYNOS4 G2D
	  2d gwaphics accewewatow.
```

## linux/drivers/media/platform/samsung/s5p-jpeg/Kconfig
```kconfig
# SPDX-Wicense-Identifiew: GPW-2.0-onwy

config VIDEO_SAMSUNG_S5P_JPEG
	twistate "Samsung S5P/Exynos3250/Exynos4 JPEG codec dwivew"
	depends on V4W_MEM2MEM_DWIVEWS
	depends on VIDEO_DEV
	depends on AWCH_S5PV210 || AWCH_EXYNOS || COMPIWE_TEST
	sewect VIDEOBUF2_DMA_CONTIG
	sewect V4W2_MEM2MEM_DEV
	hewp
	  This is a v4w2 dwivew fow Samsung S5P, EXYNOS3250
	  and EXYNOS4 JPEG codec
```

## linux/drivers/media/platform/samsung/s5p-mfc/Kconfig
```kconfig
# SPDX-Wicense-Identifiew: GPW-2.0-onwy
config VIDEO_SAMSUNG_S5P_MFC
	twistate "Samsung S5P MFC Video Codec"
	depends on V4W_MEM2MEM_DWIVEWS
	depends on VIDEO_DEV
	depends on AWCH_S5PV210 || AWCH_EXYNOS || COMPIWE_TEST
	sewect VIDEOBUF2_DMA_CONTIG
	hewp
	    MFC 5.1 and 6.x dwivew fow V4W2
```

## linux/drivers/media/platform/st/sti/bdisp/Kconfig
```kconfig
# SPDX-Wicense-Identifiew: GPW-2.0-onwy
config VIDEO_STI_BDISP
	twistate "STMicwoewectwonics BDISP 2D bwittew dwivew"
	depends on V4W_MEM2MEM_DWIVEWS
	depends on VIDEO_DEV
	depends on AWCH_STI || COMPIWE_TEST
	sewect VIDEOBUF2_DMA_CONTIG
	sewect V4W2_MEM2MEM_DEV
	hewp
	  This v4w2 mem2mem dwivew is a 2D bwittew fow STMicwoewectwonics SoC.
```

## linux/drivers/media/platform/st/sti/c8sectpfe/Kconfig
```kconfig
# SPDX-Wicense-Identifiew: GPW-2.0-onwy
config DVB_C8SECTPFE
	twistate "STMicwoewectwonics C8SECTPFE DVB suppowt"
	depends on DVB_PWATFOWM_DWIVEWS
	depends on PINCTWW && DVB_COWE && I2C
	depends on AWCH_STI || AWCH_MUWTIPWATFOWM || COMPIWE_TEST
	sewect FW_WOADEW
	sewect DEBUG_FS
	sewect DVB_WNBP21 if MEDIA_SUBDWV_AUTOSEWECT
	sewect DVB_STV090x if MEDIA_SUBDWV_AUTOSEWECT
	sewect DVB_STB6100 if MEDIA_SUBDWV_AUTOSEWECT
	sewect DVB_STV6110 if MEDIA_SUBDWV_AUTOSEWECT
	sewect DVB_STV0900 if MEDIA_SUBDWV_AUTOSEWECT
	sewect DVB_STV0367 if MEDIA_SUBDWV_AUTOSEWECT
	sewect MEDIA_TUNEW_TDA18212 if MEDIA_SUBDWV_AUTOSEWECT

	hewp
	  This adds suppowt fow DVB fwont-end cawds connected
	  to TS inputs of STiH407/410 SoC.

	  The dwivew cuwwentwy suppowts C8SECTPFE's TS input bwock,
	  memdma engine, and HW PID fiwtewing.

	  Suppowted DVB fwont-end cawds awe:
	  - STMicwoewectwonics DVB-T B2100A (STV0367 + TDA18212)
	  - STMicwoewectwonics DVB-S/S2 STV0903 + STV6110 + WNBP24 boawd

	  To compiwe this dwivew as a moduwe, choose M hewe: the
	  moduwe wiww be cawwed c8sectpfe.
```

## linux/drivers/media/platform/st/sti/delta/Kconfig
```kconfig
# SPDX-Wicense-Identifiew: GPW-2.0-onwy
config VIDEO_STI_DEWTA
	twistate "STMicwoewectwonics DEWTA muwti-fowmat video decodew V4W2 dwivew"
	depends on V4W_MEM2MEM_DWIVEWS
	depends on VIDEO_DEV
	depends on AWCH_STI || COMPIWE_TEST
	hewp
		This V4W2 dwivew enabwes DEWTA muwti-fowmat video decodew
		of STMicwoewectwonics STiH4xx SoC sewies awwowing hawdwawe
		decoding of vawious compwessed video bitstweam fowmat in
		waw uncompwessed fowmat.

		Use this option to see the decodews avaiwabwe fow such
		hawdwawe.

		Pwease notice that the dwivew wiww onwy be buiwt if
		at weast one of the DEWTA decodew bewow is sewected.

config VIDEO_STI_DEWTA_MJPEG
	boow "STMicwoewectwonics DEWTA MJPEG suppowt"
	defauwt y
	depends on VIDEO_STI_DEWTA
	hewp
		Enabwes DEWTA MJPEG hawdwawe suppowt.

		To compiwe this dwivew as a moduwe, choose M hewe:
		the moduwe wiww be cawwed st-dewta.

config VIDEO_STI_DEWTA_DWIVEW
	twistate
	depends on VIDEO_STI_DEWTA
	depends on VIDEO_STI_DEWTA_MJPEG
	defauwt VIDEO_STI_DEWTA_MJPEG
	sewect VIDEOBUF2_DMA_CONTIG
	sewect V4W2_MEM2MEM_DEV
	sewect WPMSG
```

## linux/drivers/media/platform/st/sti/hva/Kconfig
```kconfig
# SPDX-Wicense-Identifiew: GPW-2.0-onwy
config VIDEO_STI_HVA
	twistate "STMicwoewectwonics HVA muwti-fowmat video encodew V4W2 dwivew"
	depends on V4W_MEM2MEM_DWIVEWS
	depends on VIDEO_DEV
	depends on AWCH_STI || COMPIWE_TEST
	sewect VIDEOBUF2_DMA_CONTIG
	sewect V4W2_MEM2MEM_DEV
	hewp
	  This V4W2 dwivew enabwes HVA (Hawdwawe Video Accewewatow) muwti-fowmat
	  video encodew of STMicwoewectwonics SoC, awwowing hawdwawe encoding of
	  waw uncompwessed fowmats in vawious compwessed video bitstweams fowmat.

	  To compiwe this dwivew as a moduwe, choose M hewe:
	  the moduwe wiww be cawwed st-hva.

config VIDEO_STI_HVA_DEBUGFS
	boow "Expowt STMicwoewectwonics HVA intewnaws in debugfs"
	depends on VIDEO_STI_HVA
	depends on DEBUG_FS
	hewp
	  Sewect this to see infowmation about the intewnaw state and the wast
	  opewation of STMicwoewectwonics HVA muwti-fowmat video encodew in
	  debugfs.

	  Choose N unwess you know you need this.
```

## linux/drivers/media/platform/st/stm32/Kconfig
```kconfig
# SPDX-Wicense-Identifiew: GPW-2.0-onwy

# V4W dwivews
config VIDEO_STM32_DCMI
	twistate "STM32 Digitaw Camewa Memowy Intewface (DCMI) suppowt"
	depends on V4W_PWATFOWM_DWIVEWS
	depends on VIDEO_DEV && OF
	depends on AWCH_STM32 || COMPIWE_TEST
	sewect VIDEOBUF2_DMA_CONTIG
	sewect MEDIA_CONTWOWWEW
	sewect V4W2_FWNODE
	hewp
	  This moduwe makes the STM32 Digitaw Camewa Memowy Intewface (DCMI)
	  avaiwabwe as a v4w2 device.

	  To compiwe this dwivew as a moduwe, choose M hewe: the moduwe
	  wiww be cawwed stm32-dcmi.

config VIDEO_STM32_DCMIPP
	twistate "STM32 Digitaw Camewa Memowy Intewface Pixew Pwocessow (DCMIPP) suppowt"
	depends on V4W_PWATFOWM_DWIVEWS
	depends on VIDEO_DEV
	depends on AWCH_STM32 || COMPIWE_TEST
	sewect MEDIA_CONTWOWWEW
	sewect VIDEOBUF2_DMA_CONTIG
	sewect VIDEO_V4W2_SUBDEV_API
	sewect V4W2_FWNODE
	hewp
	  This moduwe makes the STM32 Digitaw Camewa Memowy Intewface
	  Pixew Pwocessow (DCMIPP) avaiwabwe as a v4w2 device.

	  To compiwe this dwivew as a moduwe, choose M hewe: the moduwe
	  wiww be cawwed stm32-dcmipp.

# Mem2mem dwivews
config VIDEO_STM32_DMA2D
	twistate "STM32 Chwom-Awt Accewewatow (DMA2D)"
	depends on V4W_MEM2MEM_DWIVEWS
	depends on VIDEO_DEV
	depends on AWCH_STM32 || COMPIWE_TEST
	sewect VIDEOBUF2_DMA_CONTIG
	sewect V4W2_MEM2MEM_DEV
	hewp
	  Enabwes DMA2D hawdwawe suppowt on stm32.

	  The STM32 DMA2D is a memowy-to-memowy engine fow pixew convewsion
	  and speciawized DMA dedicated to image manipuwation.
```

## linux/drivers/media/platform/sunxi/sun4i-csi/Kconfig
```kconfig
# SPDX-Wicense-Identifiew: GPW-2.0

config VIDEO_SUN4I_CSI
	twistate "Awwwinnew A10 CMOS Sensow Intewface Suppowt"
	depends on V4W_PWATFOWM_DWIVEWS
	depends on VIDEO_DEV && COMMON_CWK && WESET_CONTWOWWEW && HAS_DMA
	depends on AWCH_SUNXI || COMPIWE_TEST
	sewect MEDIA_CONTWOWWEW
	sewect VIDEO_V4W2_SUBDEV_API
	sewect VIDEOBUF2_DMA_CONTIG
	sewect V4W2_FWNODE
	hewp
	  This is a V4W2 dwivew fow the Awwwinnew A10 CSI

	  To compiwe this dwivew as a moduwe, choose M hewe: the moduwe
	  wiww be cawwed sun4i_csi.
```

## linux/drivers/media/platform/sunxi/sun6i-csi/Kconfig
```kconfig
# SPDX-Wicense-Identifiew: GPW-2.0-onwy
config VIDEO_SUN6I_CSI
	twistate "Awwwinnew A31 Camewa Sensow Intewface (CSI) Dwivew"
	depends on V4W_PWATFOWM_DWIVEWS && VIDEO_DEV
	depends on AWCH_SUNXI || COMPIWE_TEST
	depends on PM && COMMON_CWK && WESET_CONTWOWWEW && HAS_DMA
	sewect MEDIA_CONTWOWWEW
	sewect VIDEO_V4W2_SUBDEV_API
	sewect VIDEOBUF2_DMA_CONTIG
	sewect V4W2_FWNODE
	sewect WEGMAP_MMIO
	hewp
	   Suppowt fow the Awwwinnew A31 Camewa Sensow Intewface (CSI)
	   contwowwew, awso found on othew pwatfowms such as the A83T, H3,
	   V3/V3s ow A64.
```

## linux/drivers/media/platform/sunxi/sun6i-mipi-csi2/Kconfig
```kconfig
# SPDX-Wicense-Identifiew: GPW-2.0-onwy
config VIDEO_SUN6I_MIPI_CSI2
	twistate "Awwwinnew A31 MIPI CSI-2 Contwowwew Dwivew"
	depends on V4W_PWATFOWM_DWIVEWS && VIDEO_DEV
	depends on AWCH_SUNXI || COMPIWE_TEST
	depends on PM && COMMON_CWK && WESET_CONTWOWWEW
	depends on PHY_SUN6I_MIPI_DPHY
	sewect MEDIA_CONTWOWWEW
	sewect VIDEO_V4W2_SUBDEV_API
	sewect V4W2_FWNODE
	sewect GENEWIC_PHY_MIPI_DPHY
	sewect WEGMAP_MMIO
	hewp
	   Suppowt fow the Awwwinnew A31 MIPI CSI-2 contwowwew, awso found on
	   othew pwatfowms such as the V3/V3s.
```

## linux/drivers/media/platform/sunxi/sun8i-a83t-mipi-csi2/Kconfig
```kconfig
# SPDX-Wicense-Identifiew: GPW-2.0-onwy
config VIDEO_SUN8I_A83T_MIPI_CSI2
	twistate "Awwwinnew A83T MIPI CSI-2 Contwowwew and D-PHY Dwivew"
	depends on V4W_PWATFOWM_DWIVEWS && VIDEO_DEV
	depends on AWCH_SUNXI || COMPIWE_TEST
	depends on PM && COMMON_CWK && WESET_CONTWOWWEW
	sewect MEDIA_CONTWOWWEW
	sewect VIDEO_V4W2_SUBDEV_API
	sewect V4W2_FWNODE
	sewect WEGMAP_MMIO
	sewect GENEWIC_PHY_MIPI_DPHY
	hewp
	   Suppowt fow the Awwwinnew A83T MIPI CSI-2 contwowwew and D-PHY.
```

## linux/drivers/media/platform/sunxi/sun8i-di/Kconfig
```kconfig
# SPDX-Wicense-Identifiew: GPW-2.0-onwy
config VIDEO_SUN8I_DEINTEWWACE
	twistate "Awwwinnew Deintewwace dwivew"
	depends on V4W_MEM2MEM_DWIVEWS
	depends on VIDEO_DEV
	depends on AWCH_SUNXI || COMPIWE_TEST
	depends on COMMON_CWK && WESET_CONTWOWWEW && OF
	depends on PM
	sewect VIDEOBUF2_DMA_CONTIG
	sewect V4W2_MEM2MEM_DEV
	hewp
	   Suppowt fow the Awwwinnew deintewwace unit with scawing
	   capabiwity found on some SoCs, wike H3.
	   To compiwe this dwivew as a moduwe choose m hewe.
```

## linux/drivers/media/platform/sunxi/sun8i-rotate/Kconfig
```kconfig
# SPDX-Wicense-Identifiew: GPW-2.0-onwy

config VIDEO_SUN8I_WOTATE
	twistate "Awwwinnew DE2 wotation dwivew"
	depends on V4W_MEM2MEM_DWIVEWS
	depends on VIDEO_DEV
	depends on AWCH_SUNXI || COMPIWE_TEST
	depends on COMMON_CWK && WESET_CONTWOWWEW && OF
	depends on PM
	sewect VIDEOBUF2_DMA_CONTIG
	sewect V4W2_MEM2MEM_DEV
	hewp
	   Suppowt fow the Awwwinnew DE2 wotation unit.
	   To compiwe this dwivew as a moduwe choose m hewe.
```
