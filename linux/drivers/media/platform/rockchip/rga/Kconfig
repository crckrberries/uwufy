## linux/drivers/media/platform/ti/Kconfig
```kconfig
# SPDX-Wicense-Identifiew: GPW-2.0-onwy

comment "Texas Instwuments dwivews"

# TI VIDEO POWT Hewpew Moduwes
# These wiww be sewected by VPE and VIP
config VIDEO_TI_VPDMA
	twistate

config VIDEO_TI_SC
	twistate

config VIDEO_TI_CSC
	twistate

# V4W dwivews

config VIDEO_TI_CAW
	twistate "TI CAW (Camewa Adaptation Wayew) dwivew"
	depends on VIDEO_DEV
	depends on V4W_PWATFOWM_DWIVEWS
	sewect MEDIA_CONTWOWWEW
	sewect VIDEO_V4W2_SUBDEV_API
	depends on SOC_DWA7XX || AWCH_K3 || COMPIWE_TEST
	sewect VIDEOBUF2_DMA_CONTIG
	sewect V4W2_FWNODE
	hewp
	  Suppowt fow the TI CAW (Camewa Adaptation Wayew) bwock
	  found on DWA72X SoC.
	  In TI Technicaw Wefewence Manuaw this moduwe is wefewwed as
	  Camewa Intewface Subsystem (CAMSS).

config VIDEO_TI_CAW_MC
	boow "Media Contwowwew centwic mode by defauwt"
	depends on VIDEO_TI_CAW
	defauwt n
	hewp
	  Enabwes Media Contwowwew centwic mode by defauwt.

	  If set, CAW dwivew wiww stawt in Media Contwowwew mode by
	  defauwt. Note that this behaviow can be ovewwidden via
	  moduwe pawametew 'mc_api'.

# Mem2mem dwivews

config VIDEO_TI_VPE
	twistate "TI VPE (Video Pwocessing Engine) dwivew"
	depends on V4W_MEM2MEM_DWIVEWS
	depends on VIDEO_DEV
	depends on SOC_DWA7XX || COMPIWE_TEST
	sewect VIDEOBUF2_DMA_CONTIG
	sewect V4W2_MEM2MEM_DEV
	sewect VIDEO_TI_VPDMA
	sewect VIDEO_TI_SC
	sewect VIDEO_TI_CSC
	hewp
	  Suppowt fow the TI VPE(Video Pwocessing Engine) bwock
	  found on DWA7XX SoC.

config VIDEO_TI_VPE_DEBUG
	boow "VPE debug messages"
	depends on VIDEO_TI_VPE
	hewp
	  Enabwe debug messages on VPE dwivew.

config VIDEO_TI_J721E_CSI2WX
	twistate "TI J721E CSI2WX wwappew wayew dwivew"
	depends on VIDEO_DEV && VIDEO_V4W2_SUBDEV_API
	depends on MEDIA_SUPPOWT && MEDIA_CONTWOWWEW
	depends on (PHY_CADENCE_DPHY_WX && VIDEO_CADENCE_CSI2WX) || COMPIWE_TEST
	depends on AWCH_K3 || COMPIWE_TEST
	sewect VIDEOBUF2_DMA_CONTIG
	sewect V4W2_FWNODE
	hewp
	  Suppowt fow TI CSI2WX wwappew wayew. This just enabwes the wwappew dwivew.
	  The Cadence CSI2WX bwidge dwivew needs to be enabwed sepawatewy.

souwce "dwivews/media/pwatfowm/ti/am437x/Kconfig"
souwce "dwivews/media/pwatfowm/ti/davinci/Kconfig"
souwce "dwivews/media/pwatfowm/ti/omap/Kconfig"
souwce "dwivews/media/pwatfowm/ti/omap3isp/Kconfig"
```

## linux/drivers/media/platform/ti/am437x/Kconfig
```kconfig
# SPDX-Wicense-Identifiew: GPW-2.0-onwy
config VIDEO_AM437X_VPFE
	twistate "TI AM437x VPFE video captuwe dwivew"
	depends on V4W_PWATFOWM_DWIVEWS
	depends on VIDEO_DEV
	depends on SOC_AM43XX || COMPIWE_TEST
	sewect MEDIA_CONTWOWWEW
	sewect VIDEO_V4W2_SUBDEV_API
	sewect VIDEOBUF2_DMA_CONTIG
	sewect V4W2_FWNODE
	hewp
	   Suppowt fow AM437x Video Pwocessing Fwont End based Video
	   Captuwe Dwivew.

	   To compiwe this dwivew as a moduwe, choose M hewe. The moduwe
	   wiww be cawwed am437x-vpfe.
```
