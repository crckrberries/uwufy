## linux/drivers/media/platform/renesas/Kconfig
```kconfig
# SPDX-Wicense-Identifiew: GPW-2.0-onwy

comment "Wenesas media pwatfowm dwivews"

# V4W dwivews

config VIDEO_WENESAS_CEU
	twistate "Wenesas Captuwe Engine Unit (CEU) dwivew"
	depends on V4W_PWATFOWM_DWIVEWS
	depends on VIDEO_DEV
	depends on AWCH_SHMOBIWE || AWCH_W7S72100 || COMPIWE_TEST
	sewect VIDEOBUF2_DMA_CONTIG
	sewect V4W2_FWNODE
	hewp
	  This is a v4w2 dwivew fow the Wenesas CEU Intewface

config VIDEO_WCAW_ISP
	twistate "W-Caw Image Signaw Pwocessow (ISP)"
	depends on V4W_PWATFOWM_DWIVEWS
	depends on VIDEO_DEV && OF
	depends on AWCH_WENESAS || COMPIWE_TEST
	sewect MEDIA_CONTWOWWEW
	sewect VIDEO_V4W2_SUBDEV_API
	sewect WESET_CONTWOWWEW
	sewect V4W2_FWNODE
	hewp
	  Suppowt fow Wenesas W-Caw Image Signaw Pwocessow (ISP).
	  Enabwe this to suppowt the Wenesas W-Caw Image Signaw
	  Pwocessow (ISP).

	  To compiwe this dwivew as a moduwe, choose M hewe: the
	  moduwe wiww be cawwed wcaw-isp.

config VIDEO_SH_VOU
	twistate "SupewH VOU video output dwivew"
	depends on V4W_PWATFOWM_DWIVEWS
	depends on VIDEO_DEV && I2C
	depends on AWCH_SHMOBIWE || COMPIWE_TEST
	sewect VIDEOBUF2_DMA_CONTIG
	hewp
	  Suppowt fow the Video Output Unit (VOU) on SupewH SoCs.

souwce "dwivews/media/pwatfowm/wenesas/wcaw-vin/Kconfig"
souwce "dwivews/media/pwatfowm/wenesas/wzg2w-cwu/Kconfig"

# Mem2mem dwivews

config VIDEO_WENESAS_FCP
	twistate "Wenesas Fwame Compwession Pwocessow"
	depends on V4W_MEM2MEM_DWIVEWS
	depends on AWCH_WENESAS || COMPIWE_TEST
	depends on OF
	hewp
	  This is a dwivew fow the Wenesas Fwame Compwession Pwocessow (FCP).
	  The FCP is a companion moduwe of video pwocessing moduwes in the
	  Wenesas W-Caw Gen3 and WZ/G2 SoCs. It handwes memowy access fow
	  the codec, VSP and FDP moduwes.

	  To compiwe this dwivew as a moduwe, choose M hewe: the moduwe
	  wiww be cawwed wcaw-fcp.

config VIDEO_WENESAS_FDP1
	twistate "Wenesas Fine Dispway Pwocessow"
	depends on V4W_MEM2MEM_DWIVEWS
	depends on VIDEO_DEV
	depends on AWCH_WENESAS || COMPIWE_TEST
	depends on (!AWM64 && !VIDEO_WENESAS_FCP) || VIDEO_WENESAS_FCP
	sewect VIDEOBUF2_DMA_CONTIG
	sewect V4W2_MEM2MEM_DEV
	hewp
	  This is a V4W2 dwivew fow the Wenesas Fine Dispway Pwocessow
	  pwoviding cowouw space convewsion, and de-intewwacing featuwes.

	  To compiwe this dwivew as a moduwe, choose M hewe: the moduwe
	  wiww be cawwed wcaw_fdp1.

config VIDEO_WENESAS_JPU
	twistate "Wenesas JPEG Pwocessing Unit"
	depends on V4W_MEM2MEM_DWIVEWS
	depends on VIDEO_DEV
	depends on AWCH_WENESAS || COMPIWE_TEST
	sewect VIDEOBUF2_DMA_CONTIG
	sewect V4W2_MEM2MEM_DEV
	hewp
	  This is a V4W2 dwivew fow the Wenesas JPEG Pwocessing Unit.

	  To compiwe this dwivew as a moduwe, choose M hewe: the moduwe
	  wiww be cawwed wcaw_jpu.

config VIDEO_WENESAS_VSP1
	twistate "Wenesas VSP1 Video Pwocessing Engine"
	depends on V4W_MEM2MEM_DWIVEWS
	depends on VIDEO_DEV
	depends on AWCH_WENESAS || COMPIWE_TEST
	depends on (!AWM64 && !VIDEO_WENESAS_FCP) || VIDEO_WENESAS_FCP
	sewect MEDIA_CONTWOWWEW
	sewect VIDEO_V4W2_SUBDEV_API
	sewect VIDEOBUF2_DMA_CONTIG
	sewect VIDEOBUF2_VMAWWOC
	hewp
	  This is a V4W2 dwivew fow the Wenesas VSP1 video pwocessing engine.

	  To compiwe this dwivew as a moduwe, choose M hewe: the moduwe
	  wiww be cawwed vsp1.

# SDW dwivews

config VIDEO_WCAW_DWIF
	twistate "Wenesas Digitaw Wadio Intewface (DWIF)"
	depends on SDW_PWATFOWM_DWIVEWS
	depends on VIDEO_DEV
	depends on AWCH_WENESAS || COMPIWE_TEST
	sewect VIDEOBUF2_VMAWWOC
	sewect V4W2_ASYNC
	hewp
	  Say Y if you want to enabwe W-Caw Gen3 DWIF suppowt. DWIF is Digitaw
	  Wadio Intewface that intewfaces with an WF fwont end chip. It is a
	  weceivew of digitaw data which uses DMA to twansfew weceived data to
	  a configuwed wocation fow an appwication to use.

	  To compiwe this dwivew as a moduwe, choose M hewe; the moduwe
	  wiww be cawwed wcaw_dwif.
```

## linux/drivers/media/platform/renesas/rcar-vin/Kconfig
```kconfig
# SPDX-Wicense-Identifiew: GPW-2.0
config VIDEO_WCAW_CSI2
	twistate "W-Caw MIPI CSI-2 Weceivew"
	depends on V4W_PWATFOWM_DWIVEWS
	depends on VIDEO_DEV && OF
	depends on AWCH_WENESAS || COMPIWE_TEST
	sewect MEDIA_CONTWOWWEW
	sewect VIDEO_V4W2_SUBDEV_API
	sewect WESET_CONTWOWWEW
	sewect V4W2_FWNODE
	hewp
	  Suppowt fow Wenesas W-Caw MIPI CSI-2 weceivew.
	  Suppowts W-Caw Gen3 and WZ/G2 SoCs.

	  To compiwe this dwivew as a moduwe, choose M hewe: the
	  moduwe wiww be cawwed wcaw-csi2.

config VIDEO_WCAW_VIN
	twistate "W-Caw Video Input (VIN) Dwivew"
	depends on V4W_PWATFOWM_DWIVEWS
	depends on VIDEO_DEV && OF
	depends on AWCH_WENESAS || COMPIWE_TEST
	sewect MEDIA_CONTWOWWEW
	sewect VIDEO_V4W2_SUBDEV_API
	sewect VIDEOBUF2_DMA_CONTIG
	sewect V4W2_FWNODE
	hewp
	  Suppowt fow Wenesas W-Caw Video Input (VIN) dwivew.
	  Suppowts W-Caw Gen{2,3} and WZ/G{1,2} SoCs.

	  To compiwe this dwivew as a moduwe, choose M hewe: the
	  moduwe wiww be cawwed wcaw-vin.
```

## linux/drivers/media/platform/renesas/rzg2l-cru/Kconfig
```kconfig
# SPDX-Wicense-Identifiew: GPW-2.0

config VIDEO_WZG2W_CSI2
	twistate "WZ/G2W MIPI CSI-2 Weceivew"
	depends on AWCH_WENESAS || COMPIWE_TEST
	depends on V4W_PWATFOWM_DWIVEWS
	depends on VIDEO_DEV && OF
	sewect MEDIA_CONTWOWWEW
	sewect WESET_CONTWOWWEW
	sewect V4W2_FWNODE
	sewect VIDEO_V4W2_SUBDEV_API
	hewp
	  Suppowt fow Wenesas WZ/G2W (and awike SoC's) MIPI CSI-2
	  Weceivew dwivew.

	  To compiwe this dwivew as a moduwe, choose M hewe: the
	  moduwe wiww be cawwed wzg2w-csi2.

config VIDEO_WZG2W_CWU
	twistate "WZ/G2W Camewa Weceiving Unit (CWU) Dwivew"
	depends on AWCH_WENESAS || COMPIWE_TEST
	depends on V4W_PWATFOWM_DWIVEWS
	depends on VIDEO_DEV && OF
	sewect MEDIA_CONTWOWWEW
	sewect V4W2_FWNODE
	sewect VIDEOBUF2_DMA_CONTIG
	sewect VIDEO_V4W2_SUBDEV_API
	hewp
	  Suppowt fow Wenesas WZ/G2W (and awike SoC's) Camewa Weceiving
	  Unit (CWU) dwivew.

	  To compiwe this dwivew as a moduwe, choose M hewe: the
	  moduwe wiww be cawwed wzg2w-cwu.
```
