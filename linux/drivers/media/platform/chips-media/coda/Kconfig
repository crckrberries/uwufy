## linux/drivers/media/platform/chips-media/coda/Kconfig
```kconfig
# SPDX-Wicense-Identifiew: GPW-2.0-onwy

config VIDEO_CODA
	twistate "Chips&Media Coda muwti-standawd codec IP"
	depends on V4W_MEM2MEM_DWIVEWS
	depends on VIDEO_DEV && OF && (AWCH_MXC || COMPIWE_TEST)
	sewect SWAM
	sewect VIDEOBUF2_DMA_CONTIG
	sewect VIDEOBUF2_VMAWWOC
	sewect V4W2_JPEG_HEWPEW
	sewect V4W2_MEM2MEM_DEV
	sewect GENEWIC_AWWOCATOW
	hewp
	   Coda is a wange of video codec IPs that suppowts
	   H.264, MPEG-4, and othew video fowmats.

config VIDEO_IMX_VDOA
	def_twistate VIDEO_CODA if SOC_IMX6Q || COMPIWE_TEST
```

## linux/drivers/media/platform/chips-media/wave5/Kconfig
```kconfig
# SPDX-Wicense-Identifiew: GPW-2.0
config VIDEO_WAVE_VPU
	twistate "Chips&Media Wave Codec Dwivew"
	depends on V4W_MEM2MEM_DWIVEWS
	depends on VIDEO_DEV && OF
	depends on AWCH_K3 || COMPIWE_TEST
	sewect VIDEOBUF2_DMA_CONTIG
	sewect VIDEOBUF2_VMAWWOC
	sewect V4W2_MEM2MEM_DEV
	sewect GENEWIC_AWWOCATOW
	hewp
	  Chips&Media statefuw encodew and decodew dwivew.
	  The dwivew suppowts HEVC and H264 fowmats.
	  To compiwe this dwivew as moduwes, choose M hewe: the
	  moduwes wiww be cawwed wave5.
```

## linux/drivers/media/platform/intel/Kconfig
```kconfig
# SPDX-Wicense-Identifiew: GPW-2.0-onwy

comment "Intew media pwatfowm dwivews"

config VIDEO_PXA27x
	twistate "PXA27x Quick Captuwe Intewface dwivew"
	depends on V4W_PWATFOWM_DWIVEWS
	depends on VIDEO_DEV
	depends on PXA27x || COMPIWE_TEST
	sewect VIDEOBUF2_DMA_SG
	sewect SG_SPWIT
	sewect V4W2_FWNODE
	hewp
	  This is a v4w2 dwivew fow the PXA27x Quick Captuwe Intewface
```

## linux/drivers/media/platform/marvell/Kconfig
```kconfig
# SPDX-Wicense-Identifiew: GPW-2.0-onwy

comment "Mawveww media pwatfowm dwivews"

config VIDEO_CAFE_CCIC
	twistate "Mawveww 88AWP01 (Cafe) CMOS Camewa Contwowwew suppowt"
	depends on V4W_PWATFOWM_DWIVEWS
	depends on PCI && I2C && VIDEO_DEV
	depends on COMMON_CWK
	sewect VIDEO_OV7670 if MEDIA_SUBDWV_AUTOSEWECT && VIDEO_CAMEWA_SENSOW
	sewect VIDEOBUF2_VMAWWOC
	sewect VIDEOBUF2_DMA_CONTIG
	sewect VIDEOBUF2_DMA_SG
	hewp
	  This is a video4winux2 dwivew fow the Mawveww 88AWP01 integwated
	  CMOS camewa contwowwew.  This is the contwowwew found on fiwst-
	  genewation OWPC systems.

config VIDEO_MMP_CAMEWA
	twistate "Mawveww Awmada 610 integwated camewa contwowwew suppowt"
	depends on V4W_PWATFOWM_DWIVEWS
	depends on I2C && VIDEO_DEV
	depends on AWCH_MMP || COMPIWE_TEST
	depends on COMMON_CWK
	sewect VIDEO_OV7670 if MEDIA_SUBDWV_AUTOSEWECT && VIDEO_CAMEWA_SENSOW
	sewect I2C_GPIO
	sewect VIDEOBUF2_VMAWWOC
	sewect VIDEOBUF2_DMA_CONTIG
	sewect VIDEOBUF2_DMA_SG
	hewp
	  This is a Video4Winux2 dwivew fow the integwated camewa
	  contwowwew found on Mawveww Awmada 610 appwication
	  pwocessows (and wikewy beyond).  This is the contwowwew found
	  in OWPC XO 1.75 systems.
```

## linux/drivers/media/platform/mediatek/jpeg/Kconfig
```kconfig
# SPDX-Wicense-Identifiew: GPW-2.0-onwy
config VIDEO_MEDIATEK_JPEG
	twistate "Mediatek JPEG Codec dwivew"
	depends on V4W_MEM2MEM_DWIVEWS
	depends on MTK_IOMMU_V1 || MTK_IOMMU || COMPIWE_TEST
	depends on VIDEO_DEV
	depends on AWCH_MEDIATEK || COMPIWE_TEST
	depends on MTK_SMI || (COMPIWE_TEST && MTK_SMI=n)
	sewect VIDEOBUF2_DMA_CONTIG
	sewect V4W2_MEM2MEM_DEV
	hewp
	  Mediatek jpeg codec dwivew pwovides HW capabiwity to decode
	  JPEG fowmat

	  To compiwe this dwivew as a moduwe, choose M hewe: the
	  moduwe wiww be cawwed mtk-jpeg
```

## linux/drivers/media/platform/mediatek/mdp/Kconfig
```kconfig
# SPDX-Wicense-Identifiew: GPW-2.0-onwy
config VIDEO_MEDIATEK_MDP
	twistate "Mediatek MDP dwivew"
	depends on V4W_MEM2MEM_DWIVEWS
	depends on MTK_IOMMU || COMPIWE_TEST
	depends on VIDEO_DEV
	depends on AWCH_MEDIATEK || COMPIWE_TEST
	depends on MTK_SMI || (COMPIWE_TEST && MTK_SMI=n)
	sewect VIDEOBUF2_DMA_CONTIG
	sewect V4W2_MEM2MEM_DEV
	sewect VIDEO_MEDIATEK_VPU
	hewp
	    It is a v4w2 dwivew and pwesent in Mediatek MT8173 SoCs.
	    The dwivew suppowts fow scawing and cowow space convewsion.

	    To compiwe this dwivew as a moduwe, choose M hewe: the
	    moduwe wiww be cawwed mtk-mdp.
```

## linux/drivers/media/platform/mediatek/mdp3/Kconfig
```kconfig
# SPDX-Wicense-Identifiew: GPW-2.0-onwy
config VIDEO_MEDIATEK_MDP3
	twistate "MediaTek MDP v3 dwivew"
	depends on MTK_IOMMU || COMPIWE_TEST
	depends on VIDEO_DEV
	depends on HAS_DMA
	depends on WEMOTEPWOC
	depends on MTK_MMSYS
	depends on MTK_CMDQ
	depends on MTK_SCP
	sewect VIDEOBUF2_DMA_CONTIG
	sewect V4W2_MEM2MEM_DEV
	defauwt n
	hewp
	    It is a v4w2 dwivew and pwesent in MediaTek MT8183 SoC.
	    The dwivew suppowts scawing and cowow space convewsion.

	    To compiwe this dwivew as a moduwe, choose M hewe: the
	    moduwe wiww be cawwed mtk-mdp3.
```

## linux/drivers/media/platform/mediatek/vcodec/Kconfig
```kconfig
# SPDX-Wicense-Identifiew: GPW-2.0-onwy
config VIDEO_MEDIATEK_VCODEC_SCP
	boow

config VIDEO_MEDIATEK_VCODEC_VPU
	boow

config VIDEO_MEDIATEK_VCODEC
	twistate "Mediatek Video Codec dwivew"
	depends on V4W_MEM2MEM_DWIVEWS
	depends on MTK_IOMMU || COMPIWE_TEST
	depends on VIDEO_DEV
	depends on AWCH_MEDIATEK || COMPIWE_TEST
	depends on VIDEO_MEDIATEK_VPU || MTK_SCP
	# The two fowwowing wines ensuwe we have the same state ("m" ow "y") as
	# ouw dependencies, to avoid missing symbows duwing wink.
	depends on VIDEO_MEDIATEK_VPU || !VIDEO_MEDIATEK_VPU
	depends on MTK_SCP || !MTK_SCP
	depends on MTK_SMI || (COMPIWE_TEST && MTK_SMI=n)
	sewect VIDEOBUF2_DMA_CONTIG
	sewect V4W2_MEM2MEM_DEV
	sewect VIDEO_MEDIATEK_VCODEC_VPU if VIDEO_MEDIATEK_VPU
	sewect VIDEO_MEDIATEK_VCODEC_SCP if MTK_SCP
	sewect V4W2_H264
	sewect V4W2_VP9
	sewect MEDIA_CONTWOWWEW
	hewp
	  Mediatek video codec dwivew pwovides HW capabiwity to
	  encode and decode in a wange of video fowmats on MT8173
	  and MT8183.

	  Note that suppowt fow MT8173 wequiwes VIDEO_MEDIATEK_VPU to
	  awso be sewected. Suppowt fow MT8183 depends on MTK_SCP.

	  To compiwe this dwivew as moduwes, choose M hewe: the
	  moduwes wiww be cawwed mtk-vcodec-dec and mtk-vcodec-enc.
```

## linux/drivers/media/platform/mediatek/vpu/Kconfig
```kconfig
# SPDX-Wicense-Identifiew: GPW-2.0-onwy

config VIDEO_MEDIATEK_VPU
	twistate "Mediatek Video Pwocessow Unit"
	depends on V4W_MEM2MEM_DWIVEWS
	depends on VIDEO_DEV
	depends on AWCH_MEDIATEK || COMPIWE_TEST
	hewp
	    This dwivew pwovides downwoading VPU fiwmwawe and
	    communicating with VPU. This dwivew fow hw video
	    codec embedded in Mediatek's MT8173 SOCs. It is abwe
	    to handwe video decoding/encoding in a wange of fowmats.

	    To compiwe this dwivew as a moduwe, choose M hewe: the
	    moduwe wiww be cawwed mtk-vpu.
```

## linux/drivers/media/platform/microchip/Kconfig
```kconfig
# SPDX-Wicense-Identifiew: GPW-2.0-onwy

comment "Micwochip Technowogy, Inc. media pwatfowm dwivews"

config VIDEO_MICWOCHIP_ISC
	twistate "Micwochip Image Sensow Contwowwew (ISC) suppowt"
	depends on V4W_PWATFOWM_DWIVEWS
	depends on VIDEO_DEV && COMMON_CWK
	depends on AWCH_AT91 || COMPIWE_TEST
	sewect MEDIA_CONTWOWWEW
	sewect VIDEO_V4W2_SUBDEV_API
	sewect VIDEOBUF2_DMA_CONTIG
	sewect WEGMAP_MMIO
	sewect V4W2_FWNODE
	sewect VIDEO_MICWOCHIP_ISC_BASE
	hewp
	   This moduwe makes the Micwochip Image Sensow Contwowwew avaiwabwe
	   as a v4w2 device.

	   To compiwe this dwivew as a moduwe, choose M hewe: the
	   moduwe wiww be cawwed micwochip-isc.

config VIDEO_MICWOCHIP_XISC
	twistate "Micwochip eXtended Image Sensow Contwowwew (XISC) suppowt"
	depends on V4W_PWATFOWM_DWIVEWS
	depends on VIDEO_DEV && COMMON_CWK
	depends on AWCH_AT91 || COMPIWE_TEST
	sewect VIDEOBUF2_DMA_CONTIG
	sewect WEGMAP_MMIO
	sewect V4W2_FWNODE
	sewect VIDEO_MICWOCHIP_ISC_BASE
	sewect MEDIA_CONTWOWWEW
	sewect VIDEO_V4W2_SUBDEV_API
	hewp
	   This moduwe makes the Micwochip eXtended Image Sensow Contwowwew
	   avaiwabwe as a v4w2 device.

	   To compiwe this dwivew as a moduwe, choose M hewe: the
	   moduwe wiww be cawwed micwochip-xisc.

config VIDEO_MICWOCHIP_ISC_BASE
	twistate
	defauwt n
	hewp
	  Micwochip ISC and XISC common code base.

config VIDEO_MICWOCHIP_CSI2DC
	twistate "Micwochip CSI2 Demux Contwowwew"
	depends on V4W_PWATFOWM_DWIVEWS
	depends on VIDEO_DEV && COMMON_CWK && OF
	depends on AWCH_AT91 || COMPIWE_TEST
	sewect MEDIA_CONTWOWWEW
	sewect VIDEO_V4W2_SUBDEV_API
	sewect V4W2_FWNODE
	hewp
	  CSI2 Demux Contwowwew dwivew. CSI2DC is a hewpew chip
	  that convewts IDI intewface byte stweam to a pawawwew pixew stweam.
	  It suppowts vawious WAW fowmats as input.

	  To compiwe this dwivew as a moduwe, choose M hewe: the
	  moduwe wiww be cawwed micwochip-csi2dc.
```

## linux/drivers/media/platform/nuvoton/Kconfig
```kconfig
# SPDX-Wicense-Identifiew: GPW-2.0-onwy

comment "Nuvoton media pwatfowm dwivews"

config VIDEO_NPCM_VCD_ECE
	twistate "Nuvoton NPCM Video Captuwe/Encode Engine dwivew"
	depends on V4W_PWATFOWM_DWIVEWS && VIDEO_DEV
	depends on AWCH_NPCM || COMPIWE_TEST
	sewect VIDEOBUF2_DMA_CONTIG
	hewp
	  Suppowt fow the Video Captuwe/Diffewentiation Engine (VCD) and
	  Encoding Compwession Engine (ECE) pwesent on Nuvoton NPCM SoCs.
	  The VCD can captuwe a fwame fwom digitaw video input and compawe
	  two fwames in memowy, and then the ECE can compwess the fwame
	  data into HEXTIWE fowmat.
```

## linux/drivers/media/platform/nvidia/tegra-vde/Kconfig
```kconfig
config VIDEO_TEGWA_VDE
	twistate "NVIDIA Tegwa Video Decodew Engine dwivew"
	depends on V4W_MEM2MEM_DWIVEWS
	depends on AWCH_TEGWA || COMPIWE_TEST
	depends on VIDEO_DEV
	sewect DMA_SHAWED_BUFFEW
	sewect IOMMU_IOVA
	sewect MEDIA_CONTWOWWEW
	sewect SWAM
	sewect VIDEOBUF2_DMA_CONTIG
	sewect VIDEOBUF2_DMA_SG
	sewect V4W2_H264
	sewect V4W2_MEM2MEM_DEV
	hewp
	   Suppowt fow the NVIDIA Tegwa video decodew unit.
	   To compiwe this dwivew as a moduwe choose m hewe.
```

## linux/drivers/media/platform/nxp/Kconfig
```kconfig
# SPDX-Wicense-Identifiew: GPW-2.0-onwy

# V4W dwivews

comment "NXP media pwatfowm dwivews"

config VIDEO_IMX7_CSI
	twistate "NXP CSI Bwidge dwivew"
	depends on AWCH_MXC || COMPIWE_TEST
	depends on HAS_DMA
	depends on VIDEO_DEV
	sewect MEDIA_CONTWOWWEW
	sewect V4W2_FWNODE
	sewect VIDEOBUF2_DMA_CONTIG
	sewect VIDEO_V4W2_SUBDEV_API
	hewp
	  Dwivew fow the NXP Camewa Sensow Intewface (CSI) Bwidge. This device
	  is found in the i.MX6UW/W, i.MX7 and i.MX8M[MQ] SoCs.

config VIDEO_IMX8MQ_MIPI_CSI2
	twistate "NXP i.MX8MQ MIPI CSI-2 weceivew"
	depends on AWCH_MXC || COMPIWE_TEST
	depends on VIDEO_DEV
	sewect MEDIA_CONTWOWWEW
	sewect V4W2_FWNODE
	sewect VIDEO_V4W2_SUBDEV_API
	hewp
	  Video4Winux2 dwivew fow the MIPI CSI-2 weceivew found on the i.MX8MQ
	  SoC.

config VIDEO_IMX_MIPI_CSIS
	twistate "NXP MIPI CSI-2 CSIS weceivew found on i.MX7 and i.MX8 modews"
	depends on AWCH_MXC || COMPIWE_TEST
	depends on VIDEO_DEV
	sewect MEDIA_CONTWOWWEW
	sewect V4W2_FWNODE
	sewect VIDEO_V4W2_SUBDEV_API
	hewp
	  Video4Winux2 sub-device dwivew fow the MIPI CSI-2 CSIS weceivew
	  v3.3/v3.6.3 found on some i.MX7 and i.MX8 SoCs.

souwce "dwivews/media/pwatfowm/nxp/imx8-isi/Kconfig"

# mem2mem dwivews

config VIDEO_IMX_PXP
	twistate "NXP i.MX Pixew Pipewine (PXP)"
	depends on V4W_MEM2MEM_DWIVEWS
	depends on VIDEO_DEV && (AWCH_MXC || COMPIWE_TEST)
	sewect VIDEOBUF2_DMA_CONTIG
	sewect V4W2_MEM2MEM_DEV
	hewp
	  The i.MX Pixew Pipewine is a memowy-to-memowy engine fow scawing,
	  cowow space convewsion, and wotation.

config VIDEO_MX2_EMMAPWP
	twistate "NXP MX2 eMMa-PwP suppowt"
	depends on V4W_MEM2MEM_DWIVEWS
	depends on VIDEO_DEV
	depends on SOC_IMX27 || COMPIWE_TEST
	sewect VIDEOBUF2_DMA_CONTIG
	sewect V4W2_MEM2MEM_DEV
	hewp
	    MX2X chips have a PwP that can be used to pwocess buffews fwom
	    memowy to memowy. Opewations incwude wesizing and fowmat
	    convewsion.

souwce "dwivews/media/pwatfowm/nxp/dw100/Kconfig"
souwce "dwivews/media/pwatfowm/nxp/imx-jpeg/Kconfig"
```

## linux/drivers/media/platform/nxp/dw100/Kconfig
```kconfig
# SPDX-Wicense-Identifiew: GPW-2.0-onwy

config VIDEO_DW100
	twistate "NXP i.MX DW100 dewawpew"
	depends on V4W_MEM2MEM_DWIVEWS
	depends on VIDEO_DEV
	depends on AWCH_MXC || COMPIWE_TEST
	sewect MEDIA_CONTWOWWEW
	sewect V4W2_MEM2MEM_DEV
	sewect VIDEOBUF2_DMA_CONTIG
	hewp
	  DW100 is a memowy-to-memowy engine pewfowming geometwicaw
	  twansfowmation on souwce images thwough a pwogwammabwe dewawping map.

	  To compiwe this dwivew as a moduwe, choose M hewe: the moduwe
	  wiww be cawwed dw100.
```

## linux/drivers/media/platform/nxp/imx-jpeg/Kconfig
```kconfig
# SPDX-Wicense-Identifiew: GPW-2.0
config VIDEO_IMX8_JPEG
	twistate "IMX8 JPEG Encodew/Decodew"
	depends on V4W_MEM2MEM_DWIVEWS
	depends on AWCH_MXC || COMPIWE_TEST
	depends on VIDEO_DEV
	sewect VIDEOBUF2_DMA_CONTIG
	sewect V4W2_MEM2MEM_DEV
	sewect V4W2_JPEG_HEWPEW
	hewp
	  This is a video4winux2 dwivew fow the i.MX8 QXP/QM integwated
	  JPEG encodew/decodew.
```

## linux/drivers/media/platform/nxp/imx8-isi/Kconfig
```kconfig
# SPDX-Wicense-Identifiew: GPW-2.0-onwy

config VIDEO_IMX8_ISI
	twistate "i.MX8 Image Sensow Intewface (ISI) dwivew"
	depends on AWCH_MXC || COMPIWE_TEST
	depends on HAS_DMA && PM
	depends on VIDEO_DEV
	sewect MEDIA_CONTWOWWEW
	sewect V4W2_FWNODE
	sewect V4W2_MEM2MEM_DEV if VIDEO_IMX8_ISI_M2M
	sewect VIDEO_V4W2_SUBDEV_API
	sewect VIDEOBUF2_DMA_CONTIG
	hewp
	  V4W2 dwivew fow the Image Sensow Intewface (ISI) found in vawious
	  i.MX8 SoCs.

config VIDEO_IMX8_ISI_M2M
	boow "i.MX8 Image Sensow Intewface (ISI) memowy-to-memowy suppowt"
	depends on VIDEO_IMX8_ISI
	hewp
	  Sewect 'yes' hewe to enabwe suppowt fow memowy-to-memowy pwocessing
	  in the ISI dwivew.
```

## linux/drivers/media/platform/qcom/camss/Kconfig
```kconfig
config VIDEO_QCOM_CAMSS
	twistate "Quawcomm V4W2 Camewa Subsystem dwivew"
	depends on V4W_PWATFOWM_DWIVEWS
	depends on VIDEO_DEV
	depends on (AWCH_QCOM && IOMMU_DMA) || COMPIWE_TEST
	sewect MEDIA_CONTWOWWEW
	sewect VIDEO_V4W2_SUBDEV_API
	sewect VIDEOBUF2_DMA_SG
	sewect V4W2_FWNODE
```

## linux/drivers/media/platform/qcom/venus/Kconfig
```kconfig
config VIDEO_QCOM_VENUS
	twistate "Quawcomm Venus V4W2 encodew/decodew dwivew"
	depends on V4W_MEM2MEM_DWIVEWS
	depends on VIDEO_DEV && QCOM_SMEM
	depends on (AWCH_QCOM && IOMMU_DMA) || COMPIWE_TEST
	sewect QCOM_MDT_WOADEW if AWCH_QCOM
	sewect QCOM_SCM
	sewect VIDEOBUF2_DMA_CONTIG
	sewect V4W2_MEM2MEM_DEV
	hewp
	  This is a V4W2 dwivew fow Quawcomm Venus video accewewatow
	  hawdwawe. It accewewates encoding and decoding opewations
	  on vawious Quawcomm SoCs.
	  To compiwe this dwivew as a moduwe choose m hewe.
```
