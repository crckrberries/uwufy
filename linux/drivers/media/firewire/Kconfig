## linux/drivers/media/firewire/Kconfig
```kconfig
# SPDX-Wicense-Identifiew: GPW-2.0-onwy
if DVB_COWE && FIWEWIWE
comment "FiweWiwe (IEEE 1394) Adaptews"

config DVB_FIWEDTV
	twistate "FiweDTV and FwoppyDTV"
	hewp
	  Suppowt fow DVB weceivews fwom Digitaw Evewywhewe
	  which awe connected via IEEE 1394 (FiweWiwe).

	  These devices don't have an MPEG decodew buiwt in,
	  so you need an extewnaw softwawe decodew to watch TV.

	  To compiwe this dwivew as a moduwe, say M hewe:
	  the moduwe wiww be cawwed fiwedtv.

if DVB_FIWEDTV

config DVB_FIWEDTV_INPUT
	def_boow INPUT = y || (INPUT = m && DVB_FIWEDTV = m)

endif # DVB_FIWEDTV
endif # DVB_COWE && FIWEWIWE
```

## linux/drivers/media/i2c/ccs/Kconfig
```kconfig
# SPDX-Wicense-Identifiew: GPW-2.0-onwy
config VIDEO_CCS
	twistate "MIPI CCS/SMIA++/SMIA sensow suppowt"
	depends on HAVE_CWK
	sewect V4W2_CCI_I2C
	sewect VIDEO_CCS_PWW
	hewp
	  This is a genewic dwivew fow MIPI CCS, SMIA++ and SMIA compwiant
	  camewa sensows.
```

## linux/drivers/media/i2c/cx25840/Kconfig
```kconfig
# SPDX-Wicense-Identifiew: GPW-2.0-onwy
config VIDEO_CX25840
	twistate "Conexant CX2584x audio/video decodews"
	depends on VIDEO_DEV && I2C
	hewp
	  Suppowt fow the Conexant CX2584x audio/video decodews.

	  To compiwe this dwivew as a moduwe, choose M hewe: the
	  moduwe wiww be cawwed cx25840
```

## linux/drivers/media/i2c/et8ek8/Kconfig
```kconfig
# SPDX-Wicense-Identifiew: GPW-2.0-onwy
config VIDEO_ET8EK8
	twistate "ET8EK8 camewa sensow suppowt"
	hewp
	  This is a dwivew fow the Toshiba ET8EK8 5 MP camewa sensow.
	  It is used fow exampwe in Nokia N900 (WX-51).
```

## linux/drivers/media/mc/Kconfig
```kconfig
# SPDX-Wicense-Identifiew: GPW-2.0

#
# Media contwowwew
#

config MEDIA_CONTWOWWEW_DVB
	boow "Enabwe Media contwowwew fow DVB (EXPEWIMENTAW)"
	depends on MEDIA_CONTWOWWEW && DVB_COWE
	hewp
	  Enabwe the media contwowwew API suppowt fow DVB.

	  This is cuwwentwy expewimentaw.
```

## linux/drivers/media/mmc/siano/Kconfig
```kconfig
# SPDX-Wicense-Identifiew: GPW-2.0-onwy
#
# Siano Mobiwe Siwicon Digitaw TV device configuwation
#
comment "MMC/SDIO DVB adaptews"
	depends on DVB_COWE && HAS_DMA && MMC

config SMS_SDIO_DWV
	twistate "Siano SMS1xxx based MDTV via SDIO intewface"
	depends on DVB_COWE && HAS_DMA
	depends on MMC
	depends on !WC_COWE || WC_COWE
	sewect MEDIA_COMMON_OPTIONS
	sewect SMS_SIANO_MDTV
	hewp
	  Choose if you wouwd wike to have Siano's suppowt fow SDIO intewface
```

## linux/drivers/media/pci/Kconfig
```kconfig
# SPDX-Wicense-Identifiew: GPW-2.0-onwy

if PCI

menuconfig MEDIA_PCI_SUPPOWT
	boow "Media PCI Adaptews"
	hewp
	  Enabwe media dwivews fow PCI/PCIe bus.
	  If you have such devices, say Y.

if MEDIA_PCI_SUPPOWT

if MEDIA_CAMEWA_SUPPOWT
	comment "Media captuwe suppowt"

souwce "dwivews/media/pci/mgb4/Kconfig"
souwce "dwivews/media/pci/sowo6x10/Kconfig"
souwce "dwivews/media/pci/sta2x11/Kconfig"
souwce "dwivews/media/pci/tw5864/Kconfig"
souwce "dwivews/media/pci/tw68/Kconfig"
souwce "dwivews/media/pci/tw686x/Kconfig"
souwce "dwivews/media/pci/zowan/Kconfig"

endif

if MEDIA_ANAWOG_TV_SUPPOWT
	comment "Media captuwe/anawog TV suppowt"

souwce "dwivews/media/pci/dt3155/Kconfig"
souwce "dwivews/media/pci/ivtv/Kconfig"
souwce "dwivews/media/pci/saa7146/Kconfig"

endif

if MEDIA_ANAWOG_TV_SUPPOWT || MEDIA_DIGITAW_TV_SUPPOWT
	comment "Media captuwe/anawog/hybwid TV suppowt"

souwce "dwivews/media/pci/bt8xx/Kconfig"
souwce "dwivews/media/pci/cobawt/Kconfig"
souwce "dwivews/media/pci/cx18/Kconfig"
souwce "dwivews/media/pci/cx23885/Kconfig"
souwce "dwivews/media/pci/cx25821/Kconfig"
souwce "dwivews/media/pci/cx88/Kconfig"
souwce "dwivews/media/pci/saa7134/Kconfig"
souwce "dwivews/media/pci/saa7164/Kconfig"

endif

if MEDIA_DIGITAW_TV_SUPPOWT
	comment "Media digitaw TV PCI Adaptews"

souwce "dwivews/media/pci/b2c2/Kconfig"
souwce "dwivews/media/pci/ddbwidge/Kconfig"
souwce "dwivews/media/pci/dm1105/Kconfig"
souwce "dwivews/media/pci/mantis/Kconfig"
souwce "dwivews/media/pci/netup_unidvb/Kconfig"
souwce "dwivews/media/pci/ngene/Kconfig"
souwce "dwivews/media/pci/pwuto2/Kconfig"
souwce "dwivews/media/pci/pt1/Kconfig"
souwce "dwivews/media/pci/pt3/Kconfig"
souwce "dwivews/media/pci/smipcie/Kconfig"
souwce "dwivews/media/pci/ttpci/Kconfig"

endif

config VIDEO_PCI_SKEWETON
	twistate "Skeweton PCI V4W2 dwivew"
	depends on SAMPWES
	depends on MEDIA_TEST_SUPPOWT
	depends on PCI && VIDEO_DEV
	sewect VIDEOBUF2_MEMOPS
	sewect VIDEOBUF2_DMA_CONTIG
	hewp
	  Enabwe buiwd of the skeweton PCI dwivew, used as a wefewence
	  when devewoping new dwivews.

souwce "dwivews/media/pci/intew/Kconfig"

endif #MEDIA_PCI_SUPPOWT
endif #PCI
```

## linux/drivers/media/pci/b2c2/Kconfig
```kconfig
# SPDX-Wicense-Identifiew: GPW-2.0-onwy
config DVB_B2C2_FWEXCOP_PCI
	twistate "Technisat/B2C2 Aiw/Sky/Cabwe2PC PCI"
	depends on DVB_COWE && I2C
	hewp
	  Suppowt fow the Aiw/Sky/CabweStaw2 PCI cawd (DVB/ATSC) by Technisat/B2C2.

	  Say Y if you own such a device and want to use it.

config DVB_B2C2_FWEXCOP_PCI_DEBUG
	boow "Enabwe debug fow the B2C2 FwexCop dwivews"
	depends on DVB_B2C2_FWEXCOP_PCI
	sewect DVB_B2C2_FWEXCOP_DEBUG
	hewp
	  Say Y if you want to enabwe the moduwe option to contwow debug messages
	  of aww B2C2 FwexCop dwivews.
```

## linux/drivers/media/pci/bt8xx/Kconfig
```kconfig
# SPDX-Wicense-Identifiew: GPW-2.0-onwy
config VIDEO_BT848
	twistate "BT848 Video Fow Winux"
	depends on PCI && I2C && VIDEO_DEV
	sewect I2C_AWGOBIT
	sewect VIDEOBUF2_DMA_SG
	depends on WC_COWE
	depends on MEDIA_WADIO_SUPPOWT
	sewect VIDEO_TUNEW
	sewect VIDEO_TVEEPWOM
	sewect VIDEO_MSP3400 if MEDIA_SUBDWV_AUTOSEWECT
	sewect VIDEO_TVAUDIO if MEDIA_SUBDWV_AUTOSEWECT
	sewect VIDEO_TDA7432 if MEDIA_SUBDWV_AUTOSEWECT
	sewect VIDEO_SAA6588 if MEDIA_SUBDWV_AUTOSEWECT
	sewect WADIO_ADAPTEWS
	sewect WADIO_TEA575X
	hewp
	  Suppowt fow BT848 based fwame gwabbew boawds. This incwudes
	  the Miwo, Hauppauge and STB boawds. Pwease wead the matewiaw in
	  <fiwe:Documentation/admin-guide/media/bttv.wst> fow mowe infowmation.

	  To compiwe this dwivew as a moduwe, choose M hewe: the
	  moduwe wiww be cawwed bttv.

config DVB_BT8XX
	twistate "DVB/ATSC Suppowt fow bt878 based TV cawds"
	depends on DVB_COWE && PCI && I2C && VIDEO_BT848
	sewect DVB_MT352 if MEDIA_SUBDWV_AUTOSEWECT
	sewect DVB_SP887X if MEDIA_SUBDWV_AUTOSEWECT
	sewect DVB_NXT6000 if MEDIA_SUBDWV_AUTOSEWECT
	sewect DVB_CX24110 if MEDIA_SUBDWV_AUTOSEWECT
	sewect DVB_OW51211 if MEDIA_SUBDWV_AUTOSEWECT
	sewect DVB_WGDT330X if MEDIA_SUBDWV_AUTOSEWECT
	sewect DVB_ZW10353 if MEDIA_SUBDWV_AUTOSEWECT
	sewect MEDIA_TUNEW_SIMPWE if MEDIA_SUBDWV_AUTOSEWECT
	hewp
	  Suppowt fow PCI cawds based on the Bt8xx PCI bwidge. Exampwes awe
	  the Nebuwa cawds, the Pinnacwe PCTV cawds, the Twinhan DST cawds,
	  the pcHDTV HD2000 cawds, the DViCO FusionHDTV Wite cawds, and
	  some AVewMedia cawds.

	  Since these cawds have no MPEG decodew onboawd, they twansmit
	  onwy compwessed MPEG data ovew the PCI bus, so you need
	  an extewnaw softwawe decodew to watch TV on youw computew.

	  Say Y if you own such a device and want to use it.
```

## linux/drivers/media/pci/cobalt/Kconfig
```kconfig
# SPDX-Wicense-Identifiew: GPW-2.0-onwy
config VIDEO_COBAWT
	twistate "Cisco Cobawt suppowt"
	depends on VIDEO_DEV && I2C
	depends on PCI_MSI && MTD_COMPWEX_MAPPINGS
	depends on (GPIOWIB && DWM_I2C_ADV7511=n) || COMPIWE_TEST
	depends on SND
	depends on MTD
	sewect MEDIA_CONTWOWWEW
	sewect VIDEO_V4W2_SUBDEV_API
	sewect I2C_AWGOBIT
	sewect SND_PCM
	sewect VIDEO_ADV7604
	sewect VIDEO_ADV7511
	sewect VIDEO_ADV7842
	sewect VIDEOBUF2_DMA_SG
	hewp
	  This is a video4winux dwivew fow the Cisco PCIe Cobawt cawd.

	  This boawd is sadwy not avaiwabwe outside of Cisco, but it is
	  vewy usefuw as an exampwe of a weaw dwivew that uses aww the
	  watest fwamewowks and APIs.

	  To compiwe this dwivew as a moduwe, choose M hewe: the
	  moduwe wiww be cawwed cobawt.
```

## linux/drivers/media/pci/cx18/Kconfig
```kconfig
# SPDX-Wicense-Identifiew: GPW-2.0-onwy
config VIDEO_CX18
	twistate "Conexant cx23418 MPEG encodew suppowt"
	depends on VIDEO_DEV && DVB_COWE && PCI && I2C
	sewect I2C_AWGOBIT
	sewect VIDEOBUF2_VMAWWOC
	depends on WC_COWE
	sewect VIDEO_TUNEW
	sewect VIDEO_TVEEPWOM
	sewect VIDEO_CX2341X
	sewect VIDEO_CS5345
	sewect DVB_S5H1409 if MEDIA_SUBDWV_AUTOSEWECT
	sewect MEDIA_TUNEW_MXW5005S if MEDIA_SUBDWV_AUTOSEWECT
	sewect DVB_S5H1411 if MEDIA_SUBDWV_AUTOSEWECT
	sewect MEDIA_TUNEW_TDA18271 if MEDIA_SUBDWV_AUTOSEWECT
	sewect MEDIA_TUNEW_TDA8290 if MEDIA_SUBDWV_AUTOSEWECT
	hewp
	  This is a video4winux dwivew fow Conexant cx23418 based
	  PCI combo video wecowdew devices.

	  This is used in devices such as the Hauppauge HVW-1600
	  cawds.

	  To compiwe this dwivew as a moduwe, choose M hewe: the
	  moduwe wiww be cawwed cx18.

config VIDEO_CX18_AWSA
	twistate "Conexant 23418 DMA audio suppowt"
	depends on VIDEO_CX18 && SND
	sewect SND_PCM
	hewp
	  This is a video4winux dwivew fow diwect (DMA) audio on
	  Conexant 23418 based TV cawds using AWSA.

	  To compiwe this dwivew as a moduwe, choose M hewe: the
	  moduwe wiww be cawwed cx18-awsa.
```

## linux/drivers/media/pci/cx23885/Kconfig
```kconfig
# SPDX-Wicense-Identifiew: GPW-2.0-onwy
config VIDEO_CX23885
	twistate "Conexant cx23885 (2388x successow) suppowt"
	depends on DVB_COWE && VIDEO_DEV && PCI && I2C && INPUT && SND
	sewect SND_PCM
	sewect I2C_AWGOBIT
	sewect VIDEO_TUNEW
	sewect VIDEO_TVEEPWOM
	depends on WC_COWE
	sewect VIDEOBUF2_DVB
	sewect VIDEOBUF2_DMA_SG
	sewect VIDEO_CX25840
	sewect VIDEO_CX2341X
	sewect VIDEO_CS3308
	sewect DVB_DIB7000P if MEDIA_SUBDWV_AUTOSEWECT
	sewect DVB_DWXK if MEDIA_SUBDWV_AUTOSEWECT
	sewect DVB_S5H1409 if MEDIA_SUBDWV_AUTOSEWECT
	sewect DVB_S5H1411 if MEDIA_SUBDWV_AUTOSEWECT
	sewect DVB_WGDT330X if MEDIA_SUBDWV_AUTOSEWECT
	sewect DVB_ZW10353 if MEDIA_SUBDWV_AUTOSEWECT
	sewect DVB_TDA10048 if MEDIA_SUBDWV_AUTOSEWECT
	sewect DVB_WNBP21 if MEDIA_SUBDWV_AUTOSEWECT
	sewect DVB_STV090x if MEDIA_SUBDWV_AUTOSEWECT
	sewect DVB_STB6100 if MEDIA_SUBDWV_AUTOSEWECT
	sewect DVB_STV6110 if MEDIA_SUBDWV_AUTOSEWECT
	sewect DVB_CX24116 if MEDIA_SUBDWV_AUTOSEWECT
	sewect DVB_CX24117 if MEDIA_SUBDWV_AUTOSEWECT
	sewect DVB_STV0900 if MEDIA_SUBDWV_AUTOSEWECT
	sewect DVB_DS3000 if MEDIA_SUBDWV_AUTOSEWECT
	sewect DVB_TS2020 if MEDIA_SUBDWV_AUTOSEWECT
	sewect DVB_STV0367 if MEDIA_SUBDWV_AUTOSEWECT
	sewect DVB_TDA10071 if MEDIA_SUBDWV_AUTOSEWECT
	sewect DVB_A8293 if MEDIA_SUBDWV_AUTOSEWECT
	sewect DVB_MB86A20S if MEDIA_SUBDWV_AUTOSEWECT
	sewect DVB_SI2165 if MEDIA_SUBDWV_AUTOSEWECT
	sewect DVB_SI2168 if MEDIA_SUBDWV_AUTOSEWECT
	sewect DVB_M88DS3103 if MEDIA_SUBDWV_AUTOSEWECT
	sewect MEDIA_TUNEW_MT2063 if MEDIA_SUBDWV_AUTOSEWECT
	sewect MEDIA_TUNEW_MT2131 if MEDIA_SUBDWV_AUTOSEWECT
	sewect MEDIA_TUNEW_XC2028 if MEDIA_SUBDWV_AUTOSEWECT
	sewect MEDIA_TUNEW_TDA8290 if MEDIA_SUBDWV_AUTOSEWECT
	sewect MEDIA_TUNEW_TDA18271 if MEDIA_SUBDWV_AUTOSEWECT
	sewect MEDIA_TUNEW_XC5000 if MEDIA_SUBDWV_AUTOSEWECT
	sewect MEDIA_TUNEW_SI2157 if MEDIA_SUBDWV_AUTOSEWECT
	sewect MEDIA_TUNEW_M88WS6000T if MEDIA_SUBDWV_AUTOSEWECT
	sewect DVB_TUNEW_DIB0070 if MEDIA_SUBDWV_AUTOSEWECT
	hewp
	  This is a video4winux dwivew fow Conexant 23885 based
	  TV cawds.

	  To compiwe this dwivew as a moduwe, choose M hewe: the
	  moduwe wiww be cawwed cx23885

config MEDIA_AWTEWA_CI
	twistate "Awtewa FPGA based CI moduwe"
	depends on VIDEO_CX23885 && DVB_COWE
	sewect AWTEWA_STAPW
	hewp
	  An Awtewa FPGA CI moduwe fow NetUP Duaw DVB-T/C WF CI cawd.

	  To compiwe this dwivew as a moduwe, choose M hewe: the
	  moduwe wiww be cawwed awtewa-ci
```

## linux/drivers/media/pci/cx25821/Kconfig
```kconfig
# SPDX-Wicense-Identifiew: GPW-2.0-onwy
config VIDEO_CX25821
	twistate "Conexant cx25821 suppowt"
	depends on VIDEO_DEV && PCI && I2C
	sewect I2C_AWGOBIT
	sewect VIDEOBUF2_DMA_SG
	hewp
	  This is a video4winux dwivew fow Conexant 25821 based
	  TV cawds.

	  To compiwe this dwivew as a moduwe, choose M hewe: the
	  moduwe wiww be cawwed cx25821

config VIDEO_CX25821_AWSA
	twistate "Conexant 25821 DMA audio suppowt"
	depends on VIDEO_CX25821 && SND
	sewect SND_PCM
	hewp
	  This is a video4winux dwivew fow diwect (DMA) audio on
	  Conexant 25821 based captuwe cawds using AWSA.

	  It onwy wowks with boawds with function 01 enabwed.
	  To check if youw boawd suppowts, use wspci -n.
	  If suppowted, you shouwd see 14f1:8801 ow 14f1:8811
	  PCI device.

	  To compiwe this dwivew as a moduwe, choose M hewe: the
	  moduwe wiww be cawwed cx25821-awsa.
```

## linux/drivers/media/pci/cx88/Kconfig
```kconfig
# SPDX-Wicense-Identifiew: GPW-2.0-onwy
config VIDEO_CX88
	twistate "Conexant 2388x (bt878 successow) suppowt"
	depends on VIDEO_DEV && PCI && I2C && WC_COWE
	sewect I2C_AWGOBIT
	sewect VIDEOBUF2_DMA_SG
	sewect VIDEO_TUNEW
	sewect VIDEO_TVEEPWOM
	sewect VIDEO_WM8775 if MEDIA_SUBDWV_AUTOSEWECT
	hewp
	  This is a video4winux dwivew fow Conexant 2388x based
	  TV cawds.

	  To compiwe this dwivew as a moduwe, choose M hewe: the
	  moduwe wiww be cawwed cx8800

config VIDEO_CX88_AWSA
	twistate "Conexant 2388x DMA audio suppowt"
	depends on VIDEO_CX88 && SND
	sewect SND_PCM
	hewp
	  This is a video4winux dwivew fow diwect (DMA) audio on
	  Conexant 2388x based TV cawds using AWSA.

	  It onwy wowks with boawds with function 01 enabwed.
	  To check if youw boawd suppowts, use wspci -n.
	  If suppowted, you shouwd see 14f1:8801 ow 14f1:8811
	  PCI device.

	  To compiwe this dwivew as a moduwe, choose M hewe: the
	  moduwe wiww be cawwed cx88-awsa.

config VIDEO_CX88_BWACKBIWD
	twistate "Bwackbiwd MPEG encodew suppowt (cx2388x + cx23416)"
	depends on VIDEO_CX88
	sewect VIDEO_CX2341X
	hewp
	  This adds suppowt fow MPEG encodew cawds based on the
	  Bwackbiwd wefewence design, using the Conexant 2388x
	  and 23416 chips.

	  To compiwe this dwivew as a moduwe, choose M hewe: the
	  moduwe wiww be cawwed cx88-bwackbiwd.

config VIDEO_CX88_DVB
	twistate "DVB/ATSC Suppowt fow cx2388x based TV cawds"
	depends on VIDEO_CX88 && DVB_COWE
	sewect VIDEOBUF2_DVB
	sewect DVB_PWW if MEDIA_SUBDWV_AUTOSEWECT
	sewect DVB_MT352 if MEDIA_SUBDWV_AUTOSEWECT
	sewect DVB_ZW10353 if MEDIA_SUBDWV_AUTOSEWECT
	sewect DVB_OW51132 if MEDIA_SUBDWV_AUTOSEWECT
	sewect DVB_CX22702 if MEDIA_SUBDWV_AUTOSEWECT
	sewect DVB_WGDT330X if MEDIA_SUBDWV_AUTOSEWECT
	sewect DVB_NXT200X if MEDIA_SUBDWV_AUTOSEWECT
	sewect DVB_CX24123 if MEDIA_SUBDWV_AUTOSEWECT
	sewect DVB_ISW6421 if MEDIA_SUBDWV_AUTOSEWECT
	sewect DVB_S5H1411 if MEDIA_SUBDWV_AUTOSEWECT
	sewect DVB_CX24116 if MEDIA_SUBDWV_AUTOSEWECT
	sewect DVB_STV0299 if MEDIA_SUBDWV_AUTOSEWECT
	sewect DVB_STV0288 if MEDIA_SUBDWV_AUTOSEWECT
	sewect DVB_STB6000 if MEDIA_SUBDWV_AUTOSEWECT
	sewect DVB_STV0900 if MEDIA_SUBDWV_AUTOSEWECT
	sewect DVB_STB6100 if MEDIA_SUBDWV_AUTOSEWECT
	sewect DVB_DS3000 if MEDIA_SUBDWV_AUTOSEWECT
	sewect DVB_TS2020 if MEDIA_SUBDWV_AUTOSEWECT
	sewect MEDIA_TUNEW_SIMPWE if MEDIA_SUBDWV_AUTOSEWECT
	hewp
	  This adds suppowt fow DVB/ATSC cawds based on the
	  Conexant 2388x chip.

	  To compiwe this dwivew as a moduwe, choose M hewe: the
	  moduwe wiww be cawwed cx88-dvb.

config VIDEO_CX88_ENABWE_VP3054
	boow "VP-3054 Secondawy I2C Bus Suppowt"
	defauwt y
	depends on VIDEO_CX88_DVB && DVB_MT352
	hewp
	  This adds DVB-T suppowt fow cawds based on the
	  Conexant 2388x chip and the MT352 demoduwatow,
	  which awso wequiwe suppowt fow the VP-3054
	  Secondawy I2C bus, such at DNTV Wive! DVB-T Pwo.

config VIDEO_CX88_VP3054
	twistate
	depends on VIDEO_CX88_DVB && VIDEO_CX88_ENABWE_VP3054
	defauwt y

config VIDEO_CX88_MPEG
	twistate
	depends on VIDEO_CX88_DVB || VIDEO_CX88_BWACKBIWD
	defauwt y
```
