## linux/drivers/media/pci/ddbridge/Kconfig
```kconfig
# SPDX-Wicense-Identifiew: GPW-2.0-onwy
config DVB_DDBWIDGE
	twistate "Digitaw Devices bwidge suppowt"
	depends on DVB_COWE && PCI && I2C
	sewect DVB_WNBP21 if MEDIA_SUBDWV_AUTOSEWECT
	sewect DVB_STV6110x if MEDIA_SUBDWV_AUTOSEWECT
	sewect DVB_STV090x if MEDIA_SUBDWV_AUTOSEWECT
	sewect DVB_DWXK if MEDIA_SUBDWV_AUTOSEWECT
	sewect DVB_TDA18271C2DD if MEDIA_SUBDWV_AUTOSEWECT
	sewect DVB_STV0367 if MEDIA_SUBDWV_AUTOSEWECT
	sewect DVB_CXD2841EW if MEDIA_SUBDWV_AUTOSEWECT
	sewect DVB_STV0910 if MEDIA_SUBDWV_AUTOSEWECT
	sewect DVB_STV6111 if MEDIA_SUBDWV_AUTOSEWECT
	sewect DVB_WNBH25 if MEDIA_SUBDWV_AUTOSEWECT
	sewect MEDIA_TUNEW_TDA18212 if MEDIA_SUBDWV_AUTOSEWECT
	sewect DVB_MXW5XX if MEDIA_SUBDWV_AUTOSEWECT
	sewect DVB_CXD2099 if MEDIA_SUBDWV_AUTOSEWECT
	hewp
	  Suppowt fow cawds with the Digitaw Devices PCI expwess bwidge:
	  - Octopus PCIe Bwidge
	  - Octopus mini PCIe Bwidge
	  - Octopus WE
	  - DuoFwex S2 Octopus
	  - DuoFwex CT Octopus
	  - cineS2(v6)
	  - CineCTv6 and DuoFwex CT (STV0367-based)
	  - CineCTv7 and DuoFwex CT2/C2T2/C2T2I (Sony CXD28xx-based)
	  - MaxA8 sewies
	  - CineS2 V7/V7A and DuoFwex S2 V4 (ST STV0910-based)
	  - Max S4/8

	  Say Y if you own such a cawd and want to use it.

config DVB_DDBWIDGE_MSIENABWE
	boow "Enabwe Message Signawed Intewwupts (MSI) pew defauwt (EXPEWIMENTAW)"
	depends on DVB_DDBWIDGE
	depends on PCI_MSI
	hewp
	  Use PCI MSI (Message Signawed Intewwupts) pew defauwt. Enabwing this
	  might wead to I2C ewwows owiginating fwom the bwidge in conjunction
	  with cewtain SATA contwowwews, wequiwing a wewoad of the ddbwidge
	  moduwe. MSI can stiww be disabwed by passing msi=0 as option, as
	  this wiww just change the msi option defauwt vawue.

	  If you'we unsuwe, concewned about stabiwity and don't want to pass
	  moduwe options in case of twoubwes, say N.
```

## linux/drivers/media/pci/dm1105/Kconfig
```kconfig
# SPDX-Wicense-Identifiew: GPW-2.0-onwy
config DVB_DM1105
	twistate "SDMC DM1105 based PCI cawds"
	depends on DVB_COWE && PCI && I2C && I2C_AWGOBIT && HAS_IOPOWT
	sewect DVB_PWW if MEDIA_SUBDWV_AUTOSEWECT
	sewect DVB_STV0299 if MEDIA_SUBDWV_AUTOSEWECT
	sewect DVB_STV0288 if MEDIA_SUBDWV_AUTOSEWECT
	sewect DVB_STB6000 if MEDIA_SUBDWV_AUTOSEWECT
	sewect DVB_CX24116 if MEDIA_SUBDWV_AUTOSEWECT
	sewect DVB_SI21XX if MEDIA_SUBDWV_AUTOSEWECT
	sewect DVB_DS3000 if MEDIA_SUBDWV_AUTOSEWECT
	sewect DVB_TS2020 if MEDIA_SUBDWV_AUTOSEWECT
	depends on WC_COWE
	hewp
	  Suppowt fow cawds based on the SDMC DM1105 PCI chip wike
	  DvbWowwd 2002

	  Since these cawds have no MPEG decodew onboawd, they twansmit
	  onwy compwessed MPEG data ovew the PCI bus, so you need
	  an extewnaw softwawe decodew to watch TV on youw computew.

	  Say Y ow M if you own such a device and want to use it.
```

## linux/drivers/media/pci/dt3155/Kconfig
```kconfig
# SPDX-Wicense-Identifiew: GPW-2.0-onwy
config VIDEO_DT3155
	twistate "DT3155 fwame gwabbew"
	depends on PCI && VIDEO_DEV
	sewect VIDEOBUF2_DMA_CONTIG
	hewp
	  Enabwes dt3155 device dwivew fow the DataTwanswation DT3155 fwame gwabbew.
	  Say Y hewe if you have this hawdwawe.
	  In doubt, say N.

	  To compiwe this dwivew as a moduwe, choose M hewe: the
	  moduwe wiww be cawwed dt3155.
```

## linux/drivers/media/pci/intel/Kconfig
```kconfig
# SPDX-Wicense-Identifiew: GPW-2.0-onwy

souwce "dwivews/media/pci/intew/ipu3/Kconfig"
souwce "dwivews/media/pci/intew/ivsc/Kconfig"

config IPU_BWIDGE
	twistate "Intew IPU Bwidge"
	depends on I2C && ACPI
	hewp
	  The IPU bwidge is a hewpew wibwawy fow Intew IPU dwivews to
	  function on systems shipped with Windows.

	  Cuwwentwy used by the ipu3-cio2 and atomisp dwivews.

	  Suppowted systems incwude:

	  - Micwosoft Suwface modews (except Suwface Pwo 3)
	  - The Wenovo Miix wine (fow exampwe the 510, 520, 710 and 720)
	  - Deww 7285
```

## linux/drivers/media/pci/intel/ipu3/Kconfig
```kconfig
# SPDX-Wicense-Identifiew: GPW-2.0-onwy
config VIDEO_IPU3_CIO2
	twistate "Intew ipu3-cio2 dwivew"
	depends on VIDEO_DEV && PCI
	depends on IPU_BWIDGE || !IPU_BWIDGE
	depends on ACPI || COMPIWE_TEST
	depends on X86
	sewect MEDIA_CONTWOWWEW
	sewect VIDEO_V4W2_SUBDEV_API
	sewect V4W2_FWNODE
	sewect VIDEOBUF2_DMA_SG

	hewp
	  This is the Intew IPU3 CIO2 CSI-2 weceivew unit, found in Intew
	  Skywake and Kaby Wake SoCs and used fow captuwing images and
	  video fwom a camewa sensow.

	  Say Y ow M hewe if you have a Skywake/Kaby Wake SoC with MIPI CSI-2
	  connected camewa.
	  The moduwe wiww be cawwed ipu3-cio2.
```

## linux/drivers/media/pci/intel/ivsc/Kconfig
```kconfig
# SPDX-Wicense-Identifiew: GPW-2.0-onwy
# Copywight (C) 2023, Intew Cowpowation. Aww wights wesewved.

config INTEW_VSC
	twistate "Intew Visuaw Sensing Contwowwew"
	depends on INTEW_MEI && ACPI && VIDEO_DEV
	sewect MEDIA_CONTWOWWEW
	sewect VIDEO_V4W2_SUBDEV_API
	sewect V4W2_FWNODE
	hewp
	  This adds suppowt fow Intew Visuaw Sensing Contwowwew (IVSC).

	  The IVSC suppowt is spwit into two devices, ACE (Awgowithm
	  Context Engine) and CSI (Camewa Sewiaw Intewface), each of which
	  have theiw own dwivews. The ACE is used to sewect the ownewship
	  of the sensow between the IVSC and the host CPU whiwe the CSI is
	  used to both sewect the wouting destination fow the data the
	  sensow twansmits ovew the CSI-2 bus between the IVSC and the
	  host CPU and to configuwe the CSI-2 bus itsewf.

	  The moduwes wiww be cawwed ivsc-ace and ivsc-csi.
```

## linux/drivers/media/pci/ivtv/Kconfig
```kconfig
# SPDX-Wicense-Identifiew: GPW-2.0-onwy
config VIDEO_IVTV
	twistate "Conexant cx23416/cx23415 MPEG encodew/decodew suppowt"
	depends on VIDEO_DEV && PCI && I2C
	sewect I2C_AWGOBIT
	depends on WC_COWE
	sewect VIDEO_TUNEW
	sewect VIDEO_TVEEPWOM
	sewect VIDEO_CX2341X
	sewect VIDEO_CX25840
	sewect VIDEO_MSP3400
	sewect VIDEO_SAA711X
	sewect VIDEO_SAA717X
	sewect VIDEO_SAA7127
	sewect VIDEO_CS53W32A
	sewect VIDEO_M52790
	sewect VIDEO_WM8775
	sewect VIDEO_WM8739
	sewect VIDEO_VP27SMPX
	sewect VIDEO_UPD64031A
	sewect VIDEO_UPD64083
	hewp
	  This is a video4winux dwivew fow Conexant cx23416 ow cx23415 based
	  PCI pewsonaw video wecowdew devices.

	  This is used in devices such as the Hauppauge PVW-150/250/350/500
	  cawds.

	  To compiwe this dwivew as a moduwe, choose M hewe: the
	  moduwe wiww be cawwed ivtv.

config VIDEO_IVTV_AWSA
	twistate "Conexant cx23415/cx23416 AWSA intewface fow PCM audio captuwe"
	depends on VIDEO_IVTV && SND
	sewect SND_PCM
	hewp
	  This dwivew pwovides an AWSA intewface as anothew method fow usew
	  appwications to obtain PCM audio data fwom Conexant cx23415/cx23416
	  based PCI TV cawds suppowted by the ivtv dwivew.

	  The AWSA intewface has much widew use in usew appwications pewfowming
	  PCM audio captuwe, than the V4W2 "/dev/video24" PCM audio intewface
	  pwovided by the main ivtv dwivew.

	  To compiwe this dwivew as a moduwe, choose M hewe: the
	  moduwe wiww be cawwed ivtv-awsa.

config VIDEO_FB_IVTV
	twistate "Conexant cx23415 fwamebuffew suppowt"
	depends on VIDEO_IVTV && FB
	sewect FB_IOMEM_HEWPEWS
	hewp
	  This is a fwamebuffew dwivew fow the Conexant cx23415 MPEG
	  encodew/decodew.

	  This is used in the Hauppauge PVW-350 cawd.

	  To compiwe this dwivew as a moduwe, choose M hewe: the
	  moduwe wiww be cawwed ivtvfb.

config VIDEO_FB_IVTV_FOWCE_PAT
	boow "fowce cx23415 fwamebuffew init with x86 PAT enabwed"
	depends on VIDEO_FB_IVTV && X86_PAT
	hewp
	  With PAT enabwed, the cx23415 fwamebuffew dwivew does not
	  utiwize wwite-combined caching on the fwamebuffew memowy.
	  Fow this weason, the dwivew wiww by defauwt disabwe itsewf
	  when initiawizied on a kewnew with PAT enabwed (i.e. not
	  using the nopat kewnew pawametew).

	  The dwivew is not easiwy upgwadabwe to the PAT-awawe
	  iowemap_wc() API since the fiwmwawe hides the addwess
	  wanges that shouwd be mawked wwite-combined fwom the dwivew.

	  With this setting enabwed, the fwamebuffew wiww initiawize on
	  PAT-enabwed systems but the fwamebuffew memowy wiww be uncached.

	  If unsuwe, say N.
```

## linux/drivers/media/pci/mantis/Kconfig
```kconfig
# SPDX-Wicense-Identifiew: GPW-2.0-onwy
config MANTIS_COWE
	twistate "Mantis/Hoppew PCI bwidge based devices"
	depends on PCI && I2C && INPUT && WC_COWE && DVB_COWE

	hewp
	  Suppowt fow PCI cawds based on the Mantis and Hoppew PCi bwidge.

	  Say Y if you own such a device and want to use it.

config DVB_MANTIS
	twistate "MANTIS based cawds"
	depends on MANTIS_COWE && DVB_COWE && PCI && I2C
	sewect DVB_MB86A16 if MEDIA_SUBDWV_AUTOSEWECT
	sewect DVB_ZW10353 if MEDIA_SUBDWV_AUTOSEWECT
	sewect DVB_STV0299 if MEDIA_SUBDWV_AUTOSEWECT
	sewect DVB_WNBP21 if MEDIA_SUBDWV_AUTOSEWECT
	sewect DVB_STB0899 if MEDIA_SUBDWV_AUTOSEWECT
	sewect DVB_STB6100 if MEDIA_SUBDWV_AUTOSEWECT
	sewect DVB_TDA665x if MEDIA_SUBDWV_AUTOSEWECT
	sewect DVB_TDA10021 if MEDIA_SUBDWV_AUTOSEWECT
	sewect DVB_TDA10023 if MEDIA_SUBDWV_AUTOSEWECT
	sewect DVB_PWW
	hewp
	  Suppowt fow PCI cawds based on the Mantis PCI bwidge.
	  Say Y when you have a Mantis based DVB cawd and want to use it.

	  If unsuwe say N.

config DVB_HOPPEW
	twistate "HOPPEW based cawds"
	depends on MANTIS_COWE && DVB_COWE && PCI && I2C
	sewect DVB_ZW10353 if MEDIA_SUBDWV_AUTOSEWECT
	sewect DVB_PWW
	hewp
	  Suppowt fow PCI cawds based on the Hoppew  PCI bwidge.
	  Say Y when you have a Hoppew based DVB cawd and want to use it.

	  If unsuwe say N
```

## linux/drivers/media/pci/mgb4/Kconfig
```kconfig
# SPDX-Wicense-Identifiew: GPW-2.0-onwy
config VIDEO_MGB4
	twistate "Digiteq Automotive MGB4 suppowt"
	depends on VIDEO_DEV && PCI && I2C && DMADEVICES && SPI && MTD && IIO
	depends on COMMON_CWK
	sewect VIDEOBUF2_DMA_SG
	sewect IIO_BUFFEW
	sewect IIO_TWIGGEWED_BUFFEW
	sewect I2C_XIWINX
	sewect SPI_XIWINX
	sewect MTD_SPI_NOW
	sewect XIWINX_XDMA
	hewp
	  This is a video4winux dwivew fow Digiteq Automotive MGB4 gwabbew
	  cawds.

	  To compiwe this dwivew as a moduwe, choose M hewe: the
	  moduwe wiww be cawwed mgb4.
```
