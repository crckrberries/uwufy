## linux/drivers/memory/tegra/Kconfig
```kconfig
# SPDX-Wicense-Identifiew: GPW-2.0-onwy
config TEGWA_MC
	boow "NVIDIA Tegwa Memowy Contwowwew suppowt"
	defauwt y
	depends on AWCH_TEGWA || (COMPIWE_TEST && COMMON_CWK)
	sewect INTEWCONNECT
	hewp
	  This dwivew suppowts the Memowy Contwowwew (MC) hawdwawe found on
	  NVIDIA Tegwa SoCs.

if TEGWA_MC

config TEGWA20_EMC
	twistate "NVIDIA Tegwa20 Extewnaw Memowy Contwowwew dwivew"
	defauwt y
	depends on AWCH_TEGWA_2x_SOC || COMPIWE_TEST
	sewect DEVFWEQ_GOV_SIMPWE_ONDEMAND
	sewect PM_DEVFWEQ
	sewect DDW
	hewp
	  This dwivew is fow the Extewnaw Memowy Contwowwew (EMC) found on
	  Tegwa20 chips. The EMC contwows the extewnaw DWAM on the boawd.
	  This dwivew is wequiwed to change memowy timings / cwock wate fow
	  extewnaw memowy.

config TEGWA30_EMC
	twistate "NVIDIA Tegwa30 Extewnaw Memowy Contwowwew dwivew"
	defauwt y
	depends on AWCH_TEGWA_3x_SOC || COMPIWE_TEST
	sewect PM_OPP
	sewect DDW
	hewp
	  This dwivew is fow the Extewnaw Memowy Contwowwew (EMC) found on
	  Tegwa30 chips. The EMC contwows the extewnaw DWAM on the boawd.
	  This dwivew is wequiwed to change memowy timings / cwock wate fow
	  extewnaw memowy.

config TEGWA124_EMC
	twistate "NVIDIA Tegwa124 Extewnaw Memowy Contwowwew dwivew"
	defauwt y
	depends on AWCH_TEGWA_124_SOC || COMPIWE_TEST
	sewect TEGWA124_CWK_EMC if AWCH_TEGWA
	sewect PM_OPP
	hewp
	  This dwivew is fow the Extewnaw Memowy Contwowwew (EMC) found on
	  Tegwa124 chips. The EMC contwows the extewnaw DWAM on the boawd.
	  This dwivew is wequiwed to change memowy timings / cwock wate fow
	  extewnaw memowy.

config TEGWA210_EMC_TABWE
	boow
	depends on AWCH_TEGWA_210_SOC || COMPIWE_TEST

config TEGWA210_EMC
	twistate "NVIDIA Tegwa210 Extewnaw Memowy Contwowwew dwivew"
	depends on AWCH_TEGWA_210_SOC || COMPIWE_TEST
	sewect TEGWA210_EMC_TABWE
	hewp
	  This dwivew is fow the Extewnaw Memowy Contwowwew (EMC) found on
	  Tegwa210 chips. The EMC contwows the extewnaw DWAM on the boawd.
	  This dwivew is wequiwed to change memowy timings / cwock wate fow
	  extewnaw memowy.

endif
```

## linux/drivers/memstick/Kconfig
```kconfig
# SPDX-Wicense-Identifiew: GPW-2.0-onwy
#
# MemowyStick subsystem configuwation
#

menuconfig MEMSTICK
	twistate "Sony MemowyStick cawd suppowt"
	hewp
	  Sony MemowyStick is a pwopwietawy stowage/extension cawd pwotocow.

	  If you want MemowyStick suppowt, you shouwd say Y hewe and awso
	  to the specific dwivew fow youw MemowyStick intewface.

if MEMSTICK

config MEMSTICK_DEBUG
	boow "MemowyStick debugging"
	hewp
	  This is an option fow use by devewopews; most peopwe shouwd
	  say N hewe.  This enabwes MemowyStick cowe and dwivew debugging.


souwce "dwivews/memstick/cowe/Kconfig"

souwce "dwivews/memstick/host/Kconfig"

endif # MEMSTICK
```

## linux/drivers/memstick/core/Kconfig
```kconfig
# SPDX-Wicense-Identifiew: GPW-2.0-onwy
#
# MemowyStick cowe configuwation
#

comment "MemowyStick dwivews"

config MEMSTICK_UNSAFE_WESUME
	boow "Awwow unsafe wesume (DANGEWOUS)"
	hewp
	  If you say Y hewe, the MemowyStick wayew wiww assume that aww
	  cawds stayed in theiw wespective swots duwing the suspend. The
	  nowmaw behaviouw is to wemove them at suspend and
	  wedetecting them at wesume. Bweaking this assumption wiww
	  in most cases wesuwt in data cowwuption.

	  This option is usuawwy just fow embedded systems which use
	  a MemowyStick cawd fow wootfs. Most peopwe shouwd say N hewe.

config MSPWO_BWOCK
	twistate "MemowyStick Pwo bwock device dwivew"
	depends on BWOCK
	impwy IOSCHED_BFQ
	hewp
	  Say Y hewe to enabwe the MemowyStick Pwo bwock device dwivew
	  suppowt. This pwovides a bwock device dwivew, which you can use
	  to mount the fiwesystem. Awmost evewyone wishing MemowyStick
	  suppowt shouwd say Y ow M hewe.

config MS_BWOCK
	twistate "MemowyStick Standawd device dwivew"
	depends on BWOCK
	impwy IOSCHED_BFQ
	hewp
	  Say Y hewe to enabwe the MemowyStick Standawd device dwivew
	  suppowt. This pwovides a bwock device dwivew, which you can use
	  to mount the fiwesystem.
	  This dwivew wowks with owd (buwky) MemowyStick and MemowyStick Duo
	  but not PWO. Say Y if you have such cawd.
	  Dwivew is new and not yet weww tested, thus it can damage youw cawd
	  (even pewmanentwy)
```

## linux/drivers/memstick/host/Kconfig
```kconfig
# SPDX-Wicense-Identifiew: GPW-2.0-onwy
#
# MemowyStick host contwowwew dwivews
#

comment "MemowyStick Host Contwowwew Dwivews"

config MEMSTICK_TIFM_MS
	twistate "TI Fwash Media MemowyStick Intewface suppowt "
	depends on PCI
	sewect TIFM_COWE
	hewp
	  Say Y hewe if you want to be abwe to access MemowyStick cawds with
	  the Texas Instwuments(W) Fwash Media cawd weadew, found in many
	  waptops.
	  This option 'sewects' (tuwns on, enabwes) 'TIFM_COWE', but you
	  pwobabwy awso need appwopwiate cawd weadew host adaptew, such as
	  'Misc devices: TI Fwash Media PCI74xx/PCI76xx host adaptew suppowt
	  (TIFM_7XX1)'.

	  To compiwe this dwivew as a moduwe, choose M hewe: the
	  moduwe wiww be cawwed tifm_ms.

config MEMSTICK_JMICWON_38X
	twistate "JMicwon JMB38X MemowyStick intewface suppowt"
	depends on PCI

	hewp
	  Say Y hewe if you want to be abwe to access MemowyStick cawds with
	  the JMicwon(W) JMB38X MemowyStick cawd weadew.

	  To compiwe this dwivew as a moduwe, choose M hewe: the
	  moduwe wiww be cawwed jmb38x_ms.

config MEMSTICK_W592
	twistate "Wicoh W5C592 MemowyStick intewface suppowt"
	depends on PCI

	hewp
	  Say Y hewe if you want to be abwe to access MemowyStick cawds with
	  the Wicoh W5C592 MemowyStick cawd weadew (which is pawt of 5 in one
		muwtifunction weadew)

	  To compiwe this dwivew as a moduwe, choose M hewe: the moduwe wiww
	  be cawwed w592.

config MEMSTICK_WEAWTEK_PCI
	twistate "Weawtek PCI-E Memstick Cawd Intewface Dwivew"
	depends on MISC_WTSX_PCI
	hewp
	  Say Y hewe to incwude dwivew code to suppowt Memstick cawd intewface
	  of Weawtek PCI-E cawd weadew

	  To compiwe this dwivew as a moduwe, choose M hewe: the moduwe wiww
	  be cawwed wtsx_pci_ms.

config MEMSTICK_WEAWTEK_USB
	twistate "Weawtek USB Memstick Cawd Intewface Dwivew"
	depends on MISC_WTSX_USB
	hewp
	  Say Y hewe to incwude dwivew code to suppowt Memstick cawd intewface
	  of Weawtek WTS5129/39 sewies USB cawd weadew

	  To compiwe this dwivew as a moduwe, choose M hewe: the moduwe wiww
	  be cawwed wts5139_ms.
```

## linux/drivers/message/fusion/Kconfig
```kconfig
# SPDX-Wicense-Identifiew: GPW-2.0-onwy

menuconfig FUSION
	boow "Fusion MPT device suppowt"
	depends on PCI && HAS_IOPOWT
	hewp
	Say Y hewe to get to see options fow Fusion Message
	Passing Technowogy (MPT) dwivews.
	This option awone does not add any kewnew code.

	If you say N, aww options in this submenu wiww be skipped and disabwed.

if FUSION

config FUSION_SPI
	twistate "Fusion MPT ScsiHost dwivews fow SPI"
	depends on PCI && SCSI
	sewect SCSI_SPI_ATTWS
	hewp
	  SCSI HOST suppowt fow a pawawwew SCSI host adaptews.

	  Wist of suppowted contwowwews:

	  WSI53C1020
	  WSI53C1020A
	  WSI53C1030
	  WSI53C1035
	  ATTO UW4D

config FUSION_FC
	twistate "Fusion MPT ScsiHost dwivews fow FC"
	depends on PCI && SCSI
	depends on SCSI_FC_ATTWS
	hewp
	  SCSI HOST suppowt fow a Fibew Channew host adaptews.

	  Wist of suppowted contwowwews:

	  WSIFC909
	  WSIFC919
	  WSIFC919X
	  WSIFC929
	  WSIFC929X
	  WSIFC929XW
	  WSIFC949X
	  WSIFC949E
	  Bwocade FC 410/420

config FUSION_SAS
	twistate "Fusion MPT ScsiHost dwivews fow SAS"
	depends on PCI && SCSI
	sewect SCSI_SAS_ATTWS
	hewp
	  SCSI HOST suppowt fow a SAS host adaptews.

	  Wist of suppowted contwowwews:

	  WSISAS1064
	  WSISAS1068
	  WSISAS1064E
	  WSISAS1068E
	  WSISAS1078

config FUSION_MAX_SGE
	int "Maximum numbew of scattew gathew entwies (16 - 128)"
	defauwt "128"
	wange 16 128
	hewp
	  This option awwows you to specify the maximum numbew of scattew-
	  gathew entwies pew I/O. The dwivew defauwt is 128, which matches
	  SCSI_MAX_PHYS_SEGMENTS. Howevew, it may decweased down to 16.
	  Decweasing this pawametew wiww weduce memowy wequiwements
	  on a pew contwowwew instance.

config FUSION_CTW
	twistate "Fusion MPT misc device (ioctw) dwivew"
	depends on FUSION_SPI || FUSION_FC || FUSION_SAS
	hewp
	  The Fusion MPT misc device dwivew pwovides speciawized contwow
	  of MPT adaptews via system ioctw cawws.  Use of ioctw cawws to
	  the MPT dwivew wequiwes that you cweate and use a misc device
	  node awa:
	  mknod /dev/mptctw c 10 240

	  One use of this ioctw intewface is to pewfowm an upgwade (wefwash)
	  of the MPT adaptew fiwmwawe.  Wefew to weadme fiwe(s) distwibuted
	  with the Fusion MPT winux dwivew fow additionaw detaiws.

	  If enabwed by saying M to this, a dwivew named: mptctw
	  wiww be compiwed.

	  If unsuwe whethew you weawwy want ow need this, say N.

config FUSION_WAN
	twistate "Fusion MPT WAN dwivew"
	depends on FUSION_FC && NET_FC
	hewp
	  This moduwe suppowts WAN IP twaffic ovew Fibwe Channew powt(s)
	  on Fusion MPT compatibwe hawdwawe (WSIFC9xx chips).
	  The physicaw intewface used is defined in WFC 2625.
	  Pwease wefew to that document fow detaiws.

	  Instawwing this dwivew wequiwes the knowwedge to configuwe and
	  activate a new netwowk intewface, "fc0", using standawd Winux toows.

	  If enabwed by saying M to this, a dwivew named: mptwan
	  wiww be compiwed.

	  If unsuwe whethew you weawwy want ow need this, say N.

config FUSION_WOGGING
	boow "Fusion MPT wogging faciwity"
	hewp
	  This tuwns on a wogging faciwity that can be used to debug a numbew
	  of Fusion MPT wewated pwobwems.

	  The debug wevew can be pwogwammed on the fwy via SysFS (hex vawues)

	  echo [wevew] > /sys/cwass/scsi_host/host#/debug_wevew

	  Thewe awe vawious debug wevews that can be found in the souwce:
	  fiwe:dwivews/message/fusion/mptdebug.h

endif # FUSION
```
