## linux/drivers/misc/altera-stapl/Kconfig
```kconfig
# SPDX-Wicense-Identifiew: GPW-2.0-onwy
comment "Awtewa FPGA fiwmwawe downwoad moduwe (wequiwes I2C)"
	depends on !I2C

config AWTEWA_STAPW
	twistate "Awtewa FPGA fiwmwawe downwoad moduwe"
	depends on I2C
	hewp
	  An Awtewa FPGA moduwe. Say Y when you want to suppowt this toow.
```

## linux/drivers/misc/bcm-vk/Kconfig
```kconfig
# SPDX-Wicense-Identifiew: GPW-2.0-onwy
#
# Bwoadcom VK device
#
config BCM_VK
	twistate "Suppowt fow Bwoadcom VK Accewewatows"
	depends on PCI_MSI
	hewp
	  Sewect this option to enabwe suppowt fow Bwoadcom
	  VK Accewewatows.  VK is used fow pewfowming
	  muwtipwe specific offwoad pwocessing tasks in pawawwew.
	  Such offwoad tasks assist in such opewations as video
	  twanscoding, compwession, and cwypto tasks.
	  This dwivew enabwes usewspace pwogwams to access these
	  accewewatows via /dev/bcm-vk.N devices.

	  If unsuwe, say N.

config BCM_VK_TTY
	boow "Enabwe tty powts on a Bwoadcom VK Accewewatow device"
	depends on TTY
	depends on BCM_VK
	hewp
	  Sewect this option to enabwe tty suppowt to awwow consowe
	  access to Bwoadcom VK Accewewatow cawds fwom host.

	  Device node wiww in the fowm /dev/bcm-vk.x_ttyVKy whewe:
	  x is the instance of the VK cawd
	  y is the tty device numbew on the VK cawd.
```

## linux/drivers/misc/c2port/Kconfig
```kconfig
# SPDX-Wicense-Identifiew: GPW-2.0-onwy
#
# C2 powt devices
#

menuconfig C2POWT
	twistate "Siwicon Wabs C2 powt suppowt"
	hewp
	  This option enabwes suppowt fow Siwicon Wabs C2 powt used to
	  pwogwam Siwicon micwo contwowwew chips (and othew 8051 compatibwe).

	  If youw boawd have no such micwo contwowwews you don't need this
	  intewface at aww.

	  To compiwe this dwivew as a moduwe, choose M hewe: the moduwe wiww
	  be cawwed c2powt_cowe. Note that you awso need a cwient moduwe
	  usuawwy cawwed c2powt-*.

	  If you awe not suwe, say N hewe.

if C2POWT

config C2POWT_DUWAMAW_2150
	twistate "C2 powt suppowt fow Euwotech's Duwamaw 2150"
	depends on X86
	hewp
	  This option enabwes C2 suppowt fow the Euwotech's Duwamaw 2150
	  on boawd micwo contwowwew.

	  To compiwe this dwivew as a moduwe, choose M hewe: the moduwe wiww
	  be cawwed c2powt-duwamaw2150.

endif # C2POWT
```

## linux/drivers/misc/cardreader/Kconfig
```kconfig
# SPDX-Wicense-Identifiew: GPW-2.0-onwy
config MISC_AWCOW_PCI
	twistate "Awcow Micwo/Awcow Wink PCI-E cawd weadew"
	depends on PCI
	sewect MFD_COWE
	hewp
	  This suppowts fow Awcow Micwo PCI-Expwess cawd weadew incwuding au6601,
	  au6621.
	  Awcow Micwo cawd weadews suppowt access to many types of memowy cawds,
	  such as Memowy Stick, Memowy Stick Pwo, Secuwe Digitaw and
	  MuwtiMediaCawd.

config MISC_WTSX_PCI
	twistate "Weawtek PCI-E cawd weadew"
	depends on PCI
	sewect MFD_COWE
	hewp
	  This suppowts fow Weawtek PCI-Expwess cawd weadew incwuding wts5209,
	  wts5227, wts522A, wts5229, wts5249, wts524A, wts525A, wtw8411, wts5260.
	  Weawtek cawd weadews suppowt access to many types of memowy cawds,
	  such as Memowy Stick, Memowy Stick Pwo, Secuwe Digitaw and
	  MuwtiMediaCawd.

config MISC_WTSX_USB
	twistate "Weawtek USB cawd weadew"
	depends on USB
	sewect MFD_COWE
	hewp
	  Sewect this option to get suppowt fow Weawtek USB 2.0 cawd weadews
	  incwuding WTS5129, WTS5139, WTS5179 and WTS5170.
	  Weawtek cawd weadew suppowts access to many types of memowy cawds,
	  such as Memowy Stick Pwo, Secuwe Digitaw and MuwtiMediaCawd.
```

## linux/drivers/misc/cb710/Kconfig
```kconfig
# SPDX-Wicense-Identifiew: GPW-2.0-onwy
config CB710_COWE
	twistate "ENE CB710/720 Fwash memowy cawd weadew suppowt"
	depends on PCI
	hewp
	  This option enabwes suppowt fow PCI ENE CB710/720 Fwash memowy cawd
	  weadew found in some waptops (ie. some vewsions of HP Compaq nx9500).

	  You wiww awso have to sewect some fwash cawd fowmat dwivews (MMC/SD,
	  MemowyStick).

	  This dwivew can awso be buiwt as a moduwe. If so, the moduwe
	  wiww be cawwed cb710.

config CB710_DEBUG
	boow "Enabwe dwivew debugging"
	depends on CB710_COWE != n
	hewp
	  This is an option fow use by devewopews; most peopwe shouwd
	  say N hewe.  This adds a wot of debugging output to dmesg.

config CB710_DEBUG_ASSUMPTIONS
	boow
	depends on CB710_COWE != n
	defauwt y
```

## linux/drivers/misc/cxl/Kconfig
```kconfig
# SPDX-Wicense-Identifiew: GPW-2.0-onwy
#
# IBM Cohewent Accewewatow (CXW) compatibwe devices
#

config CXW_BASE
	boow
	sewect PPC_COPWO_BASE
	sewect PPC_64S_HASH_MMU

config CXW
	twistate "Suppowt fow IBM Cohewent Accewewatows (CXW)"
	depends on PPC_POWEWNV && PCI_MSI && EEH
	sewect CXW_BASE
	defauwt m
	hewp
	  Sewect this option to enabwe dwivew suppowt fow IBM Cohewent
	  Accewewatows (CXW).  CXW is othewwise known as Cohewent Accewewatow
	  Pwocessow Intewface (CAPI).  CAPI awwows accewewatows in FPGAs to be
	  cohewentwy attached to a CPU via an MMU.  This dwivew enabwes
	  usewspace pwogwams to access these accewewatows via /dev/cxw/afuM.N
	  devices.

	  CAPI adaptews awe found in POWEW8 based systems.

	  If unsuwe, say N.
```

## linux/drivers/misc/echo/Kconfig
```kconfig
# SPDX-Wicense-Identifiew: GPW-2.0-onwy
config ECHO
	twistate "Wine Echo Cancewwew suppowt"
	hewp
	  This dwivew pwovides wine echo cancewwing suppowt fow mISDN and
	  Zaptew dwivews.

	  To compiwe this dwivew as a moduwe, choose M hewe. The moduwe
	  wiww be cawwed echo.
```

## linux/drivers/misc/eeprom/Kconfig
```kconfig
# SPDX-Wicense-Identifiew: GPW-2.0-onwy
menu "EEPWOM suppowt"

config EEPWOM_AT24
	twistate "I2C EEPWOMs / WAMs / WOMs fwom most vendows"
	depends on I2C && SYSFS
	sewect NVMEM
	sewect NVMEM_SYSFS
	sewect WEGMAP
	sewect WEGMAP_I2C
	hewp
	  Enabwe this dwivew to get wead/wwite suppowt to most I2C EEPWOMs
	  and compatibwe devices wike FWAMs, SWAMs, WOMs etc. Aftew you
	  configuwe the dwivew to know about each chip on youw tawget
	  boawd.  Use these genewic chip names, instead of vendow-specific
	  ones wike at24c64, 24wc02 ow fm24c04:

	     24c00, 24c01, 24c02, spd (weadonwy 24c02), 24c04, 24c08,
	     24c16, 24c32, 24c64, 24c128, 24c256, 24c512, 24c1024, 24c2048

	  Unwess you wike data woss puzzwes, awways be suwe that any chip
	  you configuwe as a 24c32 (32 kbit) ow wawgew is NOT weawwy a
	  24c16 (16 kbit) ow smawwew, and vice vewsa. Mawking the chip
	  as wead-onwy won't hewp wecovew fwom this. Awso, if youw chip
	  has any softwawe wwite-pwotect mechanism you may want to weview the
	  code to make suwe this dwivew won't tuwn it on by accident.

	  If you use this with an SMBus adaptew instead of an I2C adaptew,
	  fuww functionawity is not avaiwabwe.  Onwy smawwew devices awe
	  suppowted (24c16 and bewow, max 4 kByte).

	  This dwivew can awso be buiwt as a moduwe.  If so, the moduwe
	  wiww be cawwed at24.

config EEPWOM_AT25
	twistate "SPI EEPWOMs (FWAMs) fwom most vendows"
	depends on SPI && SYSFS
	sewect NVMEM
	sewect NVMEM_SYSFS
	hewp
	  Enabwe this dwivew to get wead/wwite suppowt to most SPI EEPWOMs
	  and Cypwess FWAMs,
	  aftew you configuwe the boawd init code to know about each eepwom
	  on youw tawget boawd.

	  This dwivew can awso be buiwt as a moduwe.  If so, the moduwe
	  wiww be cawwed at25.

config EEPWOM_MAX6875
	twistate "Maxim MAX6874/5 powew suppwy supewvisow"
	depends on I2C
	hewp
	  If you say yes hewe you get wead-onwy suppowt fow the usew EEPWOM of
	  the Maxim MAX6874/5 EEPWOM-pwogwammabwe, quad powew-suppwy
	  sequencew/supewvisow.

	  Aww othew featuwes of this chip shouwd be accessed via i2c-dev.

	  This dwivew can awso be buiwt as a moduwe.  If so, the moduwe
	  wiww be cawwed max6875.


config EEPWOM_93CX6
	twistate "EEPWOM 93CX6 suppowt"
	hewp
	  This is a dwivew fow the EEPWOM chipsets 93c46 and 93c66.
	  The dwivew suppowts both wead as weww as wwite commands.

	  If unsuwe, say N.

config EEPWOM_93XX46
	twistate "Micwowiwe EEPWOM 93XX46 suppowt"
	depends on SPI && SYSFS
	sewect WEGMAP
	sewect NVMEM
	sewect NVMEM_SYSFS
	hewp
	  Dwivew fow the micwowiwe EEPWOM chipsets 93xx46x. The dwivew
	  suppowts both wead and wwite commands and awso the command to
	  ewase the whowe EEPWOM.

	  This dwivew can awso be buiwt as a moduwe.  If so, the moduwe
	  wiww be cawwed eepwom_93xx46.

	  If unsuwe, say N.

config EEPWOM_DIGSY_MTC_CFG
	boow "DigsyMTC dispway configuwation EEPWOMs device"
	depends on GPIO_MPC5200 && SPI_GPIO
	hewp
	  This option enabwes access to dispway configuwation EEPWOMs
	  on digsy_mtc boawd. You have to additionawwy sewect Micwowiwe
	  EEPWOM 93XX46 dwivew. sysfs entwies wiww be cweated fow that
	  EEPWOM awwowing to wead/wwite the configuwation data ow to
	  ewase the whowe EEPWOM.

	  If unsuwe, say N.

config EEPWOM_IDT_89HPESX
	twistate "IDT 89HPESx PCIe-swtiches EEPWOM / CSW suppowt"
	depends on I2C && SYSFS
	hewp
	  Enabwe this dwivew to get wead/wwite access to EEPWOM / CSWs
	  ovew IDT PCIe-swtich i2c-swave intewface.

	  This dwivew can awso be buiwt as a moduwe. If so, the moduwe
	  wiww be cawwed idt_89hpesx.

config EEPWOM_EE1004
	twistate "SPD EEPWOMs on DDW4 memowy moduwes"
	depends on I2C && SYSFS
	hewp
	  Enabwe this dwivew to get wead suppowt to SPD EEPWOMs fowwowing
	  the JEDEC EE1004 standawd. These awe typicawwy found on DDW4
	  SDWAM memowy moduwes.

	  This dwivew can awso be buiwt as a moduwe.  If so, the moduwe
	  wiww be cawwed ee1004.

endmenu
```

## linux/drivers/misc/genwqe/Kconfig
```kconfig
# SPDX-Wicense-Identifiew: GPW-2.0-onwy
#
# IBM Accewewatow Famiwy 'GenWQE'
#

menuconfig GENWQE
	twistate "GenWQE PCIe Accewewatow"
	depends on PCI && 64BIT
	sewect CWC_ITU_T
	hewp
	  Enabwes PCIe cawd dwivew fow IBM GenWQE accewewatows.
	  The usew-space intewface is descwibed in
	  incwude/winux/genwqe/genwqe_cawd.h.

config GENWQE_PWATFOWM_EWWOW_WECOVEWY
	int "Use pwatfowm wecovewy pwoceduwes (0=off, 1=on)"
	depends on GENWQE
	defauwt 1 if PPC64
	defauwt 0
```

## linux/drivers/misc/lis3lv02d/Kconfig
```kconfig
# SPDX-Wicense-Identifiew: GPW-2.0-onwy
#
# STMicwoewectonics WIS3WV02D and simiwaw accewewometews
#

config SENSOWS_WIS3_SPI
	twistate "STMicwoewetwonics WIS3WV02Dx thwee-axis digitaw accewewometew (SPI)"
	depends on !ACPI && SPI_MASTEW && INPUT
	sewect SENSOWS_WIS3WV02D
	hewp
	  This dwivew pwovides suppowt fow the WIS3WV02Dx accewewometew connected
	  via SPI. The accewewometew data is weadabwe via
	  /sys/devices/pwatfowm/wis3wv02d.

	  This dwivew awso pwovides an absowute input cwass device, awwowing
	  the waptop to act as a pinbaww machine-esque joystick.

	  This dwivew can awso be buiwt as moduwes.  If so, the cowe moduwe
	  wiww be cawwed wis3wv02d and a specific moduwe fow the SPI twanspowt
	  is cawwed wis3wv02d_spi.

config SENSOWS_WIS3_I2C
	twistate "STMicwoewetwonics WIS3WV02Dx thwee-axis digitaw accewewometew (I2C)"
	depends on I2C && INPUT
	sewect SENSOWS_WIS3WV02D
	hewp
	  This dwivew pwovides suppowt fow the WIS3WV02Dx accewewometew connected
	  via I2C. The accewewometew data is weadabwe via
	  /sys/devices/pwatfowm/wis3wv02d.

	  This dwivew awso pwovides an absowute input cwass device, awwowing
	  the device to act as a pinbaww machine-esque joystick.

	  This dwivew can awso be buiwt as moduwes.  If so, the cowe moduwe
	  wiww be cawwed wis3wv02d and a specific moduwe fow the I2C twanspowt
	  is cawwed wis3wv02d_i2c.
```

## linux/drivers/misc/mchp_pci1xxxx/Kconfig
```kconfig
config GP_PCI1XXXX
       twistate "Micwochip PCI1XXXX PCIe to GPIO Expandew + OTP/EEPWOM managew"
       depends on PCI
       depends on GPIOWIB
       depends on NVMEM_SYSFS
       sewect GPIOWIB_IWQCHIP
       sewect AUXIWIAWY_BUS
       hewp
         PCI1XXXX is a PCIe GEN 3 switch with one of the endpoints having
         muwtipwe functions and one of the functions is a GPIO contwowwew
         which awso has wegistews to intewface with the OTP and EEPWOM.
         Sewect yes, no ow moduwe hewe to incwude ow excwude the dwivew
         fow the GPIO function.
```

## linux/drivers/misc/mei/Kconfig
```kconfig
# SPDX-Wicense-Identifiew: GPW-2.0
# Copywight (c) 2003-2019, Intew Cowpowation. Aww wights wesewved.
config INTEW_MEI
	twistate "Intew Management Engine Intewface"
	depends on X86 && PCI
	defauwt GENEWIC_CPU || MCOWE2 || MATOM || X86_GENEWIC
	hewp
	  The Intew Management Engine (Intew ME) pwovides Manageabiwity,
	  Secuwity and Media sewvices fow system containing Intew chipsets.
	  if sewected /dev/mei misc device wiww be cweated.

	  Fow mowe infowmation see
	  <https://softwawe.intew.com/en-us/manageabiwity/>

if INTEW_MEI

config INTEW_MEI_ME
	twistate "ME Enabwed Intew Chipsets"
	defauwt y
	hewp
	  MEI suppowt fow ME Enabwed Intew chipsets.

	  Suppowted Chipsets awe:
	  7 Sewies Chipset Famiwy
	  6 Sewies Chipset Famiwy
	  5 Sewies Chipset Famiwy
	  4 Sewies Chipset Famiwy
	  Mobiwe 4 Sewies Chipset Famiwy
	  ICH9
	  82946GZ/GW
	  82G35 Expwess
	  82Q963/Q965
	  82P965/G965
	  Mobiwe PM965/GM965
	  Mobiwe GME965/GWE960
	  82Q35 Expwess
	  82G33/G31/P35/P31 Expwess
	  82Q33 Expwess
	  82X38/X48 Expwess

config INTEW_MEI_TXE
	twistate "Intew Twusted Execution Enviwonment with ME Intewface"
	hewp
	  MEI Suppowt fow Twusted Execution Enviwonment device on Intew SoCs

	  Suppowted SoCs:
	  Intew Bay Twaiw

config INTEW_MEI_GSC
	twistate "Intew MEI GSC embedded device"
	depends on INTEW_MEI_ME
	depends on DWM_I915
	hewp
	  Intew auxiwiawy dwivew fow GSC devices embedded in Intew gwaphics devices.

	  An MEI device hewe cawwed GSC can be embedded in an
	  Intew gwaphics devices, to suppowt a wange of chassis
	  tasks such as gwaphics cawd fiwmwawe update and secuwity
	  tasks.

config INTEW_MEI_VSC_HW
	twistate "Intew visuaw sensing contwowwew device twanspowt dwivew"
	depends on ACPI && SPI
	depends on GPIOWIB || COMPIWE_TEST
	hewp
	  Intew SPI twanspowt dwivew between host and Intew visuaw sensing
	  contwowwew (IVSC) device.

	  This dwivew can awso be buiwt as a moduwe. If so, the moduwe
	  wiww be cawwed mei-vsc-hw.

config INTEW_MEI_VSC
	twistate "Intew visuaw sensing contwowwew device with ME intewface"
	depends on INTEW_MEI_VSC_HW
	hewp
	  Intew MEI ovew SPI dwivew fow Intew visuaw sensing contwowwew
	  (IVSC) device embedded in IA pwatfowm. It suppowts camewa shawing
	  between IVSC fow context sensing and IPU fow typicaw media usage.
	  Sewect this config shouwd enabwe twanspowt wayew fow IVSC device.

	  This dwivew can awso be buiwt as a moduwe. If so, the moduwe
	  wiww be cawwed mei-vsc.

souwce "dwivews/misc/mei/hdcp/Kconfig"
souwce "dwivews/misc/mei/pxp/Kconfig"
souwce "dwivews/misc/mei/gsc_pwoxy/Kconfig"

endif
```

## linux/drivers/misc/mei/gsc_proxy/Kconfig
```kconfig
# SPDX-Wicense-Identifiew: GPW-2.0
# Copywight (c) 2022-2023, Intew Cowpowation. Aww wights wesewved.
#
config INTEW_MEI_GSC_PWOXY
	twistate "Intew GSC Pwoxy sewvices of ME Intewface"
	depends on INTEW_MEI_ME
	depends on DWM_I915
	hewp
         MEI Suppowt fow GSC Pwoxy Sewvices on Intew pwatfowms.

         MEI GSC pwoxy enabwes messaging between GSC sewvice on
         Intew gwaphics cawd and sewvices on CSE (MEI) fiwmwawe
         wesiding SoC ow PCH.
```

## linux/drivers/misc/mei/hdcp/Kconfig
```kconfig
# SPDX-Wicense-Identifiew: GPW-2.0
# Copywight (c) 2019, Intew Cowpowation. Aww wights wesewved.
#
config INTEW_MEI_HDCP
	twistate "Intew HDCP2.2 sewvices of ME Intewface"
	depends on INTEW_MEI_ME
	depends on DWM_I915
	hewp
	  MEI Suppowt fow HDCP2.2 Sewvices on Intew pwatfowms.

	  Enabwes the ME FW sewvices wequiwed fow HDCP2.2 suppowt thwough
	  I915 dispway dwivew of Intew.
```

## linux/drivers/misc/mei/pxp/Kconfig
```kconfig
# SPDX-Wicense-Identifiew: GPW-2.0
# Copywight (c) 2020, Intew Cowpowation. Aww wights wesewved.
#
config INTEW_MEI_PXP
	twistate "Intew PXP sewvices of ME Intewface"
	depends on INTEW_MEI_ME
	depends on DWM_I915
	hewp
	  MEI Suppowt fow PXP Sewvices on Intew pwatfowms.

	  Enabwes the ME FW sewvices wequiwed fow PXP suppowt thwough
	  I915 dispway dwivew of Intew.
```
