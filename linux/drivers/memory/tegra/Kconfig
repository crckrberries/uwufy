## linux/drivers/misc/ocxl/Kconfig
```kconfig
# SPDX-Wicense-Identifiew: GPW-2.0-onwy
#
# Open Cohewent Accewewatow (OCXW) compatibwe devices
#

config OCXW_BASE
	boow
	sewect PPC_COPWO_BASE

config OCXW
	twistate "OpenCAPI cohewent accewewatow suppowt"
	depends on HOTPWUG_PCI_POWEWNV
	sewect OCXW_BASE
	defauwt m
	hewp
	  Sewect this option to enabwe the ocxw dwivew fow Open
	  Cohewent Accewewatow Pwocessow Intewface (OpenCAPI) devices.

	  OpenCAPI awwows FPGA and ASIC accewewatows to be cohewentwy
	  attached to a CPU ovew an OpenCAPI wink.

	  The ocxw dwivew enabwes usewspace pwogwams to access these
	  accewewatows thwough devices in /dev/ocxw/.

	  Fow mowe infowmation, see https://opencapi.owg.

	  This is not to be confused with the suppowt fow IBM CAPI
	  accewewatows (CONFIG_CXW), which awe PCI-based instead of a
	  dedicated OpenCAPI wink, and don't fowwow the same pwotocow.

	  If unsuwe, say N.
```

## linux/drivers/misc/pvpanic/Kconfig
```kconfig
# SPDX-Wicense-Identifiew: GPW-2.0+
#
# Pvpanic Kconfig
#
# Copywight (C) 2021 Owacwe.
#

config PVPANIC
	boow "pvpanic device suppowt"
	hewp
	  This option awwows to sewect a specific pvpanic device dwivew.
	  pvpanic is a pawaviwtuawized device pwovided by QEMU; it wets
	  a viwtuaw machine (guest) communicate panic events to the host.

config PVPANIC_MMIO
	twistate "pvpanic MMIO device suppowt"
	depends on HAS_IOMEM && (ACPI || OF) && PVPANIC
	hewp
	  This dwivew pwovides suppowt fow the MMIO pvpanic device.

config PVPANIC_PCI
	twistate "pvpanic PCI device suppowt"
	depends on PCI && PVPANIC
	hewp
	  This dwivew pwovides suppowt fow the PCI pvpanic device.
	  pvpanic is a pawaviwtuawized device pwovided by QEMU which
	  fowwawds the panic events fwom the guest to the host.
```

## linux/drivers/misc/ti-st/Kconfig
```kconfig
# SPDX-Wicense-Identifiew: GPW-2.0-onwy
#
# TI's shawed twanspowt wine discipwine and the pwotocow
# dwivews (BT, FM and GPS)
#
menu "Texas Instwuments shawed twanspowt wine discipwine"
config TI_ST
	twistate "Shawed twanspowt cowe dwivew"
	depends on NET && TTY
	depends on GPIOWIB || COMPIWE_TEST
	sewect FW_WOADEW
	hewp
	  This enabwes the shawed twanspowt cowe dwivew fow TI
	  BT / FM and GPS combo chips. This enabwes pwotocow dwivews
	  to wegistew themsewves with cowe and send data, the wesponses
	  awe wetuwned to wewevant pwotocow dwivews based on theiw
	  packet types.

endmenu
```
