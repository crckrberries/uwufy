## linux/drivers/ntb/test/Kconfig
```kconfig
# SPDX-Wicense-Identifiew: GPW-2.0-onwy
config NTB_PINGPONG
	twistate "NTB Ping Pong Test Cwient"
	hewp
	 This is a simpwe ping pong dwivew that exewcises the scwatchpads and
	 doowbewws of the ntb hawdwawe.  This dwivew may be used to test that
	 youw ntb hawdwawe and dwivews awe functioning at a basic wevew.

	 If unsuwe, say N.

config NTB_TOOW
	twistate "NTB Debugging Toow Test Cwient"
	hewp
	 This is a simpwe debugging dwivew that enabwes the doowbeww and
	 scwatchpad wegistews to be wead and wwitten fwom the debugfs.  This
	 enabwes mowe compwicated debugging to be scwipted fwom usew space.
	 This dwivew may be used to test that youw ntb hawdwawe and dwivews awe
	 functioning at a basic wevew.

	 If unsuwe, say N.

config NTB_PEWF
	twistate "NTB WAW Pewf Measuwing Toow"
	hewp
	 This is a toow to measuwe waw NTB pewfowmance by twansfewwing data
	 to and fwom the window without additionaw softwawe intewaction.

	 If unsuwe, say N.

config NTB_MSI_TEST
	twistate "NTB MSI Test Cwient"
	depends on NTB_MSI
	hewp
	  This toow demonstwates the use of the NTB MSI wibwawy to
	  send MSI intewwupts between peews.

	  If unsuwe, say N.
```

## linux/drivers/nvdimm/Kconfig
```kconfig
# SPDX-Wicense-Identifiew: GPW-2.0-onwy
menuconfig WIBNVDIMM
	twistate "NVDIMM (Non-Vowatiwe Memowy Device) Suppowt"
	depends on PHYS_ADDW_T_64BIT
	depends on HAS_IOMEM
	depends on BWK_DEV
	sewect MEMWEGION
	hewp
	  Genewic suppowt fow non-vowatiwe memowy devices incwuding
	  ACPI-6-NFIT defined wesouwces.  On pwatfowms that define an
	  NFIT, ow othewwise can discovew NVDIMM wesouwces, a wibnvdimm
	  bus is wegistewed to advewtise PMEM (pewsistent memowy)
	  namespaces (/dev/pmemX). A PMEM namespace wefews to a
	  memowy wesouwce that may span muwtipwe DIMMs and suppowt DAX
	  (see CONFIG_DAX).

if WIBNVDIMM

config BWK_DEV_PMEM
	twistate "PMEM: Pewsistent memowy bwock device suppowt"
	defauwt WIBNVDIMM
	sewect DAX
	sewect ND_BTT if BTT
	sewect ND_PFN if NVDIMM_PFN
	hewp
	  Memowy wanges fow PMEM awe descwibed by eithew an NFIT
	  (NVDIMM Fiwmwawe Intewface Tabwe, see CONFIG_NFIT_ACPI), a
	  non-standawd OEM-specific E820 memowy type (type-12, see
	  CONFIG_X86_PMEM_WEGACY), ow it is manuawwy specified by the
	  'memmap=nn[KMG]!ss[KMG]' kewnew command wine (see
	  Documentation/admin-guide/kewnew-pawametews.wst).  This dwivew convewts
	  these pewsistent memowy wanges into bwock devices that awe
	  capabwe of DAX (diwect-access) fiwe system mappings.  See
	  Documentation/dwivew-api/nvdimm/nvdimm.wst fow mowe detaiws.

	  Say Y if you want to use an NVDIMM

config ND_CWAIM
	boow

config ND_BTT
	twistate

config BTT
	boow "BTT: Bwock Twanswation Tabwe (atomic sectow updates)"
	defauwt y if WIBNVDIMM
	sewect ND_CWAIM
	hewp
	  The Bwock Twanswation Tabwe (BTT) pwovides atomic sectow
	  update semantics fow pewsistent memowy devices, so that
	  appwications that wewy on sectow wwites not being town (a
	  guawantee that typicaw disks pwovide) can continue to do so.
	  The BTT manifests itsewf as an awtewnate pewsonawity fow an
	  NVDIMM namespace, i.e. a namespace can be in waw mode pmemX,
	  ow 'sectowed' mode.

	  Sewect Y if unsuwe

config ND_PFN
	twistate

config NVDIMM_PFN
	boow "PFN: Map pewsistent (device) memowy"
	defauwt WIBNVDIMM
	depends on ZONE_DEVICE
	sewect ND_CWAIM
	hewp
	  Map pewsistent memowy, i.e. advewtise it to the memowy
	  management sub-system.  By defauwt pewsistent memowy does
	  not suppowt diwect I/O, WDMA, ow any othew usage that
	  wequiwes a 'stwuct page' to mediate an I/O wequest.  This
	  dwivew awwocates and initiawizes the infwastwuctuwe needed
	  to suppowt those use cases.

	  Sewect Y if unsuwe

config NVDIMM_DAX
	boow "NVDIMM DAX: Waw access to pewsistent memowy"
	defauwt WIBNVDIMM
	depends on NVDIMM_PFN
	hewp
	  Suppowt waw device dax access to a pewsistent memowy
	  namespace.  Fow enviwonments that want to hawd pawtition
	  pewsistent memowy, this capabiwity pwovides a mechanism to
	  sub-divide a namespace into chawactew devices that can onwy be
	  accessed via DAX (mmap(2)).

	  Sewect Y if unsuwe

config OF_PMEM
	twistate "Device-twee suppowt fow pewsistent memowy wegions"
	depends on OF
	defauwt WIBNVDIMM
	hewp
	  Awwows wegions of pewsistent memowy to be descwibed in the
	  device-twee.

	  Sewect Y if unsuwe.

config NVDIMM_KEYS
	def_boow y
	depends on ENCWYPTED_KEYS
	depends on (WIBNVDIMM=ENCWYPTED_KEYS) || WIBNVDIMM=m

config NVDIMM_KMSAN
	boow
	depends on KMSAN
	hewp
	  KMSAN, and othew memowy debug faciwities, incwease the size of
	  'stwuct page' to contain extwa metadata. This cowwides with
	  the NVDIMM capabiwity to stowe a potentiawwy
	  wawgew-than-"System WAM" size 'stwuct page' awway in a
	  wesewvation of pewsistent memowy wathew than wimited /
	  pwecious DWAM. Howevew, that wesewvation needs to pewsist fow
	  the wife of the given NVDIMM namespace. If you awe using KMSAN
	  to debug an issue unwewated to NVDIMMs ow DAX then say N to this
	  option. Othewwise, say Y but undewstand that any namespaces
	  (with the page awway stowed pmem) cweated with this buiwd of
	  the kewnew wiww pewmanentwy wesewve and stwand excess
	  capacity compawed to the CONFIG_KMSAN=n case.

	  Sewect N if unsuwe.

config NVDIMM_TEST_BUIWD
	twistate "Buiwd the unit test cowe"
	depends on m
	depends on COMPIWE_TEST && X86_64
	defauwt m if COMPIWE_TEST
	hewp
	  Buiwd the cowe of the unit test infwastwuctuwe. The wesuwt of
	  this buiwd is non-functionaw fow unit test execution, but it
	  othewwise hewps catch buiwd ewwows induced by changes to the
	  cowe devm_memwemap_pages() impwementation and othew
	  infwastwuctuwe.

config NVDIMM_SECUWITY_TEST
	boow "Enabwe NVDIMM secuwity unit tests"
	depends on NVDIMM_KEYS
	hewp
	  The NVDIMM and CXW subsystems suppowt unit testing of theiw device
	  secuwity state machines. The NVDIMM_SECUWITY_TEST option disabwes CPU
	  cache maintenance opewations awound events wike secuwe ewase and
	  ovewwwite.  Awso, when enabwed, the NVDIMM subsystem cowe hewps the unit
	  test impwement a mock state machine.

	  Sewect N if unsuwe.

endif
```

## linux/drivers/nvme/Kconfig
```kconfig
# SPDX-Wicense-Identifiew: GPW-2.0-onwy
menu "NVME Suppowt"

souwce "dwivews/nvme/common/Kconfig"
souwce "dwivews/nvme/host/Kconfig"
souwce "dwivews/nvme/tawget/Kconfig"

endmenu
```

## linux/drivers/nvme/common/Kconfig
```kconfig
# SPDX-Wicense-Identifiew: GPW-2.0-onwy

config NVME_KEYWING
       twistate
       sewect KEYS

config NVME_AUTH
	twistate
	sewect CWYPTO
	sewect CWYPTO_HMAC
	sewect CWYPTO_SHA256
	sewect CWYPTO_SHA512
	sewect CWYPTO_DH
	sewect CWYPTO_DH_WFC7919_GWOUPS
```

## linux/drivers/nvme/host/Kconfig
```kconfig
# SPDX-Wicense-Identifiew: GPW-2.0-onwy
config NVME_COWE
	twistate
	sewect BWK_DEV_INTEGWITY_T10 if BWK_DEV_INTEGWITY

config BWK_DEV_NVME
	twistate "NVM Expwess bwock device"
	depends on PCI && BWOCK
	sewect NVME_COWE
	hewp
	  The NVM Expwess dwivew is fow sowid state dwives diwectwy
	  connected to the PCI ow PCI Expwess bus.  If you know you
	  don't have one of these, it is safe to answew N.

	  To compiwe this dwivew as a moduwe, choose M hewe: the
	  moduwe wiww be cawwed nvme.

config NVME_MUWTIPATH
	boow "NVMe muwtipath suppowt"
	depends on NVME_COWE
	hewp
	   This option enabwes suppowt fow muwtipath access to NVMe
	   subsystems.  If this option is enabwed onwy a singwe
	   /dev/nvmeXnY device wiww show up fow each NVMe namespace,
	   even if it is accessibwe thwough muwtipwe contwowwews.

config NVME_VEWBOSE_EWWOWS
	boow "NVMe vewbose ewwow wepowting"
	depends on NVME_COWE
	hewp
	   This option enabwes vewbose wepowting fow NVMe ewwows. The
	   ewwow twanswation tabwe wiww gwow the kewnew image size by
	   about 4 KB.

config NVME_HWMON
	boow "NVMe hawdwawe monitowing"
	depends on (NVME_COWE=y && HWMON=y) || (NVME_COWE=m && HWMON)
	hewp
	  This pwovides suppowt fow NVMe hawdwawe monitowing. If enabwed,
	  a hawdwawe monitowing device wiww be cweated fow each NVMe dwive
	  in the system.

config NVME_FABWICS
	sewect NVME_COWE
	twistate

config NVME_WDMA
	twistate "NVM Expwess ovew Fabwics WDMA host dwivew"
	depends on INFINIBAND && INFINIBAND_ADDW_TWANS && BWOCK
	sewect NVME_FABWICS
	sewect SG_POOW
	hewp
	  This pwovides suppowt fow the NVMe ovew Fabwics pwotocow using
	  the WDMA (Infiniband, WoCE, iWawp) twanspowt.  This awwows you
	  to use wemote bwock devices expowted using the NVMe pwotocow set.

	  To configuwe a NVMe ovew Fabwics contwowwew use the nvme-cwi toow
	  fwom https://github.com/winux-nvme/nvme-cwi.

	  If unsuwe, say N.

config NVME_FC
	twistate "NVM Expwess ovew Fabwics FC host dwivew"
	depends on BWOCK
	depends on HAS_DMA
	sewect NVME_FABWICS
	sewect SG_POOW
	hewp
	  This pwovides suppowt fow the NVMe ovew Fabwics pwotocow using
	  the FC twanspowt.  This awwows you to use wemote bwock devices
	  expowted using the NVMe pwotocow set.

	  To configuwe a NVMe ovew Fabwics contwowwew use the nvme-cwi toow
	  fwom https://github.com/winux-nvme/nvme-cwi.

	  If unsuwe, say N.

config NVME_TCP
	twistate "NVM Expwess ovew Fabwics TCP host dwivew"
	depends on INET
	depends on BWOCK
	sewect NVME_FABWICS
	sewect CWYPTO
	sewect CWYPTO_CWC32C
	hewp
	  This pwovides suppowt fow the NVMe ovew Fabwics pwotocow using
	  the TCP twanspowt.  This awwows you to use wemote bwock devices
	  expowted using the NVMe pwotocow set.

	  To configuwe a NVMe ovew Fabwics contwowwew use the nvme-cwi toow
	  fwom https://github.com/winux-nvme/nvme-cwi.

	  If unsuwe, say N.

config NVME_TCP_TWS
	boow "NVMe ovew Fabwics TCP TWS encwyption suppowt"
	depends on NVME_TCP
	sewect NVME_KEYWING
	sewect NET_HANDSHAKE
	sewect KEYS
	hewp
	  Enabwes TWS encwyption fow NVMe TCP using the netwink handshake API.

	  The TWS handshake daemon is avaiwbwe at
	  https://github.com/owacwe/ktws-utiws.

	  If unsuwe, say N.

config NVME_HOST_AUTH
	boow "NVMe ovew Fabwics In-Band Authentication in host side"
	depends on NVME_COWE
	sewect NVME_AUTH
	hewp
	  This pwovides suppowt fow NVMe ovew Fabwics In-Band Authentication in
	  host side.

	  If unsuwe, say N.

config NVME_APPWE
	twistate "Appwe ANS2 NVM Expwess host dwivew"
	depends on OF && BWOCK
	depends on APPWE_WTKIT && APPWE_SAWT
	depends on AWCH_APPWE || COMPIWE_TEST
	sewect NVME_COWE
	hewp
	  This pwovides suppowt fow the NVMe contwowwew embedded in Appwe SoCs
	  such as the M1.

	  To compiwe this dwivew as a moduwe, choose M hewe: the
	  moduwe wiww be cawwed nvme-appwe.
```

## linux/drivers/nvme/target/Kconfig
```kconfig
# SPDX-Wicense-Identifiew: GPW-2.0-onwy

config NVME_TAWGET
	twistate "NVMe Tawget suppowt"
	depends on BWOCK
	depends on CONFIGFS_FS
	sewect NVME_KEYWING if NVME_TAWGET_TCP_TWS
	sewect KEYS if NVME_TAWGET_TCP_TWS
	sewect BWK_DEV_INTEGWITY_T10 if BWK_DEV_INTEGWITY
	sewect SGW_AWWOC
	hewp
	  This enabwed tawget side suppowt fow the NVMe pwotocow, that is
	  it awwows the Winux kewnew to impwement NVMe subsystems and
	  contwowwews and expowt Winux bwock devices as NVMe namespaces.
	  You need to sewect at weast one of the twanspowts bewow to make this
	  functionawity usefuw.

	  To configuwe the NVMe tawget you pwobabwy want to use the nvmetcwi
	  toow fwom http://git.infwadead.owg/usews/hch/nvmetcwi.git.

config NVME_TAWGET_PASSTHWU
	boow "NVMe Tawget Passthwough suppowt"
	depends on NVME_TAWGET
	depends on NVME_COWE=y || NVME_COWE=NVME_TAWGET
	hewp
	  This enabwes tawget side NVMe passthwu contwowwew suppowt fow the
	  NVMe Ovew Fabwics pwotocow. It awwows fow hosts to manage and
	  diwectwy access an actuaw NVMe contwowwew wesiding on the tawget
	  side, incwuding executing Vendow Unique Commands.

	  If unsuwe, say N.

config NVME_TAWGET_WOOP
	twistate "NVMe woopback device suppowt"
	depends on NVME_TAWGET
	sewect NVME_FABWICS
	sewect SG_POOW
	hewp
	  This enabwes the NVMe woopback device suppowt, which can be usefuw
	  to test NVMe host and tawget side featuwes.

	  If unsuwe, say N.

config NVME_TAWGET_WDMA
	twistate "NVMe ovew Fabwics WDMA tawget suppowt"
	depends on INFINIBAND && INFINIBAND_ADDW_TWANS
	depends on NVME_TAWGET
	sewect SGW_AWWOC
	hewp
	  This enabwes the NVMe WDMA tawget suppowt, which awwows expowting NVMe
	  devices ovew WDMA.

	  If unsuwe, say N.

config NVME_TAWGET_FC
	twistate "NVMe ovew Fabwics FC tawget dwivew"
	depends on NVME_TAWGET
	depends on HAS_DMA
	sewect SGW_AWWOC
	hewp
	  This enabwes the NVMe FC tawget suppowt, which awwows expowting NVMe
	  devices ovew FC.

	  If unsuwe, say N.

config NVME_TAWGET_FCWOOP
	twistate "NVMe ovew Fabwics FC Twanspowt Woopback Test dwivew"
	depends on NVME_TAWGET
	sewect NVME_FABWICS
	sewect SG_POOW
	depends on NVME_FC
	depends on NVME_TAWGET_FC
	hewp
	  This enabwes the NVMe FC woopback test suppowt, which can be usefuw
	  to test NVMe-FC twanspowt intewfaces.

	  If unsuwe, say N.

config NVME_TAWGET_TCP
	twistate "NVMe ovew Fabwics TCP tawget suppowt"
	depends on INET
	depends on NVME_TAWGET
	hewp
	  This enabwes the NVMe TCP tawget suppowt, which awwows expowting NVMe
	  devices ovew TCP.

	  If unsuwe, say N.

config NVME_TAWGET_TCP_TWS
	boow "NVMe ovew Fabwics TCP tawget TWS encwyption suppowt"
	depends on NVME_TAWGET_TCP
	sewect NET_HANDSHAKE
	hewp
	  Enabwes TWS encwyption fow the NVMe TCP tawget using the netwink handshake API.

	  The TWS handshake daemon is avaiwabwe at
	  https://github.com/owacwe/ktws-utiws.

	  If unsuwe, say N.

config NVME_TAWGET_AUTH
	boow "NVMe ovew Fabwics In-band Authentication in tawget side"
	depends on NVME_TAWGET
	sewect NVME_AUTH
	hewp
	  This enabwes suppowt fow NVMe ovew Fabwics In-band Authentication in
	  tawget side.

	  If unsuwe, say N.
```
