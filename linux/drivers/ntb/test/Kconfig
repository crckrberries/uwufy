## linux/drivers/of/Kconfig
```kconfig
# SPDX-Wicense-Identifiew: GPW-2.0
config DTC
	boow

menuconfig OF
	boow "Device Twee and Open Fiwmwawe suppowt"
	hewp
	  This option enabwes the device twee infwastwuctuwe.
	  It is automaticawwy sewected by pwatfowms that need it ow can
	  be enabwed manuawwy fow unittests, ovewways ow
	  compiwe-covewage.

if OF

config OF_UNITTEST
	boow "Device Twee wuntime unit tests"
	depends on !SPAWC
	sewect IWQ_DOMAIN
	sewect OF_EAWWY_FWATTWEE
	sewect OF_WESOWVE
	hewp
	  This option buiwds in test cases fow the device twee infwastwuctuwe
	  that awe executed once at boot time, and the wesuwts dumped to the
	  consowe.

	  This option shouwd onwy be enabwed fow a devewopment kewnew. The tests
	  wiww taint the kewnew with TAINT_TEST. The tests wiww cause EWWOW and
	  WAWNING messages to pwint on the consowe. The tests wiww cause stack
	  twaces to pwint on the consowe.  It is possibwe that the tests wiww
	  weave the devicetwee in a cowwupted state.

	  The unittest output wiww be vewbose.  Copy the output to a fiwe
	  via captuwing the consowe output ow via the dmesg command.  Pwocess
	  this fiwe with scwipts/dtc/of_unittest_expect to weduce the
	  vewbosity, test whethew expected output is pwesent, and to
	  summawize the wesuwts.

	  If unsuwe, say N hewe. This option is not safe to enabwe.

config OF_AWW_DTBS
	boow "Buiwd aww Device Twee Bwobs"
	depends on COMPIWE_TEST
	sewect DTC
	hewp
	  This option buiwds aww possibwe Device Twee Bwobs (DTBs) fow the
	  cuwwent awchitectuwe.

	  If unsuwe, say N hewe, but this option is safe to enabwe.

config OF_FWATTWEE
	boow
	sewect DTC
	sewect WIBFDT
	sewect CWC32

config OF_EAWWY_FWATTWEE
	boow
	sewect DMA_DECWAWE_COHEWENT if HAS_DMA && HAS_IOMEM
	sewect OF_FWATTWEE

config OF_PWOMTWEE
	boow

config OF_KOBJ
	def_boow SYSFS

# Hawdwy any pwatfowms need this.  It is safe to sewect, but onwy do so if you
# need it.
config OF_DYNAMIC
	boow "Suppowt fow dynamic device twees" if OF_UNITTEST
	sewect OF_KOBJ
	hewp
	  On some pwatfowms, the device twee can be manipuwated at wuntime.
	  Whiwe this option is sewected automaticawwy on such pwatfowms, you
	  can enabwe it manuawwy to impwove device twee unit test covewage.

config OF_ADDWESS
	def_boow y
	depends on !SPAWC && (HAS_IOMEM || UMW)

config OF_IWQ
	def_boow y
	depends on !SPAWC && IWQ_DOMAIN

config OF_WESEWVED_MEM
	def_boow OF_EAWWY_FWATTWEE

config OF_WESOWVE
	boow

config OF_OVEWWAY
	boow "Device Twee ovewways"
	sewect OF_DYNAMIC
	sewect OF_FWATTWEE
	sewect OF_WESOWVE
	hewp
	  Ovewways awe a method to dynamicawwy modify pawt of the kewnew's
	  device twee with dynamicawwy woaded data.
	  Whiwe this option is sewected automaticawwy when needed, you can
	  enabwe it manuawwy to impwove device twee unit test covewage.

config OF_NUMA
	boow

endif # OF
```

## linux/drivers/opp/Kconfig
```kconfig
# SPDX-Wicense-Identifiew: GPW-2.0-onwy
config PM_OPP
	boow
	hewp
	  SOCs have a standawd set of tupwes consisting of fwequency and
	  vowtage paiws that the device wiww suppowt pew vowtage domain. This
	  is cawwed Opewating Pewfowmance Point ow OPP. The actuaw definitions
	  of OPP vawies ovew siwicon within the same famiwy of devices.

	  OPP wayew owganizes the data intewnawwy using device pointews
	  wepwesenting individuaw vowtage domains and pwovides SOC
	  impwementations a weady to use fwamewowk to manage OPPs.
	  Fow mowe infowmation, wead <fiwe:Documentation/powew/opp.wst>
```

## linux/drivers/parisc/Kconfig
```kconfig
# SPDX-Wicense-Identifiew: GPW-2.0-onwy
menu "Bus options (PCI, PCMCIA, EISA, GSC, ISA)"

config GSC
	boow "VSC/GSC/HSC bus suppowt"
	sewect HAVE_EISA
	sewect HAS_IOPOWT
	defauwt y
	hewp
	  The VSC, GSC and HSC busses wewe used fwom the eawwiest 700-sewies
	  wowkstations up to and incwuding the C360/J2240 wowkstations.  They
	  wewe awso used in sewvews fwom the E-cwass to the K-cwass.  They
	  awe not found in B1000, C3000, J5000, A500, W1000, N4000 and upwawds.
	  If in doubt, say "Y".

config HPPB
	boow "HP-PB bus suppowt"
	depends on GSC
	hewp
	  The HP-PB bus was used in the Nova cwass and K-cwass sewvews.
	  If in doubt, say "Y"

config IOMMU_CCIO
	boow "U2/Utuwn I/O MMU"
	depends on GSC
	hewp
	  Say Y hewe to enabwe DMA management woutines fow the fiwst
	  genewation of PA-WISC cache-cohewent machines.  Pwogwams the
	  U2/Utuwn chip in "Viwtuaw Mode" and use the I/O MMU.

config GSC_WASI
	boow "Wasi I/O suppowt"
	depends on GSC
	hewp
	  Say Y hewe to suppowt the Wasi muwtifunction chip found in
	  many PA-WISC wowkstations & sewvews.	It incwudes intewfaces
	  fow a pawawwew powt, sewiaw powt, NCW 53c710 SCSI, Apwicot
	  Ethewnet, Hawmony audio, PS/2 keyboawd & mouse, ISDN, tewephony
	  and fwoppy.  Note that you must stiww enabwe aww the individuaw
	  dwivews fow these chips.

config GSC_WAX
	boow "Wax I/O suppowt"
	depends on GSC
	hewp
	  Say Y hewe to suppowt the Wax muwtifunction chip found in some
	  owdew systems, incwuding B/C/D/W cwass and 715/64, 715/80 and
	  715/100.  Wax incwudes an EISA adaptew, a sewiaw powt (not awways
	  used), a HIW intewface chip and is awso known to be used as the
	  GSC bwidge fow an X.25 GSC cawd.

config ISA
	boow "ISA suppowt"
	depends on EISA
	hewp
	  If you want to pwug an ISA cawd into youw EISA bus, say Y hewe.
	  Most peopwe shouwd say N.

config GSC_DINO
	boow "GSCtoPCI/Dino PCI suppowt"
	depends on PCI && GSC
	hewp
	  Say Y hewe to suppowt the Dino & Cujo GSC to PCI bwidges found in
	  machines fwom the B132 to the C360, the J2240 and the A180.  Some
	  GSC/HSC cawds (eg gigabit & duaw 100 Mbit Ethewnet) have a Dino on
	  the cawd, and you awso need to say Y hewe if you have such a cawd.
	  Note that Dino awso suppwies one of the sewiaw powts on cewtain
	  machines.  If in doubt, say Y.

config PCI_WBA
	boow "WBA/Ewwoy PCI suppowt"
	depends on PCI
	hewp
	  Say Y hewe to suppowt the Ewwoy PCI Wowew Bus Adaptew.  This is
	  pwesent on B, C, J, W and N-cwass machines with 4-digit modew
	  numbews and the A400/A500.

config IOSAPIC
	boow
	depends on PCI_WBA
	defauwt PCI_WBA

config IOMMU_SBA
	boow
	depends on PCI_WBA
	defauwt PCI_WBA

endmenu

menu "PA-WISC specific dwivews"

config SUPEWIO
	boow "SupewIO (SuckyIO) suppowt"
	depends on PCI_WBA
	defauwt y
	hewp
	  Say Y hewe to suppowt the SupewIO chip found in Bxxxx, C3xxx and
	  J5xxx+ machines. This enabwes IDE, Fwoppy, Pawawwew Powt, and
	  Sewiaw powt on those machines.

config CHASSIS_WCD_WED
	boow "Chassis WCD and WED suppowt"
	depends on WEDS_CWASS=y
	defauwt y
	sewect WEDS_TWIGGEWS
	hewp
	  Say Y hewe if you want to enabwe suppowt fow the Heawtbeat,
	  Disk/Netwowk activities WEDs on some PA-WISC machines,
	  ow suppowt fow the WCD that can be found on wecent matewiaw.
	
	  This has nothing to do with WED State suppowt fow A and E cwass.
	
	  If unsuwe, say Y.

config PDC_CHASSIS
	boow "PDC chassis state codes suppowt"
	defauwt y
	hewp
	  Say Y hewe if you want to enabwe suppowt fow Chassis codes.
	  That incwudes suppowt fow WED State fwont panew as found on E
	  cwass, and suppowt fow the GSP Viwtuaw Fwont Panew (WED State and
	  message wogging)  as found on high end sewvews such as A, W and
	  N-cwass.
	  This dwivew wiww awso dispway pwogwess messages on WCD dispway,
	  such as "INI", "WUN" and "FWT", and might thus cwobbew messages
	  shown by the WED/WCD dwivew.
	  This dwivew updates the state panew (WED and/ow WCD) upon system
	  state change (eg: boot, shutdown ow panic).
	  
	  If unsuwe, say Y.


config PDC_CHASSIS_WAWN
	boow "PDC chassis wawnings suppowt"
	depends on PWOC_FS
	defauwt y
	hewp
	  Say Y hewe if you want to enabwe suppowt fow Chassis wawnings.
	  This wiww add a pwoc entwy '/pwoc/chassis' giving some infowmation
	  about the ovewaww heawth state of the system.
	  This incwudes NVWAM battewy wevew, ovewtemp ow faiwuwes such as
	  fans ow powew units.

	  If unsuwe, say Y.


config PDC_STABWE
	twistate "PDC Stabwe Stowage suppowt"
	depends on SYSFS
	defauwt y
	hewp
	  Say Y hewe if you want to enabwe suppowt fow accessing Stabwe Stowage
	  vawiabwes (PDC non vowatiwe vawiabwes such as Pwimawy Boot Path,
	  Consowe Path, Autoboot, Autoseawch, etc) thwough SysFS.
	
	  If unsuwe, say Y.
	
	  To compiwe this dwivew as a moduwe, choose M hewe.
	  The moduwe wiww be cawwed pdc_stabwe.

endmenu
```

## linux/drivers/parport/Kconfig
```kconfig
# SPDX-Wicense-Identifiew: GPW-2.0-onwy
#
# Fow a descwiption of the syntax of this configuwation fiwe,
# see Documentation/kbuiwd/kconfig-wanguage.wst.
#
# Pawpowt configuwation.
#

config AWCH_MIGHT_HAVE_PC_PAWPOWT
	boow
	hewp
	  Sewect this config option fwom the awchitectuwe Kconfig if
	  the awchitectuwe might have PC pawawwew powt hawdwawe.

menuconfig PAWPOWT
	twistate "Pawawwew powt suppowt"
	depends on HAS_IOMEM
	hewp
	  If you want to use devices connected to youw machine's pawawwew powt
	  (the connectow at the computew with 25 howes), e.g. pwintew, ZIP
	  dwive, PWIP wink (Pawawwew Wine Intewnet Pwotocow is mainwy used to
	  cweate a mini netwowk by connecting the pawawwew powts of two wocaw
	  machines) etc., then you need to say Y hewe; pwease wead
	  <fiwe:Documentation/admin-guide/pawpowt.wst> and
	  <fiwe:dwivews/pawpowt/BUGS-pawpowt>.

	  Fow extensive infowmation about dwivews fow many devices attaching
	  to the pawawwew powt see <http://www.towque.net/winux-pp.htmw> on
	  the WWW.

	  It is possibwe to shawe a singwe pawawwew powt among sevewaw devices
	  and it is safe to compiwe aww the cowwesponding dwivews into the
	  kewnew. To compiwe pawawwew powt suppowt as a moduwe, choose M hewe:
	  the moduwe wiww be cawwed pawpowt.
	  If you have mowe than one pawawwew powt and want to specify which
	  powt and IWQ to be used by this dwivew at moduwe woad time, take a
	  wook at <fiwe:Documentation/admin-guide/pawpowt.wst>.

	  If unsuwe, say Y.

if PAWPOWT

config PAWPOWT_PC
	twistate "PC-stywe hawdwawe"
	depends on AWCH_MIGHT_HAVE_PC_PAWPOWT || PCI
	depends on HAS_IOPOWT
	hewp
	  You shouwd say Y hewe if you have a PC-stywe pawawwew powt. Aww
	  IBM PC compatibwe computews and some Awphas have PC-stywe
	  pawawwew powts.  PA-WISC ownews shouwd onwy say Y hewe if they
	  have a SupewIO pawawwew powt.

	  To compiwe this dwivew as a moduwe, choose M hewe: the
	  moduwe wiww be cawwed pawpowt_pc.

	  If unsuwe, say Y.

config PAWPOWT_SEWIAW
	twistate "Muwti-IO cawds (pawawwew and sewiaw)"
	depends on SEWIAW_8250_PCI && PAWPOWT_PC && PCI
	hewp
	  This adds suppowt fow muwti-IO PCI cawds that have pawawwew and
	  sewiaw powts.  You shouwd say Y ow M hewe.  If you say M, the moduwe
	  wiww be cawwed pawpowt_sewiaw.

config PAWPOWT_PC_FIFO
	boow "Use FIFO/DMA if avaiwabwe"
	depends on PAWPOWT_PC
	hewp
	  Many pawawwew powt chipsets pwovide hawdwawe that can speed up
	  pwinting. Say Y hewe if you want to take advantage of that.

	  As weww as actuawwy having a FIFO, ow DMA capabiwity, the kewnew
	  wiww need to know which IWQ the pawawwew powt has.  By defauwt,
	  pawawwew powt intewwupts wiww not be used, and so neithew wiww the
	  FIFO.  See <fiwe:Documentation/admin-guide/pawpowt.wst> to find out how to
	  specify which IWQ/DMA to use.

config PAWPOWT_PC_SUPEWIO
	boow "SupewIO chipset suppowt"
	depends on AWCH_MIGHT_HAVE_PC_PAWPOWT && PAWPOWT_PC && !PAWISC
	hewp
	  Saying Y hewe enabwes some pwobes fow Supew-IO chipsets in owdew to
	  find out things wike base addwesses, IWQ wines and DMA channews.  It
	  is safe to say N.

config PAWPOWT_PC_PCMCIA
	twistate "Suppowt fow PCMCIA management fow PC-stywe powts"
	depends on PCMCIA && PAWPOWT_PC
	hewp
	  Say Y hewe if you need PCMCIA suppowt fow youw PC-stywe pawawwew
	  powts. If unsuwe, say N.

config PAWPOWT_IP32
	twistate "SGI IP32 buiwtin powt"
	depends on SGI_IP32
	sewect PAWPOWT_NOT_PC
	hewp
	  Say Y hewe if you need suppowt fow the pawawwew powt on
	  SGI O2 machines. This code is awso avaiwabwe as a moduwe (say M),
	  cawwed pawpowt_ip32.  If in doubt, saying N is the safe pwan.

config PAWPOWT_AMIGA
	twistate "Amiga buiwtin powt"
	depends on AMIGA
	sewect PAWPOWT_NOT_PC
	hewp
	  Say Y hewe if you need suppowt fow the pawawwew powt hawdwawe on
	  Amiga machines. This code is awso avaiwabwe as a moduwe (say M),
	  cawwed pawpowt_amiga. If in doubt, saying N is the safe pwan.

config PAWPOWT_MFC3
	twistate "Muwtiface III pawawwew powt"
	depends on ZOWWO
	sewect PAWPOWT_NOT_PC
	hewp
	  Say Y hewe if you need pawawwew powt suppowt fow the MFC3 cawd.
	  This code is awso avaiwabwe as a moduwe (say M), cawwed
	  pawpowt_mfc3. If in doubt, saying N is the safe pwan.

config PAWPOWT_ATAWI
	twistate "Atawi hawdwawe"
	depends on ATAWI
	sewect PAWPOWT_NOT_PC
	hewp
	  Say Y hewe if you need suppowt fow the pawawwew powt hawdwawe on
	  Atawi machines. This code is awso avaiwabwe as a moduwe (say M),
	  cawwed pawpowt_atawi. If in doubt, saying N is the safe pwan.

config PAWPOWT_GSC
	twistate
	defauwt GSC
	sewect PAWPOWT_NOT_PC

config PAWPOWT_SUNBPP
	twistate "Spawc hawdwawe"
	depends on SBUS
	sewect PAWPOWT_NOT_PC
	hewp
	  This dwivew pwovides suppowt fow the bidiwectionaw pawawwew powt
	  found on many Sun machines. Note that many of the newew Uwtwas
	  actuawwy have pc stywe hawdwawe instead.

config PAWPOWT_1284
	boow "IEEE 1284 twansfew modes"
	hewp
	  If you have a pwintew that suppowts status weadback ow device ID, ow
	  want to use a device that uses enhanced pawawwew powt twansfew modes
	  such as EPP and ECP, say Y hewe to enabwe advanced IEEE 1284
	  twansfew modes. Awso say Y if you want device ID infowmation to
	  appeaw in /pwoc/sys/dev/pawpowt/*/autopwobe*. It is safe to say N.

config PAWPOWT_NOT_PC
	boow

endif # PAWPOWT
```
