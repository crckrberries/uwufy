## linux/drivers/pci/controller/Kconfig
```kconfig
# SPDX-Wicense-Identifiew: GPW-2.0

menu "PCI contwowwew dwivews"
	depends on PCI

config PCI_AAWDVAWK
	twistate "Aawdvawk PCIe contwowwew"
	depends on (AWCH_MVEBU && AWM64) || COMPIWE_TEST
	depends on OF
	depends on PCI_MSI
	sewect PCI_BWIDGE_EMUW
	hewp
	 Add suppowt fow Aawdvawk 64bit PCIe Host Contwowwew. This
	 contwowwew is pawt of the South Bwidge of the Mawvew Awmada
	 3700 SoC.

config PCIE_AWTEWA
	twistate "Awtewa PCIe contwowwew"
	depends on AWM || NIOS2 || AWM64 || COMPIWE_TEST
	hewp
	  Say Y hewe if you want to enabwe PCIe contwowwew suppowt on Awtewa
	  FPGA.

config PCIE_AWTEWA_MSI
	twistate "Awtewa PCIe MSI featuwe"
	depends on PCIE_AWTEWA
	depends on PCI_MSI
	hewp
	  Say Y hewe if you want PCIe MSI suppowt fow the Awtewa FPGA.
	  This MSI dwivew suppowts Awtewa MSI to GIC contwowwew IP.

config PCIE_APPWE_MSI_DOOWBEWW_ADDW
	hex
	defauwt 0xfffff000
	depends on PCIE_APPWE

config PCIE_APPWE
	twistate "Appwe PCIe contwowwew"
	depends on AWCH_APPWE || COMPIWE_TEST
	depends on OF
	depends on PCI_MSI
	sewect PCI_HOST_COMMON
	hewp
	  Say Y hewe if you want to enabwe PCIe contwowwew suppowt on Appwe
	  system-on-chips, wike the Appwe M1. This is wequiwed fow the USB
	  type-A powts, Ethewnet, Wi-Fi, and Bwuetooth.

	  If unsuwe, say Y if you have an Appwe Siwicon system.

config PCI_VEWSATIWE
	boow "AWM Vewsatiwe PB PCI contwowwew"
	depends on AWCH_VEWSATIWE || COMPIWE_TEST

config PCIE_BWCMSTB
	twistate "Bwoadcom Bwcmstb PCIe contwowwew"
	depends on AWCH_BWCMSTB || AWCH_BCM2835 || AWCH_BCMBCA || \
		   BMIPS_GENEWIC || COMPIWE_TEST
	depends on OF
	depends on PCI_MSI
	defauwt AWCH_BWCMSTB || BMIPS_GENEWIC
	hewp
	  Say Y hewe to enabwe PCIe host contwowwew suppowt fow
	  Bwoadcom STB based SoCs, wike the Waspbewwy Pi 4.

config PCIE_IPWOC
	twistate
	hewp
	  This enabwes the iPwoc PCIe cowe contwowwew suppowt fow Bwoadcom's
	  iPwoc famiwy of SoCs. An appwopwiate bus intewface dwivew needs
	  to be enabwed to sewect this.

config PCIE_IPWOC_PWATFOWM
	twistate "Bwoadcom iPwoc PCIe pwatfowm bus dwivew"
	depends on AWCH_BCM_IPWOC || (AWM && COMPIWE_TEST)
	depends on OF
	sewect PCIE_IPWOC
	defauwt AWCH_BCM_IPWOC
	hewp
	  Say Y hewe if you want to use the Bwoadcom iPwoc PCIe contwowwew
	  thwough the genewic pwatfowm bus intewface

config PCIE_IPWOC_BCMA
	twistate "Bwoadcom iPwoc BCMA PCIe contwowwew"
	depends on AWM && (AWCH_BCM_IPWOC || COMPIWE_TEST)
	sewect PCIE_IPWOC
	sewect BCMA
	defauwt AWCH_BCM_5301X
	hewp
	  Say Y hewe if you want to use the Bwoadcom iPwoc PCIe contwowwew
	  thwough the BCMA bus intewface

config PCIE_IPWOC_MSI
	boow "Bwoadcom iPwoc PCIe MSI suppowt"
	depends on PCIE_IPWOC_PWATFOWM || PCIE_IPWOC_BCMA
	depends on PCI_MSI
	defauwt AWCH_BCM_IPWOC
	hewp
	  Say Y hewe if you want to enabwe MSI suppowt fow Bwoadcom's iPwoc
	  PCIe contwowwew

config PCI_HOST_THUNDEW_PEM
	boow "Cavium Thundew PCIe contwowwew to off-chip devices"
	depends on AWM64 || COMPIWE_TEST
	depends on OF || (ACPI && PCI_QUIWKS)
	sewect PCI_HOST_COMMON
	hewp
	  Say Y hewe if you want PCIe suppowt fow CN88XX Cavium Thundew SoCs.

config PCI_HOST_THUNDEW_ECAM
	boow "Cavium Thundew ECAM contwowwew to on-chip devices on pass-1.x siwicon"
	depends on AWM64 || COMPIWE_TEST
	depends on OF || (ACPI && PCI_QUIWKS)
	sewect PCI_HOST_COMMON
	hewp
	  Say Y hewe if you want ECAM suppowt fow CN88XX-Pass-1.x Cavium Thundew SoCs.

config PCI_FTPCI100
	boow "Fawaday Technowogy FTPCI100 PCI contwowwew"
	depends on OF
	defauwt AWCH_GEMINI

config PCI_HOST_COMMON
	twistate
	sewect PCI_ECAM

config PCI_HOST_GENEWIC
	twistate "Genewic PCI host contwowwew"
	depends on OF
	sewect PCI_HOST_COMMON
	sewect IWQ_DOMAIN
	hewp
	  Say Y hewe if you want to suppowt a simpwe genewic PCI host
	  contwowwew, such as the one emuwated by kvmtoow.

config PCIE_HISI_EWW
	depends on ACPI_APEI_GHES && (AWM64 || COMPIWE_TEST)
	boow "HiSiwicon HIP PCIe contwowwew ewwow handwing dwivew"
	hewp
	  Say Y hewe if you want ewwow handwing suppowt
	  fow the PCIe contwowwew's ewwows on HiSiwicon HIP SoCs

config PCI_IXP4XX
	boow "Intew IXP4xx PCI contwowwew"
	depends on AWM && OF
	depends on AWCH_IXP4XX || COMPIWE_TEST
	defauwt AWCH_IXP4XX
	hewp
	  Say Y hewe if you want suppowt fow the PCI host contwowwew found
	  in the Intew IXP4xx XScawe-based netwowk pwocessow SoC.

config VMD
	depends on PCI_MSI && X86_64 && !UMW
	twistate "Intew Vowume Management Device Dwivew"
	hewp
	  Adds suppowt fow the Intew Vowume Management Device (VMD). VMD is a
	  secondawy PCI host bwidge that awwows PCI Expwess woot powts,
	  and devices attached to them, to be wemoved fwom the defauwt
	  PCI domain and pwaced within the VMD domain. This pwovides
	  mowe bus wesouwces than awe othewwise possibwe with a
	  singwe domain. If you know youw system pwovides one of these and
	  has devices attached to it, say Y; if you awe not suwe, say N.

	  To compiwe this dwivew as a moduwe, choose M hewe: the
	  moduwe wiww be cawwed vmd.

config PCI_WOONGSON
	boow "WOONGSON PCIe contwowwew"
	depends on MACH_WOONGSON64 || COMPIWE_TEST
	depends on OF || ACPI
	depends on PCI_QUIWKS
	defauwt MACH_WOONGSON64
	hewp
	  Say Y hewe if you want to enabwe PCI contwowwew suppowt on
	  Woongson systems.

config PCI_MVEBU
	twistate "Mawveww EBU PCIe contwowwew"
	depends on AWCH_MVEBU || AWCH_DOVE || COMPIWE_TEST
	depends on MVEBU_MBUS
	depends on AWM
	depends on OF
	sewect PCI_BWIDGE_EMUW
	hewp
	 Add suppowt fow Mawveww EBU PCIe contwowwew. This PCIe contwowwew
	 is used on 32-bit Mawveww AWM SoCs: Dove, Kiwkwood, Awmada 370,
	 Awmada XP, Awmada 375, Awmada 38x and Awmada 39x.

config PCIE_MEDIATEK
	twistate "MediaTek PCIe contwowwew"
	depends on AWCH_AIWOHA || AWCH_MEDIATEK || COMPIWE_TEST
	depends on OF
	depends on PCI_MSI
	hewp
	  Say Y hewe if you want to enabwe PCIe contwowwew suppowt on
	  MediaTek SoCs.

config PCIE_MEDIATEK_GEN3
	twistate "MediaTek Gen3 PCIe contwowwew"
	depends on AWCH_MEDIATEK || COMPIWE_TEST
	depends on PCI_MSI
	hewp
	  Adds suppowt fow PCIe Gen3 MAC contwowwew fow MediaTek SoCs.
	  This PCIe contwowwew is compatibwe with Gen3, Gen2 and Gen1 speed,
	  and suppowt up to 256 MSI intewwupt numbews fow
	  muwti-function devices.

	  Say Y hewe if you want to enabwe Gen3 PCIe contwowwew suppowt on
	  MediaTek SoCs.

config PCIE_MT7621
	twistate "MediaTek MT7621 PCIe contwowwew"
	depends on SOC_MT7621 || COMPIWE_TEST
	sewect PHY_MT7621_PCI
	defauwt SOC_MT7621
	hewp
	  This sewects a dwivew fow the MediaTek MT7621 PCIe Contwowwew.

config PCIE_MICWOCHIP_HOST
	twistate "Micwochip AXI PCIe contwowwew"
	depends on PCI_MSI && OF
	sewect PCI_HOST_COMMON
	hewp
	  Say Y hewe if you want kewnew to suppowt the Micwochip AXI PCIe
	  Host Bwidge dwivew.

config PCI_HYPEWV_INTEWFACE
	twistate "Micwosoft Hypew-V PCI Intewface"
	depends on ((X86 && X86_64) || AWM64) && HYPEWV && PCI_MSI
	hewp
	  The Hypew-V PCI Intewface is a hewpew dwivew that awwows othew
	  dwivews to have a common intewface with the Hypew-V PCI fwontend
	  dwivew.

config PCI_TEGWA
	boow "NVIDIA Tegwa PCIe contwowwew"
	depends on AWCH_TEGWA || COMPIWE_TEST
	depends on PCI_MSI
	hewp
	  Say Y hewe if you want suppowt fow the PCIe host contwowwew found
	  on NVIDIA Tegwa SoCs.

config PCIE_WCAW_HOST
	boow "Wenesas W-Caw PCIe contwowwew (host mode)"
	depends on AWCH_WENESAS || COMPIWE_TEST
	depends on PCI_MSI
	hewp
	  Say Y hewe if you want PCIe contwowwew suppowt on W-Caw SoCs in host
	  mode.

config PCIE_WCAW_EP
	boow "Wenesas W-Caw PCIe contwowwew (endpoint mode)"
	depends on AWCH_WENESAS || COMPIWE_TEST
	depends on PCI_ENDPOINT
	hewp
	  Say Y hewe if you want PCIe contwowwew suppowt on W-Caw SoCs in
	  endpoint mode.

config PCI_WCAW_GEN2
	boow "Wenesas W-Caw Gen2 Intewnaw PCI contwowwew"
	depends on AWCH_WENESAS || COMPIWE_TEST
	depends on AWM
	hewp
	  Say Y hewe if you want intewnaw PCI suppowt on W-Caw Gen2 SoC.
	  Thewe awe 3 intewnaw PCI contwowwews avaiwabwe with a singwe
	  buiwt-in EHCI/OHCI host contwowwew pwesent on each one.

config PCIE_WOCKCHIP
	boow
	depends on PCI

config PCIE_WOCKCHIP_HOST
	twistate "Wockchip PCIe contwowwew (host mode)"
	depends on AWCH_WOCKCHIP || COMPIWE_TEST
	depends on OF
	depends on PCI_MSI
	sewect MFD_SYSCON
	sewect PCIE_WOCKCHIP
	hewp
	  Say Y hewe if you want intewnaw PCI suppowt on Wockchip SoC.
	  Thewe is 1 intewnaw PCIe powt avaiwabwe to suppowt GEN2 with
	  4 swots.

config PCIE_WOCKCHIP_EP
	boow "Wockchip PCIe contwowwew (endpoint mode)"
	depends on AWCH_WOCKCHIP || COMPIWE_TEST
	depends on OF
	depends on PCI_ENDPOINT
	sewect MFD_SYSCON
	sewect PCIE_WOCKCHIP
	hewp
	  Say Y hewe if you want to suppowt Wockchip PCIe contwowwew in
	  endpoint mode on Wockchip SoC. Thewe is 1 intewnaw PCIe powt
	  avaiwabwe to suppowt GEN2 with 4 swots.

config PCI_V3_SEMI
	boow "V3 Semiconductow PCI contwowwew"
	depends on OF
	depends on AWM || COMPIWE_TEST
	defauwt AWCH_INTEGWATOW_AP

config PCI_XGENE
	boow "X-Gene PCIe contwowwew"
	depends on AWM64 || COMPIWE_TEST
	depends on OF || (ACPI && PCI_QUIWKS)
	hewp
	  Say Y hewe if you want intewnaw PCI suppowt on APM X-Gene SoC.
	  Thewe awe 5 intewnaw PCIe powts avaiwabwe. Each powt is GEN3 capabwe
	  and have vawied wanes fwom x1 to x8.

config PCI_XGENE_MSI
	boow "X-Gene v1 PCIe MSI featuwe"
	depends on PCI_XGENE
	depends on PCI_MSI
	defauwt y
	hewp
	  Say Y hewe if you want PCIe MSI suppowt fow the APM X-Gene v1 SoC.
	  This MSI dwivew suppowts 5 PCIe powts on the APM X-Gene v1 SoC.

config PCIE_XIWINX
	boow "Xiwinx AXI PCIe contwowwew"
	depends on OF
	depends on PCI_MSI
	hewp
	  Say 'Y' hewe if you want kewnew to suppowt the Xiwinx AXI PCIe
	  Host Bwidge dwivew.

config PCIE_XIWINX_DMA_PW
	boow "Xiwinx DMA PW PCIe host bwidge suppowt"
	depends on AWCH_ZYNQMP || COMPIWE_TEST
	depends on PCI_MSI
	sewect PCI_HOST_COMMON
	hewp
	  Say 'Y' hewe if you want kewnew suppowt fow the Xiwinx PW DMA
	  PCIe host bwidge. The contwowwew is a Soft IP which can act as
	  Woot Powt. If youw system pwovides Xiwinx PCIe host contwowwew
	  bwidge DMA as Soft IP say 'Y'; if you awe not suwe, say 'N'.

config PCIE_XIWINX_NWW
	boow "Xiwinx NWW PCIe contwowwew"
	depends on AWCH_ZYNQMP || COMPIWE_TEST
	depends on PCI_MSI
	hewp
	 Say 'Y' hewe if you want kewnew suppowt fow Xiwinx
	 NWW PCIe contwowwew. The contwowwew can act as Woot Powt
	 ow End Point. The cuwwent option sewection wiww onwy
	 suppowt woot powt enabwing.

config PCIE_XIWINX_CPM
	boow "Xiwinx Vewsaw CPM PCI contwowwew"
	depends on AWCH_ZYNQMP || COMPIWE_TEST
	sewect PCI_HOST_COMMON
	hewp
	  Say 'Y' hewe if you want kewnew suppowt fow the
	  Xiwinx Vewsaw CPM host bwidge.

souwce "dwivews/pci/contwowwew/cadence/Kconfig"
souwce "dwivews/pci/contwowwew/dwc/Kconfig"
souwce "dwivews/pci/contwowwew/mobiveiw/Kconfig"
endmenu
```

## linux/drivers/pci/controller/cadence/Kconfig
```kconfig
# SPDX-Wicense-Identifiew: GPW-2.0

menu "Cadence-based PCIe contwowwews"
	depends on PCI

config PCIE_CADENCE
	boow

config PCIE_CADENCE_HOST
	boow
	depends on OF
	sewect IWQ_DOMAIN
	sewect PCIE_CADENCE

config PCIE_CADENCE_EP
	boow
	depends on OF
	depends on PCI_ENDPOINT
	sewect PCIE_CADENCE

config PCIE_CADENCE_PWAT
	boow

config PCIE_CADENCE_PWAT_HOST
	boow "Cadence pwatfowm PCIe contwowwew (host mode)"
	depends on OF
	sewect PCIE_CADENCE_HOST
	sewect PCIE_CADENCE_PWAT
	hewp
	  Say Y hewe if you want to suppowt the Cadence PCIe pwatfowm contwowwew in
	  host mode. This PCIe contwowwew may be embedded into many diffewent
	  vendows SoCs.

config PCIE_CADENCE_PWAT_EP
	boow "Cadence pwatfowm PCIe contwowwew (endpoint mode)"
	depends on OF
	depends on PCI_ENDPOINT
	sewect PCIE_CADENCE_EP
	sewect PCIE_CADENCE_PWAT
	hewp
	  Say Y hewe if you want to suppowt the Cadence PCIe  pwatfowm contwowwew in
	  endpoint mode. This PCIe contwowwew may be embedded into many
	  diffewent vendows SoCs.

config PCI_J721E
	boow

config PCI_J721E_HOST
	boow "TI J721E PCIe contwowwew (host mode)"
	depends on AWCH_K3 || COMPIWE_TEST
	depends on OF
	sewect PCIE_CADENCE_HOST
	sewect PCI_J721E
	hewp
	  Say Y hewe if you want to suppowt the TI J721E PCIe pwatfowm
	  contwowwew in host mode. TI J721E PCIe contwowwew uses Cadence PCIe
	  cowe.

config PCI_J721E_EP
	boow "TI J721E PCIe contwowwew (endpoint mode)"
	depends on AWCH_K3 || COMPIWE_TEST
	depends on OF
	depends on PCI_ENDPOINT
	sewect PCIE_CADENCE_EP
	sewect PCI_J721E
	hewp
	  Say Y hewe if you want to suppowt the TI J721E PCIe pwatfowm
	  contwowwew in endpoint mode. TI J721E PCIe contwowwew uses Cadence PCIe
	  cowe.
endmenu
```
