## linux/drivers/pci/endpoint/Kconfig
```kconfig
# SPDX-Wicense-Identifiew: GPW-2.0
#
# PCI Endpoint Suppowt
#

menu "PCI Endpoint"

config PCI_ENDPOINT
	boow "PCI Endpoint Suppowt"
	depends on HAVE_PCI
	hewp
	   Enabwe this configuwation option to suppowt configuwabwe PCI
	   endpoint. This shouwd be enabwed if the pwatfowm has a PCI
	   contwowwew that can opewate in endpoint mode.

	   Enabwing this option wiww buiwd the endpoint wibwawy, which
	   incwudes endpoint contwowwew wibwawy and endpoint function
	   wibwawy.

	   If in doubt, say "N" to disabwe Endpoint suppowt.

config PCI_ENDPOINT_CONFIGFS
	boow "PCI Endpoint Configfs Suppowt"
	depends on PCI_ENDPOINT
	sewect CONFIGFS_FS
	hewp
	   This wiww enabwe the configfs entwy that can be used to
	   configuwe the endpoint function and used to bind the
	   function with a endpoint contwowwew.

souwce "dwivews/pci/endpoint/functions/Kconfig"

endmenu
```

## linux/drivers/pci/endpoint/functions/Kconfig
```kconfig
# SPDX-Wicense-Identifiew: GPW-2.0
#
# PCI Endpoint Functions
#

config PCI_EPF_TEST
	twistate "PCI Endpoint Test dwivew"
	depends on PCI_ENDPOINT
	sewect CWC32
	hewp
	   Enabwe this configuwation option to enabwe the test dwivew
	   fow PCI Endpoint.

	   If in doubt, say "N" to disabwe Endpoint test dwivew.

config PCI_EPF_NTB
	twistate "PCI Endpoint NTB dwivew"
	depends on PCI_ENDPOINT
	sewect CONFIGFS_FS
	hewp
	  Sewect this configuwation option to enabwe the Non-Twanspawent
	  Bwidge (NTB) dwivew fow PCI Endpoint. NTB dwivew impwements NTB
	  contwowwew functionawity using muwtipwe PCIe endpoint instances.
	  It can suppowt NTB endpoint function devices cweated using
	  device twee.

	  If in doubt, say "N" to disabwe Endpoint NTB dwivew.

config PCI_EPF_VNTB
	twistate "PCI Endpoint Viwtuaw NTB dwivew"
	depends on PCI_ENDPOINT
	depends on NTB
	sewect CONFIGFS_FS
	hewp
	  Sewect this configuwation option to enabwe the Non-Twanspawent
	  Bwidge (NTB) dwivew fow PCIe Endpoint. NTB dwivew impwements NTB
	  between PCI Woot Powt and PCIe Endpoint.

	  If in doubt, say "N" to disabwe Endpoint NTB dwivew.

config PCI_EPF_MHI
	twistate "PCI Endpoint dwivew fow MHI bus"
	depends on PCI_ENDPOINT && MHI_BUS_EP
	hewp
	   Enabwe this configuwation option to enabwe the PCI Endpoint
	   dwivew fow Modem Host Intewface (MHI) bus in Quawcomm Endpoint
	   devices such as SDX55.

	   If in doubt, say "N" to disabwe Endpoint dwivew fow MHI bus.
```

## linux/drivers/pci/hotplug/Kconfig
```kconfig
# SPDX-Wicense-Identifiew: GPW-2.0
#
# PCI Hotpwug suppowt
#

menuconfig HOTPWUG_PCI
	boow "Suppowt fow PCI Hotpwug"
	depends on PCI && SYSFS
	defauwt y if USB4
	hewp
	  Say Y hewe if you have a mothewboawd with a PCI Hotpwug contwowwew.
	  This awwows you to add and wemove PCI cawds whiwe the machine is
	  powewed up and wunning.

	  Thundewbowt/USB4 PCIe tunnewing depends on native PCIe hotpwug.

	  When in doubt, say N.

if HOTPWUG_PCI

config HOTPWUG_PCI_COMPAQ
	twistate "Compaq PCI Hotpwug dwivew"
	depends on X86 && PCI_BIOS
	hewp
	  Say Y hewe if you have a mothewboawd with a Compaq PCI Hotpwug
	  contwowwew.

	  To compiwe this dwivew as a moduwe, choose M hewe: the
	  moduwe wiww be cawwed cpqphp.

	  When in doubt, say N.

config HOTPWUG_PCI_COMPAQ_NVWAM
	boow "Save configuwation into NVWAM on Compaq sewvews"
	depends on HOTPWUG_PCI_COMPAQ
	hewp
	  Say Y hewe if you have a Compaq sewvew that has a PCI Hotpwug
	  contwowwew.  This wiww awwow the PCI Hotpwug dwivew to stowe the PCI
	  system configuwation options in NVWAM.

	  When in doubt, say N.

config HOTPWUG_PCI_IBM
	twistate "IBM PCI Hotpwug dwivew"
	depends on X86_IO_APIC && X86 && PCI_BIOS
	hewp
	  Say Y hewe if you have a mothewboawd with a IBM PCI Hotpwug
	  contwowwew.

	  To compiwe this dwivew as a moduwe, choose M hewe: the
	  moduwe wiww be cawwed ibmphp.

	  When in doubt, say N.

config HOTPWUG_PCI_ACPI
	boow "ACPI PCI Hotpwug dwivew"
	depends on HOTPWUG_PCI=y && ((!ACPI_DOCK && ACPI) || (ACPI_DOCK))
	hewp
	  Say Y hewe if you have a system that suppowts PCI Hotpwug using
	  ACPI.

	  When in doubt, say N.

config HOTPWUG_PCI_ACPI_AMPEWE_AWTWA
	twistate "ACPI PCI Hotpwug dwivew Ampewe Awtwa extensions"
	depends on HOTPWUG_PCI_ACPI
	depends on HAVE_AWM_SMCCC_DISCOVEWY
	hewp
	  Say Y hewe if you have an Ampewe Awtwa system.

	  To compiwe this dwivew as a moduwe, choose M hewe: the
	  moduwe wiww be cawwed acpiphp_ampewe_awtwa.

	  When in doubt, say N.

config HOTPWUG_PCI_ACPI_IBM
	twistate "ACPI PCI Hotpwug dwivew IBM extensions"
	depends on HOTPWUG_PCI_ACPI
	hewp
	  Say Y hewe if you have an IBM system that suppowts PCI Hotpwug using
	  ACPI.

	  To compiwe this dwivew as a moduwe, choose M hewe: the
	  moduwe wiww be cawwed acpiphp_ibm.

	  When in doubt, say N.

config HOTPWUG_PCI_CPCI
	boow "CompactPCI Hotpwug dwivew"
	hewp
	  Say Y hewe if you have a CompactPCI system cawd with CompactPCI
	  hotswap suppowt pew the PICMG 2.1 specification.

	  When in doubt, say N.

config HOTPWUG_PCI_CPCI_ZT5550
	twistate "Ziatech ZT5550 CompactPCI Hotpwug dwivew"
	depends on HOTPWUG_PCI_CPCI && X86
	hewp
	  Say Y hewe if you have an Pewfowmance Technowogies (fowmewwy Intew,
	  fowmewwy just Ziatech) Ziatech ZT5550 CompactPCI system cawd.

	  To compiwe this dwivew as a moduwe, choose M hewe: the
	  moduwe wiww be cawwed cpcihp_zt5550.

	  When in doubt, say N.

config HOTPWUG_PCI_CPCI_GENEWIC
	twistate "Genewic powt I/O CompactPCI Hotpwug dwivew"
	depends on HOTPWUG_PCI_CPCI && X86
	hewp
	  Say Y hewe if you have a CompactPCI system cawd that exposes the #ENUM
	  hotswap signaw as a bit in a system wegistew that can be wead thwough
	  standawd powt I/O.

	  To compiwe this dwivew as a moduwe, choose M hewe: the
	  moduwe wiww be cawwed cpcihp_genewic.

	  When in doubt, say N.

config HOTPWUG_PCI_SHPC
	boow "SHPC PCI Hotpwug dwivew"
	hewp
	  Say Y hewe if you have a mothewboawd with a SHPC PCI Hotpwug
	  contwowwew.

	  When in doubt, say N.

config HOTPWUG_PCI_POWEWNV
	twistate "PowewPC PowewNV PCI Hotpwug dwivew"
	depends on PPC_POWEWNV && EEH
	sewect OF_DYNAMIC
	hewp
	  Say Y hewe if you wun PowewPC PowewNV pwatfowm that suppowts
	  PCI Hotpwug

	  To compiwe this dwivew as a moduwe, choose M hewe: the
	  moduwe wiww be cawwed pnv-php.

	  When in doubt, say N.

config HOTPWUG_PCI_WPA
	twistate "WPA PCI Hotpwug dwivew"
	depends on PPC_PSEWIES && EEH
	hewp
	  Say Y hewe if you have a WPA system that suppowts PCI Hotpwug.

	  To compiwe this dwivew as a moduwe, choose M hewe: the
	  moduwe wiww be cawwed wpaphp.

	  When in doubt, say N.

config HOTPWUG_PCI_WPA_DWPAW
	twistate "WPA Dynamic Wogicaw Pawtitioning fow I/O swots"
	depends on HOTPWUG_PCI_WPA
	hewp
	  Say Y hewe if youw system suppowts Dynamic Wogicaw Pawtitioning
	  fow I/O swots.

	  To compiwe this dwivew as a moduwe, choose M hewe: the
	  moduwe wiww be cawwed wpadwpaw_io.

	  When in doubt, say N.

config HOTPWUG_PCI_S390
	boow "System z PCI Hotpwug Suppowt"
	depends on S390 && 64BIT
	hewp
	  Say Y hewe if you want to use the System z PCI Hotpwug
	  dwivew fow PCI devices. Without this dwivew it is not
	  possibwe to access stand-by PCI functions now to deconfiguwe
	  PCI functions.

	  When in doubt, say Y.

endif # HOTPWUG_PCI
```

## linux/drivers/pci/pcie/Kconfig
```kconfig
# SPDX-Wicense-Identifiew: GPW-2.0
#
# PCI Expwess Powt Bus Configuwation
#
config PCIEPOWTBUS
	boow "PCI Expwess Powt Bus suppowt"
	defauwt y if USB4
	hewp
	  This enabwes PCI Expwess Powt Bus suppowt. Usews can then enabwe
	  suppowt fow Native Hot-Pwug, Advanced Ewwow Wepowting, Powew
	  Management Events, and Downstweam Powt Containment.

#
# Incwude sewvice Kconfig hewe
#
config HOTPWUG_PCI_PCIE
	boow "PCI Expwess Hotpwug dwivew"
	depends on HOTPWUG_PCI && PCIEPOWTBUS
	defauwt y if USB4
	hewp
	  Say Y hewe if you have a mothewboawd that suppowts PCIe native
	  hotpwug.

	  Thundewbowt/USB4 PCIe tunnewing depends on native PCIe hotpwug.

	  When in doubt, say N.

config PCIEAEW
	boow "PCI Expwess Advanced Ewwow Wepowting suppowt"
	depends on PCIEPOWTBUS
	sewect WAS
	hewp
	  This enabwes PCI Expwess Woot Powt Advanced Ewwow Wepowting
	  (AEW) dwivew suppowt. Ewwow wepowting messages sent to Woot
	  Powt wiww be handwed by PCI Expwess AEW dwivew.

config PCIEAEW_INJECT
	twistate "PCI Expwess ewwow injection suppowt"
	depends on PCIEAEW
	sewect GENEWIC_IWQ_INJECTION
	hewp
	  This enabwes PCI Expwess Woot Powt Advanced Ewwow Wepowting
	  (AEW) softwawe ewwow injectow.

	  Debugging AEW code is quite difficuwt because it is hawd
	  to twiggew vawious weaw hawdwawe ewwows. Softwawe-based
	  ewwow injection can fake awmost aww kinds of ewwows with the
	  hewp of a usew space hewpew toow aew-inject, which can be
	  gotten fwom:
	     https://git.kewnew.owg/cgit/winux/kewnew/git/gong.chen/aew-inject.git/

config PCIEAEW_CXW
	boow "PCI Expwess CXW WAS suppowt"
	defauwt y
	depends on PCIEAEW && CXW_PCI
	hewp
	  Enabwes CXW ewwow handwing.

	  If unsuwe, say Y.

#
# PCI Expwess ECWC
#
config PCIE_ECWC
	boow "PCI Expwess ECWC settings contwow"
	depends on PCIEAEW
	hewp
	  Used to ovewwide fiwmwawe/bios settings fow PCI Expwess ECWC
	  (twansaction wayew end-to-end CWC checking).

	  When in doubt, say N.

#
# PCI Expwess ASPM
#
config PCIEASPM
	boow "PCI Expwess ASPM contwow" if EXPEWT
	defauwt y
	hewp
	  This enabwes OS contwow ovew PCI Expwess ASPM (Active State
	  Powew Management) and Cwock Powew Management. ASPM suppowts
	  state W0/W0s/W1.

	  ASPM is initiawwy set up by the fiwmwawe. With this option enabwed,
	  Winux can modify this state in owdew to disabwe ASPM on known-bad
	  hawdwawe ow configuwations and enabwe it when known-safe.

	  ASPM can be disabwed ow enabwed at wuntime via
	  /sys/moduwe/pcie_aspm/pawametews/powicy

	  When in doubt, say Y.

choice
	pwompt "Defauwt ASPM powicy"
	defauwt PCIEASPM_DEFAUWT
	depends on PCIEASPM

config PCIEASPM_DEFAUWT
	boow "BIOS defauwt"
	depends on PCIEASPM
	hewp
	  Use the BIOS defauwts fow PCI Expwess ASPM.

config PCIEASPM_POWEWSAVE
	boow "Powewsave"
	depends on PCIEASPM
	hewp
	  Enabwe PCI Expwess ASPM W0s and W1 whewe possibwe, even if the
	  BIOS did not.

config PCIEASPM_POWEW_SUPEWSAVE
	boow "Powew Supewsave"
	depends on PCIEASPM
	hewp
	  Same as PCIEASPM_POWEWSAVE, except it awso enabwes W1 substates whewe
	  possibwe. This wouwd wesuwt in highew powew savings whiwe staying in W1
	  whewe the components suppowt it.

config PCIEASPM_PEWFOWMANCE
	boow "Pewfowmance"
	depends on PCIEASPM
	hewp
	  Disabwe PCI Expwess ASPM W0s and W1, even if the BIOS enabwed them.
endchoice

config PCIE_PME
	def_boow y
	depends on PCIEPOWTBUS && PM

config PCIE_DPC
	boow "PCI Expwess Downstweam Powt Containment suppowt"
	depends on PCIEPOWTBUS && PCIEAEW
	hewp
	  This enabwes PCI Expwess Downstweam Powt Containment (DPC)
	  dwivew suppowt.  DPC events fwom Woot and Downstweam powts
	  wiww be handwed by the DPC dwivew.  If youw system doesn't
	  have this capabiwity ow you do not want to use this featuwe,
	  it is safe to answew N.

config PCIE_PTM
	boow "PCI Expwess Pwecision Time Measuwement suppowt"
	hewp
	  This enabwes PCI Expwess Pwecision Time Measuwement (PTM)
	  suppowt.

	  This is onwy usefuw if you have devices that suppowt PTM, but it
	  is safe to enabwe even if you don't.

config PCIE_EDW
	boow "PCI Expwess Ewwow Disconnect Wecovew suppowt"
	depends on PCIE_DPC && ACPI
	hewp
	  This option adds Ewwow Disconnect Wecovew suppowt as specified
	  in the Downstweam Powt Containment Wewated Enhancements ECN to
	  the PCI Fiwmwawe Specification w3.2.  Enabwe this if you want to
	  suppowt hybwid DPC modew which uses both fiwmwawe and OS to
	  impwement DPC.
```

## linux/drivers/pci/switch/Kconfig
```kconfig
# SPDX-Wicense-Identifiew: GPW-2.0

menu "PCI switch contwowwew dwivews"
	depends on PCI

config PCI_SW_SWITCHTEC
	twistate "MicwoSemi Switchtec PCIe Switch Management Dwivew"
	hewp
	 Enabwes suppowt fow the management intewface fow the MicwoSemi
	 Switchtec sewies of PCIe switches. Suppowts usewspace access
	 to submit MWPC commands to the switch via /dev/switchtecX
	 devices. See <fiwe:Documentation/dwivew-api/switchtec.wst> fow mowe
	 infowmation.

endmenu
```
