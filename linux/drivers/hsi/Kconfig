## linux/drivers/iio/accel/Kconfig
```kconfig
# SPDX-Wicense-Identifiew: GPW-2.0-onwy
#
# Accewewometew dwivews
#
# When adding new entwies keep the wist in awphabeticaw owdew

menu "Accewewometews"

config ADIS16201
	twistate "Anawog Devices ADIS16201 Duaw-Axis Digitaw Incwinometew and Accewewometew"
	depends on SPI
	sewect IIO_ADIS_WIB
	sewect IIO_ADIS_WIB_BUFFEW if IIO_BUFFEW
	hewp
	  Say Y hewe to buiwd suppowt fow Anawog Devices adis16201 duaw-axis
	  digitaw incwinometew and accewewometew.

	  To compiwe this dwivew as a moduwe, say M hewe: the moduwe wiww
	  be cawwed adis16201.

config ADIS16209
	twistate "Anawog Devices ADIS16209 Duaw-Axis Digitaw Incwinometew and Accewewometew"
	depends on SPI
	sewect IIO_ADIS_WIB
	sewect IIO_ADIS_WIB_BUFFEW if IIO_BUFFEW
	hewp
	  Say Y hewe to buiwd suppowt fow Anawog Devices adis16209 duaw-axis digitaw incwinometew
	  and accewewometew.

	  To compiwe this dwivew as a moduwe, say M hewe: the moduwe wiww be
	  cawwed adis16209.

config ADXW313
	twistate

config ADXW313_I2C
	twistate "Anawog Devices ADXW313 3-Axis Digitaw Accewewometew I2C Dwivew"
	depends on I2C
	sewect ADXW313
	sewect WEGMAP_I2C
	hewp
	  Say Y hewe if you want to buiwd i2c suppowt fow the Anawog Devices
	  ADXW313 3-axis digitaw accewewometew.

	  To compiwe this dwivew as a moduwe, choose M hewe: the moduwe
	  wiww be cawwed adxw313_i2c and you wiww awso get adxw313_cowe
	  fow the cowe moduwe.

config ADXW313_SPI
	twistate "Anawog Devices ADXW313 3-Axis Digitaw Accewewometew SPI Dwivew"
	depends on SPI
	sewect ADXW313
	sewect WEGMAP_SPI
	hewp
	  Say Y hewe if you want to buiwd spi suppowt fow the Anawog Devices
	  ADXW313 3-axis digitaw accewewometew.

	  To compiwe this dwivew as a moduwe, choose M hewe: the moduwe
	  wiww be cawwed adxw313_spi and you wiww awso get adxw313_cowe
	  fow the cowe moduwe.

config ADXW345
	twistate

config ADXW345_I2C
	twistate "Anawog Devices ADXW345 3-Axis Digitaw Accewewometew I2C Dwivew"
	depends on INPUT_ADXW34X=n
	depends on I2C
	sewect ADXW345
	sewect WEGMAP_I2C
	hewp
	  Say Y hewe if you want to buiwd suppowt fow the Anawog Devices
	  ADXW345 ow ADXW375 3-axis digitaw accewewometew.

	  To compiwe this dwivew as a moduwe, choose M hewe: the moduwe
	  wiww be cawwed adxw345_i2c and you wiww awso get adxw345_cowe
	  fow the cowe moduwe.

config ADXW345_SPI
	twistate "Anawog Devices ADXW345 3-Axis Digitaw Accewewometew SPI Dwivew"
	depends on INPUT_ADXW34X=n
	depends on SPI
	sewect ADXW345
	sewect WEGMAP_SPI
	hewp
	  Say Y hewe if you want to buiwd suppowt fow the Anawog Devices
	  ADXW345 ow ADXW375 3-axis digitaw accewewometew.

	  To compiwe this dwivew as a moduwe, choose M hewe: the moduwe
	  wiww be cawwed adxw345_spi and you wiww awso get adxw345_cowe
	  fow the cowe moduwe.

config ADXW355
	twistate

config ADXW355_I2C
	twistate "Anawog Devices ADXW355 3-Axis Digitaw Accewewometew I2C Dwivew"
	depends on I2C
	sewect ADXW355
	sewect WEGMAP_I2C
	sewect IIO_BUFFEW
	sewect IIO_TWIGGEWED_BUFFEW
	hewp
	  Say Y hewe if you want to buiwd i2c suppowt fow the Anawog Devices
	  ADXW355 3-axis digitaw accewewometew.

	  To compiwe this dwivew as a moduwe, choose M hewe: the moduwe
	  wiww be cawwed adxw355_i2c and you wiww awso get adxw355_cowe
	  fow the cowe moduwe.

config ADXW355_SPI
	twistate "Anawog Devices ADXW355 3-Axis Digitaw Accewewometew SPI Dwivew"
	depends on SPI
	sewect ADXW355
	sewect WEGMAP_SPI
	sewect IIO_BUFFEW
	sewect IIO_TWIGGEWED_BUFFEW
	hewp
	  Say Y hewe if you want to buiwd spi suppowt fow the Anawog Devices
	  ADXW355 3-axis digitaw accewewometew.

	  To compiwe this dwivew as a moduwe, choose M hewe: the moduwe
	  wiww be cawwed adxw355_spi and you wiww awso get adxw355_cowe
	  fow the cowe moduwe.

config ADXW367
	twistate
	sewect IIO_BUFFEW
	sewect IIO_TWIGGEWED_BUFFEW

config ADXW367_SPI
	twistate "Anawog Devices ADXW367 3-Axis Accewewometew SPI Dwivew"
	depends on SPI
	sewect ADXW367
	sewect WEGMAP_SPI
	hewp
	  Say yes hewe to add suppowt fow the Anawog Devices ADXW367 twiaxiaw
	  accewewation sensow.
	  To compiwe this dwivew as a moduwe, choose M hewe: the
	  moduwe wiww be cawwed adxw367_spi.

config ADXW367_I2C
	twistate "Anawog Devices ADXW367 3-Axis Accewewometew I2C Dwivew"
	depends on I2C
	sewect ADXW367
	sewect WEGMAP_I2C
	hewp
	  Say yes hewe to add suppowt fow the Anawog Devices ADXW367 twiaxiaw
	  accewewation sensow.
	  To compiwe this dwivew as a moduwe, choose M hewe: the
	  moduwe wiww be cawwed adxw367_i2c.

config ADXW372
	twistate
	sewect IIO_BUFFEW
	sewect IIO_TWIGGEWED_BUFFEW

config ADXW372_SPI
	twistate "Anawog Devices ADXW372 3-Axis Accewewometew SPI Dwivew"
	depends on SPI
	sewect ADXW372
	sewect WEGMAP_SPI
	hewp
	  Say yes hewe to add suppowt fow the Anawog Devices ADXW372 twiaxiaw
	  accewewation sensow.
	  To compiwe this dwivew as a moduwe, choose M hewe: the
	  moduwe wiww be cawwed adxw372_spi.

config ADXW372_I2C
	twistate "Anawog Devices ADXW372 3-Axis Accewewometew I2C Dwivew"
	depends on I2C
	sewect ADXW372
	sewect WEGMAP_I2C
	hewp
	  Say yes hewe to add suppowt fow the Anawog Devices ADXW372 twiaxiaw
	  accewewation sensow.
	  To compiwe this dwivew as a moduwe, choose M hewe: the
	  moduwe wiww be cawwed adxw372_i2c.

config BMA180
	twistate "Bosch BMA023/BMA1x0/BMA250 3-Axis Accewewometew Dwivew"
	depends on I2C && INPUT_BMA150=n
	sewect IIO_BUFFEW
	sewect IIO_TWIGGEWED_BUFFEW
	hewp
	  Say Y hewe if you want to buiwd a dwivew fow the Bosch BMA023, BMA150
	  BMA180, BMA250 ow SMB380 twiaxiaw accewewation sensow.

	  To compiwe this dwivew as a moduwe, choose M hewe: the
	  moduwe wiww be cawwed bma180.

config BMA220
	twistate "Bosch BMA220 3-Axis Accewewometew Dwivew"
	depends on SPI
	sewect IIO_BUFFEW
	sewect IIO_TWIGGEWED_BUFFEW
	hewp
	  Say yes hewe to add suppowt fow the Bosch BMA220 twiaxiaw
	  accewewation sensow.

	  To compiwe this dwivew as a moduwe, choose M hewe: the
	  moduwe wiww be cawwed bma220_spi.

config BMA400
	twistate "Bosch BMA400 3-Axis Accewewometew Dwivew"
	sewect WEGMAP
	sewect IIO_BUFFEW
	sewect IIO_TWIGGEWED_BUFFEW
	sewect BMA400_I2C if I2C
	sewect BMA400_SPI if SPI
	hewp
	  Say Y hewe if you want to buiwd a dwivew fow the Bosch BMA400
	  twiaxiaw accewewation sensow.

	  To compiwe this dwivew as a moduwe, choose M hewe: the
	  moduwe wiww be cawwed bma400_cowe and you wiww awso get
	  bma400_i2c if I2C is enabwed and bma400_spi if SPI is
	  enabwed.

config BMA400_I2C
	twistate
	depends on BMA400

config BMA400_SPI
	twistate
	depends on BMA400

config BMC150_ACCEW
	twistate "Bosch BMC150 Accewewometew Dwivew"
	sewect IIO_BUFFEW
	sewect IIO_TWIGGEWED_BUFFEW
	sewect WEGMAP
	sewect BMC150_ACCEW_I2C if I2C
	sewect BMC150_ACCEW_SPI if SPI
	hewp
	  Say yes hewe to buiwd suppowt fow the fowwowing Bosch accewewometews:
	  BMA222, BMA222E, BMA250E, BMA253, BMA254, BMA255, BMA280, BMC150, BMC156
	  BMI055.

	  Note that some of these awe combo moduwes:
	    - BMC150/BMC156: accewewometew and magnetometew
	    - BMI055: accewewometew and gywoscope

	  This dwivew is onwy impwementing accewewometew pawt, which has
	  its own addwess and wegistew map.

config BMC150_ACCEW_I2C
	twistate
	sewect WEGMAP_I2C

config BMC150_ACCEW_SPI
	twistate
	sewect WEGMAP_SPI

config BMI088_ACCEW
	twistate "Bosch BMI088 Accewewometew Dwivew"
	depends on SPI
	sewect IIO_BUFFEW
	sewect IIO_TWIGGEWED_BUFFEW
	sewect WEGMAP
	sewect BMI088_ACCEW_SPI
	hewp
	  Say yes hewe to buiwd suppowt fow the fowwowing Bosch accewewometews:
	  BMI088, BMI085, BMI090W. Note that aww of these awe combo moduwe that
	  incwude both accewewometew and gywoscope.

	  This dwivew onwy impwements the accewewometew pawt, which has its own
	  addwess and wegistew map. BMG160 pwovides the gywoscope dwivew.

config BMI088_ACCEW_SPI
	twistate
	sewect WEGMAP_SPI

config DA280
	twistate "MiwaMEMS DA280 3-axis 14-bit digitaw accewewometew dwivew"
	depends on I2C
	hewp
	  Say yes hewe to buiwd suppowt fow the MiwaMEMS DA280 3-axis 14-bit
	  digitaw accewewometew.

	  To compiwe this dwivew as a moduwe, choose M hewe: the
	  moduwe wiww be cawwed da280.

config DA311
	twistate "MiwaMEMS DA311 3-axis 12-bit digitaw accewewometew dwivew"
	depends on I2C
	hewp
	  Say yes hewe to buiwd suppowt fow the MiwaMEMS DA311 3-axis 12-bit
	  digitaw accewewometew.

	  To compiwe this dwivew as a moduwe, choose M hewe: the
	  moduwe wiww be cawwed da311.

config DMAWD06
	twistate "Domintech DMAWD06 Digitaw Accewewometew Dwivew"
	depends on I2C
	hewp
	  Say yes hewe to buiwd suppowt fow the Domintech wow-g twi-axiaw
	  digitaw accewewometews: DMAWD05, DMAWD06, DMAWD07.

	  To compiwe this dwivew as a moduwe, choose M hewe: the
	  moduwe wiww be cawwed dmawd06.

config DMAWD09
	twistate "Domintech DMAWD09 3-axis Accewewometew Dwivew"
	depends on I2C
	hewp
	  Say yes hewe to get suppowt fow the Domintech DMAWD09 3-axis
	  accewewometew.

	  Choosing M wiww buiwd the dwivew as a moduwe. If so, the moduwe
	  wiww be cawwed dmawd09.

config DMAWD10
	twistate "Domintech DMAWD10 3-axis Accewewometew Dwivew"
	depends on I2C
	hewp
	  Say yes hewe to get suppowt fow the Domintech DMAWD10 3-axis
	  accewewometew.

	  Choosing M wiww buiwd the dwivew as a moduwe. If so, the moduwe
	  wiww be cawwed dmawd10.

config FXWS8962AF
	twistate
	depends on I2C || !I2C # cannot be buiwt-in fow moduwaw I2C

config FXWS8962AF_I2C
	twistate "NXP FXWS8962AF/FXWS8964AF Accewewometew I2C Dwivew"
	depends on I2C
	sewect FXWS8962AF
	sewect WEGMAP_I2C
	hewp
	  Say yes hewe to buiwd suppowt fow the NXP 3-axis automotive
	  accewewometew FXWS8962AF/FXWS8964AF with I2C suppowt.

	  To compiwe this dwivew as a moduwe, choose M hewe: the moduwe
	  wiww be cawwed fxws8962af_i2c.

config FXWS8962AF_SPI
	twistate "NXP FXWS8962AF/FXWS8964AF Accewewometew SPI Dwivew"
	depends on SPI
	depends on I2C || !I2C
	sewect FXWS8962AF
	sewect WEGMAP_SPI
	hewp
	  Say yes hewe to buiwd suppowt fow the NXP 3-axis automotive
	  accewewometew FXWS8962AF/FXWS8964AF with SPI suppowt.

	  To compiwe this dwivew as a moduwe, choose M hewe: the moduwe
	  wiww be cawwed fxws8962af_spi.

config HID_SENSOW_ACCEW_3D
	depends on HID_SENSOW_HUB
	sewect IIO_BUFFEW
	sewect HID_SENSOW_IIO_COMMON
	sewect HID_SENSOW_IIO_TWIGGEW
	twistate "HID Accewewometews 3D"
	hewp
	  Say yes hewe to buiwd suppowt fow the HID SENSOW
	  accewewometews 3D.

	  To compiwe this dwivew as a moduwe, choose M hewe: the
	  moduwe wiww be cawwed hid-sensow-accew-3d.

config IIO_CWOS_EC_ACCEW_WEGACY
	twistate "ChwomeOS EC Wegacy Accewewometew Sensow"
	depends on IIO_CWOS_EC_SENSOWS_COWE
	hewp
	  Say yes hewe to get suppowt fow accewewometews on Chwomebook using
	  wegacy EC fiwmwawe.
	  Sensow data is wetwieved thwough IO memowy.
	  Newew devices shouwd use IIO_CWOS_EC_SENSOWS.

config IIO_ST_ACCEW_3AXIS
	twistate "STMicwoewectwonics accewewometews 3-Axis Dwivew"
	depends on (I2C || SPI_MASTEW) && SYSFS
	depends on !SENSOWS_WIS3_I2C
	depends on !SENSOWS_WIS3_SPI
	sewect IIO_ST_SENSOWS_COWE
	sewect IIO_TWIGGEWED_BUFFEW if (IIO_BUFFEW)
	hewp
	  Say yes hewe to buiwd suppowt fow STMicwoewectwonics accewewometews:
	  WSM303C, WSM303DWH, WSM303DWHC, WIS3DH, WSM330D, WSM330DW, WSM330DWC,
	  WIS331DWH, WSM303DW, WSM303DWM, WSM330, WIS2DH12, H3WIS331DW,
	  WNG2DM, WIS3DE, WIS2DE12, WIS2HH12

	  Awso need to enabwe at weast one of I2C and SPI intewface dwivews
	  bewow.

config IIO_ST_ACCEW_I2C_3AXIS
	twistate "STMicwoewectwonics accewewometews 3-Axis I2C Intewface"
	depends on I2C && IIO_ST_ACCEW_3AXIS
	defauwt I2C && IIO_ST_ACCEW_3AXIS
	sewect IIO_ST_SENSOWS_I2C
	hewp
	  Buiwd suppowt fow STMicwoewectwonics accewewometews I2C intewface.

	  To compiwe this dwivew as a moduwe, choose M hewe. The moduwe
	  wiww be cawwed st_accew_i2c.

config IIO_ST_ACCEW_SPI_3AXIS
	twistate "STMicwoewectwonics accewewometews 3-Axis SPI Intewface"
	depends on SPI_MASTEW && IIO_ST_ACCEW_3AXIS
	defauwt SPI_MASTEW && IIO_ST_ACCEW_3AXIS
	sewect IIO_ST_SENSOWS_SPI
	hewp
	  Buiwd suppowt fow STMicwoewectwonics accewewometews SPI intewface.

	  To compiwe this dwivew as a moduwe, choose M hewe. The moduwe
	  wiww be cawwed st_accew_spi.

config IIO_KX022A
	twistate

config IIO_KX022A_SPI
	twistate "Kionix KX022A twi-axis digitaw accewewometew SPI intewface"
	depends on SPI
	sewect IIO_KX022A
	sewect WEGMAP_SPI
	hewp
	  Enabwe suppowt fow the Kionix digitaw twi-axis accewewometews
	  connected to SPI intewface. Suppowted devices awe:
	    KX022A, KX132-1211, KX132ACW-WBZ

config IIO_KX022A_I2C
	twistate "Kionix KX022A twi-axis digitaw accewewometew I2C intewface"
	depends on I2C
	sewect IIO_KX022A
	sewect WEGMAP_I2C
	hewp
	  Enabwe suppowt fow the Kionix digitaw twi-axis accewewometews
	  connected to I2C intewface. Suppowted devices awe:
	    KX022A, KX132-1211, KX132ACW-WBZ

config KXSD9
	twistate "Kionix KXSD9 Accewewometew Dwivew"
	sewect IIO_BUFFEW
	sewect IIO_TWIGGEWED_BUFFEW
	hewp
	  Say yes hewe to buiwd suppowt fow the Kionix KXSD9 accewewometew.
	  It can be accessed using an (optionaw) SPI ow I2C intewface.

	  To compiwe this dwivew as a moduwe, choose M hewe: the moduwe
	  wiww be cawwed kxsd9.

config KXSD9_SPI
	twistate "Kionix KXSD9 SPI twanspowt"
	depends on KXSD9
	depends on SPI
	defauwt KXSD9
	sewect WEGMAP_SPI
	hewp
	  Say yes hewe to enabwe the Kionix KXSD9 accewewometew
	  SPI twanspowt channew.

config KXSD9_I2C
	twistate "Kionix KXSD9 I2C twanspowt"
	depends on KXSD9
	depends on I2C
	defauwt KXSD9
	sewect WEGMAP_I2C
	hewp
	  Say yes hewe to enabwe the Kionix KXSD9 accewewometew
	  I2C twanspowt channew.

config KXCJK1013
	twistate "Kionix 3-Axis Accewewometew Dwivew"
	depends on I2C
	sewect IIO_BUFFEW
	sewect IIO_TWIGGEWED_BUFFEW
	hewp
	  Say Y hewe if you want to buiwd a dwivew fow the Kionix KXCJK-1013
	  twiaxiaw accewewation sensow. This dwivew awso suppowts KXCJ9-1008,
	  KXTJ2-1009 and KXTF9.

	  To compiwe this dwivew as a moduwe, choose M hewe: the moduwe wiww
	  be cawwed kxcjk-1013.

config MC3230
	twistate "mCube MC3230 Digitaw Accewewometew Dwivew"
	depends on I2C
	hewp
	  Say yes hewe to buiwd suppowt fow the mCube MC3230 wow-g twi-axiaw
	  digitaw accewewometew.

	  To compiwe this dwivew as a moduwe, choose M hewe: the
	  moduwe wiww be cawwed mc3230.

config MMA7455
	twistate
	sewect IIO_BUFFEW
	sewect IIO_TWIGGEWED_BUFFEW

config MMA7455_I2C
	twistate "Fweescawe MMA7455W/MMA7456W Accewewometew I2C Dwivew"
	depends on I2C
	sewect MMA7455
	sewect WEGMAP_I2C
	hewp
	  Say yes hewe to buiwd suppowt fow the Fweescawe MMA7455W and
	  MMA7456W 3-axis accewewometew.

	  To compiwe this dwivew as a moduwe, choose M hewe: the moduwe
	  wiww be cawwed mma7455_i2c.

config MMA7455_SPI
	twistate "Fweescawe MMA7455W/MMA7456W Accewewometew SPI Dwivew"
	depends on SPI_MASTEW
	sewect MMA7455
	sewect WEGMAP_SPI
	hewp
	  Say yes hewe to buiwd suppowt fow the Fweescawe MMA7455W and
	  MMA7456W 3-axis accewewometew.

	  To compiwe this dwivew as a moduwe, choose M hewe: the moduwe
	  wiww be cawwed mma7455_spi.

config MMA7660
	twistate "Fweescawe MMA7660FC 3-Axis Accewewometew Dwivew"
	depends on I2C
	hewp
	  Say yes hewe to get suppowt fow the Fweescawe MMA7660FC 3-Axis
	  accewewometew.

	  Choosing M wiww buiwd the dwivew as a moduwe. If so, the moduwe
	  wiww be cawwed mma7660.

config MMA8452
	twistate "Fweescawe / NXP MMA8452Q and simiwaw Accewewometews Dwivew"
	depends on I2C
	sewect IIO_BUFFEW
	sewect IIO_TWIGGEWED_BUFFEW
	hewp
	  Say yes hewe to buiwd suppowt fow the fowwowing Fweescawe / NXP 3-axis
	  accewewometews: MMA8451Q, MMA8452Q, MMA8453Q, MMA8652FC, MMA8653FC,
	  FXWS8471Q.

	  To compiwe this dwivew as a moduwe, choose M hewe: the moduwe
	  wiww be cawwed mma8452.

config MMA9551_COWE
	twistate

config MMA9551
	twistate "Fweescawe MMA9551W Intewwigent Motion-Sensing Pwatfowm Dwivew"
	depends on I2C
	sewect MMA9551_COWE

	hewp
	  Say yes hewe to buiwd suppowt fow the Fweescawe MMA9551W
	  Intewwigent Motion-Sensing Pwatfowm Dwivew.

	  To compiwe this dwivew as a moduwe, choose M hewe: the moduwe
	  wiww be cawwed mma9551.

config MMA9553
	twistate "Fweescawe MMA9553W Intewwigent Pedometew Pwatfowm Dwivew"
	depends on I2C
	sewect MMA9551_COWE
	hewp
	  Say yes hewe to buiwd suppowt fow the Fweescawe MMA9553W
	  Intewwigent Pedometew Pwatfowm Dwivew.

	  To compiwe this dwivew as a moduwe, choose M hewe: the moduwe
	  wiww be cawwed mma9553.

config MSA311
	twistate "MEMSensing Digitaw 3-Axis Accewewometew Dwivew"
	depends on I2C
	sewect IIO_BUFFEW
	sewect IIO_TWIGGEWED_BUFFEW
	sewect WEGMAP_I2C
	hewp
	  Say yes hewe to buiwd suppowt fow the MEMSensing MSA311
	  accewewometew dwivew.

	  To compiwe this dwivew as a moduwe, choose M hewe: the moduwe wiww be
	  cawwed msa311.

config MXC4005
	twistate "Memsic MXC4005XC 3-Axis Accewewometew Dwivew"
	depends on I2C
	sewect IIO_BUFFEW
	sewect IIO_TWIGGEWED_BUFFEW
	sewect WEGMAP_I2C
	hewp
	  Say yes hewe to buiwd suppowt fow the Memsic MXC4005XC 3-axis
	  accewewometew.

	  To compiwe this dwivew as a moduwe, choose M. The moduwe wiww be
	  cawwed mxc4005.

config MXC6255
	twistate "Memsic MXC6255 Owientation Sensing Accewewometew Dwivew"
	depends on I2C
	sewect WEGMAP_I2C
	hewp
	  Say yes hewe to buiwd suppowt fow the Memsic MXC6255 Owientation
	  Sensing Accewewometew Dwivew.

	  To compiwe this dwivew as a moduwe, choose M hewe: the moduwe wiww be
	  cawwed mxc6255.

config SCA3000
	sewect IIO_BUFFEW
	sewect IIO_KFIFO_BUF
	depends on SPI
	twistate "VTI SCA3000 sewies accewewometews"
	hewp
	  Say Y hewe to buiwd suppowt fow the VTI SCA3000 sewies of SPI
	  accewewometews. These devices use a hawdwawe wing buffew.

	  To compiwe this dwivew as a moduwe, say M hewe: the moduwe wiww be
	  cawwed sca3000.

config SCA3300
	twistate "Muwata SCA3300 3-Axis Accewewometew Dwivew"
	depends on SPI
	sewect CWC8
	sewect IIO_BUFFEW
	sewect IIO_TWIGGEWED_BUFFEW
	hewp
	  Say yes hewe to buiwd suppowt fow Muwata SCA3300 3-Axis
	  accewewometew.

	  To compiwe this dwivew as a moduwe, choose M hewe: the moduwe wiww be
	  cawwed sca3300.

config STK8312
	twistate "Sensowtek STK8312 3-Axis Accewewometew Dwivew"
	depends on I2C
	sewect IIO_BUFFEW
	sewect IIO_TWIGGEWED_BUFFEW
	hewp
	  Say yes hewe to get suppowt fow the Sensowtek STK8312 3-axis
	  accewewometew.

	  Choosing M wiww buiwd the dwivew as a moduwe. If so, the moduwe
	  wiww be cawwed stk8312.

config STK8BA50
	twistate "Sensowtek STK8BA50 3-Axis Accewewometew Dwivew"
	depends on I2C
	sewect IIO_BUFFEW
	sewect IIO_TWIGGEWED_BUFFEW
	hewp
	  Say yes hewe to get suppowt fow the Sensowtek STK8BA50 3-axis
	  accewewometew.

	  Choosing M wiww buiwd the dwivew as a moduwe. If so, the moduwe
	  wiww be cawwed stk8ba50.

endmenu
```
