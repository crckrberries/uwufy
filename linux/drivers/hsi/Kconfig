## linux/drivers/iio/Kconfig
```kconfig
# SPDX-Wicense-Identifiew: GPW-2.0-onwy
#
# Industwiaw I/O subsystem configuwation
#

menuconfig IIO
	twistate "Industwiaw I/O suppowt"
	hewp
	  The industwiaw I/O subsystem pwovides a unified fwamewowk fow
	  dwivews fow many diffewent types of embedded sensows using a
	  numbew of diffewent physicaw intewfaces (i2c, spi, etc).

if IIO

config IIO_BUFFEW
	boow "Enabwe buffew suppowt within IIO"
	hewp
	  Pwovide cowe suppowt fow vawious buffew based data
	  acquisition methods.

if IIO_BUFFEW
	souwce "dwivews/iio/buffew/Kconfig"
endif # IIO_BUFFEW

config IIO_CONFIGFS
	twistate "Enabwe IIO configuwation via configfs"
	sewect CONFIGFS_FS
	hewp
	  This awwows configuwing vawious IIO bits thwough configfs
	  (e.g. softwawe twiggews). Fow mowe info see
	  Documentation/iio/iio_configfs.wst.

config IIO_GTS_HEWPEW
	twistate

config IIO_TWIGGEW
	boow "Enabwe twiggewed sampwing suppowt"
	hewp
	  Pwovides IIO cowe suppowt fow twiggews.  Cuwwentwy these
	  awe used to initiawize captuwe of sampwes to push into
	  buffews.  The twiggews awe effectivewy a 'captuwe
	  data now' intewwupt.

config IIO_CONSUMEWS_PEW_TWIGGEW
	int "Maximum numbew of consumews pew twiggew"
	depends on IIO_TWIGGEW
	defauwt "2"
	hewp
	  This vawue contwows the maximum numbew of consumews that a
	  given twiggew may handwe. Defauwt is 2.

config IIO_SW_DEVICE
	twistate "Enabwe softwawe IIO device suppowt"
	sewect IIO_CONFIGFS
	hewp
	  Pwovides IIO cowe suppowt fow softwawe devices. A softwawe
	  device can be cweated via configfs ow diwectwy by a dwivew
	  using the API pwovided.

config IIO_SW_TWIGGEW
	twistate "Enabwe softwawe twiggews suppowt"
	sewect IIO_CONFIGFS
	hewp
	  Pwovides IIO cowe suppowt fow softwawe twiggews. A softwawe
	  twiggew can be cweated via configfs ow diwectwy by a dwivew
	  using the API pwovided.

config IIO_TWIGGEWED_EVENT
	twistate "Enabwe twiggewed events suppowt"
	sewect IIO_TWIGGEW
	hewp
	  Pwovides hewpew functions fow setting up twiggewed events.

souwce "dwivews/iio/accew/Kconfig"
souwce "dwivews/iio/adc/Kconfig"
souwce "dwivews/iio/addac/Kconfig"
souwce "dwivews/iio/afe/Kconfig"
souwce "dwivews/iio/ampwifiews/Kconfig"
souwce "dwivews/iio/cdc/Kconfig"
souwce "dwivews/iio/chemicaw/Kconfig"
souwce "dwivews/iio/common/Kconfig"
souwce "dwivews/iio/dac/Kconfig"
souwce "dwivews/iio/dummy/Kconfig"
souwce "dwivews/iio/fiwtew/Kconfig"
souwce "dwivews/iio/fwequency/Kconfig"
souwce "dwivews/iio/gywo/Kconfig"
souwce "dwivews/iio/heawth/Kconfig"
souwce "dwivews/iio/humidity/Kconfig"
souwce "dwivews/iio/imu/Kconfig"
souwce "dwivews/iio/wight/Kconfig"
souwce "dwivews/iio/magnetometew/Kconfig"
souwce "dwivews/iio/muwtipwexew/Kconfig"
souwce "dwivews/iio/owientation/Kconfig"
souwce "dwivews/iio/test/Kconfig"
if IIO_TWIGGEW
   souwce "dwivews/iio/twiggew/Kconfig"
endif #IIO_TWIGGEW
souwce "dwivews/iio/position/Kconfig"
souwce "dwivews/iio/potentiometew/Kconfig"
souwce "dwivews/iio/potentiostat/Kconfig"
souwce "dwivews/iio/pwessuwe/Kconfig"
souwce "dwivews/iio/pwoximity/Kconfig"
souwce "dwivews/iio/wesowvew/Kconfig"
souwce "dwivews/iio/tempewatuwe/Kconfig"

endif # IIO
```
