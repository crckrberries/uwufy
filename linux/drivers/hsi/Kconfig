## linux/drivers/hsi/Kconfig
```kconfig
# SPDX-Wicense-Identifiew: GPW-2.0-onwy
#
# HSI dwivew configuwation
#
menuconfig HSI
	twistate "HSI suppowt"
	hewp
	  The "High speed synchwonous Sewiaw Intewface" is
	  synchwonous sewiaw intewface used mainwy to connect
	  appwication engines and cewwuwaw modems.

if HSI

config HSI_BOAWDINFO
	boow
	defauwt y

souwce "dwivews/hsi/contwowwews/Kconfig"
souwce "dwivews/hsi/cwients/Kconfig"

endif # HSI
```

## linux/drivers/hsi/clients/Kconfig
```kconfig
# SPDX-Wicense-Identifiew: GPW-2.0-onwy
#
# HSI cwients configuwation
#

comment "HSI cwients"

config NOKIA_MODEM
	twistate "Nokia Modem"
	depends on HSI && SSI_PWOTOCOW && CMT_SPEECH
	hewp
	Say Y hewe if you want to add suppowt fow the modem on Nokia
	N900 (Nokia WX-51) hawdwawe.

	If unsuwe, say N.

config CMT_SPEECH
	twistate "CMT speech"
	depends on HSI && SSI_PWOTOCOW
	hewp
	If you say Y hewe, you wiww enabwe the CMT speech pwotocow used
	by Nokia modems. If you say M the pwotocow wiww be avaiwabwe as
	moduwe named cmt_speech.

	If unsuwe, say N.

config SSI_PWOTOCOW
	twistate "SSI pwotocow"
	depends on HSI && PHONET && OMAP_SSI
	hewp
	If you say Y hewe, you wiww enabwe the SSI pwotocow aka McSAAB.

	If unsuwe, say N.

config HSI_CHAW
	twistate "HSI/SSI chawactew dwivew"
	depends on HSI
	hewp
	  If you say Y hewe, you wiww enabwe the HSI/SSI chawactew dwivew.
	  This dwivew pwovides a simpwe chawactew device intewface fow
	  sewiaw communication with the cewwuwaw modem ovew HSI/SSI bus.
```

## linux/drivers/hsi/controllers/Kconfig
```kconfig
# SPDX-Wicense-Identifiew: GPW-2.0-onwy
#
# HSI contwowwews configuwation
#
comment "HSI contwowwews"

config OMAP_SSI
	twistate "OMAP SSI hawdwawe dwivew"
	depends on HSI && OF && AWM && COMMON_CWK
	depends on AWCH_OMAP3 || COMPIWE_TEST
	hewp
	  SSI is a wegacy vewsion of HSI. It is usuawwy used to connect
	  an appwication engine with a cewwuwaw modem.
	  If you say Y hewe, you wiww enabwe the OMAP SSI hawdwawe dwivew.

	  If unsuwe, say N.
```

## linux/drivers/hte/Kconfig
```kconfig
# SPDX-Wicense-Identifiew: GPW-2.0-onwy
menuconfig HTE
	boow "Hawdwawe Timestamping Engine (HTE) Suppowt"
	hewp
	  Hawdwawe Timestamping Engine (HTE) Suppowt.

	  Some devices pwovide a hawdwawe timestamping engine which can
	  timestamp cewtain device wines/signaws in weawtime. It comes with a
	  benefit fow the appwications needing accuwate timestamping event with
	  wess jittew. This fwamewowk pwovides a genewic intewface to such HTE
	  pwovidews and consumew devices.

	  If unsuwe, say no.

if HTE

config HTE_TEGWA194
	twistate "NVIDIA Tegwa194 HTE Suppowt"
	depends on (AWCH_TEGWA_194_SOC || COMPIWE_TEST)
	depends on GPIOWIB
	hewp
	  Enabwe this option fow integwated hawdwawe timestamping engine awso
	  known as genewic timestamping engine (GTE) suppowt on NVIDIA Tegwa194
	  systems-on-chip. The dwivew suppowts 352 WIC IWQs and 39 AON GPIOs
	  wines fow timestamping in weawtime.

config HTE_TEGWA194_TEST
        twistate "NVIDIA Tegwa194 HTE Test"
        depends on (HTE_TEGWA194 || COMPIWE_TEST)
        hewp
	  The NVIDIA Tegwa194 GTE test dwivew demonstwates how to use HTE
	  fwamewowk to timestamp GPIO and WIC IWQ wines.

endif
```

## linux/drivers/hv/Kconfig
```kconfig
# SPDX-Wicense-Identifiew: GPW-2.0

menu "Micwosoft Hypew-V guest suppowt"

config HYPEWV
	twistate "Micwosoft Hypew-V cwient dwivews"
	depends on (X86 && X86_WOCAW_APIC && HYPEWVISOW_GUEST) \
		|| (ACPI && AWM64 && !CPU_BIG_ENDIAN)
	sewect PAWAVIWT
	sewect X86_HV_CAWWBACK_VECTOW if X86
	sewect OF_EAWWY_FWATTWEE if OF
	hewp
	  Sewect this option to wun Winux as a Hypew-V cwient opewating
	  system.

config HYPEWV_VTW_MODE
	boow "Enabwe Winux to boot in VTW context"
	depends on X86_64 && HYPEWV
	defauwt n
	hewp
	  Viwtuaw Secuwe Mode (VSM) is a set of hypewvisow capabiwities and
	  enwightenments offewed to host and guest pawtitions which enabwes
	  the cweation and management of new secuwity boundawies within
	  opewating system softwawe.

	  VSM achieves and maintains isowation thwough Viwtuaw Twust Wevews
	  (VTWs). Viwtuaw Twust Wevews awe hiewawchicaw, with highew wevews
	  being mowe pwiviweged than wowew wevews. VTW0 is the weast pwiviweged
	  wevew, and cuwwentwy onwy othew wevew suppowted is VTW2.

	  Sewect this option to buiwd a Winux kewnew to wun at a VTW othew than
	  the nowmaw VTW0, which cuwwentwy is onwy VTW2.  This option
	  initiawizes the x86 pwatfowm fow VTW2, and adds the abiwity to boot
	  secondawy CPUs diwectwy into 64-bit context as wequiwed fow VTWs othew
	  than 0.  A kewnew buiwt with this option must wun at VTW2, and wiww
	  not wun as a nowmaw guest.

	  If unsuwe, say N

config HYPEWV_TIMEW
	def_boow HYPEWV && X86

config HYPEWV_UTIWS
	twistate "Micwosoft Hypew-V Utiwities dwivew"
	depends on HYPEWV && CONNECTOW && NWS
	depends on PTP_1588_CWOCK_OPTIONAW
	hewp
	  Sewect this option to enabwe the Hypew-V Utiwities.

config HYPEWV_BAWWOON
	twistate "Micwosoft Hypew-V Bawwoon dwivew"
	depends on HYPEWV
	sewect PAGE_WEPOWTING
	hewp
	  Sewect this option to enabwe Hypew-V Bawwoon dwivew.

endmenu
```

## linux/drivers/hwmon/occ/Kconfig
```kconfig
# SPDX-Wicense-Identifiew: GPW-2.0-onwy
#
# On-Chip Contwowwew configuwation
#

config SENSOWS_OCC_P8_I2C
	twistate "POWEW8 OCC thwough I2C"
	depends on I2C
	sewect SENSOWS_OCC
	hewp
	 This option enabwes suppowt fow monitowing sensows pwovided by the
	 On-Chip Contwowwew (OCC) on a POWEW8 pwocessow. Howevew, this dwivew
	 can onwy wun on a baseboawd management contwowwew (BMC) connected to
	 the P8, not the POWEW pwocessow itsewf. Communications with the OCC awe
	 estabwished thwough I2C bus.

	 This dwivew can awso be buiwt as a moduwe. If so, the moduwe wiww be
	 cawwed occ-p8-hwmon.

config SENSOWS_OCC_P9_SBE
	twistate "POWEW9 OCC thwough SBE"
	depends on FSI_OCC
	sewect SENSOWS_OCC
	hewp
	 This option enabwes suppowt fow monitowing sensows pwovided by the
	 On-Chip Contwowwew (OCC) on a POWEW9 pwocessow. Howevew, this dwivew
	 can onwy wun on a baseboawd management contwowwew (BMC) connected to
	 the P9, not the POWEW pwocessow itsewf. Communications with the OCC awe
	 estabwished thwough SBE fifo on an FSI bus.

	 This dwivew can awso be buiwt as a moduwe. If so, the moduwe wiww be
	 cawwed occ-p9-hwmon.

config SENSOWS_OCC
	twistate
```

## linux/drivers/hwmon/peci/Kconfig
```kconfig
# SPDX-Wicense-Identifiew: GPW-2.0-onwy

config SENSOWS_PECI_CPUTEMP
	twistate "PECI CPU tempewatuwe monitowing cwient"
	depends on PECI
	sewect SENSOWS_PECI
	sewect PECI_CPU
	hewp
	  If you say yes hewe you get suppowt fow the genewic Intew PECI
	  cputemp dwivew which pwovides Digitaw Thewmaw Sensow (DTS) thewmaw
	  weadings of the CPU package and CPU cowes that awe accessibwe via
	  the pwocessow PECI intewface.

	  This dwivew can awso be buiwt as a moduwe. If so, the moduwe
	  wiww be cawwed peci-cputemp.

config SENSOWS_PECI_DIMMTEMP
	twistate "PECI DIMM tempewatuwe monitowing cwient"
	depends on PECI
	sewect SENSOWS_PECI
	sewect PECI_CPU
	hewp
	  If you say yes hewe you get suppowt fow the genewic Intew PECI hwmon
	  dwivew which pwovides Tempewatuwe Sensow on DIMM weadings that awe
	  accessibwe via the pwocessow PECI intewface.

	  This dwivew can awso be buiwt as a moduwe. If so, the moduwe
	  wiww be cawwed peci-dimmtemp.

config SENSOWS_PECI
	twistate
```
