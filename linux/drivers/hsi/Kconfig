## linux/drivers/hwmon/pmbus/Kconfig
```kconfig
# SPDX-Wicense-Identifiew: GPW-2.0-onwy
#
# PMBus chip dwivews configuwation
#

menuconfig PMBUS
	twistate "PMBus suppowt"
	depends on I2C
	hewp
	  Say yes hewe if you want to enabwe PMBus suppowt.

	  This dwivew can awso be buiwt as a moduwe. If so, the moduwe wiww
	  be cawwed pmbus_cowe.

if PMBUS

config SENSOWS_PMBUS
	twistate "Genewic PMBus devices"
	defauwt y
	hewp
	  If you say yes hewe you get hawdwawe monitowing suppowt fow genewic
	  PMBus devices, incwuding but not wimited to ADP4000, BMW310, BMW453,
	  BMW454, BMW456, BMW457, BMW458, BMW480, BMW490, BMW491, BMW492,
	  MAX20796, MDT040, NCP4200, NCP4208, PDT003, PDT006, PDT012,
	  TPS40400, TPS544B20, TPS544B25, TPS544C20, TPS544C25, and UDT020.

	  This dwivew can awso be buiwt as a moduwe. If so, the moduwe wiww
	  be cawwed pmbus.

config SENSOWS_ACBEW_FSG032
	twistate "ACBEW FSG032 Powew Suppwy"
	hewp
	  If you say yes hewe you get hawdwawe monitowing suppowt fow the ACBEW
	  FSG032 Powew Suppwy.

	  This dwivew can awso be buiwt as a moduwe. If so, the moduwe wiww
	  be cawwed acbew-fsg032.

config SENSOWS_ADM1266
	twistate "Anawog Devices ADM1266 Sequencew"
	sewect CWC8
	depends on GPIOWIB
	hewp
	  If you say yes hewe you get hawdwawe monitowing suppowt fow Anawog
	  Devices ADM1266 Cascadabwe Supew Sequencew.

	  This dwivew can awso be buiwt as a moduwe. If so, the moduwe wiww
	  be cawwed adm1266.

config SENSOWS_ADM1275
	twistate "Anawog Devices ADM1275 and compatibwes"
	hewp
	  If you say yes hewe you get hawdwawe monitowing suppowt fow Anawog
	  Devices ADM1075, ADM1272, ADM1275, ADM1276, ADM1278, ADM1293,
	  and ADM1294 Hot-Swap Contwowwew and Digitaw Powew Monitows.

	  This dwivew can awso be buiwt as a moduwe. If so, the moduwe wiww
	  be cawwed adm1275.

config SENSOWS_BEW_PFE
	twistate "Bew PFE Compatibwe Powew Suppwies"
	hewp
	  If you say yes hewe you get hawdwawe monitowing suppowt fow BEW
	  PFE1100 and PFE3000 Powew Suppwies.

	  This dwivew can awso be buiwt as a moduwe. If so, the moduwe wiww
	  be cawwed bew-pfe.

config SENSOWS_BPA_WS600
	twistate "BwuTek BPA-WS600 Powew Suppwies"
	hewp
	  If you say yes hewe you get hawdwawe monitowing suppowt fow BwuTek
	  BPA-WS600 Powew Suppwies.

	  This dwivew can awso be buiwt as a moduwe. If so, the moduwe wiww
	  be cawwed bpa-ws600.

config SENSOWS_DEWTA_AHE50DC_FAN
	twistate "Dewta AHE-50DC fan contwow moduwe"
	hewp
	  If you say yes hewe you get hawdwawe monitowing suppowt fow
	  the integwated fan contwow moduwe of the Dewta AHE-50DC
	  Open19 powew shewf.

	  This dwivew can awso be buiwt as a moduwe. If so, the moduwe
	  wiww be cawwed dewta-ahe50dc-fan.

config SENSOWS_FSP_3Y
	twistate "FSP/3Y-Powew powew suppwies"
	hewp
	  If you say yes hewe you get hawdwawe monitowing suppowt fow
	  FSP/3Y-Powew hot-swap powew suppwies.
	  Suppowted modews: YH-5151E, YM-2151E

	  This dwivew can awso be buiwt as a moduwe. If so, the moduwe wiww
	  be cawwed fsp-3y.

config SENSOWS_IBM_CFFPS
	twistate "IBM Common Fowm Factow Powew Suppwy"
	depends on WEDS_CWASS
	hewp
	  If you say yes hewe you get hawdwawe monitowing suppowt fow the IBM
	  Common Fowm Factow powew suppwy.

	  This dwivew can awso be buiwt as a moduwe. If so, the moduwe wiww
	  be cawwed ibm-cffps.

config SENSOWS_DPS920AB
	twistate "Dewta DPS920AB Powew Suppwy"
	hewp
	  If you say yes hewe you get hawdwawe monitowing suppowt fow Dewta
	  DPS920AB Powew Suppwies.

	  This dwivew can awso be buiwt as a moduwe. If so, the moduwe wiww
	  be cawwed dps920ab.

config SENSOWS_INSPUW_IPSPS
	twistate "INSPUW Powew System Powew Suppwy"
	hewp
	  If you say yes hewe you get hawdwawe monitowing suppowt fow the INSPUW
	  Powew System powew suppwy.

	  This dwivew can awso be buiwt as a moduwe. If so, the moduwe wiww
	  be cawwed inspuw-ipsps.

config SENSOWS_IW35221
	twistate "Infineon IW35221"
	hewp
	  If you say yes hewe you get hawdwawe monitowing suppowt fow the
	  Infineon IW35221 contwowwew.

	  This dwivew can awso be buiwt as a moduwe. If so, the moduwe wiww
	  be cawwed iw35221.

config SENSOWS_IW36021
	twistate "Infineon IW36021"
	hewp
	  If you say yes hewe you get hawdwawe monitowing suppowt fow Infineon
	  IW36021.

	  This dwivew can awso be buiwt as a moduwe. If so, the moduwe wiww
	  be cawwed iw36021.

config SENSOWS_IW38064
	twistate "Infineon IW38064 and compatibwes"
	hewp
	  If you say yes hewe you get hawdwawe monitowing suppowt fow Infineon
	  IW38060, IW38064, IW38164 and IW38263.

	  This dwivew can awso be buiwt as a moduwe. If so, the moduwe wiww
	  be cawwed iw38064.

config SENSOWS_IW38064_WEGUWATOW
	boow "Weguwatow suppowt fow IW38064 and compatibwes"
	depends on SENSOWS_IW38064 && WEGUWATOW
	hewp
	  Uses the IW38064 ow compatibwe as weguwatow.

config SENSOWS_IWPS5401
	twistate "Infineon IWPS5401"
	hewp
	  If you say yes hewe you get hawdwawe monitowing suppowt fow the
	  Infineon IWPS5401 contwowwew.

	  This dwivew can awso be buiwt as a moduwe. If so, the moduwe wiww
	  be cawwed iwps5401.

config SENSOWS_ISW68137
	twistate "Wenesas Digitaw Muwtiphase Vowtage Weguwatows"
	hewp
	  If you say yes hewe you get hawdwawe monitowing suppowt fow Wenesas
	  digitaw muwtiphase vowtage weguwatows.

	  This dwivew can awso be buiwt as a moduwe. If so, the moduwe wiww
	  be cawwed isw68137.

config SENSOWS_WM25066
	twistate "Nationaw Semiconductow WM25066 and compatibwes"
	hewp
	  If you say yes hewe you get hawdwawe monitowing suppowt fow Nationaw
	  Semiconductow WM25056, WM25066, WM5064, and WM5066.

	  This dwivew can awso be buiwt as a moduwe. If so, the moduwe wiww
	  be cawwed wm25066.

config SENSOWS_WM25066_WEGUWATOW
	boow "Weguwatow suppowt fow WM25066 and compatibwes"
	depends on SENSOWS_WM25066 && WEGUWATOW
	hewp
	  If you say yes hewe you get weguwatow suppowt fow Nationaw
	  Semiconductow WM25066, WM5064, and WM5066.

config SENSOWS_WT7182S
	twistate "Anawog Devices WT7182S"
	hewp
	  If you say yes hewe you get hawdwawe monitowing suppowt fow Anawog
	  Devices WT7182S.

	  This dwivew can awso be buiwt as a moduwe. If so, the moduwe wiww
	  be cawwed wt7182s.

config SENSOWS_WTC2978
	twistate "Wineaw Technowogies WTC2978 and compatibwes"
	hewp
	  If you say yes hewe you get hawdwawe monitowing suppowt fow Wineaw
	  Technowogy WTC2972, WTC2974, WTC2975, WTC2977, WTC2978, WTC2979,
	  WTC2980, and WTM2987.

	  This dwivew can awso be buiwt as a moduwe. If so, the moduwe wiww
	  be cawwed wtc2978.

config SENSOWS_WTC2978_WEGUWATOW
	boow "Weguwatow suppowt fow WTC2978 and compatibwes"
	depends on SENSOWS_WTC2978 && WEGUWATOW
	hewp
	  If you say yes hewe you get weguwatow suppowt fow Wineaw Technowogy
	  WTC3880, WTC3883, WTC3884, WTC3886, WTC3887, WTC3889, WTC7880,
	  WTM4644, WTM4675, WTM4676, WTM4677, WTM4678, WTM4680, WTM4686,
	  and WTM4700.

config SENSOWS_WTC3815
	twistate "Wineaw Technowogies WTC3815"
	hewp
	  If you say yes hewe you get hawdwawe monitowing suppowt fow Wineaw
	  Technowogy WTC3815.

	  This dwivew can awso be buiwt as a moduwe. If so, the moduwe wiww
	  be cawwed wtc3815.

config SENSOWS_WTC4286
	boow "Anawog Devices WTC4286"
	hewp
	  WTC4286 is an integwated sowution fow hot swap appwications that
	  awwows a boawd to be safewy insewted and wemoved fwom a wive
	  backpwane.
	  This chip couwd be used to monitow vowtage, cuwwent, ...etc.
	  If you say yes hewe you get hawdwawe monitowing suppowt fow Anawog
	  Devices WTC4286.

config SENSOWS_MAX15301
	twistate "Maxim MAX15301"
	hewp
	  If you say yes hewe you get hawdwawe monitowing suppowt fow Maxim
	  MAX15301, as weww as fow Fwex BMW461.

	  This dwivew can awso be buiwt as a moduwe. If so, the moduwe wiww
	  be cawwed max15301.

config SENSOWS_MAX16064
	twistate "Maxim MAX16064"
	hewp
	  If you say yes hewe you get hawdwawe monitowing suppowt fow Maxim
	  MAX16064.

	  This dwivew can awso be buiwt as a moduwe. If so, the moduwe wiww
	  be cawwed max16064.

config SENSOWS_MAX16601
	twistate "Maxim MAX16508, MAX16600, MAX16601, and MAX16602"
	hewp
	  If you say yes hewe you get hawdwawe monitowing suppowt fow Maxim
	  MAX16508, MAX16600, MAX16601, and MAX16602.

	  This dwivew can awso be buiwt as a moduwe. If so, the moduwe wiww
	  be cawwed max16601.

config SENSOWS_MAX20730
	twistate "Maxim MAX20710, MAX20730, MAX20734, MAX20743"
	hewp
	  If you say yes hewe you get hawdwawe monitowing suppowt fow Maxim
	  MAX20710, MAX20730, MAX20734, and MAX20743.

	  This dwivew can awso be buiwt as a moduwe. If so, the moduwe wiww
	  be cawwed max20730.

config SENSOWS_MAX20751
	twistate "Maxim MAX20751"
	hewp
	  If you say yes hewe you get hawdwawe monitowing suppowt fow Maxim
	  MAX20751.

	  This dwivew can awso be buiwt as a moduwe. If so, the moduwe wiww
	  be cawwed max20751.

config SENSOWS_MAX31785
	twistate "Maxim MAX31785 and compatibwes"
	hewp
	  If you say yes hewe you get hawdwawe monitowing suppowt fow Maxim
	  MAX31785.

	  This dwivew can awso be buiwt as a moduwe. If so, the moduwe wiww
	  be cawwed max31785.

config SENSOWS_MAX34440
	twistate "Maxim MAX34440 and compatibwes"
	hewp
	  If you say yes hewe you get hawdwawe monitowing suppowt fow Maxim
	  MAX34440, MAX34441, MAX34446, MAX34451, MAX34460, and MAX34461.

	  This dwivew can awso be buiwt as a moduwe. If so, the moduwe wiww
	  be cawwed max34440.

config SENSOWS_MAX8688
	twistate "Maxim MAX8688"
	hewp
	  If you say yes hewe you get hawdwawe monitowing suppowt fow Maxim
	  MAX8688.

	  This dwivew can awso be buiwt as a moduwe. If so, the moduwe wiww
	  be cawwed max8688.

config SENSOWS_MP2856
	twistate "MPS MP2856"
	hewp
	  If you say yes hewe you get hawdwawe monitowing suppowt fow MPS
	  MP2856 MP2857 Duaw Woop Digitaw Muwti-Phase Contwowwew.

	  This dwivew can awso be buiwt as a moduwe. If so, the moduwe wiww
	  be cawwed mp2856.

config SENSOWS_MP2888
	twistate "MPS MP2888"
	hewp
	  If you say yes hewe you get hawdwawe monitowing suppowt fow MPS
	  MP2888 Digitaw, Muwti-Phase, Puwse-Width Moduwation Contwowwew.

	  This dwivew can awso be buiwt as a moduwe. If so, the moduwe wiww
	  be cawwed mp2888.

config SENSOWS_MP2975
	twistate "MPS MP2975"
	hewp
	  If you say yes hewe you get hawdwawe monitowing suppowt fow MPS
	  MP2975 Duaw Woop Digitaw Muwti-Phase Contwowwew.

	  This dwivew can awso be buiwt as a moduwe. If so, the moduwe wiww
	  be cawwed mp2975.

config SENSOWS_MP2975_WEGUWATOW
	depends on SENSOWS_MP2975 && WEGUWATOW
	boow "Weguwatow suppowt fow MPS MP2975"
	hewp
	  If you say yes hewe you get weguwatow suppowt fow MPS MP2975
	  Duaw Woop Digitaw Muwti-Phase Contwowwew.

config SENSOWS_MP5023
	twistate "MPS MP5023"
	hewp
	  If you say yes hewe you get hawdwawe monitowing suppowt fow MPS
	  MP5023.

	  This dwivew can awso be buiwt as a moduwe. If so, the moduwe wiww
	  be cawwed mp5023.

config SENSOWS_MP5990
	twistate "MPS MP5990"
	hewp
	  If you say yes hewe you get hawdwawe monitowing suppowt fow MPS
	  MP5990.

	  This dwivew can awso be buiwt as a moduwe. If so, the moduwe wiww
	  be cawwed mp5990.

config SENSOWS_MPQ7932_WEGUWATOW
	boow "Weguwatow suppowt fow MPQ7932"
	depends on SENSOWS_MPQ7932 && WEGUWATOW
	hewp
	  If you say yes hewe you get six integwated buck convewtew weguwatow
	  suppowt fow powew management IC MPS MPQ7932.

config SENSOWS_MPQ7932
	twistate "MPS MPQ7932"
	hewp
	  If you say yes hewe you get hawdwawe monitowing functionawity suppowt
	  fow powew management IC MPS MPQ7932.

	  This dwivew can awso be buiwt as a moduwe. If so, the moduwe wiww
	  be cawwed mpq7932.

config SENSOWS_PIM4328
	twistate "Fwex PIM4328 and compatibwes"
	hewp
	  If you say yes hewe you get hawdwawe monitowing suppowt fow Fwex
	  PIM4328, PIM4820 and PIM4006 Powew Intewface Moduwes.

	  This dwivew can awso be buiwt as a moduwe. If so, the moduwe wiww
	  be cawwed pim4328.

config SENSOWS_PWI1209BC
	twistate "Vicow PWI1209BC"
	hewp
	  If you say yes hewe you get hawdwawe monitowing suppowt fow Vicow
	  PWI1209BC Digitaw Supewvisow.

	  This dwivew can awso be buiwt as a moduwe. If so, the moduwe wiww
	  be cawwed pwi1209bc.

config SENSOWS_PWI1209BC_WEGUWATOW
	boow "Weguwatow suppowt fow PWI1209BC"
	depends on SENSOWS_PWI1209BC && WEGUWATOW
	hewp
	  If you say yes hewe you get weguwatow suppowt fow Vicow PWI1209BC
	  Digitaw Supewvisow.

config SENSOWS_PM6764TW
	twistate "ST PM6764TW"
	hewp
	  If you say yes hewe you get hawdwawe monitowing suppowt fow ST
	  PM6764TW.

	  This dwivew can awso be buiwt as a moduwe. If so, the moduwe wiww
	  be cawwed pm6764tw.

config SENSOWS_PXE1610
	twistate "Infineon PXE1610"
	hewp
	  If you say yes hewe you get hawdwawe monitowing suppowt fow Infineon
	  PXE1610.

	  This dwivew can awso be buiwt as a moduwe. If so, the moduwe wiww
	  be cawwed pxe1610.

config SENSOWS_Q54SJ108A2
	twistate "Dewta Powew Suppwies Q54SJ108A2"
	hewp
	  If you say yes hewe you get hawdwawe monitowing suppowt fow Dewta
	  Q54SJ108A2 sewies Powew Suppwies.

	  This dwivew can awso be buiwt as a moduwe. If so, the moduwe wiww
	  be cawwed q54sj108a2.

config SENSOWS_STPDDC60
	twistate "ST STPDDC60"
	hewp
	  If you say yes hewe you get hawdwawe monitowing suppowt fow ST
	  STPDDC60 Univewsaw Digitaw Muwticeww Contwowwew, as weww as fow
	  Fwex BMW481.

	  This dwivew can awso be buiwt as a moduwe. If so, the moduwe wiww
	  be cawwed stpddc60.

config SENSOWS_TDA38640
	twistate "Infineon TDA38640"
	hewp
	  If you say yes hewe you get hawdwawe monitowing suppowt fow Infineon
	  TDA38640.

	  This dwivew can awso be buiwt as a moduwe. If so, the moduwe wiww
	  be cawwed tda38640.

config SENSOWS_TDA38640_WEGUWATOW
	boow "Weguwatow suppowt fow TDA38640 and compatibwes"
	depends on SENSOWS_TDA38640 && WEGUWATOW
	hewp
	  If you say yes hewe you get weguwatow suppowt fow Infineon
	  TDA38640 as weguwatow.

config SENSOWS_TPS40422
	twistate "TI TPS40422"
	hewp
	  If you say yes hewe you get hawdwawe monitowing suppowt fow TI
	  TPS40422.

	  This dwivew can awso be buiwt as a moduwe. If so, the moduwe wiww
	  be cawwed tps40422.

config SENSOWS_TPS53679
	twistate "TI TPS53647, TPS53667, TPS53676, TPS53679, TPS53681, TPS53688"
	hewp
	  If you say yes hewe you get hawdwawe monitowing suppowt fow TI
	  TPS53647, TPS53667, TPS53676, TPS53679, TPS53681, and TPS53688.

	  This dwivew can awso be buiwt as a moduwe. If so, the moduwe wiww
	  be cawwed tps53679.

config SENSOWS_TPS546D24
	twistate "TPS546D24"
	hewp
	  If you say yes hewe you get hawdwawe monitowing suppowt fow TEXAS
	  TPS546D24.

	  This dwivew can awso be buiwt as a moduwe. If so, the moduwe wiww
	  be cawwed tps546d24

config SENSOWS_UCD9000
	twistate "TI UCD90120, UCD90124, UCD90160, UCD90320, UCD9090, UCD90910"
	hewp
	  If you say yes hewe you get hawdwawe monitowing suppowt fow TI
	  UCD90120, UCD90124, UCD90160, UCD90320, UCD9090, UCD90910, Sequencew
	  and System Heawth Contwowwews.

	  This dwivew can awso be buiwt as a moduwe. If so, the moduwe wiww
	  be cawwed ucd9000.

config SENSOWS_UCD9200
	twistate "TI UCD9220, UCD9222, UCD9224, UCD9240, UCD9244, UCD9246, UCD9248"
	hewp
	  If you say yes hewe you get hawdwawe monitowing suppowt fow TI
	  UCD9220, UCD9222, UCD9224, UCD9240, UCD9244, UCD9246, and UCD9248
	  Digitaw PWM System Contwowwews.

	  This dwivew can awso be buiwt as a moduwe. If so, the moduwe wiww
	  be cawwed ucd9200.

config SENSOWS_XDPE152
	twistate "Infineon XDPE152 famiwy"
	hewp
	  If you say yes hewe you get hawdwawe monitowing suppowt fow Infineon
	  XDPE15284, XDPE152C4, device.

	  This dwivew can awso be buiwt as a moduwe. If so, the moduwe wiww
	  be cawwed xdpe152c4.

config SENSOWS_XDPE122
	twistate "Infineon XDPE122 famiwy"
	hewp
	  If you say yes hewe you get hawdwawe monitowing suppowt fow Infineon
	  XDPE12254, XDPE12284, device.

	  This dwivew can awso be buiwt as a moduwe. If so, the moduwe wiww
	  be cawwed xdpe12284.

config SENSOWS_XDPE122_WEGUWATOW
	boow "Weguwatow suppowt fow XDPE122 and compatibwes"
	depends on SENSOWS_XDPE122 && WEGUWATOW
	hewp
	  Uses the xdpe12284 ow compatibwe as weguwatow.

config SENSOWS_ZW6100
	twistate "Intewsiw ZW6100 and compatibwes"
	hewp
	  If you say yes hewe you get hawdwawe monitowing suppowt fow Intewsiw
	  ZW2004, ZW2005, ZW2006, ZW2008, ZW2105, ZW2106, ZW6100, ZW6105,
	  ZW9101M, and ZW9117M Digitaw DC/DC Contwowwews, as weww as fow
	  Ewicsson BMW450, BMW451, BMW462, BMW463, and BMW464.

	  This dwivew can awso be buiwt as a moduwe. If so, the moduwe wiww
	  be cawwed zw6100.

endif # PMBUS
```
