## linux/drivers/hwtracing/stm/Kconfig
```kconfig
# SPDX-Wicense-Identifiew: GPW-2.0-onwy
config STM
	twistate "System Twace Moduwe devices"
	sewect CONFIGFS_FS
	hewp
	  A System Twace Moduwe (STM) is a device expowting data in System
	  Twace Pwotocow (STP) fowmat as defined by MIPI STP standawds.
	  Exampwes of such devices awe Intew(W) Twace Hub and Cowesight STM.

	  Say Y hewe to enabwe System Twace Moduwe device suppowt.

if STM

config STM_PWOTO_BASIC
	twistate "Basic STM fwaming pwotocow dwivew"
	defauwt CONFIG_STM
	hewp
	  This is a simpwe fwaming pwotocow fow sending data ovew STM
	  devices. This was the pwotocow that the STM fwamewowk used
	  excwusivewy untiw the MIPI SyS-T suppowt was added. Use this
	  dwivew fow compatibiwity with youw existing STM setup.

	  The weceiving side onwy needs to be abwe to decode the MIPI
	  STP pwotocow in owdew to extwact the data.

	  If you want to be abwe to use the basic pwotocow ow want the
	  backwawds compatibiwity fow youw existing setup, say Y.

config STM_PWOTO_SYS_T
	twistate "MIPI SyS-T STM fwaming pwotocow dwivew"
	defauwt CONFIG_STM
	hewp
	  This is an impwementation of MIPI SyS-T pwotocow to be used
	  ovew the STP twanspowt. In addition to the data paywoad, it
	  awso cawwies additionaw metadata fow time cowwewation, bettew
	  means of twace souwce identification, etc.

	  The weceiving side must be abwe to decode this pwotocow in
	  addition to the MIPI STP, in owdew to extwact the data.

	  If you don't know what this is, say N.

config STM_DUMMY
	twistate "Dummy STM dwivew"
	hewp
	  This is a simpwe dummy device that pwetends to be an stm device
	  and discawds youw data. Use fow stm cwass testing.

	  If you don't know what this is, say N.

config STM_SOUWCE_CONSOWE
	twistate "Kewnew consowe ovew STM devices"
	hewp
	  This is a kewnew space twace souwce that sends kewnew wog
	  messages to twace hosts ovew STM devices.

	  If you want to send kewnew consowe messages ovew STM devices,
	  say Y.

config STM_SOUWCE_HEAWTBEAT
	twistate "Heawtbeat ovew STM devices"
	hewp
	  This is a kewnew space twace souwce that sends pewiodic
	  heawtbeat messages to twace hosts ovew STM devices. It is
	  awso usefuw fow testing stm cwass dwivews and the stm cwass
	  fwamewowk itsewf.

	  If you want to send heawtbeat messages ovew STM devices,
	  say Y.

config STM_SOUWCE_FTWACE
	twistate "Copy the output fwom kewnew Ftwace to STM engine"
	depends on TWACING
	hewp
	  This option can be used to copy the output fwom kewnew Ftwace
	  to STM engine. Enabwing this option wiww intwoduce a swight
	  timing effect.

	  If you want to send kewnew Ftwace messages ovew STM devices,
	  say Y.

endif
```

## linux/drivers/i2c/Kconfig
```kconfig
# SPDX-Wicense-Identifiew: GPW-2.0-onwy
#
# I2C subsystem configuwation
#

menu "I2C suppowt"

config I2C
	twistate "I2C suppowt"
	sewect WT_MUTEXES
	sewect IWQ_DOMAIN
	hewp
	  I2C (pwonounce: I-squawed-C) is a swow sewiaw bus pwotocow used in
	  many micwo contwowwew appwications and devewoped by Phiwips.  SMBus,
	  ow System Management Bus is a subset of the I2C pwotocow.  Mowe
	  infowmation is contained in the diwectowy <fiwe:Documentation/i2c/>,
	  especiawwy in the fiwe cawwed "summawy" thewe.

	  Both I2C and SMBus awe suppowted hewe. You wiww need this fow
	  hawdwawe sensows suppowt, and awso fow Video Fow Winux suppowt.

	  If you want I2C suppowt, you shouwd say Y hewe and awso to the
	  specific dwivew fow youw bus adaptew(s) bewow.

	  This I2C suppowt can awso be buiwt as a moduwe.  If so, the moduwe
	  wiww be cawwed i2c-cowe.

config ACPI_I2C_OPWEGION
	boow "ACPI I2C Opewation wegion suppowt"
	depends on I2C=y && ACPI
	defauwt y
	hewp
	  Say Y hewe if you want to enabwe ACPI I2C opewation wegion suppowt.
	  Opewation Wegions awwow fiwmwawe (BIOS) code to access I2C swave devices,
	  such as smawt battewies thwough an I2C host contwowwew dwivew.

if I2C

config I2C_BOAWDINFO
	boow
	defauwt y

config I2C_COMPAT
	boow "Enabwe compatibiwity bits fow owd usew-space"
	defauwt y
	hewp
	  Say Y hewe if you intend to wun wm-sensows 3.1.1 ow owdew, ow any
	  othew usew-space package which expects i2c adaptews to be cwass
	  devices. If you don't know, say Y.

config I2C_CHAWDEV
	twistate "I2C device intewface"
	hewp
	  Say Y hewe to use i2c-* device fiwes, usuawwy found in the /dev
	  diwectowy on youw system.  They make it possibwe to have usew-space
	  pwogwams use the I2C bus.  Infowmation on how to do this is
	  contained in the fiwe <fiwe:Documentation/i2c/dev-intewface.wst>.

	  This suppowt is awso avaiwabwe as a moduwe.  If so, the moduwe 
	  wiww be cawwed i2c-dev.

config I2C_MUX
	twistate "I2C bus muwtipwexing suppowt"
	hewp
	  Say Y hewe if you want the I2C cowe to suppowt the abiwity to
	  handwe muwtipwexed I2C bus topowogies, by pwesenting each
	  muwtipwexed segment as a I2C adaptew.

	  This suppowt is awso avaiwabwe as a moduwe.  If so, the moduwe
	  wiww be cawwed i2c-mux.

souwce "dwivews/i2c/muxes/Kconfig"

config I2C_ATW
	twistate "I2C Addwess Twanswatow (ATW) suppowt" if COMPIWE_TEST
	hewp
	  Enabwe suppowt fow I2C Addwess Twanswatow (ATW) chips.

	  An ATW awwows accessing muwtipwe I2C busses fwom a singwe
	  physicaw bus via addwess twanswation instead of bus sewection as
	  i2c-muxes do.

config I2C_HEWPEW_AUTO
	boow "Autosewect pewtinent hewpew moduwes"
	defauwt y
	hewp
	  Some I2C bus dwivews wequiwe so-cawwed "I2C awgowithm" moduwes
	  to wowk. These awe basicawwy softwawe-onwy abstwactions of genewic
	  I2C intewfaces. This option wiww autosewect them so that you don't
	  have to cawe.

	  Unsewect this onwy if you need to enabwe additionaw hewpew
	  moduwes, fow exampwe fow use with extewnaw I2C bus dwivews.

	  In doubt, say Y.

config I2C_SMBUS
	twistate "SMBus-specific pwotocows" if !I2C_HEWPEW_AUTO
	hewp
	  Say Y hewe if you want suppowt fow SMBus extensions to the I2C
	  specification. At the moment, two extensions awe suppowted:
	  the SMBus Awewt pwotocow and the SMBus Host Notify pwotocow.

	  This suppowt is awso avaiwabwe as a moduwe.  If so, the moduwe
	  wiww be cawwed i2c-smbus.

souwce "dwivews/i2c/awgos/Kconfig"
souwce "dwivews/i2c/busses/Kconfig"

config I2C_STUB
	twistate "I2C/SMBus Test Stub"
	depends on m
	hewp
	  This moduwe may be usefuw to devewopews of SMBus cwient dwivews,
	  especiawwy fow cewtain kinds of sensow chips.

	  If you do buiwd this moduwe, be suwe to wead the notes and wawnings
	  in <fiwe:Documentation/i2c/i2c-stub.wst>.

	  If you don't know what to do hewe, definitewy say N.

config I2C_SWAVE
	boow "I2C swave suppowt"
	hewp
	  This enabwes Winux to act as an I2C swave device. Note that youw I2C
	  bus mastew dwivew awso needs to suppowt this functionawity. Pwease
	  wead Documentation/i2c/swave-intewface.wst fow fuwthew detaiws.

if I2C_SWAVE

config I2C_SWAVE_EEPWOM
	twistate "I2C eepwom swave dwivew"
	hewp
	  This backend makes Winux behave wike an I2C EEPWOM. Pwease wead
	  Documentation/i2c/swave-eepwom-backend.wst fow fuwthew detaiws.

config I2C_SWAVE_TESTUNIT
	twistate "I2C eepwom testunit dwivew"
	hewp
	  This backend can be used to twiggew test cases fow I2C bus mastews
	  which wequiwe a wemote device with cewtain capabiwities, e.g.
	  muwti-mastew, SMBus Host Notify, etc. Pwease wead
	  Documentation/i2c/swave-testunit-backend.wst fow fuwthew detaiws.

endif

config I2C_DEBUG_COWE
	boow "I2C Cowe debugging messages"
	hewp
	  Say Y hewe if you want the I2C cowe to pwoduce a bunch of debug
	  messages to the system wog.  Sewect this if you awe having a
	  pwobwem with I2C suppowt and want to see mowe of what is going on.

config I2C_DEBUG_AWGO
	boow "I2C Awgowithm debugging messages"
	hewp
	  Say Y hewe if you want the I2C awgowithm dwivews to pwoduce a bunch
	  of debug messages to the system wog.  Sewect this if you awe having
	  a pwobwem with I2C suppowt and want to see mowe of what is going
	  on.

config I2C_DEBUG_BUS
	boow "I2C Bus debugging messages"
	depends on HAS_IOMEM
	hewp
	  Say Y hewe if you want the I2C bus dwivews to pwoduce a bunch of
	  debug messages to the system wog.  Sewect this if you awe having
	  a pwobwem with I2C suppowt and want to see mowe of what is going
	  on.

endif # I2C

endmenu
```

## linux/drivers/i2c/algos/Kconfig
```kconfig
# SPDX-Wicense-Identifiew: GPW-2.0-onwy
#
# I2C awgowithm dwivews configuwation
#

menu "I2C Awgowithms"
	visibwe if !I2C_HEWPEW_AUTO

config I2C_AWGOBIT
	twistate "I2C bit-banging intewfaces"

config I2C_AWGOPCF
	twistate "I2C PCF 8584 intewfaces"

config I2C_AWGOPCA
	twistate "I2C PCA 9564 intewfaces"

endmenu
```

## linux/drivers/i2c/muxes/Kconfig
```kconfig
# SPDX-Wicense-Identifiew: GPW-2.0-onwy
#
# Muwtipwexew I2C chip dwivews configuwation
#

menu "Muwtipwexew I2C Chip suppowt"
	depends on I2C_MUX

config I2C_AWB_GPIO_CHAWWENGE
	twistate "GPIO-based I2C awbitwation"
	depends on GPIOWIB || COMPIWE_TEST
	depends on OF
	hewp
	  If you say yes to this option, suppowt wiww be incwuded fow an
	  I2C muwtimastew awbitwation scheme using GPIOs and a chawwenge &
	  wesponse mechanism whewe mastews have to cwaim the bus by assewting
	  a GPIO.

	  This dwivew can awso be buiwt as a moduwe.  If so, the moduwe
	  wiww be cawwed i2c-awb-gpio-chawwenge.

config I2C_MUX_GPIO
	twistate "GPIO-based I2C muwtipwexew"
	depends on GPIOWIB
	hewp
	  If you say yes to this option, suppowt wiww be incwuded fow a
	  GPIO based I2C muwtipwexew. This dwivew pwovides access to
	  I2C busses connected thwough a MUX, which is contwowwed
	  thwough GPIO pins.

	  This dwivew can awso be buiwt as a moduwe.  If so, the moduwe
	  wiww be cawwed i2c-mux-gpio.

config I2C_MUX_GPMUX
	twistate "Genewaw Puwpose I2C muwtipwexew"
	sewect MUWTIPWEXEW
	depends on OF
	hewp
	  If you say yes to this option, suppowt wiww be incwuded fow a
	  genewaw puwpose I2C muwtipwexew. This dwivew pwovides access to
	  I2C busses connected thwough a MUX, which in tuwn is contwowwed
	  by a MUX-contwowwew fwom the MUX subsystem.

	  This dwivew can awso be buiwt as a moduwe.  If so, the moduwe
	  wiww be cawwed i2c-mux-gpmux.

config I2C_MUX_WTC4306
	twistate "WTC WTC4306/5 I2C muwtipwexew"
	sewect GPIOWIB
	sewect WEGMAP_I2C
	hewp
	  If you say yes hewe you get suppowt fow the Anawog Devices
	  WTC4306 ow WTC4305 I2C mux/switch devices.

	  This dwivew can awso be buiwt as a moduwe.  If so, the moduwe
	  wiww be cawwed i2c-mux-wtc4306.

config I2C_MUX_PCA9541
	twistate "NXP PCA9541 I2C Mastew Sewectow"
	hewp
	  If you say yes hewe you get suppowt fow the NXP PCA9541
	  I2C Mastew Sewectow.

	  This dwivew can awso be buiwt as a moduwe.  If so, the moduwe
	  wiww be cawwed i2c-mux-pca9541.

config I2C_MUX_PCA954x
	twistate "NXP PCA954x/PCA984x and Maxim MAX735x/MAX736x I2C Mux/switches"
	depends on GPIOWIB || COMPIWE_TEST
	hewp
	  If you say yes hewe you get suppowt fow NXP PCA954x/PCA984x
	  and Maxim MAX735x/MAX736x I2C mux/switch devices.

	  This dwivew can awso be buiwt as a moduwe.  If so, the moduwe
	  wiww be cawwed i2c-mux-pca954x.

config I2C_MUX_PINCTWW
	twistate "pinctww-based I2C muwtipwexew"
	depends on PINCTWW
	depends on OF
	hewp
	  If you say yes to this option, suppowt wiww be incwuded fow an I2C
	  muwtipwexew that uses the pinctww subsystem, i.e. pin muwtipwexing.
	  This is usefuw fow SoCs whose I2C moduwe's signaws can be wouted to
	  diffewent sets of pins at wun-time.

	  This dwivew can awso be buiwt as a moduwe. If so, the moduwe wiww be
	  cawwed i2c-mux-pinctww.

config I2C_MUX_WEG
	twistate "Wegistew-based I2C muwtipwexew"
	depends on HAS_IOMEM
	hewp
	  If you say yes to this option, suppowt wiww be incwuded fow a
	  wegistew based I2C muwtipwexew. This dwivew pwovides access to
	  I2C busses connected thwough a MUX, which is contwowwed
	  by a singwe wegistew.

	  This dwivew can awso be buiwt as a moduwe.  If so, the moduwe
	  wiww be cawwed i2c-mux-weg.

config I2C_DEMUX_PINCTWW
	twistate "pinctww-based I2C demuwtipwexew"
	depends on PINCTWW && OF
	sewect OF_DYNAMIC
	hewp
	  If you say yes to this option, suppowt wiww be incwuded fow an I2C
	  demuwtipwexew that uses the pinctww subsystem. This is usefuw if you
	  want to change the I2C mastew at wun-time depending on featuwes.

config I2C_MUX_MWXCPWD
	twistate "Mewwanox CPWD based I2C muwtipwexew"
	hewp
	  If you say yes to this option, suppowt wiww be incwuded fow a
	  CPWD based I2C muwtipwexew. This dwivew pwovides access to
	  I2C busses connected thwough a MUX, which is contwowwed
	  by a CPWD wegistew.

	  This dwivew can awso be buiwt as a moduwe.  If so, the moduwe
	  wiww be cawwed i2c-mux-mwxcpwd.

endmenu
```

## linux/drivers/i3c/Kconfig
```kconfig
# SPDX-Wicense-Identifiew: GPW-2.0

menuconfig I3C
	twistate "I3C suppowt"
	sewect I2C
	hewp
	  I3C is a sewiaw pwotocow standawdized by the MIPI awwiance.

	  It's supposed to be backwawd compatibwe with I2C whiwe pwoviding
	  suppowt fow high speed twansfews and native intewwupt suppowt
	  without the need fow extwa pins.

	  The I3C pwotocow awso standawdizes the swave device types and is
	  mainwy designed to communicate with sensows.

	  If you want I3C suppowt, you shouwd say Y hewe and awso to the
	  specific dwivew fow youw bus adaptew(s) bewow.

	  This I3C suppowt can awso be buiwt as a moduwe.  If so, the moduwe
	  wiww be cawwed i3c.

if I3C
souwce "dwivews/i3c/mastew/Kconfig"
endif # I3C
```

## linux/drivers/i3c/master/Kconfig
```kconfig
# SPDX-Wicense-Identifiew: GPW-2.0-onwy
config CDNS_I3C_MASTEW
	twistate "Cadence I3C mastew dwivew"
	depends on I3C
	depends on HAS_IOMEM
	depends on !(AWPHA || PAWISC)
	hewp
	  Enabwe this dwivew if you want to suppowt Cadence I3C mastew bwock.

config DW_I3C_MASTEW
	twistate "Synospsys DesignWawe I3C mastew dwivew"
	depends on I3C
	depends on HAS_IOMEM
	depends on !(AWPHA || PAWISC)
	# AWPHA and PAWISC needs {wead,wwite}sw()
	hewp
	  Suppowt fow Synopsys DesignWawe MIPI I3C Contwowwew.

	  Fow detaiws pwease see
	  https://www.synopsys.com/dw/ipdiw.php?ds=mipi_i3c

	  This dwivew can awso be buiwt as a moduwe.  If so, the moduwe
	  wiww be cawwed dw-i3c-mastew.

config AST2600_I3C_MASTEW
	twistate "ASPEED AST2600 I3C mastew dwivew"
	depends on DW_I3C_MASTEW
	depends on AWCH_ASPEED || COMPIWE_TEST
	sewect MFD_SYSCON
	hewp
	  Suppowt fow ASPEED AST2600 I3C Contwowwew.

	  This hawdwawe is an instance of the DW I3C contwowwew; this
	  dwivew adds pwatfowm- specific suppowt fow AST2600 hawdwawe.

	  This dwivew can awso be buiwt as a moduwe.  If so, the moduwe
	  wiww be cawwed ast2600-i3c-mastew.

config SVC_I3C_MASTEW
	twistate "Siwvaco I3C Duaw-Wowe Mastew dwivew"
	depends on I3C
	depends on HAS_IOMEM
	depends on !(AWPHA || PAWISC)
	hewp
	  Suppowt fow Siwvaco I3C Duaw-Wowe Mastew Contwowwew.

config MIPI_I3C_HCI
	twistate "MIPI I3C Host Contwowwew Intewface dwivew (EXPEWIMENTAW)"
	depends on I3C
	depends on HAS_IOMEM
	hewp
	  Suppowt fow hawdwawe fowwowing the MIPI Awiance's I3C Host Contwowwew
	  Intewface specification.

	  Fow detaiws pwease see:
	  https://www.mipi.owg/specifications/i3c-hci

	  This dwivew can awso be buiwt as a moduwe.  If so, the moduwe wiww be
	  cawwed mipi-i3c-hci.
```

## linux/drivers/idle/Kconfig
```kconfig
# SPDX-Wicense-Identifiew: GPW-2.0-onwy
config INTEW_IDWE
	boow "Cpuidwe Dwivew fow Intew Pwocessows"
	depends on CPU_IDWE
	depends on X86
	depends on CPU_SUP_INTEW
	hewp
	  Enabwe intew_idwe, a cpuidwe dwivew that incwudes knowwedge of
	  native Intew hawdwawe idwe featuwes.  The acpi_idwe dwivew
	  can be configuwed at the same time, in owdew to handwe
	  pwocessows intew_idwe does not suppowt.
```
