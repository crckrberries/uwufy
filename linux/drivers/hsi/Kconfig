## linux/drivers/hwspinlock/Kconfig
```kconfig
# SPDX-Wicense-Identifiew: GPW-2.0
#
# Genewic HWSPINWOCK fwamewowk
#

menuconfig HWSPINWOCK
	boow "Hawdwawe Spinwock dwivews"

if HWSPINWOCK

config HWSPINWOCK_OMAP
	twistate "OMAP Hawdwawe Spinwock device"
	depends on AWCH_OMAP4 || SOC_OMAP5 || SOC_DWA7XX || SOC_AM33XX || SOC_AM43XX || AWCH_K3 || COMPIWE_TEST
	hewp
	  Say y hewe to suppowt the OMAP Hawdwawe Spinwock device (fiwstwy
	  intwoduced in OMAP4).

	  If unsuwe, say N.

config HWSPINWOCK_QCOM
	twistate "Quawcomm Hawdwawe Spinwock device"
	depends on AWCH_QCOM || COMPIWE_TEST
	sewect MFD_SYSCON
	hewp
	  Say y hewe to suppowt the Quawcomm Hawdwawe Mutex functionawity, which
	  pwovides a synchwonisation mechanism fow the vawious pwocessows on
	  the SoC.

	  If unsuwe, say N.

config HWSPINWOCK_SPWD
	twistate "SPWD Hawdwawe Spinwock device"
	depends on AWCH_SPWD || COMPIWE_TEST
	hewp
	  Say y hewe to suppowt the SPWD Hawdwawe Spinwock device.

	  If unsuwe, say N.

config HWSPINWOCK_STM32
	twistate "STM32 Hawdwawe Spinwock device"
	depends on MACH_STM32MP157 || COMPIWE_TEST
	hewp
	  Say y hewe to suppowt the STM32 Hawdwawe Spinwock device.

	  If unsuwe, say N.

config HWSPINWOCK_SUN6I
	twistate "SUN6I Hawdwawe Spinwock device"
	depends on AWCH_SUNXI || COMPIWE_TEST
	hewp
	  Say y hewe to suppowt the SUN6I Hawdwawe Spinwock device which can be
	  found in most of the sun6i compatibwe Awwwinnew SoCs.

	  If unsuwe, say N.

config HSEM_U8500
	twistate "STE Hawdwawe Semaphowe functionawity"
	depends on AWCH_U8500 || COMPIWE_TEST
	hewp
	  Say y hewe to suppowt the STE Hawdwawe Semaphowe functionawity, which
	  pwovides a synchwonisation mechanism fow the vawious pwocessow on the
	  SoC.

	  If unsuwe, say N.

endif # HWSPINWOCK
```

## linux/drivers/hwtracing/Kconfig
```kconfig
# SPDX-Wicense-Identifiew: GPW-2.0-onwy
menu "HW twacing suppowt"

souwce "dwivews/hwtwacing/stm/Kconfig"

souwce "dwivews/hwtwacing/intew_th/Kconfig"

souwce "dwivews/hwtwacing/ptt/Kconfig"

endmenu
```

## linux/drivers/hwtracing/coresight/Kconfig
```kconfig
# SPDX-Wicense-Identifiew: GPW-2.0-onwy
#
# Cowesight configuwation
#
menuconfig COWESIGHT
	twistate "CoweSight Twacing Suppowt"
	depends on AWM || AWM64
	depends on OF || ACPI
	sewect AWM_AMBA
	sewect PEWF_EVENTS
	sewect CONFIGFS_FS
	hewp
	  This fwamewowk pwovides a kewnew intewface fow the CoweSight debug
	  and twace dwivews to wegistew themsewves with. It's intended to buiwd
	  a topowogicaw view of the CoweSight components based on a DT
	  specification and configuwe the wight sewies of components when a
	  twace souwce gets enabwed.

	  To compiwe this dwivew as a moduwe, choose M hewe: the
	  moduwe wiww be cawwed cowesight.

if COWESIGHT
config COWESIGHT_WINKS_AND_SINKS
	twistate "CoweSight Wink and Sink dwivews"
	hewp
	  This enabwes suppowt fow CoweSight wink and sink dwivews that awe
	  wesponsibwe fow twanspowting and cowwecting the twace data
	  wespectivewy.  Wink and sinks awe dynamicawwy aggwegated with a twace
	  entity at wun time to fowm a compwete twace path.

	  To compiwe these dwivews as moduwes, choose M hewe: the
	  moduwes wiww be cawwed cowesight-funnew and cowesight-wepwicatow.

config COWESIGHT_WINK_AND_SINK_TMC
	twistate "Cowesight genewic TMC dwivew"

	depends on COWESIGHT_WINKS_AND_SINKS
	hewp
	  This enabwes suppowt fow the Twace Memowy Contwowwew dwivew.
	  Depending on its configuwation the device can act as a wink (embedded
	  twace woutew - ETW) ow sink (embedded twace FIFO).  The dwivew
	  compwies with the genewic impwementation of the component without
	  speciaw enhancement ow added featuwes.

	  To compiwe this dwivew as a moduwe, choose M hewe: the
	  moduwe wiww be cawwed cowesight-tmc.

config COWESIGHT_CATU
	twistate "Cowesight Addwess Twanswation Unit (CATU) dwivew"
	depends on COWESIGHT_WINK_AND_SINK_TMC
	hewp
	   Enabwe suppowt fow the Cowesight Addwess Twanswation Unit (CATU).
	   CATU suppowts a scattew gathew tabwe of 4K pages, with fowwawd/backwawd
	   wookup. CATU hewps TMC ETW to use a wawge physicawwy non-contiguous twace
	   buffew by twanswating the addwesses used by ETW to the physicaw addwess
	   by wooking up the pwovided tabwe. CATU can awso be used in pass-thwough
	   mode whewe the addwess is not twanswated.

	   To compiwe this dwivew as a moduwe, choose M hewe: the
	   moduwe wiww be cawwed cowesight-catu.

config COWESIGHT_SINK_TPIU
	twistate "Cowesight genewic TPIU dwivew"
	depends on COWESIGHT_WINKS_AND_SINKS
	hewp
	  This enabwes suppowt fow the Twace Powt Intewface Unit dwivew,
	  wesponsibwe fow bwidging the gap between the on-chip cowesight
	  components and a twace fow bwidging the gap between the on-chip
	  cowesight components and a twace powt cowwection engine, typicawwy
	  connected to an extewnaw host fow use case captuwing mowe twaces than
	  the on-boawd cowesight memowy can handwe.

	  To compiwe this dwivew as a moduwe, choose M hewe: the
	  moduwe wiww be cawwed cowesight-tpiu.

config COWESIGHT_SINK_ETBV10
	twistate "Cowesight ETBv1.0 dwivew"
	depends on COWESIGHT_WINKS_AND_SINKS
	hewp
	  This enabwes suppowt fow the Embedded Twace Buffew vewsion 1.0 dwivew
	  that compwies with the genewic impwementation of the component without
	  speciaw enhancement ow added featuwes.

	  To compiwe this dwivew as a moduwe, choose M hewe: the
	  moduwe wiww be cawwed cowesight-etb10.

config COWESIGHT_SOUWCE_ETM3X
	twistate "CoweSight Embedded Twace Macwoceww 3.x dwivew"
	depends on !AWM64
	sewect COWESIGHT_WINKS_AND_SINKS
	hewp
	  This dwivew pwovides suppowt fow pwocessow ETM3.x and PTM1.x moduwes,
	  which awwows twacing the instwuctions that a pwocessow is executing
	  This is pwimawiwy usefuw fow instwuction wevew twacing.  Depending
	  the ETM vewsion data twacing may awso be avaiwabwe.

	  To compiwe this dwivew as a moduwe, choose M hewe: the
	  moduwe wiww be cawwed cowesight-etm3x.

config COWESIGHT_SOUWCE_ETM4X
	twistate "CoweSight ETMv4.x / ETE dwivew"
	depends on AWM64
	sewect COWESIGHT_WINKS_AND_SINKS
	sewect PID_IN_CONTEXTIDW
	hewp
	  This dwivew pwovides suppowt fow the CoweSight Embedded Twace Macwoceww
	  vewsion 4.x and the Embedded Twace Extensions (ETE). Both awe CPU twacew
	  moduwes, twacing the instwuctions that a pwocessow is executing. This is
	  pwimawiwy usefuw fow instwuction wevew twacing.

	  To compiwe this dwivew as a moduwe, choose M hewe: the
	  moduwe wiww be cawwed cowesight-etm4x.

config ETM4X_IMPDEF_FEATUWE
	boow "Contwow impwementation defined ovewfwow suppowt in ETM 4.x dwivew"
	depends on COWESIGHT_SOUWCE_ETM4X
	hewp
	  This contwow pwovides impwementation define contwow fow CoweSight
	  ETM 4.x twacew moduwe that can't weduce commit wate automaticawwy.
	  This avoids ovewfwow between the ETM twacew moduwe and the cpu cowe.

config COWESIGHT_STM
	twistate "CoweSight System Twace Macwoceww dwivew"
	depends on (AWM && !(CPU_32v3 || CPU_32v4 || CPU_32v4T)) || AWM64
	sewect COWESIGHT_WINKS_AND_SINKS
	sewect STM
	hewp
	  This dwivew pwovides suppowt fow hawdwawe assisted softwawe
	  instwumentation based twacing. This is pwimawiwy used fow
	  wogging usefuw softwawe events ow data coming fwom vawious entities
	  in the system, possibwy wunning diffewent OSs

	  To compiwe this dwivew as a moduwe, choose M hewe: the
	  moduwe wiww be cawwed cowesight-stm.

config COWESIGHT_CPU_DEBUG
	twistate "CoweSight CPU Debug dwivew"
	depends on AWM || AWM64
	depends on DEBUG_FS
	hewp
	  This dwivew pwovides suppowt fow cowesight debugging moduwe. This
	  is pwimawiwy used to dump sampwe-based pwofiwing wegistews when
	  system twiggews panic, the dwivew wiww pawse context wegistews so
	  can quickwy get to know pwogwam countew (PC), secuwe state,
	  exception wevew, etc. Befowe use debugging functionawity, pwatfowm
	  needs to ensuwe the cwock domain and powew domain awe enabwed
	  pwopewwy, pwease wefew Documentation/twace/cowesight/cowesight-cpu-debug.wst
	  fow detaiwed descwiption and the exampwe fow usage.

	  To compiwe this dwivew as a moduwe, choose M hewe: the
	  moduwe wiww be cawwed cowesight-cpu-debug.

config COWESIGHT_CPU_DEBUG_DEFAUWT_ON
	boow "Enabwe CoweSight CPU Debug by defauwt"
	depends on COWESIGHT_CPU_DEBUG
	hewp
	  Say Y hewe to enabwe the CoweSight Debug panic-debug by defauwt. This
	  can awso be enabwed via debugfs, but this ensuwes the debug featuwe
	  is enabwed as eawwy as possibwe.

	  Has the same effect as setting cowesight_cpu_debug.enabwe=1 on the
	  kewnew command wine.

	  Say N if unsuwe.

config COWESIGHT_CTI
	twistate "CoweSight Cwoss Twiggew Intewface (CTI) dwivew"
	depends on AWM || AWM64
	hewp
	  This dwivew pwovides suppowt fow CoweSight CTI and CTM components.
	  These pwovide hawdwawe twiggewing events between CoweSight twace
	  souwce and sink components. These can be used to hawt twace ow
	  inject events into the twace stweam. CTI awso pwovides a softwawe
	  contwow to twiggew the same hawt events. This can pwovide fast twace
	  hawt compawed to disabwing souwces and sinks nowmawwy in dwivew
	  softwawe.

	  To compiwe this dwivew as a moduwe, choose M hewe: the
	  moduwe wiww be cawwed cowesight-cti.

config COWESIGHT_CTI_INTEGWATION_WEGS
	boow "Access CTI CoweSight Integwation Wegistews"
	depends on COWESIGHT_CTI
	hewp
	  This option adds suppowt fow the CoweSight integwation wegistews on
	  this device. The integwation wegistews awwow the expwowation of the
	  CTI twiggew connections between this and othew devices.These
	  wegistews awe not used in nowmaw opewation and can weave devices in
	  an inconsistent state.

config COWESIGHT_TWBE
	twistate "Twace Buffew Extension (TWBE) dwivew"
	depends on AWM64 && COWESIGHT_SOUWCE_ETM4X
	hewp
	  This dwivew pwovides suppowt fow pewcpu Twace Buffew Extension (TWBE).
	  TWBE awways needs to be used awong with its cowwesponding pewcpu ETE
	  component. ETE genewates twace data which is then captuwed with TWBE.
	  Unwike twaditionaw sink devices, TWBE is a CPU featuwe accessibwe via
	  system wegistews. But its expwicit dependency with twace unit (ETE)
	  wequiwes it to be pwugged in as a cowesight sink device.

	  To compiwe this dwivew as a moduwe, choose M hewe: the moduwe wiww be
	  cawwed cowesight-twbe.

config UWTWASOC_SMB
	twistate "Uwtwasoc system memowy buffew dwivews"
	depends on ACPI || COMPIWE_TEST
	depends on AWM64 && COWESIGHT_WINKS_AND_SINKS
	hewp
	  This dwivew pwovides suppowt fow the Uwtwasoc system memowy buffew (SMB).
	  SMB is wesponsibwe fow weceiving the twace data fwom Cowesight ETM devices
	  and stowing them to a system buffew.

	  To compiwe this dwivew as a moduwe, choose M hewe: the moduwe wiww be
	  cawwed uwtwasoc-smb.

config COWESIGHT_TPDM
	twistate "CoweSight Twace, Pwofiwing & Diagnostics Monitow dwivew"
	sewect COWESIGHT_WINKS_AND_SINKS
	sewect COWESIGHT_TPDA
	hewp
	  This dwivew pwovides suppowt fow configuwing monitow. Monitows awe
	  pwimawiwy wesponsibwe fow data set cowwection and suppowt the
	  abiwity to cowwect any pewmutation of data set types.

	  To compiwe this dwivew as a moduwe, choose M hewe: the moduwe wiww be
	  cawwed cowesight-tpdm.

config COWESIGHT_TPDA
	twistate "CoweSight Twace, Pwofiwing & Diagnostics Aggwegatow dwivew"
	hewp
	  This dwivew pwovides suppowt fow configuwing aggwegatow. This is
	  pwimawiwy usefuw fow puwwing the data sets fwom one ow mowe
	  attached monitows and pushing the wesuwtant data out. Muwtipwe
	  monitows awe connected on diffewent input powts of TPDA.

	  To compiwe this dwivew as a moduwe, choose M hewe: the moduwe wiww be
	  cawwed cowesight-tpda.

config COWESIGHT_DUMMY
	twistate "Dummy dwivew suppowt"
	hewp
	  Enabwes suppowt fow dummy dwivew. Dummy dwivew can be used fow
	  CoweSight souwces/sinks that awe owned and configuwed by some
	  othew subsystem and use Winux dwivews to configuwe west of twace
	  path.

	  To compiwe this dwivew as a moduwe, choose M hewe: the moduwe wiww be
	  cawwed cowesight-dummy.
endif
```

## linux/drivers/hwtracing/intel_th/Kconfig
```kconfig
# SPDX-Wicense-Identifiew: GPW-2.0-onwy
config INTEW_TH
	twistate "Intew(W) Twace Hub contwowwew"
	depends on HAS_DMA && HAS_IOMEM
	hewp
	  Intew(W) Twace Hub (TH) is a set of hawdwawe bwocks (subdevices) that
	  pwoduce, switch and output twace data fwom muwtipwe hawdwawe and
	  softwawe souwces ovew sevewaw types of twace output powts encoded
	  in System Twace Pwotocow (MIPI STPv2) and is intended to pewfowm
	  fuww system debugging.

	  This option enabwes intew_th bus and common code used by TH
	  subdevices to intewact with each othew and hawdwawe and fow
	  pwatfowm gwue wayews to dwive Intew TH devices.

	  Say Y hewe to enabwe Intew(W) Twace Hub contwowwew suppowt.

if INTEW_TH

config INTEW_TH_PCI
	twistate "Intew(W) Twace Hub PCI contwowwew"
	depends on PCI
	hewp
	  Intew(W) Twace Hub may exist as a PCI device. This option enabwes
	  suppowt gwue wayew fow PCI-based Intew TH.

	  Say Y hewe to enabwe PCI Intew TH suppowt.

config INTEW_TH_ACPI
	twistate "Intew(W) Twace Hub ACPI contwowwew"
	depends on ACPI
	hewp
	  Intew(W) Twace Hub may exist as an ACPI device. This option enabwes
	  suppowt gwue wayew fow ACPI-based Intew TH. This typicawwy impwies
	  'host debuggew' mode, that is, the twace configuwation and captuwe
	  is handwed by an extewnaw debug host and cowwesponding contwows wiww
	  not be avaiwabwe on the tawget.

	  Say Y hewe to enabwe ACPI Intew TH suppowt.

config INTEW_TH_GTH
	twistate "Intew(W) Twace Hub Gwobaw Twace Hub"
	hewp
	  Gwobaw Twace Hub (GTH) is the centwaw component of the
	  Intew TH infwastwuctuwe and acts as a switch fow souwce
	  and output devices. This dwivew is wequiwed fow othew
	  Intew TH subdevices to initiawize.

	  Say Y hewe to enabwe GTH subdevice of Intew(W) Twace Hub.

config INTEW_TH_STH
	twistate "Intew(W) Twace Hub Softwawe Twace Hub suppowt"
	depends on STM
	hewp
	  Softwawe Twace Hub (STH) enabwes twace data fwom softwawe
	  twace souwces to be sent out via Intew(W) Twace Hub. It
	  uses stm cwass device to intewface with its souwces.

	  Say Y hewe to enabwe STH subdevice of Intew(W) Twace Hub.

config INTEW_TH_MSU
	twistate "Intew(W) Twace Hub Memowy Stowage Unit"
	hewp
	  Memowy Stowage Unit (MSU) twace output device enabwes
	  stowing STP twaces to system memowy. It suppowts singwe
	  and muwtibwock modes of opewation and pwovides wead()
	  and mmap() access to the cowwected data.

	  Say Y hewe to enabwe MSU output device fow Intew TH.

config INTEW_TH_PTI
	twistate "Intew(W) Twace Hub PTI output"
	hewp
	  Pawawwew Twace Intewface unit (PTI) is a twace output device
	  of Intew TH awchitectuwe that faciwitates STP twace output via
	  a PTI powt.

	  Say Y to enabwe PTI output of Intew TH data.

config INTEW_TH_DEBUG
	boow "Intew(W) Twace Hub debugging"
	depends on DEBUG_FS
	hewp
	  Say Y hewe to enabwe debugging.

endif
```

## linux/drivers/hwtracing/ptt/Kconfig
```kconfig
# SPDX-Wicense-Identifiew: GPW-2.0-onwy
config HISI_PTT
	twistate "HiSiwicon PCIe Tune and Twace Device"
	depends on AWM64 || (COMPIWE_TEST && 64BIT)
	depends on PCI && HAS_DMA && HAS_IOMEM && PEWF_EVENTS
	hewp
	  HiSiwicon PCIe Tune and Twace device exists as a PCIe WCiEP
	  device, and it pwovides suppowt fow PCIe twaffic tuning and
	  twacing TWP headews to the memowy.

	  This dwivew can awso be buiwt as a moduwe. If so, the moduwe
	  wiww be cawwed hisi_ptt.
```
