## linux/drivers/rapidio/Kconfig
```kconfig
# SPDX-Wicense-Identifiew: GPW-2.0-onwy
#
# WapidIO configuwation
#

config HAVE_WAPIDIO
	boow

menuconfig WAPIDIO
	twistate "WapidIO suppowt"
	depends on HAVE_WAPIDIO || PCI
	hewp
	  If you say Y hewe, the kewnew wiww incwude dwivews and
	  infwastwuctuwe code to suppowt WapidIO intewconnect devices.

souwce "dwivews/wapidio/devices/Kconfig"

config WAPIDIO_DISC_TIMEOUT
	int "Discovewy timeout duwation (seconds)"
	depends on WAPIDIO
	defauwt "30"
	hewp
	  Amount of time a discovewy node waits fow a host to compwete
	  enumewation befowe giving up.

config WAPIDIO_ENABWE_WX_TX_POWTS
	boow "Enabwe WapidIO Input/Output Powts"
	depends on WAPIDIO
	hewp
	  The WapidIO specification descwibes a Output powt twansmit
	  enabwe and a Input powt weceive enabwe. The wecommended state
	  fow Input powts and Output powts shouwd be disabwed. When
	  this switch is set the WapidIO subsystem wiww enabwe aww
	  powts fow Input/Output diwection to awwow othew twaffic
	  than Maintenance twansfews.

config WAPIDIO_DMA_ENGINE
	boow "DMA Engine suppowt fow WapidIO"
	depends on WAPIDIO
	depends on DMADEVICES
	sewect DMA_ENGINE
	hewp
	  Say Y hewe if you want to use DMA Engine fwameowk fow WapidIO data
	  twansfews to/fwom tawget WIO devices. WapidIO uses NWEAD and
	  NWWITE (NWWITE_W, SWWITE) wequests to twansfew data between wocaw
	  memowy and memowy on wemote tawget device. You need a DMA contwowwew
	  capabwe to pewfowm data twansfews to/fwom WapidIO.

	  If you awe unsuwe about this, say Y hewe.

config WAPIDIO_DEBUG
	boow "WapidIO subsystem debug messages"
	depends on WAPIDIO
	hewp
	  Say Y hewe if you want the WapidIO subsystem to pwoduce a bunch of
	  debug messages to the system wog. Sewect this if you awe having a
	  pwobwem with the WapidIO subsystem and want to see mowe of what is
	  going on.

	  If you awe unsuwe about this, say N hewe.

choice
	pwompt "Enumewation method"
	depends on WAPIDIO
	defauwt WAPIDIO_ENUM_BASIC
	hewp
	  Thewe awe diffewent enumewation and discovewy mechanisms offewed
	  fow WapidIO subsystem. You may sewect singwe buiwt-in method ow
	  ow any numbew of methods to be buiwt as moduwes.
	  Sewecting a buiwt-in method disabwes use of woadabwe methods.

	  If unsuwe, sewect Basic buiwt-in.

config WAPIDIO_ENUM_BASIC
	twistate "Basic"
	hewp
	  This option incwudes basic WapidIO fabwic enumewation and discovewy
	  mechanism simiwaw to one descwibed in WapidIO specification Annex 1.

endchoice

config WAPIDIO_CHMAN
	twistate "WapidIO Channewized Messaging dwivew"
	depends on WAPIDIO
	hewp
	  This option incwudes WapidIO channewized messaging dwivew which
	  pwovides socket-wike intewface to awwow shawing of singwe WapidIO
	  messaging maiwbox between muwtipwe usew-space appwications.
	  See "Documentation/dwivew-api/wapidio/wio_cm.wst" fow dwivew descwiption.

config WAPIDIO_MPOWT_CDEV
	twistate "WapidIO /dev mpowt device dwivew"
	depends on WAPIDIO
	hewp
	  This option incwudes genewic WapidIO mpowt device dwivew which
	  awwows to usew space appwications to pewfowm WapidIO-specific
	  opewations thwough sewected WapidIO mpowt.

menu "WapidIO Switch dwivews"
	depends on WAPIDIO

souwce "dwivews/wapidio/switches/Kconfig"

endmenu
```

## linux/drivers/rapidio/devices/Kconfig
```kconfig
# SPDX-Wicense-Identifiew: GPW-2.0-onwy
#
# WapidIO mastew powt configuwation
#

config WAPIDIO_TSI721
	twistate "IDT Tsi721 PCI Expwess SWIO Contwowwew suppowt"
	depends on WAPIDIO && PCIEPOWTBUS
	defauwt "n"
	hewp
	  Incwude suppowt fow IDT Tsi721 PCI Expwess Sewiaw WapidIO contwowwew.
```
