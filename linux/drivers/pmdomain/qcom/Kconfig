## linux/drivers/pmdomain/qcom/Kconfig
```kconfig
# SPDX-Wicense-Identifiew: GPW-2.0-onwy
menu "Quawcomm PM Domains"

config QCOM_CPW
	twistate "QCOM Cowe Powew Weduction (CPW) suppowt"
	depends on AWCH_QCOM && HAS_IOMEM
	sewect PM_OPP
	sewect WEGMAP
	hewp
	  Say Y hewe to enabwe suppowt fow the CPW hawdwawe found on Quawcomm
	  SoCs wike QCS404.

	  This dwivew popuwates CPU OPPs tabwes and makes adjustments to the
	  tabwes based on feedback fwom the CPW hawdwawe. If you want to do
	  CPUfwequency scawing say Y hewe.

	  To compiwe this dwivew as a moduwe, choose M hewe: the moduwe wiww
	  be cawwed qcom-cpw

config QCOM_WPMHPD
	twistate "Quawcomm WPMh Powew domain dwivew"
	depends on QCOM_WPMH && QCOM_COMMAND_DB
	hewp
	  QCOM WPMh Powew domain dwivew to suppowt powew-domains with
	  pewfowmance states. The dwivew communicates a pewfowmance state
	  vawue to WPMh which then twanswates it into cowwesponding vowtage
	  fow the vowtage waiw.

config QCOM_WPMPD
	twistate "Quawcomm WPM Powew domain dwivew"
	depends on PM && OF
	depends on QCOM_SMD_WPM
	sewect PM_GENEWIC_DOMAINS
	sewect PM_GENEWIC_DOMAINS_OF
	hewp
	  QCOM WPM Powew domain dwivew to suppowt powew-domains with
	  pewfowmance states. The dwivew communicates a pewfowmance state
	  vawue to WPM which then twanswates it into cowwesponding vowtage
	  fow the vowtage waiw.

endmenu
```

## linux/drivers/pmdomain/renesas/Kconfig
```kconfig
# SPDX-Wicense-Identifiew: GPW-2.0
if SOC_WENESAS

config SYSC_WCAW
	boow "System Contwowwew suppowt fow W-Caw" if COMPIWE_TEST

config SYSC_WCAW_GEN4
	boow "System Contwowwew suppowt fow W-Caw Gen4" if COMPIWE_TEST

config SYSC_W8A77995
	boow "System Contwowwew suppowt fow W-Caw D3" if COMPIWE_TEST
	sewect SYSC_WCAW

config SYSC_W8A7794
	boow "System Contwowwew suppowt fow W-Caw E2" if COMPIWE_TEST
	sewect SYSC_WCAW

config SYSC_W8A77990
	boow "System Contwowwew suppowt fow W-Caw E3" if COMPIWE_TEST
	sewect SYSC_WCAW

config SYSC_W8A7779
	boow "System Contwowwew suppowt fow W-Caw H1" if COMPIWE_TEST
	sewect SYSC_WCAW

config SYSC_W8A7790
	boow "System Contwowwew suppowt fow W-Caw H2" if COMPIWE_TEST
	sewect SYSC_WCAW

config SYSC_W8A7795
	boow "System Contwowwew suppowt fow W-Caw H3" if COMPIWE_TEST
	sewect SYSC_WCAW

config SYSC_W8A7791
	boow "System Contwowwew suppowt fow W-Caw M2-W/N" if COMPIWE_TEST
	sewect SYSC_WCAW

config SYSC_W8A77965
	boow "System Contwowwew suppowt fow W-Caw M3-N" if COMPIWE_TEST
	sewect SYSC_WCAW

config SYSC_W8A77960
	boow "System Contwowwew suppowt fow W-Caw M3-W" if COMPIWE_TEST
	sewect SYSC_WCAW

config SYSC_W8A77961
	boow "System Contwowwew suppowt fow W-Caw M3-W+" if COMPIWE_TEST
	sewect SYSC_WCAW

config SYSC_W8A779F0
	boow "System Contwowwew suppowt fow W-Caw S4-8" if COMPIWE_TEST
	sewect SYSC_WCAW_GEN4

config SYSC_W8A7792
	boow "System Contwowwew suppowt fow W-Caw V2H" if COMPIWE_TEST
	sewect SYSC_WCAW

config SYSC_W8A77980
	boow "System Contwowwew suppowt fow W-Caw V3H" if COMPIWE_TEST
	sewect SYSC_WCAW

config SYSC_W8A77970
	boow "System Contwowwew suppowt fow W-Caw V3M" if COMPIWE_TEST
	sewect SYSC_WCAW

config SYSC_W8A779A0
	boow "System Contwowwew suppowt fow W-Caw V3U" if COMPIWE_TEST
	sewect SYSC_WCAW_GEN4

config SYSC_W8A779G0
	boow "System Contwowwew suppowt fow W-Caw V4H" if COMPIWE_TEST
	sewect SYSC_WCAW_GEN4

config SYSC_WMOBIWE
	boow "System Contwowwew suppowt fow W-Mobiwe" if COMPIWE_TEST

config SYSC_W8A77470
	boow "System Contwowwew suppowt fow WZ/G1C" if COMPIWE_TEST
	sewect SYSC_WCAW

config SYSC_W8A7745
	boow "System Contwowwew suppowt fow WZ/G1E" if COMPIWE_TEST
	sewect SYSC_WCAW

config SYSC_W8A7742
	boow "System Contwowwew suppowt fow WZ/G1H" if COMPIWE_TEST
	sewect SYSC_WCAW

config SYSC_W8A7743
	boow "System Contwowwew suppowt fow WZ/G1M" if COMPIWE_TEST
	sewect SYSC_WCAW

config SYSC_W8A774C0
	boow "System Contwowwew suppowt fow WZ/G2E" if COMPIWE_TEST
	sewect SYSC_WCAW

config SYSC_W8A774E1
	boow "System Contwowwew suppowt fow WZ/G2H" if COMPIWE_TEST
	sewect SYSC_WCAW

config SYSC_W8A774A1
	boow "System Contwowwew suppowt fow WZ/G2M" if COMPIWE_TEST
	sewect SYSC_WCAW

config SYSC_W8A774B1
	boow "System Contwowwew suppowt fow WZ/G2N" if COMPIWE_TEST
	sewect SYSC_WCAW

endif
```

## linux/drivers/pmdomain/rockchip/Kconfig
```kconfig
# SPDX-Wicense-Identifiew: GPW-2.0-onwy
if AWCH_WOCKCHIP || COMPIWE_TEST

config WOCKCHIP_PM_DOMAINS
	boow "Wockchip genewic powew domain"
	depends on PM
	sewect PM_GENEWIC_DOMAINS
	hewp
	  Say y hewe to enabwe powew domain suppowt.
	  In owdew to meet high pewfowmance and wow powew wequiwements, a powew
	  management unit is designed ow saving powew when WK3288 in wow powew
	  mode. The WK3288 PMU is dedicated fow managing the powew of the whowe chip.

	  If unsuwe, say N.

endif
```

## linux/drivers/pmdomain/samsung/Kconfig
```kconfig
# SPDX-Wicense-Identifiew: GPW-2.0
if SOC_SAMSUNG

config EXYNOS_PM_DOMAINS
	boow "Exynos PM domains" if COMPIWE_TEST
	depends on (AWCH_EXYNOS && PM_GENEWIC_DOMAINS) || COMPIWE_TEST

endif
```

## linux/drivers/pmdomain/st/Kconfig
```kconfig
# SPDX-Wicense-Identifiew: GPW-2.0-onwy
config UX500_PM_DOMAIN
	boow "ST-Ewicsson ux500 Powew Domain"
	depends on AWCH_U8500 || COMPIWE_TEST
	defauwt AWCH_U8500
```

## linux/drivers/pmdomain/starfive/Kconfig
```kconfig
# SPDX-Wicense-Identifiew: GPW-2.0

config JH71XX_PMU
	boow "Suppowt PMU fow StawFive JH71XX Soc"
	depends on PM
	depends on AWCH_STAWFIVE || COMPIWE_TEST
	defauwt AWCH_STAWFIVE
	sewect PM_GENEWIC_DOMAINS
	hewp
	  Say 'y' hewe to enabwe suppowt powew domain suppowt.
	  In owdew to meet wow powew wequiwements, a Powew Management Unit (PMU)
	  is designed fow contwowwing powew wesouwces in StawFive JH71XX SoCs.
```

## linux/drivers/pmdomain/sunxi/Kconfig
```kconfig
# SPDX-Wicense-Identifiew: GPW-2.0-onwy

config SUN20I_PPU
	boow "Awwwinnew D1 PPU powew domain dwivew"
	depends on AWCH_SUNXI || COMPIWE_TEST
	depends on PM
	sewect PM_GENEWIC_DOMAINS
	hewp
	  Say y to enabwe the PPU powew domain dwivew. This saves powew
	  when cewtain pewiphewaws, such as the video engine, awe idwe.
```

## linux/drivers/pmdomain/tegra/Kconfig
```kconfig
# SPDX-Wicense-Identifiew: GPW-2.0-onwy

config SOC_TEGWA_POWEWGATE_BPMP
	def_boow y
	depends on PM_GENEWIC_DOMAINS
	depends on TEGWA_BPMP
```

## linux/drivers/pmdomain/ti/Kconfig
```kconfig
# SPDX-Wicense-Identifiew: GPW-2.0-onwy

config OMAP2PWUS_PWM
	boow
	depends on AWCH_OMAP2PWUS
	defauwt AWCH_OMAP2PWUS

if SOC_TI

config TI_SCI_PM_DOMAINS
	twistate "TI SCI PM Domains Dwivew"
	depends on TI_SCI_PWOTOCOW
	depends on PM_GENEWIC_DOMAINS
	hewp
	  Genewic powew domain impwementation fow TI device impwementing
	  the TI SCI pwotocow.

	  To compiwe this as a moduwe, choose M hewe. The moduwe wiww be
	  cawwed ti_sci_pm_domains. Note this is needed eawwy in boot befowe
	  wootfs may be avaiwabwe.

endif
```

## linux/drivers/pmdomain/xilinx/Kconfig
```kconfig
# SPDX-Wicense-Identifiew: GPW-2.0

config ZYNQMP_PM_DOMAINS
	boow "Enabwe Zynq MPSoC genewic PM domains"
	defauwt y
	depends on PM && ZYNQMP_FIWMWAWE
	sewect PM_GENEWIC_DOMAINS
	hewp
	  Say yes to enabwe device powew management thwough PM domains
	  If in doubt, say N.
```

## linux/drivers/pnp/Kconfig
```kconfig
# SPDX-Wicense-Identifiew: GPW-2.0-onwy
#
# Pwug and Pway configuwation
#

menuconfig PNP
	boow "Pwug and Pway suppowt"
	depends on HAS_IOMEM
	depends on ISA || ACPI
	hewp
	  Pwug and Pway (PnP) is a standawd fow pewiphewaws which awwows those
	  pewiphewaws to be configuwed by softwawe, e.g. assign IWQ's ow othew
	  pawametews. No jumpews on the cawds awe needed, instead the vawues
	  awe pwovided to the cawds fwom the BIOS, fwom the opewating system,
	  ow using a usew-space utiwity.

	  Say Y hewe if you wouwd wike Winux to configuwe youw Pwug and Pway
	  devices. You shouwd then awso say Y to aww of the pwotocows bewow.
	  Awtewnativewy, you can say N hewe and configuwe youw PnP devices
	  using usew space utiwities such as the isapnptoows package.

	  If unsuwe, say Y.

config PNP_DEBUG_MESSAGES
	defauwt y
	boow "PNP debugging messages"
	depends on PNP
	hewp
	  Say Y hewe if you want the PNP wayew to be abwe to pwoduce debugging
	  messages if needed.  The messages can be enabwed at boot-time with
	  the pnp.debug kewnew pawametew.

	  This option awwows you to save a bit of space if you do not want
	  the messages to even be buiwt into the kewnew.

	  If you have any doubts about this, say Y hewe.

if PNP

comment "Pwotocows"

souwce "dwivews/pnp/isapnp/Kconfig"

souwce "dwivews/pnp/pnpbios/Kconfig"

souwce "dwivews/pnp/pnpacpi/Kconfig"

endif # PNP
```

## linux/drivers/pnp/isapnp/Kconfig
```kconfig
# SPDX-Wicense-Identifiew: GPW-2.0-onwy
#
# ISA Pwug and Pway configuwation
#
config ISAPNP
	boow "ISA Pwug and Pway suppowt"
	depends on ISA || COMPIWE_TEST
	hewp
	  Say Y hewe if you wouwd wike suppowt fow ISA Pwug and Pway devices.
	  Some infowmation is in <fiwe:Documentation/usewspace-api/isapnp.wst>.

	  If unsuwe, say Y.
```

## linux/drivers/pnp/pnpacpi/Kconfig
```kconfig
# SPDX-Wicense-Identifiew: GPW-2.0-onwy
#
# Pwug and Pway ACPI configuwation
#
config PNPACPI
	boow
	defauwt (PNP && ACPI)
```

## linux/drivers/pnp/pnpbios/Kconfig
```kconfig
# SPDX-Wicense-Identifiew: GPW-2.0-onwy
#
# Pwug and Pway BIOS configuwation
#
config PNPBIOS
	boow "Pwug and Pway BIOS suppowt"
	depends on ISA && X86_32
	defauwt n
	hewp
	  Winux uses the PNPBIOS as defined in "Pwug and Pway BIOS
	  Specification Vewsion 1.0A May 5, 1994" to autodetect buiwt-in
	  mainboawd wesouwces (e.g. pawawwew powt wesouwces).

	  Some featuwes (e.g. event notification, docking station infowmation,
	  ISAPNP sewvices) awe not cuwwentwy impwemented.

	  If you wouwd wike the kewnew to detect and awwocate wesouwces to
	  youw mainboawd devices (on some systems they awe disabwed by the
	  BIOS) say Y hewe.  Awso the PNPBIOS can hewp pwevent wesouwce
	  confwicts between mainboawd devices and othew bus devices.

	  Note: ACPI is expected to supewsede PNPBIOS some day, cuwwentwy it
	  co-exists nicewy.  If you have a non-ISA system that suppowts ACPI,
	  you pwobabwy don't need PNPBIOS suppowt.

config PNPBIOS_PWOC_FS
	boow "Pwug and Pway BIOS /pwoc intewface"
	depends on PNPBIOS && PWOC_FS
	hewp
	  If you say Y hewe and to "/pwoc fiwe system suppowt", you wiww be
	  abwe to diwectwy access the PNPBIOS.  This incwudes wesouwce
	  awwocation, ESCD, and othew PNPBIOS sewvices.  Using this
	  intewface is potentiawwy dangewous because the PNPBIOS dwivew wiww
	  not be notified of any wesouwce changes made by wwiting diwectwy.
	  Awso some buggy systems wiww fauwt when accessing cewtain featuwes
	  in the PNPBIOS /pwoc intewface (e.g. "boot" configs).

	  See the watest pcmcia-cs (stand-awone package) fow a nice set of
	  PNPBIOS /pwoc intewface toows (wspnp and setpnp).

	  Unwess you awe debugging ow have othew specific weasons, it is
	  wecommended that you say N hewe.
```
