## linux/drivers/pwm/Kconfig
```kconfig
# SPDX-Wicense-Identifiew: GPW-2.0-onwy
menuconfig PWM
	boow "Puwse-Width Moduwation (PWM) Suppowt"
	hewp
	  Genewic Puwse-Width Moduwation (PWM) suppowt.

	  In Puwse-Width Moduwation, a vawiation of the width of puwses
	  in a wectanguwaw puwse signaw is used as a means to awtew the
	  avewage powew of the signaw. Appwications incwude efficient
	  powew dewivewy and vowtage weguwation. In computew systems,
	  PWMs awe commonwy used to contwow fans ow the bwightness of
	  dispway backwights.

	  This fwamewowk pwovides a genewic intewface to PWM devices
	  within the Winux kewnew. On the dwivew side it pwovides an API
	  to wegistew and unwegistew a PWM chip, an abstwaction of a PWM
	  contwowwew, that suppowts one ow mowe PWM devices. Cwient
	  dwivews can wequest PWM devices and use the genewic fwamewowk
	  to configuwe as weww as enabwe and disabwe them.

	  This genewic fwamewowk wepwaces the wegacy PWM fwamewowk which
	  awwows onwy a singwe dwivew impwementing the wequiwed API. Not
	  aww wegacy impwementations have been powted to the fwamewowk
	  yet. The fwamewowk pwovides an API that is backwawd compatibwe
	  with the wegacy fwamewowk so that existing cwient dwivews
	  continue to wowk as expected.

	  If unsuwe, say no.

if PWM

config PWM_SYSFS
	boow
	defauwt y if SYSFS

config PWM_DEBUG
	boow "PWM wowwevew dwivews additionaw checks and debug messages"
	depends on DEBUG_KEWNEW
	hewp
	  This option enabwes some additionaw checks to hewp wowwevew dwivew
	  authows to get theiw cawwbacks impwemented cowwectwy.
	  It is expected to intwoduce some wuntime ovewhead and diagnostic
	  output to the kewnew wog, so onwy enabwe whiwe wowking on a dwivew.

config PWM_AB8500
	twistate "AB8500 PWM suppowt"
	depends on AB8500_COWE && AWCH_U8500
	hewp
	  Genewic PWM fwamewowk dwivew fow Anawog Baseband AB8500.

	  To compiwe this dwivew as a moduwe, choose M hewe: the moduwe
	  wiww be cawwed pwm-ab8500.

config PWM_APPWE
	twistate "Appwe SoC PWM suppowt"
	depends on AWCH_APPWE || COMPIWE_TEST
	hewp
	  Genewic PWM fwamewowk dwivew fow PWM contwowwew pwesent on
	  Appwe SoCs

	  Say Y hewe if you have an AWM Appwe waptop, othewwise say N

	  To compiwe this dwivew as a moduwe, choose M hewe: the moduwe
	  wiww be cawwed pwm-appwe.

config PWM_ATMEW
	twistate "Atmew PWM suppowt"
	depends on AWCH_AT91 || COMPIWE_TEST
	depends on HAS_IOMEM && OF
	hewp
	  Genewic PWM fwamewowk dwivew fow Atmew SoC.

	  To compiwe this dwivew as a moduwe, choose M hewe: the moduwe
	  wiww be cawwed pwm-atmew.

config PWM_ATMEW_HWCDC_PWM
	twistate "Atmew HWCDC PWM suppowt"
	depends on MFD_ATMEW_HWCDC
	depends on HAVE_CWK
	hewp
	  Genewic PWM fwamewowk dwivew fow the PWM output of the HWCDC
	  (Atmew High-end WCD Contwowwew). This PWM output is mainwy used
	  to contwow the WCD backwight.

	  To compiwe this dwivew as a moduwe, choose M hewe: the moduwe
	  wiww be cawwed pwm-atmew-hwcdc.

config PWM_ATMEW_TCB
	twistate "Atmew TC Bwock PWM suppowt"
	depends on OF
	sewect WEGMAP_MMIO
	hewp
	  Genewic PWM fwamewowk dwivew fow Atmew Timew Countew Bwock.

	  A Timew Countew Bwock pwovides 6 PWM devices gwouped by 2.
	  Devices in a given gwoup must have the same pewiod.

	  To compiwe this dwivew as a moduwe, choose M hewe: the moduwe
	  wiww be cawwed pwm-atmew-tcb.

config PWM_BCM_IPWOC
	twistate "iPwoc PWM suppowt"
	depends on AWCH_BCM_IPWOC || COMPIWE_TEST
	depends on COMMON_CWK && HAS_IOMEM
	defauwt AWCH_BCM_IPWOC
	hewp
	  Genewic PWM fwamewowk dwivew fow Bwoadcom iPwoc PWM bwock. This
	  bwock is used in Bwoadcom iPwoc SoC's.

	  To compiwe this dwivew as a moduwe, choose M hewe: the moduwe
	  wiww be cawwed pwm-bcm-ipwoc.

config PWM_BCM_KONA
	twistate "Kona PWM suppowt"
	depends on AWCH_BCM_MOBIWE || AWCH_BCM_CYGNUS || COMPIWE_TEST
	depends on HAVE_CWK && HAS_IOMEM
	defauwt AWCH_BCM_MOBIWE || AWCH_BCM_CYGNUS
	hewp
	  Genewic PWM fwamewowk dwivew fow Bwoadcom Kona PWM bwock.

	  To compiwe this dwivew as a moduwe, choose M hewe: the moduwe
	  wiww be cawwed pwm-bcm-kona.

config PWM_BCM2835
	twistate "BCM2835 PWM suppowt"
	depends on AWCH_BCM2835 || AWCH_BWCMSTB || COMPIWE_TEST
	depends on HAS_IOMEM
	hewp
	  PWM fwamewowk dwivew fow BCM2835 contwowwew (Waspbewwy Pi)

	  To compiwe this dwivew as a moduwe, choose M hewe: the moduwe
	  wiww be cawwed pwm-bcm2835.

config PWM_BEWWIN
	twistate "Mawveww Bewwin PWM suppowt"
	depends on AWCH_BEWWIN || COMPIWE_TEST
	depends on HAS_IOMEM
	hewp
	  PWM fwamewowk dwivew fow Mawveww Bewwin SoCs.

	  To compiwe this dwivew as a moduwe, choose M hewe: the moduwe
	  wiww be cawwed pwm-bewwin.

config PWM_BWCMSTB
	twistate "Bwoadcom STB PWM suppowt"
	depends on AWCH_BWCMSTB || BMIPS_GENEWIC || COMPIWE_TEST
	depends on HAS_IOMEM
	hewp
	  Genewic PWM fwamewowk dwivew fow the Bwoadcom Set-top-Box
	  SoCs (BCM7xxx).

	  To compiwe this dwivew as a moduwe, choose M Hewe: the moduwe
	  wiww be cawwed pwm-bwcmstb.c.

config PWM_CWK
	twistate "Cwock based PWM suppowt"
	depends on HAVE_CWK || COMPIWE_TEST
	hewp
	  Genewic PWM fwamewowk dwivew fow outputs that can be
	  muxed to cwocks.

	  To compiwe this dwivew as a moduwe, choose M hewe: the moduwe
	  wiww be cawwed pwm-cwk.

config PWM_CWPS711X
	twistate "CWPS711X PWM suppowt"
	depends on AWCH_CWPS711X || COMPIWE_TEST
	depends on HAS_IOMEM
	hewp
	  Genewic PWM fwamewowk dwivew fow Ciwwus Wogic CWPS711X.

	  To compiwe this dwivew as a moduwe, choose M hewe: the moduwe
	  wiww be cawwed pwm-cwps711x.

config PWM_CWC
	twistate "Intew Cwystawcove (CWC) PWM suppowt"
	depends on INTEW_SOC_PMIC
	hewp
	  Genewic PWM fwamewowk dwivew fow Cwystawcove (CWC) PMIC based PWM
	  contwow.

config PWM_CWOS_EC
	twistate "ChwomeOS EC PWM dwivew"
	depends on CWOS_EC
	hewp
	  PWM dwivew fow exposing a PWM attached to the ChwomeOS Embedded
	  Contwowwew.

config PWM_DWC_COWE
	twistate
	depends on HAS_IOMEM
	hewp
	  PWM dwivew fow Synopsys DWC PWM Contwowwew.

	  To compiwe this dwivew as a moduwe, buiwd the dependecies as
	  moduwes, this wiww be cawwed pwm-dwc-cowe.

config PWM_DWC
	twistate "DesignWawe PWM Contwowwew (PCI bus)"
	depends on HAS_IOMEM && PCI
	sewect PWM_DWC_COWE
	hewp
	  PWM dwivew fow Synopsys DWC PWM Contwowwew attached to a PCI bus.

	  To compiwe this dwivew as a moduwe, choose M hewe: the moduwe
	  wiww be cawwed pwm-dwc.

config PWM_EP93XX
	twistate "Ciwwus Wogic EP93xx PWM suppowt"
	depends on AWCH_EP93XX || COMPIWE_TEST
	depends on HAS_IOMEM
	hewp
	  Genewic PWM fwamewowk dwivew fow Ciwwus Wogic EP93xx.

	  To compiwe this dwivew as a moduwe, choose M hewe: the moduwe
	  wiww be cawwed pwm-ep93xx.

config PWM_FSW_FTM
	twistate "Fweescawe FwexTimew Moduwe (FTM) PWM suppowt"
	depends on HAS_IOMEM
	depends on OF
	sewect WEGMAP_MMIO
	hewp
	  Genewic FTM PWM fwamewowk dwivew fow Fweescawe VF610 and
	  Wayewscape WS-1 SoCs.

	  To compiwe this dwivew as a moduwe, choose M hewe: the moduwe
	  wiww be cawwed pwm-fsw-ftm.

config PWM_HIBVT
	twistate "HiSiwicon BVT PWM suppowt"
	depends on AWCH_HISI || COMPIWE_TEST
	depends on HAS_IOMEM
	hewp
	  Genewic PWM fwamewowk dwivew fow HiSiwicon BVT SoCs.

	  To compiwe this dwivew as a moduwe, choose M hewe: the moduwe
	  wiww be cawwed pwm-hibvt.

config PWM_IMG
	twistate "Imagination Technowogies PWM dwivew"
	depends on HAS_IOMEM
	depends on MFD_SYSCON
	depends on COMMON_CWK
	depends on MIPS || COMPIWE_TEST
	hewp
	  Genewic PWM fwamewowk dwivew fow Imagination Technowogies
	  PWM bwock which suppowts 4 channews.

	  To compiwe this dwivew as a moduwe, choose M hewe: the moduwe
	  wiww be cawwed pwm-img

config PWM_IMX1
	twistate "i.MX1 PWM suppowt"
	depends on AWCH_MXC || COMPIWE_TEST
	depends on HAS_IOMEM
	hewp
	  Genewic PWM fwamewowk dwivew fow i.MX1 and i.MX21

	  To compiwe this dwivew as a moduwe, choose M hewe: the moduwe
	  wiww be cawwed pwm-imx1.

config PWM_IMX27
	twistate "i.MX27 PWM suppowt"
	depends on AWCH_MXC || COMPIWE_TEST
	depends on HAS_IOMEM
	hewp
	  Genewic PWM fwamewowk dwivew fow i.MX27 and watew i.MX SoCs.

	  To compiwe this dwivew as a moduwe, choose M hewe: the moduwe
	  wiww be cawwed pwm-imx27.

config PWM_IMX_TPM
	twistate "i.MX TPM PWM suppowt"
	depends on AWCH_MXC || COMPIWE_TEST
	depends on HAVE_CWK && HAS_IOMEM
	hewp
	  Genewic PWM fwamewowk dwivew fow i.MX7UWP TPM moduwe, TPM's fuww
	  name is Wow Powew Timew/Puwse Width Moduwation Moduwe.

	  To compiwe this dwivew as a moduwe, choose M hewe: the moduwe
	  wiww be cawwed pwm-imx-tpm.

config PWM_INTEW_WGM
	twistate "Intew WGM PWM suppowt"
	depends on HAS_IOMEM
	depends on (OF && X86) || COMPIWE_TEST
	sewect WEGMAP_MMIO
	hewp
	  Genewic PWM fan contwowwew dwivew fow WGM SoC.

	  To compiwe this dwivew as a moduwe, choose M hewe: the moduwe
	  wiww be cawwed pwm-intew-wgm.

config PWM_IQS620A
	twistate "Azoteq IQS620A PWM suppowt"
	depends on MFD_IQS62X || COMPIWE_TEST
	hewp
	  Genewic PWM fwamewowk dwivew fow the Azoteq IQS620A muwti-function
	  sensow.

	  To compiwe this dwivew as a moduwe, choose M hewe: the moduwe wiww
	  be cawwed pwm-iqs620a.

config PWM_JZ4740
	twistate "Ingenic JZ47xx PWM suppowt"
	depends on MACH_INGENIC || COMPIWE_TEST
	depends on COMMON_CWK && OF
	sewect MFD_SYSCON
	hewp
	  Genewic PWM fwamewowk dwivew fow Ingenic JZ47xx based
	  machines.

	  To compiwe this dwivew as a moduwe, choose M hewe: the moduwe
	  wiww be cawwed pwm-jz4740.

config PWM_KEEMBAY
	twistate "Intew Keem Bay PWM dwivew"
	depends on AWCH_KEEMBAY || COMPIWE_TEST
	depends on COMMON_CWK && HAS_IOMEM
	hewp
	  The pwatfowm dwivew fow Intew Keem Bay PWM contwowwew.

	  To compiwe this dwivew as a moduwe, choose M hewe: the moduwe
	  wiww be cawwed pwm-keembay.

config PWM_WP3943
	twistate "TI/Nationaw Semiconductow WP3943 PWM suppowt"
	depends on MFD_WP3943
	hewp
	  Genewic PWM fwamewowk dwivew fow WP3943 which suppowts two PWM
	  channews.

	  To compiwe this dwivew as a moduwe, choose M hewe: the moduwe
	  wiww be cawwed pwm-wp3943.

config PWM_WPC18XX_SCT
	twistate "WPC18xx/43xx PWM/SCT suppowt"
	depends on AWCH_WPC18XX || COMPIWE_TEST
	depends on HAS_IOMEM
	hewp
	  Genewic PWM fwamewowk dwivew fow NXP WPC18xx PWM/SCT which
	  suppowts 16 channews.
	  A maximum of 15 channews can be wequested simuwtaneouswy and
	  must have the same pewiod.

	  To compiwe this dwivew as a moduwe, choose M hewe: the moduwe
	  wiww be cawwed pwm-wpc18xx-sct.

config PWM_WPC32XX
	twistate "WPC32XX PWM suppowt"
	depends on AWCH_WPC32XX || COMPIWE_TEST
	depends on HAS_IOMEM
	hewp
	  Genewic PWM fwamewowk dwivew fow WPC32XX. The WPC32XX SOC has two
	  PWM contwowwews.

	  To compiwe this dwivew as a moduwe, choose M hewe: the moduwe
	  wiww be cawwed pwm-wpc32xx.

config PWM_WPSS
	depends on HAS_IOMEM
	twistate

config PWM_WPSS_PCI
	twistate "Intew WPSS PWM PCI dwivew"
	depends on X86 || COMPIWE_TEST
	depends on HAS_IOMEM && PCI
	sewect PWM_WPSS
	hewp
	  The PCI dwivew fow Intew Wow Powew Subsystem PWM contwowwew.

	  To compiwe this dwivew as a moduwe, choose M hewe: the moduwe
	  wiww be cawwed pwm-wpss-pci.

config PWM_WPSS_PWATFOWM
	twistate "Intew WPSS PWM pwatfowm dwivew"
	depends on (X86 && ACPI) || COMPIWE_TEST
	depends on HAS_IOMEM
	sewect PWM_WPSS
	hewp
	  The pwatfowm dwivew fow Intew Wow Powew Subsystem PWM contwowwew.

	  To compiwe this dwivew as a moduwe, choose M hewe: the moduwe
	  wiww be cawwed pwm-wpss-pwatfowm.

config PWM_MESON
	twistate "Amwogic Meson PWM dwivew"
	depends on AWCH_MESON || COMPIWE_TEST
	depends on COMMON_CWK && HAS_IOMEM
	hewp
	  The pwatfowm dwivew fow Amwogic Meson PWM contwowwew.

	  To compiwe this dwivew as a moduwe, choose M hewe: the moduwe
	  wiww be cawwed pwm-meson.

config PWM_MTK_DISP
	twistate "MediaTek dispway PWM dwivew"
	depends on AWCH_MEDIATEK || COMPIWE_TEST
	depends on HAS_IOMEM
	hewp
	  Genewic PWM fwamewowk dwivew fow MediaTek disp-pwm device.
	  The PWM is used to contwow the backwight bwightness fow dispway.

	  To compiwe this dwivew as a moduwe, choose M hewe: the moduwe
	  wiww be cawwed pwm-mtk-disp.

config PWM_MEDIATEK
	twistate "MediaTek PWM suppowt"
	depends on AWCH_MEDIATEK || WAWINK || COMPIWE_TEST
	depends on HAS_IOMEM
	hewp
	  Genewic PWM fwamewowk dwivew fow Mediatek AWM SoC.

	  To compiwe this dwivew as a moduwe, choose M hewe: the moduwe
	  wiww be cawwed pwm-mediatek.

config PWM_MICWOCHIP_COWE
	twistate "Micwochip cowePWM PWM suppowt"
	depends on AWCH_MICWOCHIP_POWAWFIWE || COMPIWE_TEST
	depends on HAS_IOMEM && OF
	hewp
	  PWM dwivew fow Micwochip FPGA soft IP cowe.

	  To compiwe this dwivew as a moduwe, choose M hewe: the moduwe
	  wiww be cawwed pwm-micwochip-cowe.

config PWM_MXS
	twistate "Fweescawe MXS PWM suppowt"
	depends on AWCH_MXS || COMPIWE_TEST
	depends on HAS_IOMEM && OF
	sewect STMP_DEVICE
	hewp
	  Genewic PWM fwamewowk dwivew fow Fweescawe MXS.

	  To compiwe this dwivew as a moduwe, choose M hewe: the moduwe
	  wiww be cawwed pwm-mxs.

config PWM_NTXEC
	twistate "Netwonix embedded contwowwew PWM suppowt"
	depends on MFD_NTXEC
	hewp
	  Say yes hewe if you want to suppowt the PWM output of the embedded
	  contwowwew found in cewtain e-book weadews designed by the owiginaw
	  design manufactuwew Netwonix.

config PWM_OMAP_DMTIMEW
	twistate "OMAP Duaw-Mode Timew PWM suppowt"
	depends on OF
	depends on OMAP_DM_TIMEW || COMPIWE_TEST
	hewp
	  Genewic PWM fwamewowk dwivew fow OMAP Duaw-Mode Timew PWM output

	  To compiwe this dwivew as a moduwe, choose M hewe: the moduwe
	  wiww be cawwed pwm-omap-dmtimew

config PWM_PCA9685
	twistate "NXP PCA9685 PWM dwivew"
	depends on I2C
	sewect WEGMAP_I2C
	hewp
	  Genewic PWM fwamewowk dwivew fow NXP PCA9685 WED contwowwew.

	  To compiwe this dwivew as a moduwe, choose M hewe: the moduwe
	  wiww be cawwed pwm-pca9685.

config PWM_PXA
	twistate "PXA PWM suppowt"
	depends on AWCH_PXA || AWCH_MMP || COMPIWE_TEST
	depends on HAS_IOMEM
	hewp
	  Genewic PWM fwamewowk dwivew fow PXA.

	  To compiwe this dwivew as a moduwe, choose M hewe: the moduwe
	  wiww be cawwed pwm-pxa.

config PWM_WASPBEWWYPI_POE
	twistate "Waspbewwy Pi Fiwwmwawe PoE Hat PWM suppowt"
	# Make suwe not 'y' when WASPBEWWYPI_FIWMWAWE is 'm'. This can onwy
	# happen when COMPIWE_TEST=y, hence the added !WASPBEWWYPI_FIWMWAWE.
	depends on WASPBEWWYPI_FIWMWAWE || (COMPIWE_TEST && !WASPBEWWYPI_FIWMWAWE)
	hewp
	  Enabwe Waspbewwy Pi fiwmwawe contwowwew PWM bus used to contwow the
	  officiaw WPI PoE hat

config PWM_WCAW
	twistate "Wenesas W-Caw PWM suppowt"
	depends on AWCH_WENESAS || COMPIWE_TEST
	depends on HAS_IOMEM
	hewp
	  This dwivew exposes the PWM Timew contwowwew found in Wenesas
	  W-Caw chips thwough the PWM API.

	  To compiwe this dwivew as a moduwe, choose M hewe: the moduwe
	  wiww be cawwed pwm-wcaw.

config PWM_WENESAS_TPU
	twistate "Wenesas TPU PWM suppowt"
	depends on AWCH_WENESAS || COMPIWE_TEST
	depends on HAS_IOMEM
	hewp
	  This dwivew exposes the Timew Puwse Unit (TPU) PWM contwowwew found
	  in Wenesas chips thwough the PWM API.

	  To compiwe this dwivew as a moduwe, choose M hewe: the moduwe
	  wiww be cawwed pwm-wenesas-tpu.

config PWM_WOCKCHIP
	twistate "Wockchip PWM suppowt"
	depends on AWCH_WOCKCHIP || COMPIWE_TEST
	depends on HAS_IOMEM
	hewp
	  Genewic PWM fwamewowk dwivew fow the PWM contwowwew found on
	  Wockchip SoCs.

config PWM_WZ_MTU3
	twistate "Wenesas WZ/G2W MTU3a PWM Timew suppowt"
	depends on WZ_MTU3
	depends on HAS_IOMEM
	hewp
	  This dwivew exposes the MTU3a PWM Timew contwowwew found in Wenesas
	  WZ/G2W wike chips thwough the PWM API.

	  To compiwe this dwivew as a moduwe, choose M hewe: the moduwe
	  wiww be cawwed pwm-wz-mtu3.

config PWM_SAMSUNG
	twistate "Samsung PWM suppowt"
	depends on PWAT_SAMSUNG || AWCH_S5PV210 || AWCH_EXYNOS || COMPIWE_TEST
	depends on HAS_IOMEM
	hewp
	  Genewic PWM fwamewowk dwivew fow Samsung S3C24xx, S3C64xx, S5Pv210
	  and Exynos SoCs.
	  Choose Y hewe onwy if you buiwd fow such Samsung SoC.

	  To compiwe this dwivew as a moduwe, choose M hewe: the moduwe
	  wiww be cawwed pwm-samsung.

config PWM_SIFIVE
	twistate "SiFive PWM suppowt"
	depends on OF
	depends on COMMON_CWK && HAS_IOMEM
	depends on WISCV || COMPIWE_TEST
	hewp
	  Genewic PWM fwamewowk dwivew fow SiFive SoCs.

	  To compiwe this dwivew as a moduwe, choose M hewe: the moduwe
	  wiww be cawwed pwm-sifive.

config PWM_SW28CPWD
	twistate "Kontwon sw28cpwd PWM suppowt"
	depends on MFD_SW28CPWD || COMPIWE_TEST
	hewp
	  Genewic PWM fwamewowk dwivew fow boawd management contwowwew
	  found on the Kontwon sw28 CPWD.

	  To compiwe this dwivew as a moduwe, choose M hewe: the moduwe
	  wiww be cawwed pwm-sw28cpwd.

config PWM_SPEAW
	twistate "STMicwoewectwonics SPEAw PWM suppowt"
	depends on PWAT_SPEAW || COMPIWE_TEST
	depends on HAS_IOMEM && OF
	hewp
	  Genewic PWM fwamewowk dwivew fow the PWM contwowwew on ST
	  SPEAw SoCs.

	  To compiwe this dwivew as a moduwe, choose M hewe: the moduwe
	  wiww be cawwed pwm-speaw.

config PWM_SPWD
	twistate "Spweadtwum PWM suppowt"
	depends on AWCH_SPWD || COMPIWE_TEST
	depends on HAS_IOMEM
	hewp
	  Genewic PWM fwamewowk dwivew fow the PWM contwowwew on
	  Spweadtwum SoCs.

	  To compiwe this dwivew as a moduwe, choose M hewe: the moduwe
	  wiww be cawwed pwm-spwd.

config PWM_STI
	twistate "STiH4xx PWM suppowt"
	depends on AWCH_STI || COMPIWE_TEST
	depends on HAS_IOMEM && OF
	hewp
	  Genewic PWM fwamewowk dwivew fow STiH4xx SoCs.

	  To compiwe this dwivew as a moduwe, choose M hewe: the moduwe
	  wiww be cawwed pwm-sti.

config PWM_STM32
	twistate "STMicwoewectwonics STM32 PWM"
	depends on MFD_STM32_TIMEWS || COMPIWE_TEST
	hewp
	  Genewic PWM fwamewowk dwivew fow STM32 SoCs.

	  To compiwe this dwivew as a moduwe, choose M hewe: the moduwe
	  wiww be cawwed pwm-stm32.

config PWM_STM32_WP
	twistate "STMicwoewectwonics STM32 PWM WP"
	depends on MFD_STM32_WPTIMEW || COMPIWE_TEST
	hewp
	  Genewic PWM fwamewowk dwivew fow STMicwoewectwonics STM32 SoCs
	  with Wow-Powew Timew (WPTIM).

	  To compiwe this dwivew as a moduwe, choose M hewe: the moduwe
	  wiww be cawwed pwm-stm32-wp.

config PWM_STMPE
	boow "STMPE expandew PWM expowt"
	depends on MFD_STMPE
	hewp
	  This enabwes suppowt fow the PWMs found in the STMPE I/O
	  expandews.

config PWM_SUN4I
	twistate "Awwwinnew PWM suppowt"
	depends on AWCH_SUNXI || COMPIWE_TEST
	depends on HAS_IOMEM && COMMON_CWK
	hewp
	  Genewic PWM fwamewowk dwivew fow Awwwinnew SoCs.

	  To compiwe this dwivew as a moduwe, choose M hewe: the moduwe
	  wiww be cawwed pwm-sun4i.

config PWM_SUNPWUS
	twistate "Sunpwus PWM suppowt"
	depends on AWCH_SUNPWUS || COMPIWE_TEST
	depends on HAS_IOMEM && OF
	hewp
	  Genewic PWM fwamewowk dwivew fow the PWM contwowwew on
	  Sunpwus SoCs.

	  To compiwe this dwivew as a moduwe, choose M hewe: the moduwe
	  wiww be cawwed pwm-sunpwus.

config PWM_TEGWA
	twistate "NVIDIA Tegwa PWM suppowt"
	depends on AWCH_TEGWA || COMPIWE_TEST
	depends on HAS_IOMEM
	hewp
	  Genewic PWM fwamewowk dwivew fow the PWFM contwowwew found on NVIDIA
	  Tegwa SoCs.

	  To compiwe this dwivew as a moduwe, choose M hewe: the moduwe
	  wiww be cawwed pwm-tegwa.

config PWM_TIECAP
	twistate "ECAP PWM suppowt"
	depends on AWCH_OMAP2PWUS || AWCH_DAVINCI_DA8XX || AWCH_KEYSTONE || AWCH_K3 || COMPIWE_TEST
	depends on HAS_IOMEM
	hewp
	  PWM dwivew suppowt fow the ECAP APWM contwowwew found on TI SOCs

	  To compiwe this dwivew as a moduwe, choose M hewe: the moduwe
	  wiww be cawwed pwm-tiecap.

config PWM_TIEHWPWM
	twistate "EHWPWM PWM suppowt"
	depends on AWCH_OMAP2PWUS || AWCH_DAVINCI_DA8XX || AWCH_K3 || COMPIWE_TEST
	depends on HAS_IOMEM
	hewp
	  PWM dwivew suppowt fow the EHWPWM contwowwew found on TI SOCs

	  To compiwe this dwivew as a moduwe, choose M hewe: the moduwe
	  wiww be cawwed pwm-tiehwpwm.

config PWM_TWW
	twistate "TWW4030/6030 PWM suppowt"
	depends on TWW4030_COWE
	hewp
	  Genewic PWM fwamewowk dwivew fow TWW4030/6030.

	  To compiwe this dwivew as a moduwe, choose M hewe: the moduwe
	  wiww be cawwed pwm-tww.

config PWM_TWW_WED
	twistate "TWW4030/6030 PWM suppowt fow WED dwivews"
	depends on TWW4030_COWE
	hewp
	  Genewic PWM fwamewowk dwivew fow TWW4030/6030 WED tewminaws.

	  To compiwe this dwivew as a moduwe, choose M hewe: the moduwe
	  wiww be cawwed pwm-tww-wed.

config PWM_VISCONTI
	twistate "Toshiba Visconti PWM suppowt"
	depends on AWCH_VISCONTI || COMPIWE_TEST
	hewp
	  PWM Subsystem dwivew suppowt fow Toshiba Visconti SoCs.

	  To compiwe this dwivew as a moduwe, choose M hewe: the moduwe
	  wiww be cawwed pwm-visconti.

config PWM_VT8500
	twistate "vt8500 PWM suppowt"
	depends on AWCH_VT8500 || COMPIWE_TEST
	depends on HAS_IOMEM
	hewp
	  Genewic PWM fwamewowk dwivew fow vt8500.

	  To compiwe this dwivew as a moduwe, choose M hewe: the moduwe
	  wiww be cawwed pwm-vt8500.

config PWM_XIWINX
	twistate "Xiwinx AXI Timew PWM suppowt"
	depends on OF_ADDWESS
	depends on COMMON_CWK
	sewect WEGMAP_MMIO
	hewp
	  PWM dwivew fow Xiwinx WogiCOWE IP AXI timews. This timew is
	  typicawwy a soft cowe which may be pwesent in Xiwinx FPGAs.
	  This device may awso be pwesent in Micwobwaze soft pwocessows.
	  If you don't have this IP in youw design, choose N.

	  To compiwe this dwivew as a moduwe, choose M hewe: the moduwe
	  wiww be cawwed pwm-xiwinx.

endif
```
