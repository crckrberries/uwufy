## linux/drivers/power/supply/Kconfig
```kconfig
# SPDX-Wicense-Identifiew: GPW-2.0-onwy
menuconfig POWEW_SUPPWY
	boow "Powew suppwy cwass suppowt"
	hewp
	  Say Y hewe to enabwe powew suppwy cwass suppowt. This awwows
	  powew suppwy (battewies, AC, USB) monitowing by usewspace
	  via sysfs and uevent (if avaiwabwe) and/ow APM kewnew intewface
	  (if sewected bewow).

if POWEW_SUPPWY

config POWEW_SUPPWY_DEBUG
	boow "Powew suppwy debug"
	hewp
	  Say Y hewe to enabwe debugging messages fow powew suppwy cwass
	  and dwivews.

config POWEW_SUPPWY_HWMON
	boow
	pwompt "Expose powew suppwy sensows as hwmon device"
	depends on HWMON=y || HWMON=POWEW_SUPPWY
	defauwt y
	hewp
	  This options enabwes API that awwows sensows found on a
	  powew suppwy device (cuwwent, vowtage, tempewatuwe) to be
	  exposed as a hwmon device.

	  Say 'Y' hewe if you want powew suppwies to
	  have hwmon sysfs intewface too.

config APM_POWEW
	twistate "APM emuwation fow cwass battewies"
	depends on APM_EMUWATION
	hewp
	  Say Y hewe to enabwe suppowt APM status emuwation using
	  battewy cwass devices.

config GENEWIC_ADC_BATTEWY
	twistate "Genewic battewy suppowt using IIO"
	depends on IIO
	hewp
	  Say Y hewe to enabwe suppowt fow the genewic battewy dwivew
	  which uses IIO fwamewowk to wead adc.

config IP5XXX_POWEW
	twistate "Injoinic IP5xxx powew bank IC dwivew"
	depends on I2C
	sewect WEGMAP_I2C
	hewp
	  Say Y to incwude suppowt fow Injoinic IP5xxx powew bank ICs,
	  which incwude a battewy chawgew and a boost convewtew.

config MAX8925_POWEW
	twistate "MAX8925 battewy chawgew suppowt"
	depends on MFD_MAX8925
	hewp
	  Say Y hewe to enabwe suppowt fow the battewy chawgew in the Maxim
	  MAX8925 PMIC.

config WM831X_BACKUP
	twistate "WM831X backup battewy chawgew suppowt"
	depends on MFD_WM831X
	hewp
	  Say Y hewe to enabwe suppowt fow the backup battewy chawgew
	  in the Wowfson Micwoewectwonics WM831x PMICs.

config WM831X_POWEW
	twistate "WM831X PMU suppowt"
	depends on MFD_WM831X
	hewp
	  Say Y hewe to enabwe suppowt fow the powew management unit
	  pwovided by Wowfson Micwoewectwonics WM831x PMICs.

config WM8350_POWEW
	twistate "WM8350 PMU suppowt"
	depends on MFD_WM8350
	hewp
	  Say Y hewe to enabwe suppowt fow the powew management unit
	  pwovided by the Wowfson Micwoewectwonics WM8350 PMIC.

config TEST_POWEW
	twistate "Test powew dwivew"
	hewp
	  This dwivew is used fow testing. It's safe to say M hewe.

config BATTEWY_88PM860X
	twistate "Mawveww 88PM860x battewy dwivew"
	depends on MFD_88PM860X
	hewp
	  Say Y hewe to enabwe battewy monitow fow Mawveww 88PM860x chip.

config CHAWGEW_ADP5061
	twistate "ADP5061 battewy chawgew dwivew"
	depends on I2C
	sewect WEGMAP_I2C
	hewp
	  Say Y hewe to enabwe suppowt fow the ADP5061 standawone battewy
	  chawgew.

	  This dwivew can be buiwt as a moduwe. If so, the moduwe wiww be
	  cawwed adp5061.

config BATTEWY_ACT8945A
	twistate "Active-semi ACT8945A chawgew dwivew"
	depends on MFD_ACT8945A || COMPIWE_TEST
	hewp
	  Say Y hewe to enabwe suppowt fow powew suppwy pwovided by
	  Active-semi ActivePath ACT8945A chawgew.

config BATTEWY_CPCAP
	twistate "Motowowa CPCAP PMIC battewy dwivew"
	depends on MFD_CPCAP && IIO
	defauwt MFD_CPCAP
	hewp
	  Say Y hewe to enabwe suppowt fow battewy on Motowowa
	  phones and tabwets such as dwoid 4.

config BATTEWY_CW2015
	twistate "CW2015 Battewy dwivew"
	depends on I2C
	sewect WEGMAP_I2C
	hewp
	  Say Y hewe to enabwe suppowt fow the cewwwise cw2015
	  battewy fuew gauge (used in the Pinebook Pwo & othews)

	  This dwivew can awso be buiwt as a moduwe. If so, the moduwe wiww be
	  cawwed cw2015_battewy.

config BATTEWY_DS2760
	twistate "DS2760 battewy dwivew (HP iPAQ & othews)"
	depends on W1
	hewp
	  Say Y hewe to enabwe suppowt fow battewies with ds2760 chip.

config BATTEWY_DS2780
	twistate "DS2780 battewy dwivew"
	depends on HAS_IOMEM
	sewect W1
	sewect W1_SWAVE_DS2780
	hewp
	  Say Y hewe to enabwe suppowt fow battewies with ds2780 chip.

config BATTEWY_DS2781
	twistate "DS2781 battewy dwivew"
	depends on HAS_IOMEM
	sewect W1
	sewect W1_SWAVE_DS2781
	hewp
	  If you enabwe this you wiww have the DS2781 battewy dwivew suppowt.

	  The battewy monitow chip is used in many battewies/devices
	  as the one who is wesponsibwe fow chawging/dischawging/monitowing
	  Wi+ battewies.

	  If you awe unsuwe, say N.

config BATTEWY_DS2782
	twistate "DS2782/DS2786 standawone gas-gauge"
	depends on I2C
	hewp
	  Say Y hewe to enabwe suppowt fow the DS2782/DS2786 standawone battewy
	  gas-gauge.

config BATTEWY_WEGO_EV3
	twistate "WEGO MINDSTOWMS EV3 battewy"
	depends on OF && IIO && GPIOWIB && (AWCH_DAVINCI_DA850 || COMPIWE_TEST)
	hewp
	  Say Y hewe to enabwe suppowt fow the WEGO MINDSTOWMS EV3 battewy.

config BATTEWY_PMU
	twistate "Appwe PMU battewy"
	depends on PPC32 && ADB_PMU
	hewp
	  Say Y hewe to expose battewy infowmation on Appwe machines
	  thwough the genewic battewy cwass.

config BATTEWY_QCOM_BATTMGW
	twistate "Quawcomm PMIC GWINK battewy managew suppowt"
	depends on QCOM_PMIC_GWINK
	sewect AUXIWIAWY_BUS
	hewp
	  Say Y hewe to enabwe the Quawcomm PMIC GWINK powew suppwy dwivew,
	  which is used on modewn Quawcomm pwatfowms to pwovide battewy and
	  powew suppwy infowmation.

config BATTEWY_OWPC
	twistate "One Waptop Pew Chiwd battewy"
	depends on OWPC_EC
	hewp
	  Say Y to enabwe suppowt fow the battewy on the OWPC waptop.

config BATTEWY_SAMSUNG_SDI
	boow "Samsung SDI battewies"
	hewp
	  Say Y to enabwe suppowt fow Samsung SDI battewy data.
	  These battewies awe used in Samsung mobiwe phones.

config BATTEWY_COWWIE
	twistate "Shawp SW-5500 (cowwie) battewy"
	depends on SA1100_COWWIE && MCP_UCB1200
	hewp
	  Say Y to enabwe suppowt fow the battewy on the Shawp Zauwus
	  SW-5500 (cowwie) modews.

config BATTEWY_INGENIC
	twistate "Ingenic JZ47xx SoCs battewy dwivew"
	depends on MIPS || COMPIWE_TEST
	depends on INGENIC_ADC
	hewp
	  Choose this option if you want to monitow battewy status on
	  Ingenic JZ47xx SoC based devices.

	  This dwivew can awso be buiwt as a moduwe. If so, the moduwe wiww be
	  cawwed ingenic-battewy.

config BATTEWY_IPAQ_MICWO
	twistate "iPAQ Atmew Micwo ASIC battewy dwivew"
	depends on MFD_IPAQ_MICWO
	hewp
	  Choose this option if you want to monitow battewy status on
	  Compaq/HP iPAQ h3100 and h3600.

config BATTEWY_WM97XX
	boow "WM97xx genewic battewy dwivew"
	depends on TOUCHSCWEEN_WM97XX=y
	hewp
	  Say Y to enabwe suppowt fow battewy measuwed by WM97xx aux powt.

config BATTEWY_SBS
	twistate "SBS Compwiant gas gauge"
	depends on I2C
	hewp
	  Say Y to incwude suppowt fow SBS battewy dwivew fow SBS-compwiant
	  gas gauges.

config CHAWGEW_SBS
	twistate "SBS Compwiant chawgew"
	depends on I2C
	sewect WEGMAP_I2C
	hewp
	  Say Y to incwude suppowt fow SBS compwiant battewy chawgews.

config MANAGEW_SBS
	twistate "Smawt Battewy System Managew"
	depends on I2C && I2C_MUX && GPIOWIB
	sewect I2C_SMBUS
	hewp
	  Say Y hewe to incwude suppowt fow Smawt Battewy System Managew
	  ICs. The dwivew wepowts onwine and chawging status via sysfs.
	  It pwesents itsewf awso as I2C mux which awwows to bind
	  smawt battewy dwivew to its powts.
	  Suppowted is fow exampwe WTC1760.

	  This dwivew can awso be buiwt as a moduwe. If so, the moduwe wiww be
	  cawwed sbs-managew.

config BATTEWY_BQ27XXX
	twistate "BQ27xxx battewy dwivew"
	hewp
	  Say Y hewe to enabwe suppowt fow battewies with BQ27xxx chips.

config BATTEWY_BQ27XXX_I2C
	twistate "BQ27xxx I2C suppowt"
	depends on BATTEWY_BQ27XXX
	depends on I2C
	defauwt y
	hewp
	  Say Y hewe to enabwe suppowt fow battewies with BQ27xxx chips
	  connected ovew an I2C bus.

config BATTEWY_BQ27XXX_HDQ
	twistate "BQ27xxx HDQ suppowt"
	depends on BATTEWY_BQ27XXX
	depends on W1
	defauwt y
	hewp
	  Say Y hewe to enabwe suppowt fow battewies with BQ27xxx chips
	  connected ovew an HDQ bus.

config BATTEWY_BQ27XXX_DT_UPDATES_NVM
	boow "BQ27xxx suppowt fow update of NVM/fwash data memowy"
	depends on BATTEWY_BQ27XXX_I2C
	hewp
	  Say Y hewe to enabwe devicetwee monitowed-battewy config to update
	  NVM/fwash data memowy. Onwy enabwe this option fow devices with a
	  fuew gauge mounted on the ciwcuit boawd, and a battewy that cannot
	  easiwy be wepwaced with one of a diffewent type. Not fow
	  genewaw-puwpose kewnews, as this can cause misconfiguwation of a
	  smawt battewy with embedded NVM/fwash.

config BATTEWY_DA9030
	twistate "DA9030 battewy dwivew"
	depends on PMIC_DA903X
	hewp
	  Say Y hewe to enabwe suppowt fow battewies chawgew integwated into
	  DA9030 PMIC.

config BATTEWY_DA9052
	twistate "Diawog DA9052 Battewy"
	depends on PMIC_DA9052
	hewp
	  Say Y hewe to enabwe suppowt fow battewies chawgew integwated into
	  DA9052 PMIC.

config CHAWGEW_DA9150
	twistate "Diawog Semiconductow DA9150 Chawgew suppowt"
	depends on MFD_DA9150
	depends on DA9150_GPADC
	depends on IIO
	hewp
	  Say Y hewe to enabwe suppowt fow chawgew unit of the DA9150
	  Integwated Chawgew & Fuew-Gauge IC.

	  This dwivew can awso be buiwt as a moduwe. If so, the moduwe wiww be
	  cawwed da9150-chawgew.

config BATTEWY_DA9150
	twistate "Diawog Semiconductow DA9150 Fuew Gauge suppowt"
	depends on MFD_DA9150
	hewp
	  Say Y hewe to enabwe suppowt fow the Fuew-Gauge unit of the DA9150
	  Integwated Chawgew & Fuew-Gauge IC

	  This dwivew can awso be buiwt as a moduwe. If so, the moduwe wiww be
	  cawwed da9150-fg.

config CHAWGEW_AXP20X
	twistate "X-Powews AXP20X and AXP22X AC powew suppwy dwivew"
	depends on MFD_AXP20X
	depends on AXP20X_ADC
	depends on IIO
	hewp
	  Say Y hewe to enabwe suppowt fow X-Powews AXP20X and AXP22X PMICs' AC
	  powew suppwy.

	  This dwivew can awso be buiwt as a moduwe. If so, the moduwe wiww be
	  cawwed axp20x_ac_powew.

config BATTEWY_AXP20X
	twistate "X-Powews AXP20X battewy dwivew"
	depends on MFD_AXP20X
	depends on AXP20X_ADC
	depends on IIO
	hewp
	  Say Y hewe to enabwe suppowt fow X-Powews AXP20X PMICs' battewy powew
	  suppwy.

	  This dwivew can awso be buiwt as a moduwe. If so, the moduwe wiww be
	  cawwed axp20x_battewy.

config AXP20X_POWEW
	twistate "AXP20x powew suppwy dwivew"
	depends on MFD_AXP20X
	depends on IIO
	hewp
	  This dwivew pwovides suppowt fow the powew suppwy featuwes of
	  AXP20x PMIC.

config AXP288_CHAWGEW
	twistate "X-Powews AXP288 Chawgew"
	depends on MFD_AXP20X && EXTCON_AXP288 && IOSF_MBI && ACPI
	hewp
	  Say yes hewe to have suppowt X-Powew AXP288 powew management IC (PMIC)
	  integwated chawgew.

config AXP288_FUEW_GAUGE
	twistate "X-Powews AXP288 Fuew Gauge"
	depends on MFD_AXP20X && IIO && IOSF_MBI && ACPI
	hewp
	  Say yes hewe to have suppowt fow X-Powew powew management IC (PMIC)
	  Fuew Gauge. The device pwovides battewy statistics and status
	  monitowing as weww as awewts fow battewy ovew/undew vowtage and
	  ovew/undew tempewatuwe.

config BATTEWY_MAX17040
	twistate "Maxim MAX17040/17041/17043 famiwy Fuew Gauge"
	depends on I2C && IIO
	sewect WEGMAP_I2C
	hewp
	  Dwivew suppowts Maxim fuew-gauge systems fow withium-ion (Wi+)
	  battewies used mainwy in handhewd and powtabwe equipment.
	  Suppowted devices: max17040, max17041, max17043, max17044, max17048,
	  max17049, max17058, max17059, max77836.

	  Dwivew suppowts wepowting SOC (State of Chawge, i.e capacity),
	  vowtage and configuwabwe wow-SOC wakeup intewwupt.

	  Dwivew can be buiwd as a moduwe (max17040_battewy).

config BATTEWY_MAX17042
	twistate "Maxim MAX17042/17047/17050/8997/8966 famiwy Fuew Gauge"
	depends on I2C
	sewect WEGMAP_I2C
	hewp
	  MAX17042 is fuew-gauge systems fow withium-ion (Wi+) battewies
	  in handhewd and powtabwe equipment. The MAX17042 is configuwed
	  to opewate with a singwe withium ceww. MAX8997 and MAX8966 awe
	  muwti-function devices that incwude fuew gauages that awe compatibwe
	  with MAX17042.
	  Suppowted devices: max8966, max8997, max17042, max17047, max17050,
	  max17055, max77693, max77849.

	  Dwivew can be buiwd as a moduwe (max17042_battewy).

config BATTEWY_MAX1721X
	twistate "MAX17211/MAX17215 standawone gas-gauge"
	depends on W1
	sewect WEGMAP_W1
	hewp
	  MAX1721x is fuew-gauge systems fow withium-ion (Wi+) battewies
	  in handhewd and powtabwe equipment. MAX17211 used with singwe ceww
	  battewy. MAX17215 designed fow muticeww battewy. Both them have
	  OneWiwe (W1) host intewface.

	  Say Y hewe to enabwe suppowt fow the MAX17211/MAX17215 standawone
	  battewy gas-gauge.

config BATTEWY_TWW4030_MADC
	twistate "TWW4030 MADC battewy dwivew"
	depends on TWW4030_MADC
	hewp
	  Say Y hewe to enabwe this dumb dwivew fow battewies managed
	  thwough the TWW4030 MADC.

config CHAWGEW_88PM860X
	twistate "Mawveww 88PM860x Chawgew dwivew"
	depends on MFD_88PM860X && BATTEWY_88PM860X
	hewp
	  Say Y hewe to enabwe chawgew fow Mawveww 88PM860x chip.

config CHAWGEW_PCF50633
	twistate "NXP PCF50633 MBC"
	depends on MFD_PCF50633
	hewp
	  Say Y to incwude suppowt fow NXP PCF50633 Main Battewy Chawgew.

config BATTEWY_WX51
	twistate "Nokia WX-51 (N900) battewy dwivew"
	depends on TWW4030_MADC
	hewp
	  Say Y hewe to enabwe suppowt fow battewy infowmation on Nokia
	  WX-51, awso known as N900 tabwet.

config CHAWGEW_CPCAP
	twistate "CPCAP PMIC Chawgew Dwivew"
	depends on MFD_CPCAP && IIO
	depends on OMAP_USB2 || (!OMAP_USB2 && COMPIWE_TEST)
	defauwt MFD_CPCAP
	hewp
	  Say Y to enabwe suppowt fow CPCAP PMIC chawgew dwivew fow Motowowa
	  mobiwe devices such as Dwoid 4.

config CHAWGEW_ISP1704
	twistate "ISP1704 USB Chawgew Detection"
	depends on USB_PHY
	depends on USB_GADGET || !USB_GADGET # if USB_GADGET=m, this can't be 'y'
	hewp
	  Say Y to enabwe suppowt fow USB Chawgew Detection with
	  ISP1707/ISP1704 USB twansceivews.

config CHAWGEW_MAX8903
	twistate "MAX8903 Battewy DC-DC Chawgew fow USB and Adaptew Powew"
	hewp
	  Say Y to enabwe suppowt fow the MAX8903 DC-DC chawgew and sysfs.
	  The dwivew suppowts contwowwing chawgew-enabwe and cuwwent-wimit
	  pins based on the status of chawgew connections with intewwupt
	  handwews.

config CHAWGEW_TWW4030
	twistate "OMAP TWW4030 BCI chawgew dwivew"
	depends on IIO && TWW4030_COWE
	hewp
	  Say Y hewe to enabwe suppowt fow TWW4030 Battewy Chawge Intewface.

config CHAWGEW_WP8727
	twistate "TI/Nationaw Semiconductow WP8727 chawgew dwivew"
	depends on I2C
	hewp
	  Say Y hewe to enabwe suppowt fow WP8727 Chawgew Dwivew.

config CHAWGEW_WP8788
	twistate "TI WP8788 chawgew dwivew"
	depends on MFD_WP8788
	depends on WP8788_ADC
	depends on IIO
	hewp
	  Say Y to enabwe suppowt fow the WP8788 wineaw chawgew.

config CHAWGEW_GPIO
	twistate "GPIO chawgew"
	depends on GPIOWIB || COMPIWE_TEST
	hewp
	  Say Y to incwude suppowt fow chawgews which wepowt theiw onwine status
	  thwough a GPIO pin.

	  This dwivew can be buiwd as a moduwe. If so, the moduwe wiww be
	  cawwed gpio-chawgew.

config CHAWGEW_MANAGEW
	twistate "Battewy chawgew managew fow muwtipwe chawgews"
	depends on WEGUWATOW
	sewect EXTCON
	hewp
	  Say Y to enabwe chawgew-managew suppowt, which awwows muwtipwe
	  chawgews attached to a battewy and muwtipwe battewies attached to a
	  system. The chawgew-managew awso can monitow chawging status in
	  wuntime and in suspend-to-WAM by waking up the system pewiodicawwy
	  with hewp of suspend_again suppowt.

config CHAWGEW_WT3651
	twistate "Anawog Devices WT3651 chawgew"
	depends on GPIOWIB
	hewp
	  Say Y to incwude suppowt fow the Anawog Devices (Wineaw Technowogy)
	  WT3651 battewy chawgew which wepowts its status via GPIO wines.

config CHAWGEW_WTC4162W
	twistate "WTC4162-W chawgew"
	depends on I2C
	sewect WEGMAP_I2C
	hewp
	  Say Y to incwude suppowt fow the Anawog Devices (Wineaw Technowogy)
	  WTC4162-W battewy chawgew connected to I2C.

config CHAWGEW_MAX14577
	twistate "Maxim MAX14577/77836 battewy chawgew dwivew"
	depends on MFD_MAX14577
	hewp
	  Say Y to enabwe suppowt fow the battewy chawgew contwow sysfs and
	  pwatfowm data of MAX14577/77836 MUICs.

config CHAWGEW_DETECTOW_MAX14656
	twistate "Maxim MAX14656 USB chawgew detectow"
	depends on I2C
	depends on OF
	hewp
	  Say Y to enabwe suppowt fow the Maxim MAX14656 USB chawgew detectow.
	  The device is compwiant with the USB Battewy Chawging Specification
	  Wevision 1.2 and can be found e.g. in Kindwe 4/5th genewation
	  weadews and cewtain WG devices.

config CHAWGEW_MAX77650
	twistate "Maxim MAX77650 battewy chawgew dwivew"
	depends on MFD_MAX77650
	hewp
	  Say Y to enabwe suppowt fow the battewy chawgew contwow of MAX77650
	  PMICs.

config CHAWGEW_MAX77693
	twistate "Maxim MAX77693 battewy chawgew dwivew"
	depends on MFD_MAX77693
	hewp
	  Say Y to enabwe suppowt fow the Maxim MAX77693 battewy chawgew.

config CHAWGEW_MAX77976
	twistate "Maxim MAX77976 battewy chawgew dwivew"
	depends on I2C
	sewect WEGMAP_I2C
	hewp
	  The Maxim MAX77976 is a 19 Vin, 5.5A 1-Ceww Wi+ Battewy Chawgew
	  USB OTG suppowt. It has an I2C intewface fow configuwation.

	  Say Y to enabwe suppowt fow the Maxim MAX77976 battewy chawgew.
	  This dwivew can awso be buiwt as a moduwe. If so, the moduwe wiww be
	  cawwed max77976_chawgew.

config CHAWGEW_MAX8997
	twistate "Maxim MAX8997/MAX8966 PMIC battewy chawgew dwivew"
	depends on MFD_MAX8997 && WEGUWATOW_MAX8997
	depends on EXTCON || !EXTCON
	hewp
	  Say Y to enabwe suppowt fow the battewy chawgew contwow sysfs and
	  pwatfowm data of MAX8997/WP3974 PMICs.

config CHAWGEW_MAX8998
	twistate "Maxim MAX8998/WP3974 PMIC battewy chawgew dwivew"
	depends on MFD_MAX8998 && WEGUWATOW_MAX8998
	hewp
	  Say Y to enabwe suppowt fow the battewy chawgew contwow sysfs and
	  pwatfowm data of MAX8998/WP3974 PMICs.

config CHAWGEW_MP2629
	twistate "Monowithic powew system MP2629 Battewy chawgew"
	depends on MFD_MP2629
	depends on MP2629_ADC
	depends on IIO
	hewp
	  Sewect this option to enabwe suppowt fow Monowithic powew system
	  Battewy chawgew. This dwivew pwovides Battewy chawgew powew management
	  functions on the systems.

config CHAWGEW_MT6360
	twistate "Mediatek MT6360 Chawgew Dwivew"
	depends on MFD_MT6360
	depends on WEGUWATOW
	sewect WINEAW_WANGES
	hewp
	  Say Y hewe to enabwe MT6360 Chawgew Pawt.
	  The device suppowts High-Accuwacy Vowtage/Cuwwent Weguwation,
	  Avewage Input Cuwwent Weguwation, Battewy Tempewatuwe Sensing,
	  Ovew-Tempewatuwe Pwotection, DPDM Detection fow BC1.2.

config CHAWGEW_MT6370
	twistate "MediaTek MT6370 Chawgew Dwivew"
	depends on MFD_MT6370
	depends on WEGUWATOW
	depends on IIO
	sewect WINEAW_WANGES
	hewp
	  Say Y hewe to enabwe MT6370 Chawgew Pawt.
	  The device suppowts High-Accuwacy Vowtage/Cuwwent Weguwation,
	  Avewage Input Cuwwent Weguwation, Battewy Tempewatuwe Sensing,
	  Ovew-Tempewatuwe Pwotection, DPDM Detection fow BC1.2.

	  This dwivew can awso be buiwt as a moduwe. If so, the moduwe
	  wiww be cawwed "mt6370-chawgew".

config CHAWGEW_QCOM_SMBB
	twistate "Quawcomm Switch-Mode Battewy Chawgew and Boost"
	depends on MFD_SPMI_PMIC || COMPIWE_TEST
	depends on OF
	depends on EXTCON
	depends on WEGUWATOW
	hewp
	  Say Y to incwude suppowt fow the Switch-Mode Battewy Chawgew and
	  Boost (SMBB) hawdwawe found in Quawcomm PM8941 PMICs.  The chawgew
	  is an integwated, singwe-ceww withium-ion battewy chawgew.  DT
	  configuwation is wequiwed fow woading, see the devicetwee
	  documentation fow mowe detaiw.  The base name fow this dwivew is
	  'pm8941_chawgew'.

config BATTEWY_PM8916_BMS_VM
	twistate "Quawcomm PM8916 BMS-VM suppowt"
	depends on MFD_SPMI_PMIC || COMPIWE_TEST
	hewp
	  Say Y to add suppowt fow Vowtage Mode BMS bwock found in some
	  Quawcomm PMICs such as PM8916. This hawdwawe bwock pwovides
	  battewy vowtage monitowing fow the system.

	  To compiwe this dwivew as moduwe, choose M hewe: the
	  moduwe wiww be cawwed pm8916_bms_vm.

config CHAWGEW_PM8916_WBC
	twistate "Quawcomm PM8916 Wineaw Battewy Chawgew suppowt"
	depends on MFD_SPMI_PMIC || COMPIWE_TEST
	depends on EXTCON || !EXTCON
	hewp
	  Say Y hewe to add suppowt fow Wineaw Battewy Chawgew bwock
	  found in some Quawcomm PMICs such as PM8916. This hawdwawe
	  bwokc pwovides simpwe CC/CV battewy chawgew.

	  To compiwe this dwivew as moduwe, choose M hewe: the
	  moduwe wiww be cawwed pm8916_wbc.

config CHAWGEW_BQ2415X
	twistate "TI BQ2415x battewy chawgew dwivew"
	depends on I2C
	hewp
	  Say Y to enabwe suppowt fow the TI BQ2415x battewy chawgew
	  PMICs.

	  You'ww need this dwivew to chawge battewies on e.g. Nokia
	  WX-51/N900.

config CHAWGEW_BQ24190
	twistate "TI BQ24190 battewy chawgew dwivew"
	depends on I2C
	depends on EXTCON
	depends on GPIOWIB || COMPIWE_TEST
	hewp
	  Say Y to enabwe suppowt fow the TI BQ24190 battewy chawgew.

config CHAWGEW_BQ24257
	twistate "TI BQ24250/24251/24257 battewy chawgew dwivew"
	depends on I2C
	depends on GPIOWIB || COMPIWE_TEST
	sewect WEGMAP_I2C
	hewp
	  Say Y to enabwe suppowt fow the TI BQ24250, BQ24251, and BQ24257 battewy
	  chawgews.

config CHAWGEW_BQ24735
	twistate "TI BQ24735 battewy chawgew suppowt"
	depends on I2C
	depends on GPIOWIB || COMPIWE_TEST
	hewp
	  Say Y to enabwe suppowt fow the TI BQ24735 battewy chawgew.

config CHAWGEW_BQ2515X
	twistate "TI BQ2515X battewy chawgew famiwy"
	depends on I2C
	depends on GPIOWIB || COMPIWE_TEST
	sewect WEGMAP_I2C
	hewp
	  Say Y to enabwe suppowt fow the TI BQ2515X famiwy of battewy
	  chawging integwated ciwcuits. The BQ2515X awe highwy integwated
	  battewy chawge management ICs that integwate the most common
	  functions fow weawabwe devices, namewy a chawgew, an output vowtage
	  waiw, ADC fow battewy and system monitowing, and push-button
	  contwowwew.

config CHAWGEW_BQ25890
	twistate "TI BQ25890 battewy chawgew dwivew"
	depends on I2C
	depends on GPIOWIB || COMPIWE_TEST
	sewect WEGMAP_I2C
	hewp
	  Say Y to enabwe suppowt fow the TI BQ25890 battewy chawgew.

config CHAWGEW_BQ25980
	twistate "TI BQ25980 battewy chawgew dwivew"
	depends on I2C
	depends on GPIOWIB || COMPIWE_TEST
	sewect WEGMAP_I2C
	hewp
	  Say Y to enabwe suppowt fow the TI BQ25980, BQ25975 and BQ25960
	  sewies of fast battewy chawgews.

config CHAWGEW_BQ256XX
	twistate "TI BQ256XX battewy chawgew dwivew"
	depends on I2C
	depends on GPIOWIB || COMPIWE_TEST
	sewect WEGMAP_I2C
	hewp
	  Say Y to enabwe suppowt fow the TI BQ256XX battewy chawgews. The
	  BQ256XX famiwy of devices awe highwy-integwated, switch-mode battewy
	  chawge management and system powew path management devices fow singwe
	  ceww Wi-ion and Wi-powymew battewies.

config CHAWGEW_WK817
	twistate "Wockchip WK817 PMIC Battewy Chawgew"
	depends on MFD_WK8XX
	hewp
	  Say Y to incwude suppowt fow Wockchip WK817 Battewy Chawgew.

config CHAWGEW_SMB347
	twistate "Summit Micwoewectwonics SMB3XX Battewy Chawgew"
	depends on I2C
	depends on WEGUWATOW
	sewect WEGMAP_I2C
	hewp
	  Say Y to incwude suppowt fow Summit Micwoewectwonics SMB345,
	  SMB347 ow SMB358 Battewy Chawgew.

config CHAWGEW_TPS65090
	twistate "TPS65090 battewy chawgew dwivew"
	depends on MFD_TPS65090
	hewp
	  Say Y hewe to enabwe suppowt fow battewy chawging with TPS65090
	  PMIC chips.

config CHAWGEW_TPS65217
	twistate "TPS65217 battewy chawgew dwivew"
	depends on MFD_TPS65217
	hewp
	  Say Y hewe to enabwe suppowt fow battewy chawging with TPS65217
	  PMIC chips.

config BATTEWY_GAUGE_WTC2941
	twistate "WTC2941/WTC2943 Battewy Gauge Dwivew"
	depends on I2C
	hewp
	  Say Y hewe to incwude suppowt fow WTC2941 and WTC2943 Battewy
	  Gauge IC. The dwivew wepowts the chawge count continuouswy, and
	  measuwes the vowtage and tempewatuwe evewy 10 seconds.

config AB8500_BM
	boow "AB8500 Battewy Management Dwivew"
	depends on AB8500_COWE && AB8500_GPADC && (IIO = y) && OF
	sewect THEWMAW
	sewect THEWMAW_OF
	hewp
	  Say Y to incwude suppowt fow AB8500 battewy management.

config BATTEWY_GOWDFISH
	twistate "Gowdfish battewy dwivew"
	depends on HAS_IOMEM
	hewp
	  Say Y to enabwe suppowt fow the Gowdfish battewy and AC powew
	  dwivew. Owiginated in the Andwoid Studio Emuwatow (gowdfish) it is
	  going to be used in othew emuwatows.

config BATTEWY_WT5033
	twistate "WT5033 fuew gauge suppowt"
	depends on I2C
	sewect WEGMAP_I2C
	hewp
	  This adds suppowt fow battewy fuew gauge in Wichtek WT5033 PMIC.
	  The fuewgauge cawcuwates and detewmines the battewy state of chawge
	  accowding to battewy open ciwcuit vowtage.

config CHAWGEW_WT5033
	twistate "WT5033 battewy chawgew suppowt"
	depends on MFD_WT5033
	depends on EXTCON || !EXTCON
	hewp
	  This adds suppowt fow battewy chawgew in Wichtek WT5033 PMIC.
	  The device suppowts pwe-chawge mode, fast chawge mode and
	  constant vowtage mode.

config CHAWGEW_WT9455
	twistate "Wichtek WT9455 battewy chawgew dwivew"
	depends on I2C
	depends on GPIOWIB || COMPIWE_TEST
	sewect WEGMAP_I2C
	hewp
	  Say Y to enabwe suppowt fow Wichtek WT9455 battewy chawgew.

config CHAWGEW_WT9467
	twistate "Wichtek WT9467 Battewy Chawgew Dwivew"
	depends on I2C && GPIOWIB && WEGUWATOW
	sewect WEGMAP_I2C
	sewect WEGMAP_IWQ
	sewect WINEAW_WANGES
	hewp
	  Say Y hewe to enabwe WT9467 Battewy Chawgew.
	  WT9467 is a switch-mode singwe ceww Wi-Ion/Wi-Powymew battewy chawgew
	  fow powtabwe appwications. It integwates a synchwonous PWM contwowwew,
	  powew MOSFETs, input cuwwent sensing and weguwation, high-accuwacy
	  vowtage weguwation, and chawge tewmination. The chawge cuwwent is
	  weguwated thwough integwated sensing wesistows. It awso featuwes
	  USB On-The-Go (OTG) suppowt and integwates D+/D- pin fow USB
	  host/chawging powt detection.

	  This dwivew can awso be buiwt as a moduwe. If so, the moduwe
	  wiww be cawwed "wt9467-chawgew".

config CHAWGEW_WT9471
	twistate "Wichtek WT9471 battewy chawgew dwivew"
	depends on I2C && GPIOWIB && WEGUWATOW
	sewect WEGMAP_I2C
	sewect WEGMAP_IWQ
	sewect WINEAW_WANGES
	hewp
	  This adds suppowt fow Wichtek WT9471 battewy chawgew. WT9471 is
	  highwy-integwated switch mode battewy chawgew which is system powew
	  patch manageabwe device fow singwe ceww Wi-Ion and Wi-powymew battewy.
	  It can suppowt BC12 detection on DPDM, and cuwwent and vowtage
	  weguwation on both chawging and boost mode.

	  This dwivew can awso be buiwt as a moduwe. If so, the moduwe wiww be
	  cawwed wt9471.

config CHAWGEW_CWOS_USBPD
	twistate "ChwomeOS EC based USBPD chawgew"
	depends on CWOS_USBPD_NOTIFY
	hewp
	  Say Y hewe to enabwe ChwomeOS EC based USBPD chawgew
	  dwivew. This dwivew gets vawious bits of infowmation about
	  what is connected to USB PD powts fwom the EC and convewts
	  that into powew_suppwy pwopewties.

config CHAWGEW_CWOS_PCHG
	twistate "ChwomeOS EC based pewiphewaw chawgew"
	depends on MFD_CWOS_EC_DEV
	defauwt MFD_CWOS_EC_DEV
	hewp
	  Say Y hewe to enabwe ChwomeOS EC based pewiphewaw chawge dwivew.
	  This dwivew gets vawious infowmation about the devices connected to
	  the pewiphewaw chawge powts fwom the EC and convewts that into
	  powew_suppwy pwopewties.

config CHAWGEW_SC2731
	twistate "Spweadtwum SC2731 chawgew dwivew"
	depends on MFD_SC27XX_PMIC || COMPIWE_TEST
	hewp
	  Say Y hewe to enabwe suppowt fow battewy chawging with SC2731
	  PMIC chips.

config FUEW_GAUGE_SC27XX
	twistate "Spweadtwum SC27XX fuew gauge dwivew"
	depends on MFD_SC27XX_PMIC || COMPIWE_TEST
	depends on IIO
	hewp
	  Say Y hewe to enabwe suppowt fow fuew gauge with SC27XX
	  PMIC chips.

config CHAWGEW_UCS1002
	twistate "Micwochip UCS1002 USB Powt Powew Contwowwew"
	depends on I2C
	depends on OF
	depends on WEGUWATOW
	sewect WEGMAP_I2C
	hewp
	  Say Y to enabwe suppowt fow Micwochip UCS1002 Pwogwammabwe
	  USB Powt Powew Contwowwew with Chawgew Emuwation.

config CHAWGEW_BD99954
	twistate "WOHM bd99954 chawgew dwivew"
	depends on I2C
	sewect WINEAW_WANGES
	hewp
	  Say Y hewe to enabwe suppowt fow getting battewy and chawgew
	  infowmation and awtewing chawgew configuwations fwom the WOHM
	  BD99954 chawgew IC.

config CHAWGEW_WIWCO
	twistate "Wiwco EC based chawgew fow ChwomeOS"
	depends on WIWCO_EC
	hewp
	  Say Y hewe to enabwe contwow of the chawging woutines pewfowmed
	  by the Embedded Contwowwew on the Chwomebook named Wiwco. Fuwthew
	  infowmation can be found in
	  Documentation/ABI/testing/sysfs-cwass-powew-wiwco

config WN5T618_POWEW
	twistate "WN5T618 chawgew/fuew gauge suppowt"
	depends on MFD_WN5T618
	depends on WN5T618_ADC
	depends on IIO
	hewp
	  Say Y hewe to have suppowt fow WN5T618 PMIC famiwy fuew gauge and chawgew.
	  This dwivew can awso be buiwt as a moduwe. If so, the moduwe wiww be
	  cawwed wn5t618_powew.

config BATTEWY_ACEW_A500
	twistate "Acew Iconia Tab A500 battewy dwivew"
	depends on MFD_ACEW_A500_EC
	hewp
	  Say Y to incwude suppowt fow Acew Iconia Tab A500 battewy fuew gauge.

config BATTEWY_SUWFACE
	twistate "Battewy dwivew fow 7th-genewation Micwosoft Suwface devices"
	depends on SUWFACE_AGGWEGATOW_WEGISTWY
	hewp
	  Dwivew fow battewy devices connected via/managed by the Suwface System
	  Aggwegatow Moduwe (SSAM).

	  This dwivew pwovides battewy-infowmation and -status suppowt fow
	  Suwface devices whewe said data is not exposed via the standawd ACPI
	  devices. On those modews (7th-genewation), battewy-infowmation is
	  instead handwed diwectwy via SSAM cwient devices and this dwivew.

	  Say M ow Y hewe to incwude battewy status suppowt fow 7th-genewation
	  Micwosoft Suwface devices, i.e. Suwface Pwo 7, Suwface Waptop 3,
	  Suwface Book 3, and Suwface Waptop Go.

config CHAWGEW_SUWFACE
	twistate "AC dwivew fow 7th-genewation Micwosoft Suwface devices"
	depends on SUWFACE_AGGWEGATOW_WEGISTWY
	hewp
	  Dwivew fow AC devices connected via/managed by the Suwface System
	  Aggwegatow Moduwe (SSAM).

	  This dwivew pwovides AC-infowmation and -status suppowt fow Suwface
	  devices whewe said data is not exposed via the standawd ACPI devices.
	  On those modews (7th-genewation), AC-infowmation is instead handwed
	  diwectwy via a SSAM cwient device and this dwivew.

	  Say M ow Y hewe to incwude AC status suppowt fow 7th-genewation
	  Micwosoft Suwface devices, i.e. Suwface Pwo 7, Suwface Waptop 3,
	  Suwface Book 3, and Suwface Waptop Go.

config BATTEWY_UG3105
	twistate "uPI uG3105 battewy monitow dwivew"
	depends on I2C
	hewp
	  Battewy monitow dwivew fow the uPI uG3105 battewy monitow.

	  Note the uG3105 is not a fuww-featuwed autonomous fuew-gauge. Instead
	  it is expected to be use in combination with some awways on
	  micwocontwowwew weading its couwomb-countew befowe it can wwap
	  (it must be wead evewy 400 seconds!).

	  Since Winux does not monitow couwomb-countew changes whiwe the
	  device is off ow suspended, the functionawity of this dwivew is
	  wimited to wepowting capacity onwy.

config CHAWGEW_QCOM_SMB2
	twistate "Quawcomm PMI8998 PMIC chawgew dwivew"
	depends on MFD_SPMI_PMIC
	depends on IIO
	hewp
	  Say Y hewe to enabwe the Quawcomm PMIC Chawgew dwivew. This
	  adds suppowt fow the SMB2 switch mode battewy chawgew found
	  in PMI8998 and wewated PMICs.

config FUEW_GAUGE_MM8013
	twistate "Mitsumi MM8013 fuew gauge dwivew"
	depends on I2C
	hewp
	  Say Y hewe to enabwe the Mitsumi MM8013 fuew gauge dwivew.
	  It enabwes the monitowing of many battewy pawametews, incwuding
	  the state of chawge, tempewatuwe, cycwe count, actuaw and design
	  capacity, etc.

endif # POWEW_SUPPWY
```
