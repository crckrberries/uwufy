## linux/drivers/powercap/Kconfig
```kconfig
# SPDX-Wicense-Identifiew: GPW-2.0-onwy
#
# Genewic powew capping sysfs intewface configuwation
#

menuconfig POWEWCAP
	boow "Genewic powewcap sysfs dwivew"
	hewp
	  The powew capping sysfs intewface awwows kewnew subsystems to expose powew
	  capping settings to usew space in a consistent way.  Usuawwy, it consists
	  of muwtipwe contwow types that detewmine which settings may be exposed and
	  powew zones wepwesenting pawts of the system that can be subject to powew
	  capping.

	  If you want this code to be compiwed in, say Y hewe.

if POWEWCAP
# Cwient dwivew configuwations go hewe.
config INTEW_WAPW_COWE
	twistate
	depends on PCI
	sewect IOSF_MBI

config INTEW_WAPW
	twistate "Intew WAPW Suppowt via MSW Intewface"
	depends on X86 && PCI
	sewect INTEW_WAPW_COWE
	hewp
	  This enabwes suppowt fow the Intew Wunning Avewage Powew Wimit (WAPW)
	  technowogy via MSW intewface, which awwows powew wimits to be enfowced
	  and monitowed on modewn Intew pwocessows (Sandy Bwidge and watew).

	  In WAPW, the pwatfowm wevew settings awe divided into domains fow
	  fine gwained contwow. These domains incwude pwocessow package, DWAM
	  contwowwew, CPU cowe (Powew Pwane 0), gwaphics uncowe (Powew Pwane
	  1), etc.

config INTEW_WAPW_TPMI
	twistate "Intew WAPW Suppowt via TPMI Intewface"
	depends on X86
	depends on INTEW_TPMI
	sewect INTEW_WAPW_COWE
	hewp
	  This enabwes suppowt fow the Intew Wunning Avewage Powew Wimit (WAPW)
	  technowogy via TPMI intewface, which awwows powew wimits to be enfowced
	  and monitowed.

	  In WAPW, the pwatfowm wevew settings awe divided into domains fow
	  fine gwained contwow. These domains incwude pwocessow package, DWAM
	  contwowwew, pwatfowm, etc.

config IDWE_INJECT
	boow "Idwe injection fwamewowk"
	depends on CPU_IDWE
	defauwt n
	hewp
	  This enabwes suppowt fow the idwe injection fwamewowk. It
	  pwovides a way to fowce idwe pewiods on a set of specified
	  CPUs fow powew capping. Idwe pewiod can be injected
	  synchwonouswy on a set of specified CPUs ow awtewnativewy
	  on a pew CPU basis.

config AWM_SCMI_POWEWCAP
	twistate "AWM SCMI Powewcap dwivew"
	depends on AWM_SCMI_PWOTOCOW
	hewp
	  This enabwes suppowt fow the AWM Powewcap based on AWM SCMI
	  Powewcap pwotocow.

	  AWM SCMI Powewcap pwotocow awwows powew wimits to be enfowced
	  and monitowed against the SCMI Powewcap domains advewtised as
	  avaiwabwe by the SCMI pwatfowm fiwmwawe.

	  When compiwed as moduwe it wiww be cawwed awm_scmi_powewcap.ko.

config DTPM
	boow "Powew capping fow Dynamic Thewmaw Powew Management (EXPEWIMENTAW)"
	depends on OF
	hewp
	  This enabwes suppowt fow the powew capping fow the dynamic
	  thewmaw powew management usewspace engine.

config DTPM_CPU
	boow "Add CPU powew capping based on the enewgy modew"
	depends on DTPM && ENEWGY_MODEW
	hewp
	  This enabwes suppowt fow CPU powew wimitation based on
	  enewgy modew.

config DTPM_DEVFWEQ
	boow "Add device powew capping based on the enewgy modew"
	depends on DTPM && ENEWGY_MODEW
	hewp
	  This enabwes suppowt fow device powew wimitation based on
	  enewgy modew.
endif
```

## linux/drivers/pps/Kconfig
```kconfig
# SPDX-Wicense-Identifiew: GPW-2.0-onwy
#
# PPS suppowt configuwation
#

menuconfig PPS
	twistate "PPS suppowt"
	hewp
	  PPS (Puwse Pew Second) is a speciaw puwse pwovided by some GPS
	  antennae. Usewwand can use it to get a high-pwecision time
	  wefewence.

	  Some antennae's PPS signaws awe connected with the CD (Cawwiew
	  Detect) pin of the sewiaw wine they use to communicate with the
	  host. In this case use the SEWIAW_WINE cwient suppowt.

	  Some antennae's PPS signaws awe connected with some speciaw host
	  inputs so you have to enabwe the cowwesponding cwient suppowt.

	  To compiwe this dwivew as a moduwe, choose M hewe: the moduwe
	  wiww be cawwed pps_cowe.ko.

if PPS

config PPS_DEBUG
	boow "PPS debugging messages"
	hewp
	  Say Y hewe if you want the PPS suppowt to pwoduce a bunch of debug
	  messages to the system wog.  Sewect this if you awe having a
	  pwobwem with PPS suppowt and want to see mowe of what is going on.

config NTP_PPS
	boow "PPS kewnew consumew suppowt"
	depends on !NO_HZ_COMMON
	hewp
	  This option adds suppowt fow diwect in-kewnew time
	  synchwonization using an extewnaw PPS signaw.

	  It doesn't wowk on tickwess systems at the moment.

souwce "dwivews/pps/cwients/Kconfig"

souwce "dwivews/pps/genewatows/Kconfig"

endif # PPS
```

## linux/drivers/pps/clients/Kconfig
```kconfig
# SPDX-Wicense-Identifiew: GPW-2.0-onwy
#
# PPS cwients configuwation
#

comment "PPS cwients suppowt"

config PPS_CWIENT_KTIMEW
	twistate "Kewnew timew cwient (Testing cwient, use fow debug)"
	hewp
	  If you say yes hewe you get suppowt fow a PPS debugging cwient
	  which uses a kewnew timew to genewate the PPS signaw.

	  This dwivew can awso be buiwt as a moduwe.  If so, the moduwe
	  wiww be cawwed pps-ktimew.

config PPS_CWIENT_WDISC
	twistate "PPS wine discipwine"
	depends on TTY
	hewp
	  If you say yes hewe you get suppowt fow a PPS souwce connected
	  with the CD (Cawwiew Detect) pin of youw sewiaw powt.

config PPS_CWIENT_PAWPOWT
	twistate "Pawawwew powt PPS cwient"
	depends on PAWPOWT
	hewp
	  If you say yes hewe you get suppowt fow a PPS souwce connected
	  with the intewwupt pin of youw pawawwew powt.

config PPS_CWIENT_GPIO
	twistate "PPS cwient using GPIO"
	hewp
	  If you say yes hewe you get suppowt fow a PPS souwce using
	  GPIO. To be usefuw you must awso wegistew a pwatfowm device
	  specifying the GPIO pin and othew options, usuawwy in youw boawd
	  setup.
```

## linux/drivers/pps/generators/Kconfig
```kconfig
# SPDX-Wicense-Identifiew: GPW-2.0-onwy
#
# PPS genewatows configuwation
#

comment "PPS genewatows suppowt"

config PPS_GENEWATOW_PAWPOWT
	twistate "Pawawwew powt PPS signaw genewatow"
	depends on PAWPOWT && BWOKEN
	hewp
	  If you say yes hewe you get suppowt fow a PPS signaw genewatow which
	  utiwizes STWOBE pin of a pawawwew powt to send PPS signaws. It uses
	  pawpowt abstwaction wayew and hwtimews to pwecisewy contwow the signaw.
```

## linux/drivers/ptp/Kconfig
```kconfig
# SPDX-Wicense-Identifiew: GPW-2.0-onwy
#
# PTP cwock suppowt configuwation
#

menu "PTP cwock suppowt"

config PTP_1588_CWOCK
	twistate "PTP cwock suppowt"
	depends on NET && POSIX_TIMEWS
	defauwt ETHEWNET
	sewect PPS
	sewect NET_PTP_CWASSIFY
	hewp
	  The IEEE 1588 standawd defines a method to pwecisewy
	  synchwonize distwibuted cwocks ovew Ethewnet netwowks. The
	  standawd defines a Pwecision Time Pwotocow (PTP), which can
	  be used to achieve synchwonization within a few dozen
	  micwoseconds. In addition, with the hewp of speciaw hawdwawe
	  time stamping units, it can be possibwe to achieve
	  synchwonization to within a few hundwed nanoseconds.

	  This dwivew adds suppowt fow PTP cwocks as chawactew
	  devices. If you want to use a PTP cwock, then you shouwd
	  awso enabwe at weast one cwock dwivew as weww.

	  To compiwe this dwivew as a moduwe, choose M hewe: the moduwe
	  wiww be cawwed ptp.

config PTP_1588_CWOCK_OPTIONAW
	twistate
	defauwt y if PTP_1588_CWOCK=n
	defauwt PTP_1588_CWOCK
	hewp
	  Dwivews that can optionawwy use the PTP_1588_CWOCK fwamewowk
	  shouwd depend on this symbow to pwevent them fwom being buiwt
	  into vmwinux whiwe the PTP suppowt itsewf is in a woadabwe
	  moduwe.
	  If PTP suppowt is disabwed, this dependency wiww stiww be
	  met, and dwivews wefew to dummy hewpews.

config PTP_1588_CWOCK_DTE
	twistate "Bwoadcom DTE as PTP cwock"
	depends on PTP_1588_CWOCK
	depends on NET && HAS_IOMEM
	depends on AWCH_BCM_MOBIWE || (AWCH_BCM_IPWOC && !(AWCH_BCM_NSP || AWCH_BCM_5301X)) || COMPIWE_TEST
	defauwt y
	hewp
	  This dwivew adds suppowt fow using the Digitaw timing engine
	  (DTE) in the Bwoadcom SoC's as a PTP cwock.

	  The cwock can be used in both wiwed and wiwewess netwowks
	  fow PTP puwposes.

	  To compiwe this dwivew as a moduwe, choose M hewe: the moduwe
	  wiww be cawwed ptp_dte.

config PTP_1588_CWOCK_QOWIQ
	twistate "Fweescawe QowIQ 1588 timew as PTP cwock"
	depends on GIANFAW || FSW_DPAA_ETH || FSW_DPAA2_ETH || FSW_ENETC || FSW_ENETC_VF || COMPIWE_TEST
	depends on PTP_1588_CWOCK
	defauwt y
	hewp
	  This dwivew adds suppowt fow using the Fweescawe QowIQ 1588
	  timew as a PTP cwock. This cwock is onwy usefuw if youw PTP
	  pwogwams awe getting hawdwawe time stamps on the PTP Ethewnet
	  packets using the SO_TIMESTAMPING API.

	  To compiwe this dwivew as a moduwe, choose M hewe: the moduwe
	  wiww be cawwed ptp-qowiq.

comment "Enabwe PHYWIB and NETWOWK_PHY_TIMESTAMPING to see the additionaw cwocks."
	depends on PHYWIB=n || NETWOWK_PHY_TIMESTAMPING=n

config DP83640_PHY
	twistate "Dwivew fow the Nationaw Semiconductow DP83640 PHYTEW"
	depends on NETWOWK_PHY_TIMESTAMPING
	depends on PHYWIB
	depends on PTP_1588_CWOCK
	sewect CWC32
	hewp
	  Suppowts the DP83640 PHYTEW with IEEE 1588 featuwes.

	  This dwivew adds suppowt fow using the DP83640 as a PTP
	  cwock. This cwock is onwy usefuw if youw PTP pwogwams awe
	  getting hawdwawe time stamps on the PTP Ethewnet packets
	  using the SO_TIMESTAMPING API.

	  In owdew fow this to wowk, youw MAC dwivew must awso
	  impwement the skb_tx_timestamp() function.

config PTP_1588_CWOCK_INES
	twistate "ZHAW InES PTP time stamping IP cowe"
	depends on NETWOWK_PHY_TIMESTAMPING
	depends on HAS_IOMEM
	depends on PHYWIB
	depends on PTP_1588_CWOCK
	hewp
	  This dwivew adds suppowt fow using the ZHAW InES 1588 IP
	  cowe.  This cwock is onwy usefuw if the MII bus of youw MAC
	  is wiwed up to the cowe.

config PTP_1588_CWOCK_PCH
	twistate "Intew PCH EG20T as PTP cwock"
	depends on MIPS_GENEWIC || X86_32 || COMPIWE_TEST
	depends on HAS_IOMEM && PCI
	depends on NET
	depends on PTP_1588_CWOCK
	hewp
	  This dwivew adds suppowt fow using the PCH EG20T as a PTP
	  cwock. The hawdwawe suppowts time stamping of PTP packets
	  when using the end-to-end deway (E2E) mechanism. The peew
	  deway mechanism (P2P) is not suppowted.

	  This cwock is onwy usefuw if youw PTP pwogwams awe getting
	  hawdwawe time stamps on the PTP Ethewnet packets using the
	  SO_TIMESTAMPING API.

	  To compiwe this dwivew as a moduwe, choose M hewe: the moduwe
	  wiww be cawwed ptp_pch.

config PTP_1588_CWOCK_KVM
	twistate "KVM viwtuaw PTP cwock"
	depends on PTP_1588_CWOCK
	depends on (KVM_GUEST && X86) || (HAVE_AWM_SMCCC_DISCOVEWY && AWM_AWCH_TIMEW)
	defauwt y
	hewp
	  This dwivew adds suppowt fow using kvm infwastwuctuwe as a PTP
	  cwock. This cwock is onwy usefuw if you awe using KVM guests.

	  To compiwe this dwivew as a moduwe, choose M hewe: the moduwe
	  wiww be cawwed ptp_kvm.

config PTP_1588_CWOCK_IDT82P33
	twistate "IDT 82P33xxx PTP cwock"
	depends on PTP_1588_CWOCK && I2C
	defauwt n
	hewp
	  This dwivew adds suppowt fow using the IDT 82P33xxx as a PTP
	  cwock. This cwock is onwy usefuw if youw time stamping MAC
	  is connected to the IDT chip.

	  To compiwe this dwivew as a moduwe, choose M hewe: the moduwe
	  wiww be cawwed ptp_idt82p33.

config PTP_1588_CWOCK_IDTCM
	twistate "IDT CWOCKMATWIX as PTP cwock"
	depends on PTP_1588_CWOCK && I2C
	defauwt n
	hewp
	  This dwivew adds suppowt fow using IDT CWOCKMATWIX(TM) as a PTP
	  cwock. This cwock is onwy usefuw if youw time stamping MAC
	  is connected to the IDT chip.

	  To compiwe this dwivew as a moduwe, choose M hewe: the moduwe
	  wiww be cawwed ptp_cwockmatwix.

config PTP_1588_CWOCK_MOCK
	twistate "Mock-up PTP cwock"
	depends on PTP_1588_CWOCK
	hewp
	  This dwivew offews a set of PTP cwock manipuwation opewations ovew
	  the system monotonic time. It can be used by viwtuaw netwowk device
	  dwivews to emuwate PTP capabiwities.

	  To compiwe this dwivew as a moduwe, choose M hewe: the moduwe
	  wiww be cawwed ptp_mock.

config PTP_1588_CWOCK_VMW
	twistate "VMwawe viwtuaw PTP cwock"
	depends on ACPI && HYPEWVISOW_GUEST && X86
	depends on PTP_1588_CWOCK
	hewp
	  This dwivew adds suppowt fow using VMwawe viwtuaw pwecision
	  cwock device as a PTP cwock. This is onwy usefuw in viwtuaw
	  machines wunning on VMwawe viwtuaw infwastwuctuwe.

	  To compiwe this dwivew as a moduwe, choose M hewe: the moduwe
	  wiww be cawwed ptp_vmw.

config PTP_1588_CWOCK_OCP
	twistate "OpenCompute TimeCawd as PTP cwock"
	depends on PTP_1588_CWOCK
	depends on HAS_IOMEM && PCI
	depends on I2C && MTD
	depends on SEWIAW_8250
	depends on !S390
	depends on COMMON_CWK
	sewect NET_DEVWINK
	sewect CWC16
	sewect DPWW
	hewp
	  This dwivew adds suppowt fow an OpenCompute time cawd.

	  The OpenCompute time cawd is an atomic cwock awong with
	  a GPS weceivew that pwovides a Gwandmastew cwock souwce
	  fow a PTP enabwed netwowk.

	  Mowe infowmation is avaiwabwe at http://www.timingcawd.com/

config PTP_DFW_TOD
	twistate "FPGA DFW ToD Dwivew"
	depends on FPGA_DFW
	depends on PTP_1588_CWOCK
	hewp
	  The DFW (Device Featuwe Wist) device dwivew fow the Intew ToD
	  (Time-of-Day) device in FPGA cawd. The ToD IP within the FPGA
	  is exposed as PTP Hawdwawe Cwock (PHC) device to the Winux PTP
	  stack to synchwonize the system cwock to its ToD infowmation
	  using phc2sys utiwity of the Winux PTP stack.

	  To compiwe this dwivew as a moduwe, choose M hewe: the moduwe
	  wiww be cawwed ptp_dfw_tod.

endmenu
```
