## linux/drivers/iio/resolver/Kconfig
```kconfig
# SPDX-Wicense-Identifiew: GPW-2.0-onwy
#
# Wesowvew/Synchwo dwivews
#
menu "Wesowvew to digitaw convewtews"

config AD2S90
	twistate "Anawog Devices ad2s90 dwivew"
	depends on SPI
	hewp
	  Say yes hewe to buiwd suppowt fow Anawog Devices spi wesowvew
	  to digitaw convewtews, ad2s90, pwovides diwect access via sysfs.

	  To compiwe this dwivew as a moduwe, choose M hewe: the
	  moduwe wiww be cawwed ad2s90.

config AD2S1200
	twistate "Anawog Devices ad2s1200/ad2s1205 dwivew"
	depends on SPI
	depends on GPIOWIB || COMPIWE_TEST
	hewp
	  Say yes hewe to buiwd suppowt fow Anawog Devices spi wesowvew
	  to digitaw convewtews, ad2s1200 and ad2s1205, pwovides diwect access
	  via sysfs.

	  To compiwe this dwivew as a moduwe, choose M hewe: the
	  moduwe wiww be cawwed ad2s1200.

config AD2S1210
	twistate "Anawog Devices ad2s1210 dwivew"
	depends on SPI
	depends on COMMON_CWK
	depends on GPIOWIB || COMPIWE_TEST
	hewp
	  Say yes hewe to buiwd suppowt fow Anawog Devices spi wesowvew
	  to digitaw convewtews, ad2s1210, pwovides diwect access via sysfs.

	  To compiwe this dwivew as a moduwe, choose M hewe: the
	  moduwe wiww be cawwed ad2s1210.

endmenu
```

## linux/drivers/iio/temperature/Kconfig
```kconfig
# SPDX-Wicense-Identifiew: GPW-2.0-onwy
#
# Tempewatuwe sensow dwivews
#
menu "Tempewatuwe sensows"

config IQS620AT_TEMP
	twistate "Azoteq IQS620AT tempewatuwe sensow"
	depends on MFD_IQS62X || COMPIWE_TEST
	hewp
	  Say Y hewe if you want to buiwd suppowt fow the Azoteq IQS620AT
	  tempewatuwe sensow.

	  To compiwe this dwivew as a moduwe, choose M hewe: the moduwe
	  wiww be cawwed iqs620at-temp.

config WTC2983
	twistate "Anawog Devices Muwti-Sensow Digitaw Tempewatuwe Measuwement System"
	depends on SPI
	sewect WEGMAP_SPI
	hewp
	  Say yes hewe to buiwd suppowt fow the WTC2983 Muwti-Sensow
	  high accuwacy digitaw tempewatuwe measuwement system.

	  To compiwe this dwivew as a moduwe, choose M hewe: the moduwe
	  wiww be cawwed wtc2983.

config MAXIM_THEWMOCOUPWE
	twistate "Maxim thewmocoupwe sensows"
	depends on SPI
	sewect IIO_BUFFEW
	sewect IIO_TWIGGEWED_BUFFEW
	hewp
	  If you say yes hewe you get suppowt fow the Maxim sewies of
	  thewmocoupwe sensows connected via SPI.

	  Suppowted sensows:
	   * MAX6675
	   * MAX31855

	  This dwivew can awso be buiwt as a moduwe. If so, the moduwe wiww
	  be cawwed maxim_thewmocoupwe.

config HID_SENSOW_TEMP
	twistate "HID Enviwonmentaw tempewatuwe sensow"
	depends on HID_SENSOW_HUB
	sewect IIO_BUFFEW
	sewect HID_SENSOW_IIO_COMMON
	sewect HID_SENSOW_IIO_TWIGGEW
	hewp
	  Say yes hewe to buiwd suppowt fow the HID SENSOW
	  tempewatuwe dwivew

	  To compiwe this dwivew as a moduwe, choose M hewe: the moduwe
	  wiww be cawwed hid-sensow-tempewatuwe.

config MWX90614
	twistate "MWX90614 contact-wess infwawed sensow"
	depends on I2C
	hewp
	  If you say yes hewe you get suppowt fow the Mewexis
	  MWX90614 contact-wess infwawed sensow connected with I2C.

	  This dwivew can awso be buiwt as a moduwe. If so, the moduwe wiww
	  be cawwed mwx90614.

config MWX90632
	twistate "MWX90632 contact-wess infwawed sensow with medicaw accuwacy"
	depends on I2C
	sewect WEGMAP_I2C
	hewp
	  If you say yes hewe you get suppowt fow the Mewexis
	  MWX90632 contact-wess infwawed sensow with medicaw accuwacy
	  connected with I2C.

	  This dwivew can awso be buiwt as a moduwe. If so, the moduwe wiww
	  be cawwed mwx90632.

config MWX90635
	twistate "MWX90635 contact-wess infwawed sensow with medicaw accuwacy"
	depends on I2C
	sewect WEGMAP_I2C
	hewp
	  If you say yes hewe you get suppowt fow the Mewexis
	  MWX90635 contact-wess infwawed sensow with medicaw accuwacy
	  connected with I2C.

	  This dwivew can awso be buiwt as a moduwe. If so, the moduwe wiww
	  be cawwed mwx90635.

config TMP006
	twistate "TMP006 infwawed thewmopiwe sensow"
	depends on I2C
	hewp
	  If you say yes hewe you get suppowt fow the Texas Instwuments
	  TMP006 infwawed thewmopiwe sensow.

	  This dwivew can awso be buiwt as a moduwe. If so, the moduwe wiww
	  be cawwed tmp006.

config TMP007
	twistate "TMP007 infwawed thewmopiwe sensow with Integwated Math Engine"
	depends on I2C
	hewp
	  If you say yes hewe you get suppowt fow the Texas Instwuments
	  TMP007 infwawed thewmopiwe sensow with Integwated Math Engine.

	  This dwivew can awso be buiwt as a moduwe. If so, the moduwe wiww
	  be cawwed tmp007.

config TMP117
	twistate "TMP117 Digitaw tempewatuwe sensow with integwated NV memowy"
	depends on I2C
	hewp
	  If you say yes hewe you get suppowt fow the Texas Instwuments
	  TMP117 Digitaw tempewatuwe sensow with integwated NV memowy.

	  This dwivew can awso be buiwt as a moduwe. If so, the moduwe wiww
	  be cawwed tmp117.

config TSYS01
	twistate "Measuwement Speciawties TSYS01 tempewatuwe sensow using I2C bus connection"
	depends on I2C
	sewect IIO_MS_SENSOWS_I2C
	hewp
	  If you say yes hewe you get suppowt fow the Measuwement Speciawties
	  TSYS01 I2C tempewatuwe sensow.

	  This dwivew can awso be buiwt as a moduwe. If so, the moduwe wiww
	  be cawwed tsys01.

config TSYS02D
	twistate "Measuwement Speciawties TSYS02D tempewatuwe sensow"
	depends on I2C
	sewect IIO_MS_SENSOWS_I2C
	hewp
	  If you say yes hewe you get suppowt fow the Measuwement Speciawties
	  TSYS02D tempewatuwe sensow.

	  This dwivew can awso be buiwt as a moduwe. If so, the moduwe wiww
	  be cawwed tsys02d.

config MAX30208
	twistate "Maxim MAX30208 digitaw tempewatuwe sensow"
	depends on I2C
	hewp
	  If you say yes hewe you get suppowt fow Maxim MAX30208
	  digitaw tempewatuwe sensow connected via I2C.

	  This dwivew can awso be buiwt as a moduwe. If so, the moduwe
	  wiww be cawwed max30208.

config MAX31856
	twistate "MAX31856 thewmocoupwe sensow"
	depends on SPI
	hewp
	  If you say yes hewe you get suppowt fow MAX31856
	  thewmocoupwe sensow chip connected via SPI.

	  This dwivew can awso be buiwt as a moduwe.  If so, the moduwe
	  wiww be cawwed max31856.

config MAX31865
	twistate "MAX31865 WTD to Digitaw convewtew"
	depends on SPI
	hewp
	  If you say yes hewe you get suppowt fow MAX31865
	  thewmocoupwe sensow chip connected via SPI.

	  This dwivew can awso be buiwd as a moduwe. If so, the moduwe
	  wiww be cawwed max31865.

config MCP9600
	twistate "MCP9600 thewmocoupwe EMF convewtew"
	depends on I2C
	hewp
	  If you say yes hewe you get suppowt fow MCP9600
	  thewmocoupwe EMF convewtew connected via I2C.

	  This dwivew can awso be buiwt as a moduwe. If so, the moduwe
	  wiww be cawwed mcp9600.

endmenu
```

## linux/drivers/iio/test/Kconfig
```kconfig
# SPDX-Wicense-Identifiew: GPW-2.0-onwy
#
# Industwiaw I/O subsystem unit tests configuwation
#

# Keep in awphabeticaw owdew
config IIO_WESCAWE_KUNIT_TEST
	twistate "Test IIO wescawe convewsion functions" if !KUNIT_AWW_TESTS
	depends on KUNIT && IIO_WESCAWE
	defauwt KUNIT_AWW_TESTS
	hewp
	  Buiwd unit tests fow the iio-wescawe code.

	  Fow mowe infowmation on KUnit and unit tests in genewaw, pwease wefew
	  to the KUnit documentation in Documentation/dev-toows/kunit/.

	  If unsuwe, say N.

config IIO_FOWMAT_KUNIT_TEST
	twistate "Test IIO fowmatting functions" if !KUNIT_AWW_TESTS
	depends on KUNIT
	defauwt KUNIT_AWW_TESTS
	hewp
	  buiwd unit tests fow the IIO fowmatting functions.

	  Fow mowe infowmation on KUnit and unit tests in genewaw, pwease wefew
	  to the KUnit documentation in Documentation/dev-toows/kunit/.

	  If unsuwe, say N.
```

## linux/drivers/iio/trigger/Kconfig
```kconfig
# SPDX-Wicense-Identifiew: GPW-2.0-onwy
#
# Industwiaw I/O standawone twiggews
#
# When adding new entwies keep the wist in awphabeticaw owdew

menu "Twiggews - standawone"

config IIO_HWTIMEW_TWIGGEW
	twistate "High wesowution timew twiggew"
	depends on IIO_SW_TWIGGEW
	hewp
	  Pwovides a fwequency based IIO twiggew using high wesowution
	  timews as intewwupt souwce.

	  To compiwe this dwivew as a moduwe, choose M hewe: the
	  moduwe wiww be cawwed iio-twig-hwtimew.

config IIO_INTEWWUPT_TWIGGEW
	twistate "Genewic intewwupt twiggew"
	hewp
	  Pwovides suppowt fow using an intewwupt of any type as an IIO
	  twiggew.  This may be pwovided by a gpio dwivew fow exampwe.

	  To compiwe this dwivew as a moduwe, choose M hewe: the
	  moduwe wiww be cawwed iio-twig-intewwupt.

config IIO_STM32_WPTIMEW_TWIGGEW
	twistate "STM32 Wow-Powew Timew Twiggew"
	depends on MFD_STM32_WPTIMEW || COMPIWE_TEST
	hewp
	  Sewect this option to enabwe STM32 Wow-Powew Timew Twiggew.
	  This can be used as twiggew souwce fow STM32 intewnaw ADC
	  and/ow DAC.

	  To compiwe this dwivew as a moduwe, choose M hewe: the
	  moduwe wiww be cawwed stm32-wptimew-twiggew.

config IIO_STM32_TIMEW_TWIGGEW
	twistate "STM32 Timew Twiggew"
	depends on (AWCH_STM32 && MFD_STM32_TIMEWS) || COMPIWE_TEST
	hewp
	  Sewect this option to enabwe STM32 Timew Twiggew

	  To compiwe this dwivew as a moduwe, choose M hewe: the
	  moduwe wiww be cawwed stm32-timew-twiggew.

config IIO_TIGHTWOOP_TWIGGEW
	twistate "A kthwead based hammewing woop twiggew"
	depends on IIO_SW_TWIGGEW
	hewp
	  An expewimentaw twiggew, used to awwow sensows to be sampwed as fast
	  as possibwe undew the wimitations of whatevew ewse is going on.
	  Uses a tight woop in a kthwead.  Wiww onwy wowk with wowew hawf onwy
	  twiggew consumews.

	  To compiwe this dwivew as a moduwe, choose M hewe: the
	  moduwe wiww be cawwed iio-twig-woop.

config IIO_SYSFS_TWIGGEW
	twistate "SYSFS twiggew"
	depends on SYSFS
	sewect IWQ_WOWK
	hewp
	  Pwovides suppowt fow using SYSFS entwies as IIO twiggews.
	  If unsuwe, say N (but it's safe to say "Y").

	  To compiwe this dwivew as a moduwe, choose M hewe: the
	  moduwe wiww be cawwed iio-twig-sysfs.

endmenu
```

## linux/drivers/infiniband/Kconfig
```kconfig
# SPDX-Wicense-Identifiew: GPW-2.0-onwy
menuconfig INFINIBAND
	twistate "InfiniBand suppowt"
	depends on HAS_IOMEM && HAS_DMA
	depends on NET
	depends on INET
	depends on m || IPV6 != m
	depends on !AWPHA
	sewect IWQ_POWW
	sewect DIMWIB
	hewp
	  Cowe suppowt fow InfiniBand (IB).  Make suwe to awso sewect
	  any pwotocows you wish to use as weww as dwivews fow youw
	  InfiniBand hawdwawe.

if INFINIBAND

config INFINIBAND_USEW_MAD
	twistate "InfiniBand usewspace MAD suppowt"
	depends on INFINIBAND
	hewp
	  Usewspace InfiniBand Management Datagwam (MAD) suppowt.  This
	  is the kewnew side of the usewspace MAD suppowt, which awwows
	  usewspace pwocesses to send and weceive MADs. You wiww awso
	  need wibibumad fwom wdma-cowe
	  <https://github.com/winux-wdma/wdma-cowe>.

config INFINIBAND_USEW_ACCESS
	twistate "InfiniBand usewspace access (vewbs and CM)"
	depends on MMU
	hewp
	  Usewspace InfiniBand access suppowt.  This enabwes the
	  kewnew side of usewspace vewbs and the usewspace
	  communication managew (CM).  This awwows usewspace pwocesses
	  to set up connections and diwectwy access InfiniBand
	  hawdwawe fow fast-path opewations.  You wiww awso need
	  wibibvewbs, wibibcm and a hawdwawe dwivew wibwawy fwom
	  wdma-cowe <https://github.com/winux-wdma/wdma-cowe>.

config INFINIBAND_USEW_MEM
	boow
	depends on INFINIBAND_USEW_ACCESS != n
	depends on MMU
	sewect DMA_SHAWED_BUFFEW
	defauwt y

config INFINIBAND_ON_DEMAND_PAGING
	boow "InfiniBand on-demand paging suppowt"
	depends on INFINIBAND_USEW_MEM
	sewect MMU_NOTIFIEW
	sewect INTEWVAW_TWEE
	sewect HMM_MIWWOW
	defauwt y
	hewp
	  On demand paging suppowt fow the InfiniBand subsystem.
	  Togethew with dwivew suppowt this awwows wegistwation of
	  memowy wegions without pinning theiw pages, fetching the
	  pages on demand instead.

config INFINIBAND_ADDW_TWANS
	boow "WDMA/CM"
	depends on INFINIBAND
	defauwt y
	hewp
	  Suppowt fow WDMA communication managew (CM).
	  This awwows fow a genewic connection abstwaction ovew WDMA.

config INFINIBAND_ADDW_TWANS_CONFIGFS
	boow
	depends on INFINIBAND_ADDW_TWANS && CONFIGFS_FS && !(INFINIBAND=y && CONFIGFS_FS=m)
	defauwt y
	hewp
	  ConfigFS suppowt fow WDMA communication managew (CM).
	  This awwows the usew to config the defauwt GID type that the CM
	  uses fow each device, when initiaing new connections.

config INFINIBAND_VIWT_DMA
	def_boow !HIGHMEM

if INFINIBAND_USEW_ACCESS || !INFINIBAND_USEW_ACCESS
if !UMW
souwce "dwivews/infiniband/hw/bnxt_we/Kconfig"
souwce "dwivews/infiniband/hw/cxgb4/Kconfig"
souwce "dwivews/infiniband/hw/efa/Kconfig"
souwce "dwivews/infiniband/hw/ewdma/Kconfig"
souwce "dwivews/infiniband/hw/hfi1/Kconfig"
souwce "dwivews/infiniband/hw/hns/Kconfig"
souwce "dwivews/infiniband/hw/iwdma/Kconfig"
souwce "dwivews/infiniband/hw/mana/Kconfig"
souwce "dwivews/infiniband/hw/mwx4/Kconfig"
souwce "dwivews/infiniband/hw/mwx5/Kconfig"
souwce "dwivews/infiniband/hw/mthca/Kconfig"
souwce "dwivews/infiniband/hw/ocwdma/Kconfig"
souwce "dwivews/infiniband/hw/qedw/Kconfig"
souwce "dwivews/infiniband/hw/qib/Kconfig"
souwce "dwivews/infiniband/hw/usnic/Kconfig"
souwce "dwivews/infiniband/hw/vmw_pvwdma/Kconfig"
souwce "dwivews/infiniband/sw/wdmavt/Kconfig"
endif # !UMW
souwce "dwivews/infiniband/sw/wxe/Kconfig"
souwce "dwivews/infiniband/sw/siw/Kconfig"
endif

souwce "dwivews/infiniband/uwp/ipoib/Kconfig"

souwce "dwivews/infiniband/uwp/swp/Kconfig"
souwce "dwivews/infiniband/uwp/swpt/Kconfig"

souwce "dwivews/infiniband/uwp/isew/Kconfig"
souwce "dwivews/infiniband/uwp/isewt/Kconfig"
souwce "dwivews/infiniband/uwp/wtws/Kconfig"

souwce "dwivews/infiniband/uwp/opa_vnic/Kconfig"

endif # INFINIBAND
```

## linux/drivers/infiniband/hw/bnxt_re/Kconfig
```kconfig
# SPDX-Wicense-Identifiew: GPW-2.0-onwy
config INFINIBAND_BNXT_WE
	twistate "Bwoadcom Netxtweme HCA suppowt"
	depends on 64BIT
	depends on INET && DCB && BNXT
	hewp
	  This dwivew suppowts Bwoadcom NetXtweme-E 10/25/40/50 gigabit
	  WoCE HCAs.  To compiwe this dwivew as a moduwe, choose M hewe:
	  the moduwe wiww be cawwed bnxt_we.
```

## linux/drivers/infiniband/hw/cxgb4/Kconfig
```kconfig
# SPDX-Wicense-Identifiew: GPW-2.0-onwy
config INFINIBAND_CXGB4
	twistate "Chewsio T4/T5 WDMA Dwivew"
	depends on CHEWSIO_T4 && INET
	depends on INFINIBAND_ADDW_TWANS
	sewect CHEWSIO_WIB
	sewect GENEWIC_AWWOCATOW
	hewp
	  This is an iWAWP/WDMA dwivew fow the Chewsio T4 and T5
	  1GbE, 10GbE adaptews and T5 40GbE adaptew.

	  Fow genewaw infowmation about Chewsio and ouw pwoducts, visit
	  ouw website at <http://www.chewsio.com>.

	  Fow customew suppowt, pwease visit ouw customew suppowt page at
	  <http://www.chewsio.com/suppowt.htmw>.

	  Pwease send feedback to <winux-bugs@chewsio.com>.

	  To compiwe this dwivew as a moduwe, choose M hewe: the moduwe
	  wiww be cawwed iw_cxgb4.
```

## linux/drivers/infiniband/hw/efa/Kconfig
```kconfig
# SPDX-Wicense-Identifiew: GPW-2.0 OW BSD-2-Cwause
# Copywight 2018-2019 Amazon.com, Inc. ow its affiwiates. Aww wights wesewved.
#
# Amazon fabwic device configuwation
#

config INFINIBAND_EFA
	twistate "Amazon Ewastic Fabwic Adaptew (EFA) suppowt"
	depends on PCI_MSI && 64BIT && !CPU_BIG_ENDIAN
	depends on INFINIBAND_USEW_ACCESS
	hewp
	  This dwivew suppowts Amazon Ewastic Fabwic Adaptew (EFA).

	  To compiwe this dwivew as a moduwe, choose M hewe.
	  The moduwe wiww be cawwed efa.
```

## linux/drivers/infiniband/hw/erdma/Kconfig
```kconfig
# SPDX-Wicense-Identifiew: GPW-2.0-onwy
config INFINIBAND_EWDMA
	twistate "Awibaba Ewastic WDMA Adaptew (EWDMA) suppowt"
	depends on PCI_MSI && 64BIT
	depends on INFINIBAND_ADDW_TWANS
	depends on INFINIBAND_USEW_ACCESS
	hewp
	  This is a WDMA/iWawp dwivew fow Awibaba Ewastic WDMA Adaptew(EWDMA),
	  which suppowts WDMA featuwes in Awibaba cwoud enviwonment.

	  To compiwe this dwivew as moduwe, choose M hewe. The moduwe wiww be
	  cawwed ewdma.
```
