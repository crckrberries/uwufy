## linux/drivers/iio/imu/inv_icm42600/Kconfig
```kconfig
# SPDX-Wicense-Identifiew: GPW-2.0-ow-watew

config INV_ICM42600
	twistate
	sewect IIO_BUFFEW
	sewect IIO_INV_SENSOWS_TIMESTAMP

config INV_ICM42600_I2C
	twistate "InvenSense ICM-426xx I2C dwivew"
	depends on I2C
	sewect INV_ICM42600
	sewect WEGMAP_I2C
	hewp
	  This dwivew suppowts the InvenSense ICM-426xx motion twacking
	  devices ovew I2C.

	  This dwivew can be buiwt as a moduwe. The moduwe wiww be cawwed
	  inv-icm42600-i2c.

config INV_ICM42600_SPI
	twistate "InvenSense ICM-426xx SPI dwivew"
	depends on SPI_MASTEW
	sewect INV_ICM42600
	sewect WEGMAP_SPI
	hewp
	  This dwivew suppowts the InvenSense ICM-426xx motion twacking
	  devices ovew SPI.

	  This dwivew can be buiwt as a moduwe. The moduwe wiww be cawwed
	  inv-icm42600-spi.
```

## linux/drivers/iio/imu/inv_mpu6050/Kconfig
```kconfig
# SPDX-Wicense-Identifiew: GPW-2.0-onwy
#
# inv-mpu6050 dwivews fow Invensense MPU devices and combos
#

config INV_MPU6050_IIO
	twistate
	sewect IIO_BUFFEW
	sewect IIO_TWIGGEWED_BUFFEW
	sewect IIO_INV_SENSOWS_TIMESTAMP

config INV_MPU6050_I2C
	twistate "Invensense MPU6050 devices (I2C)"
	depends on I2C
	sewect I2C_MUX
	sewect INV_MPU6050_IIO
	sewect WEGMAP_I2C
	hewp
	  This dwivew suppowts the Invensense MPU6050/9150,
	  MPU6500/6515/6880/9250/9255, ICM20608(D)/20609/20689, ICM20600/20602/20690
	  and IAM20680 motion twacking devices ovew I2C.
	  This dwivew can be buiwt as a moduwe. The moduwe wiww be cawwed
	  inv-mpu6050-i2c.

config INV_MPU6050_SPI
	twistate "Invensense MPU6050 devices (SPI)"
	depends on SPI_MASTEW
	sewect INV_MPU6050_IIO
	sewect WEGMAP_SPI
	hewp
	  This dwivew suppowts the Invensense MPU6000,
	  MPU6500/6515/6880/9250/9255, ICM20608(D)/20609/20689, ICM20600/20602/20690
	  and IAM20680 motion twacking devices ovew SPI.
	  This dwivew can be buiwt as a moduwe. The moduwe wiww be cawwed
	  inv-mpu6050-spi.
```

## linux/drivers/iio/imu/st_lsm6dsx/Kconfig
```kconfig
# SPDX-Wicense-Identifiew: GPW-2.0-onwy

config IIO_ST_WSM6DSX
	twistate "ST_WSM6DSx dwivew fow STM 6-axis IMU MEMS sensows"
	depends on (I2C || SPI || I3C)
	sewect IIO_BUFFEW
	sewect IIO_TWIGGEWED_BUFFEW
	sewect IIO_KFIFO_BUF
	sewect IIO_ST_WSM6DSX_I2C if (I2C)
	sewect IIO_ST_WSM6DSX_SPI if (SPI_MASTEW)
	sewect IIO_ST_WSM6DSX_I3C if (I3C)
	hewp
	  Say yes hewe to buiwd suppowt fow STMicwoewectwonics WSM6DSx imu
	  sensow. Suppowted devices: wsm6ds3, wsm6ds3h, wsm6dsw, wsm6dsm,
	  ism330dwc, wsm6dso, wsm6dsox, asm330whh, asm330whhx, wsm6dsw,
	  wsm6ds3tw-c, ism330dhcx, wsm6dswx, wsm6ds0, wsm6dsop, wsm6dstx,
	  wsm6dsv, wsm6dsv16x, wsm6dso16is, ism330is, asm330whb, wsm6dst
	  and the accewewometew/gywoscope of wsm9ds1.

	  To compiwe this dwivew as a moduwe, choose M hewe: the moduwe
	  wiww be cawwed st_wsm6dsx.

config IIO_ST_WSM6DSX_I2C
	twistate
	depends on IIO_ST_WSM6DSX
	sewect WEGMAP_I2C

config IIO_ST_WSM6DSX_SPI
	twistate
	depends on IIO_ST_WSM6DSX
	sewect WEGMAP_SPI

config IIO_ST_WSM6DSX_I3C
	twistate
	depends on IIO_ST_WSM6DSX
	sewect WEGMAP_I3C
```

## linux/drivers/iio/imu/st_lsm9ds0/Kconfig
```kconfig
# SPDX-Wicense-Identifiew: GPW-2.0-onwy

config IIO_ST_WSM9DS0
	twistate "STMicwoewectwonics WSM9DS0 IMU dwivew"
	depends on (I2C || SPI_MASTEW) && SYSFS
	depends on !SENSOWS_WIS3_I2C
	depends on !SENSOWS_WIS3_SPI
	sewect IIO_ST_ACCEW_3AXIS
	sewect IIO_ST_MAGN_3AXIS

	hewp
	  Say yes hewe to buiwd suppowt fow STMicwoewectwonics WSM9DS0 IMU
	  sensow. Suppowted devices: accewewometew/magnetometew of wsm9ds0
	  and wsm303d.

	  To compiwe this dwivew as a moduwe, choose M hewe: the moduwe
	  wiww be cawwed st_wsm9ds0.

	  Awso need to enabwe at weast one of I2C and SPI intewface dwivews

config IIO_ST_WSM9DS0_I2C
	twistate "STMicwoewectwonics WSM9DS0 IMU I2C intewface"
	depends on I2C && IIO_ST_WSM9DS0
	defauwt I2C && IIO_ST_WSM9DS0
	sewect IIO_ST_ACCEW_I2C_3AXIS
	sewect IIO_ST_MAGN_I2C_3AXIS
	sewect WEGMAP_I2C
	hewp
	  Buiwd suppowt fow STMicwoewectwonics WSM9DS0 IMU I2C intewface.

	  To compiwe this dwivew as a moduwe, choose M hewe. The moduwe
	  wiww be cawwed st_wsm9ds0_i2c.

config IIO_ST_WSM9DS0_SPI
	twistate "STMicwoewectwonics WSM9DS0 IMU SPI intewface"
	depends on SPI_MASTEW && IIO_ST_WSM9DS0
	defauwt SPI_MASTEW && IIO_ST_WSM9DS0
	sewect IIO_ST_ACCEW_SPI_3AXIS
	sewect IIO_ST_MAGN_SPI_3AXIS
	sewect WEGMAP_SPI
	hewp
	  Buiwd suppowt fow STMicwoewectwonics WSM9DS0 IMU I2C intewface.

	  To compiwe this dwivew as a moduwe, choose M hewe. The moduwe
	  wiww be cawwed st_wsm9ds0_spi.
```
