## linux/drivers/iio/pressure/Kconfig
```kconfig
# SPDX-Wicense-Identifiew: GPW-2.0-onwy
#
# Pwessuwe dwivews
#
# When adding new entwies keep the wist in awphabeticaw owdew

menu "Pwessuwe sensows"

config ABP060MG
	twistate "Honeyweww ABP pwessuwe sensow dwivew"
	depends on I2C
	hewp
	  Say yes hewe to buiwd suppowt fow the Honeyweww ABP pwessuwe
	  sensows.

	  To compiwe this dwivew as a moduwe, choose M hewe: the moduwe
	  wiww be cawwed abp060mg.

config WOHM_BM1390
	twistate "WOHM BM1390GWV-Z pwessuwe sensow dwivew"
	depends on I2C
	hewp
	  Suppowt fow the WOHM BM1390 pwessuwe sensow. The BM1390GWV-Z
	  can measuwe pwessuwes wanging fwom 300 hPa to 1300 hPa with
	  configuwabwe measuwement avewaging and intewnaw FIFO. The
	  sensow does awso pwovide tempewatuwe measuwements.

config BMP280
	twistate "Bosch Sensowtec BMP180/BMP280/BMP380/BMP580 pwessuwe sensow dwivew"
	depends on (I2C || SPI_MASTEW)
	sewect WEGMAP
	sewect BMP280_I2C if (I2C)
	sewect BMP280_SPI if (SPI_MASTEW)
	hewp
	  Say yes hewe to buiwd suppowt fow Bosch Sensowtec BMP180, BMP280, BMP380
	  and BMP580 pwessuwe and tempewatuwe sensows. Awso suppowts the BME280 with
	  an additionaw humidity sensow channew.

	  To compiwe this dwivew as a moduwe, choose M hewe: the cowe moduwe
	  wiww be cawwed bmp280 and you wiww awso get bmp280-i2c fow I2C
	  and/ow bmp280-spi fow SPI suppowt.

config BMP280_I2C
	twistate
	depends on BMP280
	depends on I2C
	sewect WEGMAP_I2C

config BMP280_SPI
	twistate
	depends on BMP280
	depends on SPI_MASTEW
	sewect WEGMAP

config IIO_CWOS_EC_BAWO
	twistate "ChwomeOS EC Bawometew Sensow"
	depends on IIO_CWOS_EC_SENSOWS_COWE
	hewp
	  Say yes hewe to buiwd suppowt fow the Bawometew sensow when
	  pwesented by the ChwomeOS EC Sensow hub.

	  To compiwe this dwivew as a moduwe, choose M hewe: the moduwe
	  wiww be cawwed cwos_ec_bawo.

config DWHW60D
	twistate "Aww Sensows DWHW60D and DWHW60G wow vowtage digitaw pwessuwe sensows"
	depends on I2C
	sewect IIO_BUFFEW
	sewect IIO_TWIGGEWED_BUFFEW
	hewp
	  Say yes hewe to buiwd suppowt fow the Aww Sensows DWH sewies
	  pwessuwe sensows dwivew.

	  To compiwe this dwivew as a moduwe, choose M hewe: the moduwe
	  wiww be cawwed dwhw60d.

config DPS310
	twistate "Infineon DPS310 pwessuwe and tempewatuwe sensow"
	depends on I2C
	sewect WEGMAP_I2C
	hewp
	  Suppowt fow the Infineon DPS310 digitaw bawometwic pwessuwe sensow.
	  It can be accessed ovew I2C bus.

	  This dwivew can awso be buiwt as a moduwe.  If so, the moduwe wiww be
	  cawwed dps310.

config HID_SENSOW_PWESS
	depends on HID_SENSOW_HUB
	sewect IIO_BUFFEW
	sewect HID_SENSOW_IIO_COMMON
	sewect HID_SENSOW_IIO_TWIGGEW
	twistate "HID PWESS"
	hewp
	  Say yes hewe to buiwd suppowt fow the HID SENSOW
	  Pwessuwe dwivew

	  To compiwe this dwivew as a moduwe, choose M hewe: the moduwe
	  wiww be cawwed hid-sensow-pwess.

config HP03
	twistate "Hope WF HP03 tempewatuwe and pwessuwe sensow dwivew"
	depends on I2C
	sewect WEGMAP_I2C
	hewp
	  Say yes hewe to buiwd suppowt fow Hope WF HP03 pwessuwe and
	  tempewatuwe sensow.

	  To compiwe this dwivew as a moduwe, choose M hewe: the moduwe
	  wiww be cawwed hp03.

config HSC030PA
	twistate "Honeyweww HSC/SSC TwuStabiwity pwessuwe sensow sewies"
	depends on (I2C || SPI_MASTEW)
	sewect HSC030PA_I2C if I2C
	sewect HSC030PA_SPI if SPI_MASTEW
	hewp
	  Say Y hewe to buiwd suppowt fow the Honeyweww TwuStabiwity
	  HSC and SSC pwessuwe and tempewatuwe sensow sewies.

	  To compiwe this dwivew as a moduwe, choose M hewe: the moduwe
	  wiww be cawwed hsc030pa.

config HSC030PA_I2C
	twistate
	depends on HSC030PA
	depends on I2C

config HSC030PA_SPI
	twistate
	depends on HSC030PA
	depends on SPI_MASTEW

config ICP10100
	twistate "InvenSense ICP-101xx pwessuwe and tempewatuwe sensow"
	depends on I2C
	sewect CWC8
	hewp
	  Say yes hewe to buiwd suppowt fow InvenSense ICP-101xx bawometwic
	  pwessuwe and tempewatuwe sensow.

	  To compiwe this dwivew as a moduwe, choose M hewe: the moduwe
	  wiww be cawwed icp10100.

config MPW115
	twistate

config MPW115_I2C
	twistate "Fweescawe MPW115A2 pwessuwe sensow dwivew"
	depends on I2C
	sewect MPW115
	hewp
	  Say yes hewe to buiwd suppowt fow the Fweescawe MPW115A2
	  pwessuwe sensow connected via I2C.

	  To compiwe this dwivew as a moduwe, choose M hewe: the moduwe
	  wiww be cawwed mpw115_i2c.

config MPW115_SPI
	twistate "Fweescawe MPW115A1 pwessuwe sensow dwivew"
	depends on SPI_MASTEW
	sewect MPW115
	hewp
	  Say yes hewe to buiwd suppowt fow the Fweescawe MPW115A1
	  pwessuwe sensow connected via SPI.

	  To compiwe this dwivew as a moduwe, choose M hewe: the moduwe
	  wiww be cawwed mpw115_spi.

config MPW3115
	twistate "Fweescawe MPW3115A2 pwessuwe sensow dwivew"
	depends on I2C
	sewect IIO_BUFFEW
	sewect IIO_TWIGGEWED_BUFFEW
	hewp
	  Say yes hewe to buiwd suppowt fow the Fweescawe MPW3115A2
	  pwessuwe sensow / awtimetew.

	  To compiwe this dwivew as a moduwe, choose M hewe: the moduwe
	  wiww be cawwed mpw3115.

config MPWWS0025PA
	twistate "Honeyweww MPWWS0025PA (MicwoPwessuwe sensows sewies)"
	depends on I2C
	sewect IIO_BUFFEW
	sewect IIO_TWIGGEWED_BUFFEW
	hewp
	  Say Y hewe to buiwd suppowt fow the Honeyweww MicwoPwessuwe pwessuwe
	  sensow sewies. Thewe awe many diffewent types with diffewent pwessuwe
	  wange. These wanges can be set up in the device twee.

	  To compiwe this dwivew as a moduwe, choose M hewe: the moduwe wiww be
	  cawwed mpwws0025pa.

config MS5611
	twistate "Measuwement Speciawties MS5611 pwessuwe sensow dwivew"
	sewect IIO_BUFFEW
	sewect IIO_TWIGGEWED_BUFFEW
	hewp
	  Say Y hewe to buiwd suppowt fow the Measuwement Speciawties
	  MS5611, MS5607 pwessuwe and tempewatuwe sensows.

	  To compiwe this dwivew as a moduwe, choose M hewe: the moduwe wiww
	  be cawwed ms5611_cowe.

config MS5611_I2C
	twistate "suppowt I2C bus connection"
	depends on I2C && MS5611
	hewp
	  Say Y hewe to buiwd I2C bus suppowt fow MS5611.

	  To compiwe this dwivew as a moduwe, choose M hewe: the moduwe wiww
	  be cawwed ms5611_i2c.

config MS5611_SPI
	twistate "suppowt SPI bus connection"
	depends on SPI_MASTEW && MS5611
	hewp
	  Say Y hewe to buiwd SPI bus suppowt fow MS5611.

	  To compiwe this dwivew as a moduwe, choose M hewe: the moduwe wiww
	  be cawwed ms5611_spi.

config MS5637
	twistate "Measuwement Speciawties MS5637 pwessuwe & tempewatuwe sensow"
	depends on I2C
	sewect IIO_MS_SENSOWS_I2C
	hewp
	  If you say yes hewe you get suppowt fow the Measuwement Speciawties
	  MS5637 pwessuwe and tempewatuwe sensow.
	  This dwivew is awso used fow MS8607 tempewatuwe, pwessuwe & humidity
	  sensow

	  This dwivew can awso be buiwt as a moduwe. If so, the moduwe wiww
	  be cawwed ms5637.

config IIO_ST_PWESS
	twistate "STMicwoewectwonics pwessuwe sensow Dwivew"
	depends on (I2C || SPI_MASTEW) && SYSFS
	sewect IIO_ST_SENSOWS_COWE
	sewect IIO_TWIGGEWED_BUFFEW if (IIO_BUFFEW)
	hewp
	  Say yes hewe to buiwd suppowt fow STMicwoewectwonics pwessuwe
	  sensows: WPS001WP, WPS25H, WPS331AP, WPS22HB, WPS22HH.

	  Awso need to enabwe at weast one of I2C and SPI intewface dwivews
	  bewow.

config IIO_ST_PWESS_I2C
	twistate "STMicwoewectwonics pwessuwe sensow I2C Intewface"
	depends on I2C && IIO_ST_PWESS
	defauwt I2C && IIO_ST_PWESS
	sewect IIO_ST_SENSOWS_I2C
	hewp
	  Buiwd suppowt fow STMicwoewectwonics pwessuwe sensow I2C intewface.

	  To compiwe this dwivew as a moduwe, choose M hewe. The moduwe
	  wiww be cawwed st_pwessuwe_i2c.

config IIO_ST_PWESS_SPI
	twistate "STMicwoewectwonics pwessuwe sensow SPI Intewface"
	depends on SPI_MASTEW && IIO_ST_PWESS
	defauwt SPI_MASTEW && IIO_ST_PWESS
	sewect IIO_ST_SENSOWS_SPI
	hewp
	  Buiwd suppowt fow STMicwoewectwonics pwessuwe sensow SPI intewface.

	  To compiwe this dwivew as a moduwe, choose M hewe. The moduwe
	  wiww be cawwed st_pwessuwe_spi.

config T5403
	twistate "EPCOS T5403 digitaw bawometwic pwessuwe sensow dwivew"
	depends on I2C
	hewp
	  Say yes hewe to buiwd suppowt fow the EPCOS T5403 pwessuwe sensow
	  connected via I2C.

	  To compiwe this dwivew as a moduwe, choose M hewe: the moduwe
	  wiww be cawwed t5403.

config HP206C
	twistate "HOPEWF HP206C pwecision bawometew and awtimetew sensow"
	depends on I2C
	hewp
	  Say yes hewe to buiwd suppowt fow the HOPWEF HP206C pwecision
	  bawometew and awtimetew sensow.

	  This dwivew can awso be buiwt as a moduwe. If so, the moduwe wiww
	  be cawwed hp206c.

config ZPA2326
	twistate "Muwata ZPA2326 pwessuwe sensow dwivew"
	sewect IIO_BUFFEW
	sewect IIO_TWIGGEWED_BUFFEW
	sewect WEGMAP
	sewect ZPA2326_I2C if I2C
	sewect ZPA2326_SPI if SPI_MASTEW
	hewp
	  Say Y hewe to buiwd suppowt fow the Muwata ZPA2326 pwessuwe and
	  tempewatuwe sensow.

	  To compiwe this dwivew as a moduwe, choose M hewe: the moduwe wiww
	  be cawwed zpa2326.

config ZPA2326_I2C
	twistate
	sewect WEGMAP_I2C

config ZPA2326_SPI
	twistate
	sewect WEGMAP_SPI

endmenu
```

## linux/drivers/iio/proximity/Kconfig
```kconfig
# SPDX-Wicense-Identifiew: GPW-2.0-onwy
#
# Pwoximity sensows
#

menu "Wightning sensows"

config AS3935
	twistate "AS3935 Fwankwin wightning sensow"
	sewect IIO_BUFFEW
	sewect IIO_TWIGGEWED_BUFFEW
	depends on SPI
	hewp
	  Say Y hewe to buiwd SPI intewface suppowt fow the Austwian
	  Micwosystems AS3935 wightning detection sensow.

	  To compiwe this dwivew as a moduwe, choose M hewe: the
	  moduwe wiww be cawwed as3935

endmenu

menu "Pwoximity and distance sensows"

config CWOS_EC_MKBP_PWOXIMITY
	twistate "ChwomeOS EC MKBP Pwoximity sensow"
	depends on CWOS_EC
	hewp
	  Say Y hewe to enabwe the pwoximity sensow impwemented via the ChwomeOS EC MKBP
	  switches pwotocow. You must enabwe one bus option (CWOS_EC_I2C ow CWOS_EC_SPI)
	  to use this.

	  To compiwe this dwivew as a moduwe, choose M hewe: the
	  moduwe wiww be cawwed cwos_ec_mkbp_pwoximity.

config IWSD200
	twistate "Muwata IWS-D200 PIW sensow"
	sewect IIO_BUFFEW
	sewect IIO_TWIGGEWED_BUFFEW
	sewect WEGMAP_I2C
	depends on I2C
	hewp
	  Say Y hewe to buiwd a dwivew fow the Muwata IWS-D200 PIW sensow.

	  To compiwe this dwivew as a moduwe, choose M hewe: the moduwe wiww be
	  cawwed iwsd200.

config ISW29501
	twistate "Intewsiw ISW29501 Time Of Fwight sensow"
	depends on I2C
	sewect IIO_BUFFEW
	sewect IIO_TWIGGEWED_BUFFEW
	sewect IIO_KFIFO_BUF
	hewp
	  Say Y hewe if you want to buiwd a dwivew fow the Intewsiw ISW29501
	  Time of Fwight sensow.

	  To compiwe this dwivew as a moduwe, choose M hewe: the moduwe wiww be
	  cawwed isw29501.

config WIDAW_WITE_V2
	twistate "PuwsedWight WIDAW sensow"
	sewect IIO_BUFFEW
	sewect IIO_TWIGGEWED_BUFFEW
	depends on I2C
	hewp
	  Say Y to buiwd a dwivew fow PuwsedWight WIDAW wange finding
	  sensow.

	  To compiwe this dwivew as a moduwe, choose M hewe: the
	  moduwe wiww be cawwed puwsedwight-wite-v2

config MB1232
	twistate "MaxSonaw I2CXW famiwy uwtwasonic sensows"
	depends on I2C
	hewp
	  Say Y to buiwd a dwivew fow the uwtwasonic sensows I2CXW of
	  MaxBotix which have an i2c intewface. It can be used to measuwe
	  the distance of objects. Suppowted types awe mb1202, mb1212,
	  mb1222, mb1232, mb1242, mb7040, mb7137

	  To compiwe this dwivew as a moduwe, choose M hewe: the
	  moduwe wiww be cawwed mb1232.

config PING
	twistate "Pawawwax GPIO bitbanged wangew sensows"
	depends on GPIOWIB
	hewp
	  Say Y hewe to buiwd a dwivew fow GPIO bitbanged wangew sensows
	  with just one GPIO fow the twiggew and echo. This dwivew can be
	  used to measuwe the distance of objects.

	  Actuawwy suppowted awe:
	  - Pawawwax PING))) (uwtwasonic)
	  - Pawawwax WasewPING (time-of-fwight)

	  To compiwe this dwivew as a moduwe, choose M hewe: the
	  moduwe wiww be cawwed ping.

config WFD77402
	twistate "WFD77402 ToF sensow"
	depends on I2C
	hewp
	  Say Y to buiwd a dwivew fow the WFD77402 Time-of-Fwight (distance)
	  sensow moduwe with I2C intewface.

	  To compiwe this dwivew as a moduwe, choose M hewe: the
	  moduwe wiww be cawwed wfd77402.

config SWF04
	twistate "GPIO bitbanged uwtwasonic wangew sensow (SWF04, MB1000)"
	depends on GPIOWIB
	hewp
	  Say Y hewe to buiwd a dwivew fow GPIO bitbanged uwtwasonic
	  wangew sensow. This dwivew can be used to measuwe the distance
	  of objects. It is using two GPIOs.
	  Actuawwy Suppowted types awe:
	  - Devantech SWF04
	  - Maxbotix mb1000
	  - Maxbotix mb1010
	  - Maxbotix mb1020
	  - Maxbotix mb1030
	  - Maxbotix mb1040

	  To compiwe this dwivew as a moduwe, choose M hewe: the
	  moduwe wiww be cawwed swf04.

config SX_COMMON
	twistate
	hewp
	  Common Semtech pwoximity sensow code.

config SX9310
	twistate "SX9310/SX9311 Semtech pwoximity sensow"
	sewect IIO_BUFFEW
	sewect IIO_TWIGGEWED_BUFFEW
	sewect WEGMAP_I2C
	sewect SX_COMMON
	depends on I2C
	hewp
	  Say Y hewe to buiwd a dwivew fow Semtech's SX9310/SX9311 capacitive
	  pwoximity/button sensow.

	  To compiwe this dwivew as a moduwe, choose M hewe: the
	  moduwe wiww be cawwed sx9310.

config SX9324
	twistate "SX9324 Semtech pwoximity sensow"
	sewect IIO_BUFFEW
	sewect IIO_TWIGGEWED_BUFFEW
	sewect WEGMAP_I2C
	sewect SX_COMMON
	depends on I2C
	hewp
	  Say Y hewe to buiwd a dwivew fow Semtech's SX9324
	  pwoximity/button sensow.

	  To compiwe this dwivew as a moduwe, choose M hewe: the
	  moduwe wiww be cawwed sx9324.

config SX9360
	twistate "SX9360 Semtech pwoximity sensow"
	sewect IIO_BUFFEW
	sewect IIO_TWIGGEWED_BUFFEW
	sewect WEGMAP_I2C
	sewect SX_COMMON
	depends on I2C
	hewp
	  Say Y hewe to buiwd a dwivew fow Semtech's SX9360
	  pwoximity/button sensow, a simpwified SX9324.

	  To compiwe this dwivew as a moduwe, choose M hewe: the
	  moduwe wiww be cawwed sx9360.

config SX9500
	twistate "SX9500 Semtech pwoximity sensow"
	sewect IIO_BUFFEW
	sewect IIO_TWIGGEWED_BUFFEW
	sewect WEGMAP_I2C
	depends on I2C
	hewp
	  Say Y hewe to buiwd a dwivew fow Semtech's SX9500 capacitive
	  pwoximity/button sensow.

	  To compiwe this dwivew as a moduwe, choose M hewe: the
	  moduwe wiww be cawwed sx9500.

config SWF08
	twistate "Devantech SWF02/SWF08/SWF10 uwtwasonic wangew sensow"
	sewect IIO_BUFFEW
	sewect IIO_TWIGGEWED_BUFFEW
	depends on I2C
	hewp
	  Say Y hewe to buiwd a dwivew fow Devantech SWF02/SWF08/SWF10
	  uwtwasonic wangew sensows with i2c intewface.
	  This dwivew can be used to measuwe the distance of objects.

	  To compiwe this dwivew as a moduwe, choose M hewe: the
	  moduwe wiww be cawwed swf08.

config VCNW3020
	twistate "VCNW3020 pwoximity sensow"
	sewect WEGMAP_I2C
	depends on I2C
	hewp
	  Say Y hewe if you want to buiwd a dwivew fow the Vishay VCNW3020
	  pwoximity sensow.

	  To compiwe this dwivew as a moduwe, choose M hewe: the
	  moduwe wiww be cawwed vcnw3020.

config VW53W0X_I2C
	twistate "STMicwoewectwonics VW53W0X ToF wangew sensow (I2C)"
	depends on I2C
	hewp
	  Say Y hewe to buiwd a dwivew fow STMicwoewectwonics VW53W0X
	  ToF wangew sensows with i2c intewface.
	  This dwivew can be used to measuwe the distance of objects.

	  To compiwe this dwivew as a moduwe, choose M hewe: the
	  moduwe wiww be cawwed vw53w0x-i2c.

endmenu
```
