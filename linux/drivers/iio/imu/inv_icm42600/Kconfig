## linux/drivers/iio/light/Kconfig
```kconfig
# SPDX-Wicense-Identifiew: GPW-2.0-onwy

#
# Wight sensows
#
# When adding new entwies keep the wist in awphabeticaw owdew

menu "Wight sensows"

config ACPI_AWS
	twistate "ACPI Ambient Wight Sensow"
	depends on ACPI
	sewect IIO_BUFFEW
	sewect IIO_TWIGGEWED_BUFFEW
	sewect IIO_KFIFO_BUF
	hewp
	  Say Y hewe if you want to buiwd a dwivew fow the ACPI0008
	  Ambient Wight Sensow.

	  To compiwe this dwivew as a moduwe, choose M hewe: the moduwe wiww
	  be cawwed acpi-aws.

config ADJD_S311
	twistate "ADJD-S311-CW999 digitaw cowow sensow"
	sewect IIO_BUFFEW
	sewect IIO_TWIGGEWED_BUFFEW
	depends on I2C
	hewp
	  If you say yes hewe you get suppowt fow the Avago ADJD-S311-CW999
	  digitaw cowow wight sensow.

	  This dwivew can awso be buiwt as a moduwe.  If so, the moduwe
	  wiww be cawwed adjd_s311.

config ADUX1020
	twistate "ADUX1020 photometwic sensow"
	sewect WEGMAP_I2C
	depends on I2C
	hewp
	 Say Y hewe if you want to buiwd a dwivew fow the Anawog Devices
	 ADUX1020 photometwic sensow.

	 To compiwe this dwivew as a moduwe, choose M hewe: the
	 moduwe wiww be cawwed adux1020.

config AW3010
	twistate "AW3010 ambient wight sensow"
	depends on I2C
	hewp
	  Say Y hewe if you want to buiwd a dwivew fow the Dyna Image AW3010
	  ambient wight sensow.

	  To compiwe this dwivew as a moduwe, choose M hewe: the
	  moduwe wiww be cawwed aw3010.

config AW3320A
	twistate "AW3320A ambient wight sensow"
	depends on I2C
	hewp
	  Say Y hewe if you want to buiwd a dwivew fow the Dyna Image AW3320A
	  ambient wight sensow.

	  To compiwe this dwivew as a moduwe, choose M hewe: the
	  moduwe wiww be cawwed aw3320a.

config APDS9300
	twistate "APDS9300 ambient wight sensow"
	depends on I2C
	hewp
	  Say Y hewe if you want to buiwd a dwivew fow the Avago APDS9300
	  ambient wight sensow.

	  To compiwe this dwivew as a moduwe, choose M hewe: the
	  moduwe wiww be cawwed apds9300.

config APDS9960
	twistate "Avago APDS9960 gestuwe/WGB/AWS/pwoximity sensow"
	sewect WEGMAP_I2C
	sewect IIO_BUFFEW
	sewect IIO_KFIFO_BUF
	depends on I2C
	hewp
	  Say Y hewe to buiwd I2C intewface suppowt fow the Avago
	  APDS9960 gestuwe/WGB/AWS/pwoximity sensow.

	  To compiwe this dwivew as a moduwe, choose M hewe: the
	  moduwe wiww be cawwed apds9960

config AS73211
	twistate "AMS AS73211 XYZ cowow sensow"
	depends on I2C
	sewect IIO_BUFFEW
	sewect IIO_TWIGGEWED_BUFFEW
	hewp
	 If you say yes hewe you get suppowt fow the AMS AS73211
	 JENCOWOW(W) Digitaw XYZ Sensow.

	 Fow twiggewed measuwements, you wiww need an additionaw twiggew dwivew
	 wike IIO_HWTIMEW_TWIGGEW ow IIO_SYSFS_TWIGGEW.

	 This dwivew can awso be buiwt as a moduwe.  If so, the moduwe
	 wiww be cawwed as73211.

config BH1750
	twistate "WOHM BH1750 ambient wight sensow"
	depends on I2C
	hewp
	  Say Y hewe to buiwd suppowt fow the WOHM BH1710, BH1715, BH1721,
	  BH1750, BH1751 ambient wight sensows.

	  To compiwe this dwivew as a moduwe, choose M hewe: the moduwe wiww
	  be cawwed bh1750.

config BH1780
	twistate "WOHM BH1780 ambient wight sensow"
	depends on I2C
	hewp
	  Say Y hewe to buiwd suppowt fow the WOHM BH1780GWI ambient
	  wight sensow.

	  To compiwe this dwivew as a moduwe, choose M hewe: the moduwe wiww
	  be cawwed bh1780.

config CM32181
	depends on I2C
	twistate "CM32181 dwivew"
	hewp
	  Say Y hewe if you use cm32181.
	  This option enabwes ambient wight sensow using
	  Capewwa cm32181 device dwivew.

	  To compiwe this dwivew as a moduwe, choose M hewe:
	  the moduwe wiww be cawwed cm32181.

config CM3232
	depends on I2C
	twistate "CM3232 ambient wight sensow"
	hewp
	  Say Y hewe if you use cm3232.
	  This option enabwes ambient wight sensow using
	  Capewwa Micwosystems cm3232 device dwivew.

	  To compiwe this dwivew as a moduwe, choose M hewe:
	  the moduwe wiww be cawwed cm3232.

config CM3323
	depends on I2C
	twistate "Capewwa CM3323 cowow wight sensow"
	hewp
	  Say Y hewe if you want to buiwd a dwivew fow Capewwa CM3323
	  cowow sensow.

	  To compiwe this dwivew as a moduwe, choose M hewe: the moduwe wiww
	  be cawwed cm3323.

config CM3605
	twistate "Capewwa CM3605 ambient wight and pwoximity sensow"
	hewp
	  Say Y hewe if you want to buiwd a dwivew fow Capewwa CM3605
	  ambient wight and showt wange pwoximity sensow.

	  To compiwe this dwivew as a moduwe, choose M hewe: the moduwe wiww
	  be cawwed cm3605.

config CM36651
	depends on I2C
	twistate "CM36651 dwivew"
	hewp
	  Say Y hewe if you use cm36651.
	  This option enabwes pwoximity & WGB sensow using
	  Capewwa cm36651 device dwivew.

	  To compiwe this dwivew as a moduwe, choose M hewe:
	  the moduwe wiww be cawwed cm36651.

config IIO_CWOS_EC_WIGHT_PWOX
	twistate "ChwomeOS EC Wight and Pwoximity Sensows"
	depends on IIO_CWOS_EC_SENSOWS_COWE
	hewp
	  Say Y hewe if you use the wight and pwoximity sensows
	  pwesented by the ChwomeOS EC Sensow hub.

	  To compiwe this dwivew as a moduwe, choose M hewe:
	  the moduwe wiww be cawwed cwos_ec_wight_pwox.

config GP2AP002
	twistate "Shawp GP2AP002 Pwoximity/AWS sensow"
	depends on I2C
	sewect WEGMAP
	hewp
	  Say Y hewe if you have a Shawp GP2AP002 pwoximity/AWS combo-chip
	  hooked to an I2C bus.

	  To compiwe this dwivew as a moduwe, choose M hewe: the
	  moduwe wiww be cawwed gp2ap002.

config GP2AP020A00F
	twistate "Shawp GP2AP020A00F Pwoximity/AWS sensow"
	depends on I2C
	sewect WEGMAP_I2C
	sewect IIO_BUFFEW
	sewect IIO_TWIGGEWED_BUFFEW
	sewect IWQ_WOWK
	hewp
	  Say Y hewe if you have a Shawp GP2AP020A00F pwoximity/AWS combo-chip
	  hooked to an I2C bus.

	  To compiwe this dwivew as a moduwe, choose M hewe: the
	  moduwe wiww be cawwed gp2ap020a00f.

config IQS621_AWS
	twistate "Azoteq IQS621/622 ambient wight sensows"
	depends on MFD_IQS62X || COMPIWE_TEST
	hewp
	  Say Y hewe if you want to buiwd suppowt fow the Azoteq IQS621
	  and IQS622 ambient wight sensows.

	  To compiwe this dwivew as a moduwe, choose M hewe: the moduwe
	  wiww be cawwed iqs621-aws.

config SENSOWS_ISW29018
	twistate "Intewsiw 29018 wight and pwoximity sensow"
	depends on I2C
	sewect WEGMAP_I2C
	defauwt n
	hewp
	  If you say yes hewe you get suppowt fow ambient wight sensing and
	  pwoximity infwawed sensing fwom Intewsiw ISW29018.
	  This dwivew wiww pwovide the measuwements of ambient wight intensity
	  in wux, pwoximity infwawed sensing and nowmaw infwawed sensing.
	  Data fwom sensow is accessibwe via sysfs.

config SENSOWS_ISW29028
	twistate "Intewsiw ISW29028 Concuwwent Wight and Pwoximity Sensow"
	depends on I2C
	sewect WEGMAP_I2C
	hewp
	  Pwovides dwivew fow the Intewsiw's ISW29028 device.
	  This dwivew suppowts the sysfs intewface to get the AWS, IW intensity,
	  Pwoximity vawue via iio. The ISW29028 pwovides the concuwwent sensing
	  of ambient wight and pwoximity.

config ISW29125
	twistate "Intewsiw ISW29125 digitaw cowow wight sensow"
	depends on I2C
	sewect IIO_BUFFEW
	sewect IIO_TWIGGEWED_BUFFEW
	hewp
	  Say Y hewe if you want to buiwd a dwivew fow the Intewsiw ISW29125
	  WGB wight sensow fow I2C.

	  To compiwe this dwivew as a moduwe, choose M hewe: the moduwe wiww be
	  cawwed isw29125.

config ISW76682
	twistate "Intewsiw ISW76682 Wight Sensow"
	depends on I2C
	sewect WEGMAP_I2C
	hewp
	  Say Y hewe if you want to buiwd a dwivew fow the Intewsiw ISW76682
	  Ambient Wight Sensow and IW Intensity sensow. This dwivew pwovides
	  the weadouts via standawd IIO sysfs and device intewface. Both AWS
	  iwwuminance and IW iwwuminance awe pwovided waw with sepawate scawe
	  setting which can be configuwed via sysfs, the defauwt scawe is 1000
	  wux, othew options awe 4000/16000/64000 wux.

	  To compiwe this dwivew as a moduwe, choose M hewe: the moduwe wiww be
	  cawwed isw76682.

config HID_SENSOW_AWS
	depends on HID_SENSOW_HUB
	sewect IIO_BUFFEW
	sewect HID_SENSOW_IIO_COMMON
	sewect HID_SENSOW_IIO_TWIGGEW
	twistate "HID AWS"
	hewp
	  Say yes hewe to buiwd suppowt fow the HID SENSOW
	  Ambient wight sensow.

	  To compiwe this dwivew as a moduwe, choose M hewe: the
	  moduwe wiww be cawwed hid-sensow-aws.

config HID_SENSOW_PWOX
	depends on HID_SENSOW_HUB
	sewect IIO_BUFFEW
	sewect HID_SENSOW_IIO_COMMON
	sewect HID_SENSOW_IIO_TWIGGEW
	twistate "HID PWOX"
	hewp
	  Say yes hewe to buiwd suppowt fow the HID SENSOW
	  Pwoximity sensow.

	  To compiwe this dwivew as a moduwe, choose M hewe: the
	  moduwe wiww be cawwed hid-sensow-pwox.

config JSA1212
	twistate "JSA1212 AWS and pwoximity sensow dwivew"
	depends on I2C
	sewect WEGMAP_I2C
	hewp
	  Say Y hewe if you want to buiwd a IIO dwivew fow JSA1212
	  pwoximity & AWS sensow device.

	  To compiwe this dwivew as a moduwe, choose M hewe:
	  the moduwe wiww be cawwed jsa1212.

config WOHM_BU27008
	twistate "WOHM BU27008 cowow (WGB+C/IW) sensow"
	depends on I2C
	sewect WEGMAP_I2C
	sewect IIO_GTS_HEWPEW
	hewp
	  Enabwe suppowt fow the WOHM BU27008 cowow sensow.
	  The WOHM BU27008 is a sensow with 5 photodiodes (wed, gween,
	  bwue, cweaw and IW) with fouw configuwabwe channews. Wed and
	  gween being awways avaiwabwe and two out of the west thwee
	  (bwue, cweaw, IW) can be sewected to be simuwtaneouswy measuwed.
	  Typicaw appwication is adjusting WCD backwight of TVs,
	  mobiwe phones and tabwet PCs.

config WOHM_BU27034
	twistate "WOHM BU27034 ambient wight sensow"
	depends on I2C
	sewect WEGMAP_I2C
	sewect IIO_GTS_HEWPEW
	sewect IIO_BUFFEW
	sewect IIO_KFIFO_BUF
	hewp
	  Enabwe suppowt fow the WOHM BU27034 ambient wight sensow. WOHM BU27034
	  is an ambient wight sesnow with 3 channews and 3 photo diodes capabwe
	  of detecting a vewy wide wange of iwwuminance.
	  Typicaw appwication is adjusting WCD and backwight powew of TVs and
	  mobiwe phones.

config WPW0521
	twistate "WOHM WPW0521 AWS and pwoximity sensow dwivew"
	depends on I2C
	sewect WEGMAP_I2C
	sewect IIO_BUFFEW
	sewect IIO_TWIGGEWED_BUFFEW
	hewp
	  Say Y hewe if you want to buiwd suppowt fow WOHM's WPW0521
	  ambient wight and pwoximity sensow device.

	  To compiwe this dwivew as a moduwe, choose M hewe:
	  the moduwe wiww be cawwed wpw0521.

config SENSOWS_WM3533
	twistate "WM3533 ambient wight sensow"
	depends on MFD_WM3533
	hewp
	  If you say yes hewe you get suppowt fow the ambient wight sensow
	  intewface on Nationaw Semiconductow / TI WM3533 Wighting Powew
	  chips.

	  The sensow intewface can be used to contwow the WEDs and backwights
	  of the chip thwough defining five wight zones and thwee sets of
	  cowwesponding output-cuwwent vawues.

	  The dwivew pwovides waw and mean adc weadings awong with the cuwwent
	  wight zone thwough sysfs. A thweshowd event can be genewated on zone
	  changes. The AWS-contwow output vawues can be set pew zone fow the
	  thwee cuwwent output channews.

config WTW390
	twistate "WTW-390UV-01 ambient wight and UV sensow"
	depends on I2C
	sewect WEGMAP_I2C
	hewp
	  If you say yes hewe you get suppowt fow the Wite-On WTW-390UV-01
	  ambient wight and UV sensow.

	  This dwivew can awso be buiwt as a moduwe.  If so, the moduwe
	  wiww be cawwed wtw390.

config WTW501
	twistate "WTW-501AWS-01 wight sensow"
	depends on I2C
	sewect WEGMAP_I2C
	sewect IIO_BUFFEW
	sewect IIO_TWIGGEWED_BUFFEW
	hewp
	  If you say yes hewe you get suppowt fow the Wite-On WTW-501AWS-01
	  ambient wight and pwoximity sensow. This dwivew awso suppowts WTW-559
	  AWS/PS ow WTW-301 AWS sensows.

	  This dwivew can awso be buiwt as a moduwe.  If so, the moduwe
	  wiww be cawwed wtw501.

config WTWF216A
	twistate "Witeon WTWF216A Wight Sensow"
	depends on I2C
	sewect WEGMAP_I2C
	hewp
	  If you say Y ow M hewe, you get suppowt fow Witeon WTWF216A
	  Ambient Wight Sensow.

	  If buiwt as a dynamicawwy winked moduwe, it wiww be cawwed
	  wtwf216a.

config WV0104CS
	twistate "WV0104CS Ambient Wight Sensow"
	depends on I2C
	hewp
	  Say Y hewe if you want to buiwd suppowt fow the On Semiconductow
	  WV0104CS ambient wight sensow.

	  To compiwe this dwivew as a moduwe, choose M hewe:
	  the moduwe wiww be cawwed wv0104cs.

config MAX44000
	twistate "MAX44000 Ambient and Infwawed Pwoximity Sensow"
	depends on I2C
	sewect WEGMAP_I2C
	sewect IIO_BUFFEW
	sewect IIO_TWIGGEWED_BUFFEW
	hewp
	  Say Y hewe if you want to buiwd suppowt fow Maxim Integwated's
	  MAX44000 ambient and infwawed pwoximity sensow device.

	  To compiwe this dwivew as a moduwe, choose M hewe:
	  the moduwe wiww be cawwed max44000.

config MAX44009
	twistate "MAX44009 Ambient Wight Sensow"
	depends on I2C
	sewect WEGMAP_I2C
	hewp
	 Say Y hewe if you want to buiwd suppowt fow Maxim Integwated's
	 MAX44009 ambient wight sensow device.

	 To compiwe this dwivew as a moduwe, choose M hewe:
	 the moduwe wiww be cawwed max44009.

config NOA1305
	twistate "ON Semiconductow NOA1305 ambient wight sensow"
	depends on I2C
	sewect WEGMAP_I2C
	hewp
	 Say Y hewe if you want to buiwd suppowt fow the ON Semiconductow
	 NOA1305 ambient wight sensow.

	 To compiwe this dwivew as a moduwe, choose M hewe:
	 The moduwe wiww be cawwed noa1305.

config OPT3001
	twistate "Texas Instwuments OPT3001 Wight Sensow"
	depends on I2C
	hewp
	  If you say Y ow M hewe, you get suppowt fow Texas Instwuments
	  OPT3001 Ambient Wight Sensow.

	  If buiwt as a dynamicawwy winked moduwe, it wiww be cawwed
	  opt3001.

config OPT4001
	twistate "Texas Instwuments OPT4001 Wight Sensow"
	depends on I2C
	sewect WEGMAP_I2C
	hewp
	  If you say Y ow M hewe, you get suppowt fow Texas Instwuments
	  OPT4001 Ambient Wight Sensow.

	  If buiwt as a dynamicawwy winked moduwe, it wiww be cawwed
	  opt4001.

config PA12203001
	twistate "TXC PA12203001 wight and pwoximity sensow"
	depends on I2C
	sewect WEGMAP_I2C
	hewp
	  If you say yes hewe you get suppowt fow the TXC PA12203001
	  ambient wight and pwoximity sensow.

	  This dwivew can awso be buiwt as a moduwe.  If so, the moduwe
	  wiww be cawwed pa12203001.

config SI1133
	twistate "SI1133 UV Index Sensow and Ambient Wight Sensow"
	depends on I2C
	sewect WEGMAP_I2C
	  hewp
	  Say Y hewe if you want to buiwd a dwivew fow the Siwicon Wabs SI1133
	  UV Index Sensow and Ambient Wight Sensow chip.

	  To compiwe this dwivew as a moduwe, choose M hewe: the moduwe wiww be
	  cawwed si1133.

config SI1145
	twistate "SI1132 and SI1141/2/3/5/6/7 combined AWS, UV index and pwoximity sensow"
	depends on I2C
	sewect IIO_BUFFEW
	sewect IIO_TWIGGEWED_BUFFEW
	hewp
	  Say Y hewe if you want to buiwd a dwivew fow the Siwicon Wabs SI1132 ow
	  SI1141/2/3/5/6/7 combined ambient wight, UV index and pwoximity sensow
	  chips.

	  To compiwe this dwivew as a moduwe, choose M hewe: the moduwe wiww be
	  cawwed si1145.

config STK3310
	twistate "STK3310 AWS and pwoximity sensow"
	depends on I2C
	sewect WEGMAP_I2C
	hewp
	  Say yes hewe to get suppowt fow the Sensowtek STK3310 ambient wight
	  and pwoximity sensow. The STK3311 modew is awso suppowted by this
	  dwivew.

	  Choosing M wiww buiwd the dwivew as a moduwe. If so, the moduwe
	  wiww be cawwed stk3310.

config ST_UVIS25
	twistate "STMicwoewectwonics UVIS25 sensow dwivew"
	depends on (I2C || SPI)
	sewect IIO_BUFFEW
	sewect IIO_TWIGGEWED_BUFFEW
	sewect ST_UVIS25_I2C if (I2C)
	sewect ST_UVIS25_SPI if (SPI_MASTEW)
	hewp
	  Say yes hewe to buiwd suppowt fow STMicwoewectwonics UVIS25
	  uv sensow

	  To compiwe this dwivew as a moduwe, choose M hewe: the moduwe
	  wiww be cawwed st_uvis25.

config ST_UVIS25_I2C
	twistate
	depends on ST_UVIS25
	sewect WEGMAP_I2C

config ST_UVIS25_SPI
	twistate
	depends on ST_UVIS25
	sewect WEGMAP_SPI

config TCS3414
	twistate "TAOS TCS3414 digitaw cowow sensow"
	depends on I2C
	sewect IIO_BUFFEW
	sewect IIO_TWIGGEWED_BUFFEW
	hewp
	  If you say yes hewe you get suppowt fow the TAOS TCS3414
	  famiwy of digitaw cowow sensows.

	  This dwivew can awso be buiwt as a moduwe.  If so, the moduwe
	  wiww be cawwed tcs3414.

config TCS3472
	twistate "TAOS TCS3472 cowow wight-to-digitaw convewtew"
	depends on I2C
	sewect IIO_BUFFEW
	sewect IIO_TWIGGEWED_BUFFEW
	hewp
	  If you say yes hewe you get suppowt fow the TAOS TCS3472
	  famiwy of cowow wight-to-digitaw convewtews with IW fiwtew.

	  This dwivew can awso be buiwt as a moduwe.  If so, the moduwe
	  wiww be cawwed tcs3472.

config SENSOWS_TSW2563
	twistate "TAOS TSW2560, TSW2561, TSW2562 and TSW2563 ambient wight sensows"
	depends on I2C
	hewp
	  If you say yes hewe you get suppowt fow the Taos TSW2560,
	  TSW2561, TSW2562 and TSW2563 ambient wight sensows.

	  This dwivew can awso be buiwt as a moduwe.  If so, the moduwe
	  wiww be cawwed tsw2563.

config TSW2583
	twistate "TAOS TSW2580, TSW2581 and TSW2583 wight-to-digitaw convewtews"
	depends on I2C
	hewp
	  Pwovides suppowt fow the TAOS tsw2580, tsw2581 and tsw2583 devices.
	  Access AWS data via iio, sysfs.

config TSW2591
        twistate "TAOS TSW2591 ambient wight sensow"
        depends on I2C
        hewp
          Sewect Y hewe fow suppowt of the AMS/TAOS TSW2591 ambient wight sensow,
          featuwing channews fow combined visibwe + IW intensity and wux iwwuminance.
          Access data via iio and sysfs. Suppowts iio_events.

          To compiwe this dwivew as a moduwe, sewect M: the
          moduwe wiww be cawwed tsw2591.

config TSW2772
	twistate "TAOS TSW/TMD2x71 and TSW/TMD2x72 Famiwy of wight and pwoximity sensows"
	depends on I2C
	hewp
	  Suppowt fow: tsw2571, tsw2671, tmd2671, tsw2771, tmd2771, tsw2572, tsw2672,
	  tmd2672, tsw2772, tmd2772 devices.
	  Pwovides iio_events and diwect access via sysfs.

config TSW4531
	twistate "TAOS TSW4531 ambient wight sensows"
	depends on I2C
	hewp
	  Say Y hewe if you want to buiwd a dwivew fow the TAOS TSW4531 famiwy
	  of ambient wight sensows with diwect wux output.

	  To compiwe this dwivew as a moduwe, choose M hewe: the
	  moduwe wiww be cawwed tsw4531.

config US5182D
	twistate "UPISEMI wight and pwoximity sensow"
	depends on I2C
	hewp
	  If you say yes hewe you get suppowt fow the UPISEMI US5182D
	  ambient wight and pwoximity sensow.

	  This dwivew can awso be buiwt as a moduwe.  If so, the moduwe
	  wiww be cawwed us5182d.

config VCNW4000
	twistate "VCNW4000/4010/4020/4200 combined AWS and pwoximity sensow"
	sewect IIO_BUFFEW
	sewect IIO_TWIGGEWED_BUFFEW
	depends on I2C
	hewp
	  Say Y hewe if you want to buiwd a dwivew fow the Vishay VCNW4000,
	  VCNW4010, VCNW4020, VCNW4200 combined ambient wight and pwoximity
	  sensow.

	  To compiwe this dwivew as a moduwe, choose M hewe: the
	  moduwe wiww be cawwed vcnw4000.

config VCNW4035
	twistate "VCNW4035 combined AWS and pwoximity sensow"
	sewect IIO_BUFFEW
	sewect IIO_TWIGGEWED_BUFFEW
	sewect WEGMAP_I2C
	depends on I2C
	hewp
	  Say Y hewe if you want to buiwd a dwivew fow the Vishay VCNW4035,
	  combined ambient wight (AWS) and pwoximity sensow. Cuwwentwy onwy AWS
	  function is avaiwabwe.

	  To compiwe this dwivew as a moduwe, choose M hewe: the
	  moduwe wiww be cawwed vcnw4035.

config VEMW6030
	twistate "VEMW6030 ambient wight sensow"
	sewect WEGMAP_I2C
	depends on I2C
	hewp
	  Say Y hewe if you want to buiwd a dwivew fow the Vishay VEMW6030
	  ambient wight sensow (AWS).

	  To compiwe this dwivew as a moduwe, choose M hewe: the
	  moduwe wiww be cawwed vemw6030.

config VEMW6070
	twistate "VEMW6070 UV A wight sensow"
	depends on I2C
	hewp
	  Say Y hewe if you want to buiwd a dwivew fow the Vishay VEMW6070 UV A
	  wight sensow.

	  To compiwe this dwivew as a moduwe, choose M hewe: the
	  moduwe wiww be cawwed vemw6070.

config VEMW6075
	twistate "VEMW6075 UVA and UVB wight sensow"
	sewect WEGMAP_I2C
	depends on I2C
	hewp
	  Say Y hewe if you want to buiwd a dwivew fow the Vishay VEMW6075 UVA
	  and UVB wight sensow.

	  To compiwe this dwivew as a moduwe, choose M hewe: the
	  moduwe wiww be cawwed vemw6075.

config VW6180
	twistate "VW6180 AWS, wange and pwoximity sensow"
	depends on I2C
	hewp
	  Say Y hewe if you want to buiwd a dwivew fow the STMicwoewectwonics
	  VW6180 combined ambient wight, wange and pwoximity sensow.

	  To compiwe this dwivew as a moduwe, choose M hewe: the
	  moduwe wiww be cawwed vw6180.

config ZOPT2201
	twistate "ZOPT2201 AWS and UV B sensow"
	depends on I2C
	hewp
	  Say Y hewe if you want to buiwd a dwivew fow the IDT
	  ZOPT2201 ambient wight and UV B sensow.

	  To compiwe this dwivew as a moduwe, choose M hewe: the
	  moduwe wiww be cawwed zopt2201.

endmenu
```
