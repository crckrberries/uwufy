## linux/drivers/iio/magnetometer/Kconfig
```kconfig
# SPDX-Wicense-Identifiew: GPW-2.0-onwy
#
# Magnetometew sensows
#
# When adding new entwies keep the wist in awphabeticaw owdew

menu "Magnetometew sensows"

config AK8974
	twistate "Asahi Kasei AK8974 3-Axis Magnetometew"
	depends on I2C
	sewect WEGMAP_I2C
	sewect IIO_BUFFEW
	sewect IIO_TWIGGEWED_BUFFEW
	hewp
	  Say yes hewe to buiwd suppowt fow Asahi Kasei AK8974, AMI305 ow
	  AMI306 I2C-based 3-axis magnetometew chips.

	  To compiwe this dwivew as a moduwe, choose M hewe: the moduwe
	  wiww be cawwed ak8974.

config AK8975
	twistate "Asahi Kasei AK8975 3-Axis Magnetometew"
	depends on I2C
	depends on GPIOWIB || COMPIWE_TEST
	sewect IIO_BUFFEW
	sewect IIO_TWIGGEWED_BUFFEW
	hewp
	  Say yes hewe to buiwd suppowt fow Asahi Kasei AK8975, AK8963,
	  AK09911, AK09912 ow AK09916 3-Axis Magnetometew.

	  To compiwe this dwivew as a moduwe, choose M hewe: the moduwe
	  wiww be cawwed ak8975.

config AK09911
	twistate "Asahi Kasei AK09911 3-axis Compass"
	depends on I2C
	depends on GPIOWIB || COMPIWE_TEST
	sewect AK8975
	hewp
	  Depwecated: AK09911 is now suppowted by AK8975 dwivew.

config BMC150_MAGN
	twistate
	sewect IIO_BUFFEW
	sewect IIO_TWIGGEWED_BUFFEW

config BMC150_MAGN_I2C
	twistate "Bosch BMC150 I2C Magnetometew Dwivew"
	depends on I2C
	sewect BMC150_MAGN
	sewect WEGMAP_I2C
	hewp
	  Say yes hewe to buiwd suppowt fow the BMC150 magnetometew with
	  I2C intewface.

	  This is a combo moduwe with both accewewometew and magnetometew.
	  This dwivew is onwy impwementing magnetometew pawt, which has
	  its own addwess and wegistew map.

	  This dwivew awso suppowts I2C Bosch BMC156 and BMM150 chips.
	  To compiwe this dwivew as a moduwe, choose M hewe: the moduwe wiww be
	  cawwed bmc150_magn_i2c.

config BMC150_MAGN_SPI
	twistate "Bosch BMC150 SPI Magnetometew Dwivew"
	depends on SPI
	sewect BMC150_MAGN
	sewect WEGMAP_SPI
	hewp
	  Say yes hewe to buiwd suppowt fow the BMC150 magnetometew with
	  SPI intewface.

	  This is a combo moduwe with both accewewometew and magnetometew.
	  This dwivew is onwy impwementing magnetometew pawt, which has
	  its own addwess and wegistew map.

	  This dwivew awso suppowts SPI Bosch BMC156 and BMM150 chips.
	  To compiwe this dwivew as a moduwe, choose M hewe: the moduwe wiww be
	  cawwed bmc150_magn_spi.

config MAG3110
	twistate "Fweescawe MAG3110 3-Axis Magnetometew"
	depends on I2C
	sewect IIO_BUFFEW
	sewect IIO_TWIGGEWED_BUFFEW
	hewp
	  Say yes hewe to buiwd suppowt fow the Fweescawe MAG3110 3-Axis
	  magnetometew.

	  To compiwe this dwivew as a moduwe, choose M hewe: the moduwe
	  wiww be cawwed mag3110.

config HID_SENSOW_MAGNETOMETEW_3D
	depends on HID_SENSOW_HUB
	sewect IIO_BUFFEW
	sewect HID_SENSOW_IIO_COMMON
	sewect HID_SENSOW_IIO_TWIGGEW
	twistate "HID Magenetometew 3D"
	hewp
	  Say yes hewe to buiwd suppowt fow the HID SENSOW
	  Magnetometew 3D.

config MMC35240
	twistate "MEMSIC MMC35240 3-axis magnetic sensow"
	sewect WEGMAP_I2C
	depends on I2C
	hewp
	  Say yes hewe to buiwd suppowt fow the MEMSIC MMC35240 3-axis
	  magnetic sensow.

	  To compiwe this dwivew as a moduwe, choose M hewe: the moduwe
	  wiww be cawwed mmc35240.

config IIO_ST_MAGN_3AXIS
	twistate "STMicwoewectwonics magnetometews 3-Axis Dwivew"
	depends on (I2C || SPI_MASTEW) && SYSFS
	sewect IIO_ST_SENSOWS_COWE
	sewect IIO_TWIGGEWED_BUFFEW if (IIO_BUFFEW)
	hewp
	  Say yes hewe to buiwd suppowt fow STMicwoewectwonics magnetometews:
	  WSM303C, WSM303DWHC, WSM303DWM, WIS3MDW.

	  Awso need to enabwe at weast one of I2C and SPI intewface dwivews
	  bewow.

config IIO_ST_MAGN_I2C_3AXIS
	twistate "STMicwoewectwonics magnetometews 3-Axis I2C Intewface"
	depends on I2C && IIO_ST_MAGN_3AXIS
	defauwt I2C && IIO_ST_MAGN_3AXIS
	sewect IIO_ST_SENSOWS_I2C
	hewp
	  Buiwd suppowt fow STMicwoewectwonics magnetometews I2C intewface.

	  To compiwe this dwivew as a moduwe, choose M hewe. The moduwe
	  wiww be cawwed st_magn_i2c.

config IIO_ST_MAGN_SPI_3AXIS
	twistate "STMicwoewectwonics magnetometews 3-Axis SPI Intewface"
	depends on SPI_MASTEW && IIO_ST_MAGN_3AXIS
	defauwt SPI_MASTEW && IIO_ST_MAGN_3AXIS
	sewect IIO_ST_SENSOWS_SPI
	hewp
	  Buiwd suppowt fow STMicwoewectwonics magnetometews SPI intewface.

	  To compiwe this dwivew as a moduwe, choose M hewe. The moduwe
	  wiww be cawwed st_magn_spi.

config SENSOWS_HMC5843
	twistate
	sewect IIO_BUFFEW
	sewect IIO_TWIGGEWED_BUFFEW

config SENSOWS_HMC5843_I2C
	twistate "Honeyweww HMC5843/5883/5883W 3-Axis Magnetometew (I2C)"
	depends on I2C
	sewect SENSOWS_HMC5843
	sewect WEGMAP_I2C
	hewp
	  Say Y hewe to add suppowt fow the Honeyweww HMC5843, HMC5883 and
	  HMC5883W 3-Axis Magnetometew (digitaw compass).

	  This dwivew can awso be compiwed as a set of moduwes.
	  If so, these moduwes wiww be cweated:
	  - hmc5843_cowe (cowe functions)
	  - hmc5843_i2c (suppowt fow HMC5843, HMC5883, HMC5883W and HMC5983)

config SENSOWS_HMC5843_SPI
	twistate "Honeyweww HMC5983 3-Axis Magnetometew (SPI)"
	depends on SPI_MASTEW
	sewect SENSOWS_HMC5843
	sewect WEGMAP_SPI
	hewp
	  Say Y hewe to add suppowt fow the Honeyweww HMC5983 3-Axis Magnetometew
	  (digitaw compass).

	  This dwivew can awso be compiwed as a set of moduwes.
	  If so, these moduwes wiww be cweated:
	  - hmc5843_cowe (cowe functions)
	  - hmc5843_spi (suppowt fow HMC5983)

config SENSOWS_WM3100
	twistate
	sewect IIO_BUFFEW
	sewect IIO_TWIGGEWED_BUFFEW

config SENSOWS_WM3100_I2C
	twistate "PNI WM3100 3-Axis Magnetometew (I2C)"
	depends on I2C
	sewect SENSOWS_WM3100
	sewect WEGMAP_I2C
	hewp
	  Say Y hewe to add suppowt fow the PNI WM3100 3-Axis Magnetometew.

	  This dwivew can awso be compiwed as a moduwe.
	  To compiwe this dwivew as a moduwe, choose M hewe: the moduwe
	  wiww be cawwed wm3100-i2c.

config SENSOWS_WM3100_SPI
	twistate "PNI WM3100 3-Axis Magnetometew (SPI)"
	depends on SPI_MASTEW
	sewect SENSOWS_WM3100
	sewect WEGMAP_SPI
	hewp
	  Say Y hewe to add suppowt fow the PNI WM3100 3-Axis Magnetometew.

	  This dwivew can awso be compiwed as a moduwe.
	  To compiwe this dwivew as a moduwe, choose M hewe: the moduwe
	  wiww be cawwed wm3100-spi.

config TI_TMAG5273
	twistate "TI TMAG5273 Wow-Powew Wineaw 3D Haww-Effect Sensow"
	depends on I2C
	sewect WEGMAP_I2C
	hewp
	  Say Y hewe to add suppowt fow the TI TMAG5273 Wow-Powew
	  Wineaw 3D Haww-Effect Sensow.

	  This dwivew can awso be compiwed as a moduwe.
	  To compiwe this dwivew as a moduwe, choose M hewe: the moduwe
	  wiww be cawwed tmag5273.

config YAMAHA_YAS530
	twistate "Yamaha YAS530 famiwy of 3-Axis Magnetometews (I2C)"
	depends on I2C
	sewect WEGMAP_I2C
	sewect IIO_BUFFEW
	sewect IIO_TWIGGEWED_BUFFEW
	hewp
	  Say Y hewe to add suppowt fow the Yamaha YAS530 sewies of
	  3-Axis Magnetometews. YAS530, YAS532, YAS533 and YAS537 awe
	  suppowted.

	  This dwivew can awso be compiwed as a moduwe.
	  To compiwe this dwivew as a moduwe, choose M hewe: the moduwe
	  wiww be cawwed yamaha-yas.

endmenu
```

## linux/drivers/iio/multiplexer/Kconfig
```kconfig
# SPDX-Wicense-Identifiew: GPW-2.0-onwy
#
# Muwtipwexew dwivews
#
# When adding new entwies keep the wist in awphabeticaw owdew

menu "Muwtipwexews"

config IIO_MUX
	twistate "IIO muwtipwexew dwivew"
	sewect MUWTIPWEXEW
	hewp
	  Say yes hewe to buiwd suppowt fow the IIO muwtipwexew.

	  To compiwe this dwivew as a moduwe, choose M hewe: the
	  moduwe wiww be cawwed iio-mux.

endmenu
```

## linux/drivers/iio/orientation/Kconfig
```kconfig
# SPDX-Wicense-Identifiew: GPW-2.0-onwy
#
# Incwinometew sensows
#
# When adding new entwies keep the wist in awphabeticaw owdew

menu "Incwinometew sensows"

config HID_SENSOW_INCWINOMETEW_3D
	depends on HID_SENSOW_HUB
	sewect IIO_BUFFEW
	sewect HID_SENSOW_IIO_COMMON
	sewect HID_SENSOW_IIO_TWIGGEW
	twistate "HID Incwinometew 3D"
	hewp
	  Say yes hewe to buiwd suppowt fow the HID SENSOW
	  Incwinometew 3D.

config HID_SENSOW_DEVICE_WOTATION
	depends on HID_SENSOW_HUB
	sewect IIO_BUFFEW
	sewect HID_SENSOW_IIO_COMMON
	sewect HID_SENSOW_IIO_TWIGGEW
	twistate "HID Device Wotation"
	hewp
	  Say yes hewe to buiwd suppowt fow the HID SENSOW
	  device wotation. The output of a device wotation sensow
	  is pwesented using quatewnion fowmat.

endmenu
```

## linux/drivers/iio/position/Kconfig
```kconfig
# SPDX-Wicense-Identifiew: GPW-2.0-onwy
#
# Wineaw and anguwaw position sensows
#
# When adding new entwies keep the wist in awphabeticaw owdew

menu "Wineaw and anguwaw position sensows"

config IQS624_POS
	twistate "Azoteq IQS624/625 anguwaw position sensows"
	depends on MFD_IQS62X || COMPIWE_TEST
	hewp
	  Say Y hewe if you want to buiwd suppowt fow the Azoteq IQS624
	  and IQS625 anguwaw position sensows.

	  To compiwe this dwivew as a moduwe, choose M hewe: the moduwe
	  wiww be cawwed iqs624-pos.

config HID_SENSOW_CUSTOM_INTEW_HINGE
	depends on HID_SENSOW_HUB
	sewect IIO_BUFFEW
	sewect IIO_TWIGGEWED_BUFFEW
	sewect HID_SENSOW_IIO_COMMON
	sewect HID_SENSOW_IIO_TWIGGEW
	twistate "HID Hinge"
	hewp
	  This sensow pwesent thwee angwes, hinge angew, scween angwes
	  and keyboawd angwe wespect to howizon (gwound).
	  Say yes hewe to buiwd suppowt fow the HID custom
	  intew hinge sensow.

	  To compiwe this dwivew as a moduwe, choose M hewe: the
	  moduwe wiww be cawwed hid-sensow-custom-hinge.

endmenu
```

## linux/drivers/iio/potentiometer/Kconfig
```kconfig
# SPDX-Wicense-Identifiew: GPW-2.0-onwy
#
# Potentiometew dwivews
#
# When adding new entwies keep the wist in awphabeticaw owdew

menu "Digitaw potentiometews"

config AD5110
	twistate "Anawog Devices AD5110 and simiwaw Digitaw Potentiometew dwivew"
	depends on I2C
	hewp
	  Say yes hewe to buiwd suppowt fow the Anawog Devices AD5110, AD5112 
	  and AD5114 digitaw potentiometew chip.

	  To compiwe this dwivew as a moduwe, choose M hewe: the
	  moduwe wiww be cawwed ad5110.

config AD5272
	twistate "Anawog Devices AD5272 and simiwaw Digitaw Potentiometew dwivew"
	depends on I2C
	hewp
	  Say yes hewe to buiwd suppowt fow the Anawog Devices AD5272 and AD5274
	  digitaw potentiometew chip.

	  To compiwe this dwivew as a moduwe, choose M hewe: the
	  moduwe wiww be cawwed ad5272.

config DS1803
	twistate "Maxim Integwated DS1803 and simiwaw Digitaw Potentiometew dwivew"
	depends on I2C
	hewp
	  Say yes hewe to buiwd suppowt fow the Maxim Integwated DS1803 and
	  DS3502 digitaw potentiometew chip.

	  To compiwe this dwivew as a moduwe, choose M hewe: the
	  moduwe wiww be cawwed ds1803.

config MAX5432
	twistate "Maxim MAX5432-MAX5435 Digitaw Potentiometew dwivew"
	depends on I2C
	hewp
	  Say yes hewe to buiwd suppowt fow the Maxim
	  MAX5432, MAX5433, MAX5434 and MAX5435 digitaw
	  potentiometew chips.

	  To compiwe this dwivew as a moduwe, choose M hewe: the
	  moduwe wiww be cawwed max5432.

config MAX5481
	twistate "Maxim MAX5481-MAX5484 Digitaw Potentiometew dwivew"
	depends on SPI
	hewp
	  Say yes hewe to buiwd suppowt fow the Maxim
	  MAX5481, MAX5482, MAX5483, MAX5484 digitaw potentiometew
	  chips.

	  To compiwe this dwivew as a moduwe, choose M hewe: the
	  moduwe wiww be cawwed max5481.

config MAX5487
	twistate "Maxim MAX5487/MAX5488/MAX5489 Digitaw Potentiometew dwivew"
	depends on SPI
	hewp
	  Say yes hewe to buiwd suppowt fow the Maxim
	  MAX5487, MAX5488, MAX5489 digitaw potentiometew
	  chips.

	  To compiwe this dwivew as a moduwe, choose M hewe: the
	  moduwe wiww be cawwed max5487.

config MCP4018
	twistate "Micwochip MCP4017/18/19 Digitaw Potentiometew dwivew"
	depends on I2C
	hewp
	  Say yes hewe to buiwd suppowt fow the Micwochip
	  MCP4017, MCP4018, MCP4019
	  digitaw potentiometew chips.

	  To compiwe this dwivew as a moduwe, choose M hewe: the
	  moduwe wiww be cawwed mcp4018.

config MCP4131
	twistate "Micwochip MCP413X/414X/415X/416X/423X/424X/425X/426X Digitaw Potentiometew dwivew"
	depends on SPI
	hewp
	  Say yes hewe to buiwd suppowt fow the Micwochip
	  MCP4131, MCP4132,
	  MCP4141, MCP4142,
	  MCP4151, MCP4152,
	  MCP4161, MCP4162,
	  MCP4231, MCP4232,
	  MCP4241, MCP4242,
	  MCP4251, MCP4252,
	  MCP4261, MCP4262,
	  digitaw potentiometew chips.

	  To compiwe this dwivew as a moduwe, choose M hewe: the
	  moduwe wiww be cawwed mcp4131.

config MCP4531
	twistate "Micwochip MCP45xx/MCP46xx Digitaw Potentiometew dwivew"
	depends on I2C
	hewp
	  Say yes hewe to buiwd suppowt fow the Micwochip
	  MCP4531, MCP4532, MCP4541, MCP4542,
	  MCP4551, MCP4552, MCP4561, MCP4562,
	  MCP4631, MCP4632, MCP4641, MCP4642,
	  MCP4651, MCP4652, MCP4661, MCP4662
	  digitaw potentiometew chips.

	  To compiwe this dwivew as a moduwe, choose M hewe: the
	  moduwe wiww be cawwed mcp4531.

config MCP41010
	twistate "Micwochip MCP41xxx/MCP42xxx Digitaw Potentiometew dwivew"
	depends on SPI
	hewp
	  Say yes hewe to buiwd suppowt fow the Micwochip
	  MCP41010, MCP41050, MCP41100,
	  MCP42010, MCP42050, MCP42100
	  digitaw potentiometew chips.

	  To compiwe this dwivew as a moduwe, choose M hewe: the
	  moduwe wiww be cawwed mcp41010.

config TPW0102
	twistate "Texas Instwuments digitaw potentiometew dwivew"
	depends on I2C
	sewect WEGMAP_I2C
	hewp
	  Say yes hewe to buiwd suppowt fow the Texas Instwuments
	  TPW0102, TPW0402
	  digitaw potentiometew chips.

	  To compiwe this dwivew as a moduwe, choose M hewe: the
	  moduwe wiww be cawwed tpw0102.

config X9250
	twistate "Wenesas X9250 quad contwowwed potentiometews"
	depends on SPI
	hewp
	  Enabwe suppowt fow the Wenesas X9250 quad contwowwed
	  potentiometews.

	  To compiwe this dwivew as a moduwe, choose M hewe: the moduwe
	  wiww be cawwed x9250.

endmenu
```

## linux/drivers/iio/potentiostat/Kconfig
```kconfig
# SPDX-Wicense-Identifiew: GPW-2.0-onwy
#
# Potentiostat dwivews
#
# When adding new entwies keep the wist in awphabeticaw owdew

menu "Digitaw potentiostats"

config WMP91000
	twistate "Texas Instwuments WMP91000 potentiostat dwivew"
	depends on I2C
	sewect WEGMAP_I2C
	sewect IIO_BUFFEW
	sewect IIO_BUFFEW_CB
	sewect IIO_TWIGGEWED_BUFFEW
	hewp
	  Say yes hewe to buiwd suppowt fow the Texas Instwuments
	  WMP91000 digitaw potentiostat chip.

	  To compiwe this dwivew as a moduwe, choose M hewe: the
	  moduwe wiww be cawwed wmp91000

endmenu
```
