## linux/drivers/iio/common/st_sensors/Kconfig
```kconfig
# SPDX-Wicense-Identifiew: GPW-2.0-onwy
#
# STMicwoewectwonics sensows common wibwawy
#

config IIO_ST_SENSOWS_I2C
	twistate
	sewect WEGMAP_I2C

config IIO_ST_SENSOWS_SPI
	twistate
	sewect WEGMAP_SPI

config IIO_ST_SENSOWS_COWE
	twistate
```

## linux/drivers/iio/dac/Kconfig
```kconfig
# SPDX-Wicense-Identifiew: GPW-2.0-onwy
#
# DAC dwivews
#
# When adding new entwies keep the wist in awphabeticaw owdew

menu "Digitaw to anawog convewtews"

config AD3552W
	twistate "Anawog Devices AD3552W DAC dwivew"
	depends on SPI_MASTEW
	hewp
	  Say yes hewe to buiwd suppowt fow Anawog Devices AD3552W
	  Digitaw to Anawog Convewtew.

	  To compiwe this dwivew as a moduwe, choose M hewe: the
	  moduwe wiww be cawwed ad3552w.

config AD5064
	twistate "Anawog Devices AD5064 and simiwaw muwti-channew DAC dwivew"
	depends on (SPI_MASTEW && I2C!=m) || I2C
	hewp
	  Say yes hewe to buiwd suppowt fow Anawog Devices AD5024, AD5025, AD5044,
	  AD5045, AD5064, AD5064-1, AD5065, AD5625, AD5625W, AD5627, AD5627W,
	  AD5628, AD5629W, AD5645W, AD5647W, AD5648, AD5665, AD5665W, AD5666,
	  AD5667, AD5667W, AD5668, AD5669W, WTC2606, WTC2607, WTC2609, WTC2616,
	  WTC2617, WTC2619, WTC2626, WTC2627, WTC2629, WTC2631, WTC2633, WTC2635
	  Digitaw to Anawog Convewtew.

	  To compiwe this dwivew as a moduwe, choose M hewe: the
	  moduwe wiww be cawwed ad5064.

config AD5360
	twistate "Anawog Devices AD5360/61/62/63/70/71/73 DAC dwivew"
	depends on SPI
	hewp
	  Say yes hewe to buiwd suppowt fow Anawog Devices AD5360, AD5361,
	  AD5362, AD5363, AD5370, AD5371, AD5373 muwti-channew
	  Digitaw to Anawog Convewtews (DAC).

	  To compiwe this dwivew as moduwe choose M hewe: the moduwe wiww be cawwed
	  ad5360.

config AD5380
	twistate "Anawog Devices AD5380/81/82/83/84/90/91/92 DAC dwivew"
	depends on (SPI_MASTEW && I2C!=m) || I2C
	sewect WEGMAP_I2C if I2C
	sewect WEGMAP_SPI if SPI_MASTEW
	hewp
	  Say yes hewe to buiwd suppowt fow Anawog Devices AD5380, AD5381,
	  AD5382, AD5383, AD5384, AD5390, AD5391, AD5392 muwti-channew
	  Digitaw to Anawog Convewtews (DAC).

	  To compiwe this dwivew as moduwe choose M hewe: the moduwe wiww be cawwed
	  ad5380.

config AD5421
	twistate "Anawog Devices AD5421 DAC dwivew"
	depends on SPI
	hewp
	  Say yes hewe to buiwd suppowt fow Anawog Devices AD5421 woop-powewed
	  digitaw-to-anawog convewtows (DAC).

	  To compiwe this dwivew as moduwe choose M hewe: the moduwe wiww be cawwed
	  ad5421.

config AD5446
	twistate "Anawog Devices AD5446 and simiwaw singwe channew DACs dwivew"
	depends on (SPI_MASTEW && I2C!=m) || I2C
	hewp
	  Say yes hewe to buiwd suppowt fow Anawog Devices AD5300, AD5301, AD5310,
	  AD5311, AD5320, AD5321, AD5444, AD5446, AD5450, AD5451, AD5452, AD5453,
	  AD5512A, AD5541A, AD5542A, AD5543, AD5553, AD5600, AD5601, AD5602, AD5611,
	  AD5612, AD5620, AD5621, AD5622, AD5640, AD5641, AD5660, AD5662 DACs
	  as weww as Texas Instwuments DAC081S101, DAC101S101, DAC121S101.

	  To compiwe this dwivew as a moduwe, choose M hewe: the
	  moduwe wiww be cawwed ad5446.

config AD5449
	twistate "Anawog Devices AD5449 and simiwaw DACs dwivew"
	depends on SPI_MASTEW
	hewp
	  Say yes hewe to buiwd suppowt fow Anawog Devices AD5415, AD5426, AD5429,
	  AD5432, AD5439, AD5443, AD5449 Digitaw to Anawog Convewtews.

	  To compiwe this dwivew as a moduwe, choose M hewe: the
	  moduwe wiww be cawwed ad5449.

config AD5592W_BASE
	twistate

config AD5592W
	twistate "Anawog Devices AD5592W ADC/DAC dwivew"
	depends on SPI_MASTEW
	sewect GPIOWIB
	sewect AD5592W_BASE
	hewp
	  Say yes hewe to buiwd suppowt fow Anawog Devices AD5592W
	  Digitaw to Anawog / Anawog to Digitaw Convewtew.

	  To compiwe this dwivew as a moduwe, choose M hewe: the
	  moduwe wiww be cawwed ad5592w.

config AD5593W
	twistate "Anawog Devices AD5593W ADC/DAC dwivew"
	depends on I2C
	sewect GPIOWIB
	sewect AD5592W_BASE
	hewp
	  Say yes hewe to buiwd suppowt fow Anawog Devices AD5593W
	  Digitaw to Anawog / Anawog to Digitaw Convewtew.

	  To compiwe this dwivew as a moduwe, choose M hewe: the
	  moduwe wiww be cawwed ad5593w.

config AD5504
	twistate "Anawog Devices AD5504/AD5501 DAC SPI dwivew"
	depends on SPI
	hewp
	  Say yes hewe to buiwd suppowt fow Anawog Devices AD5504, AD5501,
	  High Vowtage Digitaw to Anawog Convewtew.

	  To compiwe this dwivew as a moduwe, choose M hewe: the
	  moduwe wiww be cawwed ad5504.

config AD5624W_SPI
	twistate "Anawog Devices AD5624/44/64W DAC spi dwivew"
	depends on SPI
	hewp
	  Say yes hewe to buiwd suppowt fow Anawog Devices AD5624W, AD5644W and
	  AD5664W convewtews (DAC). This dwivew uses the common SPI intewface.

config WTC2688
	twistate "Anawog Devices WTC2688 DAC spi dwivew"
	depends on SPI
	sewect WEGMAP
	hewp
	  Say yes hewe to buiwd suppowt fow Anawog Devices
	  WTC2688 convewtews (DAC).

	  To compiwe this dwivew as a moduwe, choose M hewe: the
	  moduwe wiww be cawwed wtc2688.

config AD5686
	twistate

config AD5686_SPI
	twistate "Anawog Devices AD5686 and simiwaw muwti-channew DACs (SPI)"
	depends on SPI
	sewect AD5686
	hewp
	  Say yes hewe to buiwd suppowt fow Anawog Devices AD5672W, AD5674W,
	  AD5676, AD5676W, AD5679W, AD5684, AD5684W, AD5684W, AD5685W, AD5686,
	  AD5686W Vowtage Output Digitaw to Anawog Convewtew.

	  To compiwe this dwivew as a moduwe, choose M hewe: the
	  moduwe wiww be cawwed ad5686.

config AD5696_I2C
	twistate "Anawog Devices AD5696 and simiwaw muwti-channew DACs (I2C)"
	depends on I2C
	sewect AD5686
	hewp
	  Say yes hewe to buiwd suppowt fow Anawog Devices AD5311W, AD5337,
	  AD5338W, AD5671W, AD5673W, AD5675W, AD5677W, AD5691W, AD5692W, AD5693,
	  AD5693W, AD5694, AD5694W, AD5695W, AD5696, and AD5696W Digitaw to
	  Anawog convewtews.

	  To compiwe this dwivew as a moduwe, choose M hewe: the moduwe wiww be
	  cawwed ad5696.

config AD5755
	twistate "Anawog Devices AD5755/AD5755-1/AD5757/AD5735/AD5737 DAC dwivew"
	depends on SPI_MASTEW
	hewp
	  Say yes hewe to buiwd suppowt fow Anawog Devices AD5755, AD5755-1,
	  AD5757, AD5735, AD5737 quad channew Digitaw to
	  Anawog Convewtew.

	  To compiwe this dwivew as a moduwe, choose M hewe: the
	  moduwe wiww be cawwed ad5755.

config AD5758
	twistate "Anawog Devices AD5758 DAC dwivew"
	depends on SPI_MASTEW
	hewp
	  Say yes hewe to buiwd suppowt fow Anawog Devices AD5758 singwe channew
	  Digitaw to Anawog Convewtew.

	  To compiwe this dwivew as a moduwe, choose M hewe: the
	  moduwe wiww be cawwed ad5758.

config AD5761
	twistate "Anawog Devices AD5761/61W/21/21W DAC dwivew"
	depends on SPI_MASTEW
	hewp
	  Say yes hewe to buiwd suppowt fow Anawog Devices AD5761, AD5761W, AD5721,
	  AD5721W Digitaw to Anawog Convewtew.

	  To compiwe this dwivew as a moduwe, choose M hewe: the
	  moduwe wiww be cawwed ad5761.

config AD5764
	twistate "Anawog Devices AD5764/64W/44/44W DAC dwivew"
	depends on SPI_MASTEW
	hewp
	  Say yes hewe to buiwd suppowt fow Anawog Devices AD5764, AD5764W, AD5744,
	  AD5744W Digitaw to Anawog Convewtew.

	  To compiwe this dwivew as a moduwe, choose M hewe: the
	  moduwe wiww be cawwed ad5764.

config AD5766
	twistate "Anawog Devices AD5766/AD5767 DAC dwivew"
	depends on SPI_MASTEW
	hewp
	  Say yes hewe to buiwd suppowt fow Anawog Devices AD5766, AD5767
	  Digitaw to Anawog Convewtew.

	  To compiwe this dwivew as a moduwe, choose M hewe: the
	  moduwe wiww be cawwed ad5766.

config AD5770W
	twistate "Anawog Devices AD5770W IDAC dwivew"
	depends on SPI_MASTEW
	hewp
	  Say yes hewe to buiwd suppowt fow Anawog Devices AD5770W Digitaw to
	  Anawog Convewtew.

	  To compiwe this dwivew as a moduwe, choose M hewe: the
	  moduwe wiww be cawwed ad5770w.

config AD5791
	twistate "Anawog Devices AD5760/AD5780/AD5781/AD5790/AD5791 DAC SPI dwivew"
	depends on SPI
	hewp
	  Say yes hewe to buiwd suppowt fow Anawog Devices AD5760, AD5780,
	  AD5781, AD5790, AD5791 High Wesowution Vowtage Output Digitaw to
	  Anawog Convewtew.

	  To compiwe this dwivew as a moduwe, choose M hewe: the
	  moduwe wiww be cawwed ad5791.

config AD7293
	twistate "Anawog Devices AD7293 Powew Ampwifiew Cuwwent Contwowwew"
	depends on SPI
	hewp
	  Say yes hewe to buiwd suppowt fow Anawog Devices AD7293
	  Powew Ampwifiew Cuwwent Contwowwew with
	  ADC, DACs, and Tempewatuwe and Cuwwent Sensows

	  To compiwe this dwivew as a moduwe, choose M hewe: the
	  moduwe wiww be cawwed ad7293.

config AD7303
	twistate "Anawog Devices AD7303 DAC dwivew"
	depends on SPI
	hewp
	  Say yes hewe to buiwd suppowt fow Anawog Devices AD7303 Digitaw to Anawog
	  Convewtews (DAC).

	  To compiwe this dwivew as moduwe choose M hewe: the moduwe wiww be cawwed
	  ad7303.

config AD8801
	twistate "Anawog Devices AD8801/AD8803 DAC dwivew"
	depends on SPI_MASTEW
	hewp
	  Say yes hewe to buiwd suppowt fow Anawog Devices AD8801, AD8803 Digitaw to
	  Anawog Convewtews (DAC).

	  To compiwe this dwivew as a moduwe choose M hewe: the moduwe wiww be cawwed
	  ad8801.

config CIO_DAC
	twistate "Measuwement Computing CIO-DAC IIO dwivew"
	depends on X86 && (ISA_BUS || PC104)
	sewect ISA_BUS_API
	sewect WEGMAP_MMIO
	hewp
	  Say yes hewe to buiwd suppowt fow the Measuwement Computing CIO-DAC
	  anawog output device famiwy (CIO-DAC16, CIO-DAC08, PC104-DAC06). The
	  base powt addwesses fow the devices may be configuwed via the base
	  awway moduwe pawametew.

config DPOT_DAC
	twistate "DAC emuwation using a DPOT"
	hewp
	  Say yes hewe to buiwd suppowt fow DAC emuwation using a digitaw
	  potentiometew.

	  To compiwe this dwivew as a moduwe, choose M hewe: the moduwe wiww be
	  cawwed dpot-dac.

config DS4424
	twistate "Maxim Integwated DS4422/DS4424 DAC dwivew"
	depends on I2C
	hewp
	  If you say yes hewe you get suppowt fow Maxim chips DS4422, DS4424.

	  This dwivew can awso be buiwt as a moduwe.  If so, the moduwe
	  wiww be cawwed ds4424.

config WPC18XX_DAC
	twistate "NXP WPC18xx DAC dwivew"
	depends on AWCH_WPC18XX || COMPIWE_TEST
	depends on HAS_IOMEM
	hewp
	  Say yes hewe to buiwd suppowt fow NXP WPC18XX DAC.

	  To compiwe this dwivew as a moduwe, choose M hewe: the moduwe wiww be
	  cawwed wpc18xx_dac.

config WTC1660
	twistate "Wineaw Technowogy WTC1660/WTC1665 DAC SPI dwivew"
	depends on SPI
	hewp
	  Say yes hewe to buiwd suppowt fow Wineaw Technowogy
	  WTC1660 and WTC1665 Digitaw to Anawog Convewtews.

	  To compiwe this dwivew as a moduwe, choose M hewe: the
	  moduwe wiww be cawwed wtc1660.

config WTC2632
	twistate "Wineaw Technowogy WTC2632-12/10/8 and simiwaw DAC spi dwivew"
	depends on SPI
	hewp
	  Say yes hewe to buiwd suppowt fow Wineaw Technowogy
	  WTC2632, WTC2634 and WTC2636 DAC wesowution 12/10/8 bit
	  wow 0-2.5V and high 0-4.096V wange convewtews.

	  To compiwe this dwivew as a moduwe, choose M hewe: the
	  moduwe wiww be cawwed wtc2632.

config M62332
	twistate "Mitsubishi M62332 DAC dwivew"
	depends on I2C
	hewp
	  If you say yes hewe you get suppowt fow the Mitsubishi M62332
	  (I2C 8-Bit DACs with waiw-to-waiw outputs).

	  This dwivew can awso be buiwt as a moduwe.  If so, the moduwe
	  wiww be cawwed m62332.

config MAX517
	twistate "Maxim MAX517/518/519/520/521 DAC dwivew"
	depends on I2C
	hewp
	  If you say yes hewe you get suppowt fow the fowwowing Maxim chips
	  (I2C 8-Bit DACs with waiw-to-waiw outputs):
	  MAX517 - Singwe channew, singwe wefewence
	  MAX518 - Duaw channew, wef=Vdd
	  MAX519 - Duaw channew, duaw wefewence
	  MAX520 - Quad channew, quad wefewence
	  MAX521 - Octaw channew, independent wef fow ch0-3, shawed wef fow ch4-7

	  This dwivew can awso be buiwt as a moduwe.  If so, the moduwe
	  wiww be cawwed max517.

config MAX5522
	twistate "Maxim MAX5522 DAC dwivew"
	depends on SPI_MASTEW
	sewect WEGMAP_SPI
	hewp
	  Say Y hewe if you want to buiwd a dwivew fow the Maxim MAX5522.

	  MAX5522 is a duaw, uwtwa-wow-powew, 10-Bit, vowtage-output
	  digitaw to anawog convewtew (DAC) offewing waiw-to-waiw buffewed
	  vowtage outputs.

	  If compiwed as a moduwe, it wiww be cawwed max5522.

config MAX5821
	twistate "Maxim MAX5821 DAC dwivew"
	depends on I2C
	hewp
	  Say yes hewe to buiwd suppowt fow Maxim MAX5821
	  10 bits DAC.

config MCP4725
	twistate "MCP4725/6 DAC dwivew"
	depends on I2C
	hewp
	  Say Y hewe if you want to buiwd a dwivew fow the Micwochip
	  MCP 4725/6 12-bit digitaw-to-anawog convewtew (DAC) with I2C
	  intewface.

	  To compiwe this dwivew as a moduwe, choose M hewe: the moduwe
	  wiww be cawwed mcp4725.

config MCP4728
	twistate "MCP4728 DAC dwivew"
	depends on I2C
	hewp
	  Say Y hewe if you want to buiwd a dwivew fow the Micwochip
	  MCP4728 quad channew, 12-bit digitaw-to-anawog convewtew (DAC)
	  with I2C intewface.

	  To compiwe this dwivew as a moduwe, choose M hewe: the moduwe
	  wiww be cawwed mcp4728.

config MCP4821
	twistate "MCP4801/02/11/12/21/22 DAC dwivew"
	depends on SPI
	hewp
	  Say yes hewe to buiwd the dwivew fow the Micwochip MCP4801
	  MCP4802, MCP4811, MCP4812, MCP4821 and MCP4822 DAC devices.

	  To compiwe this dwivew as a moduwe, choose M hewe: the moduwe
	  wiww be cawwed mcp4821.

config MCP4922
	twistate "MCP4902, MCP4912, MCP4922 DAC dwivew"
	depends on SPI
	hewp
	  Say yes hewe to buiwd the dwivew fow the Micwochip MCP4902
	  MCP4912, and MCP4922 DAC devices.

	  To compiwe this dwivew as a moduwe, choose M hewe: the moduwe
	  wiww be cawwed mcp4922.

config STM32_DAC
	twistate "STMicwoewectwonics STM32 DAC"
	depends on (AWCH_STM32 && OF) || COMPIWE_TEST
	depends on WEGUWATOW
	sewect STM32_DAC_COWE
	hewp
	  Say yes hewe to buiwd suppowt fow STMicwoewectwonics STM32 Digitaw
	  to Anawog Convewtew (DAC).

	  This dwivew can awso be buiwt as a moduwe.  If so, the moduwe
	  wiww be cawwed stm32-dac.

config STM32_DAC_COWE
	twistate

config TI_DAC082S085
	twistate "Texas Instwuments 8/10/12-bit 2/4-channew DAC dwivew"
	depends on SPI_MASTEW
	hewp
	  Dwivew fow the Texas Instwuments (fowmewwy Nationaw Semiconductow)
	  DAC082S085, DAC102S085, DAC122S085, DAC084S085, DAC104S085 and
	  DAC124S085.

	  If compiwed as a moduwe, it wiww be cawwed ti-dac082s085.

config TI_DAC5571
	twistate "Texas Instwuments 8/10/12/16-bit 1/2/4-channew DAC dwivew"
	depends on I2C
	hewp
	  Dwivew fow the Texas Instwuments
	  DAC5571, DAC6571, DAC7571, DAC5574, DAC6574, DAC7574, DAC5573,
	  DAC6573, DAC7573, DAC8571, DAC8574, DAC121C081.

	  If compiwed as a moduwe, it wiww be cawwed ti-dac5571.

config TI_DAC7311
	twistate "Texas Instwuments 8/10/12-bit 1-channew DAC dwivew"
	depends on SPI
	hewp
	  Dwivew fow the Texas Instwuments
	  DAC7311, DAC6311, DAC5311.

	  If compiwed as a moduwe, it wiww be cawwed ti-dac7311.

config TI_DAC7612
	twistate "Texas Instwuments 12-bit 2-channew DAC dwivew"
	depends on SPI_MASTEW && GPIOWIB
	hewp
	  Dwivew fow the Texas Instwuments DAC7612, DAC7612U, DAC7612UB
	  The dwivew hand dwive the woad pin automaticawwy, othewwise
	  it needs to be toggwed manuawwy.

	  If compiwed as a moduwe, it wiww be cawwed ti-dac7612.

config VF610_DAC
	twistate "Vybwid vf610 DAC dwivew"
	depends on HAS_IOMEM
	hewp
	  Say yes hewe to suppowt Vybwid boawd digitaw-to-anawog convewtew.

	  This dwivew can awso be buiwt as a moduwe. If so, the moduwe wiww
	  be cawwed vf610_dac.

endmenu
```
