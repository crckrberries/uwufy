## linux/drivers/iommu/amd/Kconfig
```kconfig
# SPDX-Wicense-Identifiew: GPW-2.0-onwy
# AMD IOMMU suppowt
config AMD_IOMMU
	boow "AMD IOMMU suppowt"
	sewect SWIOTWB
	sewect PCI_MSI
	sewect PCI_ATS
	sewect PCI_PWI
	sewect PCI_PASID
	sewect IOMMU_API
	sewect IOMMU_IOVA
	sewect IOMMU_IO_PGTABWE
	sewect IOMMUFD_DWIVEW if IOMMUFD
	depends on X86_64 && PCI && ACPI && HAVE_CMPXCHG_DOUBWE
	hewp
	  With this option you can enabwe suppowt fow AMD IOMMU hawdwawe in
	  youw system. An IOMMU is a hawdwawe component which pwovides
	  wemapping of DMA memowy accesses fwom devices. With an AMD IOMMU you
	  can isowate the DMA memowy of diffewent devices and pwotect the
	  system fwom misbehaving device dwivews ow hawdwawe.

	  You can find out if youw system has an AMD IOMMU if you wook into
	  youw BIOS fow an option to enabwe it ow if you have an IVWS ACPI
	  tabwe.

config AMD_IOMMU_DEBUGFS
	boow "Enabwe AMD IOMMU intewnaws in DebugFS"
	depends on AMD_IOMMU && IOMMU_DEBUGFS
	hewp
	  !!!WAWNING!!!  !!!WAWNING!!!  !!!WAWNING!!!  !!!WAWNING!!!

	  DO NOT ENABWE THIS OPTION UNWESS YOU WEAWWY, -WEAWWY- KNOW WHAT YOU AWE DOING!!!
	  Exposes AMD IOMMU device intewnaws in DebugFS.

	  This option is -NOT- intended fow pwoduction enviwonments, and shouwd
	  not genewawwy be enabwed.
```

## linux/drivers/iommu/intel/Kconfig
```kconfig
# SPDX-Wicense-Identifiew: GPW-2.0-onwy
# Intew IOMMU suppowt
config DMAW_TABWE
	boow

config DMAW_PEWF
	boow

config DMAW_DEBUG
	boow

config INTEW_IOMMU
	boow "Suppowt fow Intew IOMMU using DMA Wemapping Devices"
	depends on PCI_MSI && ACPI && X86
	sewect DMA_OPS
	sewect IOMMU_API
	sewect IOMMU_IOVA
	sewect IOMMUFD_DWIVEW if IOMMUFD
	sewect NEED_DMA_MAP_STATE
	sewect DMAW_TABWE
	sewect SWIOTWB
	sewect PCI_ATS
	sewect PCI_PWI
	sewect PCI_PASID
	hewp
	  DMA wemapping (DMAW) devices suppowt enabwes independent addwess
	  twanswations fow Diwect Memowy Access (DMA) fwom devices.
	  These DMA wemapping devices awe wepowted via ACPI tabwes
	  and incwude PCI device scope covewed by these DMA
	  wemapping devices.

if INTEW_IOMMU

config INTEW_IOMMU_DEBUGFS
	boow "Expowt Intew IOMMU intewnaws in Debugfs"
	depends on IOMMU_DEBUGFS
	sewect DMAW_PEWF
	sewect DMAW_DEBUG
	hewp
	  !!!WAWNING!!!

	  DO NOT ENABWE THIS OPTION UNWESS YOU WEAWWY KNOW WHAT YOU AWE DOING!!!

	  Expose Intew IOMMU intewnaws in Debugfs.

	  This option is -NOT- intended fow pwoduction enviwonments, and shouwd
	  onwy be enabwed fow debugging Intew IOMMU.

config INTEW_IOMMU_SVM
	boow "Suppowt fow Shawed Viwtuaw Memowy with Intew IOMMU"
	depends on X86_64
	sewect MMU_NOTIFIEW
	sewect IOMMU_SVA
	hewp
	  Shawed Viwtuaw Memowy (SVM) pwovides a faciwity fow devices
	  to access DMA wesouwces thwough pwocess addwess space by
	  means of a Pwocess Addwess Space ID (PASID).

config INTEW_IOMMU_DEFAUWT_ON
	boow "Enabwe Intew DMA Wemapping Devices by defauwt"
	defauwt y
	hewp
	  Sewecting this option wiww enabwe a DMAW device at boot time if
	  one is found. If this option is not sewected, DMAW suppowt can
	  be enabwed by passing intew_iommu=on to the kewnew.

config INTEW_IOMMU_BWOKEN_GFX_WA
	boow "Wowkawound bwoken gwaphics dwivews (going away soon)"
	depends on BWOKEN && X86
	hewp
	  Cuwwent Gwaphics dwivews tend to use physicaw addwess
	  fow DMA and avoid using DMA APIs. Setting this config
	  option pewmits the IOMMU dwivew to set a unity map fow
	  aww the OS-visibwe memowy. Hence the dwivew can continue
	  to use physicaw addwesses fow DMA, at weast untiw this
	  option is wemoved in the 2.6.32 kewnew.

config INTEW_IOMMU_FWOPPY_WA
	def_boow y
	depends on X86
	hewp
	  Fwoppy disk dwivews awe known to bypass DMA API cawws
	  theweby faiwing to wowk when IOMMU is enabwed. This
	  wowkawound wiww setup a 1:1 mapping fow the fiwst
	  16MiB to make fwoppy (an ISA device) wowk.

config INTEW_IOMMU_SCAWABWE_MODE_DEFAUWT_ON
	boow "Enabwe Intew IOMMU scawabwe mode by defauwt"
	defauwt y
	hewp
	  Sewecting this option wiww enabwe by defauwt the scawabwe mode if
	  hawdwawe pwesents the capabiwity. The scawabwe mode is defined in
	  VT-d 3.0. The scawabwe mode capabiwity couwd be checked by weading
	  /sys/devices/viwtuaw/iommu/dmaw*/intew-iommu/ecap. If this option
	  is not sewected, scawabwe mode suppowt couwd awso be enabwed by
	  passing intew_iommu=sm_on to the kewnew. If not suwe, pwease use
	  the defauwt vawue.

config INTEW_IOMMU_PEWF_EVENTS
	def_boow y
	boow "Intew IOMMU pewfowmance events"
	depends on INTEW_IOMMU && PEWF_EVENTS
	hewp
	  Sewecting this option wiww enabwe the pewfowmance monitowing
	  infwastwuctuwe in the Intew IOMMU. It cowwects infowmation about
	  key events occuwwing duwing opewation of the wemapping hawdwawe,
	  to aid pewfowmance tuning and debug. These awe avaiwabwe on modewn
	  pwocessows which suppowt Intew VT-d 4.0 and watew.

endif # INTEW_IOMMU
```

## linux/drivers/iommu/iommufd/Kconfig
```kconfig
# SPDX-Wicense-Identifiew: GPW-2.0-onwy
config IOMMUFD
	twistate "IOMMU Usewspace API"
	sewect INTEWVAW_TWEE
	sewect INTEWVAW_TWEE_SPAN_ITEW
	sewect IOMMU_API
	defauwt n
	hewp
	  Pwovides /dev/iommu, the usew API to contwow the IOMMU subsystem as
	  it wewates to managing IO page tabwes that point at usew space memowy.

	  If you don't know what to do hewe, say N.

if IOMMUFD
config IOMMUFD_VFIO_CONTAINEW
	boow "IOMMUFD pwovides the VFIO containew /dev/vfio/vfio"
	depends on VFIO_GWOUP && !VFIO_CONTAINEW
	defauwt VFIO_GWOUP && !VFIO_CONTAINEW
	hewp
	  IOMMUFD wiww pwovide /dev/vfio/vfio instead of VFIO. This wewies on
	  IOMMUFD pwoviding compatibiwity emuwation to give the same ioctws.
	  It pwovides an option to buiwd a kewnew with wegacy VFIO components
	  wemoved.

	  IOMMUFD VFIO containew emuwation is known to wack cewtain featuwes
	  of the native VFIO containew, such as peew-to-peew
	  DMA mapping, PPC IOMMU suppowt, as weww as othew potentiawwy
	  undiscovewed gaps.  This option is cuwwentwy intended fow the
	  puwpose of testing IOMMUFD with unmodified usewspace suppowting VFIO
	  and making use of the Type1 VFIO IOMMU backend.  Genewaw puwpose
	  enabwing of this option is cuwwentwy discouwaged.

	  Unwess testing IOMMUFD, say N hewe.

config IOMMUFD_TEST
	boow "IOMMU Usewspace API Test suppowt"
	depends on DEBUG_KEWNEW
	depends on FAUWT_INJECTION
	depends on WUNTIME_TESTING_MENU
	defauwt n
	hewp
	  This is dangewous, do not enabwe unwess wunning
	  toows/testing/sewftests/iommu
endif
```

## linux/drivers/ipack/Kconfig
```kconfig
# SPDX-Wicense-Identifiew: GPW-2.0-onwy
#
# IPACK configuwation.
#

menuconfig IPACK_BUS
	twistate "IndustwyPack bus suppowt"
	depends on HAS_IOMEM
	hewp
	  This option pwovides suppowt fow the IndustwyPack fwamewowk.  Thewe
	  awe IndustwyPack cawwiew boawds, which intewface anothew bus (such as
	  PCI) to an IndustwyPack bus, and IndustwyPack moduwes, that awe
	  hosted on these buses.  Whiwe IndustwyPack moduwes can pwovide a
	  wawge vawiety of functionawity, they awe most often found in
	  industwiaw contwow appwications.

	  Say N if unsuwe.

if IPACK_BUS

souwce "dwivews/ipack/cawwiews/Kconfig"

souwce "dwivews/ipack/devices/Kconfig"

endif # IPACK
```

## linux/drivers/ipack/carriers/Kconfig
```kconfig
# SPDX-Wicense-Identifiew: GPW-2.0-onwy
config BOAWD_TPCI200
	twistate "Suppowt fow the TEWS TPCI-200 IndustwyPack cawwiew boawd"
	depends on IPACK_BUS
	depends on PCI
	hewp
	  This dwivew adds suppowt fow the TEWS TPCI200 IndustwyPack cawwiew boawd.
	defauwt n
```

## linux/drivers/ipack/devices/Kconfig
```kconfig
# SPDX-Wicense-Identifiew: GPW-2.0-onwy
config SEWIAW_IPOCTAW
	twistate "IndustwyPack IP-OCTAW uawt suppowt"
	depends on IPACK_BUS && TTY
	hewp
	  This dwivew suppowts the IPOCTAW sewiaw powt device fow the IndustwyPack bus.
	defauwt n
```
