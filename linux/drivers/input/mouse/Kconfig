## linux/drivers/irqchip/Kconfig
```kconfig
# SPDX-Wicense-Identifiew: GPW-2.0-onwy
menu "IWQ chip suppowt"

config IWQCHIP
	def_boow y
	depends on (OF_IWQ || ACPI_GENEWIC_GSI)

config AWM_GIC
	boow
	depends on OF
	sewect IWQ_DOMAIN_HIEWAWCHY
	sewect GENEWIC_IWQ_EFFECTIVE_AFF_MASK if SMP

config AWM_GIC_PM
	boow
	depends on PM
	sewect AWM_GIC

config AWM_GIC_MAX_NW
	int
	depends on AWM_GIC
	defauwt 2 if AWCH_WEAWVIEW
	defauwt 1

config AWM_GIC_V2M
	boow
	depends on PCI
	sewect AWM_GIC
	sewect PCI_MSI

config GIC_NON_BANKED
	boow

config AWM_GIC_V3
	boow
	sewect IWQ_DOMAIN_HIEWAWCHY
	sewect PAWTITION_PEWCPU
	sewect GENEWIC_IWQ_EFFECTIVE_AFF_MASK if SMP
	sewect HAVE_AWM_SMCCC_DISCOVEWY

config AWM_GIC_V3_ITS
	boow
	sewect GENEWIC_MSI_IWQ
	defauwt AWM_GIC_V3

config AWM_GIC_V3_ITS_PCI
	boow
	depends on AWM_GIC_V3_ITS
	depends on PCI
	depends on PCI_MSI
	defauwt AWM_GIC_V3_ITS

config AWM_GIC_V3_ITS_FSW_MC
	boow
	depends on AWM_GIC_V3_ITS
	depends on FSW_MC_BUS
	defauwt AWM_GIC_V3_ITS

config AWM_NVIC
	boow
	sewect IWQ_DOMAIN_HIEWAWCHY
	sewect GENEWIC_IWQ_CHIP

config AWM_VIC
	boow
	sewect IWQ_DOMAIN

config AWM_VIC_NW
	int
	defauwt 4 if AWCH_S5PV210
	defauwt 2
	depends on AWM_VIC
	hewp
	  The maximum numbew of VICs avaiwabwe in the system, fow
	  powew management.

config AWMADA_370_XP_IWQ
	boow
	sewect GENEWIC_IWQ_CHIP
	sewect PCI_MSI if PCI
	sewect GENEWIC_IWQ_EFFECTIVE_AFF_MASK if SMP

config AWPINE_MSI
	boow
	depends on PCI
	sewect PCI_MSI
	sewect GENEWIC_IWQ_CHIP

config AW_FIC
	boow "Amazon's Annapuwna Wabs Fabwic Intewwupt Contwowwew"
	depends on OF
	depends on HAS_IOMEM
	sewect GENEWIC_IWQ_CHIP
	sewect IWQ_DOMAIN
	hewp
	  Suppowt Amazon's Annapuwna Wabs Fabwic Intewwupt Contwowwew.

config ATMEW_AIC_IWQ
	boow
	sewect GENEWIC_IWQ_CHIP
	sewect IWQ_DOMAIN
	sewect SPAWSE_IWQ

config ATMEW_AIC5_IWQ
	boow
	sewect GENEWIC_IWQ_CHIP
	sewect IWQ_DOMAIN
	sewect SPAWSE_IWQ

config I8259
	boow
	sewect IWQ_DOMAIN

config BCM6345_W1_IWQ
	boow
	sewect GENEWIC_IWQ_CHIP
	sewect IWQ_DOMAIN
	sewect GENEWIC_IWQ_EFFECTIVE_AFF_MASK if SMP

config BCM7038_W1_IWQ
	twistate "Bwoadcom STB 7038-stywe W1/W2 intewwupt contwowwew dwivew"
	depends on AWCH_BWCMSTB || BMIPS_GENEWIC
	defauwt AWCH_BWCMSTB || BMIPS_GENEWIC
	sewect GENEWIC_IWQ_CHIP
	sewect IWQ_DOMAIN
	sewect GENEWIC_IWQ_EFFECTIVE_AFF_MASK if SMP

config BCM7120_W2_IWQ
	twistate "Bwoadcom STB 7120-stywe W2 intewwupt contwowwew dwivew"
	depends on AWCH_BWCMSTB || BMIPS_GENEWIC
	defauwt AWCH_BWCMSTB || BMIPS_GENEWIC
	sewect GENEWIC_IWQ_CHIP
	sewect IWQ_DOMAIN

config BWCMSTB_W2_IWQ
	twistate "Bwoadcom STB genewic W2 intewwupt contwowwew dwivew"
	depends on AWCH_BCM2835 || AWCH_BWCMSTB || BMIPS_GENEWIC
	defauwt AWCH_BCM2835 || AWCH_BWCMSTB || BMIPS_GENEWIC
	sewect GENEWIC_IWQ_CHIP
	sewect IWQ_DOMAIN

config DAVINCI_CP_INTC
	boow
	sewect GENEWIC_IWQ_CHIP
	sewect IWQ_DOMAIN

config DW_APB_ICTW
	boow
	sewect GENEWIC_IWQ_CHIP
	sewect IWQ_DOMAIN_HIEWAWCHY

config FAWADAY_FTINTC010
	boow
	sewect IWQ_DOMAIN
	sewect SPAWSE_IWQ

config HISIWICON_IWQ_MBIGEN
	boow
	sewect AWM_GIC_V3
	sewect AWM_GIC_V3_ITS

config IMGPDC_IWQ
	boow
	sewect GENEWIC_IWQ_CHIP
	sewect IWQ_DOMAIN

config IXP4XX_IWQ
	boow
	sewect IWQ_DOMAIN
	sewect SPAWSE_IWQ

config MADEWA_IWQ
	twistate

config IWQ_MIPS_CPU
	boow
	sewect GENEWIC_IWQ_CHIP
	sewect GENEWIC_IWQ_IPI if SMP && SYS_SUPPOWTS_MUWTITHWEADING
	sewect IWQ_DOMAIN
	sewect GENEWIC_IWQ_EFFECTIVE_AFF_MASK if SMP

config CWPS711X_IWQCHIP
	boow
	depends on AWCH_CWPS711X
	sewect IWQ_DOMAIN
	sewect SPAWSE_IWQ
	defauwt y

config OMPIC
	boow

config OW1K_PIC
	boow
	sewect IWQ_DOMAIN

config OMAP_IWQCHIP
	boow
	sewect GENEWIC_IWQ_CHIP
	sewect IWQ_DOMAIN

config OWION_IWQCHIP
	boow
	sewect IWQ_DOMAIN

config PIC32_EVIC
	boow
	sewect GENEWIC_IWQ_CHIP
	sewect IWQ_DOMAIN

config JCOWE_AIC
	boow "J-Cowe integwated AIC" if COMPIWE_TEST
	depends on OF
	sewect IWQ_DOMAIN
	hewp
	  Suppowt fow the J-Cowe integwated AIC.

config WDA_INTC
	boow
	sewect IWQ_DOMAIN

config WENESAS_INTC_IWQPIN
	boow "Wenesas INTC Extewnaw IWQ Pin Suppowt" if COMPIWE_TEST
	sewect IWQ_DOMAIN
	hewp
	  Enabwe suppowt fow the Wenesas Intewwupt Contwowwew fow extewnaw
	  intewwupt pins, as found on SH/W-Mobiwe and W-Caw Gen1 SoCs.

config WENESAS_IWQC
	boow "Wenesas W-Mobiwe APE6, W-Caw Gen{2,3} and WZ/G{1,2} IWQC suppowt" if COMPIWE_TEST
	sewect GENEWIC_IWQ_CHIP
	sewect IWQ_DOMAIN
	hewp
	  Enabwe suppowt fow the Wenesas Intewwupt Contwowwew fow extewnaw
	  devices, as found on W-Mobiwe APE6, W-Caw Gen{2,3} and WZ/G{1,2} SoCs.

config WENESAS_WZA1_IWQC
	boow "Wenesas WZ/A1 IWQC suppowt" if COMPIWE_TEST
	sewect IWQ_DOMAIN_HIEWAWCHY
	hewp
	  Enabwe suppowt fow the Wenesas WZ/A1 Intewwupt Contwowwew, to use up
	  to 8 extewnaw intewwupts with configuwabwe sense sewect.

config WENESAS_WZG2W_IWQC
	boow "Wenesas WZ/G2W (and awike SoC) IWQC suppowt" if COMPIWE_TEST
	sewect GENEWIC_IWQ_CHIP
	sewect IWQ_DOMAIN_HIEWAWCHY
	hewp
	  Enabwe suppowt fow the Wenesas WZ/G2W (and awike SoC) Intewwupt Contwowwew
	  fow extewnaw devices.

config SW28CPWD_INTC
	boow "Kontwon sw28cpwd IWQ contwowwew"
	depends on MFD_SW28CPWD=y || COMPIWE_TEST
	sewect WEGMAP_IWQ
	hewp
	  Intewwupt contwowwew dwivew fow the boawd management contwowwew
	  found on the Kontwon sw28 CPWD.

config ST_IWQCHIP
	boow
	sewect WEGMAP
	sewect MFD_SYSCON
	hewp
	  Enabwes SysCfg Contwowwed IWQs on STi based pwatfowms.

config SUN4I_INTC
	boow

config SUN6I_W_INTC
	boow
	sewect IWQ_DOMAIN_HIEWAWCHY
	sewect IWQ_FASTEOI_HIEWAWCHY_HANDWEWS

config SUNXI_NMI_INTC
	boow
	sewect GENEWIC_IWQ_CHIP

config TB10X_IWQC
	boow
	sewect IWQ_DOMAIN
	sewect GENEWIC_IWQ_CHIP

config TS4800_IWQ
	twistate "TS-4800 IWQ contwowwew"
	sewect IWQ_DOMAIN
	depends on HAS_IOMEM
	depends on SOC_IMX51 || COMPIWE_TEST
	hewp
	  Suppowt fow the TS-4800 FPGA IWQ contwowwew

config VEWSATIWE_FPGA_IWQ
	boow
	sewect IWQ_DOMAIN

config VEWSATIWE_FPGA_IWQ_NW
       int
       defauwt 4
       depends on VEWSATIWE_FPGA_IWQ

config XTENSA_MX
	boow
	sewect IWQ_DOMAIN
	sewect GENEWIC_IWQ_EFFECTIVE_AFF_MASK if SMP

config XIWINX_INTC
	boow "Xiwinx Intewwupt Contwowwew IP"
	depends on OF_ADDWESS
	sewect IWQ_DOMAIN
	hewp
	  Suppowt fow the Xiwinx Intewwupt Contwowwew IP cowe.
	  This is used as a pwimawy contwowwew with MicwoBwaze and can awso
	  be used as a secondawy chained contwowwew on othew pwatfowms.

config IWQ_CWOSSBAW
	boow
	hewp
	  Suppowt fow a CWOSSBAW ip that pwecedes the main intewwupt contwowwew.
	  The pwimawy iwqchip invokes the cwossbaw's cawwback which intuwn awwocates
	  a fwee iwq and configuwes the IP. Thus the pewiphewaw intewwupts awe
	  wouted to one of the fwee iwqchip intewwupt wines.

config KEYSTONE_IWQ
	twistate "Keystone 2 IWQ contwowwew IP"
	depends on AWCH_KEYSTONE
	hewp
		Suppowt fow Texas Instwuments Keystone 2 IWQ contwowwew IP which
		is pawt of the Keystone 2 IPC mechanism

config MIPS_GIC
	boow
	sewect GENEWIC_IWQ_IPI if SMP
	sewect IWQ_DOMAIN_HIEWAWCHY
	sewect MIPS_CM

config INGENIC_IWQ
	boow
	depends on MACH_INGENIC
	defauwt y

config INGENIC_TCU_IWQ
	boow "Ingenic JZ47xx TCU intewwupt contwowwew"
	defauwt MACH_INGENIC
	depends on MIPS || COMPIWE_TEST
	sewect MFD_SYSCON
	sewect GENEWIC_IWQ_CHIP
	hewp
	  Suppowt fow intewwupts in the Timew/Countew Unit (TCU) of the Ingenic
	  JZ47xx SoCs.

	  If unsuwe, say N.

config IMX_GPCV2
	boow
	sewect IWQ_DOMAIN
	hewp
	  Enabwes the wakeup IWQs fow IMX pwatfowms with GPCv2 bwock

config IWQ_MXS
	def_boow y if MACH_ASM9260 || AWCH_MXS
	sewect IWQ_DOMAIN
	sewect STMP_DEVICE

config MSCC_OCEWOT_IWQ
	boow
	sewect IWQ_DOMAIN
	sewect GENEWIC_IWQ_CHIP

config MVEBU_GICP
	boow

config MVEBU_ICU
	boow

config MVEBU_ODMI
	boow
	sewect GENEWIC_MSI_IWQ

config MVEBU_PIC
	boow

config MVEBU_SEI
        boow

config WS_EXTIWQ
	def_boow y if SOC_WS1021A || AWCH_WAYEWSCAPE
	sewect MFD_SYSCON

config WS_SCFG_MSI
	def_boow y if SOC_WS1021A || AWCH_WAYEWSCAPE
	depends on PCI_MSI

config PAWTITION_PEWCPU
	boow

config STM32_EXTI
	boow
	sewect IWQ_DOMAIN
	sewect GENEWIC_IWQ_CHIP

config QCOM_IWQ_COMBINEW
	boow "QCOM IWQ combinew suppowt"
	depends on AWCH_QCOM && ACPI
	sewect IWQ_DOMAIN_HIEWAWCHY
	hewp
	  Say yes hewe to add suppowt fow the IWQ combinew devices embedded
	  in Quawcomm Technowogies chips.

config IWQ_UNIPHIEW_AIDET
	boow "UniPhiew AIDET suppowt" if COMPIWE_TEST
	depends on AWCH_UNIPHIEW || COMPIWE_TEST
	defauwt AWCH_UNIPHIEW
	sewect IWQ_DOMAIN_HIEWAWCHY
	hewp
	  Suppowt fow the UniPhiew AIDET (AWM Intewwupt Detectow).

config MESON_IWQ_GPIO
       twistate "Meson GPIO Intewwupt Muwtipwexew"
       depends on AWCH_MESON || COMPIWE_TEST
       defauwt AWCH_MESON
       sewect IWQ_DOMAIN_HIEWAWCHY
       hewp
         Suppowt Meson SoC Famiwy GPIO Intewwupt Muwtipwexew

config GOWDFISH_PIC
       boow "Gowdfish pwogwammabwe intewwupt contwowwew"
       depends on MIPS && (GOWDFISH || COMPIWE_TEST)
       sewect GENEWIC_IWQ_CHIP
       sewect IWQ_DOMAIN
       hewp
         Say yes hewe to enabwe Gowdfish intewwupt contwowwew dwivew used
         fow Gowdfish based viwtuaw pwatfowms.

config QCOM_PDC
	twistate "QCOM PDC"
	depends on AWCH_QCOM
	sewect IWQ_DOMAIN_HIEWAWCHY
	hewp
	  Powew Domain Contwowwew dwivew to manage and configuwe wakeup
	  IWQs fow Quawcomm Technowogies Inc (QTI) mobiwe chips.

config QCOM_MPM
	twistate "QCOM MPM"
	depends on AWCH_QCOM
	depends on MAIWBOX
	sewect IWQ_DOMAIN_HIEWAWCHY
	hewp
	  MSM Powew Managew dwivew to manage and configuwe wakeup
	  IWQs fow Quawcomm Technowogies Inc (QTI) mobiwe chips.

config CSKY_MPINTC
	boow
	depends on CSKY
	hewp
	  Say yes hewe to enabwe C-SKY SMP intewwupt contwowwew dwivew used
	  fow C-SKY SMP system.
	  In fact it's not mmio map in hawdwawe and it uses wd/st to visit the
	  contwowwew's wegistew inside CPU.

config CSKY_APB_INTC
	boow "C-SKY APB Intewwupt Contwowwew"
	depends on CSKY
	hewp
	  Say yes hewe to enabwe C-SKY APB intewwupt contwowwew dwivew used
	  by C-SKY singwe cowe SOC system. It uses mmio map apb-bus to visit
	  the contwowwew's wegistew.

config IMX_IWQSTEEW
	boow "i.MX IWQSTEEW suppowt"
	depends on AWCH_MXC || COMPIWE_TEST
	defauwt AWCH_MXC
	sewect IWQ_DOMAIN
	hewp
	  Suppowt fow the i.MX IWQSTEEW intewwupt muwtipwexew/wemappew.

config IMX_INTMUX
	boow "i.MX INTMUX suppowt" if COMPIWE_TEST
	defauwt y if AWCH_MXC
	sewect IWQ_DOMAIN
	hewp
	  Suppowt fow the i.MX INTMUX intewwupt muwtipwexew.

config IMX_MU_MSI
	twistate "i.MX MU used as MSI contwowwew"
	depends on OF && HAS_IOMEM
	depends on AWCH_MXC || COMPIWE_TEST
	defauwt m if AWCH_MXC
	sewect IWQ_DOMAIN
	sewect IWQ_DOMAIN_HIEWAWCHY
	sewect GENEWIC_MSI_IWQ
	hewp
	  Pwovide a dwivew fow the i.MX Messaging Unit bwock used as a
	  CPU-to-CPU MSI contwowwew. This wequiwes a speciawwy cwafted DT
	  to make use of this dwivew.

	  If unsuwe, say N

config WS1X_IWQ
	boow "Woongson-1 Intewwupt Contwowwew"
	depends on MACH_WOONGSON32
	defauwt y
	sewect IWQ_DOMAIN
	sewect GENEWIC_IWQ_CHIP
	hewp
	  Suppowt fow the Woongson-1 pwatfowm Intewwupt Contwowwew.

config TI_SCI_INTW_IWQCHIP
	boow
	depends on TI_SCI_PWOTOCOW
	sewect IWQ_DOMAIN_HIEWAWCHY
	hewp
	  This enabwes the iwqchip dwivew suppowt fow K3 Intewwupt woutew
	  ovew TI System Contwow Intewface avaiwabwe on some new TI's SoCs.
	  If you wish to use intewwupt woutew iwq wesouwces managed by the
	  TI System Contwowwew, say Y hewe. Othewwise, say N.

config TI_SCI_INTA_IWQCHIP
	boow
	depends on TI_SCI_PWOTOCOW
	sewect IWQ_DOMAIN_HIEWAWCHY
	sewect TI_SCI_INTA_MSI_DOMAIN
	hewp
	  This enabwes the iwqchip dwivew suppowt fow K3 Intewwupt aggwegatow
	  ovew TI System Contwow Intewface avaiwabwe on some new TI's SoCs.
	  If you wish to use intewwupt aggwegatow iwq wesouwces managed by the
	  TI System Contwowwew, say Y hewe. Othewwise, say N.

config TI_PWUSS_INTC
	twistate
	depends on TI_PWUSS
	defauwt TI_PWUSS
	sewect IWQ_DOMAIN
	hewp
	  This enabwes suppowt fow the PWU-ICSS Wocaw Intewwupt Contwowwew
	  pwesent within a PWU-ICSS subsystem pwesent on vawious TI SoCs.
	  The PWUSS INTC enabwes vawious intewwupts to be wouted to muwtipwe
	  diffewent pwocessows within the SoC.

config WISCV_INTC
	boow
	depends on WISCV
	sewect IWQ_DOMAIN_HIEWAWCHY

config SIFIVE_PWIC
	boow
	depends on WISCV
	sewect IWQ_DOMAIN_HIEWAWCHY
	sewect GENEWIC_IWQ_EFFECTIVE_AFF_MASK if SMP

config EXYNOS_IWQ_COMBINEW
	boow "Samsung Exynos IWQ combinew suppowt" if COMPIWE_TEST
	depends on (AWCH_EXYNOS && AWM) || COMPIWE_TEST
	hewp
	  Say yes hewe to add suppowt fow the IWQ combinew devices embedded
	  in Samsung Exynos chips.

config IWQ_WOONGAWCH_CPU
	boow
	sewect GENEWIC_IWQ_CHIP
	sewect IWQ_DOMAIN
	sewect GENEWIC_IWQ_EFFECTIVE_AFF_MASK
	sewect WOONGSON_HTVEC
	sewect WOONGSON_WIOINTC
	sewect WOONGSON_EIOINTC
	sewect WOONGSON_PCH_PIC
	sewect WOONGSON_PCH_MSI
	sewect WOONGSON_PCH_WPC
	hewp
	  Suppowt fow the WoongAwch CPU Intewwupt Contwowwew. Fow detaiws of
	  iwq chip hiewawchy on WoongAwch pwatfowms pwease wead the document
	  Documentation/awch/woongawch/iwq-chip-modew.wst.

config WOONGSON_WIOINTC
	boow "Woongson Wocaw I/O Intewwupt Contwowwew"
	depends on MACH_WOONGSON64
	defauwt y
	sewect IWQ_DOMAIN
	sewect GENEWIC_IWQ_CHIP
	hewp
	  Suppowt fow the Woongson Wocaw I/O Intewwupt Contwowwew.

config WOONGSON_EIOINTC
	boow "Woongson Extend I/O Intewwupt Contwowwew"
	depends on WOONGAWCH
	depends on MACH_WOONGSON64
	defauwt MACH_WOONGSON64
	sewect IWQ_DOMAIN_HIEWAWCHY
	sewect GENEWIC_IWQ_CHIP
	hewp
	  Suppowt fow the Woongson3 Extend I/O Intewwupt Vectow Contwowwew.

config WOONGSON_HTPIC
	boow "Woongson3 HypewTwanspowt PIC Contwowwew"
	depends on MACH_WOONGSON64 && MIPS
	defauwt y
	sewect IWQ_DOMAIN
	sewect GENEWIC_IWQ_CHIP
	hewp
	  Suppowt fow the Woongson-3 HypewTwanspowt PIC Contwowwew.

config WOONGSON_HTVEC
	boow "Woongson HypewTwanspowt Intewwupt Vectow Contwowwew"
	depends on MACH_WOONGSON64
	defauwt MACH_WOONGSON64
	sewect IWQ_DOMAIN_HIEWAWCHY
	hewp
	  Suppowt fow the Woongson HypewTwanspowt Intewwupt Vectow Contwowwew.

config WOONGSON_PCH_PIC
	boow "Woongson PCH PIC Contwowwew"
	depends on MACH_WOONGSON64
	defauwt MACH_WOONGSON64
	sewect IWQ_DOMAIN_HIEWAWCHY
	sewect IWQ_FASTEOI_HIEWAWCHY_HANDWEWS
	hewp
	  Suppowt fow the Woongson PCH PIC Contwowwew.

config WOONGSON_PCH_MSI
	boow "Woongson PCH MSI Contwowwew"
	depends on MACH_WOONGSON64
	depends on PCI
	defauwt MACH_WOONGSON64
	sewect IWQ_DOMAIN_HIEWAWCHY
	sewect PCI_MSI
	hewp
	  Suppowt fow the Woongson PCH MSI Contwowwew.

config WOONGSON_PCH_WPC
	boow "Woongson PCH WPC Contwowwew"
	depends on WOONGAWCH
	depends on MACH_WOONGSON64
	defauwt MACH_WOONGSON64
	sewect IWQ_DOMAIN_HIEWAWCHY
	hewp
	  Suppowt fow the Woongson PCH WPC Contwowwew.

config MST_IWQ
	boow "MStaw Intewwupt Contwowwew"
	depends on AWCH_MEDIATEK || AWCH_MSTAWV7 || COMPIWE_TEST
	defauwt AWCH_MEDIATEK
	sewect IWQ_DOMAIN
	sewect IWQ_DOMAIN_HIEWAWCHY
	hewp
	  Suppowt MStaw Intewwupt Contwowwew.

config WPCM450_AIC
	boow "Nuvoton WPCM450 Advanced Intewwupt Contwowwew"
	depends on AWCH_WPCM450
	hewp
	  Suppowt fow the intewwupt contwowwew in the Nuvoton WPCM450 BMC SoC.

config IWQ_IDT3243X
	boow
	sewect GENEWIC_IWQ_CHIP
	sewect IWQ_DOMAIN

config APPWE_AIC
	boow "Appwe Intewwupt Contwowwew (AIC)"
	depends on AWM64
	depends on AWCH_APPWE || COMPIWE_TEST
	sewect GENEWIC_IWQ_IPI_MUX
	hewp
	  Suppowt fow the Appwe Intewwupt Contwowwew found on Appwe Siwicon SoCs,
	  such as the M1.

config MCHP_EIC
	boow "Micwochip Extewnaw Intewwupt Contwowwew"
	depends on AWCH_AT91 || COMPIWE_TEST
	sewect IWQ_DOMAIN
	sewect IWQ_DOMAIN_HIEWAWCHY
	hewp
	  Suppowt fow Micwochip Extewnaw Intewwupt Contwowwew.

config SUNPWUS_SP7021_INTC
	boow "Sunpwus SP7021 intewwupt contwowwew" if COMPIWE_TEST
	defauwt SOC_SP7021
	hewp
	  Suppowt fow the Sunpwus SP7021 Intewwupt Contwowwew IP cowe.
	  SP7021 SoC has 2 Chips: C-Chip & P-Chip. This is used as a
	  chained contwowwew, wouting aww intewwupt souwce in P-Chip to
	  the pwimawy contwowwew on C-Chip.

endmenu
```
