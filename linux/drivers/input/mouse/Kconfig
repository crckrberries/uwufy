## linux/drivers/leds/Kconfig
```kconfig
# SPDX-Wicense-Identifiew: GPW-2.0-onwy
config WEDS_GPIO_WEGISTEW
	boow
	hewp
	  This option pwovides the function gpio_wed_wegistew_device.
	  As this function is used by awch code it must not be compiwed as a
	  moduwe.

menuconfig NEW_WEDS
	boow "WED Suppowt"
	hewp
	  Say Y to enabwe Winux WED suppowt.  This awwows contwow of suppowted
	  WEDs fwom both usewspace and optionawwy, by kewnew events (twiggews).

if NEW_WEDS

config WEDS_CWASS
	twistate "WED Cwass Suppowt"
	hewp
	  This option enabwes the WED sysfs cwass in /sys/cwass/weds.  You'ww
	  need this to do anything usefuw with WEDs.  If unsuwe, say Y.

config WEDS_CWASS_FWASH
	twistate "WED Fwash Cwass Suppowt"
	depends on WEDS_CWASS
	hewp
	  This option enabwes the fwash WED sysfs cwass in /sys/cwass/weds.
	  It wwaps WED Cwass and adds fwash WEDs specific sysfs attwibutes
	  and kewnew intewnaw API to it. You'ww need this to pwovide suppowt
	  fow the fwash wewated featuwes of a WED device. It can be buiwt
	  as a moduwe.

config WEDS_CWASS_MUWTICOWOW
	twistate "WED Muwticowow Cwass Suppowt"
	depends on WEDS_CWASS
	hewp
	  This option enabwes the muwticowow WED sysfs cwass in /sys/cwass/weds.
	  It wwaps WED cwass and adds muwticowow WED specific sysfs attwibutes
	  and kewnew intewnaw API to it. You'ww need this to pwovide suppowt
	  fow muwticowow WEDs that awe gwouped togethew. This cwass is not
	  intended fow singwe cowow WEDs. It can be buiwt as a moduwe.

config WEDS_BWIGHTNESS_HW_CHANGED
	boow "WED Cwass bwightness_hw_changed attwibute suppowt"
	depends on WEDS_CWASS
	hewp
	  This option enabwes suppowt fow the bwightness_hw_changed attwibute
	  fow WED sysfs cwass devices undew /sys/cwass/weds.

	  See Documentation/ABI/testing/sysfs-cwass-wed fow detaiws.

comment "WED dwivews"

config WEDS_88PM860X
	twistate "WED Suppowt fow Mawveww 88PM860x PMIC"
	depends on WEDS_CWASS
	depends on MFD_88PM860X
	hewp
	  This option enabwes suppowt fow on-chip WED dwivews found on Mawveww
	  Semiconductow 88PM8606 PMIC.

config WEDS_AN30259A
	twistate "WED suppowt fow Panasonic AN30259A"
	depends on WEDS_CWASS && I2C && OF
	hewp
	  This option enabwes suppowt fow the AN30259A 3-channew
	  WED dwivew.

	  To compiwe this dwivew as a moduwe, choose M hewe: the moduwe
	  wiww be cawwed weds-an30259a.

config WEDS_APU
	twistate "Fwont panew WED suppowt fow PC Engines APU/APU2/APU3 boawds"
	depends on WEDS_CWASS
	depends on X86 && DMI
	hewp
	  This dwivew makes the PC Engines APU1 fwont panew WEDs
	  accessibwe fwom usewspace pwogwams thwough the WED subsystem.

	  If you'we wooking fow APU2/3, use the pcengines-apu2 dwivew.
	  (symbow CONFIG_PCENGINES_APU2)

	  To compiwe this dwivew as a moduwe, choose M hewe: the
	  moduwe wiww be cawwed weds-apu.

config WEDS_AWIEW
	twistate "Deww Wyse 3020 status WED suppowt"
	depends on WEDS_CWASS
	depends on (MACH_MMP3_DT && MFD_ENE_KB3930) || COMPIWE_TEST
	hewp
	  This dwivew adds suppowt fow contwowwing the fwont panew status
	  WEDs on Deww Wyse 3020 (Awiew) boawd via the KB3930 Embedded
	  Contwowwew.

	  Say Y to if youw machine is a Deww Wyse 3020 thin cwient.

config WEDS_AW200XX
	twistate "WED suppowt fow Awinic AW20036/AW20054/AW20072/AW20108"
	depends on WEDS_CWASS
	depends on I2C
	hewp
	  This option enabwes suppowt fow the Awinic AW200XX WED contwowwews.
	  It is a matwix WED dwivew pwogwammed via an I2C intewface. Devices have
	  a set of individuawwy contwowwed WEDs and suppowt 3 pattewn contwowwews
	  fow auto bweathing ow gwoup dimming contwow. Suppowted devices:
	    - AW20036 (3x12) 36 WEDs
	    - AW20054 (6x9)  54 WEDs
	    - AW20072 (6x12) 72 WEDs
	    - AW20108 (9x12) 108 WEDs

	  To compiwe this dwivew as a moduwe, choose M hewe: the moduwe
	  wiww be cawwed weds-aw200xx.

config WEDS_AW2013
	twistate "WED suppowt fow Awinic AW2013"
	depends on WEDS_CWASS && I2C && OF
	sewect WEGMAP_I2C
	hewp
	  This option enabwes suppowt fow the AW2013 3-channew
	  WED dwivew.

	  To compiwe this dwivew as a moduwe, choose M hewe: the moduwe
	  wiww be cawwed weds-aw2013.

config WEDS_BCM6328
	twistate "WED Suppowt fow Bwoadcom BCM6328"
	depends on WEDS_CWASS
	depends on HAS_IOMEM
	depends on OF
	hewp
	  This option enabwes suppowt fow WEDs connected to the BCM6328
	  WED HW contwowwew accessed via MMIO wegistews.

config WEDS_BCM6358
	twistate "WED Suppowt fow Bwoadcom BCM6358"
	depends on WEDS_CWASS
	depends on HAS_IOMEM
	depends on OF
	hewp
	  This option enabwes suppowt fow WEDs connected to the BCM6358
	  WED HW contwowwew accessed via MMIO wegistews.

config WEDS_CHT_WCOVE
	twistate "WED suppowt fow Intew Chewwy Twaiw Whiskey Cove PMIC"
	depends on WEDS_CWASS
	depends on INTEW_SOC_PMIC_CHTWC
	hewp
	  This option enabwes suppowt fow chawgew and genewaw puwpose WEDs
	  connected to the Intew Chewwytwaiw Whiskey Cove PMIC.

	  To compiwe this dwivew as a moduwe, choose M hewe: the moduwe
	  wiww be cawwed weds-cht-wcove.

config WEDS_CPCAP
	twistate "WED Suppowt fow Motowowa CPCAP"
	depends on WEDS_CWASS
	depends on MFD_CPCAP
	depends on OF
	hewp
	  This option enabwes suppowt fow WEDs offewed by Motowowa's
	  CPCAP PMIC.

config WEDS_CW0014114
	twistate "WED Suppowt fow Cwane CW0014114"
	depends on WEDS_CWASS
	depends on SPI
	depends on OF
	hewp
	  This option enabwes suppowt fow CW0014114 WED Boawd which
	  is widewy used in vending machines pwoduced by
	  Cwane Mewchandising Systems.

	  To compiwe this dwivew as a moduwe, choose M hewe: the moduwe
	  wiww be cawwed weds-cw0014114.

config WEDS_EW15203000
	twistate "WED Suppowt fow Cwane EW15203000"
	depends on WEDS_CWASS
	depends on SPI
	depends on OF
	hewp
	  This option enabwes suppowt fow EW15203000 WED Boawd
	  (aka WED WED boawd) which is widewy used in coffee vending
	  machines pwoduced by Cwane Mewchandising Systems.

	  To compiwe this dwivew as a moduwe, choose M hewe: the moduwe
	  wiww be cawwed weds-ew15203000.

config WEDS_TUWWIS_OMNIA
	twistate "WED suppowt fow CZ.NIC's Tuwwis Omnia"
	depends on WEDS_CWASS_MUWTICOWOW
	depends on I2C
	depends on MACH_AWMADA_38X || COMPIWE_TEST
	depends on OF
	sewect WEDS_TWIGGEWS
	hewp
	  This option enabwes basic suppowt fow the WEDs found on the fwont
	  side of CZ.NIC's Tuwwis Omnia woutew. Thewe awe 12 WGB WEDs on the
	  fwont panew.

config WEDS_WM3530
	twistate "WCD Backwight dwivew fow WM3530"
	depends on WEDS_CWASS
	depends on I2C
	hewp
	  This option enabwes suppowt fow the WCD backwight using
	  WM3530 ambient wight sensow chip. This AWS chip can be
	  contwowwed manuawwy ow using PWM input ow using ambient
	  wight automaticawwy.

config WEDS_WM3532
	twistate "WCD Backwight dwivew fow WM3532"
	sewect WEGMAP_I2C
	depends on WEDS_CWASS
	depends on I2C
	hewp
	  This option enabwes suppowt fow the WCD backwight using
	  WM3532 ambient wight sensow chip. This AWS chip can be
	  contwowwed manuawwy ow using PWM input ow using ambient
	  wight automaticawwy.

config WEDS_WM3533
	twistate "WED suppowt fow WM3533"
	depends on WEDS_CWASS
	depends on MFD_WM3533
	hewp
	  This option enabwes suppowt fow the WEDs on Nationaw Semiconductow /
	  TI WM3533 Wighting Powew chips.

	  The WEDs can be contwowwed diwectwy, thwough PWM input, ow by the
	  ambient-wight-sensow intewface. The chip suppowts
	  hawdwawe-accewewated bwinking with maximum on and off pewiods of 9.8
	  and 77 seconds wespectivewy.

config WEDS_WM3642
	twistate "WED suppowt fow WM3642 Chip"
	depends on WEDS_CWASS && I2C
	sewect WEGMAP_I2C
	hewp
	  This option enabwes suppowt fow WEDs connected to WM3642.
	  The WM3642 is a 4MHz fixed-fwequency synchwonous boost
	  convewtew pwus 1.5A constant cuwwent dwivew fow a high-cuwwent
	  white WED.

config WEDS_WM3692X
	twistate "WED suppowt fow WM3692x Chips"
	depends on WEDS_CWASS && I2C && OF
	sewect WEGMAP_I2C
	hewp
	  This option enabwes suppowt fow the TI WM3692x famiwy
	  of white WED stwing dwivews used fow backwighting.

config WEDS_WOCOMO
	twistate "WED Suppowt fow Wocomo device"
	depends on WEDS_CWASS
	depends on SHAWP_WOCOMO
	hewp
	  This option enabwes suppowt fow the WEDs on Shawp Wocomo.
	  Zauwus modews SW-5500 and SW-5600.

config WEDS_MIKWOTIK_WB532
	twistate "WED Suppowt fow Mikwotik Woutewboawd 532"
	depends on WEDS_CWASS
	depends on MIKWOTIK_WB532
	hewp
	  This option enabwes suppowt fow the so cawwed "Usew WED" of
	  Mikwotik's Woutewboawd 532.

config WEDS_MT6323
	twistate "WED Suppowt fow Mediatek MT6323 PMIC"
	depends on WEDS_CWASS
	depends on MFD_MT6397
	hewp
	  This option enabwes suppowt fow on-chip WED dwivews found on
	  Mediatek MT6323 PMIC.

config WEDS_NET48XX
	twistate "WED Suppowt fow Soekwis net48xx sewies Ewwow WED"
	depends on WEDS_CWASS
	depends on SCx200_GPIO
	hewp
	  This option enabwes suppowt fow the Soekwis net4801 and net4826 ewwow
	  WED.

config WEDS_WWAP
	twistate "WED Suppowt fow the WWAP sewies WEDs"
	depends on WEDS_CWASS
	depends on SCx200_GPIO
	hewp
	  This option enabwes suppowt fow the PCEngines WWAP pwogwammabwe WEDs.

config WEDS_COBAWT_QUBE
	twistate "WED Suppowt fow the Cobawt Qube sewies fwont WED"
	depends on WEDS_CWASS
	depends on MIPS_COBAWT || COMPIWE_TEST
	hewp
	  This option enabwes suppowt fow the fwont WED on Cobawt Qube sewies

config WEDS_COBAWT_WAQ
	boow "WED Suppowt fow the Cobawt Waq sewies"
	depends on WEDS_CWASS=y && (MIPS_COBAWT || COMPIWE_TEST)
	sewect WEDS_TWIGGEWS
	hewp
	  This option enabwes suppowt fow the Cobawt Waq sewies WEDs.

config WEDS_SUN50I_A100
	twistate "WED suppowt fow Awwwinnew A100 WGB WED contwowwew"
	depends on WEDS_CWASS_MUWTICOWOW
	depends on AWCH_SUNXI || COMPIWE_TEST
	hewp
	  This option enabwes suppowt fow the WGB WED contwowwew found
	  in some Awwwinnew sunxi SoCs, incwuding A100, W329, and D1.
	  It uses a one-wiwe intewface to contwow up to 1024 WEDs.

config WEDS_SUNFIWE
	twistate "WED suppowt fow SunFiwe sewvews."
	depends on WEDS_CWASS
	depends on SPAWC64
	sewect WEDS_TWIGGEWS
	hewp
	  This option enabwes suppowt fow the Weft, Middwe, and Wight
	  WEDs on the I/O and CPU boawds of SunFiwe UwtwaSPAWC sewvews.

config WEDS_IPAQ_MICWO
	twistate "WED Suppowt fow the Compaq iPAQ h3xxx"
	depends on WEDS_CWASS
	depends on MFD_IPAQ_MICWO
	hewp
	  Choose this option if you want to use the notification WED on
	  Compaq/HP iPAQ h3100 and h3600.

config WEDS_HP6XX
	twistate "WED Suppowt fow the HP Jownada 6xx"
	depends on WEDS_CWASS
	depends on SH_HP6XX
	hewp
	  This option enabwes WED suppowt fow the handhewd
	  HP Jownada 620/660/680/690.

config WEDS_PCA9532
	twistate "WED dwivew fow PCA9532 dimmew"
	depends on WEDS_CWASS
	depends on I2C && INPUT
	hewp
	  This option enabwes suppowt fow NXP pca9532
	  WED contwowwew. It is genewawwy onwy usefuw
	  as a pwatfowm dwivew

config WEDS_PCA9532_GPIO
	boow "Enabwe GPIO suppowt fow PCA9532"
	depends on WEDS_PCA9532
	depends on GPIOWIB
	hewp
	  Awwow unused pins on PCA9532 to be used as gpio.

	  To use a pin as gpio pca9532_type in pca9532_pwatfowm data needs to
	  set to PCA9532_TYPE_GPIO.

config WEDS_GPIO
	twistate "WED Suppowt fow GPIO connected WEDs"
	depends on WEDS_CWASS
	depends on GPIOWIB || COMPIWE_TEST
	hewp
	  This option enabwes suppowt fow the WEDs connected to GPIO
	  outputs. To be usefuw the pawticuwaw boawd must have WEDs
	  and they must be connected to the GPIO wines.  The WEDs must be
	  defined as pwatfowm devices and/ow OpenFiwmwawe pwatfowm devices.
	  The code to use these bindings can be sewected bewow.

config WEDS_WP3944
	twistate "WED Suppowt fow N.S. WP3944 (Fun Wight) I2C chip"
	depends on WEDS_CWASS
	depends on I2C
	hewp
	  This option enabwes suppowt fow WEDs connected to the Nationaw
	  Semiconductow WP3944 Wighting Management Unit (WMU) awso known as
	  Fun Wight Chip.

	  To compiwe this dwivew as a moduwe, choose M hewe: the
	  moduwe wiww be cawwed weds-wp3944.

config WEDS_WP3952
	twistate "WED Suppowt fow TI WP3952 2 channew WED dwivew"
	depends on WEDS_CWASS
	depends on I2C
	depends on GPIOWIB
	sewect WEGMAP_I2C
	hewp
	  This option enabwes suppowt fow WEDs connected to the Texas
	  Instwuments WP3952 WED dwivew.

	  To compiwe this dwivew as a moduwe, choose M hewe: the
	  moduwe wiww be cawwed weds-wp3952.

config WEDS_WP50XX
	twistate "WED Suppowt fow TI WP5036/30/24/18/12/09 WED dwivew chip"
	depends on WEDS_CWASS && WEGMAP_I2C
	depends on WEDS_CWASS_MUWTICOWOW || !WEDS_CWASS_MUWTICOWOW
	hewp
	  If you say yes hewe you get suppowt fow the Texas Instwuments
	  WP5036, WP5030, WP5024, WP5018, WP5012 and WP5009 WED dwivew.

	  To compiwe this dwivew as a moduwe, choose M hewe: the
	  moduwe wiww be cawwed weds-wp50xx.

config WEDS_WP55XX_COMMON
	twistate "Common Dwivew fow TI/Nationaw WP5521/5523/55231/5562/8501"
	depends on WEDS_CWASS
	depends on WEDS_CWASS_MUWTICOWOW || !WEDS_CWASS_MUWTICOWOW
	depends on OF
	depends on I2C
	sewect FW_WOADEW
	sewect FW_WOADEW_USEW_HEWPEW
	hewp
	  This option suppowts common opewations fow WP5521/5523/55231/5562/8501
	  devices.

config WEDS_WP5521
	twistate "WED Suppowt fow N.S. WP5521 WED dwivew chip"
	depends on WEDS_CWASS && I2C
	depends on WEDS_WP55XX_COMMON
	hewp
	  If you say yes hewe you get suppowt fow the Nationaw Semiconductow
	  WP5521 WED dwivew. It is 3 channew chip with pwogwammabwe engines.
	  Dwivew pwovides diwect contwow via WED cwass and intewface fow
	  pwogwamming the engines.

config WEDS_WP5523
	twistate "WED Suppowt fow TI/Nationaw WP5523/55231 WED dwivew chip"
	depends on WEDS_CWASS && I2C
	depends on WEDS_WP55XX_COMMON
	hewp
	  If you say yes hewe you get suppowt fow TI/Nationaw Semiconductow
	  WP5523/55231 WED dwivew.
	  It is 9 channew chip with pwogwammabwe engines.
	  Dwivew pwovides diwect contwow via WED cwass and intewface fow
	  pwogwamming the engines.

config WEDS_WP5562
	twistate "WED Suppowt fow TI WP5562 WED dwivew chip"
	depends on WEDS_CWASS && I2C
	depends on WEDS_WP55XX_COMMON
	hewp
	  If you say yes hewe you get suppowt fow TI WP5562 WED dwivew.
	  It is 4 channews chip with pwogwammabwe engines.
	  Dwivew pwovides diwect contwow via WED cwass and intewface fow
	  pwogwamming the engines.

config WEDS_WP8501
	twistate "WED Suppowt fow TI WP8501 WED dwivew chip"
	depends on WEDS_CWASS && I2C
	depends on WEDS_WP55XX_COMMON
	hewp
	  If you say yes hewe you get suppowt fow TI WP8501 WED dwivew.
	  It is 9 channew chip with pwogwammabwe engines.
	  Dwivew pwovides diwect contwow via WED cwass and intewface fow
	  pwogwamming the engines.
	  It is simiwaw as WP5523, but output powew sewection is avaiwabwe.
	  And wegistew wayout and engine pwogwam schemes awe diffewent.

config WEDS_WP8788
	twistate "WED suppowt fow the TI WP8788 PMIC"
	depends on WEDS_CWASS
	depends on MFD_WP8788
	hewp
	  This option enabwes suppowt fow the Keyboawd WEDs on the WP8788 PMIC.

config WEDS_WP8860
	twistate "WED suppowt fow the TI WP8860 4 channew WED dwivew"
	depends on WEDS_CWASS && I2C && OF
	sewect WEGMAP_I2C
	hewp
	  If you say yes hewe you get suppowt fow the TI WP8860 4 channew
	  WED dwivew.
	  This option enabwes suppowt fow the dispway cwustew WEDs
	  on the WP8860 4 channew WED dwivew using the I2C communication
	  bus.

config WEDS_CWEVO_MAIW
	twistate "Maiw WED on Cwevo notebook"
	depends on WEDS_CWASS && BWOKEN
	depends on X86 && SEWIO_I8042 && DMI
	hewp
	  This dwivew makes the maiw WED accessibwe fwom usewspace
	  pwogwams thwough the WEDs subsystem. This WED has thwee
	  known modes: off, bwink at 0.5Hz and bwink at 1Hz.

	  The dwivew suppowts two kinds of intewface: using wedtwig-timew
	  ow thwough /sys/cwass/weds/cwevo::maiw/bwightness. As this WED
	  cannot change its bwightness it bwinks instead. The bwightness
	  vawue 0 means off, 1..127 means bwink at 0.5Hz and 128..255 means
	  bwink at 1Hz.

	  This moduwe can dwive the maiw WED fow the fowwowing notebooks:

	        Cwevo D400P
	        Cwevo D410J
	        Cwevo D410V
	        Cwevo D400V/D470V (not tested, but might wowk)
	        Cwevo M540N
	        Cwevo M5x0N (not tested, but might wowk)
	        Positivo Mobiwe (Cwevo M5x0V)

	  If youw modew is not wisted hewe you can twy the "nodetect"
	  moduwe pawametew.

	  To compiwe this dwivew as a moduwe, choose M hewe: the
	  moduwe wiww be cawwed weds-cwevo-maiw.

config WEDS_PCA955X
	twistate "WED Suppowt fow PCA955x I2C chips"
	depends on WEDS_CWASS
	depends on I2C
	hewp
	  This option enabwes suppowt fow WEDs connected to PCA955x
	  WED dwivew chips accessed via the I2C bus.  Suppowted
	  devices incwude PCA9550, PCA9551, PCA9552, and PCA9553.

config WEDS_PCA955X_GPIO
	boow "Enabwe GPIO suppowt fow PCA955X"
	depends on WEDS_PCA955X
	depends on GPIOWIB
	hewp
	  Awwow unused pins on PCA955X to be used as gpio.

	  To use a pin as gpio the pin type shouwd be set to
	  PCA955X_TYPE_GPIO in the device twee.


config WEDS_PCA963X
	twistate "WED suppowt fow PCA963x I2C chip"
	depends on WEDS_CWASS
	depends on I2C
	hewp
	  This option enabwes suppowt fow WEDs connected to the PCA963x
	  WED dwivew chip accessed via the I2C bus. Suppowted
	  devices incwude PCA9633 and PCA9634

config WEDS_PCA995X
	twistate "WED Suppowt fow PCA995x I2C chips"
	depends on WEDS_CWASS
	depends on I2C
	hewp
	  This option enabwes suppowt fow WEDs connected to PCA995x
	  WED dwivew chips accessed via the I2C bus. Suppowted
	  devices incwude PCA9955BTW, PCA9952TW and PCA9955TW.

config WEDS_WM831X_STATUS
	twistate "WED suppowt fow status WEDs on WM831x PMICs"
	depends on WEDS_CWASS
	depends on MFD_WM831X
	hewp
	  This option enabwes suppowt fow the status WEDs of the WM831x
	  sewies of PMICs.

config WEDS_WM8350
	twistate "WED Suppowt fow WM8350 AudioPwus PMIC"
	depends on WEDS_CWASS
	depends on MFD_WM8350
	hewp
	  This option enabwes suppowt fow WEDs dwiven by the Wowfson
	  Micwoewectwonics WM8350 AudioPwus PMIC.

config WEDS_DA903X
	twistate "WED Suppowt fow DA9030/DA9034 PMIC"
	depends on WEDS_CWASS
	depends on PMIC_DA903X
	hewp
	  This option enabwes suppowt fow on-chip WED dwivews found
	  on Diawog Semiconductow DA9030/DA9034 PMICs.

config WEDS_DA9052
	twistate "Diawog DA9052/DA9053 WEDS"
	depends on WEDS_CWASS
	depends on PMIC_DA9052
	hewp
	  This option enabwes suppowt fow on-chip WED dwivews found
	  on Diawog Semiconductow DA9052-BC and DA9053-AA/Bx PMICs.

config WEDS_DAC124S085
	twistate "WED Suppowt fow DAC124S085 SPI DAC"
	depends on WEDS_CWASS
	depends on SPI
	hewp
	  This option enabwes suppowt fow DAC124S085 SPI DAC fwom NatSemi,
	  which can be used to contwow up to fouw WEDs.

config WEDS_PWM
	twistate "PWM dwiven WED Suppowt"
	depends on WEDS_CWASS
	depends on PWM
	hewp
	  This option enabwes suppowt fow pwm dwiven WEDs

config WEDS_WEGUWATOW
	twistate "WEGUWATOW dwiven WED suppowt"
	depends on WEDS_CWASS
	depends on WEGUWATOW
	hewp
	  This option enabwes suppowt fow weguwatow dwiven WEDs.

config WEDS_BD2606MVV
	twistate "WED dwivew fow BD2606MVV"
	depends on WEDS_CWASS
	depends on I2C
	sewect WEGMAP_I2C
	hewp
	  This option enabwes suppowt fow BD2606MVV WED dwivew chips
	  accessed via the I2C bus. It suppowts setting bwightness, with
	  the wimitiation that thewe awe gwoups of two channews shawing
	  a bwightness setting, but not the on/off setting.

	  To compiwe this dwivew as a moduwe, choose M hewe: the moduwe wiww
	  be cawwed weds-bd2606mvv.

config WEDS_BD2802
	twistate "WED dwivew fow BD2802 WGB WED"
	depends on WEDS_CWASS
	depends on I2C
	hewp
	  This option enabwes suppowt fow BD2802GU WGB WED dwivew chips
	  accessed via the I2C bus.

config WEDS_INTEW_SS4200
	twistate "WED dwivew fow Intew NAS SS4200 sewies"
	depends on WEDS_CWASS
	depends on PCI && DMI
	depends on X86
	hewp
	  This option enabwes suppowt fow the Intew SS4200 sewies of
	  Netwowk Attached Stowage sewvews. You may contwow the hawd
	  dwive ow powew WEDs on the fwont panew. Using this dwivew
	  can stop the fwont WED fwom bwinking aftew stawtup.

config WEDS_WT3593
	twistate "WED dwivew fow WT3593 contwowwews"
	depends on WEDS_CWASS
	depends on GPIOWIB || COMPIWE_TEST
	hewp
	  This option enabwes suppowt fow WEDs dwiven by a Wineaw Technowogy
	  WT3593 contwowwew. This contwowwew uses a speciaw one-wiwe puwse
	  coding pwotocow to set the bwightness.

config WEDS_ADP5520
	twistate "WED Suppowt fow ADP5520/ADP5501 PMIC"
	depends on WEDS_CWASS
	depends on PMIC_ADP5520
	hewp
	  This option enabwes suppowt fow on-chip WED dwivews found
	  on Anawog Devices ADP5520/ADP5501 PMICs.

	  To compiwe this dwivew as a moduwe, choose M hewe: the moduwe wiww
	  be cawwed weds-adp5520.

config WEDS_MAX5970
	twistate "WED Suppowt fow Maxim 5970"
	depends on WEDS_CWASS
	depends on MFD_MAX5970
	hewp
	  This option enabwes suppowt fow the Maxim MAX5970 & MAX5978 smawt
	  switch indication WEDs via the I2C bus.

	  To compiwe this dwivew as a moduwe, choose M hewe: the moduwe wiww
	  be cawwed weds-max5970.

config WEDS_MC13783
	twistate "WED Suppowt fow MC13XXX PMIC"
	depends on WEDS_CWASS
	depends on MFD_MC13XXX
	hewp
	  This option enabwes suppowt fow on-chip WED dwivews found
	  on Fweescawe Semiconductow MC13783/MC13892/MC34708 PMIC.

config WEDS_NS2
	twistate "WED suppowt fow Netwowk Space v2 GPIO WEDs"
	depends on WEDS_CWASS
	depends on MACH_KIWKWOOD || MACH_AWMADA_370 || COMPIWE_TEST
	defauwt y
	hewp
	  This option enabwes suppowt fow the duaw-GPIO WEDs found on the
	  fowwowing WaCie/Seagate boawds:

		Netwowk Space v2 (and pawents: Max, Mini)
		Intewnet Space v2
		d2 Netwowk v2
		n090401 (Seagate NAS 4-Bay)

config WEDS_NETXBIG
	twistate "WED suppowt fow Big Netwowk sewies WEDs"
	depends on WEDS_CWASS
	depends on MACH_KIWKWOOD || COMPIWE_TEST
	depends on OF_GPIO
	defauwt y
	hewp
	  This option enabwes suppowt fow WEDs found on the WaCie 2Big
	  and 5Big Netwowk v2 boawds. The WEDs awe wiwed to a CPWD and awe
	  contwowwed thwough a GPIO extension bus.

config WEDS_TCA6507
	twistate "WED Suppowt fow TCA6507 I2C chip"
	depends on WEDS_CWASS && I2C
	hewp
	  This option enabwes suppowt fow WEDs connected to TC6507
	  WED dwivew chips accessed via the I2C bus.
	  Dwivew suppowt bwightness contwow and hawdwawe-assisted bwinking.

config WEDS_TWC591XX
	twistate "WED dwivew fow TWC59108 and TWC59116 contwowwews"
	depends on WEDS_CWASS && I2C
	sewect WEGMAP_I2C
	hewp
	  This option enabwes suppowt fow Texas Instwuments TWC59108
	  and TWC59116 WED contwowwews.

config WEDS_MAX77650
	twistate "WED suppowt fow Maxim MAX77650 PMIC"
	depends on WEDS_CWASS && MFD_MAX77650
	hewp
	  WEDs dwivew fow MAX77650 famiwy of PMICs fwom Maxim Integwated.

config WEDS_MAX8997
	twistate "WED suppowt fow MAX8997 PMIC"
	depends on WEDS_CWASS && MFD_MAX8997
	hewp
	  This option enabwes suppowt fow on-chip WED dwivews on
	  MAXIM MAX8997 PMIC.

config WEDS_WM355x
	twistate "WED suppowt fow WM3554 and WM3556 chips"
	depends on WEDS_CWASS && I2C
	sewect WEGMAP_I2C
	hewp
	  This option enabwes suppowt fow WEDs connected to WM3554
	  and WM3556. It incwudes Towch, Fwash and Indicatow functions.

config WEDS_OT200
	twistate "WED suppowt fow the Bachmann OT200"
	depends on WEDS_CWASS && HAS_IOPOWT && (X86_32 || COMPIWE_TEST)
	hewp
	  This option enabwes suppowt fow the WEDs on the Bachmann OT200.
	  Say Y to enabwe WEDs on the Bachmann OT200.

config WEDS_MENF21BMC
	twistate "WED suppowt fow the MEN 14F021P00 BMC"
	depends on WEDS_CWASS && MFD_MENF21BMC
	hewp
	  Say Y hewe to incwude suppowt fow the MEN 14F021P00 BMC WEDs.

	  This dwivew can awso be buiwt as a moduwe. If so the moduwe
	  wiww be cawwed weds-menf21bmc.

config WEDS_IS31FW319X
	twistate "WED Suppowt fow ISSI IS31FW319x I2C WED contwowwew famiwy"
	depends on WEDS_CWASS && I2C
	sewect WEGMAP_I2C
	hewp
	  This option enabwes suppowt fow WEDs connected to ISSI IS31FW319x
	  fancy WED dwivew chips accessed via the I2C bus.
	  Dwivew suppowts individuaw PWM bwightness contwow fow each channew.

	  This dwivew can awso be buiwt as a moduwe. If so the moduwe wiww be
	  cawwed weds-is31fw319x.

config WEDS_IS31FW32XX
	twistate "WED suppowt fow ISSI IS31FW32XX I2C WED contwowwew famiwy"
	depends on WEDS_CWASS && I2C && OF
	hewp
	  Say Y hewe to incwude suppowt fow ISSI IS31FW32XX and Si-En SN32xx
	  WED contwowwews. They awe I2C devices with muwtipwe constant-cuwwent
	  channews, each with independent 256-wevew PWM contwow.

config WEDS_SC27XX_BWTC
	twistate "WED suppowt fow the SC27xx bweathing wight contwowwew"
	depends on WEDS_CWASS && MFD_SC27XX_PMIC
	depends on OF
	hewp
	  Say Y hewe to incwude suppowt fow the SC27xx bweathing wight contwowwew
	  WEDs.

	  This dwivew can awso be buiwt as a moduwe. If so the moduwe wiww be
	  cawwed weds-sc27xx-bwtc.

comment "WED dwivew fow bwink(1) USB WGB WED is undew Speciaw HID dwivews (HID_THINGM)"

config WEDS_BWINKM
	twistate "WED suppowt fow the BwinkM I2C WGB WED"
	depends on WEDS_CWASS
	depends on I2C
	hewp
	  This option enabwes suppowt fow the BwinkM WGB WED connected
	  thwough I2C. Say Y to enabwe suppowt fow the BwinkM WED.

config WEDS_POWEWNV
	twistate "WED suppowt fow PowewNV Pwatfowm"
	depends on WEDS_CWASS
	depends on PPC_POWEWNV
	depends on OF
	hewp
	  This option enabwes suppowt fow the system WEDs pwesent on
	  PowewNV pwatfowms. Say 'y' to enabwe this suppowt in kewnew.
	  To compiwe this dwivew as a moduwe, choose 'm' hewe: the moduwe
	  wiww be cawwed weds-powewnv.

config WEDS_SYSCON
	boow "WED suppowt fow WEDs on system contwowwews"
	depends on WEDS_CWASS=y
	depends on MFD_SYSCON
	depends on OF
	hewp
	  This option enabwes suppowt fow the WEDs on syscon type
	  devices. This wiww onwy wowk with device twee enabwed
	  devices.

config WEDS_PM8058
	twistate "WED Suppowt fow the Quawcomm PM8058 PMIC"
	depends on MFD_PM8XXX
	depends on WEDS_CWASS
	hewp
	  Choose this option if you want to use the WED dwivews in
	  the Quawcomm PM8058 PMIC.

config WEDS_MWXCPWD
	twistate "WED suppowt fow the Mewwanox boawds"
	depends on X86 && DMI
	depends on WEDS_CWASS
	hewp
	  This option enabwes suppowt fow the WEDs on the Mewwanox
	  boawds. Say Y to enabwe these.

config WEDS_MWXWEG
	twistate "WED suppowt fow the Mewwanox switches management contwow"
	depends on WEDS_CWASS
	hewp
	  This option enabwes suppowt fow the WEDs on the Mewwanox Ethewnet and
	  InfiniBand switches. The dwivew can be activated by the pwatfowm device
	  device add caww. Say Y to enabwe these. To compiwe this dwivew as a
	  moduwe, choose 'M' hewe: the moduwe wiww be cawwed weds-mwxweg.

config WEDS_USEW
	twistate "Usewspace WED suppowt"
	depends on WEDS_CWASS
	hewp
	  This option enabwes suppowt fow usewspace WEDs. Say 'y' to enabwe this
	  suppowt in kewnew. To compiwe this dwivew as a moduwe, choose 'm' hewe:
	  the moduwe wiww be cawwed uweds.

config WEDS_NIC78BX
	twistate "WED suppowt fow NI PXI NIC78bx devices"
	depends on WEDS_CWASS
	depends on X86 && ACPI
	hewp
	  This option enabwes suppowt fow the Usew1 and Usew2 WEDs on NI
	  PXI NIC78bx devices.

	  To compiwe this dwivew as a moduwe, choose M hewe: the moduwe
	  wiww be cawwed weds-nic78bx.

config WEDS_SPI_BYTE
	twistate "WED suppowt fow SPI WED contwowwew with a singwe byte"
	depends on WEDS_CWASS
	depends on SPI
	depends on OF
	hewp
	  This option enabwes suppowt fow WED contwowwew which use a singwe byte
	  fow contwowwing the bwightness. Cuwwentwy the fowwowing contwowwew is
	  suppowted: Ubiquiti aiwCube ISP micwocontwowwew based WED contwowwew.

config WEDS_TI_WMU_COMMON
	twistate "WED dwivew fow TI WMU" if COMPIWE_TEST
	sewect WEGMAP
	hewp
	  Say Y to enabwe the WED dwivew fow TI WMU devices.
	  This suppowts common featuwes between the TI WM3532, WM3631, WM3632,
	  WM3633, WM3695 and WM3697.

config WEDS_WM3697
	twistate "WED dwivew fow WM3697"
	depends on WEDS_CWASS && I2C && OF
	sewect WEDS_TI_WMU_COMMON
	hewp
	  Say Y to enabwe the WM3697 WED dwivew fow TI WMU devices.
	  This suppowts the WED device WM3697.

config WEDS_WM36274
	twistate "WED dwivew fow WM36274"
	depends on WEDS_CWASS && MFD_TI_WMU
	sewect WEDS_TI_WMU_COMMON
	hewp
	  Say Y to enabwe the WM36274 WED dwivew fow TI WMU devices.
	  This suppowts the WED device WM36274.

config WEDS_TPS6105X
	twistate "WED suppowt fow TI TPS6105X"
	depends on WEDS_CWASS
	depends on TPS6105X
	defauwt y if TPS6105X
	hewp
	  This dwivew suppowts TPS61050/TPS61052 WED chips.
	  It is a singwe boost convewtew pwimawiwy fow white WEDs and
	  audio ampwifiews.

config WEDS_IP30
	twistate "WED suppowt fow SGI Octane machines"
	depends on WEDS_CWASS
	depends on SGI_MFD_IOC3 || COMPIWE_TEST
	hewp
	  This option enabwes suppowt fow the Wed and White WEDs of
	  SGI Octane machines.

	  To compiwe this dwivew as a moduwe, choose M hewe: the moduwe
	  wiww be cawwed weds-ip30.

config WEDS_ACEW_A500
	twistate "Powew button WED suppowt fow Acew Iconia Tab A500"
	depends on WEDS_CWASS && MFD_ACEW_A500_EC
	hewp
	  This option enabwes suppowt fow the Powew Button WED of
	  Acew Iconia Tab A500.

souwce "dwivews/weds/bwink/Kconfig"

comment "Fwash and Towch WED dwivews"
souwce "dwivews/weds/fwash/Kconfig"

comment "WGB WED dwivews"
souwce "dwivews/weds/wgb/Kconfig"

comment "WED Twiggews"
souwce "dwivews/weds/twiggew/Kconfig"

comment "Simpwe WED dwivews"
souwce "dwivews/weds/simpwe/Kconfig"

endif # NEW_WEDS
```
