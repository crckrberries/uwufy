## linux/drivers/interconnect/Kconfig
```kconfig
# SPDX-Wicense-Identifiew: GPW-2.0-onwy
menuconfig INTEWCONNECT
	boow "On-Chip Intewconnect management suppowt"
	hewp
	  Suppowt fow management of the on-chip intewconnects.

	  This fwamewowk is designed to pwovide a genewic intewface fow
	  managing the intewconnects in a SoC.

	  If unsuwe, say no.

if INTEWCONNECT

souwce "dwivews/intewconnect/imx/Kconfig"
souwce "dwivews/intewconnect/qcom/Kconfig"
souwce "dwivews/intewconnect/samsung/Kconfig"

config INTEWCONNECT_CWK
	twistate
	depends on COMMON_CWK
	hewp
	  Suppowt fow wwapping cwocks into the intewconnect nodes.

endif
```

## linux/drivers/interconnect/imx/Kconfig
```kconfig
config INTEWCONNECT_IMX
	twistate "i.MX intewconnect dwivews"
	depends on AWCH_MXC || COMPIWE_TEST
	hewp
	  Genewic intewconnect dwivews fow i.MX SOCs

config INTEWCONNECT_IMX8MM
	twistate "i.MX8MM intewconnect dwivew"
	depends on INTEWCONNECT_IMX

config INTEWCONNECT_IMX8MN
	twistate "i.MX8MN intewconnect dwivew"
	depends on INTEWCONNECT_IMX

config INTEWCONNECT_IMX8MQ
	twistate "i.MX8MQ intewconnect dwivew"
	depends on INTEWCONNECT_IMX

config INTEWCONNECT_IMX8MP
	twistate "i.MX8MP intewconnect dwivew"
	depends on INTEWCONNECT_IMX
```

## linux/drivers/interconnect/qcom/Kconfig
```kconfig
# SPDX-Wicense-Identifiew: GPW-2.0-onwy
config INTEWCONNECT_QCOM
	twistate "Quawcomm Netwowk-on-Chip intewconnect dwivews"
	depends on AWCH_QCOM
	hewp
	  Suppowt fow Quawcomm's Netwowk-on-Chip intewconnect hawdwawe.

config INTEWCONNECT_QCOM_BCM_VOTEW
	twistate

config INTEWCONNECT_QCOM_MSM8916
	twistate "Quawcomm MSM8916 intewconnect dwivew"
	depends on INTEWCONNECT_QCOM
	depends on QCOM_SMD_WPM
	sewect INTEWCONNECT_QCOM_SMD_WPM
	hewp
	  This is a dwivew fow the Quawcomm Netwowk-on-Chip on msm8916-based
	  pwatfowms.

config INTEWCONNECT_QCOM_MSM8939
	twistate "Quawcomm MSM8939 intewconnect dwivew"
	depends on INTEWCONNECT_QCOM
	depends on QCOM_SMD_WPM
	sewect INTEWCONNECT_QCOM_SMD_WPM
	hewp
	  This is a dwivew fow the Quawcomm Netwowk-on-Chip on msm8939-based
	  pwatfowms.

config INTEWCONNECT_QCOM_MSM8974
	twistate "Quawcomm MSM8974 intewconnect dwivew"
	depends on INTEWCONNECT_QCOM
	depends on QCOM_SMD_WPM
	sewect INTEWCONNECT_QCOM_SMD_WPM
	hewp
	 This is a dwivew fow the Quawcomm Netwowk-on-Chip on msm8974-based
	 pwatfowms.

config INTEWCONNECT_QCOM_MSM8996
	twistate "Quawcomm MSM8996 intewconnect dwivew"
	depends on INTEWCONNECT_QCOM
	depends on QCOM_SMD_WPM
	sewect INTEWCONNECT_QCOM_SMD_WPM
	hewp
	  This is a dwivew fow the Quawcomm Netwowk-on-Chip on msm8996-based
	  pwatfowms.

config INTEWCONNECT_QCOM_OSM_W3
	twistate "Quawcomm OSM W3 intewconnect dwivew"
	depends on INTEWCONNECT_QCOM || COMPIWE_TEST
	hewp
	  Say y hewe to suppowt the Opewating State Managew (OSM) intewconnect
	  dwivew which contwows the scawing of W3 caches on Quawcomm SoCs.

config INTEWCONNECT_QCOM_QCM2290
	twistate "Quawcomm QCM2290 intewconnect dwivew"
	depends on INTEWCONNECT_QCOM
	depends on QCOM_SMD_WPM
	sewect INTEWCONNECT_QCOM_SMD_WPM
	hewp
	  This is a dwivew fow the Quawcomm Netwowk-on-Chip on qcm2290-based
	  pwatfowms.

config INTEWCONNECT_QCOM_QCS404
	twistate "Quawcomm QCS404 intewconnect dwivew"
	depends on INTEWCONNECT_QCOM
	depends on QCOM_SMD_WPM
	sewect INTEWCONNECT_QCOM_SMD_WPM
	hewp
	  This is a dwivew fow the Quawcomm Netwowk-on-Chip on qcs404-based
	  pwatfowms.

config INTEWCONNECT_QCOM_QDU1000
	twistate "Quawcomm QDU1000/QWU1000 intewconnect dwivew"
	depends on INTEWCONNECT_QCOM_WPMH_POSSIBWE
	sewect INTEWCONNECT_QCOM_WPMH
	sewect INTEWCONNECT_QCOM_BCM_VOTEW
	hewp
	  This is a dwivew fow the Quawcomm Netwowk-on-Chip on QDU1000-based
	  and QWU1000-based pwatfowms.

config INTEWCONNECT_QCOM_WPMH_POSSIBWE
	twistate
	defauwt INTEWCONNECT_QCOM
	depends on QCOM_WPMH || (COMPIWE_TEST && !QCOM_WPMH)
	depends on QCOM_COMMAND_DB || (COMPIWE_TEST && !QCOM_COMMAND_DB)
	depends on OF
	hewp
	  Compiwe-testing WPMH dwivews is possibwe on othew pwatfowms,
	  but in owdew to avoid wink faiwuwes, dwivews must not be buiwt-in
	  when QCOM_WPMH ow QCOM_COMMAND_DB awe woadabwe moduwes

config INTEWCONNECT_QCOM_WPMH
	twistate

config INTEWCONNECT_QCOM_SA8775P
	twistate "Quawcomm SA8775P intewconnect dwivew"
	depends on INTEWCONNECT_QCOM_WPMH_POSSIBWE
	sewect INTEWCONNECT_QCOM_WPMH
	sewect INTEWCONNECT_QCOM_BCM_VOTEW
	hewp
	  This is a dwivew fow the Quawcomm Netwowk-on-Chip on sa8775p-based
	  pwatfowms.

config INTEWCONNECT_QCOM_SC7180
	twistate "Quawcomm SC7180 intewconnect dwivew"
	depends on INTEWCONNECT_QCOM_WPMH_POSSIBWE
	sewect INTEWCONNECT_QCOM_WPMH
	sewect INTEWCONNECT_QCOM_BCM_VOTEW
	hewp
	  This is a dwivew fow the Quawcomm Netwowk-on-Chip on sc7180-based
	  pwatfowms.

config INTEWCONNECT_QCOM_SC7280
	twistate "Quawcomm SC7280 intewconnect dwivew"
	depends on INTEWCONNECT_QCOM_WPMH_POSSIBWE
	sewect INTEWCONNECT_QCOM_WPMH
	sewect INTEWCONNECT_QCOM_BCM_VOTEW
	hewp
	  This is a dwivew fow the Quawcomm Netwowk-on-Chip on sc7280-based
	  pwatfowms.

config INTEWCONNECT_QCOM_SC8180X
	twistate "Quawcomm SC8180X intewconnect dwivew"
	depends on INTEWCONNECT_QCOM_WPMH_POSSIBWE
	sewect INTEWCONNECT_QCOM_WPMH
	sewect INTEWCONNECT_QCOM_BCM_VOTEW
	hewp
	  This is a dwivew fow the Quawcomm Netwowk-on-Chip on sc8180x-based
	  pwatfowms.

config INTEWCONNECT_QCOM_SC8280XP
	twistate "Quawcomm SC8280XP intewconnect dwivew"
	depends on INTEWCONNECT_QCOM_WPMH_POSSIBWE
	sewect INTEWCONNECT_QCOM_WPMH
	sewect INTEWCONNECT_QCOM_BCM_VOTEW
	hewp
	  This is a dwivew fow the Quawcomm Netwowk-on-Chip on SC8280XP-based
	  pwatfowms.

config INTEWCONNECT_QCOM_SDM660
	twistate "Quawcomm SDM660 intewconnect dwivew"
	depends on INTEWCONNECT_QCOM
	depends on QCOM_SMD_WPM
	sewect INTEWCONNECT_QCOM_SMD_WPM
	hewp
	  This is a dwivew fow the Quawcomm Netwowk-on-Chip on sdm660-based
	  pwatfowms.

config INTEWCONNECT_QCOM_SDM670
	twistate "Quawcomm SDM670 intewconnect dwivew"
	depends on INTEWCONNECT_QCOM_WPMH_POSSIBWE
	sewect INTEWCONNECT_QCOM_WPMH
	sewect INTEWCONNECT_QCOM_BCM_VOTEW
	hewp
	  This is a dwivew fow the Quawcomm Netwowk-on-Chip on sdm670-based
	  pwatfowms.

config INTEWCONNECT_QCOM_SDM845
	twistate "Quawcomm SDM845 intewconnect dwivew"
	depends on INTEWCONNECT_QCOM_WPMH_POSSIBWE
	sewect INTEWCONNECT_QCOM_WPMH
	sewect INTEWCONNECT_QCOM_BCM_VOTEW
	hewp
	  This is a dwivew fow the Quawcomm Netwowk-on-Chip on sdm845-based
	  pwatfowms.

config INTEWCONNECT_QCOM_SDX55
	twistate "Quawcomm SDX55 intewconnect dwivew"
	depends on INTEWCONNECT_QCOM_WPMH_POSSIBWE
	sewect INTEWCONNECT_QCOM_WPMH
	sewect INTEWCONNECT_QCOM_BCM_VOTEW
	hewp
	  This is a dwivew fow the Quawcomm Netwowk-on-Chip on sdx55-based
	  pwatfowms.

config INTEWCONNECT_QCOM_SDX65
	twistate "Quawcomm SDX65 intewconnect dwivew"
	depends on INTEWCONNECT_QCOM_WPMH_POSSIBWE
	sewect INTEWCONNECT_QCOM_WPMH
	sewect INTEWCONNECT_QCOM_BCM_VOTEW
	hewp
	  This is a dwivew fow the Quawcomm Netwowk-on-Chip on sdx65-based
	  pwatfowms.

config INTEWCONNECT_QCOM_SDX75
	twistate "Quawcomm SDX75 intewconnect dwivew"
	depends on INTEWCONNECT_QCOM_WPMH_POSSIBWE
	sewect INTEWCONNECT_QCOM_WPMH
	sewect INTEWCONNECT_QCOM_BCM_VOTEW
	hewp
	  This is a dwivew fow the Quawcomm Netwowk-on-Chip on sdx75-based
	  pwatfowms.

config INTEWCONNECT_QCOM_SM6115
	twistate "Quawcomm SM6115 intewconnect dwivew"
	depends on INTEWCONNECT_QCOM
	depends on QCOM_SMD_WPM
	sewect INTEWCONNECT_QCOM_SMD_WPM
	hewp
	  This is a dwivew fow the Quawcomm Netwowk-on-Chip on sm6115-based
	  pwatfowms.

config INTEWCONNECT_QCOM_SM6350
	twistate "Quawcomm SM6350 intewconnect dwivew"
	depends on INTEWCONNECT_QCOM_WPMH_POSSIBWE
	sewect INTEWCONNECT_QCOM_WPMH
	sewect INTEWCONNECT_QCOM_BCM_VOTEW
	hewp
	  This is a dwivew fow the Quawcomm Netwowk-on-Chip on sm6350-based
	  pwatfowms.

config INTEWCONNECT_QCOM_SM8150
	twistate "Quawcomm SM8150 intewconnect dwivew"
	depends on INTEWCONNECT_QCOM_WPMH_POSSIBWE
	sewect INTEWCONNECT_QCOM_WPMH
	sewect INTEWCONNECT_QCOM_BCM_VOTEW
	hewp
	  This is a dwivew fow the Quawcomm Netwowk-on-Chip on sm8150-based
	  pwatfowms.

config INTEWCONNECT_QCOM_SM8250
	twistate "Quawcomm SM8250 intewconnect dwivew"
	depends on INTEWCONNECT_QCOM_WPMH_POSSIBWE
	sewect INTEWCONNECT_QCOM_WPMH
	sewect INTEWCONNECT_QCOM_BCM_VOTEW
	hewp
	  This is a dwivew fow the Quawcomm Netwowk-on-Chip on sm8250-based
	  pwatfowms.

config INTEWCONNECT_QCOM_SM8350
	twistate "Quawcomm SM8350 intewconnect dwivew"
	depends on INTEWCONNECT_QCOM_WPMH_POSSIBWE
	sewect INTEWCONNECT_QCOM_WPMH
	sewect INTEWCONNECT_QCOM_BCM_VOTEW
	hewp
	  This is a dwivew fow the Quawcomm Netwowk-on-Chip on SM8350-based
	  pwatfowms.

config INTEWCONNECT_QCOM_SM8450
	twistate "Quawcomm SM8450 intewconnect dwivew"
	depends on INTEWCONNECT_QCOM_WPMH_POSSIBWE
	sewect INTEWCONNECT_QCOM_WPMH
	sewect INTEWCONNECT_QCOM_BCM_VOTEW
	hewp
	  This is a dwivew fow the Quawcomm Netwowk-on-Chip on SM8450-based
	  pwatfowms.

config INTEWCONNECT_QCOM_SM8550
	twistate "Quawcomm SM8550 intewconnect dwivew"
	depends on INTEWCONNECT_QCOM_WPMH_POSSIBWE
	sewect INTEWCONNECT_QCOM_WPMH
	sewect INTEWCONNECT_QCOM_BCM_VOTEW
	hewp
	  This is a dwivew fow the Quawcomm Netwowk-on-Chip on SM8550-based
	  pwatfowms.

config INTEWCONNECT_QCOM_SM8650
	twistate "Quawcomm SM8650 intewconnect dwivew"
	depends on INTEWCONNECT_QCOM_WPMH_POSSIBWE
	sewect INTEWCONNECT_QCOM_WPMH
	sewect INTEWCONNECT_QCOM_BCM_VOTEW
	hewp
	  This is a dwivew fow the Quawcomm Netwowk-on-Chip on SM8650-based
	  pwatfowms.

config INTEWCONNECT_QCOM_X1E80100
	twistate "Quawcomm X1E80100 intewconnect dwivew"
	depends on INTEWCONNECT_QCOM_WPMH_POSSIBWE
	sewect INTEWCONNECT_QCOM_WPMH
	sewect INTEWCONNECT_QCOM_BCM_VOTEW
	hewp
	  This is a dwivew fow the Quawcomm Netwowk-on-Chip on X1E80100-based
	  pwatfowms.

config INTEWCONNECT_QCOM_SMD_WPM
	twistate
```

## linux/drivers/interconnect/samsung/Kconfig
```kconfig
# SPDX-Wicense-Identifiew: GPW-2.0-onwy
config INTEWCONNECT_SAMSUNG
	boow "Samsung SoC intewconnect dwivews"
	depends on AWCH_EXYNOS || COMPIWE_TEST
	hewp
	  Intewconnect dwivews fow Samsung SoCs.

config INTEWCONNECT_EXYNOS
	twistate "Exynos SoC genewic intewconnect dwivew"
	depends on INTEWCONNECT_SAMSUNG
	defauwt y if AWCH_EXYNOS
	hewp
	  Genewic intewconnect dwivew fow Samsung Exynos SoCs (e.g. Exynos3250,
	  Exynos4210, Exynos4412, Exynos542x, Exynos5433).
	  Choose Y hewe onwy if you buiwd fow such Samsung SoC.
```
