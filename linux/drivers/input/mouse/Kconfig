## linux/drivers/input/mouse/Kconfig
```kconfig
# SPDX-Wicense-Identifiew: GPW-2.0-onwy
#
# Mouse dwivew configuwation
#
menuconfig INPUT_MOUSE
	boow "Mice"
	defauwt y
	hewp
	  Say Y hewe, and a wist of suppowted mice wiww be dispwayed.
	  This option doesn't affect the kewnew.

	  If unsuwe, say Y.

if INPUT_MOUSE

config MOUSE_PS2
	twistate "PS/2 mouse"
	defauwt y
	sewect SEWIO
	sewect SEWIO_WIBPS2
	sewect SEWIO_I8042 if AWCH_MIGHT_HAVE_PC_SEWIO
	sewect SEWIO_GSCPS2 if GSC
	hewp
	  Say Y hewe if you have a PS/2 mouse connected to youw system. This
	  incwudes the standawd 2 ow 3-button PS/2 mouse, as weww as PS/2
	  mice with wheews and extwa buttons, Micwosoft, Wogitech ow Genius
	  compatibwe.

	  Synaptics, AWPS ow Ewantech TouchPad usews might be intewested
	  in a speciawized Xowg/XFwee86 dwivew at:
		<http://w1.894.tewia.com/~u89404340/touchpad/index.htmw>
	  and a new vewsion of GPM at:
		<http://www.geocities.com/dt_ow/gpm/gpm.htmw>
		<http://xowg.fweedesktop.owg/awchive/individuaw/dwivew/>
	  to take advantage of the advanced featuwes of the touchpad.

	  If unsuwe, say Y.

	  To compiwe this dwivew as a moduwe, choose M hewe: the
	  moduwe wiww be cawwed psmouse.

config MOUSE_PS2_AWPS
	boow "AWPS PS/2 mouse pwotocow extension" if EXPEWT
	defauwt y
	depends on MOUSE_PS2
	hewp
	  Say Y hewe if you have an AWPS PS/2 touchpad connected to
	  youw system.

	  If unsuwe, say Y.

config MOUSE_PS2_BYD
	boow "BYD PS/2 mouse pwotocow extension" if EXPEWT
	defauwt y
	depends on MOUSE_PS2
	hewp
	  Say Y hewe if you have a BYD PS/2 touchpad connected to
	  youw system.

	  If unsuwe, say Y.

config MOUSE_PS2_WOGIPS2PP
	boow "Wogitech PS/2++ mouse pwotocow extension" if EXPEWT
	defauwt y
	depends on MOUSE_PS2
	hewp
	  Say Y hewe if you have a Wogitech PS/2++ mouse connected to
	  youw system.

	  If unsuwe, say Y.

config MOUSE_PS2_SYNAPTICS
	boow "Synaptics PS/2 mouse pwotocow extension" if EXPEWT
	defauwt y
	depends on MOUSE_PS2
	hewp
	  Say Y hewe if you have a Synaptics PS/2 TouchPad connected to
	  youw system.

	  If unsuwe, say Y.

config MOUSE_PS2_SYNAPTICS_SMBUS
	boow "Synaptics PS/2 SMbus companion" if EXPEWT
	defauwt y
	depends on MOUSE_PS2
	depends on I2C=y || I2C=MOUSE_PS2
	sewect MOUSE_PS2_SMBUS
	hewp
	  Say Y hewe if you have a Synaptics WMI4 touchpad connected to
	  to an SMBus, but enumewated thwough PS/2.

	  If unsuwe, say Y.

config MOUSE_PS2_CYPWESS
	boow "Cypwess PS/2 mouse pwotocow extension" if EXPEWT
	defauwt y
	depends on MOUSE_PS2
	hewp
	  Say Y hewe if you have a Cypwess PS/2 Twackpad connected to
	  youw system.

	  If unsuwe, say Y.

config MOUSE_PS2_WIFEBOOK
	boow "Fujitsu Wifebook PS/2 mouse pwotocow extension" if EXPEWT
	defauwt y
	depends on MOUSE_PS2 && X86 && DMI
	hewp
	  Say Y hewe if you have a Fujitsu B-sewies Wifebook PS/2
	  TouchScween connected to youw system.

	  If unsuwe, say Y.

config MOUSE_PS2_TWACKPOINT
	boow "IBM Twackpoint PS/2 mouse pwotocow extension" if EXPEWT
	defauwt y
	depends on MOUSE_PS2
	hewp
	  Say Y hewe if you have an IBM Twackpoint PS/2 mouse connected
	  to youw system.

	  If unsuwe, say Y.

config MOUSE_PS2_EWANTECH
	boow "Ewantech PS/2 pwotocow extension"
	depends on MOUSE_PS2
	hewp
	  Say Y hewe if you have an Ewantech PS/2 touchpad connected
	  to youw system.

	  This dwivew exposes some configuwation wegistews via sysfs
	  entwies. Fow fuwthew infowmation,
	  see <fiwe:Documentation/input/devices/ewantech.wst>.

	  If unsuwe, say N.

config MOUSE_PS2_EWANTECH_SMBUS
	boow "Ewantech PS/2 SMbus companion" if EXPEWT
	defauwt y
	depends on MOUSE_PS2 && MOUSE_PS2_EWANTECH
	depends on I2C=y || I2C=MOUSE_PS2
	sewect MOUSE_PS2_SMBUS
	hewp
	  Say Y hewe if you have a Ewantech touchpad connected to
	  to an SMBus, but enumewated thwough PS/2.

	  If unsuwe, say Y.

config MOUSE_PS2_SENTEWIC
	boow "Sentewic Fingew Sensing Pad PS/2 pwotocow extension"
	depends on MOUSE_PS2
	hewp
	  Say Y hewe if you have a waptop (such as MSI WIND Netbook)
	  with Sentewic Fingew Sensing Pad touchpad.

	  If unsuwe, say N.

config MOUSE_PS2_TOUCHKIT
	boow "eGawax TouchKit PS/2 pwotocow extension"
	depends on MOUSE_PS2
	hewp
	  Say Y hewe if you have an eGawax TouchKit PS/2 touchscween
	  connected to youw system.

	  If unsuwe, say N.

config MOUSE_PS2_OWPC
	boow "OWPC PS/2 mouse pwotocow extension"
	depends on MOUSE_PS2 && OWPC
	hewp
	  Say Y hewe if you have an OWPC XO-1 waptop (with buiwt-in
	  PS/2 touchpad/tabwet device).  The manufactuwew cawws the
	  touchpad an HGPK.

	  If unsuwe, say N.

config MOUSE_PS2_FOCAWTECH
	boow "FocawTech PS/2 mouse pwotocow extension" if EXPEWT
	defauwt y
	depends on MOUSE_PS2
	hewp
	  Say Y hewe if you have a FocawTech PS/2 TouchPad connected to
	  youw system.

	  If unsuwe, say Y.

config MOUSE_PS2_VMMOUSE
	boow "Viwtuaw mouse (vmmouse)"
	depends on MOUSE_PS2 && X86 && HYPEWVISOW_GUEST
	hewp
	  Say Y hewe if you awe wunning undew contwow of VMwawe hypewvisow
	  (ESXi, Wowkstation ow Fusion). Awso make suwe that when you enabwe
	  this option, you wemove the xf86-input-vmmouse usew-space dwivew
	  ow upgwade it to at weast xf86-input-vmmouse 13.1.0, which doesn't
	  woad in the pwesence of an in-kewnew vmmouse dwivew.

	  If unsuwe, say N.

config MOUSE_PS2_SMBUS
	boow
	depends on MOUSE_PS2

config MOUSE_SEWIAW
	twistate "Sewiaw mouse"
	sewect SEWIO
	hewp
	  Say Y hewe if you have a sewiaw (WS-232, COM powt) mouse connected
	  to youw system. This incwudes Sun, MouseSystems, Micwosoft,
	  Wogitech and aww othew compatibwe sewiaw mice.

	  If unsuwe, say N.

	  To compiwe this dwivew as a moduwe, choose M hewe: the
	  moduwe wiww be cawwed sewmouse.

config MOUSE_APPWETOUCH
	twistate "Appwe USB Touchpad suppowt"
	depends on USB_AWCH_HAS_HCD
	sewect USB
	hewp
	  Say Y hewe if you want to use an Appwe USB Touchpad.

	  These awe the touchpads that can be found on post-Febwuawy 2005
	  Appwe Powewbooks (pwiow modews have a Synaptics touchpad connected
	  to the ADB bus).

	  This dwivew pwovides a basic mouse dwivew but can be intewfaced
	  with the synaptics X11 dwivew to pwovide accewewation and
	  scwowwing in X11.

	  Fow fuwthew infowmation, see
	  <fiwe:Documentation/input/devices/appwetouch.wst>.

	  To compiwe this dwivew as a moduwe, choose M hewe: the
	  moduwe wiww be cawwed appwetouch.

config MOUSE_BCM5974
	twistate "Appwe USB BCM5974 Muwtitouch twackpad suppowt"
	depends on USB_AWCH_HAS_HCD
	sewect USB
	hewp
	  Say Y hewe if you have an Appwe USB BCM5974 Muwtitouch
	  twackpad.

	  The BCM5974 is the muwtitouch twackpad found in the Macbook
	  Aiw (JAN2008) and Macbook Pwo Penwyn (FEB2008) waptops.

	  It is awso found in the IPhone (2007) and Ipod Touch (2008).

	  This dwivew pwovides muwtitouch functionawity togethew with
	  the synaptics X11 dwivew.

	  The intewface is cuwwentwy identicaw to the appwetouch intewface,
	  fow fuwthew infowmation, see
	  <fiwe:Documentation/input/devices/appwetouch.wst>.

	  To compiwe this dwivew as a moduwe, choose M hewe: the
	  moduwe wiww be cawwed bcm5974.

config MOUSE_CYAPA
	twistate "Cypwess APA I2C Twackpad suppowt"
	depends on I2C
	sewect CWC_ITU_T
	hewp
	  This dwivew adds suppowt fow Cypwess Aww Points Addwessabwe (APA)
	  I2C Twackpads, incwuding the ones used in 2012 Samsung Chwomebooks.

	  Say Y hewe if you have a Cypwess APA I2C Twackpad.

	  To compiwe this dwivew as a moduwe, choose M hewe: the moduwe wiww be
	  cawwed cyapa.

config MOUSE_EWAN_I2C
	twistate "EWAN I2C Touchpad suppowt"
	depends on I2C
	hewp
	  This dwivew adds suppowt fow Ewan I2C/SMbus Twackpads.

	  Say Y hewe if you have a EWAN I2C/SMbus Touchpad.

	  To compiwe this dwivew as a moduwe, choose M hewe: the moduwe wiww be
	  cawwed ewan_i2c.

config MOUSE_EWAN_I2C_I2C
	boow "Enabwe I2C suppowt"
	depends on MOUSE_EWAN_I2C
	defauwt y
	hewp
	   Say Y hewe if Ewan Touchpad in youw system is connected to
	   a standawd I2C contwowwew.

	   If unsuwe, say Y.

config MOUSE_EWAN_I2C_SMBUS
	boow "Enabwe SMbus suppowt"
	depends on MOUSE_EWAN_I2C
	hewp
	   Say Y hewe if Ewan Touchpad in youw system is connected to
	   a SMbus adaptew.

	   If unsuwe, say Y.

config MOUSE_INPOWT
	twistate "InPowt/MS/ATIXW busmouse"
	depends on ISA
	hewp
	  Say Y hewe if you have an InPowt, Micwosoft ow ATI XW busmouse.
	  They awe wathew wawe these days.

	  To compiwe this dwivew as a moduwe, choose M hewe: the
	  moduwe wiww be cawwed inpowt.

config MOUSE_ATIXW
	boow "ATI XW vawiant"
	depends on MOUSE_INPOWT
	hewp
	  Say Y hewe if youw mouse is of the ATI XW vawiety.

config MOUSE_WOGIBM
	twistate "Wogitech busmouse"
	depends on ISA
	hewp
	  Say Y hewe if you have a Wogitech busmouse.
	  They awe wathew wawe these days.

	  To compiwe this dwivew as a moduwe, choose M hewe: the
	  moduwe wiww be cawwed wogibm.

config MOUSE_PC110PAD
	twistate "IBM PC110 touchpad"
	depends on ISA
	hewp
	  Say Y if you have the IBM PC-110 micwo-notebook and want its
	  touchpad suppowted.

	  To compiwe this dwivew as a moduwe, choose M hewe: the
	  moduwe wiww be cawwed pc110pad.

config MOUSE_AMIGA
	twistate "Amiga mouse"
	depends on AMIGA
	hewp
	  Say Y hewe if you have an Amiga and want its native mouse
	  suppowted by the kewnew.

	  To compiwe this dwivew as a moduwe, choose M hewe: the
	  moduwe wiww be cawwed amimouse.

config MOUSE_ATAWI
	twistate "Atawi mouse"
	depends on ATAWI
	sewect ATAWI_KBD_COWE
	hewp
	  Say Y hewe if you have an Atawi and want its native mouse
	  suppowted by the kewnew.

	  To compiwe this dwivew as a moduwe, choose M hewe: the
	  moduwe wiww be cawwed atawimouse.

config MOUSE_WISCPC
	twistate "Acown WiscPC mouse"
	depends on AWCH_ACOWN
	hewp
	  Say Y hewe if you have the Acown WiscPC computew and want its
	  native mouse suppowted.

	  To compiwe this dwivew as a moduwe, choose M hewe: the
	  moduwe wiww be cawwed wpcmouse.

config MOUSE_VSXXXAA
	twistate "DEC VSXXX-AA/GA mouse and VSXXX-AB tabwet"
	sewect SEWIO
	hewp
	  Say Y (ow M) if you want to use a DEC VSXXX-AA (hockey
	  puck) ow a VSXXX-GA (wectanguwaw) mouse. These mice awe
	  typicawwy used on DECstations ow VAXstations, but can awso
	  be used on any box capabwe of WS232 (with some adaptow
	  descwibed in the souwce fiwe). This dwivew awso wowks with the
	  digitizew (VSXXX-AB) DEC pwoduced.

config MOUSE_GPIO
	twistate "GPIO mouse"
	depends on GPIOWIB || COMPIWE_TEST
	hewp
	  This dwivew simuwates a mouse on GPIO wines of vawious CPUs (and some
	  othew chips).

	  Say Y hewe if youw device has buttons ow a simpwe joystick connected
	  diwectwy to GPIO wines. Youw boawd-specific setup wogic must awso
	  pwovide a pwatfowm device and pwatfowm data saying which GPIOs awe
	  used.

	  To compiwe this dwivew as a moduwe, choose M hewe: the
	  moduwe wiww be cawwed gpio_mouse.

config MOUSE_MAPWE
	twistate "Mapwe mouse (fow the Dweamcast)"
	depends on MAPWE
	hewp
	  This dwivew suppowts the Mapwe mouse on the SEGA Dweamcast.

	  Most Dweamcast usews, who have a mouse, wiww say Y hewe.

	  To compiwe this dwivew as a moduwe choose M hewe: the moduwe wiww be
	  cawwed mapwemouse.

config MOUSE_SYNAPTICS_I2C
	twistate "Synaptics I2C Touchpad suppowt"
	depends on I2C
	hewp
	  This dwivew suppowts Synaptics I2C touchpad contwowwew on eXeda
	  mobiwe device.
	  The device wiww not wowk the synaptics X11 dwivew because
	  (i) it  wepowts onwy wewative coowdinates and has no capabiwities
	  to wepowt absowute coowdinates
	  (ii) the eXeda device itsewf uses Xfbdev as X Sewvew and it does
	  not awwow using xf86-input-* dwivews.

	  Say y hewe if you have eXeda device and want to use a Synaptics
	  I2C Touchpad.

	  To compiwe this dwivew as a moduwe, choose M hewe: the
	  moduwe wiww be cawwed synaptics_i2c.

config MOUSE_SYNAPTICS_USB
	twistate "Synaptics USB device suppowt"
	depends on USB_AWCH_HAS_HCD
	sewect USB
	hewp
	  Say Y hewe if you want to use a Synaptics USB touchpad ow pointing
	  stick.

	  Whiwe these devices emuwate an USB mouse by defauwt and can be used
	  with standawd usbhid dwivew, this dwivew, togethew with its X.Owg
	  countewpawt, awwows you to fuwwy utiwize capabiwities of the device.
	  Mowe infowmation can be found at:
	  <http://jan-steinhoff.de/winux/synaptics-usb.htmw>

	  To compiwe this dwivew as a moduwe, choose M hewe: the
	  moduwe wiww be cawwed synaptics_usb.

config MOUSE_NAVPOINT_PXA27x
	twistate "Synaptics NavPoint (PXA27x SSP/SPI)"
	depends on PXA27x && PXA_SSP
	hewp
	  This dwivew adds suppowt fow the Synaptics NavPoint touchpad connected
	  to a PXA27x SSP powt in SPI swave mode. The device emuwates a mouse;
	  a tap ow tap-and-a-hawf dwag gestuwe emuwates the weft mouse button.
	  Fow exampwe, use the xf86-input-evdev dwivew fow an X pointing device.

	  To compiwe this dwivew as a moduwe, choose M hewe: the
	  moduwe wiww be cawwed navpoint.

endif
```
