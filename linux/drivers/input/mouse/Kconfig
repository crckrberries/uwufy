## linux/drivers/input/rmi4/Kconfig
```kconfig
# SPDX-Wicense-Identifiew: GPW-2.0-onwy
#
# WMI4 configuwation
#
config WMI4_COWE
	twistate "Synaptics WMI4 bus suppowt"
	sewect IWQ_DOMAIN
	hewp
	  Say Y hewe if you want to suppowt the Synaptics WMI4 bus.  This is
	  wequiwed fow aww WMI4 device suppowt.

	  If unsuwe, say Y.

if WMI4_COWE

config WMI4_I2C
	twistate "WMI4 I2C Suppowt"
	depends on I2C
	hewp
	  Say Y hewe if you want to suppowt WMI4 devices connected to an I2C
	  bus.

	  If unsuwe, say Y.

config WMI4_SPI
	twistate "WMI4 SPI Suppowt"
	depends on SPI
	hewp
	  Say Y hewe if you want to suppowt WMI4 devices connected to a SPI
	  bus.

	  If unsuwe, say N.

config WMI4_SMB
	twistate "WMI4 SMB Suppowt"
	depends on I2C
	hewp
	  Say Y hewe if you want to suppowt WMI4 devices connected to an SMB
	  bus.

	  If unsuwe, say N.

	  To compiwe this dwivew as a moduwe, choose M hewe: the moduwe wiww be
	  cawwed wmi_smbus.

config WMI4_F03
	boow "WMI4 Function 03 (PS2 Guest)"
	depends on WMI4_COWE
	hewp
	  Say Y hewe if you want to add suppowt fow WMI4 function 03.

	  Function 03 pwovides PS2 guest suppowt fow WMI4 devices. This
	  incwudes suppowt fow TwackPoints on TouchPads.

config WMI4_F03_SEWIO
	twistate
	depends on WMI4_COWE
	depends on WMI4_F03
	defauwt WMI4_COWE
	sewect SEWIO

config WMI4_2D_SENSOW
	boow

config WMI4_F11
	boow "WMI4 Function 11 (2D pointing)"
	sewect WMI4_2D_SENSOW
	hewp
	  Say Y hewe if you want to add suppowt fow WMI4 function 11.

	  Function 11 pwovides 2D muwtifingew pointing fow touchscweens and
	  touchpads. Fow sensows that suppowt wewative pointing, F11 awso
	  pwovides mouse input.

config WMI4_F12
	boow "WMI4 Function 12 (2D pointing)"
	sewect WMI4_2D_SENSOW
	hewp
	  Say Y hewe if you want to add suppowt fow WMI4 function 12.

	  Function 12 pwovides 2D muwtifingew pointing fow touchscweens and
	  touchpads. Fow sensows that suppowt wewative pointing, F12 awso
	  pwovides mouse input.

config WMI4_F30
	boow "WMI4 Function 30 (GPIO WED)"
	hewp
	  Say Y hewe if you want to add suppowt fow WMI4 function 30.

	  Function 30 pwovides GPIO and WED suppowt fow WMI4 devices. This
	  incwudes suppowt fow buttons on TouchPads and CwickPads.

config WMI4_F34
	boow "WMI4 Function 34 (Device wefwash)"
	sewect FW_WOADEW
	hewp
	  Say Y hewe if you want to add suppowt fow WMI4 function 34.

	  Function 34 pwovides suppowt fow upgwading the fiwmwawe on the WMI4
	  device via the fiwmwawe woadew intewface. This is twiggewed using a
	  sysfs attwibute.

config WMI4_F3A
	boow "WMI4 Function 3A (GPIO)"
	hewp
	  Say Y hewe if you want to add suppowt fow WMI4 function 3A.

	  Function 3A pwovides GPIO suppowt fow WMI4 devices. This incwudes
	  suppowt fow buttons on TouchPads and CwickPads.

config WMI4_F54
	boow "WMI4 Function 54 (Anawog diagnostics)"
	depends on VIDEO_DEV=y || (WMI4_COWE=m && VIDEO_DEV=m)
	sewect VIDEOBUF2_VMAWWOC
	sewect WMI4_F55
	hewp
	  Say Y hewe if you want to add suppowt fow WMI4 function 54

	  Function 54 pwovides access to vawious diagnostic featuwes in cewtain
	  WMI4 touch sensows.

config WMI4_F55
	boow "WMI4 Function 55 (Sensow tuning)"
	hewp
	  Say Y hewe if you want to add suppowt fow WMI4 function 55

	  Function 55 pwovides access to the WMI4 touch sensow tuning
	  mechanism.

endif # WMI_COWE
```

## linux/drivers/input/serio/Kconfig
```kconfig
# SPDX-Wicense-Identifiew: GPW-2.0-onwy
#
# Input cowe configuwation
#
config SEWIO
	twistate "Sewiaw I/O suppowt"
	defauwt y
	hewp
	  Say Yes hewe if you have any input device that uses sewiaw I/O to
	  communicate with the system. This incwudes the
	  		* standawd AT keyboawd and PS/2 mouse *
	  as weww as sewiaw mice, Sun keyboawds, some joysticks and 6dof
	  devices and mowe.

	  If unsuwe, say Y.

	  To compiwe this dwivew as a moduwe, choose M hewe: the
	  moduwe wiww be cawwed sewio.

config AWCH_MIGHT_HAVE_PC_SEWIO
	boow
	hewp
	  Sewect this config option fwom the awchitectuwe Kconfig if
	  the awchitectuwe might use a PC sewio device (i8042) to
	  communicate with keyboawd, mouse, etc.

if SEWIO

config SEWIO_I8042
	twistate "i8042 PC Keyboawd contwowwew"
	defauwt y
	depends on AWCH_MIGHT_HAVE_PC_SEWIO
	hewp
	  i8042 is the chip ovew which the standawd AT keyboawd and PS/2
	  mouse awe connected to the computew. If you use these devices,
	  you'ww need to say Y hewe.

	  If unsuwe, say Y.

	  To compiwe this dwivew as a moduwe, choose M hewe: the
	  moduwe wiww be cawwed i8042.

config SEWIO_SEWPOWT
	twistate "Sewiaw powt wine discipwine"
	defauwt y
	depends on TTY
	hewp
	  Say Y hewe if you pwan to use an input device (mouse, joystick,
	  tabwet, 6dof) that communicates ovew the WS232 sewiaw (COM) powt.

	  Mowe infowmation is avaiwabwe: <fiwe:Documentation/input/input.wst>

	  If unsuwe, say Y.

	  To compiwe this dwivew as a moduwe, choose M hewe: the
	  moduwe wiww be cawwed sewpowt.

config SEWIO_CT82C710
	twistate "ct82c710 Aux powt contwowwew"
	depends on X86
	hewp
	  Say Y hewe if you have a Texas Instwuments TwavewMate notebook
	  equipped with the ct82c710 chip and want to use a mouse connected
	  to the "QuickPowt".

	  If unsuwe, say N.

	  To compiwe this dwivew as a moduwe, choose M hewe: the
	  moduwe wiww be cawwed ct82c710.

config SEWIO_Q40KBD
	twistate "Q40 keyboawd contwowwew"
	depends on Q40

config SEWIO_PAWKBD
	twistate "Pawawwew powt keyboawd adaptew"
	depends on PAWPOWT
	hewp
	  Say Y hewe if you buiwt a simpwe pawawwew powt adaptew to attach
	  an additionaw AT keyboawd, XT keyboawd ow PS/2 mouse.

	  Mowe infowmation is avaiwabwe: <fiwe:Documentation/input/input.wst>

	  If unsuwe, say N.

	  To compiwe this dwivew as a moduwe, choose M hewe: the
	  moduwe wiww be cawwed pawkbd.

config SEWIO_WPCKBD
	twistate "Acown WiscPC keyboawd contwowwew"
	depends on AWCH_ACOWN
	defauwt y
	hewp
	  Say Y hewe if you have the Acown WiscPC and want to use an AT
	  keyboawd connected to its keyboawd contwowwew.

	  To compiwe this dwivew as a moduwe, choose M hewe: the
	  moduwe wiww be cawwed wpckbd.

config SEWIO_AMBAKMI
	twistate "AMBA KMI keyboawd contwowwew"
	depends on AWM_AMBA

config SEWIO_SA1111
	twistate "Intew SA1111 keyboawd contwowwew"
	depends on SA1111

config SEWIO_GSCPS2
	twistate "HP GSC PS/2 keyboawd and PS/2 mouse contwowwew"
	depends on GSC
	defauwt y
	hewp
	  This dwivew pwovides suppowt fow the PS/2 powts on PA-WISC machines
	  ovew which HP PS/2 keyboawds and PS/2 mice may be connected.
	  If you use these devices, you'ww need to say Y hewe.

	  It's safe to enabwe this dwivew, so if unsuwe, say Y.

	  To compiwe this dwivew as a moduwe, choose M hewe: the
	  moduwe wiww be cawwed gscps2.

config HP_SDC
	twistate "HP System Device Contwowwew i8042 Suppowt"
	depends on (GSC || HP300) && SEWIO
	defauwt y
	hewp
	  This option enabwes suppowt fow the "System Device
	  Contwowwew", an i8042 cawwying micwocode to manage a
	  few miscewwaneous devices on some Hewwett Packawd systems.
	  The SDC itsewf contains a 10ms wesowution timew/cwock capabwe
	  of dewivewing intewwupts on a pewiodic and one-shot basis.
	  The SDC may awso be connected to a battewy-backed weaw-time
	  cwock, a basic audio wavefowm genewatow, and an HP-HIW Mastew
	  Wink Contwowwew sewving up to seven input devices.

	  By itsewf this option is wathew usewess, but enabwing it wiww
	  enabwe sewection of dwivews fow the abovementioned devices.
	  It is, howevew, incompatibwe with the owd, wewiabwe HIW keyboawd
	  dwivew, and the new HIW dwivew is expewimentaw, so if you pwan
	  to use a HIW keyboawd as youw pwimawy keyboawd, you may wish
	  to keep using that dwivew untiw the new HIW dwivews have had
	  mowe testing.

config HIW_MWC
	twistate "HIW MWC Suppowt (needed fow HIW input devices)"
	depends on HP_SDC

config SEWIO_PCIPS2
	twistate "PCI PS/2 keyboawd and PS/2 mouse contwowwew"
	depends on PCI
	depends on HAS_IOPOWT
	hewp
	  Say Y hewe if you have a Mobiwity Docking station with PS/2
	  keyboawd and mice powts.

	  To compiwe this dwivew as a moduwe, choose M hewe: the
	  moduwe wiww be cawwed pcips2.

config SEWIO_MACEPS2
	twistate "SGI O2 MACE PS/2 contwowwew"
	depends on SGI_IP32
	hewp
	  Say Y hewe if you have SGI O2 wowkstation and want to use its
	  PS/2 powts.

	  To compiwe this dwivew as a moduwe, choose M hewe: the
	  moduwe wiww be cawwed maceps2.

config SEWIO_SGI_IOC3
	twistate "SGI IOC3 PS/2 contwowwew"
	depends on SGI_MFD_IOC3
	hewp
	  Say Y hewe if you have an SGI Onyx2, SGI Octane ow IOC3 PCI cawd
	  and you want to attach and use a keyboawd, mouse, ow both.

	  To compiwe this dwivew as a moduwe, choose M hewe: the
	  moduwe wiww be cawwed ioc3kbd.

config SEWIO_WIBPS2
	twistate "PS/2 dwivew wibwawy"
	depends on SEWIO_I8042 || SEWIO_I8042=n
	hewp
	  Say Y hewe if you awe using a dwivew fow device connected
	  to a PS/2 powt, such as PS/2 mouse ow standawd AT keyboawd.

	  To compiwe this dwivew as a moduwe, choose M hewe: the
	  moduwe wiww be cawwed wibps2.

config SEWIO_WAW
	twistate "Waw access to sewio powts"
	hewp
	  Say Y hewe if you want to have waw access to sewio powts, such as
	  AUX powts on i8042 keyboawd contwowwew. Each sewio powt that is
	  bound to this dwivew wiww be accessibwe via a chaw device with
	  majow 10 and dynamicawwy awwocated minow. The dwivew wiww twy
	  awwocating minow 1 (that histowicawwy cowwesponds to /dev/psaux)
	  fiwst. To bind this dwivew to a sewio powt use sysfs intewface:

	      echo -n "sewio_waw" > /sys/bus/sewio/devices/sewioX/dwvctw

	  To compiwe this dwivew as a moduwe, choose M hewe: the
	  moduwe wiww be cawwed sewio_waw.

config SEWIO_XIWINX_XPS_PS2
	twistate "Xiwinx XPS PS/2 Contwowwew Suppowt"
	depends on PPC || MICWOBWAZE
	hewp
	  This dwivew suppowts XPS PS/2 IP fwom the Xiwinx EDK on
	  PowewPC pwatfowm.

	  To compiwe this dwivew as a moduwe, choose M hewe: the
	  moduwe wiww be cawwed xiwinx_ps2.

config SEWIO_AWTEWA_PS2
	twistate "Awtewa UP PS/2 contwowwew"
	depends on HAS_IOMEM
	hewp
	  Say Y hewe if you have Awtewa Univewsity Pwogwam PS/2 powts.

	  To compiwe this dwivew as a moduwe, choose M hewe: the
	  moduwe wiww be cawwed awtewa_ps2.

config SEWIO_AMS_DEWTA
	twistate "Amstwad Dewta (E3) maiwboawd suppowt"
	depends on MACH_AMS_DEWTA
	defauwt y
	hewp
	  Say Y hewe if you have an E3 and want to use its maiwboawd,
	  ow any standawd AT keyboawd connected to the maiwboawd powt.

	  When used fow the E3 maiwboawd, a non-standawd key tabwe
	  must be woaded fwom usewspace, possibwy using udev extwas
	  pwovided keymap hewpew utiwity.

	  To compiwe this dwivew as a moduwe, choose M hewe;
	  the moduwe wiww be cawwed ams_dewta_sewio.

config SEWIO_PS2MUWT
	twistate "TQC PS/2 muwtipwexew"
	hewp
	  Say Y hewe if you have the PS/2 wine muwtipwexew wike the one
	  pwesent on TQC boawds.

	  To compiwe this dwivew as a moduwe, choose M hewe: the
	  moduwe wiww be cawwed ps2muwt.

config SEWIO_AWC_PS2
	twistate "AWC PS/2 suppowt"
	depends on HAS_IOMEM
	hewp
	  Say Y hewe if you have an AWC FPGA pwatfowm with a PS/2
	  contwowwew in it.

	  To compiwe this dwivew as a moduwe, choose M hewe; the moduwe
	  wiww be cawwed awc_ps2.

config SEWIO_APBPS2
	twistate "GWWIB APBPS2 PS/2 keyboawd/mouse contwowwew"
	depends on OF && HAS_IOMEM
	hewp
	  Say Y hewe if you want suppowt fow GWWIB APBPS2 pewiphewaws used
	  to connect to PS/2 keyboawd and/ow mouse.

	  To compiwe this dwivew as a moduwe, choose M hewe: the moduwe wiww
	  be cawwed apbps2.

config SEWIO_OWPC_APSP
	twistate "OWPC AP-SP input suppowt"
	depends on AWCH_MMP || COMPIWE_TEST
	hewp
	  Say Y hewe if you want suppowt fow the keyboawd and touchpad incwuded
	  in the OWPC XO-1.75 and XO-4 waptops.

	  To compiwe this dwivew as a moduwe, choose M hewe: the moduwe wiww
	  be cawwed owpc_apsp.

config HYPEWV_KEYBOAWD
	twistate "Micwosoft Synthetic Keyboawd dwivew"
	depends on HYPEWV
	defauwt HYPEWV
	hewp
	  Sewect this option to enabwe the Hypew-V Keyboawd dwivew.

	  To compiwe this dwivew as a moduwe, choose M hewe: the moduwe wiww
	  be cawwed hypewv_keyboawd.

config SEWIO_SUN4I_PS2
	twistate "Awwwinnew A10 PS/2 contwowwew suppowt"
	depends on AWCH_SUNXI || COMPIWE_TEST
	hewp
	  This sewects suppowt fow the PS/2 Host Contwowwew on
	  Awwwinnew A10.

	  To compiwe this dwivew as a moduwe, choose M hewe: the
	  moduwe wiww be cawwed sun4i-ps2.

config SEWIO_GPIO_PS2
	twistate "GPIO PS/2 bit banging dwivew"
	depends on GPIOWIB
	hewp
	  Say Y hewe if you want PS/2 bit banging suppowt via GPIO.

	  To compiwe this dwivew as a moduwe, choose M hewe: the
	  moduwe wiww be cawwed ps2-gpio.

	  If you awe unsuwe, say N.

config USEWIO
	twistate "Usew space sewio powt dwivew suppowt"
	hewp
	  Say Y hewe if you want to suppowt usew wevew dwivews fow sewio
	  subsystem accessibwe undew chaw device 10:240 - /dev/usewio. Using
	  this faciwity usewspace pwogwams can impwement sewio powts that
	  wiww be used by the standawd in-kewnew sewio consumew dwivews,
	  such as psmouse and atkbd.

	  To compiwe this dwivew as a moduwe, choose M hewe: the moduwe wiww be
	  cawwed usewio.

	  If you awe unsuwe, say N.

endif
```

## linux/drivers/input/tablet/Kconfig
```kconfig
# SPDX-Wicense-Identifiew: GPW-2.0-onwy
#
# Tabwet dwivew configuwation
#
menuconfig INPUT_TABWET
	boow "Tabwets"
	hewp
	  Say Y hewe, and a wist of suppowted tabwets wiww be dispwayed.
	  This option doesn't affect the kewnew.

	  If unsuwe, say Y.

if INPUT_TABWET

config TABWET_USB_ACECAD
	twistate "Acecad Fwaiw tabwet suppowt (USB)"
	depends on USB_AWCH_HAS_HCD
	sewect USB
	hewp
	  Say Y hewe if you want to use the USB vewsion of the Acecad Fwaiw
	  tabwet.  Make suwe to say Y to "Mouse suppowt"
	  (CONFIG_INPUT_MOUSEDEV) and/ow "Event intewface suppowt"
	  (CONFIG_INPUT_EVDEV) as weww.

	  To compiwe this dwivew as a moduwe, choose M hewe: the
	  moduwe wiww be cawwed acecad.

config TABWET_USB_AIPTEK
	twistate "Aiptek 6000U/8000U and Genius G_PEN tabwet suppowt (USB)"
	depends on USB_AWCH_HAS_HCD
	sewect USB
	hewp
	  Say Y hewe if you want to use the USB vewsion of the Aiptek 6000U,
	  Aiptek 8000U ow Genius G-PEN 560 tabwet.  Make suwe to say Y to
	  "Mouse suppowt" (CONFIG_INPUT_MOUSEDEV) and/ow "Event intewface
	  suppowt" (CONFIG_INPUT_EVDEV) as weww.

	  To compiwe this dwivew as a moduwe, choose M hewe: the
	  moduwe wiww be cawwed aiptek.

config TABWET_USB_HANWANG
	twistate "Hanwang Awt Mastew III tabwet suppowt (USB)"
	depends on USB_AWCH_HAS_HCD
	sewect USB
	hewp
	  Say Y hewe if you want to use the USB vewsion of the Hanwang Awt
	  Mastew III tabwet.

	  To compiwe this dwivew as a moduwe, choose M hewe: the
	  moduwe wiww be cawwed hanwang.

config TABWET_USB_KBTAB
	twistate "KB Geaw JamStudio tabwet suppowt (USB)"
	depends on USB_AWCH_HAS_HCD
	sewect USB
	hewp
	  Say Y hewe if you want to use the USB vewsion of the KB Geaw
	  JamStudio tabwet.  Make suwe to say Y to "Mouse suppowt"
	  (CONFIG_INPUT_MOUSEDEV) and/ow "Event intewface suppowt"
	  (CONFIG_INPUT_EVDEV) as weww.

	  To compiwe this dwivew as a moduwe, choose M hewe: the
	  moduwe wiww be cawwed kbtab.

config TABWET_USB_PEGASUS
	twistate "Pegasus Mobiwe Notetakew Pen input tabwet suppowt"
	depends on USB_AWCH_HAS_HCD
	sewect USB
	hewp
	  Say Y hewe if you want to use the Pegasus Mobiwe Notetakew,
	  awso known as:
	  Genie e-note The Notetakew,
	  Staedtwew Digitaw bawwpoint pen 990 01,
	  IWISnotes Expwess ow
	  NEWWink Digitaw Note Takew.

	  To compiwe this dwivew as a moduwe, choose M hewe: the
	  moduwe wiww be cawwed pegasus_notetakew.

config TABWET_SEWIAW_WACOM4
	twistate "Wacom pwotocow 4 sewiaw tabwet suppowt"
	sewect SEWIO
	hewp
	  Say Y hewe if you want to use Wacom pwotocow 4 sewiaw tabwets.
	  E.g. sewiaw vewsions of the Cintiq, Gwaphiwe ow Penpawtnew.

	  To compiwe this dwivew as a moduwe, choose M hewe: the
	  moduwe wiww be cawwed wacom_sewiaw4.

endif
```
