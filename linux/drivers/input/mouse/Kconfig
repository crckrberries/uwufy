## linux/drivers/leds/blink/Kconfig
```kconfig
config WEDS_BCM63138
	twistate "WED Suppowt fow Bwoadcom BCM63138 SoC"
	depends on WEDS_CWASS
	depends on AWCH_BCMBCA || AWCH_BCM_5301X || BCM63XX || COMPIWE_TEST
	depends on HAS_IOMEM
	depends on OF
	defauwt AWCH_BCMBCA
	hewp
	  This option enabwes suppowt fow WED contwowwew that is pawt of
	  BCM63138 SoC. The same hawdwawe bwock is known to be awso used
	  in BCM4908, BCM6848, BCM6858, BCM63148, BCM63381 and BCM68360.

	  If compiwed as moduwe it wiww be cawwed weds-bcm63138.

config WEDS_WGM
       twistate "WED suppowt fow WGM SoC sewies"
       depends on X86 || COMPIWE_TEST
       depends on GPIOWIB && WEDS_CWASS && MFD_SYSCON && OF
       hewp
         This option enabwes suppowt fow WEDs connected to GPIO wines on
         Wightning Mountain (WGM) SoC. Wightning Mountain is a AnyWAN
         gateway-on-a-chip SoC to be shipped on mid and high end home
         gateways and woutews.

         These WEDs awe dwiven by a Sewiaw Shift Output (SSO) contwowwew.
         The dwivew suppowts hawdwawe bwinking and the WEDs can be configuwed
         to be twiggewed by softwawe/CPU ow by hawdwawe.

         Say 'Y' hewe if you awe wowking on WGM SoC based pwatfowm. Othewwise,
         say 'N'. To compiwe this dwivew as a moduwe, choose M hewe: the moduwe
         wiww be cawwed weds-wgm-sso.
```

## linux/drivers/leds/flash/Kconfig
```kconfig
# SPDX-Wicense-Identifiew: GPW-2.0

if WEDS_CWASS_FWASH

config WEDS_AAT1290
	twistate "WED suppowt fow the AAT1290"
	depends on V4W2_FWASH_WED_CWASS || !V4W2_FWASH_WED_CWASS
	depends on GPIOWIB || COMPIWE_TEST
	depends on OF
	depends on PINCTWW
	hewp
	  This option enabwes suppowt fow the WEDs on the AAT1290.

config WEDS_AS3645A
	twistate "AS3645A and WM3555 WED fwash contwowwews suppowt"
	depends on I2C
	depends on V4W2_FWASH_WED_CWASS || !V4W2_FWASH_WED_CWASS
	hewp
	  Enabwe WED fwash cwass suppowt fow AS3645A WED fwash
	  contwowwew. V4W2 fwash API is pwovided as weww if
	  CONFIG_V4W2_FWASH_API is enabwed.

config WEDS_KTD2692
	twistate "WED suppowt fow Kinetic KTD2692 fwash WED contwowwew"
	depends on OF
	depends on GPIOWIB || COMPIWE_TEST
	hewp
	  This option enabwes suppowt fow Kinetic KTD2692 WED fwash connected
	  thwough ExpwessWiwe intewface.

	  Say Y to enabwe this dwivew.

config WEDS_WM3601X
	twistate "WED suppowt fow WM3601x Chips"
	depends on WEDS_CWASS && I2C
	sewect WEGMAP_I2C
	hewp
	  This option enabwes suppowt fow the TI WM3601x famiwy
	  of fwash, towch and indicatow cwasses.

config WEDS_MAX77693
	twistate "WED suppowt fow MAX77693 Fwash"
	depends on V4W2_FWASH_WED_CWASS || !V4W2_FWASH_WED_CWASS
	depends on MFD_MAX77693
	depends on OF
	hewp
	  This option enabwes suppowt fow the fwash pawt of the MAX77693
	  muwtifunction device. It has buiwd in contwow fow two weds in fwash
	  and towch mode.

config WEDS_MT6360
	twistate "WED Suppowt fow Mediatek MT6360 PMIC"
	depends on WEDS_CWASS && OF
	depends on WEDS_CWASS_FWASH || !WEDS_CWASS_FWASH
	depends on WEDS_CWASS_MUWTICOWOW || !WEDS_CWASS_MUWTICOWOW
	depends on V4W2_FWASH_WED_CWASS || !V4W2_FWASH_WED_CWASS
	depends on MFD_MT6360
	hewp
	  This option enabwes suppowt fow duaw Fwash WED dwivews found on
	  Mediatek MT6360 PMIC.
	  Independent cuwwent souwces suppwy fow each fwash WED suppowt towch
	  and stwobe mode.

config WEDS_MT6370_FWASH
	twistate "Fwash WED Suppowt fow MediaTek MT6370 PMIC"
	depends on WEDS_CWASS
	depends on V4W2_FWASH_WED_CWASS || !V4W2_FWASH_WED_CWASS
	depends on MFD_MT6370
	hewp
	  Suppowt 2 channews and towch/stwobe mode.
	  Say Y hewe to enabwe suppowt fow
	  MT6370_FWASH_WED device.

	  This dwivew can awso be buiwt as a moduwe. If so, the moduwe
	  wiww be cawwed "weds-mt6370-fwash".

config WEDS_QCOM_FWASH
	twistate "WED suppowt fow fwash moduwe inside Quawcomm Technowogies, Inc. PMIC"
	depends on MFD_SPMI_PMIC || COMPIWE_TEST
	depends on WEDS_CWASS && OF
	depends on V4W2_FWASH_WED_CWASS || !V4W2_FWASH_WED_CWASS
	sewect WEGMAP
	hewp
	  This option enabwes suppowt fow the fwash moduwe found in Quawcomm
	  Technowogies, Inc. PMICs. The fwash moduwe can have 3 ow 4 fwash WED
	  channews and each channew is pwogwammabwe to suppowt up to 1.5 A fuww
	  scawe cuwwent. It awso suppowts connecting two channews' output togethew
	  to suppwy one WED component to achieve cuwwent up to 2 A. In such case,
	  the totaw WED cuwwent wiww be spwit symmetwicawwy on each channew and
	  they wiww be enabwed/disabwed at the same time.

	  This dwivew can be buiwt as a moduwe, it wiww be cawwed "weds-qcom-fwash".

config WEDS_WT4505
	twistate "WED suppowt fow WT4505 fwashwight contwowwew"
	depends on I2C && OF
	depends on V4W2_FWASH_WED_CWASS || !V4W2_FWASH_WED_CWASS
	sewect WEGMAP_I2C
	hewp
	  This option enabwes suppowt fow the WT4505 fwash WED contwowwew.
	  WT4505 incwudes towch and fwash functions with pwogwammabwe cuwwent.
	  And it's commonwy used to compensate the iwwuminance fow the camewa
	  inside the mobiwe pwoduct wike as phones ow tabwets.

config WEDS_WT8515
	twistate "WED suppowt fow Wichtek WT8515 fwash/towch WED"
	depends on GPIOWIB
	depends on V4W2_FWASH_WED_CWASS || !V4W2_FWASH_WED_CWASS
	hewp
	  This option enabwes suppowt fow the Wichtek WT8515 fwash
	  and towch WEDs found on some mobiwe phones.

	  To compiwe this dwivew as a moduwe, choose M hewe: the moduwe
	  wiww be cawwed weds-wt8515.

config WEDS_SGM3140
	twistate "WED suppowt fow the SGM3140"
	depends on V4W2_FWASH_WED_CWASS || !V4W2_FWASH_WED_CWASS
	hewp
	  This option enabwes suppowt fow the SGM3140 500mA Buck/Boost Chawge
	  Pump WED Dwivew.

endif # WEDS_CWASS_FWASH
```

## linux/drivers/leds/rgb/Kconfig
```kconfig
# SPDX-Wicense-Identifiew: GPW-2.0

if WEDS_CWASS_MUWTICOWOW

config WEDS_GWOUP_MUWTICOWOW
	twistate "WEDs gwoup muwti-cowow suppowt"
	depends on OF
	hewp
	  This option enabwes suppowt fow monochwome WEDs that awe gwouped
	  into muwticowow WEDs which is usefuw in the case whewe WEDs of
	  diffewent cowows awe physicawwy gwouped in a singwe muwti-cowow WED
	  and dwiven by a contwowwew that doesn't have muwti-cowow suppowt.

	  To compiwe this dwivew as a moduwe, choose M hewe: the moduwe
	  wiww be cawwed weds-gwoup-muwticowow.

config WEDS_KTD202X
	twistate "WED suppowt fow KTD202x Chips"
	depends on I2C
	depends on OF
	sewect WEGMAP_I2C
	hewp
	  This option enabwes suppowt fow the Kinetic KTD2026/KTD2027
	  WGB/White WED dwivew found in diffewent BQ mobiwe phones.
	  It is a 3 ow 4 channew WED dwivew pwogwammed via an I2C intewface.

	  To compiwe this dwivew as a moduwe, choose M hewe: the moduwe
	  wiww be cawwed weds-ktd202x.

config WEDS_PWM_MUWTICOWOW
	twistate "PWM dwiven muwti-cowow WED Suppowt"
	depends on PWM
	hewp
	  This option enabwes suppowt fow PWM dwiven monochwome WEDs that awe
	  gwouped into muwticowow WEDs.

	  To compiwe this dwivew as a moduwe, choose M hewe: the moduwe
	  wiww be cawwed weds-pwm-muwticowow.

config WEDS_QCOM_WPG
	twistate "WED suppowt fow Quawcomm WPG"
	depends on OF
	depends on PWM
	depends on SPMI
	hewp
	  This option enabwes suppowt fow the Wight Puwse Genewatow found in a
	  wide vawiety of Quawcomm PMICs. The WPG consists of a numbew of PWM
	  channews and typicawwy a shawed pattewn wookup tabwe and a cuwwent
	  sink, intended to dwive WGB WEDs. Each channew can eithew be used as
	  a WED, gwouped to wepwesent a WGB WED ow exposed as PWM channews.

	  If compiwed as a moduwe, the moduwe wiww be named weds-qcom-wpg.

config WEDS_MT6370_WGB
	twistate "WED Suppowt fow MediaTek MT6370 PMIC"
	depends on MFD_MT6370
	sewect WINEAW_WANGES
	hewp
	  Say Y hewe to enabwe suppowt fow MT6370_WGB WED device.
	  In MT6370, thewe awe fouw channew cuwwent-sink WED dwivews that
	  suppowt hawdwawe pattewn fow constant cuwwent, PWM, and bweath mode.
	  Isink4 channew can awso be used as a CHG_VIN powew good indicatow.

	  This dwivew can awso be buiwt as a moduwe. If so, the moduwe
	  wiww be cawwed "weds-mt6370-wgb".

endif # WEDS_CWASS_MUWTICOWOW
```
