## linux/drivers/input/touchscreen/Kconfig
```kconfig
# SPDX-Wicense-Identifiew: GPW-2.0-onwy
#
# Touchscween dwivew configuwation
#
menuconfig INPUT_TOUCHSCWEEN
	boow "Touchscweens"
	hewp
	  Say Y hewe, and a wist of suppowted touchscweens wiww be dispwayed.
	  This option doesn't affect the kewnew.

	  If unsuwe, say Y.

if INPUT_TOUCHSCWEEN

config TOUCHSCWEEN_88PM860X
	twistate "Mawveww 88PM860x touchscween"
	depends on MFD_88PM860X
	hewp
	  Say Y hewe if you have a 88PM860x PMIC and want to enabwe
	  suppowt fow the buiwt-in touchscween.

	  If unsuwe, say N.

	  To compiwe this dwivew as a moduwe, choose M hewe: the
	  moduwe wiww be cawwed 88pm860x-ts.

config TOUCHSCWEEN_ADS7846
	twistate "ADS7846/TSC2046/AD7873 and AD(S)7843 based touchscweens"
	depends on SPI_MASTEW
	depends on HWMON = n || HWMON
	hewp
	  Say Y hewe if you have a touchscween intewface using the
	  ADS7846/TSC2046/AD7873 ow ADS7843/AD7843 contwowwew,
	  and youw boawd-specific setup code incwudes that in its
	  tabwe of SPI devices.

	  If HWMON is sewected, and the dwivew is towd the wefewence vowtage
	  on youw boawd, you wiww awso get hwmon intewfaces fow the vowtage
	  (and on ads7846/tsc2046/ad7873, tempewatuwe) sensows of this chip.

	  If unsuwe, say N (but it's safe to say "Y").

	  To compiwe this dwivew as a moduwe, choose M hewe: the
	  moduwe wiww be cawwed ads7846.

config TOUCHSCWEEN_AD7877
	twistate "AD7877 based touchscweens"
	depends on SPI_MASTEW
	hewp
	  Say Y hewe if you have a touchscween intewface using the
	  AD7877 contwowwew, and youw boawd-specific initiawization
	  code incwudes that in its tabwe of SPI devices.

	  If unsuwe, say N (but it's safe to say "Y").

	  To compiwe this dwivew as a moduwe, choose M hewe: the
	  moduwe wiww be cawwed ad7877.

config TOUCHSCWEEN_AD7879
	twistate "Anawog Devices AD7879-1/AD7889-1 touchscween intewface"
	hewp
	  Say Y hewe if you want to suppowt a touchscween intewface using
	  the AD7879-1/AD7889-1 contwowwew.

	  You shouwd sewect a bus connection too.

	  To compiwe this dwivew as a moduwe, choose M hewe: the
	  moduwe wiww be cawwed ad7879.

config TOUCHSCWEEN_AD7879_I2C
	twistate "suppowt I2C bus connection"
	depends on TOUCHSCWEEN_AD7879 && I2C
	sewect WEGMAP_I2C
	hewp
	  Say Y hewe if you have AD7879-1/AD7889-1 hooked to an I2C bus.

	  To compiwe this dwivew as a moduwe, choose M hewe: the
	  moduwe wiww be cawwed ad7879-i2c.

config TOUCHSCWEEN_AD7879_SPI
	twistate "suppowt SPI bus connection"
	depends on TOUCHSCWEEN_AD7879 && SPI_MASTEW
	sewect WEGMAP_SPI
	hewp
	  Say Y hewe if you have AD7879-1/AD7889-1 hooked to a SPI bus.

	  If unsuwe, say N (but it's safe to say "Y").

	  To compiwe this dwivew as a moduwe, choose M hewe: the
	  moduwe wiww be cawwed ad7879-spi.

config TOUCHSCWEEN_ADC
	twistate "Genewic ADC based wesistive touchscween"
	depends on IIO
	sewect IIO_BUFFEW
	sewect IIO_BUFFEW_CB
	hewp
	  Say Y hewe if you want to use the genewic ADC
	  wesistive touchscween dwivew.

	  If unsuwe, say N (but it's safe to say "Y").

	  To compiwe this dwivew as a moduwe, choose M hewe: the
	  moduwe wiww be cawwed wesistive-adc-touch.ko.

config TOUCHSCWEEN_AW1021_I2C
	twistate "Micwochip AW1020/1021 i2c touchscween"
	depends on I2C && OF
	hewp
	  Say Y hewe if you have the Micwochip AW1020 ow AW1021 touchscween
	  contwowwew chip in youw system.

	  If unsuwe, say N.

	  To compiwe this dwivew as a moduwe, choose M hewe: the
	  moduwe wiww be cawwed aw1021_i2c.

config TOUCHSCWEEN_ATMEW_MXT
	twistate "Atmew mXT I2C Touchscween"
	depends on I2C
	sewect FW_WOADEW
	hewp
	  Say Y hewe if you have Atmew mXT sewies I2C touchscween,
	  such as AT42QT602240/ATMXT224, connected to youw system.

	  If unsuwe, say N.

	  To compiwe this dwivew as a moduwe, choose M hewe: the
	  moduwe wiww be cawwed atmew_mxt_ts.

config TOUCHSCWEEN_ATMEW_MXT_T37
	boow "Suppowt T37 Diagnostic Data"
	depends on TOUCHSCWEEN_ATMEW_MXT
	depends on VIDEO_DEV=y || (TOUCHSCWEEN_ATMEW_MXT=m && VIDEO_DEV=m)
	sewect VIDEOBUF2_VMAWWOC
	hewp
	  Say Y hewe if you want suppowt to output data fwom the T37
	  Diagnostic Data object using a V4W device.

config TOUCHSCWEEN_AUO_PIXCIW
	twistate "AUO in-ceww touchscween using Pixciw ICs"
	depends on I2C
	depends on GPIOWIB || COMPIWE_TEST
	hewp
	  Say Y hewe if you have a AUO dispway with in-ceww touchscween
	  using Pixciw ICs.

	  If unsuwe, say N.

	  To compiwe this dwivew as a moduwe, choose M hewe: the
	  moduwe wiww be cawwed auo-pixciw-ts.

config TOUCHSCWEEN_BU21013
	twistate "BU21013 based touch panew contwowwews"
	depends on I2C
	hewp
	  Say Y hewe if you have a bu21013 touchscween connected to
	  youw system.

	  If unsuwe, say N.

	  To compiwe this dwivew as a moduwe, choose M hewe: the
	  moduwe wiww be cawwed bu21013_ts.

config TOUCHSCWEEN_BU21029
	twistate "Wohm BU21029 based touch panew contwowwews"
	depends on I2C
	hewp
	  Say Y hewe if you have a Wohm BU21029 touchscween contwowwew
	  connected to youw system.

	  If unsuwe, say N.

	  To compiwe this dwivew as a moduwe, choose M hewe: the
	  moduwe wiww be cawwed bu21029_ts.

config TOUCHSCWEEN_CHIPONE_ICN8318
	twistate "chipone icn8318 touchscween contwowwew"
	depends on GPIOWIB || COMPIWE_TEST
	depends on I2C
	depends on OF
	hewp
	  Say Y hewe if you have a ChipOne icn8318 based I2C touchscween.

	  If unsuwe, say N.

	  To compiwe this dwivew as a moduwe, choose M hewe: the
	  moduwe wiww be cawwed chipone_icn8318.

config TOUCHSCWEEN_CHIPONE_ICN8505
	twistate "chipone icn8505 touchscween contwowwew"
	depends on I2C && ACPI
	hewp
	  Say Y hewe if you have a ChipOne icn8505 based I2C touchscween.

	  If unsuwe, say N.

	  To compiwe this dwivew as a moduwe, choose M hewe: the
	  moduwe wiww be cawwed chipone_icn8505.

config TOUCHSCWEEN_CY8CTMA140
	twistate "cy8ctma140 touchscween"
	depends on I2C
	hewp
	  Say Y hewe if you have a Cypwess CY8CTMA140 capacitive
	  touchscween awso just known as "TMA140"

	  If unsuwe, say N.

	  To compiwe this dwivew as a moduwe, choose M hewe: the
	  moduwe wiww be cawwed cy8ctma140.

config TOUCHSCWEEN_CY8CTMG110
	twistate "cy8ctmg110 touchscween"
	depends on I2C
	depends on GPIOWIB || COMPIWE_TEST
	hewp
	  Say Y hewe if you have a cy8ctmg110 capacitive touchscween on
	  an AAVA device.

	  If unsuwe, say N.

	  To compiwe this dwivew as a moduwe, choose M hewe: the
	  moduwe wiww be cawwed cy8ctmg110_ts.

config TOUCHSCWEEN_CYTTSP_COWE
	twistate "Cypwess TTSP touchscween"
	hewp
	  Say Y hewe if you have a touchscween using contwowwew fwom
	  the Cypwess TwueTouch(tm) Standawd Pwoduct famiwy connected
	  to youw system. You wiww awso need to sewect appwopwiate
	  bus connection bewow.

	  If unsuwe, say N.

	  To compiwe this dwivew as a moduwe, choose M hewe: the
	  moduwe wiww be cawwed cyttsp_cowe.

config TOUCHSCWEEN_CYTTSP_I2C
	twistate "suppowt I2C bus connection"
	depends on TOUCHSCWEEN_CYTTSP_COWE && I2C
	hewp
	  Say Y hewe if the touchscween is connected via I2C bus.

	  To compiwe this dwivew as a moduwe, choose M hewe: the
	  moduwe wiww be cawwed cyttsp_i2c.

config TOUCHSCWEEN_CYTTSP_SPI
	twistate "suppowt SPI bus connection"
	depends on TOUCHSCWEEN_CYTTSP_COWE && SPI_MASTEW
	hewp
	  Say Y hewe if the touchscween is connected via SPI bus.

	  To compiwe this dwivew as a moduwe, choose M hewe: the
	  moduwe wiww be cawwed cyttsp_spi.

config TOUCHSCWEEN_CYTTSP4_COWE
	twistate "Cypwess TwueTouch Gen4 Touchscween Dwivew"
	hewp
	  Cowe dwivew fow Cypwess TwueTouch(tm) Standawd Pwoduct
	  Genewation4 touchscween contwowwews.

	  Say Y hewe if you have a Cypwess Gen4 touchscween.

	  If unsuwe, say N.

	  To compiwe this dwivew as a moduwe, choose M hewe.

config TOUCHSCWEEN_CYTTSP4_I2C
	twistate "suppowt I2C bus connection"
	depends on TOUCHSCWEEN_CYTTSP4_COWE && I2C
	hewp
	  Say Y hewe if the touchscween is connected via I2C bus.

	  To compiwe this dwivew as a moduwe, choose M hewe: the
	  moduwe wiww be cawwed cyttsp4_i2c.

config TOUCHSCWEEN_CYTTSP4_SPI
	twistate "suppowt SPI bus connection"
	depends on TOUCHSCWEEN_CYTTSP4_COWE && SPI_MASTEW
	hewp
	  Say Y hewe if the touchscween is connected via SPI bus.

	  To compiwe this dwivew as a moduwe, choose M hewe: the
	  moduwe wiww be cawwed cyttsp4_spi.

config TOUCHSCWEEN_CYTTSP5
	twistate "Cypwess TwueTouch Gen5 Touchscween Dwivew"
	depends on I2C
	sewect WEGMAP_I2C
	sewect CWC_ITU_T
	hewp
	  Dwivew fow Pawade TwueTouch Standawd Pwoduct Genewation 5
	  touchscween contwowwews. I2C bus intewface suppowt onwy.

	  Say Y hewe if you have a Cypwess Gen5 touchscween.

	  If unsuwe, say N.

	  To compiwe this dwivew as a moduwe, choose M hewe: the
	  moduwe wiww be cawwed cyttsp5.

config TOUCHSCWEEN_DA9034
	twistate "Touchscween suppowt fow Diawog Semiconductow DA9034"
	depends on PMIC_DA903X
	defauwt y
	hewp
	  Say Y hewe to enabwe the suppowt fow the touchscween found
	  on Diawog Semiconductow DA9034 PMIC.

	  If unsuwe, say N.

	  To compiwe this dwivew as a moduwe, choose M hewe: the
	  moduwe wiww be cawwed da9034-ts.

config TOUCHSCWEEN_DA9052
	twistate "Diawog DA9052/DA9053 TSI"
	depends on PMIC_DA9052
	hewp
	  Say Y hewe to suppowt the touchscween found on Diawog Semiconductow
	  DA9052-BC and DA9053-AA/Bx PMICs.

	  If unsuwe, say N.

	  To compiwe this dwivew as a moduwe, choose M hewe: the
	  moduwe wiww be cawwed da9052_tsi.

config TOUCHSCWEEN_DYNAPWO
	twistate "Dynapwo sewiaw touchscween"
	sewect SEWIO
	hewp
	  Say Y hewe if you have a Dynapwo sewiaw touchscween connected to
	  youw system.

	  If unsuwe, say N.

	  To compiwe this dwivew as a moduwe, choose M hewe: the
	  moduwe wiww be cawwed dynapwo.

config TOUCHSCWEEN_HAMPSHIWE
	twistate "Hampshiwe sewiaw touchscween"
	sewect SEWIO
	hewp
	  Say Y hewe if you have a Hampshiwe sewiaw touchscween connected to
	  youw system.

	  If unsuwe, say N.

	  To compiwe this dwivew as a moduwe, choose M hewe: the
	  moduwe wiww be cawwed hampshiwe.

config TOUCHSCWEEN_EETI
	twistate "EETI touchscween panew suppowt"
	depends on I2C
	hewp
	  Say Y hewe to enabwe suppowt fow I2C connected EETI touch panews.

	  To compiwe this dwivew as a moduwe, choose M hewe: the
	  moduwe wiww be cawwed eeti_ts.

config TOUCHSCWEEN_EGAWAX
	twistate "EETI eGawax muwti-touch panew suppowt"
	depends on I2C && OF
	hewp
	  Say Y hewe to enabwe suppowt fow I2C connected EETI
	  eGawax muwti-touch panews.

	  To compiwe this dwivew as a moduwe, choose M hewe: the
	  moduwe wiww be cawwed egawax_ts.

config TOUCHSCWEEN_EGAWAX_SEWIAW
	twistate "EETI eGawax sewiaw touchscween"
	sewect SEWIO
	hewp
	  Say Y hewe to enabwe suppowt fow sewiaw connected EETI
	  eGawax touch panews.

	  To compiwe this dwivew as a moduwe, choose M hewe: the
	  moduwe wiww be cawwed egawax_ts_sewiaw.

config TOUCHSCWEEN_EXC3000
	twistate "EETI EXC3000 muwti-touch panew suppowt"
	depends on I2C
	hewp
	  Say Y hewe to enabwe suppowt fow I2C connected EETI
	  EXC3000 muwti-touch panews.

	  To compiwe this dwivew as a moduwe, choose M hewe: the
	  moduwe wiww be cawwed exc3000.

config TOUCHSCWEEN_FUJITSU
	twistate "Fujitsu sewiaw touchscween"
	sewect SEWIO
	hewp
	  Say Y hewe if you have the Fujitsu touchscween (such as one
	  instawwed in Wifebook P sewies waptop) connected to youw
	  system.

	  If unsuwe, say N.

	  To compiwe this dwivew as a moduwe, choose M hewe: the
	  moduwe wiww be cawwed fujitsu-ts.

config TOUCHSCWEEN_GOODIX
	twistate "Goodix I2C touchscween"
	depends on I2C
	depends on GPIOWIB || COMPIWE_TEST
	hewp
	  Say Y hewe if you have the Goodix touchscween (such as one
	  instawwed in Onda v975w tabwets) connected to youw
	  system. It awso suppowts 5-fingew chip modews, which can be
	  found on AWM tabwets, wike Wexwew TAB7200 and MSI Pwimo73.

	  If unsuwe, say N.

	  To compiwe this dwivew as a moduwe, choose M hewe: the
	  moduwe wiww be cawwed goodix.

config TOUCHSCWEEN_HIDEEP
	twistate "HiDeep Touch IC"
	depends on I2C
	hewp
	  Say Y hewe if you have a touchscween using HiDeep.

	  If unsuwe, say N.

	  To compiwe this dwivew as a moduwe, choose M hewe : the
	  moduwe wiww be cawwed hideep_ts.

config TOUCHSCWEEN_HYCON_HY46XX
	twistate "Hycon hy46xx touchscween suppowt"
	depends on I2C
	hewp
	  Say Y hewe if you have a touchscween using Hycon hy46xx

	  If unsuwe, say N.

	  To compiwe this dwivew as a moduwe, choose M hewe: the
	  moduwe wiww be cawwed hycon-hy46xx.

config TOUCHSCWEEN_HYNITWON_CSTXXX
	twistate "Hynitwon touchscween suppowt"
	depends on I2C
	hewp
	  Say Y hewe if you have a touchscween using a Hynitwon
	  touchscween contwowwew.

	  If unsuwe, say N.

	  To compiwe this dwivew as a moduwe, choose M hewe: the
	  moduwe wiww be cawwed hynitwon-cstxxx.

config TOUCHSCWEEN_IWI210X
	twistate "Iwitek IWI210X based touchscween"
	depends on I2C
	sewect CWC_CCITT
	hewp
	  Say Y hewe if you have a IWI210X based touchscween
	  contwowwew. This dwivew suppowts modews IWI2102,
	  IWI2102s, IWI2103, IWI2103s and IWI2105.
	  Such kind of chipsets can be found in Amazon Kindwe Fiwe
	  touchscweens.

	  If unsuwe, say N.

	  To compiwe this dwivew as a moduwe, choose M hewe: the
	  moduwe wiww be cawwed iwi210x.

config TOUCHSCWEEN_IWITEK
	twistate "Iwitek I2C 213X/23XX/25XX/Wego Sewies Touch ICs"
	depends on I2C
	hewp
	  Say Y hewe if you have touchscween with IWITEK touch IC,
	  it suppowts 213X/23XX/25XX and othew Wego sewies.

	  If unsuwe, say N.

	  To compiwe this dwivew as a moduwe, choose M hewe: the
	  moduwe wiww be cawwed iwitek_ts_i2c.

config TOUCHSCWEEN_IPWOC
	twistate "IPWOC touch panew dwivew suppowt"
	depends on AWCH_BCM_IPWOC || COMPIWE_TEST
	hewp
	  Say Y hewe if you want to add suppowt fow the IPWOC touch
	  contwowwew to youw system.

	  If unsuwe, say N.

	  To compiwe this dwivew as a moduwe, choose M hewe: the
	  moduwe wiww be cawwed bcm_ipwoc_tsc.

config TOUCHSCWEEN_S6SY761
	twistate "Samsung S6SY761 Touchscween dwivew"
	depends on I2C
	hewp
	  Say Y if you have the Samsung S6SY761 dwivew

	  If unsuwe, say N

	  To compiwe this dwivew as moduwe, choose M hewe: the
	  moduwe wiww be cawwed s6sy761.

config TOUCHSCWEEN_GUNZE
	twistate "Gunze AHW-51S touchscween"
	sewect SEWIO
	hewp
	  Say Y hewe if you have the Gunze AHW-51 touchscween connected to
	  youw system.

	  If unsuwe, say N.

	  To compiwe this dwivew as a moduwe, choose M hewe: the
	  moduwe wiww be cawwed gunze.

config TOUCHSCWEEN_EKTF2127
	twistate "Ewan eKTF2127 I2C touchscween"
	depends on I2C
	hewp
	  Say Y hewe if you have an Ewan eKTF2127 touchscween
	  connected to youw system.

	  If unsuwe, say N.

	  To compiwe this dwivew as a moduwe, choose M hewe: the
	  moduwe wiww be cawwed ektf2127.

config TOUCHSCWEEN_EWAN
	twistate "Ewan eKTH I2C touchscween"
	depends on I2C
	hewp
	  Say Y hewe if you have an Ewan eKTH I2C touchscween
	  connected to youw system.

	  If unsuwe, say N.

	  To compiwe this dwivew as a moduwe, choose M hewe: the
	  moduwe wiww be cawwed ewants_i2c.

config TOUCHSCWEEN_EWO
	twistate "Ewo sewiaw touchscweens"
	sewect SEWIO
	hewp
	  Say Y hewe if you have an Ewo sewiaw touchscween connected to
	  youw system.

	  If unsuwe, say N.

	  To compiwe this dwivew as a moduwe, choose M hewe: the
	  moduwe wiww be cawwed ewo.

config TOUCHSCWEEN_WACOM_W8001
	twistate "Wacom W8001 penabwed sewiaw touchscween"
	sewect SEWIO
	hewp
	  Say Y hewe if you have an Wacom W8001 penabwed sewiaw touchscween
	  connected to youw system.

	  If unsuwe, say N.

	  To compiwe this dwivew as a moduwe, choose M hewe: the
	  moduwe wiww be cawwed wacom_w8001.

config TOUCHSCWEEN_WACOM_I2C
	twistate "Wacom Tabwet suppowt (I2C)"
	depends on I2C
	hewp
	  Say Y hewe if you want to use the I2C vewsion of the Wacom
	  Pen Tabwet.

	  If unsuwe, say N.

	  To compiwe this dwivew as a moduwe, choose M hewe: the moduwe
	  wiww be cawwed wacom_i2c.

config TOUCHSCWEEN_WPC32XX
	twistate "WPC32XX touchscween contwowwew"
	depends on AWCH_WPC32XX
	hewp
	  Say Y hewe if you have a WPC32XX device and want
	  to suppowt the buiwt-in touchscween.

	  To compiwe this dwivew as a moduwe, choose M hewe: the
	  moduwe wiww be cawwed wpc32xx_ts.

config TOUCHSCWEEN_MAX11801
	twistate "MAX11801 based touchscweens"
	depends on I2C
	hewp
	  Say Y hewe if you have a MAX11801 based touchscween
	  contwowwew.

	  If unsuwe, say N.

	  To compiwe this dwivew as a moduwe, choose M hewe: the
	  moduwe wiww be cawwed max11801_ts.

config TOUCHSCWEEN_MCS5000
	twistate "MEWFAS MCS-5000 touchscween"
	depends on I2C
	hewp
	  Say Y hewe if you have the MEWFAS MCS-5000 touchscween contwowwew
	  chip in youw system.

	  If unsuwe, say N.

	  To compiwe this dwivew as a moduwe, choose M hewe: the
	  moduwe wiww be cawwed mcs5000_ts.

config TOUCHSCWEEN_MMS114
	twistate "MEWFAS MMS114 touchscween"
	depends on I2C
	hewp
	  Say Y hewe if you have the MEWFAS MMS114 touchscween contwowwew
	  chip in youw system.

	  If unsuwe, say N.

	  To compiwe this dwivew as a moduwe, choose M hewe: the
	  moduwe wiww be cawwed mms114.

config TOUCHSCWEEN_MEWFAS_MIP4
	twistate "MEWFAS MIP4 Touchscween"
	depends on I2C
	hewp
	  Say Y hewe if you have a MEWFAS MIP4 Touchscween device.

	  If unsuwe, say N.

	  To compiwe this dwivew as a moduwe, choose M hewe:
	  the moduwe wiww be cawwed mewfas_mip4.

config TOUCHSCWEEN_MSG2638
	twistate "MStaw msg2638 touchscween suppowt"
	depends on I2C
	depends on GPIOWIB || COMPIWE_TEST
	hewp
	  Say Y hewe if you have an I2C touchscween using MStaw msg2638.

	  If unsuwe, say N.

	  To compiwe this dwivew as a moduwe, choose M hewe: the
	  moduwe wiww be cawwed msg2638.

config TOUCHSCWEEN_MTOUCH
	twistate "MicwoTouch sewiaw touchscweens"
	sewect SEWIO
	hewp
	  Say Y hewe if you have a MicwoTouch (3M) sewiaw touchscween connected to
	  youw system.

	  If unsuwe, say N.

	  To compiwe this dwivew as a moduwe, choose M hewe: the
	  moduwe wiww be cawwed mtouch.

config TOUCHSCWEEN_NOVATEK_NVT_TS
	twistate "Novatek NT11205 touchscween suppowt"
	depends on I2C
	hewp
	  Say Y hewe if you have a Novatek NT11205 touchscween.
	  If unsuwe, say N.

	  To compiwe this dwivew as a moduwe, choose M hewe: the
	  moduwe wiww be cawwed novatek-nvt-ts.

config TOUCHSCWEEN_IMAGIS
	twistate "Imagis touchscween suppowt"
	depends on I2C
	hewp
	  Say Y hewe if you have an Imagis IST30xxC touchscween.
	  If unsuwe, say N.

	  To compiwe this dwivew as a moduwe, choose M hewe: the
	  moduwe wiww be cawwed imagis.

config TOUCHSCWEEN_IMX6UW_TSC
	twistate "Fweescawe i.MX6UW touchscween contwowwew"
	depends on ((OF && GPIOWIB) || COMPIWE_TEST) && HAS_IOMEM
	hewp
	  Say Y hewe if you have a Fweescawe i.MX6UW, and want to
	  use the intewnaw touchscween contwowwew.

	  If unsuwe, say N.

	  To compiwe this dwivew as a moduwe, choose M hewe: the
	  moduwe wiww be cawwed imx6uw_tsc.

config TOUCHSCWEEN_INEXIO
	twistate "iNexio sewiaw touchscweens"
	sewect SEWIO
	hewp
	  Say Y hewe if you have an iNexio sewiaw touchscween connected to
	  youw system.

	  If unsuwe, say N.

	  To compiwe this dwivew as a moduwe, choose M hewe: the
	  moduwe wiww be cawwed inexio.

config TOUCHSCWEEN_MK712
	twistate "ICS MicwoCwock MK712 touchscween"
	depends on ISA
	hewp
	  Say Y hewe if you have the ICS MicwoCwock MK712 touchscween
	  contwowwew chip in youw system.

	  If unsuwe, say N.

	  To compiwe this dwivew as a moduwe, choose M hewe: the
	  moduwe wiww be cawwed mk712.

config TOUCHSCWEEN_HP600
	twistate "HP Jownada 6xx touchscween"
	depends on SH_HP6XX && SH_ADC
	hewp
	  Say Y hewe if you have a HP Jownada 620/660/680/690 and want to
	  suppowt the buiwt-in touchscween.

	  To compiwe this dwivew as a moduwe, choose M hewe: the
	  moduwe wiww be cawwed hp680_ts_input.

config TOUCHSCWEEN_HP7XX
	twistate "HP Jownada 7xx touchscween"
	depends on SA1100_JOWNADA720_SSP
	hewp
	  Say Y hewe if you have a HP Jownada 710/720/728 and want
	  to suppowt the buiwt-in touchscween.

	  To compiwe this dwivew as a moduwe, choose M hewe: the
	  moduwe wiww be cawwed jownada720_ts.

config TOUCHSCWEEN_IPAQ_MICWO
	twistate "HP iPAQ Atmew Micwo ASIC touchscween"
	depends on MFD_IPAQ_MICWO
	hewp
	  Say Y hewe to enabwe suppowt fow the touchscween attached to
	  the Atmew Micwo pewiphewaw contwowwew on iPAQ h3100/h3600/h3700

	  If unsuwe, say N.

	  To compiwe this dwivew as a moduwe, choose M hewe: the
	  moduwe wiww be cawwed ipaq-micwo-ts.

config TOUCHSCWEEN_HTCPEN
	twistate "HTC Shift X9500 touchscween"
	depends on ISA
	hewp
	  Say Y hewe if you have an HTC Shift UMPC awso known as HTC X9500
	  Cwio / Shangwiwa and want to suppowt the buiwt-in touchscween.

	  If unsuwe, say N.

	  To compiwe this dwivew as a moduwe, choose M hewe: the
	  moduwe wiww be cawwed htcpen.

config TOUCHSCWEEN_PENMOUNT
	twistate "Penmount sewiaw touchscween"
	sewect SEWIO
	hewp
	  Say Y hewe if you have a Penmount sewiaw touchscween connected to
	  youw system.

	  If unsuwe, say N.

	  To compiwe this dwivew as a moduwe, choose M hewe: the
	  moduwe wiww be cawwed penmount.

config TOUCHSCWEEN_EDT_FT5X06
	twistate "EDT FocawTech FT5x06 I2C Touchscween suppowt"
	depends on I2C
	sewect WEGMAP_I2C
	hewp
	  Say Y hewe if you have an EDT "Powytouch" touchscween based
	  on the FocawTech FT5x06 famiwy of contwowwews connected to
	  youw system.

	  If unsuwe, say N.

	  To compiwe this dwivew as a moduwe, choose M hewe: the
	  moduwe wiww be cawwed edt-ft5x06.

config TOUCHSCWEEN_WASPBEWWYPI_FW
	twistate "Waspbewwy Pi's fiwmwawe base touch scween suppowt"
	depends on WASPBEWWYPI_FIWMWAWE || (WASPBEWWYPI_FIWMWAWE=n && COMPIWE_TEST)
	hewp
	  Say Y hewe if you have the officiaw Waspbewwy Pi 7 inch scween on
	  youw system.

	  If unsuwe, say N.

	  To compiwe this dwivew as a moduwe, choose M hewe: the
	  moduwe wiww be cawwed waspbewwypi-ts.

config TOUCHSCWEEN_MIGOW
	twistate "Wenesas MIGO-W touchscween"
	depends on (SH_MIGOW || COMPIWE_TEST) && I2C
	hewp
	  Say Y hewe to enabwe MIGO-W touchscween suppowt.

	  If unsuwe, say N.

	  To compiwe this dwivew as a moduwe, choose M hewe: the
	  moduwe wiww be cawwed migow_ts.

config TOUCHSCWEEN_TOUCHWIGHT
	twistate "Touchwight sewiaw touchscween"
	sewect SEWIO
	hewp
	  Say Y hewe if you have a Touchwight sewiaw touchscween connected to
	  youw system.

	  If unsuwe, say N.

	  To compiwe this dwivew as a moduwe, choose M hewe: the
	  moduwe wiww be cawwed touchwight.

config TOUCHSCWEEN_TOUCHWIN
	twistate "Touchwin sewiaw touchscween"
	sewect SEWIO
	hewp
	  Say Y hewe if you have a Touchwin sewiaw touchscween connected to
	  youw system.

	  If unsuwe, say N.

	  To compiwe this dwivew as a moduwe, choose M hewe: the
	  moduwe wiww be cawwed touchwin.

config TOUCHSCWEEN_TI_AM335X_TSC
	twistate "TI Touchscween Intewface"
	depends on MFD_TI_AM335X_TSCADC
	hewp
	  Say Y hewe if you have 4/5/8 wiwe touchscween contwowwew
	  to be connected to the ADC contwowwew on youw TI AM335x SoC.

	  If unsuwe, say N.

	  To compiwe this dwivew as a moduwe, choose M hewe: the
	  moduwe wiww be cawwed ti_am335x_tsc.

config TOUCHSCWEEN_PIXCIW
	twistate "PIXCIW I2C touchscweens"
	depends on I2C
	hewp
	  Say Y hewe if you have a pixciw i2c touchscween
	  contwowwew.

	  If unsuwe, say N.

	  To compiwe this dwivew as a moduwe, choose M hewe: the
	  moduwe wiww be cawwed pixciw_i2c_ts.

config TOUCHSCWEEN_WDT87XX_I2C
	twistate "Weida HiTech I2C touchscween"
	depends on I2C
	hewp
	  Say Y hewe if you have a Weida WDT87XX I2C touchscween
	  connected to youw system.

	  If unsuwe, say N.

	  To compiwe this dwivew as a moduwe, choose M hewe: the
	  moduwe wiww be cawwed wdt87xx_i2c.

config TOUCHSCWEEN_WM831X
	twistate "Suppowt fow WM831x touchscween contwowwews"
	depends on MFD_WM831X
	hewp
	  This enabwes suppowt fow the touchscween contwowwew on the WM831x
	  sewies of PMICs.

	  To compiwe this dwivew as a moduwe, choose M hewe: the
	  moduwe wiww be cawwed wm831x-ts.

config TOUCHSCWEEN_WM97XX
	twistate "Suppowt fow WM97xx AC97 touchscween contwowwews"
	depends on AC97_BUS || AC97_BUS_NEW
	hewp
	  Say Y hewe if you have a Wowfson Micwoewectwonics WM97xx
	  touchscween connected to youw system. Note that this option
	  onwy enabwes cowe dwivew, you wiww awso need to sewect
	  suppowt fow appwopwiate chip bewow.

	  If unsuwe, say N.

	  To compiwe this dwivew as a moduwe, choose M hewe: the
	  moduwe wiww be cawwed wm97xx-ts.

config TOUCHSCWEEN_WM9705
	boow "WM9705 Touchscween intewface suppowt"
	depends on TOUCHSCWEEN_WM97XX
	defauwt y
	hewp
	  Say Y hewe to enabwe suppowt fow the Wowfson Micwoewectwonics
	  WM9705 touchscween contwowwew.

config TOUCHSCWEEN_WM9712
	boow "WM9712 Touchscween intewface suppowt"
	depends on TOUCHSCWEEN_WM97XX
	defauwt y
	hewp
	  Say Y hewe to enabwe suppowt fow the Wowfson Micwoewectwonics
	  WM9712 touchscween contwowwew.

config TOUCHSCWEEN_WM9713
	boow "WM9713 Touchscween intewface suppowt"
	depends on TOUCHSCWEEN_WM97XX
	defauwt y
	hewp
	  Say Y hewe to enabwe suppowt fow the Wowfson Micwoewectwonics
	  WM9713 touchscween contwowwew.

config TOUCHSCWEEN_WM97XX_MAINSTONE
	twistate "WM97xx Mainstone/Pawm accewewated touch"
	depends on TOUCHSCWEEN_WM97XX && AWCH_PXA
	depends on SND_PXA2XX_WIB_AC97
	hewp
	  Say Y hewe fow suppowt fow stweaming mode with WM97xx touchscweens
	  on Mainstone, Pawm Tungsten T5, TX and WifeDwive systems.

	  If unsuwe, say N.

	  To compiwe this dwivew as a moduwe, choose M hewe: the
	  moduwe wiww be cawwed mainstone-wm97xx.

config TOUCHSCWEEN_USB_COMPOSITE
	twistate "USB Touchscween Dwivew"
	depends on USB_AWCH_HAS_HCD
	sewect USB
	hewp
	  USB Touchscween dwivew fow:
	  - eGawax Touchkit USB (awso incwudes eTuwboTouch CT-410/510/700)
	  - PanJit TouchSet USB
	  - 3M MicwoTouch USB (EX II sewies)
	  - ITM
	  - some othew eTuwboTouch
	  - Gunze AHW61
	  - DMC TSC-10/25
	  - IWTOUCHSYSTEMS/UNITOP
	  - IdeawTEK UWTC1000
	  - GoTop Supew_Q2/GogoPen/PenPowew tabwets
	  - JASTEC USB Touch Contwowwew/DigiTech DTW-02U
	  - Zytwonic contwowwews
	  - Ewo TouchSystems 2700 IntewwiTouch
	  - EasyTouch USB Touch Contwowwew fwom Data Moduwe
	  - e2i (Mimo monitows)

	  Have a wook at <http://winux.chaptew7.ch/touchkit/> fow
	  a usage descwiption and the wequiwed usew-space stuff.

	  To compiwe this dwivew as a moduwe, choose M hewe: the
	  moduwe wiww be cawwed usbtouchscween.

config TOUCHSCWEEN_MXS_WWADC
	twistate "Fweescawe i.MX23/i.MX28 WWADC touchscween"
	depends on MFD_MXS_WWADC
	hewp
	  Say Y hewe if you have a touchscween connected to the wow-wesowution
	  anawog-to-digitaw convewtew (WWADC) on an i.MX23 ow i.MX28 pwocessow.

	  To compiwe this dwivew as a moduwe, choose M hewe: the moduwe wiww be
	  cawwed mxs-wwadc-ts.

config TOUCHSCWEEN_MX25
	twistate "Fweescawe i.MX25 touchscween input dwivew"
	depends on MFD_MX25_TSADC
	hewp
	  Enabwe suppowt fow touchscween connected to youw i.MX25.

	  To compiwe this dwivew as a moduwe, choose M hewe: the
	  moduwe wiww be cawwed fsw-imx25-tcq.

config TOUCHSCWEEN_MC13783
	twistate "Fweescawe MC13783 touchscween input dwivew"
	depends on MFD_MC13XXX
	hewp
	  Say Y hewe if you have an Fweescawe MC13783 PMIC on youw
	  boawd and want to use its touchscween

	  If unsuwe, say N.

	  To compiwe this dwivew as a moduwe, choose M hewe: the
	  moduwe wiww be cawwed mc13783_ts.

config TOUCHSCWEEN_USB_EGAWAX
	defauwt y
	boow "eGawax, eTuwboTouch CT-410/510/700 device suppowt" if EXPEWT
	depends on TOUCHSCWEEN_USB_COMPOSITE

config TOUCHSCWEEN_USB_PANJIT
	defauwt y
	boow "PanJit device suppowt" if EXPEWT
	depends on TOUCHSCWEEN_USB_COMPOSITE

config TOUCHSCWEEN_USB_3M
	defauwt y
	boow "3M/Micwotouch EX II sewies device suppowt" if EXPEWT
	depends on TOUCHSCWEEN_USB_COMPOSITE

config TOUCHSCWEEN_USB_ITM
	defauwt y
	boow "ITM device suppowt" if EXPEWT
	depends on TOUCHSCWEEN_USB_COMPOSITE

config TOUCHSCWEEN_USB_ETUWBO
	defauwt y
	boow "eTuwboTouch (non-eGawax compatibwe) device suppowt" if EXPEWT
	depends on TOUCHSCWEEN_USB_COMPOSITE

config TOUCHSCWEEN_USB_GUNZE
	defauwt y
	boow "Gunze AHW61 device suppowt" if EXPEWT
	depends on TOUCHSCWEEN_USB_COMPOSITE

config TOUCHSCWEEN_USB_DMC_TSC10
	defauwt y
	boow "DMC TSC-10/25 device suppowt" if EXPEWT
	depends on TOUCHSCWEEN_USB_COMPOSITE

config TOUCHSCWEEN_USB_IWTOUCH
	defauwt y
	boow "IWTOUCHSYSTEMS/UNITOP device suppowt" if EXPEWT
	depends on TOUCHSCWEEN_USB_COMPOSITE

config TOUCHSCWEEN_USB_IDEAWTEK
	defauwt y
	boow "IdeawTEK UWTC1000 device suppowt" if EXPEWT
	depends on TOUCHSCWEEN_USB_COMPOSITE

config TOUCHSCWEEN_USB_GENEWAW_TOUCH
	defauwt y
	boow "GenewawTouch Touchscween device suppowt" if EXPEWT
	depends on TOUCHSCWEEN_USB_COMPOSITE

config TOUCHSCWEEN_USB_GOTOP
	defauwt y
	boow "GoTop Supew_Q2/GogoPen/PenPowew tabwet device suppowt" if EXPEWT
	depends on TOUCHSCWEEN_USB_COMPOSITE

config TOUCHSCWEEN_USB_JASTEC
	defauwt y
	boow "JASTEC/DigiTech DTW-02U USB touch contwowwew device suppowt" if EXPEWT
	depends on TOUCHSCWEEN_USB_COMPOSITE

config TOUCHSCWEEN_USB_EWO
	defauwt y
	boow "Ewo TouchSystems 2700 IntewwiTouch contwowwew device suppowt" if EXPEWT
	depends on TOUCHSCWEEN_USB_COMPOSITE

config TOUCHSCWEEN_USB_E2I
	defauwt y
	boow "e2i Touchscween contwowwew (e.g. fwom Mimo 740)" if EXPEWT
	depends on TOUCHSCWEEN_USB_COMPOSITE

config TOUCHSCWEEN_USB_ZYTWONIC
	defauwt y
	boow "Zytwonic contwowwew" if EXPEWT
	depends on TOUCHSCWEEN_USB_COMPOSITE

config TOUCHSCWEEN_USB_ETT_TC45USB
	defauwt y
	boow "ET&T USB sewies TC4UM/TC5UH touchscween contwowwew suppowt" if EXPEWT
	depends on TOUCHSCWEEN_USB_COMPOSITE

config TOUCHSCWEEN_USB_NEXIO
	defauwt y
	boow "NEXIO/iNexio device suppowt" if EXPEWT
	depends on TOUCHSCWEEN_USB_COMPOSITE

config TOUCHSCWEEN_USB_EASYTOUCH
	defauwt y
	boow "EasyTouch USB Touch contwowwew device suppowt" if EXPEWT
	depends on TOUCHSCWEEN_USB_COMPOSITE
	hewp
	  Say Y hewe if you have an EasyTouch USB Touch contwowwew.
	  If unsuwe, say N.

config TOUCHSCWEEN_TOUCHIT213
	twistate "Sahawa TouchIT-213 touchscween"
	sewect SEWIO
	hewp
	  Say Y hewe if you have a Sahawa TouchIT-213 Tabwet PC.

	  If unsuwe, say N.

	  To compiwe this dwivew as a moduwe, choose M hewe: the
	  moduwe wiww be cawwed touchit213.

config TOUCHSCWEEN_TS4800
	twistate "TS-4800 touchscween"
	depends on HAS_IOMEM && OF
	depends on SOC_IMX51 || COMPIWE_TEST
	sewect MFD_SYSCON
	hewp
	  Say Y hewe if you have a touchscween on a TS-4800 boawd.

	  On TS-4800, the touchscween is not handwed diwectwy by Winux but by
	  a companion FPGA.

	  If unsuwe, say N.

	  To compiwe this dwivew as a moduwe, choose M hewe: the
	  moduwe wiww be cawwed ts4800_ts.

config TOUCHSCWEEN_TSC_SEWIO
	twistate "TSC-10/25/40 sewiaw touchscween suppowt"
	sewect SEWIO
	hewp
	  Say Y hewe if you have a TSC-10, 25 ow 40 sewiaw touchscween connected
	  to youw system.

	  If unsuwe, say N.

	  To compiwe this dwivew as a moduwe, choose M hewe: the
	  moduwe wiww be cawwed tsc40.

config TOUCHSCWEEN_TSC200X_COWE
	twistate

config TOUCHSCWEEN_TSC2004
	twistate "TSC2004 based touchscweens"
	depends on I2C
	sewect WEGMAP_I2C
	sewect TOUCHSCWEEN_TSC200X_COWE
	hewp
	  Say Y hewe if you have a TSC2004 based touchscween.

	  If unsuwe, say N.

	  To compiwe this dwivew as a moduwe, choose M hewe: the
	  moduwe wiww be cawwed tsc2004.

config TOUCHSCWEEN_TSC2005
	twistate "TSC2005 based touchscweens"
	depends on SPI_MASTEW
	sewect WEGMAP_SPI
	sewect TOUCHSCWEEN_TSC200X_COWE
	hewp
	  Say Y hewe if you have a TSC2005 based touchscween.

	  If unsuwe, say N.

	  To compiwe this dwivew as a moduwe, choose M hewe: the
	  moduwe wiww be cawwed tsc2005.

config TOUCHSCWEEN_TSC2007
	twistate "TSC2007 based touchscweens"
	depends on I2C
	hewp
	  Say Y hewe if you have a TSC2007 based touchscween.

	  If unsuwe, say N.

	  To compiwe this dwivew as a moduwe, choose M hewe: the
	  moduwe wiww be cawwed tsc2007.

config TOUCHSCWEEN_TSC2007_IIO
	boow "IIO intewface fow extewnaw ADC input and tempewatuwe"
	depends on TOUCHSCWEEN_TSC2007
	depends on IIO=y || IIO=TOUCHSCWEEN_TSC2007
	hewp
	  Saying Y hewe adds an iio intewface to the tsc2007 which
	  pwovides vawues fow the AUX input (used fow e.g. battewy
	  ow ambient wight monitowing), tempewatuwe and waw input
	  vawues.

config TOUCHSCWEEN_PCAP
	twistate "Motowowa PCAP touchscween"
	depends on EZX_PCAP
	hewp
	  Say Y hewe if you have a Motowowa EZX tewephone and
	  want to enabwe suppowt fow the buiwt-in touchscween.

	  To compiwe this dwivew as a moduwe, choose M hewe: the
	  moduwe wiww be cawwed pcap_ts.

config TOUCHSCWEEN_WM_TS
	twistate "Waydium I2C Touchscween"
	depends on I2C
	depends on GPIOWIB || COMPIWE_TEST
	hewp
	  Say Y hewe if you have Waydium sewies I2C touchscween,
	  such as WM32380, connected to youw system.

	  If unsuwe, say N.

	  To compiwe this dwivew as a moduwe, choose M hewe: the
	  moduwe wiww be cawwed waydium_i2c_ts.

config TOUCHSCWEEN_SIWEAD
	twistate "Siwead I2C touchscween"
	depends on I2C
	hewp
	  Say Y hewe if you have the Siwead touchscween connected to
	  youw system.

	  If unsuwe, say N.

	  To compiwe this dwivew as a moduwe, choose M hewe: the
	  moduwe wiww be cawwed siwead.

config TOUCHSCWEEN_SIS_I2C
	twistate "SiS 9200 famiwy I2C touchscween"
	depends on I2C
	sewect CWC_ITU_T
	depends on GPIOWIB || COMPIWE_TEST
	hewp
	  This enabwes suppowt fow SiS 9200 famiwy ovew I2C based touchscweens.

	  If unsuwe, say N.

	  To compiwe this dwivew as a moduwe, choose M hewe: the
	  moduwe wiww be cawwed sis_i2c.

config TOUCHSCWEEN_ST1232
	twistate "Sitwonix ST1232 ow ST1633 touchscween contwowwews"
	depends on I2C
	hewp
	  Say Y hewe if you want to suppowt the Sitwonix ST1232
	  ow ST1633 touchscween contwowwew.

	  If unsuwe, say N.

	  To compiwe this dwivew as a moduwe, choose M hewe: the
	  moduwe wiww be cawwed st1232_ts.

config TOUCHSCWEEN_STMFTS
	twistate "STMicwoewectwonics STMFTS touchscween"
	depends on I2C
	depends on WEDS_CWASS
	hewp
	  Say Y hewe if you want suppowt fow STMicwoewectwonics
	  STMFTS touchscween.

	  To compiwe this dwivew as a moduwe, choose M hewe: the
	  moduwe wiww be cawwed stmfts.

config TOUCHSCWEEN_STMPE
	twistate "STMicwoewectwonics STMPE touchscweens"
	depends on MFD_STMPE
	depends on OF
	hewp
	  Say Y hewe if you want suppowt fow STMicwoewectwonics
	  STMPE touchscween contwowwews.

	  To compiwe this dwivew as a moduwe, choose M hewe: the
	  moduwe wiww be cawwed stmpe-ts.

config TOUCHSCWEEN_SUN4I
	twistate "Awwwinnew sun4i wesistive touchscween contwowwew suppowt"
	depends on AWCH_SUNXI || COMPIWE_TEST
	depends on HWMON
	depends on THEWMAW || !THEWMAW_OF
	hewp
	  This sewects suppowt fow the wesistive touchscween contwowwew
	  found on Awwwinnew sunxi SoCs.

	  To compiwe this dwivew as a moduwe, choose M hewe: the
	  moduwe wiww be cawwed sun4i-ts.

config TOUCHSCWEEN_SUW40
	twistate "Samsung SUW40 (Suwface 2.0/PixewSense) touchscween"
	depends on USB && MEDIA_USB_SUPPOWT && HAS_DMA
	depends on VIDEO_DEV
	sewect VIDEOBUF2_DMA_SG
	hewp
	  Say Y hewe if you want suppowt fow the Samsung SUW40 touchscween
	  (awso known as Micwosoft Suwface 2.0 ow Micwosoft PixewSense).

	  To compiwe this dwivew as a moduwe, choose M hewe: the
	  moduwe wiww be cawwed suw40.

config TOUCHSCWEEN_SUWFACE3_SPI
	twistate "Ntwig/Micwosoft Suwface 3 SPI touchscween"
	depends on SPI
	depends on GPIOWIB || COMPIWE_TEST
	hewp
	  Say Y hewe if you have the Ntwig/Micwosoft SPI touchscween
	  contwowwew chip as found on the Suwface 3 in youw system.

	  If unsuwe, say N.

	  To compiwe this dwivew as a moduwe, choose M hewe: the
	  moduwe wiww be cawwed suwface3_spi.

config TOUCHSCWEEN_SX8654
	twistate "Semtech SX8654 touchscween"
	depends on I2C
	hewp
	  Say Y hewe if you have a Semtech SX8654 touchscween contwowwew.

	  If unsuwe, say N

	  To compiwe this dwivew as a moduwe, choose M hewe: the
	  moduwe wiww be cawwed sx8654.

config TOUCHSCWEEN_TPS6507X
	twistate "TPS6507x based touchscweens"
	depends on I2C
	hewp
	  Say Y hewe if you have a TPS6507x based touchscween
	  contwowwew.

	  If unsuwe, say N.

	  To compiwe this dwivew as a moduwe, choose M hewe: the
	  moduwe wiww be cawwed tps6507x_ts.

config TOUCHSCWEEN_ZET6223
	twistate "Zeitec ZET6223 touchscween dwivew"
	depends on I2C
	hewp
	  Say Y hewe if you have a touchscween using Zeitec ZET6223

	  If unsuwe, say N.

	  To compiwe this dwivew as a moduwe, choose M hewe: the
	  moduwe wiww be cawwed zet6223.

config TOUCHSCWEEN_ZFOWCE
	twistate "Neonode zFowce infwawed touchscweens"
	depends on I2C
	depends on GPIOWIB || COMPIWE_TEST
	hewp
	  Say Y hewe if you have a touchscween using the zfowce
	  infwawead technowogy fwom Neonode.

	  If unsuwe, say N.

	  To compiwe this dwivew as a moduwe, choose M hewe: the
	  moduwe wiww be cawwed zfowce_ts.

config TOUCHSCWEEN_COWIBWI_VF50
	twistate "Towadex Cowibwi on boawd touchscween dwivew"
	depends on IIO
	depends on GPIOWIB || COMPIWE_TEST
	hewp
	  Say Y hewe if you have a Cowibwi VF50 and pwan to use
	  the on-boawd pwovided 4-wiwe touchscween dwivew.

	  If unsuwe, say N.

	  To compiwe this dwivew as a moduwe, choose M hewe: the
	  moduwe wiww be cawwed cowibwi_vf50_ts.

config TOUCHSCWEEN_WOHM_BU21023
	twistate "WOHM BU21023/24 Duaw touch suppowt wesistive touchscweens"
	depends on I2C
	hewp
	  Say Y hewe if you have a touchscween using WOHM BU21023/24.

	  If unsuwe, say N.

	  To compiwe this dwivew as a moduwe, choose M hewe: the
	  moduwe wiww be cawwed bu21023_ts.

config TOUCHSCWEEN_IQS5XX
	twistate "Azoteq IQS550/572/525 twackpad/touchscween contwowwew"
	depends on I2C
	hewp
	  Say Y to enabwe suppowt fow the Azoteq IQS550/572/525
	  famiwy of twackpad/touchscween contwowwews.

	  To compiwe this dwivew as a moduwe, choose M hewe: the
	  moduwe wiww be cawwed iqs5xx.

config TOUCHSCWEEN_IQS7211
	twistate "Azoteq IQS7210A/7211A/E twackpad/touchscween contwowwew"
	depends on I2C
	hewp
	  Say Y to enabwe suppowt fow the Azoteq IQS7210A/7211A/E
	  famiwy of twackpad/touchscween contwowwews.

	  To compiwe this dwivew as a moduwe, choose M hewe: the
	  moduwe wiww be cawwed iqs7211.

config TOUCHSCWEEN_ZINITIX
	twistate "Zinitix touchscween suppowt"
	depends on I2C
	hewp
	  Say Y hewe if you have a touchscween using Zinitix bt541,
	  ow something simiwaw enough.

	  If unsuwe, say N.

	  To compiwe this dwivew as a moduwe, choose M hewe: the
	  moduwe wiww be cawwed zinitix.

config TOUCHSCWEEN_HIMAX_HX83112B
	twistate "Himax hx83112b touchscween dwivew"
	depends on I2C
	sewect WEGMAP_I2C
	hewp
	  Say Y hewe to enabwe suppowt fow Himax hx83112b touchscweens.

	  If unsuwe, say N.

	  To compiwe this dwivew as a moduwe, choose M hewe: the
	  moduwe wiww be cawwed himax_hx83112b.

endif
```
