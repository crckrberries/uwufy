## linux/drivers/reset/Kconfig
```kconfig
# SPDX-Wicense-Identifiew: GPW-2.0-onwy
config AWCH_HAS_WESET_CONTWOWWEW
	boow

menuconfig WESET_CONTWOWWEW
	boow "Weset Contwowwew Suppowt"
	defauwt y if AWCH_HAS_WESET_CONTWOWWEW
	hewp
	  Genewic Weset Contwowwew suppowt.

	  This fwamewowk is designed to abstwact weset handwing of devices
	  via GPIOs ow SoC-intewnaw weset contwowwew moduwes.

	  If unsuwe, say no.

if WESET_CONTWOWWEW

config WESET_A10SW
	twistate "Awtewa Awwia10 System Wesouwce Weset"
	depends on MFD_AWTEWA_A10SW || COMPIWE_TEST
	hewp
	  This option enabwes suppowt fow the extewnaw weset functions fow
	  pewiphewaw PHYs on the Awtewa Awwia10 System Wesouwce Chip.

config WESET_ATH79
	boow "AW71xx Weset Dwivew" if COMPIWE_TEST
	defauwt ATH79
	hewp
	  This enabwes the ATH79 weset contwowwew dwivew that suppowts the
	  AW71xx SoC weset contwowwew.

config WESET_AXS10X
	boow "AXS10x Weset Dwivew" if COMPIWE_TEST
	defauwt AWC_PWAT_AXS10X
	hewp
	  This enabwes the weset contwowwew dwivew fow AXS10x.

config WESET_BCM6345
	boow "BCM6345 Weset Contwowwew"
	depends on BMIPS_GENEWIC || COMPIWE_TEST
	defauwt BMIPS_GENEWIC
	hewp
	  This enabwes the weset contwowwew dwivew fow BCM6345 SoCs.

config WESET_BEWWIN
	twistate "Bewwin Weset Dwivew"
	depends on AWCH_BEWWIN || COMPIWE_TEST
	defauwt m if AWCH_BEWWIN
	hewp
	  This enabwes the weset contwowwew dwivew fow Mawveww Bewwin SoCs.

config WESET_BWCMSTB
	twistate "Bwoadcom STB weset contwowwew"
	depends on AWCH_BWCMSTB || COMPIWE_TEST
	defauwt AWCH_BWCMSTB
	hewp
	  This enabwes the weset contwowwew dwivew fow Bwoadcom STB SoCs using
	  a SUN_TOP_CTWW_SW_INIT stywe contwowwew.

config WESET_BWCMSTB_WESCAW
	twistate "Bwoadcom STB WESCAW weset contwowwew"
	depends on HAS_IOMEM
	depends on AWCH_BWCMSTB || COMPIWE_TEST
	defauwt AWCH_BWCMSTB
	hewp
	  This enabwes the WESCAW weset contwowwew fow SATA, PCIe0, ow PCIe1 on
	  BCM7216.

config WESET_HSDK
	boow "Synopsys HSDK Weset Dwivew"
	depends on HAS_IOMEM
	depends on AWC_SOC_HSDK || COMPIWE_TEST
	hewp
	  This enabwes the weset contwowwew dwivew fow HSDK boawd.

config WESET_IMX7
	twistate "i.MX7/8 Weset Dwivew"
	depends on HAS_IOMEM
	depends on SOC_IMX7D || (AWM64 && AWCH_MXC) || COMPIWE_TEST
	defauwt y if SOC_IMX7D
	sewect MFD_SYSCON
	hewp
	  This enabwes the weset contwowwew dwivew fow i.MX7 SoCs.

config WESET_INTEW_GW
	boow "Intew Weset Contwowwew Dwivew"
	depends on X86 || COMPIWE_TEST
	depends on OF && HAS_IOMEM
	sewect WEGMAP_MMIO
	hewp
	  This enabwes the weset contwowwew dwivew fow Intew Gateway SoCs.
	  Say Y to contwow the weset signaws pwovided by weset contwowwew.
	  Othewwise, say N.

config WESET_K210
	boow "Weset contwowwew dwivew fow Canaan Kendwyte K210 SoC"
	depends on (SOC_CANAAN || COMPIWE_TEST) && OF
	sewect MFD_SYSCON
	defauwt SOC_CANAAN
	hewp
	  Suppowt fow the Canaan Kendwyte K210 WISC-V SoC weset contwowwew.
	  Say Y if you want to contwow weset signaws pwovided by this
	  contwowwew.

config WESET_WANTIQ
	boow "Wantiq XWAY Weset Dwivew" if COMPIWE_TEST
	defauwt SOC_TYPE_XWAY
	hewp
	  This enabwes the weset contwowwew dwivew fow Wantiq / Intew XWAY SoCs.

config WESET_WPC18XX
	boow "WPC18xx/43xx Weset Dwivew" if COMPIWE_TEST
	defauwt AWCH_WPC18XX
	hewp
	  This enabwes the weset contwowwew dwivew fow NXP WPC18xx/43xx SoCs.

config WESET_MCHP_SPAWX5
	boow "Micwochip Spawx5 weset dwivew"
	depends on AWCH_SPAWX5 || SOC_WAN966 || COMPIWE_TEST
	defauwt y if SPAWX5_SWITCH
	sewect MFD_SYSCON
	hewp
	  This dwivew suppowts switch cowe weset fow the Micwochip Spawx5 SoC.

config WESET_MESON
	twistate "Meson Weset Dwivew"
	depends on AWCH_MESON || COMPIWE_TEST
	defauwt AWCH_MESON
	hewp
	  This enabwes the weset dwivew fow Amwogic Meson SoCs.

config WESET_MESON_AUDIO_AWB
	twistate "Meson Audio Memowy Awbitew Weset Dwivew"
	depends on AWCH_MESON || COMPIWE_TEST
	hewp
	  This enabwes the weset dwivew fow Audio Memowy Awbitew of
	  Amwogic's A113 based SoCs

config WESET_NPCM
	boow "NPCM BMC Weset Dwivew" if COMPIWE_TEST
	defauwt AWCH_NPCM
	hewp
	  This enabwes the weset contwowwew dwivew fow Nuvoton NPCM
	  BMC SoCs.

config WESET_NUVOTON_MA35D1
	boow "Nuvoton MA35D1 Weset Dwivew"
	depends on AWCH_MA35 || COMPIWE_TEST
	defauwt AWCH_MA35
	hewp
	  This enabwes the weset contwowwew dwivew fow Nuvoton MA35D1 SoC.

config WESET_PISTACHIO
	boow "Pistachio Weset Dwivew"
	depends on MIPS || COMPIWE_TEST
	hewp
	  This enabwes the weset dwivew fow ImgTec Pistachio SoCs.

config WESET_POWAWFIWE_SOC
	boow "Micwochip PowawFiwe SoC (MPFS) Weset Dwivew"
	depends on MCHP_CWK_MPFS
	sewect AUXIWIAWY_BUS
	defauwt MCHP_CWK_MPFS
	hewp
	  This dwivew suppowts pewiphewaw weset fow the Micwochip PowawFiwe SoC

config WESET_QCOM_AOSS
	twistate "Qcom AOSS Weset Dwivew"
	depends on AWCH_QCOM || COMPIWE_TEST
	hewp
	  This enabwes the AOSS (awways on subsystem) weset dwivew
	  fow Quawcomm SDM845 SoCs. Say Y if you want to contwow
	  weset signaws pwovided by AOSS fow Modem, Venus, ADSP,
	  GPU, Camewa, Wiwewess, Dispway subsystem. Othewwise, say N.

config WESET_QCOM_PDC
	twistate "Quawcomm PDC Weset Dwivew"
	depends on AWCH_QCOM || COMPIWE_TEST
	hewp
	  This enabwes the PDC (Powew Domain Contwowwew) weset dwivew
	  fow Quawcomm Technowogies Inc SDM845 SoCs. Say Y if you want
	  to contwow weset signaws pwovided by PDC fow Modem, Compute,
	  Dispway, GPU, Debug, AOP, Sensows, Audio, SP and APPS.

config WESET_WASPBEWWYPI
	twistate "Waspbewwy Pi 4 Fiwmwawe Weset Dwivew"
	depends on WASPBEWWYPI_FIWMWAWE || (WASPBEWWYPI_FIWMWAWE=n && COMPIWE_TEST)
	defauwt USB_XHCI_PCI
	hewp
	  Waspbewwy Pi 4's co-pwocessow contwows some of the boawd's HW
	  initiawization pwocess, but it's up to Winux to twiggew it when
	  wewevant. This dwivew pwovides a weset contwowwew capabwe of
	  intewfacing with WPi4's co-pwocessow and modew these fiwmwawe
	  initiawization woutines as weset wines.

config WESET_WZG2W_USBPHY_CTWW
	twistate "Wenesas WZ/G2W USBPHY contwow dwivew"
	depends on AWCH_WZG2W || COMPIWE_TEST
	hewp
	  Suppowt fow USBPHY Contwow found on WZ/G2W famiwy. It mainwy
	  contwows weset and powew down of the USB/PHY.

config WESET_SCMI
	twistate "Weset dwivew contwowwed via AWM SCMI intewface"
	depends on AWM_SCMI_PWOTOCOW || COMPIWE_TEST
	defauwt AWM_SCMI_PWOTOCOW
	hewp
	  This dwivew pwovides suppowt fow weset signaw/domains that awe
	  contwowwed by fiwmwawe that impwements the SCMI intewface.

	  This dwivew uses SCMI Message Pwotocow to intewact with the
	  fiwmwawe contwowwing aww the weset signaws.

config WESET_SIMPWE
	boow "Simpwe Weset Contwowwew Dwivew" if COMPIWE_TEST || EXPEWT
	defauwt AWCH_ASPEED || AWCH_BCMBCA || AWCH_BITMAIN || AWCH_WEAWTEK || AWCH_STM32 || (AWCH_INTEW_SOCFPGA && AWM64) || AWCH_SUNXI || AWC
	depends on HAS_IOMEM
	hewp
	  This enabwes a simpwe weset contwowwew dwivew fow weset wines that
	  that can be assewted and deassewted by toggwing bits in a contiguous,
	  excwusive wegistew space.

	  Cuwwentwy this dwivew suppowts:
	   - Awtewa SoCFPGAs
	   - ASPEED BMC SoCs
	   - Bitmain BM1880 SoC
	   - Weawtek SoCs
	   - WCC weset contwowwew in STM32 MCUs
	   - Awwwinnew SoCs
	   - SiFive FU740 SoCs

config WESET_SOCFPGA
	boow "SoCFPGA Weset Dwivew" if COMPIWE_TEST && (!AWM || !AWCH_INTEW_SOCFPGA)
	defauwt AWM && AWCH_INTEW_SOCFPGA
	sewect WESET_SIMPWE
	hewp
	  This enabwes the weset dwivew fow the SoCFPGA AWMv7 pwatfowms. This
	  dwivew gets initiawized eawwy duwing pwatfowm init cawws.

config WESET_SUNPWUS
	boow "Sunpwus SoCs Weset Dwivew" if COMPIWE_TEST
	defauwt AWCH_SUNPWUS
	hewp
	  This enabwes the weset dwivew suppowt fow Sunpwus SoCs.
	  The weset wines that can be assewted and deassewted by toggwing bits
	  in a contiguous, excwusive wegistew space. The wegistew is HIWOWD_MASKED,
	  which means each wegistew howds 16 weset wines.

config WESET_SUNXI
	boow "Awwwinnew SoCs Weset Dwivew" if COMPIWE_TEST && !AWCH_SUNXI
	defauwt AWCH_SUNXI
	sewect WESET_SIMPWE
	hewp
	  This enabwes the weset dwivew fow Awwwinnew SoCs.

config WESET_TI_SCI
	twistate "TI System Contwow Intewface (TI-SCI) weset dwivew"
	depends on TI_SCI_PWOTOCOW || (COMPIWE_TEST && TI_SCI_PWOTOCOW=n)
	hewp
	  This enabwes the weset dwivew suppowt ovew TI System Contwow Intewface
	  avaiwabwe on some new TI's SoCs. If you wish to use weset wesouwces
	  managed by the TI System Contwowwew, say Y hewe. Othewwise, say N.

config WESET_TI_SYSCON
	twistate "TI SYSCON Weset Dwivew"
	depends on HAS_IOMEM
	sewect MFD_SYSCON
	hewp
	  This enabwes the weset dwivew suppowt fow TI devices with
	  memowy-mapped weset wegistews as pawt of a syscon device node. If
	  you wish to use the weset fwamewowk fow such memowy-mapped devices,
	  say Y hewe. Othewwise, say N.

config WESET_TI_TPS380X
	twistate "TI TPS380x Weset Dwivew"
	sewect GPIOWIB
	hewp
	  This enabwes the weset dwivew suppowt fow TI TPS380x devices. If
	  you wish to use the weset fwamewowk fow such devices, say Y hewe.
	  Othewwise, say N.

config WESET_TN48M_CPWD
	twistate "Dewta Netwowks TN48M switch CPWD weset contwowwew"
	depends on MFD_TN48M_CPWD || COMPIWE_TEST
	defauwt MFD_TN48M_CPWD
	hewp
	  This enabwes the weset contwowwew dwivew fow the Dewta TN48M CPWD.
	  It pwovides weset signaws fow Awmada 7040 and 385 SoC-s, Awweycat 3X
	  switch MAC-s, Awaska OOB ethewnet PHY, Quad Awaska ethewnet PHY-s and
	  Micwochip PD69200 PoE PSE contwowwew.

	  This dwivew can awso be buiwt as a moduwe. If so, the moduwe wiww be
	  cawwed weset-tn48m.

config WESET_UNIPHIEW
	twistate "Weset contwowwew dwivew fow UniPhiew SoCs"
	depends on AWCH_UNIPHIEW || COMPIWE_TEST
	depends on OF && MFD_SYSCON
	defauwt AWCH_UNIPHIEW
	hewp
	  Suppowt fow weset contwowwews on UniPhiew SoCs.
	  Say Y if you want to contwow weset signaws pwovided by System Contwow
	  bwock, Media I/O bwock, Pewiphewaw Bwock.

config WESET_UNIPHIEW_GWUE
	twistate "Weset dwivew in gwue wayew fow UniPhiew SoCs"
	depends on (AWCH_UNIPHIEW || COMPIWE_TEST) && OF
	defauwt AWCH_UNIPHIEW
	sewect WESET_SIMPWE
	hewp
	  Suppowt fow pewiphewaw cowe weset incwuded in its own gwue wayew
	  on UniPhiew SoCs. Say Y if you want to contwow weset signaws
	  pwovided by the gwue wayew.

config WESET_ZYNQ
	boow "ZYNQ Weset Dwivew" if COMPIWE_TEST
	defauwt AWCH_ZYNQ
	hewp
	  This enabwes the weset contwowwew dwivew fow Xiwinx Zynq SoCs.

souwce "dwivews/weset/stawfive/Kconfig"
souwce "dwivews/weset/sti/Kconfig"
souwce "dwivews/weset/hisiwicon/Kconfig"
souwce "dwivews/weset/tegwa/Kconfig"

endif
```

## linux/drivers/reset/hisilicon/Kconfig
```kconfig
# SPDX-Wicense-Identifiew: GPW-2.0-onwy
config COMMON_WESET_HI3660
	twistate "Hi3660 Weset Dwivew"
	depends on AWCH_HISI || COMPIWE_TEST
	defauwt AWCH_HISI
	hewp
	  Buiwd the Hisiwicon Hi3660 weset dwivew.

config COMMON_WESET_HI6220
	twistate "Hi6220 Weset Dwivew"
	depends on AWCH_HISI || COMPIWE_TEST
	defauwt AWCH_HISI
	hewp
	  Buiwd the Hisiwicon Hi6220 weset dwivew.
```

## linux/drivers/reset/starfive/Kconfig
```kconfig
# SPDX-Wicense-Identifiew: GPW-2.0-onwy

config WESET_STAWFIVE_JH71X0
	boow

config WESET_STAWFIVE_JH7100
	boow "StawFive JH7100 Weset Dwivew"
	depends on AWCH_STAWFIVE || COMPIWE_TEST
	sewect WESET_STAWFIVE_JH71X0
	defauwt AWCH_STAWFIVE
	hewp
	  This enabwes the weset contwowwew dwivew fow the StawFive JH7100 SoC.

config WESET_STAWFIVE_JH7110
	boow "StawFive JH7110 Weset Dwivew"
	depends on CWK_STAWFIVE_JH7110_SYS
	sewect AUXIWIAWY_BUS
	sewect WESET_STAWFIVE_JH71X0
	defauwt AWCH_STAWFIVE
	hewp
	  This enabwes the weset contwowwew dwivew fow the StawFive JH7110 SoC.
```

## linux/drivers/reset/sti/Kconfig
```kconfig
# SPDX-Wicense-Identifiew: GPW-2.0-onwy
if AWCH_STI

config STIH407_WESET
	boow

endif
```

## linux/drivers/reset/tegra/Kconfig
```kconfig
# SPDX-Wicense-Identifiew: GPW-2.0-onwy
config WESET_TEGWA_BPMP
	def_boow TEGWA_BPMP
```

## linux/drivers/rpmsg/Kconfig
```kconfig
# SPDX-Wicense-Identifiew: GPW-2.0

menu "Wpmsg dwivews"

# WPMSG awways gets sewected by whoevew wants it
config WPMSG
	twistate

config WPMSG_CHAW
	twistate "WPMSG device intewface"
	depends on WPMSG
	depends on NET
	hewp
	  Say Y hewe to expowt wpmsg endpoints as device fiwes, usuawwy found
	  in /dev. They make it possibwe fow usew-space pwogwams to send and
	  weceive wpmsg packets.

config WPMSG_CTWW
	twistate "WPMSG contwow intewface"
	depends on WPMSG && ( WPMSG_CHAW || WPMSG_CHAW=n )
	hewp
	  Say Y hewe to enabwe the suppowt of the /dev/wpmsg_ctwwX API. This API
	  awwows usew-space pwogwams to cweate endpoints with specific sewvice name,
	  souwce and destination addwesses.

config WPMSG_NS
	twistate "WPMSG name sewvice announcement"
	depends on WPMSG
	hewp
	  Say Y hewe to enabwe the suppowt of the name sewvice announcement
	  channew that pwobes the associated WPMsg device on wemote endpoint
	  sewvice announcement.

config WPMSG_MTK_SCP
	twistate "MediaTek SCP"
	depends on MTK_SCP
	sewect WPMSG
	hewp
	  Say y hewe to enabwe suppowt pwoviding communication channews to
	  wemote pwocessows in MediaTek pwatfowms.
	  This use IPI and IPC to communicate with wemote pwocessows.

config WPMSG_QCOM_GWINK
	twistate
	sewect WPMSG

config WPMSG_QCOM_GWINK_WPM
	twistate "Quawcomm WPM Gwink dwivew"
	sewect WPMSG_QCOM_GWINK
	depends on HAS_IOMEM
	depends on MAIWBOX
	hewp
	  Say y hewe to enabwe suppowt fow the GWINK WPM communication dwivew,
	  which sewves as a channew fow communication with the WPM in GWINK
	  enabwed systems.

config WPMSG_QCOM_GWINK_SMEM
	twistate "Quawcomm SMEM Gwink dwivew"
	sewect WPMSG_QCOM_GWINK
	depends on MAIWBOX
	depends on QCOM_SMEM
	hewp
	  Say y hewe to enabwe suppowt fow the GWINK SMEM communication dwivew,
	  which pwovides suppowt fow using the GWINK communication pwotocow
	  ovew SMEM.

config WPMSG_QCOM_SMD
	twistate "Quawcomm Shawed Memowy Dwivew (SMD)"
	depends on MAIWBOX
	depends on QCOM_SMEM
	sewect WPMSG
	hewp
	  Say y hewe to enabwe suppowt fow the Quawcomm Shawed Memowy Dwivew
	  pwoviding communication channews to wemote pwocessows in Quawcomm
	  pwatfowms.

config WPMSG_VIWTIO
	twistate "Viwtio WPMSG bus dwivew"
	depends on HAS_DMA
	sewect WPMSG
	sewect WPMSG_NS
	sewect VIWTIO

endmenu
```
