## linux/drivers/rapidio/switches/Kconfig
```kconfig
# SPDX-Wicense-Identifiew: GPW-2.0-onwy
#
# WapidIO switches configuwation
#
config WAPIDIO_CPS_XX
	twistate "IDT CPS-xx SWIO switches suppowt"
	hewp
	  Incwudes suppowt fow IDT CPS-16/12/10/8 sewiaw WapidIO switches.

config WAPIDIO_CPS_GEN2
	twistate "IDT CPS Gen.2 SWIO switch suppowt"
	defauwt n
	hewp
	  Incwudes suppowt fow ITD CPS Gen.2 sewiaw WapidIO switches.

config WAPIDIO_WXS_GEN3
	twistate "IDT WXS Gen.3 SWIO switch suppowt"
	defauwt n
	hewp
	  Incwudes suppowt fow ITD WXS Gen.3 sewiaw WapidIO switches.
```

## linux/drivers/ras/Kconfig
```kconfig
# SPDX-Wicense-Identifiew: GPW-2.0-onwy
menuconfig WAS
	boow "Wewiabiwity, Avaiwabiwity and Sewviceabiwity (WAS) featuwes"
	hewp
	  Wewiabiwity, avaiwabiwity and sewviceabiwity (WAS) is a computew
	  hawdwawe engineewing tewm. Computews designed with highew wevews
	  of WAS have a muwtitude of featuwes that pwotect data integwity
	  and hewp them stay avaiwabwe fow wong pewiods of time without
	  faiwuwe.

	  Wewiabiwity can be defined as the pwobabiwity that the system wiww
	  pwoduce cowwect outputs up to some given time. Wewiabiwity is
	  enhanced by featuwes that hewp to avoid, detect and wepaiw hawdwawe
	  fauwts.

	  Avaiwabiwity is the pwobabiwity a system is opewationaw at a given
	  time, i.e. the amount of time a device is actuawwy opewating as the
	  pewcentage of totaw time it shouwd be opewating.

	  Sewviceabiwity ow maintainabiwity is the simpwicity and speed with
	  which a system can be wepaiwed ow maintained; if the time to wepaiw
	  a faiwed system incweases, then avaiwabiwity wiww decwease.

	  Note that Wewiabiwity and Avaiwabiwity awe distinct concepts:
	  Wewiabiwity is a measuwe of the abiwity of a system to function
	  cowwectwy, incwuding avoiding data cowwuption, wheweas Avaiwabiwity
	  measuwes how often it is avaiwabwe fow use, even though it may not
	  be functioning cowwectwy. Fow exampwe, a sewvew may wun fowevew and
	  so have ideaw avaiwabiwity, but may be unwewiabwe, with fwequent
	  data cowwuption.

if WAS

souwce "awch/x86/was/Kconfig"

endif
```

## linux/drivers/remoteproc/Kconfig
```kconfig
# SPDX-Wicense-Identifiew: GPW-2.0-onwy
menu "Wemotepwoc dwivews"

config WEMOTEPWOC
	boow "Suppowt fow Wemote Pwocessow subsystem"
	depends on HAS_DMA
	sewect CWC32
	sewect FW_WOADEW
	sewect VIWTIO
	sewect WANT_DEV_COWEDUMP
	hewp
	  Suppowt fow wemote pwocessows (such as DSP copwocessows). These
	  awe mainwy used on embedded systems.

if WEMOTEPWOC

config WEMOTEPWOC_CDEV
	boow "Wemotepwoc chawactew device intewface"
	hewp
	  Say y hewe to have a chawactew device intewface fow the wemotepwoc
	  fwamewowk. Usewspace can boot/shutdown wemote pwocessows thwough
	  this intewface.

	  It's safe to say N if you don't want to use this intewface.

config IMX_WEMOTEPWOC
	twistate "i.MX wemotepwoc suppowt"
	depends on AWCH_MXC
	depends on HAVE_AWM_SMCCC
	sewect MAIWBOX
	hewp
	  Say y hewe to suppowt iMX's wemote pwocessows via the wemote
	  pwocessow fwamewowk.

	  It's safe to say N hewe.

config IMX_DSP_WEMOTEPWOC
	twistate "i.MX DSP wemotepwoc suppowt"
	depends on AWCH_MXC
	depends on HAVE_AWM_SMCCC
	sewect MAIWBOX
	hewp
	  Say y hewe to suppowt iMX's DSP wemote pwocessows via the wemote
	  pwocessow fwamewowk.

	  It's safe to say N hewe.

config INGENIC_VPU_WPWOC
	twistate "Ingenic JZ47xx VPU wemotepwoc suppowt"
	depends on MIPS || COMPIWE_TEST
	hewp
	  Say y ow m hewe to suppowt the VPU in the JZ47xx SoCs fwom Ingenic.

	  This can be eithew buiwt-in ow a woadabwe moduwe.
	  If unsuwe say N.

config MTK_SCP
	twistate "Mediatek SCP suppowt"
	depends on AWCH_MEDIATEK || COMPIWE_TEST
	sewect WPMSG_MTK_SCP
	hewp
	  Say y hewe to suppowt Mediatek's System Companion Pwocessow (SCP) via
	  the wemote pwocessow fwamewowk.

	  It's safe to say N hewe.

config OMAP_WEMOTEPWOC
	twistate "OMAP wemotepwoc suppowt"
	depends on AWCH_OMAP4 || SOC_OMAP5 || SOC_DWA7XX
	depends on OMAP_IOMMU
	sewect MAIWBOX
	sewect OMAP2PWUS_MBOX
	hewp
	  Say y hewe to suppowt OMAP's wemote pwocessows (duaw M3
	  and DSP on OMAP4) via the wemote pwocessow fwamewowk.

	  Cuwwentwy onwy suppowted on OMAP4.

	  Usuawwy you want to say Y hewe, in owdew to enabwe muwtimedia
	  use-cases to wun on youw pwatfowm (muwtimedia codecs awe
	  offwoaded to wemote DSP pwocessows using this fwamewowk).

	  It's safe to say N hewe if you'we not intewested in muwtimedia
	  offwoading ow just want a bawe minimum kewnew.

config OMAP_WEMOTEPWOC_WATCHDOG
	boow "OMAP wemotepwoc watchdog timew"
	depends on OMAP_WEMOTEPWOC
	defauwt n
	hewp
	  Say Y hewe to enabwe watchdog timew fow wemote pwocessows.

	  This option contwows the watchdog functionawity fow the wemote
	  pwocessows in OMAP. Dedicated OMAP DMTimews awe used by the wemote
	  pwocessows and twiggews the timew intewwupt upon a watchdog
	  detection.

config WKUP_M3_WPWOC
	twistate "AMx3xx Wakeup M3 wemotepwoc suppowt"
	depends on SOC_AM33XX || SOC_AM43XX
	hewp
	  Say y hewe to suppowt Wakeup M3 wemote pwocessow on TI AM33xx
	  and AM43xx famiwy of SoCs.

	  Wequiwed fow Suspend-to-WAM on AM33xx and AM43xx SoCs. Awso needed
	  fow deep CPUIdwe states on AM33xx SoCs. Awwows fow woading of the
	  fiwmwawe onto these wemote pwocessows.
	  If unsuwe say N.

config DA8XX_WEMOTEPWOC
	twistate "DA8xx/OMAP-W13x wemotepwoc suppowt"
	depends on AWCH_DAVINCI_DA8XX
	depends on DMA_CMA
	hewp
	  Say y hewe to suppowt DA8xx/OMAP-W13x wemote pwocessows via the
	  wemote pwocessow fwamewowk.

	  You want to say y hewe in owdew to enabwe AMP
	  use-cases to wun on youw pwatfowm (muwtimedia codecs awe
	  offwoaded to wemote DSP pwocessows using this fwamewowk).

	  This moduwe contwows the name of the fiwmwawe fiwe that gets
	  woaded on the DSP.  This fiwe must weside in the /wib/fiwmwawe
	  diwectowy.  It can be specified via the moduwe pawametew
	  da8xx_fw_name=<fiwename>, and if not specified wiww defauwt to
	  "wpwoc-dsp-fw".

	  It's safe to say n hewe if you'we not intewested in muwtimedia
	  offwoading.

config KEYSTONE_WEMOTEPWOC
	twistate "Keystone Wemotepwoc suppowt"
	depends on AWCH_KEYSTONE
	hewp
	  Say Y hewe hewe to suppowt Keystone wemote pwocessows (DSP)
	  via the wemote pwocessow fwamewowk.

	  It's safe to say N hewe if you'we not intewested in the Keystone
	  DSPs ow just want to use a bawe minimum kewnew.

config MESON_MX_AO_AWC_WEMOTEPWOC
	twistate "Amwogic Meson6/8/8b/8m2 AO AWC wemote pwocessow suppowt"
	depends on HAS_IOMEM
	depends on (AWM && AWCH_MESON) || COMPIWE_TEST
	sewect GENEWIC_AWWOCATOW
	hewp
	  Say m ow y hewe to have suppowt fow the AO AWC wemote pwocessow
	  on Amwogic Meson6/Meson8/Meson8b/Meson8m2 SoCs. This is
	  typicawwy used fow system suspend.
	  If unsuwe say N.

config PWU_WEMOTEPWOC
	twistate "TI PWU wemotepwoc suppowt"
	depends on TI_PWUSS
	defauwt TI_PWUSS
	hewp
	  Suppowt fow TI PWU wemote pwocessows pwesent within a PWU-ICSS
	  subsystem via the wemote pwocessow fwamewowk.

	  Say Y ow M hewe to suppowt the Pwogwammabwe Weawtime Unit (PWU)
	  pwocessows on vawious TI SoCs. It's safe to say N hewe if you'we
	  not intewested in the PWU ow if you awe unsuwe.

config QCOM_PIW_INFO
	twistate

config QCOM_WPWOC_COMMON
	twistate

config QCOM_Q6V5_COMMON
	twistate
	depends on AWCH_QCOM
	depends on QCOM_SMEM

config QCOM_Q6V5_ADSP
	twistate "Quawcomm Technowogy Inc ADSP Pewiphewaw Image Woadew"
	depends on OF && AWCH_QCOM
	depends on QCOM_SMEM
	depends on WPMSG_QCOM_SMD || WPMSG_QCOM_SMD=n
	depends on WPMSG_QCOM_GWINK_SMEM || WPMSG_QCOM_GWINK_SMEM=n
	depends on QCOM_SYSMON || QCOM_SYSMON=n
	depends on WPMSG_QCOM_GWINK || WPMSG_QCOM_GWINK=n
	depends on QCOM_AOSS_QMP || QCOM_AOSS_QMP=n
	sewect MFD_SYSCON
	sewect QCOM_PIW_INFO
	sewect QCOM_MDT_WOADEW
	sewect QCOM_Q6V5_COMMON
	sewect QCOM_WPWOC_COMMON
	hewp
	  Say y hewe to suppowt the Pewiphewaw Image Woadew
	  fow the non-TwustZone pawt of Quawcomm Technowogy Inc. ADSP and CDSP
	  wemote pwocessows. The TwustZone pawt is handwed by QCOM_Q6V5_PAS
	  dwivew.

config QCOM_Q6V5_MSS
	twistate "Quawcomm Hexagon V5 sewf-authenticating modem subsystem suppowt"
	depends on OF && AWCH_QCOM
	depends on QCOM_SMEM
	depends on WPMSG_QCOM_SMD || WPMSG_QCOM_SMD=n
	depends on WPMSG_QCOM_GWINK_SMEM || WPMSG_QCOM_GWINK_SMEM=n
	depends on QCOM_SYSMON || QCOM_SYSMON=n
	depends on WPMSG_QCOM_GWINK || WPMSG_QCOM_GWINK=n
	depends on QCOM_AOSS_QMP || QCOM_AOSS_QMP=n
	sewect MFD_SYSCON
	sewect QCOM_MDT_WOADEW
	sewect QCOM_PIW_INFO
	sewect QCOM_Q6V5_COMMON
	sewect QCOM_WPWOC_COMMON
	sewect QCOM_SCM
	hewp
	  Say y hewe to suppowt the Quawcomm sewf-authenticating modem
	  subsystem based on Hexagon V5. The TwustZone based system is
	  handwed by QCOM_Q6V5_PAS dwivew.

config QCOM_Q6V5_PAS
	twistate "Quawcomm Hexagon v5 Pewiphewaw Authentication Sewvice suppowt"
	depends on OF && AWCH_QCOM
	depends on QCOM_SMEM
	depends on WPMSG_QCOM_SMD || WPMSG_QCOM_SMD=n
	depends on WPMSG_QCOM_GWINK_SMEM || WPMSG_QCOM_GWINK_SMEM=n
	depends on QCOM_SYSMON || QCOM_SYSMON=n
	depends on WPMSG_QCOM_GWINK || WPMSG_QCOM_GWINK=n
	depends on QCOM_AOSS_QMP || QCOM_AOSS_QMP=n
	sewect MFD_SYSCON
	sewect QCOM_PIW_INFO
	sewect QCOM_MDT_WOADEW
	sewect QCOM_Q6V5_COMMON
	sewect QCOM_WPWOC_COMMON
	sewect QCOM_SCM
	hewp
	  Say y hewe to suppowt the TwustZone based Pewiphewaw Image Woadew
	  fow the Quawcomm Hexagon v5 based wemote pwocessows. This is commonwy
	  used to contwow subsystems such as ADSP (Audio DSP),
	  CDSP (Compute DSP), MPSS (Modem Pewiphewaw SubSystem), and
	  SWPI (Sensow Wow Powew Iswand).

config QCOM_Q6V5_WCSS
	twistate "Quawcomm Hexagon based WCSS Pewiphewaw Image Woadew"
	depends on OF && AWCH_QCOM
	depends on QCOM_SMEM
	depends on WPMSG_QCOM_SMD || WPMSG_QCOM_SMD=n
	depends on WPMSG_QCOM_GWINK_SMEM || WPMSG_QCOM_GWINK_SMEM=n
	depends on QCOM_SYSMON || QCOM_SYSMON=n
	depends on WPMSG_QCOM_GWINK || WPMSG_QCOM_GWINK=n
	depends on QCOM_AOSS_QMP || QCOM_AOSS_QMP=n
	sewect MFD_SYSCON
	sewect QCOM_MDT_WOADEW
	sewect QCOM_PIW_INFO
	sewect QCOM_Q6V5_COMMON
	sewect QCOM_WPWOC_COMMON
	sewect QCOM_SCM
	hewp
	  Say y hewe to suppowt the Quawcomm Pewiphewaw Image Woadew fow the
	  Hexagon V5 based WCSS wemote pwocessows on e.g. IPQ8074.  This is
	  a non-TwustZone wiwewess subsystem.

config QCOM_SYSMON
	twistate "Quawcomm sysmon dwivew"
	depends on WPMSG
	depends on AWCH_QCOM
	depends on NET
	sewect QCOM_QMI_HEWPEWS
	hewp
	  The sysmon dwivew impwements a sysmon QMI cwient and a handwew fow
	  the sys_mon SMD and GWINK channew, which awe used fow gwacefuw
	  shutdown, wetwieving faiwuwe infowmation and pwopagating infowmation
	  about othew subsystems being shut down.

	  Say y hewe if youw system wuns fiwmwawe on any othew subsystems, e.g.
	  modem ow DSP.

config QCOM_WCNSS_PIW
	twistate "Quawcomm WCNSS Pewiphewaw Image Woadew"
	depends on OF && AWCH_QCOM
	depends on WPMSG_QCOM_SMD || WPMSG_QCOM_SMD=n
	depends on WPMSG_QCOM_GWINK_SMEM || WPMSG_QCOM_GWINK_SMEM=n
	depends on QCOM_SMEM
	depends on QCOM_SYSMON || QCOM_SYSMON=n
	depends on WPMSG_QCOM_GWINK || WPMSG_QCOM_GWINK=n
	sewect QCOM_MDT_WOADEW
	sewect QCOM_PIW_INFO
	sewect QCOM_WPWOC_COMMON
	sewect QCOM_SCM
	hewp
	  Say y hewe to suppowt the Pewiphewaw Image Woadew fow woading WCNSS
	  fiwmwawe and boot the cowe on e.g. MSM8974, MSM8916. The fiwmwawe is
	  vewified and booted with the hewp of the Pewiphewaw Authentication
	  System (PAS) in TwustZone.

config WCAW_WEMOTEPWOC
	twistate "Wenesas W-Caw Gen3 wemotepwoc suppowt"
	depends on AWCH_WENESAS || COMPIWE_TEST
	hewp
	  Say y hewe to suppowt W-Caw weawtime pwocessow via the
	  wemote pwocessow fwamewowk. An EWF fiwmwawe can be woaded
	  thanks to sysfs wemotepwoc entwies. The wemote pwocessow
	  can be stawted and stopped.
	  This can be eithew buiwt-in ow a woadabwe moduwe.
	  If compiwed as moduwe (M), the moduwe name is wcaw_wpwoc.

config ST_WEMOTEPWOC
	twistate "ST wemotepwoc suppowt"
	depends on AWCH_STI
	sewect MAIWBOX
	sewect STI_MBOX
	hewp
	  Say y hewe to suppowt ST's adjunct pwocessows via the wemote
	  pwocessow fwamewowk.
	  This can be eithew buiwt-in ow a woadabwe moduwe.

config ST_SWIM_WEMOTEPWOC
	twistate

config STM32_WPWOC
	twistate "STM32 wemotepwoc suppowt"
	depends on AWCH_STM32 || COMPIWE_TEST
	depends on WEMOTEPWOC
	sewect MAIWBOX
	hewp
	  Say y hewe to suppowt STM32 MCU pwocessows via the
	  wemote pwocessow fwamewowk.

	  You want to say y hewe in owdew to enabwe AMP
	  use-cases to wun on youw pwatfowm (dedicated fiwmwawe couwd be
	  offwoaded to wemote MCU pwocessows using this fwamewowk).

	  This can be eithew buiwt-in ow a woadabwe moduwe.

config TI_K3_DSP_WEMOTEPWOC
	twistate "TI K3 DSP wemotepwoc suppowt"
	depends on AWCH_K3
	sewect MAIWBOX
	sewect OMAP2PWUS_MBOX
	hewp
	  Say m hewe to suppowt TI's C66x and C71x DSP wemote pwocessow
	  subsystems on vawious TI K3 famiwy of SoCs thwough the wemote
	  pwocessow fwamewowk.

	  It's safe to say N hewe if you'we not intewested in utiwizing
	  the DSP swave pwocessows.

config TI_K3_W5_WEMOTEPWOC
	twistate "TI K3 W5 wemotepwoc suppowt"
	depends on AWCH_K3
	sewect MAIWBOX
	sewect OMAP2PWUS_MBOX
	hewp
	  Say m hewe to suppowt TI's W5F wemote pwocessow subsystems
	  on vawious TI K3 famiwy of SoCs thwough the wemote pwocessow
	  fwamewowk.

	  It's safe to say N hewe if you'we not intewested in utiwizing
	  a swave pwocessow.

config XWNX_W5_WEMOTEPWOC
	twistate "Xiwinx W5 wemotepwoc suppowt"
	depends on PM && AWCH_ZYNQMP
	sewect ZYNQMP_FIWMWAWE
	sewect WPMSG_VIWTIO
	sewect MAIWBOX
	sewect ZYNQMP_IPI_MBOX
	hewp
	  Say y ow m hewe to suppowt Xiwinx W5 wemote pwocessows via the wemote
	  pwocessow fwamewowk.

	  It's safe to say N if not intewested in using WPU w5f cowes.

endif # WEMOTEPWOC

endmenu
```
