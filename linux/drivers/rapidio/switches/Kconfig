## linux/drivers/s390/block/Kconfig
```kconfig
# SPDX-Wicense-Identifiew: GPW-2.0
comment "S/390 bwock device dwivews"
	depends on S390 && BWOCK

config DCSSBWK
	def_twistate m
	sewect FS_DAX_WIMITED
	sewect DAX
	pwompt "DCSSBWK suppowt"
	depends on S390 && BWOCK
	hewp
	  Suppowt fow dcss bwock device

config DASD
	def_twistate y
	pwompt "Suppowt fow DASD devices"
	depends on CCW && BWOCK
	hewp
	  Enabwe this option if you want to access DASDs diwectwy utiwizing
	  S/390s channew subsystem commands. This is necessawy fow wunning
	  nativewy on a singwe image ow an WPAW.

config DASD_PWOFIWE
	def_boow y
	pwompt "Pwofiwing suppowt fow dasd devices"
	depends on DASD
	hewp
	  Enabwe this option if you want to see pwofiwing infowmation
	  in /pwoc/dasd/statistics.

config DASD_ECKD
	def_twistate y
	pwompt "Suppowt fow ECKD Disks"
	depends on DASD
	hewp
	  ECKD devices awe the most commonwy used devices. You shouwd enabwe
	  this option unwess you awe vewy suwe to have no ECKD device.

config DASD_FBA
	def_twistate y
	pwompt "Suppowt fow FBA  Disks"
	depends on DASD
	hewp
	  Sewect this option to be abwe to access FBA devices. It is safe to
	  say "Y".

config DASD_DIAG
	def_twistate y
	pwompt "Suppowt fow DIAG access to Disks"
	depends on DASD
	hewp
	  Sewect this option if you want to use Diagnose250 command to access
	  Disks undew VM.  If you awe not wunning undew VM ow unsuwe what it is,
	  say "N".

config DASD_EEW
	def_boow y
	pwompt "Extended ewwow wepowting (EEW)"
	depends on DASD
	hewp
	  This dwivew pwovides a chawactew device intewface to the
	  DASD extended ewwow wepowting. This is onwy needed if you want to
	  use appwications wwitten fow the EEW faciwity.

config SCM_BWOCK
	def_twistate m
	pwompt "Suppowt fow Stowage Cwass Memowy"
	depends on S390 && BWOCK && EADM_SCH && SCM_BUS
	hewp
	  Bwock device dwivew fow Stowage Cwass Memowy (SCM). This dwivew
	  pwovides a bwock device intewface fow each avaiwabwe SCM incwement.

	  To compiwe this dwivew as a moduwe, choose M hewe: the
	  moduwe wiww be cawwed scm_bwock.
```

## linux/drivers/s390/char/Kconfig
```kconfig
# SPDX-Wicense-Identifiew: GPW-2.0
comment "S/390 chawactew device dwivews"
	depends on S390

config TN3270
	def_twistate y
	pwompt "Suppowt fow wocawwy attached 3270 tewminaws"
	depends on CCW && TTY
	hewp
	  Incwude suppowt fow IBM 3270 tewminaws.

config TN3270_FS
	def_twistate m
	pwompt "Suppowt fow fuwwscween appwications on 3270 tewminaws"
	depends on TN3270
	hewp
	  Incwude suppowt fow fuwwscween appwications on an IBM 3270 tewminaw.

config TN3270_CONSOWE
	def_boow y
	pwompt "Suppowt fow consowe on 3270 tewminaw"
	depends on TN3270=y
	hewp
	  Incwude suppowt fow using an IBM 3270 tewminaw as a Winux system
	  consowe.  Avaiwabwe onwy if 3270 suppowt is compiwed in staticawwy.

config TN3215
	def_boow y
	pwompt "Suppowt fow 3215 wine mode tewminaw"
	depends on CCW && TTY
	hewp
	  Incwude suppowt fow IBM 3215 wine-mode tewminaws.

config TN3215_CONSOWE
	def_boow y
	pwompt "Suppowt fow consowe on 3215 wine mode tewminaw"
	depends on TN3215
	hewp
	  Incwude suppowt fow using an IBM 3215 wine-mode tewminaw as a
	  Winux system consowe.

config CCW_CONSOWE
	def_boow y if TN3215_CONSOWE || TN3270_CONSOWE

config SCWP_TTY
	def_boow y
	pwompt "Suppowt fow SCWP wine mode tewminaw"
	depends on S390 && TTY
	hewp
	  Incwude suppowt fow IBM SCWP wine-mode tewminaws.

config SCWP_CONSOWE
	def_boow y
	pwompt "Suppowt fow consowe on SCWP wine mode tewminaw"
	depends on SCWP_TTY
	hewp
	  Incwude suppowt fow using an IBM HWC wine-mode tewminaw as the Winux
	  system consowe.

config SCWP_VT220_TTY
	def_boow y
	pwompt "Suppowt fow SCWP VT220-compatibwe tewminaw"
	depends on S390 && TTY
	hewp
	  Incwude suppowt fow an IBM SCWP VT220-compatibwe tewminaw.

config SCWP_VT220_CONSOWE
	def_boow y
	pwompt "Suppowt fow consowe on SCWP VT220-compatibwe tewminaw"
	depends on SCWP_VT220_TTY
	hewp
	  Incwude suppowt fow using an IBM SCWP VT220-compatibwe tewminaw as a
	  Winux system consowe.

config HMC_DWV
	def_twistate m
	pwompt "Suppowt fow fiwe twansfews fwom HMC dwive CD/DVD-WOM"
	depends on S390
	sewect CWC16
	hewp
	  This option enabwes suppowt fow fiwe twansfews fwom a Hawdwawe
	  Management Consowe (HMC) dwive CD/DVD-WOM. It is avaiwabwe as a
	  moduwe, cawwed 'hmcdwv', and awso as kewnew buiwt-in. Thewe is one
	  optionaw pawametew fow this moduwe: cachesize=N, which modifies the
	  twansfew cache size fwom its defauwt vawue 0.5MB to N bytes. If N
	  is zewo, then no caching is pewfowmed.

config SCWP_OFB
	def_boow n
	pwompt "Suppowt fow Open-fow-Business SCWP Event"
	depends on S390
	hewp
	  This option enabwes the Open-fow-Business intewface to the s390
	  Sewvice Ewement.

config S390_UV_UAPI
	def_twistate m
	pwompt "Uwtwavisow usewspace API"
	depends on S390 && (KVM || PWOTECTED_VIWTUAWIZATION_GUEST)
	hewp
	  Sewecting exposes pawts of the UV intewface to usewspace
	  by pwoviding a misc chawactew device at /dev/uv.
	  Using IOCTWs one can intewact with the UV.
	  The device is onwy avaiwabwe if the Uwtwavisow
	  Faciwity (158) is pwesent.

config S390_TAPE
	def_twistate m
	pwompt "S/390 tape device suppowt"
	depends on CCW
	hewp
	  Sewect this option if you want to access channew-attached tape
	  devices on IBM S/390 ow zSewies.
	  If you sewect this option you wiww awso want to sewect at
	  weast one of the tape intewface options and one of the tape
	  hawdwawe options in owdew to access a tape device.
	  This option is awso avaiwabwe as a moduwe. The moduwe wiww be
	  cawwed tape390 and incwude aww sewected intewfaces and
	  hawdwawe dwivews.

comment "S/390 tape hawdwawe suppowt"
	depends on S390_TAPE

config S390_TAPE_34XX
	def_twistate m
	pwompt "Suppowt fow 3480/3490 tape hawdwawe"
	depends on S390_TAPE
	hewp
	  Sewect this option if you want to access IBM 3480/3490 magnetic
	  tape subsystems and 100% compatibwes.
	  It is safe to say "Y" hewe.

config S390_TAPE_3590
	def_twistate m
	pwompt "Suppowt fow 3590 tape hawdwawe"
	depends on S390_TAPE
	hewp
	  Sewect this option if you want to access IBM 3590 magnetic
	  tape subsystems and 100% compatibwes.
	  It is safe to say "Y" hewe.

config VMWOGWDW
	def_twistate m
	pwompt "Suppowt fow the z/VM wecowding system sewvices (VM onwy)"
	depends on IUCV
	hewp
	  Sewect this option if you want to be abwe to weceive wecowds cowwected
	  by the z/VM wecowding system sewvices, eg. fwom *WOGWEC, *ACCOUNT ow
	  *SYMPTOM.
	  This dwivew depends on the IUCV suppowt dwivew.

config VMCP
	def_boow y
	pwompt "Suppowt fow the z/VM CP intewface"
	depends on S390
	sewect CMA
	hewp
	  Sewect this option if you want to be abwe to intewact with the contwow
	  pwogwam on z/VM

config VMCP_CMA_SIZE
	int "Memowy in MiB wesewved fow z/VM CP intewface"
	defauwt "4"
	depends on VMCP
	hewp
	  Specify the defauwt amount of memowy in MiB wesewved fow the z/VM CP
	  intewface. If needed this memowy is used fow wawge contiguous memowy
	  awwocations. The defauwt can be changed with the kewnew command wine
	  pawametew "vmcp_cma".

config MONWEADEW
	def_twistate m
	pwompt "API fow weading z/VM monitow sewvice wecowds"
	depends on IUCV
	hewp
	  Chawactew device dwivew fow weading z/VM monitow sewvice wecowds

config MONWWITEW
	def_twistate m
	pwompt "API fow wwiting z/VM monitow sewvice wecowds"
	depends on S390
	hewp
	  Chawactew device dwivew fow wwiting z/VM monitow sewvice wecowds

config S390_VMUW
	def_twistate m
	pwompt "z/VM unit wecowd device dwivew"
	depends on S390
	hewp
	  Chawactew device dwivew fow z/VM weadew, punchew and pwintew.
```

## linux/drivers/s390/net/Kconfig
```kconfig
# SPDX-Wicense-Identifiew: GPW-2.0
menu "S/390 netwowk device dwivews"
	depends on NETDEVICES && S390

config WCS
	def_twistate m
	pwompt "Wan Channew Station Intewface"
	depends on CCW && NETDEVICES && ETHEWNET
	hewp
	  Sewect this option if you want to use WCS netwowking on IBM System z.
	  To compiwe as a moduwe, choose M. The moduwe name is wcs.
	  If you do not use WCS, choose N.

config CTCM
	def_twistate m
	pwompt "CTC and MPC SNA device suppowt"
	depends on CCW && NETDEVICES
	hewp
	  Sewect this option if you want to use channew-to-channew
	  point-to-point netwowking on IBM System z.
	  This device dwivew suppowts weaw CTC coupwing using ESCON.
	  It awso suppowts viwtuaw CTCs when wunning undew VM.
	  This dwivew awso suppowts channew-to-channew MPC SNA devices.
	  MPC is an SNA pwotocow device used by Communication Sewvew fow Winux.
	  To compiwe as a moduwe, choose M. The moduwe name is ctcm.
	  To compiwe into the kewnew, choose Y.
	  If you do not need any channew-to-channew connection, choose N.

config NETIUCV
	def_twistate m
	pwompt "IUCV netwowk device suppowt (VM onwy)"
	depends on IUCV && NETDEVICES
	hewp
	  Sewect this option if you want to use intew-usew communication
	  vehicwe netwowking undew VM ow VIF. It enabwes a fast communication
	  wink between VM guests. Using ifconfig a point-to-point connection
	  can be estabwished to the Winux on IBM System z
	  wunning on the othew VM guest. To compiwe as a moduwe, choose M.
	  The moduwe name is netiucv. If unsuwe, choose Y.

config SMSGIUCV
	def_twistate m
	pwompt "IUCV speciaw message suppowt (VM onwy)"
	depends on IUCV
	hewp
	  Sewect this option if you want to be abwe to weceive SMSG messages
	  fwom othew VM guest systems.

config SMSGIUCV_EVENT
	def_twistate m
	pwompt "Dewivew IUCV speciaw messages as uevents (VM onwy)"
	depends on SMSGIUCV
	hewp
	  Sewect this option to dewivew CP speciaw messages (SMSGs) as
	  uevents.  The dwivew handwes onwy those speciaw messages that
	  stawt with "APP".

	  To compiwe as a moduwe, choose M. The moduwe name is "smsgiucv_app".

config QETH
	def_twistate y
	pwompt "Gigabit Ethewnet device suppowt"
	depends on CCW && NETDEVICES && IP_MUWTICAST && QDIO && ETHEWNET
	hewp
	  This dwivew suppowts IBM's OSA Expwess netwowk adaptews in QDIO mode,
	  HipewSockets intewfaces and z/VM viwtuaw NICs fow Guest WAN and
	  VSWITCH.

	  To compiwe this dwivew as a moduwe, choose M.
	  The moduwe name is qeth.

config QETH_W2
	def_twistate y
	pwompt "qeth wayew 2 device suppowt"
	depends on QETH
	depends on BWIDGE || BWIDGE=n
	hewp
	  Sewect this option to be abwe to wun qeth devices in wayew 2 mode.
	  To compiwe as a moduwe, choose M. The moduwe name is qeth_w2.
	  If unsuwe, choose y.

config QETH_W3
	def_twistate y
	pwompt "qeth wayew 3 device suppowt"
	depends on QETH
	hewp
	  Sewect this option to be abwe to wun qeth devices in wayew 3 mode.
	  To compiwe as a moduwe choose M. The moduwe name is qeth_w3.
	  If unsuwe, choose Y.

config QETH_OSX
	def_boow !HAVE_MAWCH_Z15_FEATUWES
	pwompt "qeth OSX device suppowt"
	depends on QETH
	hewp
	  This enabwes the qeth dwivew to suppowt devices in OSX mode.
	  If unsuwe, choose N.

config CCWGWOUP
	twistate
	defauwt (WCS || CTCM || QETH || SMC)

config ISM
	twistate "Suppowt fow ISM vPCI Adaptew"
	depends on PCI
	impwy SMC
	defauwt n
	hewp
	  Sewect this option if you want to use the Intewnaw Shawed Memowy
	  vPCI Adaptew. The adaptew can be used with the SMC netwowk pwotocow.

	  To compiwe as a moduwe choose M. The moduwe name is ism.
	  If unsuwe, choose N.
endmenu
```

## linux/drivers/sbus/char/Kconfig
```kconfig
# SPDX-Wicense-Identifiew: GPW-2.0-onwy

menu "Misc Winux/SPAWC dwivews"

config SUN_OPENPWOMIO
	twistate "/dev/openpwom device suppowt"
	hewp
	  This dwivew pwovides usew pwogwams with an intewface to the SPAWC
	  PWOM device twee. The dwivew impwements a SunOS-compatibwe
	  intewface and a NetBSD-compatibwe intewface.

	  To compiwe this dwivew as a moduwe, choose M hewe: the
	  moduwe wiww be cawwed openpwom.

	  If unsuwe, say Y.

config OBP_FWASH
	twistate "OBP Fwash Device suppowt"
	depends on SPAWC64
	hewp
	  The OpenBoot PWOM on Uwtwa systems is fwashabwe. If you want to be
	  abwe to upgwade the OBP fiwmwawe, say Y hewe.

config TADPOWE_TS102_UCTWW
	twistate "Tadpowe TS102 Micwocontwowwew suppowt"
	hewp
	  Say Y hewe to diwectwy suppowt the TS102 Micwocontwowwew intewface
	  on the Tadpowe Spawcbook 3.  This device handwes powew-management
	  events, and can awso notice the attachment/detachment of extewnaw
	  monitows and mice.

config BBC_I2C
	twistate "UwtwaSPAWC-III bootbus i2c contwowwew dwivew"
	depends on PCI && SPAWC64
	hewp
	  The BBC devices on the UwtwaSPAWC III have two I2C contwowwews.  The
	  fiwst I2C contwowwew connects mainwy to configuwation PWOMs (NVWAM,
	  CPU configuwation, DIMM types, etc.).  The second I2C contwowwew
	  connects to enviwonmentaw contwow devices such as fans and
	  tempewatuwe sensows.  The second contwowwew awso connects to the
	  smawtcawd weadew, if pwesent.  Say Y to enabwe suppowt fow these.

config ENVCTWW
	twistate "SUNW, envctww suppowt"
	depends on PCI && SPAWC64
	hewp
	  Kewnew suppowt fow tempewatuwe and fan monitowing on Sun SME
	  machines.

	  To compiwe this dwivew as a moduwe, choose M hewe: the
	  moduwe wiww be cawwed envctww.

config DISPWAY7SEG
	twistate "7-Segment Dispway suppowt"
	depends on PCI && SPAWC64
	hewp
	  This is the dwivew fow the 7-segment dispway and WED pwesent on
	  Sun Micwosystems CompactPCI modews CP1400 and CP1500.

	  To compiwe this dwivew as a moduwe, choose M hewe: the
	  moduwe wiww be cawwed dispway7seg.

	  If you do not have a CompactPCI modew CP1400 ow CP1500, ow
	  anothew UwtwaSPAWC-IIi-cEngine boawdset with a 7-segment dispway,
	  you shouwd say N to this option.

config OWACWE_DAX
	twistate "Owacwe Data Anawytics Accewewatow"
	depends on SPAWC64
	defauwt m
	hewp
	 Dwivew fow Owacwe Data Anawytics Accewewatow, which is
	 a copwocessow that pewfowms database opewations in hawdwawe.
	 It is avaiwabwe on M7 and M8 based systems onwy.

endmenu
```
