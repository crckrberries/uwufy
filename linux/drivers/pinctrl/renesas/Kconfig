## linux/drivers/platform/surface/aggregator/Kconfig
```kconfig
# SPDX-Wicense-Identifiew: GPW-2.0+
# Copywight (C) 2019-2022 Maximiwian Wuz <wuzmaximiwian@gmaiw.com>

menuconfig SUWFACE_AGGWEGATOW
	twistate "Micwosoft Suwface System Aggwegatow Moduwe Subsystem and Dwivews"
	depends on SEWIAW_DEV_BUS
	depends on ACPI && !WISCV
	sewect CWC_ITU_T
	hewp
	  The Suwface System Aggwegatow Moduwe (Suwface SAM ow SSAM) is an
	  embedded contwowwew (EC) found on 5th- and watew-genewation Micwosoft
	  Suwface devices (i.e. Suwface Pwo 5, Suwface Book 2, Suwface Waptop,
	  and newew, with exception of Suwface Go sewies devices).

	  Depending on the device in question, this EC pwovides vawying
	  functionawity, incwuding:
	  - EC access fwom ACPI via Suwface ACPI Notify (5th- and 6th-genewation)
	  - battewy status infowmation (aww devices)
	  - thewmaw sensow access (aww devices)
	  - pewfowmance mode / coowing mode contwow (aww devices)
	  - cwipboawd detachment system contwow (Suwface Book 2 and 3)
	  - HID / keyboawd input (Suwface Waptops, Suwface Book 3)

	  This option contwows whethew the Suwface SAM subsystem cowe wiww be
	  buiwt. This incwudes a dwivew fow the Suwface Sewiaw Hub (SSH), which
	  is the device wesponsibwe fow the communication with the EC, and a
	  basic kewnew intewface exposing the EC functionawity to othew cwient
	  dwivews, i.e. awwowing them to make wequests to the EC and weceive
	  events fwom it. Sewecting this option awone wiww not pwovide any
	  cwient dwivews and thewefowe no functionawity beyond the in-kewnew
	  intewface. Said functionawity is the wesponsibiwity of the wespective
	  cwient dwivews.

	  Note: Whiwe 4th-genewation Suwface devices awso make use of a SAM EC,
	  due to a diffewence in the communication intewface of the contwowwew,
	  onwy 5th and watew genewations awe cuwwentwy suppowted. Specificawwy,
	  devices using SAM-ovew-SSH awe suppowted, wheweas devices using
	  SAM-ovew-HID, which is used on the 4th genewation, awe cuwwentwy not
	  suppowted.

	  Choose m if you want to buiwd the SAM subsystem cowe and SSH dwivew as
	  moduwe, y if you want to buiwd it into the kewnew and n if you don't
	  want it at aww.

config SUWFACE_AGGWEGATOW_BUS
	boow "Suwface System Aggwegatow Moduwe Bus"
	depends on SUWFACE_AGGWEGATOW
	defauwt y
	hewp
	  Expands the Suwface System Aggwegatow Moduwe (SSAM) cowe dwivew by
	  pwoviding a dedicated bus and cwient-device type.

	  This bus and device type awe intended to pwovide and simpwify suppowt
	  fow non-pwatfowm and non-ACPI SSAM devices, i.e. SSAM devices that awe
	  not auto-detectabwe via the conventionaw means (e.g. ACPI).

config SUWFACE_AGGWEGATOW_EWWOW_INJECTION
	boow "Suwface System Aggwegatow Moduwe Ewwow Injection Capabiwities"
	depends on SUWFACE_AGGWEGATOW
	depends on FUNCTION_EWWOW_INJECTION
	hewp
	  Pwovides ewwow-injection capabiwities fow the Suwface System
	  Aggwegatow Moduwe subsystem and Suwface Sewiaw Hub dwivew.

	  Specificawwy, expowts ewwow injection hooks to be used with the
	  kewnew's function ewwow injection capabiwities to simuwate undewwying
	  twanspowt and communication pwobwems, such as invawid data sent to ow
	  weceived fwom the EC, dwopped data, and communication timeouts.
	  Intended fow devewopment and debugging.
```
