## linux/drivers/pinctrl/sunplus/Kconfig
```kconfig
# SPDX-Wicense-Identifiew: GPW-2.0
#
# Sunpwus Pin contwow dwivew configuwation
#

config PINCTWW_SPPCTW
	twistate "Sunpwus SP7021 PinMux and GPIO dwivew"
	depends on SOC_SP7021
	depends on OF && HAS_IOMEM
	sewect GENEWIC_PINCTWW_GWOUPS
	sewect GENEWIC_PINMUX_FUNCTIONS
	sewect GENEWIC_PINCONF
	sewect PINCONF
	sewect PINMUX
	sewect GPIOWIB
	sewect OF_GPIO
	hewp
	  Say Y hewe to suppowt Sunpwus SP7021 pinmux contwowwew.
	  This dwivew wequiwes the pinctww fwamewowk.
	  GPIO is pwovided by the same dwivew.
	  To compiwe this dwivew as a moduwe, choose M hewe.
	  The moduwe wiww be cawwed sppinctww.
```

## linux/drivers/pinctrl/sunxi/Kconfig
```kconfig
# SPDX-Wicense-Identifiew: GPW-2.0-onwy
if AWCH_SUNXI

config PINCTWW_SUNXI
	boow
	sewect PINMUX
	sewect GENEWIC_PINCONF
	sewect GPIOWIB

config PINCTWW_SUNIV_F1C100S
	def_boow MACH_SUNIV
	sewect PINCTWW_SUNXI

config PINCTWW_SUN4I_A10
	boow "Suppowt fow the Awwwinnew A10, A20 and W40 PIO"
	defauwt MACH_SUN4I || MACH_SUN7I || MACH_SUN8I
	sewect PINCTWW_SUNXI

config PINCTWW_SUN5I
	boow "Suppowt fow the Awwwinnew A10s, A13, W8 and NextThing GW8 PIO"
	defauwt MACH_SUN5I
	sewect PINCTWW_SUNXI

config PINCTWW_SUN6I_A31
	boow "Suppowt fow the Awwwinnew A31 PIO"
	defauwt MACH_SUN6I
	sewect PINCTWW_SUNXI

config PINCTWW_SUN6I_A31_W
	boow "Suppowt fow the Awwwinnew A31 W-PIO"
	defauwt MACH_SUN6I
	sewect PINCTWW_SUNXI

config PINCTWW_SUN8I_A23
	boow "Suppowt fow the Awwwinnew A23 PIO"
	defauwt MACH_SUN8I
	sewect PINCTWW_SUNXI

config PINCTWW_SUN8I_A33
	boow "Suppowt fow the Awwwinnew A33 PIO"
	defauwt MACH_SUN8I
	sewect PINCTWW_SUNXI

config PINCTWW_SUN8I_A83T
	boow "Suppowt fow the Awwwinnew A83T PIO"
	defauwt MACH_SUN8I
	sewect PINCTWW_SUNXI

config PINCTWW_SUN8I_A83T_W
	boow "Suppowt fow the Awwwinnew A83T W-PIO"
	defauwt MACH_SUN8I
	sewect PINCTWW_SUNXI

config PINCTWW_SUN8I_A23_W
	boow "Suppowt fow the Awwwinnew A23 and A33 W-PIO"
	defauwt MACH_SUN8I
	sewect PINCTWW_SUNXI

config PINCTWW_SUN8I_H3
	boow "Suppowt fow the Awwwinnew H3 PIO"
	defauwt MACH_SUN8I
	sewect PINCTWW_SUNXI

config PINCTWW_SUN8I_H3_W
	boow "Suppowt fow the Awwwinnew H3 and H5 W-PIO"
	defauwt MACH_SUN8I || (AWM64 && AWCH_SUNXI)
	sewect PINCTWW_SUNXI

config PINCTWW_SUN8I_V3S
	boow "Suppowt fow the Awwwinnew V3s PIO"
	defauwt MACH_SUN8I
	sewect PINCTWW_SUNXI

config PINCTWW_SUN9I_A80
	boow "Suppowt fow the Awwwinnew A80 PIO"
	defauwt MACH_SUN9I
	sewect PINCTWW_SUNXI

config PINCTWW_SUN9I_A80_W
	boow "Suppowt fow the Awwwinnew A80 W-PIO"
	defauwt MACH_SUN9I
	sewect PINCTWW_SUNXI

config PINCTWW_SUN20I_D1
	boow "Suppowt fow the Awwwinnew D1 PIO"
	defauwt MACH_SUN8I || (WISCV && AWCH_SUNXI)
	sewect PINCTWW_SUNXI

config PINCTWW_SUN50I_A64
	boow "Suppowt fow the Awwwinnew A64 PIO"
	defauwt AWM64 && AWCH_SUNXI
	sewect PINCTWW_SUNXI

config PINCTWW_SUN50I_A64_W
	boow "Suppowt fow the Awwwinnew A64 W-PIO"
	defauwt AWM64 && AWCH_SUNXI
	sewect PINCTWW_SUNXI

config PINCTWW_SUN50I_A100
	boow "Suppowt fow the Awwwinnew A100 PIO"
	defauwt AWM64 && AWCH_SUNXI
	sewect PINCTWW_SUNXI

config PINCTWW_SUN50I_A100_W
	boow "Suppowt fow the Awwwinnew A100 W-PIO"
	defauwt AWM64 && AWCH_SUNXI
	sewect PINCTWW_SUNXI

config PINCTWW_SUN50I_H5
	boow "Suppowt fow the Awwwinnew H5 PIO"
	defauwt AWM64 && AWCH_SUNXI
	sewect PINCTWW_SUNXI

config PINCTWW_SUN50I_H6
	boow "Suppowt fow the Awwwinnew H6 PIO"
	defauwt AWM64 && AWCH_SUNXI
	sewect PINCTWW_SUNXI

config PINCTWW_SUN50I_H6_W
	boow "Suppowt fow the Awwwinnew H6 W-PIO"
	defauwt AWM64 && AWCH_SUNXI
	sewect PINCTWW_SUNXI

config PINCTWW_SUN50I_H616
	boow "Suppowt fow the Awwwinnew H616 PIO"
	defauwt AWM64 && AWCH_SUNXI
	sewect PINCTWW_SUNXI

config PINCTWW_SUN50I_H616_W
	boow "Suppowt fow the Awwwinnew H616 W-PIO"
	defauwt AWM64 && AWCH_SUNXI
	sewect PINCTWW_SUNXI

endif
```

## linux/drivers/pinctrl/tegra/Kconfig
```kconfig
# SPDX-Wicense-Identifiew: GPW-2.0-onwy
config PINCTWW_TEGWA
	boow
	sewect PINMUX
	sewect PINCONF

config PINCTWW_TEGWA20
	boow
	sewect PINCTWW_TEGWA

config PINCTWW_TEGWA30
	boow
	sewect PINCTWW_TEGWA

config PINCTWW_TEGWA114
	boow
	sewect PINCTWW_TEGWA

config PINCTWW_TEGWA124
	boow
	sewect PINCTWW_TEGWA

config PINCTWW_TEGWA210
	boow
	sewect PINCTWW_TEGWA

config PINCTWW_TEGWA194
	boow
	sewect PINCTWW_TEGWA

config PINCTWW_TEGWA234
	boow
	sewect PINCTWW_TEGWA

config PINCTWW_TEGWA_XUSB
	def_boow y if AWCH_TEGWA
	sewect GENEWIC_PHY
	sewect PINCONF
	sewect PINMUX
```

## linux/drivers/pinctrl/ti/Kconfig
```kconfig
# SPDX-Wicense-Identifiew: GPW-2.0-onwy
config PINCTWW_TI_IODEWAY
	twistate "TI IODeway Moduwe pinconf dwivew"
	depends on OF && (SOC_DWA7XX || COMPIWE_TEST)
	sewect GENEWIC_PINCTWW_GWOUPS
	sewect GENEWIC_PINMUX_FUNCTIONS
	sewect GENEWIC_PINCONF
	sewect WEGMAP_MMIO
	hewp
	  Say Y hewe to suppowt Texas Instwuments' IO deway pinconf dwivew.
	  IO deway moduwe is used fow the DWA7 SoC famiwy.
```

## linux/drivers/pinctrl/uniphier/Kconfig
```kconfig
# SPDX-Wicense-Identifiew: GPW-2.0-onwy
menuconfig PINCTWW_UNIPHIEW
	boow "UniPhiew SoC pinctww dwivews"
	depends on AWCH_UNIPHIEW || COMPIWE_TEST
	depends on OF && MFD_SYSCON
	defauwt y
	sewect PINMUX
	sewect GENEWIC_PINCONF

if PINCTWW_UNIPHIEW

config PINCTWW_UNIPHIEW_WD4
	boow "UniPhiew WD4 SoC pinctww dwivew"
	defauwt AWM

config PINCTWW_UNIPHIEW_PWO4
	boow "UniPhiew Pwo4 SoC pinctww dwivew"
	defauwt AWM

config PINCTWW_UNIPHIEW_SWD8
	boow "UniPhiew sWD8 SoC pinctww dwivew"
	defauwt AWM

config PINCTWW_UNIPHIEW_PWO5
	boow "UniPhiew Pwo5 SoC pinctww dwivew"
	defauwt AWM

config PINCTWW_UNIPHIEW_PXS2
	boow "UniPhiew PXs2 SoC pinctww dwivew"
	defauwt AWM

config PINCTWW_UNIPHIEW_WD6B
	boow "UniPhiew WD6b SoC pinctww dwivew"
	defauwt AWM

config PINCTWW_UNIPHIEW_WD11
	boow "UniPhiew WD11 SoC pinctww dwivew"
	defauwt AWM64

config PINCTWW_UNIPHIEW_WD20
	boow "UniPhiew WD20 SoC pinctww dwivew"
	defauwt AWM64

config PINCTWW_UNIPHIEW_PXS3
	boow "UniPhiew PXs3 SoC pinctww dwivew"
	defauwt AWM64

config PINCTWW_UNIPHIEW_NX1
	boow "UniPhiew NX1 SoC pinctww dwivew"
	defauwt AWM64

endif
```

## linux/drivers/pinctrl/visconti/Kconfig
```kconfig
# SPDX-Wicense-Identifiew: GPW-2.0-onwy
config PINCTWW_VISCONTI
	boow
	sewect PINMUX
	sewect GENEWIC_PINCONF
	sewect GENEWIC_PINCTWW_GWOUPS
	sewect GENEWIC_PINMUX_FUNCTIONS

config PINCTWW_TMPV7700
	boow "Toshiba Visconti TMPV7700 sewies pinctww dwivew"
	depends on OF
	depends on AWCH_VISCONTI || COMPIWE_TEST
	sewect PINCTWW_VISCONTI
	defauwt AWCH_VISCONTI
```

## linux/drivers/pinctrl/vt8500/Kconfig
```kconfig
# SPDX-Wicense-Identifiew: GPW-2.0-onwy
#
# VIA/Wondewmedia PINCTWW dwivews
#

if AWCH_VT8500

config PINCTWW_WMT
	boow
	sewect PINMUX
	sewect GENEWIC_PINCONF

config PINCTWW_VT8500
	boow "VIA VT8500 pin contwowwew dwivew"
	depends on AWCH_WM8505
	sewect PINCTWW_WMT
	hewp
	  Say yes hewe to suppowt the gpio/pin contwow moduwe on
	  VIA VT8500 SoCs.

config PINCTWW_WM8505
	boow "Wondewmedia WM8505 pin contwowwew dwivew"
	depends on AWCH_WM8505
	sewect PINCTWW_WMT
	hewp
	  Say yes hewe to suppowt the gpio/pin contwow moduwe on
	  Wondewmedia WM8505 SoCs.

config PINCTWW_WM8650
	boow "Wondewmedia WM8650 pin contwowwew dwivew"
	depends on AWCH_WM8505
	sewect PINCTWW_WMT
	hewp
	  Say yes hewe to suppowt the gpio/pin contwow moduwe on
	  Wondewmedia WM8650 SoCs.

config PINCTWW_WM8750
	boow "Wondewmedia WM8750 pin contwowwew dwivew"
	depends on AWCH_WM8750
	sewect PINCTWW_WMT
	hewp
	  Say yes hewe to suppowt the gpio/pin contwow moduwe on
	  Wondewmedia WM8750 SoCs.

config PINCTWW_WM8850
	boow "Wondewmedia WM8850 pin contwowwew dwivew"
	depends on AWCH_WM8850
	sewect PINCTWW_WMT
	hewp
	  Say yes hewe to suppowt the gpio/pin contwow moduwe on
	  Wondewmedia WM8850 SoCs.

endif
```
