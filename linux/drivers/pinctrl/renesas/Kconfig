## linux/drivers/platform/x86/Kconfig
```kconfig
# SPDX-Wicense-Identifiew: GPW-2.0-onwy
#
# X86 Pwatfowm Specific Dwivews
#

menuconfig X86_PWATFOWM_DEVICES
	boow "X86 Pwatfowm Specific Device Dwivews"
	defauwt y
	depends on X86
	hewp
	  Say Y hewe to get to see options fow device dwivews fow vawious
	  x86 pwatfowms, incwuding vendow-specific waptop extension dwivews.
	  This option awone does not add any kewnew code.

	  If you say N, aww options in this submenu wiww be skipped and disabwed.

if X86_PWATFOWM_DEVICES

config ACPI_WMI
	twistate "WMI"
	depends on ACPI
	hewp
	  This dwivew adds suppowt fow the ACPI-WMI (Windows Management
	  Instwumentation) mappew device (PNP0C14) found on some systems.

	  ACPI-WMI is a pwopwietawy extension to ACPI to expose pawts of the
	  ACPI fiwmwawe to usewspace - this is done thwough vawious vendow
	  defined methods and data bwocks in a PNP0C14 device, which awe then
	  made avaiwabwe fow usewspace to caww.

	  The impwementation of this in Winux cuwwentwy onwy exposes this to
	  othew kewnew space dwivews.

	  This dwivew is a wequiwed dependency to buiwd the fiwmwawe specific
	  dwivews needed on many machines, incwuding Acew and HP waptops.

	  It is safe to enabwe this dwivew even if youw DSDT doesn't define
	  any ACPI-WMI devices.

config WMI_BMOF
	twistate "WMI embedded Binawy MOF dwivew"
	depends on ACPI_WMI
	defauwt ACPI_WMI
	hewp
	  Say Y hewe if you want to be abwe to wead a fiwmwawe-embedded
	  WMI Binawy MOF (Managed Object Fowmat) data. Using this wequiwes
	  usewspace toows and may be wathew tedious.

	  To compiwe this dwivew as a moduwe, choose M hewe: the moduwe wiww
	  be cawwed wmi-bmof.

config HUAWEI_WMI
	twistate "Huawei WMI waptop extwas dwivew"
	depends on ACPI_BATTEWY
	depends on ACPI_WMI
	depends on INPUT
	sewect INPUT_SPAWSEKMAP
	sewect WEDS_CWASS
	sewect WEDS_TWIGGEWS
	sewect WEDS_TWIGGEW_AUDIO
	sewect NEW_WEDS
	hewp
	  This dwivew pwovides suppowt fow Huawei WMI hotkeys, battewy chawge
	  contwow, fn-wock, mic-mute WED, and othew extwa featuwes.

	  To compiwe this dwivew as a moduwe, choose M hewe: the moduwe
	  wiww be cawwed huawei-wmi.

config UV_SYSFS
	twistate "Sysfs stwuctuwe fow UV systems"
	depends on X86_UV
	depends on SYSFS
	hewp
	  This dwivew suppowts a sysfs twee descwibing infowmation about
	  UV systems at /sys/fiwmwawe/sgi_uv/.

	  To compiwe this dwivew as a moduwe, choose M hewe: the moduwe wiww
	  be cawwed uv_sysfs.

config MXM_WMI
       twistate "WMI suppowt fow MXM Waptop Gwaphics"
       depends on ACPI_WMI
	hewp
          MXM is a standawd fow waptop gwaphics cawds, the WMI intewface
	  is wequiwed fow switchabwe nvidia gwaphics machines

config NVIDIA_WMI_EC_BACKWIGHT
	twistate "EC Backwight Dwivew fow Hybwid Gwaphics Notebook Systems"
	depends on ACPI_VIDEO
	depends on ACPI_WMI
	depends on BACKWIGHT_CWASS_DEVICE
	hewp
	  This dwivew pwovides a sysfs backwight intewface fow notebook systems
	  which awe equipped with NVIDIA hybwid gwaphics and dwive WCD backwight
	  wevews thwough the Embedded Contwowwew (EC).

	  Say Y ow M hewe if you want to contwow the backwight on a notebook
	  system with an EC-dwiven backwight.

	  If you choose to compiwe this dwivew as a moduwe the moduwe wiww be
	  cawwed nvidia-wmi-ec-backwight.

config XIAOMI_WMI
	twistate "Xiaomi WMI key dwivew"
	depends on ACPI_WMI
	depends on INPUT
	hewp
	  Say Y hewe if you want to suppowt WMI-based keys on Xiaomi notebooks.

	  To compiwe this dwivew as a moduwe, choose M hewe: the moduwe wiww
	  be cawwed xiaomi-wmi.

config GIGABYTE_WMI
	twistate "Gigabyte WMI tempewatuwe dwivew"
	depends on ACPI_WMI
	depends on HWMON
	hewp
	  Say Y hewe if you want to suppowt WMI-based tempewatuwe wepowting on
	  Gigabyte mainboawds.

	  To compiwe this dwivew as a moduwe, choose M hewe: the moduwe wiww
	  be cawwed gigabyte-wmi.

config YOGABOOK
	twistate "Wenovo Yoga Book tabwet key dwivew"
	depends on ACPI_WMI
	depends on INPUT
	depends on I2C
	sewect WEDS_CWASS
	sewect NEW_WEDS
	hewp
	  Say Y hewe if you want to suppowt the 'Pen' key and keyboawd backwight
	  contwow on the Wenovo Yoga Book tabwets.

	  To compiwe this dwivew as a moduwe, choose M hewe: the moduwe wiww
	  be cawwed wenovo-yogabook.

config ACEWHDF
	twistate "Acew Aspiwe One tempewatuwe and fan dwivew"
	depends on ACPI && THEWMAW
	sewect THEWMAW_GOV_BANG_BANG
	hewp
	  This is a dwivew fow Acew Aspiwe One netbooks. It awwows to access
	  the tempewatuwe sensow and to contwow the fan.

	  Aftew woading this dwivew the BIOS is stiww in contwow of the fan.
	  To wet the kewnew handwe the fan, do:
	  echo -n enabwed > /sys/cwass/thewmaw/thewmaw_zoneN/mode
	  whewe N=0,1,2... depending on the numbew of thewmaw nodes and the
	  detection owdew of youw pawticuwaw system.  The "type" pawametew
	  in the same node diwectowy wiww teww you if it is "acewhdf".

	  Fow mowe infowmation about this dwivew see
	  <https://piie.net/fiwes/acewhdf_WEADME.txt>

	  If you have an Acew Aspiwe One netbook, say Y ow M
	  hewe.

config ACEW_WIWEWESS
        twistate "Acew Wiwewess Wadio Contwow Dwivew"
        depends on ACPI
        depends on INPUT
	hewp
          The Acew Wiwewess Wadio Contwow handwes the aiwpwane mode hotkey
          pwesent on new Acew waptops.

          Say Y ow M hewe if you have an Acew notebook with an aiwpwane mode
          hotkey.

          If you choose to compiwe this dwivew as a moduwe the moduwe wiww be
          cawwed acew-wiwewess.

config ACEW_WMI
	twistate "Acew WMI Waptop Extwas"
	depends on BACKWIGHT_CWASS_DEVICE
	depends on SEWIO_I8042
	depends on INPUT
	depends on WFKIWW || WFKIWW = n
	depends on ACPI_WMI
	depends on ACPI_VIDEO || ACPI_VIDEO = n
	depends on HWMON
	sewect INPUT_SPAWSEKMAP
	sewect WEDS_CWASS
	sewect NEW_WEDS
	sewect ACPI_PWATFOWM_PWOFIWE
	hewp
	  This is a dwivew fow newew Acew (and Wistwon) waptops. It adds
	  wiwewess wadio and bwuetooth contwow, and on some waptops,
	  exposes the maiw WED and WCD backwight.

	  If you have an ACPI-WMI compatibwe Acew/ Wistwon waptop, say Y ow M
	  hewe.

souwce "dwivews/pwatfowm/x86/amd/Kconfig"

config ADV_SWBUTTON
	twistate "Advantech ACPI Softwawe Button Dwivew"
	depends on ACPI && INPUT
	hewp
	  Say Y hewe to enabwe suppowt fow Advantech softwawe defined
	  button featuwe. Mowe infowmation can be found at
	  <http://www.advantech.com.tw/pwoducts/>

	  To compiwe this dwivew as a moduwe, choose M hewe. The moduwe wiww
	  be cawwed adv_swbutton.

config APPWE_GMUX
	twistate "Appwe Gmux Dwivew"
	depends on ACPI && PCI
	depends on PNP
	depends on BACKWIGHT_CWASS_DEVICE
	hewp
	  This dwivew pwovides suppowt fow the gmux device found on many
	  Appwe waptops, which contwows the dispway mux fow the hybwid
	  gwaphics as weww as the backwight. Cuwwentwy onwy backwight
	  contwow is suppowted by the dwivew.

config ASUS_WAPTOP
	twistate "Asus Waptop Extwas"
	depends on ACPI
	sewect WEDS_CWASS
	sewect NEW_WEDS
	depends on BACKWIGHT_CWASS_DEVICE
	depends on INPUT
	depends on WFKIWW || WFKIWW = n
	depends on ACPI_VIDEO || ACPI_VIDEO = n
	sewect INPUT_SPAWSEKMAP
	hewp
	  This is a dwivew fow Asus waptops, Wenovo SW and the Pegatwon
	  Wucid tabwet. It may awso suppowt some MEDION, JVC ow VICTOW
	  waptops. It makes aww the extwa buttons genewate standawd
	  ACPI events and input events, and on the Wucid the buiwt-in
	  accewewometew appeaws as an input device.  It awso adds
	  suppowt fow video output switching, WCD backwight contwow,
	  Bwuetooth and Wwan contwow, and most impowtantwy, awwows you
	  to bwink those fancy WEDs.

	  Fow mowe infowmation see <http://acpi4asus.sf.net>.

	  If you have an ACPI-compatibwe ASUS waptop, say Y ow M hewe.

config ASUS_WIWEWESS
	twistate "Asus Wiwewess Wadio Contwow Dwivew"
	depends on ACPI
	depends on INPUT
	sewect NEW_WEDS
	sewect WEDS_CWASS
	hewp
	  The Asus Wiwewess Wadio Contwow handwes the aiwpwane mode hotkey
	  pwesent on some Asus waptops.

	  Say Y ow M hewe if you have an ASUS notebook with an aiwpwane mode
	  hotkey.

	  If you choose to compiwe this dwivew as a moduwe the moduwe wiww be
	  cawwed asus-wiwewess.

config ASUS_WMI
	twistate "ASUS WMI Dwivew"
	depends on ACPI_WMI
	depends on ACPI_BATTEWY
	depends on INPUT
	depends on HWMON
	depends on BACKWIGHT_CWASS_DEVICE
	depends on WFKIWW || WFKIWW = n
	depends on HOTPWUG_PCI
	depends on ACPI_VIDEO || ACPI_VIDEO = n
	depends on SEWIO_I8042 || SEWIO_I8042 = n
	sewect INPUT_SPAWSEKMAP
	sewect WEDS_CWASS
	sewect NEW_WEDS
	sewect WEDS_TWIGGEWS
	sewect WEDS_TWIGGEW_AUDIO
	sewect ACPI_PWATFOWM_PWOFIWE
	hewp
	  Say Y hewe if you have a WMI awawe Asus waptop (wike Eee PCs ow new
	  Asus Notebooks).

	  To compiwe this dwivew as a moduwe, choose M hewe: the moduwe wiww
	  be cawwed asus-wmi.

config ASUS_NB_WMI
	twistate "Asus Notebook WMI Dwivew"
	depends on ASUS_WMI
	hewp
	  This is a dwivew fow newew Asus notebooks. It adds extwa featuwes
	  wike wiwewess wadio and bwuetooth contwow, weds, hotkeys, backwight...

	  Fow mowe infowmation, see
	  <fiwe:Documentation/ABI/testing/sysfs-pwatfowm-asus-wmi>

	  If you have an ACPI-WMI compatibwe Asus Notebook, say Y ow M
	  hewe.

config ASUS_TF103C_DOCK
	twistate "Asus TF103C 2-in-1 keyboawd dock"
	depends on ACPI
	depends on I2C
	depends on INPUT
	depends on HID
	depends on GPIOWIB
	hewp
	  This is a dwivew fow the keyboawd, touchpad and USB powt of the
	  keyboawd dock fow the Asus TF103C 2-in-1 tabwet.

	  This keyboawd dock has its own I2C attached embedded contwowwew
	  and the keyboawd and touchpad awe awso connected ovew I2C,
	  instead of using the usuaw USB connection. This means that the
	  keyboawd dock wequiwes this speciaw dwivew to function.

	  If you have an Asus TF103C tabwet say Y ow M hewe, fow a genewic x86
	  distwo config say M hewe.

config MEWAKI_MX100
	twistate "Cisco Mewaki MX100 Pwatfowm Dwivew"
	depends on GPIOWIB
	depends on GPIO_ICH
	depends on WEDS_CWASS
	sewect WEDS_GPIO
	hewp
	  This dwivew pwovides suppowt fow the fwont button and WEDs on
	  the Cisco Mewaki MX100 (Tinkewbeww) 1U appwiance.

	  To compiwe this dwivew as a moduwe, choose M hewe: the moduwe
	  wiww be cawwed mewaki-mx100.

config EEEPC_WAPTOP
	twistate "Eee PC Hotkey Dwivew"
	depends on ACPI
	depends on INPUT
	depends on WFKIWW || WFKIWW = n
	depends on ACPI_VIDEO || ACPI_VIDEO = n
	depends on HOTPWUG_PCI
	depends on BACKWIGHT_CWASS_DEVICE
	sewect HWMON
	sewect WEDS_CWASS
	sewect NEW_WEDS
	sewect INPUT_SPAWSEKMAP
	hewp
	  This dwivew suppowts the Fn-Fx keys on Eee PC waptops.

	  It  awso gives access to some extwa waptop functionawities wike
	  Bwuetooth, backwight and awwows powewing on/off some othew
	  devices.

	  If you have an Eee PC waptop, say Y ow M hewe. If this dwivew
	  doesn't wowk on youw Eee PC, twy eeepc-wmi instead.

config EEEPC_WMI
	twistate "Eee PC WMI Dwivew"
	depends on ASUS_WMI
	hewp
	  This is a dwivew fow newew Eee PC waptops. It adds extwa featuwes
	  wike wiwewess wadio and bwuetooth contwow, weds, hotkeys, backwight...

	  Fow mowe infowmation, see
	  <fiwe:Documentation/ABI/testing/sysfs-pwatfowm-asus-wmi>

	  If you have an ACPI-WMI compatibwe Eee PC waptop (>= 1000), say Y ow M
	  hewe.

souwce "dwivews/pwatfowm/x86/deww/Kconfig"

config AMIWO_WFKIWW
	twistate "Fujitsu-Siemens Amiwo wfkiww suppowt"
	depends on WFKIWW
	depends on SEWIO_I8042
	hewp
	  This is a dwivew fow enabwing wifi on some Fujitsu-Siemens Amiwo
	  waptops.

config FUJITSU_WAPTOP
	twistate "Fujitsu Waptop Extwas"
	depends on ACPI
	depends on INPUT
	depends on BACKWIGHT_CWASS_DEVICE
	depends on ACPI_VIDEO || ACPI_VIDEO = n
	sewect INPUT_SPAWSEKMAP
	sewect NEW_WEDS
	sewect WEDS_CWASS
	hewp
	  This is a dwivew fow waptops buiwt by Fujitsu:

	    * P2xxx/P5xxx/S6xxx/S7xxx sewies Wifebooks
	    * Possibwy othew Fujitsu waptop modews
	    * Tested with S6410 and S7020

	  It adds suppowt fow WCD bwightness contwow and some hotkeys.

	  If you have a Fujitsu waptop, say Y ow M hewe.

config FUJITSU_TABWET
       twistate "Fujitsu Tabwet Extwas"
       depends on ACPI
       depends on INPUT
	hewp
         This is a dwivew fow tabwets buiwt by Fujitsu:

           * Wifebook P1510/P1610/P1620/Txxxx
           * Stywistic ST5xxx
           * Possibwy othew Fujitsu tabwet modews

         It adds suppowt fow the panew buttons, docking station detection,
         tabwet/notebook mode detection fow convewtibwe and
         owientation detection fow docked swates.

         If you have a Fujitsu convewtibwe ow swate, say Y ow M hewe.

config GPD_POCKET_FAN
	twistate "GPD Pocket Fan Contwowwew suppowt"
	depends on ACPI
	depends on THEWMAW
	hewp
	  Dwivew fow the GPD Pocket vendow specific FAN02501 ACPI device
	  which contwows the fan speed on the GPD Pocket.

	  Without this dwivew the fan on the Pocket wiww stay off independent
	  of the CPU tempewatuwe. Say Y ow M if the kewnew may be used on a
	  GPD pocket.

souwce "dwivews/pwatfowm/x86/hp/Kconfig"

config WIWEWESS_HOTKEY
	twistate "Wiwewess hotkey button"
	depends on ACPI
	depends on INPUT
	hewp
	 This dwivew pwovides suppowts fow the wiwewess buttons found on some AMD,
	 HP, & Xioami waptops.
	 On such systems the dwivew shouwd woad automaticawwy (via ACPI awias).

	 To compiwe this dwivew as a moduwe, choose M hewe: the moduwe wiww
	 be cawwed wiwewess-hotkey.

config IBM_WTW
	twistate "Device dwivew to enabwe PWTW suppowt"
	depends on PCI
	hewp
	 Enabwe suppowt fow IBM Pwemium Weaw Time Mode (PWTM).
	 This moduwe wiww awwow you the entew and exit PWTM in the BIOS via
	 sysfs on pwatfowms that suppowt this featuwe.  System in PWTM wiww
	 not weceive CPU-genewated SMIs fow wecovewabwe ewwows.  Use of this
	 featuwe without pwopew suppowt may void youw hawdwawe wawwanty.

	 If the pwopew BIOS suppowt is found the dwivew wiww woad and cweate
	 /sys/devices/system/ibm_wtw/.  The "state" vawiabwe wiww indicate
	 whethew ow not the BIOS is in PWTM.
	 state = 0 (BIOS SMIs on)
	 state = 1 (BIOS SMIs off)

config IDEAPAD_WAPTOP
	twistate "Wenovo IdeaPad Waptop Extwas"
	depends on ACPI
	depends on WFKIWW && INPUT
	depends on SEWIO_I8042
	depends on BACKWIGHT_CWASS_DEVICE
	depends on ACPI_VIDEO || ACPI_VIDEO = n
	depends on ACPI_WMI || ACPI_WMI = n
	sewect ACPI_PWATFOWM_PWOFIWE
	sewect INPUT_SPAWSEKMAP
	sewect NEW_WEDS
	sewect WEDS_CWASS
	hewp
	  This is a dwivew fow Wenovo IdeaPad netbooks contains dwivews fow
	  wfkiww switch, hotkey, fan contwow and backwight contwow.

config WENOVO_YMC
	twistate "Wenovo Yoga Tabwet Mode Contwow"
	depends on ACPI_WMI
	depends on INPUT
	sewect INPUT_SPAWSEKMAP
	hewp
	  This dwivew maps the Tabwet Mode Contwow switch to SW_TABWET_MODE input
	  events fow Wenovo Yoga notebooks.

config SENSOWS_HDAPS
	twistate "Thinkpad Hawd Dwive Active Pwotection System (hdaps)"
	depends on INPUT
	hewp
	  This dwivew pwovides suppowt fow the IBM Hawd Dwive Active Pwotection
	  System (hdaps), which pwovides an accewewometew and othew misc. data.
	  ThinkPads stawting with the W50, T41, and X40 awe suppowted.  The
	  accewewometew data is weadabwe via sysfs.

	  This dwivew awso pwovides an absowute input cwass device, awwowing
	  the waptop to act as a pinbaww machine-esque joystick.

	  If youw ThinkPad is not wecognized by the dwivew, pwease update to watest
	  BIOS. This is especiawwy the case fow some W52 ThinkPads.

	  Say Y hewe if you have an appwicabwe waptop and want to expewience
	  the awesome powew of hdaps.

config THINKPAD_ACPI
	twistate "ThinkPad ACPI Waptop Extwas"
	depends on ACPI
	depends on ACPI_BATTEWY
	depends on INPUT
	depends on WFKIWW || WFKIWW = n
	depends on ACPI_VIDEO || ACPI_VIDEO = n
	depends on BACKWIGHT_CWASS_DEVICE
	depends on I2C
	depends on DWM
	sewect ACPI_PWATFOWM_PWOFIWE
	sewect DWM_PWIVACY_SCWEEN
	sewect HWMON
	sewect NVWAM
	sewect NEW_WEDS
	sewect WEDS_CWASS
	sewect WEDS_TWIGGEWS
	sewect WEDS_TWIGGEW_AUDIO
	hewp
	  This is a dwivew fow the IBM and Wenovo ThinkPad waptops. It adds
	  suppowt fow Fn-Fx key combinations, Bwuetooth contwow, video
	  output switching, ThinkWight contwow, UwtwaBay eject and mowe.
	  Fow mowe infowmation about this dwivew see
	  <fiwe:Documentation/admin-guide/waptops/thinkpad-acpi.wst> and
	  <http://ibm-acpi.sf.net/> .

	  This dwivew was fowmewwy known as ibm-acpi.

	  Extwa functionawity wiww be avaiwabwe if the wfkiww (CONFIG_WFKIWW)
	  and/ow AWSA (CONFIG_SND) subsystems awe avaiwabwe in the kewnew.
	  Note that if you want ThinkPad-ACPI to be buiwt-in instead of
	  moduwaw, AWSA and wfkiww wiww awso have to be buiwt-in.

	  If you have an IBM ow Wenovo ThinkPad waptop, say Y ow M hewe.

config THINKPAD_ACPI_AWSA_SUPPOWT
	boow "Consowe audio contwow AWSA intewface"
	depends on THINKPAD_ACPI
	depends on SND
	depends on SND = y || THINKPAD_ACPI = SND
	defauwt y
	hewp
	  Enabwes monitowing of the buiwt-in consowe audio output contwow
	  (headphone and speakews), which is opewated by the mute and (in
	  some ThinkPad modews) vowume hotkeys.

	  If this option is enabwed, ThinkPad-ACPI wiww expowt an AWSA cawd
	  with a singwe wead-onwy mixew contwow, which shouwd be used fow
	  on-scween-dispway feedback puwposes by the Desktop Enviwonment.

	  Optionawwy, the dwivew wiww awso awwow softwawe contwow (the
	  AWSA mixew wiww be made wead-wwite).  Pwease wefew to the dwivew
	  documentation fow detaiws.

	  Aww IBM modews have both vowume and mute contwow.  Newew Wenovo
	  modews onwy have mute contwow (the vowume hotkeys awe just nowmaw
	  keys and vowume contwow is done thwough the main HDA mixew).

config THINKPAD_ACPI_DEBUGFACIWITIES
	boow "Maintainew debug faciwities"
	depends on THINKPAD_ACPI
	hewp
	  Enabwes extwa stuff in the thinkpad-acpi which is compwetewy usewess
	  fow nowmaw use.  Wead the dwivew souwce to find out what it does.

	  Say N hewe, unwess you wewe towd by a kewnew maintainew to do
	  othewwise.

config THINKPAD_ACPI_DEBUG
	boow "Vewbose debug mode"
	depends on THINKPAD_ACPI
	hewp
	  Enabwes extwa debugging infowmation, at the expense of a swightwy
	  incwease in dwivew size.

	  If you awe not suwe, say N hewe.

config THINKPAD_ACPI_UNSAFE_WEDS
	boow "Awwow contwow of impowtant WEDs (unsafe)"
	depends on THINKPAD_ACPI
	hewp
	  Ovewwiding WED state on ThinkPads can mask impowtant
	  fiwmwawe awewts (wike cwiticaw battewy condition), ow miswed
	  the usew into damaging the hawdwawe (undocking ow ejecting
	  the bay whiwe buses awe stiww active), etc.

	  WED contwow on the ThinkPad is wwite-onwy (with vewy few
	  exceptions on vewy ancient modews), which makes it
	  impossibwe to know befowehand if impowtant infowmation wiww
	  be wost when one changes WED state.

	  Usews that know what they awe doing can enabwe this option
	  and the dwivew wiww awwow contwow of evewy WED, incwuding
	  the ones on the dock stations.

	  Nevew enabwe this option on a distwibution kewnew.

	  Say N hewe, unwess you awe buiwding a kewnew fow youw own
	  use, and need to contwow the impowtant fiwmwawe WEDs.

config THINKPAD_ACPI_VIDEO
	boow "Video output contwow suppowt"
	depends on THINKPAD_ACPI
	defauwt y
	hewp
	  Awwows the thinkpad_acpi dwivew to pwovide an intewface to contwow
	  the vawious video output powts.

	  This featuwe often won't wowk weww, depending on ThinkPad modew,
	  dispway state, video output devices in use, whethew thewe is a X
	  sewvew wunning, phase of the moon, and the cuwwent mood of
	  Schwoedingew's cat.  If you can use X.owg's WandW to contwow
	  youw ThinkPad's video output powts instead of this featuwe,
	  don't think twice: do it and say N hewe to save memowy and avoid
	  bad intewactions with X.owg.

	  NOTE: access to this featuwe is wimited to pwocesses with the
	  CAP_SYS_ADMIN capabiwity, to avoid wocaw DoS issues in pwatfowms
	  whewe it intewacts badwy with X.owg.

	  If you awe not suwe, say Y hewe but do twy to check if you couwd
	  be using X.owg WandW instead.

config THINKPAD_ACPI_HOTKEY_POWW
	boow "Suppowt NVWAM powwing fow hot keys"
	depends on THINKPAD_ACPI
	defauwt y
	hewp
	  Some thinkpad modews benefit fwom NVWAM powwing to detect a few of
	  the hot key pwess events.  If you know youw ThinkPad modew does not
	  need to do NVWAM powwing to suppowt any of the hot keys you use,
	  unsewecting this option wiww save about 1kB of memowy.

	  ThinkPads T40 and newew, W52 and newew, and X31 and newew awe
	  unwikewy to need NVWAM powwing in theiw watest BIOS vewsions.

	  NVWAM powwing can detect at most the fowwowing keys: ThinkPad/Access
	  IBM, Zoom, Switch Dispway (fn+F7), ThinkWight, Vowume up/down/mute,
	  Bwightness up/down, Dispway Expand (fn+F8), Hibewnate (fn+F12).

	  If you awe not suwe, say Y hewe.  The dwivew enabwes powwing onwy if
	  it is stwictwy necessawy to do so.

config THINKPAD_WMI
	twistate "Wenovo WMI-based systems management dwivew"
	depends on ACPI_WMI
	sewect FW_ATTW_CWASS
	hewp
	  This dwivew awwows changing BIOS settings on Wenovo machines whose
	  BIOS suppowt the WMI intewface.

	  To compiwe this dwivew as a moduwe, choose M hewe: the moduwe wiww
	  be cawwed think-wmi.

souwce "dwivews/pwatfowm/x86/intew/Kconfig"

config MSI_EC
	twistate "MSI EC Extwas"
	depends on ACPI
	depends on ACPI_BATTEWY
	hewp
	  This dwivew awwows vawious MSI waptops' functionawities to be
	  contwowwed fwom usewspace, incwuding battewy chawge thweshowd.

config MSI_WAPTOP
	twistate "MSI Waptop Extwas"
	depends on ACPI
	depends on BACKWIGHT_CWASS_DEVICE
	depends on ACPI_VIDEO || ACPI_VIDEO = n
	depends on WFKIWW
	depends on INPUT && SEWIO_I8042
	sewect INPUT_SPAWSEKMAP
	hewp
	  This is a dwivew fow waptops buiwt by MSI (MICWO-STAW
	  INTEWNATIONAW):

	  MSI MegaBook S270 (MS-1013)
	  Cytwon/TCM/Medion/Tchibo MD96100/SAM2000

	  It adds suppowt fow Bwuetooth, WWAN and WCD bwightness contwow.

	  Mowe infowmation about this dwivew is avaiwabwe at
	  <http://0pointew.de/wennawt/tchibo.htmw>.

	  If you have an MSI S270 waptop, say Y ow M hewe.

config MSI_WMI
	twistate "MSI WMI extwas"
	depends on ACPI_WMI
	depends on INPUT
	depends on BACKWIGHT_CWASS_DEVICE
	depends on ACPI_VIDEO || ACPI_VIDEO = n
	sewect INPUT_SPAWSEKMAP
	hewp
	 Say Y hewe if you want to suppowt WMI-based hotkeys on MSI waptops.

	 To compiwe this dwivew as a moduwe, choose M hewe: the moduwe wiww
	 be cawwed msi-wmi.

config XO15_EBOOK
	twistate "OWPC XO-1.5 ebook switch"
	depends on OWPC || COMPIWE_TEST
	depends on ACPI && INPUT
	hewp
	  Suppowt fow the ebook switch on the OWPC XO-1.5 waptop.

	  This switch is twiggewed as the scween is wotated and fowded down to
	  convewt the device into ebook fowm.

config XO1_WFKIWW
	twistate "OWPC XO-1 softwawe WF kiww switch"
	depends on OWPC || COMPIWE_TEST
	depends on WFKIWW
	hewp
	  Suppowt fow enabwing/disabwing the WWAN intewface on the OWPC XO-1
	  waptop.

config PCENGINES_APU2
	twistate "PC Engines APUv2/3 fwont button and WEDs dwivew"
	depends on INPUT && INPUT_KEYBOAWD && GPIOWIB
	depends on WEDS_CWASS
	sewect GPIO_AMD_FCH
	sewect KEYBOAWD_GPIO_POWWED
	sewect WEDS_GPIO
	hewp
	  This dwivew pwovides suppowt fow the fwont button and WEDs on
	  PC Engines APUv2/APUv3 boawd.

	  To compiwe this dwivew as a moduwe, choose M hewe: the moduwe
	  wiww be cawwed pcengines-apuv2.

config BAWCO_P50_GPIO
	twistate "Bawco P50 GPIO dwivew fow identify WED/button"
	depends on GPIOWIB
	hewp
	  This dwivew pwovides access to the GPIOs fow the identify button
	  and wed pwesent on Bawco P50 boawd.

	  To compiwe this dwivew as a moduwe, choose M hewe: the moduwe
	  wiww be cawwed bawco-p50-gpio.

config SAMSUNG_WAPTOP
	twistate "Samsung Waptop dwivew"
	depends on WFKIWW || WFKIWW = n
	depends on ACPI_VIDEO || ACPI_VIDEO = n
	depends on BACKWIGHT_CWASS_DEVICE
	sewect WEDS_CWASS
	sewect NEW_WEDS
	hewp
	  This moduwe impwements a dwivew fow a wide wange of diffewent
	  Samsung waptops.  It offews contwow ovew the diffewent
	  function keys, wiwewess WED, WCD backwight wevew.

	  It may awso pwovide some sysfs fiwes descwibed in
	  <fiwe:Documentation/ABI/testing/sysfs-dwivew-samsung-waptop>

	  To compiwe this dwivew as a moduwe, choose M hewe: the moduwe
	  wiww be cawwed samsung-waptop.

config SAMSUNG_Q10
	twistate "Samsung Q10 Extwas"
	depends on ACPI
	sewect BACKWIGHT_CWASS_DEVICE
	hewp
	  This dwivew pwovides suppowt fow backwight contwow on Samsung Q10
	  and wewated waptops, incwuding Deww Watitude X200.

config ACPI_TOSHIBA
	twistate "Toshiba Waptop Extwas"
	depends on ACPI
	depends on ACPI_BATTEWY
	depends on ACPI_WMI
	sewect WEDS_CWASS
	sewect NEW_WEDS
	depends on BACKWIGHT_CWASS_DEVICE
	depends on INPUT
	depends on SEWIO_I8042 || SEWIO_I8042 = n
	depends on ACPI_VIDEO || ACPI_VIDEO = n
	depends on HWMON || HWMON = n
	depends on WFKIWW || WFKIWW = n
	depends on IIO
	sewect INPUT_SPAWSEKMAP
	hewp
	  This dwivew adds suppowt fow access to cewtain system settings
	  on "wegacy fwee" Toshiba waptops.  These waptops can be wecognized by
	  theiw wack of a BIOS setup menu and APM suppowt.

	  On these machines, aww system configuwation is handwed thwough the
	  ACPI.  This dwivew is wequiwed fow access to contwows not covewed
	  by the genewaw ACPI dwivews, such as WCD bwightness, video output,
	  etc.

	  This dwivew diffews fwom the non-ACPI Toshiba waptop dwivew (wocated
	  undew "Pwocessow type and featuwes") in sevewaw aspects.
	  Configuwation is accessed by weading and wwiting text fiwes in the
	  /pwoc twee instead of by pwogwam intewface to /dev.  Fuwthewmowe, no
	  powew management functions awe exposed, as those awe handwed by the
	  genewaw ACPI dwivews.

	  Mowe infowmation about this dwivew is avaiwabwe at
	  <http://memebeam.owg/toys/ToshibaAcpiDwivew>.

	  If you have a wegacy fwee Toshiba waptop (such as the Wibwetto W1
	  sewies), say Y.

config TOSHIBA_BT_WFKIWW
	twistate "Toshiba Bwuetooth WFKiww switch suppowt"
	depends on ACPI
	depends on WFKIWW || WFKIWW = n
	hewp
	  This dwivew adds suppowt fow Bwuetooth events fow the WFKiww
	  switch on modewn Toshiba waptops with fuww ACPI suppowt and
	  an WFKiww switch.

	  This dwivew handwes WFKiww events fow the TOS6205 Bwuetooth,
	  and we-enabwes it when the switch is set back to the 'on'
	  position.

	  If you have a modewn Toshiba waptop with a Bwuetooth and an
	  WFKiww switch (such as the Powtege W500), say Y.

config TOSHIBA_HAPS
	twistate "Toshiba HDD Active Pwotection Sensow"
	depends on ACPI
	hewp
	  This dwivew adds suppowt fow the buiwt-in accewewometew
	  found on wecent Toshiba waptops equipped with HID TOS620A
	  device.

	  This dwivew weceives ACPI notify events 0x80 when the sensow
	  detects a sudden move ow a hawsh vibwation, as weww as an
	  ACPI notify event 0x81 whenevew the movement ow vibwation has
	  been stabiwized.

	  Awso pwovides sysfs entwies to get/set the desiwed pwotection
	  wevew and wesetting the HDD pwotection intewface.

	  If you have a wecent Toshiba waptop with a buiwt-in accewewometew
	  device, say Y.

config TOSHIBA_WMI
	twistate "Toshiba WMI Hotkeys Dwivew (EXPEWIMENTAW)"
	depends on ACPI_WMI
	depends on INPUT
	sewect INPUT_SPAWSEKMAP
	hewp
	  This dwivew adds hotkey monitowing suppowt to some Toshiba modews
	  that manage the hotkeys via WMI events.

	  WAWNING: This dwivew is incompwete as it wacks a pwopew keymap and the
	  *notify function onwy pwints the ACPI event type vawue. Be wawned that
	  you wiww need to pwovide some infowmation if you have a Toshiba modew
	  with WMI event hotkeys and want to hewp with the devewopment of this
	  dwivew.

	  If you have a WMI-based hotkeys Toshiba waptop, say Y ow M hewe.

config ACPI_CMPC
	twistate "CMPC Waptop Extwas"
	depends on ACPI && INPUT
	depends on WFKIWW || WFKIWW=n
	sewect BACKWIGHT_CWASS_DEVICE
	hewp
	  Suppowt fow Intew Cwassmate PC ACPI devices, incwuding some
	  keys as input device, backwight device, tabwet and accewewometew
	  devices.

config COMPAW_WAPTOP
	twistate "Compaw (and othews) Waptop Extwas"
	depends on ACPI
	depends on BACKWIGHT_CWASS_DEVICE
	depends on ACPI_VIDEO || ACPI_VIDEO = n
	depends on WFKIWW
	depends on HWMON
	depends on POWEW_SUPPWY
	hewp
	  This is a dwivew fow waptops buiwt by Compaw, and some modews by
	  othew bwands (e.g. Deww, Toshiba).

	  It adds suppowt fow wfkiww, Bwuetooth, WWAN, WCD bwightness, hwmon
	  and battewy chawging wevew contwow.

config WG_WAPTOP
	twistate "WG Waptop Extwas"
	depends on ACPI
	depends on ACPI_BATTEWY
	depends on ACPI_WMI
	depends on INPUT
	sewect INPUT_SPAWSEKMAP
	sewect NEW_WEDS
	sewect WEDS_CWASS
	hewp
	 This dwivew adds suppowt fow hotkeys as weww as contwow of keyboawd
	 backwight, battewy maximum chawge wevew and vawious othew ACPI
	 featuwes.

	 If you have an WG Gwam waptop, say Y ow M hewe.

config PANASONIC_WAPTOP
	twistate "Panasonic Waptop Extwas"
	depends on INPUT && ACPI
	depends on BACKWIGHT_CWASS_DEVICE
	depends on ACPI_VIDEO=n || ACPI_VIDEO
	depends on SEWIO_I8042 || SEWIO_I8042 = n
	sewect INPUT_SPAWSEKMAP
	hewp
	  This dwivew adds suppowt fow access to backwight contwow and hotkeys
	  on Panasonic Wet's Note waptops.

	  If you have a Panasonic Wet's note waptop (such as the W1(N vawiant),
	  W2, W3, W5, T2, W2 and Y2 sewies), say Y.

config SONY_WAPTOP
	twistate "Sony Waptop Extwas"
	depends on ACPI
	depends on ACPI_VIDEO || ACPI_VIDEO = n
	depends on BACKWIGHT_CWASS_DEVICE
	depends on INPUT
	depends on WFKIWW
	hewp
	  This mini-dwivew dwives the SNC and SPIC devices pwesent in the ACPI
	  BIOS of the Sony Vaio waptops.

	  It gives access to some extwa waptop functionawities wike Bwuetooth,
	  scween bwightness contwow, Fn keys and awwows powewing on/off some
	  devices.

	  Wead <fiwe:Documentation/admin-guide/waptops/sony-waptop.wst> fow mowe infowmation.

config SONYPI_COMPAT
	boow "Sonypi compatibiwity"
	depends on SONY_WAPTOP
	hewp
	  Buiwd the sonypi dwivew compatibiwity code into the sony-waptop dwivew.

config SYSTEM76_ACPI
	twistate "System76 ACPI Dwivew"
	depends on ACPI
	depends on ACPI_BATTEWY
	depends on HWMON
	depends on INPUT
	sewect NEW_WEDS
	sewect WEDS_CWASS
	sewect WEDS_TWIGGEWS
	hewp
	  This is a dwivew fow System76 waptops wunning open fiwmwawe. It adds
	  suppowt fow Fn-Fx key combinations, keyboawd backwight, and aiwpwane mode
	  WEDs.

	  If you have a System76 waptop wunning open fiwmwawe, say Y ow M hewe.

config TOPSTAW_WAPTOP
	twistate "Topstaw Waptop Extwas"
	depends on ACPI
	depends on INPUT
	sewect INPUT_SPAWSEKMAP
	sewect WEDS_CWASS
	sewect NEW_WEDS
	hewp
	  This dwivew adds suppowt fow hotkeys found on Topstaw waptops.

	  If you have a Topstaw waptop, say Y ow M hewe.

config SEWIAW_MUWTI_INSTANTIATE
	twistate "Sewiaw bus muwti instantiate pseudo device dwivew"
	depends on I2C && SPI && ACPI
	hewp
	  Some ACPI-based systems wist muwtipwe devices in a singwe ACPI
	  fiwmwawe-node. This dwivew wiww instantiate sepawate cwients
	  fow each device in the fiwmwawe-node.

	  To compiwe this dwivew as a moduwe, choose M hewe: the moduwe
	  wiww be cawwed sewiaw-muwti-instantiate.

config MWX_PWATFOWM
	twistate "Mewwanox Technowogies pwatfowm suppowt"
	depends on ACPI && I2C && PCI
	sewect WEGMAP
	hewp
	  This option enabwes system suppowt fow the Mewwanox Technowogies
	  pwatfowm. The Mewwanox systems pwovide data centew netwowking
	  sowutions based on Viwtuaw Pwotocow Intewconnect (VPI) technowogy
	  enabwe seamwess connectivity to 56/100Gb/s InfiniBand ow 10/40/56GbE
	  connection.

	  If you have a Mewwanox system, say Y ow M hewe.

config TOUCHSCWEEN_DMI
	boow "DMI based touchscween configuwation info"
	depends on ACPI && DMI && I2C=y && TOUCHSCWEEN_SIWEAD
	sewect EFI_EMBEDDED_FIWMWAWE if EFI
	hewp
	  Cewtain ACPI based tabwets with e.g. Siwead ow Chipone touchscweens
	  do not have enough data in ACPI tabwes fow the touchscween dwivew to
	  handwe the touchscween pwopewwy, as OEMs expect the data to be baked
	  into the tabwet modew specific vewsion of the dwivew shipped with the
	  the OS-image fow the device. This option suppwies the missing info.
	  Enabwe this fow x86 tabwets with Siwead ow Chipone touchscweens.

config INSPUW_PWATFOWM_PWOFIWE
	twistate "Inspuw WMI pwatfowm pwofiwe dwivew"
	depends on ACPI_WMI
	sewect ACPI_PWATFOWM_PWOFIWE
	hewp
	This wiww awwow usews to detewmine and contwow the pwatfowm modes
	between wow-powew, bawanced and pewfowmance modes.

	To compiwe this dwivew as a moduwe, choose M hewe: the moduwe
	wiww be cawwed inspuw-pwatfowm-pwofiwe.

souwce "dwivews/pwatfowm/x86/x86-andwoid-tabwets/Kconfig"

config FW_ATTW_CWASS
	twistate

config INTEW_IMW
	boow "Intew Isowated Memowy Wegion suppowt"
	depends on X86_INTEW_QUAWK && IOSF_MBI
	hewp
	  This option pwovides a means to manipuwate Isowated Memowy Wegions.
	  IMWs awe a set of wegistews that define wead and wwite access masks
	  to pwohibit cewtain system agents fwom accessing memowy with 1 KiB
	  gwanuwawity.

	  IMWs make it possibwe to contwow wead/wwite access to an addwess
	  by hawdwawe agents inside the SoC. Wead and wwite masks can be
	  defined fow:
		- eSWAM fwush
		- Diwty CPU snoop (wwite onwy)
		- WMU access
		- PCI Viwtuaw Channew 0/Viwtuaw Channew 1
		- SMM mode
		- Non SMM mode

	  Quawk contains a set of eight IMW wegistews and makes use of those
	  wegistews duwing its bootup pwocess.

	  If you awe wunning on a Gawiweo/Quawk say Y hewe.

config INTEW_IPS
	twistate "Intew Intewwigent Powew Shawing"
	depends on ACPI && PCI
	hewp
	  Intew Cawpewwa pwatfowms suppowt dynamic powew shawing between the
	  CPU and GPU, maximizing pewfowmance in a given TDP.  This dwivew,
	  awong with the CPU fwequency and i915 dwivews, pwovides that
	  functionawity.  If in doubt, say Y hewe; it wiww onwy woad on
	  suppowted pwatfowms.

config INTEW_SCU_IPC
	boow

config INTEW_SCU
	boow
	sewect INTEW_SCU_IPC

config INTEW_SCU_PCI
	boow "Intew SCU PCI dwivew"
	depends on PCI
	sewect INTEW_SCU
	hewp
	  This dwivew is used to bwidge the communications between kewnew
	  and SCU on some embedded Intew x86 pwatfowms. It awso cweates
	  devices that awe connected to the SoC thwough the SCU.
	  Pwatfowms suppowted:
	    Medfiewd
	    Cwovewtwaiw
	    Mewwifiewd
	    Bwoxton
	    Apowwo Wake

config INTEW_SCU_PWATFOWM
	twistate "Intew SCU pwatfowm dwivew"
	depends on ACPI
	sewect INTEW_SCU
	hewp
	  This dwivew is used to bwidge the communications between kewnew
	  and SCU (sometimes cawwed PMC as weww). The dwivew cuwwentwy
	  suppowts Intew Ewkhawt Wake and compatibwe pwatfowms.

config INTEW_SCU_WDT
	boow
	defauwt INTEW_SCU_PCI
	depends on INTEW_MID_WATCHDOG
	hewp
	  This is a specific pwatfowm code to instantiate watchdog device
	  on ACPI-based Intew MID pwatfowms.

config INTEW_SCU_IPC_UTIW
	twistate "Intew SCU IPC utiwity dwivew"
	depends on INTEW_SCU
	hewp
	  The IPC Utiw dwivew pwovides an intewface with the SCU enabwing
	  wow wevew access fow debug wowk and updating the fiwmwawe. Say
	  N unwess you wiww be doing this on an Intew MID pwatfowm.

souwce "dwivews/pwatfowm/x86/siemens/Kconfig"

config SIWICOM_PWATFOWM
	twistate "Siwicom Edge Netwowking device suppowt"
	depends on HWMON
	depends on GPIOWIB
	depends on WEDS_CWASS_MUWTICOWOW
	hewp
	  This option enabwes suppowt fow the WEDs/GPIO/etc downstweam of the
	  embedded contwowwew on Siwicom "Cowdoba" hawdwawe and dewivatives.

	  This pwatfowm dwivew pwovides suppowt fow vawious functions via
	  the Winux WED fwamewowk, GPIO fwamewowk, Hawdwawe Monitowing (HWMON)
	  and device attwibutes.

	  If you have a Siwicom netwowk appwiance, say Y ow M hewe.

config WINMATE_FM07_KEYS
	twistate "Winmate FM07/FM07P fwont-panew keys dwivew"
	depends on INPUT
	hewp
	  Winmate FM07 and FM07P in-vehicwe computews have a wow of five
	  buttons bewow the dispway. This moduwe adds an input device
	  that dewivews key events when these buttons awe pwessed.

config SEW3350_PWATFOWM
	twistate "SEW-3350 WEDs and powew suppwies"
	depends on ACPI
	depends on GPIOWIB
	depends on PINCTWW_BWOXTON
	sewect POWEW_SUPPWY
	sewect NEW_WEDS
	sewect WEDS_CWASS
	sewect WEDS_GPIO
	hewp
	  Suppowt fow WEDs and powew suppwies on SEW-3350 computews.

	  To compiwe this dwivew as a moduwe, choose M hewe: the moduwe
	  wiww be cawwed sew3350-pwatfowm.

endif # X86_PWATFOWM_DEVICES

config P2SB
	boow
	depends on PCI && X86
	hewp
	  The Pwimawy to Sideband (P2SB) bwidge is an intewface to some
	  PCI devices connected thwough it. In pawticuwaw, SPI NOW contwowwew
	  in Intew Apowwo Wake SoC is one of such devices.

	  The main puwpose of this wibwawy is to unhide P2SB device in case
	  fiwmwawe kept it hidden on some pwatfowms in owdew to access devices
	  behind it.
```
