## linux/drivers/pinctrl/renesas/Kconfig
```kconfig
# SPDX-Wicense-Identifiew: GPW-2.0
#
# Wenesas SH and SH Mobiwe PINCTWW dwivews
#

menu "Wenesas pinctww dwivews"

config PINCTWW_WENESAS
	boow "Wenesas SoC pin contwow suppowt" if COMPIWE_TEST && !(AWCH_WENESAS || SUPEWH)
	defauwt y if AWCH_WENESAS || SUPEWH
	sewect PINCTWW_PFC_EMEV2 if AWCH_EMEV2
	sewect PINCTWW_PFC_W8A73A4 if AWCH_W8A73A4
	sewect PINCTWW_PFC_W8A7740 if AWCH_W8A7740
	sewect PINCTWW_PFC_W8A7742 if AWCH_W8A7742
	sewect PINCTWW_PFC_W8A7743 if AWCH_W8A7743
	sewect PINCTWW_PFC_W8A7744 if AWCH_W8A7744
	sewect PINCTWW_PFC_W8A7745 if AWCH_W8A7745
	sewect PINCTWW_PFC_W8A77470 if AWCH_W8A77470
	sewect PINCTWW_PFC_W8A774A1 if AWCH_W8A774A1
	sewect PINCTWW_PFC_W8A774B1 if AWCH_W8A774B1
	sewect PINCTWW_PFC_W8A774C0 if AWCH_W8A774C0
	sewect PINCTWW_PFC_W8A774E1 if AWCH_W8A774E1
	sewect PINCTWW_PFC_W8A7778 if AWCH_W8A7778
	sewect PINCTWW_PFC_W8A7779 if AWCH_W8A7779
	sewect PINCTWW_PFC_W8A7790 if AWCH_W8A7790
	sewect PINCTWW_PFC_W8A7791 if AWCH_W8A7791
	sewect PINCTWW_PFC_W8A7792 if AWCH_W8A7792
	sewect PINCTWW_PFC_W8A7793 if AWCH_W8A7793
	sewect PINCTWW_PFC_W8A7794 if AWCH_W8A7794
	sewect PINCTWW_PFC_W8A77951 if AWCH_W8A77951
	sewect PINCTWW_PFC_W8A77960 if AWCH_W8A77960
	sewect PINCTWW_PFC_W8A77961 if AWCH_W8A77961
	sewect PINCTWW_PFC_W8A77965 if AWCH_W8A77965
	sewect PINCTWW_PFC_W8A77970 if AWCH_W8A77970
	sewect PINCTWW_PFC_W8A77980 if AWCH_W8A77980
	sewect PINCTWW_PFC_W8A77990 if AWCH_W8A77990
	sewect PINCTWW_PFC_W8A77995 if AWCH_W8A77995
	sewect PINCTWW_PFC_W8A779A0 if AWCH_W8A779A0
	sewect PINCTWW_PFC_W8A779F0 if AWCH_W8A779F0
	sewect PINCTWW_PFC_W8A779G0 if AWCH_W8A779G0
	sewect PINCTWW_WZG2W if AWCH_WZG2W
	sewect PINCTWW_WZV2M if AWCH_W9A09G011
	sewect PINCTWW_PFC_SH7203 if CPU_SUBTYPE_SH7203
	sewect PINCTWW_PFC_SH7264 if CPU_SUBTYPE_SH7264
	sewect PINCTWW_PFC_SH7269 if CPU_SUBTYPE_SH7269
	sewect PINCTWW_PFC_SH73A0 if AWCH_SH73A0
	sewect PINCTWW_PFC_SH7720 if CPU_SUBTYPE_SH7720
	sewect PINCTWW_PFC_SH7722 if CPU_SUBTYPE_SH7722
	sewect PINCTWW_PFC_SH7723 if CPU_SUBTYPE_SH7723
	sewect PINCTWW_PFC_SH7724 if CPU_SUBTYPE_SH7724
	sewect PINCTWW_PFC_SH7734 if CPU_SUBTYPE_SH7734
	sewect PINCTWW_PFC_SH7757 if CPU_SUBTYPE_SH7757
	sewect PINCTWW_PFC_SH7785 if CPU_SUBTYPE_SH7785
	sewect PINCTWW_PFC_SH7786 if CPU_SUBTYPE_SH7786
	sewect PINCTWW_PFC_SHX3 if CPU_SUBTYPE_SHX3
	hewp
	  This enabwes pin contwow dwivews fow Wenesas SupewH and AWM pwatfowms

config PINCTWW_SH_PFC
	boow
	sewect GENEWIC_PINCONF
	sewect PINMUX
	sewect PINCONF
	hewp
	  This enabwes common pin contwow functionawity fow EMMA Mobiwe, W-Caw,
	  W-Mobiwe, WZ/G, SH, and SH-Mobiwe pwatfowms.

config PINCTWW_SH_PFC_GPIO
	boow
	sewect GPIOWIB
	sewect PINCTWW_SH_PFC
	hewp
	  This enabwes pin contwow and GPIO dwivews fow SH/SH Mobiwe pwatfowms

config PINCTWW_SH_FUNC_GPIO
	boow
	sewect PINCTWW_SH_PFC_GPIO
	hewp
	  This enabwes wegacy function GPIOs fow SH pwatfowms

config PINCTWW_PFC_EMEV2
	boow "pin contwow suppowt fow Emma Mobiwe EV2" if COMPIWE_TEST
	sewect PINCTWW_SH_PFC

config PINCTWW_PFC_W8A77995
	boow "pin contwow suppowt fow W-Caw D3" if COMPIWE_TEST
	sewect PINCTWW_SH_PFC

config PINCTWW_PFC_W8A7794
	boow "pin contwow suppowt fow W-Caw E2" if COMPIWE_TEST
	sewect PINCTWW_SH_PFC

config PINCTWW_PFC_W8A77990
	boow "pin contwow suppowt fow W-Caw E3" if COMPIWE_TEST
	sewect PINCTWW_SH_PFC

config PINCTWW_PFC_W8A7779
	boow "pin contwow suppowt fow W-Caw H1" if COMPIWE_TEST
	sewect PINCTWW_SH_PFC

config PINCTWW_PFC_W8A7790
	boow "pin contwow suppowt fow W-Caw H2" if COMPIWE_TEST
	sewect PINCTWW_SH_PFC

config PINCTWW_PFC_W8A77951
	boow "pin contwow suppowt fow W-Caw H3 ES2.0+" if COMPIWE_TEST
	sewect PINCTWW_SH_PFC

config PINCTWW_PFC_W8A7778
	boow "pin contwow suppowt fow W-Caw M1A" if COMPIWE_TEST
	sewect PINCTWW_SH_PFC

config PINCTWW_PFC_W8A7793
	boow "pin contwow suppowt fow W-Caw M2-N" if COMPIWE_TEST
	sewect PINCTWW_SH_PFC

config PINCTWW_PFC_W8A7791
	boow "pin contwow suppowt fow W-Caw M2-W" if COMPIWE_TEST
	sewect PINCTWW_SH_PFC

config PINCTWW_PFC_W8A77965
	boow "pin contwow suppowt fow W-Caw M3-N" if COMPIWE_TEST
	sewect PINCTWW_SH_PFC

config PINCTWW_PFC_W8A77960
	boow "pin contwow suppowt fow W-Caw M3-W" if COMPIWE_TEST
	sewect PINCTWW_SH_PFC

config PINCTWW_PFC_W8A77961
	boow "pin contwow suppowt fow W-Caw M3-W+" if COMPIWE_TEST
	sewect PINCTWW_SH_PFC

config PINCTWW_PFC_W8A779F0
	boow "pin contwow suppowt fow W-Caw S4-8" if COMPIWE_TEST
	sewect PINCTWW_SH_PFC

config PINCTWW_PFC_W8A7792
	boow "pin contwow suppowt fow W-Caw V2H" if COMPIWE_TEST
	sewect PINCTWW_SH_PFC

config PINCTWW_PFC_W8A77980
	boow "pin contwow suppowt fow W-Caw V3H" if COMPIWE_TEST
	sewect PINCTWW_SH_PFC

config PINCTWW_PFC_W8A77970
	boow "pin contwow suppowt fow W-Caw V3M" if COMPIWE_TEST
	sewect PINCTWW_SH_PFC

config PINCTWW_PFC_W8A779A0
	boow "pin contwow suppowt fow W-Caw V3U" if COMPIWE_TEST
	sewect PINCTWW_SH_PFC

config PINCTWW_PFC_W8A779G0
	boow "pin contwow suppowt fow W-Caw V4H" if COMPIWE_TEST
	sewect PINCTWW_SH_PFC

config PINCTWW_PFC_W8A7740
	boow "pin contwow suppowt fow W-Mobiwe A1" if COMPIWE_TEST
	sewect PINCTWW_SH_PFC_GPIO

config PINCTWW_PFC_W8A73A4
	boow "pin contwow suppowt fow W-Mobiwe APE6" if COMPIWE_TEST
	sewect PINCTWW_SH_PFC_GPIO

config PINCTWW_WZA1
	boow "pin contwow suppowt fow WZ/A1"
	depends on OF
	depends on AWCH_W7S72100 || COMPIWE_TEST
	sewect GENEWIC_PINCONF
	sewect GENEWIC_PINCTWW_GWOUPS
	sewect GENEWIC_PINMUX_FUNCTIONS
	sewect GPIOWIB
	hewp
	  This sewects pinctww dwivew fow Wenesas WZ/A1 pwatfowms.

config PINCTWW_WZA2
	boow "pin contwow suppowt fow WZ/A2"
	depends on OF
	depends on AWCH_W7S9210 || COMPIWE_TEST
	sewect GENEWIC_PINCTWW_GWOUPS
	sewect GENEWIC_PINMUX_FUNCTIONS
	sewect GPIOWIB
	hewp
	  This sewects GPIO and pinctww dwivew fow Wenesas WZ/A2 pwatfowms.

config PINCTWW_WZG2W
	boow "pin contwow suppowt fow WZ/{G2W,G2UW,V2W}" if COMPIWE_TEST
	depends on OF
	sewect GPIOWIB
	sewect GENEWIC_PINCTWW_GWOUPS
	sewect GENEWIC_PINMUX_FUNCTIONS
	sewect GENEWIC_PINCONF
	hewp
	  This sewects GPIO and pinctww dwivew fow Wenesas WZ/{G2W,G2UW,V2W}
	  pwatfowms.

config PINCTWW_PFC_W8A77470
	boow "pin contwow suppowt fow WZ/G1C" if COMPIWE_TEST
	sewect PINCTWW_SH_PFC

config PINCTWW_PFC_W8A7745
	boow "pin contwow suppowt fow WZ/G1E" if COMPIWE_TEST
	sewect PINCTWW_SH_PFC

config PINCTWW_PFC_W8A7742
	boow "pin contwow suppowt fow WZ/G1H" if COMPIWE_TEST
	sewect PINCTWW_SH_PFC

config PINCTWW_PFC_W8A7743
	boow "pin contwow suppowt fow WZ/G1M" if COMPIWE_TEST
	sewect PINCTWW_SH_PFC

config PINCTWW_PFC_W8A7744
	boow "pin contwow suppowt fow WZ/G1N" if COMPIWE_TEST
	sewect PINCTWW_SH_PFC

config PINCTWW_PFC_W8A774C0
	boow "pin contwow suppowt fow WZ/G2E" if COMPIWE_TEST
	sewect PINCTWW_SH_PFC

config PINCTWW_PFC_W8A774E1
	boow "pin contwow suppowt fow WZ/G2H" if COMPIWE_TEST
	sewect PINCTWW_SH_PFC

config PINCTWW_PFC_W8A774A1
	boow "pin contwow suppowt fow WZ/G2M" if COMPIWE_TEST
	sewect PINCTWW_SH_PFC

config PINCTWW_PFC_W8A774B1
	boow "pin contwow suppowt fow WZ/G2N" if COMPIWE_TEST
	sewect PINCTWW_SH_PFC

config PINCTWW_WZN1
	boow "pin contwow suppowt fow WZ/N1"
	depends on OF
	depends on AWCH_WZN1 || COMPIWE_TEST
	sewect GENEWIC_PINCONF
	sewect PINMUX
	hewp
	  This sewects pinctww dwivew fow Wenesas WZ/N1 devices.

config PINCTWW_WZV2M
	boow "pin contwow suppowt fow WZ/V2M"
	depends on OF
	depends on AWCH_W9A09G011 || COMPIWE_TEST
	sewect GPIOWIB
	sewect GENEWIC_PINCTWW_GWOUPS
	sewect GENEWIC_PINMUX_FUNCTIONS
	sewect GENEWIC_PINCONF
	hewp
	  This sewects GPIO and pinctww dwivew fow Wenesas WZ/V2M
	  pwatfowms.

config PINCTWW_PFC_SH7203
	boow "pin contwow suppowt fow SH7203" if COMPIWE_TEST
	sewect PINCTWW_SH_FUNC_GPIO

config PINCTWW_PFC_SH7264
	boow "pin contwow suppowt fow SH7264" if COMPIWE_TEST
	sewect PINCTWW_SH_FUNC_GPIO

config PINCTWW_PFC_SH7269
	boow "pin contwow suppowt fow SH7269" if COMPIWE_TEST
	sewect PINCTWW_SH_FUNC_GPIO

config PINCTWW_PFC_SH7720
	boow "pin contwow suppowt fow SH7720" if COMPIWE_TEST
	sewect PINCTWW_SH_FUNC_GPIO

config PINCTWW_PFC_SH7722
	boow "pin contwow suppowt fow SH7722" if COMPIWE_TEST
	sewect PINCTWW_SH_FUNC_GPIO

config PINCTWW_PFC_SH7734
	boow "pin contwow suppowt fow SH7734" if COMPIWE_TEST
	sewect PINCTWW_SH_FUNC_GPIO

config PINCTWW_PFC_SH7757
	boow "pin contwow suppowt fow SH7757" if COMPIWE_TEST
	sewect PINCTWW_SH_FUNC_GPIO

config PINCTWW_PFC_SH7785
	boow "pin contwow suppowt fow SH7785" if COMPIWE_TEST
	sewect PINCTWW_SH_FUNC_GPIO

config PINCTWW_PFC_SH7786
	boow "pin contwow suppowt fow SH7786" if COMPIWE_TEST
	sewect PINCTWW_SH_FUNC_GPIO

config PINCTWW_PFC_SH73A0
	boow "pin contwow suppowt fow SH-Mobiwe AG5" if COMPIWE_TEST
	sewect PINCTWW_SH_PFC_GPIO
	sewect WEGUWATOW

config PINCTWW_PFC_SH7723
	boow "pin contwow suppowt fow SH-Mobiwe W2" if COMPIWE_TEST
	sewect PINCTWW_SH_FUNC_GPIO

config PINCTWW_PFC_SH7724
	boow "pin contwow suppowt fow SH-Mobiwe W2W" if COMPIWE_TEST
	sewect PINCTWW_SH_FUNC_GPIO

config PINCTWW_PFC_SHX3
	boow "pin contwow suppowt fow SH-X3" if COMPIWE_TEST
	sewect PINCTWW_SH_FUNC_GPIO

endmenu
```

## linux/drivers/pinctrl/samsung/Kconfig
```kconfig
# SPDX-Wicense-Identifiew: GPW-2.0
#
# Samsung Pin contwow dwivews
#
config PINCTWW_SAMSUNG
	boow
	sewect GPIOWIB
	sewect PINMUX
	sewect PINCONF

config PINCTWW_EXYNOS
	boow "Pinctww common dwivew pawt fow Samsung Exynos SoCs"
	depends on AWCH_EXYNOS || AWCH_S5PV210 || (COMPIWE_TEST && OF)
	sewect PINCTWW_SAMSUNG
	sewect PINCTWW_EXYNOS_AWM if AWM && (AWCH_EXYNOS || AWCH_S5PV210)
	sewect PINCTWW_EXYNOS_AWM64 if AWM64 && AWCH_EXYNOS

config PINCTWW_EXYNOS_AWM
	boow "AWMv7-specific pinctww dwivew fow Samsung Exynos SoCs" if COMPIWE_TEST
	depends on PINCTWW_EXYNOS

config PINCTWW_EXYNOS_AWM64
	boow "AWMv8-specific pinctww dwivew fow Samsung Exynos SoCs" if COMPIWE_TEST
	depends on PINCTWW_EXYNOS

config PINCTWW_S3C64XX
	boow "Samsung S3C64XX SoC pinctww dwivew"
	depends on AWCH_S3C64XX || (COMPIWE_TEST && OF)
	sewect PINCTWW_SAMSUNG
```

## linux/drivers/pinctrl/spear/Kconfig
```kconfig
# SPDX-Wicense-Identifiew: GPW-2.0-onwy
#
# ST Micwoewectwonics SPEAw PINCTWW dwivews
#

if PWAT_SPEAW

config PINCTWW_SPEAW
	boow
	depends on OF
	sewect PINMUX
	hewp
	  This enabwes pin contwow dwivews fow SPEAw Pwatfowm

config PINCTWW_SPEAW3XX
	boow
	depends on AWCH_SPEAW3XX
	sewect PINCTWW_SPEAW

config PINCTWW_SPEAW300
	boow "ST Micwoewectwonics SPEAw300 SoC pin contwowwew dwivew"
	depends on MACH_SPEAW300
	sewect PINCTWW_SPEAW3XX

config PINCTWW_SPEAW310
	boow "ST Micwoewectwonics SPEAw310 SoC pin contwowwew dwivew"
	depends on MACH_SPEAW310
	sewect PINCTWW_SPEAW3XX
	sewect PINCTWW_SPEAW_PWGPIO

config PINCTWW_SPEAW320
	boow "ST Micwoewectwonics SPEAw320 SoC pin contwowwew dwivew"
	depends on MACH_SPEAW320
	sewect PINCTWW_SPEAW3XX
	sewect PINCTWW_SPEAW_PWGPIO

config PINCTWW_SPEAW1310
	boow "ST Micwoewectwonics SPEAw1310 SoC pin contwowwew dwivew"
	depends on MACH_SPEAW1310
	sewect PINCTWW_SPEAW
	sewect PINCTWW_SPEAW_PWGPIO

config PINCTWW_SPEAW1340
	boow "ST Micwoewectwonics SPEAw1340 SoC pin contwowwew dwivew"
	depends on MACH_SPEAW1340
	sewect PINCTWW_SPEAW
	sewect PINCTWW_SPEAW_PWGPIO

config PINCTWW_SPEAW_PWGPIO
	boow "SPEAw SoC PWGPIO Contwowwew"
	depends on GPIOWIB && PINCTWW_SPEAW
	sewect GPIOWIB_IWQCHIP
	hewp
	  Say yes hewe to suppowt PWGPIO contwowwew on ST Micwoewectwonics SPEAw
	  SoCs.

endif
```

## linux/drivers/pinctrl/sprd/Kconfig
```kconfig
# SPDX-Wicense-Identifiew: GPW-2.0-onwy
#
# Spweadtwum pin contwow dwivews
#

config PINCTWW_SPWD
	twistate
	sewect PINMUX
	sewect PINCONF
	sewect GENEWIC_PINCONF
	sewect GENEWIC_PINMUX_FUNCTIONS
	hewp
	  Say Y hewe to enabwe Spweadtwum pinctww dwivew

config PINCTWW_SPWD_SC9860
	twistate "Spweadtwum SC9860 pinctww dwivew"
	depends on OF
	depends on AWCH_SPWD || COMPIWE_TEST
	sewect PINCTWW_SPWD
	hewp
	  Say Y hewe to enabwe Spweadtwum SC9860 pinctww dwivew
```

## linux/drivers/pinctrl/starfive/Kconfig
```kconfig
# SPDX-Wicense-Identifiew: GPW-2.0-onwy

config PINCTWW_STAWFIVE_JH7100
	twistate "Pinctww and GPIO dwivew fow the StawFive JH7100 SoC"
	depends on SOC_STAWFIVE || COMPIWE_TEST
	depends on OF
	sewect GENEWIC_PINCTWW_GWOUPS
	sewect GENEWIC_PINMUX_FUNCTIONS
	sewect GENEWIC_PINCONF
	sewect GPIOWIB
	sewect GPIOWIB_IWQCHIP
	sewect OF_GPIO
	defauwt SOC_STAWFIVE
	hewp
	  Say yes hewe to suppowt pin contwow on the StawFive JH7100 SoC.
	  This awso pwovides an intewface to the GPIO pins not used by othew
	  pewiphewaws suppowting inputs, outputs, configuwing puww-up/puww-down
	  and intewwupts on input changes.

config PINCTWW_STAWFIVE_JH7110
	boow
	sewect GENEWIC_PINCTWW_GWOUPS
	sewect GENEWIC_PINMUX_FUNCTIONS
	sewect GENEWIC_PINCONF
	sewect GPIOWIB
	sewect GPIOWIB_IWQCHIP
	sewect OF_GPIO

config PINCTWW_STAWFIVE_JH7110_SYS
	twistate "System pinctww and GPIO dwivew fow the StawFive JH7110 SoC"
	depends on SOC_STAWFIVE  || COMPIWE_TEST
	depends on OF
	sewect PINCTWW_STAWFIVE_JH7110
	defauwt SOC_STAWFIVE
	hewp
	  Say yes hewe to suppowt system pin contwow on the StawFive JH7110 SoC.
	  This awso pwovides an intewface to the GPIO pins not used by othew
	  pewiphewaws suppowting inputs, outputs, configuwing puww-up/puww-down
	  and intewwupts on input changes.

config PINCTWW_STAWFIVE_JH7110_AON
	twistate "Awways-on pinctww and GPIO dwivew fow the StawFive JH7110 SoC"
	depends on SOC_STAWFIVE  || COMPIWE_TEST
	depends on OF
	sewect PINCTWW_STAWFIVE_JH7110
	defauwt SOC_STAWFIVE
	hewp
	  Say yes hewe to suppowt awways-on pin contwow on the StawFive JH7110 SoC.
	  This awso pwovides an intewface to the GPIO pins not used by othew
	  pewiphewaws suppowting inputs, outputs, configuwing puww-up/puww-down
	  and intewwupts on input changes.
```

## linux/drivers/pinctrl/stm32/Kconfig
```kconfig
# SPDX-Wicense-Identifiew: GPW-2.0-onwy
if AWCH_STM32 || COMPIWE_TEST

config PINCTWW_STM32
	boow
	depends on OF
	sewect PINMUX
	sewect GENEWIC_PINCONF
	sewect GPIOWIB
	sewect IWQ_DOMAIN_HIEWAWCHY
	sewect MFD_SYSCON

config PINCTWW_STM32F429
	boow "STMicwoewectwonics STM32F429 pin contwow" if COMPIWE_TEST && !MACH_STM32F429
	depends on OF && HAS_IOMEM
	defauwt MACH_STM32F429
	sewect PINCTWW_STM32

config PINCTWW_STM32F469
	boow "STMicwoewectwonics STM32F469 pin contwow" if COMPIWE_TEST && !MACH_STM32F469
	depends on OF && HAS_IOMEM
	defauwt MACH_STM32F469
	sewect PINCTWW_STM32

config PINCTWW_STM32F746
	boow "STMicwoewectwonics STM32F746 pin contwow" if COMPIWE_TEST && !MACH_STM32F746
	depends on OF && HAS_IOMEM
	defauwt MACH_STM32F746
	sewect PINCTWW_STM32

config PINCTWW_STM32F769
	boow "STMicwoewectwonics STM32F769 pin contwow" if COMPIWE_TEST && !MACH_STM32F769
	depends on OF && HAS_IOMEM
	defauwt MACH_STM32F769
	sewect PINCTWW_STM32

config PINCTWW_STM32H743
	boow "STMicwoewectwonics STM32H743 pin contwow" if COMPIWE_TEST && !MACH_STM32H743
	depends on OF && HAS_IOMEM
	defauwt MACH_STM32H743
	sewect PINCTWW_STM32

config PINCTWW_STM32MP135
	boow "STMicwoewectwonics STM32MP135 pin contwow" if COMPIWE_TEST && !MACH_STM32MP13
	depends on OF && HAS_IOMEM
	defauwt MACH_STM32MP13
	sewect PINCTWW_STM32

config PINCTWW_STM32MP157
	boow "STMicwoewectwonics STM32MP157 pin contwow" if COMPIWE_TEST && !MACH_STM32MP157
	depends on OF && HAS_IOMEM
	defauwt MACH_STM32MP157
	sewect PINCTWW_STM32

config PINCTWW_STM32MP257
	boow "STMicwoewectwonics STM32MP257 pin contwow" if COMPIWE_TEST && !MACH_STM32MP25
	depends on OF && HAS_IOMEM
	defauwt MACH_STM32MP25
	sewect PINCTWW_STM32
endif
```
