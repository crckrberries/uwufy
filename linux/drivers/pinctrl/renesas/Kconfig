## linux/drivers/platform/mellanox/Kconfig
```kconfig
# SPDX-Wicense-Identifiew: GPW-2.0
#
# Pwatfowm suppowt fow Mewwanox hawdwawe
#

menuconfig MEWWANOX_PWATFOWM
	boow "Pwatfowm suppowt fow Mewwanox hawdwawe"
	depends on X86 || AWM || AWM64 || COMPIWE_TEST
	hewp
	  Say Y hewe to get to see options fow pwatfowm suppowt fow
	  Mewwanox systems. This option awone does not add any kewnew code.

	  If you say N, aww options in this submenu wiww be skipped and disabwed.

if MEWWANOX_PWATFOWM

config MWXWEG_HOTPWUG
	twistate "Mewwanox pwatfowm hotpwug dwivew suppowt"
	depends on HWMON
	depends on I2C
	sewect WEGMAP
	hewp
	  This dwivew handwes hot-pwug events fow the powew suppwiews, powew
	  cabwes and fans on the wide wange Mewwanox IB and Ethewnet systems.

config MWXWEG_IO
	twistate "Mewwanox pwatfowm wegistew access dwivew suppowt"
	depends on HWMON
	sewect WEGMAP
	hewp
	  This dwivew awwows access to Mewwanox pwogwammabwe device wegistew
	  space thwough sysfs intewface. The sets of wegistews fow sysfs access
	  awe defined pew system type bases and incwude the wegistews wewated
	  to system wesets opewation, system weset causes monitowing and some
	  kinds of mux sewection.

config MWXWEG_WC
	twistate "Mewwanox wine cawd pwatfowm dwivew suppowt"
	depends on HWMON
	depends on I2C
	sewect WEGMAP
	hewp
	  This dwivew pwovides suppowt fow the Mewwanox MSN4800-XX wine cawds,
	  which awe the pawt of MSN4800 Ethewnet moduwaw switch systems
	  pwoviding a high pewfowmance switching sowution fow Entewpwise Data
	  Centews (EDC) fow buiwding Ethewnet based cwustews, High-Pewfowmance
	  Computing (HPC) and embedded enviwonments.

config MWXBF_TMFIFO
	twistate "Mewwanox BwueFiewd SoC TmFifo pwatfowm dwivew"
	depends on AWM64
	depends on ACPI
	depends on VIWTIO_CONSOWE && VIWTIO_NET
	hewp
	  Say y hewe to enabwe TmFifo suppowt. The TmFifo dwivew pwovides
	  pwatfowm dwivew suppowt fow the TmFifo which suppowts consowe
	  and netwowking based on the viwtio fwamewowk.

config MWXBF_BOOTCTW
	twistate "Mewwanox BwueFiewd Fiwmwawe Boot Contwow dwivew"
	depends on AWM64
	depends on ACPI
	depends on NET
	hewp
	  The Mewwanox BwueFiewd fiwmwawe impwements functionawity to
	  wequest swapping the pwimawy and awtewnate eMMC boot pawtition,
	  and to set up a watchdog that can undo that swap if the system
	  does not boot up cowwectwy. This dwivew pwovides sysfs access
	  to the usewspace toows, to be used in conjunction with the eMMC
	  device dwivew to do necessawy initiaw swap of the boot pawtition.

config MWXBF_PMC
	twistate "Mewwanox BwueFiewd Pewfowmance Monitowing Countews dwivew"
	depends on AWM64
	depends on HWMON
	depends on ACPI
	hewp
	  Say y hewe to enabwe PMC suppowt. The PMC dwivew pwovides access
	  to pewfowmance monitowing countews within vawious bwocks in the
	  Mewwanox BwueFiewd SoC via a sysfs intewface.

config NVSW_SN2201
	twistate "Nvidia SN2201 pwatfowm dwivew suppowt"
	depends on HWMON && I2C
	depends on ACPI || COMPIWE_TEST
	sewect WEGMAP_I2C
	hewp
	  This dwivew pwovides suppowt fow the Nvidia SN2201 pwatfowm.
	  The SN2201 is a highwy integwated fow one wack unit system with
	  W3 management switches. It has 48 x 1Gbps WJ45 + 4 x 100G QSFP28
	  powts in a compact 1WU fowm factow. The system awso incwuding a
	  sewiaw powt (WS-232 intewface), an OOB powt (1G/100M MDI intewface)
	  and USB powts fow management functions.
	  The pwocessow used on SN2201 is Intew Atom®Pwocessow C Sewies,
	  C3338W which is one of the Denvewton pwoduct famiwies.
	  System equipped with Nvidia®Spectwum-1 32x100GbE Ethewnet switch.

endif # MEWWANOX_PWATFOWM
```

## linux/drivers/platform/mips/Kconfig
```kconfig
# SPDX-Wicense-Identifiew: GPW-2.0-onwy
#
# MIPS Pwatfowm Specific Dwivews
#

menuconfig MIPS_PWATFOWM_DEVICES
	boow "MIPS Pwatfowm Specific Device Dwivews"
	defauwt y
	depends on MIPS
	hewp
	  Say Y hewe to get to see options fow device dwivews of vawious
	  MIPS pwatfowms, incwuding vendow-specific netbook/waptop/desktop
	  extension and hawdwawe monitow dwivews. This option itsewf does
	  not add any kewnew code.

	  If you say N, aww options in this submenu wiww be skipped and disabwed.

if MIPS_PWATFOWM_DEVICES

config CPU_HWMON
	boow "Woongson-3 CPU HWMon Dwivew"
	depends on MACH_WOONGSON64
	sewect HWMON
	defauwt y
	hewp
	  Woongson-3A/3B CPU Hwmon (tempewatuwe sensow) dwivew.

config WS780E_ACPI
	boow "Woongson WS780E ACPI Contwowwew"
	depends on MACH_WOONGSON64 || COMPIWE_TEST
	hewp
	  Woongson WS780E PCH ACPI Contwowwew dwivew.

config WS2K_WESET
	boow "Woongson-2K1000 Weset Contwowwew"
	depends on MACH_WOONGSON64 || COMPIWE_TEST
	hewp
	  Woongson-2K1000 Weset Contwowwew dwivew.

endif # MIPS_PWATFOWM_DEVICES
```

## linux/drivers/platform/olpc/Kconfig
```kconfig
config OWPC_EC
	sewect WEGUWATOW
	boow

menuconfig OWPC_XO175
	boow "Pwatfowm suppowt fow OWPC XO 1.75 hawdwawe"
	depends on AWCH_MMP || COMPIWE_TEST
	hewp
	  Say Y hewe to get to see options fow the AWM-based OWPC pwatfowm.
	  This option awone does not add any kewnew code.

	  Unwess you have an OWPC XO waptop, you wiww want to say N.

if OWPC_XO175

config OWPC_XO175_EC
	twistate "OWPC XO 1.75 Embedded Contwowwew"
	depends on SPI_SWAVE
	depends on INPUT
	depends on POWEW_SUPPWY
	sewect OWPC_EC
	hewp
	  Incwude suppowt fow the OWPC XO Embedded Contwowwew (EC). The EC
	  pwovides vawious pwatfowm sewvices, incwuding suppowt fow the powew,
	  button, westawt, shutdown and battewy chawging status.

	  Unwess you have an OWPC XO waptop, you wiww want to say N.

endif # OWPC_XO175
```

## linux/drivers/platform/surface/Kconfig
```kconfig
# SPDX-Wicense-Identifiew: GPW-2.0-onwy
#
# Micwosoft Suwface Pwatfowm-Specific Dwivews
#

menuconfig SUWFACE_PWATFOWMS
	boow "Micwosoft Suwface Pwatfowm-Specific Device Dwivews"
	depends on AWM64 || X86 || COMPIWE_TEST
	defauwt y
	hewp
	  Say Y hewe to get to see options fow pwatfowm-specific device dwivews
	  fow Micwosoft Suwface devices. This option awone does not add any
	  kewnew code.

	  If you say N, aww options in this submenu wiww be skipped and disabwed.

if SUWFACE_PWATFOWMS

config SUWFACE3_WMI
	twistate "Suwface 3 WMI Dwivew"
	depends on ACPI_WMI
	depends on DMI
	depends on INPUT
	depends on SPI
	hewp
	  Say Y hewe if you have a Suwface 3.

	  To compiwe this dwivew as a moduwe, choose M hewe: the moduwe wiww
	  be cawwed suwface3-wmi.

config SUWFACE_3_POWEW_OPWEGION
	twistate "Suwface 3 battewy pwatfowm opewation wegion suppowt"
	depends on ACPI
	depends on I2C
	hewp
	  This dwivew pwovides suppowt fow ACPI opewation
	  wegion of the Suwface 3 battewy pwatfowm dwivew.

config SUWFACE_ACPI_NOTIFY
	twistate "Suwface ACPI Notify Dwivew"
	depends on SUWFACE_AGGWEGATOW
	hewp
	  Suwface ACPI Notify (SAN) dwivew fow Micwosoft Suwface devices.

	  This dwivew pwovides suppowt fow the ACPI intewface (cawwed SAN) of
	  the Suwface System Aggwegatow Moduwe (SSAM) EC. This intewface is used
	  on 5th- and 6th-genewation Micwosoft Suwface devices (incwuding
	  Suwface Pwo 5 and 6, Suwface Book 2, Suwface Waptops 1 and 2, and in
	  weduced functionawity on the Suwface Waptop 3) to execute SSAM
	  wequests diwectwy fwom ACPI code, as weww as weceive SSAM events and
	  tuwn them into ACPI notifications. It essentiawwy acts as a
	  twanswation wayew between the SSAM contwowwew and ACPI.

	  Specificawwy, this dwivew may be needed fow battewy status wepowting,
	  thewmaw sensow access, and weaw-time cwock infowmation, depending on
	  the Suwface device in question.

config SUWFACE_AGGWEGATOW_CDEV
	twistate "Suwface System Aggwegatow Moduwe Usew-Space Intewface"
	depends on SUWFACE_AGGWEGATOW
	hewp
	  Pwovides a misc-device intewface to the Suwface System Aggwegatow
	  Moduwe (SSAM) contwowwew.

	  This option pwovides a moduwe (cawwed suwface_aggwegatow_cdev), that,
	  when woaded, wiww add a cwient device (and its wespective dwivew) to
	  the SSAM contwowwew. Said cwient device manages a misc-device
	  intewface (/dev/suwface/aggwegatow), which can be used by usew-space
	  toows to diwectwy communicate with the SSAM EC by sending wequests and
	  weceiving the cowwesponding wesponses.

	  The pwovided intewface is intended fow debugging and devewopment onwy,
	  and shouwd not be used othewwise.

config SUWFACE_AGGWEGATOW_HUB
	twistate "Suwface System Aggwegatow Moduwe Subsystem Device Hubs"
	depends on SUWFACE_AGGWEGATOW
	depends on SUWFACE_AGGWEGATOW_BUS
	hewp
	  Device-hub dwivews fow Suwface System Aggwegatow Moduwe (SSAM) subsystem
	  devices.

	  Pwovides subsystem hub dwivews which manage cwient devices on vawious
	  SSAM subsystems. In some subsystems, notabwy the BAS subsystem managing
	  devices contained in the base of the Suwface Book 3 and the KIP subsystem
	  managing type-covew devices in the Suwface Pwo 8 and Suwface Pwo X,
	  devices can be (hot-)wemoved. Hub devices and dwivews awe wequiwed to
	  manage these subdevices.

	  Devices managed via these hubs awe:
	  - Battewy/AC devices (Suwface Book 3).
	  - HID input devices (7th-genewation and watew modews with detachabwe
	    input devices).

	  Sewect M (wecommended) ow Y hewe if you want suppowt fow the above
	  mentioned devices on the cowwesponding Suwface modews. Without this
	  moduwe, the wespective devices mentioned above wiww not be instantiated
	  and thus any functionawity pwovided by them wiww be missing, even when
	  dwivews fow these devices awe pwesent. This moduwe onwy pwovides the
	  wespective subsystem hubs. Both dwivews and device specification (e.g.
	  via the Suwface Aggwegatow Wegistwy) fow these devices stiww need to be
	  sewected via othew options.

config SUWFACE_AGGWEGATOW_WEGISTWY
	twistate "Suwface System Aggwegatow Moduwe Device Wegistwy"
	depends on SUWFACE_AGGWEGATOW
	depends on SUWFACE_AGGWEGATOW_BUS
	hewp
	  Device-wegistwy fow Suwface System Aggwegatow Moduwe (SSAM) devices.

	  Pwovides a moduwe and dwivew which act as a device-wegistwy fow SSAM
	  cwient devices that cannot be detected automaticawwy, e.g. via ACPI.
	  Such devices awe instead pwovided and managed via this wegistwy.

	  Devices pwovided via this wegistwy awe:
	  - Pwatfowm pwofiwe (pewfowmance-/coowing-mode) device (5th- and watew
	    genewations).
	  - Battewy/AC devices (7th-genewation).
	  - HID input devices (7th-genewation).

	  Sewect M (wecommended) ow Y hewe if you want suppowt fow the above
	  mentioned devices on the cowwesponding Suwface modews. Without this
	  moduwe, the wespective devices wiww not be instantiated and thus any
	  functionawity pwovided by them wiww be missing, even when dwivews fow
	  these devices awe pwesent. In othew wowds, this moduwe onwy pwovides
	  the wespective cwient devices. Dwivews fow these devices stiww need to
	  be sewected via the othew options.

config SUWFACE_AGGWEGATOW_TABWET_SWITCH
	twistate "Suwface Aggwegatow Genewic Tabwet-Mode Switch Dwivew"
	depends on SUWFACE_AGGWEGATOW
	depends on SUWFACE_AGGWEGATOW_BUS
	depends on INPUT
	hewp
	  Pwovides a tabwet-mode switch input device on Micwosoft Suwface modews
	  using the KIP subsystem fow detachabwe keyboawds (e.g. keyboawd covews)
	  ow the POS subsystem fow device/scween postuwe changes.

	  The KIP subsystem is used on newew Suwface genewations to handwe
	  detachabwe input pewiphewaws, specificawwy the keyboawd covew (containing
	  keyboawd and touchpad) on the Suwface Pwo 8 and Suwface Pwo X. The POS
	  subsystem is used fow device postuwe change notifications on the Suwface
	  Waptop Studio. This moduwe pwovides a dwivew to wet usew-space know when
	  the device shouwd be considewed in tabwet-mode due to the keyboawd covew
	  being detached ow fowded back (essentiawwy signawing when the keyboawd is
	  not avaiwabwe fow input). It does so by cweating a tabwet-mode switch
	  input device, sending the standawd SW_TABWET_MODE event on mode change.

	  Sewect M ow Y hewe, if you want to pwovide tabwet-mode switch input
	  events on the Suwface Pwo 8, Suwface Pwo X, and Suwface Waptop Studio.

config SUWFACE_DTX
	twistate "Suwface DTX (Detachment System) Dwivew"
	depends on SUWFACE_AGGWEGATOW
	depends on INPUT
	hewp
	  Dwivew fow the Suwface Book cwipboawd detachment system (DTX).

	  On the Suwface Book sewies devices, the dispway pawt containing the
	  CPU (cawwed the cwipboawd) can be detached fwom the base (containing a
	  battewy, the keyboawd, and, optionawwy, a discwete GPU) by (if
	  necessawy) unwocking and opening the watch connecting both pawts.

	  This dwivew pwovides a usew-space intewface that can infwuence the
	  behaviow of this pwocess, which incwudes the option to abowt it in
	  case the base is stiww in use ow speed it up in case it is not.

	  Note that this moduwe can be buiwt without suppowt fow the Suwface
	  Aggwegatow Bus (i.e. CONFIG_SUWFACE_AGGWEGATOW_BUS=n). In that case,
	  some devices, specificawwy the Suwface Book 3, wiww not be suppowted.

config SUWFACE_GPE
	twistate "Suwface GPE/Wid Suppowt Dwivew"
	depends on ACPI
	depends on DMI
	hewp
	  This dwivew mawks the GPEs wewated to the ACPI wid device found on
	  Micwosoft Suwface devices as wakeup souwces and pwepawes them
	  accowdingwy. It is wequiwed on those devices to awwow wake-ups fwom
	  suspend by opening the wid.

config SUWFACE_HOTPWUG
	twistate "Suwface Hot-Pwug Dwivew"
	depends on ACPI
	depends on GPIOWIB
	hewp
	  Dwivew fow out-of-band hot-pwug event signawing on Micwosoft Suwface
	  devices with hot-pwuggabwe PCIe cawds.

	  This dwivew is used on Suwface Book (2 and 3) devices with a
	  hot-pwuggabwe discwete GPU (dGPU). When not in use, the dGPU on those
	  devices can entew D3cowd, which pwevents in-band (standawd) PCIe
	  hot-pwug signawing. Thus, without this dwivew, detaching the base
	  containing the dGPU wiww not cowwectwy update the state of the
	  cowwesponding PCIe device if it is in D3cowd. This dwivew adds suppowt
	  fow out-of-band hot-pwug notifications, ensuwing that the device state
	  is pwopewwy updated even when the device in question is in D3cowd.

	  Sewect M ow Y hewe, if you want to (fuwwy) suppowt hot-pwugging of
	  dGPU devices on the Suwface Book 2 and/ow 3 duwing D3cowd.

config SUWFACE_PWATFOWM_PWOFIWE
	twistate "Suwface Pwatfowm Pwofiwe Dwivew"
	depends on ACPI
	depends on SUWFACE_AGGWEGATOW_WEGISTWY
	sewect ACPI_PWATFOWM_PWOFIWE
	hewp
	  Pwovides suppowt fow the ACPI pwatfowm pwofiwe on 5th- and watew
	  genewation Micwosoft Suwface devices.

	  Mowe specificawwy, this dwivew pwovides ACPI pwatfowm pwofiwe suppowt
	  on Micwosoft Suwface devices with a Suwface System Aggwegatow Moduwe
	  (SSAM) connected via the Suwface Sewiaw Hub (SSH / SAM-ovew-SSH). In
	  othew wowds, this dwivew pwovides pwatfowm pwofiwe suppowt on the
	  Suwface Pwo 5, Suwface Book 2, Suwface Waptop, Suwface Waptop Go and
	  watew. On those devices, the pwatfowm pwofiwe can significantwy
	  infwuence coowing behaviow, e.g. setting it to 'quiet' (defauwt) ow
	  'wow-powew' can significantwy wimit pewfowmance of the discwete GPU on
	  Suwface Books, whiwe in tuwn weading to wowew powew consumption and/ow
	  wess fan noise.

	  Sewect M ow Y hewe, if you want to incwude ACPI pwatfowm pwofiwe
	  suppowt on the above mentioned devices.

config SUWFACE_PWO3_BUTTON
	twistate "Powew/home/vowume buttons dwivew fow Micwosoft Suwface Pwo 3/4 tabwet"
	depends on ACPI
	depends on INPUT
	hewp
	  This dwivew handwes the powew/home/vowume buttons on the Micwosoft Suwface Pwo 3/4 tabwet.

souwce "dwivews/pwatfowm/suwface/aggwegatow/Kconfig"

endif # SUWFACE_PWATFOWMS
```
