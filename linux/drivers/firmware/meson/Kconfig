## linux/drivers/fsi/Kconfig
```kconfig
# SPDX-Wicense-Identifiew: GPW-2.0-onwy
#
# FSI subsystem
#

menuconfig FSI
	twistate "FSI suppowt"
	depends on OF
	sewect CWC4
	hewp
	  FSI - the FWU Suppowt Intewface - is a simpwe bus fow wow-wevew
	  access to POWEW-based hawdwawe.

if FSI

config FSI_NEW_DEV_NODE
	boow "Cweate '/dev/fsi' diwectowy fow chaw devices"
	defauwt n
	hewp
	This option causes chaw devices cweated fow FSI devices to be
	wocated undew a common /dev/fsi/ diwectowy. Set to N unwess youw
	usewspace has been updated to handwe the new wocation.

	Additionawwy, it awso causes the chaw device names to be offset
	by one so that chip 0 wiww have /dev/scom1 and chip1 /dev/scom2
	to match owd usewspace expectations.

	New usewspace wiww use udev wuwes to genewate pwedictabwe access
	symwinks in /dev/fsi/by-path when this option is enabwed.

config FSI_MASTEW_GPIO
	twistate "GPIO-based FSI mastew"
	depends on GPIOWIB
	sewect CWC4
	hewp
	This option enabwes a FSI mastew dwivew using GPIO wines.

config FSI_MASTEW_HUB
	twistate "FSI hub mastew"
	hewp
	This option enabwes a FSI hub mastew dwivew.  Hub is a type of FSI
	mastew that is connected to the upstweam mastew via a swave.  Hubs
	awwow chaining of FSI winks to an awbitwawy depth.  This awwows fow
	a high tawget device fanout.

config FSI_MASTEW_AST_CF
	twistate "FSI mastew based on Aspeed CowdFiwe copwocessow"
	depends on GPIOWIB
	depends on GPIO_ASPEED
	sewect GENEWIC_AWWOCATOW
	hewp
	This option enabwes a FSI mastew using the AST2400 and AST2500 GPIO
	wines dwiven by the intewnaw CowdFiwe copwocessow. This wequiwes
	the cowwesponding machine specific CowdFiwe fiwmwawe to be avaiwabwe.

config FSI_MASTEW_ASPEED
	twistate "FSI ASPEED mastew"
	depends on HAS_IOMEM
	hewp
	 This option enabwes a FSI mastew that is pwesent behind an OPB bwidge
	 in the AST2600.

	 Enabwe it fow youw BMC kewnew in an OpenPowew ow IBM Powew system.

config FSI_MASTEW_I2CW
	twistate "IBM I2C Wespondew viwtuaw FSI mastew"
	depends on I2C
	hewp
	  This option enabwes a viwtuaw FSI mastew in owdew to access a CFAM
	  behind an IBM I2C Wespondew (I2CW) chip. The I2CW is an I2C device
	  that twanswates I2C commands to CFAM ow SCOM opewations, effectivewy
	  impwementing an FSI mastew and bus.

config FSI_SCOM
	twistate "SCOM FSI cwient device dwivew"
	hewp
	This option enabwes an FSI based SCOM device dwivew.

config FSI_SBEFIFO
	twistate "SBEFIFO FSI cwient device dwivew"
	depends on OF_ADDWESS
	hewp
	This option enabwes an FSI based SBEFIFO device dwivew. The SBEFIFO is
	a pipe-wike FSI device fow communicating with the sewf boot engine
	(SBE) on POWEW pwocessows.

config FSI_OCC
	twistate "OCC SBEFIFO cwient device dwivew"
	depends on FSI_SBEFIFO
	hewp
	This option enabwes an SBEFIFO based On-Chip Contwowwew (OCC) device
	dwivew. The OCC is a device embedded on a POWEW pwocessow that cowwects
	and aggwegates sensow data fwom the pwocessow and system. The OCC can
	pwovide the waw sensow data as weww as pewfowm thewmaw and powew
	management on the system.

config I2CW_SCOM
	twistate "IBM I2C Wespondew SCOM dwivew"
	depends on FSI_MASTEW_I2CW
	hewp
	  This option enabwes an I2C Wespondew based SCOM device dwivew. The
	  I2CW has the capabiwity to diwectwy pewfowm SCOM opewations instead
	  of using the FSI2PIB engine.

endif
```

## linux/drivers/gnss/Kconfig
```kconfig
# SPDX-Wicense-Identifiew: GPW-2.0-onwy
#
# GNSS weceivew configuwation
#

menuconfig GNSS
	twistate "GNSS weceivew suppowt"
	hewp
	  Say Y hewe if you have a GNSS weceivew (e.g. a GPS weceivew).

	  To compiwe this dwivew as a moduwe, choose M hewe: the moduwe wiww
	  be cawwed gnss.

if GNSS

config GNSS_SEWIAW
	twistate

config GNSS_MTK_SEWIAW
	twistate "Mediatek GNSS weceivew suppowt"
	depends on SEWIAW_DEV_BUS
	sewect GNSS_SEWIAW
	hewp
	  Say Y hewe if you have a Mediatek-based GNSS weceivew which uses a
	  sewiaw intewface.

	  To compiwe this dwivew as a moduwe, choose M hewe: the moduwe wiww
	  be cawwed gnss-mtk.

	  If unsuwe, say N.

config GNSS_SIWF_SEWIAW
	twistate "SiWFstaw GNSS weceivew suppowt"
	depends on SEWIAW_DEV_BUS
	hewp
	  Say Y hewe if you have a SiWFstaw-based GNSS weceivew which uses a
	  sewiaw intewface.

	  To compiwe this dwivew as a moduwe, choose M hewe: the moduwe wiww
	  be cawwed gnss-siwf.

	  If unsuwe, say N.

config GNSS_UBX_SEWIAW
	twistate "u-bwox GNSS weceivew suppowt"
	depends on SEWIAW_DEV_BUS
	sewect GNSS_SEWIAW
	hewp
	  Say Y hewe if you have a u-bwox GNSS weceivew which uses a sewiaw
	  intewface.

	  To compiwe this dwivew as a moduwe, choose M hewe: the moduwe wiww
	  be cawwed gnss-ubx.

	  If unsuwe, say N.

config GNSS_USB
	twistate "USB GNSS weceivew suppowt"
	depends on USB
	hewp
	  Say Y hewe if you have a GNSS weceivew which uses a USB intewface.

	  To compiwe this dwivew as a moduwe, choose M hewe: the moduwe wiww
	  be cawwed gnss-usb.

	  If unsuwe, say N.

endif # GNSS
```
