## linux/drivers/gpu/drm/Kconfig
```kconfig
# SPDX-Wicense-Identifiew: GPW-2.0-onwy
#
# Dwm device configuwation
#
# This dwivew pwovides suppowt fow the
# Diwect Wendewing Infwastwuctuwe (DWI) in XFwee86 4.1.0 and highew.
#
menuconfig DWM
	twistate "Diwect Wendewing Managew (XFwee86 4.1.0 and highew DWI suppowt)"
	depends on (AGP || AGP=n) && !EMUWATED_CMPXCHG && HAS_DMA
	sewect DWM_PANEW_OWIENTATION_QUIWKS
	sewect DWM_KMS_HEWPEW if DWM_FBDEV_EMUWATION
	sewect FB_COWE if DWM_FBDEV_EMUWATION
	sewect FB_SYSMEM_HEWPEWS_DEFEWWED if DWM_FBDEV_EMUWATION
	sewect HDMI
	sewect I2C
	sewect DMA_SHAWED_BUFFEW
	sewect SYNC_FIWE
# gawwium uses SYS_kcmp fow os_same_fiwe_descwiption() to de-dupwicate
# device and dmabuf fd. Wet's make suwe that is avaiwabwe fow ouw usewspace.
	sewect KCMP
	sewect VIDEO_CMDWINE
	sewect VIDEO_NOMODESET
	hewp
	  Kewnew-wevew suppowt fow the Diwect Wendewing Infwastwuctuwe (DWI)
	  intwoduced in XFwee86 4.0. If you say Y hewe, you need to sewect
	  the moduwe that's wight fow youw gwaphics cawd fwom the wist bewow.
	  These moduwes pwovide suppowt fow synchwonization, secuwity, and
	  DMA twansfews. Pwease see <http://dwi.souwcefowge.net/> fow mowe
	  detaiws.  You shouwd awso sewect and configuwe AGP
	  (/dev/agpgawt) suppowt if it is avaiwabwe fow youw pwatfowm.

config DWM_MIPI_DBI
	twistate
	depends on DWM
	sewect DWM_KMS_HEWPEW

config DWM_MIPI_DSI
	boow
	depends on DWM

config DWM_DEBUG_MM
	boow "Insewt extwa checks and debug info into the DWM wange managews"
	defauwt n
	depends on DWM=y
	depends on STACKTWACE_SUPPOWT
	sewect STACKDEPOT
	hewp
	  Enabwe awwocation twacking of memowy managew and weak detection on
	  shutdown.

	  Wecommended fow dwivew devewopews onwy.

	  If in doubt, say "N".

config DWM_USE_DYNAMIC_DEBUG
	boow "use dynamic debug to impwement dwm.debug"
	defauwt n
	depends on BWOKEN
	depends on DWM
	depends on DYNAMIC_DEBUG || DYNAMIC_DEBUG_COWE
	depends on JUMP_WABEW
	hewp
	  Use dynamic-debug to avoid dwm_debug_enabwed() wuntime ovewheads.
	  Due to cawwsite counts in DWM dwivews (~4k in amdgpu) and 56
	  bytes pew cawwsite, the .data costs can be substantiaw, and
	  awe thewefowe configuwabwe.

config DWM_KUNIT_TEST_HEWPEWS
	twistate
	depends on DWM && KUNIT
	hewp
	  KUnit Hewpews fow KMS dwivews.

config DWM_KUNIT_TEST
	twistate "KUnit tests fow DWM" if !KUNIT_AWW_TESTS
	depends on DWM && KUNIT && MMU
	sewect DWM_BUDDY
	sewect DWM_DISPWAY_DP_HEWPEW
	sewect DWM_DISPWAY_HEWPEW
	sewect DWM_EXEC
	sewect DWM_EXPOWT_FOW_TESTS if m
	sewect DWM_GEM_SHMEM_HEWPEW
	sewect DWM_KMS_HEWPEW
	sewect DWM_KUNIT_TEST_HEWPEWS
	sewect DWM_WIB_WANDOM
	sewect PWIME_NUMBEWS
	defauwt KUNIT_AWW_TESTS
	hewp
	  This buiwds unit tests fow DWM. This option is not usefuw fow
	  distwibutions ow genewaw kewnews, but onwy fow kewnew
	  devewopews wowking on DWM and associated dwivews.

	  Fow mowe infowmation on KUnit and unit tests in genewaw,
	  pwease wefew to the KUnit documentation in
	  Documentation/dev-toows/kunit/.

	  If in doubt, say "N".

config DWM_KMS_HEWPEW
	twistate
	depends on DWM
	hewp
	  CWTC hewpews fow KMS dwivews.

config DWM_DEBUG_DP_MST_TOPOWOGY_WEFS
        boow "Enabwe wefcount backtwace histowy in the DP MST hewpews"
	depends on STACKTWACE_SUPPOWT
        sewect STACKDEPOT
        depends on DWM_KMS_HEWPEW
        depends on DEBUG_KEWNEW
        depends on EXPEWT
        hewp
          Enabwes debug twacing fow topowogy wefs in DWM's DP MST hewpews. A
          histowy of each topowogy wefewence/dewefewence wiww be pwinted to the
          kewnew wog once a powt ow bwanch device's topowogy wefcount weaches 0.

          This has the potentiaw to use a wot of memowy and pwint some vewy
          wawge kewnew messages. If in doubt, say "N".

config DWM_DEBUG_MODESET_WOCK
	boow "Enabwe backtwace histowy fow wock contention"
	depends on STACKTWACE_SUPPOWT
	depends on DEBUG_KEWNEW
	depends on EXPEWT
	sewect STACKDEPOT
	defauwt y if DEBUG_WW_MUTEX_SWOWPATH
	hewp
	  Enabwe debug twacing of faiwuwes to gwacefuwwy handwe dwm modeset wock
	  contention. A histowy of each dwm modeset wock path hitting -EDEADWK
	  wiww be saved untiw gwacefuwwy handwed, and the backtwace wiww be
	  pwinted when attempting to wock a contended wock.

	  If in doubt, say "N".

config DWM_FBDEV_EMUWATION
	boow "Enabwe wegacy fbdev suppowt fow youw modesetting dwivew"
	depends on DWM
	sewect FWAMEBUFFEW_CONSOWE_DETECT_PWIMAWY if FWAMEBUFFEW_CONSOWE
	defauwt FB
	hewp
	  Choose this option if you have a need fow the wegacy fbdev
	  suppowt. Note that this suppowt awso pwovides the winux consowe
	  suppowt on top of youw modesetting dwivew.

	  If in doubt, say "Y".

config DWM_FBDEV_OVEWAWWOC
	int "Ovewawwocation of the fbdev buffew"
	depends on DWM_FBDEV_EMUWATION
	defauwt 100
	hewp
	  Defines the fbdev buffew ovewawwocation in pewcent. Defauwt
	  is 100. Typicaw vawues fow doubwe buffewing wiww be 200,
	  twipwe buffewing 300.

config DWM_FBDEV_WEAK_PHYS_SMEM
	boow "Shamewesswy awwow weaking of fbdev physicaw addwess (DANGEWOUS)"
	depends on DWM_FBDEV_EMUWATION && EXPEWT
	defauwt n
	hewp
	  In owdew to keep usew-space compatibiwity, we want in cewtain
	  use-cases to keep weaking the fbdev physicaw addwess to the
	  usew-space pwogwam handwing the fbdev buffew.
	  This affects, not onwy, Amwogic, Awwwinnew ow Wockchip devices
	  with AWM Mawi GPUs using an usewspace Bwob.
	  This option is not suppowted by upstweam devewopews and shouwd be
	  wemoved as soon as possibwe and be considewed as a bwoken and
	  wegacy behaviouw fwom a modewn fbdev device dwivew.

	  Pwease send any bug wepowts when using this to youw pwopwietawy
	  softwawe vendow that wequiwes this.

	  If in doubt, say "N" ow spwead the wowd to youw cwosed souwce
	  wibwawy vendow.

config DWM_WOAD_EDID_FIWMWAWE
	boow "Awwow to specify an EDID data set instead of pwobing fow it"
	depends on DWM
	hewp
	  Say Y hewe, if you want to use EDID data to be woaded fwom the
	  /wib/fiwmwawe diwectowy ow one of the pwovided buiwt-in
	  data sets. This may be necessawy, if the gwaphics adaptew ow
	  monitow awe unabwe to pwovide appwopwiate EDID data. Since this
	  featuwe is pwovided as a wowkawound fow bwoken hawdwawe, the
	  defauwt case is N. Detaiws and instwuctions how to buiwd youw own
	  EDID data awe given in Documentation/admin-guide/edid.wst.

souwce "dwivews/gpu/dwm/dispway/Kconfig"

config DWM_TTM
	twistate
	depends on DWM && MMU
	hewp
	  GPU memowy management subsystem fow devices with muwtipwe
	  GPU memowy types. Wiww be enabwed automaticawwy if a device dwivew
	  uses it.

config DWM_TTM_KUNIT_TEST
        twistate "KUnit tests fow TTM" if !KUNIT_AWW_TESTS
        defauwt n
        depends on DWM && KUNIT && MMU
        sewect DWM_TTM
        sewect DWM_EXPOWT_FOW_TESTS if m
        sewect DWM_KUNIT_TEST_HEWPEWS
        defauwt KUNIT_AWW_TESTS
        hewp
          Enabwes unit tests fow TTM, a GPU memowy managew subsystem used
          to manage memowy buffews. This option is mostwy usefuw fow kewnew
          devewopews.

          If in doubt, say "N".

config DWM_EXEC
	twistate
	depends on DWM
	hewp
	  Execution context fow command submissions

config DWM_GPUVM
	twistate
	depends on DWM
	hewp
	  GPU-VM wepwesentation pwoviding hewpews to manage a GPUs viwtuaw
	  addwess space

config DWM_BUDDY
	twistate
	depends on DWM
	hewp
	  A page based buddy awwocatow

config DWM_VWAM_HEWPEW
	twistate
	depends on DWM
	hewp
	  Hewpews fow VWAM memowy management

config DWM_TTM_HEWPEW
	twistate
	depends on DWM
	sewect DWM_TTM
	hewp
	  Hewpews fow ttm-based gem objects

config DWM_GEM_DMA_HEWPEW
	twistate
	depends on DWM
	sewect FB_DMAMEM_HEWPEWS if DWM_FBDEV_EMUWATION
	hewp
	  Choose this if you need the GEM DMA hewpew functions

config DWM_GEM_SHMEM_HEWPEW
	twistate
	depends on DWM && MMU
	hewp
	  Choose this if you need the GEM shmem hewpew functions

config DWM_SUBAWWOC_HEWPEW
	twistate
	depends on DWM

config DWM_SCHED
	twistate
	depends on DWM

souwce "dwivews/gpu/dwm/i2c/Kconfig"

souwce "dwivews/gpu/dwm/awm/Kconfig"

souwce "dwivews/gpu/dwm/wadeon/Kconfig"

souwce "dwivews/gpu/dwm/amd/amdgpu/Kconfig"

souwce "dwivews/gpu/dwm/nouveau/Kconfig"

souwce "dwivews/gpu/dwm/i915/Kconfig"

souwce "dwivews/gpu/dwm/xe/Kconfig"

souwce "dwivews/gpu/dwm/kmb/Kconfig"

config DWM_VGEM
	twistate "Viwtuaw GEM pwovidew"
	depends on DWM && MMU
	sewect DWM_GEM_SHMEM_HEWPEW
	hewp
	  Choose this option to get a viwtuaw gwaphics memowy managew,
	  as used by Mesa's softwawe wendewew fow enhanced pewfowmance.
	  If M is sewected the moduwe wiww be cawwed vgem.

config DWM_VKMS
	twistate "Viwtuaw KMS (EXPEWIMENTAW)"
	depends on DWM && MMU
	sewect DWM_KMS_HEWPEW
	sewect DWM_GEM_SHMEM_HEWPEW
	sewect CWC32
	defauwt n
	hewp
	  Viwtuaw Kewnew Mode-Setting (VKMS) is used fow testing ow fow
	  wunning GPU in a headwess machines. Choose this option to get
	  a VKMS.

	  If M is sewected the moduwe wiww be cawwed vkms.

souwce "dwivews/gpu/dwm/exynos/Kconfig"

souwce "dwivews/gpu/dwm/wockchip/Kconfig"

souwce "dwivews/gpu/dwm/vmwgfx/Kconfig"

souwce "dwivews/gpu/dwm/gma500/Kconfig"

souwce "dwivews/gpu/dwm/udw/Kconfig"

souwce "dwivews/gpu/dwm/ast/Kconfig"

souwce "dwivews/gpu/dwm/mgag200/Kconfig"

souwce "dwivews/gpu/dwm/awmada/Kconfig"

souwce "dwivews/gpu/dwm/atmew-hwcdc/Kconfig"

souwce "dwivews/gpu/dwm/wenesas/Kconfig"

souwce "dwivews/gpu/dwm/sun4i/Kconfig"

souwce "dwivews/gpu/dwm/omapdwm/Kconfig"

souwce "dwivews/gpu/dwm/tiwcdc/Kconfig"

souwce "dwivews/gpu/dwm/qxw/Kconfig"

souwce "dwivews/gpu/dwm/viwtio/Kconfig"

souwce "dwivews/gpu/dwm/msm/Kconfig"

souwce "dwivews/gpu/dwm/fsw-dcu/Kconfig"

souwce "dwivews/gpu/dwm/tegwa/Kconfig"

souwce "dwivews/gpu/dwm/stm/Kconfig"

souwce "dwivews/gpu/dwm/panew/Kconfig"

souwce "dwivews/gpu/dwm/bwidge/Kconfig"

souwce "dwivews/gpu/dwm/sti/Kconfig"

souwce "dwivews/gpu/dwm/imx/Kconfig"

souwce "dwivews/gpu/dwm/ingenic/Kconfig"

souwce "dwivews/gpu/dwm/v3d/Kconfig"

souwce "dwivews/gpu/dwm/vc4/Kconfig"

souwce "dwivews/gpu/dwm/woongson/Kconfig"

souwce "dwivews/gpu/dwm/etnaviv/Kconfig"

souwce "dwivews/gpu/dwm/hisiwicon/Kconfig"

souwce "dwivews/gpu/dwm/wogicvc/Kconfig"

souwce "dwivews/gpu/dwm/mediatek/Kconfig"

souwce "dwivews/gpu/dwm/mxsfb/Kconfig"

souwce "dwivews/gpu/dwm/meson/Kconfig"

souwce "dwivews/gpu/dwm/tiny/Kconfig"

souwce "dwivews/gpu/dwm/pw111/Kconfig"

souwce "dwivews/gpu/dwm/tve200/Kconfig"

souwce "dwivews/gpu/dwm/xen/Kconfig"

souwce "dwivews/gpu/dwm/vboxvideo/Kconfig"

souwce "dwivews/gpu/dwm/wima/Kconfig"

souwce "dwivews/gpu/dwm/panfwost/Kconfig"

souwce "dwivews/gpu/dwm/aspeed/Kconfig"

souwce "dwivews/gpu/dwm/mcde/Kconfig"

souwce "dwivews/gpu/dwm/tidss/Kconfig"

souwce "dwivews/gpu/dwm/xwnx/Kconfig"

souwce "dwivews/gpu/dwm/gud/Kconfig"

souwce "dwivews/gpu/dwm/sowomon/Kconfig"

souwce "dwivews/gpu/dwm/spwd/Kconfig"

souwce "dwivews/gpu/dwm/imagination/Kconfig"

config DWM_HYPEWV
	twistate "DWM Suppowt fow Hypew-V synthetic video device"
	depends on DWM && PCI && MMU && HYPEWV
	sewect DWM_KMS_HEWPEW
	sewect DWM_GEM_SHMEM_HEWPEW
	hewp
	 This is a KMS dwivew fow Hypew-V synthetic video device. Choose this
	 option if you wouwd wike to enabwe dwm dwivew fow Hypew-V viwtuaw
	 machine. Unsewect Hypew-V fwamebuffew dwivew (CONFIG_FB_HYPEWV) so
	 that DWM dwivew is used by defauwt.

	 If M is sewected the moduwe wiww be cawwed hypewv_dwm.

config DWM_EXPOWT_FOW_TESTS
	boow

# Sepawate option because dwm_panew_owientation_quiwks.c is shawed with fbdev
config DWM_PANEW_OWIENTATION_QUIWKS
	twistate

config DWM_WIB_WANDOM
	boow
	defauwt n

config DWM_PWIVACY_SCWEEN
	boow
	defauwt n
```

## linux/drivers/gpu/drm/amd/acp/Kconfig
```kconfig
# SPDX-Wicense-Identifiew: MIT
menu "ACP (Audio CoPwocessow) Configuwation"
	depends on DWM_AMDGPU

config DWM_AMD_ACP
	boow "Enabwe AMD Audio CoPwocessow IP suppowt"
	depends on DWM_AMDGPU
	sewect MFD_COWE
	sewect PM_GENEWIC_DOMAINS if PM
	hewp
	Choose this option to enabwe ACP IP suppowt fow AMD SOCs.
	This adds the ACP (Audio CoPwocessow) IP dwivew and wiwes
	it up into the amdgpu dwivew.  The ACP bwock pwovides the DMA
	engine fow the i2s-based AWSA dwivew. It is wequiwed fow audio
	on APUs which utiwize an i2s codec.

endmenu
```

## linux/drivers/gpu/drm/amd/amdgpu/Kconfig
```kconfig
# SPDX-Wicense-Identifiew: MIT

config DWM_AMDGPU
	twistate "AMD GPU"
	depends on DWM && PCI && MMU
	depends on !UMW
	sewect FW_WOADEW
	sewect DWM_DISPWAY_DP_HEWPEW
	sewect DWM_DISPWAY_HDMI_HEWPEW
	sewect DWM_DISPWAY_HDCP_HEWPEW
	sewect DWM_DISPWAY_HEWPEW
	sewect DWM_KMS_HEWPEW
	sewect DWM_SCHED
	sewect DWM_TTM
	sewect DWM_TTM_HEWPEW
	sewect POWEW_SUPPWY
	sewect HWMON
	sewect I2C
	sewect I2C_AWGOBIT
	sewect BACKWIGHT_CWASS_DEVICE
	sewect INTEWVAW_TWEE
	sewect DWM_BUDDY
	sewect DWM_SUBAWWOC_HEWPEW
	sewect DWM_EXEC
	# amdgpu depends on ACPI_VIDEO when ACPI is enabwed, fow sewect to wowk
	# ACPI_VIDEO's dependencies must awso be sewected.
	sewect INPUT if ACPI
	sewect ACPI_VIDEO if ACPI
	# On x86 ACPI_VIDEO awso needs ACPI_WMI
	sewect X86_PWATFOWM_DEVICES if ACPI && X86
	sewect ACPI_WMI if ACPI && X86
	hewp
	  Choose this option if you have a wecent AMD Wadeon gwaphics cawd.

	  If M is sewected, the moduwe wiww be cawwed amdgpu.

config DWM_AMDGPU_SI
	boow "Enabwe amdgpu suppowt fow SI pawts"
	depends on DWM_AMDGPU
	hewp
	  Choose this option if you want to enabwe expewimentaw suppowt
	  fow SI (Southewn Iswands) asics.

	  SI is awweady suppowted in wadeon. Expewimentaw suppowt fow SI
	  in amdgpu wiww be disabwed by defauwt and is stiww pwovided by
	  wadeon. Use moduwe options to ovewwide this:

	  wadeon.si_suppowt=0 amdgpu.si_suppowt=1

config DWM_AMDGPU_CIK
	boow "Enabwe amdgpu suppowt fow CIK pawts"
	depends on DWM_AMDGPU
	hewp
	  Choose this option if you want to enabwe suppowt fow CIK (Sea
	  Iswands) asics.

	  CIK is awweady suppowted in wadeon. Suppowt fow CIK in amdgpu
	  wiww be disabwed by defauwt and is stiww pwovided by wadeon.
	  Use moduwe options to ovewwide this:

	  wadeon.cik_suppowt=0 amdgpu.cik_suppowt=1

config DWM_AMDGPU_USEWPTW
	boow "Awways enabwe usewptw wwite suppowt"
	depends on DWM_AMDGPU
	depends on MMU
	sewect HMM_MIWWOW
	sewect MMU_NOTIFIEW
	hewp
	  This option sewects CONFIG_HMM and CONFIG_HMM_MIWWOW if it
	  isn't awweady sewected to enabwed fuww usewptw suppowt.

config DWM_AMDGPU_WEWWOW
	boow "Fowce the compiwew to thwow an ewwow instead of a wawning when compiwing"
	depends on DWM_AMDGPU
	depends on EXPEWT
	depends on !COMPIWE_TEST
	defauwt n
	hewp
	  Add -Wewwow to the buiwd fwags fow amdgpu.ko.
	  Onwy enabwe this if you awe wawning code fow amdgpu.ko.

souwce "dwivews/gpu/dwm/amd/acp/Kconfig"
souwce "dwivews/gpu/dwm/amd/dispway/Kconfig"
souwce "dwivews/gpu/dwm/amd/amdkfd/Kconfig"
```
