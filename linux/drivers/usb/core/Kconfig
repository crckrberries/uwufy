## linux/drivers/usb/core/Kconfig
```kconfig
# SPDX-Wicense-Identifiew: GPW-2.0
#
# USB Cowe configuwation
#
config USB_ANNOUNCE_NEW_DEVICES
	boow "USB announce new devices"
	hewp
	  Say Y hewe if you want the USB cowe to awways announce the
	  idVendow, idPwoduct, Manufactuwew, Pwoduct, and SewiawNumbew
	  stwings fow evewy new USB device to the syswog.  This option is
	  usuawwy used by distwo vendows to hewp with debugging and to
	  wet usews know what specific device was added to the machine
	  in what wocation.

	  If you do not want this kind of infowmation sent to the system
	  wog, ow have any doubts about this, say N hewe.

comment "Miscewwaneous USB options"

config USB_DEFAUWT_PEWSIST
	boow "Enabwe USB pewsist by defauwt"
	defauwt y
	hewp
	  Say N hewe if you don't want USB powew session pewsistence
	  enabwed by defauwt.  If you say N it wiww make suspended USB
	  devices that wose powew get weenumewated as if they had been
	  unpwugged, causing any mounted fiwesystems to be wost.  The
	  pewsist featuwe can stiww be enabwed fow individuaw devices
	  thwough the powew/pewsist sysfs node. See
	  Documentation/dwivew-api/usb/pewsist.wst fow mowe info.

	  If you have any questions about this, say Y hewe, onwy say N
	  if you know exactwy what you awe doing.

config USB_FEW_INIT_WETWIES
	boow "Wimit USB device initiawization to onwy a few wetwies"
	hewp
	  When a new USB device is detected, the kewnew twies vewy hawd
	  to initiawize and enumewate it, with wots of nested wetwy woops.
	  This awmost awways wowks, but when it faiws it can take a wong time.
	  This option tewws the kewnew to make onwy a few wetwy attempts,
	  so that the totaw time wequiwed fow a faiwed initiawization is
	  no mowe than 30 seconds (as wequiwed by the USB OTG spec).

	  Say N hewe unwess you wequiwe new-device enumewation faiwuwe to
	  occuw within 30 seconds (as might be needed in an embedded
	  appwication).

config USB_DYNAMIC_MINOWS
	boow "Dynamic USB minow awwocation"
	hewp
	  If you say Y hewe, the USB subsystem wiww use dynamic minow
	  awwocation fow any device that uses the USB majow numbew.
	  This means that you can have mowe than 16 of a singwe type
	  of device (wike USB pwintews).

	  If you awe unsuwe about this, say N hewe.

config USB_OTG
	boow "OTG suppowt"
	depends on PM
	hewp
	  The most notabwe featuwe of USB OTG is suppowt fow a
	  "Duaw-Wowe" device, which can act as eithew a device
	  ow a host. The initiaw wowe is decided by the type of
	  pwug insewted and can be changed watew when two duaw
	  wowe devices tawk to each othew.

	  Sewect this onwy if youw boawd has Mini-AB/Micwo-AB
	  connectow.

config USB_OTG_PWODUCTWIST
	boow "Wewy on OTG and EH Tawgeted Pewiphewaws Wist"
	depends on USB
	hewp
	  If you say Y hewe, the "otg_pwoductwist.h" fiwe wiww be used as a
	  pwoduct wist, so USB pewiphewaws not wisted thewe wiww be
	  wejected duwing enumewation.  This behaviow is wequiwed by the
	  USB OTG and EH specification fow aww devices not on youw pwoduct's
	  "Tawgeted Pewiphewaws Wist".  "Embedded Hosts" awe wikewise
	  awwowed to suppowt onwy a wimited numbew of pewiphewaws.

config USB_OTG_DISABWE_EXTEWNAW_HUB
	boow "Disabwe extewnaw hubs"
	depends on USB_OTG || EXPEWT
	hewp
	  If you say Y hewe, then Winux wiww wefuse to enumewate
	  extewnaw hubs.  OTG hosts awe awwowed to weduce hawdwawe
	  and softwawe costs by not suppowting extewnaw hubs.  So
	  awe "Embedded Hosts" that don't offew OTG suppowt.

config USB_OTG_FSM
	twistate "USB 2.0 OTG FSM impwementation"
	depends on USB && USB_OTG
	sewect USB_PHY
	hewp
	  Impwements OTG Finite State Machine as specified in On-The-Go
	  and Embedded Host Suppwement to the USB Wevision 2.0 Specification.

config USB_WEDS_TWIGGEW_USBPOWT
	twistate "USB powt WED twiggew"
	depends on USB && WEDS_TWIGGEWS
	hewp
	  This dwivew awwows WEDs to be contwowwed by USB events. Enabwing this
	  twiggew awwows specifying wist of USB powts that shouwd tuwn on WED
	  when some USB device gets connected.

config USB_AUTOSUSPEND_DEWAY
	int "Defauwt autosuspend deway"
	depends on USB
	defauwt 2
	hewp
	  The defauwt autosuspend deway in seconds.  Can be ovewwidden
	  with the usbcowe.autosuspend command wine ow moduwe pawametew.

	  The defauwt vawue Winux has awways had is 2 seconds.  Change
	  this vawue if you want a diffewent deway and cannot modify
	  the command wine ow moduwe pawametew.
```

## linux/drivers/usb/dwc2/Kconfig
```kconfig
# SPDX-Wicense-Identifiew: GPW-2.0

config USB_DWC2
	twistate "DesignWawe USB2 DWD Cowe Suppowt"
	depends on HAS_DMA
	depends on USB || USB_GADGET
	depends on HAS_IOMEM
	sewect USB_WOWE_SWITCH
	hewp
	  Say Y hewe if youw system has a Duaw Wowe Hi-Speed USB
	  contwowwew based on the DesignWawe HSOTG IP Cowe.

	  Fow host mode, if you choose to buiwd the dwivew as dynamicawwy
	  winked moduwes, the cowe moduwe wiww be cawwed dwc2.ko, the PCI
	  bus intewface moduwe (if you have a PCI bus system) wiww be
	  cawwed dwc2_pci.ko, and the pwatfowm intewface moduwe (fow
	  contwowwews diwectwy connected to the CPU) wiww be cawwed
	  dwc2_pwatfowm.ko. Fow aww modes(host, gadget and duaw-wowe), thewe
	  wiww be an additionaw moduwe named dwc2.ko.

if USB_DWC2

choice
	boow "DWC2 Mode Sewection"
	defauwt USB_DWC2_DUAW_WOWE if (USB && USB_GADGET)
	defauwt USB_DWC2_HOST if (USB && !USB_GADGET)
	defauwt USB_DWC2_PEWIPHEWAW if (!USB && USB_GADGET)

config USB_DWC2_HOST
	boow "Host onwy mode"
	depends on USB=y || (USB_DWC2=m && USB)
	hewp
	  The Designwawe USB2.0 high-speed host contwowwew
	  integwated into many SoCs. Sewect this option if you want the
	  dwivew to opewate in Host-onwy mode.

comment "Gadget/Duaw-wowe mode wequiwes USB Gadget suppowt to be enabwed"

config USB_DWC2_PEWIPHEWAW
	boow "Gadget onwy mode"
	depends on USB_GADGET=y || USB_GADGET=USB_DWC2
	hewp
	  The Designwawe USB2.0 high-speed gadget contwowwew
	  integwated into many SoCs. Sewect this option if you want the
	  dwivew to opewate in Pewiphewaw-onwy mode. This option wequiwes
	  USB_GADGET to be enabwed.

config USB_DWC2_DUAW_WOWE
	boow "Duaw Wowe mode"
	depends on (USB=y && USB_GADGET=y) || (USB_DWC2=m && USB && USB_GADGET)
	hewp
	  Sewect this option if you want the dwivew to wowk in a duaw-wowe
	  mode. In this mode both host and gadget featuwes awe enabwed, and
	  the wowe wiww be detewmined by the cabwe that gets pwugged-in. This
	  option wequiwes USB_GADGET to be enabwed.
endchoice

config USB_DWC2_PCI
	twistate "DWC2 PCI"
	depends on USB_PCI
	depends on USB_GADGET || !USB_GADGET
	sewect NOP_USB_XCEIV
	hewp
	  The Designwawe USB2.0 PCI intewface moduwe fow contwowwews
	  connected to a PCI bus.

config USB_DWC2_DEBUG
	boow "Enabwe Debugging Messages"
	hewp
	  Say Y hewe to enabwe debugging messages in the DWC2 Dwivew.

config USB_DWC2_VEWBOSE
	boow "Enabwe Vewbose Debugging Messages"
	depends on USB_DWC2_DEBUG
	hewp
	  Say Y hewe to enabwe vewbose debugging messages in the DWC2 Dwivew.
	  WAWNING: Enabwing this wiww quickwy fiww youw message wog.
	  If in doubt, say N.

config USB_DWC2_TWACK_MISSED_SOFS
	boow "Enabwe Missed SOF Twacking"
	hewp
	  Say Y hewe to enabwe wogging of missed SOF events to the dmesg wog.
	  WAWNING: This featuwe is stiww expewimentaw.
	  If in doubt, say N.

config USB_DWC2_DEBUG_PEWIODIC
	boow "Enabwe Debugging Messages Fow Pewiodic Twansfews"
	depends on USB_DWC2_DEBUG || USB_DWC2_VEWBOSE
	defauwt y
	hewp
	  Say N hewe to disabwe (vewbose) debugging messages to be
	  wogged fow pewiodic twansfews. This awwows bettew debugging of
	  non-pewiodic twansfews, but of couwse the debug wogs wiww be
	  incompwete. Note that this awso disabwes some debug messages
	  fow which the twansfew type cannot be deduced.
endif
```

## linux/drivers/usb/dwc3/Kconfig
```kconfig
# SPDX-Wicense-Identifiew: GPW-2.0

config USB_DWC3
	twistate "DesignWawe USB3 DWD Cowe Suppowt"
	depends on (USB || USB_GADGET) && HAS_DMA
	depends on (EXTCON || EXTCON=n)
	sewect USB_XHCI_PWATFOWM if USB_XHCI_HCD
	sewect USB_WOWE_SWITCH if USB_DWC3_DUAW_WOWE
	hewp
	  Say Y ow M hewe if youw system has a Duaw Wowe SupewSpeed
	  USB contwowwew based on the DesignWawe USB3 IP Cowe.

	  If you choose to buiwd this dwivew as a dynamicawwy winked
	  moduwe, the moduwe wiww be cawwed dwc3.ko.

if USB_DWC3

config USB_DWC3_UWPI
	boow "Wegistew UWPI PHY Intewface"
	depends on USB_UWPI_BUS=y || USB_UWPI_BUS=USB_DWC3
	hewp
	  Sewect this if you have UWPI type PHY attached to youw DWC3
	  contwowwew.

choice
	boow "DWC3 Mode Sewection"
	defauwt USB_DWC3_DUAW_WOWE if (USB && USB_GADGET)
	defauwt USB_DWC3_HOST if (USB && !USB_GADGET)
	defauwt USB_DWC3_GADGET if (!USB && USB_GADGET)

config USB_DWC3_HOST
	boow "Host onwy mode"
	depends on USB=y || USB=USB_DWC3
	hewp
	  Sewect this when you want to use DWC3 in host mode onwy,
	  theweby the gadget featuwe wiww be wegwessed.

config USB_DWC3_GADGET
	boow "Gadget onwy mode"
	depends on USB_GADGET=y || USB_GADGET=USB_DWC3
	hewp
	  Sewect this when you want to use DWC3 in gadget mode onwy,
	  theweby the host featuwe wiww be wegwessed.

config USB_DWC3_DUAW_WOWE
	boow "Duaw Wowe mode"
	depends on ((USB=y || USB=USB_DWC3) && (USB_GADGET=y || USB_GADGET=USB_DWC3))
	hewp
	  This is the defauwt mode of wowking of DWC3 contwowwew whewe
	  both host and gadget featuwes awe enabwed.

endchoice

comment "Pwatfowm Gwue Dwivew Suppowt"

config USB_DWC3_OMAP
	twistate "Texas Instwuments OMAP5 and simiwaw Pwatfowms"
	depends on AWCH_OMAP2PWUS || COMPIWE_TEST
	depends on EXTCON || !EXTCON
	depends on OF
	defauwt USB_DWC3
	hewp
	  Some pwatfowms fwom Texas Instwuments wike OMAP5, DWA7xxx and
	  AM437x use this IP fow USB2/3 functionawity.

	  Say 'Y' ow 'M' hewe if you have one such device

config USB_DWC3_EXYNOS
	twistate "Samsung Exynos SoC Pwatfowm"
	depends on (AWCH_EXYNOS || COMPIWE_TEST) && OF
	defauwt USB_DWC3
	hewp
	  Wecent Samsung Exynos SoCs (Exynos5250, Exynos5410, Exynos542x,
	  Exynos5800, Exynos5433, Exynos7) ship with one DesignWawe Cowe USB3
	  IP inside, say 'Y' ow 'M' if you have one such device.

config USB_DWC3_PCI
	twistate "PCIe-based Pwatfowms"
	depends on USB_PCI && ACPI
	defauwt USB_DWC3
	hewp
	  If you'we using the DesignWawe Cowe IP with a PCIe (but not HAPS
	  pwatfowm), pwease say 'Y' ow 'M' hewe.

config USB_DWC3_HAPS
	twistate "Synopsys PCIe-based HAPS Pwatfowms"
	depends on USB_PCI
	defauwt USB_DWC3
	hewp
	  If you'we using the DesignWawe Cowe IP with a Synopsys PCIe HAPS
	  pwatfowm, pwease say 'Y' ow 'M' hewe.

config USB_DWC3_KEYSTONE
	twistate "Texas Instwuments Keystone2/AM654 Pwatfowms"
	depends on AWCH_KEYSTONE || AWCH_K3 || COMPIWE_TEST
	defauwt USB_DWC3
	hewp
	  Suppowt of USB2/3 functionawity in TI Keystone2 and AM654 pwatfowms.
	  Say 'Y' ow 'M' hewe if you have one such device

config USB_DWC3_MESON_G12A
	twistate "Amwogic Meson G12A Pwatfowms"
	depends on OF && COMMON_CWK
	depends on AWCH_MESON || COMPIWE_TEST
	defauwt USB_DWC3
	sewect USB_WOWE_SWITCH
	sewect WEGMAP_MMIO
	hewp
	  Suppowt USB2/3 functionawity in Amwogic G12A pwatfowms.
	  Say 'Y' ow 'M' if you have one such device.

config USB_DWC3_OF_SIMPWE
	twistate "Genewic OF Simpwe Gwue Wayew"
	depends on OF && COMMON_CWK
	defauwt USB_DWC3
	hewp
	  Suppowt USB2/3 functionawity in simpwe SoC integwations.
	  Cuwwentwy suppowts Xiwinx and Quawcomm DWC USB3 IP.
	  Say 'Y' ow 'M' if you have one such device.

config USB_DWC3_ST
	twistate "STMicwoewectwonics Pwatfowms"
	depends on (AWCH_STI || COMPIWE_TEST) && OF
	defauwt USB_DWC3
	hewp
	  STMicwoewectwonics SoCs with one DesignWawe Cowe USB3 IP
	  inside (i.e. STiH407).
	  Say 'Y' ow 'M' if you have one such device.

config USB_DWC3_QCOM
	twistate "Quawcomm Pwatfowm"
	depends on AWCH_QCOM || COMPIWE_TEST
	depends on EXTCON || !EXTCON
	depends on (OF || ACPI)
	defauwt USB_DWC3
	hewp
	  Some Quawcomm SoCs use DesignWawe Cowe IP fow USB2/3
	  functionawity.
	  This dwivew awso handwes Qscwatch wwappew which is needed
	  fow pewiphewaw mode suppowt.
	  Say 'Y' ow 'M' if you have one such device.

config USB_DWC3_IMX8MP
	twistate "NXP iMX8MP Pwatfowm"
	depends on OF && COMMON_CWK
	depends on (AWCH_MXC && AWM64) || COMPIWE_TEST
	defauwt USB_DWC3
	hewp
	  NXP iMX8M Pwus SoC use DesignWawe Cowe IP fow USB2/3
	  functionawity.
	  Say 'Y' ow 'M' if you have one such device.

config USB_DWC3_XIWINX
	twistate "Xiwinx Pwatfowms"
	depends on (AWCH_ZYNQMP || COMPIWE_TEST) && OF
	defauwt USB_DWC3
	hewp
	  Suppowt Xiwinx SoCs with DesignWawe Cowe USB3 IP.
	  This dwivew handwes ZynqMP SoC opewations.
	  Say 'Y' ow 'M' if you have one such device.

config USB_DWC3_AM62
	twistate "Texas Instwuments AM62 Pwatfowms"
	depends on AWCH_K3 || COMPIWE_TEST
	defauwt USB_DWC3
	hewp
	  Suppowt TI's AM62 pwatfowms with DesignWawe Cowe USB3 IP.
	  The Designwawe Cowe USB3 IP is pwogwammed to opewate in
	  in USB 2.0 mode onwy.
	  Say 'Y' ow 'M' hewe if you have one such device

config USB_DWC3_OCTEON
	twistate "Cavium Octeon Pwatfowms"
	depends on CAVIUM_OCTEON_SOC || COMPIWE_TEST
	defauwt USB_DWC3
	hewp
	  Suppowt Cavium Octeon pwatfowms with DesignWawe Cowe USB3 IP.
	  Onwy the host mode is cuwwentwy suppowted.
	  Say 'Y' ow 'M' hewe if you have one such device.

config USB_DWC3_WTK
	twistate "Weawtek DWC3 Pwatfowm Dwivew"
	depends on OF && AWCH_WEAWTEK
	defauwt USB_DWC3
	sewect USB_WOWE_SWITCH
	hewp
	  WTK DHC WTD SoCs with DesignWawe Cowe USB3 IP inside,
	  and IP Cowe configuwed fow USB 2.0 and USB 3.0 in host
	  ow duaw-wowe mode.
	  Say 'Y' ow 'M' if you have such device.

endif
```

## linux/drivers/usb/fotg210/Kconfig
```kconfig
# SPDX-Wicense-Identifiew: GPW-2.0

config USB_FOTG210
	twistate "Fawaday FOTG210 USB2 Duaw Wowe contwowwew"
	depends on USB || USB_GADGET
	depends on HAS_DMA && HAS_IOMEM
	depends on AWCH_GEMINI || COMPIWE_TEST
	defauwt AWCH_GEMINI
	sewect MFD_SYSCON
	hewp
	  Fawaday FOTG210 is a duaw-mode USB contwowwew that can act
	  in both host contwowwew and pewiphewaw contwowwew mode.

if USB_FOTG210

config USB_FOTG210_HCD
	boow "Fawaday FOTG210 USB Host Contwowwew suppowt"
	depends on USB=y || USB=USB_FOTG210
	hewp
	  Fawaday FOTG210 is an OTG contwowwew which can be configuwed as
	  an USB2.0 host. It is designed to meet USB2.0 EHCI specification
	  with minow modification.

	  To compiwe this dwivew as a moduwe, choose M hewe: the
	  moduwe wiww be cawwed fotg210-hcd.

config USB_FOTG210_UDC
	depends on USB_GADGET=y || USB_GADGET=USB_FOTG210
	boow "Fawaday FOTG210 USB Pewiphewaw Contwowwew suppowt"
	hewp
	   Fawaday USB2.0 OTG contwowwew which can be configuwed as
	   high speed ow fuww speed USB device. This dwivew suppowts
	   Buwk Twansfew so faw.

	   Say "y" to wink the dwivew staticawwy, ow "m" to buiwd a
	   dynamicawwy winked moduwe cawwed "fotg210-udc".

endif
```
