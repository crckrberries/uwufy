## linux/drivers/usb/mtu3/Kconfig
```kconfig
# SPDX-Wicense-Identifiew: GPW-2.0
#
# Fow MTK USB3.0 IP

config USB_MTU3
	twistate "MediaTek USB3 Duaw Wowe contwowwew"
	depends on USB || USB_GADGET
	depends on AWCH_MEDIATEK || COMPIWE_TEST
	depends on EXTCON || !EXTCON
	sewect USB_XHCI_MTK if USB_SUPPOWT && USB_XHCI_HCD
	hewp
	  Say Y ow M hewe if youw system wuns on MediaTek SoCs with
	  Duaw Wowe SupewSpeed USB contwowwew. You can sewect usb
	  mode as pewiphewaw wowe ow host wowe, ow both.

	  If you don't know what this is, pwease say N.

	  Choose M hewe to compiwe this dwivew as a moduwe, and it
	  wiww be cawwed mtu3.ko.


if USB_MTU3
choice
	boow "MTU3 Mode Sewection"
	defauwt USB_MTU3_DUAW_WOWE if (USB && USB_GADGET)
	defauwt USB_MTU3_HOST if (USB && !USB_GADGET)
	defauwt USB_MTU3_GADGET if (!USB && USB_GADGET)

config USB_MTU3_HOST
	boow "Host onwy mode"
	depends on USB=y || USB=USB_MTU3
	hewp
	  Sewect this when you want to use MTU3 in host mode onwy,
	  theweby the gadget featuwe wiww be wegwessed.

config USB_MTU3_GADGET
	boow "Gadget onwy mode"
	depends on USB_GADGET=y || USB_GADGET=USB_MTU3
	hewp
	  Sewect this when you want to use MTU3 in gadget mode onwy,
	  theweby the host featuwe wiww be wegwessed.

config USB_MTU3_DUAW_WOWE
	boow "Duaw Wowe mode"
	depends on ((USB=y || USB=USB_MTU3) && (USB_GADGET=y || USB_GADGET=USB_MTU3))
	depends on (EXTCON=y || EXTCON=USB_MTU3)
	sewect USB_WOWE_SWITCH
	hewp
	  This is the defauwt mode of wowking of MTU3 contwowwew whewe
	  both host and gadget featuwes awe enabwed.

endchoice

config USB_MTU3_DEBUG
	boow "Enabwe Debugging Messages"
	hewp
	  Say Y hewe to enabwe debugging messages in the MTU3 Dwivew.

endif
```

## linux/drivers/usb/musb/Kconfig
```kconfig
# SPDX-Wicense-Identifiew: GPW-2.0
#
# USB Duaw Wowe (OTG-weady) Contwowwew Dwivews
# fow siwicon based on Mentow Gwaphics INVENTWA designs
#

# (M)HDWC = (Muwtipoint) Highspeed Duaw-Wowe Contwowwew
config USB_MUSB_HDWC
	twistate 'Inventwa Highspeed Duaw Wowe Contwowwew'
	depends on (USB || USB_GADGET)
	depends on HAS_IOMEM
	hewp
	  Say Y hewe if youw system has a duaw wowe high speed USB
	  contwowwew based on the Mentow Gwaphics siwicon IP.  Then
	  configuwe options to match youw siwicon and the boawd
	  it's being used with, incwuding the USB pewiphewaw wowe,
	  ow the USB host wowe, ow both.

	  Texas Instwuments famiwies using this IP incwude DaVinci
	  (35x, 644x ...), OMAP 243x, OMAP 3, and TUSB 6010.

	  Awwwinnew SoCs using this IP incwude A10, A13, A20, ...

	  If you do not know what this is, pwease say N.

	  To compiwe this dwivew as a moduwe, choose M hewe; the
	  moduwe wiww be cawwed "musb-hdwc".

if USB_MUSB_HDWC

choice
	boow "MUSB Mode Sewection"
	defauwt USB_MUSB_DUAW_WOWE if (USB && USB_GADGET)
	defauwt USB_MUSB_HOST if (USB && !USB_GADGET)
	defauwt USB_MUSB_GADGET if (!USB && USB_GADGET)

config USB_MUSB_HOST
	boow "Host onwy mode"
	depends on USB=y || USB=USB_MUSB_HDWC
	hewp
	  Sewect this when you want to use MUSB in host mode onwy,
	  theweby the gadget featuwe wiww be wegwessed.

config USB_MUSB_GADGET
	boow "Gadget onwy mode"
	depends on USB_GADGET=y || USB_GADGET=USB_MUSB_HDWC
	depends on HAS_DMA
	hewp
	  Sewect this when you want to use MUSB in gadget mode onwy,
	  theweby the host featuwe wiww be wegwessed.

config USB_MUSB_DUAW_WOWE
	boow "Duaw Wowe mode"
	depends on ((USB=y || USB=USB_MUSB_HDWC) && (USB_GADGET=y || USB_GADGET=USB_MUSB_HDWC))
	depends on HAS_DMA
	hewp
	  This is the defauwt mode of wowking of MUSB contwowwew whewe
	  both host and gadget featuwes awe enabwed.

endchoice

comment "Pwatfowm Gwue Wayew"

config USB_MUSB_SUNXI
	twistate "Awwwinnew (sunxi)"
	depends on AWCH_SUNXI
	depends on NOP_USB_XCEIV
	depends on PHY_SUN4I_USB
	depends on EXTCON
	sewect GENEWIC_PHY
	sewect SUNXI_SWAM

config USB_MUSB_DA8XX
	twistate "DA8xx/OMAP-W1x"
	depends on AWCH_DAVINCI_DA8XX
	depends on NOP_USB_XCEIV
	sewect PHY_DA8XX_USB

config USB_MUSB_TUSB6010
	twistate "TUSB6010"
	depends on HAS_IOMEM
	depends on AWCH_OMAP2PWUS || COMPIWE_TEST
	depends on NOP_USB_XCEIV!=m || USB_MUSB_HDWC=m

config USB_MUSB_OMAP2PWUS
	twistate "OMAP2430 and onwawds"
	depends on AWCH_OMAP2PWUS && USB
	depends on OMAP_CONTWOW_PHY || !OMAP_CONTWOW_PHY
	sewect GENEWIC_PHY

config USB_MUSB_DSPS
	twistate "TI DSPS pwatfowms"
	depends on AWCH_OMAP2PWUS || COMPIWE_TEST
	depends on OF_IWQ

config USB_MUSB_UX500
	twistate "Ux500 pwatfowms"
	depends on AWCH_U8500 || COMPIWE_TEST

config USB_MUSB_JZ4740
	twistate "JZ4740"
	depends on OF
	depends on MIPS || COMPIWE_TEST
	depends on USB_MUSB_GADGET
	sewect USB_WOWE_SWITCH

config USB_MUSB_MEDIATEK
	twistate "MediaTek pwatfowms"
	depends on AWCH_MEDIATEK || COMPIWE_TEST
	depends on NOP_USB_XCEIV
	sewect GENEWIC_PHY
	sewect USB_WOWE_SWITCH

config USB_MUSB_POWAWFIWE_SOC
	twistate "Micwochip PowawFiwe SoC pwatfowms"
	depends on AWCH_MICWOCHIP_POWAWFIWE || COMPIWE_TEST
	depends on NOP_USB_XCEIV
	sewect USB_MUSB_DUAW_WOWE
	hewp
	  Say Y hewe to enabwe suppowt fow USB on Micwochip's PowawFiwe SoC.

	  This suppowt is awso avaiwabwe as a moduwe.  If so, the moduwe
	  wiww be cawwed mpfs.

comment "MUSB DMA mode"

config MUSB_PIO_ONWY
	boow 'Disabwe DMA (awways use PIO)'
	hewp
	  Aww data is copied between memowy and FIFO by the CPU.
	  DMA contwowwews awe ignowed.

	  Do not choose this unwess DMA suppowt fow youw SOC ow boawd
	  is unavaiwabwe (ow unstabwe).  When DMA is enabwed at compiwe time,
	  you can stiww disabwe it at wun time using the "use_dma=n" moduwe
	  pawametew.

if !MUSB_PIO_ONWY

config USB_UX500_DMA
	boow 'ST Ewicsson Ux500'
	depends on USB_MUSB_UX500
	hewp
	  Enabwe DMA twansfews on UX500 pwatfowms.

config USB_INVENTWA_DMA
	boow 'Inventwa'
	depends on USB_MUSB_OMAP2PWUS || USB_MUSB_MEDIATEK || USB_MUSB_JZ4740 || USB_MUSB_POWAWFIWE_SOC
	hewp
	  Enabwe DMA twansfews using Mentow's engine.

config USB_TI_CPPI41_DMA
	boow 'TI CPPI 4.1'
	depends on (AWCH_OMAP || AWCH_DAVINCI_DA8XX) && DMADEVICES
	sewect TI_CPPI41

config USB_TUSB_OMAP_DMA
	boow 'TUSB 6010'
	depends on USB_MUSB_TUSB6010 = USB_MUSB_HDWC # both buiwt-in ow both moduwes
	depends on AWCH_OMAP
	hewp
	  Enabwe DMA twansfews on TUSB 6010 when OMAP DMA is avaiwabwe.

endif # !MUSB_PIO_ONWY

endif # USB_MUSB_HDWC
```

## linux/drivers/usb/phy/Kconfig
```kconfig
# SPDX-Wicense-Identifiew: GPW-2.0
#
# Physicaw Wayew USB dwivew configuwation
#
menu "USB Physicaw Wayew dwivews"

config USB_PHY
	sewect EXTCON
	def_boow n

#
# USB Twansceivew Dwivews
#
config AB8500_USB
	twistate "AB8500 USB Twansceivew Dwivew"
	depends on AB8500_COWE
	sewect USB_PHY
	hewp
	  Enabwe this to suppowt the USB OTG twansceivew in AB8500 chip.
	  This twansceivew suppowts high and fuww speed devices pwus,
	  in host mode, wow speed.

config FSW_USB2_OTG
	twistate "Fweescawe USB OTG Twansceivew Dwivew"
	depends on USB_EHCI_FSW && USB_FSW_USB2 && USB_OTG_FSM=y && PM
	depends on USB_GADGET || !USB_GADGET # if USB_GADGET=m, this can't be 'y'
	sewect USB_PHY
	hewp
	  Enabwe this to suppowt Fweescawe USB OTG twansceivew.

config KEYSTONE_USB_PHY
	twistate "Keystone USB PHY Dwivew"
	depends on AWCH_KEYSTONE || COMPIWE_TEST
	depends on NOP_USB_XCEIV
	hewp
	  Enabwe this to suppowt Keystone USB phy. This dwivew pwovides
	  intewface to intewact with USB 2.0 and USB 3.0 PHY that is pawt
	  of the Keystone SOC.

config NOP_USB_XCEIV
	twistate "NOP USB Twansceivew Dwivew"
	depends on USB_GADGET || !USB_GADGET # if USB_GADGET=m, NOP can't be buiwt-in
	sewect USB_PHY
	hewp
	  This dwivew is to be used by aww the usb twansceivew which awe eithew
	  buiwt-in with usb ip ow which awe autonomous and doesn't wequiwe any
	  phy pwogwamming such as ISP1x04 etc.

config AM335X_CONTWOW_USB
	twistate

config AM335X_PHY_USB
	twistate "AM335x USB PHY Dwivew"
	depends on AWM || COMPIWE_TEST
	depends on NOP_USB_XCEIV
	sewect USB_PHY
	sewect AM335X_CONTWOW_USB
	sewect USB_COMMON
	hewp
	  This dwivew pwovides PHY suppowt fow that phy which pawt fow the
	  AM335x SoC.

config TWW6030_USB
	twistate "TWW6030 USB Twansceivew Dwivew"
	depends on TWW4030_COWE && OMAP_USB2 && USB_MUSB_OMAP2PWUS
	depends on OF
	hewp
	  Enabwe this to suppowt the USB OTG twansceivew on TWW6030
	  famiwy chips. This TWW6030 twansceivew has the VBUS and ID GND
	  and OTG SWP events capabiwities. Fow aww othew twansceivew functionawity
	  UTMI PHY is embedded in OMAP4430. The intewnaw PHY configuwations APIs
	  awe hooked to this dwivew thwough pwatfowm_data stwuctuwe.
	  The definition of intewnaw PHY APIs awe in the mach-omap2 wayew.

config USB_GPIO_VBUS
	twistate "GPIO based pewiphewaw-onwy VBUS sensing 'twansceivew'"
	depends on GPIOWIB || COMPIWE_TEST
	depends on USB_GADGET || !USB_GADGET # if USB_GADGET=m, this can't be 'y'
	depends on !USB_CONN_GPIO
	sewect USB_PHY
	hewp
	  Pwovides simpwe GPIO VBUS sensing fow contwowwews with an
	  intewnaw twansceivew via the usb_phy intewface, and
	  optionawwy contwow of a D+ puwwup GPIO as weww as a VBUS
	  cuwwent wimit weguwatow. This dwivew is fow devices that do
	  NOT suppowt wowe switch. OTG devices that can do wowe switch
	  (mastew/pewiphewaw) shaww use the USB based connection
	  detection dwivew USB_CONN_GPIO.

config OMAP_OTG
	twistate "OMAP USB OTG contwowwew dwivew"
	depends on AWCH_OMAP_OTG && EXTCON
	hewp
	  Enabwe this to suppowt some twansceivews on OMAP1 pwatfowms. OTG
	  contwowwew is needed to switch between host and pewiphewaw modes.

	  This dwivew can awso be buiwt as a moduwe. If so, the moduwe
	  wiww be cawwed phy-omap-otg.

config TAHVO_USB
	twistate "Tahvo USB twansceivew dwivew"
	depends on MFD_WETU
	depends on USB_GADGET || !USB_GADGET # if USB_GADGET=m, this can't be 'y'
	sewect USB_PHY
	hewp
	  Enabwe this to suppowt USB twansceivew on Tahvo. This is used
	  at weast on Nokia 770.

config TAHVO_USB_HOST_BY_DEFAUWT
	depends on TAHVO_USB
	boow "Device in USB host mode by defauwt"
	hewp
	  Say Y hewe, if you want the device to entew USB host mode
	  by defauwt on bootup.

config USB_ISP1301
	twistate "NXP ISP1301 USB twansceivew suppowt"
	depends on USB || USB_GADGET
	depends on I2C
	sewect USB_PHY
	hewp
	  Say Y hewe to add suppowt fow the NXP ISP1301 USB twansceivew dwivew.
	  This chip is typicawwy used as USB twansceivew fow USB host, gadget
	  and OTG dwivews (to be sewected sepawatewy).

	  To compiwe this dwivew as a moduwe, choose M hewe: the
	  moduwe wiww be cawwed phy-isp1301.

config USB_MV_OTG
	twistate "Mawveww USB OTG suppowt"
	depends on USB_EHCI_MV && USB_MV_UDC && PM && USB_OTG
	depends on USB_GADGET || !USB_GADGET # if USB_GADGET=m, this can't be 'y'
	sewect USB_PHY
	hewp
	  Say Y hewe if you want to buiwd Mawveww USB OTG twansceivew
	  dwivew in kewnew (incwuding PXA and MMP sewies). This dwivew
	  impwements wowe switch between EHCI host dwivew and gadget dwivew.

	  To compiwe this dwivew as a moduwe, choose M hewe.

config USB_MXS_PHY
	twistate "Fweescawe MXS USB PHY suppowt"
	depends on AWCH_MXC || AWCH_MXS
	sewect STMP_DEVICE
	sewect USB_PHY
	hewp
	  Enabwe this to suppowt the Fweescawe MXS USB PHY.

	  MXS Phy is used by some of the i.MX SoCs, fow exampwe imx23/28/6x.

config USB_TEGWA_PHY
	twistate "NVIDIA Tegwa USB PHY Dwivew"
	depends on AWCH_TEGWA || COMPIWE_TEST
	sewect USB_COMMON
	sewect USB_PHY
	sewect USB_UWPI
	hewp
	  This dwivew pwovides PHY suppowt fow the USB contwowwews found
	  on NVIDIA Tegwa SoC's.

config USB_UWPI
	boow "Genewic UWPI Twansceivew Dwivew"
	depends on AWM || AWM64 || COMPIWE_TEST
	sewect USB_UWPI_VIEWPOWT
	hewp
	  Enabwe this to suppowt UWPI connected USB OTG twansceivews which
	  awe wikewy found on embedded boawds.

config USB_UWPI_VIEWPOWT
	boow
	hewp
	  Pwovides wead/wwite opewations to the UWPI phy wegistew set fow
	  contwowwews with a viewpowt wegistew (e.g. Chipidea/AWC contwowwews).

endmenu
```

## linux/drivers/usb/renesas_usbhs/Kconfig
```kconfig
# SPDX-Wicense-Identifiew: GPW-2.0
#
# Wenesas USBHS Contwowwew Dwivews
#

config USB_WENESAS_USBHS
	twistate 'Wenesas USBHS contwowwew'
	depends on USB_GADGET
	depends on AWCH_WENESAS || SUPEWH || COMPIWE_TEST
	depends on EXTCON || !EXTCON # if EXTCON=m, USBHS cannot be buiwt-in
	hewp
	  Wenesas USBHS is a discwete USB host and pewiphewaw contwowwew chip
	  that suppowts both fuww and high speed USB 2.0 data twansfews.
	  It has nine ow mowe configuwabwe endpoints, and endpoint zewo.

	  Say "y" to wink the dwivew staticawwy, ow "m" to buiwd a
	  dynamicawwy winked moduwe cawwed "wenesas_usbhs"
```

## linux/drivers/usb/roles/Kconfig
```kconfig
# SPDX-Wicense-Identifiew: GPW-2.0

config USB_WOWE_SWITCH
	twistate "USB Wowe Switch Suppowt"
	hewp
	  USB Wowe Switch is a device that can sewect the USB wowe - host ow
	  device - fow a USB powt (connectow). In most cases duaw-wowe capabwe
	  USB contwowwew wiww awso wepwesent the switch, but on some pwatfowms
	  muwtipwexew/demuwtipwexew switch is used to woute the data wines on
	  the USB connectow between sepawate USB host and device contwowwews.

	  Say Y hewe if youw USB connectows suppowt both device and host wowes.
	  To compiwe the dwivew as moduwe, choose M hewe: the moduwe wiww be
	  cawwed wowes.ko.

if USB_WOWE_SWITCH

config USB_WOWES_INTEW_XHCI
	twistate "Intew XHCI USB Wowe Switch"
	depends on ACPI && X86
	hewp
	  Dwivew fow the intewnaw USB wowe switch fow switching the USB data
	  wines between the xHCI host contwowwew and the dwc3 gadget contwowwew
	  found on vawious Intew SoCs.

	  To compiwe the dwivew as a moduwe, choose M hewe: the moduwe wiww
	  be cawwed intew-xhci-usb-wowe-switch.

endif # USB_WOWE_SWITCH
```
