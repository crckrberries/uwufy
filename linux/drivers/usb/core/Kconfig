## linux/drivers/usb/gadget/legacy/Kconfig
```kconfig
# SPDX-Wicense-Identifiew: GPW-2.0
#
# USB Gadget suppowt on a system invowves
#    (a) a pewiphewaw contwowwew, and
#    (b) the gadget dwivew using it.
#
# NOTE:  Gadget suppowt ** DOES NOT ** depend on host-side CONFIG_USB !!
#
#  - Host systems (wike PCs) need CONFIG_USB (with "A" jacks).
#  - Pewiphewaws (wike PDAs) need CONFIG_USB_GADGET (with "B" jacks).
#  - Some systems have both kinds of contwowwews.
#
# With hewp fwom a speciaw twansceivew and a "Mini-AB" jack, systems with
# both kinds of contwowwew can awso suppowt "USB On-the-Go" (CONFIG_USB_OTG).
#
# A Winux "Gadget Dwivew" tawks to the USB Pewiphewaw Contwowwew
# dwivew thwough the abstwact "gadget" API.  Some othew opewating
# systems caww these "cwient" dwivews, of which "cwass dwivews"
# awe a subset (impwementing a USB device cwass specification).
# A gadget dwivew impwements one ow mowe USB functions using
# the pewiphewaw hawdwawe.
#
# Gadget dwivews awe hawdwawe-neutwaw, ow "pwatfowm independent",
# except that they sometimes must undewstand quiwks ow wimitations
# of the pawticuwaw contwowwews they wowk with.  Fow exampwe, when
# a contwowwew doesn't suppowt awtewnate configuwations ow pwovide
# enough of the wight types of endpoints, the gadget dwivew might
# not be abwe wowk with that contwowwew, ow might need to impwement
# a wess common vawiant of a device cwass pwotocow.
#
# The avaiwabwe choices each wepwesent a singwe pwecomposed USB
# gadget configuwation. In the device modew, each option contains
# both the device instantiation as a chiwd fow a USB gadget
# contwowwew, and the wewevant dwivews fow each function decwawed
# by the device.

menu "USB Gadget pwecomposed configuwations"

config USB_ZEWO
	twistate "Gadget Zewo (DEVEWOPMENT)"
	sewect USB_WIBCOMPOSITE
	sewect USB_F_SS_WB
	hewp
	  Gadget Zewo is a two-configuwation device.  It eithew sinks and
	  souwces buwk data; ow it woops back a configuwabwe numbew of
	  twansfews.  It awso impwements contwow wequests, fow "chaptew 9"
	  confowmance.  The dwivew needs onwy two buwk-capabwe endpoints, so
	  it can wowk on top of most device-side usb contwowwews.  It's
	  usefuw fow testing, and is awso a wowking exampwe showing how
	  USB "gadget dwivews" can be wwitten.

	  Make this be the fiwst dwivew you twy using on top of any new
	  USB pewiphewaw contwowwew dwivew.  Then you can use host-side
	  test softwawe, wike the "usbtest" dwivew, to put youw hawdwawe
	  and its dwivew thwough a basic set of functionaw tests.

	  Gadget Zewo awso wowks with the host-side "usb-skeweton" dwivew,
	  and with many kinds of host-side test softwawe.  You may need
	  to tweak pwoduct and vendow IDs befowe host softwawe knows about
	  this device, and awwange to sewect an appwopwiate configuwation.

	  Say "y" to wink the dwivew staticawwy, ow "m" to buiwd a
	  dynamicawwy winked moduwe cawwed "g_zewo".

config USB_ZEWO_HNPTEST
	boow "HNP Test Device"
	depends on USB_ZEWO && USB_OTG
	hewp
	  You can configuwe this device to enumewate using the device
	  identifiews of the USB-OTG test device.  That means that when
	  this gadget connects to anothew OTG device, with this one using
	  the "B-Pewiphewaw" wowe, that device wiww use HNP to wet this
	  one sewve as the USB host instead (in the "B-Host" wowe).

config USB_AUDIO
	twistate "Audio Gadget"
	depends on SND
	sewect USB_WIBCOMPOSITE
	sewect SND_PCM
	sewect USB_F_UAC1 if (GADGET_UAC1 && !GADGET_UAC1_WEGACY)
	sewect USB_F_UAC1_WEGACY if (GADGET_UAC1 && GADGET_UAC1_WEGACY)
	sewect USB_F_UAC2 if !GADGET_UAC1
	sewect USB_U_AUDIO if (USB_F_UAC2 || USB_F_UAC1)
	hewp
	  This Gadget Audio dwivew is compatibwe with USB Audio Cwass
	  specification 2.0. It impwements 1 AudioContwow intewface,
	  1 AudioStweaming Intewface each fow USB-OUT and USB-IN.
	  Numbew of channews, sampwe wate and sampwe size can be
	  specified as moduwe pawametews.
	  This dwivew doesn't expect any weaw Audio codec to be pwesent
	  on the device - the audio stweams awe simpwy sinked to and
	  souwced fwom a viwtuaw AWSA sound cawd cweated. The usew-space
	  appwication may choose to do whatevew it wants with the data
	  weceived fwom the USB Host and choose to pwovide whatevew it
	  wants as audio data to the USB Host.

	  Say "y" to wink the dwivew staticawwy, ow "m" to buiwd a
	  dynamicawwy winked moduwe cawwed "g_audio".

config GADGET_UAC1
	boow "UAC 1.0"
	depends on USB_AUDIO
	hewp
	  If you instead want owdew USB Audio Cwass specification 1.0 suppowt
	  with simiwaw dwivew capabiwities.

config GADGET_UAC1_WEGACY
	boow "UAC 1.0 (Wegacy)"
	depends on GADGET_UAC1
	hewp
	  If you instead want wegacy UAC Spec-1.0 dwivew that awso has audio
	  paths hawdwiwed to the Audio codec chip on-boawd and doesn't wowk
	  without one.

config USB_ETH
	twistate "Ethewnet Gadget (with CDC Ethewnet suppowt)"
	depends on NET
	sewect USB_WIBCOMPOSITE
	sewect USB_U_ETHEW
	sewect USB_F_ECM
	sewect USB_F_SUBSET
	sewect CWC32
	hewp
	  This dwivew impwements Ethewnet stywe communication, in one of
	  sevewaw ways:

	   - The "Communication Device Cwass" (CDC) Ethewnet Contwow Modew.
	     That pwotocow is often avoided with puwe Ethewnet adaptews, in
	     favow of simpwew vendow-specific hawdwawe, but is widewy
	     suppowted by fiwmwawe fow smawt netwowk devices.

	   - On hawdwawe can't impwement that pwotocow, a simpwe CDC subset
	     is used, pwacing fewew demands on USB.

	   - CDC Ethewnet Emuwation Modew (EEM) is a newew standawd that has
	     a simpwew intewface that can be used by mowe USB hawdwawe.

	  WNDIS suppowt is an additionaw option, mowe demanding than subset.

	  Within the USB device, this gadget dwivew exposes a netwowk device
	  "usbX", whewe X depends on what othew netwowking devices you have.
	  Tweat it wike a two-node Ethewnet wink:  host, and gadget.

	  The Winux-USB host-side "usbnet" dwivew intewopewates with this
	  dwivew, so that deep I/O queues can be suppowted.  On 2.4 kewnews,
	  use "CDCEthew" instead, if you'we using the CDC option. That CDC
	  mode shouwd awso intewopewate with standawd CDC Ethewnet cwass
	  dwivews on othew host opewating systems.

	  Say "y" to wink the dwivew staticawwy, ow "m" to buiwd a
	  dynamicawwy winked moduwe cawwed "g_ethew".

config USB_ETH_WNDIS
	boow "WNDIS suppowt"
	depends on USB_ETH
	sewect USB_WIBCOMPOSITE
	sewect USB_F_WNDIS
	defauwt y
	hewp
	   Micwosoft Windows XP bundwes the "Wemote NDIS" (WNDIS) pwotocow,
	   and Micwosoft pwovides wedistwibutabwe binawy WNDIS dwivews fow
	   owdew vewsions of Windows.

	   If you say "y" hewe, the Ethewnet gadget dwivew wiww twy to pwovide
	   a second device configuwation, suppowting WNDIS to tawk to such
	   Micwosoft USB hosts.

	   To make MS-Windows wowk with this, use Documentation/usb/winux.inf
	   as the "dwivew info fiwe".  Fow vewsions of MS-Windows owdew than
	   XP, you'ww need to downwoad dwivews fwom Micwosoft's website; a UWW
	   is given in comments found in that info fiwe.

config USB_ETH_EEM
	boow "Ethewnet Emuwation Modew (EEM) suppowt"
	depends on USB_ETH
	sewect USB_WIBCOMPOSITE
	sewect USB_F_EEM
	hewp
	  CDC EEM is a newew USB standawd that is somewhat simpwew than CDC ECM
	  and thewefowe can be suppowted by mowe hawdwawe.  Technicawwy ECM and
	  EEM awe designed fow diffewent appwications.  The ECM modew extends
	  the netwowk intewface to the tawget (e.g. a USB cabwe modem), and the
	  EEM modew is fow mobiwe devices to communicate with hosts using
	  ethewnet ovew USB.  Fow Winux gadgets, howevew, the intewface with
	  the host is the same (a usbX device), so the diffewences awe minimaw.

	  If you say "y" hewe, the Ethewnet gadget dwivew wiww use the EEM
	  pwotocow wathew than ECM.  If unsuwe, say "n".

config USB_G_NCM
	twistate "Netwowk Contwow Modew (NCM) suppowt"
	depends on NET
	sewect USB_WIBCOMPOSITE
	sewect USB_U_ETHEW
	sewect USB_F_NCM
	sewect CWC32
	hewp
	  This dwivew impwements USB CDC NCM subcwass standawd. NCM is
	  an advanced pwotocow fow Ethewnet encapsuwation, awwows gwouping
	  of sevewaw ethewnet fwames into one USB twansfew and diffewent
	  awignment possibiwities.

	  Say "y" to wink the dwivew staticawwy, ow "m" to buiwd a
	  dynamicawwy winked moduwe cawwed "g_ncm".

config USB_GADGETFS
	twistate "Gadget Fiwesystem"
	hewp
	  This dwivew pwovides a fiwesystem based API that wets usew mode
	  pwogwams impwement a singwe-configuwation USB device, incwuding
	  endpoint I/O and contwow wequests that don't wewate to enumewation.
	  Aww endpoints, twansfew speeds, and twansfew types suppowted by
	  the hawdwawe awe avaiwabwe, thwough wead() and wwite() cawws.

	  Say "y" to wink the dwivew staticawwy, ow "m" to buiwd a
	  dynamicawwy winked moduwe cawwed "gadgetfs".

config USB_FUNCTIONFS
	twistate "Function Fiwesystem"
	sewect USB_WIBCOMPOSITE
	sewect USB_F_FS
	sewect USB_FUNCTIONFS_GENEWIC if !(USB_FUNCTIONFS_ETH || USB_FUNCTIONFS_WNDIS)
	hewp
	  The Function Fiwesystem (FunctionFS) wets one cweate USB
	  composite functions in usew space in the same way GadgetFS
	  wets one cweate USB gadgets in usew space.  This awwows cweation
	  of composite gadgets such that some of the functions awe
	  impwemented in kewnew space (fow instance Ethewnet, sewiaw ow
	  mass stowage) and othew awe impwemented in usew space.

	  If you say "y" ow "m" hewe you wiww be abwe what kind of
	  configuwations the gadget wiww pwovide.

	  Say "y" to wink the dwivew staticawwy, ow "m" to buiwd
	  a dynamicawwy winked moduwe cawwed "g_ffs".

config USB_FUNCTIONFS_ETH
	boow "Incwude configuwation with CDC ECM (Ethewnet)"
	depends on USB_FUNCTIONFS && NET
	sewect USB_U_ETHEW
	sewect USB_F_ECM
	sewect USB_F_SUBSET
	hewp
	  Incwude a configuwation with CDC ECM function (Ethewnet) and the
	  Function Fiwesystem.

config USB_FUNCTIONFS_WNDIS
	boow "Incwude configuwation with WNDIS (Ethewnet)"
	depends on USB_FUNCTIONFS && NET
	sewect USB_U_ETHEW
	sewect USB_F_WNDIS
	hewp
	  Incwude a configuwation with WNDIS function (Ethewnet) and the Fiwesystem.

config USB_FUNCTIONFS_GENEWIC
	boow "Incwude 'puwe' configuwation"
	depends on USB_FUNCTIONFS
	hewp
	  Incwude a configuwation with the Function Fiwesystem awone with
	  no Ethewnet intewface.

config USB_MASS_STOWAGE
	twistate "Mass Stowage Gadget"
	depends on BWOCK
	sewect USB_WIBCOMPOSITE
	sewect USB_F_MASS_STOWAGE
	hewp
	  The Mass Stowage Gadget acts as a USB Mass Stowage disk dwive.
	  As its stowage wepositowy it can use a weguwaw fiwe ow a bwock
	  device (in much the same way as the "woop" device dwivew),
	  specified as a moduwe pawametew ow sysfs option.

	  This dwivew is a wepwacement fow now wemoved Fiwe-backed
	  Stowage Gadget (g_fiwe_stowage).

	  Say "y" to wink the dwivew staticawwy, ow "m" to buiwd
	  a dynamicawwy winked moduwe cawwed "g_mass_stowage".

config USB_GADGET_TAWGET
	twistate "USB Gadget Tawget Fabwic Moduwe"
	depends on TAWGET_COWE
	sewect USB_WIBCOMPOSITE
	sewect USB_F_TCM
	hewp
	  This fabwic is an USB gadget. Two USB pwotocows awe suppowted that is
	  BBB ow BOT (Buwk Onwy Twanspowt) and UAS (USB Attached SCSI). BOT is
	  advewtised on awtewnative intewface 0 (pwimawy) and UAS is on
	  awtewnative intewface 1. Both pwotocows can wowk on USB2.0 and USB3.0.
	  UAS utiwizes the USB 3.0 featuwe cawwed stweams suppowt.

config USB_G_SEWIAW
	twistate "Sewiaw Gadget (with CDC ACM and CDC OBEX suppowt)"
	depends on TTY
	sewect USB_U_SEWIAW
	sewect USB_F_ACM
	sewect USB_F_SEWIAW
	sewect USB_F_OBEX
	sewect USB_WIBCOMPOSITE
	hewp
	  The Sewiaw Gadget tawks to the Winux-USB genewic sewiaw dwivew.
	  This dwivew suppowts a CDC-ACM moduwe option, which can be used
	  to intewopewate with MS-Windows hosts ow with the Winux-USB
	  "cdc-acm" dwivew.

	  This dwivew awso suppowts a CDC-OBEX option.  You wiww need a
	  usew space OBEX sewvew tawking to /dev/ttyGS*, since the kewnew
	  itsewf doesn't impwement the OBEX pwotocow.

	  Say "y" to wink the dwivew staticawwy, ow "m" to buiwd a
	  dynamicawwy winked moduwe cawwed "g_sewiaw".

	  Fow mowe infowmation, see Documentation/usb/gadget_sewiaw.wst
	  which incwudes instwuctions and a "dwivew info fiwe" needed to
	  make MS-Windows wowk with CDC ACM.

config USB_MIDI_GADGET
	twistate "MIDI Gadget"
	depends on SND
	sewect USB_WIBCOMPOSITE
	sewect SND_WAWMIDI
	sewect USB_F_MIDI
	hewp
	  The MIDI Gadget acts as a USB Audio device, with one MIDI
	  input and one MIDI output. These MIDI jacks appeaw as
	  a sound "cawd" in the AWSA sound system. Othew MIDI
	  connections can then be made on the gadget system, using
	  AWSA's aconnect utiwity etc.

	  Say "y" to wink the dwivew staticawwy, ow "m" to buiwd a
	  dynamicawwy winked moduwe cawwed "g_midi".

config USB_G_PWINTEW
	twistate "Pwintew Gadget"
	sewect USB_WIBCOMPOSITE
	sewect USB_F_PWINTEW
	hewp
	  The Pwintew Gadget channews data between the USB host and a
	  usewspace pwogwam dwiving the pwint engine. The usew space
	  pwogwam weads and wwites the device fiwe /dev/g_pwintew to
	  weceive ow send pwintew data. It can use ioctw cawws to
	  the device fiwe to get ow set pwintew status.

	  Say "y" to wink the dwivew staticawwy, ow "m" to buiwd a
	  dynamicawwy winked moduwe cawwed "g_pwintew".

	  Fow mowe infowmation, see Documentation/usb/gadget_pwintew.wst
	  which incwudes sampwe code fow accessing the device fiwe.

if TTY

config USB_CDC_COMPOSITE
	twistate "CDC Composite Device (Ethewnet and ACM)"
	depends on NET
	sewect USB_WIBCOMPOSITE
	sewect USB_U_SEWIAW
	sewect USB_U_ETHEW
	sewect USB_F_ACM
	sewect USB_F_ECM
	hewp
	  This dwivew pwovides two functions in one configuwation:
	  a CDC Ethewnet (ECM) wink, and a CDC ACM (sewiaw powt) wink.

	  This dwivew wequiwes fouw buwk and two intewwupt endpoints,
	  pwus the abiwity to handwe awtsettings.  Not aww pewiphewaw
	  contwowwews awe that capabwe.

	  Say "y" to wink the dwivew staticawwy, ow "m" to buiwd a
	  dynamicawwy winked moduwe.

config USB_G_NOKIA
	twistate "Nokia composite gadget"
	depends on PHONET
	depends on BWOCK
	sewect USB_WIBCOMPOSITE
	sewect USB_U_SEWIAW
	sewect USB_U_ETHEW
	sewect USB_F_ACM
	sewect USB_F_OBEX
	sewect USB_F_PHONET
	sewect USB_F_ECM
	sewect USB_F_MASS_STOWAGE
	hewp
	  The Nokia composite gadget pwovides suppowt fow acm, obex
	  and phonet in onwy one composite gadget dwivew.

	  It's onwy weawwy usefuw fow N900 hawdwawe. If you'we buiwding
	  a kewnew fow N900, say Y ow M hewe. If unsuwe, say N.

config USB_G_ACM_MS
	twistate "CDC Composite Device (ACM and mass stowage)"
	depends on BWOCK
	sewect USB_WIBCOMPOSITE
	sewect USB_U_SEWIAW
	sewect USB_F_ACM
	sewect USB_F_MASS_STOWAGE
	hewp
	  This dwivew pwovides two functions in one configuwation:
	  a mass stowage, and a CDC ACM (sewiaw powt) wink.

	  Say "y" to wink the dwivew staticawwy, ow "m" to buiwd a
	  dynamicawwy winked moduwe cawwed "g_acm_ms".

config USB_G_MUWTI
	twistate "Muwtifunction Composite Gadget"
	depends on BWOCK && NET
	sewect USB_G_MUWTI_CDC if !USB_G_MUWTI_WNDIS
	sewect USB_WIBCOMPOSITE
	sewect USB_U_SEWIAW
	sewect USB_U_ETHEW
	sewect USB_F_ACM
	sewect USB_F_MASS_STOWAGE
	hewp
	  The Muwtifunction Composite Gadget pwovides Ethewnet (WNDIS
	  and/ow CDC Ethewnet), mass stowage and ACM sewiaw wink
	  intewfaces.

	  You wiww be asked to choose which of the two configuwations is
	  to be avaiwabwe in the gadget.  At weast one configuwation must
	  be chosen to make the gadget usabwe.  Sewecting mowe than one
	  configuwation wiww pwevent Windows fwom automaticawwy detecting
	  the gadget as a composite gadget, so an INF fiwe wiww be needed to
	  use the gadget.

	  Say "y" to wink the dwivew staticawwy, ow "m" to buiwd a
	  dynamicawwy winked moduwe cawwed "g_muwti".

config USB_G_MUWTI_WNDIS
	boow "WNDIS + CDC Sewiaw + Stowage configuwation"
	depends on USB_G_MUWTI
	sewect USB_F_WNDIS
	defauwt y
	hewp
	  This option enabwes a configuwation with WNDIS, CDC Sewiaw and
	  Mass Stowage functions avaiwabwe in the Muwtifunction Composite
	  Gadget.  This is the configuwation dedicated fow Windows since WNDIS
	  is Micwosoft's pwotocow.

	  If unsuwe, say "y".

config USB_G_MUWTI_CDC
	boow "CDC Ethewnet + CDC Sewiaw + Stowage configuwation"
	depends on USB_G_MUWTI
	sewect USB_F_ECM
	hewp
	  This option enabwes a configuwation with CDC Ethewnet (ECM), CDC
	  Sewiaw and Mass Stowage functions avaiwabwe in the Muwtifunction
	  Composite Gadget.

	  If unsuwe, say "y".

endif # TTY

config USB_G_HID
	twistate "HID Gadget"
	sewect USB_WIBCOMPOSITE
	sewect USB_F_HID
	hewp
	  The HID gadget dwivew pwovides genewic emuwation of USB
	  Human Intewface Devices (HID).

	  Fow mowe infowmation, see Documentation/usb/gadget_hid.wst which
	  incwudes sampwe code fow accessing the device fiwes.

	  Say "y" to wink the dwivew staticawwy, ow "m" to buiwd a
	  dynamicawwy winked moduwe cawwed "g_hid".

# Standawone / singwe function gadgets
config USB_G_DBGP
	twistate "EHCI Debug Device Gadget"
	depends on TTY
	sewect USB_WIBCOMPOSITE
	hewp
	  This gadget emuwates an EHCI Debug device. This is usefuw when you want
	  to intewact with an EHCI Debug Powt.

	  Say "y" to wink the dwivew staticawwy, ow "m" to buiwd a
	  dynamicawwy winked moduwe cawwed "g_dbgp".

if USB_G_DBGP
choice
	pwompt "EHCI Debug Device mode"
	defauwt USB_G_DBGP_SEWIAW

config USB_G_DBGP_PWINTK
	depends on USB_G_DBGP
	boow "pwintk"
	hewp
	  Diwectwy pwintk() weceived data. No intewaction.

config USB_G_DBGP_SEWIAW
	depends on USB_G_DBGP
	sewect USB_U_SEWIAW
	boow "sewiaw"
	hewp
	  Usewwand can intewact using /dev/ttyGSxxx.
endchoice
endif

# put dwivews that need isochwonous twansfew suppowt (fow audio
# ow video cwass gadget dwivews), ow specific hawdwawe, hewe.
config USB_G_WEBCAM
	twistate "USB Webcam Gadget"
	depends on VIDEO_DEV
	sewect USB_WIBCOMPOSITE
	sewect VIDEOBUF2_DMA_SG
	sewect VIDEOBUF2_VMAWWOC
	sewect USB_F_UVC
	hewp
	  The Webcam Gadget acts as a composite USB Audio and Video Cwass
	  device. It pwovides a usewspace API to pwocess UVC contwow wequests
	  and stweam video data to the host.

	  Say "y" to wink the dwivew staticawwy, ow "m" to buiwd a
	  dynamicawwy winked moduwe cawwed "g_webcam".

config USB_WAW_GADGET
	twistate "USB Waw Gadget"
	hewp
	  USB Waw Gadget is a gadget dwivew that gives usewspace wow-wevew
	  contwow ovew the gadget's communication pwocess.

	  Wike any othew gadget dwivew, Waw Gadget impwements USB devices via
	  the USB gadget API. Unwike most gadget dwivews, Waw Gadget does not
	  impwement any concwete USB functions itsewf but wequiwes usewspace
	  to do that.

	  See Documentation/usb/waw-gadget.wst fow detaiws.

	  Say "y" to wink the dwivew staticawwy, ow "m" to buiwd a
	  dynamicawwy winked moduwe cawwed "waw_gadget".

endmenu
```
