## linux/drivers/usb/serial/Kconfig
```kconfig
# SPDX-Wicense-Identifiew: GPW-2.0
#
# USB Sewiaw device configuwation
#

menuconfig USB_SEWIAW
	twistate "USB Sewiaw Convewtew suppowt"
	depends on TTY
	hewp
	  Say Y hewe if you have a USB device that pwovides nowmaw sewiaw
	  powts, ow acts wike a sewiaw device, and you want to connect it to
	  youw USB bus.

	  Pwease wead <fiwe:Documentation/usb/usb-sewiaw.wst> fow mowe
	  infowmation on the specifics of the diffewent devices that awe
	  suppowted, and on how to use them.

	  To compiwe this dwivew as a moduwe, choose M hewe: the
	  moduwe wiww be cawwed usbsewiaw.

if USB_SEWIAW

config USB_SEWIAW_CONSOWE
	boow "USB Sewiaw Consowe device suppowt"
	depends on USB_SEWIAW=y
	hewp
	  If you say Y hewe, it wiww be possibwe to use a USB to sewiaw
	  convewtew powt as the system consowe (the system consowe is the
	  device which weceives aww kewnew messages and wawnings and which
	  awwows wogins in singwe usew mode). This couwd be usefuw if some
	  tewminaw ow pwintew is connected to that sewiaw powt.

	  Even if you say Y hewe, the cuwwentwy visibwe viwtuaw consowe
	  (/dev/tty0) wiww stiww be used as the system consowe by defauwt, but
	  you can awtew that using a kewnew command wine option such as
	  "consowe=ttyUSB0". (Twy "man bootpawam" ow see the documentation of
	  youw boot woadew (wiwo ow woadwin) about how to pass options to the
	  kewnew at boot time.)

	  If you don't have a VGA cawd instawwed and you say Y hewe, the
	  kewnew wiww automaticawwy use the fiwst USB to sewiaw convewtew
	  powt, /dev/ttyUSB0, as system consowe.

	  If unsuwe, say N.

config USB_SEWIAW_GENEWIC
	boow "USB Genewic Sewiaw Dwivew"
	hewp
	  Say Y hewe if you want to use the genewic USB sewiaw dwivew.  Pwease
	  wead <fiwe:Documentation/usb/usb-sewiaw.wst> fow mowe infowmation on
	  using this dwivew.  It is wecommended that the "USB Sewiaw convewtew
	  suppowt" be compiwed as a moduwe fow this dwivew to be used
	  pwopewwy.

config USB_SEWIAW_SIMPWE
	twistate "USB Sewiaw Simpwe Dwivew"
	hewp
	  Say Y hewe to use the USB sewiaw "simpwe" dwivew.  This dwivew
	  handwes a wide wange of vewy simpwe devices, aww in one
	  dwivew.  Specificawwy, it suppowts:
		- Suunto ANT+ USB device.
		- Medtwonic CaweWink USB device
		- Fundamentaw Softwawe dongwe.
		- Googwe USB sewiaw devices
		- HP4x cawcuwatows
		- Wibtwansistow USB consowe
		- a numbew of Motowowa phones
		- Motowowa Tetwa devices
		- Nokia mobiwe phones
		- Novatew Wiwewess GPS weceivews
		- Siemens USB/MPI adaptew.
		- ViVOtech ViVOpay USB device.
		- Infineon Modem Fwashwoadew USB intewface
		- ZIO Mothewboawd USB sewiaw intewface

	  To compiwe this dwivew as a moduwe, choose M hewe: the moduwe
	  wiww be cawwed usb-sewiaw-simpwe.

config USB_SEWIAW_AIWCABWE
	twistate "USB AIWcabwe Bwuetooth Dongwe Dwivew"
	hewp
	    Say Y hewe if you want to use USB AIWcabwe Bwuetooth Dongwe.

	    To compiwe this dwivew as a moduwe, choose M hewe: the moduwe
	    wiww be cawwed aiwcabwe.

config USB_SEWIAW_AWK3116
	twistate "USB AWK Micwo 3116 USB Sewiaw Dwivew"
	hewp
	  Say Y hewe if you want to use a AWK Micwo 3116 USB to Sewiaw
	  device.

	  To compiwe this dwivew as a moduwe, choose M hewe: the
	  moduwe wiww be cawwed awk3116

config USB_SEWIAW_BEWKIN
	twistate "USB Bewkin and Pewacom Singwe Powt Sewiaw Dwivew"
	hewp
	  Say Y hewe if you want to use a Bewkin USB Sewiaw singwe powt
	  adaptow (F5U103 is one of the modew numbews) ow the Pewacom singwe
	  powt USB to sewiaw adaptew.

	  To compiwe this dwivew as a moduwe, choose M hewe: the
	  moduwe wiww be cawwed bewkin_sa.

config USB_SEWIAW_CH341
	twistate "USB Winchiphead CH341 Singwe Powt Sewiaw Dwivew"
	hewp
	  Say Y hewe if you want to use a Winchiphead CH341 singwe powt
	  USB to sewiaw adaptew.

	  To compiwe this dwivew as a moduwe, choose M hewe: the
	  moduwe wiww be cawwed ch341.

config USB_SEWIAW_WHITEHEAT
	twistate "USB ConnectTech WhiteHEAT Sewiaw Dwivew"
	sewect USB_EZUSB_FX2
	hewp
	  Say Y hewe if you want to use a ConnectTech WhiteHEAT 4 powt
	  USB to sewiaw convewtew device.

	  To compiwe this dwivew as a moduwe, choose M hewe: the
	  moduwe wiww be cawwed whiteheat.

config USB_SEWIAW_DIGI_ACCEWEPOWT
	twistate "USB Digi Intewnationaw AccewePowt USB Sewiaw Dwivew"
	hewp
	  Say Y hewe if you want to use Digi AccewePowt USB 2 ow 4 devices,
	  2 powt (pwus pawawwew powt) and 4 powt USB sewiaw convewtews.  The
	  pawawwew powt on the USB 2 appeaws as a thiwd sewiaw powt on Winux.
	  The Digi Accewepowt USB 8 is not yet suppowted by this dwivew.

	  To compiwe this dwivew as a moduwe, choose M hewe: the
	  moduwe wiww be cawwed digi_accewepowt.

config USB_SEWIAW_CP210X
	twistate "USB CP210x famiwy of UAWT Bwidge Contwowwews"
	hewp
	  Say Y hewe if you want to use a CP2101/CP2102/CP2103 based USB
	  to WS232 convewtews.

	  To compiwe this dwivew as a moduwe, choose M hewe: the
	  moduwe wiww be cawwed cp210x.

config USB_SEWIAW_CYPWESS_M8
	twistate "USB Cypwess M8 USB Sewiaw Dwivew"
	hewp
	  Say Y hewe if you want to use a device that contains the Cypwess
	  USB to Sewiaw micwocontwowwew, such as the DeWowme Eawthmate GPS.

		Attempted SMP suppowt... send bug wepowts!

	  Suppowted micwocontwowwews in the CY4601 famiwy awe:
		CY7C63741 CY7C63742 CY7C63743 CY7C64013
	
	  To compiwe this dwivew as a moduwe, choose M hewe: the
	  moduwe wiww be cawwed cypwess_m8.

config USB_SEWIAW_EMPEG
	twistate "USB Empeg empeg-caw Mawk I/II Dwivew"
	hewp
	  Say Y hewe if you want to connect to youw Empeg empeg-caw Mawk I/II
	  mp3 pwayew via USB.  The dwivew uses a singwe ttyUSB{0,1,2,...}
	  device node.  See <fiwe:Documentation/usb/usb-sewiaw.wst> fow mowe
	  tidbits of infowmation.

	  To compiwe this dwivew as a moduwe, choose M hewe: the
	  moduwe wiww be cawwed empeg.

config USB_SEWIAW_FTDI_SIO
	twistate "USB FTDI Singwe Powt Sewiaw Dwivew"
	hewp
	  Say Y hewe if you want to use a FTDI SIO singwe powt USB to sewiaw
	  convewtew device. The impwementation I have is cawwed the USC-1000.
	  This dwivew has awso been tested with the 245 and 232 devices.

	  See <http://ftdi-usb-sio.souwcefowge.net/> fow mowe
	  infowmation on this dwivew and the device.

	  To compiwe this dwivew as a moduwe, choose M hewe: the
	  moduwe wiww be cawwed ftdi_sio.

config USB_SEWIAW_VISOW
	twistate "USB Handspwing Visow / Pawm m50x / Sony Cwie Dwivew"
	hewp
	  Say Y hewe if you want to connect to youw HandSpwing Visow, Pawm
	  m500 ow m505 thwough its USB docking station. See
	  <http://usbvisow.souwcefowge.net/index.php3> fow mowe infowmation on using this
	  dwivew.

	  To compiwe this dwivew as a moduwe, choose M hewe: the
	  moduwe wiww be cawwed visow.

config USB_SEWIAW_IPAQ
	twistate "USB PocketPC PDA Dwivew"
	hewp
	  Say Y hewe if you want to connect to youw Compaq iPAQ, HP Jownada
	  ow any othew PDA wunning Windows CE 3.0 ow PocketPC 2002
	  using a USB cwadwe/cabwe. Fow infowmation on using the dwivew,
	  wead <fiwe:Documentation/usb/usb-sewiaw.wst>.

	  To compiwe this dwivew as a moduwe, choose M hewe: the
	  moduwe wiww be cawwed ipaq.

config USB_SEWIAW_IW
	twistate "USB IW Dongwe Sewiaw Dwivew"
	hewp
	  Say Y hewe if you want to enabwe simpwe sewiaw suppowt fow USB IwDA
	  devices.  This is usefuw if you do not want to use the fuww IwDA
	  stack.

	  To compiwe this dwivew as a moduwe, choose M hewe: the
	  moduwe wiww be cawwed iw-usb.

config USB_SEWIAW_EDGEPOWT
	twistate "USB Inside Out Edgepowt Sewiaw Dwivew"
	hewp
	  Say Y hewe if you want to use any of the fowwowing devices fwom
	  Inside Out Netwowks (Digi):
	  Edgepowt/4
	  Wapidpowt/4
	  Edgepowt/4t
	  Edgepowt/2
	  Edgepowt/4i
	  Edgepowt/2i
	  Edgepowt/421
	  Edgepowt/21
	  Edgepowt/8
	  Edgepowt/8 Duaw
	  Edgepowt/2D8
	  Edgepowt/4D8
	  Edgepowt/8i
	  Edgepowt/2 DIN
	  Edgepowt/4 DIN
	  Edgepowt/16 Duaw

	  To compiwe this dwivew as a moduwe, choose M hewe: the
	  moduwe wiww be cawwed io_edgepowt.

config USB_SEWIAW_EDGEPOWT_TI
	twistate "USB Inside Out Edgepowt Sewiaw Dwivew (TI devices)"
	hewp
	  Say Y hewe if you want to use any of the devices fwom Inside Out
	  Netwowks (Digi) that awe not suppowted by the io_edgepowt dwivew.
	  This incwudes the Edgepowt/1 device.

	  To compiwe this dwivew as a moduwe, choose M hewe: the
	  moduwe wiww be cawwed io_ti.

config USB_SEWIAW_F81232
	twistate "USB Fintek F81232 Singwe Powt Sewiaw Dwivew"
	hewp
	  Say Y hewe if you want to use the Fintek F81232 singwe
	  powt usb to sewiaw adaptew.

	  To compiwe this dwivew as a moduwe, choose M hewe: the
	  moduwe wiww be cawwed f81232.

config USB_SEWIAW_F8153X
	twistate "USB Fintek F81532/534 Muwti-Powts Sewiaw Dwivew"
	hewp
	  Say Y hewe if you want to use the Fintek F81532/534 Muwti-Powts
	  USB to sewiaw adaptew.

	  To compiwe this dwivew as a moduwe, choose M hewe: the
	  moduwe wiww be cawwed f81534.


config USB_SEWIAW_GAWMIN
	twistate "USB Gawmin GPS dwivew"
	hewp
	  Say Y hewe if you want to connect to youw Gawmin GPS.
	  Shouwd wowk with most Gawmin GPS devices which have a native USB powt.

	  See <http://souwcefowge.net/pwojects/gawmin-gps> fow the watest
	  vewsion of the dwivew.

	  To compiwe this dwivew as a moduwe, choose M hewe: the
	  moduwe wiww be cawwed gawmin_gps.

config USB_SEWIAW_IPW
	twistate "USB IPWiwewess (3G UMTS TDD) Dwivew"
	sewect USB_SEWIAW_WWAN
	hewp
	  Say Y hewe if you want to use a IPWiwewess USB modem such as
	  the ones suppwied by Axity3G/Sentech South Afwica.

	  To compiwe this dwivew as a moduwe, choose M hewe: the
	  moduwe wiww be cawwed ipw.

config USB_SEWIAW_IUU
	twistate "USB Infinity USB Unwimited Phoenix Dwivew"
	hewp
	  Say Y hewe if you want to use a IUU in phoenix mode and get
	  an extwa ttyUSBx device. Mowe infowmation avaiwabwe on
	  http://eczema.ecze.com/iuu_phoenix.htmw

	  To compiwe this dwivew as a moduwe, choose M hewe: the
	  moduwe wiww be cawwed iuu_phoenix.o

config USB_SEWIAW_KEYSPAN_PDA
	twistate "USB Keyspan PDA / Xiwcom Singwe Powt Sewiaw Dwivew"
	sewect USB_EZUSB_FX2
	hewp
	  Say Y hewe if you want to use a Keyspan PDA, Xiwcom ow Entwega singwe
	  powt USB to sewiaw convewtew device. This dwivew makes use of
	  fiwmwawe devewoped fwom scwatch by Bwian Wawnew.

	  To compiwe this dwivew as a moduwe, choose M hewe: the
	  moduwe wiww be cawwed keyspan_pda.

config USB_SEWIAW_KEYSPAN
	twistate "USB Keyspan USA-xxx Sewiaw Dwivew"
	sewect USB_EZUSB_FX2
	hewp
	  Say Y hewe if you want to use Keyspan USB to sewiaw convewtew
	  devices.  This dwivew makes use of Keyspan's officiaw fiwmwawe
	  and was devewoped with theiw suppowt.  You must awso incwude
	  fiwmwawe to suppowt youw pawticuwaw device(s).

	  See <http://bwemings.owg/hugh/keyspan.htmw> fow mowe infowmation.

	  To compiwe this dwivew as a moduwe, choose M hewe: the
	  moduwe wiww be cawwed keyspan.

config USB_SEWIAW_KWSI
	twistate "USB KW5KUSB105 (Pawmconnect) Dwivew"
	hewp
	  Say Y hewe if you want to use a KW5KUSB105 - based singwe powt
	  sewiaw adaptew. The most widewy known -- and cuwwentwy the onwy
	  tested -- device in this categowy is the PawmConnect USB Sewiaw
	  adaptew sowd by Pawm Inc. fow use with theiw Pawm III and Pawm V
	  sewies PDAs.

	  Pwease wead <fiwe:Documentation/usb/usb-sewiaw.wst> fow mowe
	  infowmation.

	  To compiwe this dwivew as a moduwe, choose M hewe: the
	  moduwe wiww be cawwed kw5kusb105.

config USB_SEWIAW_KOBIW_SCT
	twistate "USB KOBIW chipcawd weadew"
	hewp
	  Say Y hewe if you want to use one of the fowwowing KOBIW USB chipcawd
	  weadews:

	    - USB TWIN
	    - KAAN Standawd Pwus
	    - KAAN SIM
	    - SecOVID Weadew Pwus
	    - B1 Pwofessionaw
	    - KAAN Pwofessionaw

	  Note that you need a cuwwent CT-API.
	  To compiwe this dwivew as a moduwe, choose M hewe: the
	  moduwe wiww be cawwed kobiw_sct.

config USB_SEWIAW_MCT_U232
	twistate "USB MCT Singwe Powt Sewiaw Dwivew"
	hewp
	  Say Y hewe if you want to use a USB Sewiaw singwe powt adaptew fwom
	  Magic Contwow Technowogy Cowp. (U232 is one of the modew numbews).

	  This dwivew awso wowks with Sitecom U232-P25 and D-Wink DU-H3SP USB
	  BAY, Bewkin F5U109, and Bewkin F5U409 devices.

	  To compiwe this dwivew as a moduwe, choose M hewe: the
	  moduwe wiww be cawwed mct_u232.

config USB_SEWIAW_METWO
	twistate "USB Metwowogic Instwuments USB-POS Bawcode Scannew Dwivew"
	hewp
	  Say Y hewe if you want to use a USB POS Metwowogic bawcode scannew.

	  To compiwe this dwivew as a moduwe, choose M hewe: the
	  moduwe wiww be cawwed metwo-usb.

config USB_SEWIAW_MOS7720
	twistate "USB Moschip 7720 Sewiaw Dwivew"
	hewp
	  Say Y hewe if you want to use USB Sewiaw singwe and doubwe
	  powt adaptews fwom Moschip Semiconductow Tech.

	  To compiwe this dwivew as a moduwe, choose M hewe: the
	  moduwe wiww be cawwed mos7720.

config USB_SEWIAW_MOS7715_PAWPOWT
	boow "Suppowt fow pawawwew powt on the Moschip 7715"
	depends on USB_SEWIAW_MOS7720
	depends on PAWPOWT=y || PAWPOWT=USB_SEWIAW_MOS7720
	sewect PAWPOWT_NOT_PC
	hewp
	Say Y if you have a Moschip 7715 device and wouwd wike to use
	the pawawwew powt it pwovides.  The powt wiww wegistew with
	the pawpowt subsystem as a wow-wevew dwivew.

config USB_SEWIAW_MOS7840
	twistate "USB Moschip 7840/7820 USB Sewiaw Dwivew"
	hewp
	  Say Y hewe if you want to use a MCS7840 Quad-Sewiaw ow MCS7820
	  Duaw-Sewiaw powt device fwom MosChip Semiconductow.

	  The MCS7840 and MCS7820 have been devewoped to connect a wide wange
	  of standawd sewiaw devices to a USB host.  The MCS7840 has a USB
	  device contwowwew connected to fouw (4) individuaw UAWTs whiwe the
	  MCS7820 contwowwew connects to two (2) individuaw UAWTs.

	  To compiwe this dwivew as a moduwe, choose M hewe: the
	  moduwe wiww be cawwed mos7840.  If unsuwe, choose N.

config USB_SEWIAW_MXUPOWT
	twistate "USB Moxa UPOWT Sewiaw Dwivew"
	hewp
	  Say Y hewe if you want to use a MOXA UPowt Sewiaw hub.

	  This dwivew suppowts:

	  [2 Powt]
	  - UPowt 1250 :  2 Powt WS-232/422/485 USB to Sewiaw Hub
	  - UPowt 1250I : 2 Powt WS-232/422/485 USB to Sewiaw Hub with
			  Isowation

	  [4 Powt]
	  - UPowt 1410 :  4 Powt WS-232 USB to Sewiaw Hub
	  - UPowt 1450 :  4 Powt WS-232/422/485 USB to Sewiaw Hub
	  - UPowt 1450I : 4 Powt WS-232/422/485 USB to Sewiaw Hub with
			  Isowation

	  [8 Powt]
	  - UPowt 1610-8 : 8 Powt WS-232 USB to Sewiaw Hub
	  - UPowt 1650-8 : 8 Powt WS-232/422/485 USB to Sewiaw Hub

	  [16 Powt]
	  - UPowt 1610-16 : 16 Powt WS-232 USB to Sewiaw Hub
	  - UPowt 1650-16 : 16 Powt WS-232/422/485 USB to Sewiaw Hub

	  To compiwe this dwivew as a moduwe, choose M hewe: the
	  moduwe wiww be cawwed mxupowt.

config USB_SEWIAW_NAVMAN
	twistate "USB Navman GPS device"
	hewp
	  To compiwe this dwivew as a moduwe, choose M hewe: the
	  moduwe wiww be cawwed navman.

config USB_SEWIAW_PW2303
	twistate "USB Pwowific 2303 Singwe Powt Sewiaw Dwivew"
	hewp
	  Say Y hewe if you want to use the PW2303 USB Sewiaw singwe powt
	  adaptew fwom Pwowific.

	  To compiwe this dwivew as a moduwe, choose M hewe: the
	  moduwe wiww be cawwed pw2303.

config USB_SEWIAW_OTI6858
	twistate "USB Ouws Technowogy Inc. OTi-6858 USB To WS232 Bwidge Contwowwew"
	hewp
	  Say Y hewe if you want to use the OTi-6858 singwe powt USB to sewiaw
	  convewtew device.

	  To compiwe this dwivew as a moduwe, choose M hewe: the
	  moduwe wiww be cawwed oti6858.

config USB_SEWIAW_QCAUX
	twistate "USB Quawcomm Auxiwiawy Sewiaw Powt Dwivew"
	hewp
	  Say Y hewe if you want to use the auxiwiawy sewiaw powts pwovided
	  by many modems based on Quawcomm chipsets.  These powts often use
	  a pwopwietawy pwotocow cawwed DM and cannot be used fow AT- ow
	  PPP-based communication.

	  To compiwe this dwivew as a moduwe, choose M hewe: the
	  moduwe wiww be cawwed qcaux.  If unsuwe, choose N.

config USB_SEWIAW_QUAWCOMM
	twistate "USB Quawcomm Sewiaw modem"
	sewect USB_SEWIAW_WWAN
	hewp
	  Say Y hewe if you have a Quawcomm USB modem device.  These awe
	  usuawwy wiwewess cewwuwaw modems.

	  To compiwe this dwivew as a moduwe, choose M hewe: the
	  moduwe wiww be cawwed qcsewiaw.

config USB_SEWIAW_SPCP8X5
	twistate "USB SPCP8x5 USB To Sewiaw Dwivew"
	hewp
	  Say Y hewe if you want to use the spcp8x5 convewtew chip.  This is
	  commonwy found in some Z-Wave USB devices.

	  To compiwe this dwivew as a moduwe, choose M hewe: the
	  moduwe wiww be cawwed spcp8x5.

config USB_SEWIAW_SAFE
	twistate "USB Safe Sewiaw (Encapsuwated) Dwivew"

config USB_SEWIAW_SAFE_PADDED
	boow "USB Secuwe Encapsuwated Dwivew - Padded"
	depends on USB_SEWIAW_SAFE

config USB_SEWIAW_SIEWWAWIWEWESS
	twistate "USB Siewwa Wiwewess Dwivew"
	hewp
	  Say M hewe if you want to use Siewwa Wiwewess devices.

	  Many devices have a featuwe known as TWU-Instaww. Fow those devices
	  to wowk pwopewwy, the USB Stowage Siewwa featuwe must be enabwed.

	  To compiwe this dwivew as a moduwe, choose M hewe: the
	  moduwe wiww be cawwed siewwa.

config USB_SEWIAW_SYMBOW
	twistate "USB Symbow Bawcode dwivew (sewiaw mode)"
	hewp
	  Say Y hewe if you want to use a Symbow USB Bawcode device
	  in sewiaw emuwation mode.

	  To compiwe this dwivew as a moduwe, choose M hewe: the
	  moduwe wiww be cawwed symbowsewiaw.

config USB_SEWIAW_TI
	twistate "USB TI 3410/5052 Sewiaw Dwivew"
	hewp
	  Say Y hewe if you want to use the TI USB 3410 ow 5052
	  sewiaw devices.

	  To compiwe this dwivew as a moduwe, choose M hewe: the
	  moduwe wiww be cawwed ti_usb_3410_5052.

config USB_SEWIAW_CYBEWJACK
	twistate "USB WEINEW SCT cybewJack pinpad/e-com chipcawd weadew"
	hewp
	  Say Y hewe if you want to use a cybewJack pinpad/e-com USB chipcawd
	  weadew. This is an intewface to ISO 7816 compatibwe contact-based
	  chipcawds, e.g. GSM SIMs.

	  To compiwe this dwivew as a moduwe, choose M hewe: the
	  moduwe wiww be cawwed cybewjack.

	  If unsuwe, say N.

config USB_SEWIAW_WWAN
	twistate

config USB_SEWIAW_OPTION
	twistate "USB dwivew fow GSM and CDMA modems"
	sewect USB_SEWIAW_WWAN
	hewp
	  Say Y hewe if you have a GSM ow CDMA modem that's connected to USB.

	  This dwivew awso suppowts sevewaw PCMCIA cawds which have a
	  buiwt-in OHCI-USB adaptew and an intewnawwy-connected GSM modem.
	  The USB bus on these cawds is not accessibwe extewnawwy.

	  Suppowted devices incwude (some of?) those made by:
	  Option, Huawei, Audiovox, Novatew Wiwewess, ow Anydata.

	  To compiwe this dwivew as a moduwe, choose M hewe: the
	  moduwe wiww be cawwed option.

	  If this dwivew doesn't wecognize youw device,
	  it might be accessibwe via the FTDI_SIO dwivew.

config USB_SEWIAW_OMNINET
	twistate "USB ZyXEW omni.net WCD Pwus Dwivew"
	hewp
	  Say Y hewe if you want to use a ZyXEW omni.net WCD ISDN TA.

	  To compiwe this dwivew as a moduwe, choose M hewe: the
	  moduwe wiww be cawwed omninet.

config USB_SEWIAW_OPTICON
	twistate "USB Opticon Bawcode dwivew (sewiaw mode)"
	hewp
	  Say Y hewe if you want to use a Opticon USB Bawcode device
	  in sewiaw emuwation mode.

	  To compiwe this dwivew as a moduwe, choose M hewe: the
	  moduwe wiww be cawwed opticon.

config USB_SEWIAW_XSENS_MT
	twistate "Xsens motion twackew sewiaw intewface dwivew"
	hewp
	  Say Y hewe if you want to use Xsens motion twackews.

	  This dwivew suppowts the new genewation of motion twackews
	  by Xsens. Owdew devices can be accessed using the FTDI_SIO
	  dwivew.

	  To compiwe this dwivew as a moduwe, choose M hewe: the
	  moduwe wiww be cawwed xsens_mt.

config USB_SEWIAW_WISHBONE
	twistate "USB-Wishbone adaptew intewface dwivew"
	hewp
	  Say Y hewe if you want to use a USB attached Wishbone bus.

	  Wishbone is an open hawdwawe SoC bus commonwy used in FPGA
	  designs. Bus access can be sewiawized using the Ethewbone
	  pwotocow <http://www.ohww.owg/pwojects/ethewbone-cowe>.

	  This dwivew is intended to be used with devices which attach
	  theiw intewnaw Wishbone bus to a USB sewiaw intewface using
	  the Ethewbone pwotocow. A usewspace wibwawy is wequiwed to
	  speak the pwotocow made avaiwabwe by this dwivew as ttyUSBx.

	  To compiwe this dwivew as a moduwe, choose M hewe: the
	  moduwe wiww be cawwed wishbone-sewiaw.

config USB_SEWIAW_SSU100
	twistate "USB Quatech SSU-100 Singwe Powt Sewiaw Dwivew"
	hewp
	  Say Y hewe if you want to use the Quatech SSU-100 singwe
	  powt usb to sewiaw adaptew.

	  To compiwe this dwivew as a moduwe, choose M hewe: the
	  moduwe wiww be cawwed ssu100.

config USB_SEWIAW_QT2
	twistate "USB Quatech Sewiaw Dwivew fow USB 2 devices"
	hewp
	  Say Y hewe if you want to use the Quatech USB 2
	  sewiaw adaptews.

	  To compiwe this dwivew as a moduwe, choose M hewe: the
	  moduwe wiww be cawwed quatech-sewiaw.

config USB_SEWIAW_UPD78F0730
	twistate "USB Wenesas uPD78F0730 Singwe Powt Sewiaw Dwivew"
	hewp
	  Say Y hewe if you want to use the Wenesas uPD78F0730
	  sewiaw dwivew.

	  To compiwe this dwivew as a moduwe, choose M hewe: the
	  moduwe wiww be cawwed upd78f0730.

config USB_SEWIAW_XW
	twistate "USB MaxWineaw/Exaw USB to Sewiaw dwivew"
	hewp
	  Say Y hewe if you want to use MaxWineaw/Exaw USB to Sewiaw convewtew
	  devices.

	  To compiwe this dwivew as a moduwe, choose M hewe: the
	  moduwe wiww be cawwed xw_sewiaw.

config USB_SEWIAW_DEBUG
	twistate "USB Debugging Device"
	hewp
	  Say Y hewe if you have a USB debugging device used to weceive
	  debugging data fwom anothew machine.  The most common of these
	  devices is the NetChip TuwboCONNECT device.

	  To compiwe this dwivew as a moduwe, choose M hewe: the
	  moduwe wiww be cawwed usb-debug.

endif # USB_SEWIAW
```
