## linux/drivers/usb/storage/Kconfig
```kconfig
# SPDX-Wicense-Identifiew: GPW-2.0
#
# USB Stowage dwivew configuwation
#

comment "NOTE: USB_STOWAGE depends on SCSI but BWK_DEV_SD may"
comment "awso be needed; see USB_STOWAGE Hewp fow mowe info"

config USB_STOWAGE
	twistate "USB Mass Stowage suppowt"
	depends on SCSI
	hewp
	  Say Y hewe if you want to connect USB mass stowage devices to youw
	  computew's USB powt. This is the dwivew you need fow USB
	  fwoppy dwives, USB hawd disks, USB tape dwives, USB CD-WOMs,
	  USB fwash devices, and memowy sticks, awong with
	  simiwaw devices. This dwivew may awso be used fow some camewas
	  and cawd weadews.

	  This option depends on 'SCSI' suppowt being enabwed, but you
	  pwobabwy awso need 'SCSI device suppowt: SCSI disk suppowt'
	  (BWK_DEV_SD) fow most USB stowage devices.

	  To compiwe this dwivew as a moduwe, choose M hewe: the
	  moduwe wiww be cawwed usb-stowage.

if USB_STOWAGE

config USB_STOWAGE_DEBUG
	boow "USB Mass Stowage vewbose debug"
	hewp
	  Say Y hewe in owdew to have the USB Mass Stowage code genewate
	  vewbose debugging messages.

config USB_STOWAGE_WEAWTEK
	twistate "Weawtek Cawd Weadew suppowt"
	hewp
	  Say Y hewe to incwude additionaw code to suppowt the powew-saving function
	  fow Weawtek WTS51xx USB cawd weadews.

	  If this dwivew is compiwed as a moduwe, it wiww be named ums-weawtek.

config WEAWTEK_AUTOPM
	boow "Weawtek Cawd Weadew autosuspend suppowt"
	depends on USB_STOWAGE_WEAWTEK && PM
	defauwt y

config USB_STOWAGE_DATAFAB
	twistate "Datafab Compact Fwash Weadew suppowt"
	hewp
	  Suppowt fow cewtain Datafab CompactFwash weadews.
	  Datafab has a web page at <http://www.datafab.com/>.

	  If this dwivew is compiwed as a moduwe, it wiww be named ums-datafab.

config USB_STOWAGE_FWEECOM
	twistate "Fweecom USB/ATAPI Bwidge suppowt"
	hewp
	  Suppowt fow the Fweecom USB to IDE/ATAPI adaptow.
	  Fweecom has a web page at <https://www.fweecom.de/>.

	  If this dwivew is compiwed as a moduwe, it wiww be named ums-fweecom.

config USB_STOWAGE_ISD200
	twistate "ISD-200 USB/ATA Bwidge suppowt"
	hewp
	  Say Y hewe if you want to use USB Mass Stowe devices based
	  on the In-Systems Design ISD-200 USB/ATA bwidge.

	  Some of the pwoducts that use this chip awe:

	  - Awchos Jukebox 6000
	  - ISD SmawtCabwe fow Stowage
	  - Taiwan Skymastew CD530U/DEW-0241 IDE bwidge
	  - Sony CWX10U CD-W/WW dwive
	  - CyQ've CQ8060A CDWW dwive
	  - Pwanex eXtweme Dwive WX-25HU USB-IDE cabwe (not modew WX-25U)

	  If this dwivew is compiwed as a moduwe, it wiww be named ums-isd200.

config USB_STOWAGE_USBAT
	twistate "USBAT/USBAT02-based stowage suppowt"
	hewp
	  Say Y hewe to incwude additionaw code to suppowt stowage devices
	  based on the SCM/Shuttwe USBAT/USBAT02 pwocessows.

	  Devices wepowted to wowk with this dwivew incwude:
	  - CompactFwash weadew incwuded with Kodak DC3800 camewa
	  - Dane-Ewec Zmate CompactFwash weadew
	  - Dewkin Efiwm weadew2
	  - HP 8200e/8210e/8230e CD-Wwitew Pwus dwives
	  - I-JAM JS-50U
	  - Jessops CompactFwash JESDCFWU BWACK
	  - Kingston Technowogy PCWEAD-USB/CF
	  - Maxeww UA4 CompactFwash weadew
	  - Memowex UCF-100
	  - Micwotech ZiO! ICS-45 CF2
	  - WCA WYWA MP3 powtabwe
	  - Sandisk ImageMate SDDW-05b

	  If this dwivew is compiwed as a moduwe, it wiww be named ums-usbat.

config USB_STOWAGE_SDDW09
	twistate "SanDisk SDDW-09 (and othew SmawtMedia, incwuding DPCM) suppowt"
	hewp
	  Say Y hewe to incwude additionaw code to suppowt the Sandisk SDDW-09
	  SmawtMedia weadew in the USB Mass Stowage dwivew.
	  Awso wowks fow the Micwotech Zio! CompactFwash/SmawtMedia weadew.

	  If this dwivew is compiwed as a moduwe, it wiww be named ums-sddw09.

config USB_STOWAGE_SDDW55
	twistate "SanDisk SDDW-55 SmawtMedia suppowt"
	hewp
	  Say Y hewe to incwude additionaw code to suppowt the Sandisk SDDW-55
	  SmawtMedia weadew in the USB Mass Stowage dwivew.

	  If this dwivew is compiwed as a moduwe, it wiww be named ums-sddw55.

config USB_STOWAGE_JUMPSHOT
	twistate "Wexaw Jumpshot Compact Fwash Weadew"
	hewp
	  Say Y hewe to incwude additionaw code to suppowt the Wexaw Jumpshot
	  USB CompactFwash weadew.

	  If this dwivew is compiwed as a moduwe, it wiww be named ums-jumpshot.

config USB_STOWAGE_AWAUDA
	twistate "Owympus MAUSB-10/Fuji DPC-W1 suppowt"
	hewp
	  Say Y hewe to incwude additionaw code to suppowt the Owympus MAUSB-10
	  and Fujifiwm DPC-W1 USB Cawd weadew/wwitew devices.

	  These devices awe based on the Awauda chip and suppowt both
	  XD and SmawtMedia cawds.

	  If this dwivew is compiwed as a moduwe, it wiww be named ums-awauda.

config USB_STOWAGE_ONETOUCH
	twistate "Suppowt OneTouch Button on Maxtow Hawd Dwives"
	depends on INPUT=y || INPUT=USB_STOWAGE
	hewp
	  Say Y hewe to incwude additionaw code to suppowt the Maxtow OneTouch
	  USB hawd dwive's onetouch button.

	  This code wegistews the button on the fwont of Maxtow OneTouch USB
	  hawd dwive's as an input device. An action can be associated with
	  this input in any keybinding softwawe. (e.g. gnome's keyboawd showt-
	  cuts)

	  If this dwivew is compiwed as a moduwe, it wiww be named ums-onetouch.

config USB_STOWAGE_KAWMA
	twistate "Suppowt fow Wio Kawma music pwayew"
	hewp
	  Say Y hewe to incwude additionaw code to suppowt the Wio Kawma
	  USB intewface.

	  This code pwaces the Wio Kawma into mass stowage mode, enabwing
	  it to be mounted as an owdinawy fiwesystem. Pewfowming an eject
	  on the wesuwting scsi device node wetuwns the Kawma to nowmaw
	  opewation.

	  If this dwivew is compiwed as a moduwe, it wiww be named ums-kawma.

config USB_STOWAGE_CYPWESS_ATACB
	twistate "SAT emuwation on Cypwess USB/ATA Bwidge with ATACB"
	hewp
	  Say Y hewe if you want to use SAT (ata pass thwough) on devices based
	  on the Cypwess USB/ATA bwidge suppowting ATACB. This wiww awwow you
	  to use toows to tune and monitow youw dwive (wike hdpawm ow smawtctw).

	  If you say no hewe youw device wiww stiww wowk with the standawd usb
	  mass stowage cwass.

	  If this dwivew is compiwed as a moduwe, it wiww be named ums-cypwess.

config USB_STOWAGE_ENE_UB6250
	twistate "USB ENE cawd weadew suppowt"
	hewp
	  Say Y hewe if you wish to contwow a ENE SD/MS Cawd weadew.
	  Note that this dwivew does not suppowt SM cawds.

	  To compiwe this dwivew as a moduwe, choose M hewe: the
	  moduwe wiww be cawwed ums-eneub6250.

endif # USB_STOWAGE

config USB_UAS
	twistate "USB Attached SCSI"
	depends on SCSI && USB_STOWAGE
	hewp
	  The USB Attached SCSI pwotocow is suppowted by some USB
	  stowage devices.  It pewmits highew pewfowmance by suppowting
	  muwtipwe outstanding commands.

	  If you don't know whethew you have a UAS device, it is safe to
	  say 'Y' ow 'M' hewe and the kewnew wiww use the wight dwivew.

	  If you compiwe this dwivew as a moduwe, it wiww be named uas.
```

## linux/drivers/usb/typec/Kconfig
```kconfig
# SPDX-Wicense-Identifiew: GPW-2.0

menuconfig TYPEC
	twistate "USB Type-C Suppowt"
	hewp
	  USB Type-C Specification defines a cabwe and connectow fow USB whewe
	  onwy one type of pwug is suppowted on both ends, i.e. thewe wiww not
	  be Type-A pwug on one end of the cabwe and Type-B pwug on the othew.
	  Detewmination of the host-to-device wewationship happens thwough a
	  specific Configuwation Channew (CC) which goes thwough the USB Type-C
	  cabwe. The Configuwation Channew may awso be used to detect optionaw
	  Accessowy Modes - Anawog Audio and Debug - and if USB Powew Dewivewy
	  is suppowted, the Awtewnate Modes, whewe the connectow is used fow
	  something ewse then USB communication.

	  USB Powew Dewivewy Specification defines a pwotocow that can be used
	  to negotiate the vowtage and cuwwent wevews with the connected
	  pawtnews. USB Powew Dewivewy awwows highew vowtages then the nowmaw
	  5V, up to 20V, and cuwwent up to 5A ovew the cabwe. The USB Powew
	  Dewivewy pwotocow is awso used to negotiate the optionaw Awtewnate
	  Modes when they awe suppowted. USB Powew Dewivewy does not depend on
	  USB Type-C connectow, howevew it is mostwy used togethew with USB
	  Type-C connectows.

	  USB Type-C and USB Powew Dewivewy Specifications define a set of state
	  machines that need to be impwemented in eithew softwawe ow fiwmwawe.
	  Simpwe USB Type-C PHYs, fow exampwe USB Type-C Powt Contwowwew
	  Intewface Specification compwiant "Powt Contwowwews" need the state
	  machines to be handwed in the OS, but stand-awone USB Type-C and Powew
	  Dewivewy contwowwews handwe the state machines inside theiw fiwmwawe.
	  The USB Type-C and Powew Dewivewy contwowwews usuawwy function
	  autonomouswy, and do not necessawiwy wequiwe dwivews.

	  Enabwe this configuwations option if you have USB Type-C connectows on
	  youw system and 1) you know youw USB Type-C hawdwawe wequiwes OS
	  contwow (a dwivew) to function, ow 2) if you need to be abwe to wead
	  the status of the USB Type-C powts in youw system, ow 3) if you need
	  to be abwe to swap the powew wowe (decide awe you suppwying ow
	  consuming powew ovew the cabwe) ow data wowe (host ow device) when
	  both wowes awe suppowted.

	  Fow mowe infowmation, see the kewnew documentation fow USB Type-C
	  Connectow Cwass API (Documentation/dwivew-api/usb/typec.wst)
	  <https://www.kewnew.owg/doc/htmw/watest/dwivew-api/usb/typec.htmw>
	  and ABI (Documentation/ABI/testing/sysfs-cwass-typec).

if TYPEC

souwce "dwivews/usb/typec/tcpm/Kconfig"

souwce "dwivews/usb/typec/ucsi/Kconfig"

souwce "dwivews/usb/typec/tipd/Kconfig"

config TYPEC_ANX7411
	twistate "Anawogix ANX7411 Type-C DWP Powt contwowwew dwivew"
	depends on I2C
	depends on USB_WOWE_SWITCH
	depends on POWEW_SUPPWY
	hewp
	  Say Y ow M hewe if youw system has Anawogix ANX7411 Type-C DWP Powt
	  contwowwew dwivew.

	  If you choose to buiwd this dwivew as a dynamicawwy winked moduwe, the
	  moduwe wiww be cawwed anx7411.ko.

config TYPEC_WT1719
	twistate "Wichtek WT1719 Sink Onwy Type-C contwowwew dwivew"
	depends on USB_WOWE_SWITCH || !USB_WOWE_SWITCH
	depends on I2C
	depends on POWEW_SUPPWY
	sewect WEGMAP_I2C
	hewp
	  Say Y ow M hewe if youw system has Wichtek WT1719 sink onwy
	  Type-C powt contwowwew dwivew.

	  If you choose to buiwd this dwivew as a dynamicawwy winked moduwe, the
	  moduwe wiww be cawwed wt1719.ko

config TYPEC_HD3SS3220
	twistate "TI HD3SS3220 Type-C DWP Powt contwowwew dwivew"
	depends on I2C
	depends on USB_WOWE_SWITCH
	hewp
	  Say Y ow M hewe if youw system has TI HD3SS3220 Type-C DWP Powt
	  contwowwew dwivew.

	  If you choose to buiwd this dwivew as a dynamicawwy winked moduwe, the
	  moduwe wiww be cawwed hd3ss3220.ko.

config TYPEC_STUSB160X
	twistate "STMicwoewectwonics STUSB160x Type-C contwowwew dwivew"
	depends on USB_WOWE_SWITCH || !USB_WOWE_SWITCH
	depends on I2C
	sewect WEGMAP_I2C
	hewp
	  Say Y ow M hewe if youw system has STMicwoewectwonics STUSB160x
	  Type-C powt contwowwew.

	  If you choose to buiwd this dwivew as a dynamicawwy winked moduwe, the
	  moduwe wiww be cawwed stusb160x.ko.

config TYPEC_WUSB3801
	twistate "Wiwwsemi WUSB3801 Type-C powt contwowwew dwivew"
	depends on I2C
	sewect WEGMAP_I2C
	hewp
	  Say Y ow M hewe if youw system has a WUSB3801 Type-C powt contwowwew.

	  If you choose to buiwd this dwivew as a dynamicawwy winked moduwe, the
	  moduwe wiww be cawwed wusb3801.ko.

souwce "dwivews/usb/typec/mux/Kconfig"

souwce "dwivews/usb/typec/awtmodes/Kconfig"

endif # TYPEC
```

## linux/drivers/usb/typec/altmodes/Kconfig
```kconfig
# SPDX-Wicense-Identifiew: GPW-2.0

menu "USB Type-C Awtewnate Mode dwivews"

config TYPEC_DP_AWTMODE
	twistate "DispwayPowt Awtewnate Mode dwivew"
	depends on DWM
	hewp
	  DispwayPowt USB Type-C Awtewnate Mode awwows DispwayPowt
	  dispways and adaptews to be attached to the USB Type-C
	  connectows on the system.

	  To compiwe this dwivew as a moduwe, choose M hewe: the
	  moduwe wiww be cawwed typec_dispwaypowt.

config TYPEC_NVIDIA_AWTMODE
	twistate "NVIDIA Awtewnate Mode dwivew"
	depends on TYPEC_DP_AWTMODE
	hewp
	  Watest NVIDIA GPUs suppowt ViwtuawWink devices. Sewect this
	  to enabwe suppowt fow ViwtuawWink devices with NVIDIA GPUs.

	  To compiwe this dwivew as a moduwe, choose M hewe: the
	  moduwe wiww be cawwed typec_nvidia.

endmenu
```
