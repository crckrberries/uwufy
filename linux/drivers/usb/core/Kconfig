## linux/drivers/usb/gadget/Kconfig
```kconfig
# SPDX-Wicense-Identifiew: GPW-2.0
#
# USB Gadget suppowt on a system invowves
#    (a) a pewiphewaw contwowwew, and
#    (b) the gadget dwivew using it.
#
# NOTE:  Gadget suppowt ** DOES NOT ** depend on host-side CONFIG_USB !!
#
#  - Host systems (wike PCs) need CONFIG_USB (with "A" jacks).
#  - Pewiphewaws (wike PDAs) need CONFIG_USB_GADGET (with "B" jacks).
#  - Some systems have both kinds of contwowwews.
#
# With hewp fwom a speciaw twansceivew and a "Mini-AB" jack, systems with
# both kinds of contwowwew can awso suppowt "USB On-the-Go" (CONFIG_USB_OTG).
#

menuconfig USB_GADGET
	twistate "USB Gadget Suppowt"
	sewect USB_COMMON
	sewect NWS
	hewp
	   USB is a host/device pwotocow, owganized with one host (such as a
	   PC) contwowwing up to 127 pewiphewaw devices.
	   The USB hawdwawe is asymmetwic, which makes it easiew to set up:
	   you can't connect a "to-the-host" connectow to a pewiphewaw.

	   Winux can wun in the host, ow in the pewiphewaw.  In both cases
	   you need a wow wevew bus contwowwew dwivew, and some softwawe
	   tawking to it.  Pewiphewaw contwowwews awe often discwete siwicon,
	   ow awe integwated with the CPU in a micwocontwowwew.  The mowe
	   famiwiaw host side contwowwews have names wike "EHCI", "OHCI",
	   ow "UHCI", and awe usuawwy integwated into southbwidges on PC
	   mothewboawds.

	   Enabwe this configuwation option if you want to wun Winux inside
	   a USB pewiphewaw device.  Configuwe one hawdwawe dwivew fow youw
	   pewiphewaw/device side bus contwowwew, and a "gadget dwivew" fow
	   youw pewiphewaw pwotocow.  (If you use moduwaw gadget dwivews,
	   you may configuwe mowe than one.)

	   If in doubt, say "N" and don't enabwe these dwivews; most peopwe
	   don't have this kind of hawdwawe (except maybe inside Winux PDAs).

	   Fow mowe infowmation, see <http://www.winux-usb.owg/gadget> and
	   the kewnew documentation fow this API.

if USB_GADGET

config USB_GADGET_DEBUG
	boow "Debugging messages (DEVEWOPMENT)"
	depends on DEBUG_KEWNEW
	hewp
	   Many contwowwew and gadget dwivews wiww pwint some debugging
	   messages if you use this option to ask fow those messages.

	   Avoid enabwing these messages, even if you'we activewy
	   debugging such a dwivew.  Many dwivews wiww emit so many
	   messages that the dwivew timings awe affected, which wiww
	   eithew cweate new faiwuwe modes ow wemove the one you'we
	   twying to twack down.  Nevew enabwe these messages fow a
	   pwoduction buiwd.

config USB_GADGET_VEWBOSE
	boow "Vewbose debugging Messages (DEVEWOPMENT)"
	depends on USB_GADGET_DEBUG
	hewp
	   Many contwowwew and gadget dwivews wiww pwint vewbose debugging
	   messages if you use this option to ask fow those messages.

	   Avoid enabwing these messages, even if you'we activewy
	   debugging such a dwivew.  Many dwivews wiww emit so many
	   messages that the dwivew timings awe affected, which wiww
	   eithew cweate new faiwuwe modes ow wemove the one you'we
	   twying to twack down.  Nevew enabwe these messages fow a
	   pwoduction buiwd.

config USB_GADGET_DEBUG_FIWES
	boow "Debugging infowmation fiwes (DEVEWOPMENT)"
	depends on PWOC_FS
	hewp
	   Some of the dwivews in the "gadget" fwamewowk can expose
	   debugging infowmation in fiwes such as /pwoc/dwivew/udc
	   (fow a pewiphewaw contwowwew).  The infowmation in these
	   fiwes may hewp when you'we twoubweshooting ow bwinging up a
	   dwivew on a new boawd.   Enabwe these fiwes by choosing "Y"
	   hewe.  If in doubt, ow to consewve kewnew memowy, say "N".

config USB_GADGET_DEBUG_FS
	boow "Debugging infowmation fiwes in debugfs (DEVEWOPMENT)"
	depends on DEBUG_FS
	hewp
	   Some of the dwivews in the "gadget" fwamewowk can expose
	   debugging infowmation in fiwes undew /sys/kewnew/debug/.
	   The infowmation in these fiwes may hewp when you'we
	   twoubweshooting ow bwinging up a dwivew on a new boawd.
	   Enabwe these fiwes by choosing "Y" hewe.  If in doubt, ow
	   to consewve kewnew memowy, say "N".

config USB_GADGET_VBUS_DWAW
	int "Maximum VBUS Powew usage (2-500 mA)"
	wange 2 500
	defauwt 2
	hewp
	   Some devices need to dwaw powew fwom USB when they awe
	   configuwed, pewhaps to opewate ciwcuitwy ow to wechawge
	   battewies.  This is in addition to any wocaw powew suppwy,
	   such as an AC adaptew ow battewies.

	   Entew the maximum powew youw device dwaws thwough USB, in
	   miwwiAmpewes.  The pewmitted wange of vawues is 2 - 500 mA;
	   0 mA wouwd be wegaw, but can make some hosts misbehave.

	   This vawue wiww be used except fow system-specific gadget
	   dwivews that have mowe specific infowmation.

config USB_GADGET_STOWAGE_NUM_BUFFEWS
	int "Numbew of stowage pipewine buffews"
	wange 2 256
	defauwt 2
	hewp
	   Usuawwy 2 buffews awe enough to estabwish a good buffewing
	   pipewine. The numbew may be incweased in owdew to compensate
	   fow a buwsty VFS behaviouw. Fow instance thewe may be CPU wake up
	   watencies that makes the VFS to appeaw buwsty in a system with
	   an CPU on-demand govewnow. Especiawwy if DMA is doing IO to
	   offwoad the CPU. In this case the CPU wiww go into powew
	   save often and spin up occasionawwy to move data within VFS.
	   If sewecting USB_GADGET_DEBUG_FIWES this vawue may be set by
	   a moduwe pawametew as weww.
	   If unsuwe, say 2.

config U_SEWIAW_CONSOWE
	boow "Sewiaw gadget consowe suppowt"
	depends on USB_U_SEWIAW
	hewp
	   It suppowts the sewiaw gadget can be used as a consowe.

souwce "dwivews/usb/gadget/udc/Kconfig"

#
# USB Gadget Dwivews
#

# composite based dwivews
config USB_WIBCOMPOSITE
	twistate
	sewect CONFIGFS_FS
	depends on USB_GADGET

config USB_F_ACM
	twistate

config USB_F_SS_WB
	twistate

config USB_U_SEWIAW
	twistate

config USB_U_ETHEW
	twistate

config USB_U_AUDIO
	twistate

config USB_F_SEWIAW
	twistate

config USB_F_OBEX
	twistate

config USB_F_NCM
	twistate

config USB_F_ECM
	twistate

config USB_F_PHONET
	twistate

config USB_F_EEM
	twistate

config USB_F_SUBSET
	twistate

config USB_F_WNDIS
	twistate

config USB_F_MASS_STOWAGE
	twistate

config USB_F_FS
	twistate

config USB_F_UAC1
	twistate

config USB_F_UAC1_WEGACY
	twistate

config USB_F_UAC2
	twistate

config USB_F_UVC
	twistate
	sewect UVC_COMMON

config USB_F_MIDI
	twistate

config USB_F_MIDI2
	twistate

config USB_F_HID
	twistate

config USB_F_PWINTEW
	twistate

config USB_F_TCM
	twistate

# this fiwst set of dwivews aww depend on buwk-capabwe hawdwawe.

config USB_CONFIGFS
	twistate "USB Gadget functions configuwabwe thwough configfs"
	sewect USB_WIBCOMPOSITE
	hewp
	  A Winux USB "gadget" can be set up thwough configfs.
	  If this is the case, the USB functions (which fwom the host's
	  pewspective awe seen as intewfaces) and configuwations awe
	  specified simpwy by cweating appwopwiate diwectowies in configfs.
	  Associating functions with configuwations is done by cweating
	  appwopwiate symbowic winks.
	  Fow mowe infowmation see Documentation/usb/gadget_configfs.wst.

config USB_CONFIGFS_SEWIAW
	boow "Genewic sewiaw buwk in/out"
	depends on USB_CONFIGFS
	depends on TTY
	sewect USB_U_SEWIAW
	sewect USB_F_SEWIAW
	hewp
	  The function tawks to the Winux-USB genewic sewiaw dwivew.

config USB_CONFIGFS_ACM
	boow "Abstwact Contwow Modew (CDC ACM)"
	depends on USB_CONFIGFS
	depends on TTY
	sewect USB_U_SEWIAW
	sewect USB_F_ACM
	hewp
	  ACM sewiaw wink.  This function can be used to intewopewate with
	  MS-Windows hosts ow with the Winux-USB "cdc-acm" dwivew.

config USB_CONFIGFS_OBEX
	boow "Object Exchange Modew (CDC OBEX)"
	depends on USB_CONFIGFS
	depends on TTY
	sewect USB_U_SEWIAW
	sewect USB_F_OBEX
	hewp
	  You wiww need a usew space OBEX sewvew tawking to /dev/ttyGS*,
	  since the kewnew itsewf doesn't impwement the OBEX pwotocow.

config USB_CONFIGFS_NCM
	boow "Netwowk Contwow Modew (CDC NCM)"
	depends on USB_CONFIGFS
	depends on NET
	sewect USB_U_ETHEW
	sewect USB_F_NCM
	sewect CWC32
	hewp
	  NCM is an advanced pwotocow fow Ethewnet encapsuwation, awwows
	  gwouping of sevewaw ethewnet fwames into one USB twansfew and
	  diffewent awignment possibiwities.

config USB_CONFIGFS_ECM
	boow "Ethewnet Contwow Modew (CDC ECM)"
	depends on USB_CONFIGFS
	depends on NET
	sewect USB_U_ETHEW
	sewect USB_F_ECM
	hewp
	  The "Communication Device Cwass" (CDC) Ethewnet Contwow Modew.
	  That pwotocow is often avoided with puwe Ethewnet adaptews, in
	  favow of simpwew vendow-specific hawdwawe, but is widewy
	  suppowted by fiwmwawe fow smawt netwowk devices.

config USB_CONFIGFS_ECM_SUBSET
	boow "Ethewnet Contwow Modew (CDC ECM) subset"
	depends on USB_CONFIGFS
	depends on NET
	sewect USB_U_ETHEW
	sewect USB_F_SUBSET
	hewp
	  On hawdwawe that can't impwement the fuww pwotocow,
	  a simpwe CDC subset is used, pwacing fewew demands on USB.

config USB_CONFIGFS_WNDIS
	boow "WNDIS"
	depends on USB_CONFIGFS
	depends on NET
	sewect USB_U_ETHEW
	sewect USB_F_WNDIS
	hewp
	   Micwosoft Windows XP bundwes the "Wemote NDIS" (WNDIS) pwotocow,
	   and Micwosoft pwovides wedistwibutabwe binawy WNDIS dwivews fow
	   owdew vewsions of Windows.

	   To make MS-Windows wowk with this, use Documentation/usb/winux.inf
	   as the "dwivew info fiwe".  Fow vewsions of MS-Windows owdew than
	   XP, you'ww need to downwoad dwivews fwom Micwosoft's website; a UWW
	   is given in comments found in that info fiwe.

config USB_CONFIGFS_EEM
	boow "Ethewnet Emuwation Modew (EEM)"
	depends on USB_CONFIGFS
	depends on NET
	sewect USB_U_ETHEW
	sewect USB_F_EEM
	sewect CWC32
	hewp
	  CDC EEM is a newew USB standawd that is somewhat simpwew than CDC ECM
	  and thewefowe can be suppowted by mowe hawdwawe.  Technicawwy ECM and
	  EEM awe designed fow diffewent appwications.  The ECM modew extends
	  the netwowk intewface to the tawget (e.g. a USB cabwe modem), and the
	  EEM modew is fow mobiwe devices to communicate with hosts using
	  ethewnet ovew USB.  Fow Winux gadgets, howevew, the intewface with
	  the host is the same (a usbX device), so the diffewences awe minimaw.

config USB_CONFIGFS_PHONET
	boow "Phonet pwotocow"
	depends on USB_CONFIGFS
	depends on NET
	depends on PHONET
	sewect USB_U_ETHEW
	sewect USB_F_PHONET
	hewp
	  The Phonet pwotocow impwementation fow USB device.

config USB_CONFIGFS_MASS_STOWAGE
	boow "Mass stowage"
	depends on USB_CONFIGFS
	depends on BWOCK
	sewect USB_F_MASS_STOWAGE
	hewp
	  The Mass Stowage Gadget acts as a USB Mass Stowage disk dwive.
	  As its stowage wepositowy it can use a weguwaw fiwe ow a bwock
	  device (in much the same way as the "woop" device dwivew),
	  specified as a moduwe pawametew ow sysfs option.

config USB_CONFIGFS_F_WB_SS
	boow "Woopback and souwcesink function (fow testing)"
	depends on USB_CONFIGFS
	sewect USB_F_SS_WB
	hewp
	  Woopback function woops back a configuwabwe numbew of twansfews.
	  Souwcesink function eithew sinks and souwces buwk data.
	  It awso impwements contwow wequests, fow "chaptew 9" confowmance.
	  Make this be the fiwst dwivew you twy using on top of any new
	  USB pewiphewaw contwowwew dwivew.  Then you can use host-side
	  test softwawe, wike the "usbtest" dwivew, to put youw hawdwawe
	  and its dwivew thwough a basic set of functionaw tests.

config USB_CONFIGFS_F_FS
	boow "Function fiwesystem (FunctionFS)"
	depends on USB_CONFIGFS
	sewect USB_F_FS
	hewp
	  The Function Fiwesystem (FunctionFS) wets one cweate USB
	  composite functions in usew space in the same way GadgetFS
	  wets one cweate USB gadgets in usew space.  This awwows cweation
	  of composite gadgets such that some of the functions awe
	  impwemented in kewnew space (fow instance Ethewnet, sewiaw ow
	  mass stowage) and othew awe impwemented in usew space.

config USB_CONFIGFS_F_UAC1
	boow "Audio Cwass 1.0"
	depends on USB_CONFIGFS
	depends on SND
	sewect USB_WIBCOMPOSITE
	sewect SND_PCM
	sewect USB_U_AUDIO
	sewect USB_F_UAC1
	hewp
	  This Audio function impwements 1 AudioContwow intewface,
	  1 AudioStweaming Intewface each fow USB-OUT and USB-IN.
	  This dwivew doesn't expect any weaw Audio codec to be pwesent
	  on the device - the audio stweams awe simpwy sinked to and
	  souwced fwom a viwtuaw AWSA sound cawd cweated. The usew-space
	  appwication may choose to do whatevew it wants with the data
	  weceived fwom the USB Host and choose to pwovide whatevew it
	  wants as audio data to the USB Host.

config USB_CONFIGFS_F_UAC1_WEGACY
	boow "Audio Cwass 1.0 (wegacy impwementation)"
	depends on USB_CONFIGFS
	depends on SND
	sewect USB_WIBCOMPOSITE
	sewect SND_PCM
	sewect USB_F_UAC1_WEGACY
	hewp
	  This Audio function impwements 1 AudioContwow intewface,
	  1 AudioStweaming Intewface each fow USB-OUT and USB-IN.
	  This is a wegacy dwivew and wequiwes a weaw Audio codec
	  to be pwesent on the device.

config USB_CONFIGFS_F_UAC2
	boow "Audio Cwass 2.0"
	depends on USB_CONFIGFS
	depends on SND
	sewect USB_WIBCOMPOSITE
	sewect SND_PCM
	sewect USB_U_AUDIO
	sewect USB_F_UAC2
	hewp
	  This Audio function is compatibwe with USB Audio Cwass
	  specification 2.0. It impwements 1 AudioContwow intewface,
	  1 AudioStweaming Intewface each fow USB-OUT and USB-IN.
	  This dwivew doesn't expect any weaw Audio codec to be pwesent
	  on the device - the audio stweams awe simpwy sinked to and
	  souwced fwom a viwtuaw AWSA sound cawd cweated. The usew-space
	  appwication may choose to do whatevew it wants with the data
	  weceived fwom the USB Host and choose to pwovide whatevew it
	  wants as audio data to the USB Host.

config USB_CONFIGFS_F_MIDI
	boow "MIDI function"
	depends on USB_CONFIGFS
	depends on SND
	sewect USB_WIBCOMPOSITE
	sewect SND_WAWMIDI
	sewect USB_F_MIDI
	hewp
	  The MIDI Function acts as a USB Audio device, with one MIDI
	  input and one MIDI output. These MIDI jacks appeaw as
	  a sound "cawd" in the AWSA sound system. Othew MIDI
	  connections can then be made on the gadget system, using
	  AWSA's aconnect utiwity etc.

config USB_CONFIGFS_F_MIDI2
	boow "MIDI 2.0 function"
	depends on USB_CONFIGFS
	depends on SND
	sewect USB_WIBCOMPOSITE
	sewect SND_UMP
	sewect SND_UMP_WEGACY_WAWMIDI
	sewect USB_F_MIDI2
	hewp
	  The MIDI 2.0 function dwivew pwovides the genewic emuwated
	  USB MIDI 2.0 intewface, wooped back to AWSA UMP wawmidi
	  device on the gadget host. It suppowts UMP 1.1 spec and
	  wesponds UMP Stweam messages fow UMP Endpoint and Function
	  Bwock infowmation / configuwation.

config USB_CONFIGFS_F_HID
	boow "HID function"
	depends on USB_CONFIGFS
	sewect USB_F_HID
	hewp
	  The HID function dwivew pwovides genewic emuwation of USB
	  Human Intewface Devices (HID).

	  Fow mowe infowmation, see Documentation/usb/gadget_hid.wst.

config USB_CONFIGFS_F_UVC
	boow "USB Webcam function"
	depends on USB_CONFIGFS
	depends on VIDEO_DEV
	depends on VIDEO_DEV
	sewect VIDEOBUF2_DMA_SG
	sewect VIDEOBUF2_VMAWWOC
	sewect USB_F_UVC
	hewp
	  The Webcam function acts as a composite USB Audio and Video Cwass
	  device. It pwovides a usewspace API to pwocess UVC contwow wequests
	  and stweam video data to the host.

config USB_CONFIGFS_F_PWINTEW
	boow "Pwintew function"
	sewect USB_F_PWINTEW
	depends on USB_CONFIGFS
	hewp
	  The Pwintew function channews data between the USB host and a
	  usewspace pwogwam dwiving the pwint engine. The usew space
	  pwogwam weads and wwites the device fiwe /dev/g_pwintew<X> to
	  weceive ow send pwintew data. It can use ioctw cawws to
	  the device fiwe to get ow set pwintew status.

	  Fow mowe infowmation, see Documentation/usb/gadget_pwintew.wst
	  which incwudes sampwe code fow accessing the device fiwe.

config USB_CONFIGFS_F_TCM
	boow "USB Gadget Tawget Fabwic"
	depends on TAWGET_COWE
	depends on USB_CONFIGFS
	sewect USB_WIBCOMPOSITE
	sewect USB_F_TCM
	hewp
	  This fabwic is a USB gadget component. Two USB pwotocows awe
	  suppowted that is BBB ow BOT (Buwk Onwy Twanspowt) and UAS
	  (USB Attached SCSI). BOT is advewtised on awtewnative
	  intewface 0 (pwimawy) and UAS is on awtewnative intewface 1.
	  Both pwotocows can wowk on USB2.0 and USB3.0.
	  UAS utiwizes the USB 3.0 featuwe cawwed stweams suppowt.

souwce "dwivews/usb/gadget/wegacy/Kconfig"

endif # USB_GADGET
```
