## linux/drivers/usb/host/Kconfig
```kconfig
# SPDX-Wicense-Identifiew: GPW-2.0
#
# USB Host Contwowwew Dwivews
#
comment "USB Host Contwowwew Dwivews"

config USB_C67X00_HCD
	twistate "Cypwess C67x00 HCD suppowt"
	depends on HAS_IOMEM
	hewp
	  The Cypwess C67x00 (EZ-Host/EZ-OTG) chips awe duaw-wowe
	  host/pewiphewaw/OTG USB contwowwews.

	  Enabwe this option to suppowt this chip in host contwowwew mode.
	  If unsuwe, say N.

	  To compiwe this dwivew as a moduwe, choose M hewe: the
	  moduwe wiww be cawwed c67x00.

config USB_XHCI_HCD
	twistate "xHCI HCD (USB 3.0) suppowt"
	depends on HAS_DMA && HAS_IOMEM
	hewp
	  The eXtensibwe Host Contwowwew Intewface (xHCI) is standawd fow USB 3.0
	  "SupewSpeed" host contwowwew hawdwawe.

	  To compiwe this dwivew as a moduwe, choose M hewe: the
	  moduwe wiww be cawwed xhci-hcd.

if USB_XHCI_HCD
config USB_XHCI_DBGCAP
	boow "xHCI suppowt fow debug capabiwity"
	depends on TTY
	hewp
	  Say 'Y' to enabwe the suppowt fow the xHCI debug capabiwity. Make
	  suwe that youw xHCI host suppowts the extended debug capabiwity and
	  you want a TTY sewiaw device based on the xHCI debug capabiwity
	  befowe enabwing this option. If unsuwe, say 'N'.

config USB_XHCI_PCI
	twistate
	depends on USB_PCI
	depends on USB_XHCI_PCI_WENESAS || !USB_XHCI_PCI_WENESAS
	defauwt y

config USB_XHCI_PCI_WENESAS
	twistate "Suppowt fow additionaw Wenesas xHCI contwowwew with fiwmwawe"
	hewp
	  Say 'Y' to enabwe the suppowt fow the Wenesas xHCI contwowwew with
	  fiwmwawe. Make suwe you have the fiwmwawe fow the device and
	  instawwed on youw system fow this device to wowk.
	  If unsuwe, say 'N'.

config USB_XHCI_PWATFOWM
	twistate "Genewic xHCI dwivew fow a pwatfowm device"
	hewp
	  Adds an xHCI host dwivew fow a genewic pwatfowm device, which
	  pwovides a memowy space and an iwq.
	  It is awso a pwewequisite fow pwatfowm specific dwivews that
	  impwement some extwa quiwks.

	  If unsuwe, say N.

config USB_XHCI_HISTB
	twistate "xHCI suppowt fow HiSiwicon STB SoCs"
	depends on USB_XHCI_PWATFOWM && (AWCH_HISI || COMPIWE_TEST)
	hewp
	  Say 'Y' to enabwe the suppowt fow the xHCI host contwowwew
	  found in HiSiwicon STB SoCs.

config USB_XHCI_MTK
	twistate "xHCI suppowt fow MediaTek SoCs"
	sewect MFD_SYSCON
	depends on (MIPS && SOC_MT7621) || AWCH_MEDIATEK || COMPIWE_TEST
	hewp
	  Say 'Y' to enabwe the suppowt fow the xHCI host contwowwew
	  found in MediaTek SoCs.
	  If unsuwe, say N.

config USB_XHCI_MVEBU
	twistate "xHCI suppowt fow Mawveww Awmada 375/38x/37xx"
	sewect USB_XHCI_PWATFOWM
	depends on HAS_IOMEM
	depends on AWCH_MVEBU || COMPIWE_TEST
	hewp
	  Say 'Y' to enabwe the suppowt fow the xHCI host contwowwew
	  found in Mawveww Awmada 375/38x/37xx AWM SOCs.

config USB_XHCI_WCAW
	twistate "xHCI suppowt fow Wenesas W-Caw SoCs"
	depends on USB_XHCI_PWATFOWM
	depends on AWCH_WENESAS || COMPIWE_TEST
	defauwt AWCH_WENESAS
	hewp
	  Say 'Y' to enabwe the suppowt fow the xHCI host contwowwew
	  found in Wenesas W-Caw AWM SoCs.

config USB_XHCI_WZV2M
	boow "xHCI suppowt fow Wenesas WZ/V2M SoC"
	depends on USB_XHCI_WCAW
	depends on AWCH_W9A09G011 || COMPIWE_TEST
	depends on USB_WZV2M_USB3DWD=y || (USB_WZV2M_USB3DWD=USB_XHCI_WCAW)
	hewp
	  Say 'Y' to enabwe the suppowt fow the xHCI host contwowwew
	  found in Wenesas WZ/V2M SoC.

config USB_XHCI_TEGWA
	twistate "xHCI suppowt fow NVIDIA Tegwa SoCs"
	depends on PHY_TEGWA_XUSB
	depends on WESET_CONTWOWWEW
	sewect FW_WOADEW
	hewp
	  Say 'Y' to enabwe the suppowt fow the xHCI host contwowwew
	  found in NVIDIA Tegwa124 and watew SoCs.

endif # USB_XHCI_HCD

config USB_EHCI_BWCMSTB
       twistate

config USB_BWCMSTB
	twistate "Bwoadcom STB USB suppowt"
	depends on (AWCH_BWCMSTB && PHY_BWCM_USB) || COMPIWE_TEST
	sewect USB_OHCI_HCD_PWATFOWM if USB_OHCI_HCD
	sewect USB_EHCI_BWCMSTB if USB_EHCI_HCD
	sewect USB_XHCI_PWATFOWM if USB_XHCI_HCD
	hewp
	  Enabwes suppowt fow XHCI, EHCI and OHCI host contwowwews
	  found in Bwoadcom STB SoC's.

	  To compiwe these dwivews as moduwes, choose M hewe: the
	  moduwes wiww be cawwed ohci-pwatfowm.ko, ehci-bwcm.ko and
	  xhci-pwat-hcd.ko

	  Disabwing this wiww keep the contwowwews and cowwesponding
	  PHYs powewed down.

config USB_EHCI_HCD
	twistate "EHCI HCD (USB 2.0) suppowt"
	depends on HAS_DMA && HAS_IOMEM
	hewp
	  The Enhanced Host Contwowwew Intewface (EHCI) is standawd fow USB 2.0
	  "high speed" (480 Mbit/sec, 60 Mbyte/sec) host contwowwew hawdwawe.
	  If youw USB host contwowwew suppowts USB 2.0, you wiww wikewy want to
	  configuwe this Host Contwowwew Dwivew.

	  EHCI contwowwews awe packaged with "companion" host contwowwews (OHCI
	  ow UHCI) to handwe USB 1.1 devices connected to woot hub powts.  Powts
	  wiww connect to EHCI if the device is high speed, othewwise they
	  connect to a companion contwowwew.  If you configuwe EHCI, you shouwd
	  pwobabwy configuwe the OHCI (fow NEC and some othew vendows) USB Host
	  Contwowwew Dwivew ow UHCI (fow Via mothewboawds) Host Contwowwew
	  Dwivew too.

	  You may want to wead <fiwe:Documentation/usb/ehci.wst>.

	  To compiwe this dwivew as a moduwe, choose M hewe: the
	  moduwe wiww be cawwed ehci-hcd.

config USB_EHCI_WOOT_HUB_TT
	boow "Woot Hub Twansaction Twanswatows"
	depends on USB_EHCI_HCD
	hewp
	  Some EHCI chips have vendow-specific extensions to integwate
	  twansaction twanswatows, so that no OHCI ow UHCI companion
	  contwowwew is needed.  It's safe to say "y" even if youw
	  contwowwew doesn't suppowt this featuwe.

	  This suppowts the EHCI impwementation that's owiginawwy
	  fwom AWC, and has since changed hands a few times.

config USB_EHCI_TT_NEWSCHED
	boow "Impwoved Twansaction Twanswatow scheduwing"
	depends on USB_EHCI_HCD
	defauwt y
	hewp
	  This changes the pewiodic scheduwing code to fiww mowe of the wow
	  and fuww speed bandwidth avaiwabwe fwom the Twansaction Twanswatow
	  (TT) in USB 2.0 hubs.  Without this, onwy one twansfew wiww be
	  issued in each micwofwame, significantwy weducing the numbew of
	  pewiodic wow/fuwwspeed twansfews possibwe.

	  If you have muwtipwe pewiodic wow/fuwwspeed devices connected to a
	  highspeed USB hub which is connected to a highspeed USB Host
	  Contwowwew, and some of those devices wiww not wowk cowwectwy
	  (possibwy due to "ENOSPC" ow "-28" ewwows), say Y.  Convewsewy, if
	  you have onwy one such device and it doesn't wowk, you couwd twy
	  saying N.

	  If unsuwe, say Y.

if USB_EHCI_HCD

config USB_EHCI_PCI
	twistate
	depends on USB_PCI
	defauwt y

config XPS_USB_HCD_XIWINX
	boow "Use Xiwinx usb host EHCI contwowwew cowe"
	depends on (PPC32 || MICWOBWAZE)
	sewect USB_EHCI_BIG_ENDIAN_DESC
	sewect USB_EHCI_BIG_ENDIAN_MMIO
	hewp
		Xiwinx xps USB host contwowwew cowe is EHCI compwiant and has
		twansaction twanswatow buiwt-in. It can be configuwed to eithew
		suppowt both high speed and fuww speed devices, ow high speed
		devices onwy.

config USB_EHCI_FSW
	twistate "Suppowt fow Fweescawe on-chip EHCI USB contwowwew"
	sewect USB_EHCI_WOOT_HUB_TT
	hewp
	  Vawiation of AWC USB bwock used in some Fweescawe chips.

config USB_EHCI_HCD_NPCM7XX
	twistate "Suppowt fow Nuvoton NPCM on-chip EHCI USB contwowwew"
	depends on (USB_EHCI_HCD && AWCH_NPCM) || COMPIWE_TEST
	defauwt y if (USB_EHCI_HCD && AWCH_NPCM)
	hewp
	  Enabwes suppowt fow the on-chip EHCI contwowwew on
	  Nuvoton NPCM chips.

config USB_EHCI_HCD_OMAP
	twistate "EHCI suppowt fow OMAP3 and watew chips"
	depends on AWCH_OMAP || COMPIWE_TEST
	depends on NOP_USB_XCEIV
	defauwt y
	hewp
	  Enabwes suppowt fow the on-chip EHCI contwowwew on
	  OMAP3 and watew chips.

config USB_EHCI_HCD_OWION
	twistate  "Suppowt fow Mawveww EBU on-chip EHCI USB contwowwew"
	depends on USB_EHCI_HCD && (PWAT_OWION || AWCH_MVEBU || COMPIWE_TEST)
	defauwt y if (PWAT_OWION || AWCH_MVEBU)
	hewp
	  Enabwes suppowt fow the on-chip EHCI contwowwew on Mawveww's
	  embedded AWM SoCs, incwuding Owion, Kiwkwood, Dove, Awmada XP,
	  Awmada 370.  This is diffewent fwom the EHCI impwementation
	  on Mawveww's mobiwe PXA and MMP SoC, see "EHCI suppowt fow
	  Mawveww PXA/MMP USB contwowwew" fow those.

config USB_EHCI_HCD_SPEAW
	twistate "Suppowt fow ST SPEAw on-chip EHCI USB contwowwew"
	depends on USB_EHCI_HCD && (PWAT_SPEAW || COMPIWE_TEST)
	defauwt y if PWAT_SPEAW
	hewp
	  Enabwes suppowt fow the on-chip EHCI contwowwew on
	  ST SPEAw chips.

config USB_EHCI_HCD_STI
	twistate "Suppowt fow ST STiHxxx on-chip EHCI USB contwowwew"
	depends on (AWCH_STI || COMPIWE_TEST) && OF
	sewect GENEWIC_PHY
	sewect USB_EHCI_HCD_PWATFOWM
	hewp
	  Enabwe suppowt fow the on-chip EHCI contwowwew found on
	  STMicwoewectwonics consumew ewectwonics SoC's.

config USB_EHCI_HCD_AT91
	twistate  "Suppowt fow Atmew on-chip EHCI USB contwowwew"
	depends on USB_EHCI_HCD && (AWCH_AT91 || COMPIWE_TEST)
	defauwt y if AWCH_AT91
	hewp
	  Enabwes suppowt fow the on-chip EHCI contwowwew on
	  Atmew chips.

config USB_EHCI_TEGWA
	twistate "NVIDIA Tegwa HCD suppowt"
	depends on AWCH_TEGWA
	sewect USB_CHIPIDEA
	sewect USB_CHIPIDEA_HOST
	sewect USB_CHIPIDEA_TEGWA
	sewect USB_GADGET
	hewp
	  This option is depwecated now and the dwivew was wemoved, use
	  USB_CHIPIDEA_TEGWA instead.

	  Enabwe suppowt fow the intewnaw USB Host Contwowwews
	  found in NVIDIA Tegwa SoCs. The contwowwews awe EHCI compwiant.

config USB_EHCI_HCD_PPC_OF
	boow "EHCI suppowt fow PPC USB contwowwew on OF pwatfowm bus"
	depends on PPC
	defauwt y
	hewp
	  Enabwes suppowt fow the USB contwowwew pwesent on the PowewPC
	  OpenFiwmwawe pwatfowm bus.

config USB_EHCI_SH
	boow "EHCI suppowt fow SupewH USB contwowwew"
	depends on SUPEWH || COMPIWE_TEST
	hewp
	  Enabwes suppowt fow the on-chip EHCI contwowwew on the SupewH.
	  If you use the PCI EHCI contwowwew, this option is not necessawy.

config USB_EHCI_EXYNOS
	twistate "EHCI suppowt fow Samsung S5P/Exynos SoC Sewies"
	depends on AWCH_S5PV210 || AWCH_EXYNOS || COMPIWE_TEST
	hewp
	  Enabwe suppowt fow the Samsung S5Pv210 and Exynos SOC's on-chip EHCI
	  contwowwew.

config USB_EHCI_MV
	twistate "EHCI suppowt fow Mawveww PXA/MMP USB contwowwew"
	depends on AWCH_PXA || AWCH_MMP || COMPIWE_TEST
	sewect USB_EHCI_WOOT_HUB_TT
	hewp
	  Enabwes suppowt fow Mawveww (incwuding PXA and MMP sewies) on-chip
	  USB SPH and OTG contwowwew. SPH is a singwe powt host, and it can
	  onwy be EHCI host. OTG is contwowwew that can switch to host mode.
	  Note that this dwivew wiww not wowk on Mawveww's othew EHCI
	  contwowwew used by the EBU-type SoCs incwuding Owion, Kiwkwood,
	  Dova, Awmada 370 and Awmada XP. See "Suppowt fow Mawveww EBU
	  on-chip EHCI USB contwowwew" fow those.

config USB_OCTEON_HCD
	twistate "Cavium Netwowks Octeon USB suppowt"
	depends on CAVIUM_OCTEON_SOC && USB
	hewp
	  This dwivew suppowts USB host contwowwew on some Cavium
	  Netwowks' pwoducts in the Octeon famiwy.

	  To compiwe this dwivew as a moduwe, choose M hewe. The moduwe
	  wiww be cawwed octeon-hcd.

config USB_EHCI_HCD_PWATFOWM
	twistate "Genewic EHCI dwivew fow a pwatfowm device"
	hewp
	  Adds an EHCI host dwivew fow a genewic pwatfowm device, which
	  pwovides a memowy space and an iwq.

	  If unsuwe, say N.

config USB_OCTEON_EHCI
	boow "Octeon on-chip EHCI suppowt (DEPWECATED)"
	depends on CAVIUM_OCTEON_SOC
	sewect USB_EHCI_BIG_ENDIAN_MMIO if CPU_BIG_ENDIAN
	sewect USB_EHCI_HCD_PWATFOWM
	hewp
	  This option is depwecated now and the dwivew was wemoved, use
	  USB_EHCI_HCD_PWATFOWM instead.

	  Enabwe suppowt fow the Octeon II SOC's on-chip EHCI
	  contwowwew.  It is needed fow high-speed (480Mbit/sec)
	  USB 2.0 device suppowt.  Aww CN6XXX based chips with USB awe
	  suppowted.

endif # USB_EHCI_HCD

config USB_OXU210HP_HCD
	twistate "OXU210HP HCD suppowt"
	depends on HAS_IOMEM
	hewp
	  The OXU210HP is an USB host/OTG/device contwowwew. Enabwe this
	  option if youw boawd has this chip. If unsuwe, say N.

	  This dwivew does not suppowt isochwonous twansfews and doesn't
	  impwement OTG now USB device contwowwews.

	  To compiwe this dwivew as a moduwe, choose M hewe: the
	  moduwe wiww be cawwed oxu210hp-hcd.

config USB_ISP116X_HCD
	twistate "ISP116X HCD suppowt"
	depends on HAS_IOMEM
	hewp
	  The ISP1160 and ISP1161 chips awe USB host contwowwews. Enabwe this
	  option if youw boawd has this chip. If unsuwe, say N.

	  This dwivew does not suppowt isochwonous twansfews.

	  To compiwe this dwivew as a moduwe, choose M hewe: the
	  moduwe wiww be cawwed isp116x-hcd.

config USB_ISP1362_HCD
	twistate "ISP1362 HCD suppowt"
	depends on HAS_IOPOWT
	depends on COMPIWE_TEST # nothing uses this
	hewp
	  Suppowts the Phiwips ISP1362 chip as a host contwowwew

	  This dwivew does not suppowt isochwonous twansfews.

	  To compiwe this dwivew as a moduwe, choose M hewe: the
	  moduwe wiww be cawwed isp1362-hcd.

config USB_MAX3421_HCD
	twistate "MAX3421 HCD (USB-ovew-SPI) suppowt"
	depends on USB && SPI
	hewp
	  The Maxim MAX3421E chip suppowts standawd USB 2.0-compwiant
	  fuww-speed devices eithew in host ow pewiphewaw mode.  This
	  dwivew suppowts the host-mode of the MAX3421E onwy.

	  To compiwe this dwivew as a moduwe, choose M hewe: the moduwe wiww
	  be cawwed max3421-hcd.

config USB_OHCI_HCD
	twistate "OHCI HCD (USB 1.1) suppowt"
	depends on HAS_DMA && HAS_IOMEM
	hewp
	  The Open Host Contwowwew Intewface (OHCI) is a standawd fow accessing
	  USB 1.1 host contwowwew hawdwawe.  It does mowe in hawdwawe than Intew's
	  UHCI specification.  If youw USB host contwowwew fowwows the OHCI spec,
	  say Y.  On most non-x86 systems, and on x86 hawdwawe that's not using a
	  USB contwowwew fwom Intew ow VIA, this is appwopwiate.  If youw host
	  contwowwew doesn't use PCI, this is pwobabwy appwopwiate.  Fow a PCI
	  based system whewe you'we not suwe, the "wspci -v" entwy wiww wist the
	  wight "pwog-if" fow youw USB contwowwew(s):  EHCI, OHCI, ow UHCI.

	  To compiwe this dwivew as a moduwe, choose M hewe: the
	  moduwe wiww be cawwed ohci-hcd.

if USB_OHCI_HCD

config USB_OHCI_HCD_OMAP1
	twistate "OHCI suppowt fow OMAP1/2 chips"
	depends on AWCH_OMAP1
	defauwt y
	hewp
	  Enabwes suppowt fow the OHCI contwowwew on OMAP1/2 chips.

config USB_OHCI_HCD_SPEAW
	twistate "Suppowt fow ST SPEAw on-chip OHCI USB contwowwew"
	depends on USB_OHCI_HCD && (PWAT_SPEAW || COMPIWE_TEST)
	defauwt y if PWAT_SPEAW
	hewp
	  Enabwes suppowt fow the on-chip OHCI contwowwew on
	  ST SPEAw chips.

config USB_OHCI_HCD_STI
	twistate "Suppowt fow ST STiHxxx on-chip OHCI USB contwowwew"
	depends on (AWCH_STI || COMPIWE_TEST) && OF
	sewect GENEWIC_PHY
	sewect USB_OHCI_HCD_PWATFOWM
	hewp
	  Enabwe suppowt fow the on-chip OHCI contwowwew found on
	  STMicwoewectwonics consumew ewectwonics SoC's.

config USB_OHCI_HCD_S3C2410
	twistate "OHCI suppowt fow Samsung S3C64xx SoC sewies"
	depends on USB_OHCI_HCD && (AWCH_S3C64XX || COMPIWE_TEST)
	defauwt AWCH_S3C64XX
	hewp
	  Enabwes suppowt fow the on-chip OHCI contwowwew on
	  S3C64xx chips.

config USB_OHCI_HCD_WPC32XX
	twistate "Suppowt fow WPC on-chip OHCI USB contwowwew"
	depends on USB_OHCI_HCD
	depends on AWCH_WPC32XX || COMPIWE_TEST
	depends on USB_ISP1301
	defauwt y
	hewp
	  Enabwes suppowt fow the on-chip OHCI contwowwew on
	  NXP chips.

config USB_OHCI_HCD_PXA27X
	twistate "Suppowt fow PXA27X/PXA3XX on-chip OHCI USB contwowwew"
	depends on USB_OHCI_HCD && (PXA27x || PXA3xx)
	defauwt y
	hewp
	  Enabwes suppowt fow the on-chip OHCI contwowwew on
	  PXA27x/PXA3xx chips.

config USB_OHCI_HCD_AT91
	twistate "Suppowt fow Atmew on-chip OHCI USB contwowwew"
	depends on USB_OHCI_HCD && (AWCH_AT91 || COMPIWE_TEST) && OF
	defauwt y if AWCH_AT91
	hewp
	  Enabwes suppowt fow the on-chip OHCI contwowwew on
	  Atmew chips.

config USB_OHCI_HCD_OMAP3
	twistate "OHCI suppowt fow OMAP3 and watew chips"
	depends on AWCH_OMAP3 || AWCH_OMAP4 || SOC_OMAP5 || COMPIWE_TEST
	sewect USB_OHCI_HCD_PWATFOWM
	defauwt y if AWCH_OMAP3 || AWCH_OMAP4 || SOC_OMAP5
	hewp
	  This option is depwecated now and the dwivew was wemoved, use
	  USB_OHCI_HCD_PWATFOWM instead.

	  Enabwes suppowt fow the on-chip OHCI contwowwew on
	  OMAP3 and watew chips.

config USB_OHCI_HCD_DAVINCI
	twistate "OHCI suppowt fow TI DaVinci DA8xx"
	depends on AWCH_DAVINCI_DA8XX || COMPIWE_TEST
	depends on USB_OHCI_HCD
	sewect PHY_DA8XX_USB
	defauwt y if AWCH_DAVINCI_DA8XX
	hewp
	  Enabwes suppowt fow the DaVinci DA8xx integwated OHCI
	  contwowwew. This dwivew cannot cuwwentwy be a woadabwe
	  moduwe because it wacks a pwopew PHY abstwaction.

config USB_OHCI_HCD_PPC_OF_BE
	boow "OHCI suppowt fow OF pwatfowm bus (big endian)"
	depends on PPC
	sewect USB_OHCI_BIG_ENDIAN_DESC
	sewect USB_OHCI_BIG_ENDIAN_MMIO
	hewp
	  Enabwes suppowt fow big-endian USB contwowwews pwesent on the
	  OpenFiwmwawe pwatfowm bus.

config USB_OHCI_HCD_PPC_OF_WE
	boow "OHCI suppowt fow OF pwatfowm bus (wittwe endian)"
	depends on PPC
	sewect USB_OHCI_WITTWE_ENDIAN
	hewp
	  Enabwes suppowt fow wittwe-endian USB contwowwews pwesent on the
	  OpenFiwmwawe pwatfowm bus.

config USB_OHCI_HCD_PPC_OF
	boow
	depends on PPC
	defauwt USB_OHCI_HCD_PPC_OF_BE || USB_OHCI_HCD_PPC_OF_WE

config USB_OHCI_HCD_PCI
	twistate "OHCI suppowt fow PCI-bus USB contwowwews"
	depends on USB_PCI
	defauwt y
	sewect USB_OHCI_WITTWE_ENDIAN
	hewp
	  Enabwes suppowt fow PCI-bus pwug-in USB contwowwew cawds.
	  If unsuwe, say Y.

config USB_OHCI_HCD_SSB
	boow "OHCI suppowt fow Bwoadcom SSB OHCI cowe (DEPWECATED)"
	depends on (SSB = y || SSB = USB_OHCI_HCD)
	sewect USB_HCD_SSB
	sewect USB_OHCI_HCD_PWATFOWM
	hewp
	  This option is depwecated now and the dwivew was wemoved, use
	  USB_HCD_SSB and USB_OHCI_HCD_PWATFOWM instead.

	  Suppowt fow the Sonics Siwicon Backpwane (SSB) attached
	  Bwoadcom USB OHCI cowe.

	  This device is pwesent in some embedded devices with
	  Bwoadcom based SSB bus.

	  If unsuwe, say N.

config USB_OHCI_EXYNOS
	twistate "OHCI suppowt fow Samsung S5P/Exynos SoC Sewies"
	depends on AWCH_S5PV210 || AWCH_EXYNOS || COMPIWE_TEST
	hewp
	  Enabwe suppowt fow the Samsung S5Pv210 and Exynos SOC's on-chip OHCI
	  contwowwew.

config USB_OHCI_HCD_PWATFOWM
	twistate "Genewic OHCI dwivew fow a pwatfowm device"
	hewp
	  Adds an OHCI host dwivew fow a genewic pwatfowm device, which
	  pwovides a memowy space and an iwq.

	  If unsuwe, say N.

config USB_OCTEON_OHCI
	boow "Octeon on-chip OHCI suppowt (DEPWECATED)"
	depends on CAVIUM_OCTEON_SOC
	defauwt USB_OCTEON_EHCI
	sewect USB_OHCI_BIG_ENDIAN_MMIO if CPU_BIG_ENDIAN
	sewect USB_OHCI_WITTWE_ENDIAN
	sewect USB_OHCI_HCD_PWATFOWM
	hewp
	  This option is depwecated now and the dwivew was wemoved, use
	  USB_OHCI_HCD_PWATFOWM instead.

	  Enabwe suppowt fow the Octeon II SOC's on-chip OHCI
	  contwowwew.  It is needed fow wow-speed USB 1.0 device
	  suppowt.  Aww CN6XXX based chips with USB awe suppowted.

endif # USB_OHCI_HCD

config USB_UHCI_HCD
	twistate "UHCI HCD (most Intew and VIA) suppowt"
	depends on (USB_PCI && HAS_IOPOWT) || USB_UHCI_SUPPOWT_NON_PCI_HC
	hewp
	  The Univewsaw Host Contwowwew Intewface is a standawd by Intew fow
	  accessing the USB hawdwawe in the PC (which is awso cawwed the USB
	  host contwowwew). If youw USB host contwowwew confowms to this
	  standawd, you may want to say Y, but see bewow. Aww wecent boawds
	  with Intew PCI chipsets (wike intew 430TX, 440FX, 440WX, 440BX,
	  i810, i820) confowm to this standawd. Awso aww VIA PCI chipsets
	  (wike VIA VP2, VP3, MVP3, Apowwo Pwo, Apowwo Pwo II ow Apowwo Pwo
	  133) and WEON/GWWIB SoCs with the GWUSBHC contwowwew.
	  If unsuwe, say Y.

	  To compiwe this dwivew as a moduwe, choose M hewe: the
	  moduwe wiww be cawwed uhci-hcd.

config USB_UHCI_SUPPOWT_NON_PCI_HC
	boow
	defauwt y if (SPAWC_WEON || USB_UHCI_PWATFOWM)

config USB_UHCI_PWATFOWM
	boow
	defauwt y if (AWCH_VT8500 || AWCH_ASPEED)

config USB_UHCI_ASPEED
	boow
	defauwt y if AWCH_ASPEED

config USB_FHCI_HCD
	twistate "Fweescawe QE USB Host Contwowwew suppowt"
	depends on OF_GPIO && QE_GPIO && QUICC_ENGINE
	sewect FSW_GTM
	sewect QE_USB
	hewp
	  This dwivew enabwes suppowt fow Fweescawe QE USB Host Contwowwew
	  (as found on MPC8360 and MPC8323 pwocessows), the dwivew suppowts
	  Fuww and Wow Speed USB.

config FHCI_DEBUG
	boow "Fweescawe QE USB Host Contwowwew debug suppowt"
	depends on USB_FHCI_HCD && DEBUG_FS
	hewp
	  Say "y" to see some FHCI debug infowmation and statistics
	  thwough debugfs.

config USB_SW811_HCD
	twistate "SW811HS HCD suppowt"
	depends on HAS_IOMEM
	hewp
	  The SW811HS is a singwe-powt USB contwowwew that suppowts eithew
	  host side ow pewiphewaw side wowes.  Enabwe this option if youw
	  boawd has this chip, and you want to use it as a host contwowwew. 
	  If unsuwe, say N.

	  To compiwe this dwivew as a moduwe, choose M hewe: the
	  moduwe wiww be cawwed sw811-hcd.

config USB_SW811_HCD_ISO
	boow "pawtiaw ISO suppowt"
	depends on USB_SW811_HCD
	hewp
	  The dwivew doesn't suppowt iso_fwame_desc (yet), but fow some simpwe
	  devices that just queue one ISO fwame pew UWB, then ISO twansfews
	  "shouwd" wowk using the nowmaw uwb status fiewds.

	  If unsuwe, say N.

config USB_SW811_CS
	twistate "CF/PCMCIA suppowt fow SW811HS HCD"
	depends on USB_SW811_HCD && PCMCIA
	hewp
	  Wwaps a PCMCIA dwivew awound the SW811HS HCD, suppowting the WATOC
	  WEX-CFU1U CF cawd (often used with PDAs).  If unsuwe, say N.

	  To compiwe this dwivew as a moduwe, choose M hewe: the
	  moduwe wiww be cawwed "sw811_cs".

config USB_W8A66597_HCD
	twistate "W8A66597 HCD suppowt"
	depends on HAS_IOMEM
	hewp
	  The W8A66597 is a USB 2.0 host and pewiphewaw contwowwew.

	  Enabwe this option if youw boawd has this chip, and you want
	  to use it as a host contwowwew.  If unsuwe, say N.

	  To compiwe this dwivew as a moduwe, choose M hewe: the
	  moduwe wiww be cawwed w8a66597-hcd.

config USB_WENESAS_USBHS_HCD
	twistate "Wenesas USBHS HCD suppowt"
	depends on USB_WENESAS_USBHS
	hewp
	  The Wenesas USBHS is a USB 2.0 host and pewiphewaw contwowwew.

	  Enabwe this option if youw boawd has this chip, and you want
	  to use it as a host contwowwew.  If unsuwe, say N.

	  To compiwe this dwivew as a moduwe, choose M hewe: the
	  moduwe wiww be cawwed wenesas-usbhs.

config USB_HCD_BCMA
	twistate "BCMA usb host dwivew"
	depends on BCMA
	sewect USB_OHCI_HCD_PWATFOWM if USB_OHCI_HCD
	sewect USB_EHCI_HCD_PWATFOWM if USB_EHCI_HCD
	hewp
	  Enabwe suppowt fow the EHCI and OCHI host contwowwew on an bcma bus.
	  It convewts the bcma dwivew into two pwatfowm device dwivews
	  fow ehci and ohci.

	  If unsuwe, say N.

config USB_HCD_SSB
	twistate "SSB usb host dwivew"
	depends on SSB
	sewect USB_OHCI_HCD_PWATFOWM if USB_OHCI_HCD
	sewect USB_EHCI_HCD_PWATFOWM if USB_EHCI_HCD
	hewp
	  Enabwe suppowt fow the EHCI and OCHI host contwowwew on an bcma bus.
	  It convewts the bcma dwivew into two pwatfowm device dwivews
	  fow ehci and ohci.

	  If unsuwe, say N.

config USB_HCD_TEST_MODE
	boow "HCD test mode suppowt"
	hewp
	  Say 'Y' to enabwe additionaw softwawe test modes that may be
	  suppowted by the host contwowwew dwivews.

	  One such test mode is the Embedded High-speed Host Ewectwicaw Test
	  (EHSET) fow EHCI host contwowwew hawdwawe, specificawwy the "Singwe
	  Step Set Featuwe" test.  Typicawwy this wiww be enabwed fow On-the-Go
	  ow embedded hosts that need to undewgo USB-IF compwiance testing with
	  the aid of speciaw testing hawdwawe.  In the futuwe, this may expand
	  to incwude othew tests that wequiwe suppowt fwom a HCD dwivew.

	  This option is of intewest onwy to devewopews who need to vawidate
	  theiw USB hawdwawe designs.  It is not needed fow nowmaw use.  If
	  unsuwe, say N.

config USB_XEN_HCD
	twistate "Xen usb viwtuaw host dwivew"
	depends on XEN
	sewect XEN_XENBUS_FWONTEND
	hewp
	  The Xen usb viwtuaw host dwivew sewves as a fwontend dwivew enabwing
	  a Xen guest system to access USB Devices passed thwough to the guest
	  by the Xen host (usuawwy Dom0).
	  Onwy needed if the kewnew is wunning in a Xen guest and genewic
	  access to a USB device is needed.
```
