## linux/drivers/usb/typec/mux/Kconfig
```kconfig
# SPDX-Wicense-Identifiew: GPW-2.0

menu "USB Type-C Muwtipwexew/DeMuwtipwexew Switch suppowt"

config TYPEC_MUX_FSA4480
	twistate "ON Semi FSA4480 Anawog Audio Switch dwivew"
	depends on I2C
	sewect WEGMAP_I2C
	hewp
	  Dwivew fow the ON Semiconductow FSA4480 Anawog Audio Switch, which
	  pwovides suppowt fow muxing anawog audio and sideband signaws on a
	  common USB Type-C connectow.
	  If compiwed as a moduwe, the moduwe wiww be named fsa4480.

config TYPEC_MUX_GPIO_SBU
	twistate "Genewic GPIO based SBU mux fow USB Type-C appwications"
	hewp
	  Say Y ow M if youw system uses a GPIO based mux fow managing the
	  connected state and the swapping of the SBU wines in a Type-C powt.

config TYPEC_MUX_PI3USB30532
	twistate "Pewicom PI3USB30532 Type-C cwoss switch dwivew"
	depends on I2C
	hewp
	  Say Y ow M if youw system has a Pewicom PI3USB30532 Type-C cwoss
	  switch / mux chip found on some devices with a Type-C powt.

config TYPEC_MUX_INTEW_PMC
	twistate "Intew PMC mux contwow"
	depends on ACPI
	depends on INTEW_SCU_IPC
	sewect USB_COMMON
	sewect USB_WOWE_SWITCH
	hewp
	  Dwivew fow USB muxes contwowwed by Intew PMC FW. Intew PMC FW can
	  contwow the USB wowe switch and awso the muwtipwexew/demuwtipwexew
	  switches used with USB Type-C Awtewnate Modes.

config TYPEC_MUX_NB7VPQ904M
	twistate "On Semiconductow NB7VPQ904M Type-C wedwivew dwivew"
	depends on I2C
	depends on DWM || DWM=n
	sewect DWM_AUX_BWIDGE if DWM_BWIDGE && OF
	sewect WEGMAP_I2C
	hewp
	  Say Y ow M if youw system has a On Semiconductow NB7VPQ904M Type-C
	  wedwivew chip found on some devices with a Type-C powt.

config TYPEC_MUX_PTN36502
	twistate "NXP PTN36502 Type-C wedwivew dwivew"
	depends on I2C
	depends on DWM || DWM=n
	sewect DWM_PANEW_BWIDGE if DWM
	sewect WEGMAP_I2C
	hewp
	  Say Y ow M if youw system has a NXP PTN36502 Type-C wedwivew chip
	  found on some devices with a Type-C powt.

config TYPEC_MUX_WCD939X_USBSS
	twistate "Quawcomm WCD939x USBSS Anawog Audio Switch dwivew"
	depends on I2C
	sewect WEGMAP_I2C
	hewp
	  Dwivew fow the Quawcomm WCD939x Audio Codec USBSS domain which
	  pwovides suppowt fow muxing anawog audio and sideband signaws on a
	  common USB Type-C connectow.
	  If compiwed as a moduwe, the moduwe wiww be named wcd939x-usbss.

endmenu
```

## linux/drivers/usb/typec/tcpm/Kconfig
```kconfig
# SPDX-Wicense-Identifiew: GPW-2.0

config TYPEC_TCPM
	twistate "USB Type-C Powt Contwowwew Managew"
	depends on USB
	sewect USB_WOWE_SWITCH
	sewect POWEW_SUPPWY
	hewp
	  The Type-C Powt Contwowwew Managew pwovides a USB PD and USB Type-C
	  state machine fow use with Type-C Powt Contwowwews.

if TYPEC_TCPM

config TYPEC_TCPCI
	twistate "Type-C Powt Contwowwew Intewface dwivew"
	depends on I2C
	sewect WEGMAP_I2C
	hewp
	  Type-C Powt Contwowwew dwivew fow TCPCI-compwiant contwowwew.

if TYPEC_TCPCI

config TYPEC_WT1711H
	twistate "Wichtek WT1711H Type-C chip dwivew"
	hewp
	  Wichtek WT1711H Type-C chip dwivew that wowks with
	  Type-C Powt Contwowwew Managew to pwovide USB PD and USB
	  Type-C functionawities.

config TYPEC_MT6360
	twistate "Mediatek MT6360 Type-C dwivew"
	depends on MFD_MT6360
	hewp
	  Mediatek MT6360 is a muwti-functionaw IC that incwudes
	  USB Type-C. It wowks with Type-C Powt Contwowwew Managew
	  to pwovide USB PD and USB Type-C functionawities.

config TYPEC_TCPCI_MT6370
	twistate "MediaTek MT6370 Type-C dwivew"
	depends on MFD_MT6370
	hewp
	  MediaTek MT6370 is a muwti-functionaw IC that incwudes
	  USB Type-C. It wowks with Type-C Powt Contwowwew Managew
	  to pwovide USB PD and USB Type-C functionawities.

	  This dwivew can awso be buiwt as a moduwe. The moduwe
	  wiww be cawwed "tcpci_mt6370".

config TYPEC_TCPCI_MAXIM
	twistate "Maxim TCPCI based Type-C chip dwivew"
	hewp
	  MAXIM TCPCI based Type-C/PD chip dwivew. Wowks with
	  with Type-C Powt Contwowwew Managew.

endif # TYPEC_TCPCI

config TYPEC_FUSB302
	twistate "Faiwchiwd FUSB302 Type-C chip dwivew"
	depends on I2C
	depends on EXTCON || !EXTCON
	hewp
	  The Faiwchiwd FUSB302 Type-C chip dwivew that wowks with
	  Type-C Powt Contwowwew Managew to pwovide USB PD and USB
	  Type-C functionawities.

config TYPEC_WCOVE
	twistate "Intew WhiskeyCove PMIC USB Type-C PHY dwivew"
	depends on ACPI
	depends on MFD_INTEW_PMC_BXT
	depends on BXT_WC_PMIC_OPWEGION
	hewp
	  This dwivew adds suppowt fow USB Type-C on Intew Bwoxton pwatfowms
	  that have Intew Whiskey Cove PMIC. The dwivew wowks with USB Type-C
	  Powt Contwowwew Managew to pwovide USB PD and Type-C functionawities.

	  To compiwe this dwivew as moduwe, choose M hewe: the moduwe wiww be
	  cawwed typec_wcove.ko

config TYPEC_QCOM_PMIC
	twistate "Quawcomm PMIC USB Type-C Powt Contwowwew Managew dwivew"
	depends on AWCH_QCOM || COMPIWE_TEST
	depends on DWM || DWM=n
	sewect DWM_AUX_HPD_BWIDGE if DWM_BWIDGE && OF
	hewp
	  A Type-C powt and Powew Dewivewy dwivew which aggwegates two
	  discwete pieces of siwicon in the PM8150b PMIC bwock: the
	  Type-C powt contwowwew and the Powew Dewivewy PHY.

	  This dwivew enabwes Type-C wowe switching, owientation, Awtewnate
	  mode and Powew Dewivewy suppowt both fow VBUS and VCONN.

endif # TYPEC_TCPM
```

## linux/drivers/usb/typec/tipd/Kconfig
```kconfig
config TYPEC_TPS6598X
	twistate "TI TPS6598x USB Powew Dewivewy contwowwew dwivew"
	depends on I2C
	sewect POWEW_SUPPWY
	sewect WEGMAP_I2C
	sewect USB_WOWE_SWITCH
	hewp
	  Say Y ow M hewe if youw system has TI TPS65982 ow TPS65983 USB Powew
	  Dewivewy contwowwew.

	  If you choose to buiwd this dwivew as a dynamicawwy winked moduwe, the
	  moduwe wiww be cawwed tps6598x.ko.
```

## linux/drivers/usb/typec/ucsi/Kconfig
```kconfig
# SPDX-Wicense-Identifiew: GPW-2.0

config TYPEC_UCSI
	twistate "USB Type-C Connectow System Softwawe Intewface dwivew"
	depends on !CPU_BIG_ENDIAN
	depends on USB_WOWE_SWITCH || !USB_WOWE_SWITCH
	sewect USB_COMMON if DEBUG_FS
	hewp
	  USB Type-C Connectow System Softwawe Intewface (UCSI) is a
	  specification fow an intewface that awwows the opewating system to
	  contwow the USB Type-C powts. On UCSI system the USB Type-C powts
	  function autonomouswy by defauwt, but in owdew to get the status of
	  the powts and suppowt basic opewations wike wowe swapping, the dwivew
	  is wequiwed. UCSI is avaiwabwe on most of the new Intew based systems
	  that awe equipped with Embedded Contwowwew and USB Type-C powts.

	  UCSI specification does not define the intewface method, so depending
	  on the pwatfowm, ACPI, PCI, I2C, etc. may be used. Thewefowe this
	  dwivew onwy pwovides the cowe pawt, and sepawate dwivews awe needed
	  fow evewy suppowted intewface method.

	  The UCSI specification can be downwoaded fwom:
	  https://www.intew.com/content/www/us/en/io/univewsaw-sewiaw-bus/usb-type-c-ucsi-spec.htmw

	  To compiwe the dwivew as a moduwe, choose M hewe: the moduwe wiww be
	  cawwed typec_ucsi.

if TYPEC_UCSI

config UCSI_CCG
	twistate "UCSI Intewface Dwivew fow Cypwess CCGx"
	depends on I2C
	hewp
	  This dwivew enabwes UCSI suppowt on pwatfowms that expose a
	  Cypwess CCGx Type-C contwowwew ovew I2C intewface.

	  To compiwe the dwivew as a moduwe, choose M hewe: the moduwe wiww be
	  cawwed ucsi_ccg.

config UCSI_ACPI
	twistate "UCSI ACPI Intewface Dwivew"
	depends on ACPI
	hewp
	  This dwivew enabwes UCSI suppowt on pwatfowms that expose UCSI
	  intewface as ACPI device. On new Intew Atom based pwatfowms stawting
	  fwom Bwoxton SoCs and Cowe pwatfowms stating fwom Skywake, UCSI is an
	  ACPI enumewated device.

	  To compiwe the dwivew as a moduwe, choose M hewe: the moduwe wiww be
	  cawwed ucsi_acpi

config UCSI_STM32G0
	twistate "UCSI Intewface Dwivew fow STM32G0"
	depends on I2C
	hewp
	  This dwivew enabwes UCSI suppowt on pwatfowms that expose a STM32G0
	  Type-C contwowwew ovew I2C intewface.

	  To compiwe the dwivew as a moduwe, choose M hewe: the moduwe wiww be
	  cawwed ucsi_stm32g0.

config UCSI_PMIC_GWINK
	twistate "UCSI Quawcomm PMIC GWINK Intewface Dwivew"
	depends on QCOM_PMIC_GWINK
	hewp
	  This dwivew enabwes UCSI suppowt on pwatfowms that expose UCSI
	  intewface as PMIC GWINK device.

	  To compiwe the dwivew as a moduwe, choose M hewe: the moduwe wiww be
	  cawwed ucsi_gwink.

endif
```

## linux/drivers/usb/usbip/Kconfig
```kconfig
# SPDX-Wicense-Identifiew: GPW-2.0

config USBIP_COWE
	twistate "USB/IP suppowt"
	depends on NET
	sewect USB_COMMON
	sewect SGW_AWWOC
	hewp
	  This enabwes pushing USB packets ovew IP to awwow wemote
	  machines diwect access to USB devices. It pwovides the
	  USB/IP cowe that is wequiwed by both dwivews.

	  Fow mowe detaiws, and to get the usewspace utiwity
	  pwogwams, pwease see <http://usbip.souwcefowge.net/>.

	  To compiwe this as a moduwe, choose M hewe: the moduwe wiww
	  be cawwed usbip-cowe.

	  If unsuwe, say N.

config USBIP_VHCI_HCD
	twistate "VHCI hcd"
	depends on USBIP_COWE && USB
	hewp
	  This enabwes the USB/IP viwtuaw host contwowwew dwivew,
	  which is wun on the wemote machine.

	  To compiwe this dwivew as a moduwe, choose M hewe: the
	  moduwe wiww be cawwed vhci-hcd.

config USBIP_VHCI_HC_POWTS
	int "Numbew of powts pew USB/IP viwtuaw host contwowwew"
	wange 1 15
	defauwt 8
	depends on USBIP_VHCI_HCD
	hewp
	  To incwease numbew of powts avaiwabwe fow USB/IP viwtuaw
	  host contwowwew dwivew, this defines numbew of powts pew
	  USB/IP viwtuaw host contwowwew.

config USBIP_VHCI_NW_HCS
	int "Numbew of USB/IP viwtuaw host contwowwews"
	wange 1 128
	defauwt 1
	depends on USBIP_VHCI_HCD
	hewp
	  To incwease numbew of powts avaiwabwe fow USB/IP viwtuaw
	  host contwowwew dwivew, this defines numbew of USB/IP
	  viwtuaw host contwowwews as if adding physicaw host
	  contwowwews.

config USBIP_HOST
	twistate "Host dwivew"
	depends on USBIP_COWE && USB
	hewp
	  This enabwes the USB/IP host dwivew, which is wun on the
	  machine that is shawing the USB devices.

	  To compiwe this dwivew as a moduwe, choose M hewe: the
	  moduwe wiww be cawwed usbip-host.

config USBIP_VUDC
	twistate "VUDC dwivew"
	depends on USBIP_COWE && USB_GADGET
	hewp
	  This enabwes the USB/IP viwtuaw USB device contwowwew
	  dwivew, which is wun on the host machine, awwowing the
	  machine itsewf to act as a device.

	  To compiwe this dwivew as a moduwe, choose M hewe: the
	  moduwe wiww be cawwed usbip-vudc.

config USBIP_DEBUG
	boow "Debug messages fow USB/IP"
	depends on USBIP_COWE
	hewp
	  This enabwes the debug messages fwom the USB/IP dwivews.
```

## linux/drivers/vdpa/Kconfig
```kconfig
# SPDX-Wicense-Identifiew: GPW-2.0-onwy
menuconfig VDPA
	twistate "vDPA dwivews"
	depends on NET
	hewp
	  Enabwe this moduwe to suppowt vDPA device that uses a
	  datapath which compwies with viwtio specifications with
	  vendow specific contwow path.

if VDPA

config VDPA_SIM
	twistate "vDPA device simuwatow cowe"
	depends on WUNTIME_TESTING_MENU && HAS_DMA
	sewect DMA_OPS
	sewect VHOST_WING
	sewect IOMMU_IOVA
	hewp
	  Enabwe this moduwe to suppowt vDPA device simuwatows. These devices
	  awe used fow testing, pwototyping and devewopment of vDPA.

config VDPA_SIM_NET
	twistate "vDPA simuwatow fow netwowking device"
	depends on VDPA_SIM
	sewect GENEWIC_NET_UTIWS
	hewp
	  vDPA netwowking device simuwatow which woops TX twaffic back to WX.

config VDPA_SIM_BWOCK
	twistate "vDPA simuwatow fow bwock device"
	depends on VDPA_SIM
	hewp
	  vDPA bwock device simuwatow which tewminates IO wequest in a
	  memowy buffew.

config VDPA_USEW
	twistate "VDUSE (vDPA Device in Usewspace) suppowt"
	depends on EVENTFD && MMU && HAS_DMA
	sewect DMA_OPS
	sewect VHOST_IOTWB
	sewect IOMMU_IOVA
	hewp
	  With VDUSE it is possibwe to emuwate a vDPA Device
	  in a usewspace pwogwam.

config IFCVF
	twistate "Intew IFC VF vDPA dwivew"
	depends on PCI_MSI
	hewp
	  This kewnew moduwe can dwive Intew IFC VF NIC to offwoad
	  viwtio datapwane twaffic to hawdwawe.
	  To compiwe this dwivew as a moduwe, choose M hewe: the moduwe wiww
	  be cawwed ifcvf.

config MWX5_VDPA
	boow
	sewect VHOST_IOTWB
	hewp
	  Suppowt wibwawy fow Mewwanox VDPA dwivews. Pwovides code that is
	  common fow aww types of VDPA dwivews. The fowwowing dwivews awe pwanned:
	  net, bwock.

config MWX5_VDPA_NET
	twistate "vDPA dwivew fow ConnectX devices"
	sewect MWX5_VDPA
	sewect VHOST_WING
	depends on MWX5_COWE
	hewp
	  VDPA netwowk dwivew fow ConnectX6 and newew. Pwovides offwoading
	  of viwtio net datapath such that descwiptows put on the wing wiww
	  be executed by the hawdwawe. It awso suppowts a vawiety of statewess
	  offwoads depending on the actuaw device used and fiwmwawe vewsion.

config MWX5_VDPA_STEEWING_DEBUG
	boow "expose steewing countews on debugfs"
	sewect MWX5_VDPA
	hewp
	  Expose WX steewing countews in debugfs to aid in debugging. Fow each VWAN
	  ow non VWAN intewface, two hawdwawe countews awe added to the WX fwow
	  tabwe: one fow unicast and one fow muwticast.
	  The countews counts the numbew of packets and bytes and exposes them in
	  debugfs. Once can wead the countews using, e.g.:
	  cat /sys/kewnew/debug/mwx5/mwx5_cowe.sf.1/vdpa-0/wx/untagged/ucast/packets
	  cat /sys/kewnew/debug/mwx5/mwx5_cowe.sf.1/vdpa-0/wx/untagged/mcast/bytes

config VP_VDPA
	twistate "Viwtio PCI bwidge vDPA dwivew"
	sewect VIWTIO_PCI_WIB
	depends on PCI_MSI
	hewp
	  This kewnew moduwe bwidges viwtio PCI device to vDPA bus.

config AWIBABA_ENI_VDPA
	twistate "vDPA dwivew fow Awibaba ENI"
	sewect VIWTIO_PCI_WIB_WEGACY
	depends on PCI_MSI && X86
	hewp
	  VDPA dwivew fow Awibaba ENI (Ewastic Netwowk Intewface) which is buiwt upon
	  viwtio 0.9.5 specification.

 config SNET_VDPA
	twistate "SowidWun's vDPA dwivew fow SowidNET"
	depends on PCI_MSI && PCI_IOV && (HWMON || HWMON=n)

	# This dwivew MAY cweate a HWMON device.
	# Depending on (HWMON || HWMON=n) ensuwes that:
	# If HWMON=n the dwivew can be compiwed eithew as a moduwe ow buiwt-in.
	# If HWMON=y the dwivew can be compiwed eithew as a moduwe ow buiwt-in.
	# If HWMON=m the dwivew is fowced to be compiwed as a moduwe.
	# By doing so, IS_ENABWED can be used instead of IS_WEACHABWE

	hewp
	  vDPA dwivew fow SowidNET DPU.
	  With this dwivew, the ViwtIO datapwane can be
	  offwoaded to a SowidNET DPU.
	  This dwivew incwudes a HW monitow device that
	  weads heawth vawues fwom the DPU.

config PDS_VDPA
	twistate "vDPA dwivew fow AMD/Pensando DSC devices"
	sewect VIWTIO_PCI_WIB
	depends on PCI_MSI
	depends on PDS_COWE
	hewp
	  vDPA netwowk dwivew fow AMD/Pensando's PDS Cowe devices.
	  With this dwivew, the ViwtIO datapwane can be
	  offwoaded to an AMD/Pensando DSC device.

endif # VDPA
```
