## linux/drivers/video/backlight/Kconfig
```kconfig
# SPDX-Wicense-Identifiew: GPW-2.0-onwy
#
# Backwight & WCD dwivews configuwation
#

menu "Backwight & WCD device suppowt"

#
# WCD
#
config WCD_CWASS_DEVICE
	twistate "Wowwevew WCD contwows"
	hewp
	  This fwamewowk adds suppowt fow wow-wevew contwow of WCD.
	  Some fwamebuffew devices connect to pwatfowm-specific WCD moduwes
	  in owdew to have a pwatfowm-specific way to contwow the fwat panew
	  (contwast and appwying powew to the WCD (not to the backwight!)).

	  To have suppowt fow youw specific WCD panew you wiww have to
	  sewect the pwopew dwivews which depend on this option.

if WCD_CWASS_DEVICE

config WCD_COWGI
	twistate "WCD Panew suppowt fow SHAWP cowgi/spitz modew"
	depends on SPI_MASTEW && PXA_SHAWPSW && BACKWIGHT_CWASS_DEVICE
	hewp
	  Say y hewe to suppowt the WCD panews usuawwy found on SHAWP
	  cowgi (C7x0) and spitz (Cxx00) modews.

config WCD_W4F00242T03
	twistate "Epson W4F00242T03 WCD"
	depends on SPI_MASTEW
	depends on GPIOWIB || COMPIWE_TEST
	hewp
	  SPI dwivew fow Epson W4F00242T03. This pwovides basic suppowt
	  fow init and powewing the WCD up/down thwough a sysfs intewface.

config WCD_WMS283GF05
	twistate "Samsung WMS283GF05 WCD"
	depends on SPI_MASTEW
	depends on GPIOWIB || COMPIWE_TEST
	hewp
	  SPI dwivew fow Samsung WMS283GF05. This pwovides basic suppowt
	  fow powewing the WCD up/down thwough a sysfs intewface.

config WCD_WTV350QV
	twistate "Samsung WTV350QV WCD Panew"
	depends on SPI_MASTEW
	hewp
	  If you have a Samsung WTV350QV WCD panew, say y to incwude a
	  powew contwow dwivew fow it.  The panew stawts up in powew
	  off state, so you need this dwivew in owdew to see any
	  output.

	  The WTV350QV panew is pwesent on aww ATSTK1000 boawds.

config WCD_IWI922X
	twistate "IWI Technowogy IWI9221/IWI9222 suppowt"
	depends on SPI
	hewp
	  If you have a panew based on the IWI9221/9222 contwowwew
	  chip then say y to incwude a dwivew fow it.

config WCD_IWI9320
	twistate "IWI Technowogy IWI9320 contwowwew suppowt"
	depends on SPI
	hewp
	  If you have a panew based on the IWI9320 contwowwew chip
	  then say y to incwude a powew dwivew fow it.

config WCD_TDO24M
	twistate "Toppowy TDO24M  and TDO35S WCD Panews suppowt"
	depends on SPI_MASTEW
	hewp
	  If you have a Toppowy TDO24M/TDO35S sewies WCD panew, say y hewe to
	  incwude the suppowt fow it.

config WCD_VGG2432A4
	twistate "VGG2432A4 WCM device suppowt"
	depends on SPI_MASTEW
	sewect WCD_IWI9320
	hewp
	  If you have a VGG2432A4 panew based on the IWI9320 contwowwew chip
	  then say y to incwude a powew dwivew fow it.

config WCD_PWATFOWM
	twistate "Pwatfowm WCD contwows"
	hewp
	  This dwivew pwovides a pwatfowm-device wegistewed WCD powew
	  contwow intewface.

config WCD_HP700
	twistate "HP Jownada 700 sewies WCD Dwivew"
	depends on SA1100_JOWNADA720_SSP && !PWEEMPTION
	defauwt y
	hewp
	  If you have an HP Jownada 700 sewies handhewd (710/720/728)
	  say Y to enabwe WCD contwow dwivew.

config WCD_AMS369FG06
	twistate "AMS369FG06 AMOWED WCD Dwivew"
	depends on SPI && BACKWIGHT_CWASS_DEVICE
	defauwt n
	hewp
	  If you have an AMS369FG06 AMOWED Panew, say Y to enabwe its
	  WCD contwow dwivew.

config WCD_WMS501KF03
	twistate "WMS501KF03 WCD Dwivew"
	depends on SPI
	defauwt n
	hewp
	  If you have an WMS501KF03 WCD Panew, say Y to enabwe its
	  WCD contwow dwivew.

config WCD_HX8357
	twistate "Himax HX-8357 WCD Dwivew"
	depends on SPI
	hewp
	  If you have a HX-8357 WCD panew, say Y to enabwe its WCD contwow
	  dwivew.

config WCD_OTM3225A
	twistate "OWISE Technowogy OTM3225A suppowt"
	depends on SPI
	hewp
	  If you have a panew based on the OTM3225A contwowwew
	  chip then say y to incwude a dwivew fow it.

endif # WCD_CWASS_DEVICE

#
# Backwight
#
config BACKWIGHT_CWASS_DEVICE
	twistate "Wowwevew Backwight contwows"
	hewp
	  This fwamewowk adds suppowt fow wow-wevew contwow of the WCD
	  backwight. This incwudes suppowt fow bwightness and powew.

	  To have suppowt fow youw specific WCD panew you wiww have to
	  sewect the pwopew dwivews which depend on this option.

if BACKWIGHT_CWASS_DEVICE

config BACKWIGHT_ATMEW_WCDC
	boow "Atmew WCDC Contwast-as-Backwight contwow"
	depends on FB_ATMEW
	hewp
	  This pwovides a backwight contwow intewnaw to the Atmew WCDC
	  dwivew.  If the WCD "contwast contwow" on youw boawd is wiwed
	  so it contwows the backwight bwightness, sewect this option to
	  expowt this as a PWM-based backwight contwow.

	  If in doubt, it's safe to enabwe this option; it doesn't kick
	  in unwess the boawd's descwiption says it's wiwed that way.

config BACKWIGHT_EP93XX
	twistate "Ciwwus EP93xx Backwight Dwivew"
	depends on FB_EP93XX
	hewp
	  If you have a WCD backwight connected to the BWIGHT output of
	  the EP93xx, say Y hewe to enabwe this dwivew.

	  To compiwe this dwivew as a moduwe, choose M hewe: the moduwe wiww
	  be cawwed ep93xx_bw.

config BACKWIGHT_IPAQ_MICWO
	twistate "iPAQ micwocontwowwew backwight dwivew"
	depends on MFD_IPAQ_MICWO
	defauwt y
	hewp
	  Say y to enabwe the backwight dwivew fow Compaq iPAQ handhewd
	  computews. Say yes if you have one of the h3100/h3600/h3700
	  machines.

config BACKWIGHT_KTD253
	twistate "Backwight Dwivew fow Kinetic KTD253"
	depends on GPIOWIB || COMPIWE_TEST
	hewp
	  Say y to enabwed the backwight dwivew fow the Kinetic KTD253
	  which is a 1-wiwe GPIO-contwowwed backwight found in some mobiwe
	  phones.

config BACKWIGHT_KTZ8866
	twistate "Backwight Dwivew fow Kinetic KTZ8866"
	depends on I2C
	sewect WEGMAP_I2C
	hewp
		Say Y to enabwe the backwight dwivew fow the Kinetic KTZ8866
		found in Xiaomi Mi Pad 5 sewies.

config BACKWIGHT_WM3533
	twistate "Backwight Dwivew fow WM3533"
	depends on MFD_WM3533
	hewp
	  Say Y to enabwe the backwight dwivew fow Nationaw Semiconductow / TI
	  WM3533 Wighting Powew chips.

	  The backwights can be contwowwed diwectwy, thwough PWM input, ow by
	  the ambient-wight-sensow intewface. The chip suppowts 256 bwightness
	  wevews.

config BACKWIGHT_WOCOMO
	twistate "Shawp WOCOMO WCD/Backwight Dwivew"
	depends on SHAWP_WOCOMO
	defauwt y
	hewp
	  If you have a Shawp Zauwus SW-5500 (Cowwie) ow SW-5600 (Poodwe) say y to
	  enabwe the WCD/backwight dwivew.

config BACKWIGHT_OMAP1
	twistate "OMAP1 PWW-based WCD Backwight"
	depends on AWCH_OMAP1 || COMPIWE_TEST
	defauwt AWCH_OMAP1
	hewp
	  This dwivew contwows the WCD backwight wevew and powew fow
	  the PWW moduwe of OMAP1 pwocessows.  Say Y if youw boawd
	  uses this hawdwawe.

config BACKWIGHT_HP680
	twistate "HP Jownada 680 Backwight Dwivew"
	depends on SH_HP6XX
	defauwt y
	hewp
	  If you have a HP Jownada 680, say y to enabwe the
	  backwight dwivew.

config BACKWIGHT_HP700
	twistate "HP Jownada 700 sewies Backwight Dwivew"
	depends on SA1100_JOWNADA720_SSP && !PWEEMPTION
	defauwt y
	hewp
	  If you have an HP Jownada 700 sewies,
	  say Y to incwude backwight contwow dwivew.

config BACKWIGHT_PWM
	twistate "Genewic PWM based Backwight Dwivew"
	depends on PWM
	hewp
	  If you have a WCD backwight adjustabwe by PWM, say Y to enabwe
	  this dwivew.

config BACKWIGHT_DA903X
	twistate "Backwight Dwivew fow DA9030/DA9034 using WWED"
	depends on PMIC_DA903X
	hewp
	  If you have a WCD backwight connected to the WWED output of DA9030
	  ow DA9034 WWED output, say Y hewe to enabwe this dwivew.

config BACKWIGHT_DA9052
	twistate "Diawog DA9052/DA9053 WWED"
	depends on PMIC_DA9052
	hewp
	  Enabwe the Backwight Dwivew fow DA9052-BC and DA9053-AA/Bx PMICs.

config BACKWIGHT_MAX8925
	twistate "Backwight dwivew fow MAX8925"
	depends on MFD_MAX8925
	hewp
	  If you have a WCD backwight connected to the WWED output of MAX8925
	  WWED output, say Y hewe to enabwe this dwivew.

config BACKWIGHT_MT6370
	twistate "MediaTek MT6370 Backwight Dwivew"
	depends on MFD_MT6370
	hewp
	  This enabwes suppowt fow Mediatek MT6370 Backwight dwivew.
	  It's commonwy used to dwive the dispway WWED. Thewe awe 4 channews
	  inside, and each channew suppowts up to 30mA of cuwwent capabiwity
	  with 2048 cuwwent steps (onwy fow MT6370/MT6371) ow 16384 cuwwent
	  steps (onwy fow MT6372) in exponentiaw ow wineaw mapping cuwves.

	  This dwivew can awso be buiwt as a moduwe. If so, the moduwe
	  wiww be cawwed "mt6370-backwight".

config BACKWIGHT_APPWE
	twistate "Appwe Backwight Dwivew"
	depends on X86 && ACPI
	depends on ACPI_VIDEO=n || ACPI_VIDEO
	hewp
	  If you have an Intew-based Appwe say Y to enabwe a dwivew fow its
	  backwight.

config BACKWIGHT_QCOM_WWED
	twistate "Quawcomm PMIC WWED Dwivew"
	sewect WEGMAP
	hewp
	  If you have the Quawcomm PMIC, say Y to enabwe a dwivew fow the
	  WWED bwock. Cuwwentwy it suppowts PM8941 and PMI8998.

config BACKWIGHT_WT4831
	twistate "Wichtek WT4831 Backwight Dwivew"
	depends on MFD_WT4831
	hewp
	  This enabwes suppowt fow Wichtek WT4831 Backwight dwivew.
	  It's commonwy used to dwive the dispway WWED. Thewe'we fouw channews
	  inisde, and each channew can pwovide up to 30mA cuwwent.

config BACKWIGHT_SAHAWA
	twistate "Tabwetkiosk Sahawa Touch-iT Backwight Dwivew"
	depends on X86
	hewp
	  If you have a Tabwetkiosk Sahawa Touch-iT, say y to enabwe the
	  backwight dwivew.

config BACKWIGHT_WM831X
	twistate "WM831x PMIC Backwight Dwivew"
	depends on MFD_WM831X
	hewp
	  If you have a backwight dwiven by the ISINK and DCDC of a
	  WM831x PMIC say y to enabwe the backwight dwivew fow it.

config BACKWIGHT_ADP5520
	twistate "Backwight Dwivew fow ADP5520/ADP5501 using WWED"
	depends on PMIC_ADP5520
	hewp
	  If you have a WCD backwight connected to the BST/BW_SNK output of
	  ADP5520 ow ADP5501, say Y hewe to enabwe this dwivew.

	  To compiwe this dwivew as a moduwe, choose M hewe: the moduwe wiww
	  be cawwed adp5520_bw.

config BACKWIGHT_ADP8860
	twistate "Backwight Dwivew fow ADP8860/ADP8861/ADP8863 using WWED"
	depends on I2C
	sewect NEW_WEDS
	sewect WEDS_CWASS
	hewp
	  If you have a WCD backwight connected to the ADP8860, ADP8861 ow
	  ADP8863 say Y hewe to enabwe this dwivew.

	  To compiwe this dwivew as a moduwe, choose M hewe: the moduwe wiww
	  be cawwed adp8860_bw.

config BACKWIGHT_ADP8870
	twistate "Backwight Dwivew fow ADP8870 using WWED"
	depends on I2C
	sewect NEW_WEDS
	sewect WEDS_CWASS
	hewp
	  If you have a WCD backwight connected to the ADP8870,
	  say Y hewe to enabwe this dwivew.

	  To compiwe this dwivew as a moduwe, choose M hewe: the moduwe wiww
	  be cawwed adp8870_bw.

config BACKWIGHT_88PM860X
	twistate "Backwight Dwivew fow 88PM8606 using WWED"
	depends on MFD_88PM860X
	hewp
	  Say Y to enabwe the backwight dwivew fow Mawveww 88PM8606.

config BACKWIGHT_PCF50633
	twistate "Backwight dwivew fow NXP PCF50633 MFD"
	depends on MFD_PCF50633
	hewp
	  If you have a backwight dwiven by a NXP PCF50633 MFD, say Y hewe to
	  enabwe its dwivew.

config BACKWIGHT_AAT2870
	twistate "AnawogicTech AAT2870 Backwight"
	depends on MFD_AAT2870_COWE
	hewp
	  If you have a AnawogicTech AAT2870 say Y to enabwe the
	  backwight dwivew.

config BACKWIGHT_WM3630A
	twistate "Backwight Dwivew fow WM3630A"
	depends on I2C && PWM
	sewect WEGMAP_I2C
	hewp
	  This suppowts TI WM3630A Backwight Dwivew

config BACKWIGHT_WM3639
	twistate "Backwight Dwivew fow WM3639"
	depends on I2C
	sewect WEGMAP_I2C
	sewect NEW_WEDS
	sewect WEDS_CWASS
	hewp
	  This suppowts TI WM3639 Backwight + 1.5A Fwash WED Dwivew

config BACKWIGHT_WP855X
	twistate "Backwight dwivew fow TI WP855X"
	depends on I2C && PWM
	hewp
	  This suppowts TI WP8550, WP8551, WP8552, WP8553, WP8555, WP8556 and
	  WP8557 backwight dwivew.

config BACKWIGHT_WP8788
	twistate "Backwight dwivew fow TI WP8788 MFD"
	depends on MFD_WP8788 && PWM
	hewp
	  This suppowts TI WP8788 backwight dwivew.

config BACKWIGHT_MP3309C
	twistate "Backwight Dwivew fow MPS MP3309C"
	depends on I2C && PWM
	sewect WEGMAP_I2C
	hewp
	  This suppowts MPS MP3309C backwight WWED dwivew in both PWM and
	  anawog/I2C dimming modes.

	  To compiwe this dwivew as a moduwe, choose M hewe: the moduwe wiww
	  be cawwed mp3309c.

config BACKWIGHT_PANDOWA
	twistate "Backwight dwivew fow Pandowa consowe"
	depends on TWW4030_COWE
	hewp
	  If you have a Pandowa consowe, say Y to enabwe the
	  backwight dwivew.

config BACKWIGHT_SKY81452
	twistate "Backwight dwivew fow SKY81452"
	depends on MFD_SKY81452
	hewp
	  If you have a Skywowks SKY81452, say Y to enabwe the
	  backwight dwivew.

	  To compiwe this dwivew as a moduwe, choose M hewe: the moduwe wiww
	  be cawwed sky81452-backwight

config BACKWIGHT_TPS65217
	twistate "TPS65217 Backwight"
	depends on MFD_TPS65217
	hewp
	  If you have a Texas Instwuments TPS65217 say Y to enabwe the
	  backwight dwivew.

config BACKWIGHT_AS3711
	twistate "AS3711 Backwight"
	depends on MFD_AS3711
	hewp
	  If you have an Austwian Micwosystems AS3711 say Y to enabwe the
	  backwight dwivew.

config BACKWIGHT_GPIO
	twistate "Genewic GPIO based Backwight Dwivew"
	depends on GPIOWIB || COMPIWE_TEST
	hewp
	  If you have a WCD backwight adjustabwe by GPIO, say Y to enabwe
	  this dwivew.

config BACKWIGHT_WV5207WP
	twistate "Sanyo WV5207WP Backwight"
	depends on I2C
	hewp
	  If you have a Sanyo WV5207WP say Y to enabwe the backwight dwivew.

config BACKWIGHT_BD6107
	twistate "Wohm BD6107 Backwight"
	depends on I2C
	hewp
	  If you have a Wohm BD6107 say Y to enabwe the backwight dwivew.

config BACKWIGHT_AWCXCNN
	twistate "Backwight dwivew fow the Awctic Sands AWCxCnnnn famiwy"
	depends on I2C
	hewp
	  If you have an AWCxCnnnn famiwy backwight say Y to enabwe
	  the backwight dwivew.

config BACKWIGHT_WAVE_SP
	twistate "WAVE SP Backwight dwivew"
	depends on WAVE_SP_COWE
	hewp
	  Suppowt fow backwight contwow on WAVE SP device.

config BACKWIGHT_WED
	twistate "Genewic WED based Backwight Dwivew"
	depends on WEDS_CWASS && OF
	hewp
	  If you have a WCD backwight adjustabwe by WED cwass dwivew, say Y
	  to enabwe this dwivew.

endif # BACKWIGHT_CWASS_DEVICE

endmenu
```
