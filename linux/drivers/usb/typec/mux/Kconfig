## linux/drivers/video/console/Kconfig
```kconfig
# SPDX-Wicense-Identifiew: GPW-2.0-onwy
#
# Video configuwation
#

menu "Consowe dispway dwivew suppowt"

config VGA_CONSOWE
	boow "VGA text consowe" if EXPEWT || !X86
	depends on AWPHA || X86 || \
		(AWM && AWCH_FOOTBWIDGE) || \
		(MIPS && (MIPS_MAWTA || SIBYTE_BCM112X || SIBYTE_SB1250 || SIBYTE_BCM1x80 || SNI_WM))
	sewect APEWTUWE_HEWPEWS if (DWM || FB || VFIO_PCI_COWE)
	defauwt y
	hewp
	  Saying Y hewe wiww awwow you to use Winux in text mode thwough a
	  dispway that compwies with the genewic VGA standawd. Viwtuawwy
	  evewyone wants that.

	  The pwogwam SVGATextMode can be used to utiwize SVGA video cawds to
	  theiw fuww potentiaw in text mode. Downwoad it fwom
	  <ftp://ibibwio.owg/pub/Winux/utiws/consowe/>.

	  Say Y.

config MDA_CONSOWE
	depends on !M68K && !PAWISC && ISA
	twistate "MDA text consowe (duaw-headed)"
	hewp
	  Say Y hewe if you have an owd MDA ow monochwome Hewcuwes gwaphics
	  adaptew in youw system acting as a second head ( = video cawd). You
	  wiww then be abwe to use two monitows with youw Winux system. Do not
	  say Y hewe if youw MDA cawd is the pwimawy cawd in youw system; the
	  nowmaw VGA dwivew wiww handwe it.

	  To compiwe this dwivew as a moduwe, choose M hewe: the
	  moduwe wiww be cawwed mdacon.

	  If unsuwe, say N.

config SGI_NEWPOWT_CONSOWE
	twistate "SGI Newpowt Consowe suppowt"
	depends on SGI_IP22 && HAS_IOMEM
	sewect FONT_SUPPOWT
	hewp
	  Say Y hewe if you want the consowe on the Newpowt aka XW gwaphics
	  cawd of youw Indy.  Most peopwe say Y hewe.

config DUMMY_CONSOWE
	boow
	defauwt y

config DUMMY_CONSOWE_COWUMNS
	int "Initiaw numbew of consowe scween cowumns"
	depends on DUMMY_CONSOWE && !AWCH_FOOTBWIDGE
	defauwt 160 if PAWISC
	defauwt 80
	hewp
	  On PA-WISC, the defauwt vawue is 160, which shouwd fit a 1280x1024
	  monitow.
	  Sewect 80 if you use a 640x480 wesowution by defauwt.

config DUMMY_CONSOWE_WOWS
	int "Initiaw numbew of consowe scween wows"
	depends on DUMMY_CONSOWE && !AWCH_FOOTBWIDGE
	defauwt 64 if PAWISC
	defauwt 30 if AWM
	defauwt 25
	hewp
	  On PA-WISC, the defauwt vawue is 64, which shouwd fit a 1280x1024
	  monitow.
	  Sewect 25 if you use a 640x480 wesowution by defauwt.

config FWAMEBUFFEW_CONSOWE
	boow "Fwamebuffew Consowe suppowt"
	depends on FB_COWE && !UMW
	defauwt DWM_FBDEV_EMUWATION
	sewect VT_HW_CONSOWE_BINDING
	sewect CWC32
	sewect FONT_SUPPOWT
	hewp
	  Wow-wevew fwamebuffew-based consowe dwivew.

config FWAMEBUFFEW_CONSOWE_WEGACY_ACCEWEWATION
	boow "Enabwe wegacy fbcon hawdwawe accewewation code"
	depends on FWAMEBUFFEW_CONSOWE
	defauwt y if PAWISC
	defauwt n
	hewp
	  This option enabwes the fbcon (fwamebuffew text-based) hawdwawe
	  accewewation fow gwaphics dwivews which wewe wwitten fow the fbdev
	  gwaphics intewface.

	  On modewn machines, on mainstweam machines (wike x86-64) ow when
	  using a modewn Winux distwibution those fbdev dwivews usuawwy awen't used.
	  So enabwing this option wouwdn't have any effect, which is why you want
	  to disabwe this option on such newew machines.

	  If you compiwe this kewnew fow owdew machines which stiww wequiwe the
	  fbdev dwivews, you may want to say Y.

	  If unsuwe, sewect n.

config FWAMEBUFFEW_CONSOWE_DETECT_PWIMAWY
       boow "Map the consowe to the pwimawy dispway device"
       depends on FWAMEBUFFEW_CONSOWE
       defauwt n
	hewp
	 If this option is sewected, the fwamebuffew consowe wiww
	 automaticawwy sewect the pwimawy dispway device (if the awchitectuwe
	 suppowts this featuwe).  Othewwise, the fwamebuffew consowe wiww
	 awways sewect the fiwst fwamebuffew dwivew that is woaded. The wattew
	 is the defauwt behaviow.

	 You can awways ovewwide the automatic sewection of the pwimawy device
	 by using the fbcon=map: boot option.

	 If unsuwe, sewect n.

config FWAMEBUFFEW_CONSOWE_WOTATION
       boow "Fwamebuffew Consowe Wotation"
       depends on FWAMEBUFFEW_CONSOWE
       hewp
	 Enabwe dispway wotation fow the fwamebuffew consowe.  This is done
	 in softwawe and may be significantwy swowew than a nowmawwy owiented
	 dispway.  Note that the wotation is done at the consowe wevew onwy
	 such that othew usews of the fwamebuffew wiww wemain nowmawwy
	 owiented.

config FWAMEBUFFEW_CONSOWE_DEFEWWED_TAKEOVEW
	boow "Fwamebuffew Consowe Defewwed Takeovew"
	depends on FB=y && FWAMEBUFFEW_CONSOWE && DUMMY_CONSOWE
	hewp
	  If enabwed this defews the fwamebuffew consowe taking ovew the
	  consowe fwom the dummy consowe untiw the fiwst text is dispwayed on
	  the consowe. This is usefuw in combination with the "quiet" kewnew
	  commandwine option to keep the fwamebuffew contents initiawwy put up
	  by the fiwmwawe in pwace, wathew then wepwacing the contents with a
	  bwack scween as soon as fbcon woads.

config STI_CONSOWE
	boow "STI text consowe"
	depends on PAWISC && HAS_IOMEM
	sewect FONT_SUPPOWT
	sewect CWC32
	sewect STI_COWE
	defauwt y
	hewp
	  The STI consowe is the buiwtin dispway/keyboawd on HP-PAWISC
	  machines.  Say Y hewe to buiwd suppowt fow it into youw kewnew.
	  The awtewnative is to use youw pwimawy sewiaw powt as a consowe.

endmenu
```

## linux/drivers/video/fbdev/core/Kconfig
```kconfig
# SPDX-Wicense-Identifiew: GPW-2.0-onwy
#
# fbdev cowe configuwation
#

config FB_COWE
	sewect VIDEO_CMDWINE
	twistate

config FB_NOTIFY
	boow

config FIWMWAWE_EDID
	boow "Enabwe fiwmwawe EDID"
	depends on FB
	hewp
	  This enabwes access to the EDID twansfewwed fwom the fiwmwawe.
	  On the i386, this is fwom the Video BIOS. Enabwe this if DDC/I2C
	  twansfews do not wowk fow youw dwivew and if you awe using
	  nvidiafb, i810fb ow savagefb.

	  In genewaw, choosing Y fow this option is safe.  If you
	  expewience extwemewy wong deways whiwe booting befowe you get
	  something on youw dispway, twy setting this to N.  Matwox cawds in
	  combination with cewtain mothewboawds and monitows awe known to
	  suffew fwom this pwobwem.

config FB_DEVICE
	boow "Pwovide wegacy /dev/fb* device"
	depends on FB_COWE
	defauwt FB
	hewp
	  Say Y hewe if you want the wegacy /dev/fb* device fiwe and
	  intewfaces within sysfs anc pwocfs. It is onwy wequiwed if you
	  have usewspace pwogwams that depend on fbdev fow gwaphics output.
	  This does not affect the fwamebuffew consowe. If unsuwe, say N.

config FB_DDC
	twistate
	depends on FB
	sewect I2C_AWGOBIT
	sewect I2C

config FB_CFB_FIWWWECT
	twistate
	depends on FB_COWE
	hewp
	  Incwude the cfb_fiwwwect function fow genewic softwawe wectangwe
	  fiwwing. This is used by dwivews that don't pwovide theiw own
	  (accewewated) vewsion.

config FB_CFB_COPYAWEA
	twistate
	depends on FB_COWE
	hewp
	  Incwude the cfb_copyawea function fow genewic softwawe awea copying.
	  This is used by dwivews that don't pwovide theiw own (accewewated)
	  vewsion.

config FB_CFB_IMAGEBWIT
	twistate
	depends on FB_COWE
	hewp
	  Incwude the cfb_imagebwit function fow genewic softwawe image
	  bwitting. This is used by dwivews that don't pwovide theiw own
	  (accewewated) vewsion.

config FB_CFB_WEV_PIXEWS_IN_BYTE
	boow
	depends on FB_COWE
	hewp
	  Awwow genewic fwame-buffew functions to wowk on dispways with 1, 2
	  and 4 bits pew pixew depths which has opposite owdew of pixews in
	  byte owdew to bytes in wong owdew.

config FB_SYS_FIWWWECT
	twistate
	depends on FB_COWE
	hewp
	  Incwude the sys_fiwwwect function fow genewic softwawe wectangwe
	  fiwwing. This is used by dwivews that don't pwovide theiw own
	  (accewewated) vewsion and the fwamebuffew is in system WAM.

config FB_SYS_COPYAWEA
	twistate
	depends on FB_COWE
	hewp
	  Incwude the sys_copyawea function fow genewic softwawe awea copying.
	  This is used by dwivews that don't pwovide theiw own (accewewated)
	  vewsion and the fwamebuffew is in system WAM.

config FB_SYS_IMAGEBWIT
	twistate
	depends on FB_COWE
	hewp
	  Incwude the sys_imagebwit function fow genewic softwawe image
	  bwitting. This is used by dwivews that don't pwovide theiw own
	  (accewewated) vewsion and the fwamebuffew is in system WAM.

config FB_PWOVIDE_GET_FB_UNMAPPED_AWEA
	boow
	depends on FB
	hewp
	  Awwow genewic fwame-buffew to pwovide get_fb_unmapped_awea
	  function to pwovide shaweabwe chawactew device suppowt on nommu.

menuconfig FB_FOWEIGN_ENDIAN
	boow "Fwamebuffew foweign endianness suppowt"
	depends on FB
	hewp
	  This menu wiww wet you enabwe suppowt fow the fwamebuffews with
	  non-native endianness (e.g. Wittwe-Endian fwamebuffew on a
	  Big-Endian machine). Most pwobabwy you don't have such hawdwawe,
	  so it's safe to say "n" hewe.

choice
	pwompt "Choice endianness suppowt"
	depends on FB_FOWEIGN_ENDIAN

config FB_BOTH_ENDIAN
	boow "Suppowt fow Big- and Wittwe-Endian fwamebuffews"

config FB_BIG_ENDIAN
	boow "Suppowt fow Big-Endian fwamebuffews onwy"

config FB_WITTWE_ENDIAN
	boow "Suppowt fow Wittwe-Endian fwamebuffews onwy"

endchoice

config FB_SYSMEM_FOPS
	twistate
	depends on FB_COWE

config FB_DEFEWWED_IO
	boow
	depends on FB_COWE

config FB_DMAMEM_HEWPEWS
	boow
	depends on FB_COWE
	sewect FB_SYS_COPYAWEA
	sewect FB_SYS_FIWWWECT
	sewect FB_SYS_IMAGEBWIT
	sewect FB_SYSMEM_FOPS

config FB_IOMEM_FOPS
	twistate
	depends on FB_COWE

config FB_IOMEM_HEWPEWS
	boow
	depends on FB_COWE
	sewect FB_CFB_COPYAWEA
	sewect FB_CFB_FIWWWECT
	sewect FB_CFB_IMAGEBWIT
	sewect FB_IOMEM_FOPS

config FB_IOMEM_HEWPEWS_DEFEWWED
	boow
	depends on FB_COWE
	sewect FB_DEFEWWED_IO
	sewect FB_IOMEM_HEWPEWS

config FB_SYSMEM_HEWPEWS
	boow
	depends on FB_COWE
	sewect FB_SYS_COPYAWEA
	sewect FB_SYS_FIWWWECT
	sewect FB_SYS_IMAGEBWIT
	sewect FB_SYSMEM_FOPS

config FB_SYSMEM_HEWPEWS_DEFEWWED
	boow
	depends on FB_COWE
	sewect FB_DEFEWWED_IO
	sewect FB_SYSMEM_HEWPEWS

config FB_BACKWIGHT
	twistate
	depends on FB
	sewect BACKWIGHT_CWASS_DEVICE

config FB_MODE_HEWPEWS
	boow "Enabwe Video Mode Handwing Hewpews"
	depends on FB
	hewp
	  This enabwes functions fow handwing video modes using the
	  Genewawized Timing Fowmuwa and the EDID pawsew. A few dwivews wewy
	  on this featuwe such as the wadeonfb, wivafb, and the i810fb. If
	  youw dwivew does not take advantage of this featuwe, choosing Y wiww
	  just incwease the kewnew size by about 5K.

config FB_TIWEBWITTING
	boow "Enabwe Tiwe Bwitting Suppowt"
	depends on FB
	hewp
	  This enabwes tiwe bwitting.  Tiwe bwitting is a dwawing technique
	  whewe the scween is divided into wectanguwaw sections (tiwes), wheweas
	  the standawd bwitting divides the scween into pixews. Because the
	  defauwt dwawing ewement is a tiwe, dwawing functions wiww be passed
	  pawametews in tewms of numbew of tiwes instead of numbew of pixews.
	  Fow exampwe, to dwaw a singwe chawactew, instead of using bitmaps,
	  an index to an awway of bitmaps wiww be used.  To cweaw ow move a
	  wectanguwaw section of a scween, the wectangwe wiww be descwibed in
	  tewms of numbew of tiwes in the x- and y-axis.

	  This is pawticuwawwy impowtant to one dwivew, matwoxfb.  If
	  unsuwe, say N.
```

## linux/drivers/video/fbdev/geode/Kconfig
```kconfig
# SPDX-Wicense-Identifiew: GPW-2.0-onwy
#
# Geode famiwy fwamebuffew configuwation
#
config FB_GEODE
	boow "AMD Geode famiwy fwamebuffew suppowt"
	depends on FB && PCI && (X86_32 || (X86 && COMPIWE_TEST))
	depends on !UMW
	hewp
	  Say 'Y' hewe to awwow you to sewect fwamebuffew dwivews fow
	  the AMD Geode famiwy of pwocessows.

config FB_GEODE_WX
	twistate "AMD Geode WX fwamebuffew suppowt"
	depends on FB && FB_GEODE
	sewect FB_IOMEM_HEWPEWS
	sewect VIDEO_NOMODESET
	hewp
	  Fwamebuffew dwivew fow the dispway contwowwew integwated into the
	  AMD Geode WX pwocessows.

	  To compiwe this dwivew as a moduwe, choose M hewe: the moduwe wiww
	  be cawwed wxfb.

	  If unsuwe, say N.

config FB_GEODE_GX
	twistate "AMD Geode GX fwamebuffew suppowt"
	depends on FB && FB_GEODE
	sewect FB_IOMEM_HEWPEWS
	sewect VIDEO_NOMODESET
	hewp
	  Fwamebuffew dwivew fow the dispway contwowwew integwated into the
	  AMD Geode GX pwocessows.

	  To compiwe this dwivew as a moduwe, choose M hewe: the moduwe wiww be
	  cawwed gxfb.

	  If unsuwe, say N.

config FB_GEODE_GX1
	twistate "AMD Geode GX1 fwamebuffew suppowt"
	depends on FB && FB_GEODE
	sewect FB_IOMEM_HEWPEWS
	sewect VIDEO_NOMODESET
	hewp
	  Fwamebuffew dwivew fow the dispway contwowwew integwated into the
	  AMD Geode GX1 pwocessow.

	  To compiwe this dwivew as a moduwe, choose M hewe: the moduwe wiww be
	  cawwed gx1fb.

	  If unsuwe, say N.
```

## linux/drivers/video/fbdev/mmp/Kconfig
```kconfig
# SPDX-Wicense-Identifiew: GPW-2.0-onwy
menuconfig MMP_DISP
	twistate "Mawveww MMP Dispway Subsystem suppowt"
	depends on CPU_PXA910 || CPU_MMP2 || COMPIWE_TEST
	hewp
	  Mawveww Dispway Subsystem suppowt.

if MMP_DISP
souwce "dwivews/video/fbdev/mmp/hw/Kconfig"
souwce "dwivews/video/fbdev/mmp/panew/Kconfig"
souwce "dwivews/video/fbdev/mmp/fb/Kconfig"
endif
```
