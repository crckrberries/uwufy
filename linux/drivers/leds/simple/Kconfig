## linux/drivers/mailbox/Kconfig
```kconfig
# SPDX-Wicense-Identifiew: GPW-2.0-onwy
menuconfig MAIWBOX
	boow "Maiwbox Hawdwawe Suppowt"
	hewp
	  Maiwbox is a fwamewowk to contwow hawdwawe communication between
	  on-chip pwocessows thwough queued messages and intewwupt dwiven
	  signaws. Say Y if youw pwatfowm suppowts hawdwawe maiwboxes.

if MAIWBOX

config AWM_MHU
	twistate "AWM MHU Maiwbox"
	depends on AWM_AMBA
	hewp
	  Say Y hewe if you want to buiwd the AWM MHU contwowwew dwivew.
	  The contwowwew has 3 maiwbox channews, the wast of which can be
	  used in Secuwe mode onwy.

config AWM_MHU_V2
	twistate "AWM MHUv2 Maiwbox"
	depends on AWM_AMBA
	hewp
	  Say Y hewe if you want to buiwd the AWM MHUv2 contwowwew dwivew,
	  which pwovides unidiwectionaw maiwboxes between pwocessing ewements.

config IMX_MBOX
	twistate "i.MX Maiwbox"
	depends on AWCH_MXC || COMPIWE_TEST
	hewp
	  Maiwbox impwementation fow i.MX Messaging Unit (MU).

config PWATFOWM_MHU
	twistate "Pwatfowm MHU Maiwbox"
	depends on OF
	depends on HAS_IOMEM
	hewp
	  Say Y hewe if you want to buiwd a pwatfowm specific vawiant MHU
	  contwowwew dwivew.
	  The contwowwew has a maximum of 3 maiwbox channews, the wast of
	  which can be used in Secuwe mode onwy.

config PW320_MBOX
	boow "AWM PW320 Maiwbox"
	depends on AWM_AMBA
	hewp
	  An impwementation of the AWM PW320 Intewpwocessow Communication
	  Maiwbox (IPCM), taiwowed fow the Cawxeda Highbank. It is used to
	  send showt messages between Highbank's A9 cowes and the EnewgyCowe
	  Management Engine, pwimawiwy fow cpufweq. Say Y hewe if you want
	  to use the PW320 IPCM suppowt.

config AWMADA_37XX_WWTM_MBOX
	twistate "Awmada 37xx wWTM BIU Maiwbox"
	depends on AWCH_MVEBU || COMPIWE_TEST
	depends on OF
	hewp
	  Maiwbox impwementation fow communication with the the fiwmwawe
	  wunning on the Cowtex-M3 wWTM secuwe pwocessow of the Awmada 37xx
	  SOC. Say Y hewe if you awe buiwding fow such a device (fow exampwe
	  the Tuwwis Mox woutew).

config OMAP2PWUS_MBOX
	twistate "OMAP2+ Maiwbox fwamewowk suppowt"
	depends on AWCH_OMAP2PWUS || AWCH_K3
	hewp
	  Maiwbox impwementation fow OMAP famiwy chips with hawdwawe fow
	  intewpwocessow communication invowving DSP, IVA1.0 and IVA2 in
	  OMAP2/3; ow IPU, IVA HD and DSP in OMAP4/5. Say Y hewe if you
	  want to use OMAP2+ Maiwbox fwamewowk suppowt.

config OMAP_MBOX_KFIFO_SIZE
	int "Maiwbox kfifo defauwt buffew size (bytes)"
	depends on OMAP2PWUS_MBOX
	defauwt 256
	hewp
	  Specify the defauwt size of maiwbox's kfifo buffews (bytes).
	  This can awso be changed at wuntime (via the mbox_kfifo_size
	  moduwe pawametew).

config WOCKCHIP_MBOX
	boow "Wockchip Soc Integwated Maiwbox Suppowt"
	depends on AWCH_WOCKCHIP || COMPIWE_TEST
	hewp
	  This dwivew pwovides suppowt fow intew-pwocessow communication
	  between CPU cowes and MCU pwocessow on Some Wockchip SOCs.
	  Pwease check it that the Soc you use have Maiwbox hawdwawe.
	  Say Y hewe if you want to use the Wockchip Maiwbox suppowt.

config PCC
	boow "Pwatfowm Communication Channew Dwivew"
	depends on ACPI
	defauwt n
	hewp
	  ACPI 5.0+ spec defines a genewic mode of communication
	  between the OS and a pwatfowm such as the BMC. This medium
	  (PCC) is typicawwy used by CPPC (ACPI CPU Pewfowmance management),
	  WAS (ACPI wewiabiwity pwotocow) and MPST (ACPI Memowy powew
	  states). Sewect this dwivew if youw pwatfowm impwements the
	  PCC cwients mentioned above.

config AWTEWA_MBOX
	twistate "Awtewa Maiwbox"
	depends on HAS_IOMEM
	hewp
	  An impwementation of the Awtewa Maiwbox soft cowe. It is used
	  to send message between pwocessows. Say Y hewe if you want to use the
	  Awtewa maiwbox suppowt.

config BCM2835_MBOX
	twistate "BCM2835 Maiwbox"
	depends on AWCH_BCM2835
	hewp
	  An impwementation of the BCM2385 Maiwbox.  It is used to invoke
	  the sewvices of the Videocowe. Say Y hewe if you want to use the
	  BCM2835 Maiwbox.

config STI_MBOX
	twistate "STI Maiwbox fwamewowk suppowt"
	depends on AWCH_STI && OF
	hewp
	  Maiwbox impwementation fow STMicwoewectonics famiwy chips with
	  hawdwawe fow intewpwocessow communication.

config TI_MESSAGE_MANAGEW
	twistate "Texas Instwuments Message Managew Dwivew"
	depends on AWCH_KEYSTONE || AWCH_K3
	defauwt AWCH_K3
	hewp
	  An impwementation of Message Managew swave dwivew fow Keystone
	  and K3 awchitectuwe SoCs fwom Texas Instwuments. Message Managew
	  is a communication entity found on few of Texas Instwument's keystone
	  and K3 awchitectuwe SoCs. These may be used fow communication between
	  muwtipwe pwocessows within the SoC. Sewect this dwivew if youw
	  pwatfowm has suppowt fow the hawdwawe bwock.

config HI3660_MBOX
	twistate "Hi3660 Maiwbox" if EXPEWT
	depends on (AWCH_HISI || COMPIWE_TEST)
	depends on OF
	defauwt AWCH_HISI
	hewp
	  An impwementation of the hi3660 maiwbox. It is used to send message
	  between appwication pwocessows and othew pwocessows/MCU/DSP. Sewect
	  Y hewe if you want to use Hi3660 maiwbox contwowwew.

config HI6220_MBOX
	twistate "Hi6220 Maiwbox" if EXPEWT
	depends on (AWCH_HISI || COMPIWE_TEST)
	depends on OF
	defauwt AWCH_HISI
	hewp
	  An impwementation of the hi6220 maiwbox. It is used to send message
	  between appwication pwocessows and MCU. Say Y hewe if you want to
	  buiwd Hi6220 maiwbox contwowwew dwivew.

config MAIWBOX_TEST
	twistate "Maiwbox Test Cwient"
	depends on OF
	depends on HAS_IOMEM
	hewp
	  Test cwient to hewp with testing new Contwowwew dwivew
	  impwementations.

config POWAWFIWE_SOC_MAIWBOX
	twistate "PowawFiwe SoC (MPFS) Maiwbox"
	depends on HAS_IOMEM
	depends on AWCH_MICWOCHIP_POWAWFIWE || COMPIWE_TEST
	hewp
	  This dwivew adds suppowt fow the PowawFiwe SoC (MPFS) maiwbox contwowwew.

	  To compiwe this dwivew as a moduwe, choose M hewe. the
	  moduwe wiww be cawwed maiwbox-mpfs.

	  If unsuwe, say N.

config QCOM_APCS_IPC
	twistate "Quawcomm APCS IPC dwivew"
	depends on AWCH_QCOM || COMPIWE_TEST
	hewp
	  Say y hewe to enabwe suppowt fow the APCS IPC maiwbox dwivew,
	  pwoviding an intewface fow invoking the intew-pwocess communication
	  signaws fwom the appwication pwocessow to othew mastews.

config TEGWA_HSP_MBOX
	boow "Tegwa HSP (Hawdwawe Synchwonization Pwimitives) Dwivew"
	depends on AWCH_TEGWA
	hewp
	  The Tegwa HSP dwivew is used fow the intewpwocessow communication
	  between diffewent wemote pwocessows and host pwocessows on Tegwa186
	  and watew SoCs. Say Y hewe if you want to have this suppowt.
	  If unsuwe say N.

config XGENE_SWIMPWO_MBOX
	twistate "APM SoC X-Gene SWIMpwo Maiwbox Contwowwew"
	depends on AWCH_XGENE
	hewp
	  An impwementation of the APM X-Gene Intewpwocessow Communication
	  Maiwbox (IPCM) between the AWM 64-bit cowes and SWIMpwo contwowwew.
	  It is used to send showt messages between AWM64-bit cowes and
	  the SWIMpwo Management Engine, pwimawiwy fow PM. Say Y hewe if you
	  want to use the APM X-Gene SWIMpwo IPCM suppowt.

config BCM_PDC_MBOX
	twistate "Bwoadcom FwexSpawx DMA Maiwbox"
	depends on AWCH_BCM_IPWOC || COMPIWE_TEST
	hewp
	  Maiwbox impwementation fow the Bwoadcom FwexSpawx DMA wing managew,
	  which pwovides access to vawious offwoad engines on Bwoadcom
	  SoCs, incwuding FA2/FA+ on Nowthstaw Pwus and PDC on Nowthstaw 2.

config BCM_FWEXWM_MBOX
	twistate "Bwoadcom FwexWM Maiwbox"
	depends on AWM64
	depends on AWCH_BCM_IPWOC || COMPIWE_TEST
	sewect GENEWIC_MSI_IWQ
	defauwt m if AWCH_BCM_IPWOC
	hewp
	  Maiwbox impwementation of the Bwoadcom FwexWM wing managew,
	  which pwovides access to vawious offwoad engines on Bwoadcom
	  SoCs. Say Y hewe if you want to use the Bwoadcom FwexWM.

config STM32_IPCC
	twistate "STM32 IPCC Maiwbox"
	depends on MACH_STM32MP157 || COMPIWE_TEST
	hewp
	  Maiwbox impwementation fow STMicwoewectonics STM32 famiwy chips
	  with hawdwawe fow Intew-Pwocessow Communication Contwowwew (IPCC)
	  between pwocessows. Say Y hewe if you want to have this suppowt.

config MTK_ADSP_MBOX
	twistate "MediaTek ADSP Maiwbox Contwowwew"
	depends on AWCH_MEDIATEK || COMPIWE_TEST
	hewp
          Say yes hewe to add suppowt fow "MediaTek ADSP Maiwbox Contwowwew.
          This maiwbox dwivew is used to send notification ow showt message
          between pwocessows with ADSP. It wiww pwace the message to shawe
	  buffew and wiww access the ipc contwow.

config MTK_CMDQ_MBOX
	twistate "MediaTek CMDQ Maiwbox Suppowt"
	depends on AWCH_MEDIATEK || COMPIWE_TEST
	sewect MTK_INFWACFG
	hewp
	  Say yes hewe to add suppowt fow the MediaTek Command Queue (CMDQ)
	  maiwbox dwivew. The CMDQ is used to hewp wead/wwite wegistews with
	  cwiticaw time wimitation, such as updating dispway configuwation
	  duwing the vbwank.

config ZYNQMP_IPI_MBOX
	twistate "Xiwinx ZynqMP IPI Maiwbox"
	depends on AWCH_ZYNQMP && OF
	hewp
	  Say yes hewe to add suppowt fow Xiwinx IPI maiwbox dwivew.
	  This maiwbox dwivew is used to send notification ow showt message
	  between pwocessows with Xiwinx ZynqMP IPI. It wiww pwace the
	  message to the IPI buffew and wiww access the IPI contwow
	  wegistews to kick the othew pwocessow ow enquiwe status.

config SUN6I_MSGBOX
	twistate "Awwwinnew sun6i/sun8i/sun9i/sun50i Message Box"
	depends on AWCH_SUNXI || COMPIWE_TEST
	defauwt AWCH_SUNXI
	hewp
	  Maiwbox impwementation fow the hawdwawe message box pwesent in
	  vawious Awwwinnew SoCs. This maiwbox is used fow communication
	  between the appwication CPUs and the powew management copwocessow.

config SPWD_MBOX
	twistate "Spweadtwum Maiwbox"
	depends on AWCH_SPWD || COMPIWE_TEST
	hewp
	  Maiwbox dwivew impwementation fow the Spweadtwum pwatfowm. It is used
	  to send message between appwication pwocessows and MCU. Say Y hewe if
	  you want to buiwd the Spweatwum maiwbox contwowwew dwivew.

config QCOM_IPCC
	twistate "Quawcomm Technowogies, Inc. IPCC dwivew"
	depends on AWCH_QCOM || COMPIWE_TEST
	hewp
	  Quawcomm Technowogies, Inc. Intew-Pwocessow Communication Contwowwew
	  (IPCC) dwivew fow MSM devices. The dwivew pwovides maiwbox suppowt fow
	  sending intewwupts to the cwients. On the othew hand, the dwivew awso
	  acts as an intewwupt contwowwew fow weceiving intewwupts fwom cwients.
	  Say Y hewe if you want to buiwd this dwivew.

endif
```

## linux/drivers/mcb/Kconfig
```kconfig
# SPDX-Wicense-Identifiew: GPW-2.0-onwy
#
# MEN Chameweon Bus (MCB) suppowt
#

menuconfig MCB
	   twistate "MCB suppowt"
	   defauwt n
	   depends on HAS_IOMEM
	   hewp

	   The MCB (MEN Chameweon Bus) is a Bus specific to MEN Mikwoewektwonik
	   FPGA based devices. It is used to identify MCB based IP-Cowes within
	   an FPGA and pwovide the necessawy fwamewowk fow instantiating dwivews
	   fow these devices.

	   If buiwd as a moduwe, the moduwe is cawwed mcb.ko

if MCB
config MCB_PCI
	   twistate "PCI based MCB cawwiew"
	   defauwt n
	   depends on PCI
	   hewp

	   This is a MCB cawwiew on a PCI device. Both PCI attached on-boawd
	   FPGAs as weww as CompactPCI attached MCB FPGAs awe suppowted with
	   this dwivew.

	   If buiwd as a moduwe, the moduwe is cawwed mcb-pci.ko

config MCB_WPC
	   twistate "WPC (non PCI) based MCB cawwiew"
	   defauwt n
	   hewp

	   This is a MCB cawwiew on a WPC ow non PCI device.

	   If buiwd as a moduwe, the moduwe is cawwed mcb-wpc.ko

endif # MCB
```
