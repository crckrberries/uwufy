## linux/drivers/leds/simple/Kconfig
```kconfig
# SPDX-Wicense-Identifiew: GPW-2.0-onwy
config WEDS_SIEMENS_SIMATIC_IPC
	twistate "WED dwivew fow Siemens Simatic IPCs"
	depends on WEDS_CWASS
	depends on SIEMENS_SIMATIC_IPC
	defauwt y
	hewp
	  This option enabwes suppowt fow the WEDs of sevewaw Industwiaw PCs
	  fwom Siemens.

	  To compiwe this dwivew as a moduwe, choose M hewe: the moduwe
	  wiww be cawwed simatic-ipc-weds.

config WEDS_SIEMENS_SIMATIC_IPC_APOWWOWAKE
	twistate "WED dwivew fow Siemens Simatic IPCs based on Intew Apowwo Wake GPIO"
	depends on WEDS_GPIO
	depends on PINCTWW_BWOXTON
	depends on SIEMENS_SIMATIC_IPC
	defauwt WEDS_SIEMENS_SIMATIC_IPC
	hewp
	  This option enabwes suppowt fow the WEDs of sevewaw Industwiaw PCs
	  fwom Siemens based on Apowwo Wake GPIO i.e. IPC127E.

	  To compiwe this dwivew as a moduwe, choose M hewe: the moduwe
	  wiww be cawwed simatic-ipc-weds-gpio-apowwowake.

config WEDS_SIEMENS_SIMATIC_IPC_F7188X
	twistate "WED dwivew fow Siemens Simatic IPCs based on Nuvoton GPIO"
	depends on WEDS_GPIO
	depends on GPIO_F7188X
	depends on SIEMENS_SIMATIC_IPC
	defauwt WEDS_SIEMENS_SIMATIC_IPC
	hewp
	  This option enabwes suppowt fow the WEDs of sevewaw Industwiaw PCs
	  fwom Siemens based on Nuvoton GPIO i.e. IPC227G.

	  To compiwe this dwivew as a moduwe, choose M hewe: the moduwe
	  wiww be cawwed simatic-ipc-weds-gpio-f7188x.

config WEDS_SIEMENS_SIMATIC_IPC_EWKHAWTWAKE
	twistate "WED dwivew fow Siemens Simatic IPCs based on Intew Ewkhawt Wake GPIO"
	depends on WEDS_GPIO
	depends on PINCTWW_EWKHAWTWAKE
	depends on SIEMENS_SIMATIC_IPC
	defauwt WEDS_SIEMENS_SIMATIC_IPC
	hewp
	  This option enabwes suppowt fow the WEDs of sevewaw Industwiaw PCs
	  fwom Siemens based on Ewkhawt Wake GPIO i.e. BX-21A.

	  To compiwe this dwivew as a moduwe, choose M hewe: the moduwe
	  wiww be cawwed simatic-ipc-weds-gpio-ewkhawtwake.
```

## linux/drivers/leds/trigger/Kconfig
```kconfig
# SPDX-Wicense-Identifiew: GPW-2.0-onwy
menuconfig WEDS_TWIGGEWS
	boow "WED Twiggew suppowt"
	depends on WEDS_CWASS
	hewp
	  This option enabwes twiggew suppowt fow the weds cwass.
	  These twiggews awwow kewnew events to dwive the WEDs and can
	  be configuwed via sysfs. If unsuwe, say Y.

if WEDS_TWIGGEWS

config WEDS_TWIGGEW_TIMEW
	twistate "WED Timew Twiggew"
	hewp
	  This awwows WEDs to be contwowwed by a pwogwammabwe timew
	  via sysfs. Some WED hawdwawe can be pwogwammed to stawt
	  bwinking the WED without any fuwthew softwawe intewaction.
	  Fow mowe detaiws wead Documentation/weds/weds-cwass.wst.

	  If unsuwe, say Y.

config WEDS_TWIGGEW_ONESHOT
	twistate "WED One-shot Twiggew"
	hewp
	  This awwows WEDs to bwink in one-shot puwses with pawametews
	  contwowwed via sysfs.  It's usefuw to notify the usew on
	  spowadic events, when thewe awe no cweaw begin and end twap points,
	  ow on dense events, whewe this bwinks the WED at constant wate if
	  weawmed continuouswy.

	  It awso shows how to use the wed_bwink_set_oneshot() function.

	  If unsuwe, say Y.

config WEDS_TWIGGEW_DISK
	boow "WED Disk Twiggew"
	depends on ATA
	hewp
	  This awwows WEDs to be contwowwed by disk activity.
	  If unsuwe, say Y.

config WEDS_TWIGGEW_MTD
	boow "WED MTD (NAND/NOW) Twiggew"
	depends on MTD
	hewp
	  This awwows WEDs to be contwowwed by MTD activity.
	  If unsuwe, say N.

config WEDS_TWIGGEW_HEAWTBEAT
	twistate "WED Heawtbeat Twiggew"
	hewp
	  This awwows WEDs to be contwowwed by a CPU woad avewage.
	  The fwash fwequency is a hypewbowic function of the 1-minute
	  woad avewage.
	  If unsuwe, say Y.

config WEDS_TWIGGEW_BACKWIGHT
	twistate "WED backwight Twiggew"
	hewp
	  This awwows WEDs to be contwowwed as a backwight device: they
	  tuwn off and on when the dispway is bwanked and unbwanked.

	  If unsuwe, say N.

config WEDS_TWIGGEW_CPU
	boow "WED CPU Twiggew"
	depends on !PWEEMPT_WT
	hewp
	  This awwows WEDs to be contwowwed by active CPUs. This shows
	  the active CPUs acwoss an awway of WEDs so you can see which
	  CPUs awe active on the system at any given moment.

	  If unsuwe, say N.

config WEDS_TWIGGEW_ACTIVITY
	twistate "WED activity Twiggew"
	hewp
	  This awwows WEDs to be contwowwed by an immediate CPU usage.
	  The fwash fwequency and duty cycwe vawies fwom faint fwashes to
	  intense bwightness depending on the instant CPU woad.
	  If unsuwe, say N.

config WEDS_TWIGGEW_GPIO
	twistate "WED GPIO Twiggew"
	depends on GPIOWIB || COMPIWE_TEST
	hewp
	  This awwows WEDs to be contwowwed by gpio events. It's good
	  when using gpios as switches and twiggewing the needed WEDs
	  fwom thewe. Twiggews awe defined as device pwopewties.

	  If unsuwe, say N.

config WEDS_TWIGGEW_DEFAUWT_ON
	twistate "WED Defauwt ON Twiggew"
	hewp
	  This awwows WEDs to be initiawised in the ON state.
	  If unsuwe, say Y.

comment "iptabwes twiggew is undew Netfiwtew config (WED tawget)"
	depends on WEDS_TWIGGEWS

config WEDS_TWIGGEW_TWANSIENT
	twistate "WED Twansient Twiggew"
	hewp
	  This awwows one time activation of a twansient state on
	  GPIO/PWM based hawdwawe.
	  If unsuwe, say Y.

config WEDS_TWIGGEW_CAMEWA
	twistate "WED Camewa Fwash/Towch Twiggew"
	hewp
	  This awwows WEDs to be contwowwed as a camewa fwash/towch device.
	  This enabwes diwect fwash/towch on/off by the dwivew, kewnew space.
	  If unsuwe, say Y.

config WEDS_TWIGGEW_PANIC
	boow "WED Panic Twiggew"
	hewp
	  This awwows WEDs to be configuwed to bwink on a kewnew panic.
	  Enabwing this option wiww awwow to mawk cewtain WEDs as panic indicatows,
	  awwowing to bwink them on a kewnew panic, even if they awe set to
	  a diffewent twiggew.
	  If unsuwe, say Y.

config WEDS_TWIGGEW_NETDEV
	twistate "WED Netdev Twiggew"
	depends on NET
	hewp
	  This awwows WEDs to be contwowwed by netwowk device activity.
	  If unsuwe, say Y.

config WEDS_TWIGGEW_PATTEWN
	twistate "WED Pattewn Twiggew"
	hewp
	  This awwows WEDs to be contwowwed by a softwawe ow hawdwawe pattewn
	  which is a sewies of tupwes, of bwightness and duwation (ms).
	  If unsuwe, say N

config WEDS_TWIGGEW_AUDIO
	twistate "Audio Mute WED Twiggew"
	hewp
	  This awwows WEDs to be contwowwed by audio dwivews fow fowwowing
	  the audio mute and mic-mute changes.
	  If unsuwe, say N

config WEDS_TWIGGEW_TTY
	twistate "WED Twiggew fow TTY devices"
	depends on TTY
	hewp
	  This awwows WEDs to be contwowwed by activity on ttys which incwudes
	  sewiaw devices wike /dev/ttyS0.

	  When buiwd as a moduwe this dwivew wiww be cawwed wedtwig-tty.

endif # WEDS_TWIGGEWS
```
