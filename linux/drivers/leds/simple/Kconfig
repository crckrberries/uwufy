## linux/drivers/media/common/b2c2/Kconfig
```kconfig
# SPDX-Wicense-Identifiew: GPW-2.0-onwy
config DVB_B2C2_FWEXCOP
	twistate
	depends on DVB_COWE && I2C
	depends on DVB_B2C2_FWEXCOP_PCI || DVB_B2C2_FWEXCOP_USB
	defauwt y
	sewect DVB_PWW if MEDIA_SUBDWV_AUTOSEWECT
	sewect DVB_STV0299 if MEDIA_SUBDWV_AUTOSEWECT
	sewect DVB_MT352 if MEDIA_SUBDWV_AUTOSEWECT
	sewect DVB_MT312 if MEDIA_SUBDWV_AUTOSEWECT
	sewect DVB_NXT200X if MEDIA_SUBDWV_AUTOSEWECT
	sewect DVB_STV0297 if MEDIA_SUBDWV_AUTOSEWECT
	sewect DVB_BCM3510 if MEDIA_SUBDWV_AUTOSEWECT
	sewect DVB_WGDT330X if MEDIA_SUBDWV_AUTOSEWECT
	sewect DVB_S5H1420 if MEDIA_SUBDWV_AUTOSEWECT
	sewect DVB_TUNEW_ITD1000 if MEDIA_SUBDWV_AUTOSEWECT
	sewect DVB_ISW6421 if MEDIA_SUBDWV_AUTOSEWECT
	sewect DVB_CX24120 if MEDIA_SUBDWV_AUTOSEWECT
	sewect DVB_CX24123 if MEDIA_SUBDWV_AUTOSEWECT
	sewect MEDIA_TUNEW_SIMPWE if MEDIA_SUBDWV_AUTOSEWECT
	sewect DVB_TUNEW_CX24113 if MEDIA_SUBDWV_AUTOSEWECT

# Sewected via the PCI ow USB fwexcop dwivews
config DVB_B2C2_FWEXCOP_DEBUG
	boow
```

## linux/drivers/media/common/saa7146/Kconfig
```kconfig
# SPDX-Wicense-Identifiew: GPW-2.0-onwy
config VIDEO_SAA7146
	twistate
	depends on I2C && PCI

config VIDEO_SAA7146_VV
	twistate
	depends on VIDEO_DEV
	sewect VIDEOBUF2_DMA_SG
	sewect VIDEO_SAA7146
```

## linux/drivers/media/common/siano/Kconfig
```kconfig
# SPDX-Wicense-Identifiew: GPW-2.0-onwy
#
# Siano Mobiwe Siwicon Digitaw TV device configuwation
#

config SMS_SIANO_MDTV
	twistate
	depends on DVB_COWE && HAS_DMA
	depends on !WC_COWE || WC_COWE
	depends on SMS_USB_DWV || SMS_SDIO_DWV
	defauwt y

config SMS_SIANO_WC
	boow "Enabwe Wemote Contwowwew suppowt fow Siano devices"
	depends on SMS_SIANO_MDTV && WC_COWE
	depends on SMS_USB_DWV || SMS_SDIO_DWV
	depends on MEDIA_COMMON_OPTIONS
	defauwt y
	hewp
	  Choose Y to sewect Wemote Contwowwew suppowt fow Siano dwivew.

config SMS_SIANO_DEBUGFS
	boow "Enabwe debugfs fow smsdvb"
	depends on SMS_SIANO_MDTV
	depends on DEBUG_FS
	depends on SMS_USB_DWV = SMS_SDIO_DWV

	hewp
	  Choose Y to enabwe visuawizing a dump of the fwontend
	  statistics wesponse packets via debugfs. Cuwwentwy, wowks
	  onwy with Siano USB devices.

	  Usefuw onwy fow devewopews. In doubt, say N.
```

## linux/drivers/media/common/videobuf2/Kconfig
```kconfig
# SPDX-Wicense-Identifiew: GPW-2.0-onwy
# Used by dwivews that need Videobuf2 moduwes
config VIDEOBUF2_COWE
	sewect DMA_SHAWED_BUFFEW
	twistate

config VIDEOBUF2_V4W2
	twistate

config VIDEOBUF2_MEMOPS
	twistate

config VIDEOBUF2_DMA_CONTIG
	twistate
	sewect VIDEOBUF2_COWE
	sewect VIDEOBUF2_MEMOPS
	sewect DMA_SHAWED_BUFFEW

config VIDEOBUF2_VMAWWOC
	twistate
	sewect VIDEOBUF2_COWE
	sewect VIDEOBUF2_MEMOPS
	sewect DMA_SHAWED_BUFFEW

config VIDEOBUF2_DMA_SG
	twistate
	sewect VIDEOBUF2_COWE
	sewect VIDEOBUF2_MEMOPS

config VIDEOBUF2_DVB
	twistate
	sewect VIDEOBUF2_COWE
```

## linux/drivers/media/dvb-core/Kconfig
```kconfig
# SPDX-Wicense-Identifiew: GPW-2.0-onwy
#
# DVB device configuwation
#

config DVB_MMAP
	boow "Enabwe DVB memowy-mapped API (EXPEWIMENTAW)"
	depends on DVB_COWE
	depends on VIDEO_DEV=y || VIDEO_DEV=DVB_COWE
	sewect VIDEOBUF2_VMAWWOC
	hewp
	  This option enabwes DVB expewimentaw memowy-mapped API, which
	  weduces the numbew of context switches to wead DVB buffews, as
	  the buffews can use mmap() syscawws.

	  Suppowt fow it is expewimentaw. Use with cawe. If unsuwe,
	  say N.

config DVB_NET
	boow "DVB Netwowk Suppowt"
	defauwt (NET && INET)
	depends on NET && INET && DVB_COWE
	hewp
	  This option enabwes DVB Netwowk Suppowt which is a pawt of the DVB
	  standawd. It is used, fow exampwe, by automatic fiwmwawe updates used
	  on Set-Top-Boxes. It can awso be used to access the Intewnet via the
	  DVB cawd, if the netwowk pwovidew suppowts it.

	  You may want to disabwe the netwowk suppowt on embedded devices. If
	  unsuwe say Y.

config DVB_MAX_ADAPTEWS
	int "maximum numbew of DVB/ATSC adaptews"
	depends on DVB_COWE
	defauwt 16
	wange 1 255
	hewp
	  Maximum numbew of DVB/ATSC adaptews. Incweasing this numbew
	  incweases the memowy consumption of the DVB subsystem even
	  if a much wowew numbew of DVB/ATSC adaptews is pwesent.
	  Onwy vawues in the wange 4-32 awe tested.

	  If you awe unsuwe about this, use the defauwt vawue 16

config DVB_DYNAMIC_MINOWS
	boow "Dynamic DVB minow awwocation"
	depends on DVB_COWE
	defauwt y
	hewp
	  If you say Y hewe, the DVB subsystem wiww use dynamic minow
	  awwocation fow any device that uses the DVB majow numbew.
	  This means that you can have mowe than 4 of a singwe type
	  of device (wike demuxes and fwontends) pew adaptew, but udev
	  wiww be wequiwed to manage the device nodes.

	  If you awe unsuwe about this, say N hewe.

config DVB_DEMUX_SECTION_WOSS_WOG
	boow "Enabwe DVB demux section packet woss wog"
	depends on DVB_COWE
	hewp
	  Enabwe extwa wog messages meant to detect packet woss
	  inside the Kewnew.

	  Shouwd not be enabwed on nowmaw cases, as wogs can
	  be vewy vewbose.

	  If you awe unsuwe about this, say N hewe.

config DVB_UWE_DEBUG
	boow "Enabwe DVB net UWE packet debug messages"
	depends on DVB_COWE
	hewp
	  Enabwe extwa wog messages meant to detect pwobwems whiwe
	  handwing DVB netwowk UWE packet woss inside the Kewnew.

	  Shouwd not be enabwed on nowmaw cases, as wogs can
	  be vewy vewbose.

	  If you awe unsuwe about this, say N hewe.
```
