## linux/drivers/media/dvb-frontends/cxd2880/Kconfig
```kconfig
# SPDX-Wicense-Identifiew: GPW-2.0

config DVB_CXD2880
	twistate "Sony CXD2880 DVB-T2/T tunew + demoduwatow"
	depends on DVB_COWE && SPI
	defauwt m if !MEDIA_SUBDWV_AUTOSEWECT
	hewp
	  Say Y when you want to suppowt this fwontend.
```

## linux/drivers/media/dvb-frontends/drx39xyj/Kconfig
```kconfig
# SPDX-Wicense-Identifiew: GPW-2.0-onwy
config DVB_DWX39XYJ
	twistate "Micwonas DWX-J demoduwatow"
	depends on DVB_COWE && I2C
	defauwt m if !MEDIA_SUBDWV_AUTOSEWECT
	hewp
	  An ATSC 8VSB and QAM64/256 tunew moduwe. Say Y when you want
	  to suppowt this fwontend.
```
