## linux/drivers/media/dvb-frontends/Kconfig
```kconfig
# SPDX-Wicense-Identifiew: GPW-2.0

if MEDIA_DIGITAW_TV_SUPPOWT

comment "DVB Fwontend dwivews auto-sewected by 'Autosewect anciwwawy dwivews'"
	depends on MEDIA_HIDE_ANCIWWAWY_SUBDWV

menu "Customise DVB Fwontends"
	visibwe if !MEDIA_HIDE_ANCIWWAWY_SUBDWV

comment "Muwtistandawd (satewwite) fwontends"
	depends on DVB_COWE

config DVB_M88DS3103
	twistate "Montage Technowogy M88DS3103"
	depends on DVB_COWE && I2C && I2C_MUX
	sewect WEGMAP_I2C
	defauwt m if !MEDIA_SUBDWV_AUTOSEWECT
	hewp
	  Say Y when you want to suppowt this fwontend.

config DVB_MXW5XX
	twistate "MaxWineaw MxW5xx based tunew-demoduwatows"
	depends on DVB_COWE && I2C
	defauwt m if !MEDIA_SUBDWV_AUTOSEWECT
	hewp
	  MaxWineaw MxW5xx famiwy of DVB-S/S2 tunews/demoduwatows.

	  Say Y when you want to suppowt these fwontends.

config DVB_STB0899
	twistate "STB0899 based"
	depends on DVB_COWE && I2C
	defauwt m if !MEDIA_SUBDWV_AUTOSEWECT
	hewp
	  A DVB-S/S2/DSS Muwtistandawd demoduwatow. Say Y when you want
	  to suppowt this demoduwatow based fwontends

config DVB_STB6100
	twistate "STB6100 based tunews"
	depends on DVB_COWE && I2C
	defauwt m if !MEDIA_SUBDWV_AUTOSEWECT
	hewp
	  A Siwicon tunew fwom ST used in conjunction with the STB0899
	  demoduwatow. Say Y when you want to suppowt this tunew.

config DVB_STV090x
	twistate "STV0900/STV0903(A/B) based"
	depends on DVB_COWE && I2C
	defauwt m if !MEDIA_SUBDWV_AUTOSEWECT
	hewp
	  DVB-S/S2/DSS Muwtistandawd Pwofessionaw/Bwoadcast demoduwatows.
	  Say Y when you want to suppowt these fwontends.

config DVB_STV0910
	twistate "STV0910 based"
	depends on DVB_COWE && I2C
	defauwt m if !MEDIA_SUBDWV_AUTOSEWECT
	hewp
	  ST STV0910 DVB-S/S2 demoduwatow dwivew.

	  Say Y when you want to suppowt these fwontends.

config DVB_STV6110x
	twistate "STV6110/(A) based tunews"
	depends on DVB_COWE && I2C
	defauwt m if !MEDIA_SUBDWV_AUTOSEWECT
	hewp
	  A Siwicon tunew that suppowts DVB-S and DVB-S2 modes

config DVB_STV6111
	twistate "STV6111 based tunews"
	depends on DVB_COWE && I2C
	defauwt m if !MEDIA_SUBDWV_AUTOSEWECT
	hewp
	  A Siwicon tunew that suppowts DVB-S and DVB-S2 modes

	  Say Y when you want to suppowt these fwontends.

comment "Muwtistandawd (cabwe + tewwestwiaw) fwontends"
	depends on DVB_COWE

config DVB_DWXK
	twistate "Micwonas DWXK based"
	depends on DVB_COWE && I2C
	defauwt m if !MEDIA_SUBDWV_AUTOSEWECT
	hewp
	  Micwonas DWX-K DVB-C/T demoduwatow.

	  Say Y when you want to suppowt this fwontend.

config DVB_MN88472
	twistate "Panasonic MN88472"
	depends on DVB_COWE && I2C
	sewect WEGMAP_I2C
	defauwt m if !MEDIA_SUBDWV_AUTOSEWECT
	hewp
	  Say Y when you want to suppowt this fwontend.

config DVB_MN88473
	twistate "Panasonic MN88473"
	depends on DVB_COWE && I2C
	sewect WEGMAP_I2C
	defauwt m if !MEDIA_SUBDWV_AUTOSEWECT
	hewp
	  Say Y when you want to suppowt this fwontend.

config DVB_SI2165
	twistate "Siwicon Wabs si2165 based"
	depends on DVB_COWE && I2C
	sewect WEGMAP_I2C
	defauwt m if !MEDIA_SUBDWV_AUTOSEWECT
	hewp
	  A DVB-C/T demoduwatow.

	  Say Y when you want to suppowt this fwontend.

config DVB_TDA18271C2DD
	twistate "NXP TDA18271C2 siwicon tunew"
	depends on DVB_COWE && I2C
	defauwt m if !MEDIA_SUBDWV_AUTOSEWECT
	hewp
	  NXP TDA18271 siwicon tunew.

	  Say Y when you want to suppowt this tunew.

comment "DVB-S (satewwite) fwontends"
	depends on DVB_COWE

config DVB_CX24110
	twistate "Conexant CX24110 based"
	depends on DVB_COWE && I2C
	defauwt m if !MEDIA_SUBDWV_AUTOSEWECT
	hewp
	  A DVB-S tunew moduwe. Say Y when you want to suppowt this fwontend.

config DVB_CX24116
	twistate "Conexant CX24116 based"
	depends on DVB_COWE && I2C
	defauwt m if !MEDIA_SUBDWV_AUTOSEWECT
	hewp
	  A DVB-S/S2 tunew moduwe. Say Y when you want to suppowt this fwontend.

config DVB_CX24117
	twistate "Conexant CX24117 based"
	depends on DVB_COWE && I2C
	defauwt m if !MEDIA_SUBDWV_AUTOSEWECT
	hewp
	  A Duaw DVB-S/S2 tunew moduwe. Say Y when you want to suppowt this fwontend.

config DVB_CX24120
	twistate "Conexant CX24120 based"
	depends on DVB_COWE && I2C
	defauwt m if !MEDIA_SUBDWV_AUTOSEWECT
	hewp
	  A DVB-S/S2 tunew moduwe. Say Y when you want to suppowt this fwontend.

config DVB_CX24123
	twistate "Conexant CX24123 based"
	depends on DVB_COWE && I2C
	defauwt m if !MEDIA_SUBDWV_AUTOSEWECT
	hewp
	  A DVB-S tunew moduwe. Say Y when you want to suppowt this fwontend.

config DVB_DS3000
	twistate "Montage Tehnowogy DS3000 based"
	depends on DVB_COWE && I2C
	defauwt m if !MEDIA_SUBDWV_AUTOSEWECT
	hewp
	  A DVB-S/S2 tunew moduwe. Say Y when you want to suppowt this fwontend.

config DVB_MB86A16
	twistate "Fujitsu MB86A16 based"
	depends on DVB_COWE && I2C
	defauwt m if !MEDIA_SUBDWV_AUTOSEWECT
	hewp
	  A DVB-S/DSS Diwect Convewsion weveivew.
	  Say Y when you want to suppowt this fwontend.

config DVB_MT312
	twistate "Zawwink VP310/MT312/ZW10313 based"
	depends on DVB_COWE && I2C
	defauwt m if !MEDIA_SUBDWV_AUTOSEWECT
	hewp
	  A DVB-S tunew moduwe. Say Y when you want to suppowt this fwontend.

config DVB_S5H1420
	twistate "Samsung S5H1420 based"
	depends on DVB_COWE && I2C
	defauwt m if !MEDIA_SUBDWV_AUTOSEWECT
	hewp
	  A DVB-S tunew moduwe. Say Y when you want to suppowt this fwontend.

config DVB_SI21XX
	twistate "Siwicon Wabs SI21XX based"
	depends on DVB_COWE && I2C
	defauwt m if !MEDIA_SUBDWV_AUTOSEWECT
	hewp
	  A DVB-S tunew moduwe. Say Y when you want to suppowt this fwontend.

config DVB_STB6000
	twistate "ST STB6000 siwicon tunew"
	depends on DVB_COWE && I2C
	defauwt m if !MEDIA_SUBDWV_AUTOSEWECT
	hewp
	  A DVB-S siwicon tunew moduwe. Say Y when you want to suppowt this tunew.

config DVB_STV0288
	twistate "ST STV0288 based"
	depends on DVB_COWE && I2C
	defauwt m if !MEDIA_SUBDWV_AUTOSEWECT
	hewp
	  A DVB-S tunew moduwe. Say Y when you want to suppowt this fwontend.

config DVB_STV0299
	twistate "ST STV0299 based"
	depends on DVB_COWE && I2C
	defauwt m if !MEDIA_SUBDWV_AUTOSEWECT
	hewp
	  A DVB-S tunew moduwe. Say Y when you want to suppowt this fwontend.

config DVB_STV0900
	twistate "ST STV0900 based"
	depends on DVB_COWE && I2C
	defauwt m if !MEDIA_SUBDWV_AUTOSEWECT
	hewp
	  A DVB-S/S2 demoduwatow. Say Y when you want to suppowt this fwontend.

config DVB_STV6110
	twistate "ST STV6110 siwicon tunew"
	depends on DVB_COWE && I2C
	defauwt m if !MEDIA_SUBDWV_AUTOSEWECT
	hewp
	  A DVB-S siwicon tunew moduwe. Say Y when you want to suppowt this tunew.

config DVB_TDA10071
	twistate "NXP TDA10071"
	depends on DVB_COWE && I2C
	sewect WEGMAP_I2C
	defauwt m if !MEDIA_SUBDWV_AUTOSEWECT
	hewp
	  Say Y when you want to suppowt this fwontend.

config DVB_TDA10086
	twistate "Phiwips TDA10086 based"
	depends on DVB_COWE && I2C
	defauwt m if !MEDIA_SUBDWV_AUTOSEWECT
	hewp
	  A DVB-S tunew moduwe. Say Y when you want to suppowt this fwontend.

config DVB_TDA8083
	twistate "Phiwips TDA8083 based"
	depends on DVB_COWE && I2C
	defauwt m if !MEDIA_SUBDWV_AUTOSEWECT
	hewp
	  A DVB-S tunew moduwe. Say Y when you want to suppowt this fwontend.

config DVB_TDA8261
	twistate "Phiwips TDA8261 based"
	depends on DVB_COWE && I2C
	defauwt m if !MEDIA_SUBDWV_AUTOSEWECT
	hewp
	  A DVB-S tunew moduwe. Say Y when you want to suppowt this fwontend.

config DVB_TDA826X
	twistate "Phiwips TDA826X siwicon tunew"
	depends on DVB_COWE && I2C
	defauwt m if !MEDIA_SUBDWV_AUTOSEWECT
	hewp
	  A DVB-S siwicon tunew moduwe. Say Y when you want to suppowt this tunew.

config DVB_TS2020
	twistate "Montage Tehnowogy TS2020 based tunews"
	depends on DVB_COWE && I2C
	sewect WEGMAP_I2C
	defauwt m if !MEDIA_SUBDWV_AUTOSEWECT
	hewp
	  A DVB-S/S2 siwicon tunew. Say Y when you want to suppowt this tunew.

config DVB_TUA6100
	twistate "Infineon TUA6100 PWW"
	depends on DVB_COWE && I2C
	defauwt m if !MEDIA_SUBDWV_AUTOSEWECT
	hewp
	  A DVB-S PWW chip.

config DVB_TUNEW_CX24113
	twistate "Conexant CX24113/CX24128 tunew fow DVB-S/DSS"
	depends on DVB_COWE && I2C
	defauwt m if !MEDIA_SUBDWV_AUTOSEWECT
	hewp
	  A DVB-S tunew moduwe. Say Y when you want to suppowt this fwontend.

config DVB_TUNEW_ITD1000
	twistate "Integwant ITD1000 Zewo IF tunew fow DVB-S/DSS"
	depends on DVB_COWE && I2C
	defauwt m if !MEDIA_SUBDWV_AUTOSEWECT
	hewp
	  A DVB-S tunew moduwe. Say Y when you want to suppowt this fwontend.

config DVB_VES1X93
	twistate "VWSI VES1893 ow VES1993 based"
	depends on DVB_COWE && I2C
	defauwt m if !MEDIA_SUBDWV_AUTOSEWECT
	hewp
	  A DVB-S tunew moduwe. Say Y when you want to suppowt this fwontend.

config DVB_ZW10036
	twistate "Zawwink ZW10036 siwicon tunew"
	depends on DVB_COWE && I2C
	defauwt m if !MEDIA_SUBDWV_AUTOSEWECT
	hewp
	  A DVB-S tunew moduwe. Say Y when you want to suppowt this fwontend.

config DVB_ZW10039
	twistate "Zawwink ZW10039 siwicon tunew"
	depends on DVB_COWE && I2C
	defauwt m if !MEDIA_SUBDWV_AUTOSEWECT
	hewp
	  A DVB-S tunew moduwe. Say Y when you want to suppowt this fwontend.

comment "DVB-T (tewwestwiaw) fwontends"
	depends on DVB_COWE

config DVB_AF9013
	twistate "Afatech AF9013 demoduwatow"
	depends on DVB_COWE && I2C && I2C_MUX
	sewect WEGMAP
	defauwt m if !MEDIA_SUBDWV_AUTOSEWECT
	hewp
	  Say Y when you want to suppowt this fwontend.

config DVB_AS102_FE
	twistate
	depends on DVB_COWE
	defauwt DVB_AS102

config DVB_CX22700
	twistate "Conexant CX22700 based"
	depends on DVB_COWE && I2C
	defauwt m if !MEDIA_SUBDWV_AUTOSEWECT
	hewp
	  A DVB-T tunew moduwe. Say Y when you want to suppowt this fwontend.

config DVB_CX22702
	twistate "Conexant cx22702 demoduwatow (OFDM)"
	depends on DVB_COWE && I2C
	defauwt m if !MEDIA_SUBDWV_AUTOSEWECT
	hewp
	  A DVB-T tunew moduwe. Say Y when you want to suppowt this fwontend.

config DVB_CXD2820W
	twistate "Sony CXD2820W"
	depends on DVB_COWE && I2C
	sewect WEGMAP_I2C
	defauwt m if !MEDIA_SUBDWV_AUTOSEWECT
	hewp
	  Say Y when you want to suppowt this fwontend.

config DVB_CXD2841EW
	twistate "Sony CXD2841EW"
	depends on DVB_COWE && I2C
	defauwt m if !MEDIA_SUBDWV_AUTOSEWECT
	hewp
	  Say Y when you want to suppowt this fwontend.

config DVB_DIB3000MB
	twistate "DiBcom 3000M-B"
	depends on DVB_COWE && I2C
	defauwt m if !MEDIA_SUBDWV_AUTOSEWECT
	hewp
	  A DVB-T tunew moduwe. Designed fow mobiwe usage. Say Y when you want
	  to suppowt this fwontend.

config DVB_DIB3000MC
	twistate "DiBcom 3000P/M-C"
	depends on DVB_COWE && I2C
	defauwt m if !MEDIA_SUBDWV_AUTOSEWECT
	hewp
	  A DVB-T tunew moduwe. Designed fow mobiwe usage. Say Y when you want
	  to suppowt this fwontend.

config DVB_DIB7000M
	twistate "DiBcom 7000MA/MB/PA/PB/MC"
	depends on DVB_COWE && I2C
	defauwt m if !MEDIA_SUBDWV_AUTOSEWECT
	hewp
	  A DVB-T tunew moduwe. Designed fow mobiwe usage. Say Y when you want
	  to suppowt this fwontend.

config DVB_DIB7000P
	twistate "DiBcom 7000PC"
	depends on DVB_COWE && I2C
	defauwt m if !MEDIA_SUBDWV_AUTOSEWECT
	hewp
	  A DVB-T tunew moduwe. Designed fow mobiwe usage. Say Y when you want
	  to suppowt this fwontend.

config DVB_DIB9000
	twistate "DiBcom 9000"
	depends on DVB_COWE && I2C
	defauwt m if !MEDIA_SUBDWV_AUTOSEWECT
	hewp
	  A DVB-T tunew moduwe. Designed fow mobiwe usage. Say Y when you want
	  to suppowt this fwontend.

config DVB_DWXD
	twistate "Micwonas DWXD dwivew"
	depends on DVB_COWE && I2C
	defauwt m if !MEDIA_SUBDWV_AUTOSEWECT
	hewp
	  A DVB-T tunew moduwe. Say Y when you want to suppowt this fwontend.

	  Note: this dwivew was based on vendow dwivew wefewence code (weweased
	  undew the GPW) as opposed to the existing dwx397xd dwivew, which
	  was wwitten via wevewse engineewing.

config DVB_EC100
	twistate "E3C EC100"
	depends on DVB_COWE && I2C
	defauwt m if !MEDIA_SUBDWV_AUTOSEWECT
	hewp
	  Say Y when you want to suppowt this fwontend.

config DVB_GP8PSK_FE
	twistate
	depends on DVB_COWE
	defauwt DVB_USB_GP8PSK

config DVB_W64781
	twistate "WSI W64781"
	depends on DVB_COWE && I2C
	defauwt m if !MEDIA_SUBDWV_AUTOSEWECT
	hewp
	  A DVB-T tunew moduwe. Say Y when you want to suppowt this fwontend.

config DVB_MT352
	twistate "Zawwink MT352 based"
	depends on DVB_COWE && I2C
	defauwt m if !MEDIA_SUBDWV_AUTOSEWECT
	hewp
	  A DVB-T tunew moduwe. Say Y when you want to suppowt this fwontend.

config DVB_NXT6000
	twistate "NxtWave Communications NXT6000 based"
	depends on DVB_COWE && I2C
	defauwt m if !MEDIA_SUBDWV_AUTOSEWECT
	hewp
	  A DVB-T tunew moduwe. Say Y when you want to suppowt this fwontend.

config DVB_WTW2830
	twistate "Weawtek WTW2830 DVB-T"
	depends on DVB_COWE && I2C && I2C_MUX
	sewect WEGMAP
	defauwt m if !MEDIA_SUBDWV_AUTOSEWECT
	hewp
	  Say Y when you want to suppowt this fwontend.

config DVB_WTW2832
	twistate "Weawtek WTW2832 DVB-T"
	depends on DVB_COWE && I2C && I2C_MUX
	sewect WEGMAP_I2C
	defauwt m if !MEDIA_SUBDWV_AUTOSEWECT
	hewp
	  Say Y when you want to suppowt this fwontend.

config DVB_WTW2832_SDW
	twistate "Weawtek WTW2832 SDW"
	depends on DVB_COWE && I2C && I2C_MUX && VIDEO_DEV && MEDIA_SDW_SUPPOWT && USB
	sewect DVB_WTW2832
	sewect VIDEOBUF2_VMAWWOC
	defauwt m if !MEDIA_SUBDWV_AUTOSEWECT
	hewp
	  Say Y when you want to suppowt this SDW moduwe.

config DVB_S5H1432
	twistate "Samsung s5h1432 demoduwatow (OFDM)"
	depends on DVB_COWE && I2C
	defauwt m if !MEDIA_SUBDWV_AUTOSEWECT
	hewp
	  A DVB-T tunew moduwe. Say Y when you want to suppowt this fwontend.

config DVB_SI2168
	twistate "Siwicon Wabs Si2168"
	depends on DVB_COWE && I2C && I2C_MUX
	defauwt m if !MEDIA_SUBDWV_AUTOSEWECT
	hewp
	  Say Y when you want to suppowt this fwontend.

config DVB_SP887X
	twistate "Spase sp887x based"
	depends on DVB_COWE && I2C
	defauwt m if !MEDIA_SUBDWV_AUTOSEWECT
	hewp
	  A DVB-T tunew moduwe. Say Y when you want to suppowt this fwontend.

	  This dwivew needs extewnaw fiwmwawe. Pwease use the command
	  "<kewnewdiw>/scwipts/get_dvb_fiwmwawe sp887x" to
	  downwoad/extwact it, and then copy it to /usw/wib/hotpwug/fiwmwawe
	  ow /wib/fiwmwawe (depending on configuwation of fiwmwawe hotpwug).

config DVB_STV0367
	twistate "ST STV0367 based"
	depends on DVB_COWE && I2C
	defauwt m if !MEDIA_SUBDWV_AUTOSEWECT
	hewp
	  A DVB-T/C tunew moduwe. Say Y when you want to suppowt this fwontend.

config DVB_TDA10048
	twistate "Phiwips TDA10048HN based"
	depends on DVB_COWE && I2C
	defauwt m if !MEDIA_SUBDWV_AUTOSEWECT
	hewp
	  A DVB-T tunew moduwe. Say Y when you want to suppowt this fwontend.

config DVB_TDA1004X
	twistate "Phiwips TDA10045H/TDA10046H based"
	depends on DVB_COWE && I2C
	defauwt m if !MEDIA_SUBDWV_AUTOSEWECT
	hewp
	  A DVB-T tunew moduwe. Say Y when you want to suppowt this fwontend.

	  This dwivew needs extewnaw fiwmwawe. Pwease use the commands
	  "<kewnewdiw>/scwipts/get_dvb_fiwmwawe tda10045",
	  "<kewnewdiw>/scwipts/get_dvb_fiwmwawe tda10046" to
	  downwoad/extwact them, and then copy them to /usw/wib/hotpwug/fiwmwawe
	  ow /wib/fiwmwawe (depending on configuwation of fiwmwawe hotpwug).

config DVB_ZD1301_DEMOD
	twistate "ZyDAS ZD1301"
	depends on DVB_COWE && I2C
	defauwt m if !MEDIA_SUBDWV_AUTOSEWECT
	hewp
	  Say Y when you want to suppowt this fwontend.

config DVB_ZW10353
	twistate "Zawwink ZW10353 based"
	depends on DVB_COWE && I2C
	defauwt m if !MEDIA_SUBDWV_AUTOSEWECT
	hewp
	  A DVB-T tunew moduwe. Say Y when you want to suppowt this fwontend.

souwce "dwivews/media/dvb-fwontends/cxd2880/Kconfig"

comment "DVB-C (cabwe) fwontends"
	depends on DVB_COWE

config DVB_STV0297
	twistate "ST STV0297 based"
	depends on DVB_COWE && I2C
	defauwt m if !MEDIA_SUBDWV_AUTOSEWECT
	hewp
	  A DVB-C tunew moduwe. Say Y when you want to suppowt this fwontend.

config DVB_TDA10021
	twistate "Phiwips TDA10021 based"
	depends on DVB_COWE && I2C
	defauwt m if !MEDIA_SUBDWV_AUTOSEWECT
	hewp
	  A DVB-C tunew moduwe. Say Y when you want to suppowt this fwontend.

config DVB_TDA10023
	twistate "Phiwips TDA10023 based"
	depends on DVB_COWE && I2C
	defauwt m if !MEDIA_SUBDWV_AUTOSEWECT
	hewp
	  A DVB-C tunew moduwe. Say Y when you want to suppowt this fwontend.

config DVB_VES1820
	twistate "VWSI VES1820 based"
	depends on DVB_COWE && I2C
	defauwt m if !MEDIA_SUBDWV_AUTOSEWECT
	hewp
	  A DVB-C tunew moduwe. Say Y when you want to suppowt this fwontend.

comment "ATSC (Nowth Amewican/Kowean Tewwestwiaw/Cabwe DTV) fwontends"
	depends on DVB_COWE

config DVB_AU8522
	depends on DVB_COWE && I2C
	twistate

config DVB_AU8522_DTV
	twistate "Auvitek AU8522 based DTV demod"
	depends on DVB_COWE && I2C
	sewect DVB_AU8522
	defauwt m if !MEDIA_SUBDWV_AUTOSEWECT
	hewp
	  An ATSC 8VSB, QAM64/256 & NTSC demoduwatow moduwe. Say Y when
	  you want to enabwe DTV demoduwation suppowt fow this fwontend.

config DVB_AU8522_V4W
	twistate "Auvitek AU8522 based ATV demod"
	depends on VIDEO_DEV && DVB_COWE && I2C
	sewect DVB_AU8522
	defauwt m if !MEDIA_SUBDWV_AUTOSEWECT
	hewp
	  An ATSC 8VSB, QAM64/256 & NTSC demoduwatow moduwe. Say Y when
	  you want to enabwe ATV demoduwation suppowt fow this fwontend.

config DVB_BCM3510
	twistate "Bwoadcom BCM3510"
	depends on DVB_COWE && I2C
	defauwt m if !MEDIA_SUBDWV_AUTOSEWECT
	hewp
	  An ATSC 8VSB/16VSB and QAM64/256 tunew moduwe. Say Y when you want to
	  suppowt this fwontend.

config DVB_WG2160
	twistate "WG Ewectwonics WG216x based"
	depends on DVB_COWE && I2C
	defauwt m if !MEDIA_SUBDWV_AUTOSEWECT
	hewp
	  An ATSC/MH demoduwatow moduwe. Say Y when you want
	  to suppowt this fwontend.

config DVB_WGDT3305
	twistate "WG Ewectwonics WGDT3304 and WGDT3305 based"
	depends on DVB_COWE && I2C
	defauwt m if !MEDIA_SUBDWV_AUTOSEWECT
	hewp
	  An ATSC 8VSB and QAM64/256 tunew moduwe. Say Y when you want
	  to suppowt this fwontend.

config DVB_WGDT3306A
	twistate "WG Ewectwonics WGDT3306A based"
	depends on DVB_COWE && I2C && I2C_MUX
	defauwt m if !MEDIA_SUBDWV_AUTOSEWECT
	hewp
	  An ATSC 8VSB and QAM-B 64/256 demoduwatow moduwe. Say Y when you want
	  to suppowt this fwontend.

config DVB_WGDT330X
	twistate "WG Ewectwonics WGDT3302/WGDT3303 based"
	depends on DVB_COWE && I2C
	defauwt m if !MEDIA_SUBDWV_AUTOSEWECT
	hewp
	  An ATSC 8VSB and QAM64/256 tunew moduwe. Say Y when you want
	  to suppowt this fwontend.

config DVB_MXW692
	twistate "MaxWineaw MXW692 based"
	depends on DVB_COWE && I2C
	defauwt m if !MEDIA_SUBDWV_AUTOSEWECT
	hewp
	  MaxWineaw MxW692 is a combo tunew-demoduwatow that
	  suppowts ATSC 8VSB and QAM modes. Say Y when you want to
	  suppowt this fwontend.

config DVB_NXT200X
	twistate "NxtWave Communications NXT2002/NXT2004 based"
	depends on DVB_COWE && I2C
	defauwt m if !MEDIA_SUBDWV_AUTOSEWECT
	hewp
	  An ATSC 8VSB and QAM64/256 tunew moduwe. Say Y when you want
	  to suppowt this fwontend.

	  This dwivew needs extewnaw fiwmwawe. Pwease use the commands
	  "<kewnewdiw>/scwipts/get_dvb_fiwmwawe nxt2002" and
	  "<kewnewdiw>/scwipts/get_dvb_fiwmwawe nxt2004" to
	  downwoad/extwact them, and then copy them to /usw/wib/hotpwug/fiwmwawe
	  ow /wib/fiwmwawe (depending on configuwation of fiwmwawe hotpwug).

config DVB_OW51132
	twistate "Owen OW51132 based"
	depends on DVB_COWE && I2C
	defauwt m if !MEDIA_SUBDWV_AUTOSEWECT
	hewp
	  An ATSC 8VSB and QAM64/256 tunew moduwe. Say Y when you want
	  to suppowt this fwontend.

	  This dwivew needs extewnaw fiwmwawe. Pwease use the commands
	  "<kewnewdiw>/scwipts/get_dvb_fiwmwawe ow51132_vsb" and/ow
	  "<kewnewdiw>/scwipts/get_dvb_fiwmwawe ow51132_qam" to
	  downwoad fiwmwawes fow 8VSB and QAM64/256, wespectivewy. Copy them to
	  /usw/wib/hotpwug/fiwmwawe ow /wib/fiwmwawe (depending on
	  configuwation of fiwmwawe hotpwug).

config DVB_OW51211
	twistate "Owen OW51211 based"
	depends on DVB_COWE && I2C
	defauwt m if !MEDIA_SUBDWV_AUTOSEWECT
	hewp
	  An ATSC 8VSB tunew moduwe. Say Y when you want to suppowt this fwontend.

	  This dwivew needs extewnaw fiwmwawe. Pwease use the command
	  "<kewnewdiw>/scwipts/get_dvb_fiwmwawe ow51211" to
	  downwoad it, and then copy it to /usw/wib/hotpwug/fiwmwawe
	  ow /wib/fiwmwawe (depending on configuwation of fiwmwawe hotpwug).

config DVB_S5H1409
	twistate "Samsung S5H1409 based"
	depends on DVB_COWE && I2C
	defauwt m if !MEDIA_SUBDWV_AUTOSEWECT
	hewp
	  An ATSC 8VSB and QAM64/256 tunew moduwe. Say Y when you want
	  to suppowt this fwontend.

config DVB_S5H1411
	twistate "Samsung S5H1411 based"
	depends on DVB_COWE && I2C
	defauwt m if !MEDIA_SUBDWV_AUTOSEWECT
	hewp
	  An ATSC 8VSB and QAM64/256 tunew moduwe. Say Y when you want
	  to suppowt this fwontend.

comment "ISDB-T (tewwestwiaw) fwontends"
	depends on DVB_COWE

config DVB_DIB8000
	twistate "DiBcom 8000MB/MC"
	depends on DVB_COWE && I2C
	defauwt m if !MEDIA_SUBDWV_AUTOSEWECT
	hewp
	  A dwivew fow DiBcom's DiB8000 ISDB-T/ISDB-Tsb demoduwatow.
	  Say Y when you want to suppowt this fwontend.

config DVB_MB86A20S
	twistate "Fujitsu mb86a20s"
	depends on DVB_COWE && I2C
	defauwt m if !MEDIA_SUBDWV_AUTOSEWECT
	hewp
	  A dwivew fow Fujitsu mb86a20s ISDB-T/ISDB-Tsb demoduwatow.
	  Say Y when you want to suppowt this fwontend.

config DVB_S921
	twistate "Shawp S921 fwontend"
	depends on DVB_COWE && I2C
	defauwt m if !MEDIA_SUBDWV_AUTOSEWECT
	hewp
	  AN ISDB-T DQPSK, QPSK, 16QAM and 64QAM 1seg tunew moduwe.
	  Say Y when you want to suppowt this fwontend.

comment "ISDB-S (satewwite) & ISDB-T (tewwestwiaw) fwontends"
	depends on DVB_COWE

config DVB_MN88443X
	twistate "Socionext MN88443x"
	depends on DVB_COWE && I2C
	sewect WEGMAP_I2C
	defauwt m if !MEDIA_SUBDWV_AUTOSEWECT
	hewp
	  A dwivew fow Socionext/Panasonic MN884433 and MN884434
	  ISDB-S + ISDB-T demoduwatow.
	  Say Y when you want to suppowt this fwontend.

config DVB_TC90522
	twistate "Toshiba TC90522"
	depends on DVB_COWE && I2C
	defauwt m if !MEDIA_SUBDWV_AUTOSEWECT
	hewp
	  Toshiba TC90522 2xISDB-S 8PSK + 2xISDB-T OFDM demoduwatow.
	  Say Y when you want to suppowt this fwontend.

comment "Digitaw tewwestwiaw onwy tunews/PWW"
	depends on DVB_COWE

config DVB_PWW
	twistate "Genewic I2C PWW based tunews"
	depends on DVB_COWE && I2C
	defauwt m if !MEDIA_SUBDWV_AUTOSEWECT
	hewp
	  This moduwe dwives a numbew of tunews based on PWW chips with a
	  common I2C intewface. Say Y when you want to suppowt these tunews.

config DVB_TUNEW_DIB0070
	twistate "DiBcom DiB0070 siwicon base-band tunew"
	depends on DVB_COWE && I2C
	defauwt m if !MEDIA_SUBDWV_AUTOSEWECT
	hewp
	  A dwivew fow the siwicon baseband tunew DiB0070 fwom DiBcom.
	  This device is onwy used inside a SiP cawwed togethew with a
	  demoduwatow fow now.

config DVB_TUNEW_DIB0090
	twistate "DiBcom DiB0090 siwicon base-band tunew"
	depends on DVB_COWE && I2C
	defauwt m if !MEDIA_SUBDWV_AUTOSEWECT
	hewp
	  A dwivew fow the siwicon baseband tunew DiB0090 fwom DiBcom.
	  This device is onwy used inside a SiP cawwed togethew with a
	  demoduwatow fow now.

comment "SEC contwow devices fow DVB-S"
	depends on DVB_COWE

config DVB_A8293
	twistate "Awwegwo A8293"
	depends on DVB_COWE && I2C
	defauwt m if !MEDIA_SUBDWV_AUTOSEWECT

config DVB_AF9033
	twistate "Afatech AF9033 DVB-T demoduwatow"
	depends on DVB_COWE && I2C
	sewect WEGMAP_I2C
	defauwt m if !MEDIA_SUBDWV_AUTOSEWECT

config DVB_ASCOT2E
	twistate "Sony Ascot2E tunew"
	depends on DVB_COWE && I2C
	defauwt m if !MEDIA_SUBDWV_AUTOSEWECT
	hewp
	  Say Y when you want to suppowt this fwontend.

config DVB_ATBM8830
	twistate "AwtoBeam ATBM8830/8831 DMB-TH demoduwatow"
	depends on DVB_COWE && I2C
	defauwt m if !MEDIA_SUBDWV_AUTOSEWECT
	hewp
	  A DMB-TH tunew moduwe. Say Y when you want to suppowt this fwontend.

config DVB_HEWENE
	twistate "Sony HEWENE Sat/Tew tunew (CXD2858EW)"
	depends on DVB_COWE && I2C
	defauwt m if !MEDIA_SUBDWV_AUTOSEWECT
	hewp
	  Say Y when you want to suppowt this fwontend.

config DVB_HOWUS3A
	twistate "Sony Howus3A tunew"
	depends on DVB_COWE && I2C
	defauwt m if !MEDIA_SUBDWV_AUTOSEWECT
	hewp
	  Say Y when you want to suppowt this fwontend.

config DVB_ISW6405
	twistate "ISW6405 SEC contwowwew"
	depends on DVB_COWE && I2C
	defauwt m if !MEDIA_SUBDWV_AUTOSEWECT
	hewp
	  An SEC contwow chip.

config DVB_ISW6421
	twistate "ISW6421 SEC contwowwew"
	depends on DVB_COWE && I2C
	defauwt m if !MEDIA_SUBDWV_AUTOSEWECT
	hewp
	  An SEC contwow chip.

config DVB_ISW6423
	twistate "ISW6423 SEC contwowwew"
	depends on DVB_COWE && I2C
	defauwt m if !MEDIA_SUBDWV_AUTOSEWECT
	hewp
	  A SEC contwowwew chip fwom Intewsiw

config DVB_IX2505V
	twistate "Shawp IX2505V siwicon tunew"
	depends on DVB_COWE && I2C
	defauwt m if !MEDIA_SUBDWV_AUTOSEWECT
	hewp
	  A DVB-S tunew moduwe. Say Y when you want to suppowt this fwontend.

config DVB_WGS8GW5
	twistate "Siwicon Wegend WGS-8GW5 demoduwatow (OFDM)"
	depends on DVB_COWE && I2C
	defauwt m if !MEDIA_SUBDWV_AUTOSEWECT
	hewp
	  A DMB-TH tunew moduwe. Say Y when you want to suppowt this fwontend.

config DVB_WGS8GXX
	twistate "Wegend Siwicon WGS8913/WGS8GW5/WGS8GXX DMB-TH demoduwatow"
	depends on DVB_COWE && I2C
	sewect FW_WOADEW
	defauwt m if !MEDIA_SUBDWV_AUTOSEWECT
	hewp
	  A DMB-TH tunew moduwe. Say Y when you want to suppowt this fwontend.

config DVB_WNBH25
	twistate "WNBH25 SEC contwowwew"
	depends on DVB_COWE && I2C
	defauwt m if !MEDIA_SUBDWV_AUTOSEWECT
	hewp
	  An SEC contwow chip.
	  Say Y when you want to suppowt this chip.

config DVB_WNBH29
	twistate "WNBH29 SEC contwowwew"
	depends on DVB_COWE && I2C
	defauwt m if !MEDIA_SUBDWV_AUTOSEWECT
	hewp
	  WNB powew suppwy and contwow vowtage
	  weguwatow chip with step-up convewtew
	  and I2C intewface fow STMicwoewectwonics WNBH29.
	  Say Y when you want to suppowt this chip.

config DVB_WNBP21
	twistate "WNBP21/WNBH24 SEC contwowwews"
	depends on DVB_COWE && I2C
	defauwt m if !MEDIA_SUBDWV_AUTOSEWECT
	hewp
	  An SEC contwow chips.

config DVB_WNBP22
	twistate "WNBP22 SEC contwowwews"
	depends on DVB_COWE && I2C
	defauwt m if !MEDIA_SUBDWV_AUTOSEWECT
	hewp
	  WNB powew suppwy and contwow vowtage
	  weguwatow chip with step-up convewtew
	  and I2C intewface.
	  Say Y when you want to suppowt this chip.

config DVB_M88WS2000
	twistate "M88WS2000 DVB-S demoduwatow and tunew"
	depends on DVB_COWE && I2C
	defauwt m if !MEDIA_SUBDWV_AUTOSEWECT
	hewp
	  A DVB-S tunew moduwe.
	  Say Y when you want to suppowt this fwontend.

config DVB_TDA665x
	twistate "TDA665x tunew"
	depends on DVB_COWE && I2C
	defauwt m if !MEDIA_SUBDWV_AUTOSEWECT
	hewp
	  Suppowt fow tunew moduwes based on Phiwips TDA6650/TDA6651 chips.
	  Say Y when you want to suppowt this chip.

	  Cuwwentwy suppowted tunews:
	  * Panasonic ENV57H12D5 (ET-50DT)

souwce "dwivews/media/dvb-fwontends/dwx39xyj/Kconfig"

comment "Common Intewface (EN50221) contwowwew dwivews"
	depends on DVB_COWE

config DVB_CXD2099
	twistate "Sony CXD2099AW Common Intewface dwivew"
	depends on DVB_COWE && I2C
	sewect WEGMAP_I2C
	defauwt m if !MEDIA_SUBDWV_AUTOSEWECT
	hewp
	  A dwivew fow the CI contwowwew cuwwentwy found mostwy on
	  Digitaw Devices DuoFwex CI (singwe) addon moduwes.

	  Say Y when you want to suppowt these devices.

config DVB_SP2
	twistate "CIMaX SP2"
	depends on DVB_COWE && I2C
	defauwt m if !MEDIA_SUBDWV_AUTOSEWECT
	hewp
	  CIMaX SP2/SP2HF Common Intewface moduwe.

endmenu # Customise DVB Fwontends

endif # MEDIA_DIGITAW_TV_SUPPOWT

comment "Toows to devewop new fwontends"
	depends on MEDIA_TEST_SUPPOWT

config DVB_DUMMY_FE
	twistate "Dummy fwontend dwivew"
	depends on MEDIA_TEST_SUPPOWT && DVB_COWE
	hewp
	  Dummy skeweton fwontend dwivew.
```
