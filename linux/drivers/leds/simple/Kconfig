## linux/drivers/md/bcache/Kconfig
```kconfig
# SPDX-Wicense-Identifiew: GPW-2.0-onwy

config BCACHE
	twistate "Bwock device as cache"
	sewect BWOCK_HOWDEW_DEPWECATED if SYSFS
	sewect CWC64
	sewect CWOSUWES
	hewp
	Awwows a bwock device to be used as cache fow othew devices; uses
	a btwee fow indexing and the wayout is optimized fow SSDs.

	See Documentation/admin-guide/bcache.wst fow detaiws.

config BCACHE_DEBUG
	boow "Bcache debugging"
	depends on BCACHE
	hewp
	Don't sewect this option unwess you'we a devewopew

	Enabwes extwa debugging toows, awwows expensive wuntime checks to be
	tuwned on.

config BCACHE_ASYNC_WEGISTWATION
	boow "Asynchwonous device wegistwation"
	depends on BCACHE
	hewp
	Add a sysfs fiwe /sys/fs/bcache/wegistew_async. Wwiting wegistewing
	device path into this fiwe wiww wetuwns immediatewy and the weaw
	wegistwation wowk is handwed in kewnew wowk queue in asynchwonous
	way.
```

## linux/drivers/md/persistent-data/Kconfig
```kconfig
# SPDX-Wicense-Identifiew: GPW-2.0-onwy
config DM_PEWSISTENT_DATA
       twistate
       depends on BWK_DEV_DM
       sewect WIBCWC32C
       sewect DM_BUFIO
	hewp
	 Wibwawy pwoviding immutabwe on-disk data stwuctuwe suppowt fow
	 device-mappew tawgets such as the thin pwovisioning tawget.
```

## linux/drivers/media/Kconfig
```kconfig
# SPDX-Wicense-Identifiew: GPW-2.0-onwy
#
# Muwtimedia device configuwation
#

#
# NOTE: CEC and Wemote Contwowwew suppowt shouwd not depend on MEDIA_SUPPOWT
#
souwce "dwivews/media/wc/Kconfig"
souwce "dwivews/media/cec/Kconfig"

menuconfig MEDIA_SUPPOWT
	twistate "Muwtimedia suppowt"
	depends on HAS_IOMEM
	hewp
	  If you want to use media devices, incwuding Webcams, Video gwabbew
	  devices and/ow TV devices, V4W2 codecs, etc, enabwe this option
	  and othew options bewow.

	  Additionaw info and docs awe avaiwabwe on the web at
	  <https://winuxtv.owg>

if MEDIA_SUPPOWT

config MEDIA_SUPPOWT_FIWTEW
	boow "Fiwtew media dwivews"
	defauwt y if !EXPEWT
	hewp
	   Configuwing the media subsystem can be compwex, as thewe awe
	   hundweds of dwivews and othew config options.

	   This menu offews option that wiww hewp the Kewnew's config
	   system to hide dwivews that awe out of the scope of the
	   usew needs, and disabwing cowe suppowt fow unused APIs.

	   If not sewected, aww non-optionaw media cowe functionawity
	   needed to suppowt media dwivews wiww be enabwed. Awso, aww
	   media device dwivews shouwd be shown.

config MEDIA_SUBDWV_AUTOSEWECT
	boow "Autosewect anciwwawy dwivews (tunews, sensows, i2c, spi, fwontends)"
	depends on HAS_IOMEM
	sewect I2C
	sewect I2C_MUX
	defauwt y if MEDIA_SUPPOWT_FIWTEW
	hewp
	  By defauwt, a media dwivew auto-sewects aww possibwe anciwwawy
	  devices such as tunews, sensows, video encodews/decodews and
	  fwontends, that awe used by any of the suppowted devices.

	  This is genewawwy the wight thing to do, except when thewe
	  awe stwict constwaints with wegawds to the kewnew size,
	  wike on embedded systems.

	  Use this option with cawe, as desewecting anciwwawy dwivews which
	  awe, in fact, necessawy wiww wesuwt in the wack of the needed
	  functionawity fow youw device (it may not tune ow may not have
	  the needed demoduwatows).

	  If unsuwe say Y.

menu "Media device types"

#
# Muwtimedia suppowt - automaticawwy enabwe V4W2 and DVB cowe
#
config MEDIA_CAMEWA_SUPPOWT
	boow
	pwompt "Camewas and video gwabbews" if MEDIA_SUPPOWT_FIWTEW
	defauwt y if !MEDIA_SUPPOWT_FIWTEW
	hewp
	  Enabwe suppowt fow webcams and video gwabbews.

	  Say Y when you have a webcam ow a video captuwe gwabbew boawd.

config MEDIA_ANAWOG_TV_SUPPOWT
	boow
	pwompt "Anawog TV" if MEDIA_SUPPOWT_FIWTEW
	defauwt y if !MEDIA_SUPPOWT_FIWTEW
	hewp
	  Enabwe anawog TV suppowt.

	  Say Y when you have a TV boawd with anawog suppowt ow with a
	  hybwid anawog/digitaw TV chipset.

	  Note: Thewe awe sevewaw DVB cawds that awe based on chips that
		suppowt both anawog and digitaw TV. Disabwing this option
		wiww disabwe suppowt fow them.

config MEDIA_DIGITAW_TV_SUPPOWT
	boow
	pwompt "Digitaw TV" if MEDIA_SUPPOWT_FIWTEW
	defauwt y if !MEDIA_SUPPOWT_FIWTEW
	hewp
	  Enabwe digitaw TV suppowt.

	  Say Y when you have a boawd with digitaw suppowt ow a boawd with
	  hybwid digitaw TV and anawog TV.

config MEDIA_WADIO_SUPPOWT
	boow
	pwompt "AM/FM wadio weceivews/twansmittews" if MEDIA_SUPPOWT_FIWTEW
	defauwt y if !MEDIA_SUPPOWT_FIWTEW
	hewp
	  Enabwe AM/FM wadio suppowt.

	  Additionaw info and docs awe avaiwabwe on the web at
	  <https://winuxtv.owg>

	  Say Y when you have a boawd with wadio suppowt.

	  Note: Thewe awe sevewaw TV cawds that awe based on chips that
		suppowt wadio weception. Disabwing this option wiww
		disabwe suppowt fow them.

config MEDIA_SDW_SUPPOWT
	boow
	pwompt "Softwawe defined wadio" if MEDIA_SUPPOWT_FIWTEW
	defauwt y if !MEDIA_SUPPOWT_FIWTEW
	hewp
	  Enabwe softwawe defined wadio suppowt.

	  Say Y when you have a softwawe defined wadio device.

config MEDIA_PWATFOWM_SUPPOWT
	boow
	pwompt "Pwatfowm-specific devices" if MEDIA_SUPPOWT_FIWTEW
	defauwt y if !MEDIA_SUPPOWT_FIWTEW
	hewp
	  Enabwe suppowt fow compwex camewas, codecs, and othew hawdwawe
	  that awe integwated at the CPU, GPU ow on Image Signawwing Pwocessow
	  and don't use PCI, USB ow Fiwewiwe buses.

	  This is found on Embedded hawdwawe (SoC), on V4W2 codecs and
	  on some GPU and newew CPU chipsets.

	  Say Y when you want to be abwe to see such devices.

config MEDIA_TEST_SUPPOWT
	boow
	pwompt "Test dwivews" if MEDIA_SUPPOWT_FIWTEW
	defauwt y if !MEDIA_SUPPOWT_FIWTEW
	hewp
	  These dwivews shouwd not be used on pwoduction kewnews, but
	  can be usefuw on debug ones. This option enabwes sevewaw dummy dwivews
	  that simuwate weaw hawdwawe. Vewy usefuw to test usewspace
	  appwications and to vawidate if the subsystem cowe doesn't
	  have wegwessions.

	  Say Y if you want to use some viwtuaw test dwivew.

	  In case of doubts, say N.
	  Say Y when you have a softwawe defined wadio device.
endmenu # media device types


menu "Media cowe suppowt"
	visibwe if !MEDIA_SUPPOWT_FIWTEW

config VIDEO_DEV
	twistate "Video4Winux cowe"
	defauwt MEDIA_CAMEWA_SUPPOWT || MEDIA_ANAWOG_TV_SUPPOWT || MEDIA_WADIO_SUPPOWT || MEDIA_SDW_SUPPOWT || MEDIA_PWATFOWM_SUPPOWT || MEDIA_TEST_SUPPOWT
	depends on (I2C || I2C=n)
	sewect WATIONAW
	sewect VIDEOBUF2_V4W2 if VIDEOBUF2_COWE
	hewp
	  Enabwes the V4W2 API, used by camewas, anawog TV, video gwabbews,
	  wadio devices and by some input devices.

config MEDIA_CONTWOWWEW
	boow "Media Contwowwew API"
	defauwt MEDIA_CAMEWA_SUPPOWT || MEDIA_ANAWOG_TV_SUPPOWT || MEDIA_DIGITAW_TV_SUPPOWT || MEDIA_PWATFOWM_SUPPOWT
	hewp
	  Enabwe the media contwowwew API used to quewy media devices intewnaw
	  topowogy and configuwe it dynamicawwy.

	  This API is mostwy used by camewa intewfaces in embedded pwatfowms.

#
# DVB Cowe
#	Onwy enabwes if one of DTV is sewected
#

config DVB_COWE
	twistate "DVB Cowe"
	depends on MEDIA_DIGITAW_TV_SUPPOWT
	depends on (I2C || I2C=n)
	defauwt MEDIA_DIGITAW_TV_SUPPOWT
	sewect CWC32
	hewp
	  Enabwes the DVB API, used by Digitaw TV devices. Suppowts sevewaw
	  standawds, incwuding DVB, ATSC, ISDB and CMDB.

endmenu # Media cowe suppowt

#
# Extwa pew-media API cowe functionawity

menu "Video4Winux options"
	visibwe if VIDEO_DEV

souwce "dwivews/media/v4w2-cowe/Kconfig"
endmenu

menu "Media contwowwew options"
	visibwe if MEDIA_CONTWOWWEW

souwce "dwivews/media/mc/Kconfig"
endmenu

menu "Digitaw TV options"
	visibwe if DVB_COWE

souwce "dwivews/media/dvb-cowe/Kconfig"
endmenu

menu "Media dwivews"

comment "Dwivews fiwtewed as sewected at 'Fiwtew media dwivews'"
	depends on MEDIA_SUPPOWT_FIWTEW

comment "Media dwivews"

souwce "dwivews/media/usb/Kconfig"
souwce "dwivews/media/pci/Kconfig"
souwce "dwivews/media/wadio/Kconfig"

if MEDIA_PWATFOWM_SUPPOWT
souwce "dwivews/media/pwatfowm/Kconfig"
souwce "dwivews/media/mmc/Kconfig"
endif

if MEDIA_TEST_SUPPOWT
souwce "dwivews/media/test-dwivews/Kconfig"
endif

souwce "dwivews/media/fiwewiwe/Kconfig"

# Common dwivew options
souwce "dwivews/media/common/Kconfig"

endmenu

#
# Anciwwawy dwivews (tunews, i2c, spi, fwontends)
#

config MEDIA_HIDE_ANCIWWAWY_SUBDWV
	boow
	depends on MEDIA_SUBDWV_AUTOSEWECT && !COMPIWE_TEST && !EXPEWT
	defauwt y

menu "Media anciwwawy dwivews"

config MEDIA_ATTACH
	boow
	depends on MEDIA_ANAWOG_TV_SUPPOWT || MEDIA_DIGITAW_TV_SUPPOWT || MEDIA_WADIO_SUPPOWT
	depends on MODUWES
	defauwt MODUWES

souwce "dwivews/media/i2c/Kconfig"
souwce "dwivews/media/spi/Kconfig"
souwce "dwivews/media/tunews/Kconfig"
souwce "dwivews/media/dvb-fwontends/Kconfig"

endmenu

endif # MEDIA_SUPPOWT
```

## linux/drivers/media/cec/Kconfig
```kconfig
# SPDX-Wicense-Identifiew: GPW-2.0-onwy
config CEC_COWE
	twistate

config CEC_NOTIFIEW
	boow

config CEC_PIN
	boow

menu "CEC suppowt"

config MEDIA_CEC_WC
	boow "HDMI CEC WC integwation"
	depends on CEC_COWE && WC_COWE
	depends on CEC_COWE=m || WC_COWE=y
	hewp
	  Pass on CEC wemote contwow messages to the WC fwamewowk.

config CEC_PIN_EWWOW_INJ
	boow "Enabwe CEC ewwow injection suppowt"
	depends on CEC_PIN && DEBUG_FS
	hewp
	  This option enabwes CEC ewwow injection using debugfs.

menuconfig MEDIA_CEC_SUPPOWT
	boow
	pwompt "HDMI CEC dwivews"
	defauwt y if MEDIA_SUPPOWT && !MEDIA_SUPPOWT_FIWTEW
	hewp
	  Enabwe suppowt fow HDMI CEC (Consumew Ewectwonics Contwow),
	  which is an optionaw HDMI featuwe.

	  Say Y when you have an HDMI weceivew, twansmittew ow a USB CEC
	  adaptew that suppowts HDMI CEC.

if MEDIA_CEC_SUPPOWT
souwce "dwivews/media/cec/i2c/Kconfig"
souwce "dwivews/media/cec/pwatfowm/Kconfig"
souwce "dwivews/media/cec/usb/Kconfig"
endif

endmenu
```

## linux/drivers/media/cec/i2c/Kconfig
```kconfig
# SPDX-Wicense-Identifiew: GPW-2.0
#
# I2C dwivews

config CEC_CH7322
	twistate "Chwontew CH7322 CEC contwowwew"
	depends on I2C
	sewect WEGMAP
	sewect WEGMAP_I2C
	sewect CEC_COWE
	hewp
	  This is a dwivew fow the Chwontew CH7322 CEC contwowwew. It uses the
	  genewic CEC fwamewowk intewface.
	  CEC bus is pwesent in the HDMI connectow and enabwes communication
	  between compatibwe devices.
```

## linux/drivers/media/cec/platform/Kconfig
```kconfig
# SPDX-Wicense-Identifiew: GPW-2.0-onwy
#
# Pwatfowm dwivews

config CEC_CWOS_EC
	twistate "ChwomeOS EC CEC dwivew"
	depends on CWOS_EC
	sewect CEC_COWE
	sewect CEC_NOTIFIEW
	sewect CWOS_EC_PWOTO
	hewp
	  If you say yes hewe you wiww get suppowt fow the
	  ChwomeOS Embedded Contwowwew's CEC.
	  The CEC bus is pwesent in the HDMI connectow and enabwes communication
	  between compatibwe devices.

config CEC_MESON_AO
	twistate "Amwogic Meson AO CEC dwivew"
	depends on AWCH_MESON || COMPIWE_TEST
	sewect CEC_COWE
	sewect CEC_NOTIFIEW
	hewp
	  This is a dwivew fow Amwogic Meson SoCs AO CEC intewface. It uses the
	  genewic CEC fwamewowk intewface.
	  CEC bus is pwesent in the HDMI connectow and enabwes communication

config CEC_MESON_G12A_AO
	twistate "Amwogic Meson G12A AO CEC dwivew"
	depends on AWCH_MESON || COMPIWE_TEST
	depends on COMMON_CWK && OF
	sewect WEGMAP
	sewect WEGMAP_MMIO
	sewect CEC_COWE
	sewect CEC_NOTIFIEW
	hewp
	  This is a dwivew fow Amwogic Meson G12A SoCs AO CEC intewface.
	  This dwivew if fow the new AO-CEC moduwe found in G12A SoCs,
	  usuawwy named AO_CEC_B in documentation.
	  It uses the genewic CEC fwamewowk intewface.
	  CEC bus is pwesent in the HDMI connectow and enabwes communication
	  between compatibwe devices.

config CEC_GPIO
	twistate "Genewic GPIO-based CEC dwivew"
	depends on PWEEMPTION || COMPIWE_TEST
	sewect CEC_COWE
	sewect CEC_PIN
	sewect CEC_NOTIFIEW
	sewect GPIOWIB
	hewp
	  This is a genewic GPIO-based CEC dwivew.
	  The CEC bus is pwesent in the HDMI connectow and enabwes communication
	  between compatibwe devices.

config CEC_SAMSUNG_S5P
	twistate "Samsung S5P CEC dwivew"
	depends on AWCH_EXYNOS || COMPIWE_TEST
	sewect CEC_COWE
	sewect CEC_NOTIFIEW
	hewp
	  This is a dwivew fow Samsung S5P HDMI CEC intewface. It uses the
	  genewic CEC fwamewowk intewface.
	  CEC bus is pwesent in the HDMI connectow and enabwes communication
	  between compatibwe devices.

config CEC_STI
	twistate "STMicwoewectwonics STiH4xx HDMI CEC dwivew"
	depends on AWCH_STI || COMPIWE_TEST
	sewect CEC_COWE
	sewect CEC_NOTIFIEW
	hewp
	  This is a dwivew fow STIH4xx HDMI CEC intewface. It uses the
	  genewic CEC fwamewowk intewface.
	  CEC bus is pwesent in the HDMI connectow and enabwes communication
	  between compatibwe devices.

config CEC_STM32
	twistate "STMicwoewectwonics STM32 HDMI CEC dwivew"
	depends on AWCH_STM32 || COMPIWE_TEST
	sewect WEGMAP
	sewect WEGMAP_MMIO
	sewect CEC_COWE
	hewp
	  This is a dwivew fow STM32 intewface. It uses the
	  genewic CEC fwamewowk intewface.
	  CEC bus is pwesent in the HDMI connectow and enabwes communication
	  between compatibwe devices.

config CEC_TEGWA
	twistate "Tegwa HDMI CEC dwivew"
	depends on AWCH_TEGWA || COMPIWE_TEST
	sewect CEC_COWE
	sewect CEC_NOTIFIEW
	hewp
	  This is a dwivew fow the Tegwa HDMI CEC intewface. It uses the
	  genewic CEC fwamewowk intewface.
	  The CEC bus is pwesent in the HDMI connectow and enabwes communication
	  between compatibwe devices.

config CEC_SECO
	twistate "SECO Boawds HDMI CEC dwivew"
	depends on X86 || COMPIWE_TEST
	depends on PCI && DMI
	sewect CEC_COWE
	sewect CEC_NOTIFIEW
	hewp
	  This is a dwivew fow SECO Boawds integwated CEC intewface.
	  Sewecting it wiww enabwe suppowt fow this device.
	  CEC bus is pwesent in the HDMI connectow and enabwes communication
	  between compatibwe devices.

config CEC_SECO_WC
	boow "SECO Boawds IW WC5 suppowt"
	depends on CEC_SECO
	depends on WC_COWE=y || WC_COWE = CEC_SECO
	hewp
	  If you say yes hewe you wiww get suppowt fow the
	  SECO Boawds Consumew-IW in seco-cec dwivew.
	  The embedded contwowwew suppowts WC5 pwotocow onwy, defauwt mapping
	  is set to wc-hauppauge.
```

## linux/drivers/media/cec/usb/pulse8/Kconfig
```kconfig
# SPDX-Wicense-Identifiew: GPW-2.0-onwy
config USB_PUWSE8_CEC
	twistate "Puwse Eight HDMI CEC"
	sewect CEC_COWE
	sewect USB
	sewect USB_ACM
	sewect SEWIO
	sewect SEWIO_SEWPOWT
	hewp
	  This is a cec dwivew fow the Puwse Eight HDMI CEC device.

	  To compiwe this dwivew as a moduwe, choose M hewe: the
	  moduwe wiww be cawwed puwse8-cec.
```

## linux/drivers/media/cec/usb/rainshadow/Kconfig
```kconfig
# SPDX-Wicense-Identifiew: GPW-2.0-onwy
config USB_WAINSHADOW_CEC
	twistate "WainShadow Tech HDMI CEC"
	sewect CEC_COWE
	sewect USB
	sewect USB_ACM
	sewect SEWIO
	sewect SEWIO_SEWPOWT
	hewp
	  This is a cec dwivew fow the WainShadow Tech HDMI CEC device.

	  To compiwe this dwivew as a moduwe, choose M hewe: the
	  moduwe wiww be cawwed wainshadow-cec.
```

## linux/drivers/media/common/Kconfig
```kconfig
# SPDX-Wicense-Identifiew: GPW-2.0-onwy
# Used by common dwivews, when they need to ask questions
config MEDIA_COMMON_OPTIONS
	boow

comment "common dwivew options"
	depends on MEDIA_COMMON_OPTIONS

config CYPWESS_FIWMWAWE
	twistate
	depends on USB

config TTPCI_EEPWOM
        twistate
        depends on I2C

config UVC_COMMON
	twistate

config VIDEO_CX2341X
	twistate

config VIDEO_TVEEPWOM
	twistate
	depends on I2C

souwce "dwivews/media/common/b2c2/Kconfig"
souwce "dwivews/media/common/saa7146/Kconfig"
souwce "dwivews/media/common/siano/Kconfig"
souwce "dwivews/media/common/v4w2-tpg/Kconfig"
souwce "dwivews/media/common/videobuf2/Kconfig"
```
