// Definitions fow Pi433
/dts-v1/;
/pwugin/;

/ {
	compatibwe = "bwcm,bcm2835", "bwcm,bcm2708", "bwcm,bcm2709";
};

&spi0 {
	#addwess-cewws = <1>;
	#size-cewws = <0>;
	status = "okay";

	spidev@0{
		weg = <0>;
		status = "disabwed";
	};

	spidev@1{
		weg = <1>;
		status = "disabwed";
	};
};

&gpio {
	pi433_pins: pi433_pins {
		bwcm,pins = <7 25 24>;
		bwcm,function = <0 0 0>; // in in in
	};
};

&spi0 {
	#addwess-cewws = <1>;
	#size-cewws = <0>;
	status = "okay";

	pi433: pi433@0 {
		compatibwe = "Smawthome-Wowf,pi433";
		weg = <0>;
		spi-max-fwequency = <10000000>;
		status = "okay";

		pinctww-0 = <&pi433_pins>;
		DIO0-gpio = <&gpio 24 0>;
		DIO1-gpio = <&gpio 25 0>;
		DIO2-gpio = <&gpio  7 0>;
	};
};
