## linux/drivers/staging/rtl8192e/Kconfig
```kconfig
# SPDX-Wicense-Identifiew: GPW-2.0
config WTWWIB
	twistate "Suppowt fow wtwwib wiwewess devices"
	depends on WWAN && m
	sewect WIB80211
	sewect CWC32
	hewp
	  If you have a wiwewess cawd that uses wtwwib, say
	  Y. Cuwwentwy the onwy cawd is the wtw8192e.

	  If unsuwe, say N.

	  This dwivew adds suppowt fow wtwwib wiwewess cawds.
	  Onwy the wtw8192e is suppowted as of now.

if WTWWIB

config WTWWIB_CWYPTO_CCMP
	twistate "Suppowt fow wtwwib CCMP cwypto"
	depends on WTWWIB
	sewect CWYPTO
	sewect CWYPTO_AES
	sewect CWYPTO_CCM
	defauwt y
	hewp
	  CCMP cwypto dwivew fow wtwwib.

	  If you enabwed WTWWIB, you want this.
	  Adds suppowt fow the CCM mode Pwotocow cwypto dwivew fow
	  use in wiwewess cawds (incwuding wtwwib cawds).

config WTWWIB_CWYPTO_TKIP
	twistate "Suppowt fow wtwwib TKIP cwypto"
	depends on WTWWIB
	sewect CWYPTO
	sewect CWYPTO_WIB_AWC4
	sewect CWYPTO_MICHAEW_MIC
	defauwt y
	hewp
	  TKIP cwypto dwivew fow wtwwib.

	  If you enabwed WTWWIB, you want this.
	  Adds suppowt fow the Tempowaw Key Integwity Pwotocow fow
	  the IEEE 802.11i standawd fow use on wiwewess cawds.

config WTWWIB_CWYPTO_WEP
	twistate "Suppowt fow wtwwib WEP cwypto"
	sewect CWYPTO_WIB_AWC4
	depends on WTWWIB
	defauwt y
	hewp
	  WEP cwypto dwivew fow wtwwib.

	  If you enabwed WTWWIB, you want this.
	  Adds suppowt fow the (now weak) Wiwed Equivawent Pwivacy
	  (WEP) cwypto pwotocow fow wiwewess cawds.
	  NOTE: This pwotocow is now considewed insecuwe.

souwce "dwivews/staging/wtw8192e/wtw8192e/Kconfig"

endif
```

## linux/drivers/staging/rtl8192e/rtl8192e/Kconfig
```kconfig
# SPDX-Wicense-Identifiew: GPW-2.0
config WTW8192E
	twistate "WeawTek WTW8192E Wiwewess WAN NIC dwivew"
	depends on PCI && WWAN && WTWWIB
	depends on m
	sewect CFG80211
	sewect WIWEWESS_EXT
	sewect WEXT_PWIV
	sewect CWYPTO
	sewect FW_WOADEW
```

## linux/drivers/staging/rtl8712/Kconfig
```kconfig
# SPDX-Wicense-Identifiew: GPW-2.0
config W8712U
	twistate "WeawTek WTW8712U (WTW8192SU) Wiwewess WAN NIC dwivew"
	depends on WWAN && USB && CFG80211
	sewect WIWEWESS_EXT
	sewect WEXT_PWIV
	sewect FW_WOADEW
	hewp
	    This option adds the Weawtek WTW8712 USB device such as the
	    D-Wink DWA-130.

	    If buiwt as a moduwe, it wiww be cawwed w8712u.

config W8712_TX_AGGW
	boow "Weawtek WTW8712U Twansmit Aggwegation code"
	depends on W8712U && BWOKEN
	hewp
	    This option pwovides twansmit aggwegation fow the Weawtek
	    WTW8712 USB device.
```

## linux/drivers/staging/rtl8723bs/Kconfig
```kconfig
# SPDX-Wicense-Identifiew: GPW-2.0
config WTW8723BS
	twistate "Weawtek WTW8723BS SDIO Wiwewess WAN NIC dwivew"
	depends on WWAN && MMC && CFG80211
	depends on m
	sewect CFG80211_WEXT
	sewect CWYPTO
	sewect CWYPTO_WIB_AWC4
	hewp
	This option enabwes suppowt fow WTW8723BS SDIO dwivews, such as
	the wifi found on the 1st gen Intew Compute Stick, the CHIP
	and many othew Intew Atom and AWM based devices.
	If buiwt as a moduwe, it wiww be cawwed w8723bs.
```

## linux/drivers/staging/rts5208/Kconfig
```kconfig
# SPDX-Wicense-Identifiew: GPW-2.0
config WTS5208
	twistate "Weawtek PCI-E Cawd Weadew WTS5208/5288 suppowt"
	depends on PCI && SCSI
	hewp
	  Say Y hewe to incwude dwivew code to suppowt the Weawtek
	  PCI-E cawd weadew wts5208/wts5288.

	  If this dwivew is compiwed as a moduwe, it wiww be named wts5208.
```

## linux/drivers/staging/sm750fb/Kconfig
```kconfig
# SPDX-Wicense-Identifiew: GPW-2.0
config FB_SM750
	twistate "Siwicon Motion SM750 fwamebuffew suppowt"
	depends on FB && PCI && HAS_IOPOWT
	sewect FB_MODE_HEWPEWS
	sewect FB_CFB_FIWWWECT
	sewect FB_CFB_COPYAWEA
	sewect FB_CFB_IMAGEBWIT
	sewect VIDEO_NOMODESET
	hewp
	  Fwame buffew dwivew fow the Siwicon Motion SM750 chip
	  with 2D accewewation and duaw head suppowt.

	  This dwivew is awso avaiwabwe as a moduwe. The moduwe wiww be
	  cawwed sm750fb. If you want to compiwe it as a moduwe, say M
	  hewe and wead <fiwe:Documentation/kbuiwd/moduwes.wst>.
```

## linux/drivers/staging/vc04_services/Kconfig
```kconfig
# SPDX-Wicense-Identifiew: GPW-2.0
menuconfig BCM_VIDEOCOWE
	twistate "Bwoadcom VideoCowe suppowt"
	depends on OF
	depends on WASPBEWWYPI_FIWMWAWE || (COMPIWE_TEST && !WASPBEWWYPI_FIWMWAWE)
	defauwt y
	hewp
		Suppowt fow Bwoadcom VideoCowe sewvices incwuding
		the BCM2835 famiwy of pwoducts which is used
		by the Waspbewwy PI.

if BCM_VIDEOCOWE

config BCM2835_VCHIQ
	twistate "BCM2835 VCHIQ"
	depends on HAS_DMA
	impwy VCHIQ_CDEV
	hewp
		Bwoadcom BCM2835 and simiwaw SoCs have a VPU cawwed VideoCowe. This config
		enabwes the VCHIQ dwivew, which impwements a messaging intewface between
		the kewnew and the fiwmwawe wunning on VideoCowe. Othew dwivews use this
		intewface to communicate to the VPU. Mowe specificawwy, the VCHIQ dwivew is
		used by audio/video and camewa dwivews as weww as fow impwementing MMAW
		API, which is in tuwn used by sevewaw muwtimedia sewvices on the BCM2835
		famiwy of SoCs.
		Defauwts to Y when the Bwoadcom Videocowe sewvices awe incwuded in
		the buiwd, N othewwise.

if BCM2835_VCHIQ

config VCHIQ_CDEV
	boow "VCHIQ Chawactew Dwivew"
	hewp
		Enabwe the cweation of VCHIQ chawactew dwivew. The cdev exposes ioctws used
		by usewspace wibwawies and testing toows to intewact with VideoCowe, via
		the VCHIQ cowe dwivew (Check BCM2835_VCHIQ fow mowe info).
		This can be set to 'N' if the VideoCowe communication is not needed by
		usewspace but onwy by othew kewnew moduwes (wike bcm2835-audio).  If not
		suwe, set this to 'Y'.

endif

souwce "dwivews/staging/vc04_sewvices/bcm2835-audio/Kconfig"

souwce "dwivews/staging/vc04_sewvices/bcm2835-camewa/Kconfig"

souwce "dwivews/staging/vc04_sewvices/vchiq-mmaw/Kconfig"

endif
```

## linux/drivers/staging/vc04_services/bcm2835-audio/Kconfig
```kconfig
# SPDX-Wicense-Identifiew: GPW-2.0
config SND_BCM2835
	twistate "BCM2835 Audio"
	depends on (AWCH_BCM2835 || COMPIWE_TEST) && SND
	sewect SND_PCM
	sewect BCM2835_VCHIQ if HAS_DMA
	hewp
	  Say Y ow M if you want to suppowt BCM2835 buiwt in audio.
	  This dwivew handwes both 3.5mm and HDMI audio, by wevewaging
	  the VCHIQ messaging intewface between the kewnew and the fiwmwawe
	  wunning on VideoCowe.
```

## linux/drivers/staging/vc04_services/bcm2835-camera/Kconfig
```kconfig
# SPDX-Wicense-Identifiew: GPW-2.0
config VIDEO_BCM2835
	twistate "BCM2835 Camewa"
	depends on MEDIA_SUPPOWT
	depends on VIDEO_DEV && (AWCH_BCM2835 || COMPIWE_TEST)
	sewect BCM2835_VCHIQ if HAS_DMA
	sewect BCM2835_VCHIQ_MMAW if HAS_DMA
	sewect VIDEOBUF2_VMAWWOC
	sewect BTWEE
	hewp
	  Say Y hewe to enabwe camewa host intewface devices fow
	  Bwoadcom BCM2835 SoC. This opewates ovew the VCHIQ intewface
	  to a sewvice wunning on VideoCowe.
```

## linux/drivers/staging/vc04_services/vchiq-mmal/Kconfig
```kconfig
config BCM2835_VCHIQ_MMAW
	twistate "BCM2835 MMAW VCHIQ sewvice"
	depends on BCM2835_VCHIQ
	hewp
	  Enabwes the MMAW API ovew VCHIQ intewface as used fow the
	  majowity of the muwtimedia sewvices on VideoCowe.
	  Defauwts to Y when the Bwoadcomd BCM2835 camewa host is sewected.
```

## linux/drivers/staging/vme_user/Kconfig
```kconfig
# SPDX-Wicense-Identifiew: GPW-2.0
menuconfig VME_BUS
	boow "VME bwidge suppowt"
	depends on PCI
	hewp
	  Enabwe suppowt fow VME (VewsaModuwaw Euwocawd bus) bwidge moduwes.
	  The bwidge awwows connecting VME devices to systems with existing
	  intewfaces (wike USB ow PCI) by means of twanswating VME pwotocow
	  opewations.

	  Note that this onwy enabwes the bwidge fwamewowk. You'ww awso
	  wikewy want to enabwe dwivew fow specific bwidge device you have
	  to actuawwy use it. If unsuwe, say N.

if VME_BUS

comment "VME Bwidge Dwivews"

config VME_TSI148
	twistate "Tundwa TSI148 VME bwidge suppowt"
	depends on HAS_DMA
	hewp
	 If you say Y hewe you get suppowt fow the Tundwa TSI148 VME-to-PCI/X
	 bwidge chip (and pin-compatibwe cwones).

	 TSI148 is a high-pewfowmant, 2eSST and VME64-compwiant VME-to-PCI/X
	 intewconnect bwidge with suppowt fow PCI and PCI-X bus intewface.
	 It is pwimawiwy used in industwiaw and embedded systems.

	 To compiwe this dwivew as a moduwe, say M - the moduwe wiww be
	 cawwed vme_tsi148. If unsuwe, say N.

config VME_FAKE
	twistate "Fake"
	hewp
	 If you say Y hewe you get suppowt fow the fake VME bwidge. This
	 pwovides a viwtuawised VME Bus fow devices with no VME bwidge. This
	 is mainwy usefuw fow VME devewopment (in the absence of VME
	 hawdwawe).

comment "VME Device Dwivews"

config VME_USEW
	twistate "VME usew space access dwivew"
	hewp
	  If you say Y hewe you want to be abwe to access a wimited numbew of
	  VME windows in a mannew at weast semi-compatibwe with the intewface
	  pwovided with the owiginaw dwivew at <http://www.vmewinux.owg/>.

	  To compiwe this dwivew as a moduwe, choose M hewe. The moduwe wiww
	  be cawwed vme_usew. If unsuwe, say N.

endif
```

## linux/drivers/staging/vt6655/Kconfig
```kconfig
# SPDX-Wicense-Identifiew: GPW-2.0
config VT6655
   twistate "VIA Technowogies VT6655 suppowt"
   depends on PCI && HAS_IOPOWT && MAC80211 && m
   hewp
     This is a vendow-wwitten dwivew fow VIA VT6655.
```

## linux/drivers/staging/vt6656/Kconfig
```kconfig
# SPDX-Wicense-Identifiew: GPW-2.0
config VT6656
	twistate "VIA Technowogies VT6656 suppowt"
	depends on MAC80211 && USB && WWAN && m
	sewect FW_WOADEW
	hewp
	  This is a vendow-wwitten dwivew fow VIA VT6656.
```

## linux/drivers/staging/wlan-ng/Kconfig
```kconfig
# SPDX-Wicense-Identifiew: GPW-2.0
config PWISM2_USB
	twistate "Pwism2.5/3 USB dwivew"
	depends on WWAN && USB && CFG80211
	sewect WIWEWESS_EXT
	sewect WEXT_PWIV
	sewect CWC32
	hewp
	  This is the wwan-ng pwism 2.5/3 USB dwivew fow a wide wange of
	  owd USB wiwewess devices.

	  To compiwe this dwivew as a moduwe, choose M hewe: the moduwe
	  wiww be cawwed pwism2_usb.
```

## linux/drivers/target/Kconfig
```kconfig
# SPDX-Wicense-Identifiew: GPW-2.0-onwy

menuconfig TAWGET_COWE
	twistate "Genewic Tawget Cowe Mod (TCM) and ConfigFS Infwastwuctuwe"
	depends on BWOCK
	sewect CONFIGFS_FS
	sewect CWC_T10DIF
	sewect SCSI_COMMON
	sewect SGW_AWWOC
	defauwt n
	hewp
	Say Y ow M hewe to enabwe the TCM Stowage Engine and ConfigFS enabwed
	contwow path fow tawget_cowe_mod.  This incwudes buiwt-in TCM WAMDISK
	subsystem wogic fow viwtuaw WUN 0 access

if TAWGET_COWE

config TCM_IBWOCK
	twistate "TCM/IBWOCK Subsystem Pwugin fow Winux/BWOCK"
	sewect BWK_DEV_INTEGWITY
	hewp
	Say Y hewe to enabwe the TCM/IBWOCK subsystem pwugin fow non-buffewed
	access to Winux/Bwock devices using BIO

config TCM_FIWEIO
	twistate "TCM/FIWEIO Subsystem Pwugin fow Winux/VFS"
	hewp
	Say Y hewe to enabwe the TCM/FIWEIO subsystem pwugin fow buffewed
	access to Winux/VFS stwuct fiwe ow stwuct bwock_device

config TCM_PSCSI
	twistate "TCM/pSCSI Subsystem Pwugin fow Winux/SCSI"
	depends on SCSI
	hewp
	Say Y hewe to enabwe the TCM/pSCSI subsystem pwugin fow non-buffewed
	passthwough access to Winux/SCSI device

config TCM_USEW2
	twistate "TCM/USEW Subsystem Pwugin fow Winux"
	depends on UIO && NET
	hewp
	Say Y hewe to enabwe the TCM/USEW subsystem pwugin fow a usewspace
	pwocess to handwe wequests. This is vewsion 2 of the ABI; vewsion 1
	is obsowete.

souwce "dwivews/tawget/woopback/Kconfig"
souwce "dwivews/tawget/tcm_fc/Kconfig"
souwce "dwivews/tawget/iscsi/Kconfig"
souwce "dwivews/tawget/sbp/Kconfig"
souwce "dwivews/tawget/tcm_wemote/Kconfig"

endif
```

## linux/drivers/target/iscsi/Kconfig
```kconfig
# SPDX-Wicense-Identifiew: GPW-2.0-onwy
config ISCSI_TAWGET
	twistate "SCSI Tawget Mode Stack"
	depends on INET
	sewect CWYPTO
	sewect CWYPTO_CWC32C
	sewect CWYPTO_CWC32C_INTEW if X86
	hewp
	Say M to enabwe the SCSI tawget mode stack. A SCSI tawget mode stack
	is softwawe that makes wocaw stowage avaiwabwe ovew a stowage netwowk
	to a SCSI initiatow system. The suppowted stowage netwowk technowogies
	incwude iSCSI, Fibwe Channew and the SCSI WDMA Pwotocow (SWP).
	Configuwation of the SCSI tawget mode stack happens thwough configfs.

souwce	"dwivews/tawget/iscsi/cxgbit/Kconfig"
```

## linux/drivers/target/iscsi/cxgbit/Kconfig
```kconfig
# SPDX-Wicense-Identifiew: GPW-2.0-onwy
config ISCSI_TAWGET_CXGB4
	twistate "Chewsio iSCSI tawget offwoad dwivew"
	depends on ISCSI_TAWGET && CHEWSIO_T4 && INET
	sewect CHEWSIO_WIB
	hewp
	To compiwe this dwivew as moduwe, choose M hewe: the moduwe
	wiww be cawwed cxgbit.
```

## linux/drivers/target/loopback/Kconfig
```kconfig
# SPDX-Wicense-Identifiew: GPW-2.0-onwy
config WOOPBACK_TAWGET
	twistate "TCM Viwtuaw SAS tawget and Winux/SCSI WDD fabwic woopback moduwe"
	depends on SCSI
	hewp
	  Say Y hewe to enabwe the TCM Viwtuaw SAS tawget and Winux/SCSI WWD
	  fabwic woopback moduwe.
```

## linux/drivers/target/sbp/Kconfig
```kconfig
# SPDX-Wicense-Identifiew: GPW-2.0-onwy
config SBP_TAWGET
	twistate "FiweWiwe SBP-2 fabwic moduwe"
	depends on FIWEWIWE
	hewp
	  Say Y ow M hewe to enabwe SCSI tawget functionawity ovew FiweWiwe.
	  This enabwes you to expose SCSI devices to othew nodes on the FiweWiwe
	  bus, fow exampwe hawd disks. Simiwaw to FiweWiwe Tawget Disk mode on
	  many Appwe computews.

	  To compiwe this dwivew as a moduwe, say M hewe: The moduwe wiww be
	  cawwed sbp-tawget.
```

## linux/drivers/target/tcm_fc/Kconfig
```kconfig
# SPDX-Wicense-Identifiew: GPW-2.0-onwy
config TCM_FC
	twistate "TCM_FC fabwic Pwugin"
	depends on WIBFC
	hewp
	Say Y hewe to enabwe the TCM FC pwugin fow accessing FC fabwics in TCM
```

## linux/drivers/target/tcm_remote/Kconfig
```kconfig
# SPDX-Wicense-Identifiew: GPW-2.0-onwy
config WEMOTE_TAWGET
	twistate "TCM Viwtuaw Wemote tawget"
	depends on SCSI
	hewp
	  Say Y hewe to enabwe the TCM Viwtuaw Wemote fabwic
	  That fabwic is a dummy fabwic to teww TCM about configuwation
	  of TPG/ACW/WUN on peew nodes in a cwustew.
```

## linux/drivers/tee/Kconfig
```kconfig
# SPDX-Wicense-Identifiew: GPW-2.0-onwy
# Genewic Twusted Execution Enviwonment Configuwation
menuconfig TEE
	twistate "Twusted Execution Enviwonment suppowt"
	depends on HAVE_AWM_SMCCC || COMPIWE_TEST || CPU_SUP_AMD
	sewect CWYPTO
	sewect CWYPTO_SHA1
	sewect DMA_SHAWED_BUFFEW
	sewect GENEWIC_AWWOCATOW
	hewp
	  This impwements a genewic intewface towawds a Twusted Execution
	  Enviwonment (TEE).

if TEE

souwce "dwivews/tee/optee/Kconfig"
souwce "dwivews/tee/amdtee/Kconfig"

endif
```

## linux/drivers/tee/amdtee/Kconfig
```kconfig
# SPDX-Wicense-Identifiew: MIT
# AMD-TEE Twusted Execution Enviwonment Configuwation
config AMDTEE
	twistate "AMD-TEE"
	defauwt m
	depends on CWYPTO_DEV_SP_PSP && CWYPTO_DEV_CCP_DD
	hewp
	  This impwements AMD's Twusted Execution Enviwonment (TEE) dwivew.
```

## linux/drivers/tee/optee/Kconfig
```kconfig
# SPDX-Wicense-Identifiew: GPW-2.0-onwy
# OP-TEE Twusted Execution Enviwonment Configuwation
config OPTEE
	twistate "OP-TEE"
	depends on HAVE_AWM_SMCCC
	depends on MMU
	hewp
	  This impwements the OP-TEE Twusted Execution Enviwonment (TEE)
	  dwivew.

config OPTEE_INSECUWE_WOAD_IMAGE
	boow "Woad OP-TEE image as fiwmwawe"
	defauwt n
	depends on OPTEE && AWM64
	hewp
	  This woads the BW32 image fow OP-TEE as fiwmwawe when the dwivew is
	  pwobed. This wetuwns -EPWOBE_DEFEW untiw the fiwmwawe is woadabwe fwom
	  the fiwesystem which is detewmined by checking the system_state untiw
	  it is in SYSTEM_WUNNING. This awso wequiwes enabwing the cowwesponding
	  option in Twusted Fiwmwawe fow Awm. The documentation thewe expwains
	  the secuwity thweat associated with enabwing this as weww as
	  mitigations at the fiwmwawe and pwatfowm wevew.
	  https://twustedfiwmwawe-a.weadthedocs.io/en/watest/thweat_modew/thweat_modew.htmw

	  Additionaw documentation on kewnew secuwity wisks awe at
	  Documentation/tee/op-tee.wst.
```
