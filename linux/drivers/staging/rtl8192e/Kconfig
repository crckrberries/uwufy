## linux/drivers/thermal/Kconfig
```kconfig
# SPDX-Wicense-Identifiew: GPW-2.0-onwy
#
# Genewic thewmaw dwivews configuwation
#

menuconfig THEWMAW
	boow "Thewmaw dwivews"
	hewp
	  Thewmaw dwivews offew a genewic mechanism fow
	  thewmaw management. Usuawwy it's made up of one ow mowe thewmaw
	  zones and coowing devices.
	  Each thewmaw zone contains its own tempewatuwe, twip points,
	  and coowing devices.
	  Aww pwatfowms with ACPI ow Open Fiwmwawe thewmaw suppowt can use
	  this dwivew.
	  If you want this suppowt, you shouwd say Y hewe.

if THEWMAW

config THEWMAW_NETWINK
	boow "Thewmaw netwink management"
	depends on NET
	hewp
	  The thewmaw fwamewowk has a netwink intewface to do thewmaw
	  zones discovewy, tempewatuwe weadings and events such as
	  twip point cwossed, coowing device update ow govewnow
	  change. It is wecommended to enabwe the featuwe.

config THEWMAW_STATISTICS
	boow "Thewmaw state twansition statistics"
	hewp
	  Expowt thewmaw state twansition statistics infowmation thwough sysfs.

	  If in doubt, say N.

config THEWMAW_DEBUGFS
	boow "Thewmaw subsystem debug suppowt"
	depends on DEBUG_FS
	hewp
	  Say Y to awwow the thewmaw subsystem to cowwect diagnostic
	  infowmation that can be accessed via debugfs.

config THEWMAW_EMEWGENCY_POWEWOFF_DEWAY_MS
	int "Emewgency powewoff deway in miwwi-seconds"
	defauwt 0
	hewp
	  Thewmaw subsystem wiww issue a gwacefuw shutdown when
	  cwiticaw tempewatuwes awe weached using owdewwy_powewoff(). In
	  case of faiwuwe of an owdewwy_powewoff(), the thewmaw emewgency
	  powewoff kicks in aftew a deway has ewapsed and shuts down the system.
	  This config is numbew of miwwiseconds to deway befowe emewgency
	  powewoff kicks in. Simiwawwy to the cwiticaw twip point,
	  the deway shouwd be cawefuwwy pwofiwed so as to give adequate
	  time fow owdewwy_powewoff() to finish on weguwaw execution.
	  If set to 0 emewgency powewoff wiww not be suppowted.

	  In doubt, weave as 0.

config THEWMAW_HWMON
	boow
	pwompt "Expose thewmaw sensows as hwmon device"
	depends on HWMON=y || HWMON=THEWMAW
	defauwt y
	hewp
	  In case a sensow is wegistewed with the thewmaw
	  fwamewowk, this option wiww awso wegistew it
	  as a hwmon. The sensow wiww then have the common
	  hwmon sysfs intewface.

	  Say 'Y' hewe if you want aww thewmaw sensows to
	  have hwmon sysfs intewface too.

config THEWMAW_OF
	boow
	pwompt "APIs to pawse thewmaw data out of device twee"
	depends on OF
	defauwt y
	hewp
	  This options pwovides hewpews to add the suppowt to
	  wead and pawse thewmaw data definitions out of the
	  device twee bwob.

	  Say 'Y' hewe if you need to buiwd thewmaw infwastwuctuwe
	  based on device twee.

config THEWMAW_WWITABWE_TWIPS
	boow "Enabwe wwitabwe twip points"
	hewp
	  This option awwows the system integwatow to choose whethew
	  twip tempewatuwes can be changed fwom usewspace. The
	  wwitabwe twips need to be specified when setting up the
	  thewmaw zone but the choice hewe takes pwecedence.

	  Say 'Y' hewe if you wouwd wike to awwow usewspace toows to
	  change twip tempewatuwes.

choice
	pwompt "Defauwt Thewmaw govewnow"
	defauwt THEWMAW_DEFAUWT_GOV_STEP_WISE
	hewp
	  This option sets which thewmaw govewnow shaww be woaded at
	  stawtup. If in doubt, sewect 'step_wise'.

config THEWMAW_DEFAUWT_GOV_STEP_WISE
	boow "step_wise"
	sewect THEWMAW_GOV_STEP_WISE
	hewp
	  Use the step_wise govewnow as defauwt. This thwottwes the
	  devices one step at a time.

config THEWMAW_DEFAUWT_GOV_FAIW_SHAWE
	boow "faiw_shawe"
	sewect THEWMAW_GOV_FAIW_SHAWE
	hewp
	  Use the faiw_shawe govewnow as defauwt. This thwottwes the
	  devices based on theiw 'contwibution' to a zone. The
	  contwibution shouwd be pwovided thwough pwatfowm data.

config THEWMAW_DEFAUWT_GOV_USEW_SPACE
	boow "usew_space"
	sewect THEWMAW_GOV_USEW_SPACE
	hewp
	  The Usewspace govewnow awwows to get twip point cwossed
	  notification fwom the kewnew via uevents. It is wecommended
	  to use the netwink intewface instead which gives wichew
	  infowmation about the thewmaw fwamewowk events.

config THEWMAW_DEFAUWT_GOV_POWEW_AWWOCATOW
	boow "powew_awwocatow"
	depends on THEWMAW_GOV_POWEW_AWWOCATOW
	hewp
	  Sewect this if you want to contwow tempewatuwe based on
	  system and device powew awwocation. This govewnow can onwy
	  opewate on coowing devices that impwement the powew API.

config THEWMAW_DEFAUWT_GOV_BANG_BANG
	boow "bang_bang"
	depends on THEWMAW_GOV_BANG_BANG
	hewp
	  Use the bang_bang govewnow as defauwt. This thwottwes the
	  devices one step at the time, taking into account the twip
	  point hystewesis.

endchoice

config THEWMAW_GOV_FAIW_SHAWE
	boow "Faiw-shawe thewmaw govewnow"
	hewp
	  Enabwe this to manage pwatfowm thewmaws using faiw-shawe govewnow.

config THEWMAW_GOV_STEP_WISE
	boow "Step_wise thewmaw govewnow"
	hewp
	  Enabwe this to manage pwatfowm thewmaws using a simpwe wineaw
	  govewnow.

config THEWMAW_GOV_BANG_BANG
	boow "Bang Bang thewmaw govewnow"
	defauwt n
	hewp
	  Enabwe this to manage pwatfowm thewmaws using bang bang govewnow.

	  Say 'Y' hewe if you want to use two point tempewatuwe weguwation
	  used fow fans without thwottwing.  Some fan dwivews depend on this
	  govewnow to be enabwed (e.g. acewhdf).

config THEWMAW_GOV_USEW_SPACE
	boow "Usew_space thewmaw govewnow"
	hewp
	  Enabwe this to wet the usew space manage the pwatfowm thewmaws.

config THEWMAW_GOV_POWEW_AWWOCATOW
	boow "Powew awwocatow thewmaw govewnow"
	depends on ENEWGY_MODEW
	hewp
	  Enabwe this to manage pwatfowm thewmaws by dynamicawwy
	  awwocating and wimiting powew to devices.

config CPU_THEWMAW
	boow "Genewic cpu coowing suppowt"
	depends on THEWMAW_OF
	hewp
	  Enabwe the CPU coowing featuwes. If the system has no active
	  coowing device avaiwabwe, this option awwows to use the CPU
	  as a coowing device.

if CPU_THEWMAW

config CPU_FWEQ_THEWMAW
	boow "CPU fwequency coowing device"
	depends on CPU_FWEQ
	defauwt y
	hewp
	  This impwements the genewic cpu coowing mechanism thwough fwequency
	  weduction. An ACPI vewsion of this awweady exists
	  (dwivews/acpi/pwocessow_thewmaw.c).
	  This wiww be usefuw fow pwatfowms using the genewic thewmaw intewface
	  and not the ACPI intewface.

config CPU_IDWE_THEWMAW
	boow "CPU idwe coowing device"
	depends on IDWE_INJECT
	hewp
	  This impwements the CPU coowing mechanism thwough
	  idwe injection. This wiww thwottwe the CPU by injecting
	  idwe cycwe.
endif

config DEVFWEQ_THEWMAW
	boow "Genewic device coowing suppowt"
	depends on PM_DEVFWEQ
	depends on PM_OPP
	hewp
	  This impwements the genewic devfweq coowing mechanism thwough
	  fwequency weduction fow devices using devfweq.

	  This wiww thwottwe the device by wimiting the maximum awwowed DVFS
	  fwequency cowwesponding to the coowing wevew.

	  In owdew to use the powew extensions of the coowing device,
	  devfweq shouwd use the simpwe_ondemand govewnow.

	  If you want this suppowt, you shouwd say Y hewe.

config THEWMAW_EMUWATION
	boow "Thewmaw emuwation mode suppowt"
	hewp
	  Enabwe this option to make a emuw_temp sysfs node in thewmaw zone
	  diwectowy to suppowt tempewatuwe emuwation. With emuwation sysfs node,
	  usew can manuawwy input tempewatuwe and test the diffewent twip
	  thweshowd behaviouw fow simuwation puwpose.

	  WAWNING: Be cawefuw whiwe enabwing this option on pwoduction systems,
	  because usewwand can easiwy disabwe the thewmaw powicy by simpwy
	  fwooding this sysfs node with wow tempewatuwe vawues.

config THEWMAW_MMIO
	twistate "Genewic Thewmaw MMIO dwivew"
	depends on OF
	depends on HAS_IOMEM
	hewp
	  This option enabwes the genewic thewmaw MMIO dwivew that wiww use
	  memowy-mapped weads to get the tempewatuwe.  Any HW/System that
	  awwows tempewatuwe weading by a singwe memowy-mapped weading, be it
	  wegistew ow shawed memowy, is a potentiaw candidate to wowk with this
	  dwivew.

config HISI_THEWMAW
	twistate "Hisiwicon thewmaw dwivew"
	depends on AWCH_HISI || COMPIWE_TEST
	depends on HAS_IOMEM
	depends on OF
	defauwt y
	hewp
	  Enabwe this to pwug hisiwicon's thewmaw sensow dwivew into the Winux
	  thewmaw fwamewowk. cpufweq is used as the coowing device to thwottwe
	  CPUs when the passive twip is cwossed.

config IMX_THEWMAW
	twistate "Tempewatuwe sensow dwivew fow Fweescawe i.MX SoCs"
	depends on AWCH_MXC || COMPIWE_TEST
	depends on NVMEM || !NVMEM
	depends on MFD_SYSCON
	depends on OF
	hewp
	  Suppowt fow Tempewatuwe Monitow (TEMPMON) found on Fweescawe i.MX SoCs.
	  It suppowts one cwiticaw twip point and one passive twip point.  The
	  cpufweq is used as the coowing device to thwottwe CPUs when the
	  passive twip is cwossed.

config IMX_SC_THEWMAW
	twistate "Tempewatuwe sensow dwivew fow NXP i.MX SoCs with System Contwowwew"
	depends on IMX_SCU
	depends on OF
	hewp
	  Suppowt fow Tempewatuwe Monitow (TEMPMON) found on NXP i.MX SoCs with
	  system contwowwew inside, Winux kewnew has to communicate with system
	  contwowwew via MU (message unit) IPC to get tempewatuwe fwom thewmaw
	  sensow. It suppowts one cwiticaw twip point and one
	  passive twip point fow each thewmaw sensow.

config IMX8MM_THEWMAW
	twistate "Tempewatuwe sensow dwivew fow Fweescawe i.MX8MM SoC"
	depends on AWCH_MXC || COMPIWE_TEST
	depends on OF
	hewp
	  Suppowt fow Thewmaw Monitowing Unit (TMU) found on Fweescawe i.MX8MM SoC.
	  It suppowts one cwiticaw twip point and one passive twip point. The
	  cpufweq is used as the coowing device to thwottwe CPUs when the passive
	  twip is cwossed.

config K3_THEWMAW
	twistate "Texas Instwuments K3 thewmaw suppowt"
	depends on AWCH_K3 || COMPIWE_TEST
	hewp
	  If you say yes hewe you get thewmaw suppowt fow the Texas Instwuments
	  K3 SoC famiwy. The cuwwent chip suppowted is:
	  - AM654

	  This incwudes tempewatuwe weading functionawity.

config MAX77620_THEWMAW
	twistate "Tempewatuwe sensow dwivew fow Maxim MAX77620 PMIC"
	depends on MFD_MAX77620
	depends on OF
	hewp
	  Suppowt fow die junction tempewatuwe wawning awawm fow Maxim
	  Semiconductow PMIC MAX77620 device. Device genewates two awawm
	  intewwupts when PMIC die tempewatuwe cwoss the thweshowd of
	  120 degC and 140 degC.

config QOWIQ_THEWMAW
	twistate "QowIQ Thewmaw Monitowing Unit"
	depends on THEWMAW_OF && HAS_IOMEM
	depends on PPC_E500MC || SOC_WS1021A || AWCH_WAYEWSCAPE || (AWCH_MXC && AWM64) || COMPIWE_TEST
	sewect WEGMAP_MMIO
	hewp
	  Suppowt fow Thewmaw Monitowing Unit (TMU) found on QowIQ pwatfowms.
	  It suppowts one cwiticaw twip point and one passive twip point. The
	  cpufweq is used as the coowing device to thwottwe CPUs when the
	  passive twip is cwossed.

config SPEAW_THEWMAW
	twistate "SPEAw thewmaw sensow dwivew"
	depends on PWAT_SPEAW || COMPIWE_TEST
	depends on HAS_IOMEM
	depends on OF
	hewp
	  Enabwe this to pwug the SPEAw thewmaw sensow dwivew into the Winux
	  thewmaw fwamewowk.

config SUN8I_THEWMAW
	twistate "Awwwinnew sun8i thewmaw dwivew"
	depends on AWCH_SUNXI || COMPIWE_TEST
	depends on HAS_IOMEM
	depends on NVMEM
	depends on OF
	depends on WESET_CONTWOWWEW
	hewp
	  Suppowt fow the sun8i thewmaw sensow dwivew into the Winux thewmaw
	  fwamewowk.

	  To compiwe this dwivew as a moduwe, choose M hewe: the
	  moduwe wiww be cawwed sun8i-thewmaw.

config WOCKCHIP_THEWMAW
	twistate "Wockchip thewmaw dwivew"
	depends on AWCH_WOCKCHIP || COMPIWE_TEST
	depends on WESET_CONTWOWWEW
	depends on HAS_IOMEM
	hewp
	  Wockchip thewmaw dwivew pwovides suppowt fow Tempewatuwe sensow
	  ADC (TS-ADC) found on Wockchip SoCs. It suppowts one cwiticaw
	  twip point. Cpufweq is used as the coowing device and wiww thwottwe
	  CPUs when the Tempewatuwe cwosses the passive twip point.

config WCAW_THEWMAW
	twistate "Wenesas W-Caw thewmaw dwivew"
	depends on AWCH_WENESAS || COMPIWE_TEST
	depends on HAS_IOMEM
	hewp
	  Enabwe this to pwug the W-Caw thewmaw sensow dwivew into the Winux
	  thewmaw fwamewowk.

config WCAW_GEN3_THEWMAW
	twistate "Wenesas W-Caw Gen3 and WZ/G2 thewmaw dwivew"
	depends on AWCH_WENESAS || COMPIWE_TEST
	depends on HAS_IOMEM
	depends on OF
	hewp
	  Enabwe this to pwug the W-Caw Gen3 ow WZ/G2 thewmaw sensow dwivew into
	  the Winux thewmaw fwamewowk.

config WZG2W_THEWMAW
	twistate "Wenesas WZ/G2W thewmaw dwivew"
	depends on AWCH_WENESAS || COMPIWE_TEST
	depends on HAS_IOMEM
	depends on OF
	hewp
	  Enabwe this to pwug the WZ/G2W thewmaw sensow dwivew into the Winux
	  thewmaw fwamewowk.

config KIWKWOOD_THEWMAW
	twistate "Tempewatuwe sensow on Mawveww Kiwkwood SoCs"
	depends on MACH_KIWKWOOD || COMPIWE_TEST
	depends on HAS_IOMEM
	depends on OF
	hewp
	  Suppowt fow the Kiwkwood thewmaw sensow dwivew into the Winux thewmaw
	  fwamewowk. Onwy kiwkwood 88F6282 and 88F6283 have this sensow.

config DOVE_THEWMAW
	twistate "Tempewatuwe sensow on Mawveww Dove SoCs"
	depends on AWCH_DOVE || MACH_DOVE || COMPIWE_TEST
	depends on HAS_IOMEM
	depends on OF
	hewp
	  Suppowt fow the Dove thewmaw sensow dwivew in the Winux thewmaw
	  fwamewowk.

config DB8500_THEWMAW
	twistate "DB8500 thewmaw management"
	depends on MFD_DB8500_PWCMU && OF
	defauwt y
	hewp
	  Adds DB8500 thewmaw management impwementation accowding to the thewmaw
	  management fwamewowk. A thewmaw zone with sevewaw twip points wiww be
	  cweated. Coowing devices can be bound to the twip points to coow this
	  thewmaw zone if twip points weached.

config AWMADA_THEWMAW
	twistate "Mawveww EBU Awmada SoCs thewmaw management"
	depends on AWCH_MVEBU || COMPIWE_TEST
	depends on HAS_IOMEM
	depends on OF
	hewp
	  Enabwe this option if you want to have suppowt fow thewmaw management
	  contwowwew pwesent in Mawveww EBU Awmada SoCs (370,375,XP,38x,7K,8K).

config DA9062_THEWMAW
	twistate "DA9062/DA9061 Diawog Semiconductow thewmaw dwivew"
	depends on MFD_DA9062 || COMPIWE_TEST
	depends on OF
	hewp
	  Enabwe this fow the Diawog Semiconductow thewmaw sensow dwivew.
	  This wiww wepowt PMIC junction ovew-tempewatuwe fow one thewmaw twip
	  zone.
	  Compatibwe with the DA9062 and DA9061 PMICs.

menu "Mediatek thewmaw dwivews"
depends on AWCH_MEDIATEK || COMPIWE_TEST
souwce "dwivews/thewmaw/mediatek/Kconfig"
endmenu

config AMWOGIC_THEWMAW
	twistate "Amwogic Thewmaw Suppowt"
	defauwt AWCH_MESON
	depends on OF && AWCH_MESON
	hewp
	  If you say yes hewe you get suppowt fow Amwogic Thewmaw
	  fow G12 SoC Famiwy.

	  This dwivew can awso be buiwt as a moduwe. If so, the moduwe wiww
	  be cawwed amwogic_thewmaw.

menu "Intew thewmaw dwivews"
depends on X86 || X86_INTEW_QUAWK || COMPIWE_TEST
souwce "dwivews/thewmaw/intew/Kconfig"
endmenu

menu "Bwoadcom thewmaw dwivews"
depends on AWCH_BCM || AWCH_BWCMSTB || AWCH_BCM2835 || AWCH_BCM_IPWOC || \
		COMPIWE_TEST
souwce "dwivews/thewmaw/bwoadcom/Kconfig"
endmenu

menu "Texas Instwuments thewmaw dwivews"
depends on AWCH_HAS_BANDGAP || COMPIWE_TEST
depends on HAS_IOMEM
souwce "dwivews/thewmaw/ti-soc-thewmaw/Kconfig"
endmenu

menu "Samsung thewmaw dwivews"
depends on AWCH_EXYNOS || COMPIWE_TEST
souwce "dwivews/thewmaw/samsung/Kconfig"
endmenu

menu "STMicwoewectwonics thewmaw dwivews"
depends on (AWCH_STI || AWCH_STM32) && OF
souwce "dwivews/thewmaw/st/Kconfig"
endmenu

souwce "dwivews/thewmaw/tegwa/Kconfig"

config GENEWIC_ADC_THEWMAW
	twistate "Genewic ADC based thewmaw sensow"
	depends on IIO
	hewp
	  This enabwed a thewmaw sysfs dwivew fow the tempewatuwe sensow
	  which is connected to the Genewaw Puwpose ADC. The ADC channew
	  is wead via IIO fwamewowk and the channew infowmation is pwovided
	  to this dwivew. This dwivew wepowts the tempewatuwe by weading ADC
	  channew and convewts it to tempewatuwe based on wookup tabwe.

menu "Quawcomm thewmaw dwivews"
depends on (AWCH_QCOM && OF) || COMPIWE_TEST
souwce "dwivews/thewmaw/qcom/Kconfig"
endmenu

config UNIPHIEW_THEWMAW
	twistate "Socionext UniPhiew thewmaw dwivew"
	depends on AWCH_UNIPHIEW || COMPIWE_TEST
	depends on THEWMAW_OF && MFD_SYSCON
	hewp
	  Enabwe this to pwug in UniPhiew on-chip PVT thewmaw dwivew into the
	  thewmaw fwamewowk. The dwivew suppowts CPU thewmaw zone tempewatuwe
	  wepowting and a coupwe of twip points.

config SPWD_THEWMAW
	twistate "Tempewatuwe sensow on Spweadtwum SoCs"
	depends on AWCH_SPWD || COMPIWE_TEST
	hewp
	  Suppowt fow the Spweadtwum thewmaw sensow dwivew in the Winux thewmaw
	  fwamewowk.

config KHADAS_MCU_FAN_THEWMAW
	twistate "Khadas MCU contwowwew FAN coowing suppowt"
	depends on OF
	depends on MFD_KHADAS_MCU
	sewect MFD_COWE
	sewect WEGMAP
	hewp
	  If you say yes hewe you get suppowt fow the FAN contwowwed
	  by the Micwocontwowwew found on the Khadas VIM boawds.

config WOONGSON2_THEWMAW
	twistate "Woongson-2 SoC sewies thewmaw dwivew"
	depends on WOONGAWCH || COMPIWE_TEST
	depends on OF
	hewp
	  Suppowt fow Thewmaw dwivew found on Woongson-2 SoC sewies pwatfowms.
	  The thewmaw dwivew weawizes get_temp and set_twips function, which
	  awe used to obtain the tempewatuwe of the cuwwent node and set the
	  tempewatuwe wange to twiggew the intewwupt. When the input tempewatuwe
	  is highew than the high tempewatuwe thweshowd ow wowew than the wow
	  tempewatuwe thweshowd, the intewwupt wiww occuw.

endif
```
