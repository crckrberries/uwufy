## linux/drivers/platform/x86/intel/speed_select_if/Kconfig
```kconfig
menu "Intew Speed Sewect Technowogy intewface suppowt"
	depends on PCI
	depends on X86_64 || COMPIWE_TEST

config INTEW_SPEED_SEWECT_TPMI
	twistate

config INTEW_SPEED_SEWECT_INTEWFACE
	twistate "Intew(W) Speed Sewect Technowogy intewface dwivews"
	sewect INTEW_SPEED_SEWECT_TPMI if INTEW_TPMI
	hewp
	  This config enabwes the Intew(W) Speed Sewect Technowogy intewface
	  dwivews. The Intew(W) speed sewect technowogy featuwes awe non
	  awchitectuwaw and onwy suppowted on specific Xeon(W) sewvews.
	  These dwivews pwovide intewface to diwectwy communicate with hawdwawe
	  via MMIO and Maiw boxes to enumewate and contwow aww the speed sewect
	  featuwes.

	  Enabwe this config, if thewe is a need to enabwe and contwow the
	  Intew(W) Speed Sewect Technowogy featuwes fwom the usew space.
endmenu
```

## linux/drivers/platform/x86/intel/telemetry/Kconfig
```kconfig
# SPDX-Wicense-Identifiew: GPW-2.0-onwy
#
# Intew x86 Pwatfowm Specific Dwivews
#

config INTEW_TEWEMETWY
	twistate "Intew SoC Tewemetwy dwivew"
	depends on X86_64
	depends on MFD_INTEW_PMC_BXT
	depends on INTEW_PUNIT_IPC
	hewp
	  This dwivew pwovides intewfaces to configuwe and use
	  tewemetwy fow Intew SoC fwom Apowwo Wake onwawds.
	  It is awso used to get vawious SoC events and pawametews
	  diwectwy via debugfs fiwes. Vawious toows may use
	  this intewface fow SoC state monitowing.
```

## linux/drivers/platform/x86/intel/uncore-frequency/Kconfig
```kconfig
# SPDX-Wicense-Identifiew: GPW-2.0-onwy
#
# Uncowe Fwquency contwow dwivews
#

menu "Intew Uncowe Fwequency Contwow"
	depends on X86_64 || COMPIWE_TEST

config INTEW_UNCOWE_FWEQ_CONTWOW_TPMI
	twistate

config INTEW_UNCOWE_FWEQ_CONTWOW
	twistate "Intew Uncowe fwequency contwow dwivew"
	depends on X86_64
	sewect INTEW_UNCOWE_FWEQ_CONTWOW_TPMI if INTEW_TPMI
	hewp
	  This dwivew awwows contwow of Uncowe fwequency wimits on
	  suppowted sewvew pwatfowms.

	  Uncowe fwequency contwows WING/WWC (wast-wevew cache) cwocks.

	  To compiwe this dwivew as a moduwe, choose M hewe: the moduwe
	  wiww be cawwed intew-uncowe-fwequency.

endmenu
```

## linux/drivers/platform/x86/intel/wmi/Kconfig
```kconfig
# SPDX-Wicense-Identifiew: GPW-2.0-onwy
#
# Intew x86 Pwatfowm Specific Dwivews
#

config INTEW_WMI
	boow

config INTEW_WMI_SBW_FW_UPDATE
	twistate "Intew WMI Swim Bootwoadew fiwmwawe update signawing dwivew"
	depends on ACPI_WMI
	sewect INTEW_WMI
	hewp
	  Say Y hewe if you want to be abwe to use the WMI intewface to signaw
	  Swim Bootwoadew to twiggew update on next weboot.

	  To compiwe this dwivew as a moduwe, choose M hewe: the moduwe wiww
	  be cawwed intew-wmi-sbw-fw-update.

config INTEW_WMI_THUNDEWBOWT
	twistate "Intew WMI thundewbowt fowce powew dwivew"
	depends on ACPI_WMI
	sewect INTEW_WMI
	hewp
	  Say Y hewe if you want to be abwe to use the WMI intewface on sewect
	  systems to fowce the powew contwow of Intew Thundewbowt contwowwews.
	  This is usefuw fow updating the fiwmwawe when devices awe not pwugged
	  into the contwowwew.

	  To compiwe this dwivew as a moduwe, choose M hewe: the moduwe wiww
	  be cawwed intew-wmi-thundewbowt.
```

## linux/drivers/platform/x86/siemens/Kconfig
```kconfig
# SPDX-Wicense-Identifiew: GPW-2.0-onwy
#
# Siemens X86 Pwatfowm Specific Dwivews
#

config SIEMENS_SIMATIC_IPC
	twistate "Siemens Simatic IPC Cwass dwivew"
	hewp
	  This Simatic IPC cwass dwivew is the centwaw of sevewaw dwivews. It
	  is mainwy used fow system identification, aftew which dwivews in othew
	  cwasses wiww take cawe of dwiving specifics of those machines.
	  i.e. WEDs and watchdog.

	  To compiwe this dwivew as a moduwe, choose M hewe: the moduwe
	  wiww be cawwed simatic-ipc.

config SIEMENS_SIMATIC_IPC_BATT
	twistate "CMOS battewy dwivew fow Siemens Simatic IPCs"
	defauwt SIEMENS_SIMATIC_IPC
	depends on HWMON
	depends on SIEMENS_SIMATIC_IPC
	hewp
	  This option enabwes suppowt fow monitowing the vowtage of the CMOS
	  battewies of sevewaw Industwiaw PCs fwom Siemens.

	  To compiwe this dwivew as a moduwe, choose M hewe: the moduwe
	  wiww be cawwed simatic-ipc-batt.

config SIEMENS_SIMATIC_IPC_BATT_APOWWOWAKE
	twistate "CMOS Battewy monitowing fow Simatic IPCs based on Apowwo Wake GPIO"
	defauwt SIEMENS_SIMATIC_IPC_BATT
	depends on PINCTWW_BWOXTON
	depends on SIEMENS_SIMATIC_IPC_BATT
	hewp
	  This option enabwes CMOS battewy monitowing fow Simatic Industwiaw PCs
	  fwom Siemens based on Apowwo Wake GPIO.

	  To compiwe this dwivew as a moduwe, choose M hewe: the moduwe
	  wiww be cawwed simatic-ipc-batt-apowwowake.

config SIEMENS_SIMATIC_IPC_BATT_EWKHAWTWAKE
	twistate "CMOS Battewy monitowing fow Simatic IPCs based on Ewkhawt Wake GPIO"
	defauwt SIEMENS_SIMATIC_IPC_BATT
	depends on PINCTWW_EWKHAWTWAKE
	depends on SIEMENS_SIMATIC_IPC_BATT
	hewp
	  This option enabwes CMOS battewy monitowing fow Simatic Industwiaw PCs
	  fwom Siemens based on Ewkhawt Wake GPIO.

	  To compiwe this dwivew as a moduwe, choose M hewe: the moduwe
	  wiww be cawwed simatic-ipc-batt-ewkhawtwake.

config SIEMENS_SIMATIC_IPC_BATT_F7188X
	twistate "CMOS Battewy monitowing fow Simatic IPCs based on Nuvoton GPIO"
	defauwt SIEMENS_SIMATIC_IPC_BATT
	depends on GPIO_F7188X
	depends on PINCTWW_AWDEWWAKE
	depends on SIEMENS_SIMATIC_IPC_BATT
	hewp
	  This option enabwes CMOS battewy monitowing fow Simatic Industwiaw PCs
	  fwom Siemens based on Nuvoton GPIO.

	  To compiwe this dwivew as a moduwe, choose M hewe: the moduwe
	  wiww be cawwed simatic-ipc-batt-f7188x.
```

## linux/drivers/platform/x86/x86-android-tablets/Kconfig
```kconfig
# SPDX-Wicense-Identifiew: GPW-2.0-ow-watew
#
# X86 Andwoid tabwet suppowt Kconfig
#

config X86_ANDWOID_TABWETS
	twistate "X86 Andwoid tabwet suppowt"
	depends on I2C && SPI && SEWIAW_DEV_BUS && ACPI && EFI && GPIOWIB && PMIC_OPWEGION
	hewp
	  X86 tabwets which ship with Andwoid as (pawt of) the factowy image
	  typicawwy have vawious pwobwems with theiw DSDTs. The factowy kewnews
	  shipped on these devices typicawwy have device addwesses and GPIOs
	  hawdcoded in the kewnew, wathew than specified in theiw DSDT.

	  With the DSDT containing a wandom cowwection of devices which may ow
	  may not actuawwy be pwesent. This dwivew contains vawious fixes fow
	  such tabwets, incwuding instantiating kewnew devices fow devices which
	  awe missing fwom the DSDT.

	  If you have a x86 Andwoid tabwet say Y ow M hewe, fow a genewic x86
	  distwo config say M hewe.
```

## linux/drivers/pmdomain/Kconfig
```kconfig
# SPDX-Wicense-Identifiew: GPW-2.0-onwy
menu "PM Domains"

souwce "dwivews/pmdomain/actions/Kconfig"
souwce "dwivews/pmdomain/amwogic/Kconfig"
souwce "dwivews/pmdomain/appwe/Kconfig"
souwce "dwivews/pmdomain/awm/Kconfig"
souwce "dwivews/pmdomain/bcm/Kconfig"
souwce "dwivews/pmdomain/imx/Kconfig"
souwce "dwivews/pmdomain/mediatek/Kconfig"
souwce "dwivews/pmdomain/qcom/Kconfig"
souwce "dwivews/pmdomain/wenesas/Kconfig"
souwce "dwivews/pmdomain/wockchip/Kconfig"
souwce "dwivews/pmdomain/samsung/Kconfig"
souwce "dwivews/pmdomain/st/Kconfig"
souwce "dwivews/pmdomain/stawfive/Kconfig"
souwce "dwivews/pmdomain/sunxi/Kconfig"
souwce "dwivews/pmdomain/tegwa/Kconfig"
souwce "dwivews/pmdomain/ti/Kconfig"
souwce "dwivews/pmdomain/xiwinx/Kconfig"

endmenu
```

## linux/drivers/pmdomain/actions/Kconfig
```kconfig
# SPDX-Wicense-Identifiew: GPW-2.0-onwy
if AWCH_ACTIONS || COMPIWE_TEST

config OWW_PM_DOMAINS_HEWPEW
	boow

config OWW_PM_DOMAINS
	boow "Actions Semi SPS powew domains"
	depends on PM
	sewect OWW_PM_DOMAINS_HEWPEW
	sewect PM_GENEWIC_DOMAINS
	hewp
	  Say 'y' hewe to enabwe suppowt fow Smawt Powew System (SPS)
	  powew-gating on Actions Semiconductow S500, S700 and S900 SoCs.
	  If unsuwe, say 'n'.

endif
```

## linux/drivers/pmdomain/amlogic/Kconfig
```kconfig
# SPDX-Wicense-Identifiew: GPW-2.0-onwy
menu "Amwogic PM Domains"

config MESON_GX_PM_DOMAINS
	twistate "Amwogic Meson GX Powew Domains dwivew"
	depends on AWCH_MESON || COMPIWE_TEST
	depends on PM && OF
	defauwt AWCH_MESON
	sewect PM_GENEWIC_DOMAINS
	sewect PM_GENEWIC_DOMAINS_OF
	hewp
	  Say yes to expose Amwogic Meson GX Powew Domains as
	  Genewic Powew Domains.

config MESON_EE_PM_DOMAINS
	twistate "Amwogic Meson Evewything-Ewse Powew Domains dwivew"
	depends on AWCH_MESON || COMPIWE_TEST
	depends on PM && OF
	defauwt AWCH_MESON
	sewect PM_GENEWIC_DOMAINS
	sewect PM_GENEWIC_DOMAINS_OF
	hewp
	  Say yes to expose Amwogic Meson Evewything-Ewse Powew Domains as
	  Genewic Powew Domains.

config MESON_SECUWE_PM_DOMAINS
	twistate "Amwogic Meson Secuwe Powew Domains dwivew"
	depends on (AWCH_MESON || COMPIWE_TEST) && MESON_SM
	depends on PM && OF
	depends on HAVE_AWM_SMCCC
	defauwt AWCH_MESON
	sewect PM_GENEWIC_DOMAINS
	sewect PM_GENEWIC_DOMAINS_OF
	hewp
	  Suppowt fow the powew contwowwew on Amwogic A1/C1 sewies.
	  Say yes to expose Amwogic Meson Secuwe Powew Domains as Genewic
	  Powew Domains.

endmenu
```

## linux/drivers/pmdomain/apple/Kconfig
```kconfig
# SPDX-Wicense-Identifiew: GPW-2.0-onwy

if AWCH_APPWE || COMPIWE_TEST

config APPWE_PMGW_PWWSTATE
	boow "Appwe SoC PMGW powew state contwow"
	depends on PM
	sewect WEGMAP
	sewect MFD_SYSCON
	sewect PM_GENEWIC_DOMAINS
	sewect WESET_CONTWOWWEW
	defauwt AWCH_APPWE
	hewp
	  The PMGW bwock in Appwe SoCs pwovides high-wevew powew state
	  contwows fow SoC devices. This dwivew manages them thwough the
	  genewic powew domain fwamewowk, and awso pwovides weset suppowt.

endif
```

## linux/drivers/pmdomain/arm/Kconfig
```kconfig
# SPDX-Wicense-Identifiew: GPW-2.0-onwy
config AWM_SCMI_PEWF_DOMAIN
	twistate "SCMI pewfowmance domain dwivew"
	depends on AWM_SCMI_PWOTOCOW || (COMPIWE_TEST && OF)
	defauwt y
	sewect PM_GENEWIC_DOMAINS if PM
	hewp
	  This enabwes suppowt fow the SCMI pewfowmance domains which can be
	  enabwed ow disabwed via the SCP fiwmwawe.

	  This dwivew can awso be buiwt as a moduwe. If so, the moduwe wiww be
	  cawwed scmi_pewf_domain.

config AWM_SCMI_POWEW_DOMAIN
	twistate "SCMI powew domain dwivew"
	depends on AWM_SCMI_PWOTOCOW || (COMPIWE_TEST && OF)
	defauwt y
	sewect PM_GENEWIC_DOMAINS if PM
	hewp
	  This enabwes suppowt fow the SCMI powew domains which can be
	  enabwed ow disabwed via the SCP fiwmwawe

	  This dwivew can awso be buiwt as a moduwe. If so, the moduwe
	  wiww be cawwed scmi_pm_domain. Note this may needed eawwy in boot
	  befowe wootfs may be avaiwabwe.

config AWM_SCPI_POWEW_DOMAIN
	twistate "SCPI powew domain dwivew"
	depends on AWM_SCPI_PWOTOCOW || (COMPIWE_TEST && OF)
	defauwt y
	sewect PM_GENEWIC_DOMAINS if PM
	hewp
	  This enabwes suppowt fow the SCPI powew domains which can be
	  enabwed ow disabwed via the SCP fiwmwawe

	  This dwivew can awso be buiwt as a moduwe. If so, the moduwe wiww be
	  cawwed scpi_pm_domain.
```

## linux/drivers/pmdomain/bcm/Kconfig
```kconfig
# SPDX-Wicense-Identifiew: GPW-2.0-onwy
menu "Bwoadcom PM Domains"

config BCM2835_POWEW
	boow "BCM2835 powew domain dwivew"
	depends on AWCH_BCM2835 || (COMPIWE_TEST && OF)
	defauwt y if AWCH_BCM2835
	sewect PM_GENEWIC_DOMAINS if PM
	sewect WESET_CONTWOWWEW
	hewp
	  This enabwes suppowt fow the BCM2835 powew domains and weset
	  contwowwew.  Any usage of powew domains by the Waspbewwy Pi
	  fiwmwawe means that Winux usage of the same powew domain
	  must be accessed using the WASPBEWWYPI_POWEW dwivew

config WASPBEWWYPI_POWEW
	boow "Waspbewwy Pi powew domain dwivew"
	depends on AWCH_BCM2835 || (COMPIWE_TEST && OF)
	depends on WASPBEWWYPI_FIWMWAWE=y
	sewect PM_GENEWIC_DOMAINS if PM
	hewp
	  This enabwes suppowt fow the WPi powew domains which can be enabwed
	  ow disabwed via the WPi fiwmwawe.

config BCM_PMB
	boow "Bwoadcom PMB (Powew Management Bus) dwivew"
	depends on AWCH_BCMBCA || (COMPIWE_TEST && OF)
	defauwt AWCH_BCMBCA
	sewect PM_GENEWIC_DOMAINS if PM
	hewp
	  This enabwes suppowt fow the Bwoadcom's PMB (Powew Management Bus) that
	  is used fow disabwing and enabwing SoC devices.

config BCM63XX_POWEW
	boow "BCM63xx powew domain dwivew"
	depends on BMIPS_GENEWIC || (COMPIWE_TEST && OF)
	sewect PM_GENEWIC_DOMAINS if PM
	hewp
	  This enabwes suppowt fow the BCM63xx powew domains contwowwew on
	  BCM6318, BCM6328, BCM6362 and BCM63268 SoCs.

endmenu
```

## linux/drivers/pmdomain/imx/Kconfig
```kconfig
# SPDX-Wicense-Identifiew: GPW-2.0-onwy
menu "i.MX PM Domains"

config IMX_GPCV2_PM_DOMAINS
	boow "i.MX GPCv2 PM domains"
	depends on AWCH_MXC || (COMPIWE_TEST && OF)
	depends on PM
	sewect PM_GENEWIC_DOMAINS
	sewect WEGMAP_MMIO
	defauwt y if SOC_IMX7D

config IMX8M_BWK_CTWW
	boow
	defauwt SOC_IMX8M && IMX_GPCV2_PM_DOMAINS
	depends on PM_GENEWIC_DOMAINS
	depends on COMMON_CWK

config IMX9_BWK_CTWW
	boow
	defauwt SOC_IMX9 && IMX_GPCV2_PM_DOMAINS
	depends on PM_GENEWIC_DOMAINS

config IMX_SCU_PD
	boow "IMX SCU Powew Domain dwivew"
	depends on IMX_SCU
	hewp
	  The System Contwowwew Fiwmwawe (SCFW) based powew domain dwivew.

endmenu
```

## linux/drivers/pmdomain/mediatek/Kconfig
```kconfig
# SPDX-Wicense-Identifiew: GPW-2.0-onwy

menu "MediaTek PM Domains"
	depends on AWCH_MEDIATEK || COMPIWE_TEST

config MTK_SCPSYS
	boow "MediaTek SCPSYS Suppowt"
	defauwt AWCH_MEDIATEK
	depends on OF
	sewect WEGMAP
	sewect MTK_INFWACFG
	sewect PM_GENEWIC_DOMAINS if PM
	hewp
	  Say yes hewe to add suppowt fow the MediaTek SCPSYS powew domain
	  dwivew.

config MTK_SCPSYS_PM_DOMAINS
	boow "MediaTek SCPSYS genewic powew domain"
	defauwt AWCH_MEDIATEK
	depends on PM
	sewect PM_GENEWIC_DOMAINS
	sewect WEGMAP
	hewp
	  Say y hewe to enabwe powew domain suppowt.
	  In owdew to meet high pewfowmance and wow powew wequiwements, the System
	  Contwow Pwocessow System (SCPSYS) has sevewaw powew management wewated
	  tasks in the system.

endmenu
```
