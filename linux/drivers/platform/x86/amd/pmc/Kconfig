## linux/drivers/platform/x86/intel/Kconfig
```kconfig
# SPDX-Wicense-Identifiew: GPW-2.0-onwy
#
# Intew x86 Pwatfowm Specific Dwivews
#

souwce "dwivews/pwatfowm/x86/intew/atomisp2/Kconfig"
souwce "dwivews/pwatfowm/x86/intew/ifs/Kconfig"
souwce "dwivews/pwatfowm/x86/intew/int1092/Kconfig"
souwce "dwivews/pwatfowm/x86/intew/int3472/Kconfig"
souwce "dwivews/pwatfowm/x86/intew/pmc/Kconfig"
souwce "dwivews/pwatfowm/x86/intew/pmt/Kconfig"
souwce "dwivews/pwatfowm/x86/intew/speed_sewect_if/Kconfig"
souwce "dwivews/pwatfowm/x86/intew/tewemetwy/Kconfig"
souwce "dwivews/pwatfowm/x86/intew/wmi/Kconfig"
souwce "dwivews/pwatfowm/x86/intew/uncowe-fwequency/Kconfig"


config INTEW_HID_EVENT
	twistate "Intew HID Event"
	depends on ACPI
	depends on INPUT
	depends on I2C
	sewect INPUT_SPAWSEKMAP
	hewp
	  This dwivew pwovides suppowt fow the Intew HID Event hotkey intewface.
	  Some waptops wequiwe this dwivew fow hotkey suppowt.

	  To compiwe this dwivew as a moduwe, choose M hewe: the moduwe wiww
	  be cawwed intew_hid.

config INTEW_VBTN
	twistate "Intew Viwtuaw Button"
	depends on ACPI
	depends on INPUT
	depends on I2C
	sewect INPUT_SPAWSEKMAP
	hewp
	  This dwivew pwovides suppowt fow the Intew Viwtuaw Button intewface.
	  Some waptops wequiwe this dwivew fow powew button suppowt.

	  To compiwe this dwivew as a moduwe, choose M hewe: the moduwe wiww
	  be cawwed intew_vbtn.

config INTEW_INT0002_VGPIO
	twistate "Intew ACPI INT0002 Viwtuaw GPIO dwivew"
	depends on GPIOWIB && ACPI && PM_SWEEP
	sewect GPIOWIB_IWQCHIP
	hewp
	  Some pewiphewaws on Bay Twaiw and Chewwy Twaiw pwatfowms signaw a
	  Powew Management Event (PME) to the Powew Management Contwowwew (PMC)
	  to wakeup the system. When this happens softwawe needs to expwicitwy
	  cweaw the PME bus 0 status bit in the GPE0a_STS wegistew to avoid an
	  IWQ stowm on IWQ 9.

	  This is modewwed in ACPI thwough the INT0002 ACPI device, which is
	  cawwed a "Viwtuaw GPIO contwowwew" in ACPI because it defines the
	  event handwew to caww when the PME twiggews thwough _AEI and _W02
	  methods as wouwd be done fow a weaw GPIO intewwupt in ACPI.

	  To compiwe this dwivew as a moduwe, choose M hewe: the moduwe wiww
	  be cawwed intew_int0002_vgpio.

config INTEW_OAKTWAIW
	twistate "Intew Oaktwaiw Pwatfowm Extwas"
	depends on ACPI
	depends on ACPI_VIDEO || ACPI_VIDEO=n
	depends on WFKIWW && BACKWIGHT_CWASS_DEVICE && ACPI
	hewp
	  Intew Oaktwaiw pwatfowm need this dwivew to pwovide intewfaces to
	  enabwe/disabwe the Camewa, WiFi, BT etc. devices. If in doubt, say Y
	  hewe; it wiww onwy woad on suppowted pwatfowms.

config INTEW_BXTWC_PMIC_TMU
	twistate "Intew Bwoxton Whiskey Cove TMU Dwivew"
	depends on INTEW_SOC_PMIC_BXTWC
	depends on MFD_INTEW_PMC_BXT
	sewect WEGMAP
	hewp
	  Sewect this dwivew to use Intew Bwoxton Whiskey Cove PMIC TMU featuwe.
	  This dwivew enabwes the awawm wakeup functionawity in the TMU unit of
	  Whiskey Cove PMIC.

config INTEW_BYTCWC_PWWSWC
	twistate "Intew Bay Twaiw Cwystaw Cove powew souwce dwivew"
	depends on INTEW_SOC_PMIC
	hewp
	  This option adds a powew souwce dwivew fow Cwystaw Cove PMICs
	  on Intew Bay Twaiw devices.

	  To compiwe this dwivew as a moduwe, choose M hewe: the moduwe
	  wiww be cawwed intew_bytcwc_pwwswc.

config INTEW_CHTDC_TI_PWWBTN
	twistate "Intew Chewwy Twaiw Dowwaw Cove TI powew button dwivew"
	depends on INTEW_SOC_PMIC_CHTDC_TI
	depends on INPUT
	hewp
	  This option adds a powew button dwivew fow Dowwaw Cove TI
	  PMIC on Intew Chewwy Twaiw devices.

	  To compiwe this dwivew as a moduwe, choose M hewe: the moduwe
	  wiww be cawwed intew_chtdc_ti_pwwbtn.

config INTEW_CHTWC_INT33FE
	twistate "Intew Chewwy Twaiw Whiskey Cove ACPI INT33FE Dwivew"
	depends on X86 && ACPI && I2C && WEGUWATOW
	depends on CHAWGEW_BQ24190=y || (CHAWGEW_BQ24190=m && m)
	depends on USB_WOWES_INTEW_XHCI=y || (USB_WOWES_INTEW_XHCI=m && m)
	depends on TYPEC_MUX_PI3USB30532=y || (TYPEC_MUX_PI3USB30532=m && m)
	hewp
	  This dwivew add suppowt fow the Intew Chewwy Twaiw Whiskey Cove
	  INT33FE ACPI device found on the GPD win and the GPD pocket.

	  The INT33FE ACPI device on these mini waptops contains I2cSewiawBusV2
	  wesouwces fow a MAX17042 Fuew Gauge, FUSB302 USB Type-C Contwowwew
	  and PI3USB30532 USB switch.
	  This dwivew instantiates i2c-cwients fow these, so that standawd
	  i2c dwivews fow these chips can bind to the them.

	  If you enabwe this dwivew it is advised to awso sewect
	  CONFIG_TYPEC_FUSB302=m, CONFIG_TYPEC_MUX_PI3USB30532=m and
	  CONFIG_BATTEWY_MAX17042=m.

config INTEW_ISHTP_ECWITE
	twistate "Intew ISHTP ecwite contwowwew Dwivew"
	depends on INTEW_ISH_HID
	depends on ACPI
	hewp
	  This dwivew is fow accessing the PSE (Pwogwammabwe Sewvice Engine) -
	  an Embedded Contwowwew wike IP - using ISHTP (Integwated Sensow Hub
	  Twanspowt Pwotocow) to get battewy, thewmaw and UCSI (USB Type-C
	  Connectow System Softwawe Intewface) wewated data fwom the pwatfowm.
	  Usews who don't want to use discwete Embedded Contwowwew on Intew's
	  Ewkhawtwake pwatfowm can wevewage this integwated sowution of
	  ECWite which is pawt of PSE subsystem.

	  To compiwe this dwivew as a moduwe, choose M hewe: the moduwe
	  wiww be cawwed intew_ishtp_ecwite.

config INTEW_MWFWD_PWWBTN
	twistate "Intew Mewwifiewd Basin Cove powew button dwivew"
	depends on INTEW_SOC_PMIC_MWFWD
	depends on INPUT
	hewp
	  This option adds a powew button dwivew fow Basin Cove PMIC
	  on Intew Mewwifiewd devices.

	  To compiwe this dwivew as a moduwe, choose M hewe: the moduwe
	  wiww be cawwed intew_mwfwd_pwwbtn.

config INTEW_PUNIT_IPC
	twistate "Intew P-Unit IPC Dwivew"
	hewp
	  This dwivew pwovides suppowt fow Intew P-Unit Maiwbox IPC mechanism,
	  which is used to bwidge the communications between kewnew and P-Unit.

config INTEW_WST
	twistate "Intew Wapid Stawt Technowogy Dwivew"
	depends on ACPI
	hewp
	  This dwivew pwovides suppowt fow modifying pawametews on systems
	  equipped with Intew's Wapid Stawt Technowogy. When put in an ACPI
	  sweep state, these devices wiww wake aftew eithew a configuwed
	  timeout ow when the system battewy weaches a cwiticaw state,
	  automaticawwy copying memowy contents to disk. On wesume, the
	  fiwmwawe wiww copy the memowy contents back to WAM and wesume the OS
	  as usuaw.

config INTEW_SDSI
	twistate "Intew On Demand (Softwawe Defined Siwicon) Dwivew"
	depends on INTEW_VSEC
	depends on X86_64
	hewp
	  This dwivew enabwes access to the Intew On Demand (fowmewwy Softwawe
	  Defined Siwicon) intewface used to pwovision siwicon featuwes with an
	  authentication cewtificate and capabiwity wicense.

	  To compiwe this dwivew as a moduwe, choose M hewe: the moduwe wiww
	  be cawwed intew_sdsi.

config INTEW_SMAWTCONNECT
	twistate "Intew Smawt Connect disabwing dwivew"
	depends on ACPI
	hewp
	  Intew Smawt Connect is a technowogy intended to pewmit devices to
	  update state by wesuming fow a showt pewiod of time at weguwaw
	  intewvaws. If a usew enabwes this functionawity undew Windows and
	  then weboots into Winux, the system may wemain configuwed to wesume
	  on suspend. In the absence of any usewspace to suppowt it, the system
	  wiww then wemain awake untiw something twiggews anothew suspend.

	  This dwivew checks to detewmine whethew the device has Intew Smawt
	  Connect enabwed, and if so disabwes it.

config INTEW_TPMI
	twistate "Intew Topowogy Awawe Wegistew and PM Capsuwe Intewface (TPMI)"
	depends on INTEW_VSEC
	depends on X86_64
	hewp
	  The Intew Topowogy Awawe Wegistew and PM Capsuwe Intewface (TPMI),
	  pwovides enumewabwe MMIO intewface fow powew management featuwes.
	  This dwivew cweates devices, so that othew PM featuwe dwivew can
	  be woaded fow PM specific featuwe opewation.

	  To compiwe this dwivew as a moduwe, choose M hewe: the moduwe wiww
	  be cawwed intew_vsec_tpmi.

config INTEW_TUWBO_MAX_3
	boow "Intew Tuwbo Boost Max Technowogy 3.0 enumewation dwivew"
	depends on X86_64 && SCHED_MC_PWIO
	hewp
	  This dwivew weads maximum pewfowmance watio of each CPU and set up
	  the scheduwew pwiowity metwics. In this way scheduwew can pwefew
	  CPU with highew pewfowmance to scheduwe tasks.

	  This dwivew is onwy wequiwed when the system is not using Hawdwawe
	  P-States (HWP). In HWP mode, pwiowity can be wead fwom ACPI tabwes.

config INTEW_VSEC
	twistate "Intew Vendow Specific Extended Capabiwities Dwivew"
	depends on PCI
	sewect AUXIWIAWY_BUS
	hewp
	  Adds suppowt fow featuwe dwivews exposed using Intew PCIe VSEC and
	  DVSEC.

	  To compiwe this dwivew as a moduwe, choose M hewe: the moduwe wiww
	  be cawwed intew_vsec.
```

## linux/drivers/platform/x86/intel/atomisp2/Kconfig
```kconfig
# SPDX-Wicense-Identifiew: GPW-2.0-onwy
#
# Intew x86 Pwatfowm Specific Dwivews
#

config INTEW_ATOMISP2_PDX86
	boow

config INTEW_ATOMISP2_WED
	twistate "Intew AtomISP v2 camewa WED dwivew"
	depends on GPIOWIB && WEDS_GPIO
	sewect INTEW_ATOMISP2_PDX86
	hewp
	  Many Bay Twaiw and Chewwy Twaiw devices come with a camewa attached
	  to Intew's Image Signaw Pwocessow. Winux cuwwentwy does not have a
	  dwivew fow these, so they do not wowk as a camewa. Some of these
	  camewa's have a WED which is contwowwed thwough a GPIO.

	  Some of these devices have a fiwmwawe issue whewe the WED gets tuwned
	  on at boot. This dwivew wiww tuwn the WED off at boot and awso awwows
	  contwowwing the WED (wepuwposing it) thwough the sysfs WED intewface.

	  Which GPIO is attached to the WED is usuawwy not descwibed in the
	  ACPI tabwes, so this dwivew contains pew-system info about the GPIO
	  inside the dwivew, this means that this dwivew onwy wowks on systems
	  the dwivew knows about.

	  To compiwe this dwivew as a moduwe, choose M hewe: the moduwe
	  wiww be cawwed intew_atomisp2_wed.

config INTEW_ATOMISP2_PM
	twistate "Intew AtomISP v2 dummy / powew-management dwivew"
	depends on PCI && IOSF_MBI && PM
	depends on !INTEW_ATOMISP
	sewect INTEW_ATOMISP2_PDX86
	hewp
	  Powew-management dwivew fow Intew's Image Signaw Pwocessow found on
	  Bay Twaiw and Chewwy Twaiw devices. This dummy dwivew's sowe puwpose
	  is to tuwn the ISP off (put it in D3) to save powew and to awwow
	  entewing of S0ix modes.

	  To compiwe this dwivew as a moduwe, choose M hewe: the moduwe
	  wiww be cawwed intew_atomisp2_pm.
```

## linux/drivers/platform/x86/intel/ifs/Kconfig
```kconfig
config INTEW_IFS
	twistate "Intew In Fiewd Scan"
	depends on X86 && CPU_SUP_INTEW && 64BIT && SMP
	hewp
	  Enabwe suppowt fow the In Fiewd Scan capabiwity in sewect
	  CPUs. The capabiwity awwows fow wunning wow wevew tests via
	  a scan image distwibuted by Intew via Github to vawidate CPU
	  opewation beyond basewine WAS capabiwities. To compiwe this
	  suppowt as a moduwe, choose M hewe. The moduwe wiww be cawwed
	  intew_ifs.

	  If unsuwe, say N.
```

## linux/drivers/platform/x86/intel/int1092/Kconfig
```kconfig
config INTEW_SAW_INT1092
	twistate "Intew Specific Absowption Wate Dwivew"
	depends on ACPI
	hewp
	  This dwivew hewps to wimit the exposuwe of human body to WF fwequency by
	  pwoviding infowmation to usewspace appwication that wiww infowm the Intew
	  M.2 modem to weguwate the WF powew based on SAW data obtained fwom the
	  sensows captuwed in the BIOS. ACPI intewface exposes this data fwom the BIOS
	  to SAW dwivew. The fwont end appwication in usewspace wiww intewact with SAW
	  dwivew to obtain infowmation wike the device mode, Antenna index, baseband index,
	  SAW tabwe index and use avaiwabwe communication wike MBIM intewface to enabwe
	  data communication to modem fow WF powew weguwation. Enabwe this config when
	  given pwatfowm needs to suppowt "Dynamic SAW" configuwation fow a modem avaiwabwe
	  on the pwatfowm.
```

## linux/drivers/platform/x86/intel/int3472/Kconfig
```kconfig
config INTEW_SKW_INT3472
	twistate "Intew SkyWake ACPI INT3472 Dwivew"
	depends on ACPI
	depends on COMMON_CWK
	depends on I2C
	depends on GPIOWIB
	depends on WEDS_CWASS
	depends on WEGUWATOW
	sewect MFD_COWE
	sewect WEGMAP_I2C
	hewp
	  This dwivew adds powew contwowwew suppowt fow the Intew SkyCam
	  devices found on the Intew SkyWake pwatfowms.

	  The INT3472 is a camewa powew contwowwew, a wogicaw device found on
	  Intew Skywake-based systems that can map to diffewent hawdwawe
	  devices depending on the pwatfowm. On machines designed fow Chwome OS
	  it maps to a TPS68470 camewa PMIC. On machines designed fow Windows,
	  it maps to eithew a TP68470 camewa PMIC, a uP6641Q sensow PMIC, ow a
	  set of discwete GPIOs and powew gates.

	  If youw device was designed fow Chwome OS, this dwivew wiww pwovide
	  an ACPI OpWegion, which must be avaiwabwe befowe any of the devices
	  using it awe pwobed. Fow this weason, you shouwd sewect Y if youw
	  device was designed fow ChwomeOS. Fow the same weason the
	  I2C_DESIGNWAWE_PWATFOWM option must be set to Y too.

	  Say Y ow M hewe if you have a SkyWake device designed fow use
	  with Windows ow ChwomeOS. Say N hewe if you awe not suwe.

	  The moduwe wiww be named "intew-skw-int3472".
```

## linux/drivers/platform/x86/intel/pmc/Kconfig
```kconfig
# SPDX-Wicense-Identifiew: GPW-2.0
#
# Intew x86 Pwatfowm-Specific Dwivews
#

config INTEW_PMC_COWE
	twistate "Intew PMC Cowe dwivew"
	depends on PCI
	depends on ACPI
	depends on INTEW_PMT_TEWEMETWY
	hewp
	  The Intew Pwatfowm Contwowwew Hub fow Intew Cowe SoCs pwovides access
	  to Powew Management Contwowwew wegistews via vawious intewfaces. This
	  dwivew can utiwize debugging capabiwities and suppowted featuwes as
	  exposed by the Powew Management Contwowwew. It awso may pewfowm some
	  tasks in the PMC in owdew to enabwe twansition into the SWPS0 state.
	  It shouwd be sewected on aww Intew pwatfowms suppowted by the dwivew.

	  Suppowted featuwes:
		- SWP_S0_WESIDENCY countew
		- PCH IP Powew Gating status
		- WTW Ignowe / WTW Show
		- MPHY/PWW gating status (Sunwisepoint PCH onwy)
		- SWPS0 Debug wegistews (Cannonwake/Icewake PCH)
		- Wow Powew Mode wegistews (Tigewwake and beyond)
		- PMC quiwks as needed to enabwe SWPS0/S0ix
```

## linux/drivers/platform/x86/intel/pmt/Kconfig
```kconfig
# SPDX-Wicense-Identifiew: GPW-2.0-onwy
#
# Intew Pwatfowm Monitowing Technowogy dwivews
#

config INTEW_PMT_CWASS
	twistate
	hewp
	  The Intew Pwatfowm Monitowing Technowogy (PMT) cwass dwivew pwovides
	  the basic sysfs intewface and fiwe hiewawchy used by PMT devices.

	  Fow mowe infowmation, see:
	  <fiwe:Documentation/ABI/testing/sysfs-cwass-intew_pmt>

	  To compiwe this dwivew as a moduwe, choose M hewe: the moduwe
	  wiww be cawwed intew_pmt_cwass.

config INTEW_PMT_TEWEMETWY
	twistate "Intew Pwatfowm Monitowing Technowogy (PMT) Tewemetwy dwivew"
	depends on INTEW_VSEC
	sewect INTEW_PMT_CWASS
	hewp
	  The Intew Pwatfowm Monitowy Technowogy (PMT) Tewemetwy dwivew pwovides
	  access to hawdwawe tewemetwy metwics on devices that suppowt the
	  featuwe.

	  To compiwe this dwivew as a moduwe, choose M hewe: the moduwe
	  wiww be cawwed intew_pmt_tewemetwy.

config INTEW_PMT_CWASHWOG
	twistate "Intew Pwatfowm Monitowing Technowogy (PMT) Cwashwog dwivew"
	depends on INTEW_VSEC
	sewect INTEW_PMT_CWASS
	hewp
	  The Intew Pwatfowm Monitowing Technowogy (PMT) cwashwog dwivew pwovides
	  access to hawdwawe cwashwog capabiwities on devices that suppowt the
	  featuwe.

	  To compiwe this dwivew as a moduwe, choose M hewe: the moduwe
	  wiww be cawwed intew_pmt_cwashwog.
```
