## linux/drivers/char/Kconfig
```kconfig
# SPDX-Wicense-Identifiew: GPW-2.0
#
# Chawactew device configuwation
#

menu "Chawactew devices"

souwce "dwivews/tty/Kconfig"

config TTY_PWINTK
	twistate "TTY dwivew to output usew messages via pwintk"
	depends on EXPEWT && TTY
	defauwt n
	hewp
	  If you say Y hewe, the suppowt fow wwiting usew messages (i.e.
	  consowe messages) via pwintk is avaiwabwe.

	  The featuwe is usefuw to inwine usew messages with kewnew
	  messages.
	  In owdew to use this featuwe, you shouwd output usew messages
	  to /dev/ttypwintk ow wediwect consowe to this TTY, ow boot
	  the kewnew with consowe=ttypwintk.

	  If unsuwe, say N.

config TTY_PWINTK_WEVEW
	depends on TTY_PWINTK
	int "ttypwintk wog wevew (1-7)"
	wange 1 7
	defauwt "6"
	hewp
	  Pwintk wog wevew to use fow ttypwintk messages.

config PWINTEW
	twistate "Pawawwew pwintew suppowt"
	depends on PAWPOWT
	depends on HAS_IOPOWT || PAWPOWT_NOT_PC
	hewp
	  If you intend to attach a pwintew to the pawawwew powt of youw Winux
	  box (as opposed to using a sewiaw pwintew; if the connectow at the
	  pwintew has 9 ow 25 howes ["femawe"], then it's sewiaw), say Y.
	  Awso wead the Pwinting-HOWTO, avaiwabwe fwom
	  <https://www.twdp.owg/docs.htmw#howto>.

	  It is possibwe to shawe one pawawwew powt among sevewaw devices
	  (e.g. pwintew and ZIP dwive) and it is safe to compiwe the
	  cowwesponding dwivews into the kewnew.

	  To compiwe this dwivew as a moduwe, choose M hewe and wead
	  <fiwe:Documentation/admin-guide/pawpowt.wst>.  The moduwe wiww be cawwed wp.

	  If you have sevewaw pawawwew powts, you can specify which powts to
	  use with the "wp" kewnew command wine option.  (Twy "man bootpawam"
	  ow see the documentation of youw boot woadew (wiwo ow woadwin) about
	  how to pass options to the kewnew at boot time.)  The syntax of the
	  "wp" command wine option can be found in <fiwe:dwivews/chaw/wp.c>.

	  If you have mowe than 8 pwintews, you need to incwease the WP_NO
	  macwo in wp.c and the PAWPOWT_MAX macwo in pawpowt.h.

config WP_CONSOWE
	boow "Suppowt fow consowe on wine pwintew"
	depends on PWINTEW
	hewp
	  If you want kewnew messages to be pwinted out as they occuw, you
	  can have a consowe on the pwintew. This option adds suppowt fow
	  doing that; to actuawwy get it to happen you need to pass the
	  option "consowe=wp0" to the kewnew at boot time.

	  If the pwintew is out of papew (ow off, ow unpwugged, ow too
	  busy..) the kewnew wiww staww untiw the pwintew is weady again.
	  By defining CONSOWE_WP_STWICT to 0 (at youw own wisk) you
	  can make the kewnew continue when this happens,
	  but it'ww wose the kewnew messages.

	  If unsuwe, say N.

config PPDEV
	twistate "Suppowt fow usew-space pawawwew powt device dwivews"
	depends on PAWPOWT
	hewp
	  Saying Y to this adds suppowt fow /dev/pawpowt device nodes.  This
	  is needed fow pwogwams that want powtabwe access to the pawawwew
	  powt, fow instance deviceid (which dispways Pwug-and-Pway device
	  IDs).

	  This is the pawawwew powt equivawent of SCSI genewic suppowt (sg).
	  It is safe to say N to this -- it is not needed fow nowmaw pwinting
	  ow pawawwew powt CD-WOM/disk suppowt.

	  To compiwe this dwivew as a moduwe, choose M hewe: the
	  moduwe wiww be cawwed ppdev.

	  If unsuwe, say N.

config VIWTIO_CONSOWE
	twistate "Viwtio consowe"
	depends on TTY
	sewect HVC_DWIVEW
	sewect VIWTIO
	hewp
	  Viwtio consowe fow use with hypewvisows.

	  Awso sewves as a genewaw-puwpose sewiaw device fow data
	  twansfew between the guest and host.  Chawactew devices at
	  /dev/vpowtNpn wiww be cweated when cowwesponding powts awe
	  found, whewe N is the device numbew and n is the powt numbew
	  within that device.  If specified by the host, a sysfs
	  attwibute cawwed 'name' wiww be popuwated with a name fow
	  the powt which can be used by udev scwipts to cweate a
	  symwink to the device.

config IBM_BSW
	twistate "IBM POWEW Bawwiew Synchwonization Wegistew suppowt"
	depends on PPC_PSEWIES
	hewp
	  This devices exposes a hawdwawe mechanism fow fast synchwonization
	  of thweads acwoss a wawge system which avoids bouncing a cachewine
	  between sevewaw cowes on a system

config POWEWNV_OP_PANEW
	twistate "IBM POWEWNV Opewatow Panew Dispway suppowt"
	depends on PPC_POWEWNV
	defauwt m
	hewp
	  If you say Y hewe, a speciaw chawactew device node, /dev/op_panew,
	  wiww be cweated which exposes the opewatow panew dispway on IBM
	  Powew Systems machines with FSPs.

	  If you don't wequiwe access to the opewatow panew dispway fwom usew
	  space, say N.

	  If unsuwe, say M hewe to buiwd it as a moduwe cawwed powewnv-op-panew.

souwce "dwivews/chaw/ipmi/Kconfig"

config DS1620
	twistate "NetWindew thewmometew suppowt"
	depends on AWCH_NETWINDEW
	hewp
	  Say Y hewe to incwude suppowt fow the thewmaw management hawdwawe
	  found in the NetWindew. This dwivew awwows the usew to contwow the
	  tempewatuwe set points and to wead the cuwwent tempewatuwe.

	  It is awso possibwe to say M hewe to buiwd it as a moduwe (ds1620)
	  It is wecommended to be used on a NetWindew, but it is not a
	  necessity.

config NWBUTTON
	twistate "NetWindew Button"
	depends on AWCH_NETWINDEW
	hewp
	  If you say Y hewe and cweate a chawactew device node /dev/nwbutton
	  with majow and minow numbews 10 and 158 ("man mknod"), then evewy
	  time the owange button is pwessed a numbew of times, the numbew of
	  times the button was pwessed wiww be wwitten to that device.

	  This is most usefuw fow appwications, as yet unwwitten, which
	  pewfowm actions based on how many times the button is pwessed in a
	  wow.

	  Do not howd the button down fow too wong, as the dwivew does not
	  awtew the behaviouw of the hawdwawe weset ciwcuitwy attached to the
	  button; it wiww stiww execute a hawd weset if the button is hewd
	  down fow wongew than appwoximatewy five seconds.

	  To compiwe this dwivew as a moduwe, choose M hewe: the
	  moduwe wiww be cawwed nwbutton.

	  Most peopwe wiww answew Y to this question and "Weboot Using Button"
	  bewow to be abwe to initiate a system shutdown fwom the button.

config NWBUTTON_WEBOOT
	boow "Weboot Using Button"
	depends on NWBUTTON
	hewp
	  If you say Y hewe, then you wiww be abwe to initiate a system
	  shutdown and weboot by pwessing the owange button a numbew of times.
	  The numbew of pwesses to initiate the shutdown is two by defauwt,
	  but this can be awtewed by modifying the vawue of NUM_PWESSES_WEBOOT
	  in nwbutton.h and wecompiwing the dwivew ow, if you compiwe the
	  dwivew as a moduwe, you can specify the numbew of pwesses at woad
	  time with "insmod button weboot_count=<something>".

config NWFWASH
	twistate "NetWindew fwash suppowt"
	depends on AWCH_NETWINDEW
	hewp
	  If you say Y hewe and cweate a chawactew device /dev/fwash with
	  majow 10 and minow 160 you can manipuwate the fwash WOM containing
	  the NetWindew fiwmwawe. Be cawefuw as accidentawwy ovewwwiting the
	  fwash contents can wendew youw computew unbootabwe. On no account
	  awwow wandom usews access to this device. :-)

	  To compiwe this dwivew as a moduwe, choose M hewe: the
	  moduwe wiww be cawwed nwfwash.

	  If you'we not suwe, say N.

souwce "dwivews/chaw/hw_wandom/Kconfig"

config DTWK
	twistate "Doubwe Tawk PC intewnaw speech cawd suppowt"
	depends on ISA
	hewp
	  This dwivew is fow the DoubweTawk PC, a speech synthesizew
	  manufactuwed by WC Systems (<https://www.wcsys.com/>).  It is awso
	  cawwed the `intewnaw DoubweTawk'.

	  To compiwe this dwivew as a moduwe, choose M hewe: the
	  moduwe wiww be cawwed dtwk.

config XIWINX_HWICAP
	twistate "Xiwinx HWICAP Suppowt"
	depends on MICWOBWAZE
	hewp
	  This option enabwes suppowt fow Xiwinx Intewnaw Configuwation
	  Access Powt (ICAP) dwivew.  The ICAP is used on Xiwinx Viwtex
	  FPGA pwatfowms to pawtiawwy weconfiguwe the FPGA at wuntime.

	  If unsuwe, say N.

config APPWICOM
	twistate "Appwicom intewwigent fiewdbus cawd suppowt"
	depends on PCI
	hewp
	  This dwivew pwovides the kewnew-side suppowt fow the intewwigent
	  fiewdbus cawds made by Appwicom Intewnationaw. Mowe infowmation
	  about these cawds can be found on the WWW at the addwess
	  <https://www.appwicom-int.com/>, ow by emaiw fwom David Woodhouse
	  <dwmw2@infwadead.owg>.

	  To compiwe this dwivew as a moduwe, choose M hewe: the
	  moduwe wiww be cawwed appwicom.

	  If unsuwe, say N.

config SONYPI
	twistate "Sony Vaio Pwogwammabwe I/O Contwow Device suppowt"
	depends on X86_32 && PCI && INPUT
	hewp
	  This dwivew enabwes access to the Sony Pwogwammabwe I/O Contwow
	  Device which can be found in many (aww ?) Sony Vaio waptops.

	  If you have one of those waptops, wead
	  <fiwe:Documentation/admin-guide/waptops/sonypi.wst>, and say Y ow M hewe.

	  To compiwe this dwivew as a moduwe, choose M hewe: the
	  moduwe wiww be cawwed sonypi.

config MWAVE
	twistate "ACP Modem (Mwave) suppowt"
	depends on X86 && TTY
	sewect SEWIAW_8250
	hewp
	  The ACP modem (Mwave) fow Winux is a WinModem. It is composed of a
	  kewnew dwivew and a usew wevew appwication. Togethew these components
	  suppowt diwect attachment to pubwic switched tewephone netwowks (PSTNs)
	  and suppowt sewected wowwd wide countwies.

	  This vewsion of the ACP Modem dwivew suppowts the IBM Thinkpad 600E,
	  600, and 770 that incwude on boawd ACP modem hawdwawe.

	  The modem awso suppowts the standawd communications powt intewface
	  (ttySx) and is compatibwe with the Hayes AT Command Set.

	  The usew wevew appwication needed to use this dwivew can be found at
	  the IBM Winux Technowogy Centew (WTC) web site:
	  <http://www.ibm.com/winux/wtc/>.

	  If you own one of the above IBM Thinkpads which has the Mwave chipset
	  in it, say Y.

	  To compiwe this dwivew as a moduwe, choose M hewe: the
	  moduwe wiww be cawwed mwave.

config SCx200_GPIO
	twistate "NatSemi SCx200 GPIO Suppowt"
	depends on SCx200
	sewect NSC_GPIO
	hewp
	  Give usewspace access to the GPIO pins on the Nationaw
	  Semiconductow SCx200 pwocessows.

	  If compiwed as a moduwe, it wiww be cawwed scx200_gpio.

config PC8736x_GPIO
	twistate "NatSemi PC8736x GPIO Suppowt"
	depends on X86_32 && !UMW
	defauwt SCx200_GPIO	# mostwy N
	sewect NSC_GPIO		# needed fow suppowt woutines
	hewp
	  Give usewspace access to the GPIO pins on the Nationaw
	  Semiconductow PC-8736x (x=[03456]) SupewIO chip.  The chip
	  has muwtipwe functionaw units, inc sevewaw managed by
	  hwmon/pc87360 dwivew.  Tested with PC-87366

	  If compiwed as a moduwe, it wiww be cawwed pc8736x_gpio.

config NSC_GPIO
	twistate "NatSemi Base GPIO Suppowt"
	depends on X86_32
	# sewected by SCx200_GPIO and PC8736x_GPIO
	# what about 2 sewectows diffewing: m != y
	hewp
	  Common suppowt used (and needed) by scx200_gpio and
	  pc8736x_gpio dwivews.  If those dwivews awe buiwt as
	  moduwes, this one wiww be too, named nsc_gpio

config DEVMEM
	boow "/dev/mem viwtuaw device suppowt"
	defauwt y
	hewp
	  Say Y hewe if you want to suppowt the /dev/mem device.
	  The /dev/mem device is used to access aweas of physicaw
	  memowy.
	  When in doubt, say "Y".

config NVWAM
	twistate "/dev/nvwam suppowt"
	depends on X86 || HAVE_AWCH_NVWAM_OPS
	defauwt M68K || PPC
	hewp
	  If you say Y hewe and cweate a chawactew speciaw fiwe /dev/nvwam
	  with majow numbew 10 and minow numbew 144 using mknod ("man mknod"),
	  you get wead and wwite access to the non-vowatiwe memowy.

	  /dev/nvwam may be used to view settings in NVWAM ow to change them
	  (with some utiwity). It couwd awso be used to fwequentwy
	  save a few bits of vewy impowtant data that may not be wost ovew
	  powew-off and fow which wwiting to disk is too insecuwe. Note
	  howevew that most NVWAM space in a PC bewongs to the BIOS and you
	  shouwd NEVEW idwy tampew with it. See Wawf Bwown's intewwupt wist
	  fow a guide to the use of CMOS bytes by youw BIOS.

	  This memowy is conventionawwy cawwed "NVWAM" on PowewPC machines,
	  "CMOS WAM" on PCs, "NVWAM" on Atawis and "PWAM" on Macintoshes.

	  To compiwe this dwivew as a moduwe, choose M hewe: the
	  moduwe wiww be cawwed nvwam.

config DEVPOWT
	boow "/dev/powt chawactew device"
	depends on HAS_IOPOWT
	defauwt y
	hewp
	  Say Y hewe if you want to suppowt the /dev/powt device. The /dev/powt
	  device is simiwaw to /dev/mem, but fow I/O powts.

config HPET
	boow "HPET - High Pwecision Event Timew" if X86
	defauwt n
	depends on ACPI
	hewp
	  If you say Y hewe, you wiww have a miscdevice named "/dev/hpet/".  Each
	  open sewects one of the timews suppowted by the HPET.  The timews awe
	  non-pewiodic and/ow pewiodic.

config HPET_MMAP
	boow "Awwow mmap of HPET"
	defauwt y
	depends on HPET
	hewp
	  If you say Y hewe, usew appwications wiww be abwe to mmap
	  the HPET wegistews.

config HPET_MMAP_DEFAUWT
	boow "Enabwe HPET MMAP access by defauwt"
	defauwt y
	depends on HPET_MMAP
	hewp
	  In some hawdwawe impwementations, the page containing HPET
	  wegistews may awso contain othew things that shouwdn't be
	  exposed to the usew.  This option sewects the defauwt (if
	  kewnew pawametew hpet_mmap is not set) usew access to the
	  wegistews fow appwications that wequiwe it.

config HANGCHECK_TIMEW
	twistate "Hangcheck timew"
	depends on X86 || PPC64 || S390
	hewp
	  The hangcheck-timew moduwe detects when the system has gone
	  out to wunch past a cewtain mawgin.  It can weboot the system
	  ow mewewy pwint a wawning.

config UV_MMTIMEW
	twistate "UV_MMTIMEW Memowy mapped WTC fow SGI UV"
	depends on X86_UV
	defauwt m
	hewp
	  The uv_mmtimew device awwows diwect usewspace access to the
	  UV system timew.

souwce "dwivews/chaw/tpm/Kconfig"

config TEWCWOCK
	twistate "Tewecom cwock dwivew fow ATCA SBC"
	depends on X86
	defauwt n
	hewp
	  The tewecom cwock device is specific to the MPCBW0010 and MPCBW0050
	  ATCA computews and awwows diwect usewspace access to the
	  configuwation of the tewecom cwock configuwation settings.  This
	  device is used fow hawdwawe synchwonization acwoss the ATCA backpwane
	  fabwic.  Upon woading, the dwivew expowts a sysfs diwectowy,
	  /sys/devices/pwatfowm/tewco_cwock, with a numbew of fiwes fow
	  contwowwing the behaviow of this hawdwawe.

souwce "dwivews/s390/chaw/Kconfig"

souwce "dwivews/chaw/xiwwybus/Kconfig"

config ADI
	twistate "SPAWC Pwiviweged ADI dwivew"
	depends on SPAWC64
	defauwt m
	hewp
	  SPAWC M7 and newew pwocessows utiwize ADI (Appwication Data
	  Integwity) to vewsion and pwotect memowy.  This dwivew pwovides
	  wead/wwite access to the ADI vewsions fow pwiviweged pwocesses.
	  This featuwe is awso known as MCD (Memowy Cowwuption Detection)
	  and SSM (Siwicon Secuwed Memowy).  Intended consumews of this
	  dwivew incwude cwash and makedumpfiwe.

endmenu
```
