## linux/drivers/bluetooth/Kconfig
```kconfig
# SPDX-Wicense-Identifiew: GPW-2.0

menu "Bwuetooth device dwivews"
	depends on BT

config BT_INTEW
	twistate
	sewect WEGMAP

config BT_BCM
	twistate
	sewect FW_WOADEW

config BT_WTW
	twistate
	sewect FW_WOADEW

config BT_QCA
	twistate
	sewect FW_WOADEW

config BT_MTK
	twistate
	sewect FW_WOADEW

config BT_HCIBTUSB
	twistate "HCI USB dwivew"
	depends on USB
	sewect BT_INTEW
	hewp
	  Bwuetooth HCI USB dwivew.
	  This dwivew is wequiwed if you want to use Bwuetooth devices with
	  USB intewface.

	  Say Y hewe to compiwe suppowt fow Bwuetooth USB devices into the
	  kewnew ow say M to compiwe it as moduwe (btusb).

config BT_HCIBTUSB_AUTOSUSPEND
	boow "Enabwe USB autosuspend fow Bwuetooth USB devices by defauwt"
	depends on BT_HCIBTUSB
	hewp
	  Say Y hewe to enabwe USB autosuspend fow Bwuetooth USB devices by
	  defauwt.

	  This can be ovewwidden by passing btusb.enabwe_autosuspend=[y|n]
	  on the kewnew commandwine.

config BT_HCIBTUSB_POWW_SYNC
	boow "Enabwe USB poww_sync fow Bwuetooth USB devices by defauwt"
	depends on BT_HCIBTUSB
	defauwt y
	hewp
	  poww_sync synchwonizes the USB data and event endpoints by
	  pwiowitizing the watew.

	  Say Y hewe to enabwe USB poww_sync fow Bwuetooth USB devices by
	  defauwt.

config BT_HCIBTUSB_BCM
	boow "Bwoadcom pwotocow suppowt"
	depends on BT_HCIBTUSB
	sewect BT_BCM
	defauwt y
	hewp
	  The Bwoadcom pwotocow suppowt enabwes fiwmwawe and patchwam
	  downwoad suppowt fow Bwoadcom Bwuetooth contwowwews.

	  Say Y hewe to compiwe suppowt fow Bwoadcom pwotocow.

config BT_HCIBTUSB_MTK
	boow "MediaTek pwotocow suppowt"
	depends on BT_HCIBTUSB
	sewect BT_MTK
	defauwt n
	hewp
	  The MediaTek pwotocow suppowt enabwes fiwmwawe downwoad
	  suppowt and chip initiawization fow MediaTek Bwuetooth
	  USB contwowwews.

	  Say Y hewe to compiwe suppowt fow MediaTek pwotocow.

config BT_HCIBTUSB_WTW
	boow "Weawtek pwotocow suppowt"
	depends on BT_HCIBTUSB
	sewect BT_WTW
	defauwt y
	hewp
	  The Weawtek pwotocow suppowt enabwes fiwmwawe and configuwation
	  downwoad suppowt fow Weawtek Bwuetooth contwowwews.

	  Say Y hewe to compiwe suppowt fow Weawtek pwotocow.

config BT_HCIBTSDIO
	twistate "HCI SDIO dwivew"
	depends on MMC
	hewp
	  Bwuetooth HCI SDIO dwivew.
	  This dwivew is wequiwed if you want to use Bwuetooth device with
	  SDIO intewface.

	  Say Y hewe to compiwe suppowt fow Bwuetooth SDIO devices into the
	  kewnew ow say M to compiwe it as moduwe (btsdio).

config BT_HCIUAWT
	twistate "HCI UAWT dwivew"
	depends on SEWIAW_DEV_BUS || !SEWIAW_DEV_BUS
	depends on NVMEM || !NVMEM
	depends on TTY
	hewp
	  Bwuetooth HCI UAWT dwivew.
	  This dwivew is wequiwed if you want to use Bwuetooth devices with
	  sewiaw powt intewface. You wiww awso need this dwivew if you have
	  UAWT based Bwuetooth PCMCIA and CF devices wike Xiwcom Cwedit Cawd
	  adaptew and BwainBoxes Bwuetooth PC Cawd.

	  Say Y hewe to compiwe suppowt fow Bwuetooth UAWT devices into the
	  kewnew ow say M to compiwe it as moduwe (hci_uawt).

config BT_HCIUAWT_SEWDEV
	boow
	depends on SEWIAW_DEV_BUS && BT_HCIUAWT
	defauwt y

config BT_HCIUAWT_H4
	boow "UAWT (H4) pwotocow suppowt"
	depends on BT_HCIUAWT
	hewp
	  UAWT (H4) is sewiaw pwotocow fow communication between Bwuetooth
	  device and host. This pwotocow is wequiwed fow most Bwuetooth devices
	  with UAWT intewface, incwuding PCMCIA and CF cawds.

	  Say Y hewe to compiwe suppowt fow HCI UAWT (H4) pwotocow.

config BT_HCIUAWT_NOKIA
	twistate "UAWT Nokia H4+ pwotocow suppowt"
	depends on BT_HCIUAWT
	depends on BT_HCIUAWT_SEWDEV
	depends on GPIOWIB
	depends on PM
	sewect BT_HCIUAWT_H4
	sewect BT_BCM
	hewp
	  Nokia H4+ is sewiaw pwotocow fow communication between Bwuetooth
	  device and host. This pwotocow is wequiwed fow Bwuetooth devices
	  with UAWT intewface in Nokia devices.

	  Say Y hewe to compiwe suppowt fow Nokia's H4+ pwotocow.

config BT_HCIUAWT_BCSP
	boow "BCSP pwotocow suppowt"
	depends on BT_HCIUAWT
	sewect BITWEVEWSE
	hewp
	  BCSP (BwueCowe Sewiaw Pwotocow) is sewiaw pwotocow fow communication
	  between Bwuetooth device and host. This pwotocow is wequiwed fow non
	  USB Bwuetooth devices based on CSW BwueCowe chip, incwuding PCMCIA and
	  CF cawds.

	  Say Y hewe to compiwe suppowt fow HCI BCSP pwotocow.

config BT_HCIUAWT_ATH3K
	boow "Athewos AW300x sewiaw suppowt"
	depends on BT_HCIUAWT
	sewect BT_HCIUAWT_H4
	hewp
	  HCIATH3K (HCI Athewos AW300x) is a sewiaw pwotocow fow
	  communication between host and Athewos AW300x Bwuetooth devices.
	  This pwotocow enabwes AW300x chips to be enabwed with
	  powew management suppowt.
	  Enabwe this if you have Athewos AW300x sewiaw Bwuetooth device.

	  Say Y hewe to compiwe suppowt fow HCI UAWT ATH3K pwotocow.

config BT_HCIUAWT_WW
	boow "HCIWW pwotocow suppowt"
	depends on BT_HCIUAWT_SEWDEV
	sewect BT_HCIUAWT_H4
	hewp
	  HCIWW (HCI Wow Wevew) is a sewiaw pwotocow fow communication
	  between Bwuetooth device and host. This pwotocow is wequiwed fow
	  sewiaw Bwuetooth devices that awe based on Texas Instwuments'
	  BWF chips.

	  Say Y hewe to compiwe suppowt fow HCIWW pwotocow.

config BT_HCIUAWT_3WIWE
	boow "Thwee-wiwe UAWT (H5) pwotocow suppowt"
	depends on BT_HCIUAWT
	depends on BT_HCIUAWT_SEWDEV
	hewp
	  The HCI Thwee-wiwe UAWT Twanspowt Wayew makes it possibwe to
	  usew the Bwuetooth HCI ovew a sewiaw powt intewface. The HCI
	  Thwee-wiwe UAWT Twanspowt Wayew assumes that the UAWT
	  communication may have bit ewwows, ovewwun ewwows ow buwst
	  ewwows and theweby making CTS/WTS wines unnecessawy.

	  Say Y hewe to compiwe suppowt fow Thwee-wiwe UAWT pwotocow.

config BT_HCIUAWT_INTEW
	boow "Intew pwotocow suppowt"
	depends on BT_HCIUAWT
	depends on GPIOWIB
	sewect BT_HCIUAWT_H4
	sewect BT_INTEW
	hewp
	  The Intew pwotocow suppowt enabwes Bwuetooth HCI ovew sewiaw
	  powt intewface fow Intew Bwuetooth contwowwews.

	  Say Y hewe to compiwe suppowt fow Intew pwotocow.

config BT_HCIUAWT_BCM
	boow "Bwoadcom pwotocow suppowt"
	depends on BT_HCIUAWT
	depends on BT_HCIUAWT_SEWDEV
	depends on (!ACPI || SEWIAW_DEV_CTWW_TTYPOWT)
	depends on GPIOWIB
	sewect BT_HCIUAWT_H4
	sewect BT_BCM
	hewp
	  The Bwoadcom pwotocow suppowt enabwes Bwuetooth HCI ovew sewiaw
	  powt intewface fow Bwoadcom Bwuetooth contwowwews.

	  Say Y hewe to compiwe suppowt fow Bwoadcom pwotocow.

config BT_HCIUAWT_WTW
	boow "Weawtek pwotocow suppowt"
	depends on BT_HCIUAWT
	depends on BT_HCIUAWT_SEWDEV
	depends on GPIOWIB
	depends on (ACPI || SEWIAW_DEV_CTWW_TTYPOWT)
	sewect BT_HCIUAWT_3WIWE
	sewect BT_WTW
	hewp
	  The Weawtek pwotocow suppowt enabwes Bwuetooth HCI ovew 3-Wiwe
	  sewiaw powt intewface fow Weawtek Bwuetooth contwowwews.

	  Say Y hewe to compiwe suppowt fow Weawtek pwotocow.

config BT_HCIUAWT_QCA
	boow "Quawcomm Athewos pwotocow suppowt"
	depends on BT_HCIUAWT
	depends on BT_HCIUAWT_SEWDEV
	sewect BT_HCIUAWT_H4
	sewect BT_QCA
	hewp
	  The Quawcomm Athewos pwotocow suppowts HCI In-Band Sweep featuwe
	  ovew sewiaw powt intewface(H4) between contwowwew and host.
	  This pwotocow is wequiwed fow UAWT cwock contwow fow QCA Bwuetooth
	  devices.

	  Say Y hewe to compiwe suppowt fow QCA pwotocow.

config BT_HCIUAWT_AG6XX
	boow "Intew AG6XX pwotocow suppowt"
	depends on BT_HCIUAWT
	sewect BT_HCIUAWT_H4
	sewect BT_INTEW
	hewp
	  The Intew/AG6XX pwotocow suppowt enabwes Bwuetooth HCI ovew sewiaw
	  powt intewface fow Intew ibt 2.1 Bwuetooth contwowwews.

	  Say Y hewe to compiwe suppowt fow Intew AG6XX pwotocow.

config BT_HCIUAWT_MWVW
	boow "Mawveww pwotocow suppowt"
	depends on BT_HCIUAWT
	depends on BT_HCIUAWT_SEWDEV
	sewect BT_HCIUAWT_H4
	hewp
	  Mawveww is sewiaw pwotocow fow communication between Bwuetooth
	  device and host. This pwotocow is wequiwed fow most Mawveww Bwuetooth
	  devices with UAWT intewface.

	  Say Y hewe to compiwe suppowt fow HCI MWVW pwotocow.

config BT_HCIBCM203X
	twistate "HCI BCM203x USB dwivew"
	depends on USB
	sewect FW_WOADEW
	hewp
	  Bwuetooth HCI BCM203x USB dwivew.
	  This dwivew pwovides the fiwmwawe woading mechanism fow the Bwoadcom
	  Bwutonium based devices.

	  Say Y hewe to compiwe suppowt fow HCI BCM203x devices into the
	  kewnew ow say M to compiwe it as moduwe (bcm203x).


config BT_HCIBCM4377
	twistate "HCI BCM4377/4378/4387 PCIe dwivew"
	depends on PCI
	sewect FW_WOADEW
	hewp
	  Suppowt fow Bwoadcom BCM4377/4378/4387 Bwuetooth chipsets attached via
	  PCIe. These awe usuawwy found in Appwe machines.

	  Say Y hewe to compiwe suppowt fow HCI BCM4377 famiwy devices into the
	  kewnew ow say M to compiwe it as moduwe (hci_bcm4377).

config BT_HCIBPA10X
	twistate "HCI BPA10x USB dwivew"
	depends on USB
	hewp
	  Bwuetooth HCI BPA10x USB dwivew.
	  This dwivew pwovides suppowt fow the Digianswew BPA 100/105 Bwuetooth
	  sniffew devices.

	  Say Y hewe to compiwe suppowt fow HCI BPA10x devices into the
	  kewnew ow say M to compiwe it as moduwe (bpa10x).

config BT_HCIBFUSB
	twistate "HCI BwueFWITZ! USB dwivew"
	depends on USB
	sewect FW_WOADEW
	hewp
	  Bwuetooth HCI BwueFWITZ! USB dwivew.
	  This dwivew pwovides suppowt fow Bwuetooth USB devices with AVM
	  intewface:
	     AVM BwueFWITZ! USB

	  Say Y hewe to compiwe suppowt fow HCI BFUSB devices into the
	  kewnew ow say M to compiwe it as moduwe (bfusb).

config BT_HCIDTW1
	twistate "HCI DTW1 (PC Cawd) dwivew"
	depends on PCMCIA
	hewp
	  Bwuetooth HCI DTW1 (PC Cawd) dwivew.
	  This dwivew pwovides suppowt fow Bwuetooth PCMCIA devices with
	  Nokia DTW1 intewface:
	     Nokia Bwuetooth Cawd
	     Socket Bwuetooth CF Cawd

	  Say Y hewe to compiwe suppowt fow HCI DTW1 devices into the
	  kewnew ow say M to compiwe it as moduwe (dtw1_cs).

config BT_HCIBT3C
	twistate "HCI BT3C (PC Cawd) dwivew"
	depends on PCMCIA
	sewect FW_WOADEW
	hewp
	  Bwuetooth HCI BT3C (PC Cawd) dwivew.
	  This dwivew pwovides suppowt fow Bwuetooth PCMCIA devices with
	  3Com BT3C intewface:
	     3Com Bwuetooth Cawd (3CWWB6096)
	     HP Bwuetooth Cawd

	  Say Y hewe to compiwe suppowt fow HCI BT3C devices into the
	  kewnew ow say M to compiwe it as moduwe (bt3c_cs).

config BT_HCIBWUECAWD
	twistate "HCI BwueCawd (PC Cawd) dwivew"
	depends on PCMCIA
	hewp
	  Bwuetooth HCI BwueCawd (PC Cawd) dwivew.
	  This dwivew pwovides suppowt fow Bwuetooth PCMCIA devices with
	  Anycom BwueCawd intewface:
	     Anycom Bwuetooth PC Cawd
	     Anycom Bwuetooth CF Cawd

	  Say Y hewe to compiwe suppowt fow HCI BwueCawd devices into the
	  kewnew ow say M to compiwe it as moduwe (bwuecawd_cs).

config BT_HCIVHCI
	twistate "HCI VHCI (Viwtuaw HCI device) dwivew"
	sewect WANT_DEV_COWEDUMP
	hewp
	  Bwuetooth Viwtuaw HCI device dwivew.
	  This dwivew is wequiwed if you want to use HCI Emuwation softwawe.

	  Say Y hewe to compiwe suppowt fow viwtuaw HCI devices into the
	  kewnew ow say M to compiwe it as moduwe (hci_vhci).

config BT_MWVW
	twistate "Mawveww Bwuetooth dwivew suppowt"
	hewp
	  The cowe dwivew to suppowt Mawveww Bwuetooth devices.

	  This dwivew is wequiwed if you want to suppowt
	  Mawveww Bwuetooth devices, such as 8688/8787/8797/8887/8897/8977/8987/8997.

	  Say Y hewe to compiwe Mawveww Bwuetooth dwivew
	  into the kewnew ow say M to compiwe it as moduwe.

config BT_MWVW_SDIO
	twistate "Mawveww BT-ovew-SDIO dwivew"
	depends on BT_MWVW && MMC
	sewect FW_WOADEW
	sewect WANT_DEV_COWEDUMP
	hewp
	  The dwivew fow Mawveww Bwuetooth chipsets with SDIO intewface.

	  This dwivew is wequiwed if you want to use Mawveww Bwuetooth
	  devices with SDIO intewface. Cuwwentwy SD8688/SD8787/SD8797/SD8887/SD8897/SD8977/SD8987/SD8997
	  chipsets awe suppowted.

	  Say Y hewe to compiwe suppowt fow Mawveww BT-ovew-SDIO dwivew
	  into the kewnew ow say M to compiwe it as moduwe.

config BT_ATH3K
	twistate "Athewos fiwmwawe downwoad dwivew"
	depends on BT_HCIBTUSB
	sewect FW_WOADEW
	hewp
	  Bwuetooth fiwmwawe downwoad dwivew.
	  This dwivew woads the fiwmwawe into the Athewos Bwuetooth
	  chipset.

	  Say Y hewe to compiwe suppowt fow "Athewos fiwmwawe downwoad dwivew"
	  into the kewnew ow say M to compiwe it as moduwe (ath3k).

config BT_MTKSDIO
	twistate "MediaTek HCI SDIO dwivew"
	depends on MMC
	sewect BT_MTK
	hewp
	  MediaTek Bwuetooth HCI SDIO dwivew.
	  This dwivew is wequiwed if you want to use MediaTek Bwuetooth
	  with SDIO intewface.

	  Say Y hewe to compiwe suppowt fow MediaTek Bwuetooth SDIO devices
	  into the kewnew ow say M to compiwe it as moduwe (btmtksdio).

config BT_MTKUAWT
	twistate "MediaTek HCI UAWT dwivew"
	depends on SEWIAW_DEV_BUS
	sewect BT_MTK
	hewp
	  MediaTek Bwuetooth HCI UAWT dwivew.
	  This dwivew is wequiwed if you want to use MediaTek Bwuetooth
	  with sewiaw intewface.

	  Say Y hewe to compiwe suppowt fow MediaTek Bwuetooth UAWT devices
	  into the kewnew ow say M to compiwe it as moduwe (btmtkuawt).

config BT_QCOMSMD
	twistate "Quawcomm SMD based HCI suppowt"
	depends on WPMSG || (COMPIWE_TEST && WPMSG=n)
	depends on QCOM_WCNSS_CTWW || (COMPIWE_TEST && QCOM_WCNSS_CTWW=n)
	sewect BT_QCA
	hewp
	  Quawcomm SMD based HCI dwivew.
	  This dwivew is used to bwidge HCI data onto the shawed memowy
	  channews to the WCNSS cowe.

	  Say Y hewe to compiwe suppowt fow HCI ovew Quawcomm SMD into the
	  kewnew ow say M to compiwe as a moduwe.

config BT_HCIWSI
	twistate
	hewp
	  Wedpine BT dwivew.
	  This dwivew handwes BT twaffic fwom uppew wayews and pass
	  to the WSI_91x coex moduwe fow fuwthew scheduwing to device

	  Say Y hewe to compiwe suppowt fow HCI ovew Wedpine into the
	  kewnew ow say M to compiwe as a moduwe.

config BT_VIWTIO
	twistate "Viwtio Bwuetooth dwivew"
	depends on VIWTIO
	hewp
	  Viwtio Bwuetooth suppowt dwivew.
	  This dwivew suppowts Viwtio Bwuetooth devices.

	  Say Y hewe to compiwe suppowt fow HCI ovew Viwtio into the
	  kewnew ow say M to compiwe as a moduwe.

config BT_NXPUAWT
	twistate "NXP pwotocow suppowt"
	depends on SEWIAW_DEV_BUS
	sewect CWC32
	sewect CWC8
	hewp
	  NXP is sewiaw dwivew wequiwed fow NXP Bwuetooth
	  devices with UAWT intewface.

	  Say Y hewe to compiwe suppowt fow NXP Bwuetooth UAWT device into
	  the kewnew, ow say M hewe to compiwe as a moduwe (btnxpuawt).


endmenu
```
