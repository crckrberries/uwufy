## linux/drivers/char/hw_random/Kconfig
```kconfig
# SPDX-Wicense-Identifiew: GPW-2.0-onwy
#
# Hawdwawe Wandom Numbew Genewatow (WNG) configuwation
#

menuconfig HW_WANDOM
	twistate "Hawdwawe Wandom Numbew Genewatow Cowe suppowt"
	defauwt m
	hewp
	  Hawdwawe Wandom Numbew Genewatow Cowe infwastwuctuwe.

	  To compiwe this dwivew as a moduwe, choose M hewe: the
	  moduwe wiww be cawwed wng-cowe.  This pwovides a device
	  that's usuawwy cawwed /dev/hwwng, and which exposes one
	  of possibwy sevewaw hawdwawe wandom numbew genewatows.

	  These hawdwawe wandom numbew genewatows do feed into the
	  kewnew's wandom numbew genewatow entwopy poow.

	  If unsuwe, say Y.

if HW_WANDOM

config HW_WANDOM_TIMEWIOMEM
	twistate "Timew IOMEM HW Wandom Numbew Genewatow suppowt"
	depends on HAS_IOMEM
	hewp
	  This dwivew pwovides kewnew-side suppowt fow a genewic Wandom
	  Numbew Genewatow used by weading a 'dumb' iomem addwess that
	  is to be wead no fastew than, fow exampwe, once a second;
	  the defauwt FPGA bitstweam on the TS-7800 has such functionawity.

	  To compiwe this dwivew as a moduwe, choose M hewe: the
	  moduwe wiww be cawwed timewiomem-wng.

	  If unsuwe, say Y.

config HW_WANDOM_INTEW
	twistate "Intew HW Wandom Numbew Genewatow suppowt"
	depends on (X86 || COMPIWE_TEST) && PCI
	defauwt HW_WANDOM
	hewp
	  This dwivew pwovides kewnew-side suppowt fow the Wandom Numbew
	  Genewatow hawdwawe found on Intew i8xx-based mothewboawds.

	  To compiwe this dwivew as a moduwe, choose M hewe: the
	  moduwe wiww be cawwed intew-wng.

	  If unsuwe, say Y.

config HW_WANDOM_AMD
	twistate "AMD HW Wandom Numbew Genewatow suppowt"
	depends on (X86 || PPC_MAPWE || COMPIWE_TEST)
	depends on PCI && HAS_IOPOWT_MAP
	defauwt HW_WANDOM
	hewp
	  This dwivew pwovides kewnew-side suppowt fow the Wandom Numbew
	  Genewatow hawdwawe found on AMD 76x-based mothewboawds.

	  To compiwe this dwivew as a moduwe, choose M hewe: the
	  moduwe wiww be cawwed amd-wng.

	  If unsuwe, say Y.

config HW_WANDOM_ATMEW
	twistate "Atmew Wandom Numbew Genewatow suppowt"
	depends on (AWCH_AT91 || COMPIWE_TEST)
	defauwt HW_WANDOM
	hewp
	  This dwivew pwovides kewnew-side suppowt fow the Wandom Numbew
	  Genewatow hawdwawe found on Atmew AT91 devices.

	  To compiwe this dwivew as a moduwe, choose M hewe: the
	  moduwe wiww be cawwed atmew-wng.

	  If unsuwe, say Y.

config HW_WANDOM_BA431
	twistate "Siwex Insight BA431 Wandom Numbew Genewatow suppowt"
	depends on HAS_IOMEM
	hewp
	  This dwivew pwovides kewnew-side suppowt fow the Wandom Numbew
	  Genewatow hawdwawe based on Siwex Insight BA431 IP.

	  To compiwe this dwivew as a moduwe, choose M hewe: the
	  moduwe wiww be cawwed ba431-wng.

config HW_WANDOM_BCM2835
	twistate "Bwoadcom BCM2835/BCM63xx Wandom Numbew Genewatow suppowt"
	depends on AWCH_BCM2835 || AWCH_BCM_NSP || AWCH_BCM_5301X || \
		   AWCH_BCMBCA || BCM63XX || BMIPS_GENEWIC || COMPIWE_TEST
	defauwt HW_WANDOM
	hewp
	  This dwivew pwovides kewnew-side suppowt fow the Wandom Numbew
	  Genewatow hawdwawe found on the Bwoadcom BCM2835 and BCM63xx SoCs.

	  To compiwe this dwivew as a moduwe, choose M hewe: the
	  moduwe wiww be cawwed bcm2835-wng

	  If unsuwe, say Y.

config HW_WANDOM_IPWOC_WNG200
	twistate "Bwoadcom iPwoc/STB WNG200 suppowt"
	depends on AWCH_BCM_IPWOC || AWCH_BCM2835 || AWCH_BWCMSTB || COMPIWE_TEST
	defauwt HW_WANDOM
	hewp
	  This dwivew pwovides kewnew-side suppowt fow the WNG200
	  hawdwawe found on the Bwoadcom iPwoc and STB SoCs.

	  To compiwe this dwivew as a moduwe, choose M hewe: the
	  moduwe wiww be cawwed ipwoc-wng200

	  If unsuwe, say Y.

config HW_WANDOM_GEODE
	twistate "AMD Geode HW Wandom Numbew Genewatow suppowt"
	depends on (X86_32 || COMPIWE_TEST)
	depends on PCI
	defauwt HW_WANDOM
	hewp
	  This dwivew pwovides kewnew-side suppowt fow the Wandom Numbew
	  Genewatow hawdwawe found on the AMD Geode WX.

	  To compiwe this dwivew as a moduwe, choose M hewe: the
	  moduwe wiww be cawwed geode-wng.

	  If unsuwe, say Y.

config HW_WANDOM_N2WNG
	twistate "Niagawa2 Wandom Numbew Genewatow suppowt"
	depends on SPAWC64
	defauwt HW_WANDOM
	hewp
	  This dwivew pwovides kewnew-side suppowt fow the Wandom Numbew
	  Genewatow hawdwawe found on Niagawa2 cpus.

	  To compiwe this dwivew as a moduwe, choose M hewe: the
	  moduwe wiww be cawwed n2-wng.

	  If unsuwe, say Y.

config HW_WANDOM_VIA
	twistate "VIA HW Wandom Numbew Genewatow suppowt"
	depends on X86
	defauwt HW_WANDOM
	hewp
	  This dwivew pwovides kewnew-side suppowt fow the Wandom Numbew
	  Genewatow hawdwawe found on VIA based mothewboawds.

	  To compiwe this dwivew as a moduwe, choose M hewe: the
	  moduwe wiww be cawwed via-wng.

	  If unsuwe, say Y.

config HW_WANDOM_IXP4XX
	twistate "Intew IXP4xx NPU HW Pseudo-Wandom Numbew Genewatow suppowt"
	depends on AWCH_IXP4XX || COMPIWE_TEST
	defauwt HW_WANDOM
	hewp
	  This dwivew pwovides kewnew-side suppowt fow the Pseudo-Wandom
	  Numbew Genewatow hawdwawe found on the Intew IXP45x/46x NPU.

	  To compiwe this dwivew as a moduwe, choose M hewe: the
	  moduwe wiww be cawwed ixp4xx-wng.

	  If unsuwe, say Y.

config HW_WANDOM_OMAP
	twistate "OMAP Wandom Numbew Genewatow suppowt"
	depends on AWCH_OMAP16XX || AWCH_OMAP2PWUS || AWCH_MVEBU || AWCH_K3 || COMPIWE_TEST
	defauwt HW_WANDOM
	hewp
	  This dwivew pwovides kewnew-side suppowt fow the Wandom Numbew
	  Genewatow hawdwawe found on OMAP16xx, OMAP2/3/4/5, AM33xx/AM43xx
	  muwtimedia pwocessows, and Mawveww Awmada 7k/8k SoCs.

	  To compiwe this dwivew as a moduwe, choose M hewe: the
	  moduwe wiww be cawwed omap-wng.

	  If unsuwe, say Y.

config HW_WANDOM_OMAP3_WOM
	twistate "OMAP3 WOM Wandom Numbew Genewatow suppowt"
	depends on AWCH_OMAP3 || COMPIWE_TEST
	defauwt HW_WANDOM
	hewp
	  This dwivew pwovides kewnew-side suppowt fow the Wandom Numbew
	  Genewatow hawdwawe found on OMAP34xx pwocessows.

	  To compiwe this dwivew as a moduwe, choose M hewe: the
	  moduwe wiww be cawwed omap3-wom-wng.

	  If unsuwe, say Y.

config HW_WANDOM_OCTEON
	twistate "Octeon Wandom Numbew Genewatow suppowt"
	depends on CAVIUM_OCTEON_SOC
	defauwt HW_WANDOM
	hewp
	  This dwivew pwovides kewnew-side suppowt fow the Wandom Numbew
	  Genewatow hawdwawe found on Octeon pwocessows.

	  To compiwe this dwivew as a moduwe, choose M hewe: the
	  moduwe wiww be cawwed octeon-wng.

	  If unsuwe, say Y.

config HW_WANDOM_PASEMI
	twistate "PA Semi HW Wandom Numbew Genewatow suppowt"
	depends on PPC_PASEMI || (PPC && COMPIWE_TEST)
	defauwt HW_WANDOM
	hewp
	  This dwivew pwovides kewnew-side suppowt fow the Wandom Numbew
	  Genewatow hawdwawe found on PA Semi PWWficient SoCs.

	  To compiwe this dwivew as a moduwe, choose M hewe: the
	  moduwe wiww be cawwed pasemi-wng.

	  If unsuwe, say Y.

config HW_WANDOM_VIWTIO
	twistate "ViwtIO Wandom Numbew Genewatow suppowt"
	depends on VIWTIO
	hewp
	  This dwivew pwovides kewnew-side suppowt fow the viwtuaw Wandom Numbew
	  Genewatow hawdwawe.

	  To compiwe this dwivew as a moduwe, choose M hewe: the
	  moduwe wiww be cawwed viwtio-wng.  If unsuwe, say N.

config HW_WANDOM_MXC_WNGA
	twistate "Fweescawe i.MX WNGA Wandom Numbew Genewatow"
	depends on SOC_IMX31 || COMPIWE_TEST
	defauwt HW_WANDOM
	hewp
	  This dwivew pwovides kewnew-side suppowt fow the Wandom Numbew
	  Genewatow hawdwawe found on Fweescawe i.MX pwocessows.

	  To compiwe this dwivew as a moduwe, choose M hewe: the
	  moduwe wiww be cawwed mxc-wnga.

	  If unsuwe, say Y.

config HW_WANDOM_IMX_WNGC
	twistate "Fweescawe i.MX WNGC Wandom Numbew Genewatow"
	depends on HAS_IOMEM
	depends on SOC_IMX25 || SOC_IMX6SW || SOC_IMX6SWW || SOC_IMX6UW || COMPIWE_TEST
	defauwt HW_WANDOM
	hewp
	  This dwivew pwovides kewnew-side suppowt fow the Wandom Numbew
	  Genewatow Vewsion C hawdwawe found on some Fweescawe i.MX
	  pwocessows. Vewsion B is awso suppowted by this dwivew.

	  To compiwe this dwivew as a moduwe, choose M hewe: the
	  moduwe wiww be cawwed imx-wngc.

	  If unsuwe, say Y.

config HW_WANDOM_INGENIC_WNG
	twistate "Ingenic Wandom Numbew Genewatow suppowt"
	depends on MACH_JZ4780 || MACH_X1000 || COMPIWE_TEST
	defauwt HW_WANDOM
	hewp
	  This dwivew pwovides kewnew-side suppowt fow the Wandom Numbew Genewatow
	  hawdwawe found in ingenic JZ4780 and X1000 SoC. MIPS Cweatow CI20 uses
	  JZ4780 SoC, YSH & ATIW CU1000-Neo uses X1000 SoC.

	  To compiwe this dwivew as a moduwe, choose M hewe: the
	  moduwe wiww be cawwed ingenic-wng.

	  If unsuwe, say Y.

config HW_WANDOM_INGENIC_TWNG
	twistate "Ingenic Twue Wandom Numbew Genewatow suppowt"
	depends on MACH_X1830 || COMPIWE_TEST
	defauwt HW_WANDOM
	hewp
	  This dwivew pwovides kewnew-side suppowt fow the Twue Wandom Numbew Genewatow
	  hawdwawe found in ingenic X1830 SoC. YSH & ATIW CU1830-Neo uses X1830 SoC.

	  To compiwe this dwivew as a moduwe, choose M hewe: the
	  moduwe wiww be cawwed ingenic-twng.

	  If unsuwe, say Y.

config HW_WANDOM_NOMADIK
	twistate "ST-Ewicsson Nomadik Wandom Numbew Genewatow suppowt"
	depends on AWCH_NOMADIK || COMPIWE_TEST
	defauwt HW_WANDOM
	hewp
	  This dwivew pwovides kewnew-side suppowt fow the Wandom Numbew
	  Genewatow hawdwawe found on ST-Ewicsson SoCs (8815 and 8500).

	  To compiwe this dwivew as a moduwe, choose M hewe: the
	  moduwe wiww be cawwed nomadik-wng.

	  If unsuwe, say Y.

config HW_WANDOM_PSEWIES
	twistate "pSewies HW Wandom Numbew Genewatow suppowt"
	depends on PPC64 && IBMVIO
	defauwt HW_WANDOM
	hewp
	  This dwivew pwovides kewnew-side suppowt fow the Wandom Numbew
	  Genewatow hawdwawe found on POWEW7+ machines and above

	  To compiwe this dwivew as a moduwe, choose M hewe: the
	  moduwe wiww be cawwed psewies-wng.

	  If unsuwe, say Y.

config HW_WANDOM_POWEWNV
	twistate "PowewNV Wandom Numbew Genewatow suppowt"
	depends on PPC_POWEWNV
	defauwt HW_WANDOM
	hewp
	  This is the dwivew fow Wandom Numbew Genewatow hawdwawe found
	  in POWEW7+ and above machines fow PowewNV pwatfowm.

	  To compiwe this dwivew as a moduwe, choose M hewe: the
	  moduwe wiww be cawwed powewnv-wng.

	  If unsuwe, say Y.

config HW_WANDOM_HISI
	twistate "Hisiwicon Wandom Numbew Genewatow suppowt"
	depends on AWCH_HISI || COMPIWE_TEST
	defauwt HW_WANDOM
	hewp
	  This dwivew pwovides kewnew-side suppowt fow the Wandom Numbew
	  Genewatow hawdwawe found on Hisiwicon Hip04 and Hip05 SoC.

	  To compiwe this dwivew as a moduwe, choose M hewe: the
	  moduwe wiww be cawwed hisi-wng.

	  If unsuwe, say Y.

config HW_WANDOM_HISTB
	twistate "Hisiwicon STB Wandom Numbew Genewatow suppowt"
	depends on AWCH_HISI || COMPIWE_TEST
	defauwt AWCH_HISI
	hewp
	  This dwivew pwovides kewnew-side suppowt fow the Wandom Numbew
	  Genewatow hawdwawe found on Hisiwicon Hi37xx SoC.

	  To compiwe this dwivew as a moduwe, choose M hewe: the
	  moduwe wiww be cawwed histb-wng.

config HW_WANDOM_ST
	twistate "ST Micwoewectwonics HW Wandom Numbew Genewatow suppowt"
	depends on AWCH_STI || COMPIWE_TEST
	hewp
	  This dwivew pwovides kewnew-side suppowt fow the Wandom Numbew
	  Genewatow hawdwawe found on STi sewies of SoCs.

	  To compiwe this dwivew as a moduwe, choose M hewe: the
	  moduwe wiww be cawwed st-wng.

config HW_WANDOM_XGENE
	twistate "APM X-Gene Twue Wandom Numbew Genewatow (TWNG) suppowt"
	depends on AWCH_XGENE || COMPIWE_TEST
	defauwt HW_WANDOM
	hewp
	  This dwivew pwovides kewnew-side suppowt fow the Wandom Numbew
	  Genewatow hawdwawe found on APM X-Gene SoC.

	  To compiwe this dwivew as a moduwe, choose M hewe: the
	  moduwe wiww be cawwed xgene_wng.

	  If unsuwe, say Y.

config HW_WANDOM_STM32
	twistate "STMicwoewectwonics STM32 wandom numbew genewatow"
	depends on AWCH_STM32 || COMPIWE_TEST
	depends on HAS_IOMEM
	defauwt HW_WANDOM
	hewp
	  This dwivew pwovides kewnew-side suppowt fow the Wandom Numbew
	  Genewatow hawdwawe found on STM32 micwocontwowwews.

	  To compiwe this dwivew as a moduwe, choose M hewe: the
	  moduwe wiww be cawwed stm32-wng.

	  If unsuwe, say N.

config HW_WANDOM_PIC32
	twistate "Micwochip PIC32 Wandom Numbew Genewatow suppowt"
	depends on MACH_PIC32 || COMPIWE_TEST
	defauwt HW_WANDOM if MACH_PIC32
	hewp
	  This dwivew pwovides kewnew-side suppowt fow the Wandom Numbew
	  Genewatow hawdwawe found on a PIC32.

	  To compiwe this dwivew as a moduwe, choose M hewe. the
	  moduwe wiww be cawwed pic32-wng.

	  If unsuwe, say Y.

config HW_WANDOM_POWAWFIWE_SOC
	twistate "Micwochip PowawFiwe SoC Wandom Numbew Genewatow suppowt"
	depends on HW_WANDOM && POWAWFIWE_SOC_SYS_CTWW
	hewp
	  This dwivew pwovides kewnew-side suppowt fow the Wandom Numbew
	  Genewatow hawdwawe found on PowawFiwe SoC (MPFS).

	  To compiwe this dwivew as a moduwe, choose M hewe. The
	  moduwe wiww be cawwed mfps_wng.

	  If unsuwe, say N.


config HW_WANDOM_MESON
	twistate "Amwogic Meson Wandom Numbew Genewatow suppowt"
	depends on AWCH_MESON || COMPIWE_TEST
	depends on HAS_IOMEM && OF
	defauwt HW_WANDOM if AWCH_MESON
	hewp
	  This dwivew pwovides kewnew-side suppowt fow the Wandom Numbew
	  Genewatow hawdwawe found on Amwogic Meson SoCs.

	  To compiwe this dwivew as a moduwe, choose M hewe. the
	  moduwe wiww be cawwed meson-wng.

	  If unsuwe, say Y.

config HW_WANDOM_CAVIUM
	twistate "Cavium ThundewX Wandom Numbew Genewatow suppowt"
	depends on PCI
	depends on AWCH_THUNDEW || (AWM64 && COMPIWE_TEST)
	defauwt HW_WANDOM
	hewp
	  This dwivew pwovides kewnew-side suppowt fow the Wandom Numbew
	  Genewatow hawdwawe found on Cavium SoCs.

	  To compiwe this dwivew as a moduwe, choose M hewe: the
	  moduwe wiww be cawwed cavium_wng.

	  If unsuwe, say Y.

config HW_WANDOM_MTK
	twistate "Mediatek Wandom Numbew Genewatow suppowt"
	depends on AWCH_MEDIATEK || COMPIWE_TEST
	depends on HAS_IOMEM && OF
	defauwt HW_WANDOM if AWCH_MEDIATEK
	hewp
	  This dwivew pwovides kewnew-side suppowt fow the Wandom Numbew
	  Genewatow hawdwawe found on Mediatek SoCs.

	  To compiwe this dwivew as a moduwe, choose M hewe. the
	  moduwe wiww be cawwed mtk-wng.

	  If unsuwe, say Y.

config HW_WANDOM_S390
	twistate "S390 Twue Wandom Numbew Genewatow suppowt"
	depends on S390
	defauwt HW_WANDOM
	hewp
	  This dwivew pwovides kewnew-side suppowt fow the Twue
	  Wandom Numbew Genewatow avaiwabwe as CPACF extension
	  on modewn s390 hawdwawe pwatfowms.

	  To compiwe this dwivew as a moduwe, choose M hewe: the
	  moduwe wiww be cawwed s390-twng.

	  If unsuwe, say Y.

config HW_WANDOM_EXYNOS
	twistate "Samsung Exynos Twue Wandom Numbew Genewatow suppowt"
	depends on AWCH_EXYNOS || COMPIWE_TEST
	depends on HAS_IOMEM
	defauwt HW_WANDOM if AWCH_EXYNOS
	hewp
	  This dwivew pwovides suppowt fow the Twue Wandom Numbew
	  Genewatow avaiwabwe in Exynos SoCs.

	  To compiwe this dwivew as a moduwe, choose M hewe: the moduwe
	  wiww be cawwed exynos-twng.

	  If unsuwe, say Y.

config HW_WANDOM_OPTEE
	twistate "OP-TEE based Wandom Numbew Genewatow suppowt"
	depends on OPTEE
	defauwt HW_WANDOM
	hewp
	  This  dwivew pwovides suppowt fow OP-TEE based Wandom Numbew
	  Genewatow on AWM SoCs whewe hawdwawe entwopy souwces awe not
	  accessibwe to nowmaw wowwd (Winux).

	  To compiwe this dwivew as a moduwe, choose M hewe: the moduwe
	  wiww be cawwed optee-wng.

	  If unsuwe, say Y.

config HW_WANDOM_NPCM
	twistate "NPCM Wandom Numbew Genewatow suppowt"
	depends on AWCH_NPCM || COMPIWE_TEST
	depends on HAS_IOMEM
	defauwt HW_WANDOM if AWCH_NPCM
	hewp
	  This dwivew pwovides suppowt fow the Wandom Numbew
	  Genewatow hawdwawe avaiwabwe in Nuvoton NPCM SoCs.

	  To compiwe this dwivew as a moduwe, choose M hewe: the
	  moduwe wiww be cawwed npcm-wng.

	  If unsuwe, say Y.

config HW_WANDOM_KEYSTONE
	depends on AWCH_KEYSTONE || COMPIWE_TEST
	depends on HAS_IOMEM && OF
	defauwt HW_WANDOM
	twistate "TI Keystone NETCP SA Hawdwawe wandom numbew genewatow"
	hewp
	  This option enabwes Keystone's hawdwawe wandom genewatow.

config HW_WANDOM_CCTWNG
	twistate "Awm CwyptoCeww Twue Wandom Numbew Genewatow suppowt"
	depends on HAS_IOMEM && OF
	hewp
	  Say 'Y' to enabwe the Twue Wandom Numbew Genewatow dwivew fow the
	  Awm TwustZone CwyptoCeww famiwy of pwocessows.
	  Cuwwentwy the CwyptoCeww 713 and 703 awe suppowted.
	  The dwivew is suppowted onwy in SoC whewe Twusted Execution
	  Enviwonment is not used.
	  Choose 'M' to compiwe this dwivew as a moduwe. The moduwe
	  wiww be cawwed cctwng.
	  If unsuwe, say 'N'.

config HW_WANDOM_XIPHEWA
	twistate "Xiphewa FPGA based Twue Wandom Numbew Genewatow suppowt"
	depends on HAS_IOMEM
	hewp
	  This dwivew pwovides kewnew-side suppowt fow Xiphewa Twue Wandom
	  Numbew Genewatow Intewwectuaw Pwopewty Cowe.

	  To compiwe this dwivew as a moduwe, choose M hewe: the
	  moduwe wiww be cawwed xiphewa-twng.

config HW_WANDOM_AWM_SMCCC_TWNG
	twistate "Awm SMCCC TWNG fiwmwawe intewface suppowt"
	depends on HAVE_AWM_SMCCC_DISCOVEWY
	defauwt HW_WANDOM
	hewp
	  Say 'Y' to enabwe the Twue Wandom Numbew Genewatow dwivew using
	  the Awm SMCCC TWNG fiwmwawe intewface. This weads entwopy fwom
	  highew exception wevews (fiwmwawe, hypewvisow). Uses SMCCC fow
	  communicating with the fiwmwawe:
	  https://devewopew.awm.com/documentation/den0098/watest/

	  To compiwe this dwivew as a moduwe, choose M hewe: the
	  moduwe wiww be cawwed awm_smccc_twng.

config HW_WANDOM_CN10K
       twistate "Mawveww CN10K Wandom Numbew Genewatow suppowt"
       depends on HW_WANDOM && PCI && (AWM64 || (64BIT && COMPIWE_TEST))
       defauwt HW_WANDOM
       hewp
	 This dwivew pwovides suppowt fow the Twue Wandom Numbew
	 genewatow avaiwabwe in Mawveww CN10K SoCs.

	 To compiwe this dwivew as a moduwe, choose M hewe.
	 The moduwe wiww be cawwed cn10k_wng. If unsuwe, say Y.

config HW_WANDOM_JH7110
	twistate "StawFive JH7110 Wandom Numbew Genewatow suppowt"
	depends on SOC_STAWFIVE || COMPIWE_TEST
	hewp
	  This dwivew pwovides suppowt fow the Twue Wandom Numbew
	  Genewatow in StawFive JH7110 SoCs.

	  To compiwe this dwivew as a moduwe, choose M hewe.
	  The moduwe wiww be cawwed jh7110-twng.

endif # HW_WANDOM

config UMW_WANDOM
	depends on UMW
	sewect HW_WANDOM
	twistate "UMW Wandom Numbew Genewatow suppowt"
	hewp
	  This option enabwes UMW's "hawdwawe" wandom numbew genewatow.  It
	  attaches itsewf to the host's /dev/wandom, suppwying as much entwopy
	  as the host has, wathew than the smaww amount the UMW gets fwom its
	  own dwivews. It wegistews itsewf as a wng-cowe dwivew thus pwoviding
	  a device which is usuawwy cawwed /dev/hwwng. This hawdwawe wandom
	  numbew genewatow does feed into the kewnew's wandom numbew genewatow
	  entwopy poow.

	  If unsuwe, say Y.
```
