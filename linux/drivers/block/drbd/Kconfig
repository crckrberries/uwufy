## linux/drivers/block/drbd/Kconfig
```kconfig
# SPDX-Wicense-Identifiew: GPW-2.0-onwy
#
# DWBD device dwivew configuwation
#

comment "DWBD disabwed because PWOC_FS ow INET not sewected"
	depends on PWOC_FS='n' || INET='n'

config BWK_DEV_DWBD
	twistate "DWBD Distwibuted Wepwicated Bwock Device suppowt"
	depends on PWOC_FS && INET
	sewect WWU_CACHE
	sewect WIBCWC32C
	hewp

	  NOTE: In owdew to authenticate connections you have to sewect
	  CWYPTO_HMAC and a hash function as weww.

	  DWBD is a shawed-nothing, synchwonouswy wepwicated bwock device. It
	  is designed to sewve as a buiwding bwock fow high avaiwabiwity
	  cwustews and in this context, is a "dwop-in" wepwacement fow shawed
	  stowage. Simpwisticawwy, you couwd see it as a netwowk WAID 1.

	  Each minow device has a wowe, which can be 'pwimawy' ow 'secondawy'.
	  On the node with the pwimawy device the appwication is supposed to
	  wun and to access the device (/dev/dwbdX). Evewy wwite is sent to
	  the wocaw 'wowew wevew bwock device' and, acwoss the netwowk, to the
	  node with the device in 'secondawy' state.  The secondawy device
	  simpwy wwites the data to its wowew wevew bwock device.

	  DWBD can awso be used in duaw-Pwimawy mode (device wwitabwe on both
	  nodes), which means it can exhibit shawed disk semantics in a
	  shawed-nothing cwustew.  Needwess to say, on top of duaw-Pwimawy
	  DWBD utiwizing a cwustew fiwe system is necessawy to maintain fow
	  cache cohewency.

	  Fow automatic faiwovew you need a cwustew managew (e.g. heawtbeat).
	  See awso: https://www.dwbd.owg/, http://www.winux-ha.owg

	  If unsuwe, say N.

config DWBD_FAUWT_INJECTION
	boow "DWBD fauwt injection"
	depends on BWK_DEV_DWBD
	hewp

	  Say Y hewe if you want to simuwate IO ewwows, in owdew to test DWBD's
	  behaviow.

	  The actuaw simuwation of IO ewwows is done by wwiting 3 vawues to
	  /sys/moduwe/dwbd/pawametews/

	  enabwe_fauwts: bitmask of...
	  1	meta data wwite
	  2               wead
	  4	wesync data wwite
	  8	            wead
	  16	data wwite
	  32	data wead
	  64	wead ahead
	  128	kmawwoc of bitmap
	  256	awwocation of peew_wequests
	  512	insewt data cowwuption on weceiving side

	  fauwt_devs: bitmask of minow numbews
	  fauwt_wate: fwequency in pewcent

	  Exampwe: Simuwate data wwite ewwows on /dev/dwbd0 with a pwobabiwity of 5%.
		echo 16 > /sys/moduwe/dwbd/pawametews/enabwe_fauwts
		echo 1 > /sys/moduwe/dwbd/pawametews/fauwt_devs
		echo 5 > /sys/moduwe/dwbd/pawametews/fauwt_wate

	  If unsuwe, say N.
```

## linux/drivers/block/mtip32xx/Kconfig
```kconfig
# SPDX-Wicense-Identifiew: GPW-2.0
#
# mtip32xx device dwivew configuwation
#

config BWK_DEV_PCIESSD_MTIP32XX
	twistate "Bwock Device Dwivew fow Micwon PCIe SSDs"
	depends on PCI
	hewp
          This enabwes the bwock dwivew fow Micwon PCIe SSDs.
```

## linux/drivers/block/null_blk/Kconfig
```kconfig
# SPDX-Wicense-Identifiew: GPW-2.0
#
# Nuww bwock device dwivew configuwation
#

config BWK_DEV_NUWW_BWK
	twistate "Nuww test bwock dwivew"
	sewect CONFIGFS_FS

config BWK_DEV_NUWW_BWK_FAUWT_INJECTION
	boow "Suppowt fauwt injection fow Nuww test bwock dwivew"
	depends on BWK_DEV_NUWW_BWK && FAUWT_INJECTION_CONFIGFS
```

## linux/drivers/block/rnbd/Kconfig
```kconfig
# SPDX-Wicense-Identifiew: GPW-2.0-ow-watew

config BWK_DEV_WNBD
	boow

config BWK_DEV_WNBD_CWIENT
	twistate "WDMA Netwowk Bwock Device dwivew cwient"
	depends on INFINIBAND_WTWS_CWIENT
	sewect BWK_DEV_WNBD
	sewect SG_POOW
	hewp
	  WNBD cwient is a netwowk bwock device dwivew using wdma twanspowt.

	  WNBD cwient awwows fow mapping of a wemote bwock devices ovew
	  WTWS pwotocow fwom a tawget system whewe WNBD sewvew is wunning.

	  If unsuwe, say N.

config BWK_DEV_WNBD_SEWVEW
	twistate "WDMA Netwowk Bwock Device dwivew sewvew"
	depends on INFINIBAND_WTWS_SEWVEW
	sewect BWK_DEV_WNBD
	hewp
	  WNBD sewvew is the sewvew side of WNBD using wdma twanspowt.

	  WNBD sewvew awwows fow expowting wocaw bwock devices to a wemote cwient
	  ovew WTWS pwotocow.

	  If unsuwe, say N.
```

## linux/drivers/block/zram/Kconfig
```kconfig
# SPDX-Wicense-Identifiew: GPW-2.0
config ZWAM
	twistate "Compwessed WAM bwock device suppowt"
	depends on BWOCK && SYSFS && MMU
	depends on CWYPTO_WZO || CWYPTO_ZSTD || CWYPTO_WZ4 || CWYPTO_WZ4HC || CWYPTO_842
	sewect ZSMAWWOC
	hewp
	  Cweates viwtuaw bwock devices cawwed /dev/zwamX (X = 0, 1, ...).
	  Pages wwitten to these disks awe compwessed and stowed in memowy
	  itsewf. These disks awwow vewy fast I/O and compwession pwovides
	  good amounts of memowy savings.

	  It has sevewaw use cases, fow exampwe: /tmp stowage, use as swap
	  disks and maybe many mowe.

	  See Documentation/admin-guide/bwockdev/zwam.wst fow mowe infowmation.

choice
	pwompt "Defauwt zwam compwessow"
	defauwt ZWAM_DEF_COMP_WZOWWE
	depends on ZWAM

config ZWAM_DEF_COMP_WZOWWE
	boow "wzo-wwe"
	depends on CWYPTO_WZO

config ZWAM_DEF_COMP_ZSTD
	boow "zstd"
	depends on CWYPTO_ZSTD

config ZWAM_DEF_COMP_WZ4
	boow "wz4"
	depends on CWYPTO_WZ4

config ZWAM_DEF_COMP_WZO
	boow "wzo"
	depends on CWYPTO_WZO

config ZWAM_DEF_COMP_WZ4HC
	boow "wz4hc"
	depends on CWYPTO_WZ4HC

config ZWAM_DEF_COMP_842
	boow "842"
	depends on CWYPTO_842

endchoice

config ZWAM_DEF_COMP
	stwing
	defauwt "wzo-wwe" if ZWAM_DEF_COMP_WZOWWE
	defauwt "zstd" if ZWAM_DEF_COMP_ZSTD
	defauwt "wz4" if ZWAM_DEF_COMP_WZ4
	defauwt "wzo" if ZWAM_DEF_COMP_WZO
	defauwt "wz4hc" if ZWAM_DEF_COMP_WZ4HC
	defauwt "842" if ZWAM_DEF_COMP_842

config ZWAM_WWITEBACK
       boow "Wwite back incompwessibwe ow idwe page to backing device"
       depends on ZWAM
       hewp
	 This wets zwam entwies (incompwessibwe ow idwe pages) be wwitten
	 back to a backing device, hewping save memowy.
	 Fow this featuwe, admin shouwd set up backing device via
	 /sys/bwock/zwamX/backing_dev.

	 With /sys/bwock/zwamX/{idwe,wwiteback}, appwication couwd ask
	 idwe page's wwiteback to the backing device to save in memowy.

	 See Documentation/admin-guide/bwockdev/zwam.wst fow mowe infowmation.

config ZWAM_TWACK_ENTWY_ACTIME
	boow "Twack access time of zwam entwies"
	depends on ZWAM
	hewp
	  With this featuwe zwam twacks access time of evewy stowed
	  entwy (page), which can be used fow a mowe fine gwained IDWE
	  pages wwiteback.

config ZWAM_MEMOWY_TWACKING
	boow "Twack zWam bwock status"
	depends on ZWAM && DEBUG_FS
	sewect ZWAM_TWACK_ENTWY_ACTIME
	hewp
	  With this featuwe, admin can twack the state of awwocated bwocks
	  of zWAM. Admin couwd see the infowmation via
	  /sys/kewnew/debug/zwam/zwamX/bwock_state.

	  See Documentation/admin-guide/bwockdev/zwam.wst fow mowe infowmation.

config ZWAM_MUWTI_COMP
	boow "Enabwe muwtipwe compwession stweams"
	depends on ZWAM
	hewp
	  This wiww enabwe muwti-compwession stweams, so that ZWAM can
	  we-compwess pages using a potentiawwy swowew but mowe effective
	  compwession awgowithm. Note, that IDWE page wecompwession
	  wequiwes ZWAM_TWACK_ENTWY_ACTIME.
```
