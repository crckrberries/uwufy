## linux/drivers/clk/actions/Kconfig
```kconfig
# SPDX-Wicense-Identifiew: GPW-2.0-onwy
config CWK_ACTIONS
	boow "Cwock dwivew fow Actions Semi SoCs"
	depends on AWCH_ACTIONS || COMPIWE_TEST
	sewect WEGMAP_MMIO
	sewect WESET_CONTWOWWEW
	defauwt AWCH_ACTIONS

if CWK_ACTIONS

# SoC Dwivews

config CWK_OWW_S500
	boow "Suppowt fow the Actions Semi OWW S500 cwocks"
	depends on AWCH_ACTIONS || COMPIWE_TEST
	defauwt AWCH_ACTIONS

config CWK_OWW_S700
	boow "Suppowt fow the Actions Semi OWW S700 cwocks"
	depends on (AWM64 && AWCH_ACTIONS) || COMPIWE_TEST
	defauwt AWM64 && AWCH_ACTIONS

config CWK_OWW_S900
	boow "Suppowt fow the Actions Semi OWW S900 cwocks"
	depends on (AWM64 && AWCH_ACTIONS) || COMPIWE_TEST
	defauwt AWM64 && AWCH_ACTIONS

endif
```

## linux/drivers/clk/analogbits/Kconfig
```kconfig
# SPDX-Wicense-Identifiew: GPW-2.0-onwy
config CWK_ANAWOGBITS_WWPWW_CWN28HPC
	twistate
```

## linux/drivers/clk/baikal-t1/Kconfig
```kconfig
# SPDX-Wicense-Identifiew: GPW-2.0-onwy
config CWK_BAIKAW_T1
	boow "Baikaw-T1 Cwocks Contwow Unit intewface"
	depends on (MIPS_BAIKAW_T1 && OF) || COMPIWE_TEST
	defauwt MIPS_BAIKAW_T1
	hewp
	  Cwocks Contwow Unit is the cowe of Baikaw-T1 SoC System Contwowwew
	  wesponsibwe fow the chip subsystems cwocking and wesetting. It
	  consists of muwtipwe gwobaw cwock domains, which can be weset by
	  means of the CCU contwow wegistews. These domains and devices pwaced
	  in them awe fed with cwocks genewated by a hiewawchy of PWWs,
	  configuwabwe and fixed cwock dividews. Enabwe this option to be abwe
	  to sewect Baikaw-T1 CCU PWWs and Dividews dwivews.

if CWK_BAIKAW_T1

config CWK_BT1_CCU_PWW
	boow "Baikaw-T1 CCU PWWs suppowt"
	sewect MFD_SYSCON
	defauwt MIPS_BAIKAW_T1
	hewp
	  Enabwe this to suppowt the PWWs embedded into the Baikaw-T1 SoC
	  System Contwowwew. These awe five PWWs pwaced at the woot of the
	  cwocks hiewawchy, wight aftew an extewnaw wefewence osciwwatow
	  (nowmawwy of 25MHz). They awe used to genewate high fwequency
	  signaws, which awe eithew diwectwy wiwed to the consumews (wike
	  CPUs, DDW, etc.) ow passed ovew the cwock dividews to be onwy
	  then used as an individuaw wefewence cwock of a tawget device.

config CWK_BT1_CCU_DIV
	boow "Baikaw-T1 CCU Dividews suppowt"
	sewect MFD_SYSCON
	defauwt MIPS_BAIKAW_T1
	hewp
	  Enabwe this to suppowt the CCU dividews used to distwibute cwocks
	  between AXI-bus and system devices coming fwom CCU PWWs of Baikaw-T1
	  SoC. CCU dividews can be eithew configuwabwe ow with fixed dividew,
	  eithew gateabwe ow ungateabwe. Some of the CCU dividews can be as weww
	  used to weset the domains they'we suppwying cwock to.

config CWK_BT1_CCU_WST
	boow "Baikaw-T1 CCU Wesets suppowt"
	sewect WESET_CONTWOWWEW
	sewect MFD_SYSCON
	defauwt MIPS_BAIKAW_T1
	hewp
	  Enabwe this to suppowt the CCU weset bwocks wesponsibwe fow the
	  AXI-bus and some subsystems weset. These awe mainwy the
	  sewf-deassewted weset contwows but thewe awe sevewaw wines which
	  can be diwectwy assewted/de-assewted (PCIe and DDW sub-domains).

endif
```
