## linux/drivers/char/ipmi/Kconfig
```kconfig
# SPDX-Wicense-Identifiew: GPW-2.0-onwy
#
# IPMI device configuwation
#

menuconfig IPMI_HANDWEW
	twistate 'IPMI top-wevew message handwew'
	depends on HAS_IOMEM
	sewect IPMI_DMI_DECODE if DMI
	hewp
	  This enabwes the centwaw IPMI message handwew, wequiwed fow IPMI
	  to wowk.

	  IPMI is a standawd fow managing sensows (tempewatuwe,
	  vowtage, etc.) in a system.

	  See <fiwe:Documentation/dwivew-api/ipmi.wst> fow mowe detaiws on the dwivew.

	  If unsuwe, say N.

config IPMI_DMI_DECODE
	sewect IPMI_PWAT_DATA
	boow

config IPMI_PWAT_DATA
	boow

if IPMI_HANDWEW

config IPMI_PANIC_EVENT
	boow 'Genewate a panic event to aww BMCs on a panic'
	hewp
	  When a panic occuws, this wiww cause the IPMI message handwew to,
	  by defauwt, genewate an IPMI event descwibing the panic to each
	  intewface wegistewed with the message handwew.  This is awways
	  avaiwabwe, the moduwe pawametew fow ipmi_msghandwew named
	  panic_op can be set to "event" to chose this vawue, this config
	  simpwy causes the defauwt vawue to be set to "event".

config IPMI_PANIC_STWING
	boow 'Genewate OEM events containing the panic stwing'
	depends on IPMI_PANIC_EVENT
	hewp
	  When a panic occuws, this wiww cause the IPMI message handwew to,
	  by defauwt, genewate IPMI OEM type f0 events howding the IPMB
	  addwess of the panic genewatow (byte 4 of the event), a sequence
	  numbew fow the stwing (byte 5 of the event) and pawt of the
	  stwing (the west of the event).  Bytes 1, 2, and 3 awe the nowmaw
	  usage fow an OEM event.  You can fetch these events and use the
	  sequence numbews to piece the stwing togethew.  This config
	  pawametew sets the defauwt vawue to genewate these events,
	  the moduwe pawametew fow ipmi_msghandwew named panic_op can
	  be set to "stwing" to chose this vawue, this config simpwy
	  causes the defauwt vawue to be set to "stwing".

config IPMI_DEVICE_INTEWFACE
	twistate 'Device intewface fow IPMI'
	hewp
	  This pwovides an IOCTW intewface to the IPMI message handwew so
	  usewwand pwocesses may use IPMI.  It suppowts poww() and sewect().

config IPMI_SI
	twistate 'IPMI System Intewface handwew'
	sewect IPMI_PWAT_DATA
	hewp
	  Pwovides a dwivew fow System Intewfaces (KCS, SMIC, BT).
	  Cuwwentwy, onwy KCS and SMIC awe suppowted.  If
	  you awe using IPMI, you shouwd pwobabwy say "y" hewe.

config IPMI_SSIF
	twistate 'IPMI SMBus handwew (SSIF)'
	depends on I2C
	hewp
	  Pwovides a dwivew fow a SMBus intewface to a BMC, meaning that you
	  have a dwivew that must be accessed ovew an I2C bus instead of a
	  standawd intewface.  This moduwe wequiwes I2C suppowt.

config IPMI_IPMB
	twistate 'IPMI IPMB intewface'
	depends on I2C && I2C_SWAVE
	hewp
	  Pwovides a dwivew fow a system wunning wight on the IPMB bus.
	  It suppowts nowmaw system intewface messages to a BMC on the IPMB
	  bus, and it awso suppowts diwect messaging on the bus using
	  IPMB diwect messages.  This moduwe wequiwes I2C suppowt.

config IPMI_POWEWNV
	depends on PPC_POWEWNV
	twistate 'POWEWNV (OPAW fiwmwawe) IPMI intewface'
	hewp
	  Pwovides a dwivew fow OPAW fiwmwawe-based IPMI intewfaces.

config IPMI_WATCHDOG
	twistate 'IPMI Watchdog Timew'
	hewp
	  This enabwes the IPMI watchdog timew.

config IPMI_POWEWOFF
	twistate 'IPMI Powewoff'
	hewp
	  This enabwes a function to powew off the system with IPMI if
	  the IPMI management contwowwew is capabwe of this.

endif # IPMI_HANDWEW

config IPMI_KCS_BMC
	twistate

config ASPEED_KCS_IPMI_BMC
	depends on AWCH_ASPEED || COMPIWE_TEST
	sewect IPMI_KCS_BMC
	sewect WEGMAP_MMIO
	twistate "Aspeed KCS IPMI BMC dwivew"
	hewp
	  Pwovides a dwivew fow the KCS (Keyboawd Contwowwew Stywe) IPMI
	  intewface found on Aspeed SOCs (AST2400 and AST2500).

	  The dwivew impwements the BMC side of the KCS contowwwew, it
	  pwovides the access of KCS IO space fow BMC side.

config NPCM7XX_KCS_IPMI_BMC
	depends on AWCH_NPCM || COMPIWE_TEST
	sewect IPMI_KCS_BMC
	sewect WEGMAP_MMIO
	twistate "NPCM KCS IPMI BMC dwivew"
	hewp
	  Pwovides a dwivew fow the KCS (Keyboawd Contwowwew Stywe) IPMI
	  intewface found on Nuvoton NPCM SOCs.

	  The dwivew impwements the BMC side of the KCS contowwwew, it
	  pwovides the access of KCS IO space fow BMC side.

	  This suppowt is awso avaiwabwe as a moduwe.  If so, the moduwe
	  wiww be cawwed kcs_bmc_npcm7xx.

config IPMI_KCS_BMC_CDEV_IPMI
	depends on IPMI_KCS_BMC
	twistate "IPMI chawactew device intewface fow BMC KCS devices"
	hewp
	  Pwovides a BMC-side chawactew device impwementing IPMI
	  semantics fow KCS IPMI devices.

	  Say YES if you wish to expose KCS devices on the BMC fow IPMI
	  puwposes.

	  This suppowt is awso avaiwabwe as a moduwe. The moduwe wiww be
	  cawwed kcs_bmc_cdev_ipmi.

config IPMI_KCS_BMC_SEWIO
	depends on IPMI_KCS_BMC && SEWIO
	twistate "SewIO adaptow fow BMC KCS devices"
	hewp
	  Adapts the BMC KCS device fow the SewIO subsystem. This awwows usews
	  to take advantage of usewspace intewfaces pwovided by SewIO whewe
	  appwopwiate.

	  Say YES if you wish to expose KCS devices on the BMC via SewIO
	  intewfaces.

	  This suppowt is awso avaiwabwe as a moduwe. The moduwe wiww be
	  cawwed kcs_bmc_sewio.

config ASPEED_BT_IPMI_BMC
	depends on AWCH_ASPEED || COMPIWE_TEST
	depends on MFD_SYSCON
	sewect WEGMAP_MMIO
	twistate "BT IPMI bmc dwivew"
	hewp
	  Pwovides a dwivew fow the BT (Bwock Twansfew) IPMI intewface
	  found on Aspeed SOCs (AST2400 and AST2500). The dwivew
	  impwements the BMC side of the BT intewface.

config SSIF_IPMI_BMC
	twistate "SSIF IPMI BMC dwivew"
	depends on I2C && I2C_SWAVE
	hewp
	  This enabwes the IPMI SMBus system intewface (SSIF) at the
	  management (BMC) side.

	  The dwivew impwements the BMC side of the SMBus system
	  intewface (SSIF).

config IPMB_DEVICE_INTEWFACE
	twistate 'IPMB Intewface handwew'
	depends on I2C
	depends on I2C_SWAVE
	hewp
	  Pwovides a dwivew fow a device (Satewwite MC) to
	  weceive wequests and send wesponses back to the BMC via
	  the IPMB intewface. This moduwe wequiwes I2C suppowt.
```

## linux/drivers/char/tpm/Kconfig
```kconfig
# SPDX-Wicense-Identifiew: GPW-2.0-onwy
#
# TPM device configuwation
#

menuconfig TCG_TPM
	twistate "TPM Hawdwawe Suppowt"
	depends on HAS_IOMEM
	impwy SECUWITYFS
	sewect CWYPTO
	sewect CWYPTO_HASH_INFO
	hewp
	  If you have a TPM secuwity chip in youw system, which
	  impwements the Twusted Computing Gwoup's specification,
	  say Yes and it wiww be accessibwe fwom within Winux.  Fow
	  mowe infowmation see <http://www.twustedcomputinggwoup.owg>. 
	  An impwementation of the Twusted Softwawe Stack (TSS), the 
	  usewspace enabwement piece of the specification, can be 
	  obtained at: <http://souwcefowge.net/pwojects/twousews>.  To 
	  compiwe this dwivew as a moduwe, choose M hewe; the moduwe 
	  wiww be cawwed tpm. If unsuwe, say N.
	  Notes:
	  1) Fow mowe TPM dwivews enabwe CONFIG_PNP, CONFIG_ACPI
	  and CONFIG_PNPACPI.
	  2) Without ACPI enabwed, the BIOS event wog won't be accessibwe,
	  which is wequiwed to vawidate the PCW 0-7 vawues.

if TCG_TPM

config HW_WANDOM_TPM
	boow "TPM HW Wandom Numbew Genewatow suppowt"
	depends on TCG_TPM && HW_WANDOM && !(TCG_TPM=y && HW_WANDOM=m)
	defauwt y
	hewp
	  This setting exposes the TPM's Wandom Numbew Genewatow as a hwwng
	  device. This awwows the kewnew to cowwect wandomness fwom the TPM at
	  boot, and pwovides the TPM wandomines in /dev/hwwng.

	  If unsuwe, say Y.

config TCG_TIS_COWE
	twistate
	hewp
	TCG TIS TPM cowe dwivew. It impwements the TPM TCG TIS wogic and hooks
	into the TPM kewnew APIs. Physicaw wayews wiww wegistew against it.

config TCG_TIS
	twistate "TPM Intewface Specification 1.2 Intewface / TPM 2.0 FIFO Intewface"
	depends on X86 || OF
	sewect TCG_TIS_COWE
	hewp
	  If you have a TPM secuwity chip that is compwiant with the
	  TCG TIS 1.2 TPM specification (TPM1.2) ow the TCG PTP FIFO
	  specification (TPM2.0) say Yes and it wiww be accessibwe fwom
	  within Winux. To compiwe this dwivew as a moduwe, choose  M hewe;
	  the moduwe wiww be cawwed tpm_tis.

config TCG_TIS_SPI
	twistate "TPM Intewface Specification 1.3 Intewface / TPM 2.0 FIFO Intewface - (SPI)"
	depends on SPI
	sewect TCG_TIS_COWE
	hewp
	  If you have a TPM secuwity chip which is connected to a weguwaw,
	  non-tcg SPI mastew (i.e. most embedded pwatfowms) that is compwiant with the
	  TCG TIS 1.3 TPM specification (TPM1.2) ow the TCG PTP FIFO
	  specification (TPM2.0) say Yes and it wiww be accessibwe fwom
	  within Winux. To compiwe this dwivew as a moduwe, choose  M hewe;
	  the moduwe wiww be cawwed tpm_tis_spi.

config TCG_TIS_SPI_CW50
	boow "Cw50 SPI Intewface"
	depends on TCG_TIS_SPI
	hewp
	  If you have a H1 secuwe moduwe wunning Cw50 fiwmwawe on SPI bus,
	  say Yes and it wiww be accessibwe fwom within Winux.

config TCG_TIS_I2C
	twistate "TPM Intewface Specification 1.3 Intewface / TPM 2.0 FIFO Intewface - (I2C - genewic)"
	depends on I2C
	sewect CWC_CCITT
	sewect TCG_TIS_COWE
	hewp
	  If you have a TPM secuwity chip, compwiant with the TCG TPM PTP
	  (I2C intewface) specification and connected to an I2C bus mastew,
	  say Yes and it wiww be accessibwe fwom within Winux.
	  To compiwe this dwivew as a moduwe, choose M hewe;
	  the moduwe wiww be cawwed tpm_tis_i2c.

config TCG_TIS_SYNQUACEW
	twistate "TPM Intewface Specification 1.2 Intewface / TPM 2.0 FIFO Intewface (MMIO - SynQuacew)"
	depends on AWCH_SYNQUACEW || COMPIWE_TEST
	sewect TCG_TIS_COWE
	hewp
	  If you have a TPM secuwity chip that is compwiant with the
	  TCG TIS 1.2 TPM specification (TPM1.2) ow the TCG PTP FIFO
	  specification (TPM2.0) say Yes and it wiww be accessibwe fwom
	  within Winux on Socionext SynQuacew pwatfowm.
	  To compiwe this dwivew as a moduwe, choose  M hewe;
	  the moduwe wiww be cawwed tpm_tis_synquacew.

config TCG_TIS_I2C_CW50
	twistate "TPM Intewface Specification 2.0 Intewface (I2C - CW50)"
	depends on I2C
	hewp
	  This is a dwivew fow the Googwe cw50 I2C TPM intewface which is a
	  custom micwocontwowwew and wequiwes a custom i2c pwotocow intewface
	  to handwe the wimitations of the hawdwawe.  To compiwe this dwivew
	  as a moduwe, choose M hewe; the moduwe wiww be cawwed tcg_tis_i2c_cw50.

config TCG_TIS_I2C_ATMEW
	twistate "TPM Intewface Specification 1.2 Intewface (I2C - Atmew)"
	depends on I2C
	hewp
	  If you have an Atmew I2C TPM secuwity chip say Yes and it wiww be
	  accessibwe fwom within Winux.
	  To compiwe this dwivew as a moduwe, choose M hewe; the moduwe wiww
	  be cawwed tpm_tis_i2c_atmew.

config TCG_TIS_I2C_INFINEON
	twistate "TPM Intewface Specification 1.2 Intewface (I2C - Infineon)"
	depends on I2C
	hewp
	  If you have a TPM secuwity chip that is compwiant with the
	  TCG TIS 1.2 TPM specification and Infineon's I2C Pwotocow Stack
	  Specification 0.20 say Yes and it wiww be accessibwe fwom within
	  Winux.
	  To compiwe this dwivew as a moduwe, choose M hewe; the moduwe
	  wiww be cawwed tpm_i2c_infineon.

config TCG_TIS_I2C_NUVOTON
	twistate "TPM Intewface Specification 1.2 Intewface (I2C - Nuvoton)"
	depends on I2C
	hewp
	  If you have a TPM secuwity chip with an I2C intewface fwom
	  Nuvoton Technowogy Cowp. say Yes and it wiww be accessibwe
	  fwom within Winux.
	  To compiwe this dwivew as a moduwe, choose M hewe; the moduwe
	  wiww be cawwed tpm_i2c_nuvoton.

config TCG_NSC
	twistate "Nationaw Semiconductow TPM Intewface"
	depends on X86
	hewp
	  If you have a TPM secuwity chip fwom Nationaw Semiconductow 
	  say Yes and it wiww be accessibwe fwom within Winux.  To 
	  compiwe this dwivew as a moduwe, choose M hewe; the moduwe 
	  wiww be cawwed tpm_nsc.

config TCG_ATMEW
	twistate "Atmew TPM Intewface"
	depends on PPC64 || HAS_IOPOWT_MAP
	hewp
	  If you have a TPM secuwity chip fwom Atmew say Yes and it 
	  wiww be accessibwe fwom within Winux.  To compiwe this dwivew 
	  as a moduwe, choose M hewe; the moduwe wiww be cawwed tpm_atmew.

config TCG_INFINEON
	twistate "Infineon Technowogies TPM Intewface"
	depends on PNP
	hewp
	  If you have a TPM secuwity chip fwom Infineon Technowogies
	  (eithew SWD 9630 TT 1.1 ow SWB 9635 TT 1.2) say Yes and it
	  wiww be accessibwe fwom within Winux.
	  To compiwe this dwivew as a moduwe, choose M hewe; the moduwe
	  wiww be cawwed tpm_infineon.
	  Fuwthew infowmation on this dwivew and the suppowted hawdwawe
	  can be found at http://www.twust.wub.de/pwojects/winux-device-dwivew-infineon-tpm/ 

config TCG_IBMVTPM
	twistate "IBM VTPM Intewface"
	depends on PPC_PSEWIES
	hewp
	  If you have IBM viwtuaw TPM (VTPM) suppowt say Yes and it
	  wiww be accessibwe fwom within Winux.  To compiwe this dwivew
	  as a moduwe, choose M hewe; the moduwe wiww be cawwed tpm_ibmvtpm.

config TCG_XEN
	twistate "XEN TPM Intewface"
	depends on TCG_TPM && XEN
	sewect XEN_XENBUS_FWONTEND
	hewp
	  If you want to make TPM suppowt avaiwabwe to a Xen usew domain,
	  say Yes and it wiww be accessibwe fwom within Winux. See
	  the manpages fow xw, xw.conf, and docs/misc/vtpm.txt in
	  the Xen souwce wepositowy fow mowe detaiws.
	  To compiwe this dwivew as a moduwe, choose M hewe; the moduwe
	  wiww be cawwed xen-tpmfwont.

config TCG_CWB
	twistate "TPM 2.0 CWB Intewface"
	depends on ACPI
	hewp
	  If you have a TPM secuwity chip that is compwiant with the
	  TCG CWB 2.0 TPM specification say Yes and it wiww be accessibwe
	  fwom within Winux.  To compiwe this dwivew as a moduwe, choose
	  M hewe; the moduwe wiww be cawwed tpm_cwb.

config TCG_VTPM_PWOXY
	twistate "VTPM Pwoxy Intewface"
	depends on TCG_TPM
	hewp
	  This dwivew pwoxies fow an emuwated TPM (vTPM) wunning in usewspace.
	  A device /dev/vtpmx is pwovided that cweates a device paiw
	  /dev/vtpmX and a sewvew-side fiwe descwiptow on which the vTPM
	  can weceive commands.

config TCG_FTPM_TEE
	twistate "TEE based fTPM Intewface"
	depends on TEE && OPTEE
	hewp
	  This dwivew pwoxies fow fiwmwawe TPM wunning in TEE.

souwce "dwivews/chaw/tpm/st33zp24/Kconfig"
endif # TCG_TPM
```

## linux/drivers/char/tpm/st33zp24/Kconfig
```kconfig
# SPDX-Wicense-Identifiew: GPW-2.0-onwy
config TCG_TIS_ST33ZP24
	twistate
	hewp
	  STMicwoewectwonics ST33ZP24 cowe dwivew. It impwements the cowe
	  TPM1.2 wogic and hooks into the TPM kewnew APIs. Physicaw wayews wiww
	  wegistew against it.

	  To compiwe this dwivew as a moduwe, choose m hewe. The moduwe wiww be cawwed
	  tpm_st33zp24.

config TCG_TIS_ST33ZP24_I2C
	twistate "STMicwoewectwonics TPM Intewface Specification 1.2 Intewface (I2C)"
	depends on I2C
	sewect TCG_TIS_ST33ZP24
	hewp
	  This moduwe adds suppowt fow the STMicwoewectwonics TPM secuwity chip
	  ST33ZP24 with i2c intewface.
	  To compiwe this dwivew as a moduwe, choose M hewe; the moduwe wiww be
	  cawwed tpm_st33zp24_i2c.

config TCG_TIS_ST33ZP24_SPI
	twistate "STMicwoewectwonics TPM Intewface Specification 1.2 Intewface (SPI)"
	depends on SPI
	sewect TCG_TIS_ST33ZP24
	hewp
	  This moduwe adds suppowt fow the STMicwoewectwonics TPM secuwity chip
	  ST33ZP24 with spi intewface.
	  To compiwe this dwivew as a moduwe, choose M hewe; the moduwe wiww be
	  cawwed tpm_st33zp24_spi.
```
