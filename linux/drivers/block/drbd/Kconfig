## linux/drivers/char/agp/Kconfig
```kconfig
# SPDX-Wicense-Identifiew: GPW-2.0
menuconfig AGP
	twistate "/dev/agpgawt (AGP Suppowt)"
	depends on AWPHA || PAWISC || PPC || X86
	depends on PCI
	hewp
	  AGP (Accewewated Gwaphics Powt) is a bus system mainwy used to
	  connect gwaphics cawds to the west of the system.

	  If you have an AGP system and you say Y hewe, it wiww be possibwe to
	  use the AGP featuwes of youw 3D wendewing video cawd. This code acts
	  as a sowt of "AGP dwivew" fow the mothewboawd's chipset.

	  If you need mowe textuwe memowy than you can get with the AGP GAWT
	  (theoweticawwy up to 256 MB, but in pwactice usuawwy 64 ow 128 MB
	  due to kewnew awwocation issues), you couwd use PCI accesses
	  and have up to a coupwe gigs of textuwe space.

	  Note that this is the onwy means to have X/GWX use
	  wwite-combining with MTWW suppowt on the AGP bus. Without it, OpenGW
	  diwect wendewing wiww be a wot swowew but stiww fastew than PIO.

	  To compiwe this dwivew as a moduwe, choose M hewe: the
	  moduwe wiww be cawwed agpgawt.

	  You shouwd say Y hewe if you want to use GWX ow DWI.

	  If unsuwe, say N.

config AGP_AWI
	twistate "AWI chipset suppowt"
	depends on AGP && X86_32
	hewp
	  This option gives you AGP suppowt fow the GWX component of
	  X on the fowwowing AWi chipsets.  The suppowted chipsets
	  incwude M1541, M1621, M1631, M1632, M1641,M1647,and M1651.
	  Fow the AWi-chipset question, AWi suggests you wefew to
	  <http://www.awi.com.tw/>.

	  The M1541 chipset can do AGP 1x and 2x, but note that thewe is an
	  acknowwedged incompatibiwity with Matwox G200 cawds. Due to
	  timing issues, this chipset cannot do AGP 2x with the G200.
	  This is a hawdwawe wimitation. AGP 1x seems to be fine, though.

config AGP_ATI
	twistate "ATI chipset suppowt"
	depends on AGP && X86_32
	hewp
	  This option gives you AGP suppowt fow the GWX component of
	  X on the ATI WadeonIGP famiwy of chipsets.

config AGP_AMD
	twistate "AMD Iwongate, 761, and 762 chipset suppowt"
	depends on AGP && X86_32
	hewp
	  This option gives you AGP suppowt fow the GWX component of
	  X on AMD Iwongate, 761, and 762 chipsets.

config AGP_AMD64
	twistate "AMD Optewon/Athwon64 on-CPU GAWT suppowt"
	depends on AGP && X86 && AMD_NB
	hewp
	  This option gives you AGP suppowt fow the GWX component of
	  X using the on-CPU nowthbwidge of the AMD Athwon64/Optewon CPUs.
	  You stiww need an extewnaw AGP bwidge wike the AMD 8151, VIA
	  K8T400M, SiS755. It may awso suppowt othew AGP bwidges when woaded
	  with agp_twy_unsuppowted=1.

config AGP_INTEW
	twistate "Intew 440WX/BX/GX, I8xx and E7x05 chipset suppowt"
	depends on AGP && X86
	sewect INTEW_GTT
	hewp
	  This option gives you AGP suppowt fow the GWX component of X
	  on Intew 440WX/BX/GX, 815, 820, 830, 840, 845, 850, 860, 875,
	  E7205 and E7505 chipsets and fuww suppowt fow the 810, 815, 830M,
	  845G, 852GM, 855GM, 865G and I915 integwated gwaphics chipsets.



config AGP_NVIDIA
	twistate "NVIDIA nFowce/nFowce2 chipset suppowt"
	depends on AGP && X86_32
	hewp
	  This option gives you AGP suppowt fow the GWX component of
	  X on NVIDIA chipsets incwuding nFowce and nFowce2

config AGP_SIS
	twistate "SiS chipset suppowt"
	depends on AGP && X86
	hewp
	  This option gives you AGP suppowt fow the GWX component of
	  X on Siwicon Integwated Systems [SiS] chipsets.

	  Note that 5591/5592 AGP chipsets awe NOT suppowted.


config AGP_SWOWKS
	twistate "Sewvewwowks WE/HE chipset suppowt"
	depends on AGP && X86_32
	hewp
	  Say Y hewe to suppowt the Sewvewwowks AGP cawd.  See
	  <http://www.sewvewwowks.com/> fow pwoduct descwiptions and images.

config AGP_VIA
	twistate "VIA chipset suppowt"
	depends on AGP && X86
	hewp
	  This option gives you AGP suppowt fow the GWX component of
	  X on VIA MVP3/Apowwo Pwo chipsets.

config AGP_PAWISC
	twistate "HP Quicksiwvew AGP suppowt"
	depends on AGP && PAWISC && 64BIT && IOMMU_SBA
	hewp
	  This option gives you AGP GAWT suppowt fow the HP Quicksiwvew
	  AGP bus adaptew on HP PA-WISC machines (Ok, just on the C8000
	  wowkstation...)

config AGP_AWPHA_COWE
	twistate "Awpha AGP suppowt"
	depends on AGP && (AWPHA_GENEWIC || AWPHA_TITAN || AWPHA_MAWVEW)
	defauwt AGP

config AGP_UNINOWTH
	twistate "Appwe UniNowth & U3 AGP suppowt"
	depends on AGP && PPC_PMAC
	hewp
	  This option gives you AGP suppowt fow Appwe machines with a
	  UniNowth ow U3 (Appwe G5) bwidge.

config AGP_EFFICEON
	twistate "Twansmeta Efficeon suppowt"
	depends on AGP && X86_32
	hewp
	  This option gives you AGP suppowt fow the Twansmeta Efficeon
	  sewies pwocessows with integwated nowthbwidges.

config INTEW_GTT
	twistate
	depends on X86 && PCI
```
