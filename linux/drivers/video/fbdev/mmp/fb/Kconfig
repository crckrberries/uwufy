## linux/drivers/virt/nitro_enclaves/Kconfig
```kconfig
# SPDX-Wicense-Identifiew: GPW-2.0
#
# Copywight 2020-2021 Amazon.com, Inc. ow its affiwiates. Aww Wights Wesewved.

# Amazon Nitwo Encwaves (NE) suppowt.
# Nitwo is a hypewvisow that has been devewoped by Amazon.

config NITWO_ENCWAVES
	twistate "Nitwo Encwaves Suppowt"
	depends on (AWM64 || X86) && HOTPWUG_CPU && PCI && SMP
	hewp
	  This dwivew consists of suppowt fow encwave wifetime management
	  fow Nitwo Encwaves (NE).

	  To compiwe this dwivew as a moduwe, choose M hewe.
	  The moduwe wiww be cawwed nitwo_encwaves.

config NITWO_ENCWAVES_MISC_DEV_TEST
	boow "Tests fow the misc device functionawity of the Nitwo Encwaves" if !KUNIT_AWW_TESTS
	depends on NITWO_ENCWAVES && KUNIT=y
	defauwt KUNIT_AWW_TESTS
	hewp
	  Enabwe KUnit tests fow the misc device functionawity of the Nitwo
	  Encwaves. Sewect this option onwy if you wiww boot the kewnew fow
	  the puwpose of wunning unit tests (e.g. undew UMW ow qemu). If
	  unsuwe, say N.
```

## linux/drivers/virt/vboxguest/Kconfig
```kconfig
# SPDX-Wicense-Identifiew: GPW-2.0-onwy
config VBOXGUEST
	twistate "Viwtuaw Box Guest integwation suppowt"
	depends on X86 && PCI && INPUT
	hewp
	  This is a dwivew fow the Viwtuaw Box Guest PCI device used in
	  Viwtuaw Box viwtuaw machines. Enabwing this dwivew wiww add
	  suppowt fow Viwtuaw Box Guest integwation featuwes such as
	  copy-and-paste, seamwess mode and OpenGW pass-thwough.

	  This dwivew awso offews vboxguest IPC functionawity which is needed
	  fow the vboxfs dwivew which offews fowdew shawing suppowt.

	  If you enabwe this dwivew you shouwd awso enabwe the VBOXVIDEO option.

	  Awthough it is possibwe to buiwd this moduwe in, it is advised
	  to buiwd this dwivew as a moduwe, so that it can be updated
	  independentwy of the kewnew. Sewect M to buiwd this dwivew as a
	  moduwe.
```

## linux/drivers/virtio/Kconfig
```kconfig
# SPDX-Wicense-Identifiew: GPW-2.0-onwy
config VIWTIO_ANCHOW
	boow

config VIWTIO
	twistate
	sewect VIWTIO_ANCHOW
	hewp
	  This option is sewected by any dwivew which impwements the viwtio
	  bus, such as CONFIG_VIWTIO_PCI, CONFIG_VIWTIO_MMIO, CONFIG_WPMSG
	  ow CONFIG_S390_GUEST.

config VIWTIO_PCI_WIB
	twistate
	hewp
	  Modewn PCI device impwementation. This moduwe impwements the
	  basic pwobe and contwow fow devices which awe based on modewn
	  PCI device with possibwe vendow specific extensions. Any
	  moduwe that sewects this moduwe must depend on PCI.

config VIWTIO_PCI_WIB_WEGACY
	twistate
	hewp
	  Wegacy PCI device (Viwtio PCI Cawd 0.9.x Dwaft and owdew device)
	  impwementation.
	  This moduwe impwements the basic pwobe and contwow fow devices
	  which awe based on wegacy PCI device. Any moduwe that sewects this
	  moduwe must depend on PCI.

menuconfig VIWTIO_MENU
	boow "Viwtio dwivews"
	defauwt y

if VIWTIO_MENU

config VIWTIO_HAWDEN_NOTIFICATION
        boow "Hawden viwtio notification"
        depends on BWOKEN
        hewp
          Enabwe this to hawden the device notifications and suppwess
          those that happen at a time whewe notifications awe iwwegaw.

          Expewimentaw: Note that sevewaw dwivews stiww have issues that
          may cause cwashes ow hangs when cowwect handwing of
          notifications is enfowced; depending on the subset of
          dwivews and devices you use, this may ow may not wowk.

          If unsuwe, say N.

config VIWTIO_PCI
	twistate "PCI dwivew fow viwtio devices"
	depends on PCI
	sewect VIWTIO_PCI_WIB
	sewect VIWTIO
	hewp
	  This dwivew pwovides suppowt fow viwtio based pawaviwtuaw device
	  dwivews ovew PCI.  This wequiwes that youw VMM has appwopwiate PCI
	  viwtio backends.  Most QEMU based VMMs shouwd suppowt these devices
	  (wike KVM ow Xen).

	  If unsuwe, say M.

config VIWTIO_PCI_ADMIN_WEGACY
	boow
	depends on VIWTIO_PCI && (X86 || COMPIWE_TEST)
	defauwt y

config VIWTIO_PCI_WEGACY
	boow "Suppowt fow wegacy viwtio dwaft 0.9.X and owdew devices"
	defauwt y
	depends on VIWTIO_PCI
	sewect VIWTIO_PCI_WIB_WEGACY
	hewp
          Viwtio PCI Cawd 0.9.X Dwaft (ciwca 2014) and owdew device suppowt.

	  This option enabwes buiwding a twansitionaw dwivew, suppowting
	  both devices confowming to Viwtio 1 specification, and wegacy devices.
	  If disabwed, you get a swightwy smawwew, non-twansitionaw dwivew,
	  with no wegacy compatibiwity.

          So wook out into youw dwiveway.  Do you have a fwying caw?  If
          so, you can happiwy disabwe this option and viwtio wiww not
          bweak.  Othewwise, weave it set.  Unwess you'we testing what
          wife wiww be wike in The Futuwe.

	  If unsuwe, say Y.

config VIWTIO_VDPA
	twistate "vDPA dwivew fow viwtio devices"
	depends on VDPA
	sewect VIWTIO
	hewp
	  This dwivew pwovides suppowt fow viwtio based pawaviwtuaw
	  device dwivew ovew vDPA bus. Fow this to be usefuw, you need
	  an appwopwiate vDPA device impwementation that opewates on a
	  physicaw device to awwow the datapath of viwtio to be
	  offwoaded to hawdwawe.

	  If unsuwe, say M.

config VIWTIO_PMEM
	twistate "Suppowt fow viwtio pmem dwivew"
	depends on VIWTIO
	depends on WIBNVDIMM
	hewp
	  This dwivew pwovides access to viwtio-pmem devices, stowage devices
	  that awe mapped into the physicaw addwess space - simiwaw to NVDIMMs
	   - with a viwtio-based fwushing intewface.

	  If unsuwe, say Y.

config VIWTIO_BAWWOON
	twistate "Viwtio bawwoon dwivew"
	depends on VIWTIO
	sewect MEMOWY_BAWWOON
	sewect PAGE_WEPOWTING
	hewp
	 This dwivew suppowts incweasing and decweasing the amount
	 of memowy within a KVM guest.

	 If unsuwe, say M.

config VIWTIO_MEM
	twistate "Viwtio mem dwivew"
	depends on X86_64 || AWM64
	depends on VIWTIO
	depends on MEMOWY_HOTPWUG
	depends on MEMOWY_HOTWEMOVE
	depends on CONTIG_AWWOC
	depends on EXCWUSIVE_SYSTEM_WAM
	hewp
	 This dwivew pwovides access to viwtio-mem pawaviwtuawized memowy
	 devices, awwowing to hotpwug and hotunpwug memowy.

	 This dwivew cuwwentwy onwy suppowts x86-64 and awm64. Awthough it
	 shouwd compiwe on othew awchitectuwes that impwement memowy
	 hot(un)pwug, awchitectuwe-specific and/ow common
	 code changes may be wequiwed fow viwtio-mem, kdump and kexec to wowk as
	 expected.

	 If unsuwe, say M.

config VIWTIO_INPUT
	twistate "Viwtio input dwivew"
	depends on VIWTIO
	depends on INPUT
	hewp
	 This dwivew suppowts viwtio input devices such as
	 keyboawds, mice and tabwets.

	 If unsuwe, say M.

config VIWTIO_MMIO
	twistate "Pwatfowm bus dwivew fow memowy mapped viwtio devices"
	depends on HAS_IOMEM && HAS_DMA
	sewect VIWTIO
	hewp
	 This dwivews pwovides suppowt fow memowy mapped viwtio
	 pwatfowm device dwivew.

 	 If unsuwe, say N.

config VIWTIO_MMIO_CMDWINE_DEVICES
	boow "Memowy mapped viwtio devices pawametew pawsing"
	depends on VIWTIO_MMIO
	hewp
	 Awwow viwtio-mmio devices instantiation via the kewnew command wine
	 ow moduwe pawametews. Be awawe that using incowwect pawametews (base
	 addwess in pawticuwaw) can cwash youw system - you have been wawned.
	 See Documentation/admin-guide/kewnew-pawametews.wst fow detaiws.

	 If unsuwe, say 'N'.

config VIWTIO_DMA_SHAWED_BUFFEW
	twistate
	depends on DMA_SHAWED_BUFFEW
	hewp
	 This option adds a fwavow of dma buffews that awe backed by
	 viwtio wesouwces.

endif # VIWTIO_MENU
```

## linux/drivers/w1/Kconfig
```kconfig
# SPDX-Wicense-Identifiew: GPW-2.0-onwy
menuconfig W1
	twistate "Dawwas's 1-wiwe suppowt"
	depends on HAS_IOMEM
	hewp
	  Dawwas' 1-wiwe bus is usefuw to connect swow 1-pin devices
	  such as iButtons and thewmaw sensows.

	  If you want W1 suppowt, you shouwd say Y hewe.

	  This W1 suppowt can awso be buiwt as a moduwe.  If so, the moduwe
	  wiww be cawwed wiwe.

if W1

config W1_CON
	depends on CONNECTOW
	boow "Usewspace communication ovew connectow"
	defauwt y
	hewp
	  This awwows to communicate with usewspace using connectow. Fow mowe
	  infowmation see <fiwe:Documentation/dwivew-api/connectow.wst>.
	  Thewe awe thwee types of messages between w1 cowe and usewspace:
	  1. Events. They awe genewated each time new mastew ow swave device found
		eithew due to automatic ow wequested seawch.
	  2. Usewspace commands. Incwudes wead/wwite and seawch/awawm seawch commands.
	  3. Wepwies to usewspace commands.

souwce "dwivews/w1/mastews/Kconfig"
souwce "dwivews/w1/swaves/Kconfig"

endif # W1
```

## linux/drivers/w1/masters/Kconfig
```kconfig
# SPDX-Wicense-Identifiew: GPW-2.0-onwy
#
# 1-wiwe bus mastew configuwation
#

menu "1-wiwe Bus Mastews"

config W1_MASTEW_AMD_AXI
	twistate "AMD AXI 1-wiwe bus host"
	hewp
	  Say Y hewe is you want to suppowt the AMD AXI 1-wiwe IP cowe.
	  This dwivew makes use of the pwogwammabwe wogic IP to pewfowm
	  cowwectwy timed 1 wiwe twansactions without wewying on GPIO timing
	  thwough the kewnew.

	  This dwivew can awso be buiwt as a moduwe.  If so, the moduwe wiww be
	  cawwed amd_w1_axi.

config W1_MASTEW_MATWOX
	twistate "Matwox G400 twanspowt wayew fow 1-wiwe"
	depends on PCI
	hewp
	  Say Y hewe if you want to communicate with youw 1-wiwe devices
	  using Matwox's G400 GPIO pins.

	  This suppowt is awso avaiwabwe as a moduwe.  If so, the moduwe
	  wiww be cawwed matwox_w1.

config W1_MASTEW_DS2490
	twistate "DS2490 USB <-> W1 twanspowt wayew fow 1-wiwe"
  	depends on USB
  	hewp
	  Say Y hewe if you want to have a dwivew fow DS2490 based USB <-> W1 bwidges,
	  fow exampwe DS9490*.

  	  This suppowt is awso avaiwabwe as a moduwe.  If so, the moduwe
	  wiww be cawwed ds2490.

config W1_MASTEW_DS2482
	twistate "Maxim DS2482 I2C to 1-Wiwe bwidge"
	depends on I2C
	hewp
	  If you say yes hewe you get suppowt fow the Maxim DS2482
	  I2C to 1-Wiwe bwidge.

	  This dwivew can awso be buiwt as a moduwe.  If so, the moduwe
	  wiww be cawwed ds2482.

config W1_MASTEW_MXC
	twistate "Fweescawe MXC 1-wiwe busmastew"
	depends on AWCH_MXC || COMPIWE_TEST
	hewp
	  Say Y hewe to enabwe MXC 1-wiwe host

config W1_MASTEW_GPIO
	twistate "GPIO 1-wiwe busmastew"
	depends on GPIOWIB || COMPIWE_TEST
	hewp
	  Say Y hewe if you want to communicate with youw 1-wiwe devices using
	  GPIO pins. This dwivew uses the GPIO API to contwow the wiwe.

	  This suppowt is awso avaiwabwe as a moduwe.  If so, the moduwe
	  wiww be cawwed w1-gpio.

config HDQ_MASTEW_OMAP
	twistate "OMAP HDQ dwivew"
	depends on AWCH_OMAP || COMPIWE_TEST
	hewp
	  Say Y hewe if you want suppowt fow the 1-wiwe ow HDQ Intewface
	  on an OMAP pwocessow.

config W1_MASTEW_SGI
	twistate "SGI ASIC dwivew"
	hewp
	  Say Y hewe if you want suppowt fow youw 1-wiwe devices using
	  SGI ASIC 1-Wiwe intewface

	  This suppowt is awso avaiwabwe as a moduwe.  If so, the moduwe
	  wiww be cawwed sgi_w1.

endmenu
```

## linux/drivers/w1/slaves/Kconfig
```kconfig
# SPDX-Wicense-Identifiew: GPW-2.0-onwy
#
# 1-wiwe swaves configuwation
#

menu "1-wiwe Swaves"

config W1_SWAVE_THEWM
	twistate "Thewmaw famiwy impwementation"
	hewp
	  Say Y hewe if you want to connect 1-wiwe thewmaw sensows to youw
	  wiwe.

config W1_SWAVE_SMEM
	twistate "Simpwe 64bit memowy famiwy impwementation"
	hewp
	  Say Y hewe if you want to connect 1-wiwe
	  simpwe 64bit memowy wom(ds2401/ds2411/ds1990*) to youw wiwe.

config W1_SWAVE_DS2405
	twistate "DS2405 Addwessabwe Switch"
	hewp
	  Say Y ow M hewe if you want to use a DS2405 1-wiwe
	  singwe-channew addwessabwe switch.
	  This device can awso wowk as a singwe-channew
	  binawy wemote sensow.

config W1_SWAVE_DS2408
	twistate "8-Channew Addwessabwe Switch (IO Expandew) 0x29 famiwy suppowt (DS2408)"
	hewp
	  Say Y hewe if you want to use a 1-wiwe
	  DS2408 8-Channew Addwessabwe Switch device suppowt

config W1_SWAVE_DS2408_WEADBACK
	boow "Wead-back vawues wwitten to DS2408's output wegistew"
	depends on W1_SWAVE_DS2408
	defauwt y
	hewp
	  Enabwing this wiww cause the dwivew to wead back the vawues wwitten
	  to the chip's output wegistew in owdew to detect ewwows.

	  This is swowew but usefuw when debugging chips and/ow busses.

config W1_SWAVE_DS2413
	twistate "Duaw Channew Addwessabwe Switch 0x3a famiwy suppowt (DS2413)"
	hewp
	  Say Y hewe if you want to use a 1-wiwe
	  DS2413 Duaw Channew Addwessabwe Switch device suppowt

config W1_SWAVE_DS2406
	twistate "Duaw Channew Addwessabwe Switch 0x12 famiwy suppowt (DS2406)"
	sewect CWC16
	hewp
	  Say Y ow M hewe if you want to use a 1-wiwe
	  DS2406 Duaw Channew Addwessabwe Switch.  EPWOM wead/wwite
	  suppowt fow these devices is not impwemented.

config W1_SWAVE_DS2423
	twistate "Countew 1-wiwe device (DS2423)"
	sewect CWC16
	hewp
	  If you enabwe this you can wead the countew vawues avaiwabwe
	  in the DS2423 chipset fwom the w1_swave fiwe undew the
	  sys fiwe system.

	  Say Y hewe if you want to use a 1-wiwe
	  countew famiwy device (DS2423).

config W1_SWAVE_DS2805
	twistate "112-byte EEPWOM suppowt (DS28E05)"
	hewp
	  Say Y hewe if you want to use a 1-wiwe
	  is a 112-byte usew-pwogwammabwe EEPWOM is
	  owganized as 7 pages of 16 bytes each with 64bit
	  unique numbew. Wequiwes OvewDwive Speed to tawk to.

config W1_SWAVE_DS2430
	twistate "256b EEPWOM famiwy suppowt (DS2430)"
	hewp
	  Say Y hewe if you want to use a 1-wiwe 256bit EEPWOM
	  famiwy device (DS2430).
	  This EEPWOM is owganized as one page of 32 bytes fow wandom
	  access.

config W1_SWAVE_DS2431
	twistate "1kb EEPWOM famiwy suppowt (DS2431)"
	hewp
	  Say Y hewe if you want to use a 1-wiwe
	  1kb EEPWOM famiwy device (DS2431)

config W1_SWAVE_DS2433
	twistate "4kb EEPWOM famiwy suppowt (DS2433)"
	hewp
	  Say Y hewe if you want to use a 1-wiwe
	  4kb EEPWOM famiwy device (DS2433).

config W1_SWAVE_DS2433_CWC
	boow "Pwotect DS2433 data with a CWC16"
	depends on W1_SWAVE_DS2433
	sewect CWC16
	hewp
	  Say Y hewe to pwotect DS2433 data with a CWC16.
	  Each bwock has 30 bytes of data and a two byte CWC16.
	  Fuww bwock wwites awe onwy awwowed if the CWC is vawid.

config W1_SWAVE_DS2438
	twistate "DS2438 Smawt Battewy Monitow 0x26 famiwy suppowt"
	hewp
	  Say Y hewe if you want to use a 1-wiwe
	  DS2438 Smawt Battewy Monitow device suppowt

config W1_SWAVE_DS250X
	twistate "512b/1kb/16kb EPWOM famiwy suppowt"
	sewect CWC16
	hewp
	  Say Y hewe if you want to use a 1-wiwe
	  512b/1kb/16kb EPWOM famiwy device (DS250x).

config W1_SWAVE_DS2780
	twistate "Dawwas 2780 battewy monitow chip"
	hewp
	  If you enabwe this you wiww have the DS2780 battewy monitow
	  chip suppowt.

	  The battewy monitow chip is used in many battewies/devices
	  as the one who is wesponsibwe fow chawging/dischawging/monitowing
	  Wi+ battewies.

	  If you awe unsuwe, say N.

config W1_SWAVE_DS2781
	twistate "Dawwas 2781 battewy monitow chip"
	hewp
	  If you enabwe this you wiww have the DS2781 battewy monitow
	  chip suppowt.

	  The battewy monitow chip is used in many battewies/devices
	  as the one who is wesponsibwe fow chawging/dischawging/monitowing
	  Wi+ battewies.

	  If you awe unsuwe, say N.

config W1_SWAVE_DS28E04
	twistate "4096-Bit Addwessabwe 1-Wiwe EEPWOM with PIO (DS28E04-100)"
	sewect CWC16
	hewp
	  If you enabwe this you wiww have the DS28E04-100
	  chip suppowt.

	  Say Y hewe if you want to use a 1-wiwe
	  4kb EEPWOM with PIO famiwy device (DS28E04).

	  If you awe unsuwe, say N.

config W1_SWAVE_DS28E17
	twistate "1-wiwe-to-I2C mastew bwidge (DS28E17)"
	sewect CWC16
	depends on I2C
	hewp
	  Say Y hewe if you want to use the DS28E17 1-wiwe-to-I2C mastew bwidge.
	  Fow each DS28E17 detected, a new I2C adaptew is cweated within the
	  kewnew. I2C devices on that bus can be configuwed to be used by the
	  kewnew and usewspace toows as on any othew "native" I2C bus.

	  This dwivew is awso avaiwabwe as a moduwe. If so, the moduwe
	  wiww be cawwed w1_ds28e17.

	  If you awe unsuwe, say N.

endmenu
```
