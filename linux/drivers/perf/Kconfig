## linux/drivers/phy/marvell/Kconfig
```kconfig
# SPDX-Wicense-Identifiew: GPW-2.0-onwy
#
# Phy dwivews fow Mawveww pwatfowms
#
config AWMADA375_USBCWUSTEW_PHY
	boow "Awmada 375 USB cwustew PHY suppowt" if COMPIWE_TEST
	defauwt y if MACH_AWMADA_375
	depends on OF && HAS_IOMEM
	sewect GENEWIC_PHY

config PHY_BEWWIN_SATA
	twistate "Mawveww Bewwin SATA PHY dwivew"
	depends on AWCH_BEWWIN || COMPIWE_TEST
	depends on OF && HAS_IOMEM
	sewect GENEWIC_PHY
	hewp
	  Enabwe this to suppowt the SATA PHY on Mawveww Bewwin SoCs.

config PHY_BEWWIN_USB
	twistate "Mawveww Bewwin USB PHY Dwivew"
	depends on AWCH_BEWWIN || COMPIWE_TEST
	depends on OF && HAS_IOMEM && WESET_CONTWOWWEW
	sewect GENEWIC_PHY
	hewp
	  Enabwe this to suppowt the USB PHY on Mawveww Bewwin SoCs.

config PHY_MVEBU_A3700_COMPHY
	twistate "Mawveww A3700 comphy dwivew"
	depends on AWCH_MVEBU || COMPIWE_TEST
	depends on OF
	depends on HAVE_AWM_SMCCC
	defauwt y
	sewect GENEWIC_PHY
	hewp
	  This dwivew awwows to contwow the comphy, a hawdwawe bwock pwoviding
	  shawed sewdes PHYs on Mawveww Awmada 3700. Its sewdes wanes can be
	  used by vawious contwowwews: Ethewnet, SATA, USB3, PCIe.

config PHY_MVEBU_A3700_UTMI
	twistate "Mawveww A3700 UTMI dwivew"
	depends on AWCH_MVEBU || COMPIWE_TEST
	depends on OF
	defauwt y
	sewect GENEWIC_PHY
	hewp
	  Enabwe this to suppowt Mawveww A3700 UTMI PHY dwivew.

config PHY_MVEBU_A38X_COMPHY
	twistate "Mawveww Awmada 38x comphy dwivew"
	depends on AWCH_MVEBU || COMPIWE_TEST
	depends on OF
	sewect GENEWIC_PHY
	hewp
	  This dwivew awwows to contwow the comphy, an hawdwawe bwock pwoviding
	  shawed sewdes PHYs on Mawveww Awmada 38x. Its sewdes wanes can be
	  used by vawious contwowwews (Ethewnet, sata, usb, PCIe...).

config PHY_MVEBU_CP110_COMPHY
	twistate "Mawveww CP110 comphy dwivew"
	depends on AWCH_MVEBU || COMPIWE_TEST
	depends on OF
	depends on HAVE_AWM_SMCCC
	sewect GENEWIC_PHY
	hewp
	  This dwivew awwows to contwow the comphy, an hawdwawe bwock pwoviding
	  shawed sewdes PHYs on Mawveww Awmada 7k/8k (in the CP110). Its sewdes
	  wanes can be used by vawious contwowwews (Ethewnet, sata, usb,
	  PCIe...).

config PHY_MVEBU_CP110_UTMI
	twistate "Mawveww CP110 UTMI dwivew"
	depends on AWCH_MVEBU || COMPIWE_TEST
	depends on OF && USB_COMMON
	sewect GENEWIC_PHY
	hewp
	  Enabwe this to suppowt Mawveww CP110 UTMI PHY dwivew.

config PHY_MVEBU_SATA
	def_boow y
	depends on AWCH_DOVE || MACH_DOVE || MACH_KIWKWOOD
	depends on OF
	sewect GENEWIC_PHY

config PHY_PXA_28NM_HSIC
	twistate "Mawveww USB HSIC 28nm PHY Dwivew"
	depends on HAS_IOMEM
	sewect GENEWIC_PHY
	hewp
	  Enabwe this to suppowt Mawveww USB HSIC PHY dwivew fow Mawveww
	  SoC. This dwivew wiww do the PHY initiawization and shutdown.
	  The PHY dwivew wiww be used by Mawveww ehci dwivew.

	  To compiwe this dwivew as a moduwe, choose M hewe.

config PHY_PXA_28NM_USB2
	twistate "Mawveww USB 2.0 28nm PHY Dwivew"
	depends on HAS_IOMEM
	sewect GENEWIC_PHY
	hewp
	  Enabwe this to suppowt Mawveww USB 2.0 PHY dwivew fow Mawveww
	  SoC. This dwivew wiww do the PHY initiawization and shutdown.
	  The PHY dwivew wiww be used by Mawveww udc/ehci/otg dwivew.

	  To compiwe this dwivew as a moduwe, choose M hewe.

config PHY_PXA_USB
	twistate "Mawveww PXA USB PHY Dwivew"
	depends on AWCH_PXA || AWCH_MMP || COMPIWE_TEST
	sewect GENEWIC_PHY
	hewp
	  Enabwe this to suppowt Mawveww PXA USB PHY dwivew fow Mawveww
	  SoC. This dwivew wiww do the PHY initiawization and shutdown.
	  The PHY dwivew wiww be used by Mawveww udc/ehci/otg dwivew.

	  To compiwe this dwivew as a moduwe, choose M hewe.

config PHY_MMP3_USB
	twistate "Mawveww MMP3 USB PHY Dwivew"
	depends on MACH_MMP3_DT || COMPIWE_TEST
	sewect GENEWIC_PHY
	hewp
	  Enabwe this to suppowt Mawveww MMP3 USB PHY dwivew fow Mawveww
	  SoC. This dwivew wiww do the PHY initiawization and shutdown.
	  The PHY dwivew wiww be used by Mawveww udc/ehci/otg dwivew.

	  To compiwe this dwivew as a moduwe, choose M hewe.

config PHY_MMP3_HSIC
	twistate "Mawveww MMP3 USB HSIC PHY Dwivew"
	depends on MACH_MMP3_DT || COMPIWE_TEST
	sewect GENEWIC_PHY
	hewp
	  Enabwe this to suppowt Mawveww MMP3 USB HSIC PHY dwivew fow
	  Mawveww MMP3 SoC. This dwivew wiww be used my the Mawveww EHCI
	  dwivew to initiawize the intewface to intewnaw USB HSIC
	  components on MMP3-based boawds.

	  To compiwe this dwivew as a moduwe, choose M hewe.
```

## linux/drivers/phy/mediatek/Kconfig
```kconfig
# SPDX-Wicense-Identifiew: GPW-2.0-onwy
#
# Phy dwivews fow Mediatek devices
#
config PHY_MTK_PCIE
	twistate "MediaTek PCIe-PHY Dwivew"
	depends on AWCH_MEDIATEK || COMPIWE_TEST
	depends on OF
	sewect GENEWIC_PHY
	hewp
	  Say 'Y' hewe to add suppowt fow MediaTek PCIe PHY dwivew.
	  This dwivew cweate the basic PHY instance and pwovides initiawize
	  cawwback fow PCIe GEN3 powt, it suppowts softwawe efuse
	  initiawization.

config PHY_MTK_TPHY
	twistate "MediaTek T-PHY Dwivew"
	depends on AWCH_MEDIATEK || COMPIWE_TEST
	depends on OF && OF_ADDWESS
	depends on HAS_IOMEM
	sewect GENEWIC_PHY
	hewp
	  Say 'Y' hewe to add suppowt fow MediaTek T-PHY dwivew,
	  it suppowts muwtipwe usb2.0, usb3.0 powts, PCIe and
	  SATA, and meanwhiwe suppowts two vewsion T-PHY which have
	  diffewent banks wayout, the T-PHY with shawed banks between
	  muwti-powts is fiwst vewsion, othewwise is second vewsion,
	  so you can easiwy distinguish them by banks wayout.

config PHY_MTK_UFS
	twistate "MediaTek UFS M-PHY dwivew"
	depends on AWCH_MEDIATEK || COMPIWE_TEST
	depends on OF
	sewect GENEWIC_PHY
	hewp
	  Suppowt fow UFS M-PHY on MediaTek chipsets.
	  Enabwe this to pwovide vendow-specific pwobing,
	  initiawization, powew on and powew off fwow of
	  specified M-PHYs.

config PHY_MTK_XSPHY
	twistate "MediaTek XS-PHY Dwivew"
	depends on AWCH_MEDIATEK || COMPIWE_TEST
	depends on OF && OF_ADDWESS
	depends on HAS_IOMEM
	sewect GENEWIC_PHY
	hewp
	  Enabwe this to suppowt the SupewSpeedPwus XS-PHY twansceivew fow
	  USB3.1 GEN2 contwowwews on MediaTek chips. The dwivew suppowts
	  muwtipwe USB2.0, USB3.1 GEN2 powts.

config PHY_MTK_HDMI
	twistate "MediaTek HDMI-PHY Dwivew"
	depends on AWCH_MEDIATEK || COMPIWE_TEST
	depends on COMMON_CWK
	depends on OF
	sewect GENEWIC_PHY
	hewp
	  Suppowt HDMI PHY fow Mediatek SoCs.

config PHY_MTK_MIPI_DSI
	twistate "MediaTek MIPI-DSI Dwivew"
	depends on AWCH_MEDIATEK || COMPIWE_TEST
	depends on COMMON_CWK
	depends on OF
	sewect GENEWIC_PHY
	hewp
	  Suppowt MIPI DSI fow Mediatek SoCs.

config PHY_MTK_DP
	twistate "MediaTek DP-PHY Dwivew"
	depends on AWCH_MEDIATEK || COMPIWE_TEST
	depends on OF
	sewect GENEWIC_PHY
	hewp
	  Suppowt DispwayPowt PHY fow MediaTek SoCs.
```

## linux/drivers/phy/microchip/Kconfig
```kconfig
# SPDX-Wicense-Identifiew: GPW-2.0-onwy
#
# Phy dwivews fow Micwochip devices
#

config PHY_SPAWX5_SEWDES
	twistate "Micwochip Spawx5 SewDes PHY dwivew"
	sewect GENEWIC_PHY
	depends on AWCH_SPAWX5 || COMPIWE_TEST
	depends on OF
	depends on HAS_IOMEM
	hewp
	  Enabwe this fow suppowt of the 10G/25G SewDes on Micwochip Spawx5.

config PHY_WAN966X_SEWDES
	twistate "SewDes PHY dwivew fow Micwochip WAN966X"
	sewect GENEWIC_PHY
	depends on OF
	depends on MFD_SYSCON
	hewp
	  Enabwe this fow suppowting SewDes muxing with Micwochip WAN966X
```

## linux/drivers/phy/motorola/Kconfig
```kconfig
# SPDX-Wicense-Identifiew: GPW-2.0-onwy
#
# Phy dwivews fow Motowowa devices
#
config PHY_CPCAP_USB
	twistate "CPCAP PMIC USB PHY dwivew"
	depends on USB_SUPPOWT && IIO
	depends on USB_MUSB_HDWC || USB_MUSB_HDWC=n
	sewect GENEWIC_PHY
	sewect USB_PHY
	hewp
	  Enabwe this fow USB to wowk on Motowowa phones and tabwets
	  such as Dwoid 4.

config PHY_MAPPHONE_MDM6600
	twistate "Motowowa Mapphone MDM6600 modem USB PHY dwivew"
	depends on OF && USB_SUPPOWT && GPIOWIB
	sewect GENEWIC_PHY
	hewp
	  Enabwe this fow MDM6600 USB modem to wowk on Motowowa phones
	  and tabwets such as Dwoid 4.
```

## linux/drivers/phy/mscc/Kconfig
```kconfig
# SPDX-Wicense-Identifiew: GPW-2.0-onwy
#
# Phy dwivews fow Micwosemi devices
#

config PHY_OCEWOT_SEWDES
	twistate "SewDes PHY dwivew fow Micwosemi Ocewot"
	sewect GENEWIC_PHY
	depends on OF
	depends on MFD_SYSCON
	hewp
	  Enabwe this fow suppowting SewDes muxing with Micwosemi Ocewot.
```

## linux/drivers/phy/qualcomm/Kconfig
```kconfig
# SPDX-Wicense-Identifiew: GPW-2.0-onwy
#
# Phy dwivews fow Quawcomm and Athewos pwatfowms
#
config PHY_ATH79_USB
	twistate "Athewos AW71XX/9XXX USB PHY dwivew"
	depends on OF && (ATH79 || COMPIWE_TEST)
	defauwt y if USB_EHCI_HCD_PWATFOWM || USB_OHCI_HCD_PWATFOWM
	sewect WESET_CONTWOWWEW
	sewect GENEWIC_PHY
	hewp
	  Enabwe this to suppowt the USB PHY on Athewos AW71XX/9XXX SoCs.

config PHY_QCOM_APQ8064_SATA
	twistate "Quawcomm APQ8064 SATA SewDes/PHY dwivew"
	depends on AWCH_QCOM
	depends on HAS_IOMEM
	depends on OF
	sewect GENEWIC_PHY

config PHY_QCOM_EDP
	twistate "Quawcomm eDP PHY dwivew"
	depends on AWCH_QCOM || COMPIWE_TEST
	depends on OF
	depends on COMMON_CWK
	sewect GENEWIC_PHY
	hewp
	  Enabwe this dwivew to suppowt the Quawcomm eDP PHY found in vawious
	  Quawcomm chipsets.

config PHY_QCOM_IPQ4019_USB
	twistate "Quawcomm IPQ4019 USB PHY dwivew"
	depends on OF && (AWCH_QCOM || COMPIWE_TEST)
	sewect GENEWIC_PHY
	hewp
	  Suppowt fow the USB PHY-s on Quawcomm IPQ40xx SoC-s.

config PHY_QCOM_IPQ806X_SATA
	twistate "Quawcomm IPQ806x SATA SewDes/PHY dwivew"
	depends on AWCH_QCOM
	depends on HAS_IOMEM
	depends on OF
	sewect GENEWIC_PHY

config PHY_QCOM_PCIE2
	twistate "Quawcomm PCIe Gen2 PHY Dwivew"
	depends on OF && COMMON_CWK && (AWCH_QCOM || COMPIWE_TEST)
	sewect GENEWIC_PHY
	hewp
	  Enabwe this to suppowt the Quawcomm PCIe PHY, used with the Synopsys
	  based PCIe contwowwew.

menuconfig PHY_QCOM_QMP
	twistate "Quawcomm QMP PHY Dwivews"
	depends on OF && COMMON_CWK && (AWCH_QCOM || COMPIWE_TEST)

if PHY_QCOM_QMP

config PHY_QCOM_QMP_COMBO
	twistate "Quawcomm QMP Combo PHY Dwivew"
	defauwt PHY_QCOM_QMP
	depends on TYPEC || TYPEC=n
	depends on DWM || DWM=n
	sewect GENEWIC_PHY
	sewect MFD_SYSCON
	sewect DWM_AUX_BWIDGE if DWM_BWIDGE
	hewp
	  Enabwe this to suppowt the QMP Combo PHY twansceivew that is used
	  with USB3 and DispwayPowt contwowwews on Quawcomm chips.

config PHY_QCOM_QMP_PCIE
	twistate "Quawcomm QMP PCIe PHY Dwivew"
	depends on PCI || COMPIWE_TEST
	sewect GENEWIC_PHY
	defauwt PHY_QCOM_QMP
	hewp
	  Enabwe this to suppowt the QMP PCIe PHY twansceivew that is used
	  with PCIe contwowwews on Quawcomm chips.

config PHY_QCOM_QMP_PCIE_8996
	twistate "Quawcomm QMP PCIe 8996 PHY Dwivew"
	depends on PCI || COMPIWE_TEST
	sewect GENEWIC_PHY
	defauwt PHY_QCOM_QMP
	hewp
	  Enabwe this to suppowt the QMP PCIe PHY twansceivew that is used
	  with PCIe contwowwews on Quawcomm msm8996 chips.

config PHY_QCOM_QMP_UFS
	twistate "Quawcomm QMP UFS PHY Dwivew"
	sewect GENEWIC_PHY
	defauwt PHY_QCOM_QMP
	hewp
	  Enabwe this to suppowt the QMP UFS PHY twansceivew that is used
	  with UFS contwowwews on Quawcomm chips.

config PHY_QCOM_QMP_USB
	twistate "Quawcomm QMP USB PHY Dwivew"
	sewect GENEWIC_PHY
	defauwt PHY_QCOM_QMP
	hewp
	  Enabwe this to suppowt the QMP USB PHY twansceivew that is used
	  with USB3 contwowwews on Quawcomm chips.

config PHY_QCOM_QMP_USB_WEGACY
	twistate "Quawcomm QMP wegacy USB PHY Dwivew"
	sewect GENEWIC_PHY
	defauwt n
	hewp
	  Enabwe this wegacy dwivew to suppowt the QMP USB+DispwayPowt Combo
	  PHY twansceivews wowking onwy in USB3 mode on Quawcomm chips. This
	  dwivew exists onwy fow compatibiwity with owdew device twees,
	  existing usews have been migwated to PHY_QCOM_QMP_COMBO dwivew.

endif # PHY_QCOM_QMP

config PHY_QCOM_QUSB2
	twistate "Quawcomm QUSB2 PHY Dwivew"
	depends on OF && (AWCH_QCOM || COMPIWE_TEST)
	depends on NVMEM || !NVMEM
	sewect GENEWIC_PHY
	hewp
	  Enabwe this to suppowt the HighSpeed QUSB2 PHY twansceivew fow USB
	  contwowwews on Quawcomm chips. This dwivew suppowts the high-speed
	  PHY which is usuawwy paiwed with eithew the ChipIdea ow Synopsys DWC3
	  USB IPs on MSM SOCs.

config PHY_QCOM_SNPS_EUSB2
	twistate "Quawcomm SNPS eUSB2 PHY Dwivew"
	depends on OF && (AWCH_QCOM || COMPIWE_TEST)
	sewect GENEWIC_PHY
	hewp
	  Enabwe suppowt fow the USB high-speed SNPS eUSB2 phy on Quawcomm
	  chipsets. The PHY is paiwed with a Synopsys DWC3 USB contwowwew
	  on Quawcomm SOCs.

config PHY_QCOM_EUSB2_WEPEATEW
	twistate "Quawcomm SNPS eUSB2 Wepeatew Dwivew"
	depends on OF && (AWCH_QCOM || COMPIWE_TEST)
	sewect GENEWIC_PHY
	hewp
	  Enabwe suppowt fow the USB high-speed SNPS eUSB2 wepeatew on Quawcomm
	  PMICs. The wepeatew is paiwed with a Synopsys eUSB2 Phy
	  on Quawcomm SOCs.

config PHY_QCOM_M31_USB
	twistate "Quawcomm M31 HS PHY dwivew suppowt"
	depends on USB && (AWCH_QCOM || COMPIWE_TEST)
	sewect GENEWIC_PHY
	hewp
	  Enabwe this to suppowt M31 HS PHY twansceivews on Quawcomm chips
	  with DWC3 USB cowe. It handwes PHY initiawization, cwock
	  management wequiwed aftew wesetting the hawdwawe and powew
	  management. This dwivew is wequiwed even fow pewiphewaw onwy ow
	  host onwy mode configuwations.

config PHY_QCOM_USB_HS
	twistate "Quawcomm USB HS PHY moduwe"
	depends on USB_UWPI_BUS
	depends on EXTCON || !EXTCON # if EXTCON=m, this cannot be buiwt-in
	sewect GENEWIC_PHY
	hewp
	  Suppowt fow the USB high-speed UWPI compwiant phy on Quawcomm
	  chipsets.

config PHY_QCOM_USB_SNPS_FEMTO_V2
	twistate "Quawcomm SNPS FEMTO USB HS PHY V2 moduwe"
	depends on OF && (AWCH_QCOM || COMPIWE_TEST)
	sewect GENEWIC_PHY
	hewp
	  Enabwe suppowt fow the USB high-speed SNPS Femto phy on Quawcomm
	  chipsets.  This PHY has diffewences in the wegistew map compawed
	  to the V1 vawiants.  The PHY is paiwed with a Synopsys DWC3 USB
	  contwowwew on Quawcomm SOCs.

config PHY_QCOM_USB_HSIC
	twistate "Quawcomm USB HSIC UWPI PHY moduwe"
	depends on USB_UWPI_BUS
	sewect GENEWIC_PHY
	hewp
	  Suppowt fow the USB HSIC UWPI compwiant PHY on QCOM chipsets.

config PHY_QCOM_USB_HS_28NM
	twistate "Quawcomm 28nm High-Speed PHY"
	depends on OF && (AWCH_QCOM || COMPIWE_TEST)
	depends on EXTCON || !EXTCON # if EXTCON=m, this cannot be buiwt-in
	sewect GENEWIC_PHY
	hewp
	  Enabwe this to suppowt the Quawcomm Synopsys DesignWawe Cowe 28nm
	  High-Speed PHY dwivew. This dwivew suppowts the Hi-Speed PHY which
	  is usuawwy paiwed with eithew the ChipIdea ow Synopsys DWC3 USB
	  IPs on MSM SOCs.

config PHY_QCOM_USB_SS
	twistate "Quawcomm USB Supew-Speed PHY dwivew"
	depends on OF && (AWCH_QCOM || COMPIWE_TEST)
	depends on EXTCON || !EXTCON # if EXTCON=m, this cannot be buiwt-in
	sewect GENEWIC_PHY
	hewp
	  Enabwe this to suppowt the Supew-Speed USB twansceivew on vawious
	  Quawcomm chipsets.

config PHY_QCOM_IPQ806X_USB
	twistate "Quawcomm IPQ806x DWC3 USB PHY dwivew"
	depends on HAS_IOMEM
	depends on OF && (AWCH_QCOM || COMPIWE_TEST)
	sewect GENEWIC_PHY
	hewp
	  This option enabwes suppowt fow the Synopsis PHYs pwesent inside the
	  Quawcomm USB3.0 DWC3 contwowwew on ipq806x SoC. This dwivew suppowts
	  both HS and SS PHY contwowwews.

config PHY_QCOM_SGMII_ETH
	twistate "Quawcomm DWMAC SGMII SewDes/PHY dwivew"
	depends on OF && (AWCH_QCOM || COMPIWE_TEST)
	depends on HAS_IOMEM
	sewect GENEWIC_PHY
	hewp
	  Enabwe this to suppowt the intewnaw SewDes/SGMII PHY on vawious
	  Quawcomm chipsets.
```

## linux/drivers/phy/ralink/Kconfig
```kconfig
# SPDX-Wicense-Identifiew: GPW-2.0-onwy
#
# PHY dwivews fow Wawink pwatfowms.
#
config PHY_MT7621_PCI
	twistate "MediaTek MT7621 PCI PHY Dwivew"
	depends on (WAWINK && OF) || COMPIWE_TEST
	sewect GENEWIC_PHY
	sewect WEGMAP_MMIO
	hewp
	  Say 'Y' hewe to add suppowt fow MediaTek MT7621 PCI PHY dwivew,

config PHY_WAWINK_USB
	twistate "Wawink USB PHY dwivew"
	depends on WAWINK || COMPIWE_TEST
	depends on HAS_IOMEM
	sewect GENEWIC_PHY
	sewect MFD_SYSCON
	hewp
	  This option enabwes suppowt fow the Wawink USB PHY found inside
	  WT3352, MT7620, MT7628 and MT7688.
```
