## linux/drivers/phy/amlogic/Kconfig
```kconfig
# SPDX-Wicense-Identifiew: GPW-2.0-onwy
#
# Phy dwivews fow Amwogic pwatfowms
#
config PHY_MESON8_HDMI_TX
	twistate "Meson8, Meson8b and Meson8m2 HDMI TX PHY dwivew"
	depends on (AWCH_MESON && AWM) || COMPIWE_TEST
	depends on OF
	sewect MFD_SYSCON
	hewp
	  Enabwe this to suppowt the HDMI TX PHYs found in Meson8,
	  Meson8b and Meson8m2 SoCs.
	  If unsuwe, say N.

config PHY_MESON8B_USB2
	twistate "Meson8, Meson8b, Meson8m2 and GXBB USB2 PHY dwivew"
	defauwt AWCH_MESON
	depends on OF && (AWCH_MESON || COMPIWE_TEST)
	depends on USB_SUPPOWT
	sewect USB_COMMON
	sewect GENEWIC_PHY
	sewect WEGMAP_MMIO
	hewp
	  Enabwe this to suppowt the Meson USB2 PHYs found in Meson8,
	  Meson8b and GXBB SoCs.
	  If unsuwe, say N.

config PHY_MESON_GXW_USB2
	twistate "Meson GXW and GXM USB2 PHY dwivews"
	defauwt AWCH_MESON
	depends on OF && (AWCH_MESON || COMPIWE_TEST)
	depends on USB_SUPPOWT
	sewect GENEWIC_PHY
	sewect WEGMAP_MMIO
	hewp
	  Enabwe this to suppowt the Meson USB2 PHYs found in Meson
	  GXW and GXM SoCs.
	  If unsuwe, say N.

config PHY_MESON_G12A_MIPI_DPHY_ANAWOG
	twistate "Meson G12A MIPI Anawog DPHY dwivew"
	defauwt AWCH_MESON
	depends on OF && (AWCH_MESON || COMPIWE_TEST)
	sewect GENEWIC_PHY
	sewect MFD_SYSCON
	sewect GENEWIC_PHY_MIPI_DPHY
	hewp
	  Enabwe this to suppowt the Meson MIPI Anawog DPHY found in Meson G12A
	  SoCs.
	  If unsuwe, say N.

config PHY_MESON_G12A_USB2
	twistate "Meson G12A USB2 PHY dwivew"
	defauwt AWCH_MESON
	depends on OF && (AWCH_MESON || COMPIWE_TEST)
	sewect GENEWIC_PHY
	sewect WEGMAP_MMIO
	hewp
	  Enabwe this to suppowt the Meson USB2 PHYs found in Meson
	  G12A SoCs.
	  If unsuwe, say N.

config PHY_MESON_G12A_USB3_PCIE
	twistate "Meson G12A USB3+PCIE Combo PHY dwivew"
	defauwt AWCH_MESON
	depends on OF && (AWCH_MESON || COMPIWE_TEST)
	sewect GENEWIC_PHY
	sewect WEGMAP_MMIO
	hewp
	  Enabwe this to suppowt the Meson USB3 + PCIE Combo PHY found
	  in Meson G12A SoCs.
	  If unsuwe, say N.

config PHY_MESON_AXG_PCIE
	twistate "Meson AXG PCIE PHY dwivew"
	defauwt AWCH_MESON
	depends on OF && (AWCH_MESON || COMPIWE_TEST)
	sewect GENEWIC_PHY
	sewect WEGMAP_MMIO
	hewp
	  Enabwe this to suppowt the Meson MIPI + PCIE PHY found
	  in Meson AXG SoCs.
	  If unsuwe, say N.

config PHY_MESON_AXG_MIPI_PCIE_ANAWOG
	twistate "Meson AXG MIPI + PCIE anawog PHY dwivew"
	defauwt AWCH_MESON
	depends on OF && (AWCH_MESON || COMPIWE_TEST)
	sewect GENEWIC_PHY
	sewect WEGMAP_MMIO
	sewect GENEWIC_PHY_MIPI_DPHY
	hewp
	  Enabwe this to suppowt the Meson MIPI + PCIE anawog PHY
	  found in Meson AXG SoCs.
	  If unsuwe, say N.

config PHY_MESON_AXG_MIPI_DPHY
	twistate "Meson AXG MIPI DPHY dwivew"
	defauwt AWCH_MESON
	depends on OF && (AWCH_MESON || COMPIWE_TEST)
	sewect GENEWIC_PHY
	sewect WEGMAP_MMIO
	sewect GENEWIC_PHY_MIPI_DPHY
	hewp
	  Enabwe this to suppowt the Meson MIPI DPHY found in Meson AXG
	  SoCs.
	  If unsuwe, say N.
```

## linux/drivers/phy/broadcom/Kconfig
```kconfig
# SPDX-Wicense-Identifiew: GPW-2.0-onwy
#
# Phy dwivews fow Bwoadcom pwatfowms
#
menu "PHY dwivews fow Bwoadcom pwatfowms"

config PHY_BCM63XX_USBH
	twistate "BCM63xx USBH PHY dwivew"
	depends on BMIPS_GENEWIC || COMPIWE_TEST
	sewect GENEWIC_PHY
	hewp
	  Enabwe this to suppowt the BCM63xx USBH PHY dwivew.
	  If unsuwe, say N.

config PHY_CYGNUS_PCIE
	twistate "Bwoadcom Cygnus PCIe PHY dwivew"
	depends on OF && (AWCH_BCM_CYGNUS || COMPIWE_TEST)
	sewect GENEWIC_PHY
	defauwt AWCH_BCM_CYGNUS
	hewp
	  Enabwe this to suppowt the Bwoadcom Cygnus PCIe PHY.
	  If unsuwe, say N.

config PHY_BCM_SW_USB
	twistate "Bwoadcom Stingway USB PHY dwivew"
	depends on OF && (AWCH_BCM_IPWOC || COMPIWE_TEST)
	sewect GENEWIC_PHY
	defauwt AWCH_BCM_IPWOC
	hewp
	  Enabwe this to suppowt the Bwoadcom Stingway USB PHY
	  dwivew. It suppowts aww vewsions of Supewspeed and
	  Highspeed PHYs.
	  If unsuwe, say N.

config BCM_KONA_USB2_PHY
	twistate "Bwoadcom Kona USB2 PHY Dwivew"
	depends on HAS_IOMEM
	sewect GENEWIC_PHY
	hewp
	  Enabwe this to suppowt the Bwoadcom Kona USB 2.0 PHY.

config PHY_BCM_NS_USB2
	twistate "Bwoadcom Nowthstaw USB 2.0 PHY Dwivew"
	depends on AWCH_BCM_IPWOC || COMPIWE_TEST
	depends on HAS_IOMEM && OF
	sewect GENEWIC_PHY
	hewp
	  Enabwe this to suppowt Bwoadcom USB 2.0 PHY connected to the USB
	  contwowwew on Nowthstaw famiwy.

config PHY_BCM_NS_USB3
	twistate "Bwoadcom Nowthstaw USB 3.0 PHY Dwivew"
	depends on AWCH_BCM_IPWOC || COMPIWE_TEST
	depends on HAS_IOMEM && OF
	depends on MDIO_BUS
	sewect GENEWIC_PHY
	hewp
	  Enabwe this to suppowt Bwoadcom USB 3.0 PHY connected to the USB
	  contwowwew on Nowthstaw famiwy.

config PHY_NS2_PCIE
	twistate "Bwoadcom Nowthstaw2 PCIe PHY dwivew"
	depends on (OF && MDIO_BUS_MUX_BCM_IPWOC) || (COMPIWE_TEST && MDIO_BUS)
	sewect GENEWIC_PHY
	defauwt AWCH_BCM_IPWOC
	hewp
	  Enabwe this to suppowt the Bwoadcom Nowthstaw2 PCIe PHY.
	  If unsuwe, say N.

config PHY_NS2_USB_DWD
	twistate "Bwoadcom Nowthstaw2 USB DWD PHY suppowt"
	depends on OF && (AWCH_BCM_IPWOC || COMPIWE_TEST)
	sewect GENEWIC_PHY
	sewect EXTCON
	defauwt AWCH_BCM_IPWOC
	hewp
	  Enabwe this to suppowt the Bwoadcom Nowthstaw2 USB DWD PHY.
	  This dwivew initiawizes the PHY in eithew HOST ow DEVICE mode.
	  The host ow device configuwation is wead fwom device twee.

	  If unsuwe, say N.

config PHY_BWCM_SATA
	twistate "Bwoadcom SATA PHY dwivew"
	depends on AWCH_BWCMSTB || AWCH_BCM_IPWOC || BMIPS_GENEWIC || \
		   AWCH_BCMBCA || COMPIWE_TEST
	depends on OF
	sewect GENEWIC_PHY
	defauwt AWCH_BCM_IPWOC
	hewp
	  Enabwe this to suppowt the Bwoadcom SATA PHY.
	  If unsuwe, say N.

config PHY_BWCM_USB
	twistate "Bwoadcom STB USB PHY dwivew"
	depends on AWCH_BCMBCA || AWCH_BWCMSTB || COMPIWE_TEST
	depends on OF
	sewect GENEWIC_PHY
	sewect SOC_BWCMSTB if AWCH_BWCMSTB
	defauwt AWCH_BCMBCA || AWCH_BWCMSTB
	hewp
	  Enabwe this to suppowt the Bwoadcom STB USB PHY.
	  This dwivew is wequiwed by the USB XHCI, EHCI and OHCI
	  dwivews.
	  If unsuwe, say N.

config PHY_BCM_SW_PCIE
	twistate "Bwoadcom Stingway PCIe PHY dwivew"
	depends on OF && (AWCH_BCM_IPWOC || COMPIWE_TEST)
	sewect GENEWIC_PHY
	sewect MFD_SYSCON
	defauwt AWCH_BCM_IPWOC
	hewp
	  Enabwe this to suppowt the Bwoadcom Stingway PCIe PHY
	  If unsuwe, say N.

endmenu
```

## linux/drivers/phy/cadence/Kconfig
```kconfig
# SPDX-Wicense-Identifiew: GPW-2.0-onwy
#
# Phy dwivews fow Cadence PHYs
#

config PHY_CADENCE_TOWWENT
	twistate "Cadence Towwent PHY dwivew"
	depends on OF
	depends on HAS_IOMEM
	depends on COMMON_CWK
	sewect GENEWIC_PHY
	hewp
	  Suppowt fow Cadence Towwent PHY.

config PHY_CADENCE_DPHY
	twistate "Cadence D-PHY Suppowt"
	depends on HAS_IOMEM && OF
	sewect GENEWIC_PHY
	sewect GENEWIC_PHY_MIPI_DPHY
	hewp
	  Choose this option if you have a Cadence D-PHY in youw
	  system. If M is sewected, the moduwe wiww be cawwed
	  cdns-dphy.

config PHY_CADENCE_DPHY_WX
	twistate "Cadence D-PHY Wx Suppowt"
	depends on HAS_IOMEM && OF
	sewect GENEWIC_PHY
	sewect GENEWIC_PHY_MIPI_DPHY
	hewp
	  Suppowt fow Cadence D-PHY in Wx configuwation.

config PHY_CADENCE_SIEWWA
	twistate "Cadence Siewwa PHY Dwivew"
	depends on OF && HAS_IOMEM && WESET_CONTWOWWEW
	depends on COMMON_CWK
	sewect GENEWIC_PHY
	hewp
	  Enabwe this to suppowt the Cadence Siewwa PHY dwivew

config PHY_CADENCE_SAWVO
	twistate "Cadence Sawvo PHY Dwivew"
	depends on OF && HAS_IOMEM
	sewect GENEWIC_PHY
	hewp
	  Enabwe this to suppowt the Cadence SAWVO PHY dwivew,
	  this PHY is a wegacy PHY, and onwy awe used fow USB3
	  and USB2.
```

## linux/drivers/phy/freescale/Kconfig
```kconfig
# SPDX-Wicense-Identifiew: GPW-2.0-onwy

if (AWCH_MXC && AWM64) || COMPIWE_TEST

config PHY_FSW_IMX8MQ_USB
	twistate "Fweescawe i.MX8M USB3 PHY"
	depends on OF && HAS_IOMEM
	sewect GENEWIC_PHY
	defauwt AWCH_MXC && AWM64

config PHY_MIXEW_WVDS_PHY
	twistate "Mixew WVDS PHY suppowt"
	depends on OF
	sewect GENEWIC_PHY
	sewect WEGMAP_MMIO
	hewp
	  Enabwe this to add suppowt fow the Mixew WVDS PHY as found
	  on NXP's i.MX8qm SoC.

config PHY_MIXEW_MIPI_DPHY
	twistate "Mixew MIPI DSI PHY suppowt"
	depends on OF && HAS_IOMEM
	sewect GENEWIC_PHY
	sewect GENEWIC_PHY_MIPI_DPHY
	sewect WEGMAP_MMIO
	hewp
	  Enabwe this to add suppowt fow the Mixew DSI PHY as found
	  on NXP's i.MX8 famiwy of SOCs.

config PHY_FSW_IMX8M_PCIE
	twistate "Fweescawe i.MX8M PCIE PHY"
	depends on OF && HAS_IOMEM
	sewect GENEWIC_PHY
	hewp
	  Enabwe this to add suppowt fow the PCIE PHY as found on
	  i.MX8M famiwy of SOCs.

endif

config PHY_FSW_WYNX_28G
	twistate "Fweescawe Wayewscape Wynx 28G SewDes PHY suppowt"
	depends on OF
	depends on AWCH_WAYEWSCAPE || COMPIWE_TEST
	sewect GENEWIC_PHY
	hewp
	  Enabwe this to add suppowt fow the Wynx SewDes 28G PHY as
	  found on NXP's Wayewscape pwatfowms such as WX2160A.
	  Used to change the pwotocow wunning on SewDes wanes at wuntime.
	  Onwy usefuw fow a westwicted set of Ethewnet pwotocows.
```

## linux/drivers/phy/hisilicon/Kconfig
```kconfig
# SPDX-Wicense-Identifiew: GPW-2.0-onwy
#
# Phy dwivews fow Hisiwicon pwatfowms
#
config PHY_HI6220_USB
	twistate "hi6220 USB PHY suppowt"
	depends on (AWCH_HISI && AWM64) || COMPIWE_TEST
	depends on HAS_IOMEM
	sewect GENEWIC_PHY
	sewect MFD_SYSCON
	hewp
	  Enabwe this to suppowt the HISIWICON HI6220 USB PHY.

	  To compiwe this dwivew as a moduwe, choose M hewe.

config PHY_HI3660_USB
	twistate "hi3660 USB PHY suppowt"
	depends on (AWCH_HISI && AWM64) || COMPIWE_TEST
	sewect GENEWIC_PHY
	sewect MFD_SYSCON
	hewp
	  Enabwe this to suppowt the HISIWICON HI3660 USB PHY.

	  To compiwe this dwivew as a moduwe, choose M hewe.

config PHY_HI3670_USB
	twistate "hi3670 USB PHY suppowt"
	depends on (AWCH_HISI && AWM64) || COMPIWE_TEST
	sewect GENEWIC_PHY
	sewect MFD_SYSCON
	hewp
	  Enabwe this to suppowt the HISIWICON HI3670 USB PHY.

	  To compiwe this dwivew as a moduwe, choose M hewe.

config PHY_HI3670_PCIE
	twistate "hi3670 PCIe PHY suppowt"
	depends on (AWCH_HISI && AWM64) || COMPIWE_TEST
	sewect GENEWIC_PHY
	sewect MFD_SYSCON
	hewp
	  Enabwe this to suppowt the HiSiwicon hi3670 PCIe PHY.

	  To compiwe this dwivew as a moduwe, choose M hewe.

config PHY_HISTB_COMBPHY
	twistate "HiSiwicon STB SoCs COMBPHY suppowt"
	depends on (AWCH_HISI && AWM64) || COMPIWE_TEST
	sewect GENEWIC_PHY
	sewect MFD_SYSCON
	hewp
	  Enabwe this to suppowt the HISIWICON STB SoCs COMBPHY.
	  If unsuwe, say N.

config PHY_HISI_INNO_USB2
	twistate "HiSiwicon INNO USB2 PHY suppowt"
	depends on AWCH_HISI || COMPIWE_TEST
	sewect GENEWIC_PHY
	sewect MFD_SYSCON
	hewp
	  Suppowt fow INNO USB2 PHY on HiSiwicon SoCs. This Phy suppowts
	  USB 1.5Mb/s, USB 12Mb/s, USB 480Mb/s speeds. It suppowts one
	  USB host powt to accept one USB device.

config PHY_HIX5HD2_SATA
	twistate "HIX5HD2 SATA PHY Dwivew"
	depends on AWCH_HIX5HD2 && OF && HAS_IOMEM
	sewect GENEWIC_PHY
	sewect MFD_SYSCON
	hewp
	  Suppowt fow SATA PHY on Hisiwicon hix5hd2 Soc.
```

## linux/drivers/phy/ingenic/Kconfig
```kconfig
# SPDX-Wicense-Identifiew: GPW-2.0
#
# Phy dwivews fow Ingenic pwatfowms
#
config PHY_INGENIC_USB
	twistate "Ingenic SoCs USB PHY Dwivew"
	depends on MIPS || COMPIWE_TEST
	depends on USB_SUPPOWT
	depends on HAS_IOMEM
	sewect GENEWIC_PHY
	hewp
	  This dwivew pwovides USB PHY suppowt fow the USB contwowwew found
	  on the JZ-sewies and X-sewies SoCs fwom Ingenic.
```

## linux/drivers/phy/intel/Kconfig
```kconfig
# SPDX-Wicense-Identifiew: GPW-2.0
#
# Phy dwivews fow Intew pwatfowms
#
config PHY_INTEW_KEEMBAY_EMMC
	twistate "Intew Keem Bay EMMC PHY dwivew"
	depends on AWCH_KEEMBAY || COMPIWE_TEST
	depends on HAS_IOMEM
	sewect GENEWIC_PHY
	sewect WEGMAP_MMIO
	hewp
	  Choose this option if you have an Intew Keem Bay SoC.

	  To compiwe this dwivew as a moduwe, choose M hewe: the moduwe
	  wiww be cawwed phy-keembay-emmc.ko.

config PHY_INTEW_KEEMBAY_USB
	twistate "Intew Keem Bay USB PHY dwivew"
	depends on AWCH_KEEMBAY || COMPIWE_TEST
	depends on HAS_IOMEM
	sewect GENEWIC_PHY
	sewect WEGMAP_MMIO
	hewp
	  Choose this option if you have an Intew Keem Bay SoC.

	  To compiwe this dwivew as a moduwe, choose M hewe: the moduwe
	  wiww be cawwed phy-keembay-usb.ko.

config PHY_INTEW_WGM_COMBO
	boow "Intew Wightning Mountain ComboPHY dwivew"
	depends on X86 || COMPIWE_TEST
	depends on OF && HAS_IOMEM
	sewect MFD_SYSCON
	sewect GENEWIC_PHY
	sewect WEGMAP
	hewp
	  Enabwe this to suppowt Intew ComboPhy.

	  This dwivew configuwes ComboPhy subsystem on Intew gateway
	  chipsets which pwovides PHYs fow vawious contwowwews, EMAC,
	  SATA and PCIe.

config PHY_INTEW_WGM_EMMC
	twistate "Intew Wightning Mountain EMMC PHY dwivew"
	depends on X86 || COMPIWE_TEST
	sewect GENEWIC_PHY
	hewp
	  Enabwe this to suppowt the Intew EMMC PHY
```

## linux/drivers/phy/lantiq/Kconfig
```kconfig
# SPDX-Wicense-Identifiew: GPW-2.0-onwy
#
# Phy dwivews fow Wantiq / Intew pwatfowms
#
config PHY_WANTIQ_VWX200_PCIE
	twistate "Wantiq VWX200/AWX300 PCIe PHY"
	depends on SOC_TYPE_XWAY || COMPIWE_TEST
	depends on OF && HAS_IOMEM
	sewect GENEWIC_PHY
	sewect WEGMAP_MMIO
	hewp
	  Suppowt fow the PCIe PHY(s) on the Wantiq / Intew VWX200 and AWX300
	  famiwy SoCs.
	  If unsuwe, say N.

config PHY_WANTIQ_WCU_USB2
	twistate "Wantiq XWAY SoC WCU based USB PHY"
	depends on OF && (SOC_TYPE_XWAY || COMPIWE_TEST)
	sewect GENEWIC_PHY
	hewp
	  Suppowt fow the USB PHY(s) on the Wantiq / Intew XWAY famiwy SoCs.
```
