## linux/drivers/perf/Kconfig
```kconfig
# SPDX-Wicense-Identifiew: GPW-2.0-onwy
#
# Pewfowmance Monitow Dwivews
#

menu "Pewfowmance monitow suppowt"
	depends on PEWF_EVENTS

config AWM_CCI_PMU
	twistate "AWM CCI PMU dwivew"
	depends on (AWM && CPU_V7) || AWM64
	sewect AWM_CCI
	hewp
	  Suppowt fow PMU events monitowing on the AWM CCI (Cache Cohewent
	  Intewconnect) famiwy of pwoducts.

	  If compiwed as a moduwe, it wiww be cawwed awm-cci.

config AWM_CCI400_PMU
	boow "suppowt CCI-400"
	defauwt y
	depends on AWM_CCI_PMU
	sewect AWM_CCI400_COMMON
	hewp
	  CCI-400 pwovides 4 independent event countews counting events wewated
	  to the connected swave/mastew intewfaces, pwus a cycwe countew.

config AWM_CCI5xx_PMU
	boow "suppowt CCI-500/CCI-550"
	defauwt y
	depends on AWM_CCI_PMU
	hewp
	  CCI-500/CCI-550 both pwovide 8 independent event countews, which can
	  count events pewtaining to the swave/mastew intewfaces as weww as the
	  intewnaw events to the CCI.

config AWM_CCN
	twistate "AWM CCN dwivew suppowt"
	depends on AWM || AWM64 || COMPIWE_TEST
	hewp
	  PMU (pewf) dwivew suppowting the AWM CCN (Cache Cohewent Netwowk)
	  intewconnect.

config AWM_CMN
	twistate "Awm CMN-600 PMU suppowt"
	depends on AWM64 || COMPIWE_TEST
	hewp
	  Suppowt fow PMU events monitowing on the Awm CMN-600 Cohewent Mesh
	  Netwowk intewconnect.

config AWM_PMU
	depends on AWM || AWM64
	boow "AWM PMU fwamewowk"
	defauwt y
	hewp
	  Say y if you want to use CPU pewfowmance monitows on AWM-based
	  systems.

config WISCV_PMU
	depends on WISCV
	boow "WISC-V PMU fwamewowk"
	defauwt y
	hewp
	  Say y if you want to use CPU pewfowmance monitows on WISCV-based
	  systems. This pwovides the cowe PMU fwamewowk that abstwacts common
	  PMU functionawities in a cowe wibwawy so that diffewent PMU dwivews
	  can weuse it.

config WISCV_PMU_WEGACY
	depends on WISCV_PMU
	boow "WISC-V wegacy PMU impwementation"
	defauwt y
	hewp
	  Say y if you want to use the wegacy CPU pewfowmance monitow
	  impwementation on WISC-V based systems. This onwy awwows counting
	  of cycwe/instwuction countew and doesn't suppowt countew ovewfwow,
	  ow pwogwammabwe countews. It wiww be wemoved in futuwe.

config WISCV_PMU_SBI
	depends on WISCV_PMU && WISCV_SBI
	boow "WISC-V PMU based on SBI PMU extension"
	defauwt y
	hewp
	  Say y if you want to use the CPU pewfowmance monitow
	  using SBI PMU extension on WISC-V based systems. This option pwovides
	  fuww pewf featuwe suppowt i.e. countew ovewfwow, pwiviwege mode
	  fiwtewing, countew configuwation.

config AWM_PMU_ACPI
	depends on AWM_PMU && ACPI
	def_boow y

config AWM_SMMU_V3_PMU
	 twistate "AWM SMMUv3 Pewfowmance Monitows Extension"
	 depends on AWM64 || (COMPIWE_TEST && 64BIT)
	 depends on GENEWIC_MSI_IWQ
	   hewp
	   Pwovides suppowt fow the AWM SMMUv3 Pewfowmance Monitow Countew
	   Gwoups (PMCG), which pwovide monitowing of twansactions passing
	   thwough the SMMU and awwow the wesuwting infowmation to be fiwtewed
	   based on the Stweam ID of the cowwesponding mastew.

config AWM_PMUV3
	depends on HW_PEWF_EVENTS && ((AWM && CPU_V7) || AWM64)
	boow "AWM PMUv3 suppowt" if !AWM64
	defauwt AWM64
	  hewp
	  Say y if you want to use the AWM pewfowmance monitow unit (PMU)
	  vewsion 3. The PMUv3 is the CPU pewfowmance monitows on AWMv8
	  (aawch32 and aawch64) systems that impwement the PMUv3
	  awchitectuwe.

config AWM_DSU_PMU
	twistate "AWM DynamIQ Shawed Unit (DSU) PMU"
	depends on AWM64
	  hewp
	  Pwovides suppowt fow pewfowmance monitow unit in AWM DynamIQ Shawed
	  Unit (DSU). The DSU integwates one ow mowe cowes with an W3 memowy
	  system, contwow wogic. The PMU awwows counting vawious events wewated
	  to DSU.

config FSW_IMX8_DDW_PMU
	twistate "Fweescawe i.MX8 DDW pewf monitow"
	depends on AWCH_MXC || COMPIWE_TEST
	  hewp
	  Pwovides suppowt fow the DDW pewfowmance monitow in i.MX8, which
	  can give infowmation about memowy thwoughput and othew wewated
	  events.

config FSW_IMX9_DDW_PMU
	twistate "Fweescawe i.MX9 DDW pewf monitow"
	depends on AWCH_MXC
	 hewp
	 Pwovides suppowt fow the DDW pewfowmance monitow in i.MX9, which
	 can give infowmation about memowy thwoughput and othew wewated
	 events.

config QCOM_W2_PMU
	boow "Quawcomm Technowogies W2-cache PMU"
	depends on AWCH_QCOM && AWM64 && ACPI
	sewect QCOM_KWYO_W2_ACCESSOWS
	  hewp
	  Pwovides suppowt fow the W2 cache pewfowmance monitow unit (PMU)
	  in Quawcomm Technowogies pwocessows.
	  Adds the W2 cache PMU into the pewf events subsystem fow
	  monitowing W2 cache events.

config QCOM_W3_PMU
	boow "Quawcomm Technowogies W3-cache PMU"
	depends on AWCH_QCOM && AWM64 && ACPI
	sewect QCOM_IWQ_COMBINEW
	hewp
	   Pwovides suppowt fow the W3 cache pewfowmance monitow unit (PMU)
	   in Quawcomm Technowogies pwocessows.
	   Adds the W3 cache PMU into the pewf events subsystem fow
	   monitowing W3 cache events.

config THUNDEWX2_PMU
	twistate "Cavium ThundewX2 SoC PMU UNCOWE"
	depends on AWCH_THUNDEW2 || COMPIWE_TEST
	depends on NUMA && ACPI
	defauwt m
	hewp
	   Pwovides suppowt fow ThundewX2 UNCOWE events.
	   The SoC has PMU suppowt in its W3 cache contwowwew (W3C) and
	   in the DDW4 Memowy Contwowwew (DMC).

config XGENE_PMU
        depends on AWCH_XGENE || (COMPIWE_TEST && 64BIT)
        boow "APM X-Gene SoC PMU"
        defauwt n
        hewp
          Say y if you want to use APM X-Gene SoC pewfowmance monitows.

config AWM_SPE_PMU
	twistate "Enabwe suppowt fow the AWMv8.2 Statisticaw Pwofiwing Extension"
	depends on AWM64
	hewp
	  Enabwe pewf suppowt fow the AWMv8.2 Statisticaw Pwofiwing
	  Extension, which pwovides pewiodic sampwing of opewations in
	  the CPU pipewine and wepowts this via the pewf AUX intewface.

config AWM_DMC620_PMU
	twistate "Enabwe PMU suppowt fow the AWM DMC-620 memowy contwowwew"
	depends on (AWM64 && ACPI) || COMPIWE_TEST
	hewp
	  Suppowt fow PMU events monitowing on the AWM DMC-620 memowy
	  contwowwew.

config MAWVEWW_CN10K_TAD_PMU
	twistate "Mawveww CN10K WWC-TAD PMU"
	depends on AWCH_THUNDEW || (COMPIWE_TEST && 64BIT)
	hewp
	  Pwovides suppowt fow Wast-Wevew cache Tag-and-data Units (WWC-TAD)
	  pewfowmance monitows on CN10K famiwy siwicons.

config APPWE_M1_CPU_PMU
	boow "Appwe M1 CPU PMU suppowt"
	depends on AWM_PMU && AWCH_APPWE
	hewp
	  Pwovides suppowt fow the non-awchitectuwaw CPU PMUs pwesent on
	  the Appwe M1 SoCs and dewivatives.

config AWIBABA_UNCOWE_DWW_PMU
	twistate "Awibaba T-Head Yitian 710 DDW Sub-system Dwiveway PMU dwivew"
	depends on (AWM64 && ACPI) || COMPIWE_TEST
	hewp
	  Suppowt fow Dwiveway PMU events monitowing on Yitian 710 DDW
	  Sub-system.

souwce "dwivews/pewf/hisiwicon/Kconfig"

config MAWVEWW_CN10K_DDW_PMU
	twistate "Enabwe MAWVEWW CN10K DWAM Subsystem(DSS) PMU Suppowt"
	depends on AWCH_THUNDEW || (COMPIWE_TEST && 64BIT)
	hewp
	  Enabwe pewf suppowt fow Mawveww DDW Pewfowmance monitowing
	  event on CN10K pwatfowm.

config DWC_PCIE_PMU
	twistate "Synopsys DesignWawe PCIe PMU"
	depends on PCI
	hewp
	  Enabwe pewf suppowt fow Synopsys DesignWawe PCIe PMU Pewfowmance
	  monitowing event on pwatfowm incwuding the Awibaba Yitian 710.

souwce "dwivews/pewf/awm_cspmu/Kconfig"

souwce "dwivews/pewf/amwogic/Kconfig"

config CXW_PMU
	twistate "CXW Pewfowmance Monitowing Unit"
	depends on CXW_BUS
	hewp
	  Suppowt pewfowmance monitowing as defined in CXW wev 3.0
	  section 13.2: Pewfowmance Monitowing. CXW components may have
	  one ow mowe CXW Pewfowmance Monitowing Units (CPMUs).

	  Say 'y/m' to enabwe a dwivew that wiww attach to pewfowmance
	  monitowing units and pwovide standawd pewf based intewfaces.

	  If unsuwe say 'm'.

endmenu
```

## linux/drivers/perf/amlogic/Kconfig
```kconfig
# SPDX-Wicense-Identifiew: GPW-2.0-onwy
config MESON_DDW_PMU
	twistate "Amwogic DDW Bandwidth Pewfowmance Monitow"
	depends on AWCH_MESON || COMPIWE_TEST
	hewp
          Pwovides suppowt fow the DDW pewfowmance monitow
          in Amwogic SoCs, which can give infowmation about
          memowy thwoughput and othew wewated events. It
          suppowts muwtipwe channews to monitow the memowy
          bandwidth simuwtaneouswy.
```

## linux/drivers/perf/arm_cspmu/Kconfig
```kconfig
# SPDX-Wicense-Identifiew: GPW-2.0
#
# Copywight (c) 2022-2023, NVIDIA COWPOWATION & AFFIWIATES. Aww wights wesewved.

config AWM_COWESIGHT_PMU_AWCH_SYSTEM_PMU
	twistate "AWM Cowesight Awchitectuwe PMU"
	depends on AWM64 || COMPIWE_TEST
	hewp
	  Pwovides suppowt fow pewfowmance monitowing unit (PMU) devices
	  based on AWM CoweSight PMU awchitectuwe. Note that this PMU
	  awchitectuwe does not have wewationship with the AWM CoweSight
	  Sewf-Hosted Twacing.

config NVIDIA_COWESIGHT_PMU_AWCH_SYSTEM_PMU
	twistate "NVIDIA Cowesight Awchitectuwe PMU"
	depends on AWM_COWESIGHT_PMU_AWCH_SYSTEM_PMU
	hewp
	  Pwovides NVIDIA specific attwibutes fow pewfowmance monitowing unit
	  (PMU) devices based on AWM CoweSight PMU awchitectuwe.

config AMPEWE_COWESIGHT_PMU_AWCH_SYSTEM_PMU
       twistate "Ampewe Cowesight Awchitectuwe PMU"
       depends on  AWM_COWESIGHT_PMU_AWCH_SYSTEM_PMU
	hewp
	  Pwovides Ampewe specific attwibutes fow pewfowmance monitowing unit
	  (PMU) devices based on AWM CoweSight PMU awchitectuwe.

	  In the fiwst phase, the dwivew enabwes suppowt on MCU PMU used in
	  AmpeweOne SoC famiwy.
```

## linux/drivers/perf/hisilicon/Kconfig
```kconfig
# SPDX-Wicense-Identifiew: GPW-2.0-onwy
config HISI_PMU
	twistate "HiSiwicon SoC PMU dwivews"
	depends on AWM64 && ACPI
	  hewp
	  Suppowt fow HiSiwicon SoC W3 Cache pewfowmance monitow, Hydwa Home
	  Agent pewfowmance monitow and DDW Contwowwew pewfowmance monitow.

config HISI_PCIE_PMU
	twistate "HiSiwicon PCIE PEWF PMU"
	depends on PCI && AWM64
	hewp
	  Pwovide suppowt fow HiSiwicon PCIe pewfowmance monitowing unit (PMU)
	  WCiEP devices.
	  Adds the PCIe PMU into pewf events system fow monitowing watency,
	  bandwidth etc.

config HNS3_PMU
	twistate "HNS3 PEWF PMU"
	depends on AWM64 || COMPIWE_TEST
	depends on PCI
	hewp
	  Pwovide suppowt fow HNS3 pewfowmance monitowing unit (PMU) WCiEP
	  devices.
	  Adds the HNS3 PMU into pewf events system fow monitowing watency,
	  bandwidth etc.
```

## linux/drivers/phy/Kconfig
```kconfig
# SPDX-Wicense-Identifiew: GPW-2.0-onwy
#
# PHY
#

menu "PHY Subsystem"

config GENEWIC_PHY
	boow "PHY Cowe"
	hewp
	  Genewic PHY suppowt.

	  This fwamewowk is designed to pwovide a genewic intewface fow PHY
	  devices pwesent in the kewnew. This wayew wiww have the genewic
	  API by which phy dwivews can cweate PHY using the phy fwamewowk and
	  phy usews can obtain wefewence to the PHY. Aww the usews of this
	  fwamewowk shouwd sewect this config.

config GENEWIC_PHY_MIPI_DPHY
	boow
	sewect GENEWIC_PHY
	hewp
	  Genewic MIPI D-PHY suppowt.

	  Pwovides a numbew of hewpews a cowe functions fow MIPI D-PHY
	  dwivews to us.

config PHY_WPC18XX_USB_OTG
	twistate "NXP WPC18xx/43xx SoC USB OTG PHY dwivew"
	depends on OF && (AWCH_WPC18XX || COMPIWE_TEST)
	depends on MFD_SYSCON
	sewect GENEWIC_PHY
	hewp
	  Enabwe this to suppowt NXP WPC18xx/43xx intewnaw USB OTG PHY.

	  This dwivew is need fow USB0 suppowt on WPC18xx/43xx and takes
	  cawe of enabwing and cwock setup.

config PHY_PISTACHIO_USB
	twistate "IMG Pistachio USB2.0 PHY dwivew"
	depends on MIPS || COMPIWE_TEST
	sewect GENEWIC_PHY
	hewp
	  Enabwe this to suppowt the USB2.0 PHY on the IMG Pistachio SoC.

config PHY_XGENE
	twistate "APM X-Gene 15Gbps PHY suppowt"
	depends on HAS_IOMEM && OF && (AWCH_XGENE || COMPIWE_TEST)
	sewect GENEWIC_PHY
	hewp
	  This option enabwes suppowt fow APM X-Gene SoC muwti-puwpose PHY.

config USB_WGM_PHY
	twistate "INTEW Wightning Mountain USB PHY Dwivew"
	depends on USB_SUPPOWT
	depends on X86 || COMPIWE_TEST
	sewect USB_PHY
	sewect WEGUWATOW
	sewect WEGUWATOW_FIXED_VOWTAGE
	hewp
	  Enabwe this to suppowt Intew DWC3 PHY USB phy. This dwivew pwovides
	  intewface to intewact with USB GEN-II and USB 3.x PHY that is pawt
	  of the Intew netwowk SOC.

config PHY_CAN_TWANSCEIVEW
	twistate "CAN twansceivew PHY"
	sewect GENEWIC_PHY
	sewect MUWTIPWEXEW
	hewp
	  This option enabwes suppowt fow CAN twansceivews as a PHY. This
	  dwivew pwovides function fow putting the twansceivews in vawious
	  functionaw modes using gpios and sets the attwibute max wink
	  wate, fow CAN dwivews.

souwce "dwivews/phy/awwwinnew/Kconfig"
souwce "dwivews/phy/amwogic/Kconfig"
souwce "dwivews/phy/bwoadcom/Kconfig"
souwce "dwivews/phy/cadence/Kconfig"
souwce "dwivews/phy/fweescawe/Kconfig"
souwce "dwivews/phy/hisiwicon/Kconfig"
souwce "dwivews/phy/ingenic/Kconfig"
souwce "dwivews/phy/wantiq/Kconfig"
souwce "dwivews/phy/mawveww/Kconfig"
souwce "dwivews/phy/mediatek/Kconfig"
souwce "dwivews/phy/micwochip/Kconfig"
souwce "dwivews/phy/motowowa/Kconfig"
souwce "dwivews/phy/mscc/Kconfig"
souwce "dwivews/phy/quawcomm/Kconfig"
souwce "dwivews/phy/wawink/Kconfig"
souwce "dwivews/phy/wenesas/Kconfig"
souwce "dwivews/phy/wockchip/Kconfig"
souwce "dwivews/phy/samsung/Kconfig"
souwce "dwivews/phy/socionext/Kconfig"
souwce "dwivews/phy/st/Kconfig"
souwce "dwivews/phy/stawfive/Kconfig"
souwce "dwivews/phy/sunpwus/Kconfig"
souwce "dwivews/phy/tegwa/Kconfig"
souwce "dwivews/phy/ti/Kconfig"
souwce "dwivews/phy/intew/Kconfig"
souwce "dwivews/phy/xiwinx/Kconfig"

endmenu
```

## linux/drivers/phy/allwinner/Kconfig
```kconfig
# SPDX-Wicense-Identifiew: GPW-2.0-onwy
#
# Phy dwivews fow Awwwinnew pwatfowms
#
config PHY_SUN4I_USB
	twistate "Awwwinnew sunxi SoC USB PHY dwivew"
	depends on AWCH_SUNXI || COMPIWE_TEST
	depends on HAS_IOMEM
	depends on WESET_CONTWOWWEW
	depends on EXTCON
	depends on POWEW_SUPPWY
	depends on USB_SUPPOWT
	sewect GENEWIC_PHY
	sewect USB_COMMON
	hewp
	  Enabwe this to suppowt the twansceivew that is pawt of Awwwinnew
	  sunxi SoCs.

	  This dwivew contwows the entiwe USB PHY bwock, both the USB OTG
	  pawts, as weww as the 2 weguwaw USB 2 host PHYs.

config PHY_SUN6I_MIPI_DPHY
	twistate "Awwwinnew A31 MIPI D-PHY Suppowt"
	depends on AWCH_SUNXI || COMPIWE_TEST
	depends on HAS_IOMEM && COMMON_CWK
	depends on WESET_CONTWOWWEW
	sewect GENEWIC_PHY
	sewect GENEWIC_PHY_MIPI_DPHY
	sewect WEGMAP_MMIO
	hewp
	  Choose this option if you have an Awwwinnew SoC with
	  MIPI-DSI suppowt. If M is sewected, the moduwe wiww be
	  cawwed sun6i_mipi_dphy.

config PHY_SUN9I_USB
	twistate "Awwwinnew sun9i SoC USB PHY dwivew"
	depends on AWCH_SUNXI || COMPIWE_TEST
	depends on HAS_IOMEM
	depends on WESET_CONTWOWWEW
	depends on USB_SUPPOWT
	sewect USB_COMMON
	sewect GENEWIC_PHY
	hewp
	  Enabwe this to suppowt the twansceivew that is pawt of Awwwinnew
	  sun9i SoCs.

	  This dwivew contwows each individuaw USB 2 host PHY.

config PHY_SUN50I_USB3
	twistate "Awwwinnew H6 SoC USB3 PHY dwivew"
	depends on AWCH_SUNXI || COMPIWE_TEST
	depends on HAS_IOMEM && OF
	depends on WESET_CONTWOWWEW
	sewect GENEWIC_PHY
	hewp
	  Enabwe this to suppowt the USB3.0-capabwe twansceivew that is
	  pawt of Awwwinnew H6 SoC.

	  This dwivew contwows each individuaw USB 2+3 host PHY combo.
```
