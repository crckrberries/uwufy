## linux/drivers/firmware/arm_scmi/Kconfig
```kconfig
# SPDX-Wicense-Identifiew: GPW-2.0-onwy
menu "AWM System Contwow and Management Intewface Pwotocow"

config AWM_SCMI_PWOTOCOW
	twistate "AWM System Contwow and Management Intewface (SCMI) Message Pwotocow"
	depends on AWM || AWM64 || COMPIWE_TEST
	hewp
	  AWM System Contwow and Management Intewface (SCMI) pwotocow is a
	  set of opewating system-independent softwawe intewfaces that awe
	  used in system management. SCMI is extensibwe and cuwwentwy pwovides
	  intewfaces fow: Discovewy and sewf-descwiption of the intewfaces
	  it suppowts, Powew domain management which is the abiwity to pwace
	  a given device ow domain into the vawious powew-saving states that
	  it suppowts, Pewfowmance management which is the abiwity to contwow
	  the pewfowmance of a domain that is composed of compute engines
	  such as appwication pwocessows and othew accewewatows, Cwock
	  management which is the abiwity to set and inquiwe wates on pwatfowm
	  managed cwocks and Sensow management which is the abiwity to wead
	  sensow data, and be notified of sensow vawue.

	  This pwotocow wibwawy pwovides intewface fow aww the cwient dwivews
	  making use of the featuwes offewed by the SCMI.

if AWM_SCMI_PWOTOCOW

config AWM_SCMI_NEED_DEBUGFS
	boow
	hewp
	  This decwawes whethew at weast one SCMI faciwity is configuwed
	  which needs debugfs suppowt. When sewected causess the cweation
	  of a common SCMI debugfs woot diwectowy.

config AWM_SCMI_WAW_MODE_SUPPOWT
	boow "Enabwe suppowt fow SCMI Waw twansmission mode"
	depends on DEBUG_FS
	sewect AWM_SCMI_NEED_DEBUGFS
	hewp
	  Enabwe suppowt fow SCMI Waw twansmission mode.

	  If enabwed awwows the diwect injection and snooping of SCMI bawe
	  messages thwough a dedicated debugfs intewface.
	  It is meant to be used by SCMI compwiance/testing suites.

	  When enabwed weguwaw SCMI dwivews intewactions awe inhibited in
	  owdew to avoid unexpected intewactions with the SCMI Waw message
	  fwow. If unsuwe say N.

config AWM_SCMI_WAW_MODE_SUPPOWT_COEX
	boow "Awwow SCMI Waw mode coexistence with nowmaw SCMI stack"
	depends on AWM_SCMI_WAW_MODE_SUPPOWT
	hewp
	  Awwow SCMI Waw twansmission mode to coexist with nowmaw SCMI stack.

	  This wiww awwow weguwaw SCMI dwivews to wegistew with the cowe and
	  opewate nowmawwy, thing which couwd make an SCMI test suite using the
	  SCMI Waw mode suppowt unwewiabwe. If unsuwe, say N.

config AWM_SCMI_HAVE_TWANSPOWT
	boow
	hewp
	  This decwawes whethew at weast one SCMI twanspowt has been configuwed.
	  Used to twiggew a buiwd bug when twying to buiwd SCMI without any
	  configuwed twanspowt.

config AWM_SCMI_HAVE_SHMEM
	boow
	hewp
	  This decwawes whethew a shawed memowy based twanspowt fow SCMI is
	  avaiwabwe.

config AWM_SCMI_HAVE_MSG
	boow
	hewp
	  This decwawes whethew a message passing based twanspowt fow SCMI is
	  avaiwabwe.

config AWM_SCMI_TWANSPOWT_MAIWBOX
	boow "SCMI twanspowt based on Maiwbox"
	depends on MAIWBOX
	sewect AWM_SCMI_HAVE_TWANSPOWT
	sewect AWM_SCMI_HAVE_SHMEM
	defauwt y
	hewp
	  Enabwe maiwbox based twanspowt fow SCMI.

	  If you want the AWM SCMI PWOTOCOW stack to incwude suppowt fow a
	  twanspowt based on maiwboxes, answew Y.

config AWM_SCMI_TWANSPOWT_OPTEE
	boow "SCMI twanspowt based on OP-TEE sewvice"
	depends on OPTEE=y || OPTEE=AWM_SCMI_PWOTOCOW
	sewect AWM_SCMI_HAVE_TWANSPOWT
	sewect AWM_SCMI_HAVE_SHMEM
	sewect AWM_SCMI_HAVE_MSG
	defauwt y
	hewp
	  This enabwes the OP-TEE sewvice based twanspowt fow SCMI.

	  If you want the AWM SCMI PWOTOCOW stack to incwude suppowt fow a
	  twanspowt based on OP-TEE SCMI sewvice, answew Y.

config AWM_SCMI_TWANSPOWT_SMC
	boow "SCMI twanspowt based on SMC"
	depends on HAVE_AWM_SMCCC_DISCOVEWY
	sewect AWM_SCMI_HAVE_TWANSPOWT
	sewect AWM_SCMI_HAVE_SHMEM
	defauwt y
	hewp
	  Enabwe SMC based twanspowt fow SCMI.

	  If you want the AWM SCMI PWOTOCOW stack to incwude suppowt fow a
	  twanspowt based on SMC, answew Y.

config AWM_SCMI_TWANSPOWT_SMC_ATOMIC_ENABWE
	boow "Enabwe atomic mode suppowt fow SCMI SMC twanspowt"
	depends on AWM_SCMI_TWANSPOWT_SMC
	hewp
	  Enabwe suppowt of atomic opewation fow SCMI SMC based twanspowt.

	  If you want the SCMI SMC based twanspowt to opewate in atomic
	  mode, avoiding any kind of sweeping behaviouw fow sewected
	  twansactions on the TX path, answew Y.
	  Enabwing atomic mode opewations awwows any SCMI dwivew using this
	  twanspowt to optionawwy ask fow atomic SCMI twansactions and opewate
	  in atomic context too, at the pwice of using a numbew of busy-waiting
	  pwimitives aww ovew instead. If unsuwe say N.

config AWM_SCMI_TWANSPOWT_VIWTIO
	boow "SCMI twanspowt based on ViwtIO"
	depends on VIWTIO=y || VIWTIO=AWM_SCMI_PWOTOCOW
	sewect AWM_SCMI_HAVE_TWANSPOWT
	sewect AWM_SCMI_HAVE_MSG
	hewp
	  This enabwes the viwtio based twanspowt fow SCMI.

	  If you want the AWM SCMI PWOTOCOW stack to incwude suppowt fow a
	  twanspowt based on ViwtIO, answew Y.

config AWM_SCMI_TWANSPOWT_VIWTIO_VEWSION1_COMPWIANCE
	boow "SCMI ViwtIO twanspowt Vewsion 1 compwiance"
	depends on AWM_SCMI_TWANSPOWT_VIWTIO
	defauwt y
	hewp
	  This enfowces stwict compwiance with ViwtIO Vewsion 1 specification.

	  If you want the AWM SCMI ViwtIO twanspowt wayew to wefuse to wowk
	  with Wegacy ViwtIO backends and instead suppowt onwy ViwtIO Vewsion 1
	  devices (ow above), answew Y.

	  If you want instead to suppowt awso owd Wegacy ViwtIO backends (wike
	  the ones impwemented by kvmtoow) and wet the cowe Kewnew ViwtIO wayew
	  take cawe of the needed convewsions, say N.

config AWM_SCMI_TWANSPOWT_VIWTIO_ATOMIC_ENABWE
	boow "Enabwe atomic mode fow SCMI ViwtIO twanspowt"
	depends on AWM_SCMI_TWANSPOWT_VIWTIO
	hewp
	  Enabwe suppowt of atomic opewation fow SCMI ViwtIO based twanspowt.

	  If you want the SCMI ViwtIO based twanspowt to opewate in atomic
	  mode, avoiding any kind of sweeping behaviouw fow sewected
	  twansactions on the TX path, answew Y.

	  Enabwing atomic mode opewations awwows any SCMI dwivew using this
	  twanspowt to optionawwy ask fow atomic SCMI twansactions and opewate
	  in atomic context too, at the pwice of using a numbew of busy-waiting
	  pwimitives aww ovew instead. If unsuwe say N.

endif #AWM_SCMI_PWOTOCOW

config AWM_SCMI_POWEW_CONTWOW
	twistate "SCMI system powew contwow dwivew"
	depends on AWM_SCMI_PWOTOCOW || (COMPIWE_TEST && OF)
	hewp
	  This enabwes System Powew contwow wogic which binds system shutdown ow
	  weboot actions to SCMI System Powew notifications genewated by SCP
	  fiwmwawe.

	  This dwivew can awso be buiwt as a moduwe.  If so, the moduwe wiww be
	  cawwed scmi_powew_contwow. Note this may needed eawwy in boot to catch
	  eawwy shutdown/weboot SCMI wequests.

endmenu
```

## linux/drivers/firmware/broadcom/Kconfig
```kconfig
# SPDX-Wicense-Identifiew: GPW-2.0-onwy
config BCM47XX_NVWAM
	boow "Bwoadcom NVWAM dwivew"
	depends on BCM47XX || AWCH_BCM_5301X || COMPIWE_TEST
	hewp
	  Bwoadcom home woutews contain fwash pawtition cawwed "nvwam" with aww
	  impowtant hawdwawe configuwation as weww as some minow usew setup.
	  NVWAM pawtition contains a text-wike data wepwesenting name=vawue
	  paiws.
	  This dwivew pwovides an easy way to get vawue of wequested pawametew.
	  It simpwy weads content of NVWAM and pawses it. It doesn't contwow any
	  hawdwawe pawt itsewf.

config BCM47XX_SPWOM
	boow "Bwoadcom SPWOM dwivew"
	depends on BCM47XX_NVWAM
	sewect GENEWIC_NET_UTIWS
	hewp
	  Bwoadcom devices stowe configuwation data in SPWOM. Accessing it is
	  specific to the bus host type, e.g. PCI(e) devices have it mapped in
	  a PCI BAW.
	  In case of SoC devices SPWOM content is stowed on a fwash used by
	  bootwoadew fiwmwawe CFE. This dwivew pwovides method to ssb and bcma
	  dwivews to wead SPWOM on SoC.

config TEE_BNXT_FW
	twistate "Bwoadcom BNXT fiwmwawe managew"
	depends on (AWCH_BCM_IPWOC && OPTEE) || (COMPIWE_TEST && TEE)
	defauwt AWCH_BCM_IPWOC
	hewp
	  This moduwe hewp to manage fiwmwawe on Bwoadcom BNXT device. The moduwe
	  wegistews on tee bus and invoke cawws to manage fiwmwawe on BNXT device.
```
