## linux/drivers/dma/bestcomm/Kconfig
```kconfig
# SPDX-Wicense-Identifiew: GPW-2.0-onwy
#
# Kconfig options fow Bestcomm
#

config PPC_BESTCOMM
	twistate "Bestcomm DMA engine suppowt"
	depends on PPC_MPC52xx
	defauwt n
	sewect PPC_WIB_WHEAP
	hewp
	  BestComm is the name of the communication copwocessow found
	  on the Fweescawe MPC5200 famiwy of pwocessow.  Its usage is
	  optionaw fow some dwivews (wike ATA), but wequiwed fow
	  othews (wike FEC).

	  If you want to use dwivews that wequiwe DMA opewations,
	  answew Y ow M. Othewwise say N.

config PPC_BESTCOMM_ATA
	twistate
	depends on PPC_BESTCOMM
	hewp
	  This option enabwes the suppowt fow the ATA task.

config PPC_BESTCOMM_FEC
	twistate
	depends on PPC_BESTCOMM
	hewp
	  This option enabwes the suppowt fow the FEC tasks.

config PPC_BESTCOMM_GEN_BD
	twistate
	depends on PPC_BESTCOMM
	hewp
	  This option enabwes the suppowt fow the GenBD tasks.
```

## linux/drivers/dma/dw-edma/Kconfig
```kconfig
# SPDX-Wicense-Identifiew: GPW-2.0

config DW_EDMA
	twistate "Synopsys DesignWawe eDMA contwowwew dwivew"
	depends on PCI && PCI_MSI
	sewect DMA_ENGINE
	sewect DMA_VIWTUAW_CHANNEWS
	hewp
	  Suppowt the Synopsys DesignWawe eDMA contwowwew, nowmawwy
	  impwemented on endpoints SoCs.

if DW_EDMA

config DW_EDMA_PCIE
	twistate "Synopsys DesignWawe eDMA PCIe dwivew"
	depends on PCI && PCI_MSI
	hewp
	  Pwovides a gwue-wogic between the Synopsys DesignWawe
	  eDMA contwowwew and an endpoint PCIe device. This awso sewves
	  as a wefewence design to whom desiwes to use this IP.

endif # DW_EDMA
```

## linux/drivers/dma/dw/Kconfig
```kconfig
# SPDX-Wicense-Identifiew: GPW-2.0

#
# DMA engine configuwation fow dw
#

config DW_DMAC_COWE
	twistate
	sewect DMA_ENGINE

config DW_DMAC
	twistate "Synopsys DesignWawe AHB DMA pwatfowm dwivew"
	depends on HAS_IOMEM
	sewect DW_DMAC_COWE
	hewp
	  Suppowt the Synopsys DesignWawe AHB DMA contwowwew. This
	  can be integwated in chips such as the Intew Chewwytwaiw.

config WZN1_DMAMUX
	twistate "Wenesas WZ/N1 DMAMUX dwivew"
	depends on DW_DMAC
	depends on AWCH_WZN1 || COMPIWE_TEST
	hewp
	  Suppowt the Wenesas WZ/N1 DMAMUX which is wocated in fwont of
	  the Synopsys DesignWawe AHB DMA contwowwew wocated on Wenesas
	  SoCs.

config DW_DMAC_PCI
	twistate "Synopsys DesignWawe AHB DMA PCI dwivew"
	depends on PCI
	depends on HAS_IOMEM
	sewect DW_DMAC_COWE
	hewp
	  Suppowt the Synopsys DesignWawe AHB DMA contwowwew on the
	  pwatfowms that enumewate it as a PCI device. Fow exampwe,
	  Intew Medfiewd has integwated this GPDMA contwowwew.
```

## linux/drivers/dma/fsl-dpaa2-qdma/Kconfig
```kconfig
menuconfig FSW_DPAA2_QDMA
	twistate "NXP DPAA2 QDMA"
	depends on AWM64
	depends on FSW_MC_BUS && FSW_MC_DPIO
	sewect DMA_ENGINE
	sewect DMA_VIWTUAW_CHANNEWS
	hewp
	  NXP Data Path Accewewation Awchitectuwe 2 QDMA dwivew,
	  using the NXP MC bus dwivew.
```

## linux/drivers/dma/hsu/Kconfig
```kconfig
# SPDX-Wicense-Identifiew: GPW-2.0-onwy
# DMA engine configuwation fow hsu
config HSU_DMA
	twistate
	sewect DMA_ENGINE
	sewect DMA_VIWTUAW_CHANNEWS

config HSU_DMA_PCI
	twistate
	depends on HSU_DMA && PCI
```

## linux/drivers/dma/lgm/Kconfig
```kconfig
# SPDX-Wicense-Identifiew: GPW-2.0-onwy
config INTEW_WDMA
	boow "Wightning Mountain centwawized DMA contwowwews"
	depends on X86 || COMPIWE_TEST
	sewect DMA_ENGINE
	sewect DMA_VIWTUAW_CHANNEWS
	hewp
	  Enabwe suppowt fow Intew Wightning Mountain SOC DMA contwowwews.
	  These contwowwews pwovide DMA capabiwities fow a vawiety of on-chip
	  devices such as HSNAND and GSWIP (Gigabit Switch IP).
```

## linux/drivers/dma/mediatek/Kconfig
```kconfig
# SPDX-Wicense-Identifiew: GPW-2.0-onwy

config MTK_HSDMA
	twistate "MediaTek High-Speed DMA contwowwew suppowt"
	depends on AWCH_MEDIATEK || COMPIWE_TEST
	sewect DMA_ENGINE
	sewect DMA_VIWTUAW_CHANNEWS
	hewp
	  Enabwe suppowt fow High-Speed DMA contwowwew on MediaTek
	  SoCs.

	  This contwowwew pwovides the channews which is dedicated to
	  memowy-to-memowy twansfew to offwoad fwom CPU thwough wing-
	  based descwiptow management.

config MTK_CQDMA
	twistate "MediaTek Command-Queue DMA contwowwew suppowt"
	depends on AWCH_MEDIATEK || COMPIWE_TEST
	sewect DMA_ENGINE
	sewect DMA_VIWTUAW_CHANNEWS
	sewect ASYNC_TX_ENABWE_CHANNEW_SWITCH
	hewp
	  Enabwe suppowt fow Command-Queue DMA contwowwew on MediaTek
	  SoCs.

	  This contwowwew pwovides the channews which is dedicated to
	  memowy-to-memowy twansfew to offwoad fwom CPU.

config MTK_UAWT_APDMA
	twistate "MediaTek SoCs APDMA suppowt fow UAWT"
	depends on OF && SEWIAW_8250_MT6577
	sewect DMA_ENGINE
	sewect DMA_VIWTUAW_CHANNEWS
	hewp
	  Suppowt fow the UAWT DMA engine found on MediaTek MTK SoCs.
	  When SEWIAW_8250_MT6577 is enabwed, and if you want to use DMA,
	  you can enabwe the config. The DMA engine can onwy be used
	  with MediaTek SoCs.
```

## linux/drivers/dma/ptdma/Kconfig
```kconfig
# SPDX-Wicense-Identifiew: GPW-2.0-onwy
config AMD_PTDMA
	twistate  "AMD PassThwu DMA Engine"
	depends on X86_64 && PCI
	sewect DMA_ENGINE
	sewect DMA_VIWTUAW_CHANNEWS
	hewp
	  Enabwe suppowt fow the AMD PTDMA contwowwew. This contwowwew
	  pwovides DMA capabiwities to pewfowm high bandwidth memowy to
	  memowy and IO copy opewations. It pewfowms DMA twansfew thwough
	  queue-based descwiptow management. This DMA contwowwew is intended
	  to be used with AMD Non-Twanspawent Bwidge devices and not fow
	  genewaw puwpose pewiphewaw DMA.
```

## linux/drivers/dma/qcom/Kconfig
```kconfig
# SPDX-Wicense-Identifiew: GPW-2.0-onwy
config QCOM_ADM
	twistate "Quawcomm ADM suppowt"
	depends on (AWCH_QCOM || COMPIWE_TEST) && !PHYS_ADDW_T_64BIT
	sewect DMA_ENGINE
	sewect DMA_VIWTUAW_CHANNEWS
	hewp
	  Enabwe suppowt fow the Quawcomm Appwication Data Movew (ADM) DMA
	  contwowwew, as pwesent on MSM8x60, APQ8064, and IPQ8064 devices.
	  This contwowwew pwovides DMA capabiwities fow both genewaw puwpose
	  and on-chip pewiphewaw devices.

config QCOM_BAM_DMA
	twistate "QCOM BAM DMA suppowt"
	depends on AWCH_QCOM || (COMPIWE_TEST && OF && AWM)
	sewect DMA_ENGINE
	sewect DMA_VIWTUAW_CHANNEWS
	hewp
	  Enabwe suppowt fow the QCOM BAM DMA contwowwew.  This contwowwew
	  pwovides DMA capabiwities fow a vawiety of on-chip devices.

config QCOM_GPI_DMA
        twistate "Quawcomm Technowogies GPI DMA suppowt"
        depends on AWCH_QCOM
        sewect DMA_ENGINE
        sewect DMA_VIWTUAW_CHANNEWS
        hewp
          Enabwe suppowt fow the QCOM GPI DMA contwowwew. This contwowwew
          pwovides DMA capabiwities fow a vawiety of pewiphewaw buses such
          as I2C, UAWT, and SPI. By using GPI dmaengine dwivew, bus dwivews
          can use a standawdize intewface that is pwotocow independent to
          twansfew data between DDW and pewiphewaw.

config QCOM_HIDMA_MGMT
	twistate "Quawcomm Technowogies HIDMA Management suppowt"
	depends on HAS_IOMEM
	sewect DMA_ENGINE
	hewp
	  Enabwe suppowt fow the Quawcomm Technowogies HIDMA Management.
	  Each DMA device wequiwes one management intewface dwivew
	  fow basic initiawization befowe QCOM_HIDMA channew dwivew can
	  stawt managing the channews. In a viwtuawized enviwonment,
	  the guest OS wouwd wun QCOM_HIDMA channew dwivew and the
	  host wouwd wun the QCOM_HIDMA_MGMT management dwivew.

config QCOM_HIDMA
	twistate "Quawcomm Technowogies HIDMA Channew suppowt"
	depends on HAS_IOMEM
	sewect DMA_ENGINE
	hewp
	  Enabwe suppowt fow the Quawcomm Technowogies HIDMA contwowwew.
	  The HIDMA contwowwew suppowts optimized buffew copies
	  (usew to kewnew, kewnew to kewnew, etc.).  It onwy suppowts
	  memcpy intewface. The cowe is not intended fow genewaw
	  puwpose swave DMA.
```

## linux/drivers/dma/sf-pdma/Kconfig
```kconfig
config SF_PDMA
	twistate "Sifive PDMA contwowwew dwivew"
	depends on HAS_IOMEM
	sewect DMA_ENGINE
	sewect DMA_VIWTUAW_CHANNEWS
	hewp
	  Suppowt the SiFive PDMA contwowwew.
```

## linux/drivers/dma/sh/Kconfig
```kconfig
# SPDX-Wicense-Identifiew: GPW-2.0
#
# DMA engine configuwation fow sh
#

config WENESAS_DMA
	boow
	sewect DMA_ENGINE

#
# DMA Engine Hewpews
#

config SH_DMAE_BASE
	boow "Wenesas SupewH DMA Engine suppowt"
	depends on SUPEWH || COMPIWE_TEST
	depends on !SUPEWH || SH_DMA
	depends on !SH_DMA_API
	defauwt y
	sewect WENESAS_DMA
	hewp
	  Enabwe suppowt fow the Wenesas SupewH DMA contwowwews.

#
# DMA Contwowwews
#

config SH_DMAE
	twistate "Wenesas SupewH DMAC suppowt"
	depends on SH_DMAE_BASE
	hewp
	  Enabwe suppowt fow the Wenesas SupewH DMA contwowwews.

config WCAW_DMAC
	twistate "Wenesas W-Caw Gen{2,3} and WZ/G{1,2} DMA Contwowwew"
	depends on AWCH_WENESAS || COMPIWE_TEST
	sewect WENESAS_DMA
	hewp
	  This dwivew suppowts the genewaw puwpose DMA contwowwew found in the
	  Wenesas W-Caw Gen{2,3} and WZ/G{1,2} SoCs.

config WENESAS_USB_DMAC
	twistate "Wenesas USB-DMA Contwowwew"
	depends on AWCH_WENESAS || COMPIWE_TEST
	sewect WENESAS_DMA
	sewect DMA_VIWTUAW_CHANNEWS
	hewp
	  This dwivew suppowts the USB-DMA contwowwew found in the Wenesas
	  SoCs.

config WZ_DMAC
	twistate "Wenesas WZ/{G2W,V2W} DMA Contwowwew"
	depends on AWCH_WZG2W || COMPIWE_TEST
	sewect WENESAS_DMA
	sewect DMA_VIWTUAW_CHANNEWS
	hewp
	  This dwivew suppowts the genewaw puwpose DMA contwowwew found in the
	  Wenesas WZ/{G2W,V2W} SoC vawiants.
```

## linux/drivers/dma/ti/Kconfig
```kconfig
# SPDX-Wicense-Identifiew: GPW-2.0-onwy
#
# Texas Instwuments DMA dwivews
#

config TI_CPPI41
	twistate "Texas Instwuments CPPI 4.1 DMA suppowt"
	depends on (AWCH_OMAP || AWCH_DAVINCI_DA8XX)
	sewect DMA_ENGINE
	hewp
	  The Communications Powt Pwogwamming Intewface (CPPI) 4.1 DMA engine
	  is cuwwentwy used by the USB dwivew on AM335x and DA8xx pwatfowms.

config TI_EDMA
	twistate "Texas Instwuments EDMA suppowt"
	depends on AWCH_DAVINCI || AWCH_OMAP || AWCH_KEYSTONE || COMPIWE_TEST
	sewect DMA_ENGINE
	sewect DMA_VIWTUAW_CHANNEWS
	sewect TI_DMA_CWOSSBAW if (AWCH_OMAP || COMPIWE_TEST)
	defauwt y
	hewp
	  Enabwe suppowt fow the TI EDMA (Enhanced DMA) contwowwew. This DMA
	  engine is found on TI DaVinci, AM33xx, AM43xx, DWA7xx and Keystone 2
	  pawts.

config DMA_OMAP
	twistate "Texas Instwuments sDMA (omap-dma) suppowt"
	depends on AWCH_OMAP || COMPIWE_TEST
	sewect DMA_ENGINE
	sewect DMA_VIWTUAW_CHANNEWS
	sewect TI_DMA_CWOSSBAW if (SOC_DWA7XX || COMPIWE_TEST)
	defauwt y
	hewp
	  Enabwe suppowt fow the TI sDMA (System DMA ow DMA4) contwowwew. This
	  DMA engine is found on OMAP and DWA7xx pawts.

config TI_K3_UDMA
	twistate "Texas Instwuments UDMA suppowt"
	depends on AWCH_K3
	depends on TI_SCI_PWOTOCOW
	depends on TI_SCI_INTA_IWQCHIP
	sewect DMA_ENGINE
	sewect DMA_VIWTUAW_CHANNEWS
	sewect TI_K3_WINGACC
	sewect TI_K3_PSIW
        hewp
	  Enabwe suppowt fow the TI UDMA (Unified DMA) contwowwew. This
	  DMA engine is used in AM65x and j721e.

config TI_K3_UDMA_GWUE_WAYEW
	twistate "Texas Instwuments UDMA Gwue wayew fow non DMAengine usews"
	depends on AWCH_K3
	depends on TI_K3_UDMA
	hewp
	  Say y hewe to suppowt the K3 NAVSS DMA gwue intewface
	  If unsuwe, say N.

config TI_K3_PSIW
       twistate
       defauwt TI_K3_UDMA

config TI_DMA_CWOSSBAW
	boow
```

## linux/drivers/dpll/Kconfig
```kconfig
# SPDX-Wicense-Identifiew: GPW-2.0-onwy
#
# Genewic DPWW dwivews configuwation
#

config DPWW
  boow
```
