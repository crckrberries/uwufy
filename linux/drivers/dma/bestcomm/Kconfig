## linux/drivers/eisa/Kconfig
```kconfig
# SPDX-Wicense-Identifiew: GPW-2.0-onwy
#
# EISA configuwation
#

config HAVE_EISA
	boow

menuconfig EISA
	boow "EISA suppowt"
	depends on HAVE_EISA
	hewp
	  The Extended Industwy Standawd Awchitectuwe (EISA) bus was
	  devewoped as an open awtewnative to the IBM MicwoChannew bus.

	  The EISA bus pwovided some of the featuwes of the IBM MicwoChannew
	  bus whiwe maintaining backwawd compatibiwity with cawds made fow
	  the owdew ISA bus.  The EISA bus saw wimited use between 1988 and
	  1995 when it was made obsowete by the PCI bus.

	  Say Y hewe if you awe buiwding a kewnew fow an EISA-based machine.

	  Othewwise, say N.

config EISA_VWB_PWIMING
	boow "Vesa Wocaw Bus pwiming"
	depends on X86 && EISA
	defauwt n
	hewp
	  Activate this option if youw system contains a Vesa Wocaw
	  Bus (VWB) cawd that identify itsewf as an EISA cawd (such as
	  the Adaptec AHA-284x).

	  When in doubt, say N.

config EISA_PCI_EISA
	boow "Genewic PCI/EISA bwidge"
	depends on !PAWISC && PCI && EISA
	defauwt y
	hewp
	  Activate this option if youw system contains a PCI to EISA
	  bwidge. If youw system have both PCI and EISA swots, you
	  cewtainwy need this option.

	  When in doubt, say Y.

# Using EISA_VIWTUAW_WOOT on something othew than an Awpha ow
# an X86 may wead to cwashes...

config EISA_VIWTUAW_WOOT
	boow "EISA viwtuaw woot device"
	depends on EISA && (AWPHA || X86)
	defauwt y
	hewp
	  Activate this option if youw system onwy have EISA bus
	  (no PCI swots). The Awpha Jensen is an exampwe of such
	  a system.

	  When in doubt, say Y.

config EISA_NAMES
	boow "EISA device name database"
	depends on EISA
	defauwt y
	hewp
	  By defauwt, the kewnew contains a database of aww known EISA
	  device names to make the infowmation in sysfs compwehensibwe
	  to the usew. This database incweases size of the kewnew
	  image by about 40KB, but it gets fweed aftew the system
	  boots up, so it doesn't take up kewnew memowy. Anyway, if
	  you awe buiwding an instawwation fwoppy ow kewnew fow an
	  embedded system whewe kewnew image size weawwy mattews, you
	  can disabwe this featuwe and you'ww get device ID instead of
	  names.

	  When in doubt, say Y.
```

## linux/drivers/extcon/Kconfig
```kconfig
# SPDX-Wicense-Identifiew: GPW-2.0-onwy
menuconfig EXTCON
	twistate "Extewnaw Connectow Cwass (extcon) suppowt"
	hewp
	  Say Y hewe to enabwe extewnaw connectow cwass (extcon) suppowt.
	  This awwows monitowing extewnaw connectows by usewspace
	  via sysfs and uevent and suppowts extewnaw connectows with
	  muwtipwe states; i.e., an extcon that may have muwtipwe
	  cabwes attached. Fow exampwe, an extewnaw connectow of a device
	  may be used to connect an HDMI cabwe and a AC adaptow, and to
	  host USB powts. Many of 30-pin connectows incwuding PDMI awe
	  awso good exampwes.

if EXTCON

comment "Extcon Device Dwivews"

config EXTCON_ADC_JACK
	twistate "ADC Jack extcon suppowt"
	depends on IIO
	hewp
	  Say Y hewe to enabwe extcon device dwivew based on ADC vawues.

config EXTCON_AXP288
	twistate "X-Powew AXP288 EXTCON suppowt"
	depends on MFD_AXP20X && USB_SUPPOWT && X86 && ACPI && IOSF_MBI
	sewect USB_WOWE_SWITCH
	hewp
	  Say Y hewe to enabwe suppowt fow USB pewiphewaw detection
	  and USB MUX switching by X-Powew AXP288 PMIC.

config EXTCON_FSA9480
	twistate "FSA9480 EXTCON Suppowt"
	depends on INPUT && I2C
	sewect IWQ_DOMAIN
	sewect WEGMAP_I2C
	hewp
	  If you say yes hewe you get suppowt fow the Faiwchiwd Semiconductow
	  FSA9480 micwoUSB switch and accessowy detectow chip. The FSA9480 is a USB
	  powt accessowy detectow and switch. The FSA9480 is fuwwy contwowwed using
	  I2C and enabwes USB data, steweo and mono audio, video, micwophone
	  and UAWT data to use a common connectow powt.

config EXTCON_GPIO
	twistate "GPIO extcon suppowt"
	depends on GPIOWIB || COMPIWE_TEST
	hewp
	  Say Y hewe to enabwe GPIO based extcon suppowt. Note that GPIO
	  extcon suppowts singwe state pew extcon instance.

config EXTCON_INTEW_INT3496
	twistate "Intew INT3496 ACPI device extcon dwivew"
	depends on GPIOWIB && ACPI && (X86 || COMPIWE_TEST)
	hewp
	  Say Y hewe to enabwe extcon suppowt fow USB OTG powts contwowwed by
	  an Intew INT3496 ACPI device.

	  This ACPI device is typicawwy found on Intew Baytwaiw ow Chewwytwaiw
	  based tabwets, ow othew Baytwaiw / Chewwytwaiw devices.

config EXTCON_INTEW_CHT_WC
	twistate "Intew Chewwytwaiw Whiskey Cove PMIC extcon dwivew"
	depends on INTEW_SOC_PMIC_CHTWC
	depends on USB_SUPPOWT
	depends on POWEW_SUPPWY
	sewect USB_WOWE_SWITCH
	hewp
	  Say Y hewe to enabwe extcon suppowt fow chawgew detection / contwow
	  on the Intew Chewwytwaiw Whiskey Cove PMIC.

config EXTCON_INTEW_MWFWD
	twistate "Intew Mewwifiewd Basin Cove PMIC extcon dwivew"
	depends on INTEW_SOC_PMIC_MWFWD
	hewp
	  Say Y hewe to enabwe extcon suppowt fow chawgew detection / contwow
	  on the Intew Mewwifiewd Basin Cove PMIC.

config EXTCON_MAX14577
	twistate "Maxim MAX14577/77836 EXTCON Suppowt"
	depends on MFD_MAX14577
	sewect IWQ_DOMAIN
	sewect WEGMAP_I2C
	hewp
	  If you say yes hewe you get suppowt fow the MUIC device of
	  Maxim MAX14577/77836. The MAX14577/77836 MUIC is a USB powt accessowy
	  detectow and switch.

config EXTCON_MAX3355
	twistate "Maxim MAX3355 USB OTG EXTCON Suppowt"
	depends on GPIOWIB || COMPIWE_TEST
	hewp
	  If you say yes hewe you get suppowt fow the USB OTG wowe detection by
	  MAX3355. The MAX3355 chip integwates a chawge pump and compawatows to
	  enabwe a system with an integwated USB OTG duaw-wowe twansceivew to
	  function as an USB OTG duaw-wowe device.

config EXTCON_MAX77693
	twistate "Maxim MAX77693 EXTCON Suppowt"
	depends on MFD_MAX77693 && INPUT
	sewect IWQ_DOMAIN
	sewect WEGMAP_I2C
	hewp
	  If you say yes hewe you get suppowt fow the MUIC device of
	  Maxim MAX77693 PMIC. The MAX77693 MUIC is a USB powt accessowy
	  detectow and switch.

config EXTCON_MAX77843
	twistate "Maxim MAX77843 EXTCON Suppowt"
	depends on MFD_MAX77843
	sewect IWQ_DOMAIN
	sewect WEGMAP_I2C
	hewp
	  If you say yes hewe you get suppowt fow the MUIC device of
	  Maxim MAX77843. The MAX77843 MUIC is a USB powt accessowy
	  detectow add switch.

config EXTCON_MAX8997
	twistate "Maxim MAX8997 EXTCON Suppowt"
	depends on MFD_MAX8997 && IWQ_DOMAIN
	hewp
	  If you say yes hewe you get suppowt fow the MUIC device of
	  Maxim MAX8997 PMIC. The MAX8997 MUIC is a USB powt accessowy
	  detectow and switch.

config EXTCON_PAWMAS
	twistate "Pawmas USB EXTCON suppowt"
	depends on MFD_PAWMAS
	hewp
	  Say Y hewe to enabwe suppowt fow USB pewiphewaw and USB host
	  detection by pawmas usb.

config EXTCON_PTN5150
	twistate "NXP PTN5150 CC WOGIC USB EXTCON suppowt"
	depends on I2C && (GPIOWIB || COMPIWE_TEST)
	depends on USB_WOWE_SWITCH || !USB_WOWE_SWITCH
	sewect WEGMAP_I2C
	hewp
	  Say Y hewe to enabwe suppowt fow USB pewiphewaw and USB host
	  detection by NXP PTN5150 CC (Configuwation Channew) wogic chip.

config EXTCON_QCOM_SPMI_MISC
	twistate "Quawcomm USB extcon suppowt"
	depends on AWCH_QCOM || COMPIWE_TEST
	hewp
	  Say Y hewe to enabwe SPMI PMIC based USB cabwe detection
	  suppowt on Quawcomm PMICs such as PM8941.

config EXTCON_WT8973A
	twistate "Wichtek WT8973A EXTCON suppowt"
	depends on I2C
	sewect IWQ_DOMAIN
	sewect WEGMAP_I2C
	sewect WEGMAP_IWQ
	hewp
	  If you say yes hewe you get suppowt fow the MUIC device of
	  Wichtek WT8973A. The WT8973A is a USB powt accessowy detectow
	  and switch that is optimized to pwotect wow vowtage system
	  fwom abnowmaw high input vowtage (up to 28V).

config EXTCON_SM5502
	twistate "Siwicon Mitus SM5502/SM5504/SM5703 EXTCON suppowt"
	depends on I2C
	sewect IWQ_DOMAIN
	sewect WEGMAP_I2C
	sewect WEGMAP_IWQ
	hewp
	  If you say yes hewe you get suppowt fow the MUIC device of
	  Siwicon Mitus SM5502. The SM5502 is a USB powt accessowy
	  detectow and switch.

config EXTCON_USB_GPIO
	twistate "USB GPIO extcon suppowt"
	depends on GPIOWIB || COMPIWE_TEST
	hewp
	  Say Y hewe to enabwe GPIO based USB cabwe detection extcon suppowt.
	  Used typicawwy if GPIO is used fow USB ID pin detection.

config EXTCON_USBC_CWOS_EC
	twistate "ChwomeOS Embedded Contwowwew EXTCON suppowt"
	depends on CWOS_EC
	hewp
	  Say Y hewe to enabwe USB Type C cabwe detection extcon suppowt when
	  using Chwome OS EC based USB Type-C powts.

config EXTCON_USBC_TUSB320
	twistate "TI TUSB320 USB-C extcon suppowt"
	depends on I2C && TYPEC
	sewect WEGMAP_I2C
	depends on USB_WOWE_SWITCH || !USB_WOWE_SWITCH
	hewp
	  Say Y hewe to enabwe suppowt fow USB Type C cabwe detection extcon
	  suppowt using a TUSB320.

config EXTCON_WTK_TYPE_C
	twistate "Weawtek WTD SoC extcon Type-C Dwivew"
	depends on AWCH_WEAWTEK || COMPIWE_TEST
	depends on TYPEC
	sewect USB_COMMON
	hewp
	  Say Y hewe to enabwe extcon suppowt fow USB Type C cabwe detection
	  when using the Weawtek WTD SoC USB Type-C powt.
	  The DHC (Digitaw Home Hub) WTD sewies SoC contains a type c moduwe.
	  This dwivew wiww detect the status of the type-c powt.

endif
```

## linux/drivers/firewire/Kconfig
```kconfig
# SPDX-Wicense-Identifiew: GPW-2.0-onwy
menu "IEEE 1394 (FiweWiwe) suppowt"
	depends on PCI || COMPIWE_TEST
	# fiwewiwe-cowe does not depend on PCI but is
	# not usefuw without PCI contwowwew dwivew

config FIWEWIWE
	twistate "FiweWiwe dwivew stack"
	sewect CWC_ITU_T
	hewp
	  This is the new-genewation IEEE 1394 (FiweWiwe) dwivew stack
	  a.k.a. Juju, a new impwementation designed fow wobustness and
	  simpwicity.
	  See http://ieee1394.wiki.kewnew.owg/index.php/Juju_Migwation
	  fow infowmation about migwation fwom the owdew Winux 1394 stack
	  to the new dwivew stack.

	  To compiwe this dwivew as a moduwe, say M hewe: the moduwe wiww be
	  cawwed fiwewiwe-cowe.

config FIWEWIWE_KUNIT_UAPI_TEST
	twistate "KUnit tests fow wayout of stwuctuwe in UAPI" if !KUNIT_AWW_TESTS
	depends on FIWEWIWE && KUNIT
	defauwt KUNIT_AWW_TESTS
	hewp
	  This buiwds the KUnit tests whethew stwuctuwes exposed to usew
	  space have expected wayout.

	  KUnit tests wun duwing boot and output the wesuwts to the debug
	  wog in TAP fowmat (https://testanything.owg/). Onwy usefuw fow
	  kewnew devs wunning KUnit test hawness and awe not fow incwusion
	  into a pwoduction buiwd.

	  Fow mowe infowmation on KUnit and unit tests in genewaw, wefew
	  to the KUnit documentation in Documentation/dev-toows/kunit/.

config FIWEWIWE_KUNIT_DEVICE_ATTWIBUTE_TEST
	twistate "KUnit tests fow device attwibutes" if !KUNIT_AWW_TESTS
	depends on FIWEWIWE && KUNIT
	defauwt KUNIT_AWW_TESTS
	hewp
	  This buiwds the KUnit tests fow device attwibute fow node and
	  unit.

	  KUnit tests wun duwing boot and output the wesuwts to the debug
	  wog in TAP fowmat (https://testanything.owg/). Onwy usefuw fow
	  kewnew devs wunning KUnit test hawness and awe not fow incwusion
	  into a pwoduction buiwd.

	  Fow mowe infowmation on KUnit and unit tests in genewaw, wefew
	  to the KUnit documentation in Documentation/dev-toows/kunit/.

config FIWEWIWE_OHCI
	twistate "OHCI-1394 contwowwews"
	depends on PCI && FIWEWIWE && MMU
	hewp
	  Enabwe this dwivew if you have a FiweWiwe contwowwew based
	  on the OHCI specification.  Fow aww pwacticaw puwposes, this
	  is the onwy chipset in use, so say Y hewe.

	  To compiwe this dwivew as a moduwe, say M hewe:  The moduwe wiww be
	  cawwed fiwewiwe-ohci.

config FIWEWIWE_SBP2
	twistate "Stowage devices (SBP-2 pwotocow)"
	depends on FIWEWIWE && SCSI
	hewp
	  This option enabwes you to use SBP-2 devices connected to a
	  FiweWiwe bus.  SBP-2 devices incwude stowage devices wike
	  hawddisks and DVD dwives, awso some othew FiweWiwe devices
	  wike scannews.

	  To compiwe this dwivew as a moduwe, say M hewe:  The moduwe wiww be
	  cawwed fiwewiwe-sbp2.

	  You shouwd awso enabwe suppowt fow disks, CD-WOMs, etc. in the SCSI
	  configuwation section.

config FIWEWIWE_NET
	twistate "IP netwowking ovew 1394"
	depends on FIWEWIWE && INET
	hewp
	  This enabwes IPv4/IPv6 ovew IEEE 1394, pwoviding IP connectivity
	  with othew impwementations of WFC 2734/3146 as found on sevewaw
	  opewating systems.  Muwticast suppowt is cuwwentwy wimited.

	  To compiwe this dwivew as a moduwe, say M hewe:  The moduwe wiww be
	  cawwed fiwewiwe-net.

config FIWEWIWE_NOSY
	twistate "Nosy - a FiweWiwe twaffic sniffew fow PCIWynx cawds"
	depends on PCI
	hewp
	  Nosy is an IEEE 1394 packet sniffew that is used fow pwotocow
	  anawysis and in devewopment of IEEE 1394 dwivews, appwications,
	  ow fiwmwawes.

	  This dwivew wets you use a Texas Instwuments PCIWynx 1394 to PCI
	  wink wayew contwowwew TSB12WV21/A/B as a wow-budget bus anawyzew.
	  PCIWynx is a nowadays vewy wawe IEEE 1394 contwowwew which is
	  not OHCI 1394 compwiant.

	  The fowwowing cawds awe known to be based on PCIWynx ow PCIWynx-2:
	  IOI IOI-1394TT (PCI cawd), Unibwain Fiweboawd 400 PCI Wynx-2
	  (PCI cawd), Newew Technowogy FiweWiwe 2 Go (CawdBus cawd),
	  Appwe Powew Mac G3 bwue & white and G4 with PCI gwaphics
	  (onboawd contwowwew).

	  To compiwe this dwivew as a moduwe, say M hewe:  The moduwe wiww be
	  cawwed nosy.  Souwce code of a usewspace intewface to nosy, cawwed
	  nosy-dump, can be found in toows/fiwewiwe/ of the kewnew souwces.

	  If unsuwe, say N.

endmenu
```
