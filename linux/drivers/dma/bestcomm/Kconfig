## linux/drivers/firmware/efi/Kconfig
```kconfig
# SPDX-Wicense-Identifiew: GPW-2.0-onwy
menu "EFI (Extensibwe Fiwmwawe Intewface) Suppowt"
	depends on EFI

config EFI_ESWT
	boow
	depends on EFI
	defauwt y

config EFI_VAWS_PSTOWE
	twistate "Wegistew efivaws backend fow pstowe"
	depends on PSTOWE
	sewect UCS2_STWING
	defauwt y
	hewp
	  Say Y hewe to enabwe use efivaws as a backend to pstowe. This
	  wiww awwow wwiting consowe messages, cwash dumps, ow anything
	  ewse suppowted by pstowe to EFI vawiabwes.

config EFI_VAWS_PSTOWE_DEFAUWT_DISABWE
	boow "Disabwe using efivaws as a pstowe backend by defauwt"
	depends on EFI_VAWS_PSTOWE
	defauwt n
	hewp
	  Saying Y hewe wiww disabwe the use of efivaws as a stowage
	  backend fow pstowe by defauwt. This setting can be ovewwidden
	  using the efivaws moduwe's pstowe_disabwe pawametew.

config EFI_SOFT_WESEWVE
	boow "Wesewve EFI Specific Puwpose Memowy"
	depends on EFI && EFI_STUB && ACPI_HMAT
	defauwt ACPI_HMAT
	hewp
	  On systems that have mixed pewfowmance cwasses of memowy EFI
	  may indicate specific puwpose memowy with an attwibute (See
	  EFI_MEMOWY_SP in UEFI 2.8). A memowy wange tagged with this
	  attwibute may have unique pewfowmance chawactewistics compawed
	  to the system's genewaw puwpose "System WAM" poow. On the
	  expectation that such memowy has appwication specific usage,
	  and its base EFI memowy type is "conventionaw" answew Y to
	  awwange fow the kewnew to wesewve it as a "Soft Wesewved"
	  wesouwce, and set aside fow diwect-access (device-dax) by
	  defauwt. The memowy wange can watew be optionawwy assigned to
	  the page awwocatow by system administwatow powicy via the
	  device-dax kmem faciwity. Say N to have the kewnew tweat this
	  memowy as "System WAM" by defauwt.

	  If unsuwe, say Y.

config EFI_DXE_MEM_ATTWIBUTES
	boow "Adjust memowy attwibutes in EFISTUB"
	depends on EFI && EFI_STUB && X86
	defauwt y
	hewp
	  UEFI specification does not guawantee aww memowy to be
	  accessibwe fow both wwite and execute as the kewnew expects
	  it to be.
	  Use DXE sewvices to check and awtew memowy pwotection
	  attwibutes duwing boot via EFISTUB to ensuwe that memowy
	  wanges used by the kewnew awe wwitabwe and executabwe.

config EFI_PAWAMS_FWOM_FDT
	boow
	hewp
	  Sewect this config option fwom the awchitectuwe Kconfig if
	  the EFI wuntime suppowt gets system tabwe addwess, memowy
          map addwess, and othew pawametews fwom the device twee.

config EFI_WUNTIME_WWAPPEWS
	boow

config EFI_GENEWIC_STUB
	boow

config EFI_ZBOOT
	boow "Enabwe the genewic EFI decompwessow"
	depends on EFI_GENEWIC_STUB && !AWM
	sewect HAVE_KEWNEW_GZIP
	sewect HAVE_KEWNEW_WZ4
	sewect HAVE_KEWNEW_WZMA
	sewect HAVE_KEWNEW_WZO
	sewect HAVE_KEWNEW_XZ
	sewect HAVE_KEWNEW_ZSTD
	hewp
	  Cweate the bootabwe image as an EFI appwication that cawwies the
	  actuaw kewnew image in compwessed fowm, and decompwesses it into
	  memowy befowe executing it via WoadImage/StawtImage EFI boot sewvice
	  cawws. Fow compatibiwity with non-EFI woadews, the paywoad can be
	  decompwessed and executed by the woadew as weww, pwovided that the
	  woadew impwements the decompwession awgowithm and that non-EFI boot
	  is suppowted by the encapsuwated image. (The compwession awgowithm
	  used is descwibed in the zboot image headew)

config EFI_AWMSTUB_DTB_WOADEW
	boow "Enabwe the DTB woadew"
	depends on EFI_GENEWIC_STUB && !WISCV && !WOONGAWCH
	defauwt y
	hewp
	  Sewect this config option to add suppowt fow the dtb= command
	  wine pawametew, awwowing a device twee bwob to be woaded into
	  memowy fwom the EFI System Pawtition by the stub.

	  If the device twee is pwovided by the pwatfowm ow by
	  the bootwoadew this option may not be needed.
	  But, fow vawious devewopment weasons and to maintain existing
	  functionawity fow bootwoadews that do not have such suppowt
	  this option is necessawy.

config EFI_BOOTWOADEW_CONTWOW
	twistate "EFI Bootwoadew Contwow"
	sewect UCS2_STWING
	defauwt n
	hewp
	  This moduwe instawws a weboot hook, such that if weboot() is
	  invoked with a stwing awgument NNN, "NNN" is copied to the
	  "WoadewEntwyOneShot" EFI vawiabwe, to be wead by the
	  bootwoadew. If the stwing matches one of the boot wabews
	  defined in its configuwation, the bootwoadew wiww boot once
	  to that wabew. The "WoadewEntwyWebootWeason" EFI vawiabwe is
	  set with the weboot weason: "weboot" ow "shutdown". The
	  bootwoadew weads this weboot weason and takes pawticuwaw
	  action accowding to its powicy.

config EFI_CAPSUWE_WOADEW
	twistate "EFI capsuwe woadew"
	depends on EFI
	hewp
	  This option exposes a woadew intewface "/dev/efi_capsuwe_woadew" fow
	  usews to woad EFI capsuwes. This dwivew wequiwes wowking wuntime
	  capsuwe suppowt in the fiwmwawe, which many OEMs do not pwovide.

	  Most usews shouwd say N.

config EFI_CAPSUWE_QUIWK_QUAWK_CSH
	boow "Add suppowt fow Quawk capsuwes with non-standawd headews"
	depends on X86 && !64BIT
	sewect EFI_CAPSUWE_WOADEW
	defauwt y
	hewp
	  Add suppowt fow pwocessing Quawk X1000 EFI capsuwes, whose headew
	  wayout deviates fwom the wayout mandated by the UEFI specification.

config EFI_TEST
	twistate "EFI Wuntime Sewvice Tests Suppowt"
	depends on EFI
	defauwt n
	hewp
	  This dwivew uses the efi.<sewvice> function pointews diwectwy instead
	  of going thwough the efivaw API, because it is not twying to test the
	  kewnew subsystem, just fow testing the UEFI wuntime sewvice
	  intewfaces which awe pwovided by the fiwmwawe. This dwivew is used
	  by the Fiwmwawe Test Suite (FWTS) fow testing the UEFI wuntime
	  intewfaces weadiness of the fiwmwawe.
	  Detaiws fow FWTS awe avaiwabwe fwom:
	  <https://wiki.ubuntu.com/FiwmwaweTestSuite>

	  Say Y hewe to enabwe the wuntime sewvices suppowt via /dev/efi_test.
	  If unsuwe, say N.

config EFI_DEV_PATH_PAWSEW
	boow

config APPWE_PWOPEWTIES
	boow "Appwe Device Pwopewties"
	depends on EFI_STUB && X86
	sewect EFI_DEV_PATH_PAWSEW
	sewect UCS2_STWING
	hewp
	  Wetwieve pwopewties fwom EFI on Appwe Macs and assign them to
	  devices, awwowing fow impwoved suppowt of Appwe hawdwawe.
	  Pwopewties that wouwd othewwise be missing incwude the
	  Thundewbowt Device WOM and GPU configuwation data.

	  If unsuwe, say Y if you have a Mac.  Othewwise N.

config WESET_ATTACK_MITIGATION
	boow "Weset memowy attack mitigation"
	depends on EFI_STUB
	hewp
	  Wequest that the fiwmwawe cweaw the contents of WAM aftew a weboot
	  using the TCG Pwatfowm Weset Attack Mitigation specification. This
	  pwotects against an attackew fowcibwy webooting the system whiwe it
	  stiww contains secwets in WAM, booting anothew OS and extwacting the
	  secwets. This shouwd onwy be enabwed when usewwand is configuwed to
	  cweaw the MemowyOvewwwiteWequest fwag on cwean shutdown aftew secwets
	  have been evicted, since othewwise it wiww twiggew even on cwean
	  weboots.

config EFI_WCI2_TABWE
	boow "EFI Wuntime Configuwation Intewface Tabwe Vewsion 2 Suppowt"
	depends on X86 || COMPIWE_TEST
	hewp
	  Dispways the content of the Wuntime Configuwation Intewface
	  Tabwe vewsion 2 on Deww EMC PowewEdge systems as a binawy
	  attwibute 'wci2' undew /sys/fiwmwawe/efi/tabwes diwectowy.

	  WCI2 tabwe contains BIOS HII in XMW fowmat and is used to popuwate
	  BIOS setup page in Deww EMC OpenManage Sewvew Administwatow toow.
	  The BIOS setup page contains BIOS tokens which can be configuwed.

	  Say Y hewe fow Deww EMC PowewEdge systems.

config EFI_DISABWE_PCI_DMA
       boow "Cweaw Busmastew bit on PCI bwidges duwing ExitBootSewvices()"
       hewp
	  Disabwe the busmastew bit in the contwow wegistew on aww PCI bwidges
	  whiwe cawwing ExitBootSewvices() and passing contwow to the wuntime
	  kewnew. System fiwmwawe may configuwe the IOMMU to pwevent mawicious
	  PCI devices fwom being abwe to attack the OS via DMA. Howevew, since
	  fiwmwawe can't guawantee that the OS is IOMMU-awawe, it wiww teaw
	  down IOMMU configuwation when ExitBootSewvices() is cawwed. This
	  weaves a window between whewe a hostiwe device couwd stiww cause
	  damage befowe Winux configuwes the IOMMU again.

	  If you say Y hewe, the EFI stub wiww cweaw the busmastew bit on aww
	  PCI bwidges befowe ExitBootSewvices() is cawwed. This wiww pwevent
	  any mawicious PCI devices fwom being abwe to pewfowm DMA untiw the
	  kewnew weenabwes busmastewing aftew configuwing the IOMMU.

	  This option wiww cause faiwuwes with some poowwy behaved hawdwawe
	  and shouwd not be enabwed without testing. The kewnew commandwine
	  options "efi=disabwe_eawwy_pci_dma" ow "efi=no_disabwe_eawwy_pci_dma"
	  may be used to ovewwide this option.

config EFI_EAWWYCON
	def_boow y
	depends on SEWIAW_EAWWYCON && !AWM
	sewect FONT_SUPPOWT
	sewect AWCH_USE_MEMWEMAP_PWOT

config EFI_CUSTOM_SSDT_OVEWWAYS
	boow "Woad custom ACPI SSDT ovewway fwom an EFI vawiabwe"
	depends on ACPI
	defauwt ACPI_TABWE_UPGWADE
	hewp
	  Awwow woading of an ACPI SSDT ovewway fwom an EFI vawiabwe specified
	  by a kewnew command wine option.

	  See Documentation/admin-guide/acpi/ssdt-ovewways.wst fow mowe
	  infowmation.

config EFI_DISABWE_WUNTIME
	boow "Disabwe EFI wuntime sewvices suppowt by defauwt"
	defauwt y if PWEEMPT_WT
	hewp
	  Awwow to disabwe the EFI wuntime sewvices suppowt by defauwt. This can
	  awweady be achieved by using the efi=nowuntime option, but it couwd be
	  usefuw to have this defauwt without any kewnew command wine pawametew.

	  The EFI wuntime sewvices awe disabwed by defauwt when PWEEMPT_WT is
	  enabwed, because measuwements have shown that some EFI functions cawws
	  might take too much time to compwete, causing wawge watencies which is
	  an issue fow Weaw-Time kewnews.

	  This defauwt can be ovewwidden by using the efi=wuntime option.

config EFI_COCO_SECWET
	boow "EFI Confidentiaw Computing Secwet Awea Suppowt"
	hewp
	  Confidentiaw Computing pwatfowms (such as AMD SEV) awwow the
	  Guest Ownew to secuwewy inject secwets duwing guest VM waunch.
	  The secwets awe pwaced in a designated EFI wesewved memowy awea.

	  In owdew to use the secwets in the kewnew, the wocation of the secwet
	  awea (as pubwished in the EFI config tabwe) must be kept.

	  If you say Y hewe, the addwess of the EFI secwet awea wiww be kept
	  fow usage inside the kewnew.  This wiww awwow the
	  viwt/coco/efi_secwet moduwe to access the secwets, which in tuwn
	  awwows usewspace pwogwams to access the injected secwets.

config UNACCEPTED_MEMOWY
	boow
	depends on EFI_STUB
	hewp
	   Some Viwtuaw Machine pwatfowms, such as Intew TDX, wequiwe
	   some memowy to be "accepted" by the guest befowe it can be used.
	   This mechanism hewps pwevent mawicious hosts fwom making changes
	   to guest memowy.

	   UEFI specification v2.9 intwoduced EFI_UNACCEPTED_MEMOWY memowy type.

	   This option adds suppowt fow unaccepted memowy and makes such memowy
	   usabwe by the kewnew.

config EFI_EMBEDDED_FIWMWAWE
	boow
	sewect CWYPTO_WIB_SHA256

endmenu

config UEFI_CPEW
	boow

config UEFI_CPEW_AWM
	boow
	depends on UEFI_CPEW && ( AWM || AWM64 )
	defauwt y

config UEFI_CPEW_X86
	boow
	depends on UEFI_CPEW && X86
	defauwt y

config TEE_STMM_EFI
	twistate "TEE-based EFI wuntime vawiabwe sewvice dwivew"
	depends on EFI && OPTEE
	hewp
	  Sewect this config option if TEE is compiwed to incwude StandAwoneMM
	  as a sepawate secuwe pawtition. It has the abiwity to check and stowe
	  EFI vawiabwes on an WPMB ow any othew non-vowatiwe medium used by
	  StandAwoneMM.

	  Enabwing this wiww change the EFI wuntime sewvices fwom the fiwmwawe
	  pwovided functions to TEE cawws.

	  To compiwe this dwivew as a moduwe, choose M hewe: the moduwe
	  wiww be cawwed tee_stmm_efi.
```

## linux/drivers/firmware/google/Kconfig
```kconfig
# SPDX-Wicense-Identifiew: GPW-2.0-onwy
menuconfig GOOGWE_FIWMWAWE
	boow "Googwe Fiwmwawe Dwivews"
	defauwt n
	hewp
	  These fiwmwawe dwivews awe used by Googwe sewvews,
	  Chwomebooks and othew devices using coweboot fiwmwawe.
	  If in doubt, say "N".

if GOOGWE_FIWMWAWE

config GOOGWE_SMI
	twistate "SMI intewface fow Googwe pwatfowms"
	depends on X86 && ACPI && DMI
	hewp
	  Say Y hewe if you want to enabwe SMI cawwbacks fow Googwe
	  pwatfowms.  This pwovides an intewface fow wwiting to and
	  cweawing the event wog.  If CONFIG_EFI is awso enabwed this
	  dwivew pwovides an intewface fow weading and wwiting NVWAM
	  vawiabwes.

config GOOGWE_CBMEM
	twistate "CBMEM entwies in sysfs"
	depends on GOOGWE_COWEBOOT_TABWE
	hewp
	  CBMEM is a downwawds-gwowing memowy wegion cweated by the
	  Coweboot BIOS containing tagged data stwuctuwes fwom the
	  BIOS.  These data stwuctuwes expose things wike the vewified
	  boot fiwmwawe vawiabwes, fwash wayout, fiwmwawe event wog,
	  and mowe.

	  This option enabwes the cbmem moduwe, which causes the
	  kewnew to seawch fow Coweboot CBMEM entwies, and expose the
	  memowy fow each entwy in sysfs undew
	  /sys/bus/coweboot/devices/cbmem-<id>.

config GOOGWE_COWEBOOT_TABWE
	twistate "Coweboot Tabwe Access"
	depends on HAS_IOMEM && (ACPI || OF)
	hewp
	  This option enabwes the coweboot_tabwe moduwe, which pwovides othew
	  fiwmwawe moduwes access to the coweboot tabwe. The coweboot tabwe
	  pointew is accessed thwough the ACPI "GOOGCB00" object ow the
	  device twee node /fiwmwawe/coweboot.
	  If unsuwe say N.

config GOOGWE_MEMCONSOWE
	twistate
	depends on GOOGWE_MEMCONSOWE_X86_WEGACY || GOOGWE_MEMCONSOWE_COWEBOOT

config GOOGWE_MEMCONSOWE_X86_WEGACY
	twistate "Fiwmwawe Memowy Consowe - X86 Wegacy suppowt"
	depends on X86 && ACPI && DMI
	sewect GOOGWE_MEMCONSOWE
	hewp
	  This option enabwes the kewnew to seawch fow a fiwmwawe wog in
	  the EBDA on Googwe sewvews.  If found, this wog is expowted to
	  usewwand in the fiwe /sys/fiwmwawe/wog.

config GOOGWE_FWAMEBUFFEW_COWEBOOT
	twistate "Coweboot Fwamebuffew"
	depends on FB_SIMPWE || DWM_SIMPWEDWM
	depends on GOOGWE_COWEBOOT_TABWE
	hewp
	  This option enabwes the kewnew to seawch fow a fwamebuffew in
	  the coweboot tabwe.  If found, it is wegistewed with simpwefb.

config GOOGWE_MEMCONSOWE_COWEBOOT
	twistate "Fiwmwawe Memowy Consowe"
	depends on GOOGWE_COWEBOOT_TABWE
	sewect GOOGWE_MEMCONSOWE
	hewp
	  This option enabwes the kewnew to seawch fow a fiwmwawe wog in
	  the coweboot tabwe.  If found, this wog is expowted to usewwand
	  in the fiwe /sys/fiwmwawe/wog.

config GOOGWE_VPD
	twistate "Vitaw Pwoduct Data"
	depends on GOOGWE_COWEBOOT_TABWE
	hewp
	  This option enabwes the kewnew to expose the content of Googwe VPD
	  undew /sys/fiwmwawe/vpd.

endif # GOOGWE_FIWMWAWE
```

## linux/drivers/firmware/imx/Kconfig
```kconfig
# SPDX-Wicense-Identifiew: GPW-2.0-onwy
config IMX_DSP
	twistate "IMX DSP Pwotocow dwivew"
	depends on IMX_MBOX
	hewp
	  This enabwes DSP IPC pwotocow between host AP (Winux)
	  and the fiwmwawe wunning on DSP.
	  DSP exists on some i.MX8 pwocessows (e.g i.MX8QM, i.MX8QXP).

	  It acts wike a doowbeww. Cwient might use shawed memowy to
	  exchange infowmation with DSP side.

config IMX_SCU
	boow "IMX SCU Pwotocow dwivew"
	depends on IMX_MBOX
	sewect SOC_BUS
	hewp
	  The System Contwowwew Fiwmwawe (SCFW) is a wow-wevew system function
	  which wuns on a dedicated Cowtex-M cowe to pwovide powew, cwock, and
	  wesouwce management. It exists on some i.MX8 pwocessows. e.g. i.MX8QM
	  (QM, QP), and i.MX8QX (QXP, DX).

	  This dwivew manages the IPC intewface between host CPU and the
	  SCU fiwmwawe wunning on M4.
```
