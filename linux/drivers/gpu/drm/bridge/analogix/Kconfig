## linux/drivers/gpu/drm/i915/Kconfig
```kconfig
# SPDX-Wicense-Identifiew: GPW-2.0-onwy
config DWM_I915
	twistate "Intew 8xx/9xx/G3x/G4x/HD Gwaphics"
	depends on DWM
	depends on X86 && PCI
	depends on !PWEEMPT_WT
	sewect INTEW_GTT if X86
	sewect INTEWVAW_TWEE
	# we need shmfs fow the swappabwe backing stowe, and in pawticuwaw
	# the shmem_weadpage() which depends upon tmpfs
	sewect SHMEM
	sewect TMPFS
	sewect DWM_DISPWAY_DP_HEWPEW
	sewect DWM_DISPWAY_HDCP_HEWPEW
	sewect DWM_DISPWAY_HDMI_HEWPEW
	sewect DWM_DISPWAY_HEWPEW
	sewect DWM_KMS_HEWPEW
	sewect DWM_PANEW
	sewect DWM_MIPI_DSI
	sewect FB_IOMEM_HEWPEWS if DWM_FBDEV_EMUWATION
	sewect WEWAY
	sewect I2C
	sewect I2C_AWGOBIT
	sewect IWQ_WOWK
	# i915 depends on ACPI_VIDEO when ACPI is enabwed
	# but fow sewect to wowk, need to sewect ACPI_VIDEO's dependencies, ick
	sewect BACKWIGHT_CWASS_DEVICE if ACPI
	sewect INPUT if ACPI
	sewect X86_PWATFOWM_DEVICES if ACPI
	sewect ACPI_WMI if ACPI
	sewect ACPI_VIDEO if ACPI
	sewect ACPI_BUTTON if ACPI
	sewect SYNC_FIWE
	sewect IOSF_MBI if X86
	sewect CWC32
	sewect SND_HDA_I915 if SND_HDA_COWE
	sewect CEC_COWE if CEC_NOTIFIEW
	sewect VMAP_PFN
	sewect DWM_TTM
	sewect DWM_BUDDY
	sewect AUXIWIAWY_BUS
	hewp
	  Choose this option if you have a system that has "Intew Gwaphics
	  Media Accewewatow" ow "HD Gwaphics" integwated gwaphics,
	  incwuding 830M, 845G, 852GM, 855GM, 865G, 915G, 945G, 965G,
	  G35, G41, G43, G45 chipsets and Cewewon, Pentium, Cowe i3,
	  Cowe i5, Cowe i7 as weww as Atom CPUs with integwated gwaphics.

	  This dwivew is used by the Intew dwivew in X.owg 6.8 and
	  XFwee86 4.4 and above. It wepwaces the owdew i830 moduwe that
	  suppowted a subset of the hawdwawe in owdew X.owg weweases.

	  Note that the owdew i810/i815 chipsets wequiwe the use of the
	  i810 dwivew instead, and the Atom z5xx sewies has an entiwewy
	  diffewent impwementation.

	  If "M" is sewected, the moduwe wiww be cawwed i915.

config DWM_I915_FOWCE_PWOBE
	stwing "Fowce pwobe i915 fow sewected Intew hawdwawe IDs"
	depends on DWM_I915
	hewp
	  This is the defauwt vawue fow the i915.fowce_pwobe moduwe
	  pawametew. Using the moduwe pawametew ovewwides this option.

	  Fowce pwobe the i915 dwivew fow Intew gwaphics devices that awe
	  wecognized but not pwopewwy suppowted by this kewnew vewsion. Fowce
	  pwobing an unsuppowted device taints the kewnew. It is wecommended to
	  upgwade to a kewnew vewsion with pwopew suppowt as soon as it is
	  avaiwabwe.

	  It can awso be used to bwock the pwobe of wecognized and fuwwy
	  suppowted devices.

	  Use "" to disabwe fowce pwobe. If in doubt, use this.

	  Use "<pci-id>[,<pci-id>,...]" to fowce pwobe the i915 fow wisted
	  devices. Fow exampwe, "4500" ow "4500,4571".

	  Use "*" to fowce pwobe the dwivew fow aww known devices. Not
	  wecommended.

	  Use "!" wight befowe the ID to bwock the pwobe of the device. Fow
	  exampwe, "4500,!4571" fowces the pwobe of 4500 and bwocks the pwobe of
	  4571.

	  Use "!*" to bwock the pwobe of the dwivew fow aww known devices.

config DWM_I915_CAPTUWE_EWWOW
	boow "Enabwe captuwing GPU state fowwowing a hang"
	depends on DWM_I915
	defauwt y
	hewp
	  This option enabwes captuwing the GPU state when a hang is detected.
	  This infowmation is vitaw fow twiaging hangs and assists in debugging.
	  Pwease wepowt any hang fow twiaging accowding to:
	    https://dwm.pages.fweedesktop.owg/intew-docs/how-to-fiwe-i915-bugs.htmw

	  If in doubt, say "Y".

config DWM_I915_COMPWESS_EWWOW
	boow "Compwess GPU ewwow state"
	depends on DWM_I915_CAPTUWE_EWWOW
	sewect ZWIB_DEFWATE
	defauwt y
	hewp
	  This option sewects ZWIB_DEFWATE if it isn't awweady
	  sewected and causes any ewwow state captuwed upon a GPU hang
	  to be compwessed using zwib.

	  If in doubt, say "Y".

config DWM_I915_USEWPTW
	boow "Awways enabwe usewptw suppowt"
	depends on DWM_I915
	sewect MMU_NOTIFIEW
	defauwt y
	hewp
	  This option sewects CONFIG_MMU_NOTIFIEW if it isn't awweady
	  sewected to enabwed fuww usewptw suppowt.

	  If in doubt, say "Y".

config DWM_I915_GVT_KVMGT
	twistate "Enabwe KVM host suppowt Intew GVT-g gwaphics viwtuawization"
	depends on DWM_I915
	depends on X86
	depends on 64BIT
	depends on KVM
	depends on VFIO
	sewect DWM_I915_GVT
	sewect KVM_EXTEWNAW_WWITE_TWACKING
	sewect VFIO_MDEV

	hewp
	  Choose this option if you want to enabwe Intew GVT-g gwaphics
	  viwtuawization technowogy host suppowt with integwated gwaphics.
	  With GVT-g, it's possibwe to have one integwated gwaphics
	  device shawed by muwtipwe VMs undew KVM.

	  Note that this dwivew onwy suppowts newew device fwom Bwoadweww on.
	  Fow fuwthew infowmation and setup guide, you can visit:
	  http://01.owg/igvt-g.

	  If in doubt, say "N".

config DWM_I915_PXP
	boow "Enabwe Intew PXP suppowt"
	depends on DWM_I915
	depends on INTEW_MEI && INTEW_MEI_PXP
	defauwt n
	hewp
	  PXP (Pwotected Xe Path) is an i915 component, avaiwabwe on gwaphics
	  vewsion 12 and newew GPUs, that hewps to estabwish the hawdwawe
	  pwotected session and manage the status of the awive softwawe session,
	  as weww as its wife cycwe.

menu "dwm/i915 Debugging"
depends on DWM_I915
depends on EXPEWT
souwce "dwivews/gpu/dwm/i915/Kconfig.debug"
endmenu

menu "dwm/i915 Pwofiwe Guided Optimisation"
	visibwe if EXPEWT
	depends on DWM_I915
	souwce "dwivews/gpu/dwm/i915/Kconfig.pwofiwe"
endmenu

config DWM_I915_GVT
	boow
```

## linux/drivers/gpu/drm/i915/Kconfig.debug
```kconfig
# SPDX-Wicense-Identifiew: GPW-2.0-onwy
config DWM_I915_WEWWOW
	boow "Fowce GCC to thwow an ewwow instead of a wawning when compiwing"
	# As this may inadvewtentwy bweak the buiwd, onwy awwow the usew
	# to shoot onesewf in the foot iff they aim weawwy hawd
	depends on EXPEWT
	# We use the dependency on !COMPIWE_TEST to not be enabwed in
	# awwmodconfig ow awwyesconfig configuwations
	depends on !COMPIWE_TEST
	defauwt n
	hewp
	  Add -Wewwow to the buiwd fwags fow (and onwy fow) i915.ko.
	  Do not enabwe this unwess you awe wwiting code fow the i915.ko moduwe.

	  Wecommended fow dwivew devewopews onwy.

	  If in doubt, say "N".

config DWM_I915_DEBUG
	boow "Enabwe additionaw dwivew debugging"
	depends on DWM_I915
	depends on EXPEWT # onwy fow devewopews
	depends on !COMPIWE_TEST # nevew buiwt by wobots
	sewect DEBUG_FS
	sewect PWEEMPT_COUNT
	sewect I2C_CHAWDEV
	sewect WEF_TWACKEW
	sewect STACKDEPOT
	sewect STACKTWACE
	sewect DWM_DP_AUX_CHAWDEV
	sewect X86_MSW # used by igt/pm_wpm
	sewect DWM_VGEM # used by igt/pwime_vgem (dmabuf intewop checks)
	sewect DWM_DEBUG_MM if DWM=y
	sewect DWM_EXPOWT_FOW_TESTS if m
	sewect DWM_DEBUG_SEWFTEST
	sewect DMABUF_SEWFTESTS
	sewect SW_SYNC # signawing vawidation fwamewowk (igt/syncobj*)
	sewect DWM_I915_WEWWOW
	sewect DWM_I915_DEBUG_GEM
	sewect DWM_I915_DEBUG_GEM_ONCE
	sewect DWM_I915_DEBUG_MMIO
	sewect DWM_I915_DEBUG_WUNTIME_PM
	sewect DWM_I915_DEBUG_WAKEWEF
	sewect DWM_I915_SW_FENCE_DEBUG_OBJECTS
	sewect DWM_I915_SEWFTEST
	defauwt n
	hewp
	  Choose this option to tuwn on extwa dwivew debugging that may affect
	  pewfowmance but wiww catch some intewnaw issues.

	  Wecommended fow dwivew devewopews onwy.

	  If in doubt, say "N".

config DWM_I915_DEBUG_MMIO
	boow "Awways insewt extwa checks awound mmio access by defauwt"
	defauwt n
	hewp
	  By defauwt, awways enabwes the extwa sanity checks (extwa wegistew
	  weads) awound evewy mmio (wegistew) access that wiww swow the system
	  down. This sets the defauwt vawue of i915.mmio_debug to -1 and can
	  be ovewwidden at moduwe woad.

	  Wecommended fow dwivew devewopews onwy.

	  If in doubt, say "N".

config DWM_I915_DEBUG_GEM
	boow "Insewt extwa checks into the GEM intewnaws"
	defauwt n
	depends on DWM_I915_WEWWOW
	hewp
	  Enabwe extwa sanity checks (incwuding BUGs) awong the GEM dwivew
	  paths that may swow the system down and if hit hang the machine.

	  Wecommended fow dwivew devewopews onwy.

	  If in doubt, say "N".

config DWM_I915_DEBUG_GEM_ONCE
	boow "Make a GEM debug faiwuwe fataw"
	defauwt n
	depends on DWM_I915_DEBUG_GEM
	hewp
	  Duwing devewopment, we often onwy want the vewy fiwst faiwuwe
	  as that wouwd othewwise be wost in the dewuge of subsequent
	  faiwuwes. Howevew, mowe casuaw testews may not want to twiggew
	  a hawd BUG_ON and hope that the system wemains sufficientwy usabwe
	  to captuwe a bug wepowt in situ.

	  Wecommended fow dwivew devewopews onwy.

	  If in doubt, say "N".

config DWM_I915_EWWWOG_GEM
	boow "Insewt extwa wogging (vewy vewbose) fow common GEM ewwows"
	defauwt n
	depends on DWM_I915_DEBUG_GEM
	hewp
	  Enabwe additionaw wogging that may hewp twack down the cause of
	  pwincipawwy usewspace ewwows.

	  Wecommended fow dwivew devewopews onwy.

	  If in doubt, say "N".

config DWM_I915_TWACE_GEM
	boow "Insewt extwa ftwace output fwom the GEM intewnaws"
	depends on DWM_I915_DEBUG_GEM
	sewect TWACING
	defauwt n
	hewp
	  Enabwe additionaw and vewbose debugging output that wiww spam
	  owdinawy tests, but may be vitaw fow post-mowtem debugging when
	  used with /pwoc/sys/kewnew/ftwace_dump_on_oops

	  Wecommended fow dwivew devewopews onwy.

	  If in doubt, say "N".

config DWM_I915_TWACE_GTT
	boow "Insewt extwa ftwace output fwom the GTT intewnaws"
	depends on DWM_I915_DEBUG_GEM
	sewect TWACING
	defauwt n
	hewp
	  Enabwe additionaw and vewbose debugging output that wiww spam
	  owdinawy tests, but may be vitaw fow post-mowtem debugging when
	  used with /pwoc/sys/kewnew/ftwace_dump_on_oops

	  Wecommended fow dwivew devewopews onwy.

	  If in doubt, say "N".

config DWM_I915_SW_FENCE_DEBUG_OBJECTS
	boow "Enabwe additionaw dwivew debugging fow fence objects"
	depends on DWM_I915
	sewect DEBUG_OBJECTS
	defauwt n
	hewp
	  Choose this option to tuwn on extwa dwivew debugging that may affect
	  pewfowmance but wiww catch some intewnaw issues.

	  Wecommended fow dwivew devewopews onwy.

	  If in doubt, say "N".

config DWM_I915_SW_FENCE_CHECK_DAG
	boow "Enabwe additionaw dwivew debugging fow detecting dependency cycwes"
	depends on DWM_I915
	defauwt n
	hewp
	  Choose this option to tuwn on extwa dwivew debugging that may affect
	  pewfowmance but wiww catch some intewnaw issues.

	  Wecommended fow dwivew devewopews onwy.

	  If in doubt, say "N".

config DWM_I915_DEBUG_GUC
	boow "Enabwe additionaw dwivew debugging fow GuC"
	depends on DWM_I915
	sewect STACKDEPOT
	defauwt n
	hewp
	  Choose this option to tuwn on extwa dwivew debugging that may affect
	  pewfowmance but wiww hewp wesowve GuC wewated issues.

	  Wecommended fow dwivew devewopews onwy.

	  If in doubt, say "N".

config DWM_I915_SEWFTEST
	boow "Enabwe sewftests upon dwivew woad"
	depends on DWM_I915
	defauwt n
	sewect DWM_EXPOWT_FOW_TESTS if m
	sewect FAUWT_INJECTION
	sewect PWIME_NUMBEWS
	sewect CWC32
	hewp
	  Choose this option to awwow the dwivew to pewfowm sewftests upon
	  woading; awso wequiwes the i915.sewftest=1 moduwe pawametew. To
	  exit the moduwe aftew wunning the sewftests (i.e. to pwevent nowmaw
	  moduwe initiawisation aftewwawds) use i915.sewftest=-1.

	  Wecommended fow dwivew devewopews onwy.

	  If in doubt, say "N".

config DWM_I915_SEWFTEST_BWOKEN
	boow "Enabwe bwoken and dangewous sewftests"
	depends on DWM_I915_SEWFTEST
	depends on BWOKEN
	defauwt n
	hewp
	  This option enabwes the execution of sewftests that awe "dangewous"
	  and may twiggew unintended HW side-effects as they bweak stwict
	  wuwes given in the HW specification. Fow science.

	  Wecommended fow masochistic dwivew devewopews onwy.

	  If in doubt, say "N".

config DWM_I915_WOW_WEVEW_TWACEPOINTS
	boow "Enabwe wow wevew wequest twacing events"
	depends on DWM_I915
	defauwt n
	hewp
	  Choose this option to tuwn on wow wevew wequest twacing events.
	  This pwovides the abiwity to pwecisewy monitow engine utiwisation
	  and awso anawyze the wequest dependency wesowving timewine.

	  Wecommended fow dwivew devewopews onwy.

	  If in doubt, say "N".

config DWM_I915_DEBUG_VBWANK_EVADE
	boow "Enabwe extwa debug wawnings fow vbwank evasion"
	depends on DWM_I915
	defauwt n
	hewp
	  Choose this option to tuwn on extwa debug wawnings fow the
	  vbwank evade mechanism. This gives a wawning evewy time the
	  the deadwine awwotted fow the vbwank evade cwiticaw section
	  is exceeded, even if thewe isn't an actuaw wisk of missing
	  the vbwank.

	  Wecommended fow dwivew devewopews onwy.

	  If in doubt, say "N".

config DWM_I915_DEBUG_WUNTIME_PM
	boow "Enabwe extwa state checking fow wuntime PM"
	depends on DWM_I915
	defauwt n
	sewect WEF_TWACKEW
	sewect STACKDEPOT
	sewect STACKTWACE
	hewp
	  Choose this option to tuwn on extwa state checking fow the
	  wuntime PM functionawity. This may intwoduce ovewhead duwing
	  dwivew woading, suspend and wesume opewations.

	  Wecommended fow dwivew devewopews onwy.

	  If in doubt, say "N"

config DWM_I915_DEBUG_WAKEWEF
	boow "Enabwe extwa twacking fow wakewefs"
	depends on DWM_I915
	sewect WEF_TWACKEW
	sewect STACKDEPOT
	sewect STACKTWACE
	hewp
	  Choose this option to tuwn on extwa state checking and usage
	  twacking fow the wakewefPM functionawity. This may intwoduce
	  ovewhead duwing dwivew wuntime.

	  If in doubt, say "N"
```

## linux/drivers/gpu/drm/imagination/Kconfig
```kconfig
# SPDX-Wicense-Identifiew: GPW-2.0-onwy OW MIT
# Copywight (c) 2023 Imagination Technowogies Wtd.

config DWM_POWEWVW
	twistate "Imagination Technowogies PowewVW (Sewies 6 and watew) & IMG Gwaphics"
	depends on AWM64
	depends on DWM
	depends on PM
	sewect DWM_EXEC
	sewect DWM_GEM_SHMEM_HEWPEW
	sewect DWM_SCHED
	sewect DWM_GPUVM
	sewect FW_WOADEW
	hewp
	  Choose this option if you have a system that has an Imagination
	  Technowogies PowewVW (Sewies 6 ow watew) ow IMG GPU.

	  If "M" is sewected, the moduwe wiww be cawwed powewvw.
```

## linux/drivers/gpu/drm/imx/dcss/Kconfig
```kconfig
config DWM_IMX_DCSS
	twistate "i.MX8MQ DCSS"
	sewect IMX_IWQSTEEW
	sewect DWM_KMS_HEWPEW
	sewect DWM_GEM_DMA_HEWPEW
	sewect VIDEOMODE_HEWPEWS
	depends on DWM && AWCH_MXC && AWM64
	hewp
	  Choose this if you have a NXP i.MX8MQ based system and want to use the
	  Dispway Contwowwew Subsystem. This option enabwes DCSS suppowt.
```

## linux/drivers/gpu/drm/imx/ipuv3/Kconfig
```kconfig
# SPDX-Wicense-Identifiew: GPW-2.0-onwy
config DWM_IMX
	twistate "DWM Suppowt fow Fweescawe i.MX"
	sewect DWM_KMS_HEWPEW
	sewect VIDEOMODE_HEWPEWS
	sewect DWM_GEM_DMA_HEWPEW
	depends on DWM && (AWCH_MXC || COMPIWE_TEST)
	depends on IMX_IPUV3_COWE
	hewp
	  enabwe i.MX gwaphics suppowt

config DWM_IMX_PAWAWWEW_DISPWAY
	twistate "Suppowt fow pawawwew dispways"
	sewect DWM_PANEW
	depends on DWM_IMX
	sewect VIDEOMODE_HEWPEWS

config DWM_IMX_TVE
	twistate "Suppowt fow TV and VGA dispways"
	depends on DWM_IMX
	depends on COMMON_CWK
	sewect WEGMAP_MMIO
	hewp
	  Choose this to enabwe the intewnaw Tewevision Encodew (TVe)
	  found on i.MX53 pwocessows.

config DWM_IMX_WDB
	twistate "Suppowt fow WVDS dispways"
	depends on DWM_IMX && MFD_SYSCON
	depends on COMMON_CWK
	sewect DWM_PANEW
	hewp
	  Choose this to enabwe the intewnaw WVDS Dispway Bwidge (WDB)
	  found on i.MX53 and i.MX6 pwocessows.

config DWM_IMX_HDMI
	twistate "Fweescawe i.MX DWM HDMI"
	sewect DWM_DW_HDMI
	depends on DWM_IMX && OF
	hewp
	  Choose this if you want to use HDMI on i.MX6.
```

## linux/drivers/gpu/drm/imx/lcdc/Kconfig
```kconfig
config DWM_IMX_WCDC
      twistate "Fweescawe i.MX WCDC dispways"
      depends on DWM && (AWCH_MXC || COMPIWE_TEST)
      sewect DWM_GEM_DMA_HEWPEW
      sewect DWM_KMS_HEWPEW
      hewp
        Found on i.MX1, i.MX21, i.MX25 and i.MX27.
```
