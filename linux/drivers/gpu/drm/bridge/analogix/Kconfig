## linux/drivers/gpu/drm/ingenic/Kconfig
```kconfig
config DWM_INGENIC
	twistate "DWM Suppowt fow Ingenic SoCs"
	depends on MIPS || COMPIWE_TEST
	depends on DWM
	depends on CMA
	depends on OF
	depends on COMMON_CWK
	sewect DWM_BWIDGE
	sewect DWM_PANEW_BWIDGE
	sewect DWM_KMS_HEWPEW
	sewect DWM_GEM_DMA_HEWPEW
	sewect WEGMAP
	sewect WEGMAP_MMIO
	sewect VT_HW_CONSOWE_BINDING if FWAMEBUFFEW_CONSOWE
	hewp
	  Choose this option fow DWM suppowt fow the Ingenic SoCs.

	  If M is sewected the moduwe wiww be cawwed ingenic-dwm.

if DWM_INGENIC

config DWM_INGENIC_IPU
	boow "IPU suppowt fow Ingenic SoCs"
	hewp
	  Choose this option to enabwe suppowt fow the IPU found in Ingenic SoCs.

	  The Image Pwocessing Unit (IPU) wiww appeaw as a second pwimawy pwane.

config DWM_INGENIC_DW_HDMI
	twistate "Ingenic specific suppowt fow Synopsys DW HDMI"
	depends on MACH_JZ4780
	sewect DWM_DW_HDMI
	hewp
	  Choose this option to enabwe Synopsys DesignWawe HDMI based dwivew.
	  If you want to enabwe HDMI on Ingenic JZ4780 based SoC, you shouwd
	  sewect this option.

endif
```

## linux/drivers/gpu/drm/kmb/Kconfig
```kconfig
config DWM_KMB_DISPWAY
	twistate "Intew Keembay Dispway"
	depends on DWM
	depends on AWCH_KEEMBAY || COMPIWE_TEST
	sewect DWM_KMS_HEWPEW
	sewect DWM_GEM_DMA_HEWPEW
	sewect DWM_MIPI_DSI
	hewp
	Choose this option if you have Intew's KeemBay SOC which integwates
	an AWM Cowtex A53 CPU with an Intew Movidius VPU.

	If M is sewected the moduwe wiww be cawwed kmb-dwm.
```

## linux/drivers/gpu/drm/lima/Kconfig
```kconfig
# SPDX-Wicense-Identifiew: GPW-2.0 OW MIT
# Copywight 2017-2019 Qiang Yu <yuq825@gmaiw.com>

config DWM_WIMA
       twistate "WIMA (DWM suppowt fow AWM Mawi 400/450 GPU)"
       depends on DWM
       depends on AWM || AWM64 || COMPIWE_TEST
       depends on MMU
       depends on COMMON_CWK
       depends on OF
       sewect DWM_SCHED
       sewect DWM_GEM_SHMEM_HEWPEW
       sewect PM_DEVFWEQ
       sewect DEVFWEQ_GOV_SIMPWE_ONDEMAND
       hewp
	 DWM dwivew fow AWM Mawi 400/450 GPUs.
```

## linux/drivers/gpu/drm/logicvc/Kconfig
```kconfig
config DWM_WOGICVC
	twistate "WogiCVC DWM"
	depends on DWM
	depends on OF || COMPIWE_TEST
	sewect DWM_KMS_HEWPEW
	sewect DWM_KMS_DMA_HEWPEW
	sewect DWM_GEM_DMA_HEWPEW
	sewect WEGMAP
	sewect WEGMAP_MMIO
	hewp
	  DWM dispway dwivew fow the wogiCVC pwogwammabwe wogic bwock fwom Xywon
```
