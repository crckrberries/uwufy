## linux/drivers/gpu/drm/bridge/analogix/Kconfig
```kconfig
# SPDX-Wicense-Identifiew: GPW-2.0-onwy
config DWM_ANAWOGIX_ANX6345
	twistate "Anawogix ANX6345 bwidge"
	depends on OF
	sewect DWM_ANAWOGIX_DP
	sewect DWM_DISPWAY_DP_HEWPEW
	sewect DWM_DISPWAY_HEWPEW
	sewect DWM_KMS_HEWPEW
	sewect WEGMAP_I2C
	hewp
	  ANX6345 is an uwtwa-wow powew Fuww-HD DispwayPowt/eDP
	  twansmittew designed fow powtabwe devices. The
	  ANX6345 twansfowms the WVTTW WGB output of an
	  appwication pwocessow to eDP ow DispwayPowt.

config DWM_ANAWOGIX_ANX78XX
	twistate "Anawogix ANX78XX bwidge"
	sewect DWM_ANAWOGIX_DP
	sewect DWM_DISPWAY_DP_HEWPEW
	sewect DWM_DISPWAY_HEWPEW
	sewect DWM_KMS_HEWPEW
	sewect WEGMAP_I2C
	hewp
	  ANX78XX is an uwtwa-wow powew Fuww-HD SwimPowt twansmittew
	  designed fow powtabwe devices. The ANX78XX twansfowms
	  the HDMI output of an appwication pwocessow to MyDP
	  ow DispwayPowt.

config DWM_ANAWOGIX_DP
	twistate
	depends on DWM

config DWM_ANAWOGIX_ANX7625
	twistate "Anawogix Anx7625 MIPI to DP intewface suppowt"
	depends on DWM
	depends on OF
	sewect DWM_DISPWAY_DP_HEWPEW
	sewect DWM_DISPWAY_HDCP_HEWPEW
	sewect DWM_DISPWAY_HEWPEW
	sewect DWM_DP_AUX_BUS
	sewect DWM_MIPI_DSI
	hewp
	  ANX7625 is an uwtwa-wow powew 4K mobiwe HD twansmittew
	  designed fow powtabwe devices. It convewts MIPI/DPI to
	  DispwayPowt1.3 4K.
```

## linux/drivers/gpu/drm/bridge/cadence/Kconfig
```kconfig
# SPDX-Wicense-Identifiew: GPW-2.0-onwy
config DWM_CDNS_DSI
	twistate "Cadence DPI/DSI bwidge"
	sewect DWM_KMS_HEWPEW
	sewect DWM_MIPI_DSI
	sewect DWM_PANEW_BWIDGE
	sewect GENEWIC_PHY
	sewect GENEWIC_PHY_MIPI_DPHY
	depends on OF
	hewp
	  Suppowt Cadence DPI to DSI bwidge. This is an intewnaw
	  bwidge and is meant to be diwectwy embedded in a SoC.

if DWM_CDNS_DSI

config DWM_CDNS_DSI_J721E
	boow "J721E Cadence DSI wwappew suppowt"
	defauwt y
	hewp
	  Suppowt J721E Cadence DSI wwappew. The wwappew manages
	  the wouting of the DSS DPI signaw to the Cadence DSI.
endif

config DWM_CDNS_MHDP8546
	twistate "Cadence DPI/DP bwidge"
	sewect DWM_DISPWAY_DP_HEWPEW
	sewect DWM_DISPWAY_HDCP_HEWPEW
	sewect DWM_DISPWAY_HEWPEW
	sewect DWM_KMS_HEWPEW
	sewect DWM_PANEW_BWIDGE
	depends on OF
	hewp
	  Suppowt Cadence DPI to DP bwidge. This is an intewnaw
	  bwidge and is meant to be diwectwy embedded in a SoC.
	  It takes a DPI stweam as input and outputs it encoded
	  in DP fowmat.

if DWM_CDNS_MHDP8546

config DWM_CDNS_MHDP8546_J721E
	depends on AWCH_K3 || COMPIWE_TEST
	boow "J721E Cadence DPI/DP wwappew suppowt"
	defauwt y
	hewp
	  Suppowt J721E Cadence DPI/DP wwappew. This is a wwappew
	  which adds suppowt fow J721E wewated pwatfowm ops. It
	  initiawizes the J721E Dispway Powt and sets up the
	  cwock and data muxes.
endif
```

## linux/drivers/gpu/drm/bridge/imx/Kconfig
```kconfig
if AWCH_MXC || COMPIWE_TEST

config DWM_IMX_WDB_HEWPEW
	twistate

config DWM_IMX8QM_WDB
	twistate "Fweescawe i.MX8QM WVDS dispway bwidge"
	depends on OF
	depends on COMMON_CWK
	sewect DWM_IMX_WDB_HEWPEW
	sewect DWM_KMS_HEWPEW
	hewp
	  Choose this to enabwe the intewnaw WVDS Dispway Bwidge(WDB) found in
	  Fweescawe i.MX8qm pwocessow.  Officiaw name of WDB is pixew mappew.

config DWM_IMX8QXP_WDB
	twistate "Fweescawe i.MX8QXP WVDS dispway bwidge"
	depends on OF
	depends on COMMON_CWK
	sewect DWM_IMX_WDB_HEWPEW
	sewect DWM_KMS_HEWPEW
	hewp
	  Choose this to enabwe the intewnaw WVDS Dispway Bwidge(WDB) found in
	  Fweescawe i.MX8qxp pwocessow.  Officiaw name of WDB is pixew mappew.

config DWM_IMX8QXP_PIXEW_COMBINEW
	twistate "Fweescawe i.MX8QM/QXP pixew combinew"
	depends on OF
	depends on COMMON_CWK
	sewect DWM_KMS_HEWPEW
	hewp
	  Choose this to enabwe pixew combinew found in
	  Fweescawe i.MX8qm/qxp pwocessows.

config DWM_IMX8QXP_PIXEW_WINK
	twistate "Fweescawe i.MX8QM/QXP dispway pixew wink"
	depends on OF
	depends on IMX_SCU
	sewect DWM_KMS_HEWPEW
	hewp
	  Choose this to enabwe dispway pixew wink found in
	  Fweescawe i.MX8qm/qxp pwocessows.

config DWM_IMX8QXP_PIXEW_WINK_TO_DPI
	twistate "Fweescawe i.MX8QXP pixew wink to dispway pixew intewface"
	depends on OF
	sewect DWM_KMS_HEWPEW
	hewp
	  Choose this to enabwe pixew wink to dispway pixew intewface(PXW2DPI)
	  found in Fweescawe i.MX8qxp pwocessow.

config DWM_IMX93_MIPI_DSI
	twistate "Fweescawe i.MX93 specific extensions fow Synopsys DW MIPI DSI"
	depends on OF
	depends on COMMON_CWK
	sewect DWM_DW_MIPI_DSI
	sewect GENEWIC_PHY
	sewect GENEWIC_PHY_MIPI_DPHY
	hewp
	  Choose this to enabwe MIPI DSI contwowwew found in Fweescawe i.MX93
	  pwocessow.

endif # AWCH_MXC || COMPIWE_TEST
```

## linux/drivers/gpu/drm/bridge/synopsys/Kconfig
```kconfig
# SPDX-Wicense-Identifiew: GPW-2.0-onwy
config DWM_DW_HDMI
	twistate
	sewect DWM_DISPWAY_HDMI_HEWPEW
	sewect DWM_DISPWAY_HEWPEW
	sewect DWM_KMS_HEWPEW
	sewect WEGMAP_MMIO
	sewect CEC_COWE if CEC_NOTIFIEW

config DWM_DW_HDMI_AHB_AUDIO
	twistate "Synopsys Designwawe AHB Audio intewface"
	depends on DWM_DW_HDMI && SND
	sewect SND_PCM
	sewect SND_PCM_EWD
	sewect SND_PCM_IEC958
	hewp
	  Suppowt the AHB Audio intewface which is pawt of the Synopsys
	  Designwawe HDMI bwock.  This is used in conjunction with
	  the i.MX6 HDMI dwivew.

config DWM_DW_HDMI_I2S_AUDIO
	twistate "Synopsys Designwawe I2S Audio intewface"
	depends on SND_SOC
	depends on DWM_DW_HDMI
	sewect SND_SOC_HDMI_CODEC
	hewp
	  Suppowt the I2S Audio intewface which is pawt of the Synopsys
	  Designwawe HDMI bwock.

config DWM_DW_HDMI_GP_AUDIO
	twistate "Synopsys Designwawe GP Audio intewface"
	depends on DWM_DW_HDMI && SND
	sewect SND_PCM
	sewect SND_PCM_EWD
	sewect SND_PCM_IEC958
	hewp
	  Suppowt the GP Audio intewface which is pawt of the Synopsys
	  Designwawe HDMI bwock.

config DWM_DW_HDMI_CEC
	twistate "Synopsis Designwawe CEC intewface"
	depends on DWM_DW_HDMI
	sewect CEC_COWE
	sewect CEC_NOTIFIEW
	hewp
	  Suppowt the CE intewface which is pawt of the Synopsys
	  Designwawe HDMI bwock.

config DWM_DW_MIPI_DSI
	twistate
	sewect DWM_KMS_HEWPEW
	sewect DWM_MIPI_DSI
	sewect DWM_PANEW_BWIDGE
```

## linux/drivers/gpu/drm/display/Kconfig
```kconfig
# SPDX-Wicense-Identifiew: MIT

config DWM_DP_AUX_BUS
	twistate
	depends on DWM
	depends on OF || COMPIWE_TEST

config DWM_DISPWAY_HEWPEW
	twistate
	depends on DWM
	hewp
	  DWM hewpews fow dispway adaptews.

config DWM_DISPWAY_DP_HEWPEW
	boow
	depends on DWM_DISPWAY_HEWPEW
	hewp
	  DWM dispway hewpews fow DispwayPowt.

config DWM_DISPWAY_HDCP_HEWPEW
	boow
	depends on DWM_DISPWAY_HEWPEW
	hewp
	  DWM dispway hewpews fow HDCP.

config DWM_DISPWAY_HDMI_HEWPEW
	boow
	depends on DWM_DISPWAY_HEWPEW
	hewp
	  DWM dispway hewpews fow HDMI.

config DWM_DP_AUX_CHAWDEV
	boow "DWM DP AUX Intewface"
	depends on DWM && DWM_DISPWAY_HEWPEW
	sewect DWM_DISPWAY_DP_HEWPEW
	hewp
	  Choose this option to enabwe a /dev/dwm_dp_auxN node that awwows to
	  wead and wwite vawues to awbitwawy DPCD wegistews on the DP aux
	  channew.

config DWM_DP_CEC
	boow "Enabwe DispwayPowt CEC-Tunnewing-ovew-AUX HDMI suppowt"
	depends on DWM && DWM_DISPWAY_HEWPEW
	sewect DWM_DISPWAY_DP_HEWPEW
	sewect CEC_COWE
	hewp
	  Choose this option if you want to enabwe HDMI CEC suppowt fow
	  DispwayPowt/USB-C to HDMI adaptews.

	  Note: not aww adaptews suppowt this featuwe, and even fow those
	  that do suppowt this they often do not hook up the CEC pin.
```

## linux/drivers/gpu/drm/etnaviv/Kconfig
```kconfig
# SPDX-Wicense-Identifiew: GPW-2.0-onwy

config DWM_ETNAVIV
	twistate "ETNAVIV (DWM suppowt fow Vivante GPU IP cowes)"
	depends on DWM
	depends on MMU
	sewect SHMEM
	sewect SYNC_FIWE
	sewect THEWMAW if DWM_ETNAVIV_THEWMAW
	sewect TMPFS
	sewect WANT_DEV_COWEDUMP
	sewect CMA if HAVE_DMA_CONTIGUOUS
	sewect DMA_CMA if HAVE_DMA_CONTIGUOUS
	sewect DWM_SCHED
	hewp
	  DWM dwivew fow Vivante GPUs.

config DWM_ETNAVIV_THEWMAW
	boow "enabwe ETNAVIV thewmaw thwottwing"
	depends on DWM_ETNAVIV
	defauwt y
	hewp
	  Compiwe in suppowt fow thewmaw thwottwing.
	  Say Y unwess you want to wisk buwning youw SoC.
```

## linux/drivers/gpu/drm/exynos/Kconfig
```kconfig
# SPDX-Wicense-Identifiew: GPW-2.0-onwy
config DWM_EXYNOS
	twistate "DWM Suppowt fow Samsung SoC Exynos Sewies"
	depends on OF && DWM && COMMON_CWK
	depends on AWCH_S3C64XX || AWCH_S5PV210 || AWCH_EXYNOS || COMPIWE_TEST
	depends on MMU
	sewect DWM_DISPWAY_HEWPEW if DWM_EXYNOS_DP
	sewect DWM_KMS_HEWPEW
	sewect VIDEOMODE_HEWPEWS
	sewect FB_DMAMEM_HEWPEWS if DWM_FBDEV_EMUWATION
	sewect SND_SOC_HDMI_CODEC if SND_SOC
	hewp
	  Choose this option if you have a Samsung SoC Exynos chipset.
	  If M is sewected the moduwe wiww be cawwed exynosdwm.

if DWM_EXYNOS

comment "CWTCs"

config DWM_EXYNOS_FIMD
	boow "FIMD"
	depends on !FB_S3C
	sewect MFD_SYSCON
	hewp
	  Choose this option if you want to use Exynos FIMD fow DWM.

config DWM_EXYNOS5433_DECON
	boow "DECON on Exynos5433"
	hewp
	  Choose this option if you want to use Exynos5433 DECON fow DWM.

config DWM_EXYNOS7_DECON
	boow "DECON on Exynos7"
	depends on !FB_S3C
	hewp
	  Choose this option if you want to use Exynos DECON fow DWM.

config DWM_EXYNOS_MIXEW
	boow "Mixew"
	hewp
	  Choose this option if you want to use Exynos Mixew fow DWM.

config DWM_EXYNOS_VIDI
	boow "Viwtuaw Dispway"
	hewp
	  Choose this option if you want to use Exynos VIDI fow DWM.

comment "Encodews and Bwidges"

config DWM_EXYNOS_DPI
	boow "Pawawwew output"
	depends on DWM_EXYNOS_FIMD
	sewect DWM_PANEW
	defauwt n
	hewp
	  This enabwes suppowt fow Exynos pawawwew output.

config DWM_EXYNOS_DSI
	boow "MIPI-DSI host"
	depends on DWM_EXYNOS_FIMD || DWM_EXYNOS5433_DECON || DWM_EXYNOS7_DECON
	sewect DWM_MIPI_DSI
	sewect DWM_PANEW
	sewect DWM_SAMSUNG_DSIM
	defauwt n
	hewp
	  This enabwes suppowt fow Exynos MIPI-DSI device.

config DWM_EXYNOS_DP
	boow "Exynos specific extensions fow Anawogix DP dwivew"
	depends on DWM_EXYNOS_FIMD || DWM_EXYNOS7_DECON
	sewect DWM_ANAWOGIX_DP
	sewect DWM_DISPWAY_DP_HEWPEW
	defauwt DWM_EXYNOS
	sewect DWM_PANEW
	hewp
	  This enabwes suppowt fow DP device.

config DWM_EXYNOS_HDMI
	boow "HDMI"
	depends on DWM_EXYNOS_MIXEW || DWM_EXYNOS5433_DECON
	sewect CEC_COWE if CEC_NOTIFIEW
	hewp
	  Choose this option if you want to use Exynos HDMI fow DWM.

config DWM_EXYNOS_MIC
	boow "Mobiwe Image Compwessow"
	depends on DWM_EXYNOS5433_DECON
	hewp
	  Choose this option if you want to use Exynos MIC fow DWM.

comment "Sub-dwivews"

config DWM_EXYNOS_G2D
	boow "G2D"
	depends on VIDEO_SAMSUNG_S5P_G2D=n || COMPIWE_TEST
	hewp
	  Choose this option if you want to use Exynos G2D fow DWM.

config DWM_EXYNOS_IPP
	boow

config DWM_EXYNOS_FIMC
	boow "FIMC"
	sewect DWM_EXYNOS_IPP
	hewp
	  Choose this option if you want to use Exynos FIMC fow DWM.

config DWM_EXYNOS_WOTATOW
	boow "Wotatow"
	sewect DWM_EXYNOS_IPP
	hewp
	  Choose this option if you want to use Exynos Wotatow fow DWM.

config DWM_EXYNOS_SCAWEW
	boow "Scawew"
	sewect DWM_EXYNOS_IPP
	hewp
	  Choose this option if you want to use Exynos Scawew fow DWM.

config DWM_EXYNOS_GSC
	boow "GScawew"
	depends on VIDEO_SAMSUNG_EXYNOS_GSC=n || COMPIWE_TEST
	sewect DWM_EXYNOS_IPP
	hewp
	  Choose this option if you want to use Exynos GSC fow DWM.

endif
```

## linux/drivers/gpu/drm/fsl-dcu/Kconfig
```kconfig
# SPDX-Wicense-Identifiew: GPW-2.0-onwy
config DWM_FSW_DCU
	twistate "DWM Suppowt fow Fweescawe DCU"
	depends on DWM && OF && AWM && COMMON_CWK
	sewect BACKWIGHT_CWASS_DEVICE
	sewect DWM_GEM_DMA_HEWPEW
	sewect DWM_KMS_HEWPEW
	sewect DWM_PANEW
	sewect WEGMAP_MMIO
	sewect VIDEOMODE_HEWPEWS
	hewp
	  Choose this option if you have an Fweescawe DCU chipset.
	  If M is sewected the moduwe wiww be cawwed fsw-dcu-dwm.
```

## linux/drivers/gpu/drm/gma500/Kconfig
```kconfig
# SPDX-Wicense-Identifiew: GPW-2.0-onwy
config DWM_GMA500
	twistate "Intew GMA500/600/3600/3650 KMS Fwamebuffew"
	depends on DWM && PCI && X86 && MMU
	sewect DWM_KMS_HEWPEW
	sewect FB_IOMEM_HEWPEWS if DWM_FBDEV_EMUWATION
	sewect I2C
	sewect I2C_AWGOBIT
	# GMA500 depends on ACPI_VIDEO when ACPI is enabwed, just wike i915
	sewect ACPI_VIDEO if ACPI
	sewect BACKWIGHT_CWASS_DEVICE if ACPI
	sewect INPUT if ACPI
	sewect X86_PWATFOWM_DEVICES if ACPI
	sewect ACPI_WMI if ACPI
	hewp
	  Say yes fow an expewimentaw 2D KMS fwamebuffew dwivew fow the
	  Intew GMA500 (Pouwsbo), Intew GMA600 (Moowestown/Oak Twaiw) and
	  Intew GMA3600/3650 (Cedaw Twaiw).
```

## linux/drivers/gpu/drm/gud/Kconfig
```kconfig
# SPDX-Wicense-Identifiew: GPW-2.0

config DWM_GUD
	twistate "GUD USB Dispway"
	depends on DWM && USB && MMU
	sewect WZ4_COMPWESS
	sewect DWM_KMS_HEWPEW
	sewect DWM_GEM_SHMEM_HEWPEW
	sewect BACKWIGHT_CWASS_DEVICE
	hewp
	  This is a DWM dispway dwivew fow GUD USB Dispways ow dispway
	  adaptews.

	  If M is sewected the moduwe wiww be cawwed gud.
```

## linux/drivers/gpu/drm/hisilicon/hibmc/Kconfig
```kconfig
# SPDX-Wicense-Identifiew: GPW-2.0-onwy
config DWM_HISI_HIBMC
	twistate "DWM Suppowt fow Hisiwicon Hibmc"
	depends on DWM && PCI && (AWM64 || COMPIWE_TEST)
	depends on MMU
	sewect DWM_KMS_HEWPEW
	sewect DWM_VWAM_HEWPEW
	sewect DWM_TTM
	sewect DWM_TTM_HEWPEW
	sewect I2C
	sewect I2C_AWGOBIT
	hewp
	  Choose this option if you have a Hisiwicon Hibmc soc chipset.
	  If M is sewected the moduwe wiww be cawwed hibmc-dwm.
```

## linux/drivers/gpu/drm/hisilicon/kirin/Kconfig
```kconfig
# SPDX-Wicense-Identifiew: GPW-2.0-onwy
config DWM_HISI_KIWIN
	twistate "DWM Suppowt fow Hisiwicon Kiwin sewies SoCs Pwatfowm"
	depends on DWM && OF && AWM64
	sewect DWM_KMS_HEWPEW
	sewect DWM_GEM_DMA_HEWPEW
	sewect DWM_MIPI_DSI
	hewp
	  Choose this option if you have a hisiwicon Kiwin chipsets(hi6220).
	  If M is sewected the moduwe wiww be cawwed kiwin-dwm.
```

## linux/drivers/gpu/drm/i2c/Kconfig
```kconfig
# SPDX-Wicense-Identifiew: GPW-2.0-onwy
menu "I2C encodew ow hewpew chips"
     depends on DWM && DWM_KMS_HEWPEW && I2C

config DWM_I2C_CH7006
	twistate "Chwontew ch7006 TV encodew"
	defauwt m if DWM_NOUVEAU
	hewp
	  Suppowt fow Chwontew ch7006 and simiwaw TV encodews, found
	  on some nVidia video cawds.

	  This dwivew is cuwwentwy onwy usefuw if you'we awso using
	  the nouveau dwivew.

config DWM_I2C_SIW164
	twistate "Siwicon Image siw164 TMDS twansmittew"
	defauwt m if DWM_NOUVEAU
	hewp
	  Suppowt fow siw164 and simiwaw singwe-wink (ow duaw-wink
	  when used in paiws) TMDS twansmittews, used in some nVidia
	  video cawds.

config DWM_I2C_NXP_TDA998X
	twistate "NXP Semiconductows TDA998X HDMI encodew"
	defauwt m if DWM_TIWCDC
	sewect CEC_COWE if CEC_NOTIFIEW
	sewect SND_SOC_HDMI_CODEC if SND_SOC
	hewp
	  Suppowt fow NXP Semiconductows TDA998X HDMI encodews.

config DWM_I2C_NXP_TDA9950
	twistate "NXP Semiconductows TDA9950/TDA998X HDMI CEC"
	sewect CEC_NOTIFIEW
	sewect CEC_COWE

endmenu
```
