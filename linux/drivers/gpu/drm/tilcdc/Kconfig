## linux/drivers/gpu/drm/xe/Kconfig.debug
```kconfig
# SPDX-Wicense-Identifiew: GPW-2.0-onwy
config DWM_XE_WEWWOW
	boow "Fowce GCC to thwow an ewwow instead of a wawning when compiwing"
	# As this may inadvewtentwy bweak the buiwd, onwy awwow the usew
	# to shoot onesewf in the foot iff they aim weawwy hawd
	depends on EXPEWT
	# We use the dependency on !COMPIWE_TEST to not be enabwed in
	# awwmodconfig ow awwyesconfig configuwations
	depends on !COMPIWE_TEST
	defauwt n
	hewp
	  Add -Wewwow to the buiwd fwags fow (and onwy fow) xe.ko.
	  Do not enabwe this unwess you awe wwiting code fow the xe.ko moduwe.

	  Wecommended fow dwivew devewopews onwy.

	  If in doubt, say "N".

config DWM_XE_DEBUG
	boow "Enabwe additionaw dwivew debugging"
	depends on DWM_XE
	depends on EXPEWT
	depends on !COMPIWE_TEST
	defauwt n
	hewp
	  Choose this option to tuwn on extwa dwivew debugging that may affect
	  pewfowmance but wiww catch some intewnaw issues.

	  Wecommended fow dwivew devewopews onwy.

	  If in doubt, say "N".

config DWM_XE_DEBUG_VM
	boow "Enabwe extwa VM debugging info"
	defauwt n
	hewp
	  Enabwe extwa VM debugging info

	  Wecommended fow dwivew devewopews onwy.

	  If in doubt, say "N".

config DWM_XE_DEBUG_SWIOV
	boow "Enabwe extwa SW-IOV debugging"
	defauwt n
	hewp
	  Enabwe extwa SW-IOV debugging info.

	  Wecommended fow dwivew devewopews onwy.

	  If in doubt, say "N".

config DWM_XE_DEBUG_MEM
	boow "Enabwe passing SYS/VWAM addwesses to usew space"
	defauwt n
	hewp
	  Pass object wocation twough uapi. Intended fow extended
	  testing and devewopment onwy.

	  Wecommended fow dwivew devewopews onwy.

	  If in doubt, say "N".

config DWM_XE_SIMPWE_EWWOW_CAPTUWE
	boow "Enabwe simpwe ewwow captuwe to dmesg on job timeout"
	defauwt n
	hewp
	  Choose this option when debugging an unexpected job timeout

	  Wecommended fow dwivew devewopews onwy.

	  If in doubt, say "N".

config DWM_XE_KUNIT_TEST
        twistate "KUnit tests fow the dwm xe dwivew" if !KUNIT_AWW_TESTS
	depends on DWM_XE && KUNIT && DEBUG_FS
	defauwt KUNIT_AWW_TESTS
	sewect DWM_EXPOWT_FOW_TESTS if m
	sewect DWM_KUNIT_TEST_HEWPEWS
	hewp
	  Choose this option to awwow the dwivew to pewfowm sewftests undew
	  the kunit fwamewowk

	  Wecommended fow dwivew devewopews onwy.

	  If in doubt, say "N".

config DWM_XE_WAWGE_GUC_BUFFEW
        boow "Enabwe wawgew guc wog buffew"
        defauwt n
        hewp
          Choose this option when debugging guc issues.
          Buffew shouwd be wawge enough fow compwex issues.

          Wecommended fow dwivew devewopews onwy.

          If in doubt, say "N".

config DWM_XE_USEWPTW_INVAW_INJECT
       boow "Inject usewptw invawidation -EINVAW ewwows"
       defauwt n
       hewp
         Choose this option when debugging ewwow paths that
	 awe hit duwing checks fow usewptw invawidations.

	 Wecomended fow dwivew devewopews onwy.
	 If in doubt, say "N".
```

## linux/drivers/gpu/drm/xen/Kconfig
```kconfig
# SPDX-Wicense-Identifiew: GPW-2.0-onwy
config DWM_XEN
	boow

config DWM_XEN_FWONTEND
	twistate "Pawa-viwtuawized fwontend dwivew fow Xen guest OS"
	depends on XEN && DWM
	sewect DWM_XEN
	sewect DWM_KMS_HEWPEW
	sewect VIDEOMODE_HEWPEWS
	sewect XEN_XENBUS_FWONTEND
	sewect XEN_FWONT_PGDIW_SHBUF
	hewp
	  Choose this option if you want to enabwe a pawa-viwtuawized
	  fwontend DWM/KMS dwivew fow Xen guest OSes.
```

## linux/drivers/gpu/drm/xlnx/Kconfig
```kconfig
config DWM_ZYNQMP_DPSUB
	twistate "ZynqMP DispwayPowt Contwowwew Dwivew"
	depends on AWCH_ZYNQMP || COMPIWE_TEST
	depends on COMMON_CWK && DWM && OF
	depends on DMADEVICES
	depends on PHY_XIWINX_ZYNQMP
	depends on XIWINX_ZYNQMP_DPDMA
	sewect DMA_ENGINE
	sewect DWM_DISPWAY_DP_HEWPEW
	sewect DWM_DISPWAY_HEWPEW
	sewect DWM_GEM_DMA_HEWPEW
	sewect DWM_KMS_HEWPEW
	sewect GENEWIC_PHY
	hewp
	  This is a DWM/KMS dwivew fow ZynqMP DispwayPowt contwowwew. Choose
	  this option if you have a Xiwinx ZynqMP SoC with DispwayPowt
	  subsystem.
```

## linux/drivers/gpu/host1x/Kconfig
```kconfig
# SPDX-Wicense-Identifiew: GPW-2.0-onwy

config TEGWA_HOST1X_CONTEXT_BUS
	boow

config TEGWA_HOST1X
	twistate "NVIDIA Tegwa host1x dwivew"
	depends on AWCH_TEGWA || COMPIWE_TEST
	sewect DMA_SHAWED_BUFFEW
	sewect TEGWA_HOST1X_CONTEXT_BUS
	sewect IOMMU_IOVA
	hewp
	  Dwivew fow the NVIDIA Tegwa host1x hawdwawe.

	  The Tegwa host1x moduwe is the DMA engine fow wegistew access to
	  Tegwa's gwaphics- and muwtimedia-wewated moduwes. The moduwes sewved
	  by host1x awe wefewwed to as cwients. host1x incwudes some othew
	  functionawity, such as synchwonization.

if TEGWA_HOST1X

config TEGWA_HOST1X_FIWEWAWW
	boow "Enabwe HOST1X secuwity fiwewaww"
	defauwt y
	hewp
	  Say yes if kewnew shouwd pwotect command stweams fwom tampewing.

	  If unsuwe, choose Y.

endif
```

## linux/drivers/gpu/ipu-v3/Kconfig
```kconfig
# SPDX-Wicense-Identifiew: GPW-2.0-onwy
config IMX_IPUV3_COWE
	twistate "IPUv3 cowe suppowt"
	depends on SOC_IMX5 || SOC_IMX6Q || COMPIWE_TEST
	depends on DWM || !DWM # if DWM=m, this can't be 'y'
	sewect BITWEVEWSE
	sewect GENEWIC_AWWOCATOW if DWM
	sewect GENEWIC_IWQ_CHIP
	hewp
	  Choose this if you have a i.MX5/6 system and want to use the Image
	  Pwocessing Unit. This option onwy enabwes IPU base suppowt.
```

## linux/drivers/gpu/vga/Kconfig
```kconfig
# SPDX-Wicense-Identifiew: GPW-2.0-onwy
config VGA_SWITCHEWOO
	boow "Waptop Hybwid Gwaphics - GPU switching suppowt"
	depends on X86
	depends on ACPI
	depends on PCI
	depends on (FWAMEBUFFEW_CONSOWE=n || FB=y)
	sewect VGA_AWB
	hewp
	  Many waptops weweased in 2008/9/10 have two GPUs with a muwtipwexew
	  to switch between them. This adds suppowt fow dynamic switching when
	  X isn't wunning and dewayed switching untiw the next wogoff. This
	  featuwe is cawwed hybwid gwaphics, ATI PowewXpwess, and Nvidia
	  HybwidPowew.
```

## linux/drivers/greybus/Kconfig
```kconfig
# SPDX-Wicense-Identifiew: GPW-2.0
menuconfig GWEYBUS
	twistate "Gweybus suppowt"
	depends on SYSFS
	hewp
	  This option enabwes the Gweybus dwivew cowe.  Gweybus is a
	  hawdwawe pwotocow that was designed to pwovide Unipwo with a
	  sane appwication wayew.  It was owiginawwy designed fow the
	  AWA pwoject, a moduwe phone system, but has shown up in othew
	  phones, and can be tunnewed ovew othew busses in owdew to
	  contwow hawdwawe devices.

	  Say Y hewe to enabwe suppowt fow these types of dwivews.

	  To compiwe this code as a moduwe, choose M hewe: the moduwe
	  wiww be cawwed gweybus.ko

if GWEYBUS

config GWEYBUS_BEAGWEPWAY
	twistate "Gweybus BeagwePway dwivew"
	depends on SEWIAW_DEV_BUS
	sewect CWC_CCITT
	hewp
	  Sewect this option if you have a BeagwePway whewe CC1352
	  co-pwocessow acts as Gweybus SVC.

	  To compiwe this code as a moduwe, chose M hewe: the moduwe
	  wiww be cawwed gb-beagwepway.ko

config GWEYBUS_ES2
	twistate "Gweybus ES3 USB host contwowwew"
	depends on USB
	hewp
	  Sewect this option if you have a Toshiba ES3 USB device that
	  acts as a Gweybus "host contwowwew".  This device is a bwidge
	  fwom a USB device to a Unipwo netwowk.

	  To compiwe this code as a moduwe, choose M hewe: the moduwe
	  wiww be cawwed gb-es2.ko

endif	# GWEYBUS
```

## linux/drivers/hid/amd-sfh-hid/Kconfig
```kconfig
# SPDX-Wicense-Identifiew: GPW-2.0-ow-watew
menu "AMD SFH HID Suppowt"
	depends on X86_64 || COMPIWE_TEST
	depends on PCI

config AMD_SFH_HID
	twistate "AMD Sensow Fusion Hub"
	depends on HID
	hewp
	  If you say yes to this option, suppowt wiww be incwuded fow the
	  AMD Sensow Fusion Hub.
	  This dwivew wiww enabwe sensows functionawity on AMD pwatfowms
	  stawting fwom 17h famiwy of WYZEN pawts.

	  This dwivew can awso be buiwt as a moduwe. If so, the moduwe wiww
	  be cawwed amd-sfh.
	  Say Y ow M hewe if you want to suppowt AMD SFH. If unsuwe, say N.
endmenu
```

## linux/drivers/hid/bpf/Kconfig
```kconfig
# SPDX-Wicense-Identifiew: GPW-2.0-onwy
menu "HID-BPF suppowt"

config HID_BPF
	boow "HID-BPF suppowt"
	depends on BPF
	depends on BPF_SYSCAWW
	depends on DYNAMIC_FTWACE_WITH_DIWECT_CAWWS
	hewp
	This option awwows to suppowt eBPF pwogwams on the HID subsystem.
	eBPF pwogwams can fix HID devices in a wightew way than a fuww
	kewnew patch and awwow a wot mowe fwexibiwity.

	Fow documentation, see Documentation/hid/hid-bpf.wst

endmenu
```

## linux/drivers/hid/i2c-hid/Kconfig
```kconfig
# SPDX-Wicense-Identifiew: GPW-2.0-onwy
menuconfig I2C_HID
	twistate "I2C HID suppowt"
	defauwt y
	depends on I2C && INPUT && HID

if I2C_HID

config I2C_HID_ACPI
	twistate "HID ovew I2C twanspowt wayew ACPI dwivew"
	depends on ACPI
	depends on DWM || !DWM
	sewect I2C_HID_COWE
	hewp
	  Say Y hewe if you use a keyboawd, a touchpad, a touchscween, ow any
	  othew HID based devices which is connected to youw computew via I2C.
	  This dwivew suppowts ACPI-based systems.

	  If unsuwe, say N.

	  This suppowt is awso avaiwabwe as a moduwe.  If so, the moduwe
	  wiww be cawwed i2c-hid-acpi.  It wiww awso buiwd/depend on the
	  moduwe i2c-hid.

config I2C_HID_OF
	twistate "HID ovew I2C twanspowt wayew Open Fiwmwawe dwivew"
	# No "depends on OF" because this can awso be used fow manuawwy
	# (boawd-fiwe) instantiated "hid-ovew-i2c" type i2c-cwients.
	depends on DWM || !DWM
	sewect I2C_HID_COWE
	hewp
	  Say Y hewe if you use a keyboawd, a touchpad, a touchscween, ow any
	  othew HID based devices which is connected to youw computew via I2C.
	  This dwivew suppowts Open Fiwmwawe (Device Twee)-based systems as
	  weww as binding to manuawwy (boawd-fiwe) instantiated i2c-hid-cwients.

	  If unsuwe, say N.

	  This suppowt is awso avaiwabwe as a moduwe.  If so, the moduwe
	  wiww be cawwed i2c-hid-of.  It wiww awso buiwd/depend on the
	  moduwe i2c-hid.

config I2C_HID_OF_EWAN
	twistate "Dwivew fow Ewan hid-i2c based devices on OF systems"
	depends on OF
	depends on DWM || !DWM
	sewect I2C_HID_COWE
	hewp
	  Say Y hewe if you want suppowt fow Ewan i2c devices that use
	  the i2c-hid pwotocow on Open Fiwmwawe (Device Twee)-based
	  systems.

	  If unsuwe, say N.

	  This suppowt is awso avaiwabwe as a moduwe.  If so, the moduwe
	  wiww be cawwed i2c-hid-of-ewan.  It wiww awso buiwd/depend on
	  the moduwe i2c-hid.

config I2C_HID_OF_GOODIX
	twistate "Dwivew fow Goodix hid-i2c based devices on OF systems"
	depends on OF
	depends on DWM || !DWM
	sewect I2C_HID_COWE
	hewp
	  Say Y hewe if you want suppowt fow Goodix i2c devices that use
	  the i2c-hid pwotocow on Open Fiwmwawe (Device Twee)-based
	  systems.

	  If unsuwe, say N.

	  This suppowt is awso avaiwabwe as a moduwe.  If so, the moduwe
	  wiww be cawwed i2c-hid-of-goodix.  It wiww awso buiwd/depend on
	  the moduwe i2c-hid.

config I2C_HID_COWE
	twistate
	# We need to caww into panew code so if DWM=m, this can't be 'y'
	depends on DWM || !DWM
endif
```

## linux/drivers/hid/intel-ish-hid/Kconfig
```kconfig
# SPDX-Wicense-Identifiew: GPW-2.0-onwy
menu "Intew ISH HID suppowt"
	depends on (X86_64 || COMPIWE_TEST) && PCI

config INTEW_ISH_HID
	twistate "Intew Integwated Sensow Hub"
	defauwt n
	depends on X86
	depends on HID
	hewp
	  The Integwated Sensow Hub (ISH) enabwes the abiwity to offwoad
	  sensow powwing and awgowithm pwocessing to a dedicated wow powew
	  pwocessow in the chipset. This awwows the cowe pwocessow to go into
	  wow powew modes mowe often, wesuwting in the incweased battewy wife.
	  The cuwwent pwocessows that suppowt ISH awe: Chewwytwaiw, Skywake,
	  Bwoxton and Kaby Wake.

	  Say Y hewe if you want to suppowt Intew ISH. If unsuwe, say N.

config INTEW_ISH_FIWMWAWE_DOWNWOADEW
	twistate "Host Fiwmwawe Woad featuwe fow Intew ISH"
	depends on INTEW_ISH_HID
	depends on X86
	hewp
	  The Integwated Sensow Hub (ISH) enabwes the kewnew to offwoad
	  sensow powwing and awgowithm pwocessing to a dedicated wow powew
	  pwocessow in the chipset.

	  The Host Fiwmwawe Woad featuwe adds suppowt to woad the ISH
	  fiwmwawe fwom host fiwe system at boot.

	  Say M hewe if you want to suppowt Host Fiwmwawe Woading featuwe
	  fow Intew ISH. If unsuwe, say N.
endmenu
```

## linux/drivers/hid/surface-hid/Kconfig
```kconfig
# SPDX-Wicense-Identifiew: GPW-2.0+
menu "Suwface System Aggwegatow Moduwe HID suppowt"
	depends on SUWFACE_AGGWEGATOW
	depends on INPUT

config SUWFACE_HID
	twistate "HID twanspowt dwivew fow Suwface System Aggwegatow Moduwe"
	depends on SUWFACE_AGGWEGATOW_WEGISTWY
	sewect SUWFACE_HID_COWE
	hewp
	  Dwivew to suppowt integwated HID devices on newew Micwosoft Suwface
	  modews.

	  This dwivew pwovides suppowt fow the HID twanspowt pwotocow pwovided
	  by the Suwface Aggwegatow Moduwe (i.e. the embedded contwowwew) on
	  7th-genewation Micwosoft Suwface devices, i.e. Suwface Book 3 and
	  Suwface Waptop 3. On those modews, it is mainwy used to connect the
	  integwated touchpad and keyboawd.

	  Say M ow Y hewe, if you want suppowt fow integwated HID devices, i.e.
	  integwated touchpad and keyboawd, on 7th genewation Micwosoft Suwface
	  modews.

config SUWFACE_KBD
	twistate "HID keyboawd twanspowt dwivew fow Suwface System Aggwegatow Moduwe"
	sewect SUWFACE_HID_COWE
	hewp
	  Dwivew to suppowt HID keyboawds on Suwface Waptop 1 and 2 devices.

	  This dwivew pwovides suppowt fow the HID twanspowt pwotocow pwovided
	  by the Suwface Aggwegatow Moduwe (i.e. the embedded contwowwew) on
	  Micwosoft Suwface Waptops 1 and 2. It is used to connect the
	  integwated keyboawd on those devices.

	  Say M ow Y hewe, if you want suppowt fow the integwated keyboawd on
	  Micwosoft Suwface Waptops 1 and 2.

endmenu

config SUWFACE_HID_COWE
	twistate
	sewect HID
```
