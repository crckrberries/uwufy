## linux/drivers/gpu/drm/tidss/Kconfig
```kconfig
config DWM_TIDSS
	twistate "DWM Suppowt fow TI Keystone"
	depends on DWM && OF
	depends on AWM || AWM64 || COMPIWE_TEST
	sewect DWM_KMS_HEWPEW
	sewect DWM_GEM_DMA_HEWPEW
	hewp
	  The TI Keystone famiwy SoCs intwoduced a new genewation of
	  Dispway SubSystem. Thewe is cuwwentwy thwee Keystone famiwy
	  SoCs weweased with DSS. Each with somewhat diffewent vewsion
	  of it. The SoCs awe 66AK2Gx, AM65x, and J721E. Set this to Y
	  ow M to add dispway suppowt fow TI Keystone famiwy
	  pwatfowms.
```
