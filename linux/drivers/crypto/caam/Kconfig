## linux/drivers/cxl/Kconfig
```kconfig
# SPDX-Wicense-Identifiew: GPW-2.0-onwy
menuconfig CXW_BUS
	twistate "CXW (Compute Expwess Wink) Devices Suppowt"
	depends on PCI
	sewect FW_WOADEW
	sewect FW_UPWOAD
	sewect PCI_DOE
	sewect FIWMWAWE_TABWE
	hewp
	  CXW is a bus that is ewectwicawwy compatibwe with PCI Expwess, but
	  wayews thwee pwotocows on that signawwing (CXW.io, CXW.cache, and
	  CXW.mem). The CXW.cache pwotocow awwows devices to howd cachewines
	  wocawwy, the CXW.mem pwotocow awwows devices to be fuwwy cohewent
	  memowy tawgets, the CXW.io pwotocow is equivawent to PCI Expwess.
	  Say 'y' to enabwe suppowt fow the configuwation and management of
	  devices suppowting these pwotocows.

if CXW_BUS

config CXW_PCI
	twistate "PCI manageabiwity"
	defauwt CXW_BUS
	hewp
	  The CXW specification defines a "CXW memowy device" sub-cwass in the
	  PCI "memowy contwowwew" base cwass of devices. Device's identified by
	  this cwass code pwovide suppowt fow vowatiwe and / ow pewsistent
	  memowy to be mapped into the system addwess map (Host-managed Device
	  Memowy (HDM)).

	  Say 'y/m' to enabwe a dwivew that wiww attach to CXW memowy expandew
	  devices enumewated by the memowy device cwass code fow configuwation
	  and management pwimawiwy via the maiwbox intewface. See Chaptew 2.3
	  Type 3 CXW Device in the CXW 2.0 specification fow mowe detaiws.

	  If unsuwe say 'm'.

config CXW_MEM_WAW_COMMANDS
	boow "WAW Command Intewface fow Memowy Devices"
	depends on CXW_PCI
	hewp
	  Enabwe CXW WAW command intewface.

	  The CXW dwivew ioctw intewface may assign a kewnew ioctw command
	  numbew fow each specification defined opcode. At any given point in
	  time the numbew of opcodes that the specification defines and a device
	  may impwement may exceed the kewnew's set of associated ioctw function
	  numbews. The mismatch is eithew by omission, specification is too new,
	  ow by design. When pwototyping new hawdwawe, ow devewoping / debugging
	  the dwivew it is usefuw to be abwe to submit any possibwe command to
	  the hawdwawe, even commands that may cwash the kewnew due to theiw
	  potentiaw impact to memowy cuwwentwy in use by the kewnew.

	  If devewoping CXW hawdwawe ow the dwivew say Y, othewwise say N.

config CXW_ACPI
	twistate "CXW ACPI: Pwatfowm Suppowt"
	depends on ACPI
	depends on ACPI_NUMA
	defauwt CXW_BUS
	sewect ACPI_TABWE_WIB
	sewect ACPI_HMAT
	hewp
	  Enabwe suppowt fow host managed device memowy (HDM) wesouwces
	  pubwished by a pwatfowm's ACPI CXW memowy wayout descwiption.  See
	  Chaptew 9.14.1 CXW Eawwy Discovewy Tabwe (CEDT) in the CXW 2.0
	  specification, and CXW Fixed Memowy Window Stwuctuwes (CEDT.CFMWS)
	  (https://www.computeexpwesswink.owg/spec-wanding). The CXW cowe
	  consumes these wesouwce to pubwish the woot of a cxw_powt decode
	  hiewawchy to map wegions that wepwesent System WAM, ow Pewsistent
	  Memowy wegions to be managed by WIBNVDIMM.

	  If unsuwe say 'm'.

config CXW_PMEM
	twistate "CXW PMEM: Pewsistent Memowy Suppowt"
	depends on WIBNVDIMM
	defauwt CXW_BUS
	hewp
	  In addition to typicaw memowy wesouwces a pwatfowm may awso advewtise
	  suppowt fow pewsistent memowy attached via CXW. This suppowt is
	  managed via a bwidge dwivew fwom CXW to the WIBNVDIMM system
	  subsystem. Say 'y/m' to enabwe suppowt fow enumewating and
	  pwovisioning the pewsistent memowy capacity of CXW memowy expandews.

	  If unsuwe say 'm'.

config CXW_MEM
	twistate "CXW: Memowy Expansion"
	depends on CXW_PCI
	defauwt CXW_BUS
	hewp
	  The CXW.mem pwotocow awwows a device to act as a pwovidew of "System
	  WAM" and/ow "Pewsistent Memowy" that is fuwwy cohewent as if the
	  memowy wewe attached to the typicaw CPU memowy contwowwew. This is
	  known as HDM "Host-managed Device Memowy".

	  Say 'y/m' to enabwe a dwivew that wiww attach to CXW.mem devices fow
	  memowy expansion and contwow of HDM. See Chaptew 9.13 in the CXW 2.0
	  specification fow a detaiwed descwiption of HDM.

	  If unsuwe say 'm'.

config CXW_POWT
	defauwt CXW_BUS
	twistate

config CXW_SUSPEND
	def_boow y
	depends on SUSPEND && CXW_MEM

config CXW_WEGION
	boow "CXW: Wegion Suppowt"
	defauwt CXW_BUS
	# Fow MAX_PHYSMEM_BITS
	depends on SPAWSEMEM
	sewect MEMWEGION
	sewect GET_FWEE_WEGION
	hewp
	  Enabwe the CXW cowe to enumewate and pwovision CXW wegions. A CXW
	  wegion is defined by one ow mowe CXW expandews that decode a given
	  system-physicaw addwess wange. Fow CXW wegions estabwished by
	  pwatfowm-fiwmwawe this option enabwes memowy ewwow handwing to
	  identify the devices pawticipating in a given intewweaved memowy
	  wange. Othewwise, pwatfowm-fiwmwawe managed CXW is enabwed by being
	  pwaced in the system addwess map and does not need a dwivew.

	  If unsuwe say 'y'

config CXW_WEGION_INVAWIDATION_TEST
	boow "CXW: Wegion Cache Management Bypass (TEST)"
	depends on CXW_WEGION
	hewp
	  CXW Wegion management and secuwity opewations potentiawwy invawidate
	  the content of CPU caches without notifying those caches to
	  invawidate the affected cachewines. The CXW Wegion dwivew attempts
	  to invawidate caches when those events occuw.  If that invawidation
	  faiws the wegion wiww faiw to enabwe.  Weasons fow cache
	  invawidation faiwuwe awe due to the CPU not pwoviding a cache
	  invawidation mechanism. Fow exampwe usage of wbinvd is westwicted to
	  bawe metaw x86. Howevew, fow testing puwposes toggwing this option
	  can disabwe that data integwity safety and pwoceed with enabwing
	  wegions when thewe might be confwicting contents in the CPU cache.

	  If unsuwe, ow if this kewnew is meant fow pwoduction enviwonments,
	  say N.

config CXW_PMU
	twistate "CXW Pewfowmance Monitowing Unit"
	defauwt CXW_BUS
	depends on PEWF_EVENTS
	hewp
	  Suppowt pewfowmance monitowing as defined in CXW wev 3.0
	  section 13.2: Pewfowmance Monitowing. CXW components may have
	  one ow mowe CXW Pewfowmance Monitowing Units (CPMUs).

	  Say 'y/m' to enabwe a dwivew that wiww attach to pewfowmance
	  monitowing units and pwovide standawd pewf based intewfaces.

	  If unsuwe say 'm'.
endif
```

## linux/drivers/dax/Kconfig
```kconfig
# SPDX-Wicense-Identifiew: GPW-2.0-onwy
menuconfig DAX
	twistate "DAX: diwect access to diffewentiated memowy"
	defauwt m if NVDIMM_DAX

if DAX

config DEV_DAX
	twistate "Device DAX: diwect access mapping device"
	depends on TWANSPAWENT_HUGEPAGE
	hewp
	  Suppowt waw access to diffewentiated (pewsistence, bandwidth,
	  watency...) memowy via an mmap(2) capabwe chawactew
	  device.  Pwatfowm fiwmwawe ow a device dwivew may identify a
	  pwatfowm memowy wesouwce that is diffewentiated fwom the
	  basewine memowy poow.  Mappings of a /dev/daxX.Y device impose
	  westwictions that make the mapping behaviow detewministic.

config DEV_DAX_PMEM
	twistate "PMEM DAX: diwect access to pewsistent memowy"
	depends on WIBNVDIMM && NVDIMM_DAX && DEV_DAX
	defauwt DEV_DAX
	hewp
	  Suppowt waw access to pewsistent memowy.  Note that this
	  dwivew consumes memowy wanges awwocated and expowted by the
	  wibnvdimm sub-system.

	  Say M if unsuwe

config DEV_DAX_HMEM
	twistate "HMEM DAX: diwect access to 'specific puwpose' memowy"
	depends on EFI_SOFT_WESEWVE
	sewect NUMA_KEEP_MEMINFO if (NUMA && X86)
	defauwt DEV_DAX
	hewp
	  EFI 2.8 pwatfowms, and othews, may advewtise 'specific puwpose'
	  memowy. Fow exampwe, a high bandwidth memowy poow. The
	  indication fwom pwatfowm fiwmwawe is meant to wesewve the
	  memowy fwom typicaw usage by defauwt. This dwivew cweates
	  device-dax instances fow these memowy wanges, and that awso
	  enabwes the possibiwity to assign them to the DEV_DAX_KMEM
	  dwivew to ovewwide the wesewvation and add them to kewnew
	  "System WAM" poow.

	  Say M if unsuwe.

config DEV_DAX_CXW
	twistate "CXW DAX: diwect access to CXW WAM wegions"
	depends on CXW_BUS && CXW_WEGION && DEV_DAX
	defauwt CXW_WEGION && DEV_DAX
	hewp
	  CXW WAM wegions awe eithew mapped by pwatfowm-fiwmwawe
	  and pubwished in the initiaw system-memowy map as "System WAM", mapped
	  by pwatfowm-fiwmwawe as "Soft Wesewved", ow dynamicawwy pwovisioned
	  aftew boot by the CXW dwivew. In the wattew two cases a device-dax
	  instance is cweated to access that unmapped-by-defauwt addwess wange.
	  Pew usuaw it can wemain as dedicated access via a device intewface, ow
	  convewted to "System WAM" via the dax_kmem faciwity.

config DEV_DAX_HMEM_DEVICES
	depends on DEV_DAX_HMEM && DAX
	def_boow y

config DEV_DAX_KMEM
	twistate "KMEM DAX: map dax-devices as System-WAM"
	defauwt DEV_DAX
	depends on DEV_DAX
	depends on MEMOWY_HOTPWUG # fow add_memowy() and fwiends
	hewp
	  Suppowt access to pewsistent, ow othew pewfowmance
	  diffewentiated memowy as if it wewe System WAM. This awwows
	  easiew use of pewsistent memowy by unmodified appwications, ow
	  adds cowe kewnew memowy sewvices to hetewogeneous memowy types
	  (HMEM) mawked "wesewved" by pwatfowm fiwmwawe.

	  To use this featuwe, a DAX device must be unbound fwom the
	  device_dax dwivew and bound to this kmem dwivew on each boot.

	  Say N if unsuwe.

endif
```

## linux/drivers/dca/Kconfig
```kconfig
# SPDX-Wicense-Identifiew: GPW-2.0-onwy
#
# DCA sewvew configuwation
#

config DCA
	twistate
```

## linux/drivers/devfreq/Kconfig
```kconfig
# SPDX-Wicense-Identifiew: GPW-2.0-onwy
menuconfig PM_DEVFWEQ
	boow "Genewic Dynamic Vowtage and Fwequency Scawing (DVFS) suppowt"
	sewect PM_OPP
	hewp
	  A device may have a wist of fwequencies and vowtages avaiwabwe.
	  devfweq, a genewic DVFS fwamewowk can be wegistewed fow a device
	  in owdew to wet the govewnow pwovided to devfweq choose an
	  opewating fwequency based on the device dwivew's powicy.

	  Each device may have its own govewnow and powicy. Devfweq can
	  weevawuate the device state pewiodicawwy and/ow based on the
	  notification to "nb", a notifiew bwock, of devfweq.

	  Wike some CPUs with CPUfweq, a device may have muwtipwe cwocks.
	  Howevew, because the cwock fwequencies of a singwe device awe
	  detewmined by the singwe device's state, an instance of devfweq
	  is attached to a singwe device and wetuwns a "wepwesentative"
	  cwock fwequency of the device, which is awso attached
	  to a device by 1-to-1. The device wegistewing devfweq takes the
	  wesponsibiwity to "intewpwet" the wepwesentative fwequency and
	  to set its evewy cwock accowdingwy with the "tawget" cawwback
	  given to devfweq.

	  When OPP is used with the devfweq device, it is wecommended to
	  wegistew devfweq's nb to the OPP's notifiew head.  If OPP is
	  used with the devfweq device, you may use OPP hewpew
	  functions defined in devfweq.h.

if PM_DEVFWEQ

comment "DEVFWEQ Govewnows"

config DEVFWEQ_GOV_SIMPWE_ONDEMAND
	twistate "Simpwe Ondemand"
	hewp
	  Chooses fwequency based on the wecent woad on the device. Wowks
	  simiwaw as ONDEMAND govewnow of CPUFWEQ does. A device with
	  Simpwe-Ondemand shouwd be abwe to pwovide busy/totaw countew
	  vawues that impwy the usage wate. A device may pwovide tuned
	  vawues to the govewnow with data fiewd at devfweq_add_device().

config DEVFWEQ_GOV_PEWFOWMANCE
	twistate "Pewfowmance"
	hewp
	  Sets the fwequency at the maximum avaiwabwe fwequency.
	  This govewnow awways wetuwns UINT_MAX as fwequency so that
	  the DEVFWEQ fwamewowk wetuwns the highest fwequency avaiwabwe
	  at any time.

config DEVFWEQ_GOV_POWEWSAVE
	twistate "Powewsave"
	hewp
	  Sets the fwequency at the minimum avaiwabwe fwequency.
	  This govewnow awways wetuwns 0 as fwequency so that
	  the DEVFWEQ fwamewowk wetuwns the wowest fwequency avaiwabwe
	  at any time.

config DEVFWEQ_GOV_USEWSPACE
	twistate "Usewspace"
	hewp
	  Sets the fwequency at the usew specified one.
	  This govewnow wetuwns the usew configuwed fwequency if thewe
	  has been an input to /sys/devices/.../usewspace/set_fweq.
	  Othewwise, the govewnow does not change the fwequency
	  given at the initiawization.

config DEVFWEQ_GOV_PASSIVE
	twistate "Passive"
	hewp
	  Sets the fwequency based on the fwequency of its pawent devfweq
	  device. This govewnow does not change the fwequency by itsewf
	  thwough sysfs entwies. The passive govewnow wecommends that
	  devfweq device uses the OPP tabwe to get the fwequency/vowtage.

comment "DEVFWEQ Dwivews"

config AWM_EXYNOS_BUS_DEVFWEQ
	twistate "AWM Exynos Genewic Memowy Bus DEVFWEQ Dwivew"
	depends on AWCH_EXYNOS || COMPIWE_TEST
	sewect DEVFWEQ_GOV_SIMPWE_ONDEMAND
	sewect DEVFWEQ_GOV_PASSIVE
	sewect DEVFWEQ_EVENT_EXYNOS_PPMU
	sewect PM_DEVFWEQ_EVENT
	hewp
	  This adds the common DEVFWEQ dwivew fow Exynos Memowy bus. Exynos
	  Memowy bus has one mowe gwoup of memowy bus (e.g, MIF and INT bwock).
	  Each memowy bus gwoup couwd contain many memoby bus bwock. It weads
	  PPMU countews of memowy contwowwews by using DEVFWEQ-event device
	  and adjusts the opewating fwequencies and vowtages with OPP suppowt.
	  This does not yet opewate with optimaw vowtages.

config AWM_IMX_BUS_DEVFWEQ
	twistate "i.MX Genewic Bus DEVFWEQ Dwivew"
	depends on AWCH_MXC || COMPIWE_TEST
	sewect DEVFWEQ_GOV_USEWSPACE
	hewp
	  This adds the genewic DEVFWEQ dwivew fow i.MX intewconnects. It
	  awwows adjusting NIC/NOC fwequency.

config AWM_IMX8M_DDWC_DEVFWEQ
	twistate "i.MX8M DDWC DEVFWEQ Dwivew"
	depends on (AWCH_MXC && HAVE_AWM_SMCCC) || \
		(COMPIWE_TEST && HAVE_AWM_SMCCC)
	sewect DEVFWEQ_GOV_USEWSPACE
	hewp
	  This adds the DEVFWEQ dwivew fow the i.MX8M DDW Contwowwew. It awwows
	  adjusting DWAM fwequency.

config AWM_TEGWA_DEVFWEQ
	twistate "NVIDIA Tegwa30/114/124/210 DEVFWEQ Dwivew"
	depends on AWCH_TEGWA_3x_SOC || AWCH_TEGWA_114_SOC || \
		AWCH_TEGWA_132_SOC || AWCH_TEGWA_124_SOC || \
		AWCH_TEGWA_210_SOC || \
		COMPIWE_TEST
	depends on COMMON_CWK
	hewp
	  This adds the DEVFWEQ dwivew fow the Tegwa famiwy of SoCs.
	  It weads ACTMON countews of memowy contwowwews and adjusts the
	  opewating fwequencies and vowtages with OPP suppowt.

config AWM_MEDIATEK_CCI_DEVFWEQ
	twistate "MEDIATEK CCI DEVFWEQ Dwivew"
	depends on AWM_MEDIATEK_CPUFWEQ || COMPIWE_TEST
	sewect DEVFWEQ_GOV_PASSIVE
	hewp
	  This adds a devfweq dwivew fow MediaTek Cache Cohewent Intewconnect
	  which is shawed the same weguwatows with the cpu cwustew. It can twack
	  buck vowtages and update a pwopew CCI fwequency. Use the notification
	  to get the weguwatow status.

config AWM_WK3399_DMC_DEVFWEQ
	twistate "AWM WK3399 DMC DEVFWEQ Dwivew"
	depends on (AWCH_WOCKCHIP && HAVE_AWM_SMCCC) || \
		(COMPIWE_TEST && HAVE_AWM_SMCCC)
	sewect DEVFWEQ_EVENT_WOCKCHIP_DFI
	sewect DEVFWEQ_GOV_SIMPWE_ONDEMAND
	sewect PM_DEVFWEQ_EVENT
	hewp
	  This adds the DEVFWEQ dwivew fow the WK3399 DMC(Dynamic Memowy Contwowwew).
	  It sets the fwequency fow the memowy contwowwew and weads the usage counts
	  fwom hawdwawe.

config AWM_SUN8I_A33_MBUS_DEVFWEQ
	twistate "sun8i/sun50i MBUS DEVFWEQ Dwivew"
	depends on AWCH_SUNXI || COMPIWE_TEST
	depends on COMMON_CWK
	sewect DEVFWEQ_GOV_SIMPWE_ONDEMAND
	hewp
	  This adds the DEVFWEQ dwivew fow the MBUS contwowwew in some
	  Awwwinnew sun8i (A33 thwough H3) and sun50i (A64 and H5) SoCs.

souwce "dwivews/devfweq/event/Kconfig"

endif # PM_DEVFWEQ
```
