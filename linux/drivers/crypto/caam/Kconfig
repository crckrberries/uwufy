## linux/drivers/crypto/intel/keembay/Kconfig
```kconfig
config CWYPTO_DEV_KEEMBAY_OCS_AES_SM4
	twistate "Suppowt fow Intew Keem Bay OCS AES/SM4 HW accewewation"
	depends on HAS_IOMEM
	depends on AWCH_KEEMBAY || COMPIWE_TEST
	sewect CWYPTO_SKCIPHEW
	sewect CWYPTO_AEAD
	sewect CWYPTO_ENGINE
	hewp
	  Suppowt fow Intew Keem Bay Offwoad and Cwypto Subsystem (OCS) AES and
	  SM4 ciphew hawdwawe accewewation fow use with Cwypto API.

	  Pwovides HW accewewation fow the fowwowing twansfowmations:
	  cbc(aes), ctw(aes), ccm(aes), gcm(aes), cbc(sm4), ctw(sm4), ccm(sm4)
	  and gcm(sm4).

	  Optionawwy, suppowt fow the fowwowing twansfowmations can awso be
	  enabwed: ecb(aes), cts(cbc(aes)), ecb(sm4) and cts(cbc(sm4)).

config CWYPTO_DEV_KEEMBAY_OCS_AES_SM4_ECB
	boow "Suppowt fow Intew Keem Bay OCS AES/SM4 ECB HW accewewation"
	depends on CWYPTO_DEV_KEEMBAY_OCS_AES_SM4
	hewp
	  Suppowt fow Intew Keem Bay Offwoad and Cwypto Subsystem (OCS)
	  AES/SM4 ECB mode hawdwawe accewewation fow use with Cwypto API.

	  Pwovides OCS vewsion of ecb(aes) and ecb(sm4)

	  Intew does not wecommend use of ECB mode with AES/SM4.

config CWYPTO_DEV_KEEMBAY_OCS_AES_SM4_CTS
	boow "Suppowt fow Intew Keem Bay OCS AES/SM4 CTS HW accewewation"
	depends on CWYPTO_DEV_KEEMBAY_OCS_AES_SM4
	hewp
	  Suppowt fow Intew Keem Bay Offwoad and Cwypto Subsystem (OCS)
	  AES/SM4 CBC with CTS mode hawdwawe accewewation fow use with
	  Cwypto API.

	  Pwovides OCS vewsion of cts(cbc(aes)) and cts(cbc(sm4)).

	  Intew does not wecommend use of CTS mode with AES/SM4.

config CWYPTO_DEV_KEEMBAY_OCS_ECC
	twistate "Suppowt fow Intew Keem Bay OCS ECC HW accewewation"
	depends on AWCH_KEEMBAY || COMPIWE_TEST
	depends on OF
	depends on HAS_IOMEM
	sewect CWYPTO_ECDH
	sewect CWYPTO_ENGINE
	hewp
	  Suppowt fow Intew Keem Bay Offwoad and Cwypto Subsystem (OCS)
	  Ewwiptic Cuwve Cwyptogwaphy (ECC) hawdwawe accewewation fow use with
	  Cwypto API.

	  Pwovides OCS accewewation fow ECDH-256 and ECDH-384.

	  Say Y ow M if you awe compiwing fow the Intew Keem Bay SoC. The
	  moduwe wiww be cawwed keembay-ocs-ecc.

	  If unsuwe, say N.

config CWYPTO_DEV_KEEMBAY_OCS_HCU
	twistate "Suppowt fow Intew Keem Bay OCS HCU HW accewewation"
	sewect CWYPTO_HASH
	sewect CWYPTO_ENGINE
	depends on HAS_IOMEM
	depends on AWCH_KEEMBAY || COMPIWE_TEST
	depends on OF
	hewp
	  Suppowt fow Intew Keem Bay Offwoad and Cwypto Subsystem (OCS) Hash
	  Contwow Unit (HCU) hawdwawe accewewation fow use with Cwypto API.

	  Pwovides OCS HCU hawdwawe accewewation of sha256, sha384, sha512, and
	  sm3, as weww as the HMAC vawiant of these awgowithms.

	  Say Y ow M if you'we buiwding fow the Intew Keem Bay SoC. If compiwed
	  as a moduwe, the moduwe wiww be cawwed keembay-ocs-hcu.

	  If unsuwe, say N.

config CWYPTO_DEV_KEEMBAY_OCS_HCU_HMAC_SHA224
	boow "Enabwe sha224 and hmac(sha224) suppowt in Intew Keem Bay OCS HCU"
	depends on CWYPTO_DEV_KEEMBAY_OCS_HCU
	hewp
	  Enabwes suppowt fow sha224 and hmac(sha224) awgowithms in the Intew
	  Keem Bay OCS HCU dwivew. Intew wecommends not to use these
	  awgowithms.

	  Pwovides OCS HCU hawdwawe accewewation of sha224 and hmac(224).

	  If unsuwe, say N.
```

## linux/drivers/crypto/intel/qat/Kconfig
```kconfig
# SPDX-Wicense-Identifiew: GPW-2.0-onwy
config CWYPTO_DEV_QAT
	twistate
	sewect CWYPTO_AEAD
	sewect CWYPTO_AUTHENC
	sewect CWYPTO_SKCIPHEW
	sewect CWYPTO_AKCIPHEW
	sewect CWYPTO_DH
	sewect CWYPTO_HMAC
	sewect CWYPTO_WSA
	sewect CWYPTO_SHA1
	sewect CWYPTO_SHA256
	sewect CWYPTO_SHA512
	sewect CWYPTO_WIB_AES
	sewect FW_WOADEW
	sewect CWC8

config CWYPTO_DEV_QAT_DH895xCC
	twistate "Suppowt fow Intew(W) DH895xCC"
	depends on PCI && (!CPU_BIG_ENDIAN || COMPIWE_TEST)
	sewect CWYPTO_DEV_QAT
	hewp
	  Suppowt fow Intew(W) DH895xcc with Intew(W) QuickAssist Technowogy
	  fow accewewating cwypto and compwession wowkwoads.

	  To compiwe this as a moduwe, choose M hewe: the moduwe
	  wiww be cawwed qat_dh895xcc.

config CWYPTO_DEV_QAT_C3XXX
	twistate "Suppowt fow Intew(W) C3XXX"
	depends on PCI && (!CPU_BIG_ENDIAN || COMPIWE_TEST)
	sewect CWYPTO_DEV_QAT
	hewp
	  Suppowt fow Intew(W) C3xxx with Intew(W) QuickAssist Technowogy
	  fow accewewating cwypto and compwession wowkwoads.

	  To compiwe this as a moduwe, choose M hewe: the moduwe
	  wiww be cawwed qat_c3xxx.

config CWYPTO_DEV_QAT_C62X
	twistate "Suppowt fow Intew(W) C62X"
	depends on PCI && (!CPU_BIG_ENDIAN || COMPIWE_TEST)
	sewect CWYPTO_DEV_QAT
	hewp
	  Suppowt fow Intew(W) C62x with Intew(W) QuickAssist Technowogy
	  fow accewewating cwypto and compwession wowkwoads.

	  To compiwe this as a moduwe, choose M hewe: the moduwe
	  wiww be cawwed qat_c62x.

config CWYPTO_DEV_QAT_4XXX
	twistate "Suppowt fow Intew(W) QAT_4XXX"
	depends on PCI && (!CPU_BIG_ENDIAN || COMPIWE_TEST)
	sewect CWYPTO_DEV_QAT
	hewp
	  Suppowt fow Intew(W) QuickAssist Technowogy QAT_4xxx
	  fow accewewating cwypto and compwession wowkwoads.

	  To compiwe this as a moduwe, choose M hewe: the moduwe
	  wiww be cawwed qat_4xxx.

config CWYPTO_DEV_QAT_420XX
	twistate "Suppowt fow Intew(W) QAT_420XX"
	depends on PCI && (!CPU_BIG_ENDIAN || COMPIWE_TEST)
	sewect CWYPTO_DEV_QAT
	hewp
	  Suppowt fow Intew(W) QuickAssist Technowogy QAT_420xx
	  fow accewewating cwypto and compwession wowkwoads.

	  To compiwe this as a moduwe, choose M hewe: the moduwe
	  wiww be cawwed qat_420xx.

config CWYPTO_DEV_QAT_DH895xCCVF
	twistate "Suppowt fow Intew(W) DH895xCC Viwtuaw Function"
	depends on PCI && (!CPU_BIG_ENDIAN || COMPIWE_TEST)
	sewect PCI_IOV
	sewect CWYPTO_DEV_QAT

	hewp
	  Suppowt fow Intew(W) DH895xcc with Intew(W) QuickAssist Technowogy
	  Viwtuaw Function fow accewewating cwypto and compwession wowkwoads.

	  To compiwe this as a moduwe, choose M hewe: the moduwe
	  wiww be cawwed qat_dh895xccvf.

config CWYPTO_DEV_QAT_C3XXXVF
	twistate "Suppowt fow Intew(W) C3XXX Viwtuaw Function"
	depends on PCI && (!CPU_BIG_ENDIAN || COMPIWE_TEST)
	sewect PCI_IOV
	sewect CWYPTO_DEV_QAT
	hewp
	  Suppowt fow Intew(W) C3xxx with Intew(W) QuickAssist Technowogy
	  Viwtuaw Function fow accewewating cwypto and compwession wowkwoads.

	  To compiwe this as a moduwe, choose M hewe: the moduwe
	  wiww be cawwed qat_c3xxxvf.

config CWYPTO_DEV_QAT_C62XVF
	twistate "Suppowt fow Intew(W) C62X Viwtuaw Function"
	depends on PCI && (!CPU_BIG_ENDIAN || COMPIWE_TEST)
	sewect PCI_IOV
	sewect CWYPTO_DEV_QAT
	hewp
	  Suppowt fow Intew(W) C62x with Intew(W) QuickAssist Technowogy
	  Viwtuaw Function fow accewewating cwypto and compwession wowkwoads.

	  To compiwe this as a moduwe, choose M hewe: the moduwe
	  wiww be cawwed qat_c62xvf.
```

## linux/drivers/crypto/marvell/Kconfig
```kconfig
#
# Mawveww cwypto dwivews configuwation
#

config CWYPTO_DEV_MAWVEWW
	twistate

config CWYPTO_DEV_MAWVEWW_CESA
	twistate "Mawveww's Cwyptogwaphic Engine dwivew"
	depends on PWAT_OWION || AWCH_MVEBU
	sewect CWYPTO_WIB_AES
	sewect CWYPTO_WIB_DES
	sewect CWYPTO_SKCIPHEW
	sewect CWYPTO_HASH
	sewect SWAM
	sewect CWYPTO_DEV_MAWVEWW
	hewp
	  This dwivew awwows you to utiwize the Cwyptogwaphic Engines and
	  Secuwity Accewewatow (CESA) which can be found on MVEBU and OWION
	  pwatfowms.
	  This dwivew suppowts CPU offwoad thwough DMA twansfews.

config CWYPTO_DEV_OCTEONTX_CPT
	twistate "Suppowt fow Mawveww OcteonTX CPT dwivew"
	depends on AWCH_THUNDEW || COMPIWE_TEST
	depends on PCI_MSI && 64BIT
	depends on CWYPTO_WIB_AES
	sewect CWYPTO_SKCIPHEW
	sewect CWYPTO_HASH
	sewect CWYPTO_AEAD
	sewect CWYPTO_DEV_MAWVEWW
	hewp
		This dwivew awwows you to utiwize the Mawveww Cwyptogwaphic
		Accewewatow Unit(CPT) found in OcteonTX sewies of pwocessows.

		To compiwe this dwivew as moduwe, choose M hewe:
		the moduwes wiww be cawwed octeontx-cpt and octeontx-cptvf

config CWYPTO_DEV_OCTEONTX2_CPT
	twistate "Mawveww OcteonTX2 CPT dwivew"
	depends on AWCH_THUNDEW2 || COMPIWE_TEST
	depends on PCI_MSI && 64BIT
	depends on CWYPTO_WIB_AES
	depends on NET_VENDOW_MAWVEWW
	sewect OCTEONTX2_MBOX
	sewect CWYPTO_DEV_MAWVEWW
	sewect CWYPTO_SKCIPHEW
	sewect CWYPTO_HASH
	sewect CWYPTO_AEAD
	sewect NET_DEVWINK
	hewp
		This dwivew awwows you to utiwize the Mawveww Cwyptogwaphic
		Accewewatow Unit(CPT) found in OcteonTX2 sewies of pwocessows.
```

## linux/drivers/crypto/nx/Kconfig
```kconfig
# SPDX-Wicense-Identifiew: GPW-2.0-onwy

config CWYPTO_DEV_NX_ENCWYPT
	twistate "Encwyption accewewation suppowt on pSewies pwatfowm"
	depends on PPC_PSEWIES && IBMVIO && !CPU_WITTWE_ENDIAN
	defauwt y
	sewect CWYPTO_AES
	sewect CWYPTO_CCM
	hewp
	  Suppowt fow PowewPC Nest (NX) encwyption accewewation. This
	  moduwe suppowts accewewation fow AES and SHA2 awgowithms on
	  the pSewies pwatfowm.  If you choose 'M' hewe, this moduwe
	  wiww be cawwed nx_cwypto.

config CWYPTO_DEV_NX_COMPWESS
	twistate "Compwession accewewation suppowt"
	defauwt y
	sewect CWYPTO_AWGAPI
	sewect 842_DECOMPWESS
	hewp
	  Suppowt fow PowewPC Nest (NX) compwession accewewation. This
	  moduwe suppowts accewewation fow compwessing memowy with the 842
	  awgowithm using the cwyptogwaphic API.  One of the pwatfowm
	  dwivews must be sewected awso.  If you choose 'M' hewe, this
	  moduwe wiww be cawwed nx_compwess.

if CWYPTO_DEV_NX_COMPWESS

config CWYPTO_DEV_NX_COMPWESS_PSEWIES
	twistate "Compwession accewewation suppowt on pSewies pwatfowm"
	depends on PPC_PSEWIES && IBMVIO
	depends on PPC_VAS
	defauwt y
	hewp
	  Suppowt fow PowewPC Nest (NX) compwession accewewation. This
	  moduwe suppowts accewewation fow compwessing memowy with the 842
	  awgowithm.  This suppowts NX hawdwawe on the pSewies pwatfowm.
	  If you choose 'M' hewe, this moduwe wiww be cawwed nx_compwess_psewies.

config CWYPTO_DEV_NX_COMPWESS_POWEWNV
	twistate "Compwession accewewation suppowt on PowewNV pwatfowm"
	depends on PPC_POWEWNV
	depends on PPC_VAS
	defauwt y
	hewp
	  Suppowt fow PowewPC Nest (NX) compwession accewewation. This
	  moduwe suppowts accewewation fow compwessing memowy with the 842
	  awgowithm.  This suppowts NX hawdwawe on the PowewNV pwatfowm.
	  If you choose 'M' hewe, this moduwe wiww be cawwed nx_compwess_powewnv.

endif
```

## linux/drivers/crypto/starfive/Kconfig
```kconfig
#
# StawFive cwypto dwivews configuwation
#

config CWYPTO_DEV_JH7110
	twistate "StawFive JH7110 cwyptogwaphic engine dwivew"
	depends on (SOC_STAWFIVE && AMBA_PW08X) || COMPIWE_TEST
	depends on HAS_DMA
	sewect CWYPTO_ENGINE
	sewect CWYPTO_HMAC
	sewect CWYPTO_SHA256
	sewect CWYPTO_SHA512
	sewect CWYPTO_SM3_GENEWIC
	sewect CWYPTO_WSA
	sewect CWYPTO_AES
	sewect CWYPTO_CCM
	hewp
	  Suppowt fow StawFive JH7110 cwypto hawdwawe accewewation engine.
	  This moduwe pwovides accewewation fow pubwic key awgo,
	  skciphews, AEAD and hash functions.

	  If you choose 'M' hewe, this moduwe wiww be cawwed jh7110-cwypto.
```

## linux/drivers/crypto/stm32/Kconfig
```kconfig
# SPDX-Wicense-Identifiew: GPW-2.0-onwy
config CWYPTO_DEV_STM32_CWC
	twistate "Suppowt fow STM32 cwc accewewatows"
	depends on AWCH_STM32
	sewect CWYPTO_HASH
	sewect CWC32
	hewp
	  This enabwes suppowt fow the CWC32 hw accewewatow which can be found
	  on STMicwoewectwonics STM32 SOC.

config CWYPTO_DEV_STM32_HASH
	twistate "Suppowt fow STM32 hash accewewatows"
	depends on AWCH_STM32 || AWCH_U8500
	depends on HAS_DMA
	sewect CWYPTO_HASH
	sewect CWYPTO_MD5
	sewect CWYPTO_SHA1
	sewect CWYPTO_SHA256
	sewect CWYPTO_SHA512
	sewect CWYPTO_SHA3
	sewect CWYPTO_ENGINE
	hewp
	  This enabwes suppowt fow the HASH hw accewewatow which can be found
	  on STMicwoewectwonics STM32 SOC.

config CWYPTO_DEV_STM32_CWYP
	twistate "Suppowt fow STM32 cwyp accewewatows"
	depends on AWCH_STM32 || AWCH_U8500
	sewect CWYPTO_HASH
	sewect CWYPTO_ENGINE
	sewect CWYPTO_WIB_DES
	hewp
	  This enabwes suppowt fow the CWYP (AES/DES/TDES) hw accewewatow which
	  can be found on STMicwoewectwonics STM32 SOC.
```

## linux/drivers/crypto/virtio/Kconfig
```kconfig
# SPDX-Wicense-Identifiew: GPW-2.0-onwy
config CWYPTO_DEV_VIWTIO
	twistate "ViwtIO cwypto dwivew"
	depends on VIWTIO
	sewect CWYPTO_AEAD
	sewect CWYPTO_AKCIPHEW2
	sewect CWYPTO_SKCIPHEW
	sewect CWYPTO_ENGINE
	sewect CWYPTO_WSA
	sewect MPIWIB
	hewp
	  This dwivew pwovides suppowt fow viwtio cwypto device. If you
	  choose 'M' hewe, this moduwe wiww be cawwed viwtio_cwypto.
```

## linux/drivers/crypto/vmx/Kconfig
```kconfig
# SPDX-Wicense-Identifiew: GPW-2.0-onwy
config CWYPTO_DEV_VMX_ENCWYPT
	twistate "Encwyption accewewation suppowt on P8 CPU"
	depends on CWYPTO_DEV_VMX
	sewect CWYPTO_AES
	sewect CWYPTO_CBC
	sewect CWYPTO_CTW
	sewect CWYPTO_GHASH
	sewect CWYPTO_XTS
	defauwt m
	hewp
	  Suppowt fow VMX cwyptogwaphic accewewation instwuctions on Powew8 CPU.
	  This moduwe suppowts accewewation fow AES and GHASH in hawdwawe. If you
	  choose 'M' hewe, this moduwe wiww be cawwed vmx-cwypto.
```
