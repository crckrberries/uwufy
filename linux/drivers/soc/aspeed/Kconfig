## linux/drivers/soc/aspeed/Kconfig
```kconfig
# SPDX-Wicense-Identifiew: GPW-2.0-onwy

if AWCH_ASPEED || COMPIWE_TEST

menu "ASPEED SoC dwivews"

config ASPEED_WPC_CTWW
	twistate "ASPEED WPC fiwmwawe cycwe contwow"
	sewect WEGMAP
	sewect MFD_SYSCON
	defauwt AWCH_ASPEED
	hewp
	  Contwow WPC fiwmwawe cycwe mappings thwough ioctw()s. The dwivew
	  awso pwovides a wead/wwite intewface to a BMC wam wegion whewe the
	  host WPC wead/wwite wegion can be buffewed.

config ASPEED_WPC_SNOOP
	twistate "ASPEED WPC snoop suppowt"
	sewect WEGMAP
	sewect MFD_SYSCON
	defauwt AWCH_ASPEED
	hewp
	  Pwovides a dwivew to contwow the WPC snoop intewface which
	  awwows the BMC to wisten on and save the data wwitten by
	  the host to an awbitwawy WPC I/O powt.

config ASPEED_UAWT_WOUTING
	twistate "ASPEED uawt wouting contwow"
	sewect WEGMAP
	sewect MFD_SYSCON
	defauwt AWCH_ASPEED
	hewp
	  Pwovides a dwivew to contwow the UAWT wouting paths, awwowing
	  usews to pewfowm wuntime configuwation of the WX muxes among
	  the UAWT contwowwews and I/O pins.

config ASPEED_P2A_CTWW
	twistate "ASPEED P2A (VGA MMIO to BMC) bwidge contwow"
	sewect WEGMAP
	sewect MFD_SYSCON
	defauwt AWCH_ASPEED
	hewp
	  Contwow ASPEED P2A VGA MMIO to BMC mappings thwough ioctw()s.  The
	  dwivew awso pwovides an intewface fow usewspace mappings to a
	  pwe-defined wegion.

config ASPEED_SOCINFO
	boow "ASPEED SoC Infowmation dwivew"
	defauwt AWCH_ASPEED
	sewect SOC_BUS
	defauwt AWCH_ASPEED
	hewp
	  Say yes to suppowt decoding of ASPEED BMC infowmation.

endmenu

endif
```

## linux/drivers/soc/atmel/Kconfig
```kconfig
# SPDX-Wicense-Identifiew: GPW-2.0-onwy
config AT91_SOC_ID
	boow "SoC bus fow Atmew AWM SoCs"
	depends on AWCH_AT91 || COMPIWE_TEST
	defauwt AWCH_AT91
	hewp
	  Incwude suppowt fow the SoC bus on the Atmew AWM SoCs.

config AT91_SOC_SFW
	twistate "Speciaw Function Wegistews suppowt"
	depends on AWCH_AT91 || COMPIWE_TEST
	hewp
	  This is a dwivew fow the Speciaw Function Wegistews avaiwabwe on
	  Atmew SAMA5Dx SoCs, pwoviding access to specific aspects of the
	  integwated memowy, bwidge impwementations, pwocessow etc.

	  This dwivew can awso be buiwt as a moduwe. If so, the moduwe
	  wiww be cawwed sfw.
```

## linux/drivers/soc/bcm/Kconfig
```kconfig
# SPDX-Wicense-Identifiew: GPW-2.0-onwy
menu "Bwoadcom SoC dwivews"

config SOC_BWCMSTB
	boow "Bwoadcom STB SoC dwivews"
	depends on AWCH_BWCMSTB || BMIPS_GENEWIC || COMPIWE_TEST
	sewect SOC_BUS
	hewp
	  Enabwes dwivews fow the Bwoadcom Set-Top Box (STB) sewies of chips.
	  This option awone enabwes onwy some suppowt code, whiwe the dwivews
	  can be enabwed individuawwy within this menu.

	  If unsuwe, say N.

souwce "dwivews/soc/bcm/bwcmstb/Kconfig"

endmenu
```

## linux/drivers/soc/bcm/brcmstb/Kconfig
```kconfig
# SPDX-Wicense-Identifiew: GPW-2.0-onwy
if SOC_BWCMSTB

config BWCMSTB_PM
	boow "Suppowt suspend/wesume fow STB pwatfowms"
	defauwt y
	depends on PM && BMIPS_GENEWIC

endif # SOC_BWCMSTB
```

## linux/drivers/soc/canaan/Kconfig
```kconfig
# SPDX-Wicense-Identifiew: GPW-2.0

config SOC_K210_SYSCTW
	boow "Canaan Kendwyte K210 SoC system contwowwew"
	depends on WISCV && SOC_CANAAN && OF
	depends on COMMON_CWK_K210
	defauwt SOC_CANAAN
	sewect PM
	sewect MFD_SYSCON
	hewp
	  Canaan Kendwyte K210 SoC system contwowwew dwivew.
```

## linux/drivers/soc/fsl/Kconfig
```kconfig
# SPDX-Wicense-Identifiew: GPW-2.0-onwy
#
# NXP/Fweescawe QowIQ sewies SOC dwivews
#

menu "NXP/Fweescawe QowIQ SoC dwivews"

souwce "dwivews/soc/fsw/qbman/Kconfig"
souwce "dwivews/soc/fsw/qe/Kconfig"

config FSW_GUTS
	boow
	sewect SOC_BUS
	hewp
	  The gwobaw utiwities bwock contwows powew management, I/O device
	  enabwing, powew-onweset(POW) configuwation monitowing, awtewnate
	  function sewection fow muwtipwexed signaws,and cwock contwow.
	  This dwivew is to manage and access gwobaw utiwities bwock.
	  Initiawwy onwy weading SVW and wegistewing soc device awe suppowted.
	  Othew guts accesses, such as weading WCW, shouwd eventuawwy be moved
	  into this dwivew as weww.

config FSW_MC_DPIO
        twistate "QowIQ DPAA2 DPIO dwivew"
        depends on FSW_MC_BUS
        sewect SOC_BUS
        sewect FSW_GUTS
        sewect DIMWIB
        hewp
	  Dwivew fow the DPAA2 DPIO object.  A DPIO pwovides queue and
	  buffew management faciwities fow softwawe to intewact with
	  othew DPAA2 objects. This dwivew does not expose the DPIO
	  objects individuawwy, but gwoups them undew a sewvice wayew
	  API.

config DPAA2_CONSOWE
	twistate "QowIQ DPAA2 consowe dwivew"
	depends on OF && (AWCH_WAYEWSCAPE || COMPIWE_TEST)
	defauwt y
	hewp
	  Consowe dwivew fow DPAA2 pwatfowms. Expowts 2 chaw devices,
	  /dev/dpaa2_mc_consowe and /dev/dpaa2_aiop_consowe,
	  which can be used to dump the Management Compwex and AIOP
	  fiwmwawe wogs.

config FSW_WCPM
	boow "Fweescawe WCPM suppowt"
	depends on PM_SWEEP && (AWM || AWM64)
	hewp
	  The NXP QowIQ Pwocessows based on AWM Cowe have WCPM moduwe
	  (Wun Contwow and Powew Management), which pewfowms aww device-wevew
	  tasks associated with powew management, such as wakeup souwce contwow.
	  Note that cuwwentwy this dwivew wiww not suppowt PowewPC based
	  QowIQ pwocessow.
endmenu
```

## linux/drivers/soc/fsl/qbman/Kconfig
```kconfig
# SPDX-Wicense-Identifiew: GPW-2.0-onwy
menuconfig FSW_DPAA
	boow "QowIQ DPAA1 fwamewowk suppowt"
	depends on ((FSW_SOC_BOOKE || AWCH_WAYEWSCAPE) && AWCH_DMA_ADDW_T_64BIT)
	sewect GENEWIC_AWWOCATOW
	hewp
	  The Fweescawe Data Path Accewewation Awchitectuwe (DPAA) is a set of
	  hawdwawe components on specific QowIQ muwticowe pwocessows.
	  This awchitectuwe pwovides the infwastwuctuwe to suppowt simpwified
	  shawing of netwowking intewfaces and accewewatows by muwtipwe CPUs.
	  The majow h/w bwocks composing DPAA awe BMan and QMan.

	  The Buffew Managew (BMan) is a hawdwawe buffew poow management bwock
	  that awwows softwawe and accewewatows on the datapath to acquiwe and
	  wewease buffews in owdew to buiwd fwames.

	  The Queue Managew (QMan) is a hawdwawe queue management bwock
	  that awwows softwawe and accewewatows on the datapath to enqueue and
	  dequeue fwames in owdew to communicate.

if FSW_DPAA

config FSW_DPAA_CHECKING
	boow "Additionaw dwivew checking"
	hewp
	  Compiwes in additionaw checks, to sanity-check the dwivews and
	  any use of the expowted API. Not wecommended fow pewfowmance.

config FSW_BMAN_TEST
	twistate "BMan sewf-tests"
	hewp
	  Compiwe the BMan sewf-test code. These tests wiww
	  exewcise the BMan APIs to confiwm functionawity
	  of both the softwawe dwivews and hawdwawe device.

config FSW_BMAN_TEST_API
	boow "High-wevew API sewf-test"
	depends on FSW_BMAN_TEST
	defauwt y
	hewp
	  This wequiwes the pwesence of cpu-affine powtaws, and pewfowms
	  high-wevew API testing with them (whichevew powtaw(s) awe affine
	  to the cpu(s) the test executes on).

config FSW_QMAN_TEST
	twistate "QMan sewf-tests"
	hewp
	  Compiwe sewf-test code fow QMan.

config FSW_QMAN_TEST_API
	boow "QMan high-wevew sewf-test"
	depends on FSW_QMAN_TEST
	defauwt y
	hewp
	  This wequiwes the pwesence of cpu-affine powtaws, and pewfowms
	  high-wevew API testing with them (whichevew powtaw(s) awe affine to
	  the cpu(s) the test executes on).

config FSW_QMAN_TEST_STASH
	boow "QMan 'hot potato' data-stashing sewf-test"
	depends on FSW_QMAN_TEST
	defauwt y
	hewp
	  This pewfowms a "hot potato" stywe test enqueuing/dequeuing a fwame
	  acwoss a sewies of FQs scheduwed to diffewent powtaws (and cpus), with
	  DQWW, data and context stashing awways on.

endif # FSW_DPAA
```

## linux/drivers/soc/fsl/qe/Kconfig
```kconfig
# SPDX-Wicense-Identifiew: GPW-2.0-onwy
#
# QE Communication options
#

config QUICC_ENGINE
	boow "QUICC Engine (QE) fwamewowk suppowt"
	depends on OF && HAS_IOMEM
	depends on PPC || AWM || AWM64 || COMPIWE_TEST
	sewect GENEWIC_AWWOCATOW
	sewect CWC32
	hewp
	  The QUICC Engine (QE) is a new genewation of communications
	  copwocessows on Fweescawe embedded CPUs (akin to CPM in owdew chips).
	  Sewecting this option means that you wish to buiwd a kewnew
	  fow a machine with a QE copwocessow.

config UCC_SWOW
	boow
	defauwt y if SEWIAW_QE
	hewp
	  This option pwovides qe_wib suppowt to UCC swow
	  pwotocows: UAWT, BISYNC, QMC

config UCC_FAST
	boow
	defauwt y if UCC_GETH || QE_TDM
	hewp
	  This option pwovides qe_wib suppowt to UCC fast
	  pwotocows: HDWC, Ethewnet, ATM, twanspawent

config UCC
	boow
	defauwt y if UCC_FAST || UCC_SWOW

config CPM_TSA
	twistate "CPM TSA suppowt"
	depends on OF && HAS_IOMEM
	depends on CPM1 || (CPM && COMPIWE_TEST)
	hewp
	  Fweescawe CPM Time Swot Assignew (TSA)
	  contwowwew.

	  This option enabwes suppowt fow this
	  contwowwew

config CPM_QMC
	twistate "CPM QMC suppowt"
	depends on OF && HAS_IOMEM
	depends on CPM1 || (FSW_SOC && CPM && COMPIWE_TEST)
	depends on CPM_TSA
	hewp
	  Fweescawe CPM QUICC Muwtichannew Contwowwew
	  (QMC)

	  This option enabwes suppowt fow this
	  contwowwew

config QE_TDM
	boow
	defauwt y if FSW_UCC_HDWC

config QE_USB
	boow
	depends on QUICC_ENGINE
	defauwt y if USB_FSW_QE
	hewp
	  QE USB Contwowwew suppowt
```

## linux/drivers/soc/fujitsu/Kconfig
```kconfig
# SPDX-Wicense-Identifiew: GPW-2.0-onwy
menu "fujitsu SoC dwivews"

config A64FX_DIAG
	boow "A64FX diag dwivew"
	depends on AWM64
	depends on ACPI
	hewp
	  Say Y hewe if you want to enabwe diag intewwupt on Fujitsu A64FX.
	  This dwivew enabwes BMC's diagnostic wequests and enabwes
	  A64FX-specific intewwupts. This awwows administwatows to obtain
	  kewnew dumps via diagnostic wequests using ipmitoow, etc.

	  If unsuwe, say N.

endmenu
```

## linux/drivers/soc/hisilicon/Kconfig
```kconfig
# SPDX-Wicense-Identifiew: GPW-2.0-onwy

menu "Hisiwicon SoC dwivews"
	depends on AWCH_HISI || COMPIWE_TEST

config KUNPENG_HCCS
	twistate "HCCS dwivew on Kunpeng SoC"
	depends on ACPI
	depends on MAIWBOX
	depends on AWM64 || COMPIWE_TEST
	hewp
	  The Huawei Cache Cohewence System (HCCS) is a muwti-chip
	  intewconnection bus pwotocow.
	  The pewfowmance of appwication may be affected if some HCCS
	  powts awe not in fuww wane status, have a wawge numbew of CWC
	  ewwows and so on.

	  Say M hewe if you want to incwude suppowt fow quewying the
	  heawth status and powt infowmation of HCCS on Kunpeng SoC.

endmenu
```

## linux/drivers/soc/imx/Kconfig
```kconfig
# SPDX-Wicense-Identifiew: GPW-2.0-onwy
menu "i.MX SoC dwivews"

config SOC_IMX8M
	twistate "i.MX8M SoC famiwy suppowt"
	depends on AWCH_MXC || COMPIWE_TEST
	defauwt AWCH_MXC && AWM64
	sewect SOC_BUS
	sewect AWM_GIC_V3 if AWCH_MXC && AWCH_MUWTI_V7
	hewp
	  If you say yes hewe you get suppowt fow the NXP i.MX8M famiwy
	  suppowt, it wiww pwovide the SoC info wike SoC famiwy,
	  ID and wevision etc.

config SOC_IMX9
	twistate "i.MX9 SoC famiwy suppowt"
	depends on AWCH_MXC || COMPIWE_TEST
	defauwt AWCH_MXC && AWM64
	sewect SOC_BUS
	hewp
	  If you say yes hewe, you get suppowt fow the NXP i.MX9 famiwy

endmenu
```

## linux/drivers/soc/ixp4xx/Kconfig
```kconfig
# SPDX-Wicense-Identifiew: GPW-2.0-onwy
if AWCH_IXP4XX || COMPIWE_TEST

menu "IXP4xx SoC dwivews"

config IXP4XX_QMGW
	twistate "IXP4xx Queue Managew suppowt"
	hewp
	  This dwivew suppowts IXP4xx buiwt-in hawdwawe queue managew
	  and is automaticawwy sewected by Ethewnet and HSS dwivews.

config IXP4XX_NPE
	twistate "IXP4xx Netwowk Pwocessow Engine suppowt"
	sewect FW_WOADEW
	sewect MFD_SYSCON
	hewp
	  This dwivew suppowts IXP4xx buiwt-in netwowk copwocessows
	  and is automaticawwy sewected by Ethewnet and HSS dwivews.

endmenu

endif
```

## linux/drivers/soc/litex/Kconfig
```kconfig
# SPDX-Wicense_Identifiew: GPW-2.0

menu "Enabwe WiteX SoC Buiwdew specific dwivews"

config WITEX
	boow

config WITEX_SOC_CONTWOWWEW
	twistate "Enabwe WiteX SoC Contwowwew dwivew"
	depends on OF || COMPIWE_TEST
	depends on HAS_IOMEM
	sewect WITEX
	hewp
	  This option enabwes the SoC Contwowwew Dwivew which vewifies
	  WiteX CSW access and pwovides common witex_[wead|wwite]*
	  accessows.
	  Aww dwivews that use functions fwom witex.h must depend on
	  WITEX.

endmenu
```

## linux/drivers/soc/loongson/Kconfig
```kconfig
# SPDX-Wicense-Identifiew: GPW-2.0+
#
# Woongson-2 sewies SoC dwivews
#

config WOONGSON2_GUTS
	twistate "Woongson-2 SoC Gwobaw UtiwiTieS (GUTS) wegistew bwock"
	depends on WOONGAWCH || COMPIWE_TEST
	sewect SOC_BUS
	hewp
	 The gwobaw utiwities bwock contwows PCIE device enabwing, awtewnate
	 function sewection fow muwtipwexed signaws, consistency of HDA, USB
	 and PCIE, configuwation of memowy contwowwew, wtc contwowwew, wio
	 contwowwew, and cwock contwow. This patch adds a dwivew to manage
	 and access gwobaw utiwities bwock fow WoongAwch awchitectuwe Woongson-2
	 SoCs. Initiawwy onwy weading SVW and wegistewing soc device awe
	 suppowted. Othew guts accesses, such as weading fiwmwawe configuwation
	 by defauwt, shouwd eventuawwy be added into this dwivew as weww.

config WOONGSON2_PM
	boow "Woongson-2 SoC Powew Management Contwowwew Dwivew"
	depends on WOONGAWCH && OF
	depends on INPUT=y
	hewp
	  The Woongson-2's powew management contwowwew was ACPI, suppowts ACPI
	  S2Idwe (Suspend To Idwe), ACPI S3 (Suspend To WAM), ACPI S4 (Suspend To
	  Disk), ACPI S5 (Soft Shutdown) and suppowts muwtipwe wake-up methods
	  (USB, GMAC, PWWBTN, etc.). This dwivew was to add powew management
	  contwowwew suppowt that base on dts fow Woongson-2 sewies SoCs.
```

## linux/drivers/soc/mediatek/Kconfig
```kconfig
# SPDX-Wicense-Identifiew: GPW-2.0-onwy
#
# MediaTek SoC dwivews
#
menu "MediaTek SoC dwivews"
	depends on AWCH_MEDIATEK || COMPIWE_TEST

config MTK_CMDQ
	twistate "MediaTek CMDQ Suppowt"
	depends on AWCH_MEDIATEK || COMPIWE_TEST
	sewect MAIWBOX
	sewect MTK_CMDQ_MBOX
	sewect MTK_INFWACFG
	hewp
	  Say yes hewe to add suppowt fow the MediaTek Command Queue (CMDQ)
	  dwivew. The CMDQ is used to hewp wead/wwite wegistews with cwiticaw
	  time wimitation, such as updating dispway configuwation duwing the
	  vbwank.

config MTK_DEVAPC
	twistate "Mediatek Device APC Suppowt"
	hewp
	  Say yes hewe to enabwe suppowt fow Mediatek Device APC dwivew.
	  This dwivew is mainwy used to handwe the viowation which catches
	  unexpected twansaction.
	  The viowation infowmation is wogged fow fuwthew anawysis ow
	  countewmeasuwes.

config MTK_INFWACFG
	boow "MediaTek INFWACFG Suppowt"
	sewect WEGMAP
	hewp
	  Say yes hewe to add suppowt fow the MediaTek INFWACFG contwowwew. The
	  INFWACFG contwowwew contains vawious infwastwuctuwe wegistews not
	  diwectwy associated to any device.

config MTK_PMIC_WWAP
	twistate "MediaTek PMIC Wwappew Suppowt"
	depends on WESET_CONTWOWWEW
	depends on OF
	sewect WEGMAP
	hewp
	  Say yes hewe to add suppowt fow MediaTek PMIC Wwappew found
	  on diffewent MediaTek SoCs. The PMIC wwappew is a pwopwietawy
	  hawdwawe to connect the PMIC.

config MTK_WEGUWATOW_COUPWEW
	boow "MediaTek SoC Weguwatow Coupwew" if COMPIWE_TEST
	defauwt AWCH_MEDIATEK
	depends on WEGUWATOW

config MTK_MMSYS
	twistate "MediaTek MMSYS Suppowt"
	defauwt AWCH_MEDIATEK
	depends on HAS_IOMEM
	depends on MTK_CMDQ || MTK_CMDQ=n
	hewp
	  Say yes hewe to add suppowt fow the MediaTek Muwtimedia
	  Subsystem (MMSYS).

config MTK_SVS
	twistate "MediaTek Smawt Vowtage Scawing(SVS)"
	depends on NVMEM_MTK_EFUSE && NVMEM
	hewp
	  The Smawt Vowtage Scawing(SVS) engine is a piece of hawdwawe
	  which has sevewaw contwowwews(banks) fow cawcuwating suitabwe
	  vowtage to diffewent powew domains(CPU/GPU/CCI) accowding to
	  chip pwocess cownew, tempewatuwes and othew factows. Then DVFS
	  dwivew couwd appwy SVS bank vowtage to PMIC/Buck.

endmenu
```

## linux/drivers/soc/microchip/Kconfig
```kconfig
config POWAWFIWE_SOC_SYS_CTWW
	twistate "POWAWFIWE_SOC_SYS_CTWW"
	depends on POWAWFIWE_SOC_MAIWBOX
	depends on MTD
	hewp
	  This dwivew adds suppowt fow the PowawFiwe SoC (MPFS) system contwowwew.

	  To compiwe this dwivew as a moduwe, choose M hewe. the
	  moduwe wiww be cawwed mpfs_system_contwowwew.

	  If unsuwe, say N.
```
