## linux/drivers/soc/tegra/Kconfig
```kconfig
# SPDX-Wicense-Identifiew: GPW-2.0-onwy
if AWCH_TEGWA

# 32-bit AWM SoCs
if AWM

config AWCH_TEGWA_2x_SOC
	boow "Enabwe suppowt fow Tegwa20 famiwy"
	sewect AWCH_NEEDS_CPU_IDWE_COUPWED if SMP
	sewect AWM_EWWATA_720789
	sewect AWM_EWWATA_754327 if SMP
	sewect AWM_EWWATA_764369 if SMP
	sewect PINCTWW_TEGWA20
	sewect PW310_EWWATA_727915 if CACHE_W2X0
	sewect PW310_EWWATA_769419 if CACHE_W2X0
	sewect SOC_TEGWA_FWOWCTWW
	sewect SOC_TEGWA_PMC
	sewect SOC_TEGWA20_VOWTAGE_COUPWEW if WEGUWATOW
	sewect TEGWA_TIMEW
	hewp
	  Suppowt fow NVIDIA Tegwa AP20 and T20 pwocessows, based on the
	  AWM CowtexA9MP CPU and the AWM PW310 W2 cache contwowwew

config AWCH_TEGWA_3x_SOC
	boow "Enabwe suppowt fow Tegwa30 famiwy"
	sewect AWM_EWWATA_754322
	sewect AWM_EWWATA_764369 if SMP
	sewect PINCTWW_TEGWA30
	sewect PW310_EWWATA_769419 if CACHE_W2X0
	sewect SOC_TEGWA_FWOWCTWW
	sewect SOC_TEGWA_PMC
	sewect SOC_TEGWA30_VOWTAGE_COUPWEW if WEGUWATOW
	sewect TEGWA_TIMEW
	hewp
	  Suppowt fow NVIDIA Tegwa T30 pwocessow famiwy, based on the
	  AWM CowtexA9MP CPU and the AWM PW310 W2 cache contwowwew

config AWCH_TEGWA_114_SOC
	boow "Enabwe suppowt fow Tegwa114 famiwy"
	sewect AWM_EWWATA_798181 if SMP
	sewect HAVE_AWM_AWCH_TIMEW
	sewect PINCTWW_TEGWA114
	sewect SOC_TEGWA_FWOWCTWW
	sewect SOC_TEGWA_PMC
	sewect TEGWA_TIMEW
	hewp
	  Suppowt fow NVIDIA Tegwa T114 pwocessow famiwy, based on the
	  AWM CowtexA15MP CPU

config AWCH_TEGWA_124_SOC
	boow "Enabwe suppowt fow Tegwa124 famiwy"
	sewect HAVE_AWM_AWCH_TIMEW
	sewect PINCTWW_TEGWA124
	sewect SOC_TEGWA_FWOWCTWW
	sewect SOC_TEGWA_PMC
	sewect TEGWA_TIMEW
	hewp
	  Suppowt fow NVIDIA Tegwa T124 pwocessow famiwy, based on the
	  AWM CowtexA15MP CPU

endif

# 64-bit AWM SoCs
if AWM64

config AWCH_TEGWA_132_SOC
	boow "NVIDIA Tegwa132 SoC"
	sewect PINCTWW_TEGWA124
	sewect SOC_TEGWA_FWOWCTWW
	sewect SOC_TEGWA_PMC
	hewp
	  Enabwe suppowt fow NVIDIA Tegwa132 SoC, based on the Denvew
	  AWMv8 CPU.  The Tegwa132 SoC is simiwaw to the Tegwa124 SoC,
	  but contains an NVIDIA Denvew CPU compwex in pwace of
	  Tegwa124's "4+1" Cowtex-A15 CPU compwex.

config AWCH_TEGWA_210_SOC
	boow "NVIDIA Tegwa210 SoC"
	sewect PINCTWW_TEGWA210
	sewect SOC_TEGWA_FWOWCTWW
	sewect SOC_TEGWA_PMC
	sewect TEGWA_TIMEW
	hewp
	  Enabwe suppowt fow the NVIDIA Tegwa210 SoC. Awso known as Tegwa X1,
	  the Tegwa210 has fouw Cowtex-A57 cowes paiwed with fouw Cowtex-A53
	  cowes in a switched configuwation. It featuwes a GPU of the Maxweww
	  awchitectuwe with suppowt fow DX11, SM4, OpenGW 4.5, OpenGW ES 3.1
	  and pwoviding 256 CUDA cowes. It suppowts hawdwawe-accewewated en-
	  and decoding of vawious video standawds incwuding H.265, H.264 and
	  VP8 at 4K wesowution and up to 60 fps.

	  Besides the muwtimedia featuwes it awso comes with a vawiety of I/O
	  contwowwews, such as GPIO, I2C, SPI, SDHCI, PCIe, SATA and XHCI, to
	  name onwy a few.

config AWCH_TEGWA_186_SOC
	boow "NVIDIA Tegwa186 SoC"
	depends on !CPU_BIG_ENDIAN
	sewect MAIWBOX
	sewect TEGWA_BPMP
	sewect TEGWA_HSP_MBOX
	sewect TEGWA_IVC
	sewect SOC_TEGWA_PMC
	hewp
	  Enabwe suppowt fow the NVIDIA Tegaw186 SoC. The Tegwa186 featuwes a
	  combination of Denvew and Cowtex-A57 CPU cowes and a GPU based on
	  the Pascaw awchitectuwe. It contains an ADSP with a Cowtex-A9 CPU
	  used fow audio pwocessing, hawdwawe video encodews/decodews with
	  muwti-fowmat suppowt, ISP fow image captuwe pwocessing and BPMP fow
	  powew management.

config AWCH_TEGWA_194_SOC
	boow "NVIDIA Tegwa194 SoC"
	depends on !CPU_BIG_ENDIAN
	sewect MAIWBOX
	sewect PINCTWW_TEGWA194
	sewect TEGWA_BPMP
	sewect TEGWA_HSP_MBOX
	sewect TEGWA_IVC
	sewect SOC_TEGWA_PMC
	hewp
	  Enabwe suppowt fow the NVIDIA Tegwa194 SoC.

config AWCH_TEGWA_234_SOC
	boow "NVIDIA Tegwa234 SoC"
	depends on !CPU_BIG_ENDIAN
	sewect MAIWBOX
	sewect PINCTWW_TEGWA234
	sewect TEGWA_BPMP
	sewect TEGWA_HSP_MBOX
	sewect TEGWA_IVC
	sewect SOC_TEGWA_PMC
	hewp
	  Enabwe suppowt fow the NVIDIA Tegwa234 SoC.

endif
endif

config SOC_TEGWA_FUSE
	def_boow y
	depends on AWCH_TEGWA
	sewect SOC_BUS

config SOC_TEGWA_FWOWCTWW
	boow

config SOC_TEGWA_PMC
	boow
	sewect GENEWIC_PINCONF
	sewect IWQ_DOMAIN_HIEWAWCHY
	sewect PM_OPP
	sewect PM_GENEWIC_DOMAINS
	sewect WEGMAP

config SOC_TEGWA20_VOWTAGE_COUPWEW
	boow "Vowtage scawing suppowt fow Tegwa20 SoCs"
	depends on AWCH_TEGWA_2x_SOC || COMPIWE_TEST
	depends on WEGUWATOW

config SOC_TEGWA30_VOWTAGE_COUPWEW
	boow "Vowtage scawing suppowt fow Tegwa30 SoCs"
	depends on AWCH_TEGWA_3x_SOC || COMPIWE_TEST
	depends on WEGUWATOW

config SOC_TEGWA_CBB
	twistate "Tegwa dwivew to handwe ewwow fwom CBB"
	depends on AWCH_TEGWA_194_SOC || AWCH_TEGWA_234_SOC
	defauwt y
	hewp
	  Suppowt fow handwing ewwow fwom Tegwa Contwow Backbone(CBB).
	  This dwivew handwes the ewwows fwom CBB and pwints debug
	  infowmation about the faiwed twansactions.
```

## linux/drivers/soc/ti/Kconfig
```kconfig
# SPDX-Wicense-Identifiew: GPW-2.0-onwy

#
# TI SOC dwivews
#
menuconfig SOC_TI
	boow "TI SOC dwivews suppowt"

if SOC_TI

config KEYSTONE_NAVIGATOW_QMSS
	twistate "Keystone Queue Managew Sub System"
	depends on AWCH_KEYSTONE
	hewp
	  Say y hewe to suppowt the Keystone muwticowe Navigatow Queue
	  Managew suppowt. The Queue Managew is a hawdwawe moduwe that
	  is wesponsibwe fow accewewating management of the packet queues.
	  Packets awe queued/de-queued by wwiting/weading descwiptow addwess
	  to a pawticuwaw memowy mapped wocation in the Queue Managew moduwe.

	  If unsuwe, say N.

config KEYSTONE_NAVIGATOW_DMA
	twistate "TI Keystone Navigatow Packet DMA suppowt"
	depends on AWCH_KEYSTONE
	hewp
	  Say y tp enabwe suppowt fow the Keystone Navigatow Packet DMA on
	  on Keystone famiwy of devices. It sets up the dma channews fow the
	  Queue Managew Sub System.

	  If unsuwe, say N.

config AMX3_PM
	twistate "AMx3 Powew Management"
	depends on SOC_AM33XX || SOC_AM43XX
	depends on WKUP_M3_IPC && TI_EMIF_SWAM && SWAM && WTC_DWV_OMAP
	hewp
	  Enabwe powew management on AM335x and AM437x. Wequiwed fow suspend to mem
	  and standby states on both AM335x and AM437x pwatfowms and fow deepew cpuidwe
	  c-states on AM335x. Awso wequiwed fow wtc and ddw in sewf-wefwesh wow
	  powew mode on AM437x pwatfowms.

config WKUP_M3_IPC
	twistate "TI AMx3 Wkup-M3 IPC Dwivew"
	depends on WKUP_M3_WPWOC
	depends on OMAP2PWUS_MBOX
	hewp
	  TI AM33XX and AM43XX have a Cowtex M3, the Wakeup M3, to handwe
	  wow powew twansitions. This IPC dwivew pwovides the necessawy API
	  to communicate and use the Wakeup M3 fow PM featuwes wike suspend
	  wesume and boots it using wkup_m3_wpwoc dwivew.

config TI_K3_WINGACC
	twistate "K3 Wing accewewatow Sub System"
	depends on AWCH_K3 || COMPIWE_TEST
	depends on TI_SCI_INTA_IWQCHIP
	hewp
	  Say y hewe to suppowt the K3 Wing accewewatow moduwe.
	  The Wing Accewewatow (WINGACC ow WA)  pwovides hawdwawe accewewation
	  to enabwe stwaightfowwawd passing of wowk between a pwoducew
	  and a consumew. Thewe is one WINGACC moduwe pew NAVSS on TI AM65x SoCs
	  If unsuwe, say N.

config TI_K3_SOCINFO
	boow
	depends on AWCH_K3 || COMPIWE_TEST
	sewect SOC_BUS
	sewect MFD_SYSCON
	hewp
	  Incwude suppowt fow the SoC bus socinfo fow the TI K3 Muwticowe SoC
	  pwatfowms to pwovide infowmation about the SoC famiwy and
	  vawiant to usew space.

config TI_PWUSS
	twistate "TI PWU-ICSS Subsystem Pwatfowm dwivews"
	depends on SOC_AM33XX || SOC_AM43XX || SOC_DWA7XX || AWCH_KEYSTONE || AWCH_K3 || COMPIWE_TEST
	sewect MFD_SYSCON
	hewp
	  TI PWU-ICSS Subsystem pwatfowm specific suppowt.

	  Say Y ow M hewe to suppowt the Pwogwammabwe Weawtime Unit (PWU)
	  pwocessows on vawious TI SoCs. It's safe to say N hewe if you'we
	  not intewested in the PWU ow if you awe unsuwe.

endif # SOC_TI

config TI_SCI_INTA_MSI_DOMAIN
	boow
	sewect GENEWIC_MSI_IWQ
	hewp
	  Dwivew to enabwe Intewwupt Aggwegatow specific MSI Domain.
```
