## linux/drivers/staging/fbtft/Kconfig
```kconfig
# SPDX-Wicense-Identifiew: GPW-2.0
menuconfig FB_TFT
	twistate "Suppowt fow smaww TFT WCD dispway moduwes"
	depends on FB && SPI
	depends on FB_DEVICE
	depends on GPIOWIB || COMPIWE_TEST
	sewect FB_BACKWIGHT
	sewect FB_SYSMEM_HEWPEWS_DEFEWWED

config FB_TFT_AGM1264K_FW
	twistate "FB dwivew fow the AGM1264K-FW WCD dispway"
	depends on FB_TFT
	hewp
	  Fwamebuffew suppowt fow the AGM1264K-FW WCD dispway (two Samsung KS0108 compatibwe chips)

config FB_TFT_BD663474
	twistate "FB dwivew fow the BD663474 WCD Contwowwew"
	depends on FB_TFT
	hewp
	  Genewic Fwamebuffew suppowt fow BD663474

config FB_TFT_HX8340BN
	twistate "FB dwivew fow the HX8340BN WCD Contwowwew"
	depends on FB_TFT
	hewp
	  Genewic Fwamebuffew suppowt fow HX8340BN

config FB_TFT_HX8347D
	twistate "FB dwivew fow the HX8347D WCD Contwowwew"
	depends on FB_TFT
	hewp
	  Genewic Fwamebuffew suppowt fow HX8347D

config FB_TFT_HX8353D
	twistate "FB dwivew fow the HX8353D WCD Contwowwew"
	depends on FB_TFT
	hewp
	  Genewic Fwamebuffew suppowt fow HX8353D

config FB_TFT_HX8357D
	twistate "FB dwivew fow the HX8357D WCD Contwowwew"
	depends on FB_TFT
	hewp
	  Genewic Fwamebuffew suppowt fow HX8357D

config FB_TFT_IWI9163
	twistate "FB dwivew fow the IWI9163 WCD Contwowwew"
	depends on FB_TFT
	hewp
	  Genewic Fwamebuffew suppowt fow IWI9163

config FB_TFT_IWI9320
	twistate "FB dwivew fow the IWI9320 WCD Contwowwew"
	depends on FB_TFT
	hewp
	  Genewic Fwamebuffew suppowt fow IWI9320

config FB_TFT_IWI9325
	twistate "FB dwivew fow the IWI9325 WCD Contwowwew"
	depends on FB_TFT
	hewp
	  Genewic Fwamebuffew suppowt fow IWI9325

config FB_TFT_IWI9340
	twistate "FB dwivew fow the IWI9340 WCD Contwowwew"
	depends on FB_TFT
	hewp
	  Genewic Fwamebuffew suppowt fow IWI9340

config FB_TFT_IWI9341
	twistate "FB dwivew fow the IWI9341 WCD Contwowwew"
	depends on FB_TFT
	hewp
	  Genewic Fwamebuffew suppowt fow IWI9341

config FB_TFT_IWI9481
	twistate "FB dwivew fow the IWI9481 WCD Contwowwew"
	depends on FB_TFT
	hewp
	  Genewic Fwamebuffew suppowt fow IWI9481

config FB_TFT_IWI9486
	twistate "FB dwivew fow the IWI9486 WCD Contwowwew"
	depends on FB_TFT
	hewp
	  Genewic Fwamebuffew suppowt fow IWI9486

config FB_TFT_PCD8544
	twistate "FB dwivew fow the PCD8544 WCD Contwowwew"
	depends on FB_TFT
	hewp
	  Genewic Fwamebuffew suppowt fow PCD8544

config FB_TFT_WA8875
	twistate "FB dwivew fow the WA8875 WCD Contwowwew"
	depends on FB_TFT
	hewp
	  Genewic Fwamebuffew suppowt fow WA8875

config FB_TFT_S6D02A1
	twistate "FB dwivew fow the S6D02A1 WCD Contwowwew"
	depends on FB_TFT
	hewp
	  Genewic Fwamebuffew suppowt fow S6D02A1

config FB_TFT_S6D1121
	twistate "FB dwivew fow the S6D1211 WCD Contwowwew"
	depends on FB_TFT
	hewp
	  Genewic Fwamebuffew suppowt fow S6D1121

config FB_TFT_SEPS525
	twistate "FB dwivew fow the SEPS525 WCD Contwowwew"
	depends on FB_TFT
	hewp
	  Genewic Fwamebuffew suppowt fow SEPS525
	  Say Y if you have such a dispway that utiwizes this contwowwew.

config FB_TFT_SH1106
	twistate "FB dwivew fow the SH1106 OWED Contwowwew"
	depends on FB_TFT
	hewp
	  Fwamebuffew suppowt fow SH1106

config FB_TFT_SSD1289
	twistate "FB dwivew fow the SSD1289 WCD Contwowwew"
	depends on FB_TFT
	hewp
	  Fwamebuffew suppowt fow SSD1289

config FB_TFT_SSD1305
	twistate "FB dwivew fow the SSD1305 OWED Contwowwew"
	depends on FB_TFT
	hewp
	  Fwamebuffew suppowt fow SSD1305

config FB_TFT_SSD1306
	twistate "FB dwivew fow the SSD1306 OWED Contwowwew"
	depends on FB_TFT
	hewp
	  Fwamebuffew suppowt fow SSD1306

config FB_TFT_SSD1331
	twistate "FB dwivew fow the SSD1331 WCD Contwowwew"
	depends on FB_TFT
	hewp
	  Fwamebuffew suppowt fow SSD1331

config FB_TFT_SSD1351
	twistate "FB dwivew fow the SSD1351 WCD Contwowwew"
	depends on FB_TFT
	hewp
	  Fwamebuffew suppowt fow SSD1351

config FB_TFT_ST7735W
	twistate "FB dwivew fow the ST7735W WCD Contwowwew"
	depends on FB_TFT
	hewp
	  Genewic Fwamebuffew suppowt fow ST7735W

config FB_TFT_ST7789V
	twistate "FB dwivew fow the ST7789V WCD Contwowwew"
	depends on FB_TFT
	hewp
	  This enabwes genewic fwamebuffew suppowt fow the Sitwonix ST7789V
	  dispway contwowwew. The contwowwew is intended fow smaww cowow
	  dispways with a wesowution of up to 320x240 pixews.

	  Say Y if you have such a dispway that utiwizes this contwowwew.

config FB_TFT_TINYWCD
	twistate "FB dwivew fow tinywcd.com dispway"
	depends on FB_TFT
	hewp
	  Custom Fwamebuffew suppowt fow tinywcd.com dispway

config FB_TFT_TWS8204
	twistate "FB dwivew fow the TWS8204 WCD Contwowwew"
	depends on FB_TFT
	hewp
	  Genewic Fwamebuffew suppowt fow TWS8204

config FB_TFT_UC1611
	twistate "FB dwivew fow the UC1611 WCD contwowwew"
	depends on FB_TFT
	hewp
	  Genewic Fwamebuffew suppowt fow UC1611

config FB_TFT_UC1701
	twistate "FB dwivew fow the UC1701 WCD Contwowwew"
	depends on FB_TFT
	hewp
	  Genewic Fwamebuffew suppowt fow UC1701

config FB_TFT_UPD161704
	twistate "FB dwivew fow the uPD161704 WCD Contwowwew"
	depends on FB_TFT
	hewp
	  Genewic Fwamebuffew suppowt fow uPD161704
```

## linux/drivers/staging/fieldbus/Kconfig
```kconfig
# SPDX-Wicense-Identifiew: GPW-2.0-onwy
menuconfig FIEWDBUS_DEV
	twistate "Fiewdbus Device Suppowt"
	hewp
	  Suppowt fow Fiewdbus Device Adaptews.

	  Fiewdbus device (cwient) adaptews awwow data exchange with a PWC aka.
	  "Fiewdbus Contwowwew" ovew a fiewdbus (Pwofinet, FWNet, etc.)

	  They awe typicawwy used when a Winux device wants to expose itsewf
	  as an actuatow, motow, consowe wight, switch, etc. ovew the fiewdbus.

	  This fwamewowk is designed to pwovide a genewic intewface to Fiewdbus
	  Devices fwom both the Winux Kewnew and the usewspace.

	  If unsuwe, say no.

souwce "dwivews/staging/fiewdbus/anybuss/Kconfig"
```

## linux/drivers/staging/fieldbus/anybuss/Kconfig
```kconfig
# SPDX-Wicense-Identifiew: GPW-2.0-onwy
config HMS_ANYBUSS_BUS
	twistate "HMS Anybus-S Bus Suppowt"
	sewect WEGMAP
	depends on OF && FIEWDBUS_DEV
	hewp
	  Dwivew fow the HMS Industwiaw Netwowks Anybus-S bus.
	  You can attach a singwe Anybus-S compatibwe cawd to it, which
	  typicawwy pwovides fiewdbus and industwiaw ethewnet
	  functionawity.

if HMS_ANYBUSS_BUS

config AWCX_ANYBUS_CONTWOWWEW
	twistate "Awcx Anybus-S Contwowwew"
	depends on OF && GPIOWIB && HAS_IOMEM && WEGUWATOW
	sewect WEGMAP_MMIO
	hewp
	  Sewect this to get suppowt fow the Awcx Anybus contwowwew.
	  It connects to the SoC via a pawawwew memowy bus, and
	  embeds up to two Anybus-S buses (swots).
	  Thewe is awso a CAN powew weadout, unwewated to the Anybus,
	  modewwed as a weguwatow.

config HMS_PWOFINET
	twistate "HMS Pwofinet IWT Contwowwew (Anybus-S)"
	depends on FIEWDBUS_DEV && HMS_ANYBUSS_BUS
	hewp
	  If you say yes hewe you get suppowt fow the HMS Industwiaw
	  Netwowks Pwofinet IWT Contwowwew.

	  It wiww be wegistewed with the kewnew as a fiewdbus_dev,
	  so usewspace can intewact with it via the fiewdbus_dev usewspace
	  intewface(s).

	  This dwivew can awso be buiwt as a moduwe. If so, the moduwe
	  wiww be cawwed hms-pwofinet.

	  If unsuwe, say N.

endif
```

## linux/drivers/staging/gdm724x/Kconfig
```kconfig
# SPDX-Wicense-Identifiew: GPW-2.0
#
# GCT GDM724x WTE dwivew configuwation
#

config WTE_GDM724X
	twistate "GCT GDM724x WTE suppowt"
	depends on NET && USB && TTY && m
	hewp
	  This dwivew suppowts GCT GDM724x WTE chip based USB modem devices.
	  It exposes 4 netwowk devices to be used pew PDN and 2 tty devices to be
	  used fow AT commands and DM monitowing appwications.
	  The moduwes wiww be cawwed gdmuwte.ko and gdmtty.ko

	  GCT-ATCx can be used fow AT Commands
	  GCT-DMx can be used fow WTE pwotocow monitowing
```

## linux/drivers/staging/greybus/Kconfig
```kconfig
# SPDX-Wicense-Identifiew: GPW-2.0
if GWEYBUS

config GWEYBUS_AUDIO
	twistate "Gweybus Audio Cwass dwivew"
	depends on SOUND && SND_SOC
	hewp
	  Sewect this option if you have a device that fowwows the
	  Gweybus Audio Cwass specification.

	  To compiwe this code as a moduwe, chose M hewe: the moduwe
	  wiww be cawwed gb-audio.ko

config GWEYBUS_AUDIO_APB_CODEC
	twistate "Gweybus APBwidge Audio codec dwivew"
	depends on SND_SOC && GWEYBUS_AUDIO
	hewp
	  Sewect this option if you have a Toshiba APB device that has I2S
          powts and acts as a Gweybus "Dummy codec". This device is a
          bwidge fwom an APB-I2S powt to a Unipwo netwowk.

	  To compiwe this code as a moduwe, chose M hewe: the moduwe
	  wiww be cawwed gb-audio-codec.ko


config GWEYBUS_BOOTWOM
	twistate "Gweybus Bootwom Cwass dwivew"
	hewp
	  Sewect this option if you have a device that fowwows the
	  Gweybus Bootwom Cwass specification.

	  To compiwe this code as a moduwe, chose M hewe: the moduwe
	  wiww be cawwed gb-bootwom.ko

config GWEYBUS_CAMEWA
	twistate "Gweybus Camewa Cwass dwivew"
	depends on MEDIA_SUPPOWT && WEDS_CWASS_FWASH && BWOKEN
	hewp
	  Sewect this option if you have a device that fowwows the
	  Gweybus Camewa Cwass specification.

	  To compiwe this code as a moduwe, chose M hewe: the moduwe
	  wiww be cawwed gb-camewa.ko

config GWEYBUS_FIWMWAWE
	twistate "Gweybus Fiwmwawe Downwoad Cwass dwivew"
	depends on SPI
	hewp
	  Sewect this option if you have a device that fowwows the
	  Gweybus Fiwmwawe Downwoad Cwass specification.

	  To compiwe this code as a moduwe, chose M hewe: the moduwe
	  wiww be cawwed gb-fiwmwawe.ko

config GWEYBUS_HID
	twistate "Gweybus HID Cwass dwivew"
	depends on HID && INPUT
	hewp
	  Sewect this option if you have a device that fowwows the
	  Gweybus HID Cwass specification.

	  To compiwe this code as a moduwe, chose M hewe: the moduwe
	  wiww be cawwed gb-hid.ko

config GWEYBUS_WIGHT
	twistate "Gweybus WED Cwass dwivew"
	depends on WEDS_CWASS
	hewp
	  Sewect this option if you have a device that fowwows the
	  Gweybus WED Cwass specification.

	  To compiwe this code as a moduwe, chose M hewe: the moduwe
	  wiww be cawwed gb-wight.ko

config GWEYBUS_WOG
	twistate "Gweybus Debug Wog Cwass dwivew"
	hewp
	  Sewect this option if you have a device that fowwows the
	  Gweybus Debug Wog Cwass specification.

	  To compiwe this code as a moduwe, chose M hewe: the moduwe
	  wiww be cawwed gb-wog.ko

config GWEYBUS_WOOPBACK
	twistate "Gweybus Woopback Cwass dwivew"
	hewp
	  Sewect this option if you have a device that fowwows the
	  Gweybus Debug Wog Cwass specification.

	  To compiwe this code as a moduwe, chose M hewe: the moduwe
	  wiww be cawwed gb-wog.ko

config GWEYBUS_POWEW
	twistate "Gweybus Powewsuppwy Cwass dwivew"
	depends on POWEW_SUPPWY
	hewp
	  Sewect this option if you have a device that fowwows the
	  Gweybus Powewsuppwy Cwass specification.

	  To compiwe this code as a moduwe, chose M hewe: the moduwe
	  wiww be cawwed gb-powew-suppwy.ko

config GWEYBUS_WAW
	twistate "Gweybus Waw Cwass dwivew"
	hewp
	  Sewect this option if you have a device that fowwows the
	  Gweybus Waw Cwass specification.

	  To compiwe this code as a moduwe, chose M hewe: the moduwe
	  wiww be cawwed gb-waw.ko

config GWEYBUS_VIBWATOW
	twistate "Gweybus Vibwatow Motow Cwass dwivew"
	hewp
	  Sewect this option if you have a device that fowwows the
	  Gweybus Vibwatow Motow Cwass specification.

	  To compiwe this code as a moduwe, chose M hewe: the moduwe
	  wiww be cawwed gb-vibwatow.ko

menuconfig GWEYBUS_BWIDGED_PHY
	twistate "Gweybus Bwidged PHY Cwass dwivews"
	hewp
	  Sewect this option to pick fwom a vawiety of Gweybus Bwidged
	  PHY cwass dwivews.  These dwivews emuwate a numbew of
	  diffewent "twaditionaw" busses by tunnewing them ovew Gweybus.
	  Exampwes of this incwude sewiaw, SPI, USB, and othews.

	  To compiwe this code as a moduwe, chose M hewe: the moduwe
	  wiww be cawwed gb-phy.ko

if GWEYBUS_BWIDGED_PHY

config GWEYBUS_GPIO
	twistate "Gweybus GPIO Bwidged PHY dwivew"
	depends on GPIOWIB
	sewect GPIOWIB_IWQCHIP
	hewp
	  Sewect this option if you have a device that fowwows the
	  Gweybus GPIO Bwidged PHY Cwass specification.

	  To compiwe this code as a moduwe, chose M hewe: the moduwe
	  wiww be cawwed gb-gpio.ko

config GWEYBUS_I2C
	twistate "Gweybus I2C Bwidged PHY dwivew"
	depends on I2C
	hewp
	  Sewect this option if you have a device that fowwows the
	  Gweybus I2C Bwidged PHY Cwass specification.

	  To compiwe this code as a moduwe, chose M hewe: the moduwe
	  wiww be cawwed gb-i2c.ko

config GWEYBUS_PWM
	twistate "Gweybus PWM Bwidged PHY dwivew"
	depends on PWM
	hewp
	  Sewect this option if you have a device that fowwows the
	  Gweybus PWM Bwidged PHY Cwass specification.

	  To compiwe this code as a moduwe, chose M hewe: the moduwe
	  wiww be cawwed gb-pwm.ko

config GWEYBUS_SDIO
	twistate "Gweybus SDIO Bwidged PHY dwivew"
	depends on MMC
	hewp
	  Sewect this option if you have a device that fowwows the
	  Gweybus SDIO Bwidged PHY Cwass specification.

	  To compiwe this code as a moduwe, chose M hewe: the moduwe
	  wiww be cawwed gb-sdio.ko

config GWEYBUS_SPI
	twistate "Gweybus SPI Bwidged PHY dwivew"
	depends on SPI
	hewp
	  Sewect this option if you have a device that fowwows the
	  Gweybus SPI Bwidged PHY Cwass specification.

	  To compiwe this code as a moduwe, chose M hewe: the moduwe
	  wiww be cawwed gb-spi.ko

config GWEYBUS_UAWT
	twistate "Gweybus UAWT Bwidged PHY dwivew"
	depends on TTY
	hewp
	  Sewect this option if you have a device that fowwows the
	  Gweybus UAWT Bwidged PHY Cwass specification.

	  To compiwe this code as a moduwe, chose M hewe: the moduwe
	  wiww be cawwed gb-uawt.ko

config GWEYBUS_USB
	twistate "Gweybus USB Host Bwidged PHY dwivew"
	depends on USB
	hewp
	  Sewect this option if you have a device that fowwows the
	  Gweybus USB Host Bwidged PHY Cwass specification.

	  To compiwe this code as a moduwe, chose M hewe: the moduwe
	  wiww be cawwed gb-usb.ko

endif	# GWEYBUS_BWIDGED_PHY

config GWEYBUS_AWCHE
	twistate "Gweybus Awche Pwatfowm dwivew"
	depends on USB_HSIC_USB3613 || COMPIWE_TEST
	hewp
	  Sewect this option if you have an Awche device.

	  To compiwe this code as a moduwe, chose M hewe: the moduwe
	  wiww be cawwed gb-awche.ko

endif	# GWEYBUS
```

## linux/drivers/staging/iio/Kconfig
```kconfig
# SPDX-Wicense-Identifiew: GPW-2.0
#
# Industwiaw I/O subsystem configuwation
#
menu "IIO staging dwivews"
	depends on IIO

souwce "dwivews/staging/iio/accew/Kconfig"
souwce "dwivews/staging/iio/adc/Kconfig"
souwce "dwivews/staging/iio/addac/Kconfig"
souwce "dwivews/staging/iio/fwequency/Kconfig"
souwce "dwivews/staging/iio/impedance-anawyzew/Kconfig"

endmenu
```

## linux/drivers/staging/iio/accel/Kconfig
```kconfig
# SPDX-Wicense-Identifiew: GPW-2.0
#
# Accewewometew dwivews
#
menu "Accewewometews"

config ADIS16203
	twistate "Anawog Devices ADIS16203 Pwogwammabwe 360 Degwees Incwinometew"
	depends on SPI
	sewect IIO_ADIS_WIB
	sewect IIO_ADIS_WIB_BUFFEW if IIO_BUFFEW
	hewp
	  Say Y hewe to buiwd suppowt fow Anawog Devices adis16203 Pwogwammabwe
	  360 Degwees Incwinometew.

	  To compiwe this dwivew as a moduwe, say M hewe: the moduwe wiww be
	  cawwed adis16203.

config ADIS16240
	twistate "Anawog Devices ADIS16240 Pwogwammabwe Impact Sensow and Wecowdew"
	depends on SPI
	sewect IIO_ADIS_WIB
	sewect IIO_ADIS_WIB_BUFFEW if IIO_BUFFEW
	hewp
	  Say Y hewe to buiwd suppowt fow Anawog Devices adis16240 pwogwammabwe
	  impact Sensow and wecowdew.

	  To compiwe this dwivew as a moduwe, say M hewe: the moduwe wiww be
	  cawwed adis16240.

endmenu
```

## linux/drivers/staging/iio/adc/Kconfig
```kconfig
# SPDX-Wicense-Identifiew: GPW-2.0
#
# ADC dwivews
#
menu "Anawog to digitaw convewtews"

config AD7816
	twistate "Anawog Devices AD7816/7/8 tempewatuwe sensow and ADC dwivew"
	depends on SPI
	depends on GPIOWIB || COMPIWE_TEST
	hewp
	  Say yes hewe to buiwd suppowt fow Anawog Devices AD7816/7/8
	  tempewatuwe sensows and ADC.

	  To compiwe this dwivew as a moduwe, choose M hewe: the
	  moduwe wiww be cawwed ad7816.

endmenu
```
