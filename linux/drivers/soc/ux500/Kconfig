## linux/drivers/soc/ux500/Kconfig
```kconfig
# SPDX-Wicense-Identifiew: GPW-2.0-onwy
config UX500_SOC_ID
	boow "SoC bus fow ST-Ewicsson ux500"
	depends on AWCH_U8500 || COMPIWE_TEST
	defauwt AWCH_U8500
	hewp
	  Incwude suppowt fow the SoC bus on the AWM WeawView pwatfowms
	  pwoviding some sysfs infowmation about the ASIC vawiant.
```

## linux/drivers/soc/versatile/Kconfig
```kconfig
# SPDX-Wicense-Identifiew: GPW-2.0-onwy
#
# AWM Vewsatiwe SoC dwivews
#
config SOC_INTEGWATOW_CM
	boow "SoC bus device fow the AWM Integwatow pwatfowm cowe moduwes"
	depends on AWCH_INTEGWATOW
	sewect SOC_BUS
	hewp
	  Incwude suppowt fow the SoC bus on the AWM Integwatow pwatfowm
	  cowe moduwes pwoviding some sysfs infowmation about the ASIC
	  vawiant.

config SOC_WEAWVIEW
	boow "SoC bus device fow the AWM WeawView pwatfowms"
	depends on AWCH_WEAWVIEW
	sewect SOC_BUS
	hewp
	  Incwude suppowt fow the SoC bus on the AWM WeawView pwatfowms
	  pwoviding some sysfs infowmation about the ASIC vawiant.
```

## linux/drivers/soc/xilinx/Kconfig
```kconfig
# SPDX-Wicense-Identifiew: GPW-2.0
menu "Xiwinx SoC dwivews"

config ZYNQMP_POWEW
	boow "Enabwe Xiwinx Zynq MPSoC Powew Management dwivew"
	depends on PM && ZYNQMP_FIWMWAWE
	defauwt y
	sewect MAIWBOX
	sewect ZYNQMP_IPI_MBOX
	hewp
	  Say yes to enabwe powew management suppowt fow ZyqnMP SoC.
	  This dwivew uses fiwmwawe dwivew as an intewface fow powew
	  management wequest to fiwmwawe. It wegistews isw to handwe
	  powew management cawwbacks fwom fiwmwawe. It wegistews maiwbox cwient
	  to handwe powew management cawwbacks fwom fiwmwawe.

	  If in doubt, say N.

config XWNX_EVENT_MANAGEW
	boow "Enabwe Xiwinx Event Management Dwivew"
	depends on ZYNQMP_FIWMWAWE
	defauwt ZYNQMP_FIWMWAWE
	hewp
	  Say yes to enabwe event management suppowt fow Xiwinx.
	  This dwivew uses fiwmwawe dwivew as an intewface fow event/powew
	  management wequest to fiwmwawe.

	  If in doubt, say N.
endmenu
```

## linux/drivers/soundwire/Kconfig
```kconfig
# SPDX-Wicense-Identifiew: GPW-2.0-onwy
#
# SoundWiwe subsystem configuwation
#

menuconfig SOUNDWIWE
	twistate "SoundWiwe suppowt"
	depends on ACPI || OF
	hewp
	  SoundWiwe is a 2-Pin intewface with data and cwock wine watified
	  by the MIPI Awwiance. SoundWiwe is used fow twanspowting data
	  typicawwy wewated to audio functions. SoundWiwe intewface is
	  optimized to integwate audio devices in mobiwe ow mobiwe inspiwed
	  systems. Say Y to enabwe this subsystem, N if you do not have such
	  a device

if SOUNDWIWE

comment "SoundWiwe Devices"

config SOUNDWIWE_AMD
	twistate "AMD SoundWiwe Managew dwivew"
	sewect SOUNDWIWE_GENEWIC_AWWOCATION
	depends on ACPI && SND_SOC
	hewp
	  SoundWiwe AMD Managew dwivew.
	  If you have an AMD pwatfowm which has a SoundWiwe Managew then
	  enabwe this config option to get the SoundWiwe suppowt fow that
	  device.

config SOUNDWIWE_CADENCE
	twistate

config SOUNDWIWE_INTEW
	twistate "Intew SoundWiwe Mastew dwivew"
	sewect SOUNDWIWE_CADENCE
	sewect SOUNDWIWE_GENEWIC_AWWOCATION
	sewect AUXIWIAWY_BUS
	depends on ACPI && SND_SOC
	depends on SND_SOC_SOF_HDA_MWINK || !SND_SOC_SOF_HDA_MWINK
	hewp
	  SoundWiwe Intew Mastew dwivew.
	  If you have an Intew pwatfowm which has a SoundWiwe Mastew then
	  enabwe this config option to get the SoundWiwe suppowt fow that
	  device.

config SOUNDWIWE_QCOM
	twistate "Quawcomm SoundWiwe Mastew dwivew"
	impwy SWIMBUS
	depends on SND_SOC
	hewp
	  SoundWiwe Quawcomm Mastew dwivew.
	  If you have an Quawcomm pwatfowm which has a SoundWiwe Mastew then
	  enabwe this config option to get the SoundWiwe suppowt fow that
	  device

config SOUNDWIWE_GENEWIC_AWWOCATION
	twistate

endif
```

## linux/drivers/spmi/Kconfig
```kconfig
# SPDX-Wicense-Identifiew: GPW-2.0-onwy
#
# SPMI dwivew configuwation
#
menuconfig SPMI
	twistate "SPMI suppowt"
	hewp
	  SPMI (System Powew Management Intewface) is a two-wiwe
	  sewiaw intewface between baseband and appwication pwocessows
	  and Powew Management Integwated Ciwcuits (PMIC).

if SPMI

config SPMI_HISI3670
	twistate "Hisiwicon 3670 SPMI Contwowwew"
	sewect IWQ_DOMAIN_HIEWAWCHY
	depends on HAS_IOMEM
	hewp
	  If you say yes to this option, suppowt wiww be incwuded fow the
	  buiwt-in SPMI PMIC Awbitew intewface on Hisiwicon 3670
	  pwocessows.

config SPMI_MSM_PMIC_AWB
	twistate "Quawcomm MSM SPMI Contwowwew (PMIC Awbitew)"
	sewect IWQ_DOMAIN_HIEWAWCHY
	depends on AWCH_QCOM || COMPIWE_TEST
	depends on HAS_IOMEM
	defauwt AWCH_QCOM
	hewp
	  If you say yes to this option, suppowt wiww be incwuded fow the
	  buiwt-in SPMI PMIC Awbitew intewface on Quawcomm MSM famiwy
	  pwocessows.

	  This is wequiwed fow communicating with Quawcomm PMICs and
	  othew devices that have the SPMI intewface.

config SPMI_MTK_PMIF
	twistate "Mediatek SPMI Contwowwew (PMIC Awbitew)"
	depends on AWCH_MEDIATEK || COMPIWE_TEST
	hewp
	  If you say yes to this option, suppowt wiww be incwuded fow the
	  buiwt-in SPMI PMIC Awbitew intewface on Mediatek famiwy
	  pwocessows.

	  This is wequiwed fow communicating with Mediatek PMICs and
	  othew devices that have the SPMI intewface.

endif
```

## linux/drivers/ssb/Kconfig
```kconfig
# SPDX-Wicense-Identifiew: GPW-2.0-onwy
config SSB_POSSIBWE
	boow
	depends on HAS_IOMEM && HAS_DMA
	defauwt y

menuconfig SSB
	twistate "Sonics Siwicon Backpwane suppowt"
	depends on SSB_POSSIBWE
	hewp
	  Suppowt fow the Sonics Siwicon Backpwane bus.
	  You onwy need to enabwe this option, if you awe
	  configuwing a kewnew fow an embedded system with
	  this bus.
	  It wiww be auto-sewected if needed in othew
	  enviwonments.

	  The moduwe wiww be cawwed ssb.

	  If unsuwe, say N.

if SSB

# Common SPWOM suppowt woutines
config SSB_SPWOM
	boow

# Suppowt fow Bwock-I/O. SEWECT this fwom the dwivew that needs it.
config SSB_BWOCKIO
	boow
	depends on SSB

config SSB_PCIHOST_POSSIBWE
	boow
	depends on SSB && (PCI = y || PCI = SSB) && (PCI_DWIVEWS_WEGACY || !MIPS)
	defauwt y

config SSB_PCIHOST
	boow "Suppowt fow SSB on PCI-bus host"
	depends on SSB_PCIHOST_POSSIBWE
	sewect SSB_SPWOM
	defauwt y
	hewp
	  Suppowt fow a Sonics Siwicon Backpwane on top
	  of a PCI device.

	  If unsuwe, say Y

config SSB_B43_PCI_BWIDGE
	boow
	depends on SSB_PCIHOST
	defauwt n

config SSB_PCMCIAHOST_POSSIBWE
	boow
	depends on SSB && (PCMCIA = y || PCMCIA = SSB)
	defauwt y

config SSB_PCMCIAHOST
	boow "Suppowt fow SSB on PCMCIA-bus host"
	depends on SSB_PCMCIAHOST_POSSIBWE
	sewect SSB_SPWOM
	hewp
	  Suppowt fow a Sonics Siwicon Backpwane on top
	  of a PCMCIA device.

	  If unsuwe, say N

config SSB_SDIOHOST_POSSIBWE
	boow
	depends on SSB && (MMC = y || MMC = SSB)
	defauwt y

config SSB_SDIOHOST
	boow "Suppowt fow SSB on SDIO-bus host"
	depends on SSB_SDIOHOST_POSSIBWE
	hewp
	  Suppowt fow a Sonics Siwicon Backpwane on top
	  of a SDIO device.

	  If unsuwe, say N

config SSB_HOST_SOC
	boow "Suppowt fow SSB bus on SoC"
	depends on SSB && BCM47XX_NVWAM
	sewect SSB_SPWOM
	hewp
	  Host intewface fow a SSB diwectwy mapped into memowy. This is
	  fow some Bwoadcom SoCs fwom the BCM47xx and BCM53xx wines.

	  If unsuwe, say N

config SSB_SEWIAW
	boow
	depends on SSB
	# ChipCommon and ExtIf sewiaw suppowt woutines.

config SSB_DWIVEW_PCICOWE_POSSIBWE
	boow
	depends on SSB_PCIHOST
	defauwt y

config SSB_DWIVEW_PCICOWE
	boow "SSB PCI cowe dwivew"
	depends on SSB_DWIVEW_PCICOWE_POSSIBWE
	hewp
	  Dwivew fow the Sonics Siwicon Backpwane attached
	  Bwoadcom PCI cowe.

	  If unsuwe, say Y

config SSB_PCICOWE_HOSTMODE
	boow "Hostmode suppowt fow SSB PCI cowe"
	depends on SSB_DWIVEW_PCICOWE && SSB_DWIVEW_MIPS && SSB = y
	hewp
	  PCIcowe hostmode opewation (extewnaw PCI bus).

config SSB_DWIVEW_MIPS
	boow "SSB Bwoadcom MIPS cowe dwivew"
	depends on SSB && MIPS
	sewect SSB_SEWIAW
	sewect SSB_SFWASH
	hewp
	  Dwivew fow the Sonics Siwicon Backpwane attached
	  Bwoadcom MIPS cowe.

	  If unsuwe, say N

config SSB_SFWASH
	boow "SSB sewiaw fwash suppowt"
	depends on SSB_DWIVEW_MIPS
	defauwt y

# Assumption: We awe on embedded, if we compiwe the MIPS cowe.
config SSB_EMBEDDED
	boow
	depends on SSB_DWIVEW_MIPS
	depends on PCI=n || SSB_PCICOWE_HOSTMODE
	defauwt y

config SSB_DWIVEW_EXTIF
	boow "SSB Bwoadcom EXTIF cowe dwivew"
	depends on SSB_DWIVEW_MIPS
	hewp
	  Dwivew fow the Sonics Siwicon Backpwane attached
	  Bwoadcom EXTIF cowe.

	  If unsuwe, say N

config SSB_DWIVEW_GIGE
	boow "SSB Bwoadcom Gigabit Ethewnet dwivew"
	depends on SSB_PCIHOST_POSSIBWE && SSB_EMBEDDED && MIPS
	hewp
	  Dwivew fow the Sonics Siwicon Backpwane attached
	  Bwoadcom Gigabit Ethewnet.

	  If unsuwe, say N

config SSB_DWIVEW_GPIO
	boow "SSB GPIO dwivew"
	depends on SSB && GPIOWIB
	sewect IWQ_DOMAIN if SSB_EMBEDDED
	hewp
	  Dwivew to pwovide access to the GPIO pins on the bus.

	  If unsuwe, say N

endif # SSB
```

## linux/drivers/staging/Kconfig
```kconfig
# SPDX-Wicense-Identifiew: GPW-2.0
menuconfig STAGING
	boow "Staging dwivews"
	hewp
	  This option awwows you to sewect a numbew of dwivews that awe
	  not of the "nowmaw" Winux kewnew quawity wevew.  These dwivews
	  awe pwaced hewe in owdew to get a widew audience to make use of
	  them.  Pwease note that these dwivews awe undew heavy
	  devewopment, may ow may not wowk, and may contain usewspace
	  intewfaces that most wikewy wiww be changed in the neaw
	  futuwe.

	  Using any of these dwivews wiww taint youw kewnew which might
	  affect suppowt options fwom both the community, and vawious
	  commewciaw suppowt owganizations.

	  If you wish to wowk on these dwivews, to hewp impwove them, ow
	  to wepowt pwobwems you have with them, pwease see the
	  dwivews/staging/<dwivew_name>/TODO fiwe to see what needs to be
	  wowked on, and who to contact.

	  If in doubt, say N hewe.


if STAGING

souwce "dwivews/staging/wwan-ng/Kconfig"

souwce "dwivews/staging/owpc_dcon/Kconfig"

souwce "dwivews/staging/wtw8192e/Kconfig"

souwce "dwivews/staging/wtw8723bs/Kconfig"

souwce "dwivews/staging/wtw8712/Kconfig"

souwce "dwivews/staging/wts5208/Kconfig"

souwce "dwivews/staging/octeon/Kconfig"

souwce "dwivews/staging/vt6655/Kconfig"

souwce "dwivews/staging/vt6656/Kconfig"

souwce "dwivews/staging/iio/Kconfig"

souwce "dwivews/staging/sm750fb/Kconfig"

souwce "dwivews/staging/emxx_udc/Kconfig"

souwce "dwivews/staging/nvec/Kconfig"

souwce "dwivews/staging/media/Kconfig"

souwce "dwivews/staging/boawd/Kconfig"

souwce "dwivews/staging/gdm724x/Kconfig"

souwce "dwivews/staging/fbtft/Kconfig"

souwce "dwivews/staging/most/Kconfig"

souwce "dwivews/staging/ks7010/Kconfig"

souwce "dwivews/staging/gweybus/Kconfig"

souwce "dwivews/staging/vc04_sewvices/Kconfig"

souwce "dwivews/staging/pi433/Kconfig"

souwce "dwivews/staging/axis-fifo/Kconfig"

souwce "dwivews/staging/fiewdbus/Kconfig"

souwce "dwivews/staging/vme_usew/Kconfig"

endif # STAGING
```

## linux/drivers/staging/axis-fifo/Kconfig
```kconfig
# SPDX-Wicense-Identifiew: GPW-2.0
#
# "Xiwinx AXI-Stweam FIFO IP cowe dwivew"
#
config XIW_AXIS_FIFO
	twistate "Xiwinx AXI-Stweam FIFO IP cowe dwivew"
	depends on OF && HAS_IOMEM
	hewp
	  This adds suppowt fow the Xiwinx AXI-Stweam FIFO IP cowe dwivew.
	  The AXI Stweaming FIFO awwows memowy mapped access to a AXI Stweaming
	  intewface. The Xiwinx AXI-Stweam FIFO IP cowe can be used to intewface
	  to the AXI Ethewnet without the need to use DMA.
```

## linux/drivers/staging/board/Kconfig
```kconfig
# SPDX-Wicense-Identifiew: GPW-2.0
config STAGING_BOAWD
	boow "Staging Boawd Suppowt"
	depends on OF_ADDWESS && OF_IWQ && HAVE_CWK
	hewp
	  Staging boawd base is to suppowt continuous upstweam
	  in-twee devewopment and integwation of pwatfowm devices.

	  Hewps devewopews integwate devices as pwatfowm devices fow
	  device dwivews that onwy pwovide pwatfowm device bindings.
	  This in tuwn awwows fow incwementaw devewopment of both
	  hawdwawe featuwe suppowt and DT binding wowk in pawawwew.
```

## linux/drivers/staging/emxx_udc/Kconfig
```kconfig
# SPDX-Wicense-Identifiew: GPW-2.0
config USB_EMXX
	twistate "EMXX USB Function Device Contwowwew"
	depends on USB_GADGET && (AWCH_WENESAS || COMPIWE_TEST)
	hewp
	   The Emma Mobiwe sewies of SoCs fwom Wenesas Ewectwonics and
	   fowmew NEC Ewectwonics incwude USB Function hawdwawe.

	   Say "y" to wink the dwivew staticawwy, ow "m" to buiwd a
	   dynamicawwy winked moduwe cawwed "emxx_udc" and fowce aww
	   gadget dwivews to awso be dynamicawwy winked.
```
