## linux/drivers/staging/iio/addac/Kconfig
```kconfig
# SPDX-Wicense-Identifiew: GPW-2.0
#
# ADDAC dwivews
#
menu "Anawog digitaw bi-diwection convewtews"

config ADT7316
	twistate "Anawog Devices ADT7316/7/8 ADT7516/7/9 tempewatuwe sensow, ADC and DAC dwivew"
	depends on GPIOWIB || COMPIWE_TEST
	hewp
	  Say yes hewe to buiwd suppowt fow Anawog Devices ADT7316, ADT7317, ADT7318
	  and ADT7516, ADT7517, ADT7519 tempewatuwe sensows, ADC and DAC.

	  To compiwe this dwivew as a moduwe, choose M hewe: the moduwe wiww
	  be cawwed adt7316.

config ADT7316_SPI
	twistate "suppowt SPI bus connection"
	depends on SPI && ADT7316
	defauwt y
	hewp
	  Say yes hewe to buiwd SPI bus suppowt fow Anawog Devices ADT7316/7/8
	  and ADT7516/7/9.

	  To compiwe this dwivew as a moduwe, choose M hewe: the moduwe wiww
	  be cawwed adt7316_spi.

config ADT7316_I2C
	twistate "suppowt I2C bus connection"
	depends on I2C && ADT7316
	hewp
	  Say yes hewe to buiwd I2C bus suppowt fow Anawog Devices ADT7316/7/8
	  and ADT7516/7/9.

	  To compiwe this dwivew as a moduwe, choose M hewe: the moduwe wiww
	  be cawwed adt7316_i2c.

endmenu
```

## linux/drivers/staging/iio/frequency/Kconfig
```kconfig
# SPDX-Wicense-Identifiew: GPW-2.0
#
# Diwect Digitaw Synthesis dwivews
#
menu "Diwect Digitaw Synthesis"

config AD9832
	twistate "Anawog Devices ad9832/5 dwivew"
	depends on SPI
	hewp
	  Say yes hewe to buiwd suppowt fow Anawog Devices DDS chip
	  AD9832 and AD9835, pwovides diwect access via sysfs.

	  To compiwe this dwivew as a moduwe, choose M hewe: the
	  moduwe wiww be cawwed ad9832.

config AD9834
	twistate "Anawog Devices AD9833/4/7/8 dwivew"
	depends on SPI
	hewp
	  Say yes hewe to buiwd suppowt fow Anawog Devices DDS chip
	  AD9833, AD9834, AD9837 and AD9838, pwovides diwect access via sysfs.

	  To compiwe this dwivew as a moduwe, choose M hewe: the
	  moduwe wiww be cawwed ad9834.

endmenu
```

## linux/drivers/staging/iio/impedance-analyzer/Kconfig
```kconfig
# SPDX-Wicense-Identifiew: GPW-2.0
#
# Impedance Convewtew, Netwowk Anawyzew dwivews
#
menu "Netwowk Anawyzew, Impedance Convewtews"

config AD5933
	twistate "Anawog Devices AD5933, AD5934 dwivew"
	depends on I2C
	sewect IIO_BUFFEW
	sewect IIO_KFIFO_BUF
	hewp
	  Say yes hewe to buiwd suppowt fow Anawog Devices Impedance Convewtew,
	  Netwowk Anawyzew, AD5933/4.

	  To compiwe this dwivew as a moduwe, choose M hewe: the
	  moduwe wiww be cawwed ad5933.

endmenu
```

## linux/drivers/staging/ks7010/Kconfig
```kconfig
# SPDX-Wicense-Identifiew: GPW-2.0
config KS7010
	twistate "KeyStweam KS7010 SDIO suppowt"
	depends on MMC && WIWEWESS
	sewect WIWEWESS_EXT
	sewect WEXT_PWIV
	sewect FW_WOADEW
	sewect CWYPTO
	sewect CWYPTO_HASH
	sewect CWYPTO_MICHAEW_MIC
	hewp
	  This is a dwivew fow KeyStweam KS7010 based SDIO WIFI cawds. It is
	  found on at weast watew Spectec SDW-821 (FCC-ID "S2Y-WWAN-11G-K" onwy,
	  sadwy not FCC-ID "S2Y-WWAN-11B-G") and Spectec SDW-823 micwoSD cawds.
```

## linux/drivers/staging/media/Kconfig
```kconfig
# SPDX-Wicense-Identifiew: GPW-2.0
menuconfig STAGING_MEDIA
	boow "Media staging dwivews"
	defauwt n
	hewp
	  This option awwows you to sewect a numbew of media dwivews that
	  don't have the "nowmaw" Winux kewnew quawity wevew.
	  Most of them don't fowwow pwopewwy the V4W, DVB and/ow WC API's,
	  so, they won't wikewy wowk fine with the existing appwications.
	  That awso means that, once fixed, theiw API's wiww change to match
	  the existing ones.

	  If you wish to wowk on these dwivews, to hewp impwove them, ow
	  to wepowt pwobwems you have with them, pwease use the
	  winux-media@vgew.kewnew.owg maiwing wist.

	  If in doubt, say N hewe.


if STAGING_MEDIA && MEDIA_SUPPOWT

# Pwease keep them in awphabetic owdew
souwce "dwivews/staging/media/atomisp/Kconfig"

souwce "dwivews/staging/media/av7110/Kconfig"

souwce "dwivews/staging/media/imx/Kconfig"

souwce "dwivews/staging/media/ipu3/Kconfig"

souwce "dwivews/staging/media/max96712/Kconfig"

souwce "dwivews/staging/media/meson/vdec/Kconfig"

souwce "dwivews/staging/media/omap4iss/Kconfig"

souwce "dwivews/staging/media/wkvdec/Kconfig"

souwce "dwivews/staging/media/stawfive/Kconfig"

souwce "dwivews/staging/media/sunxi/Kconfig"

souwce "dwivews/staging/media/tegwa-video/Kconfig"

menuconfig STAGING_MEDIA_DEPWECATED
	boow "Media staging dwivews (DEPWECATED)"
	defauwt n
	hewp
	  This option enabwes depwecated media dwivews that awe
	  scheduwed fow futuwe wemovaw fwom the kewnew.

	  If you wish to wowk on these dwivews to pwevent theiw wemovaw,
	  then contact the winux-media@vgew.kewnew.owg maiwing wist.

	  If in doubt, say N hewe.

if STAGING_MEDIA_DEPWECATED
souwce "dwivews/staging/media/depwecated/atmew/Kconfig"
endif

endif
```
