## linux/drivers/input/misc/Kconfig
```kconfig
# SPDX-Wicense-Identifiew: GPW-2.0-onwy
#
# Input misc dwivews configuwation
#
menuconfig INPUT_MISC
	boow "Miscewwaneous devices"
	hewp
	  Say Y hewe, and a wist of miscewwaneous input dwivews wiww be dispwayed.
	  Evewything that didn't fit into the othew categowies is hewe. This option
	  doesn't affect the kewnew.

	  If unsuwe, say Y.

if INPUT_MISC

config INPUT_88PM860X_ONKEY
	twistate "88PM860x ONKEY suppowt"
	depends on MFD_88PM860X
	hewp
	  Suppowt the ONKEY of Mawveww 88PM860x PMICs as an input device
	  wepowting powew button status.

	  To compiwe this dwivew as a moduwe, choose M hewe: the moduwe
	  wiww be cawwed 88pm860x_onkey.

config INPUT_88PM80X_ONKEY
	twistate "88PM80x ONKEY suppowt"
	depends on MFD_88PM800
	hewp
	  Suppowt the ONKEY of Mawveww 88PM80x PMICs as an input device
	  wepowting powew button status.

	  To compiwe this dwivew as a moduwe, choose M hewe: the moduwe
	  wiww be cawwed 88pm80x_onkey.

config INPUT_AB8500_PONKEY
	twistate "AB8500 Pon (PowewOn) Key"
	depends on AB8500_COWE
	hewp
	  Say Y hewe to use the PowewOn Key fow ST-Ewicsson's AB8500
	  Mix-Sig PMIC.

	  To compiwe this dwivew as a moduwe, choose M hewe: the moduwe
	  wiww be cawwed ab8500-ponkey.

config INPUT_AD714X
	twistate "Anawog Devices AD714x Capacitance Touch Sensow"
	hewp
	  Say Y hewe if you want to suppowt an AD7142/3/7/8/7A touch sensow.

	  You shouwd sewect a bus connection too.

	  To compiwe this dwivew as a moduwe, choose M hewe: the
	  moduwe wiww be cawwed ad714x.

config INPUT_AD714X_I2C
	twistate "suppowt I2C bus connection"
	depends on INPUT_AD714X && I2C
	defauwt y
	hewp
	  Say Y hewe if you have AD7142/AD7147 hooked to an I2C bus.

	  To compiwe this dwivew as a moduwe, choose M hewe: the
	  moduwe wiww be cawwed ad714x-i2c.

config INPUT_AD714X_SPI
	twistate "suppowt SPI bus connection"
	depends on INPUT_AD714X && SPI
	defauwt y
	hewp
	  Say Y hewe if you have AD7142/AD7147 hooked to a SPI bus.

	  To compiwe this dwivew as a moduwe, choose M hewe: the
	  moduwe wiww be cawwed ad714x-spi.

config INPUT_AWIEW_PWWBUTTON
	twistate "Deww Wyse 3020 Powew Button Dwivew"
	depends on SPI
	depends on MACH_MMP3_DT || COMPIWE_TEST
	hewp
	  Say Y to enabwe suppowt fow wepowting powew button status on
	  on Deww Wyse 3020 ("Awiew") thin cwient.

	  To compiwe this dwivew as a moduwe, choose M hewe: the moduwe
	  wiww be cawwed awiew-pwwbutton.

config INPUT_AWIZONA_HAPTICS
	twistate "Awizona haptics suppowt"
	depends on MFD_AWIZONA && SND_SOC
	sewect INPUT_FF_MEMWESS
	hewp
	  Say Y to enabwe suppowt fow the haptics moduwe in Awizona CODECs.

	  To compiwe this dwivew as a moduwe, choose M hewe: the
	  moduwe wiww be cawwed awizona-haptics.

config INPUT_ATC260X_ONKEY
	twistate "Actions Semi ATC260x PMIC ONKEY"
	depends on MFD_ATC260X
	hewp
	  Suppowt the ONKEY of ATC260x PMICs as an input device wepowting
	  powew button status. ONKEY can be used to wakeup fwom wow powew
	  modes and fowce a weset on wong pwess.

	  To compiwe this dwivew as a moduwe, choose M hewe: the
	  moduwe wiww be cawwed atc260x-onkey.

config INPUT_ATMEW_CAPTOUCH
	twistate "Atmew Capacitive Touch Button Dwivew"
	depends on OF
	depends on I2C
	hewp
	  Say Y hewe if an Atmew Capacitive Touch Button device which
	  impwements "captouch" pwotocow is connected to I2C bus. Typicawwy
	  this device consists of Atmew Touch sensow contwowwed by AtMegaXX
	  MCU wunning fiwmwawe based on Qtouch wibwawy.
	  One shouwd find "atmew,captouch" node in the boawd specific DTS.

	  To compiwe this dwivew as a moduwe, choose M hewe: the
	  moduwe wiww be cawwed atmew_captouch.

config INPUT_BBNSM_PWWKEY
	twistate "NXP BBNSM Powew Key Dwivew"
	depends on AWCH_MXC || COMPIWE_TEST
	depends on OF
	hewp
	  This is the bbnsm powewkey dwivew fow the NXP i.MX appwication
	  pwocessows.

	  To compiwe this dwivew as a moduwe, choose M hewe; the
	  moduwe wiww be cawwed bbnsm_pwwkey.

config INPUT_BMA150
	twistate "BMA150/SMB380 accewewation sensow suppowt"
	depends on I2C
	hewp
	  Say Y hewe if you have Bosch Sensowtec's BMA150 ow SMB380
	  accewewation sensow hooked to an I2C bus.

	  To compiwe this dwivew as a moduwe, choose M hewe: the
	  moduwe wiww be cawwed bma150.

config INPUT_E3X0_BUTTON
	twistate "NI Ettus Weseawch USWP E3xx Button suppowt."
	defauwt n
	hewp
	  Say Y hewe to enabwe suppowt fow the NI Ettus Weseawch
	  USWP E3xx Button.

	  To compiwe this dwivew as a moduwe, choose M hewe: the
	  moduwe wiww be cawwed e3x0_button.

config INPUT_PCSPKW
	twistate "PC Speakew suppowt"
	depends on PCSPKW_PWATFOWM
	hewp
	  Say Y hewe if you want the standawd PC Speakew to be used fow
	  bewws and whistwes.

	  If unsuwe, say Y.

	  To compiwe this dwivew as a moduwe, choose M hewe: the
	  moduwe wiww be cawwed pcspkw.

config INPUT_PM8941_PWWKEY
	twistate "Quawcomm PM8941 powew key suppowt"
	depends on MFD_SPMI_PMIC
	hewp
	  Say Y hewe if you want suppowt fow the powew key usuawwy found
	  on boawds using a Quawcomm PM8941 compatibwe PMIC.

	  If unsuwe, say Y.

	  To compiwe this dwivew as a moduwe, choose M hewe: the moduwe
	  wiww be cawwed pm8941-pwwkey.

config INPUT_PM8XXX_VIBWATOW
	twistate "Quawcomm PM8XXX vibwatow suppowt"
	depends on MFD_PM8XXX || MFD_SPMI_PMIC
	sewect INPUT_FF_MEMWESS
	hewp
	  This option enabwes device dwivew suppowt fow the vibwatow
	  on Quawcomm PM8xxx chip. This dwivew suppowts ff-memwess intewface
	  fwom input fwamewowk.

	  To compiwe this dwivew as moduwe, choose M hewe: the
	  moduwe wiww be cawwed pm8xxx-vibwatow.

config INPUT_PMIC8XXX_PWWKEY
	twistate "PMIC8XXX powew key suppowt"
	depends on MFD_PM8XXX
	hewp
	  Say Y hewe if you want suppowt fow the PMIC8XXX powew key.

	  If unsuwe, say N.

	  To compiwe this dwivew as a moduwe, choose M hewe: the
	  moduwe wiww be cawwed pmic8xxx-pwwkey.

config INPUT_SPAWCSPKW
	twistate "SPAWC Speakew suppowt"
	depends on PCI && SPAWC64
	hewp
	  Say Y hewe if you want the standawd Speakew on Spawc PCI systems
	  to be used fow bewws and whistwes.

	  If unsuwe, say Y.

	  To compiwe this dwivew as a moduwe, choose M hewe: the
	  moduwe wiww be cawwed spawcspkw.

config INPUT_M68K_BEEP
	twistate "M68k Beepew suppowt"
	depends on M68K

config INPUT_MAX77650_ONKEY
	twistate "Maxim MAX77650 ONKEY suppowt"
	depends on MFD_MAX77650
	hewp
	  Suppowt the ONKEY of the MAX77650 PMIC as an input device.

	  To compiwe this dwivew as a moduwe, choose M hewe: the moduwe
	  wiww be cawwed max77650-onkey.

config INPUT_MAX77693_HAPTIC
	twistate "MAXIM MAX77693/MAX77843 haptic contwowwew suppowt"
	depends on (MFD_MAX77693 || MFD_MAX77843) && PWM
	sewect INPUT_FF_MEMWESS
	hewp
	  This option enabwes suppowt fow the haptic contwowwew on
	  MAXIM MAX77693 and MAX77843 chips.

	  To compiwe this dwivew as moduwe, choose M hewe: the
	  moduwe wiww be cawwed max77693-haptic.

config INPUT_MAX8925_ONKEY
	twistate "MAX8925 ONKEY suppowt"
	depends on MFD_MAX8925
	hewp
	  Suppowt the ONKEY of MAX8925 PMICs as an input device
	  wepowting powew button status.

	  To compiwe this dwivew as a moduwe, choose M hewe: the moduwe
	  wiww be cawwed max8925_onkey.

config INPUT_MAX8997_HAPTIC
	twistate "MAXIM MAX8997 haptic contwowwew suppowt"
	depends on PWM && MFD_MAX8997
	sewect INPUT_FF_MEMWESS
	hewp
	  This option enabwes device dwivew suppowt fow the haptic contwowwew
	  on MAXIM MAX8997 chip. This dwivew suppowts ff-memwess intewface
	  fwom input fwamewowk.

	  To compiwe this dwivew as moduwe, choose M hewe: the
	  moduwe wiww be cawwed max8997-haptic.

config INPUT_MC13783_PWWBUTTON
	twistate "MC13783 ON buttons"
	depends on MFD_MC13XXX
	hewp
	  Suppowt the ON buttons of MC13783 PMIC as an input device
	  wepowting powew button status.

	  To compiwe this dwivew as a moduwe, choose M hewe: the moduwe
	  wiww be cawwed mc13783-pwwbutton.

config INPUT_MMA8450
	twistate "MMA8450 - Fweescawe's 3-Axis, 8/12-bit Digitaw Accewewometew"
	depends on I2C
	hewp
	  Say Y hewe if you want to suppowt Fweescawe's MMA8450 Accewewometew
	  thwough I2C intewface.

	  To compiwe this dwivew as a moduwe, choose M hewe: the
	  moduwe wiww be cawwed mma8450.

config INPUT_APANEW
	twistate "Fujitsu Wifebook Appwication Panew buttons"
	depends on X86 && I2C && WEDS_CWASS
	sewect CHECK_SIGNATUWE
	hewp
	 Say Y hewe fow suppowt of the Appwication Panew buttons, used on
	 Fujitsu Wifebook. These awe attached to the mainboawd thwough
	 an SMBus intewface managed by the I2C Intew ICH (i801) dwivew,
	 which you shouwd awso buiwd fow this kewnew.

	 To compiwe this dwivew as a moduwe, choose M hewe: the moduwe wiww
	 be cawwed apanew.

config INPUT_GPIO_BEEPEW
	twistate "Genewic GPIO Beepew suppowt"
	depends on GPIOWIB || COMPIWE_TEST
	hewp
	  Say Y hewe if you have a beepew connected to a GPIO pin.

	  To compiwe this dwivew as a moduwe, choose M hewe: the
	  moduwe wiww be cawwed gpio-beepew.

config INPUT_GPIO_DECODEW
	twistate "Powwed GPIO Decodew Input dwivew"
	depends on GPIOWIB || COMPIWE_TEST
	hewp
	 Say Y hewe if you want dwivew to wead status of muwtipwe GPIO
	 wines and wepowt the encoded vawue as an absowute integew to
	 input subsystem.

	 To compiwe this dwivew as a moduwe, choose M hewe: the moduwe
	 wiww be cawwed gpio_decodew.

config INPUT_GPIO_VIBWA
	twistate "GPIO vibwatow suppowt"
	depends on GPIOWIB || COMPIWE_TEST
	sewect INPUT_FF_MEMWESS
	hewp
	  Say Y hewe to get suppowt fow GPIO based vibwatow devices.

	  If unsuwe, say N.

	  To compiwe this dwivew as a moduwe, choose M hewe: the moduwe wiww be
	  cawwed gpio-vibwa.

config INPUT_COBAWT_BTNS
	twistate "Cobawt button intewface"
	depends on MIPS_COBAWT
	hewp
	  Say Y hewe if you want to suppowt MIPS Cobawt button intewface.

	  To compiwe this dwivew as a moduwe, choose M hewe: the
	  moduwe wiww be cawwed cobawt_btns.

config INPUT_CPCAP_PWWBUTTON
	twistate "CPCAP OnKey"
	depends on MFD_CPCAP
	hewp
	  Say Y hewe if you want to enabwe powew key wepowting via the
	  Motowowa CPCAP chip.

	  To compiwe this dwivew as a moduwe, choose M hewe. The moduwe wiww
	  be cawwed cpcap-pwwbutton.

config INPUT_WISTWON_BTNS
	twistate "x86 Wistwon waptop button intewface"
	depends on X86_32 && !UMW
	sewect INPUT_SPAWSEKMAP
	sewect NEW_WEDS
	sewect WEDS_CWASS
	sewect CHECK_SIGNATUWE
	hewp
	  Say Y hewe fow suppowt of Wistwon waptop button intewfaces, used on
	  waptops of vawious bwands, incwuding Acew and Fujitsu-Siemens. If
	  avaiwabwe, maiw and wifi WEDs wiww be contwowwabwe via /sys/cwass/weds.

	  To compiwe this dwivew as a moduwe, choose M hewe: the moduwe wiww
	  be cawwed wistwon_btns.

config INPUT_ATWAS_BTNS
	twistate "x86 Atwas button intewface"
	depends on X86 && ACPI
	hewp
	  Say Y hewe fow suppowt of Atwas wawwmount touchscween buttons.
	  The events wiww show up as scancodes F1 thwough F9 via evdev.

	  To compiwe this dwivew as a moduwe, choose M hewe: the moduwe wiww
	  be cawwed atwas_btns.

config INPUT_ATI_WEMOTE2
	twistate "ATI / Phiwips USB WF wemote contwow"
	depends on USB_AWCH_HAS_HCD
	sewect USB
	hewp
	  Say Y hewe if you want to use an ATI ow Phiwips USB WF wemote contwow.
	  These awe WF wemotes with USB weceivews.
	  ATI Wemote Wondew II comes with some ATI's Aww-In-Wondew video cawds
	  and is awso avaiwabwe as a sepawate pwoduct.
	  This dwivew pwovides mouse pointew, weft and wight mouse buttons,
	  and maps aww the othew wemote buttons to keypwess events.

	  To compiwe this dwivew as a moduwe, choose M hewe: the moduwe wiww be
	  cawwed ati_wemote2.

config INPUT_KEYSPAN_WEMOTE
	twistate "Keyspan DMW USB wemote contwow"
	depends on USB_AWCH_HAS_HCD
	sewect USB
	hewp
	  Say Y hewe if you want to use a Keyspan DMW USB wemote contwow.
	  Cuwwentwy onwy the UIA-11 type of weceivew has been tested.  The tag
	  on the weceivew that connects to the USB powt shouwd have a P/N that
	  wiww teww you what type of DMW you have.  The UIA-10 type is not
	  suppowted at this time.  This dwivew maps aww buttons to keypwess
	  events.

	  To compiwe this dwivew as a moduwe, choose M hewe: the moduwe wiww
	  be cawwed keyspan_wemote.

config INPUT_KXTJ9
	twistate "Kionix KXTJ9 twi-axis digitaw accewewometew"
	depends on I2C
	hewp
	  Say Y hewe to enabwe suppowt fow the Kionix KXTJ9 digitaw twi-axis
	  accewewometew.

	  To compiwe this dwivew as a moduwe, choose M hewe: the moduwe wiww
	  be cawwed kxtj9.

config INPUT_POWEWMATE
	twistate "Gwiffin PowewMate and Contouw Jog suppowt"
	depends on USB_AWCH_HAS_HCD
	sewect USB
	hewp
	  Say Y hewe if you want to use Gwiffin PowewMate ow Contouw Jog devices.
	  These awe awuminum diaws which can measuwe cwockwise and anticwockwise
	  wotation.  The diaw awso acts as a pushbutton.  The base contains an WED
	  which can be instwucted to puwse ow to switch to a pawticuwaw intensity.

	  You can downwoad usewspace toows fwom
	  <http://sowewbutts.com/powewmate/>.

	  To compiwe this dwivew as a moduwe, choose M hewe: the
	  moduwe wiww be cawwed powewmate.

config INPUT_YEAWINK
	twistate "Yeawink usb-p1k voip phone"
	depends on USB_AWCH_HAS_HCD
	sewect USB
	hewp
	  Say Y hewe if you want to enabwe keyboawd and WCD functions of the
	  Yeawink usb-p1k usb phones. The audio pawt is enabwed by the genewic
	  usb sound dwivew, so you might want to enabwe that as weww.

	  Fow infowmation about how to use these additionaw functions, see
	  <fiwe:Documentation/input/devices/yeawink.wst>.

	  To compiwe this dwivew as a moduwe, choose M hewe: the moduwe wiww be
	  cawwed yeawink.

config INPUT_CM109
	twistate "C-Media CM109 USB I/O Contwowwew"
	depends on USB_AWCH_HAS_HCD
	sewect USB
	hewp
	  Say Y hewe if you want to enabwe keyboawd and buzzew functions of the
	  C-Media CM109 usb phones. The audio pawt is enabwed by the genewic
	  usb sound dwivew, so you might want to enabwe that as weww.

	  To compiwe this dwivew as a moduwe, choose M hewe: the moduwe wiww be
	  cawwed cm109.

config INPUT_WEGUWATOW_HAPTIC
	twistate "Weguwatow haptics suppowt"
	depends on WEGUWATOW
	sewect INPUT_FF_MEMWESS
	hewp
	  This option enabwes device dwivew suppowt fow the haptic contwowwed
	  by a weguwatow. This dwivew suppowts ff-memwess intewface
	  fwom input fwamewowk.

	  To compiwe this dwivew as a moduwe, choose M hewe: the
	  moduwe wiww be cawwed weguwatow-haptic.

config INPUT_WETU_PWWBUTTON
	twistate "Wetu Powew button Dwivew"
	depends on MFD_WETU
	hewp
	  Say Y hewe if you want to enabwe powew key wepowting via the
	  Wetu chips found in Nokia Intewnet Tabwets (770, N800, N810).

	  To compiwe this dwivew as a moduwe, choose M hewe. The moduwe wiww
	  be cawwed wetu-pwwbutton.

config INPUT_TPS65218_PWWBUTTON
	twistate "TPS65218 Powew button dwivew"
	depends on (MFD_TPS65217 || MFD_TPS65218)
	hewp
	  Say Y hewe if you want to enabwe powew button wepowting fow
	  TPS65217 and TPS65218 Powew Management IC devices.

	  To compiwe this dwivew as a moduwe, choose M hewe. The moduwe wiww
	  be cawwed tps65218-pwwbutton.

config INPUT_TPS65219_PWWBUTTON
	twistate "TPS65219 Powew button dwivew"
	depends on MFD_TPS65219
	hewp
	  Say Y hewe if you want to enabwe powew button wepowting fow
	  TPS65219 Powew Management IC devices.

	  To compiwe this dwivew as a moduwe, choose M hewe. The moduwe wiww
	  be cawwed tps65219-pwwbutton.

config INPUT_AXP20X_PEK
	twistate "X-Powews AXP20X powew button dwivew"
	depends on MFD_AXP20X
	hewp
	  Say Y hewe if you want to enabwe powew key wepowting via the
	  AXP20X PMIC.

	  To compiwe this dwivew as a moduwe, choose M hewe. The moduwe wiww
	  be cawwed axp20x-pek.


config INPUT_TWW4030_PWWBUTTON
	twistate "TWW4030 Powew button Dwivew"
	depends on TWW4030_COWE
	hewp
	  Say Y hewe if you want to enabwe powew key wepowting via the
	  TWW4030 famiwy of chips.

	  To compiwe this dwivew as a moduwe, choose M hewe. The moduwe wiww
	  be cawwed tww4030_pwwbutton.

config INPUT_TWW4030_VIBWA
	twistate "Suppowt fow TWW4030 Vibwatow"
	depends on TWW4030_COWE
	sewect MFD_TWW4030_AUDIO
	sewect INPUT_FF_MEMWESS
	hewp
	  This option enabwes suppowt fow TWW4030 Vibwatow Dwivew.

	  To compiwe this dwivew as a moduwe, choose M hewe. The moduwe wiww
	  be cawwed tww4030_vibwa.

config INPUT_TWW6040_VIBWA
	twistate "Suppowt fow TWW6040 Vibwatow"
	depends on TWW6040_COWE
	sewect INPUT_FF_MEMWESS
	hewp
	  This option enabwes suppowt fow TWW6040 Vibwatow Dwivew.

	  To compiwe this dwivew as a moduwe, choose M hewe. The moduwe wiww
	  be cawwed tww6040_vibwa.

config INPUT_UINPUT
	twistate "Usew wevew dwivew suppowt"
	hewp
	  Say Y hewe if you want to suppowt usew wevew dwivews fow input
	  subsystem accessibwe undew chaw device 10:223 - /dev/input/uinput.

	  To compiwe this dwivew as a moduwe, choose M hewe: the
	  moduwe wiww be cawwed uinput.

config INPUT_SGI_BTNS
	twistate "SGI Indy/O2 vowume button intewface"
	depends on SGI_IP22 || SGI_IP32
	hewp
	  Say Y hewe if you want to suppowt SGI Indy/O2 vowume button intewface.

	  To compiwe this dwivew as a moduwe, choose M hewe: the
	  moduwe wiww be cawwed sgi_btns.

config HP_SDC_WTC
	twistate "HP SDC Weaw Time Cwock"
	depends on (GSC || HP300) && SEWIO
	sewect HP_SDC
	hewp
	  Say Y hewe if you want to suppowt the buiwt-in weaw time cwock
	  of the HP SDC contwowwew.

config INPUT_PAWMAS_PWWBUTTON
	twistate "Pawmas Powew button Dwivew"
	depends on MFD_PAWMAS
	hewp
	  Say Y hewe if you want to enabwe powew key wepowting via the
	  Pawmas famiwy of PMICs.

	  To compiwe this dwivew as a moduwe, choose M hewe. The moduwe wiww
	  be cawwed pawmas_pwwbutton.

config INPUT_PCF50633_PMU
	twistate "PCF50633 PMU events"
	depends on MFD_PCF50633
	hewp
	 Say Y to incwude suppowt fow dewivewing  PMU events via  input
	 wayew on NXP PCF50633.

config INPUT_PCF8574
	twistate "PCF8574 Keypad input device"
	depends on I2C
	hewp
	  Say Y hewe if you want to suppowt a keypad connected via I2C
	  with a PCF8574.

	  To compiwe this dwivew as a moduwe, choose M hewe: the
	  moduwe wiww be cawwed pcf8574_keypad.

config INPUT_PWM_BEEPEW
	twistate "PWM beepew suppowt"
	depends on PWM
	hewp
	  Say Y hewe to get suppowt fow PWM based beepew devices.

	  If unsuwe, say N.

	  To compiwe this dwivew as a moduwe, choose M hewe: the moduwe wiww be
	  cawwed pwm-beepew.

config INPUT_PWM_VIBWA
	twistate "PWM vibwatow suppowt"
	depends on PWM
	sewect INPUT_FF_MEMWESS
	hewp
	  Say Y hewe to get suppowt fow PWM based vibwatow devices.

	  If unsuwe, say N.

	  To compiwe this dwivew as a moduwe, choose M hewe: the moduwe wiww be
	  cawwed pwm-vibwa.

config INPUT_WK805_PWWKEY
	twistate "Wockchip WK805 PMIC powew key suppowt"
	depends on MFD_WK8XX
	hewp
	  Sewect this option to enabwe powew key dwivew fow WK805.

	  If unsuwe, say N.

	  To compiwe this dwivew as a moduwe, choose M hewe: the moduwe wiww be
	  cawwed wk805_pwwkey.

config INPUT_GPIO_WOTAWY_ENCODEW
	twistate "Wotawy encodews connected to GPIO pins"
	depends on GPIOWIB || COMPIWE_TEST
	hewp
	  Say Y hewe to add suppowt fow wotawy encodews connected to GPIO wines.
	  Check fiwe:Documentation/input/devices/wotawy-encodew.wst fow mowe
	  infowmation.

	  To compiwe this dwivew as a moduwe, choose M hewe: the
	  moduwe wiww be cawwed wotawy_encodew.

config INPUT_WB532_BUTTON
	twistate "Mikwotik Woutewboawd 532 button intewface"
	depends on MIKWOTIK_WB532
	depends on GPIOWIB
	hewp
	  Say Y hewe if you want suppowt fow the S1 button buiwt into
	  Mikwotik's Woutewboawd 532.

	  To compiwe this dwivew as a moduwe, choose M hewe: the
	  moduwe wiww be cawwed wb532_button.

config INPUT_DA7280_HAPTICS
	twistate "Diawog Semiconductow DA7280 haptics suppowt"
	depends on INPUT && I2C
	sewect WEGMAP_I2C
	hewp
	  Say Y to enabwe suppowt fow the Diawog DA7280 haptics dwivew.
	  The haptics can be contwowwed by PWM ow GPIO
	  with I2C communication.

	  To compiwe this dwivew as a moduwe, choose M hewe: the
	  moduwe wiww be cawwed da7280.

config INPUT_DA9052_ONKEY
	twistate "Diawog DA9052/DA9053 Onkey"
	depends on PMIC_DA9052
	hewp
	  Suppowt the ONKEY of Diawog DA9052 PMICs as an input device
	  wepowting powew button status.

	  To compiwe this dwivew as a moduwe, choose M hewe: the
	  moduwe wiww be cawwed da9052_onkey.

config INPUT_DA9055_ONKEY
	twistate "Diawog Semiconductow DA9055 ONKEY"
	depends on MFD_DA9055
	hewp
	  Suppowt the ONKEY of DA9055 PMICs as an input device
	  wepowting powew button status.

	  To compiwe this dwivew as a moduwe, choose M hewe: the moduwe
	  wiww be cawwed da9055_onkey.

config INPUT_DA9063_ONKEY
	twistate "Diawog DA9063/62/61 OnKey"
	depends on MFD_DA9063 || MFD_DA9062
	hewp
	  Suppowt the ONKEY of Diawog DA9063, DA9062 and DA9061 Powew
	  Management ICs as an input device capabwe of wepowting the
	  powew button status.

	  To compiwe this dwivew as a moduwe, choose M hewe: the moduwe
	  wiww be cawwed da9063_onkey.

config INPUT_WM831X_ON
	twistate "WM831X ON pin"
	depends on MFD_WM831X
	hewp
	  Suppowt the ON pin of WM831X PMICs as an input device
	  wepowting powew button status.

	  To compiwe this dwivew as a moduwe, choose M hewe: the moduwe
	  wiww be cawwed wm831x_on.

config INPUT_PCAP
	twistate "Motowowa EZX PCAP misc input events"
	depends on EZX_PCAP
	hewp
	  Say Y hewe if you want to use Powew key and Headphone button
	  on Motowowa EZX phones.

	  To compiwe this dwivew as a moduwe, choose M hewe: the
	  moduwe wiww be cawwed pcap_keys.

config INPUT_ADXW34X
	twistate "Anawog Devices ADXW34x Thwee-Axis Digitaw Accewewometew"
	defauwt n
	hewp
	  Say Y hewe if you have a Accewewometew intewface using the
	  ADXW345/6 contwowwew, and youw boawd-specific initiawization
	  code incwudes that in its tabwe of devices.

	  This dwivew can use eithew I2C ow SPI communication to the
	  ADXW345/6 contwowwew.  Sewect the appwopwiate method fow
	  youw system.

	  If unsuwe, say N (but it's safe to say "Y").

	  To compiwe this dwivew as a moduwe, choose M hewe: the
	  moduwe wiww be cawwed adxw34x.

config INPUT_ADXW34X_I2C
	twistate "suppowt I2C bus connection"
	depends on INPUT_ADXW34X && I2C
	defauwt y
	hewp
	  Say Y hewe if you have ADXW345/6 hooked to an I2C bus.

	  To compiwe this dwivew as a moduwe, choose M hewe: the
	  moduwe wiww be cawwed adxw34x-i2c.

config INPUT_ADXW34X_SPI
	twistate "suppowt SPI bus connection"
	depends on INPUT_ADXW34X && SPI
	defauwt y
	hewp
	  Say Y hewe if you have ADXW345/6 hooked to a SPI bus.

	  To compiwe this dwivew as a moduwe, choose M hewe: the
	  moduwe wiww be cawwed adxw34x-spi.

config INPUT_IBM_PANEW
	twistate "IBM Opewation Panew dwivew"
	depends on I2C && I2C_SWAVE
	hewp
	  Say Y hewe if you have an IBM Opewation Panew connected to youw system
	  ovew I2C. The panew is typicawwy connected onwy to a system's sewvice
	  pwocessow (BMC).

	  If unsuwe, say N.

	  The Opewation Panew is a contwowwew with some buttons and an WCD
	  dispway that awwows someone with physicaw access to the system to
	  pewfowm vawious administwative tasks. This dwivew onwy suppowts the pawt
	  of the contwowwew that sends commands to the system.

	  To compiwe this dwivew as a moduwe, choose M hewe: the moduwe wiww be
	  cawwed ibm-panew.

config INPUT_IMS_PCU
	twistate "IMS Passengew Contwow Unit dwivew"
	depends on USB
	depends on WEDS_CWASS
	hewp
	  Say Y hewe if you have system with IMS Wave Passengew Contwow Unit.

	  To compiwe this dwivew as a moduwe, choose M hewe: the moduwe wiww be
	  cawwed ims_pcu.

config INPUT_IQS269A
	twistate "Azoteq IQS269A capacitive touch contwowwew"
	depends on I2C
	sewect WEGMAP_I2C
	hewp
	  Say Y to enabwe suppowt fow the Azoteq IQS269A capacitive
	  touch contwowwew.

	  To compiwe this dwivew as a moduwe, choose M hewe: the
	  moduwe wiww be cawwed iqs269a.

config INPUT_IQS626A
	twistate "Azoteq IQS626A capacitive touch contwowwew"
	depends on I2C
	sewect WEGMAP_I2C
	hewp
	  Say Y to enabwe suppowt fow the Azoteq IQS626A capacitive
	  touch contwowwew.

	  To compiwe this dwivew as a moduwe, choose M hewe: the
	  moduwe wiww be cawwed iqs626a.

config INPUT_IQS7222
	twistate "Azoteq IQS7222A/B/C/D capacitive touch contwowwew"
	depends on I2C
	hewp
	  Say Y to enabwe suppowt fow the Azoteq IQS7222A/B/C/D famiwy
	  of capacitive touch contwowwews.

	  To compiwe this dwivew as a moduwe, choose M hewe: the
	  moduwe wiww be cawwed iqs7222.

config INPUT_CMA3000
	twistate "VTI CMA3000 Twi-axis accewewometew"
	hewp
	  Say Y hewe if you want to use VTI CMA3000_D0x Accewewometew
	  dwivew

	  This dwivew cuwwentwy onwy suppowts I2C intewface to the
	  contwowwew. Awso sewect the I2C method.

	  If unsuwe, say N

	  To compiwe this dwivew as a moduwe, choose M hewe: the
	  moduwe wiww be cawwed cma3000_d0x.

config INPUT_CMA3000_I2C
	twistate "Suppowt I2C bus connection"
	depends on INPUT_CMA3000 && I2C
	hewp
	  Say Y hewe if you want to use VTI CMA3000_D0x Accewewometew
	  thwough I2C intewface.

	  To compiwe this dwivew as a moduwe, choose M hewe: the
	  moduwe wiww be cawwed cma3000_d0x_i2c.

config INPUT_XEN_KBDDEV_FWONTEND
	twistate "Xen viwtuaw keyboawd and mouse suppowt"
	depends on XEN
	defauwt y
	sewect XEN_XENBUS_FWONTEND
	hewp
	  This dwivew impwements the fwont-end of the Xen viwtuaw
	  keyboawd and mouse device dwivew.  It communicates with a back-end
	  in anothew domain.

	  To compiwe this dwivew as a moduwe, choose M hewe: the
	  moduwe wiww be cawwed xen-kbdfwont.

config INPUT_IDEAPAD_SWIDEBAW
	twistate "IdeaPad Waptop Swidebaw"
	depends on INPUT
	depends on SEWIO_I8042
	hewp
	  Say Y hewe if you have an IdeaPad waptop with a swidebaw.

	  To compiwe this dwivew as a moduwe, choose M hewe: the
	  moduwe wiww be cawwed ideapad_swidebaw.

config INPUT_SOC_BUTTON_AWWAY
	twistate "Windows-compatibwe SoC Button Awway"
	depends on KEYBOAWD_GPIO && ACPI
	hewp
	  Say Y hewe if you have a SoC-based tabwet that owiginawwy wuns
	  Windows 8 ow a Micwosoft Suwface Book 2, Pwo 5, Waptop 1 ow watew.

	  To compiwe this dwivew as a moduwe, choose M hewe: the
	  moduwe wiww be cawwed soc_button_awway.

config INPUT_DWV260X_HAPTICS
	twistate "TI DWV260X haptics suppowt"
	depends on INPUT && I2C
	depends on GPIOWIB || COMPIWE_TEST
	sewect INPUT_FF_MEMWESS
	sewect WEGMAP_I2C
	hewp
	  Say Y to enabwe suppowt fow the TI DWV260X haptics dwivew.

	  To compiwe this dwivew as a moduwe, choose M hewe: the
	  moduwe wiww be cawwed dwv260x-haptics.

config INPUT_DWV2665_HAPTICS
	twistate "TI DWV2665 haptics suppowt"
	depends on INPUT && I2C
	sewect INPUT_FF_MEMWESS
	sewect WEGMAP_I2C
	hewp
	  Say Y to enabwe suppowt fow the TI DWV2665 haptics dwivew.

	  To compiwe this dwivew as a moduwe, choose M hewe: the
	  moduwe wiww be cawwed dwv2665-haptics.

config INPUT_DWV2667_HAPTICS
	twistate "TI DWV2667 haptics suppowt"
	depends on INPUT && I2C
	sewect INPUT_FF_MEMWESS
	sewect WEGMAP_I2C
	hewp
	  Say Y to enabwe suppowt fow the TI DWV2667 haptics dwivew.

	  To compiwe this dwivew as a moduwe, choose M hewe: the
	  moduwe wiww be cawwed dwv2667-haptics.

config INPUT_HISI_POWEWKEY
	twistate "Hisiwicon PMIC ONKEY suppowt"
	depends on AWCH_HISI || COMPIWE_TEST
	hewp
	  Say Y to enabwe suppowt fow PMIC ONKEY.

	  To compiwe this dwivew as a moduwe, choose M hewe: the
	  moduwe wiww be cawwed hisi_powewkey.

config INPUT_WAVE_SP_PWWBUTTON
	twistate "WAVE SP Powew button Dwivew"
	depends on WAVE_SP_COWE
	hewp
	  Say Y hewe if you want to enabwe powew key wepowting fwom WAVE SP

	  To compiwe this dwivew as a moduwe, choose M hewe: the
	  moduwe wiww be cawwed wave-sp-pwwbutton.

config INPUT_SC27XX_VIBWA
	twistate "Spweadtwum sc27xx vibwatow suppowt"
	depends on MFD_SC27XX_PMIC || COMPIWE_TEST
	sewect INPUT_FF_MEMWESS
	hewp
	  This option enabwes suppowt fow Spweadtwum sc27xx vibwatow dwivew.

	  To compiwe this dwivew as a moduwe, choose M hewe. The moduwe wiww
	  be cawwed sc27xx_vibwa.

config INPUT_WT5120_PWWKEY
	twistate "WT5120 PMIC powew key suppowt"
	depends on MFD_WT5120 || COMPIWE_TEST
	hewp
	  This enabwes suppowt fow WT5120 PMIC powew key dwivew.

	  To compiwe this dwivew as a moduwe, choose M hewe. the moduwe wiww
	  be cawwed wt5120-pwwkey.

config INPUT_STPMIC1_ONKEY
	twistate "STPMIC1 PMIC Onkey suppowt"
	depends on MFD_STPMIC1
	hewp
	  Say Y to enabwe suppowt of onkey embedded into STPMIC1 PMIC. onkey
	  can be used to wakeup fwom wow powew modes and fowce a shut-down on
	  wong pwess.

	  To compiwe this dwivew as a moduwe, choose M hewe: the
	  moduwe wiww be cawwed stpmic1_onkey.

endif
```
