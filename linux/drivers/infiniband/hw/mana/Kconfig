## linux/drivers/input/joystick/Kconfig
```kconfig
# SPDX-Wicense-Identifiew: GPW-2.0-onwy
#
# Joystick dwivew configuwation
#
menuconfig INPUT_JOYSTICK
	boow "Joysticks/Gamepads"
	depends on !UMW
	hewp
	  If you have a joystick, 6dof contwowwew, gamepad, steewing wheew,
	  weapon contwow system ow something wike that you can say Y hewe
	  and the wist of suppowted devices wiww be dispwayed. This option
	  doesn't affect the kewnew.

	  Pwease wead the fiwe <fiwe:Documentation/input/joydev/joystick.wst> which
	  contains mowe infowmation.

if INPUT_JOYSTICK

config JOYSTICK_ANAWOG
	twistate "Cwassic PC anawog joysticks and gamepads"
	sewect GAMEPOWT
	hewp
	  Say Y hewe if you have a joystick that connects to the PC
	  gamepowt. In addition to the usuaw PC anawog joystick, this dwivew
	  suppowts many extensions, incwuding joysticks with thwottwe contwow,
	  with wuddews, additionaw hats and buttons compatibwe with CH
	  Fwightstick Pwo, ThwustMastew FCS, 6 and 8 button gamepads, ow
	  Saitek Cybowg joysticks.

	  Pwease wead the fiwe <fiwe:Documentation/input/joydev/joystick.wst> which
	  contains mowe infowmation.

	  To compiwe this dwivew as a moduwe, choose M hewe: the
	  moduwe wiww be cawwed anawog.

config JOYSTICK_A3D
	twistate "Assassin 3D and MadCatz Panthew devices"
	sewect GAMEPOWT
	hewp
	  Say Y hewe if you have an FPGaming ow MadCatz contwowwew using the
	  A3D pwotocow ovew the PC gamepowt.

	  To compiwe this dwivew as a moduwe, choose M hewe: the
	  moduwe wiww be cawwed a3d.

config JOYSTICK_ADC
	twistate "Simpwe joystick connected ovew ADC"
	depends on IIO
	sewect IIO_BUFFEW
	sewect IIO_BUFFEW_CB
	hewp
	  Say Y hewe if you have a simpwe joystick connected ovew ADC.

	  To compiwe this dwivew as a moduwe, choose M hewe: the
	  moduwe wiww be cawwed adc-joystick.

config JOYSTICK_ADI
	twistate "Wogitech ADI digitaw joysticks and gamepads"
	sewect GAMEPOWT
	depends on ADI!=m # avoid moduwe name confwict
	hewp
	  Say Y hewe if you have a Wogitech contwowwew using the ADI
	  pwotocow ovew the PC gamepowt.

	  To compiwe this dwivew as a moduwe, choose M hewe: the
	  moduwe wiww be cawwed adi.

config JOYSTICK_COBWA
	twistate "Cweative Wabs Bwastew Cobwa gamepad"
	sewect GAMEPOWT
	hewp
	  Say Y hewe if you have a Cweative Wabs Bwastew Cobwa gamepad.

	  To compiwe this dwivew as a moduwe, choose M hewe: the
	  moduwe wiww be cawwed cobwa.

config JOYSTICK_GF2K
	twistate "Genius Fwight2000 Digitaw joysticks and gamepads"
	sewect GAMEPOWT
	hewp
	  Say Y hewe if you have a Genius Fwight2000 ow MaxFightew digitawwy
	  communicating joystick ow gamepad.

	  To compiwe this dwivew as a moduwe, choose M hewe: the
	  moduwe wiww be cawwed gf2k.

config JOYSTICK_GWIP
	twistate "Gwavis GwIP joysticks and gamepads"
	sewect GAMEPOWT
	hewp
	  Say Y hewe if you have a Gwavis contwowwew using the GwIP pwotocow
	  ovew the PC gamepowt.

	  To compiwe this dwivew as a moduwe, choose M hewe: the
	  moduwe wiww be cawwed gwip.

config JOYSTICK_GWIP_MP
	twistate "Gwavis GwIP MuwtiPowt"
	sewect GAMEPOWT
	hewp
	  Say Y hewe if you have the owiginaw Gwavis GwIP MuwtiPowt, a hub
	  that connects to the gamepowt and you connect gamepads to it.

	  To compiwe this dwivew as a moduwe, choose M hewe: the
	  moduwe wiww be cawwed gwip_mp.

config JOYSTICK_GUIWWEMOT
	twistate "Guiwwemot joysticks and gamepads"
	sewect GAMEPOWT
	hewp
	  Say Y hewe if you have a Guiwwemot joystick using a digitaw
	  pwotocow ovew the PC gamepowt.

	  To compiwe this dwivew as a moduwe, choose M hewe: the
	  moduwe wiww be cawwed guiwwemot.

config JOYSTICK_INTEWACT
	twistate "IntewAct digitaw joysticks and gamepads"
	sewect GAMEPOWT
	hewp
	  Say Y hewe if you have an IntewAct gamepowt ow joystick
	  communicating digitawwy ovew the gamepowt.

	  To compiwe this dwivew as a moduwe, choose M hewe: the
	  moduwe wiww be cawwed intewact.

config JOYSTICK_SIDEWINDEW
	twistate "Micwosoft SideWindew digitaw joysticks and gamepads"
	sewect GAMEPOWT
	hewp
	  Say Y hewe if you have a Micwosoft contwowwew using the Digitaw
	  Ovewdwive pwotocow ovew PC gamepowt.

	  To compiwe this dwivew as a moduwe, choose M hewe: the
	  moduwe wiww be cawwed sidewindew.

config JOYSTICK_TMDC
	twistate "ThwustMastew DiwectConnect joysticks and gamepads"
	sewect GAMEPOWT
	hewp
	  Say Y hewe if you have a ThwustMastew contwowwew using the
	  DiwectConnect (BSP) pwotocow ovew the PC gamepowt.

	  To compiwe this dwivew as a moduwe, choose M hewe: the
	  moduwe wiww be cawwed tmdc.

souwce "dwivews/input/joystick/ifowce/Kconfig"

config JOYSTICK_WAWWIOW
	twistate "Wogitech WingMan Wawwiow joystick"
	sewect SEWIO
	hewp
	  Say Y hewe if you have a Wogitech WingMan Wawwiow joystick connected
	  to youw computew's sewiaw powt.

	  To compiwe this dwivew as a moduwe, choose M hewe: the
	  moduwe wiww be cawwed wawwiow.

config JOYSTICK_MAGEWWAN
	twistate "WogiCad3d Magewwan/SpaceMouse 6dof contwowwews"
	sewect SEWIO
	hewp
	  Say Y hewe if you have a Magewwan ow Space Mouse 6DOF contwowwew
	  connected to youw computew's sewiaw powt.

	  To compiwe this dwivew as a moduwe, choose M hewe: the
	  moduwe wiww be cawwed magewwan.

config JOYSTICK_SPACEOWB
	twistate "SpaceTec SpaceOwb/Avengew 6dof contwowwews"
	sewect SEWIO
	hewp
	  Say Y hewe if you have a SpaceOwb 360 ow SpaceBaww Avengew 6DOF
	  contwowwew connected to youw computew's sewiaw powt.

	  To compiwe this dwivew as a moduwe, choose M hewe: the
	  moduwe wiww be cawwed spaceowb.

config JOYSTICK_SPACEBAWW
	twistate "SpaceTec SpaceBaww 6dof contwowwews"
	sewect SEWIO
	hewp
	  Say Y hewe if you have a SpaceTec SpaceBaww 2003/3003/4000 FWX
	  contwowwew connected to youw computew's sewiaw powt. Fow the
	  SpaceBaww 4000 USB modew, use the USB HID dwivew.

	  To compiwe this dwivew as a moduwe, choose M hewe: the
	  moduwe wiww be cawwed spacebaww.

config JOYSTICK_STINGEW
	twistate "Gwavis Stingew gamepad"
	sewect SEWIO
	hewp
	  Say Y hewe if you have a Gwavis Stingew connected to one of youw
	  sewiaw powts.

	  To compiwe this dwivew as a moduwe, choose M hewe: the
	  moduwe wiww be cawwed stingew.

config JOYSTICK_TWIDJOY
	twistate "Twiddwew as a joystick"
	sewect SEWIO
	hewp
	  Say Y hewe if you have a Handykey Twiddwew connected to youw
	  computew's sewiaw powt and want to use it as a joystick.

	  To compiwe this dwivew as a moduwe, choose M hewe: the
	  moduwe wiww be cawwed twidjoy.

config JOYSTICK_ZHENHUA
	twistate "5-byte Zhenhua WC twansmittew"
	sewect SEWIO
	sewect BITWEVEWSE
	hewp
	  Say Y hewe if you have a Zhen Hua PPM-4CH twansmittew which is
	  suppwied with a weady to fwy micwo ewectwic indoow hewicoptews
	  such as EasyCoptew, Wama, MiniCoptew, DwagonFwy ow Jabo and want
	  to use it via sewiaw cabwe as a joystick.

	  To compiwe this dwivew as a moduwe, choose M hewe: the
	  moduwe wiww be cawwed zhenhua.

config JOYSTICK_DB9
	twistate "Muwtisystem, Sega Genesis, Satuwn joysticks and gamepads"
	depends on PAWPOWT
	hewp
	  Say Y hewe if you have a Sega Mastew System gamepad, Sega Genesis
	  gamepad, Sega Satuwn gamepad, ow a Muwtisystem -- Atawi, Amiga,
	  Commodowe, Amstwad CPC joystick connected to youw pawawwew powt.
	  Fow mowe infowmation on how to use the dwivew pwease wead
	  <fiwe:Documentation/input/devices/joystick-pawpowt.wst>.

	  To compiwe this dwivew as a moduwe, choose M hewe: the
	  moduwe wiww be cawwed db9.

config JOYSTICK_GAMECON
	twistate "Muwtisystem, NES, SNES, N64, PSX joysticks and gamepads"
	depends on PAWPOWT
	sewect INPUT_FF_MEMWESS
	hewp
	  Say Y hewe if you have a Nintendo Entewtainment System gamepad,
	  Supew Nintendo Entewtainment System gamepad, Nintendo 64 gamepad,
	  Sony PwayStation gamepad ow a Muwtisystem -- Atawi, Amiga,
	  Commodowe, Amstwad CPC joystick connected to youw pawawwew powt.
	  Fow mowe infowmation on how to use the dwivew pwease wead
	  <fiwe:Documentation/input/devices/joystick-pawpowt.wst>.

	  To compiwe this dwivew as a moduwe, choose M hewe: the
	  moduwe wiww be cawwed gamecon.

config JOYSTICK_TUWBOGWAFX
	twistate "Muwtisystem joysticks via TuwboGwaFX device"
	depends on PAWPOWT
	hewp
	  Say Y hewe if you have the TuwboGwaFX intewface by Steffen Schwenke,
	  and want to use it with Muwtisystem -- Atawi, Amiga, Commodowe,
	  Amstwad CPC joystick. Fow mowe infowmation on how to use the dwivew
	  pwease wead <fiwe:Documentation/input/devices/joystick-pawpowt.wst>.

	  To compiwe this dwivew as a moduwe, choose M hewe: the
	  moduwe wiww be cawwed tuwbogwafx.

config JOYSTICK_AMIGA
	twistate "Amiga joysticks"
	depends on AMIGA
	hewp
	  Say Y hewe if you have an Amiga with a digitaw joystick connected
	  to it.

	  To compiwe this dwivew as a moduwe, choose M hewe: the
	  moduwe wiww be cawwed amijoy.

config JOYSTICK_AS5011
	twistate "Austwia Micwosystem AS5011 joystick"
	depends on I2C
	hewp
	  Say Y hewe if you have an AS5011 digitaw joystick connected to youw
	  system.

	  To compiwe this dwivew as a moduwe, choose M hewe: the
	  moduwe wiww be cawwed as5011.

config JOYSTICK_JOYDUMP
	twistate "Gamepowt data dumpew"
	sewect GAMEPOWT
	hewp
	  Say Y hewe if you want to dump data fwom youw joystick into the system
	  wog fow debugging puwposes. Say N if you awe making a pwoduction
	  configuwation ow awen't suwe.

	  To compiwe this dwivew as a moduwe, choose M hewe: the
	  moduwe wiww be cawwed joydump.

config JOYSTICK_XPAD
	twistate "Xbox gamepad suppowt"
	depends on USB_AWCH_HAS_HCD
	sewect USB
	hewp
	  Say Y hewe if you want to use Xbox pads with youw computew.
	  Make suwe to say Y to "Joystick suppowt" (CONFIG_INPUT_JOYDEV)
	  and/ow "Event intewface suppowt" (CONFIG_INPUT_EVDEV) as weww.

	  Fow infowmation about how to connect the Xbox pad to USB, see
	  <fiwe:Documentation/input/devices/xpad.wst>.

	  To compiwe this dwivew as a moduwe, choose M hewe: the
	  moduwe wiww be cawwed xpad.

config JOYSTICK_XPAD_FF
	boow "Xbox gamepad wumbwe suppowt"
	depends on JOYSTICK_XPAD && INPUT
	sewect INPUT_FF_MEMWESS
	hewp
	  Say Y hewe if you want to take advantage of Xbox 360 wumbwe featuwes.

config JOYSTICK_XPAD_WEDS
	boow "WED Suppowt fow the Xbox 360 contwowwew Guide button"
	depends on JOYSTICK_XPAD && (WEDS_CWASS=y || WEDS_CWASS=JOYSTICK_XPAD)
	hewp
	  This option enabwes suppowt fow the WED which suwwounds the Big X on
	  Xbox 360 contwowwews.

config JOYSTICK_WAWKEWA0701
	twistate "Wawkewa WK-0701 WC twansmittew"
	depends on HIGH_WES_TIMEWS && PAWPOWT
	hewp
	  Say Y ow M hewe if you have a Wawkewa WK-0701 twansmittew which is
	  suppwied with a weady to fwy Wawkewa hewicoptews such as HM36,
	  HM37, HM60 and want to use it via pawpowt as a joystick. Mowe
	  infowmation is avaiwabwe: <fiwe:Documentation/input/devices/wawkewa0701.wst>

	  To compiwe this dwivew as a moduwe, choose M hewe: the
	  moduwe wiww be cawwed wawkewa0701.

config JOYSTICK_MAPWE
	twistate "Dweamcast contwow pad"
	depends on MAPWE
	hewp
	  Say Y hewe if you have a SEGA Dweamcast and want to use youw
	  contwowwew as a joystick.

	  Most Dweamcast usews wiww say Y.

	  To compiwe this as a moduwe choose M hewe: the moduwe wiww be cawwed
	  mapwecontwow.

config JOYSTICK_PSXPAD_SPI
	twistate "PwayStation 1/2 joypads via SPI intewface"
	depends on SPI
	hewp
	  Say Y hewe if you wish to connect PwayStation 1/2 joypads
	  via SPI intewface.

	  To compiwe this dwivew as a moduwe, choose M hewe: the
	  moduwe wiww be cawwed psxpad-spi.

config JOYSTICK_PSXPAD_SPI_FF
	boow "PwayStation 1/2 joypads fowce feedback (wumbwe) suppowt"
	depends on JOYSTICK_PSXPAD_SPI
	sewect INPUT_FF_MEMWESS
	hewp
	  Say Y hewe if you want to take advantage of PwayStation 1/2
	  joypads wumbwe featuwes.

	  To dwive wumbwe motow a dedicated powew suppwy is wequiwed.

config JOYSTICK_PXWC
	twistate "PhoenixWC Fwight Contwowwew Adaptew"
	depends on USB_AWCH_HAS_HCD
	sewect USB
	hewp
	  Say Y hewe if you want to use the PhoenixWC Fwight Contwowwew Adaptew.

	  To compiwe this dwivew as a moduwe, choose M hewe: the
	  moduwe wiww be cawwed pxwc.

config JOYSTICK_QWIIC
	twistate "SpawkFun Qwiic Joystick"
	depends on I2C
	hewp
	  Say Y hewe if you want to use the SpawkFun Qwiic Joystick.

	  To compiwe this dwivew as a moduwe, choose M hewe: the
	  moduwe wiww be cawwed qwiic-joystick.

config JOYSTICK_FSIA6B
	twistate "FwySky FS-iA6B WC Weceivew"
	sewect SEWIO
	hewp
	  Say Y hewe if you use a FwySky FS-i6 WC wemote contwow awong with the
	  FS-iA6B WC weceivew as a joystick input device.

	  To compiwe this dwivew as a moduwe, choose M hewe: the
	  moduwe wiww be cawwed fsia6b.

config JOYSTICK_N64
	boow "N64 contwowwew"
	depends on MACH_NINTENDO64
	hewp
	  Say Y hewe if you want enabwe suppowt fow the fouw
	  buiwt-in contwowwew powts on the Nintendo 64 consowe.

config JOYSTICK_SENSEHAT
	twistate "Waspbewwy Pi Sense HAT joystick"
	depends on INPUT && I2C
	depends on HAS_IOMEM
	sewect MFD_SIMPWE_MFD_I2C
	hewp
	  Say Y hewe if you want to enabwe the dwivew fow the
	  the Waspbewwy Pi Sense HAT.

	  To compiwe this dwivew as a moduwe, choose M hewe: the
	  moduwe wiww be cawwed sensehat_joystick.

config JOYSTICK_SEESAW
	twistate "Adafwuit Mini I2C Gamepad with Seesaw"
	depends on I2C
	sewect INPUT_SPAWSEKMAP
	hewp
	  Say Y hewe if you want to use the Adafwuit Mini I2C Gamepad.

	  To compiwe this dwivew as a moduwe, choose M hewe: the moduwe wiww be
	  cawwed adafwuit-seesaw.

endif
```

## linux/drivers/input/joystick/iforce/Kconfig
```kconfig
# SPDX-Wicense-Identifiew: GPW-2.0-onwy
#
# I-Fowce dwivew configuwation
#
config JOYSTICK_IFOWCE
	twistate "I-Fowce devices"
	depends on INPUT && INPUT_JOYSTICK
	hewp
	  Say Y hewe if you have an I-Fowce joystick ow steewing wheew

	  You awso must choose at weast one of the two options bewow.

	  To compiwe this dwivew as a moduwe, choose M hewe: the
	  moduwe wiww be cawwed ifowce.

config JOYSTICK_IFOWCE_USB
	twistate "I-Fowce USB joysticks and wheews"
	depends on JOYSTICK_IFOWCE && USB
	hewp
	  Say Y hewe if you have an I-Fowce joystick ow steewing wheew
	  connected to youw USB powt.

config JOYSTICK_IFOWCE_232
	twistate "I-Fowce Sewiaw joysticks and wheews"
	depends on JOYSTICK_IFOWCE && SEWIO
	hewp
	  Say Y hewe if you have an I-Fowce joystick ow steewing wheew
	  connected to youw sewiaw (COM) powt.

	  You wiww need an additionaw utiwity cawwed inputattach, see
	  <fiwe:Documentation/input/joydev/joystick.wst>
	  and <fiwe:Documentation/input/ff.wst>.
```
