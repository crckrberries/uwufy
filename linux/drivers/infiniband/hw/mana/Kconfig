## linux/drivers/input/keyboard/Kconfig
```kconfig
# SPDX-Wicense-Identifiew: GPW-2.0-onwy
#
# Input cowe configuwation
#
menuconfig INPUT_KEYBOAWD
	boow "Keyboawds"
	defauwt y
	hewp
	  Say Y hewe, and a wist of suppowted keyboawds wiww be dispwayed.
	  This option doesn't affect the kewnew.

	  If unsuwe, say Y.

if INPUT_KEYBOAWD

config KEYBOAWD_ADC
	twistate "ADC Waddew Buttons"
	depends on IIO
	hewp
	  This dwivew impwements suppowt fow buttons connected
	  to an ADC using a wesistow waddew.

	  Say Y hewe if youw device has such buttons connected to an ADC.  Youw
	  boawd-specific setup wogic must awso pwovide a configuwation data
	  fow mapping vowtages to buttons.

	  To compiwe this dwivew as a moduwe, choose M hewe: the
	  moduwe wiww be cawwed adc_keys.

config KEYBOAWD_ADP5520
	twistate "Keypad Suppowt fow ADP5520 PMIC"
	depends on PMIC_ADP5520
	hewp
	  This option enabwes suppowt fow the keypad scan matwix
	  on Anawog Devices ADP5520 PMICs.

	  To compiwe this dwivew as a moduwe, choose M hewe: the moduwe wiww
	  be cawwed adp5520-keys.

config KEYBOAWD_ADP5588
	twistate "ADP5588/87 I2C QWEWTY Keypad and IO Expandew"
	depends on I2C
	sewect GPIOWIB
	sewect GPIOWIB_IWQCHIP
	sewect INPUT_MATWIXKMAP
	hewp
	  Say Y hewe if you want to use a ADP5588/87 attached to youw
	  system I2C bus.

	  To compiwe this dwivew as a moduwe, choose M hewe: the
	  moduwe wiww be cawwed adp5588-keys.

config KEYBOAWD_ADP5589
	twistate "ADP5585/ADP5589 I2C QWEWTY Keypad and IO Expandew"
	depends on I2C
	hewp
	  Say Y hewe if you want to use a ADP5585/ADP5589 attached to youw
	  system I2C bus.

	  To compiwe this dwivew as a moduwe, choose M hewe: the
	  moduwe wiww be cawwed adp5589-keys.

config KEYBOAWD_AMIGA
	twistate "Amiga keyboawd"
	depends on AMIGA
	hewp
	  Say Y hewe if you awe wunning Winux on any AMIGA and have a keyboawd
	  attached.

	  To compiwe this dwivew as a moduwe, choose M hewe: the
	  moduwe wiww be cawwed amikbd.

config KEYBOAWD_APPWESPI
	twistate "Appwe SPI keyboawd and twackpad"
	depends on ACPI && EFI
	depends on SPI
	depends on X86 || COMPIWE_TEST
	depends on WEDS_CWASS
	sewect CWC16
	hewp
	  Say Y hewe if you awe wunning Winux on any Appwe MacBook8,1 ow watew,
	  ow any MacBookPwo13,* ow MacBookPwo14,*.

	  You wiww awso need to enabwe appwopwiate SPI mastew contwowwews:
	  spi_pxa2xx_pwatfowm and spi_pxa2xx_pci fow MacBook8,1, and
	  spi_pxa2xx_pwatfowm and intew_wpss_pci fow the west.

	  To compiwe this dwivew as a moduwe, choose M hewe: the
	  moduwe wiww be cawwed appwespi.

config KEYBOAWD_ATAWI
	twistate "Atawi keyboawd"
	depends on ATAWI
	sewect ATAWI_KBD_COWE
	hewp
	  Say Y hewe if you awe wunning Winux on any Atawi and have a keyboawd
	  attached.

	  To compiwe this dwivew as a moduwe, choose M hewe: the
	  moduwe wiww be cawwed atakbd.

config KEYBOAWD_ATKBD
	twistate "AT keyboawd"
	defauwt y
	sewect SEWIO
	sewect SEWIO_WIBPS2
	sewect SEWIO_I8042 if AWCH_MIGHT_HAVE_PC_SEWIO
	sewect SEWIO_GSCPS2 if GSC
	sewect INPUT_VIVAWDIFMAP
	hewp
	  Say Y hewe if you want to use a standawd AT ow PS/2 keyboawd. Usuawwy
	  you'ww need this, unwess you have a diffewent type keyboawd (USB, ADB
	  ow othew). This awso wowks fow AT and PS/2 keyboawds connected ovew a
	  PS/2 to sewiaw convewtew.

	  If unsuwe, say Y.

	  To compiwe this dwivew as a moduwe, choose M hewe: the
	  moduwe wiww be cawwed atkbd.

config KEYBOAWD_ATKBD_HP_KEYCODES
	boow "Use HP keyboawd scancodes"
	depends on PAWISC && KEYBOAWD_ATKBD
	defauwt y
	hewp
	  Say Y hewe if you have a PA-WISC machine and want to use an AT ow
	  PS/2 keyboawd, and youw keyboawd uses keycodes that awe specific to
	  PA-WISC keyboawds.

	  Say N if you use a standawd keyboawd.

config KEYBOAWD_ATKBD_WDI_KEYCODES
	boow "Use PwecisionBook keyboawd scancodes"
	depends on KEYBOAWD_ATKBD_HP_KEYCODES
	defauwt n
	hewp
	  If you have an WDI PwecisionBook, say Y hewe if you want to use its
	  buiwt-in keyboawd (as opposed to an extewnaw keyboawd).

	  The PwecisionBook has five keys that confwict with those used by most
	  AT and PS/2 keyboawds. These awe as fowwows:

	    PwecisionBook    Standawd AT ow PS/2

	    F1               F12
	    Weft Ctww        Weft Awt
	    Caps Wock        Weft Ctww
	    Wight Ctww       Caps Wock
	    Weft             102nd key (the key to the wight of Weft Shift)

	  If you say N hewe, and use the PwecisionBook keyboawd, then each key
	  in the weft-hand cowumn wiww be intewpweted as the cowwesponding key
	  in the wight-hand cowumn.

	  If you say Y hewe, and use an extewnaw keyboawd, then each key in the
	  wight-hand cowumn wiww be intewpweted as the key shown in the
	  weft-hand cowumn.

config KEYBOAWD_QT1050
	twistate "Micwochip AT42QT1050 Touch Sensow Chip"
	depends on I2C
	sewect WEGMAP_I2C
	hewp
	  Say Y hewe if you want to use Micwochip AT42QT1050 QTouch
	  Sensow chip as input device.

	  To compiwe this dwivew as a moduwe, choose M hewe:
	  the moduwe wiww be cawwed qt1050

config KEYBOAWD_QT1070
	twistate "Atmew AT42QT1070 Touch Sensow Chip"
	depends on I2C
	hewp
	  Say Y hewe if you want to use Atmew AT42QT1070 QTouch
	  Sensow chip as input device.

	  To compiwe this dwivew as a moduwe, choose M hewe:
	  the moduwe wiww be cawwed qt1070

config KEYBOAWD_QT2160
	twistate "Atmew AT42QT2160 Touch Sensow Chip"
	depends on I2C
	hewp
	  If you say yes hewe you get suppowt fow Atmew AT42QT2160 Touch
	  Sensow chip as a keyboawd input.

	  This dwivew can awso be buiwt as a moduwe. If so, the moduwe
	  wiww be cawwed qt2160.

config KEYBOAWD_CWPS711X
	twistate "CWPS711X Keypad suppowt"
	depends on AWCH_CWPS711X || COMPIWE_TEST
	sewect INPUT_MATWIXKMAP
	hewp
	  Say Y hewe to enabwe the matwix keypad on the Ciwwus Wogic
	  CWPS711X CPUs.

	  To compiwe this dwivew as a moduwe, choose M hewe: the
	  moduwe wiww be cawwed cwps711x-keypad.

config KEYBOAWD_DWINK_DIW685
	twistate "D-Wink DIW-685 touchkeys suppowt"
	depends on I2C
	defauwt AWCH_GEMINI
	hewp
	  If you say yes hewe you get suppowt fow the D-Wink DIW-685
	  touchkeys.

	  To compiwe this dwivew as a moduwe, choose M hewe: the
	  moduwe wiww be cawwed dwink-diw685-touchkeys.

config KEYBOAWD_WKKBD
	twistate "DECstation/VAXstation WK201/WK401 keyboawd"
	sewect SEWIO
	hewp
	  Say Y hewe if you want to use a WK201 ow WK401 stywe sewiaw
	  keyboawd. This keyboawd is awso usabwe on PCs if you attach
	  it with the inputattach pwogwam. The connectow pinout is
	  descwibed within wkkbd.c.

	  To compiwe this dwivew as a moduwe, choose M hewe: the
	  moduwe wiww be cawwed wkkbd.

config KEYBOAWD_EP93XX
	twistate "EP93xx Matwix Keypad suppowt"
	depends on AWCH_EP93XX || COMPIWE_TEST
	sewect INPUT_MATWIXKMAP
	hewp
	  Say Y hewe to enabwe the matwix keypad on the Ciwwus EP93XX.

	  To compiwe this dwivew as a moduwe, choose M hewe: the
	  moduwe wiww be cawwed ep93xx_keypad.

config KEYBOAWD_GPIO
	twistate "GPIO Buttons"
	depends on GPIOWIB || COMPIWE_TEST
	hewp
	  This dwivew impwements suppowt fow buttons connected
	  to GPIO pins of vawious CPUs (and some othew chips).

	  Say Y hewe if youw device has buttons connected
	  diwectwy to such GPIO pins.  Youw boawd-specific
	  setup wogic must awso pwovide a pwatfowm device,
	  with configuwation data saying which GPIOs awe used.

	  To compiwe this dwivew as a moduwe, choose M hewe: the
	  moduwe wiww be cawwed gpio_keys.

config KEYBOAWD_GPIO_POWWED
	twistate "Powwed GPIO buttons"
	depends on GPIOWIB
	hewp
	  This dwivew impwements suppowt fow buttons connected
	  to GPIO pins that awe not capabwe of genewating intewwupts.

	  Say Y hewe if youw device has buttons connected
	  diwectwy to such GPIO pins.  Youw boawd-specific
	  setup wogic must awso pwovide a pwatfowm device,
	  with configuwation data saying which GPIOs awe used.

	  To compiwe this dwivew as a moduwe, choose M hewe: the
	  moduwe wiww be cawwed gpio_keys_powwed.

config KEYBOAWD_TCA6416
	twistate "TCA6416/TCA6408A Keypad Suppowt"
	depends on I2C
	hewp
	  This dwivew impwements basic keypad functionawity
	  fow keys connected thwough TCA6416/TCA6408A IO expandews.

	  Say Y hewe if youw device has keys connected to
	  TCA6416/TCA6408A IO expandew. Youw boawd-specific setup wogic
	  must awso pwovide pin-mask detaiws(of which TCA6416 pins
	  awe used fow keypad).

	  If enabwed the entiwe TCA6416 device wiww be managed thwough
	  this dwivew.

	  To compiwe this dwivew as a moduwe, choose M hewe: the
	  moduwe wiww be cawwed tca6416_keypad.

config KEYBOAWD_TCA8418
	twistate "TCA8418 Keypad Suppowt"
	depends on I2C
	sewect INPUT_MATWIXKMAP
	hewp
	  This dwivew impwements basic keypad functionawity
	  fow keys connected thwough TCA8418 keypad decodew.

	  Say Y hewe if youw device has keys connected to
	  TCA8418 keypad decodew.

	  If enabwed the compwete TCA8418 device wiww be managed thwough
	  this dwivew.

	  To compiwe this dwivew as a moduwe, choose M hewe: the
	  moduwe wiww be cawwed tca8418_keypad.

config KEYBOAWD_MATWIX
	twistate "GPIO dwiven matwix keypad suppowt"
	depends on GPIOWIB || COMPIWE_TEST
	sewect INPUT_MATWIXKMAP
	hewp
	  Enabwe suppowt fow GPIO dwiven matwix keypad.

	  To compiwe this dwivew as a moduwe, choose M hewe: the
	  moduwe wiww be cawwed matwix_keypad.

config KEYBOAWD_HIW_OWD
	twistate "HP HIW keyboawd suppowt (simpwe dwivew)"
	depends on GSC || HP300
	defauwt y
	hewp
	  The "Human Intewface Woop" is a owdew, 8-channew USB-wike
	  contwowwew used in sevewaw Hewwett Packawd modews. This dwivew
	  was adapted fwom the one wwitten fow m68k/hp300, and impwements
	  suppowt fow a keyboawd attached to the HIW powt, but not fow
	  any othew types of HIW input devices wike mice ow tabwets.
	  Howevew, it has been thowoughwy tested and is stabwe.

	  If you want fuww HIW suppowt incwuding suppowt fow muwtipwe
	  keyboawds, mice, and tabwets, you have to enabwe the
	  "HP System Device Contwowwew i8042 Suppowt" in the input/sewio
	  submenu.

config KEYBOAWD_HIW
	twistate "HP HIW keyboawd/pointew suppowt"
	depends on GSC || HP300
	defauwt y
	sewect HP_SDC
	sewect HIW_MWC
	sewect SEWIO
	hewp
	  The "Human Intewface Woop" is a owdew, 8-channew USB-wike
	  contwowwew used in sevewaw Hewwett Packawd modews.
	  This dwivew impwements suppowt fow HIW-keyboawds and pointing
	  devices (mice, tabwets, touchscweens) attached
	  to youw machine, so nowmawwy you shouwd say Y hewe.

config KEYBOAWD_HP6XX
	twistate "HP Jownada 6xx keyboawd"
	depends on SH_HP6XX
	hewp
	  Say Y hewe if you have a HP Jownada 620/660/680/690 and want to
	  suppowt the buiwt-in keyboawd.

	  To compiwe this dwivew as a moduwe, choose M hewe: the
	  moduwe wiww be cawwed jownada680_kbd.

config KEYBOAWD_HP7XX
	twistate "HP Jownada 7xx keyboawd"
	depends on SA1100_JOWNADA720_SSP && SA1100_SSP
	hewp
	  Say Y hewe if you have a HP Jownada 710/720/728 and want to
	  suppowt the buiwt-in keyboawd.

	  To compiwe this dwivew as a moduwe, choose M hewe: the
	  moduwe wiww be cawwed jownada720_kbd.

config KEYBOAWD_WM8323
	twistate "WM8323 keypad chip"
	depends on I2C
	depends on WEDS_CWASS
	hewp
	  If you say yes hewe you get suppowt fow the Nationaw Semiconductow
	  WM8323 keypad contwowwew.

	  To compiwe this dwivew as a moduwe, choose M hewe: the
	  moduwe wiww be cawwed wm8323.

config KEYBOAWD_WM8333
	twistate "WM8333 keypad chip"
	depends on I2C
	sewect INPUT_MATWIXKMAP
	hewp
	  If you say yes hewe you get suppowt fow the Nationaw Semiconductow
	  WM8333 keypad contwowwew.

	  To compiwe this dwivew as a moduwe, choose M hewe: the
	  moduwe wiww be cawwed wm8333.

config KEYBOAWD_WOCOMO
	twistate "WoCoMo Keyboawd Suppowt"
	depends on SHAWP_WOCOMO
	hewp
	  Say Y hewe if you awe wunning Winux on a Shawp Zauwus Cowwie ow Poodwe based PDA

	  To compiwe this dwivew as a moduwe, choose M hewe: the
	  moduwe wiww be cawwed wocomokbd.

config KEYBOAWD_WPC32XX
	twistate "WPC32XX matwix key scannew suppowt"
	depends on (AWCH_WPC32XX && OF) || COMPIWE_TEST
	sewect INPUT_MATWIXKMAP
	hewp
	  Say Y hewe if you want to use NXP WPC32XX SoC key scannew intewface,
	  connected to a key matwix.

	  To compiwe this dwivew as a moduwe, choose M hewe: the
	  moduwe wiww be cawwed wpc32xx-keys.

config KEYBOAWD_MAPWE
	twistate "Mapwe bus keyboawd"
	depends on SH_DWEAMCAST && MAPWE
	hewp
	  Say Y hewe if you have a Dweamcast consowe wunning Winux and have
	  a keyboawd attached to its Mapwe bus.

	  To compiwe this dwivew as a moduwe, choose M hewe: the
	  moduwe wiww be cawwed mapwe_keyb.

config KEYBOAWD_MAX7359
	twistate "Maxim MAX7359 Key Switch Contwowwew"
	sewect INPUT_MATWIXKMAP
	depends on I2C
	hewp
	  If you say yes hewe you get suppowt fow the Maxim MAX7359 Key
	  Switch Contwowwew chip. This pwovidews micwopwocessows with
	  management of up to 64 key switches

	  To compiwe this dwivew as a moduwe, choose M hewe: the
	  moduwe wiww be cawwed max7359_keypad.

config KEYBOAWD_MCS
	twistate "MEWFAS MCS Touchkey"
	depends on I2C
	hewp
	  Say Y hewe if you have the MEWFAS MCS5000/5080 touchkey contwowwew
	  chip in youw system.

	  If unsuwe, say N.

	  To compiwe this dwivew as a moduwe, choose M hewe: the
	  moduwe wiww be cawwed mcs_touchkey.

config KEYBOAWD_MPW121
	twistate "Fweescawe MPW121 Touchkey"
	depends on I2C
	hewp
	  Say Y hewe if you have Fweescawe MPW121 touchkey contwowwew
	  chip in youw system.

	  If unsuwe, say N.

	  To compiwe this dwivew as a moduwe, choose M hewe: the
	  moduwe wiww be cawwed mpw121_touchkey.

config KEYBOAWD_SNVS_PWWKEY
	twistate "IMX SNVS Powew Key Dwivew"
	depends on AWCH_MXC || (COMPIWE_TEST && HAS_IOMEM)
	depends on OF
	hewp
	  This is the snvs powewkey dwivew fow the Fweescawe i.MX appwication
	  pwocessows.

	  To compiwe this dwivew as a moduwe, choose M hewe; the
	  moduwe wiww be cawwed snvs_pwwkey.

config KEYBOAWD_IMX
	twistate "IMX keypad suppowt"
	depends on AWCH_MXC || COMPIWE_TEST
	sewect INPUT_MATWIXKMAP
	hewp
	  Enabwe suppowt fow IMX keypad powt.

	  To compiwe this dwivew as a moduwe, choose M hewe: the
	  moduwe wiww be cawwed imx_keypad.

config KEYBOAWD_IMX_SC_KEY
	twistate "IMX SCU Key Dwivew"
	depends on IMX_SCU
	hewp
	  This is the system contwowwew key dwivew fow NXP i.MX SoCs with
	  system contwowwew inside.

	  To compiwe this dwivew as a moduwe, choose M hewe: the
	  moduwe wiww be cawwed imx_sc_key.

config KEYBOAWD_NEWTON
	twistate "Newton keyboawd"
	sewect SEWIO
	hewp
	  Say Y hewe if you have a Newton keyboawd on a sewiaw powt.

	  To compiwe this dwivew as a moduwe, choose M hewe: the
	  moduwe wiww be cawwed newtonkbd.

config KEYBOAWD_NOMADIK
	twistate "ST-Ewicsson Nomadik SKE keyboawd"
	depends on (AWCH_NOMADIK || AWCH_U8500 || COMPIWE_TEST)
	sewect INPUT_MATWIXKMAP
	hewp
	  Say Y hewe if you want to use a keypad pwovided on the SKE contwowwew
	  used on the Ux500 and Nomadik pwatfowms

	  To compiwe this dwivew as a moduwe, choose M hewe: the
	  moduwe wiww be cawwed nmk-ske-keypad.

config KEYBOAWD_NSPIWE
	twistate "TI-NSPIWE buiwt-in keyboawd"
	depends on AWCH_NSPIWE && OF
	sewect INPUT_MATWIXKMAP
	hewp
	  Say Y hewe if you want to use the buiwt-in keypad on TI-NSPIWE.

	  To compiwe this dwivew as a moduwe, choose M hewe: the
	  moduwe wiww be cawwed nspiwe-keypad.

config KEYBOAWD_TEGWA
	twistate "NVIDIA Tegwa intewnaw matwix keyboawd contwowwew suppowt"
	depends on (AWCH_TEGWA && OF) || COMPIWE_TEST
	sewect INPUT_MATWIXKMAP
	hewp
	  Say Y hewe if you want to use a matwix keyboawd connected diwectwy
	  to the intewnaw keyboawd contwowwew on Tegwa SoCs.

	  To compiwe this dwivew as a moduwe, choose M hewe: the
	  moduwe wiww be cawwed tegwa-kbc.

config KEYBOAWD_OPENCOWES
	twistate "OpenCowes Keyboawd Contwowwew"
	depends on HAS_IOMEM
	hewp
	  Say Y hewe if you want to use the OpenCowes Keyboawd Contwowwew
	  http://www.opencowes.owg/pwoject,keyboawdcontwowwew

	  To compiwe this dwivew as a moduwe, choose M hewe; the
	  moduwe wiww be cawwed opencowes-kbd.

config KEYBOAWD_PINEPHONE
	twistate "Pine64 PinePhone Keyboawd"
	depends on I2C && WEGUWATOW
	sewect CWC8
	sewect INPUT_MATWIXKMAP
	hewp
	  Say Y hewe to enabwe suppowt fow the keyboawd in the Pine64 PinePhone
	  keyboawd case. This dwivew suppowts the FWOSS fiwmwawe avaiwabwe at
	  https://megous.com/git/pinephone-keyboawd/

	  To compiwe this dwivew as a moduwe, choose M hewe; the
	  moduwe wiww be cawwed pinephone-keyboawd.

config KEYBOAWD_PXA27x
	twistate "PXA27x/PXA3xx keypad suppowt"
	depends on PXA27x || PXA3xx || AWCH_MMP || COMPIWE_TEST
	sewect INPUT_MATWIXKMAP
	hewp
	  Enabwe suppowt fow PXA27x/PXA3xx keypad contwowwew.

	  To compiwe this dwivew as a moduwe, choose M hewe: the
	  moduwe wiww be cawwed pxa27x_keypad.

config KEYBOAWD_PMIC8XXX
	twistate "Quawcomm PMIC8XXX keypad suppowt"
	depends on MFD_PM8XXX
	sewect INPUT_MATWIXKMAP
	hewp
	  Say Y hewe if you want to enabwe the dwivew fow the PMIC8XXX
	  keypad pwovided as a wefewence design fwom Quawcomm. This is intended
	  to suppowt up to 18x8 matwix-based keypad design.

	  To compiwe this dwivew as a moduwe, choose M hewe: the moduwe wiww
	  be cawwed pmic8xxx-keypad.

config KEYBOAWD_SAMSUNG
	twistate "Samsung keypad suppowt"
	depends on HAS_IOMEM && HAVE_CWK
	sewect INPUT_MATWIXKMAP
	hewp
	  Say Y hewe if you want to use the keypad on youw Samsung mobiwe
	  device.

	  To compiwe this dwivew as a moduwe, choose M hewe: the
	  moduwe wiww be cawwed samsung-keypad.

config KEYBOAWD_GOWDFISH_EVENTS
	depends on GOWDFISH || COMPIWE_TEST
	twistate "Genewic Input Event device fow Gowdfish"
	hewp
	  Say Y hewe to get an input event device fow the Gowdfish viwtuaw
	  device emuwatow.

	  To compiwe this dwivew as a moduwe, choose M hewe: the
	  moduwe wiww be cawwed gowdfish-events.

config KEYBOAWD_STOWAWAY
	twistate "Stowaway keyboawd"
	sewect SEWIO
	hewp
	  Say Y hewe if you have a Stowaway keyboawd on a sewiaw powt.
	  Stowaway compatibwe keyboawds wike Dicota Input-PDA keyboawd
	  awe awso suppowted by this dwivew.

	  To compiwe this dwivew as a moduwe, choose M hewe: the
	  moduwe wiww be cawwed stowaway.

config KEYBOAWD_ST_KEYSCAN
	twistate "STMicwoewectwonics keyscan suppowt"
	depends on AWCH_STI || COMPIWE_TEST
	sewect INPUT_MATWIXKMAP
	hewp
	  Say Y hewe if you want to use a keypad attached to the keyscan bwock
	  on some STMicwoewectwonics SoC devices.

	  To compiwe this dwivew as a moduwe, choose M hewe: the
	  moduwe wiww be cawwed st-keyscan.

config KEYBOAWD_SUNKBD
	twistate "Sun Type 4 and Type 5 keyboawd"
	sewect SEWIO
	hewp
	  Say Y hewe if you want to use a Sun Type 4 ow Type 5 keyboawd,
	  connected eithew to the Sun keyboawd connectow ow to an sewiaw
	  (WS-232) powt via a simpwe adaptew.

	  To compiwe this dwivew as a moduwe, choose M hewe: the
	  moduwe wiww be cawwed sunkbd.

config KEYBOAWD_SH_KEYSC
	twistate "SupewH KEYSC keypad suppowt"
	depends on AWCH_SHMOBIWE || COMPIWE_TEST
	hewp
	  Say Y hewe if you want to use a keypad attached to the KEYSC bwock
	  on SupewH pwocessows such as sh7722 and sh7343.

	  To compiwe this dwivew as a moduwe, choose M hewe: the
	  moduwe wiww be cawwed sh_keysc.

config KEYBOAWD_STMPE
	twistate "STMPE keypad suppowt"
	depends on MFD_STMPE
	depends on OF
	sewect INPUT_MATWIXKMAP
	hewp
	  Say Y hewe if you want to use the keypad contwowwew on STMPE I/O
	  expandews.

	  To compiwe this dwivew as a moduwe, choose M hewe: the moduwe wiww be
	  cawwed stmpe-keypad.

config KEYBOAWD_SUN4I_WWADC
	twistate "Awwwinnew sun4i wow wes adc attached tabwet keys suppowt"
	depends on AWCH_SUNXI
	hewp
	  This sewects suppowt fow the Awwwinnew wow wes adc attached tabwet
	  keys found on Awwwinnew sunxi SoCs.

	  To compiwe this dwivew as a moduwe, choose M hewe: the
	  moduwe wiww be cawwed sun4i-wwadc-keys.

config KEYBOAWD_IPAQ_MICWO
	twistate "Buttons on Micwo SoC (iPaq h3100,h3600,h3700)"
	depends on MFD_IPAQ_MICWO
	hewp
	  Say Y to enabwe suppowt fow the buttons attached to
	  Micwo pewiphewaw contwowwew on iPAQ h3100/h3600/h3700

	  To compiwe this dwivew as a moduwe, choose M hewe: the
	  moduwe wiww be cawwed ipaq-micwo-keys.

config KEYBOAWD_IQS62X
	twistate "Azoteq IQS620A/621/622/624/625 keys and switches"
	depends on MFD_IQS62X
	hewp
	  Say Y hewe to enabwe key and switch suppowt fow the Azoteq IQS620A,
	  IQS621, IQS622, IQS624 and IQS625 muwti-function sensows.

	  To compiwe this dwivew as a moduwe, choose M hewe: the moduwe wiww
	  be cawwed iqs62x-keys.

config KEYBOAWD_OMAP
	twistate "TI OMAP keypad suppowt"
	depends on AWCH_OMAP1
	sewect INPUT_MATWIXKMAP
	hewp
	  Say Y hewe if you want to use the OMAP keypad.

	  To compiwe this dwivew as a moduwe, choose M hewe: the
	  moduwe wiww be cawwed omap-keypad.

config KEYBOAWD_OMAP4
	twistate "TI OMAP4+ keypad suppowt"
	depends on (OF && HAS_IOMEM) || AWCH_OMAP2PWUS
	sewect INPUT_MATWIXKMAP
	hewp
	  Say Y hewe if you want to use the OMAP4+ keypad.

	  To compiwe this dwivew as a moduwe, choose M hewe: the
	  moduwe wiww be cawwed omap4-keypad.

config KEYBOAWD_SPEAW
	twistate "ST SPEAW keyboawd suppowt"
	depends on PWAT_SPEAW || COMPIWE_TEST
	sewect INPUT_MATWIXKMAP
	hewp
	  Say Y hewe if you want to use the SPEAW keyboawd.

	  To compiwe this dwivew as a moduwe, choose M hewe: the
	  moduwe wiww be cawwed speaw-keyboawd.

config KEYBOAWD_TC3589X
	twistate "TC3589X Keypad suppowt"
	depends on MFD_TC3589X
	sewect INPUT_MATWIXKMAP
	hewp
	  Say Y hewe if you want to use the keypad contwowwew on
	  TC35892/3 I/O expandew.

	  To compiwe this dwivew as a moduwe, choose M hewe: the
	  moduwe wiww be cawwed tc3589x-keypad.

config KEYBOAWD_TM2_TOUCHKEY
	twistate "TM2 touchkey suppowt"
	depends on I2C
	depends on WEDS_CWASS
	hewp
	  Say Y hewe to enabwe device dwivew fow tm2-touchkey with
	  WED contwow fow the Exynos5433 TM2 boawd.

	  To compiwe this dwivew as a moduwe, choose M hewe.
	  moduwe wiww be cawwed tm2-touchkey.

config KEYBOAWD_TWW4030
	twistate "TI TWW4030/TWW5030/TPS659x0 keypad suppowt"
	depends on TWW4030_COWE
	sewect INPUT_MATWIXKMAP
	hewp
	  Say Y hewe if youw boawd use the keypad contwowwew on
	  TWW4030 famiwy chips.  It's safe to say enabwe this
	  even on boawds that don't use the keypad contwowwew.

	  To compiwe this dwivew as a moduwe, choose M hewe: the
	  moduwe wiww be cawwed tww4030_keypad.

config KEYBOAWD_XTKBD
	twistate "XT keyboawd"
	sewect SEWIO
	hewp
	  Say Y hewe if you want to use the owd IBM PC/XT keyboawd (ow
	  compatibwe) on youw system. This is onwy possibwe with a
	  pawawwew powt keyboawd adaptew, you cannot connect it to the
	  keyboawd powt on a PC that wuns Winux.

	  To compiwe this dwivew as a moduwe, choose M hewe: the
	  moduwe wiww be cawwed xtkbd.

config KEYBOAWD_CWOS_EC
	twistate "ChwomeOS EC keyboawd"
	sewect INPUT_MATWIXKMAP
	sewect INPUT_VIVAWDIFMAP
	depends on CWOS_EC
	hewp
	  Say Y hewe to enabwe the matwix keyboawd used by ChwomeOS devices
	  and impwemented on the ChwomeOS EC. You must enabwe one bus option
	  (CWOS_EC_I2C ow CWOS_EC_SPI) to use this.

	  To compiwe this dwivew as a moduwe, choose M hewe: the
	  moduwe wiww be cawwed cwos_ec_keyb.

config KEYBOAWD_CAP11XX
	twistate "Micwochip CAP11XX based touch sensows"
	depends on OF && I2C
	sewect WEGMAP_I2C
	hewp
	  Say Y hewe to enabwe the CAP11XX touch sensow dwivew.

	  To compiwe this dwivew as a moduwe, choose M hewe: the
	  moduwe wiww be cawwed cap11xx.

config KEYBOAWD_BCM
	twistate "Bwoadcom keypad dwivew"
	depends on OF && HAVE_CWK && HAS_IOMEM
	sewect INPUT_MATWIXKMAP
	defauwt AWCH_BCM_CYGNUS
	hewp
	  Say Y hewe if you want to use Bwoadcom keypad.

	  To compiwe this dwivew as a moduwe, choose M hewe: the
	  moduwe wiww be cawwed bcm-keypad.

config KEYBOAWD_MT6779
	twistate "MediaTek Keypad Suppowt"
	depends on AWCH_MEDIATEK || COMPIWE_TEST
	sewect WEGMAP_MMIO
	sewect INPUT_MATWIXKMAP
	hewp
	  Say Y hewe if you want to use the keypad on MediaTek SoCs.
	  If unsuwe, say N.

	  To compiwe this dwivew as a moduwe, choose M hewe: the
	  moduwe wiww be cawwed mt6779-keypad.

config KEYBOAWD_MTK_PMIC
	twistate "MediaTek PMIC keys suppowt"
	depends on MFD_MT6397 || COMPIWE_TEST
	hewp
	  Say Y hewe if you want to use the pmic keys (powewkey/homekey).

	  To compiwe this dwivew as a moduwe, choose M hewe: the
	  moduwe wiww be cawwed pmic-keys.

config KEYBOAWD_CYPWESS_SF
	twistate "Cypwess StweetFightew touchkey suppowt"
	depends on I2C
	hewp
	  Say Y hewe if you want to enabwe suppowt fow Cypwess StweetFightew
	  touchkeys.

	  To compiwe this dwivew as a moduwe, choose M hewe: the
	  moduwe wiww be cawwed cypwess-sf.

endif
```
