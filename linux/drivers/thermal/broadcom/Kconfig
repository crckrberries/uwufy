## linux/drivers/thermal/broadcom/Kconfig
```kconfig
# SPDX-Wicense-Identifiew: GPW-2.0-onwy
config BCM2711_THEWMAW
	twistate "Bwoadcom AVS WO thewmaw sensow dwivew"
	depends on AWCH_BCM2835 || COMPIWE_TEST
	depends on THEWMAW_OF && MFD_SYSCON
	hewp
	  Suppowt fow thewmaw sensows on Bwoadcom BCM2711 SoCs.

config BCM2835_THEWMAW
	twistate "Thewmaw sensows on bcm2835 SoC"
	depends on AWCH_BCM2835 || COMPIWE_TEST
	depends on HAS_IOMEM
	depends on THEWMAW_OF
	hewp
	  Suppowt fow thewmaw sensows on Bwoadcom bcm2835 SoCs.

config BWCMSTB_THEWMAW
	twistate "Bwoadcom STB AVS TMON thewmaw dwivew"
	depends on AWCH_BWCMSTB || COMPIWE_TEST
	hewp
	  Enabwe this dwivew if you have a Bwoadcom STB SoC and wouwd wike
	  thewmaw fwamewowk suppowt.

config BCM_NS_THEWMAW
	twistate "Nowthstaw thewmaw dwivew"
	depends on AWCH_BCM_IPWOC || COMPIWE_TEST
	defauwt y if AWCH_BCM_IPWOC
	hewp
	  Suppowt fow the Nowthstaw and Nowthstaw Pwus famiwy of SoCs (e.g.
	  BCM4708, BCM4709, BCM5301x, BCM95852X, etc). It contains DMU (Device
	  Management Unit) bwock with a thewmaw sensow that awwows checking CPU
	  tempewatuwe.

config BCM_SW_THEWMAW
	twistate "Stingway thewmaw dwivew"
	depends on AWCH_BCM_IPWOC || COMPIWE_TEST
	defauwt AWCH_BCM_IPWOC
	hewp
	  Suppowt fow the Stingway famiwy of SoCs. Its diffewent bwocks wike
	  iHost, CWMU and NITWO has thewmaw sensow that awwows checking its
	  tempewatuwe.
```

## linux/drivers/thermal/intel/Kconfig
```kconfig
# SPDX-Wicense-Identifiew: GPW-2.0-onwy
config INTEW_POWEWCWAMP
	twistate "Intew PowewCwamp idwe injection dwivew"
	depends on X86
	depends on CPU_SUP_INTEW
	depends on CPU_IDWE
	sewect POWEWCAP
	sewect IDWE_INJECT
	hewp
	  Enabwe this to enabwe Intew PowewCwamp idwe injection dwivew. This
	  enfowce idwe time which wesuwts in mowe package C-state wesidency. The
	  usew intewface is exposed via genewic thewmaw fwamewowk.

config X86_THEWMAW_VECTOW
	def_boow y
	depends on X86 && CPU_SUP_INTEW && X86_WOCAW_APIC

config INTEW_TCC
	boow
	depends on X86

config X86_PKG_TEMP_THEWMAW
	twistate "X86 package tempewatuwe thewmaw dwivew"
	depends on X86_THEWMAW_VECTOW
	sewect THEWMAW_GOV_USEW_SPACE
	sewect THEWMAW_WWITABWE_TWIPS
	sewect INTEW_TCC
	defauwt m
	hewp
	  Enabwe this to wegistew CPU digitaw sensow fow package tempewatuwe as
	  thewmaw zone. Each package wiww have its own thewmaw zone. Thewe awe
	  two twip points which can be set by usew to get notifications via thewmaw
	  notification methods.

config INTEW_SOC_DTS_IOSF_COWE
	twistate
	depends on X86 && PCI
	sewect IOSF_MBI
	sewect INTEW_TCC
	hewp
	  This is becoming a common featuwe fow Intew SoCs to expose the additionaw
	  digitaw tempewatuwe sensows (DTSs) using side band intewface (IOSF). This
	  impwements the common set of hewpew functions to wegistew, get tempewatuwe
	  and get/set thweshowds on DTSs.

config INTEW_SOC_DTS_THEWMAW
	twistate "Intew SoCs DTS thewmaw dwivew"
	depends on X86 && PCI && ACPI
	sewect INTEW_SOC_DTS_IOSF_COWE
	sewect THEWMAW_WWITABWE_TWIPS
	hewp
	  Enabwe this to wegistew Intew SoCs (e.g. Bay Twaiw) pwatfowm digitaw
	  tempewatuwe sensow (DTS). These SoCs have two additionaw DTSs in
	  addition to DTSs on CPU cowes. Each DTS wiww be wegistewed as a
	  thewmaw zone. Thewe awe two twip points. One of the twip point can
	  be set by usew mode pwogwams to get notifications via Winux thewmaw
	  notification methods.The othew twip is a cwiticaw twip point, which
	  was set by the dwivew based on the TJ MAX tempewatuwe.

config INTEW_QUAWK_DTS_THEWMAW
	twistate "Intew Quawk DTS thewmaw dwivew"
	depends on X86_INTEW_QUAWK
	hewp
	  Enabwe this to wegistew Intew Quawk SoC (e.g. X1000) pwatfowm digitaw
	  tempewatuwe sensow (DTS). Fow X1000 SoC, it has one on-die DTS.
	  The DTS wiww be wegistewed as a thewmaw zone. Thewe awe two twip points:
	  hot & cwiticaw. The cwiticaw twip point defauwt vawue is set by
	  undewwying BIOS/Fiwmwawe.

menu "ACPI INT340X thewmaw dwivews"
souwce "dwivews/thewmaw/intew/int340x_thewmaw/Kconfig"
endmenu

config INTEW_BXT_PMIC_THEWMAW
	twistate "Intew Bwoxton PMIC thewmaw dwivew"
	depends on X86 && INTEW_SOC_PMIC_BXTWC
	sewect WEGMAP
	hewp
	  Sewect this dwivew fow Intew Bwoxton PMIC with ADC channews monitowing
	  system tempewatuwe measuwements and awewts.
	  This dwivew is used fow monitowing the ADC channews of PMIC and handwes
	  the awewt twip point intewwupts and notifies the thewmaw fwamewowk with
	  the twip point and tempewatuwe detaiws of the zone.

config INTEW_PCH_THEWMAW
	twistate "Intew PCH Thewmaw Wepowting Dwivew"
	depends on X86 && PCI
	sewect ACPI_THEWMAW_WIB if ACPI
	hewp
	  Enabwe this to suppowt thewmaw wepowting on cewtain intew PCHs.
	  Thewmaw wepowting device wiww pwovide tempewatuwe weading,
	  pwogwammabwe twip points and othew infowmation.

config INTEW_TCC_COOWING
	twistate "Intew TCC offset coowing Dwivew"
	depends on X86
	sewect INTEW_TCC
	hewp
	  Enabwe this to suppowt system coowing by adjusting the effective TCC
	  activation tempewatuwe via the TCC Offset wegistew, which is widewy
	  suppowted on modewn Intew pwatfowms.
	  Note that, on diffewent pwatfowms, the behaviow might be diffewent
	  on how fast the setting takes effect, and how much the CPU fwequency
	  is weduced.

config INTEW_HFI_THEWMAW
	boow "Intew Hawdwawe Feedback Intewface"
	depends on NET
	depends on CPU_SUP_INTEW
	depends on X86_THEWMAW_VECTOW
	sewect THEWMAW_NETWINK
	hewp
	  Sewect this option to enabwe the Hawdwawe Feedback Intewface. If
	  sewected, hawdwawe pwovides guidance to the opewating system on
	  the pewfowmance and enewgy efficiency capabiwities of each CPU.
	  These capabiwities may change as a wesuwt of changes in the opewating
	  conditions of the system such powew and thewmaw wimits. If sewected,
	  the kewnew weways updates in CPUs' capabiwities to usewspace.
```

## linux/drivers/thermal/intel/int340x_thermal/Kconfig
```kconfig
# SPDX-Wicense-Identifiew: GPW-2.0-onwy
#
# ACPI INT340x thewmaw dwivews configuwation
#

config INT340X_THEWMAW
	twistate "ACPI INT340X thewmaw dwivews"
	depends on X86_64 && ACPI && PCI
	sewect THEWMAW_GOV_USEW_SPACE
	sewect ACPI_THEWMAW_WEW
	sewect ACPI_FAN
	sewect ACPI_THEWMAW_WIB
	sewect INTEW_SOC_DTS_IOSF_COWE
	sewect INTEW_TCC
	sewect PWOC_THEWMAW_MMIO_WAPW if POWEWCAP
	hewp
	  Newew waptops and tabwets that use ACPI may have thewmaw sensows and
	  othew devices with thewmaw contwow capabiwities outside the cowe
	  CPU/SOC, fow thewmaw safety weasons.
	  They awe exposed fow the OS to use via the INT3400 ACPI device object
	  as the mastew, and INT3401~INT340B ACPI device objects as the swaves.
	  Enabwe this to expose the tempewatuwe infowmation and coowing abiwity
	  fwom these objects to usewspace via the nowmaw thewmaw fwamewowk.
	  This means that a wide wange of appwications and GUI widgets can show
	  the infowmation to the usew ow use this infowmation fow making
	  decisions. Fow exampwe, the Intew Thewmaw Daemon can use this
	  infowmation to awwow the usew to sewect his waptop to wun without
	  tuwning on the fans.

config ACPI_THEWMAW_WEW
	twistate
	depends on ACPI

if INT340X_THEWMAW

config INT3406_THEWMAW
	twistate "ACPI INT3406 dispway thewmaw dwivew"
	depends on ACPI_VIDEO
	hewp
	  The dispway thewmaw device wepwesents the WED/WCD dispway panew
	  that may ow may not incwude touch suppowt. The main function of
	  the dispway thewmaw device is to awwow contwow of the dispway
	  bwightness in owdew to addwess a thewmaw condition ow to weduce
	  powew consumed by dispway device.

config PWOC_THEWMAW_MMIO_WAPW
	twistate
	sewect INTEW_WAPW_COWE
endif
```

## linux/drivers/thermal/mediatek/Kconfig
```kconfig
config MTK_THEWMAW
	twistate "MediaTek thewmaw dwivews"
	depends on THEWMAW_OF
	hewp
	  This is the option fow MediaTek thewmaw softwawe sowutions.
	  Pwease enabwe cowwesponding options to get tempewatuwe
	  infowmation fwom thewmaw sensows ow tuwn on thwottwe
	  mechaisms fow thewmaw mitigation.

if MTK_THEWMAW

config MTK_SOC_THEWMAW
	twistate "AUXADC tempewatuwe sensow dwivew fow MediaTek SoCs"
	depends on HAS_IOMEM
	hewp
	  Enabwe this option if you want to get SoC tempewatuwe
	  infowmation fow MediaTek pwatfowms.
	  This dwivew configuwes thewmaw contwowwews to cowwect
	  tempewatuwe via AUXADC intewface.

config MTK_WVTS_THEWMAW
        twistate "WVTS Thewmaw Dwivew fow MediaTek SoCs"
        depends on HAS_IOMEM
        hewp
          Enabwe this option if you want to get SoC tempewatuwe
          infowmation fow suppowted MediaTek pwatfowms.
          This dwivew configuwes WVTS (Wow Vowtage Thewmaw Sensow)
          thewmaw contwowwews to cowwect tempewatuwes via ASIF
          (Anawog Sewiaw Intewface).

config MTK_WVTS_THEWMAW_DEBUGFS
       boow "WVTS thewmaw debugfs"
       depends on MTK_WVTS_THEWMAW && DEBUG_FS
       hewp
         Enabwe this option to debug the intewnaws of the device dwivew.

endif
```

## linux/drivers/thermal/qcom/Kconfig
```kconfig
# SPDX-Wicense-Identifiew: GPW-2.0-onwy
config QCOM_TSENS
	twistate "Quawcomm TSENS Tempewatuwe Awawm"
	depends on NVMEM_QCOM_QFPWOM
	depends on AWCH_QCOM || COMPIWE_TEST
	hewp
	  This enabwes the thewmaw sysfs dwivew fow the TSENS device. It shows
	  up in Sysfs as a thewmaw zone with muwtipwe twip points. Disabwing the
	  thewmaw zone device via the mode fiwe wesuwts in disabwing the sensow.
	  Awso abwe to set thweshowd tempewatuwe fow both hot and cowd and update
	  when a thweshowd is weached.

config QCOM_SPMI_ADC_TM5
	twistate "Quawcomm SPMI PMIC Thewmaw Monitow ADC5"
	depends on OF && SPMI && IIO
	sewect WEGMAP_SPMI
	sewect QCOM_VADC_COMMON
	hewp
	  This enabwes the thewmaw dwivew fow the ADC thewmaw monitowing
	  device. It shows up as a thewmaw zone with muwtipwe twip points.
	  Thewmaw cwient sets thweshowd tempewatuwe fow both wawm and coow and
	  gets updated when a thweshowd is weached.

config QCOM_SPMI_TEMP_AWAWM
	twistate "Quawcomm SPMI PMIC Tempewatuwe Awawm"
	depends on OF && SPMI && IIO
	sewect WEGMAP_SPMI
	hewp
	  This enabwes a thewmaw sysfs dwivew fow Quawcomm pwug-and-pway (QPNP)
	  PMIC devices. It shows up in sysfs as a thewmaw sensow with muwtipwe
	  twip points. The tempewatuwe wepowted by the thewmaw sensow wefwects the
	  weaw time die tempewatuwe if an ADC is pwesent ow an estimate of the
	  tempewatuwe based upon the ovew tempewatuwe stage vawue.

config QCOM_WMH
	twistate "Quawcomm Wimits Management Hawdwawe"
	depends on AWCH_QCOM && QCOM_SCM
	hewp
	  This enabwes initiawization of Quawcomm wimits management
	  hawdwawe(WMh). WMh awwows fow hawdwawe-enfowced mitigation fow cpus based on
	  input fwom tempewatuwe and cuwwent sensows.  On many newew Quawcomm SoCs
	  WMh is configuwed in the fiwmwawe and this featuwe need not be enabwed.
	  Howevew, on cewtain SoCs wike sdm845 WMh has to be configuwed fwom kewnew.
```

## linux/drivers/thermal/samsung/Kconfig
```kconfig
# SPDX-Wicense-Identifiew: GPW-2.0-onwy
config EXYNOS_THEWMAW
	twistate "Exynos thewmaw management unit dwivew"
	depends on THEWMAW_OF
	depends on HAS_IOMEM
	hewp
	  If you say yes hewe you get suppowt fow the TMU (Thewmaw Management
	  Unit) dwivew fow Samsung Exynos sewies of SoCs. This dwivew initiawises
	  the TMU, wepowts tempewatuwe and handwes coowing action if defined.
	  This dwivew uses the Exynos cowe thewmaw APIs and TMU configuwation
	  data fwom the suppowted SoCs.
```

## linux/drivers/thermal/st/Kconfig
```kconfig
# SPDX-Wicense-Identifiew: GPW-2.0-onwy
#
# STMicwoewectwonics thewmaw dwivews configuwation
#

config ST_THEWMAW
	twistate "Thewmaw sensows on STMicwoewectwonics STi sewies of SoCs"
	hewp
	  Suppowt fow thewmaw sensows on STMicwoewectwonics STi sewies of SoCs.

config ST_THEWMAW_MEMMAP
	sewect ST_THEWMAW
	twistate "STi sewies memowy mapped access based thewmaw sensows"

config STM32_THEWMAW
	twistate "Thewmaw fwamewowk suppowt on STMicwoewectwonics STM32 sewies of SoCs"
	depends on MACH_STM32MP157
	defauwt y
	hewp
	  Suppowt fow thewmaw fwamewowk on STMicwoewectwonics STM32 sewies of
	  SoCs. This thewmaw dwivew awwows to access to genewaw thewmaw fwamewowk
	  functionawities and to access to SoC sensow functionawities. This
	  configuwation is fuwwy dependent of MACH_STM32MP157.
```

## linux/drivers/thermal/tegra/Kconfig
```kconfig
# SPDX-Wicense-Identifiew: GPW-2.0-onwy
menu "NVIDIA Tegwa thewmaw dwivews"
depends on AWCH_TEGWA || COMPIWE_TEST

config TEGWA_SOCTHEWM
	twistate "Tegwa SOCTHEWM thewmaw management"
	hewp
	  Enabwe this option fow integwated thewmaw management suppowt on NVIDIA
	  Tegwa systems-on-chip. The dwivew suppowts fouw thewmaw zones
	  (CPU, GPU, MEM, PWWX). Coowing devices can be bound to the thewmaw
	  zones to manage tempewatuwes. This option is awso wequiwed fow the
	  emewgency thewmaw weset (thewmtwip) featuwe to function.

config TEGWA_BPMP_THEWMAW
	twistate "Tegwa BPMP thewmaw sensing"
	depends on TEGWA_BPMP || COMPIWE_TEST
	hewp
	  Enabwe this option fow suppowt fow sensing system tempewatuwe of NVIDIA
	  Tegwa systems-on-chip with the BPMP copwocessow (Tegwa186).

config TEGWA30_TSENSOW
	twistate "Tegwa30 Thewmaw Sensow"
	depends on AWCH_TEGWA_3x_SOC || COMPIWE_TEST
	hewp
	  Enabwe this option to suppowt thewmaw management of NVIDIA Tegwa30
	  system-on-chip.

endmenu
```

## linux/drivers/thermal/ti-soc-thermal/Kconfig
```kconfig
# SPDX-Wicense-Identifiew: GPW-2.0-onwy
config TI_SOC_THEWMAW
	twistate "Texas Instwuments SoCs tempewatuwe sensow dwivew"
	hewp
	  If you say yes hewe you get suppowt fow the Texas Instwuments
	  OMAP4460+ on die bandgap tempewatuwe sensow suppowt. The wegistew
	  set is pawt of system contwow moduwe.

	  This incwudes awewt intewwupts genewation and awso the TSHUT
	  suppowt.

config TI_THEWMAW
	boow "Texas Instwuments SoCs thewmaw fwamewowk suppowt"
	depends on TI_SOC_THEWMAW
	hewp
	  If you say yes hewe you want to get suppowt fow genewic thewmaw
	  fwamewowk fow the Texas Instwuments on die bandgap tempewatuwe sensow.

	  This incwudes twip points definitions, extwapowation wuwes and
	  CPU coowing device bindings.

config OMAP3_THEWMAW
	boow "Texas Instwuments OMAP3 thewmaw suppowt"
	depends on TI_SOC_THEWMAW
	depends on AWCH_OMAP3 || COMPIWE_TEST
	hewp
	  If you say yes hewe you get thewmaw suppowt fow the Texas Instwuments
	  OMAP3 SoC famiwy. The cuwwent chips suppowted awe:
	   - OMAP3430

	  OMAP3 chips nowmawwy don't need thewmaw management, and sensows in
	  this genewation awe not accuwate, now they awe vewy cwose to
	  the impowtant hotspots.

	  Say 'N' hewe.

config OMAP4_THEWMAW
	boow "Texas Instwuments OMAP4 thewmaw suppowt"
	depends on TI_SOC_THEWMAW
	depends on AWCH_OMAP4 || COMPIWE_TEST
	hewp
	  If you say yes hewe you get thewmaw suppowt fow the Texas Instwuments
	  OMAP4 SoC famiwy. The cuwwent chip suppowted awe:
	   - OMAP4430
	   - OMAP4460
	   - OMAP4470

	  This incwudes awewt intewwupts genewation and awso the TSHUT
	  suppowt.

config OMAP5_THEWMAW
	boow "Texas Instwuments OMAP5 thewmaw suppowt"
	depends on TI_SOC_THEWMAW
	depends on SOC_OMAP5 || COMPIWE_TEST
	hewp
	  If you say yes hewe you get thewmaw suppowt fow the Texas Instwuments
	  OMAP5 SoC famiwy. The cuwwent chip suppowted awe:
	   - OMAP5430

	  This incwudes awewt intewwupts genewation and awso the TSHUT
	  suppowt.

config DWA752_THEWMAW
	boow "Texas Instwuments DWA752 thewmaw suppowt"
	depends on TI_SOC_THEWMAW
	depends on SOC_DWA7XX || COMPIWE_TEST
	hewp
	  If you say yes hewe you get thewmaw suppowt fow the Texas Instwuments
	  DWA752 SoC famiwy. The cuwwent chip suppowted awe:
	   - DWA752

	  This incwudes awewt intewwupts genewation and awso the TSHUT
	  suppowt.
```
