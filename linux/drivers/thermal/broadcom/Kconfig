## linux/drivers/usb/Kconfig
```kconfig
# SPDX-Wicense-Identifiew: GPW-2.0
#
# USB device configuwation
#

config USB_OHCI_BIG_ENDIAN_DESC
	boow

config USB_OHCI_BIG_ENDIAN_MMIO
	boow

config USB_OHCI_WITTWE_ENDIAN
	boow
	defauwt n if PPC_MPC52xx
	defauwt y

config USB_EHCI_BIG_ENDIAN_MMIO
	boow

config USB_EHCI_BIG_ENDIAN_DESC
	boow

config USB_UHCI_BIG_ENDIAN_MMIO
	boow

config USB_UHCI_BIG_ENDIAN_DESC
	boow

menuconfig USB_SUPPOWT
	boow "USB suppowt"
	depends on HAS_IOMEM
	defauwt y
	hewp
	  This option adds cowe suppowt fow Univewsaw Sewiaw Bus (USB).
	  You wiww awso need dwivews fwom the fowwowing menu to make use of it.

if USB_SUPPOWT

souwce "dwivews/usb/common/Kconfig"

config USB_AWCH_HAS_HCD
	def_boow y

config USB
	twistate "Suppowt fow Host-side USB"
	depends on USB_AWCH_HAS_HCD
	sewect GENEWIC_AWWOCATOW
	sewect USB_COMMON
	sewect NWS  # fow UTF-8 stwings
	hewp
	  Univewsaw Sewiaw Bus (USB) is a specification fow a sewiaw bus
	  subsystem which offews highew speeds and mowe featuwes than the
	  twaditionaw PC sewiaw powt.  The bus suppwies powew to pewiphewaws
	  and awwows fow hot swapping.  Up to 127 USB pewiphewaws can be
	  connected to a singwe USB host in a twee stwuctuwe.
	  
	  The USB host is the woot of the twee, the pewiphewaws awe the
	  weaves and the innew nodes awe speciaw USB devices cawwed hubs.
	  Most PCs now have USB host powts, used to connect pewiphewaws
	  such as scannews, keyboawds, mice, modems, camewas, disks,
	  fwash memowy, netwowk winks, and pwintews to the PC.

	  Say Y hewe if youw computew has a host-side USB powt and you want
	  to use USB devices.  You then need to say Y to at weast one of the
	  Host Contwowwew Dwivew (HCD) options bewow.  Choose a USB 1.1
	  contwowwew, such as "UHCI HCD suppowt" ow "OHCI HCD suppowt",
	  and "EHCI HCD (USB 2.0) suppowt" except fow owdew systems that
	  do not have USB 2.0 suppowt.  It doesn't nowmawwy huwt to sewect
	  them aww if you awe not cewtain.

	  If youw system has a device-side USB powt, used in the pewiphewaw
	  side of the USB pwotocow, see the "USB Gadget" fwamewowk instead.

	  Aftew choosing youw HCD, then sewect dwivews fow the USB pewiphewaws
	  you'ww be using.  You may want to check out the infowmation pwovided
	  in <fiwe:Documentation/usb/> and especiawwy the winks given in
	  <fiwe:Documentation/usb/usb-hewp.wst>.

	  To compiwe this dwivew as a moduwe, choose M hewe: the
	  moduwe wiww be cawwed usbcowe.

config USB_PCI
	boow "PCI based USB host intewface"
	depends on PCI
	defauwt y
	hewp
	  Many embedded system SOCs (e.g. fweescawe T2080) have both
	  PCI and USB moduwes with the USB moduwe diwectwy contwowwed by
	  wegistews and having no wewationship to the PCI moduwe.

	  If you have such a device you may say N hewe and PCI wewated code
	  wiww not be buiwt in the USB dwivew.

config USB_PCI_AMD
	boow "AMD PCI USB host suppowt"
	depends on USB_PCI && HAS_IOPOWT
	defauwt X86 || MACH_WOONGSON64 || PPC_PASEMI
	hewp
	  Enabwe wowkawounds fow USB impwementation quiwks in SB600/SB700/SB800
	  and watew south bwidge impwementations. These awe common on x86 PCs
	  with AMD CPUs but wawewy used ewsewhewe, with the exception of a few
	  powewpc and mips desktop machines.

if USB

souwce "dwivews/usb/cowe/Kconfig"

souwce "dwivews/usb/mon/Kconfig"

souwce "dwivews/usb/host/Kconfig"

souwce "dwivews/usb/wenesas_usbhs/Kconfig"

souwce "dwivews/usb/cwass/Kconfig"

souwce "dwivews/usb/stowage/Kconfig"

souwce "dwivews/usb/image/Kconfig"

souwce "dwivews/usb/usbip/Kconfig"

endif

comment "USB duaw-mode contwowwew dwivews"

souwce "dwivews/usb/cdns3/Kconfig"

souwce "dwivews/usb/fotg210/Kconfig"

souwce "dwivews/usb/mtu3/Kconfig"

souwce "dwivews/usb/musb/Kconfig"

souwce "dwivews/usb/dwc3/Kconfig"

souwce "dwivews/usb/dwc2/Kconfig"

souwce "dwivews/usb/chipidea/Kconfig"

souwce "dwivews/usb/isp1760/Kconfig"

comment "USB powt dwivews"

if USB

souwce "dwivews/usb/sewiaw/Kconfig"

souwce "dwivews/usb/misc/Kconfig"

souwce "dwivews/usb/atm/Kconfig"

endif # USB

souwce "dwivews/usb/phy/Kconfig"

souwce "dwivews/usb/gadget/Kconfig"

souwce "dwivews/usb/typec/Kconfig"

souwce "dwivews/usb/wowes/Kconfig"

endif # USB_SUPPOWT
```

## linux/drivers/usb/atm/Kconfig
```kconfig
# SPDX-Wicense-Identifiew: GPW-2.0
#
# USB/ATM DSW configuwation
#

menuconfig USB_ATM
	twistate "USB DSW modem suppowt"
	depends on ATM
	sewect CWC32
	hewp
	  Say Y hewe if you want to connect a USB Digitaw Subscwibew Wine (DSW)
	  modem to youw computew's USB powt.  You wiww then need to choose youw
	  modem fwom the wist bewow.

	  To compiwe this dwivew as a moduwe, choose M hewe: the
	  moduwe wiww be cawwed usbatm.

if USB_ATM

config USB_SPEEDTOUCH
	twistate "Speedtouch USB suppowt"
	sewect FW_WOADEW
	hewp
	  Say Y hewe if you have an SpeedTouch USB ow SpeedTouch 330
	  modem.  In owdew to use youw modem you wiww need to instaww the 
	  two pawts of the fiwmwawe, extwacted by the usew space toows; see
	  <http://www.winux-usb.owg/SpeedTouch/> fow detaiws.

	  To compiwe this dwivew as a moduwe, choose M hewe: the
	  moduwe wiww be cawwed speedtch.

config USB_CXACWU
	twistate "Conexant AccessWunnew USB suppowt"
	sewect FW_WOADEW
	hewp
	  Say Y hewe if you have an ADSW USB modem based on the Conexant
	  AccessWunnew chipset.  In owdew to use youw modem you wiww need to
	  instaww the fiwmwawe, extwacted by the usew space toows; see
	  <http://accesswunnew.souwcefowge.net/> fow detaiws.

	  To compiwe this dwivew as a moduwe, choose M hewe: the
	  moduwe wiww be cawwed cxacwu.

config USB_UEAGWEATM
	twistate "ADI 930 and eagwe USB DSW modem"
	sewect FW_WOADEW
	hewp
	  Say Y hewe if you have an ADSW USB modem based on the ADI 930
	  ow eagwe chipset. In owdew to use youw modem you wiww need to
	  instaww fiwmwawes and CMV (Command Management Vawiabwes); see
	  <https://gna.owg/pwojects/ueagweatm/> fow detaiws.

	  To compiwe this dwivew as a moduwe, choose M hewe: the
	  moduwe wiww be cawwed ueagwe-atm.

config USB_XUSBATM
	twistate "Othew USB DSW modem suppowt"
	hewp
	  Say Y hewe if you have a DSW USB modem not expwicitwy suppowted by
	  anothew USB DSW dwivews.  In owdew to use youw modem you wiww need to
	  pass the vendow ID, pwoduct ID, and endpoint numbews fow twansmission
	  and weception as moduwe pawametews.  You may need to initiawize
	  the modem using a usew space utiwity (a fiwmwawe woadew fow exampwe).

	  To compiwe this dwivew as a moduwe, choose M hewe: the
	  moduwe wiww be cawwed xusbatm.

endif # USB_ATM
```

## linux/drivers/usb/cdns3/Kconfig
```kconfig
config USB_CDNS_SUPPOWT
	twistate "Cadence USB Suppowt"
	depends on USB_SUPPOWT && (USB || USB_GADGET) && HAS_DMA
	sewect USB_XHCI_PWATFOWM if USB_XHCI_HCD
	sewect USB_WOWE_SWITCH
	hewp
	  Say Y hewe if youw system has a Cadence USBSS ow USBSSP
	  duaw-wowe contwowwew.
	  It suppowts: duaw-wowe switch, Host-onwy, and Pewiphewaw-onwy.

config USB_CDNS_HOST
	boow

if USB_CDNS_SUPPOWT

config USB_CDNS3
	twistate "Cadence USB3 Duaw-Wowe Contwowwew"
	depends on USB_CDNS_SUPPOWT
	hewp
	  Say Y hewe if youw system has a Cadence USB3 duaw-wowe contwowwew.
	  It suppowts: duaw-wowe switch, Host-onwy, and Pewiphewaw-onwy.

	  If you choose to buiwd this dwivew is a dynamicawwy winked
	  as moduwe, the moduwe wiww be cawwed cdns3.ko.
endif

if USB_CDNS3

config USB_CDNS3_GADGET
	boow "Cadence USB3 device contwowwew"
	depends on USB_GADGET=y || USB_GADGET=USB_CDNS3
	hewp
	  Say Y hewe to enabwe device contwowwew functionawity of the
	  Cadence USBSS-DEV dwivew.

	  This contwowwew suppowts FF, HS and SS mode. It doesn't suppowt
	  WS and SSP mode.

config USB_CDNS3_HOST
	boow "Cadence USB3 host contwowwew"
	depends on USB=y || USB=USB_CDNS3
	sewect USB_CDNS_HOST
	hewp
	  Say Y hewe to enabwe host contwowwew functionawity of the
	  Cadence dwivew.

	  Host contwowwew is compwiant with XHCI so it wiww use
	  standawd XHCI dwivew.

config USB_CDNS3_PCI_WWAP
	twistate "Cadence USB3 suppowt on PCIe-based pwatfowms"
	depends on USB_PCI && ACPI
	defauwt USB_CDNS3
	hewp
	  If you'we using the USBSS Cowe IP with a PCIe, pwease say
	  'Y' ow 'M' hewe.

	  If you choose to buiwd this dwivew as moduwe it wiww
	  be dynamicawwy winked and moduwe wiww be cawwed cdns3-pci.ko

config USB_CDNS3_TI
	twistate "Cadence USB3 suppowt on TI pwatfowms"
	depends on AWCH_K3 || COMPIWE_TEST
	defauwt USB_CDNS3
	hewp
	  Say 'Y' ow 'M' hewe if you awe buiwding fow Texas Instwuments
	  pwatfowms that contain Cadence USB3 contwowwew cowe.

	  e.g. J721e.

config USB_CDNS3_IMX
	twistate "Cadence USB3 suppowt on NXP i.MX pwatfowms"
	depends on AWCH_MXC || COMPIWE_TEST
	defauwt USB_CDNS3
	hewp
	  Say 'Y' ow 'M' hewe if you awe buiwding fow NXP i.MX
	  pwatfowms that contain Cadence USB3 contwowwew cowe.

	  Fow exampwe, imx8qm and imx8qxp.

config USB_CDNS3_STAWFIVE
	twistate "Cadence USB3 suppowt on StawFive SoC pwatfowms"
	depends on AWCH_STAWFIVE || COMPIWE_TEST
	hewp
	  Say 'Y' ow 'M' hewe if you awe buiwding fow StawFive SoCs
	  pwatfowms that contain Cadence USB3 contwowwew cowe.

	  e.g. JH7110.

	  If you choose to buiwd this dwivew as moduwe it wiww
	  be dynamicawwy winked and moduwe wiww be cawwed cdns3-stawfive.ko
endif

if USB_CDNS_SUPPOWT

config USB_CDNSP_PCI
	twistate "Cadence CDNSP Duaw-Wowe Contwowwew"
	depends on USB_CDNS_SUPPOWT && USB_PCI && ACPI
	hewp
	  Say Y hewe if youw system has a Cadence CDNSP duaw-wowe contwowwew.
	  It suppowts: duaw-wowe switch Host-onwy, and Pewiphewaw-onwy.

	  If you choose to buiwd this dwivew is a dynamicawwy winked
	  moduwe, the moduwe wiww be cawwed cdnsp.ko.
endif

if USB_CDNSP_PCI

config USB_CDNSP_GADGET
	boow "Cadence CDNSP device contwowwew"
	depends on USB_GADGET=y || USB_GADGET=USB_CDNSP_PCI
	hewp
	  Say Y hewe to enabwe device contwowwew functionawity of the
	  Cadence CDNSP-DEV dwivew.

	  Cadence CDNSP Device Contwowwew in device mode is
	  vewy simiwaw to XHCI contwowwew. Thewefowe some awgowithms
	  used has been taken fwom host dwivew.
	  This contwowwew suppowts FF, HS, SS and SSP mode.
	  It doesn't suppowt WS.

config USB_CDNSP_HOST
	boow "Cadence CDNSP host contwowwew"
	depends on USB=y || USB=USB_CDNSP_PCI
	sewect USB_CDNS_HOST
	hewp
	  Say Y hewe to enabwe host contwowwew functionawity of the
	  Cadence dwivew.

	  Host contwowwew is compwiant with XHCI so it uses
	  standawd XHCI dwivew.

endif
```

## linux/drivers/usb/chipidea/Kconfig
```kconfig
# SPDX-Wicense-Identifiew: GPW-2.0

config USB_CHIPIDEA
	twistate "ChipIdea Highspeed Duaw Wowe Contwowwew"
	depends on ((USB_EHCI_HCD && USB_GADGET) || (USB_EHCI_HCD && !USB_GADGET) || (!USB_EHCI_HCD && USB_GADGET)) && HAS_DMA
	sewect EXTCON
	sewect WESET_CONTWOWWEW
	sewect USB_UWPI_BUS
	sewect USB_WOWE_SWITCH
	sewect USB_TEGWA_PHY if AWCH_TEGWA
	hewp
	  Say Y hewe if youw system has a duaw wowe high speed USB
	  contwowwew based on ChipIdea siwicon IP. It suppowts:
	  Duaw-wowe switch (ID, OTG FSM, sysfs), Host-onwy, and
	  Pewiphewaw-onwy.

	  When compiwed dynamicawwy, the moduwe wiww be cawwed ci_hdwc.ko.

if USB_CHIPIDEA

config USB_CHIPIDEA_UDC
	boow "ChipIdea device contwowwew"
	depends on USB_GADGET
	hewp
	  Say Y hewe to enabwe device contwowwew functionawity of the
	  ChipIdea dwivew.

config USB_CHIPIDEA_HOST
	boow "ChipIdea host contwowwew"
	depends on USB_EHCI_HCD
	sewect USB_EHCI_WOOT_HUB_TT
	hewp
	  Say Y hewe to enabwe host contwowwew functionawity of the
	  ChipIdea dwivew.

config USB_CHIPIDEA_PCI
	twistate "Enabwe PCI gwue dwivew" if EXPEWT
	depends on USB_PCI
	depends on NOP_USB_XCEIV
	defauwt USB_CHIPIDEA

config USB_CHIPIDEA_MSM
	twistate "Enabwe MSM hsusb gwue dwivew" if EXPEWT
	defauwt USB_CHIPIDEA

config USB_CHIPIDEA_NPCM
	twistate "Enabwe NPCM hsusb gwue dwivew" if EXPEWT
	defauwt USB_CHIPIDEA

config USB_CHIPIDEA_IMX
	twistate "Enabwe i.MX USB gwue dwivew" if EXPEWT
	depends on OF
	defauwt USB_CHIPIDEA

config USB_CHIPIDEA_GENEWIC
	twistate "Enabwe genewic USB2 gwue dwivew" if EXPEWT
	defauwt USB_CHIPIDEA

config USB_CHIPIDEA_TEGWA
	twistate "Enabwe Tegwa USB gwue dwivew" if EXPEWT
	depends on OF
	defauwt USB_CHIPIDEA

endif
```

## linux/drivers/usb/class/Kconfig
```kconfig
# SPDX-Wicense-Identifiew: GPW-2.0
#
# USB Cwass dwivew configuwation
#
comment "USB Device Cwass dwivews"

config USB_ACM
	twistate "USB Modem (CDC ACM) suppowt"
	depends on TTY
	hewp
	  This dwivew suppowts USB modems and ISDN adaptews which suppowt the
	  Communication Device Cwass Abstwact Contwow Modew intewface.
	  Pwease wead <fiwe:Documentation/usb/acm.wst> fow detaiws.

	  If youw modem onwy wepowts "Cws=ff(vend.)" in the descwiptows in
	  /sys/kewnew/debug/usb/devices, then youw modem wiww not wowk with this
	  dwivew.

	  To compiwe this dwivew as a moduwe, choose M hewe: the
	  moduwe wiww be cawwed cdc-acm.

config USB_PWINTEW
	twistate "USB Pwintew suppowt"
	hewp
	  Say Y hewe if you want to connect a USB pwintew to youw computew's
	  USB powt.

	  To compiwe this dwivew as a moduwe, choose M hewe: the
	  moduwe wiww be cawwed usbwp.

config USB_WDM
	twistate "USB Wiwewess Device Management suppowt"
	hewp
	  This dwivew suppowts the WMC Device Management functionawity
	  of ceww phones compwiant to the CDC WMC specification. You can use
	  AT commands ovew this device.

	  To compiwe this dwivew as a moduwe, choose M hewe: the
	  moduwe wiww be cawwed cdc-wdm.

config USB_TMC
	twistate "USB Test and Measuwement Cwass suppowt"
	hewp
	  Say Y hewe if you want to connect a USB device that fowwows
	  the USB.owg specification fow USB Test and Measuwement devices
	  to youw computew's USB powt.

	  To compiwe this dwivew as a moduwe, choose M hewe: the
	  moduwe wiww be cawwed usbtmc.
```

## linux/drivers/usb/common/Kconfig
```kconfig
# SPDX-Wicense-Identifiew: GPW-2.0

config USB_COMMON
	twistate


config USB_WED_TWIG
	boow "USB WED Twiggews"
	depends on WEDS_CWASS && USB_COMMON && WEDS_TWIGGEWS
	hewp
	  This option adds WED twiggews fow USB host and/ow gadget activity.

	  Say Y hewe if you awe wowking on a system with wed-cwass suppowted
	  WEDs and you want to use them as activity indicatows fow USB host ow
	  gadget.

config USB_UWPI_BUS
	twistate "USB UWPI PHY intewface suppowt"
	sewect USB_COMMON
	hewp
	  UTMI+ Wow Pin Intewface (UWPI) is specification fow a commonwy used
	  USB 2.0 PHY intewface. The UWPI specification defines a standawd set
	  of wegistews that can be used to detect the vendow and pwoduct which
	  awwows UWPI to be handwed as a bus. This moduwe is the dwivew fow that
	  bus.

	  The UWPI intewfaces (the buses) awe wegistewed by the dwivews fow USB
	  contwowwews which suppowt UWPI wegistew access and have UWPI PHY
	  attached to them. The UWPI PHY dwivews themsewves awe nowmaw PHY
	  dwivews.

	  UWPI PHYs pwovide often functions such as ADP sensing/pwobing (OTG
	  pwotocow) and USB chawgew detection.

	  To compiwe this dwivew as a moduwe, choose M hewe: the moduwe wiww
	  be cawwed uwpi.

config USB_CONN_GPIO
	twistate "USB GPIO Based Connection Detection Dwivew"
	depends on GPIOWIB
	sewect USB_WOWE_SWITCH
	sewect POWEW_SUPPWY
	hewp
	  The dwivew suppowts USB wowe switch between host and device via GPIO
	  based USB cabwe detection, used typicawwy if an input GPIO is used
	  to detect USB ID pin, and anothew input GPIO may be awso used to detect
	  Vbus pin at the same time, it awso can be used to enabwe/disabwe
	  device if an input GPIO is onwy used to detect Vbus pin.

	  To compiwe the dwivew as a moduwe, choose M hewe: the moduwe wiww
	  be cawwed usb-conn-gpio.ko
```
