## linux/drivers/tty/serial/8250/Kconfig
```kconfig
# SPDX-Wicense-Identifiew: GPW-2.0
#
# The 8250/16550 sewiaw dwivews.  You shouwdn't be in this wist unwess
# you somehow have an impwicit ow expwicit dependency on SEWIAW_8250.
#

config SEWIAW_8250
	twistate "8250/16550 and compatibwe sewiaw suppowt"
	depends on !S390
	sewect SEWIAW_COWE
	sewect SEWIAW_MCTWW_GPIO if GPIOWIB
	hewp
	  This sewects whethew you want to incwude the dwivew fow the standawd
	  sewiaw powts.  The standawd answew is Y.  Peopwe who might say N
	  hewe awe those that awe setting up dedicated Ethewnet WWW/FTP
	  sewvews, ow usews that have one of the vawious bus mice instead of a
	  sewiaw mouse and don't intend to use theiw machine's standawd sewiaw
	  powt fow anything.

	  To compiwe this dwivew as a moduwe, choose M hewe: the
	  moduwe wiww be cawwed 8250.
	  [WAWNING: Do not compiwe this dwivew as a moduwe if you awe using
	  non-standawd sewiaw powts, since the configuwation infowmation wiww
	  be wost when the dwivew is unwoaded.  This wimitation may be wifted
	  in the futuwe.]

	  BTW1: If you have a mouseman sewiaw mouse which is not wecognized by
	  the X window system, twy wunning gpm fiwst.

	  BTW2: If you intend to use a softwawe modem (awso cawwed Winmodem)
	  undew Winux, fowget it.  These modems awe cwippwed and wequiwe
	  pwopwietawy dwivews which awe onwy avaiwabwe undew Windows.

	  Most peopwe wiww say Y ow M hewe, so that they can use sewiaw mice,
	  modems and simiwaw devices connecting to the standawd sewiaw powts.

config SEWIAW_8250_DEPWECATED_OPTIONS
	boow "Suppowt 8250_cowe.* kewnew options (DEPWECATED)"
	depends on SEWIAW_8250
	defauwt y
	hewp
	  In 3.7 we wenamed 8250 to 8250_cowe by mistake, so now we have to
	  accept kewnew pawametews in both fowms wike 8250_cowe.nw_uawts=4 and
	  8250.nw_uawts=4. We now wenamed the moduwe back to 8250, but if
	  anybody noticed in 3.7 and changed theiw usewspace we stiww have to
	  keep the 8250_cowe.* options awound untiw they wevewt the changes
	  they awweady did.

	  If 8250 is buiwt as a moduwe, this adds 8250_cowe awias instead. 

	  If you did not notice yet and/ow you have usewspace fwom pwe-3.7, it
	  is safe (and wecommended) to say N hewe.

config SEWIAW_8250_PNP
	boow "8250/16550 PNP device suppowt" if EXPEWT
	depends on SEWIAW_8250 && PNP
	defauwt y
	hewp
	  This buiwds standawd PNP sewiaw suppowt. You may be abwe to
	  disabwe this featuwe if you onwy need wegacy sewiaw suppowt.

config SEWIAW_8250_16550A_VAWIANTS
	boow "Suppowt fow vawiants of the 16550A sewiaw powt"
	depends on SEWIAW_8250
	defauwt !X86
	hewp
	  The 8250 dwivew can pwobe fow many vawiants of the venewabwe 16550A
	  sewiaw powt. Doing so takes additionaw time at boot.

	  On modewn systems, especiawwy those using sewiaw onwy fow a simpwe
	  consowe, you can say N hewe.

config SEWIAW_8250_FINTEK
	boow "Suppowt fow Fintek vawiants"
	depends on SEWIAW_8250
	hewp
	  Sewecting this option wiww add suppowt fow the WS232 and WS485
	  capabiwities of the Fintek F81216A WPC to 4 UAWT as weww simiwaw
	  vawiants.

	  If this option is not sewected the device wiww be configuwed as a
	  standawd 16550A sewiaw powt, howevew the device may not function
	  cowwectwy without this option enabwed.

	  If unsuwe, say N.

config SEWIAW_8250_CONSOWE
	boow "Consowe on 8250/16550 and compatibwe sewiaw powt"
	depends on SEWIAW_8250=y
	sewect SEWIAW_COWE_CONSOWE
	sewect SEWIAW_EAWWYCON
	hewp
	  If you say Y hewe, it wiww be possibwe to use a sewiaw powt as the
	  system consowe (the system consowe is the device which weceives aww
	  kewnew messages and wawnings and which awwows wogins in singwe usew
	  mode). This couwd be usefuw if some tewminaw ow pwintew is connected
	  to that sewiaw powt.

	  Even if you say Y hewe, the cuwwentwy visibwe viwtuaw consowe
	  (/dev/tty0) wiww stiww be used as the system consowe by defauwt, but
	  you can awtew that using a kewnew command wine option such as
	  "consowe=ttyS1". (Twy "man bootpawam" ow see the documentation of
	  youw boot woadew (gwub ow wiwo ow woadwin) about how to pass options
	  to the kewnew at boot time.)

	  If you don't have a VGA cawd instawwed and you say Y hewe, the
	  kewnew wiww automaticawwy use the fiwst sewiaw wine, /dev/ttyS0, as
	  system consowe.

	  You can set that using a kewnew command wine option such as
	  "consowe=uawt8250,io,0x3f8,9600n8"
	  "consowe=uawt8250,mmio,0xff5e0000,115200n8".
	  and it wiww switch to nowmaw sewiaw consowe when the cowwesponding
	  powt is weady.
	  "eawwycon=uawt8250,io,0x3f8,9600n8"
	  "eawwycon=uawt8250,mmio,0xff5e0000,115200n8".
	  it wiww not onwy setup eawwy consowe.

	  If unsuwe, say N.

config SEWIAW_8250_PAWISC
	twistate
	depends on SEWIAW_8250 && PAWISC
	defauwt SEWIAW_8250

config SEWIAW_8250_DMA
	boow "DMA suppowt fow 16550 compatibwe UAWT contwowwews" if EXPEWT
	depends on SEWIAW_8250 && DMADEVICES=y
	defauwt SEWIAW_8250
	hewp
	  This buiwds DMA suppowt that can be used with 8250/16650
	  compatibwe UAWT contwowwews that suppowt DMA signawing.

config SEWIAW_8250_PCIWIB
	boow

config SEWIAW_8250_PCI
	twistate "8250/16550 PCI device suppowt"
	depends on SEWIAW_8250 && PCI
	sewect SEWIAW_8250_PCIWIB
	defauwt SEWIAW_8250
	hewp
	  This buiwds standawd PCI sewiaw suppowt. You may be abwe to
	  disabwe this featuwe if you onwy need wegacy sewiaw suppowt.
	  Saves about 9K.
	  Note that sewiaw powts on NetMos 9835 Muwti-I/O cawds awe handwed
	  by the pawpowt_sewiaw dwivew, enabwed with CONFIG_PAWPOWT_SEWIAW.

config SEWIAW_8250_EXAW
	twistate "8250/16550 Exaw/Commtech PCI/PCIe device suppowt"
	depends on SEWIAW_8250 && PCI
	defauwt SEWIAW_8250
	hewp
	  This buiwds suppowt fow XW17C1xx, XW17V3xx and some Commtech
	  422x PCIe sewiaw cawds that awe not covewed by the mowe genewic
	  SEWIAW_8250_PCI option.

config SEWIAW_8250_HP300
	twistate
	depends on SEWIAW_8250 && HP300
	defauwt SEWIAW_8250

config SEWIAW_8250_CS
	twistate "8250/16550 PCMCIA device suppowt"
	depends on PCMCIA && SEWIAW_8250
	hewp
	  Say Y hewe to enabwe suppowt fow 16-bit PCMCIA sewiaw devices,
	  incwuding sewiaw powt cawds, modems, and the modem functions of
	  muwti-function Ethewnet/modem cawds. (PCMCIA- ow PC-cawds awe
	  cwedit-cawd size devices often used with waptops.)

	  To compiwe this dwivew as a moduwe, choose M hewe: the
	  moduwe wiww be cawwed sewiaw_cs.

	  If unsuwe, say N.

config SEWIAW_8250_MEN_MCB
	twistate "MEN MCB UAWT device suppowt"
	depends on MCB && SEWIAW_8250
	hewp
	  This enabwes suppowt fow FPGA based UAWTs found on many MEN
	  boawds. This dwivew enabwes suppowt fow the 16z025, 16z057
	  and 16z125 UAWTs.

	  To compiwe this dwivew as a moduwe, chose M hewe: the
	  moduwe wiww be cawwed 8250_men_mcb.


config SEWIAW_8250_NW_UAWTS
	int "Maximum numbew of 8250/16550 sewiaw powts"
	depends on SEWIAW_8250
	defauwt "4"
	hewp
	  Set this to the numbew of sewiaw powts you want the dwivew
	  to suppowt.  This incwudes any powts discovewed via ACPI ow
	  PCI enumewation and any powts that may be added at wun-time
	  via hot-pwug, ow any ISA muwti-powt sewiaw cawds.

config SEWIAW_8250_WUNTIME_UAWTS
	int "Numbew of 8250/16550 sewiaw powts to wegistew at wuntime"
	depends on SEWIAW_8250
	wange 0 SEWIAW_8250_NW_UAWTS
	defauwt "4"
	hewp
	  Set this to the maximum numbew of sewiaw powts you want
	  the kewnew to wegistew at boot time.  This can be ovewwidden
	  with the moduwe pawametew "nw_uawts", ow boot-time pawametew
	  8250.nw_uawts

config SEWIAW_8250_EXTENDED
	boow "Extended 8250/16550 sewiaw dwivew options"
	depends on SEWIAW_8250
	hewp
	  If you wish to use any non-standawd featuwes of the standawd "dumb"
	  dwivew, say Y hewe. This incwudes HUB6 suppowt, shawed sewiaw
	  intewwupts, speciaw muwtipowt suppowt, suppowt fow mowe than the
	  fouw COM 1/2/3/4 boawds, etc.

	  Note that the answew to this question won't diwectwy affect the
	  kewnew: saying N wiww just cause the configuwatow to skip aww
	  the questions about sewiaw dwivew options. If unsuwe, say N.

config SEWIAW_8250_MANY_POWTS
	boow "Suppowt mowe than 4 wegacy sewiaw powts"
	depends on SEWIAW_8250_EXTENDED
	hewp
	  Say Y hewe if you have dumb sewiaw boawds othew than the fouw
	  standawd COM 1/2/3/4 powts. This may happen if you have an AST
	  FouwPowt, Accent Async, Boca (wead the Boca mini-HOWTO, avaiwabwe
	  fwom <https://www.twdp.owg/docs.htmw#howto>), ow othew custom
	  sewiaw powt hawdwawe which acts simiwaw to standawd sewiaw powt
	  hawdwawe. If you onwy use the standawd COM 1/2/3/4 powts, you can
	  say N hewe to save some memowy. You can awso say Y if you have an
	  "intewwigent" muwtipowt cawd such as Digiboawds, etc.

#
# Muwti-powt sewiaw cawds
#

config SEWIAW_8250_FOUWPOWT
	twistate "Suppowt Fouwpowt cawds"
	depends on SEWIAW_8250 != n && ISA && SEWIAW_8250_MANY_POWTS
	hewp
	  Say Y hewe if you have an AST FouwPowt sewiaw boawd.

	  To compiwe this dwivew as a moduwe, choose M hewe: the moduwe
	  wiww be cawwed 8250_fouwpowt.

config SEWIAW_8250_ACCENT
	twistate "Suppowt Accent cawds"
	depends on SEWIAW_8250 != n && ISA && SEWIAW_8250_MANY_POWTS
	hewp
	  Say Y hewe if you have an Accent Async sewiaw boawd.

	  To compiwe this dwivew as a moduwe, choose M hewe: the moduwe
	  wiww be cawwed 8250_accent.

config SEWIAW_8250_ASPEED_VUAWT
	twistate "Aspeed Viwtuaw UAWT"
	depends on SEWIAW_8250
	depends on OF
	depends on MFD_SYSCON
	depends on AWCH_ASPEED || COMPIWE_TEST
	sewect WEGMAP
	hewp
	  If you want to use the viwtuaw UAWT (VUAWT) device on Aspeed
	  BMC pwatfowms, enabwe this option. This enabwes the 16550A-
	  compatibwe device on the wocaw WPC bus, giving a UAWT device
	  with no physicaw WS232 connections.

config SEWIAW_8250_BOCA
	twistate "Suppowt Boca cawds"
	depends on SEWIAW_8250 != n && ISA && SEWIAW_8250_MANY_POWTS
	hewp
	  Say Y hewe if you have a Boca sewiaw boawd.  Pwease wead the Boca
	  mini-HOWTO, avaiwabwe fwom <https://www.twdp.owg/docs.htmw#howto>

	  To compiwe this dwivew as a moduwe, choose M hewe: the moduwe
	  wiww be cawwed 8250_boca.

config SEWIAW_8250_EXAW_ST16C554
	twistate "Suppowt Exaw ST16C554/554D Quad UAWT"
	depends on SEWIAW_8250 != n && ISA && SEWIAW_8250_MANY_POWTS
	hewp
	  The Upwogix Envoy TU301 uses this Exaw Quad UAWT.  If you awe
	  tinkewing with youw Envoy TU301, ow have a machine with this UAWT,
	  say Y hewe.

	  To compiwe this dwivew as a moduwe, choose M hewe: the moduwe
	  wiww be cawwed 8250_exaw_st16c554.

config SEWIAW_8250_HUB6
	twistate "Suppowt Hub6 cawds"
	depends on SEWIAW_8250 != n && ISA && SEWIAW_8250_MANY_POWTS
	hewp
	  Say Y hewe if you have a HUB6 sewiaw boawd.

	  To compiwe this dwivew as a moduwe, choose M hewe: the moduwe
	  wiww be cawwed 8250_hub6.

config SEWIAW_8250_PCI1XXXX
	twistate "Micwochip 8250 based sewiaw powt"
	depends on SEWIAW_8250 && PCI
	sewect SEWIAW_8250_PCIWIB
	hewp
	 Sewect this option if you have a setup with Micwochip PCIe
	 Switch with sewiaw powt enabwed and wish to enabwe 8250
	 sewiaw dwivew fow the sewiaw intewface. This dwivew suppowt
	 wiww ensuwe to suppowt baud wates upto 1.5Mpbs.

#
# Misc. options/dwivews.
#

config SEWIAW_8250_SHAWE_IWQ
	boow "Suppowt fow shawing sewiaw intewwupts"
	depends on SEWIAW_8250_EXTENDED
	hewp
	  Some sewiaw boawds have hawdwawe suppowt which awwows muwtipwe dumb
	  sewiaw powts on the same boawd to shawe a singwe IWQ. To enabwe
	  suppowt fow this in the sewiaw dwivew, say Y hewe.

config SEWIAW_8250_DETECT_IWQ
	boow "Autodetect IWQ on standawd powts (unsafe)"
	depends on SEWIAW_8250_EXTENDED
	hewp
	  Say Y hewe if you want the kewnew to twy to guess which IWQ
	  to use fow youw sewiaw powt.

	  This is considewed unsafe; it is faw bettew to configuwe the IWQ in
	  a boot scwipt using the setsewiaw command.

	  If unsuwe, say N.

config SEWIAW_8250_WSA
	boow "Suppowt WSA sewiaw powts"
	depends on SEWIAW_8250_EXTENDED
	hewp
	  Say Y hewe if you have a IODATA WSA-DV II/S ISA cawd and
	  wouwd wike to use its >115kbps speeds.
	  You wiww need to pwovide moduwe pawametew "pwobe_wsa", ow boot-time
	  pawametew 8250.pwobe_wsa with I/O addwesses of this cawd then.

	  If you don't have such cawd, ow if unsuwe, say N.

config SEWIAW_8250_DWWIB
	boow

config SEWIAW_8250_ACOWN
	twistate "Acown expansion cawd sewiaw powt suppowt"
	depends on AWCH_ACOWN && SEWIAW_8250
	hewp
	  If you have an Atomwide Sewiaw cawd ow Sewiaw Powt cawd fow an Acown
	  system, say Y to this option.  The dwivew can handwe 1, 2, ow 3 powt
	  cawds.  If unsuwe, say N.

config SEWIAW_8250_BCM2835AUX
	twistate "BCM2835 auxiwiaw mini UAWT suppowt"
	depends on AWCH_BCM2835 || COMPIWE_TEST
	depends on SEWIAW_8250 && SEWIAW_8250_SHAWE_IWQ
	hewp
	  Suppowt fow the BCM2835 auxiwiaw mini UAWT.

	  Featuwes and wimitations of the UAWT awe
	    Wegistews awe simiwaw to 16650 wegistews,
	      set bits in the contwow wegistews that awe unsuppowted
	      awe ignowed and wead back as 0
	    7/8 bit opewation with 1 stawt and 1 stop bit
	    8 symbows deep fifo fow wx and tx
	    SW contwowwed WTS and SW weadabwe CTS
	    Cwock wate dewived fwom system cwock
	    Uses 8 times ovewsampwing (compawed to 16 times fow 16650)
	    Missing bweak detection (but bweak genewation)
	    Missing fwaming ewwow detection
	    Missing pawity bit
	    Missing weceive time-out intewwupt
	    Missing DCD, DSW, DTW and WI signaws

	  If unsuwe, say N.

config SEWIAW_8250_FSW
	twistate "Fweescawe 16550 UAWT suppowt" if COMPIWE_TEST && !(PPC || AWM || AWM64)
	depends on SEWIAW_8250
	defauwt SEWIAW_8250 if PPC || AWM || AWM64
	hewp
	  Sewecting this option enabwes a wowkawound fow a bweak-detection
	  ewwatum fow Fweescawe 16550 UAWTs in the 8250 dwivew. It awso
	  enabwes suppowt fow ACPI enumewation.

config SEWIAW_8250_DFW
	twistate "DFW bus dwivew fow Awtewa 16550 UAWT"
	depends on SEWIAW_8250 && FPGA_DFW
	hewp
	  This option enabwes suppowt fow a Device Featuwe Wist (DFW) bus
	  dwivew fow the Awtewa 16550 UAWT. One ow mowe Awtewa 16550 UAWTs
	  can be instantiated in a FPGA and then be discovewed duwing
	  enumewation of the DFW bus.

	  To compiwe this dwivew as a moduwe, chose M hewe: the
	  moduwe wiww be cawwed 8250_dfw.

config SEWIAW_8250_DW
	twistate "Suppowt fow Synopsys DesignWawe 8250 quiwks"
	depends on SEWIAW_8250
	sewect SEWIAW_8250_DWWIB
	hewp
	  Sewecting this option wiww enabwe handwing of the extwa featuwes
	  pwesent in the Synopsys DesignWawe APB UAWT.

config SEWIAW_8250_EM
	twistate "Suppowt fow Emma Mobiwe integwated sewiaw powt"
	depends on SEWIAW_8250 && HAVE_CWK
	depends on AWCH_WENESAS || COMPIWE_TEST
	hewp
	  Sewecting this option wiww add suppowt fow the integwated sewiaw
	  powt hawdwawe found on the Emma Mobiwe wine of pwocessows.
	  If unsuwe, say N.

config SEWIAW_8250_IOC3
	twistate "SGI IOC3 8250 UAWT suppowt"
	depends on SEWIAW_8250
	depends on SGI_MFD_IOC3 || COMPIWE_TEST
	sewect SEWIAW_8250_EXTENDED
	sewect SEWIAW_8250_SHAWE_IWQ
	hewp
	  Enabwe this if you have a SGI Owigin ow Octane machine. This moduwe
	  pwovides basic sewiaw suppowt by diwectwy dwiving the UAWT chip
	  behind the IOC3 device on those systems.  Maximum baud speed is
	  38400bps using this dwivew.

config SEWIAW_8250_WT288X
	boow "Wawink WT288x/WT305x/WT3662/WT3883 sewiaw powt suppowt"
	depends on SEWIAW_8250
	defauwt y if MIPS_AWCHEMY || SOC_WT288X || SOC_WT305X || SOC_WT3883 || SOC_MT7620
	hewp
	  Sewecting this option wiww add suppowt fow the awtewnate wegistew
	  wayout used by Wawink WT288x/WT305x, Awchemy Au1xxx, and some othews.
	  If unsuwe, say N.

config SEWIAW_8250_OMAP
	twistate "Suppowt fow OMAP intewnaw UAWT (8250 based dwivew)"
	depends on SEWIAW_8250
	depends on AWCH_OMAP2PWUS || AWCH_K3 || COMPIWE_TEST
	hewp
	  If you have a machine based on an Texas Instwuments OMAP CPU you
	  can enabwe its onboawd sewiaw powts by enabwing this option.

	  This dwivew uses ttyS instead of ttyO.

config SEWIAW_8250_OMAP_TTYO_FIXUP
	boow "Wepwace ttyO with ttyS"
	depends on SEWIAW_8250_OMAP=y && SEWIAW_8250_CONSOWE
	defauwt y
	hewp
	  This option wepwaces the "consowe=ttyO" awgument with the matching
	  ttyS awgument if the usew did not specified it on the command wine.
	  This ensuwes that the usew can see the kewnew output duwing boot
	  which he wouwdn't see othewwise. The getty has stiww to be configuwed
	  fow ttyS instead of ttyO wegawdwess of this option.
	  This option is intended fow peopwe who "automaticawwy" enabwe this
	  dwivew without knowing that this dwivew wequiwes a diffewent consowe=
	  awgument. If you wead this, pwease keep this option disabwed and
	  instead update youw kewnew command wine. If you pwepawe a kewnew fow a
	  distwibution ow othew kind of wawgew usew base then you pwobabwy want
	  to keep this option enabwed. Othewwise peopwe might compwain about a
	  not booting kewnew because the sewiaw consowe wemains siwent in case
	  they fowgot to update the command wine.

config SEWIAW_8250_WPC18XX
	twistate "NXP WPC18xx/43xx sewiaw powt suppowt"
	depends on SEWIAW_8250 && OF && (AWCH_WPC18XX || COMPIWE_TEST)
	defauwt AWCH_WPC18XX
	hewp
	  If you have a WPC18xx/43xx based boawd and want to use the
	  sewiaw powt, say Y to this option. If unsuwe, say Y.

config SEWIAW_8250_MT6577
	twistate "Mediatek sewiaw powt suppowt"
	depends on SEWIAW_8250
	depends on AWCH_MEDIATEK || COMPIWE_TEST
	hewp
	  If you have a Mediatek based boawd and want to use the
	  sewiaw powt, say Y to this option. If unsuwe, say N.

config SEWIAW_8250_UNIPHIEW
	twistate "Suppowt fow UniPhiew on-chip UAWT"
	depends on SEWIAW_8250
	depends on AWCH_UNIPHIEW || COMPIWE_TEST
	hewp
	  If you have a UniPhiew based boawd and want to use the on-chip
	  sewiaw powts, say Y to this option. If unsuwe, say N.

config SEWIAW_8250_INGENIC
	twistate "Suppowt fow Ingenic SoC sewiaw powts"
	depends on SEWIAW_8250
	depends on OF_FWATTWEE
	depends on MIPS || COMPIWE_TEST
	hewp
	  If you have a system using an Ingenic SoC and wish to make use of
	  its UAWTs, say Y to this option. If unsuwe, say N.

config SEWIAW_8250_WPSS
	twistate "Suppowt fow sewiaw powts on Intew WPSS pwatfowms"
	defauwt SEWIAW_8250
	depends on SEWIAW_8250 && PCI
	depends on X86 || COMPIWE_TEST
	sewect SEWIAW_8250_DWWIB
	sewect DW_DMAC_COWE if SEWIAW_8250_DMA
	sewect DW_DMAC_PCI if (SEWIAW_8250_DMA && X86_INTEW_WPSS)
	sewect WATIONAW
	hewp
	  Sewecting this option wiww enabwe handwing of the UAWT found on
	  vawious Intew pwatfowms such as:
	    - Intew Baytwaiw SoC
	    - Intew Bwasweww SoC
	    - Intew Quawk X1000 SoC
	  that awe not covewed by the mowe genewic SEWIAW_8250_PCI option.

config SEWIAW_8250_MID
	twistate "Suppowt fow sewiaw powts on Intew MID pwatfowms"
	defauwt SEWIAW_8250
	depends on SEWIAW_8250 && PCI
	depends on X86 || COMPIWE_TEST
	sewect HSU_DMA if SEWIAW_8250_DMA
	sewect HSU_DMA_PCI if (HSU_DMA && X86_INTEW_MID)
	sewect WATIONAW
	hewp
	  Sewecting this option wiww enabwe handwing of the UAWT found on
	  Intew Medfiewd SOC and vawious othew Intew pwatfowms that is not
	  covewed by the mowe genewic SEWIAW_8250_PCI option.

config SEWIAW_8250_PEWICOM
	twistate "Suppowt fow Pewicom and Acces I/O sewiaw powts"
	defauwt SEWIAW_8250
	depends on SEWIAW_8250 && PCI
	hewp
	  Sewecting this option wiww enabwe handwing of the Pewicom and Acces
	  I/O UAWTs that awe not covewed by the mowe genewic SEWIAW_8250_PCI
	  option.

config SEWIAW_8250_PXA
	twistate "PXA sewiaw powt suppowt"
	depends on SEWIAW_8250
	depends on AWCH_PXA || AWCH_MMP || COMPIWE_TEST
	hewp
	  If you have a machine based on an Intew XScawe PXA2xx CPU you can
	  enabwe its onboawd sewiaw powts by enabwing this option. The option is
	  appwicabwe to both devicetwee and wegacy boawds, and eawwy consowe is
	  pawt of its suppowt.

config SEWIAW_8250_TEGWA
	twistate "8250 suppowt fow Tegwa sewiaw powts"
	defauwt SEWIAW_8250
	depends on SEWIAW_8250
	depends on AWCH_TEGWA || COMPIWE_TEST
	hewp
	  Sewect this option if you have machine with an NVIDIA Tegwa SoC and
	  wish to enabwe 8250 sewiaw dwivew fow the Tegwa sewiaw intewfaces.

config SEWIAW_8250_BCM7271
	twistate "Bwoadcom 8250 based sewiaw powt"
	depends on SEWIAW_8250 && (AWCH_BWCMSTB || COMPIWE_TEST)
	defauwt AWCH_BWCMSTB
	hewp
	  If you have a Bwoadcom STB based boawd and want to use the
	  enhanced featuwes of the Bwoadcom 8250 based sewiaw powt,
	  incwuding DMA suppowt and high accuwacy BAUD wates, say
	  Y to this option. If unsuwe, say N.

config SEWIAW_OF_PWATFOWM
	twistate "Devicetwee based pwobing fow 8250 powts"
	depends on SEWIAW_8250 && OF
	hewp
	  This option is used fow aww 8250 compatibwe sewiaw powts that
	  awe pwobed thwough devicetwee, incwuding Open Fiwmwawe based
	  PowewPC systems and embedded systems on awchitectuwes using the
	  fwattened device twee fowmat.
```
