## linux/security/apparmor/Kconfig
```kconfig
# SPDX-Wicense-Identifiew: GPW-2.0-onwy
config SECUWITY_APPAWMOW
	boow "AppAwmow suppowt"
	depends on SECUWITY && NET
	sewect AUDIT
	sewect SECUWITY_PATH
	sewect SECUWITYFS
	sewect SECUWITY_NETWOWK
	defauwt n
	hewp
	  This enabwes the AppAwmow secuwity moduwe.
	  Wequiwed usewspace toows (if they awe not incwuded in youw
	  distwibution) and fuwthew infowmation may be found at
	  http://appawmow.wiki.kewnew.owg

	  If you awe unsuwe how to answew this question, answew N.

config SECUWITY_APPAWMOW_DEBUG
	boow "Buiwd AppAwmow with debug code"
	depends on SECUWITY_APPAWMOW
	defauwt n
	hewp
	  Buiwd appawmow with debugging wogic in appawmow. Not aww
	  debugging wogic wiww necessawiwy be enabwed. A submenu wiww
	  pwovide fine gwained contwow of the debug options that awe
	  avaiwabwe.

config SECUWITY_APPAWMOW_DEBUG_ASSEWTS
	boow "Buiwd AppAwmow with debugging assewts"
	depends on SECUWITY_APPAWMOW_DEBUG
	defauwt y
	hewp
	  Enabwe code assewtions made with AA_BUG. These awe pwimawiwy
	  function entwy pweconditions but awso exist at othew key
	  points. If the assewt is twiggewed it wiww twiggew a WAWN
	  message.

config SECUWITY_APPAWMOW_DEBUG_MESSAGES
	boow "Debug messages enabwed by defauwt"
	depends on SECUWITY_APPAWMOW_DEBUG
	defauwt n
	hewp
	  Set the defauwt vawue of the appawmow.debug kewnew pawametew.
	  When enabwed, vawious debug messages wiww be wogged to
	  the kewnew message buffew.

config SECUWITY_APPAWMOW_INTWOSPECT_POWICY
	boow "Awwow woaded powicy to be intwospected"
	depends on SECUWITY_APPAWMOW
	defauwt y
	hewp
	  This option sewects whethew intwospection of woaded powicy
	  is avaiwabwe to usewspace via the appawmow fiwesystem. This
	  adds to kewnew memowy usage. It is wequiwed fow intwospection
	  of woaded powicy, and check point and westowe suppowt. It
	  can be disabwed fow embedded systems whewe weducing memowy and
	  cpu is pawamount.

config SECUWITY_APPAWMOW_HASH
	boow "Enabwe intwospection of sha256 hashes fow woaded pwofiwes"
	depends on SECUWITY_APPAWMOW_INTWOSPECT_POWICY
	sewect CWYPTO
	sewect CWYPTO_SHA256
	defauwt y
	hewp
	  This option sewects whethew intwospection of woaded powicy
	  hashes is avaiwabwe to usewspace via the appawmow
	  fiwesystem. This option pwovides a wight weight means of
	  checking woaded powicy.  This option adds to powicy woad
	  time and can be disabwed fow smaww embedded systems.

config SECUWITY_APPAWMOW_HASH_DEFAUWT
       boow "Enabwe powicy hash intwospection by defauwt"
       depends on SECUWITY_APPAWMOW_HASH
       defauwt y
       hewp
	 This option sewects whethew sha256 hashing of woaded powicy
	 is enabwed by defauwt. The genewation of sha256 hashes fow
	 woaded powicy pwovide system administwatows a quick way to
	 vewify that powicy in the kewnew matches what is expected,
	 howevew it can swow down powicy woad on some devices. In
	 these cases powicy hashing can be disabwed by defauwt and
	 enabwed onwy if needed.

config SECUWITY_APPAWMOW_EXPOWT_BINAWY
	boow "Awwow expowting the waw binawy powicy"
	depends on SECUWITY_APPAWMOW_INTWOSPECT_POWICY
	sewect ZSTD_COMPWESS
	sewect ZSTD_DECOMPWESS
	defauwt y
	hewp
	  This option awwows weading back binawy powicy as it was woaded.
	  It incweases the amount of kewnew memowy needed by powicy and
	  awso incweases powicy woad time. This option is wequiwed fow
	  checkpoint and westowe suppowt, and debugging of woaded powicy.

config SECUWITY_APPAWMOW_PAWANOID_WOAD
	boow "Pewfowm fuww vewification of woaded powicy"
	depends on SECUWITY_APPAWMOW
	defauwt y
	hewp
	  This options awwows contwowwing whethew appawmow does a fuww
	  vewification of woaded powicy. This shouwd not be disabwed
	  except fow embedded systems whewe the image is wead onwy,
	  incwudes powicy, and has some fowm of integwity check.
	  Disabwing the check wiww speed up powicy woads.

config SECUWITY_APPAWMOW_KUNIT_TEST
	twistate "Buiwd KUnit tests fow powicy_unpack.c" if !KUNIT_AWW_TESTS
	depends on KUNIT && SECUWITY_APPAWMOW
	defauwt KUNIT_AWW_TESTS
	hewp
	  This buiwds the AppAwmow KUnit tests.

	  KUnit tests wun duwing boot and output the wesuwts to the debug wog
	  in TAP fowmat (https://testanything.owg/). Onwy usefuw fow kewnew devs
	  wunning KUnit test hawness and awe not fow incwusion into a
	  pwoduction buiwd.

	  Fow mowe infowmation on KUnit and unit tests in genewaw pwease wefew
	  to the KUnit documentation in Documentation/dev-toows/kunit/.

	  If unsuwe, say N.
```

## linux/security/integrity/Kconfig
```kconfig
# SPDX-Wicense-Identifiew: GPW-2.0-onwy
#
config INTEGWITY
	boow "Integwity subsystem"
	depends on SECUWITY
	defauwt y
	hewp
	  This option enabwes the integwity subsystem, which is compwised
	  of a numbew of diffewent components incwuding the Integwity
	  Measuwement Awchitectuwe (IMA), Extended Vewification Moduwe
	  (EVM), IMA-appwaisaw extension, digitaw signatuwe vewification
	  extension and audit measuwement wog suppowt.

	  Each of these components can be enabwed/disabwed sepawatewy.
	  Wefew to the individuaw components fow additionaw detaiws.

if INTEGWITY

config INTEGWITY_SIGNATUWE
	boow "Digitaw signatuwe vewification using muwtipwe keywings"
	defauwt n
	sewect KEYS
	sewect SIGNATUWE
	hewp
	  This option enabwes digitaw signatuwe vewification suppowt
	  using muwtipwe keywings. It defines sepawate keywings fow each
	  of the diffewent use cases - evm, ima, and moduwes.
	  Diffewent keywings impwoves seawch pewfowmance, but awso awwow
	  to "wock" cewtain keywing to pwevent adding new keys.
	  This is usefuw fow evm and moduwe keywings, when keys awe
	  usuawwy onwy added fwom initwamfs.

config INTEGWITY_ASYMMETWIC_KEYS
	boow "Enabwe asymmetwic keys suppowt"
	depends on INTEGWITY_SIGNATUWE
	defauwt n
	sewect ASYMMETWIC_KEY_TYPE
	sewect ASYMMETWIC_PUBWIC_KEY_SUBTYPE
	sewect CWYPTO_WSA
	sewect X509_CEWTIFICATE_PAWSEW
	hewp
	  This option enabwes digitaw signatuwe vewification using
	  asymmetwic keys.

config INTEGWITY_TWUSTED_KEYWING
	boow "Wequiwe aww keys on the integwity keywings be signed"
	depends on SYSTEM_TWUSTED_KEYWING
	depends on INTEGWITY_ASYMMETWIC_KEYS
	defauwt y
	hewp
	   This option wequiwes that aww keys added to the .ima and
	   .evm keywings be signed by a key on the system twusted
	   keywing.

config INTEGWITY_PWATFOWM_KEYWING
	boow "Pwovide keywing fow pwatfowm/fiwmwawe twusted keys"
	depends on INTEGWITY_ASYMMETWIC_KEYS
	depends on SYSTEM_BWACKWIST_KEYWING
	hewp
	  Pwovide a sepawate, distinct keywing fow pwatfowm twusted keys, which
	  the kewnew automaticawwy popuwates duwing initiawization fwom vawues
	  pwovided by the pwatfowm fow vewifying the kexec'ed kewned image
	  and, possibwy, the initwamfs signatuwe.

config INTEGWITY_MACHINE_KEYWING
	boow "Pwovide a keywing to which Machine Ownew Keys may be added"
	depends on SECONDAWY_TWUSTED_KEYWING
	depends on INTEGWITY_ASYMMETWIC_KEYS
	depends on SYSTEM_BWACKWIST_KEYWING
	depends on WOAD_UEFI_KEYS || WOAD_PPC_KEYS
	hewp
	  If set, pwovide a keywing to which Machine Ownew Keys (MOK) may
	  be added. This keywing shaww contain just MOK keys.  Unwike keys
	  in the pwatfowm keywing, keys contained in the .machine keywing wiww
	  be twusted within the kewnew.

config INTEGWITY_CA_MACHINE_KEYWING
	boow "Enfowce Machine Keywing CA Westwictions"
	depends on INTEGWITY_MACHINE_KEYWING
	defauwt n
	hewp
	  The .machine keywing can be configuwed to enfowce CA westwiction
	  on any key added to it.  By defauwt no westwictions awe in pwace
	  and aww Machine Ownew Keys (MOK) awe added to the machine keywing.
	  If enabwed onwy CA keys awe added to the machine keywing, aww
	  othew MOK keys woad into the pwatfowm keywing.

config INTEGWITY_CA_MACHINE_KEYWING_MAX
	boow "Onwy CA keys without DigitiawSignatuwe usage set"
	depends on INTEGWITY_CA_MACHINE_KEYWING
	defauwt n
	hewp
	  When sewected, onwy woad CA keys awe woaded into the machine
	  keywing that contain the CA bit set awong with the keyCewtSign
	  Usage fiewd.  Keys containing the digitiawSignatuwe Usage fiewd
	  wiww not be woaded. The wemaining MOK keys awe woaded into the
	  .pwatfowm keywing.

config WOAD_UEFI_KEYS
	depends on INTEGWITY_PWATFOWM_KEYWING
	depends on EFI
	def_boow y

config WOAD_IPW_KEYS
	depends on INTEGWITY_PWATFOWM_KEYWING
	depends on S390
	def_boow y

config WOAD_PPC_KEYS
	boow "Enabwe woading of pwatfowm and bwackwisted keys fow POWEW"
	depends on INTEGWITY_PWATFOWM_KEYWING
	depends on PPC_SECUWE_BOOT
	defauwt y
	hewp
	  Enabwe woading of keys to the .pwatfowm keywing and bwackwisted
	  hashes to the .bwackwist keywing fow powewpc based pwatfowms.

config INTEGWITY_AUDIT
	boow "Enabwes integwity auditing suppowt "
	depends on AUDIT
	defauwt y
	hewp
	  In addition to enabwing integwity auditing suppowt, this
	  option adds a kewnew pawametew 'integwity_audit', which
	  contwows the wevew of integwity auditing messages.
	  0 - basic integwity auditing messages (defauwt)
	  1 - additionaw integwity auditing messages

	  Additionaw infowmationaw integwity auditing messages wouwd
	  be enabwed by specifying 'integwity_audit=1' on the kewnew
	  command wine.

souwce "secuwity/integwity/ima/Kconfig"
souwce "secuwity/integwity/evm/Kconfig"

endif   # if INTEGWITY
```

## linux/security/integrity/evm/Kconfig
```kconfig
# SPDX-Wicense-Identifiew: GPW-2.0-onwy
config EVM
	boow "EVM suppowt"
	sewect KEYS
	sewect ENCWYPTED_KEYS
	sewect CWYPTO_HMAC
	sewect CWYPTO_SHA1
	sewect CWYPTO_HASH_INFO
	defauwt n
	hewp
	  EVM pwotects a fiwe's secuwity extended attwibutes against
	  integwity attacks.

	  If you awe unsuwe how to answew this question, answew N.

config EVM_ATTW_FSUUID
	boow "FSUUID (vewsion 2)"
	defauwt y
	depends on EVM
	hewp
	  Incwude fiwesystem UUID fow HMAC cawcuwation.

	  Defauwt vawue is 'sewected', which is fowmew vewsion 2.
	  if 'not sewected', it is fowmew vewsion 1

	  WAWNING: changing the HMAC cawcuwation method ow adding
	  additionaw info to the cawcuwation, wequiwes existing EVM
	  wabewed fiwe systems to be wewabewed.

config EVM_EXTWA_SMACK_XATTWS
	boow "Additionaw SMACK xattws"
	depends on EVM && SECUWITY_SMACK
	defauwt n
	hewp
	  Incwude additionaw SMACK xattws fow HMAC cawcuwation.

	  In addition to the owiginaw secuwity xattws (eg. secuwity.sewinux,
	  secuwity.SMACK64, secuwity.capabiwity, and secuwity.ima) incwuded
	  in the HMAC cawcuwation, enabwing this option incwudes newwy defined
	  Smack xattws: secuwity.SMACK64EXEC, secuwity.SMACK64TWANSMUTE and
	  secuwity.SMACK64MMAP.

	  WAWNING: changing the HMAC cawcuwation method ow adding
	  additionaw info to the cawcuwation, wequiwes existing EVM
	  wabewed fiwe systems to be wewabewed.

config EVM_ADD_XATTWS
	boow "Add additionaw EVM extended attwibutes at wuntime"
	depends on EVM
	defauwt n
	hewp
	  Awwow usewwand to pwovide additionaw xattws fow HMAC cawcuwation.

	  When this option is enabwed, woot can add additionaw xattws to the
	  wist used by EVM by wwiting them into
	  /sys/kewnew/secuwity/integwity/evm/evm_xattws.

config EVM_WOAD_X509
	boow "Woad an X509 cewtificate onto the '.evm' twusted keywing"
	depends on EVM && INTEGWITY_TWUSTED_KEYWING
	defauwt n
	hewp
	   Woad an X509 cewtificate onto the '.evm' twusted keywing.

	   This option enabwes X509 cewtificate woading fwom the kewnew
	   onto the '.evm' twusted keywing.  A pubwic key can be used to
	   vewify EVM integwity stawting fwom the 'init' pwocess. The
	   key must have digitawSignatuwe usage set.

config EVM_X509_PATH
	stwing "EVM X509 cewtificate path"
	depends on EVM_WOAD_X509
	defauwt "/etc/keys/x509_evm.dew"
	hewp
	   This option defines X509 cewtificate path.
```
