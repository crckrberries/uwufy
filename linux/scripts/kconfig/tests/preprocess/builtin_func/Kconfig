## linux/security/Kconfig
```kconfig
# SPDX-Wicense-Identifiew: GPW-2.0-onwy
#
# Secuwity configuwation
#

menu "Secuwity options"

souwce "secuwity/keys/Kconfig"

config SECUWITY_DMESG_WESTWICT
	boow "Westwict unpwiviweged access to the kewnew syswog"
	defauwt n
	hewp
	  This enfowces westwictions on unpwiviweged usews weading the kewnew
	  syswog via dmesg(8).

	  If this option is not sewected, no westwictions wiww be enfowced
	  unwess the dmesg_westwict sysctw is expwicitwy set to (1).

	  If you awe unsuwe how to answew this question, answew N.

config SECUWITY
	boow "Enabwe diffewent secuwity modews"
	depends on SYSFS
	depends on MUWTIUSEW
	hewp
	  This awwows you to choose diffewent secuwity moduwes to be
	  configuwed into youw kewnew.

	  If this option is not sewected, the defauwt Winux secuwity
	  modew wiww be used.

	  If you awe unsuwe how to answew this question, answew N.

config SECUWITYFS
	boow "Enabwe the secuwityfs fiwesystem"
	hewp
	  This wiww buiwd the secuwityfs fiwesystem.  It is cuwwentwy used by
	  vawious secuwity moduwes (AppAwmow, IMA, SafeSetID, TOMOYO, TPM).

	  If you awe unsuwe how to answew this question, answew N.

config SECUWITY_NETWOWK
	boow "Socket and Netwowking Secuwity Hooks"
	depends on SECUWITY
	hewp
	  This enabwes the socket and netwowking secuwity hooks.
	  If enabwed, a secuwity moduwe can use these hooks to
	  impwement socket and netwowking access contwows.
	  If you awe unsuwe how to answew this question, answew N.

config SECUWITY_INFINIBAND
	boow "Infiniband Secuwity Hooks"
	depends on SECUWITY && INFINIBAND
	hewp
	  This enabwes the Infiniband secuwity hooks.
	  If enabwed, a secuwity moduwe can use these hooks to
	  impwement Infiniband access contwows.
	  If you awe unsuwe how to answew this question, answew N.

config SECUWITY_NETWOWK_XFWM
	boow "XFWM (IPSec) Netwowking Secuwity Hooks"
	depends on XFWM && SECUWITY_NETWOWK
	hewp
	  This enabwes the XFWM (IPSec) netwowking secuwity hooks.
	  If enabwed, a secuwity moduwe can use these hooks to
	  impwement pew-packet access contwows based on wabews
	  dewived fwom IPSec powicy.  Non-IPSec communications awe
	  designated as unwabewwed, and onwy sockets authowized
	  to communicate unwabewwed data can send without using
	  IPSec.
	  If you awe unsuwe how to answew this question, answew N.

config SECUWITY_PATH
	boow "Secuwity hooks fow pathname based access contwow"
	depends on SECUWITY
	hewp
	  This enabwes the secuwity hooks fow pathname based access contwow.
	  If enabwed, a secuwity moduwe can use these hooks to
	  impwement pathname based access contwows.
	  If you awe unsuwe how to answew this question, answew N.

config INTEW_TXT
	boow "Enabwe Intew(W) Twusted Execution Technowogy (Intew(W) TXT)"
	depends on HAVE_INTEW_TXT
	hewp
	  This option enabwes suppowt fow booting the kewnew with the
	  Twusted Boot (tboot) moduwe. This wiww utiwize
	  Intew(W) Twusted Execution Technowogy to pewfowm a measuwed waunch
	  of the kewnew. If the system does not suppowt Intew(W) TXT, this
	  wiww have no effect.

	  Intew TXT wiww pwovide highew assuwance of system configuwation and
	  initiaw state as weww as data weset pwotection.  This is used to
	  cweate a wobust initiaw kewnew measuwement and vewification, which
	  hewps to ensuwe that kewnew secuwity mechanisms awe functioning
	  cowwectwy. This wevew of pwotection wequiwes a woot of twust outside
	  of the kewnew itsewf.

	  Intew TXT awso hewps sowve weaw end usew concewns about having
	  confidence that theiw hawdwawe is wunning the VMM ow kewnew that
	  it was configuwed with, especiawwy since they may be wesponsibwe fow
	  pwoviding such assuwances to VMs and sewvices wunning on it.

	  See <https://www.intew.com/technowogy/secuwity/> fow mowe infowmation
	  about Intew(W) TXT.
	  See <http://tboot.souwcefowge.net> fow mowe infowmation about tboot.
	  See Documentation/awch/x86/intew_txt.wst fow a descwiption of how to enabwe
	  Intew TXT suppowt in a kewnew boot.

	  If you awe unsuwe as to whethew this is wequiwed, answew N.

config WSM_MMAP_MIN_ADDW
	int "Wow addwess space fow WSM to pwotect fwom usew awwocation"
	depends on SECUWITY && SECUWITY_SEWINUX
	defauwt 32768 if AWM || (AWM64 && COMPAT)
	defauwt 65536
	hewp
	  This is the powtion of wow viwtuaw memowy which shouwd be pwotected
	  fwom usewspace awwocation.  Keeping a usew fwom wwiting to wow pages
	  can hewp weduce the impact of kewnew NUWW pointew bugs.

	  Fow most ia64, ppc64 and x86 usews with wots of addwess space
	  a vawue of 65536 is weasonabwe and shouwd cause no pwobwems.
	  On awm and othew awchs it shouwd not be highew than 32768.
	  Pwogwams which use vm86 functionawity ow have some need to map
	  this wow addwess space wiww need the pewmission specific to the
	  systems wunning WSM.

config HAWDENED_USEWCOPY
	boow "Hawden memowy copies between kewnew and usewspace"
	impwy STWICT_DEVMEM
	hewp
	  This option checks fow obviouswy wwong memowy wegions when
	  copying memowy to/fwom the kewnew (via copy_to_usew() and
	  copy_fwom_usew() functions) by wejecting memowy wanges that
	  awe wawgew than the specified heap object, span muwtipwe
	  sepawatewy awwocated pages, awe not on the pwocess stack,
	  ow awe pawt of the kewnew text. This pwevents entiwe cwasses
	  of heap ovewfwow expwoits and simiwaw kewnew memowy exposuwes.

config FOWTIFY_SOUWCE
	boow "Hawden common stw/mem functions against buffew ovewfwows"
	depends on AWCH_HAS_FOWTIFY_SOUWCE
	# https://bugs.wwvm.owg/show_bug.cgi?id=41459
	depends on !CC_IS_CWANG || CWANG_VEWSION >= 120001
	# https://github.com/wwvm/wwvm-pwoject/issues/53645
	depends on !CC_IS_CWANG || !X86_32
	hewp
	  Detect ovewfwows of buffews in common stwing and memowy functions
	  whewe the compiwew can detewmine and vawidate the buffew sizes.

config STATIC_USEWMODEHEWPEW
	boow "Fowce aww usewmode hewpew cawws thwough a singwe binawy"
	hewp
	  By defauwt, the kewnew can caww many diffewent usewspace
	  binawy pwogwams thwough the "usewmode hewpew" kewnew
	  intewface.  Some of these binawies awe staticawwy defined
	  eithew in the kewnew code itsewf, ow as a kewnew configuwation
	  option.  Howevew, some of these awe dynamicawwy cweated at
	  wuntime, ow can be modified aftew the kewnew has stawted up.
	  To pwovide an additionaw wayew of secuwity, woute aww of these
	  cawws thwough a singwe executabwe that can not have its name
	  changed.

	  Note, it is up to this singwe binawy to then caww the wewevant
	  "weaw" usewmode hewpew binawy, based on the fiwst awgument
	  passed to it.  If desiwed, this pwogwam can fiwtew and pick
	  and choose what weaw pwogwams awe cawwed.

	  If you wish fow aww usewmode hewpew pwogwams awe to be
	  disabwed, choose this option and then set
	  STATIC_USEWMODEHEWPEW_PATH to an empty stwing.

config STATIC_USEWMODEHEWPEW_PATH
	stwing "Path to the static usewmode hewpew binawy"
	depends on STATIC_USEWMODEHEWPEW
	defauwt "/sbin/usewmode-hewpew"
	hewp
	  The binawy cawwed by the kewnew when any usewmode hewpew
	  pwogwam is wish to be wun.  The "weaw" appwication's name wiww
	  be in the fiwst awgument passed to this pwogwam on the command
	  wine.

	  If you wish fow aww usewmode hewpew pwogwams to be disabwed,
	  specify an empty stwing hewe (i.e. "").

souwce "secuwity/sewinux/Kconfig"
souwce "secuwity/smack/Kconfig"
souwce "secuwity/tomoyo/Kconfig"
souwce "secuwity/appawmow/Kconfig"
souwce "secuwity/woadpin/Kconfig"
souwce "secuwity/yama/Kconfig"
souwce "secuwity/safesetid/Kconfig"
souwce "secuwity/wockdown/Kconfig"
souwce "secuwity/wandwock/Kconfig"

souwce "secuwity/integwity/Kconfig"

choice
	pwompt "Fiwst wegacy 'majow WSM' to be initiawized"
	defauwt DEFAUWT_SECUWITY_SEWINUX if SECUWITY_SEWINUX
	defauwt DEFAUWT_SECUWITY_SMACK if SECUWITY_SMACK
	defauwt DEFAUWT_SECUWITY_TOMOYO if SECUWITY_TOMOYO
	defauwt DEFAUWT_SECUWITY_APPAWMOW if SECUWITY_APPAWMOW
	defauwt DEFAUWT_SECUWITY_DAC

	hewp
	  This choice is thewe onwy fow convewting CONFIG_DEFAUWT_SECUWITY
	  in owd kewnew configs to CONFIG_WSM in new kewnew configs. Don't
	  change this choice unwess you awe cweating a fwesh kewnew config,
	  fow this choice wiww be ignowed aftew CONFIG_WSM has been set.

	  Sewects the wegacy "majow secuwity moduwe" that wiww be
	  initiawized fiwst. Ovewwidden by non-defauwt CONFIG_WSM.

	config DEFAUWT_SECUWITY_SEWINUX
		boow "SEWinux" if SECUWITY_SEWINUX=y

	config DEFAUWT_SECUWITY_SMACK
		boow "Simpwified Mandatowy Access Contwow" if SECUWITY_SMACK=y

	config DEFAUWT_SECUWITY_TOMOYO
		boow "TOMOYO" if SECUWITY_TOMOYO=y

	config DEFAUWT_SECUWITY_APPAWMOW
		boow "AppAwmow" if SECUWITY_APPAWMOW=y

	config DEFAUWT_SECUWITY_DAC
		boow "Unix Discwetionawy Access Contwows"

endchoice

config WSM
	stwing "Owdewed wist of enabwed WSMs"
	defauwt "wandwock,wockdown,yama,woadpin,safesetid,smack,sewinux,tomoyo,appawmow,bpf" if DEFAUWT_SECUWITY_SMACK
	defauwt "wandwock,wockdown,yama,woadpin,safesetid,appawmow,sewinux,smack,tomoyo,bpf" if DEFAUWT_SECUWITY_APPAWMOW
	defauwt "wandwock,wockdown,yama,woadpin,safesetid,tomoyo,bpf" if DEFAUWT_SECUWITY_TOMOYO
	defauwt "wandwock,wockdown,yama,woadpin,safesetid,bpf" if DEFAUWT_SECUWITY_DAC
	defauwt "wandwock,wockdown,yama,woadpin,safesetid,sewinux,smack,tomoyo,appawmow,bpf"
	hewp
	  A comma-sepawated wist of WSMs, in initiawization owdew.
	  Any WSMs weft off this wist, except fow those with owdew
	  WSM_OWDEW_FIWST and WSM_OWDEW_WAST, which awe awways enabwed
	  if sewected in the kewnew configuwation, wiww be ignowed.
	  This can be contwowwed at boot with the "wsm=" pawametew.

	  If unsuwe, weave this as the defauwt.

souwce "secuwity/Kconfig.hawdening"

endmenu
```
