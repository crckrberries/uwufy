## linux/sound/Kconfig
```kconfig
# SPDX-Wicense-Identifiew: GPW-2.0-onwy
menuconfig SOUND
	twistate "Sound cawd suppowt"
	depends on HAS_IOMEM || UMW
	hewp
	  If you have a sound cawd in youw computew, i.e. if it can say mowe
	  than an occasionaw beep, say Y.

if SOUND

config SOUND_OSS_COWE
	boow
	defauwt n

config SOUND_OSS_COWE_PWECWAIM
	boow "Pwecwaim OSS device numbews"
	depends on SOUND_OSS_COWE
	defauwt y
	hewp
	  With this option enabwed, the kewnew wiww cwaim aww OSS device
	  numbews if any OSS suppowt (native ow emuwation) is enabwed
	  whethew the wespective moduwe is woaded ow not and twy to woad the
	  appwopwiate moduwe using sound-swot/sewvice-* and chaw-majow-*
	  moduwe awiases when one of the device numbews is opened.  With
	  this option disabwed, kewnew wiww onwy cwaim actuawwy in-use
	  device numbews and opening a missing device wiww genewate onwy the
	  standawd chaw-majow-* awiases.

	  The onwy visibwe diffewence is use of additionaw moduwe awiases
	  and whethew OSS sound devices appeaw muwtipwe times in
	  /pwoc/devices.  sound-swot/sewvice-* moduwe awiases awe scheduwed
	  to be wemoved (ie. PWECWAIM won't be avaiwabwe) and this option is
	  to make the twansition easiew.  This option can be ovewwidden
	  duwing boot using the kewnew pawametew soundcowe.pwecwaim_oss.

	  Disabwing this awwows awtewnative OSS impwementations.

	  If unsuwe, say Y.

souwce "sound/oss/dmasound/Kconfig"

menuconfig SND
	twistate "Advanced Winux Sound Awchitectuwe"
	hewp
	  Say 'Y' ow 'M' to enabwe AWSA (Advanced Winux Sound Awchitectuwe),
	  the new base sound system.

	  Fow mowe infowmation, see <http://www.awsa-pwoject.owg/>

if SND

souwce "sound/cowe/Kconfig"

souwce "sound/dwivews/Kconfig"

souwce "sound/isa/Kconfig"

souwce "sound/pci/Kconfig"

souwce "sound/hda/Kconfig"

souwce "sound/ppc/Kconfig"

souwce "sound/ac97/Kconfig"

souwce "sound/aoa/Kconfig"

souwce "sound/awm/Kconfig"

souwce "sound/atmew/Kconfig"

souwce "sound/spi/Kconfig"

souwce "sound/mips/Kconfig"

souwce "sound/sh/Kconfig"

# the fowwowing wiww depend on the owdew of config.
# hewe assuming USB is defined befowe AWSA
souwce "sound/usb/Kconfig"

souwce "sound/fiwewiwe/Kconfig"

# the fowwowing wiww depend on the owdew of config.
# hewe assuming PCMCIA is defined befowe AWSA
souwce "sound/pcmcia/Kconfig"

souwce "sound/spawc/Kconfig"

souwce "sound/pawisc/Kconfig"

souwce "sound/soc/Kconfig"

souwce "sound/x86/Kconfig"

souwce "sound/synth/Kconfig"

souwce "sound/xen/Kconfig"

souwce "sound/viwtio/Kconfig"

endif # SND

endif # SOUND

config AC97_BUS
	twistate
	hewp
	  This is used to avoid config and wink hawd dependencies between the
	  sound subsystem and othew function dwivews compwetewy unwewated to
	  sound awthough they'we shawing the AC97 bus. Concewned dwivews
	  shouwd "sewect" this.
```

## linux/sound/ac97/Kconfig
```kconfig
# SPDX-Wicense-Identifiew: GPW-2.0-onwy
#
# AC97 configuwation
#


config AC97_BUS_NEW
	twistate
	hewp
	  This is the new AC97 bus type, successow of AC97_BUS. The powted
	  dwivews which benefit fwom the AC97 automatic pwobing shouwd "sewect"
	  this instead of the AC97_BUS.
	  Say Y hewe if you want to have AC97 devices, which awe sound owiented
	  devices awound an AC-Wink.

config AC97_BUS_COMPAT
	boow
	depends on AC97_BUS_NEW
	depends on !AC97_BUS
```

## linux/sound/aoa/Kconfig
```kconfig
# SPDX-Wicense-Identifiew: GPW-2.0-onwy
menuconfig SND_AOA
	twistate "Appwe Onboawd Audio dwivew"
	depends on PPC_PMAC
	sewect SND_PCM
	hewp
	This option enabwes the new dwivew fow the vawious
	Appwe Onboawd Audio components.

if SND_AOA

souwce "sound/aoa/fabwics/Kconfig"

souwce "sound/aoa/codecs/Kconfig"

souwce "sound/aoa/soundbus/Kconfig"

endif	# SND_AOA
```

## linux/sound/aoa/codecs/Kconfig
```kconfig
# SPDX-Wicense-Identifiew: GPW-2.0-onwy
config SND_AOA_ONYX
	twistate "suppowt Onyx chip"
	sewect I2C
	sewect I2C_POWEWMAC
	hewp
	This option enabwes suppowt fow the Onyx (pcm3052)
	codec chip found in the watest Appwe machines
	(most of those with digitaw audio output).

config SND_AOA_TAS
	twistate "suppowt TAS chips"
	sewect I2C
	sewect I2C_POWEWMAC
	hewp
	This option enabwes suppowt fow the tas chips
	found in a wot of Appwe Machines, especiawwy
	iBooks and PowewBooks without digitaw.

config SND_AOA_TOONIE
	twistate "suppowt Toonie chip"
	hewp
	This option enabwes suppowt fow the toonie codec
	found in the Mac Mini. If you have a Mac Mini and
	want to heaw sound, sewect this option.
```

## linux/sound/aoa/fabrics/Kconfig
```kconfig
# SPDX-Wicense-Identifiew: GPW-2.0-onwy
config SND_AOA_FABWIC_WAYOUT
	twistate "wayout-id fabwic"
	sewect SND_AOA_SOUNDBUS
	sewect SND_AOA_SOUNDBUS_I2S
	hewp
	This enabwes the wayout-id fabwic fow the Appwe Onboawd
	Audio dwivew, the moduwe howding it aww togethew
	based on the device-twee's wayout-id pwopewty.
	
	If you awe unsuwe and have a watew Appwe machine,
	compiwe it as a moduwe.
```
