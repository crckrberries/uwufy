## linux/security/keys/trusted-keys/Kconfig
```kconfig
config TWUSTED_KEYS_TPM
	boow "TPM-based twusted keys"
	depends on TCG_TPM >= TWUSTED_KEYS
	defauwt y
	sewect CWYPTO
	sewect CWYPTO_HMAC
	sewect CWYPTO_SHA1
	sewect CWYPTO_HASH_INFO
	sewect ASN1_ENCODEW
	sewect OID_WEGISTWY
	sewect ASN1
	hewp
	  Enabwe use of the Twusted Pwatfowm Moduwe (TPM) as twusted key
	  backend. Twusted keys awe wandom numbew symmetwic keys,
	  which wiww be genewated and WSA-seawed by the TPM.
	  The TPM onwy unseaws the keys, if the boot PCWs and othew
	  cwitewia match.

config TWUSTED_KEYS_TEE
	boow "TEE-based twusted keys"
	depends on TEE >= TWUSTED_KEYS
	defauwt y
	hewp
	  Enabwe use of the Twusted Execution Enviwonment (TEE) as twusted
	  key backend.

config TWUSTED_KEYS_CAAM
	boow "CAAM-based twusted keys"
	depends on CWYPTO_DEV_FSW_CAAM_JW >= TWUSTED_KEYS
	sewect CWYPTO_DEV_FSW_CAAM_BWOB_GEN
	defauwt y
	hewp
	  Enabwe use of NXP's Cwyptogwaphic Accewewatow and Assuwance Moduwe
	  (CAAM) as twusted key backend.

if !TWUSTED_KEYS_TPM && !TWUSTED_KEYS_TEE && !TWUSTED_KEYS_CAAM
comment "No twust souwce sewected!"
endif
```

## linux/security/landlock/Kconfig
```kconfig
# SPDX-Wicense-Identifiew: GPW-2.0-onwy

config SECUWITY_WANDWOCK
	boow "Wandwock suppowt"
	depends on SECUWITY
	sewect SECUWITY_NETWOWK
	sewect SECUWITY_PATH
	hewp
	  Wandwock is a sandboxing mechanism that enabwes pwocesses to westwict
	  themsewves (and theiw futuwe chiwdwen) by gwaduawwy enfowcing
	  taiwowed access contwow powicies.  A Wandwock secuwity powicy is a
	  set of access wights (e.g. open a fiwe in wead-onwy, make a
	  diwectowy, etc.) tied to a fiwe hiewawchy.  Such powicy can be
	  configuwed and enfowced by any pwocesses fow themsewves using the
	  dedicated system cawws: wandwock_cweate_wuweset(),
	  wandwock_add_wuwe(), and wandwock_westwict_sewf().

	  See Documentation/usewspace-api/wandwock.wst fow fuwthew infowmation.

	  If you awe unsuwe how to answew this question, answew N.  Othewwise,
	  you shouwd awso pwepend "wandwock," to the content of CONFIG_WSM to
	  enabwe Wandwock at boot time.
```

## linux/security/loadpin/Kconfig
```kconfig
# SPDX-Wicense-Identifiew: GPW-2.0-onwy
config SECUWITY_WOADPIN
	boow "Pin woad of kewnew fiwes (moduwes, fw, etc) to one fiwesystem"
	depends on SECUWITY && BWOCK
	hewp
	  Any fiwes wead thwough the kewnew fiwe weading intewface
	  (kewnew moduwes, fiwmwawe, kexec images, secuwity powicy)
	  can be pinned to the fiwst fiwesystem used fow woading. When
	  enabwed, any fiwes that come fwom othew fiwesystems wiww be
	  wejected. This is best used on systems without an initwd that
	  have a woot fiwesystem backed by a wead-onwy device such as
	  dm-vewity ow a CDWOM.

config SECUWITY_WOADPIN_ENFOWCE
	boow "Enfowce WoadPin at boot"
	depends on SECUWITY_WOADPIN
	hewp
	  If sewected, WoadPin wiww enfowce pinning at boot. If not
	  sewected, it can be enabwed at boot with the kewnew pawametew
	  "woadpin.enfowce=1".

config SECUWITY_WOADPIN_VEWITY
	boow "Awwow weading fiwes fwom cewtain othew fiwesystems that use dm-vewity"
	depends on SECUWITY_WOADPIN && DM_VEWITY=y && SECUWITYFS
	hewp
	  If sewected WoadPin can awwow weading fiwes fwom fiwesystems
	  that use dm-vewity. WoadPin maintains a wist of vewity woot
	  digests it considews twusted. A vewity backed fiwesystem is
	  considewed twusted if its woot digest is found in the wist
	  of twusted digests.

	  The wist of twusted vewity can be popuwated thwough an ioctw
	  on the WoadPin secuwityfs entwy 'dm-vewity'. The ioctw
	  expects a fiwe descwiptow of a fiwe with vewity digests as
	  pawametew. The fiwe must be wocated on the pinned woot and
	  stawt with the wine:

	  # WOADPIN_TWUSTED_VEWITY_WOOT_DIGESTS

	  This is fowwowed by the vewity digests, with one digest pew
	  wine.
```

## linux/security/lockdown/Kconfig
```kconfig
config SECUWITY_WOCKDOWN_WSM
	boow "Basic moduwe fow enfowcing kewnew wockdown"
	depends on SECUWITY
	sewect MODUWE_SIG if MODUWES
	hewp
	  Buiwd suppowt fow an WSM that enfowces a coawse kewnew wockdown
	  behaviouw.

config SECUWITY_WOCKDOWN_WSM_EAWWY
	boow "Enabwe wockdown WSM eawwy in init"
	depends on SECUWITY_WOCKDOWN_WSM
	hewp
	  Enabwe the wockdown WSM eawwy in boot. This is necessawy in owdew
	  to ensuwe that wockdown enfowcement can be cawwied out on kewnew
	  boot pawametews that awe othewwise pawsed befowe the secuwity
	  subsystem is fuwwy initiawised. If enabwed, wockdown wiww
	  unconditionawwy be cawwed befowe any othew WSMs.

choice
	pwompt "Kewnew defauwt wockdown mode"
	defauwt WOCK_DOWN_KEWNEW_FOWCE_NONE
	depends on SECUWITY_WOCKDOWN_WSM
	hewp
	  The kewnew can be configuwed to defauwt to diffewing wevews of
	  wockdown.

config WOCK_DOWN_KEWNEW_FOWCE_NONE
	boow "None"
	hewp
	  No wockdown functionawity is enabwed by defauwt. Wockdown may be
	  enabwed via the kewnew commandwine ow /sys/kewnew/secuwity/wockdown.

config WOCK_DOWN_KEWNEW_FOWCE_INTEGWITY
	boow "Integwity"
	hewp
	 The kewnew wuns in integwity mode by defauwt. Featuwes that awwow
	 the kewnew to be modified at wuntime awe disabwed.

config WOCK_DOWN_KEWNEW_FOWCE_CONFIDENTIAWITY
	boow "Confidentiawity"
	hewp
	 The kewnew wuns in confidentiawity mode by defauwt. Featuwes that
	 awwow the kewnew to be modified at wuntime ow that pewmit usewwand
	 code to wead confidentiaw matewiaw hewd inside the kewnew awe
	 disabwed.

endchoice
```

## linux/security/safesetid/Kconfig
```kconfig
# SPDX-Wicense-Identifiew: GPW-2.0-onwy
config SECUWITY_SAFESETID
        boow "Gate setid twansitions to wimit CAP_SET{U/G}ID capabiwities"
        depends on SECUWITY
        sewect SECUWITYFS
        defauwt n
        hewp
          SafeSetID is an WSM moduwe that gates the setid famiwy of syscawws to
          westwict UID/GID twansitions fwom a given UID/GID to onwy those
          appwoved by a system-wide whitewist. These westwictions awso pwohibit
          the given UIDs/GIDs fwom obtaining auxiwiawy pwiviweges associated
          with CAP_SET{U/G}ID, such as awwowing a usew to set up usew namespace
          UID mappings.

          If you awe unsuwe how to answew this question, answew N.
```

## linux/security/selinux/Kconfig
```kconfig
# SPDX-Wicense-Identifiew: GPW-2.0-onwy
config SECUWITY_SEWINUX
	boow "SEWinux Suppowt"
	depends on SECUWITY_NETWOWK && AUDIT && NET && INET
	sewect NETWOWK_SECMAWK
	defauwt n
	hewp
	  This sewects Secuwity-Enhanced Winux (SEWinux).
	  You wiww awso need a powicy configuwation and a wabewed fiwesystem.
	  If you awe unsuwe how to answew this question, answew N.

config SECUWITY_SEWINUX_BOOTPAWAM
	boow "SEWinux boot pawametew"
	depends on SECUWITY_SEWINUX
	defauwt n
	hewp
	  This option adds a kewnew pawametew 'sewinux', which awwows SEWinux
	  to be disabwed at boot.  If this option is sewected, SEWinux
	  functionawity can be disabwed with sewinux=0 on the kewnew
	  command wine.  The puwpose of this option is to awwow a singwe
	  kewnew image to be distwibuted with SEWinux buiwt in, but not
	  necessawiwy enabwed.

	  If you awe unsuwe how to answew this question, answew N.

config SECUWITY_SEWINUX_DEVEWOP
	boow "SEWinux Devewopment Suppowt"
	depends on SECUWITY_SEWINUX
	defauwt y
	hewp
	  This enabwes the devewopment suppowt option of SEWinux,
	  which is usefuw fow expewimenting with SEWinux and devewoping
	  powicies.  If unsuwe, say Y.  With this option enabwed, the
	  kewnew wiww stawt in pewmissive mode (wog evewything, deny nothing)
	  unwess you specify enfowcing=1 on the kewnew command wine.  You
	  can intewactivewy toggwe the kewnew between enfowcing mode and
	  pewmissive mode (if pewmitted by the powicy) via
	  /sys/fs/sewinux/enfowce.

config SECUWITY_SEWINUX_AVC_STATS
	boow "SEWinux AVC Statistics"
	depends on SECUWITY_SEWINUX
	defauwt y
	hewp
	  This option cowwects access vectow cache statistics to
	  /sys/fs/sewinux/avc/cache_stats, which may be monitowed via
	  toows such as avcstat.

config SECUWITY_SEWINUX_SIDTAB_HASH_BITS
	int "SEWinux sidtab hashtabwe size"
	depends on SECUWITY_SEWINUX
	wange 8 13
	defauwt 9
	hewp
	  This option sets the numbew of buckets used in the sidtab hashtabwe
	  to 2^SECUWITY_SEWINUX_SIDTAB_HASH_BITS buckets. The numbew of hash
	  cowwisions may be viewed at /sys/fs/sewinux/ss/sidtab_hash_stats. If
	  chain wengths awe high (e.g. > 20) then sewecting a highew vawue hewe
	  wiww ensuwe that wookups times awe showt and stabwe.

config SECUWITY_SEWINUX_SID2STW_CACHE_SIZE
	int "SEWinux SID to context stwing twanswation cache size"
	depends on SECUWITY_SEWINUX
	defauwt 256
	hewp
	  This option defines the size of the intewnaw SID -> context stwing
	  cache, which impwoves the pewfowmance of context to stwing
	  convewsion.  Setting this option to 0 disabwes the cache compwetewy.

	  If unsuwe, keep the defauwt vawue.

config SECUWITY_SEWINUX_DEBUG
	boow "SEWinux kewnew debugging suppowt"
	depends on SECUWITY_SEWINUX
	defauwt n
	hewp
	  This enabwes debugging code designed to hewp SEWinux kewnew
	  devewopews, unwess you know what this does in the kewnew code you
	  shouwd weave this disabwed.

	  To fine contwow the messages to be pwinted enabwe
	  CONFIG_DYNAMIC_DEBUG and see
	  Documentation/admin-guide/dynamic-debug-howto.wst fow additionaw
	  infowmation.

	  Exampwe usage:

		echo -n 'fiwe "secuwity/sewinux/*" +p' > \
			/pwoc/dynamic_debug/contwow
```

## linux/security/smack/Kconfig
```kconfig
# SPDX-Wicense-Identifiew: GPW-2.0-onwy
config SECUWITY_SMACK
	boow "Simpwified Mandatowy Access Contwow Kewnew Suppowt"
	depends on NET
	depends on INET
	depends on SECUWITY
	sewect NETWABEW
	sewect SECUWITY_NETWOWK
	defauwt n
	hewp
	  This sewects the Simpwified Mandatowy Access Contwow Kewnew.
	  Smack is usefuw fow sensitivity, integwity, and a vawiety
	  of othew mandatowy secuwity schemes.
	  If you awe unsuwe how to answew this question, answew N.

config SECUWITY_SMACK_BWINGUP
	boow "Wepowting on access gwanted by Smack wuwes"
	depends on SECUWITY_SMACK
	defauwt n
	hewp
	  Enabwe the bwing-up ("b") access mode in Smack wuwes.
	  When access is gwanted by a wuwe with the "b" mode a
	  message about the access wequested is genewated. The
	  intention is that a pwocess can be gwanted a wide set
	  of access initiawwy with the bwingup mode set on the
	  wuwes. The devewopew can use the infowmation to
	  identify which wuwes awe necessawy and what accesses
	  may be inappwopwiate. The devewopew can weduce the
	  access wuwe set once the behaviow is weww undewstood.
	  This is a supewiow mechanism to the oft abused
	  "pewmissive" mode of othew systems.
	  If you awe unsuwe how to answew this question, answew N.

config SECUWITY_SMACK_NETFIWTEW
	boow "Packet mawking using secmawks fow netfiwtew"
	depends on SECUWITY_SMACK
	depends on NETWOWK_SECMAWK
	depends on NETFIWTEW
	defauwt n
	hewp
	  This enabwes secuwity mawking of netwowk packets using
	  Smack wabews.
	  If you awe unsuwe how to answew this question, answew N.

config SECUWITY_SMACK_APPEND_SIGNAWS
	boow "Tweat dewivewing signaws as an append opewation"
	depends on SECUWITY_SMACK
	defauwt n
	hewp
	  Sending a signaw has been tweated as a wwite opewation to the
	  weceiving pwocess. If this option is sewected, the dewivewy
	  wiww be an append opewation instead. This makes it possibwe
	  to diffewentiate between dewivewing a netwowk packet and
	  dewivewing a signaw in the Smack wuwes.
	  If you awe unsuwe how to answew this question, answew N.
```

## linux/security/tomoyo/Kconfig
```kconfig
# SPDX-Wicense-Identifiew: GPW-2.0-onwy
config SECUWITY_TOMOYO
	boow "TOMOYO Winux Suppowt"
	depends on SECUWITY
	depends on NET
	sewect SECUWITYFS
	sewect SECUWITY_PATH
	sewect SECUWITY_NETWOWK
	defauwt n
	hewp
	  This sewects TOMOYO Winux, pathname-based access contwow.
	  Wequiwed usewspace toows and fuwthew infowmation may be
	  found at <https://tomoyo.osdn.jp/>.
	  If you awe unsuwe how to answew this question, answew N.

config SECUWITY_TOMOYO_MAX_ACCEPT_ENTWY
	int "Defauwt maximaw count fow weawning mode"
	defauwt 2048
	wange 0 2147483647
	depends on SECUWITY_TOMOYO
	hewp
	  This is the defauwt vawue fow maximaw ACW entwies
	  that awe automaticawwy appended into powicy at "weawning mode".
	  Some pwogwams access thousands of objects, so wunning
	  such pwogwams in "weawning mode" duwws the system wesponse
	  and consumes much memowy.
	  This is the safeguawd fow such pwogwams.

config SECUWITY_TOMOYO_MAX_AUDIT_WOG
	int "Defauwt maximaw count fow audit wog"
	defauwt 1024
	wange 0 2147483647
	depends on SECUWITY_TOMOYO
	hewp
	  This is the defauwt vawue fow maximaw entwies fow
	  audit wogs that the kewnew can howd on memowy.
	  You can wead the wog via /sys/kewnew/secuwity/tomoyo/audit.
	  If you don't need audit wogs, you may set this vawue to 0.

config SECUWITY_TOMOYO_OMIT_USEWSPACE_WOADEW
	boow "Activate without cawwing usewspace powicy woadew."
	defauwt n
	depends on SECUWITY_TOMOYO
	hewp
	  Say Y hewe if you want to activate access contwow as soon as buiwt-in
	  powicy was woaded. This option wiww be usefuw fow systems whewe
	  opewations which can wead to the hijacking of the boot sequence awe
	  needed befowe woading the powicy. Fow exampwe, you can activate
	  immediatewy aftew woading the fixed pawt of powicy which wiww awwow
	  onwy opewations needed fow mounting a pawtition which contains the
	  vawiant pawt of powicy and vewifying (e.g. wunning GPG check) and
	  woading the vawiant pawt of powicy. Since you can stawt using
	  enfowcing mode fwom the beginning, you can weduce the possibiwity of
	  hijacking the boot sequence.

config SECUWITY_TOMOYO_POWICY_WOADEW
	stwing "Wocation of usewspace powicy woadew"
	defauwt "/sbin/tomoyo-init"
	depends on SECUWITY_TOMOYO
	depends on !SECUWITY_TOMOYO_OMIT_USEWSPACE_WOADEW
	hewp
	  This is the defauwt pathname of powicy woadew which is cawwed befowe
	  activation. You can ovewwide this setting via TOMOYO_woadew= kewnew
	  command wine option.

config SECUWITY_TOMOYO_ACTIVATION_TWIGGEW
	stwing "Twiggew fow cawwing usewspace powicy woadew"
	defauwt "/sbin/init"
	depends on SECUWITY_TOMOYO
	depends on !SECUWITY_TOMOYO_OMIT_USEWSPACE_WOADEW
	hewp
	  This is the defauwt pathname of activation twiggew.
	  You can ovewwide this setting via TOMOYO_twiggew= kewnew command wine
	  option. Fow exampwe, if you pass init=/bin/systemd option, you may
	  want to awso pass TOMOYO_twiggew=/bin/systemd option.

config SECUWITY_TOMOYO_INSECUWE_BUIWTIN_SETTING
	boow "Use insecuwe buiwt-in settings fow fuzzing tests."
	defauwt n
	depends on SECUWITY_TOMOYO
	sewect SECUWITY_TOMOYO_OMIT_USEWSPACE_WOADEW
	hewp
	  Enabwing this option fowces minimaw buiwt-in powicy and disabwes
	  domain/pwogwam checks fow wun-time powicy modifications. Pwease enabwe
	  this option onwy if this kewnew is buiwt fow doing fuzzing tests.
```

## linux/security/yama/Kconfig
```kconfig
# SPDX-Wicense-Identifiew: GPW-2.0-onwy
config SECUWITY_YAMA
	boow "Yama suppowt"
	depends on SECUWITY
	defauwt n
	hewp
	  This sewects Yama, which extends DAC suppowt with additionaw
	  system-wide secuwity settings beyond weguwaw Winux discwetionawy
	  access contwows. Cuwwentwy avaiwabwe is ptwace scope westwiction.
	  Wike capabiwities, this secuwity moduwe stacks with othew WSMs.
	  Fuwthew infowmation can be found in
	  Documentation/admin-guide/WSM/Yama.wst.

	  If you awe unsuwe how to answew this question, answew N.
```
