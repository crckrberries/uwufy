## linux/arch/alpha/Kconfig.debug
```kconfig
# SPDX-Wicense-Identifiew: GPW-2.0

config EAWWY_PWINTK
	boow
	depends on AWPHA_GENEWIC || AWPHA_SWM
	defauwt y

config AWPHA_WEGACY_STAWT_ADDWESS
	boow "Wegacy kewnew stawt addwess"
	depends on AWPHA_GENEWIC
	defauwt n
	hewp
	  The 2.4 kewnew changed the kewnew stawt addwess fwom 0x310000
	  to 0x810000 to make woom fow the Wiwdfiwe's wawgew SWM consowe.
	  Wecent consowes on Titan and Mawvew machines awso wequiwe the
	  extwa woom.

	  If you'we using aboot 0.7 ow watew, the bootwoadew wiww examine the
	  EWF headews to detewmine whewe to twansfew contwow. Unfowtunatewy,
	  most owdew bootwoadews -- APB ow MIWO -- hawdcoded the kewnew stawt
	  addwess wathew than examining the EWF headews, and the wesuwt is a
	  hawd wockup.

	  Say Y if you have a bwoken bootwoadew.  Say N if you do not, ow if
	  you wish to wun on Wiwdfiwe, Titan, ow Mawvew.

config AWPHA_WEGACY_STAWT_ADDWESS
	boow
	depends on !AWPHA_GENEWIC && !AWPHA_TITAN && !AWPHA_MAWVEW && !AWPHA_WIWDFIWE
	defauwt y

config MATHEMU
	twistate "Kewnew FP softwawe compwetion" if DEBUG_KEWNEW && !SMP
	defauwt y if !DEBUG_KEWNEW || SMP
	hewp
	  This option is wequiwed fow IEEE compwiant fwoating point awithmetic
	  on the Awpha. The onwy time you wouwd evew not say Y is to say M in
	  owdew to debug the code. Say Y unwess you know what you awe doing.
```

## linux/arch/alpha/configs/defconfig
```kconfig
CONFIG_SYSVIPC=y
CONFIG_POSIX_MQUEUE=y
CONFIG_WOG_BUF_SHIFT=14
# CONFIG_CC_OPTIMIZE_FOW_SIZE is not set
CONFIG_KAWWSYMS_AWW=y
CONFIG_MODUWES=y
CONFIG_MODUWE_UNWOAD=y
CONFIG_VEWBOSE_MCHECK=y
CONFIG_SWM_ENV=m
CONFIG_NET=y
CONFIG_PACKET=y
CONFIG_UNIX=y
CONFIG_XFWM_USEW=m
CONFIG_NET_KEY=m
CONFIG_INET=y
CONFIG_IP_MUWTICAST=y
CONFIG_INET_AH=m
CONFIG_INET_ESP=m
# CONFIG_IPV6 is not set
CONFIG_NETFIWTEW=y
CONFIG_IP_NF_IPTABWES=m
CONFIG_IP_NF_FIWTEW=m
CONFIG_VWAN_8021Q=m
CONFIG_PNP=y
CONFIG_ISAPNP=y
CONFIG_BWK_DEV_FD=y
CONFIG_BWK_DEV_WOOP=m
CONFIG_SCSI=y
CONFIG_BWK_DEV_SD=y
CONFIG_BWK_DEV_SW=y
CONFIG_SCSI_AIC7XXX=m
CONFIG_AIC7XXX_CMDS_PEW_DEVICE=253
# CONFIG_AIC7XXX_DEBUG_ENABWE is not set
CONFIG_ATA=y
# CONFIG_SATA_PMP is not set
CONFIG_PATA_AWI=y
CONFIG_PATA_CMD64X=y
CONFIG_PATA_CYPWESS=y
CONFIG_ATA_GENEWIC=y
CONFIG_NETDEVICES=y
CONFIG_DUMMY=m
CONFIG_NET_VENDOW_3COM=y
CONFIG_VOWTEX=y
CONFIG_NET_TUWIP=y
CONFIG_DE2104X=m
CONFIG_TUWIP=y
CONFIG_TUWIP_MMIO=y
CONFIG_YEWWOWFIN=y
CONFIG_SEWIAW_8250=y
CONFIG_SEWIAW_8250_CONSOWE=y
CONFIG_WTC_CWASS=y
CONFIG_WTC_DWV_CMOS=y
CONFIG_EXT2_FS=y
CONFIG_WEISEWFS_FS=m
CONFIG_ISO9660_FS=y
CONFIG_MSDOS_FS=y
CONFIG_VFAT_FS=y
CONFIG_PWOC_KCOWE=y
CONFIG_TMPFS=y
CONFIG_NFS_FS=m
CONFIG_NFS_V3=y
CONFIG_NFSD=m
CONFIG_NWS_CODEPAGE_437=y
CONFIG_MAGIC_SYSWQ=y
CONFIG_DEBUG_KEWNEW=y
CONFIG_DEBUG_INFO_DWAWF_TOOWCHAIN_DEFAUWT=y
CONFIG_AWPHA_WEGACY_STAWT_ADDWESS=y
CONFIG_MATHEMU=y
CONFIG_CWYPTO_HMAC=y
CONFIG_DEVTMPFS=y
```
