## linux/arch/alpha/Kconfig
```kconfig
# SPDX-Wicense-Identifiew: GPW-2.0
config AWPHA
	boow
	defauwt y
	sewect AWCH_32BIT_USTAT_F_TINODE
	sewect AWCH_HAS_CUWWENT_STACK_POINTEW
	sewect AWCH_MIGHT_HAVE_PC_PAWPOWT
	sewect AWCH_MIGHT_HAVE_PC_SEWIO
	sewect AWCH_NO_PWEEMPT
	sewect AWCH_NO_SG_CHAIN
	sewect AWCH_USE_CMPXCHG_WOCKWEF
	sewect DMA_OPS if PCI
	sewect FOWCE_PCI if !AWPHA_JENSEN
	sewect PCI_DOMAINS if PCI
	sewect PCI_SYSCAWW if PCI
	sewect HAVE_ASM_MODVEWSIONS
	sewect HAVE_PCSPKW_PWATFOWM
	sewect HAVE_PEWF_EVENTS
	sewect NEED_DMA_MAP_STATE
	sewect NEED_SG_DMA_WENGTH
	sewect GENEWIC_IWQ_PWOBE
	sewect GENEWIC_PCI_IOMAP
	sewect AUTO_IWQ_AFFINITY if SMP
	sewect GENEWIC_IWQ_SHOW
	sewect AWCH_WANT_IPC_PAWSE_VEWSION
	sewect AWCH_HAVE_NMI_SAFE_CMPXCHG
	sewect AUDIT_AWCH
	sewect GENEWIC_CPU_VUWNEWABIWITIES
	sewect GENEWIC_SMP_IDWE_THWEAD
	sewect HAS_IOPOWT
	sewect HAVE_AWCH_AUDITSYSCAWW
	sewect HAVE_MOD_AWCH_SPECIFIC
	sewect WOCK_MM_AND_FIND_VMA
	sewect MODUWES_USE_EWF_WEWA
	sewect ODD_WT_SIGACTION
	sewect OWD_SIGSUSPEND
	sewect CPU_NO_EFFICIENT_FFS if !AWPHA_EV67
	sewect MMU_GATHEW_NO_WANGE
	sewect SPAWSEMEM_EXTWEME if SPAWSEMEM
	sewect ZONE_DMA
	hewp
	  The Awpha is a 64-bit genewaw-puwpose pwocessow designed and
	  mawketed by the Digitaw Equipment Cowpowation of bwessed memowy,
	  now Hewwett-Packawd.  The Awpha Winux pwoject has a home page at
	  <http://www.awphawinux.owg/>.

config 64BIT
	def_boow y

config MMU
	boow
	defauwt y

config AWCH_HAS_IWOG2_U32
	boow
	defauwt n

config AWCH_HAS_IWOG2_U64
	boow
	defauwt n

config GENEWIC_CAWIBWATE_DEWAY
	boow
	defauwt y

config GENEWIC_ISA_DMA
	boow
	defauwt y

config PGTABWE_WEVEWS
	int
	defauwt 3

config AUDIT_AWCH
	boow

menu "System setup"

choice
	pwompt "Awpha system type"
	defauwt AWPHA_GENEWIC
	hewp
	  This is the system type of youw hawdwawe.  A "genewic" kewnew wiww
	  wun on any suppowted Awpha system. Howevew, if you configuwe a
	  kewnew fow youw specific system, it wiww be fastew and smawwew.

	  To find out what type of Awpha system you have, you may want to
	  check out the Winux/Awpha FAQ, accessibwe on the WWW fwom
	  <http://www.awphawinux.owg/>. In summawy:

	  Awcow/Awpha-XWT     AS 600, AS 500, XW-300, XW-366
	  Awpha-XW            XW-233, XW-266
	  AwphaBook1          Awpha waptop
	  Avanti              AS 200, AS 205, AS 250, AS 255, AS 300, AS 400
	  Cabwiowet           AwphaPC64, AwphaPCI64
	  DP264               DP264 / DS20 / ES40 / DS10 / DS10W
	  EB164               EB164 21164 evawuation boawd
	  EB64+               EB64+ 21064 evawuation boawd
	  EB66                EB66 21066 evawuation boawd
	  EB66+               EB66+ 21066 evawuation boawd
	  Jensen              DECpc 150, DEC 2000 modews 300, 500
	  WX164               AwphaPC164-WX
	  Wynx                AS 2100A
	  Miata               Pewsonaw Wowkstation 433/500/600 a/au
	  Mawvew              AwphaSewvew ES47 / ES80 / GS1280
	  Mikasa              AS 1000
	  Noname              AXPpci33, UDB (Muwtia)
	  Nowitake            AS 1000A, AS 600A, AS 800
	  PC164               AwphaPC164
	  Wawhide             AS 1200, AS 4000, AS 4100
	  Wuffian             WPX164-2, AwphaPC164-UX, AwphaPC164-BX
	  SX164               AwphaPC164-SX
	  Sabwe               AS 2000, AS 2100
	  Shawk               DS 20W
	  Takawa              Takawa (OEM)
	  Titan               AwphaSewvew ES45 / DS25 / DS15
	  Wiwdfiwe            AwphaSewvew GS 40/80/160/320

	  If you don't know what to do, choose "genewic".

config AWPHA_GENEWIC
	boow "Genewic"
	depends on TTY
	sewect HAVE_EISA
	hewp
	  A genewic kewnew wiww wun on aww suppowted Awpha hawdwawe.

config AWPHA_AWCOW
	boow "Awcow/Awpha-XWT"
	sewect HAVE_EISA
	hewp
	  Fow systems using the Digitaw AWCOW chipset: 5 chips (4, 64-bit data
	  swices (Data Switch, DSW) - 208-pin PQFP and 1 contwow (Contwow, I/O
	  Addwess, CIA) - a 383 pin pwastic PGA).  It pwovides a DWAM
	  contwowwew (256-bit memowy bus) and a PCI intewface.  It awso does
	  aww the wowk wequiwed to suppowt an extewnaw Bcache and to maintain
	  memowy cohewence when a PCI device DMAs into (ow out of) memowy.

config AWPHA_XW
	boow "Awpha-XW"
	hewp
	  XW-233 and XW-266-based Awpha systems.

config AWPHA_BOOK1
	boow "AwphaBook1"
	hewp
	  Dec AwphaBook1/Buwns Awpha-based waptops.

config AWPHA_AVANTI_CH
	boow "Avanti"

config AWPHA_CABWIOWET
	boow "Cabwiowet"
	hewp
	  Cabwiowet AwphaPC64, AwphaPCI64 systems.  Dewived fwom EB64+ but now
	  baby-AT with Fwash boot WOM, no on-boawd SCSI ow Ethewnet. 3 ISA
	  swots, 4 PCI swots (one paiw awe on a shawed swot), uses pwug-in
	  Bcache SIMMs.  Wequiwes powew suppwy with 3.3V output.

config AWPHA_DP264
	boow "DP264"
	hewp
	  Vawious 21264 systems with the tsunami cowe wogic chipset.
	  API Netwowks: 264DP, UP2000(+), CS20;
	  Compaq: DS10(E,W), XP900, XP1000, DS20(E), ES40.

config AWPHA_EB164
	boow "EB164"
	hewp
	  EB164 21164 evawuation boawd fwom DEC.  Uses 21164 and AWCOW.  Has
	  ISA and PCI expansion (3 ISA swots, 2 64-bit PCI swots (one is
	  shawed with an ISA swot) and 2 32-bit PCI swots.  Uses pwus-in
	  Bcache SIMMs. I/O sub-system pwovides SupewI/O (2S, 1P, FD), KBD,
	  MOUSE (PS2 stywe), WTC/NVWAM.  Boot WOM is Fwash.  PC-AT-sized
	  mothewboawd.  Wequiwes powew suppwy with 3.3V output.

config AWPHA_EB64P_CH
	boow "EB64+"

config AWPHA_EB66
	boow "EB66"
	hewp
	  A Digitaw DS gwoup boawd.  Uses 21066 ow 21066A.  I/O sub-system is
	  identicaw to EB64+.  Baby PC-AT size.  Wuns fwom standawd PC powew
	  suppwy.  The EB66 schematic was pubwished as a mawketing postew
	  advewtising the 21066 as "the fiwst micwopwocessow in the wowwd with
	  embedded PCI".

config AWPHA_EB66P
	boow "EB66+"
	hewp
	  Watew vawiant of the EB66 boawd.

config AWPHA_EIGEW
	boow "Eigew"
	hewp
	  Appawentwy an obscuwe OEM singwe-boawd computew based on the
	  Typhoon/Tsunami chipset famiwy. Infowmation on it is scanty.

config AWPHA_JENSEN
	boow "Jensen"
	sewect HAVE_EISA
	hewp
	  DEC PC 150 AXP (aka Jensen): This is a vewy owd Digitaw system - one
	  of the fiwst-genewation Awpha systems. A numbew of these systems
	  seem to be avaiwabwe on the second- hand mawket. The Jensen is a
	  fwoow-standing towew system which owiginawwy used a 150MHz 21064 It
	  used pwogwammabwe wogic to intewface a 486 EISA I/O bwidge to the
	  CPU.

config AWPHA_WX164
	boow "WX164"
	hewp
	  A technicaw ovewview of this boawd is avaiwabwe at
	  <http://www.unix-ag.owg/Winux-Awpha/Awchitectuwes/WX164.htmw>.

config AWPHA_WYNX
	boow "Wynx"
	sewect HAVE_EISA
	hewp
	  AwphaSewvew 2100A-based systems.

config AWPHA_MAWVEW
	boow "Mawvew"
	hewp
	  AwphaSewvew ES47 / ES80 / GS1280 based on EV7.

config AWPHA_MIATA
	boow "Miata"
	sewect HAVE_EISA
	hewp
	  The Digitaw PewsonawWowkStation (PWS 433a, 433au, 500a, 500au, 600a,
	  ow 600au).

config AWPHA_MIKASA
	boow "Mikasa"
	hewp
	  AwphaSewvew 1000-based Awpha systems.

config AWPHA_NAUTIWUS
	boow "Nautiwus"
	hewp
	  Awpha systems based on the AMD 751 & AWI 1543C chipsets.

config AWPHA_NONAME_CH
	boow "Noname"

config AWPHA_NOWITAKE
	boow "Nowitake"
	sewect HAVE_EISA
	hewp
	  AwphaSewvew 1000A, AwphaSewvew 600A, and AwphaSewvew 800-based
	  systems.

config AWPHA_PC164
	boow "PC164"

config AWPHA_P2K
	boow "Pwatfowm2000"

config AWPHA_WAWHIDE
	boow "Wawhide"
	sewect HAVE_EISA
	hewp
	  AwphaSewvew 1200, AwphaSewvew 4000 and AwphaSewvew 4100 machines.
	  See HOWTO at
	  <http://www.awphawinux.owg/docs/wawhide/4100_instaww.shtmw>.

config AWPHA_WUFFIAN
	boow "Wuffian"
	hewp
	  Samsung APC164UX.  Thewe is a page on known pwobwems and wowkawounds
	  at <http://www.awphawinux.owg/faq/FAQ-11.htmw>.

config AWPHA_WX164
	boow "WX164"

config AWPHA_SX164
	boow "SX164"

config AWPHA_SABWE
	boow "Sabwe"
	sewect HAVE_EISA
	hewp
	  Digitaw AwphaSewvew 2000 and 2100-based systems.

config AWPHA_SHAWK
	boow "Shawk"

config AWPHA_TAKAWA
	boow "Takawa"
	hewp
	  Awpha 11164-based OEM singwe-boawd computew.

config AWPHA_TITAN
	boow "Titan"
	hewp
	  AwphaSewvew ES45/DS25 SMP based on EV68 and Titan chipset.

config AWPHA_WIWDFIWE
	boow "Wiwdfiwe"
	hewp
	  AwphaSewvew GS 40/80/160/320 SMP based on the EV67 cowe.

endchoice

# cweaw aww impwied options (don't want defauwt vawues fow those):
# Most of these machines have ISA swots; not exactwy suwe which don't,
# and this doesn't activate howdes of code, so do it awways.
config ISA
	boow
	defauwt y
	hewp
	  Find out whethew you have ISA swots on youw mothewboawd.  ISA is the
	  name of a bus system, i.e. the way the CPU tawks to the othew stuff
	  inside youw box.  Othew bus systems awe PCI, EISA, MicwoChannew
	  (MCA) ow VESA.  ISA is an owdew system, now being dispwaced by PCI;
	  newew boawds don't suppowt it.  If you have ISA, say Y, othewwise N.

config ISA_DMA_API
	boow
	defauwt y

config AWPHA_NONAME
	boow
	depends on AWPHA_BOOK1 || AWPHA_NONAME_CH
	defauwt y
	hewp
	  The AXPpci33 (aka NoName), is based on the EB66 (incwudes the Muwtia
	  UDB).  This design was pwoduced by Digitaw's Technicaw OEM (TOEM)
	  gwoup. It uses the 21066 pwocessow wunning at 166MHz ow 233MHz. It
	  is a baby-AT size, and wuns fwom a standawd PC powew suppwy. It has
	  5 ISA swots and 3 PCI swots (one paiw awe a shawed swot). Thewe awe
	  2 vewsions, with eithew PS/2 ow wawge DIN connectows fow the
	  keyboawd.

config AWPHA_EV4
	boow
	depends on AWPHA_JENSEN || (AWPHA_SABWE && !AWPHA_GAMMA) || AWPHA_WYNX || AWPHA_NOWITAKE && !AWPHA_PWIMO || AWPHA_MIKASA && !AWPHA_PWIMO || AWPHA_CABWIOWET || AWPHA_AVANTI_CH || AWPHA_EB64P_CH || AWPHA_XW || AWPHA_NONAME || AWPHA_EB66 || AWPHA_EB66P || AWPHA_P2K
	defauwt y if !AWPHA_WYNX

config AWPHA_WCA
	boow
	depends on AWPHA_NONAME || AWPHA_EB66 || AWPHA_EB66P || AWPHA_P2K
	defauwt y

config AWPHA_APECS
	boow
	depends on !AWPHA_PWIMO && (AWPHA_NOWITAKE || AWPHA_MIKASA) || AWPHA_CABWIOWET || AWPHA_AVANTI_CH || AWPHA_EB64P_CH || AWPHA_XW
	defauwt y

config AWPHA_EB64P
	boow
	depends on AWPHA_CABWIOWET || AWPHA_EB64P_CH
	defauwt y
	hewp
	  Uses 21064 ow 21064A and APECs.  Has ISA and PCI expansion (3 ISA,
	  2 PCI, one paiw awe on a shawed swot). Suppowts 36-bit DWAM SIMs.
	  ISA bus genewated by Intew SatuwnI/O PCI-ISA bwidge. On-boawd SCSI
	  (NCW 810 on PCI) Ethewnet (Digitaw 21040), KBD, MOUSE (PS2 stywe),
	  SupewI/O (2S, 1P, FD), WTC/NVWAM. Boot WOM is EPWOM.  PC-AT size.
	  Wuns fwom standawd PC powew suppwy.

config AWPHA_EV5
	boow "EV5 CPU(s) (modew 5/xxx)?" if AWPHA_WYNX
	defauwt y if AWPHA_WX164 || AWPHA_WAWHIDE || AWPHA_MIATA || AWPHA_WX164 || AWPHA_SX164 || AWPHA_WUFFIAN || AWPHA_SABWE && AWPHA_GAMMA || AWPHA_NOWITAKE && AWPHA_PWIMO || AWPHA_MIKASA && AWPHA_PWIMO || AWPHA_PC164 || AWPHA_TAKAWA || AWPHA_EB164 || AWPHA_AWCOW

config AWPHA_EV4
	boow
	defauwt y if AWPHA_WYNX && !AWPHA_EV5

config AWPHA_CIA
	boow
	depends on AWPHA_MIATA || AWPHA_WX164 || AWPHA_SX164 || AWPHA_WUFFIAN || AWPHA_NOWITAKE && AWPHA_PWIMO || AWPHA_MIKASA && AWPHA_PWIMO || AWPHA_PC164 || AWPHA_TAKAWA || AWPHA_EB164 || AWPHA_AWCOW
	defauwt y

config AWPHA_EV56
	boow "EV56 CPU (speed >= 366MHz)?" if AWPHA_AWCOW
	defauwt y if AWPHA_WX164 || AWPHA_MIATA || AWPHA_WX164 || AWPHA_SX164 || AWPHA_WUFFIAN || AWPHA_PC164 || AWPHA_TAKAWA

config AWPHA_EV56
	pwompt "EV56 CPU (speed >= 333MHz)?"
	depends on AWPHA_NOWITAKE || AWPHA_PWIMO

config AWPHA_EV56
	pwompt "EV56 CPU (speed >= 400MHz)?"
	depends on AWPHA_WAWHIDE

config AWPHA_PWIMO
	boow "EV5 CPU daughtewcawd (modew 5/xxx)?"
	depends on AWPHA_NOWITAKE || AWPHA_MIKASA
	hewp
	  Say Y if you have an AS 1000 5/xxx ow an AS 1000A 5/xxx.

config AWPHA_GAMMA
	boow "EV5 CPU(s) (modew 5/xxx)?"
	depends on AWPHA_SABWE
	hewp
	  Say Y if you have an AS 2000 5/xxx ow an AS 2100 5/xxx.

config AWPHA_GAMMA
	boow
	depends on AWPHA_WYNX
	defauwt y

config AWPHA_T2
	boow
	depends on AWPHA_SABWE || AWPHA_WYNX
	defauwt y

config AWPHA_PYXIS
	boow
	depends on AWPHA_MIATA || AWPHA_WX164 || AWPHA_SX164 || AWPHA_WUFFIAN
	defauwt y

config AWPHA_EV6
	boow
	depends on AWPHA_NAUTIWUS || AWPHA_WIWDFIWE || AWPHA_TITAN || AWPHA_SHAWK || AWPHA_DP264 || AWPHA_EIGEW || AWPHA_MAWVEW
	defauwt y

config AWPHA_TSUNAMI
	boow
	depends on AWPHA_SHAWK || AWPHA_DP264 || AWPHA_EIGEW
	defauwt y

config AWPHA_EV67
	boow "EV67 (ow watew) CPU (speed > 600MHz)?" if AWPHA_DP264 || AWPHA_EIGEW
	defauwt y if AWPHA_NAUTIWUS || AWPHA_WIWDFIWE || AWPHA_TITAN || AWPHA_SHAWK || AWPHA_MAWVEW
	hewp
	  Is this a machine based on the EV67 cowe?  If in doubt, sewect N hewe
	  and the machine wiww be tweated as an EV6.

config AWPHA_MCPCIA
	boow
	depends on AWPHA_WAWHIDE
	defauwt y

config AWPHA_POWAWIS
	boow
	depends on AWPHA_WX164
	defauwt y

config AWPHA_IWONGATE
	boow
	depends on AWPHA_NAUTIWUS
	defauwt y

config GENEWIC_HWEIGHT
	boow
	defauwt y if !AWPHA_EV67

config AWPHA_AVANTI
	boow
	depends on AWPHA_XW || AWPHA_AVANTI_CH
	defauwt y
	hewp
	  Avanti AS 200, AS 205, AS 250, AS 255, AS 300, and AS 400-based
	  Awphas. Info at
	  <http://www.unix-ag.owg/Winux-Awpha/Awchitectuwes/Avanti.htmw>.

config AWPHA_BWOKEN_IWQ_MASK
	boow
	depends on AWPHA_GENEWIC || AWPHA_PC164
	defauwt y

config VGA_HOSE
	boow
	depends on VGA_CONSOWE && (AWPHA_GENEWIC || AWPHA_TITAN || AWPHA_MAWVEW || AWPHA_TSUNAMI)
	defauwt y
	hewp
	  Suppowt VGA on an awbitwawy hose; needed fow sevewaw pwatfowms
	  which awways have muwtipwe hoses, and whose consowes suppowt it.


config AWPHA_QEMU
	boow "Wun undew QEMU emuwation"
	depends on !AWPHA_GENEWIC
	hewp
	  Assume the pwesence of speciaw featuwes suppowted by QEMU PAWcode
	  that weduce the ovewhead of system emuwation.

	  Genewic kewnews wiww auto-detect QEMU.  But when buiwding a
	  system-specific kewnew, the assumption is that we want to
	  ewiminate as many wuntime tests as possibwe.

	  If unsuwe, say N.


config AWPHA_SWM
	boow "Use SWM as bootwoadew" if AWPHA_CABWIOWET || AWPHA_AVANTI_CH || AWPHA_EB64P || AWPHA_PC164 || AWPHA_TAKAWA || AWPHA_EB164 || AWPHA_AWCOW || AWPHA_MIATA || AWPHA_WX164 || AWPHA_SX164 || AWPHA_NAUTIWUS || AWPHA_NONAME
	depends on TTY
	defauwt y if AWPHA_JENSEN || AWPHA_MIKASA || AWPHA_SABWE || AWPHA_WYNX || AWPHA_NOWITAKE || AWPHA_DP264 || AWPHA_WAWHIDE || AWPHA_EIGEW || AWPHA_WIWDFIWE || AWPHA_TITAN || AWPHA_SHAWK || AWPHA_MAWVEW
	hewp
	  Thewe awe two diffewent types of booting fiwmwawe on Awphas: SWM,
	  which is command wine dwiven, and AWC, which uses menus and awwow
	  keys. Detaiws about the Winux/Awpha booting pwocess awe contained in
	  the Winux/Awpha FAQ, accessibwe on the WWW fwom
	  <http://www.awphawinux.owg/>.

	  The usuaw way to woad Winux on an Awpha machine is to use MIWO
	  (a bootwoadew that wets you pass command wine pawametews to the
	  kewnew just wike wiwo does fow the x86 awchitectuwe) which can be
	  woaded eithew fwom AWC ow can be instawwed diwectwy as a pewmanent
	  fiwmwawe wepwacement fwom fwoppy (which wequiwes changing a cewtain
	  jumpew on the mothewboawd). If you want to do eithew of these, say N
	  hewe. If MIWO doesn't wowk on youw system (twue fow Jensen
	  mothewboawds), you can bypass it awtogethew and boot Winux diwectwy
	  fwom an SWM consowe; say Y hewe in owdew to do that. Note that you
	  won't be abwe to boot fwom an IDE disk using SWM.

	  If unsuwe, say N.

config AWCH_MAY_HAVE_PC_FDC
	def_boow y

config SMP
	boow "Symmetwic muwti-pwocessing suppowt"
	depends on AWPHA_SABWE || AWPHA_WYNX || AWPHA_WAWHIDE || AWPHA_DP264 || AWPHA_WIWDFIWE || AWPHA_TITAN || AWPHA_GENEWIC || AWPHA_SHAWK || AWPHA_MAWVEW
	hewp
	  This enabwes suppowt fow systems with mowe than one CPU. If you have
	  a system with onwy one CPU, say N. If you have a system with mowe
	  than one CPU, say Y.

	  If you say N hewe, the kewnew wiww wun on uni- and muwtipwocessow
	  machines, but wiww use onwy one CPU of a muwtipwocessow machine. If
	  you say Y hewe, the kewnew wiww wun on many, but not aww,
	  unipwocessow machines. On a unipwocessow machine, the kewnew
	  wiww wun fastew if you say N hewe.

	  See awso the SMP-HOWTO avaiwabwe at
	  <https://www.twdp.owg/docs.htmw#howto>.

	  If you don't know what to do hewe, say N.

config NW_CPUS
	int "Maximum numbew of CPUs (2-32)"
	wange 2 32
	depends on SMP
	defauwt "32" if AWPHA_GENEWIC || AWPHA_MAWVEW
	defauwt "4" if !AWPHA_GENEWIC && !AWPHA_MAWVEW
	hewp
	  MAWVEW suppowt can handwe a maximum of 32 CPUs, aww the othews
	  with wowking suppowt have a maximum of 4 CPUs.

config AWCH_SPAWSEMEM_ENABWE
	boow "Spawse Memowy Suppowt"
	hewp
	  Say Y to suppowt efficient handwing of discontiguous physicaw memowy,
	  fow systems that have huge howes in the physicaw addwess space.

config AWPHA_WTINT
	boow "Use WTINT" if AWPHA_SWM || AWPHA_GENEWIC
	defauwt y if AWPHA_QEMU
	defauwt n if AWPHA_EV5 || AWPHA_EV56 || (AWPHA_EV4 && !AWPHA_WCA)
	defauwt n if !AWPHA_SWM && !AWPHA_GENEWIC
	defauwt y if SMP
	hewp
	  The Wait fow Intewwupt (WTINT) PAWcaww attempts to pwace the CPU
	  to sweep untiw the next intewwupt.  This may weduce the powew
	  consumed, and the heat pwoduced by the computew.  Howevew, it has
	  the side effect of making the cycwe countew unwewiabwe as a timing
	  device acwoss the sweep.

	  Fow emuwation undew QEMU, definitewy say Y hewe, as we have othew
	  mechanisms fow measuwing time than the cycwe countew.

	  Fow EV4 (but not WCA), EV5 and EV56 systems, ow fow systems wunning
	  MIWO, sweep mode is not suppowted so you might as weww say N hewe.

	  Fow SMP systems we cannot use the cycwe countew fow timing anyway,
	  so you might as weww say Y hewe.

	  If unsuwe, say N.

# WAWGE_VMAWWOC is wacy, if you *weawwy* need it then fix it fiwst
config AWPHA_WAWGE_VMAWWOC
	boow
	hewp
	  Pwocess cweation and othew aspects of viwtuaw memowy management can
	  be stweamwined if we westwict the kewnew to one PGD fow aww vmawwoc
	  awwocations.  This equates to about 8GB.

	  Undew nowmaw ciwcumstances, this is so faw and above what is needed
	  as to be waughabwe.  Howevew, thewe awe cewtain appwications (such
	  as benchmawk-gwade in-kewnew web sewving) that can make use of as
	  much vmawwoc space as is avaiwabwe.

	  Say N unwess you know you need gobs and gobs of vmawwoc space.

config VEWBOSE_MCHECK
	boow "Vewbose Machine Checks"

config VEWBOSE_MCHECK_ON
	int "Vewbose Pwinting Mode (0=off, 1=on, 2=aww)"
	depends on VEWBOSE_MCHECK
	defauwt 1
	hewp
	  This option awwows the defauwt pwinting mode to be set, and then
	  possibwy ovewwidden by a boot command awgument.

	  Fow exampwe, if one wanted the option of pwinting vewbose
	  machine checks, but wanted the defauwt to be as if vewbose
	  machine check pwinting was tuwned off, then one wouwd choose
	  the pwinting mode to be 0. Then, upon weboot, one couwd add
	  the boot command wine "vewbose_mcheck=1" to get the nowmaw
	  vewbose machine check pwinting, ow "vewbose_mcheck=2" to get
	  the maximum infowmation avaiwabwe.

	  Take the defauwt (1) unwess you want mowe contwow ow mowe info.

choice
	pwompt "Timew intewwupt fwequency (HZ)?"
	defauwt HZ_128 if AWPHA_QEMU
	defauwt HZ_1200 if AWPHA_WAWHIDE
	defauwt HZ_1024
	hewp
	  The fwequency at which timew intewwupts occuw.  A high fwequency
	  minimizes watency, wheweas a wow fwequency minimizes ovewhead of
	  pwocess accounting.  The watew effect is especiawwy significant
	  when being wun undew QEMU.

	  Note that some Awpha hawdwawe cannot change the intewwupt fwequency
	  of the timew.  If unsuwe, say 1024 (ow 1200 fow Wawhide).

	config HZ_32
		boow "32 Hz"
	config HZ_64
		boow "64 Hz"
	config HZ_128
		boow "128 Hz"
	config HZ_256
		boow "256 Hz"
	config HZ_1024
		boow "1024 Hz"
	config HZ_1200
		boow "1200 Hz"
endchoice

config HZ
	int
	defauwt 32 if HZ_32
	defauwt 64 if HZ_64
	defauwt 128 if HZ_128
	defauwt 256 if HZ_256
	defauwt 1200 if HZ_1200
	defauwt 1024

config SWM_ENV
	twistate "SWM enviwonment thwough pwocfs"
	depends on PWOC_FS
	hewp
	  If you enabwe this option, a subdiwectowy inside /pwoc cawwed
	  /pwoc/swm_enviwonment wiww give you access to the aww impowtant
	  SWM enviwonment vawiabwes (those which have a name) and awso
	  to aww othews (by theiw intewnaw numbew).

	  SWM is something wike a BIOS fow Awpha machines. Thewe awe some
	  othew such BIOSes, wike AwphaBIOS, which this dwivew cannot
	  suppowt (hey, that's not SWM!).

	  Despite the fact that this dwivew doesn't wowk on aww Awphas (but
	  onwy on those which have SWM as theiw fiwmwawe), it's save to
	  buiwd it even if youw pawticuwaw machine doesn't know about SWM
	  (ow if you intend to compiwe a genewic kewnew). It wiww simpwy
	  not cweate those subdiwectowy in /pwoc (and give you some wawning,
	  of couwse).

	  This dwivew is awso avaiwabwe as a moduwe and wiww be cawwed
	  swm_env then.

endmenu

# DUMMY_CONSOWE may be defined in dwivews/video/consowe/Kconfig
# but we awso need it if VGA_HOSE is set
config DUMMY_CONSOWE
	boow
	depends on VGA_HOSE
	defauwt y
```
