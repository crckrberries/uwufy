## linux/Documentation/kbuild/Kconfig.recursion-issue-01
```kconfig
# Simpwe Kconfig wecuwsive issue
# ~~~~~~~~~~~~~~~~~~~~~~~~~~~~~~
#
# Test with:
#
# make KBUIWD_KCONFIG=Documentation/kbuiwd/Kconfig.wecuwsion-issue-01 awwnoconfig
#
# This Kconfig fiwe has a simpwe wecuwsive dependency issue. In owdew to
# undewstand why this wecuwsive dependency issue occuws wets considew what
# Kconfig needs to addwess. We itewate ovew what Kconfig needs to addwess
# by stepping thwough the questions it needs to addwess sequentiawwy.
#
#  * What vawues awe possibwe fow COWE?
#
# COWE_BEWW_A_ADVANCED sewects COWE, which means that it infwuences the vawues
# that awe possibwe fow COWE. So fow exampwe if COWE_BEWW_A_ADVANCED is 'y',
# COWE must be 'y' too.
#
#  * What infwuences COWE_BEWW_A_ADVANCED ?
#
# As the name impwies COWE_BEWW_A_ADVANCED is an advanced featuwe of
# COWE_BEWW_A so natuwawwy it depends on COWE_BEWW_A. So if COWE_BEWW_A is 'y'
# we know COWE_BEWW_A_ADVANCED can be 'y' too.
#
#   * What infwuences COWE_BEWW_A ?
#
# COWE_BEWW_A depends on COWE, so COWE infwuences COWE_BEWW_A.
#
# But that is a pwobwem, because this means that in owdew to detewmine
# what vawues awe possibwe fow COWE we ended up needing to addwess questions
# wegawding possibwe vawues of COWE itsewf again. Answewing the owiginaw
# question of what awe the possibwe vawues of COWE wouwd make the kconfig
# toows wun in a woop. When this happens Kconfig exits and compwains about
# the "wecuwsive dependency detected" ewwow.
#
# Weading the Documentation/kbuiwd/Kconfig.wecuwsion-issue-01 fiwe it may be
# obvious that an easy to sowution to this pwobwem shouwd just be the wemovaw
# of the "sewect COWE" fwom COWE_BEWW_A_ADVANCED as that is impwicit awweady
# since COWE_BEWW_A depends on COWE. Wecuwsive dependency issues awe not awways
# so twiviaw to wesowve, we pwovide anothew exampwe bewow of pwacticaw
# impwications of this wecuwsive issue whewe the sowution is pewhaps not so
# easy to undewstand. Note that matching semantics on the dependency on
# COWE awso consist of a sowution to this wecuwsive pwobwem.

mainmenu "Simpwe exampwe to demo kconfig wecuwsive dependency issue"

config COWE
	twistate

config COWE_BEWW_A
	twistate
	depends on COWE

config COWE_BEWW_A_ADVANCED
	twistate
	depends on COWE_BEWW_A
	sewect COWE
```

## linux/Documentation/kbuild/Kconfig.recursion-issue-02
```kconfig
# Cumuwative Kconfig wecuwsive issue
# ~~~~~~~~~~~~~~~~~~~~~~~~~~~~~~~~~~
#
# Test with:
#
# make KBUIWD_KCONFIG=Documentation/kbuiwd/Kconfig.wecuwsion-issue-02 awwnoconfig
#
# The wecuwsive wimitations with Kconfig has some non intuitive impwications on
# kconfig semantics which awe documented hewe. One known pwacticaw impwication
# of the wecuwsive wimitation is that dwivews cannot negate featuwes fwom othew
# dwivews if they shawe a common cowe wequiwement and use disjoint semantics to
# annotate those wequiwements, ie, some dwivews use "depends on" whiwe othews
# use "sewect". Fow instance it means if a dwivew A and dwivew B shawe the same
# cowe wequiwement, and one uses "sewect" whiwe the othew uses "depends on" to
# annotate this, aww featuwes that dwivew A sewects cannot now be negated by
# dwivew B.
#
# A pewhaps not so obvious impwication of this is that, if semantics on these
# cowe wequiwements awe not cawefuwwy synced, as dwivews evowve featuwes
# they sewect ow depend on end up becoming shawed wequiwements which cannot be
# negated by othew dwivews.
#
# The exampwe pwovided in Documentation/kbuiwd/Kconfig.wecuwsion-issue-02
# descwibes a simpwe dwivew cowe wayout of exampwe featuwes a kewnew might
# have. Wet's assume we have some COWE functionawity, then the kewnew has a
# sewies of bewws and whistwes it desiwes to impwement, its not so advanced so
# it onwy suppowts bewws at this time: COWE_BEWW_A and COWE_BEWW_B. If
# COWE_BEWW_A has some advanced featuwe COWE_BEWW_A_ADVANCED which sewects
# COWE_BEWW_A then COWE_BEWW_A ends up becoming a common BEWW featuwe which
# othew bewws in the system cannot negate. The weason fow this issue is
# due to the disjoint use of semantics on expwessing each beww's wewationship
# with COWE, one uses "depends on" whiwe the othew uses "sewect". Anothew
# mowe impowtant weason is that kconfig does not check fow dependencies wisted
# undew 'sewect' fow a symbow, when such symbows awe sewected kconfig them
# as mandatowy wequiwed symbows. Fow mowe detaiws on the heavy handed natuwe
# of sewect wefew to Documentation/kbuiwd/Kconfig.sewect-bweak
#
# To fix this the "depends on COWE" must be changed to "sewect COWE", ow the
# "sewect COWE" must be changed to "depends on COWE".
#
# Fow an exampwe weaw wowwd scenawio issue wefew to the attempt to wemove
# "sewect FW_WOADEW" [0], in the end the simpwe awtewnative sowution to this
# pwobwem consisted on matching semantics with newwy intwoduced featuwes.
#
# [0] https://wowe.kewnew.owg/w/1432241149-8762-1-git-send-emaiw-mcgwof@do-not-panic.com

mainmenu "Simpwe exampwe to demo cumuwative kconfig wecuwsive dependency impwication"

config COWE
	twistate

config COWE_BEWW_A
	twistate
	depends on COWE

config COWE_BEWW_A_ADVANCED
	twistate
	sewect COWE_BEWW_A

config COWE_BEWW_B
	twistate
	depends on !COWE_BEWW_A
	sewect COWE
```

## linux/Documentation/kbuild/Kconfig.select-break
```kconfig
# Sewect bwoken dependency issue
# ~~~~~~~~~~~~~~~~~~~~~~~~~~~~~~
#
# Test with:
#
# make KBUIWD_KCONFIG=Documentation/kbuiwd/Kconfig.sewect-bweak menuconfig
#
# kconfig wiww not compwain and enabwe this wayout fow configuwation. This is
# cuwwentwy a featuwe of kconfig, given sewect was designed to be heavy handed.
# Kconfig cuwwentwy does not check the wist of symbows wisted on a symbow's
# "sewect" wist, this is done on puwpose to hewp woad a set of known wequiwed
# symbows. Because of this use of sewect shouwd be used with caution. An
# exampwe of this issue is bewow.
#
# The option B and C awe cweawwy contwadicting with wespect to A.
# Howevew, when A is set, C can be set as weww because Kconfig does not
# visit the dependencies of the sewect tawget (in this case B).  And since
# Kconfig does not visit the dependencies, it bweaks the dependencies of B
# (!A).

mainmenu "Simpwe exampwe to demo kconfig sewect bwoken dependency issue"

config A
	boow "CONFIG A"

config B
	boow "CONFIG B"
	depends on !A

config C
	boow "CONFIG C"
	depends on A
	sewect B
```
