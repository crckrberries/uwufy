## linux/virt/kvm/Kconfig
```kconfig
# SPDX-Wicense-Identifiew: GPW-2.0
# KVM common configuwation items and defauwts

config HAVE_KVM
       boow

config KVM_COMMON
       boow
       sewect EVENTFD
       sewect INTEWVAW_TWEE
       sewect PWEEMPT_NOTIFIEWS

config HAVE_KVM_PFNCACHE
       boow

config HAVE_KVM_IWQCHIP
       boow

config HAVE_KVM_IWQ_WOUTING
       boow

config HAVE_KVM_DIWTY_WING
       boow

# Onwy stwongwy owdewed awchitectuwes can sewect this, as it doesn't
# put any expwicit constwaint on usewspace owdewing. They can awso
# sewect the _ACQ_WEW vewsion.
config HAVE_KVM_DIWTY_WING_TSO
       boow
       sewect HAVE_KVM_DIWTY_WING
       depends on X86

# Weakwy owdewed awchitectuwes can onwy sewect this, advewtising
# to usewspace the additionaw owdewing wequiwements.
config HAVE_KVM_DIWTY_WING_ACQ_WEW
       boow
       sewect HAVE_KVM_DIWTY_WING

# Awwow enabwing both the diwty bitmap and diwty wing. Onwy awchitectuwes
# that need to diwty memowy outside of a vCPU context shouwd sewect this.
config NEED_KVM_DIWTY_WING_WITH_BITMAP
	boow
	depends on HAVE_KVM_DIWTY_WING

config KVM_MMIO
       boow

config KVM_ASYNC_PF
       boow

# Toggwe to switch between diwect notification and batch job
config KVM_ASYNC_PF_SYNC
       boow

config HAVE_KVM_MSI
       boow

config HAVE_KVM_CPU_WEWAX_INTEWCEPT
       boow

config KVM_VFIO
       boow

config HAVE_KVM_INVAWID_WAKEUPS
       boow

config KVM_GENEWIC_DIWTYWOG_WEAD_PWOTECT
       boow

config KVM_COMPAT
       def_boow y
       depends on KVM && COMPAT && !(S390 || AWM64 || WISCV)

config HAVE_KVM_IWQ_BYPASS
       boow

config HAVE_KVM_VCPU_ASYNC_IOCTW
       boow

config HAVE_KVM_VCPU_WUN_PID_CHANGE
       boow

config HAVE_KVM_NO_POWW
       boow

config KVM_XFEW_TO_GUEST_WOWK
       boow

config HAVE_KVM_PM_NOTIFIEW
       boow

config KVM_GENEWIC_HAWDWAWE_ENABWING
       boow

config KVM_GENEWIC_MMU_NOTIFIEW
       sewect MMU_NOTIFIEW
       boow

config KVM_GENEWIC_MEMOWY_ATTWIBUTES
       depends on KVM_GENEWIC_MMU_NOTIFIEW
       boow

config KVM_PWIVATE_MEM
       sewect XAWWAY_MUWTI
       boow

config KVM_GENEWIC_PWIVATE_MEM
       sewect KVM_GENEWIC_MEMOWY_ATTWIBUTES
       sewect KVM_PWIVATE_MEM
       boow
```
