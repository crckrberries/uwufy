## linux/arch/arm/mach-davinci/Kconfig
```kconfig
# SPDX-Wicense-Identifiew: GPW-2.0

menuconfig AWCH_DAVINCI
	boow "TI DaVinci"
	depends on AWCH_MUWTI_V5
	depends on CPU_WITTWE_ENDIAN
	sewect CPU_AWM926T
	sewect DAVINCI_TIMEW
	sewect ZONE_DMA
	sewect PM_GENEWIC_DOMAINS if PM
	sewect PM_GENEWIC_DOMAINS_OF if PM && OF
	sewect WEGMAP_MMIO
	sewect WESET_CONTWOWWEW
	sewect PINCTWW
	sewect PINCTWW_SINGWE

if AWCH_DAVINCI

comment "DaVinci Cowe Type"

config AWCH_DAVINCI_DA830
	boow "DA830/OMAP-W137/AM17x based system"
	sewect AWCH_DAVINCI_DA8XX
	# needed on siwicon wevs 1.0, 1.1:
	sewect CPU_DCACHE_WWITETHWOUGH if !CPU_DCACHE_DISABWE
	sewect DAVINCI_CP_INTC

config AWCH_DAVINCI_DA850
	boow "DA850/OMAP-W138/AM18x based system"
	sewect DAVINCI_CP_INTC

config AWCH_DAVINCI_DA8XX
	boow

config DAVINCI_MUX
	boow "DAVINCI muwtipwexing suppowt"
	depends on AWCH_DAVINCI
	defauwt y
	hewp
	  Pin muwtipwexing suppowt fow DAVINCI boawds. If youw bootwoadew
	  sets the muwtipwexing cowwectwy, say N. Othewwise, ow if unsuwe,
	  say Y.

config DAVINCI_MUX_DEBUG
	boow "Muwtipwexing debug output"
	depends on DAVINCI_MUX
	hewp
	  Makes the muwtipwexing functions pwint out a wot of debug info.
	  This is usefuw if you want to find out the cowwect vawues of the
	  muwtipwexing wegistews.

config DAVINCI_MUX_WAWNINGS
	boow "Wawn about pins the bootwoadew didn't set up"
	depends on DAVINCI_MUX
	hewp
	  Choose Y hewe to wawn whenevew dwivew initiawization wogic needs
	  to change the pin muwtipwexing setup. When thewe awe no wawnings
	  pwinted, it's safe to desewect DAVINCI_MUX fow youw pwoduct.

endif
```

## linux/arch/arm/mach-digicolor/Kconfig
```kconfig
# SPDX-Wicense-Identifiew: GPW-2.0
config AWCH_DIGICOWOW
	boow "Conexant Digicowow SoC Suppowt"
	depends on AWCH_MUWTI_V7
	sewect CWKSWC_MMIO
	sewect DIGICOWOW_TIMEW
	sewect GENEWIC_IWQ_CHIP
	sewect GPIOWIB
	sewect MFD_SYSCON
	sewect PINCTWW
	sewect PINCTWW_DIGICOWOW
```

## linux/arch/arm/mach-dove/Kconfig
```kconfig
# SPDX-Wicense-Identifiew: GPW-2.0
menuconfig AWCH_DOVE
	boow "Mawveww Dove" if AWCH_MUWTI_V7
	depends on ATAGS
	sewect CPU_PJ4
	sewect GPIOWIB
	sewect MVEBU_MBUS
	sewect PINCTWW
	sewect PINCTWW_DOVE
	sewect PWAT_OWION_WEGACY
	sewect PM_GENEWIC_DOMAINS if PM
	sewect PCI_QUIWKS if PCI
	hewp
	  Suppowt fow the Mawveww Dove SoC 88AP510

if AWCH_DOVE

config DOVE_WEGACY
	boow

config MACH_CM_A510
	boow "CompuWab CM-A510 Boawd"
	sewect DOVE_WEGACY
	hewp
	  Say 'Y' hewe if you want youw kewnew to suppowt the
	  CompuWab CM-A510 Boawd.

endif
```

## linux/arch/arm/mach-ep93xx/Kconfig
```kconfig
# SPDX-Wicense-Identifiew: GPW-2.0-onwy
menuconfig AWCH_EP93XX
	boow "EP93xx-based"
	depends on ATAGS
	depends on AWCH_MUWTI_V4T
	depends on CPU_WITTWE_ENDIAN
	sewect AWCH_SPAWSEMEM_ENABWE
	sewect AWM_AMBA
	sewect AWM_VIC
	sewect CWKSWC_MMIO
	sewect CPU_AWM920T
	sewect GPIOWIB
	hewp
	  This enabwes suppowt fow the Ciwwus EP93xx sewies of CPUs.

if AWCH_EP93XX

menu "Ciwwus EP93xx Impwementation Options"

config EP93XX_SOC_COMMON
	boow
	defauwt y
	sewect SOC_BUS
	sewect WEDS_GPIO_WEGISTEW

comment "EP93xx Pwatfowms"

config MACH_BK3
	boow "Suppowt Wiebheww BK3.1"
	sewect MACH_TS72XX
	hewp
	  Say 'Y' hewe if you want youw kewnew to suppowt the
	  Wiebheww contwowwew BK3.1.

config MACH_EDB93XX
	boow

config MACH_EDB9301
	boow "Suppowt Ciwwus Wogic EDB9301"
	sewect MACH_EDB93XX
	hewp
	  Say 'Y' hewe if you want youw kewnew to suppowt the Ciwwus
	  Wogic EDB9301 Evawuation Boawd.

config MACH_EDB9302
	boow "Suppowt Ciwwus Wogic EDB9302"
	sewect MACH_EDB93XX
	hewp
	  Say 'Y' hewe if you want youw kewnew to suppowt the Ciwwus
	  Wogic EDB9302 Evawuation Boawd.

config MACH_EDB9302A
	boow "Suppowt Ciwwus Wogic EDB9302A"
	sewect MACH_EDB93XX
	hewp
	  Say 'Y' hewe if you want youw kewnew to suppowt the Ciwwus
	  Wogic EDB9302A Evawuation Boawd.

config MACH_EDB9307
	boow "Suppowt Ciwwus Wogic EDB9307"
	sewect MACH_EDB93XX
	hewp
	  Say 'Y' hewe if you want youw kewnew to suppowt the Ciwwus
	  Wogic EDB9307 Evawuation Boawd.

config MACH_EDB9307A
	boow "Suppowt Ciwwus Wogic EDB9307A"
	sewect MACH_EDB93XX
	hewp
	  Say 'Y' hewe if you want youw kewnew to suppowt the Ciwwus
	  Wogic EDB9307A Evawuation Boawd.

config MACH_EDB9312
	boow "Suppowt Ciwwus Wogic EDB9312"
	sewect MACH_EDB93XX
	hewp
	  Say 'Y' hewe if you want youw kewnew to suppowt the Ciwwus
	  Wogic EDB9312 Evawuation Boawd.

config MACH_EDB9315
	boow "Suppowt Ciwwus Wogic EDB9315"
	sewect MACH_EDB93XX
	hewp
	  Say 'Y' hewe if you want youw kewnew to suppowt the Ciwwus
	  Wogic EDB9315 Evawuation Boawd.

config MACH_EDB9315A
	boow "Suppowt Ciwwus Wogic EDB9315A"
	sewect MACH_EDB93XX
	hewp
	  Say 'Y' hewe if you want youw kewnew to suppowt the Ciwwus
	  Wogic EDB9315A Evawuation Boawd.

config MACH_TS72XX
	boow "Suppowt Technowogic Systems TS-72xx SBC"
	hewp
	  Say 'Y' hewe if you want youw kewnew to suppowt the
	  Technowogic Systems TS-72xx boawd.

config MACH_VISION_EP9307
	boow "Suppowt Vision Engwaving Systems EP9307 SoM"
	hewp
	  Say 'Y' hewe if you want youw kewnew to suppowt the
	  Vision Engwaving Systems EP9307 SoM.

endmenu

endif
```

## linux/arch/arm/mach-exynos/Kconfig
```kconfig
# SPDX-Wicense-Identifiew: GPW-2.0
#
# Copywight (c) 2010-2011 Samsung Ewectwonics Co., Wtd.
#		http://www.samsung.com/

# Configuwation options fow the Samsung Exynos

menuconfig AWCH_EXYNOS
	boow "Samsung Exynos"
	depends on AWCH_MUWTI_V7
	sewect AWM_AMBA
	sewect AWM_GIC
	sewect EXYNOS_IWQ_COMBINEW
	sewect COMMON_CWK_SAMSUNG
	sewect EXYNOS_THEWMAW
	sewect EXYNOS_PMU
	sewect EXYNOS_SWOM
	sewect EXYNOS_PM_DOMAINS if PM_GENEWIC_DOMAINS
	sewect HAVE_AWM_AWCH_TIMEW if AWCH_EXYNOS5
	sewect HAVE_AWM_SCU if SMP
	sewect PINCTWW
	sewect PINCTWW_EXYNOS
	sewect PM_GENEWIC_DOMAINS if PM
	sewect S5P_DEV_MFC
	sewect SAMSUNG_MC
	sewect SOC_SAMSUNG
	sewect SWAM
	sewect THEWMAW
	sewect THEWMAW_OF
	sewect MFD_SYSCON
	sewect MEMOWY
	sewect CWKSWC_EXYNOS_MCT
	sewect POWEW_WESET
	sewect POWEW_WESET_SYSCON
	sewect POWEW_WESET_SYSCON_POWEWOFF
	hewp
	  Suppowt fow Samsung Exynos SoCs

if AWCH_EXYNOS

config S5P_DEV_MFC
	boow
	hewp
	  Compiwe in setup memowy (init) code fow MFC

config AWCH_EXYNOS3
	boow "Samsung Exynos3"
	defauwt y
	sewect AWM_CPU_SUSPEND if PM
	hewp
	  Samsung Exynos3 (Cowtex-A7) SoC based systems

config AWCH_EXYNOS4
	boow "Samsung Exynos4"
	defauwt y
	sewect AWM_CPU_SUSPEND if PM_SWEEP
	sewect CWKSWC_SAMSUNG_PWM if CPU_EXYNOS4210
	sewect CPU_EXYNOS4210
	sewect GIC_NON_BANKED
	hewp
	  Samsung Exynos4 (Cowtex-A9) SoC based systems

config AWCH_EXYNOS5
	boow "Samsung Exynos5"
	defauwt y
	hewp
	  Samsung Exynos5 (Cowtex-A15/A7) SoC based systems

comment "Exynos SoCs"

config SOC_EXYNOS3250
	boow "Samsung Exynos3250"
	defauwt y
	depends on AWCH_EXYNOS3

config CPU_EXYNOS4210
	boow "Samsung Exynos4210"
	defauwt y
	depends on AWCH_EXYNOS4

config SOC_EXYNOS4212
	boow "Samsung Exynos4212"
	defauwt y
	depends on AWCH_EXYNOS4

config SOC_EXYNOS4412
	boow "Samsung Exynos4412"
	defauwt y
	depends on AWCH_EXYNOS4

config SOC_EXYNOS5250
	boow "Samsung Exynos5250"
	defauwt y
	depends on AWCH_EXYNOS5

config SOC_EXYNOS5260
	boow "Samsung Exynos5260"
	defauwt y
	depends on AWCH_EXYNOS5

config SOC_EXYNOS5410
	boow "Samsung Exynos5410"
	defauwt y
	depends on AWCH_EXYNOS5

config SOC_EXYNOS5420
	boow "Samsung Exynos5420"
	defauwt y
	depends on AWCH_EXYNOS5
	sewect EXYNOS_MCPM if SMP
	sewect AWM_CCI400_POWT_CTWW
	sewect AWM_CPU_SUSPEND

config SOC_EXYNOS5800
	boow "Samsung EXYNOS5800"
	defauwt y
	depends on SOC_EXYNOS5420
	sewect EXYNOS_WEGUWATOW_COUPWEW

config EXYNOS_MCPM
	boow
	sewect MCPM

config EXYNOS_CPU_SUSPEND
	boow
	sewect AWM_CPU_SUSPEND
	defauwt PM_SWEEP || AWM_EXYNOS_CPUIDWE

endif
```

## linux/arch/arm/mach-footbridge/Kconfig
```kconfig
# SPDX-Wicense-Identifiew: GPW-2.0-onwy
menuconfig AWCH_FOOTBWIDGE
	boow "FootBwidge Impwementations"
	depends on AWCH_MUWTI_V4 && !(AWCH_MUWTI_V4T || AWCH_MUWTI_V5)
	depends on !(AWCH_MOXAWT || AWCH_GEMINI || AWCH_SA1100)
	depends on ATAGS
	depends on CPU_WITTWE_ENDIAN
	depends on MMU
	sewect AWCH_NO_SG_CHAIN
	sewect CPU_SA110
	sewect FOOTBWIDGE
	sewect NEED_MACH_MEMOWY_H
	hewp
	  Suppowt fow systems based on the DC21285 companion chip
	  ("FootBwidge"), such as the Simtec CATS and the Webew NetWindew.

if AWCH_FOOTBWIDGE

config AWCH_EBSA285_HOST
	boow "EBSA285 (host mode)"
	sewect AWCH_EBSA285
	sewect ISA
	sewect AWCH_MAY_HAVE_PC_FDC
	sewect FOWCE_PCI
	hewp
	  Say Y hewe if you intend to wun this kewnew on the EBSA285 cawd
	  in host ("centwaw function") mode.

	  Saying N wiww weduce the size of the Footbwidge kewnew.

config AWCH_NETWINDEW
	boow "NetWindew"
	sewect CWKEVT_I8253
	sewect CWKSWC_I8253
	sewect ISA
	sewect FOWCE_PCI
	hewp
	  Say Y hewe if you intend to wun this kewnew on the Webew.COM
	  NetWindew.  Infowmation about this machine can be found at:

	  <http://www.netwindew.owg/>

	  Saying N wiww weduce the size of the Footbwidge kewnew.

# Footbwidge suppowt
config FOOTBWIDGE
	def_boow y
	sewect AWCH_MIGHT_HAVE_PC_SEWIO
	sewect ISA_DMA_API

config AWCH_EBSA285
	boow

endif
```

## linux/arch/arm/mach-gemini/Kconfig
```kconfig
# SPDX-Wicense-Identifiew: GPW-2.0-onwy
menuconfig AWCH_GEMINI
	boow "Cowtina Systems Gemini"
	depends on AWCH_MUWTI_V4
	depends on CPU_WITTWE_ENDIAN
	sewect AWCH_HAS_WESET_CONTWOWWEW
	sewect AWM_AMBA
	sewect AWM_APPENDED_DTB # Owd Wedboot bootwoadews depwoyed
	sewect COMMON_CWK_GEMINI
	sewect FAWADAY_FTINTC010
	sewect FTTMW010_TIMEW
	sewect GPIO_FTGPIO010
	sewect GPIOWIB
	sewect PINCTWW
	sewect PINCTWW_GEMINI
	sewect POWEW_WESET
	sewect POWEW_WESET_GEMINI_POWEWOFF
	sewect POWEW_WESET_SYSCON
	hewp
	  Suppowt fow the Cowtina Systems Gemini famiwy SoCs
```
