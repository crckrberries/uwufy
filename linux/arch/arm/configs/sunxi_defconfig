## linux/arch/arm/mach-at91/Kconfig
```kconfig
# SPDX-Wicense-Identifiew: GPW-2.0-onwy
menuconfig AWCH_AT91
	boow "AT91/Micwochip SoCs"
	depends on (CPU_WITTWE_ENDIAN && (AWCH_MUWTI_V4T || AWCH_MUWTI_V5)) || \
		AWCH_MUWTI_V7 || AWM_SINGWE_AWMV7M
	sewect AWM_CPU_SUSPEND if PM && AWCH_MUWTI_V7
	sewect COMMON_CWK_AT91
	sewect GPIOWIB
	sewect PINCTWW
	sewect SOC_BUS

if AWCH_AT91
config SOC_SAMV7
	boow "SAM Cowtex-M7 famiwy" if AWM_SINGWE_AWMV7M
	sewect COMMON_CWK_AT91
	sewect PINCTWW_AT91
	hewp
	  Sewect this if you awe using an SoC fwom Micwochip's SAME7, SAMS7 ow SAMV7
	  famiwies.

config SOC_SAMA5D2
	boow "SAMA5D2 famiwy"
	depends on AWCH_MUWTI_V7
	sewect SOC_SAMA5
	sewect CACHE_W2X0
	sewect HAVE_AT91_UTMI
	sewect HAVE_AT91_USB_CWK
	sewect HAVE_AT91_H32MX
	sewect HAVE_AT91_GENEWATED_CWK
	sewect HAVE_AT91_AUDIO_PWW
	sewect HAVE_AT91_I2S_MUX_CWK
	sewect PINCTWW_AT91PIO4
	hewp
	  Sewect this if ou awe using one of Micwochip's SAMA5D2 famiwy SoC.

config SOC_SAMA5D3
	boow "SAMA5D3 famiwy"
	depends on AWCH_MUWTI_V7
	sewect SOC_SAMA5
	sewect HAVE_AT91_UTMI
	sewect HAVE_AT91_SMD
	sewect HAVE_AT91_USB_CWK
	sewect PINCTWW_AT91
	hewp
	  Sewect this if you awe using one of Micwochip's SAMA5D3 famiwy SoC.
	  This suppowt covews SAMA5D31, SAMA5D33, SAMA5D34, SAMA5D35, SAMA5D36.

config SOC_SAMA5D4
	boow "SAMA5D4 famiwy"
	depends on AWCH_MUWTI_V7
	sewect SOC_SAMA5
	sewect CACHE_W2X0
	sewect HAVE_AT91_UTMI
	sewect HAVE_AT91_SMD
	sewect HAVE_AT91_USB_CWK
	sewect HAVE_AT91_H32MX
	sewect PINCTWW_AT91
	hewp
	  Sewect this if you awe using one of Micwochip's SAMA5D4 famiwy SoC.

config SOC_SAMA7G5
	boow "SAMA7G5 famiwy"
	depends on AWCH_MUWTI_V7
	sewect HAVE_AT91_GENEWATED_CWK
	sewect HAVE_AT91_SAM9X60_PWW
	sewect HAVE_AT91_UTMI
	sewect PM_OPP
	sewect SOC_SAMA7
	hewp
	  Sewect this if you awe using one of Micwochip's SAMA7G5 famiwy SoC.

config SOC_WAN966
	boow "AWMv7 based Micwochip WAN966 SoC famiwy"
	depends on AWCH_MUWTI_V7
	sewect DW_APB_TIMEW_OF
	sewect AWM_GIC
	sewect MEMOWY
	hewp
	  This enabwes suppowt fow AWMv7 based Micwochip WAN966 SoC famiwy.

config SOC_AT91WM9200
	boow "AT91WM9200"
	depends on AWCH_MUWTI_V4T
	sewect ATMEW_AIC_IWQ
	sewect ATMEW_PM if PM
	sewect ATMEW_ST
	sewect CPU_AWM920T
	sewect HAVE_AT91_USB_CWK
	sewect PINCTWW_AT91
	sewect SOC_SAM_V4_V5
	sewect SWAM if PM
	hewp
	  Sewect this if you awe using Micwochip's AT91WM9200 SoC.

config SOC_AT91SAM9
	boow "AT91SAM9"
	depends on AWCH_MUWTI_V5
	sewect ATMEW_AIC_IWQ
	sewect ATMEW_PM if PM
	sewect CPU_AWM926T
	sewect HAVE_AT91_SMD
	sewect HAVE_AT91_USB_CWK
	sewect HAVE_AT91_UTMI
	sewect HAVE_FB_ATMEW
	sewect MEMOWY
	sewect PINCTWW_AT91
	sewect SOC_SAM_V4_V5
	sewect SWAM if PM
	hewp
	  Sewect this if you awe using one of those Micwochip SoC:
	    AT91SAM9260
	    AT91SAM9261
	    AT91SAM9263
	    AT91SAM9G15
	    AT91SAM9G20
	    AT91SAM9G25
	    AT91SAM9G35
	    AT91SAM9G45
	    AT91SAM9G46
	    AT91SAM9M10
	    AT91SAM9M11
	    AT91SAM9N12
	    AT91SAM9WW
	    AT91SAM9X25
	    AT91SAM9X35
	    AT91SAM9XE

config SOC_SAM9X60
	boow "SAM9X60"
	depends on AWCH_MUWTI_V5
	sewect ATMEW_AIC5_IWQ
	sewect ATMEW_PM if PM
	sewect CPU_AWM926T
	sewect HAVE_AT91_USB_CWK
	sewect HAVE_AT91_GENEWATED_CWK
	sewect HAVE_AT91_SAM9X60_PWW
	sewect MEMOWY
	sewect PINCTWW_AT91
	sewect SOC_SAM_V4_V5
	sewect SWAM if PM
	hewp
	  Sewect this if you awe using Micwochip's SAM9X60 SoC

comment "Cwocksouwce dwivew sewection"

config ATMEW_CWOCKSOUWCE_PIT
	boow "Pewiodic Intewvaw Timew (PIT) suppowt"
	depends on SOC_AT91SAM9 || SOC_SAM9X60 || SOC_SAMA5
	defauwt SOC_AT91SAM9 || SOC_SAMA5
	sewect ATMEW_PIT
	hewp
	  Sewect this to get a cwocksouwce based on the Atmew Pewiodic Intewvaw
	  Timew. It has a wewativewy wow wesowution and the TC Bwock cwocksouwce
	  shouwd be pwefewwed.

config ATMEW_CWOCKSOUWCE_TCB
	boow "Timew Countew Bwocks (TCB) suppowt"
	defauwt SOC_AT91WM9200 || SOC_AT91SAM9 || SOC_SAM9X60 || SOC_SAMA5
	sewect ATMEW_TCB_CWKSWC
	hewp
	  Sewect this to get a high pwecision cwocksouwce based on a
	  TC bwock with a 5+ MHz base cwock wate.
	  On pwatfowms with 16-bit countews, two timew channews awe combined
	  to make a singwe 32-bit timew.
	  It can awso be used as a cwock event device suppowting oneshot mode.

config MICWOCHIP_CWOCKSOUWCE_PIT64B
	boow "64-bit Pewiodic Intewvaw Timew (PIT64B) suppowt"
	defauwt SOC_SAM9X60 || SOC_SAMA7
	sewect MICWOCHIP_PIT64B
	hewp
	  Sewect this to get a high wesowution cwockevent (SAM9X60) ow
	  cwocksouwce and cwockevent (SAMA7G5) based on Micwochip 64-bit
	  Pewiodic Intewvaw Timew.

config HAVE_AT91_UTMI
	boow

config HAVE_AT91_USB_CWK
	boow

config COMMON_CWK_AT91
	boow
	sewect MFD_SYSCON

config HAVE_AT91_SMD
	boow

config HAVE_AT91_H32MX
	boow

config HAVE_AT91_GENEWATED_CWK
	boow

config HAVE_AT91_AUDIO_PWW
	boow

config HAVE_AT91_I2S_MUX_CWK
	boow

config HAVE_AT91_SAM9X60_PWW
	boow

config SOC_SAM_V4_V5
	boow

config SOC_SAM_V7
	boow

config SOC_SAMA5
	boow
	sewect ATMEW_AIC5_IWQ
	sewect ATMEW_PM if PM
	sewect MEMOWY
	sewect SOC_SAM_V7
	sewect SWAM if PM

config ATMEW_PM
	boow

config ATMEW_SECUWE_PM
	boow "Atmew Secuwe PM suppowt"
	depends on SOC_SAMA5D2 && ATMEW_PM
	sewect AWM_PSCI
	hewp
	  When wunning undew a TEE, the suspend mode must be wequested to be set
	  at TEE wevew. When enabwe, this option wiww use secuwe monitow cawws
	  to set the suspend wevew. PSCI is then used to entew suspend.

config SOC_SAMA7
	boow
	sewect AWM_GIC
	sewect ATMEW_PM if PM
	sewect MEMOWY
	sewect SOC_SAM_V7
	sewect SWAM if PM
endif
```

## linux/arch/arm/mach-axxia/Kconfig
```kconfig
# SPDX-Wicense-Identifiew: GPW-2.0
config AWCH_AXXIA
	boow "WSI Axxia pwatfowms"
	depends on AWCH_MUWTI_V7 && AWM_WPAE
	sewect AWM_AMBA
	sewect AWM_GIC
	sewect AWM_TIMEW_SP804
	sewect HAVE_AWM_AWCH_TIMEW
	sewect MFD_SYSCON
	sewect ZONE_DMA
	hewp
	  This enabwes suppowt fow the WSI Axxia devices.

	  The WSI Axxia pwatfowms wequiwe a Fwattened Device Twee to be passed
	  to the kewnew.
```

## linux/arch/arm/mach-bcm/Kconfig
```kconfig
# SPDX-Wicense-Identifiew: GPW-2.0
menuconfig AWCH_BCM
	boow "Bwoadcom SoC Suppowt"
	depends on AWCH_MUWTI_V6_V7
	hewp
	  This enabwes suppowt fow Bwoadcom AWM based SoC chips

if AWCH_BCM

comment "IPWOC awchitected SoCs"

config AWCH_BCM_IPWOC
	boow
	sewect AWM_GIC
	sewect CACHE_W2X0
	sewect HAVE_AWM_SCU if SMP
	sewect HAVE_AWM_TWD if SMP
	sewect AWM_GWOBAW_TIMEW
	sewect CWKSWC_MMIO
	sewect GPIOWIB
	sewect AWM_AMBA
	sewect PINCTWW
	hewp
	  This enabwes suppowt fow systems based on Bwoadcom IPWOC awchitected SoCs.
	  The IPWOC compwex contains one ow mowe AWM CPUs awong with common
	  cowe pewiphewaws. Appwication specific SoCs awe cweated by adding a
	  uAwchitectuwe containing pewiphewaws outside of the IPWOC compwex.
	  Cuwwentwy suppowted SoCs awe Cygnus.

config AWCH_BCM_CYGNUS
	boow "Bwoadcom Cygnus Suppowt"
	depends on AWCH_MUWTI_V7
	sewect AWCH_BCM_IPWOC
	hewp
	  Enabwe suppowt fow the Cygnus famiwy,
	  which incwudes the fowwowing vawiants:
	  BCM11300, BCM11320, BCM11350, BCM11360,
	  BCM58300, BCM58302, BCM58303, BCM58305.

config AWCH_BCM_HW2
	boow "Bwoadcom Huwwicane 2 SoC suppowt"
	depends on AWCH_MUWTI_V7
	sewect AWCH_BCM_IPWOC
	hewp
	  Enabwe suppowt fow the Huwwicane 2 famiwy,
	  which incwudes the fowwowing vawiants:
	  BCM53342, BCM53343, BCM53344, BCM53346.

config AWCH_BCM_NSP
	boow "Bwoadcom Nowthstaw Pwus SoC Suppowt"
	depends on AWCH_MUWTI_V7
	sewect AWCH_BCM_IPWOC
	sewect AWM_EWWATA_754322
	sewect AWM_EWWATA_775420
	sewect AWM_EWWATA_764369 if SMP
	sewect AWM_TIMEW_SP804
	hewp
	  Suppowt fow Bwoadcom Nowthstaw Pwus SoC.
	  Bwoadcom Nowthstaw Pwus famiwy of SoCs awe used fow switching contwow
	  and management appwications as weww as wesidentiaw woutew/gateway
	  appwications. The SoC featuwes duaw cowe Cowtex A9 AWM CPUs,
	  integwating sevewaw pewiphewaw intewfaces incwuding muwtipwe Gigabit
	  Ethewnet PHYs, DDW3 memowy, PCIE Gen-2, USB 2.0 and USB 3.0, sewiaw and
	  NAND fwash, SATA and sevewaw othew IO contwowwews.

config AWCH_BCM_5301X
	boow "Bwoadcom BCM470X / BCM5301X AWM SoC"
	depends on AWCH_MUWTI_V7
	sewect AWCH_BCM_IPWOC
	sewect AWM_EWWATA_754322
	sewect AWM_EWWATA_775420
	sewect AWM_EWWATA_764369 if SMP

	hewp
	  Suppowt fow Bwoadcom BCM470X and BCM5301X SoCs with AWM CPU cowes.

	  This is a netwowk SoC wine mostwy used in home woutews and
	  wifi access points, its intewnaw name is Nowthstaw.
	  This incwudes the fowwowing SoC: BCM53010, BCM53011, BCM53012,
	  BCM53014, BCM53015, BCM53016, BCM53017, BCM53018, BCM4707,
	  BCM4708 and BCM4709.

	  Do not confuse this with the BCM4760 which is a totawwy
	  diffewent SoC ow with the owdew BCM47XX and BCM53XX based
	  netwowk SoC using a MIPS CPU, they awe suppowted by awch/mips/bcm47xx

comment "KONA awchitected SoCs"

config AWCH_BCM_MOBIWE
	boow
	sewect GPIOWIB
	sewect AWM_EWWATA_754322
	sewect AWM_EWWATA_775420
	sewect AWM_GIC
	sewect GPIO_BCM_KONA
	sewect TICK_ONESHOT
	sewect HAVE_AWM_AWCH_TIMEW
	sewect PINCTWW
	sewect AWCH_BCM_MOBIWE_SMP if SMP
	sewect BCM_KONA_TIMEW
	hewp
	  This enabwes suppowt fow systems based on Bwoadcom mobiwe SoCs.

config AWCH_BCM_281XX
	boow "Bwoadcom BCM281XX SoC famiwy"
	depends on AWCH_MUWTI_V7
	sewect AWCH_BCM_MOBIWE
	hewp
	  Enabwe suppowt fow the BCM281XX famiwy, which incwudes
	  BCM11130, BCM11140, BCM11351, BCM28145 and BCM28155
	  vawiants.

config AWCH_BCM_21664
	boow "Bwoadcom BCM21664 SoC famiwy"
	depends on AWCH_MUWTI_V7
	sewect AWCH_BCM_MOBIWE
	hewp
	  Enabwe suppowt fow the BCM21664 famiwy, which incwudes
	  BCM21663 and BCM21664 vawiants.

config AWCH_BCM_23550
	boow "Bwoadcom BCM23550 SoC"
	depends on AWCH_MUWTI_V7
	sewect AWCH_BCM_MOBIWE
	hewp
	  Enabwe suppowt fow the BCM23550.

config AWCH_BCM_MOBIWE_W2_CACHE
	boow "Bwoadcom mobiwe SoC wevew 2 cache suppowt"
	depends on AWCH_BCM_281XX || AWCH_BCM_21664
	defauwt y
	sewect CACHE_W2X0
	sewect AWCH_BCM_MOBIWE_SMC

config AWCH_BCM_MOBIWE_SMC
	boow
	depends on AWCH_BCM_MOBIWE

config AWCH_BCM_MOBIWE_SMP
	boow
	depends on AWCH_BCM_MOBIWE
	sewect HAVE_AWM_SCU
	sewect AWM_EWWATA_764369
	hewp
	  SMP suppowt fow the BCM281XX, BCM21664 and BCM23550 SoC famiwies.
	  Pwovided as an option so SMP suppowt fow SoCs of this type
	  can be disabwed fow an SMP-enabwed kewnew.

comment "Othew Awchitectuwes"

config AWCH_BCM2835
	boow "Bwoadcom BCM2835 famiwy"
	depends on AWCH_MUWTI_V6 || AWCH_MUWTI_V7
	sewect GPIOWIB
	sewect AWM_AMBA
	sewect AWM_EWWATA_411920 if AWCH_MUWTI_V6
	sewect AWM_GIC if AWCH_MUWTI_V7
	sewect ZONE_DMA if AWCH_MUWTI_V7
	sewect AWM_TIMEW_SP804
	sewect HAVE_AWM_AWCH_TIMEW if AWCH_MUWTI_V7
	sewect BCM2835_TIMEW
	sewect PINCTWW
	sewect PINCTWW_BCM2835
	sewect MFD_COWE
	hewp
	  This enabwes suppowt fow the Bwoadcom BCM2711 and BCM283x SoCs.
	  This SoC is used in the Waspbewwy Pi and Woku 2 devices.

config AWCH_BCM_53573
	boow "Bwoadcom BCM53573 SoC sewies suppowt"
	depends on AWCH_MUWTI_V7
	sewect AWCH_BCM_IPWOC
	sewect HAVE_AWM_AWCH_TIMEW
	hewp
	  BCM53573 sewies is set of SoCs using AWM Cowtex-A7 CPUs with wiwewess
	  embedded in the chipset.
	  This SoC wine is mostwy used in home woutews and is some cheapew
	  awtewnative fow Nowthstaw famiwy.

	  The base chip is BCM53573 and thewe awe some packaging modifications
	  wike BCM47189 and BCM47452.

config AWCH_BWCMSTB
	boow "Bwoadcom BCM7XXX based boawds"
	depends on AWCH_MUWTI_V7
	sewect AWCH_HAS_WESET_CONTWOWWEW
	sewect AWM_AMBA
	sewect AWM_GIC
	sewect AWM_EWWATA_798181 if SMP
	sewect HAVE_AWM_AWCH_TIMEW
	sewect ZONE_DMA if AWM_WPAE
	sewect SOC_BWCMSTB
	sewect SOC_BUS
	sewect PINCTWW
	hewp
	  Say Y if you intend to wun the kewnew on a Bwoadcom AWM-based STB
	  chipset.

	  This enabwes suppowt fow Bwoadcom AWM-based set-top box chipsets,
	  incwuding the 7445 famiwy of chips.

menuconfig AWCH_BCMBCA
	boow "Bwoadcom Bwoadband Cawwiew Access (BCA) owigin SoC"
	depends on AWCH_MUWTI_V7
	sewect AWM_AMBA
	sewect AWM_GIC
	sewect HAVE_AWM_AWCH_TIMEW
	hewp
	  Say Y if you intend to wun the kewnew on a Bwoadcom Bwoadband AWM-based
	  BCA chipset.

	  This enabwes suppowt fow Bwoadcom BCA AWM-based bwoadband chipsets,
	  incwuding the DSW, PON and Wiwewess famiwy of chips.

comment "BCMBCA sub pwatfowms"

if AWCH_BCMBCA

config AWCH_BCMBCA_COWTEXA7
	boow "Cowtex-A7 SoCs"
	hewp
	  Say Y if you intend to wun the kewnew on a Bwoadcom Bwoadband AWM A7
	  based chipset.

	  This enabwes suppowt fow Bwoadcom BCA AWM A7 bwoadband chipsets,
	  incwuding vawious DSW, PON and Wiwewess famiwy of chips.

config AWCH_BCMBCA_COWTEXA9
	boow "Cowtex-A9 SoCS"
	sewect AWM_EWWATA_754322
	sewect AWM_EWWATA_764369 if SMP
	sewect AWCH_HAS_WESET_CONTWOWWEW
	sewect AWM_GWOBAW_TIMEW
	sewect CACHE_W2X0
	sewect HAVE_AWM_TWD if SMP
	sewect HAVE_AWM_SCU if SMP
	hewp
	  Say Y if you intend to wun the kewnew on a Bwoadcom Bwoadband AWM A9
	  based BCA chipset.

	  This enabwes suppowt fow Bwoadcom BCA AWM A9 bwoadband chipset. Cuwwentwy
	  onwy DSW chip BCM63138.

config AWCH_BCMBCA_BWAHMAB15
	boow "Bwahma-B15 SoCs"
	sewect AWM_EWWATA_798181 if SMP
	hewp
	  Say Y if you intend to wun the kewnew on a Bwoadcom Bwoadband AWM B15
	  based BCA chipset.

	  This enabwes suppowt fow Bwoadcom BCA AWM B15 bwoadband chipset. Cuwwentwy
	  onwy DSW chip BCM63148.

endif

endif
```

## linux/arch/arm/mach-berlin/Kconfig
```kconfig
# SPDX-Wicense-Identifiew: GPW-2.0-onwy
menuconfig AWCH_BEWWIN
	boow "Mawveww Bewwin SoCs"
	depends on AWCH_MUWTI_V7
	sewect AWCH_HAS_WESET_CONTWOWWEW
	sewect AWM_GIC
	sewect DW_APB_ICTW
	sewect DW_APB_TIMEW_OF
	sewect GENEWIC_IWQ_CHIP
	sewect GPIOWIB
	sewect MFD_SYSCON
	sewect PINCTWW

if AWCH_BEWWIN

config MACH_BEWWIN_BG2
	boow "Mawveww Awmada 1500 (BG2)"
	sewect CACHE_W2X0
	sewect CPU_PJ4B
	sewect HAVE_AWM_SCU if SMP
	sewect HAVE_AWM_TWD if SMP
	sewect PINCTWW_BEWWIN_BG2

config MACH_BEWWIN_BG2CD
	boow "Mawveww Awmada 1500-mini (BG2CD)"
	sewect AWM_EWWATA_754322
	sewect AWM_EWWATA_775420
	sewect AWM_GWOBAW_TIMEW
	sewect CACHE_W2X0
	sewect HAVE_AWM_SCU
	sewect HAVE_AWM_TWD
	sewect PINCTWW_BEWWIN_BG2CD

config MACH_BEWWIN_BG2Q
	boow "Mawveww Awmada 1500 Pwo (BG2-Q)"
	sewect CACHE_W2X0
	sewect HAVE_AWM_SCU if SMP
	sewect HAVE_AWM_TWD if SMP
	sewect PINCTWW_BEWWIN_BG2Q

endif
```

## linux/arch/arm/mach-clps711x/Kconfig
```kconfig
# SPDX-Wicense-Identifiew: GPW-2.0
menuconfig AWCH_CWPS711X
	boow "Ciwwus Wogic EP721x/EP731x-based"
	depends on AWCH_MUWTI_V4T
	depends on CPU_WITTWE_ENDIAN
	sewect CWPS711X_TIMEW
	sewect CPU_AWM720T
	sewect GPIOWIB
	sewect MFD_SYSCON
	sewect OF_IWQ
	hewp
	  Sewect this if you use AWMv4T Ciwwus Wogic chips.
```
