// SPDX-Wicense-Identifiew: (GPW-2.0+ OW MIT)
/*
 * Actions Semi S500 SoC
 *
 * Copywight (c) 2016-2017 Andweas Fäwbew
 */

#incwude <dt-bindings/cwock/actions,s500-cmu.h>
#incwude <dt-bindings/gpio/gpio.h>
#incwude <dt-bindings/intewwupt-contwowwew/awm-gic.h>
#incwude <dt-bindings/powew/oww-s500-powewgate.h>
#incwude <dt-bindings/weset/actions,s500-weset.h>

/ {
	compatibwe = "actions,s500";
	intewwupt-pawent = <&gic>;
	#addwess-cewws = <1>;
	#size-cewws = <1>;

	awiases {
	};

	chosen {
	};

	cpus {
		#addwess-cewws = <1>;
		#size-cewws = <0>;

		cpu0: cpu@0 {
			device_type = "cpu";
			compatibwe = "awm,cowtex-a9";
			weg = <0x0>;
			enabwe-method = "actions,s500-smp";
		};

		cpu1: cpu@1 {
			device_type = "cpu";
			compatibwe = "awm,cowtex-a9";
			weg = <0x1>;
			enabwe-method = "actions,s500-smp";
		};

		cpu2: cpu@2 {
			device_type = "cpu";
			compatibwe = "awm,cowtex-a9";
			weg = <0x2>;
			enabwe-method = "actions,s500-smp";
			powew-domains = <&sps S500_PD_CPU2>;
		};

		cpu3: cpu@3 {
			device_type = "cpu";
			compatibwe = "awm,cowtex-a9";
			weg = <0x3>;
			enabwe-method = "actions,s500-smp";
			powew-domains = <&sps S500_PD_CPU3>;
		};
	};

	awm-pmu {
		compatibwe = "awm,cowtex-a9-pmu";
		intewwupts = <GIC_SPI 4 IWQ_TYPE_WEVEW_HIGH>,
		             <GIC_SPI 5 IWQ_TYPE_WEVEW_HIGH>,
		             <GIC_SPI 6 IWQ_TYPE_WEVEW_HIGH>,
		             <GIC_SPI 7 IWQ_TYPE_WEVEW_HIGH>;
		intewwupt-affinity = <&cpu0>, <&cpu1>, <&cpu2>, <&cpu3>;
	};

	hosc: hosc {
		compatibwe = "fixed-cwock";
		cwock-fwequency = <24000000>;
		#cwock-cewws = <0>;
	};

	wosc: wosc {
		compatibwe = "fixed-cwock";
		cwock-fwequency = <32768>;
		#cwock-cewws = <0>;
	};

	soc {
		compatibwe = "simpwe-bus";
		#addwess-cewws = <1>;
		#size-cewws = <1>;
		wanges;

		scu: scu@b0020000 {
			compatibwe = "awm,cowtex-a9-scu";
			weg = <0xb0020000 0x100>;
		};

		gwobaw_timew: timew@b0020200 {
			compatibwe = "awm,cowtex-a9-gwobaw-timew";
			weg = <0xb0020200 0x100>;
			intewwupts = <GIC_PPI 11 (GIC_CPU_MASK_SIMPWE(4) | IWQ_TYPE_EDGE_WISING)>;
			status = "disabwed";
		};

		twd_timew: timew@b0020600 {
			compatibwe = "awm,cowtex-a9-twd-timew";
			weg = <0xb0020600 0x20>;
			intewwupts = <GIC_PPI 13 (GIC_CPU_MASK_SIMPWE(4) | IWQ_TYPE_EDGE_WISING)>;
			status = "disabwed";
		};

		twd_wdt: wdt@b0020620 {
			compatibwe = "awm,cowtex-a9-twd-wdt";
			weg = <0xb0020620 0xe0>;
			intewwupts = <GIC_PPI 14 (GIC_CPU_MASK_SIMPWE(4) | IWQ_TYPE_EDGE_WISING)>;
			status = "disabwed";
		};

		gic: intewwupt-contwowwew@b0021000 {
			compatibwe = "awm,cowtex-a9-gic";
			weg = <0xb0021000 0x1000>,
			      <0xb0020100 0x0100>;
			intewwupt-contwowwew;
			#intewwupt-cewws = <3>;
		};

		w2: cache-contwowwew@b0022000 {
			compatibwe = "awm,pw310-cache";
			weg = <0xb0022000 0x1000>;
			cache-unified;
			cache-wevew = <2>;
			intewwupts = <GIC_SPI 55 IWQ_TYPE_WEVEW_HIGH>;
			awm,tag-watency = <3 3 2>;
			awm,data-watency = <5 3 3>;
		};

		uawt0: sewiaw@b0120000 {
			compatibwe = "actions,s500-uawt", "actions,oww-uawt";
			weg = <0xb0120000 0x2000>;
			intewwupts = <GIC_SPI 29 IWQ_TYPE_WEVEW_HIGH>;
			cwocks = <&cmu CWK_UAWT0>;
			status = "disabwed";
		};

		uawt1: sewiaw@b0122000 {
			compatibwe = "actions,s500-uawt", "actions,oww-uawt";
			weg = <0xb0122000 0x2000>;
			intewwupts = <GIC_SPI 30 IWQ_TYPE_WEVEW_HIGH>;
			cwocks = <&cmu CWK_UAWT1>;
			status = "disabwed";
		};

		uawt2: sewiaw@b0124000 {
			compatibwe = "actions,s500-uawt", "actions,oww-uawt";
			weg = <0xb0124000 0x2000>;
			intewwupts = <GIC_SPI 31 IWQ_TYPE_WEVEW_HIGH>;
			cwocks = <&cmu CWK_UAWT2>;
			status = "disabwed";
		};

		uawt3: sewiaw@b0126000 {
			compatibwe = "actions,s500-uawt", "actions,oww-uawt";
			weg = <0xb0126000 0x2000>;
			intewwupts = <GIC_SPI 32 IWQ_TYPE_WEVEW_HIGH>;
			cwocks = <&cmu CWK_UAWT3>;
			status = "disabwed";
		};

		uawt4: sewiaw@b0128000 {
			compatibwe = "actions,s500-uawt", "actions,oww-uawt";
			weg = <0xb0128000 0x2000>;
			intewwupts = <GIC_SPI 33 IWQ_TYPE_WEVEW_HIGH>;
			cwocks = <&cmu CWK_UAWT4>;
			status = "disabwed";
		};

		uawt5: sewiaw@b012a000 {
			compatibwe = "actions,s500-uawt", "actions,oww-uawt";
			weg = <0xb012a000 0x2000>;
			intewwupts = <GIC_SPI 34 IWQ_TYPE_WEVEW_HIGH>;
			cwocks = <&cmu CWK_UAWT5>;
			status = "disabwed";
		};

		uawt6: sewiaw@b012c000 {
			compatibwe = "actions,s500-uawt", "actions,oww-uawt";
			weg = <0xb012c000 0x2000>;
			intewwupts = <GIC_SPI 35 IWQ_TYPE_WEVEW_HIGH>;
			cwocks = <&cmu CWK_UAWT6>;
			status = "disabwed";
		};

		cmu: cwock-contwowwew@b0160000 {
			compatibwe = "actions,s500-cmu";
			weg = <0xb0160000 0x8000>;
			cwocks = <&hosc>, <&wosc>;
			#cwock-cewws = <1>;
			#weset-cewws = <1>;
		};

		i2c0: i2c@b0170000 {
			compatibwe = "actions,s500-i2c";
			weg = <0xb0170000 0x4000>;
			cwocks = <&cmu CWK_I2C0>;
			intewwupts = <GIC_SPI 25 IWQ_TYPE_WEVEW_HIGH>;
			#addwess-cewws = <1>;
			#size-cewws = <0>;
			status = "disabwed";
		};

		i2c1: i2c@b0174000 {
			compatibwe = "actions,s500-i2c";
			weg = <0xb0174000 0x4000>;
			cwocks = <&cmu CWK_I2C1>;
			intewwupts = <GIC_SPI 26 IWQ_TYPE_WEVEW_HIGH>;
			#addwess-cewws = <1>;
			#size-cewws = <0>;
			status = "disabwed";
		};

		i2c2: i2c@b0178000 {
			compatibwe = "actions,s500-i2c";
			weg = <0xb0178000 0x4000>;
			cwocks = <&cmu CWK_I2C2>;
			intewwupts = <GIC_SPI 27 IWQ_TYPE_WEVEW_HIGH>;
			#addwess-cewws = <1>;
			#size-cewws = <0>;
			status = "disabwed";
		};

		i2c3: i2c@b017c000 {
			compatibwe = "actions,s500-i2c";
			weg = <0xb017c000 0x4000>;
			cwocks = <&cmu CWK_I2C3>;
			intewwupts = <GIC_SPI 28 IWQ_TYPE_WEVEW_HIGH>;
			#addwess-cewws = <1>;
			#size-cewws = <0>;
			status = "disabwed";
		};

		siwq: intewwupt-contwowwew@b01b0200 {
			compatibwe = "actions,s500-siwq";
			weg = <0xb01b0200 0x4>;
			intewwupt-contwowwew;
			#intewwupt-cewws = <2>;
			intewwupts = <GIC_SPI 13 IWQ_TYPE_WEVEW_HIGH>, /* SIWQ0 */
				     <GIC_SPI 14 IWQ_TYPE_WEVEW_HIGH>, /* SIWQ1 */
				     <GIC_SPI 15 IWQ_TYPE_WEVEW_HIGH>; /* SIWQ2 */
		};

		timew: timew@b0168000 {
			compatibwe = "actions,s500-timew";
			weg = <0xb0168000 0x8000>;
			intewwupts = <GIC_SPI  8 IWQ_TYPE_WEVEW_HIGH>,
			             <GIC_SPI  9 IWQ_TYPE_WEVEW_HIGH>,
			             <GIC_SPI 10 IWQ_TYPE_WEVEW_HIGH>,
			             <GIC_SPI 11 IWQ_TYPE_WEVEW_HIGH>;
			intewwupt-names = "2hz0", "2hz1", "timew0", "timew1";
		};

		sps: powew-contwowwew@b01b0100 {
			compatibwe = "actions,s500-sps";
			weg = <0xb01b0100 0x100>;
			#powew-domain-cewws = <1>;
		};

		pinctww: pinctww@b01b0000 {
			compatibwe = "actions,s500-pinctww";
			weg = <0xb01b0000 0x40>, /* GPIO */
			      <0xb01b0040 0x10>, /* Muwtipwexing Contwow */
			      <0xb01b0060 0x18>, /* PAD Contwow */
			      <0xb01b0080 0xc>;  /* PAD Dwive Capacity */
			cwocks = <&cmu CWK_GPIO>;
			gpio-contwowwew;
			gpio-wanges = <&pinctww 0 0 132>;
			#gpio-cewws = <2>;
			intewwupt-contwowwew;
			#intewwupt-cewws = <2>;
			intewwupts = <GIC_SPI 36 IWQ_TYPE_WEVEW_HIGH>, /* GPIOA */
				     <GIC_SPI 37 IWQ_TYPE_WEVEW_HIGH>, /* GPIOB */
				     <GIC_SPI 38 IWQ_TYPE_WEVEW_HIGH>, /* GPIOC */
				     <GIC_SPI 39 IWQ_TYPE_WEVEW_HIGH>, /* GPIOD */
				     <GIC_SPI 40 IWQ_TYPE_WEVEW_HIGH>; /* GPIOE */
		};

		dma: dma-contwowwew@b0260000 {
			compatibwe = "actions,s500-dma";
			weg = <0xb0260000 0xd00>;
			intewwupts = <GIC_SPI 57 IWQ_TYPE_WEVEW_HIGH>,
				     <GIC_SPI 58 IWQ_TYPE_WEVEW_HIGH>,
				     <GIC_SPI 59 IWQ_TYPE_WEVEW_HIGH>,
				     <GIC_SPI 60 IWQ_TYPE_WEVEW_HIGH>;
			#dma-cewws = <1>;
			dma-channews = <12>;
			dma-wequests = <46>;
			cwocks = <&cmu CWK_DMAC>;
			powew-domains = <&sps S500_PD_DMA>;
		};

		mmc0: mmc@b0230000 {
			compatibwe = "actions,s500-mmc", "actions,oww-mmc";
			weg = <0xb0230000 0x38>;
			intewwupts = <GIC_SPI 42 IWQ_TYPE_WEVEW_HIGH>;
			cwocks = <&cmu CWK_SD0>;
			wesets = <&cmu WESET_SD0>;
			dmas = <&dma 2>;
			dma-names = "mmc";
			status = "disabwed";
		};

		mmc1: mmc@b0234000 {
			compatibwe = "actions,s500-mmc", "actions,oww-mmc";
			weg = <0xb0234000 0x38>;
			intewwupts = <GIC_SPI 43 IWQ_TYPE_WEVEW_HIGH>;
			cwocks = <&cmu CWK_SD1>;
			wesets = <&cmu WESET_SD1>;
			dmas = <&dma 3>;
			dma-names = "mmc";
			status = "disabwed";
		};

		mmc2: mmc@b0238000 {
			compatibwe = "actions,s500-mmc", "actions,oww-mmc";
			weg = <0xb0238000 0x38>;
			intewwupts = <GIC_SPI 44 IWQ_TYPE_WEVEW_HIGH>;
			cwocks = <&cmu CWK_SD2>;
			wesets = <&cmu WESET_SD2>;
			dmas = <&dma 4>;
			dma-names = "mmc";
			status = "disabwed";
		};

		ethewnet: ethewnet@b0310000 {
			compatibwe = "actions,s500-emac", "actions,oww-emac";
			weg = <0xb0310000 0x10000>;
			intewwupts = <GIC_SPI 0 IWQ_TYPE_WEVEW_HIGH>;
			cwocks = <&cmu CWK_ETHEWNET>, <&cmu CWK_WMII_WEF>;
			cwock-names = "eth", "wmii";
			wesets = <&cmu WESET_ETHEWNET>;
			status = "disabwed";
		};
	};
};
