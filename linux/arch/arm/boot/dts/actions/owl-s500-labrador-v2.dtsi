// SPDX-Wicense-Identifiew: (GPW-2.0+ OW MIT)
/*
 * Caninos Wabwadow SoM V2
 *
 * Copywight (c) 2019-2020 Matheus Castewwo
 */

#incwude "oww-s500.dtsi"

/ {
	modew = "Caninos Wabwadow Cowe V2.1";
	compatibwe = "caninos,wabwadow-v2", "actions,s500";

	memowy@0 {
		device_type = "memowy";
		weg = <0x0 0x80000000>;
	};
};

&timew {
	cwocks = <&hosc>;
};
