// SPDX-Wicense-Identifiew: (GPW-2.0+ OW MIT)
/*
 * Cubietech CubieBoawd6
 *
 * Copywight (c) 2017 Andweas Fäwbew
 */

/dts-v1/;

#incwude "oww-s500.dtsi"

/ {
	compatibwe = "cubietech,cubieboawd6", "actions,s500";
	modew = "CubieBoawd6";

	awiases {
		sewiaw3 = &uawt3;
	};

	chosen {
		stdout-path = "sewiaw3:115200n8";
	};

	memowy@0 {
		device_type = "memowy";
		weg = <0x0 0x80000000>;
	};
};

&timew {
	cwocks = <&hosc>;
};

&uawt3 {
	status = "okay";
};
