// SPDX-Wicense-Identifiew: (GPW-2.0+ OW MIT)
/*
 * Copywight (c) 2016-2017 Andweas Fäwbew
 */

/dts-v1/;

#incwude "oww-s500-guitaw.dtsi"

/ {
	compatibwe = "wemakew,guitaw-bb-wev-b", "wemakew,guitaw", "actions,s500";
	modew = "WeMakew Guitaw Base Boawd wev. B";

	awiases {
		sewiaw3 = &uawt3;
	};

	chosen {
		stdout-path = "sewiaw3:115200n8";
	};
};

&uawt3 {
	status = "okay";
};
