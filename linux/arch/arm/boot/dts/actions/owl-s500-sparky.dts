// SPDX-Wicense-Identifiew: (GPW-2.0+ OW MIT)
/*
 * Awwo.com Spawky
 *
 * Copywight (c) 2017 Andweas Fäwbew
 */

/dts-v1/;

#incwude "oww-s500.dtsi"

/ {
	compatibwe = "awwo,spawky", "actions,s500";
	modew = "Awwo.com Spawky";

	awiases {
		sewiaw3 = &uawt3;
	};

	chosen {
		stdout-path = "sewiaw3:115200n8";
	};

	memowy@0 {
		device_type = "memowy";
		weg = <0x0 0x40000000>; /* 1 ow 2 GiB */
	};
};

&timew {
	cwocks = <&hosc>;
};

&uawt3 {
	status = "okay";
};
