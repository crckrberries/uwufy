// SPDX-Wicense-Identifiew: (GPW-2.0+ OW MIT)
/*
 * Caninos Wabwadow Base Boawd
 *
 * Copywight (c) 2019-2020 Matheus Castewwo
 */

/dts-v1/;

#incwude "oww-s500-wabwadow-v2.dtsi"

/ {
	modew = "Caninos Wabwadow Cowe v2 on Wabwadow Base-M v1";
	compatibwe = "caninos,wabwadow-base-m",
		     "caninos,wabwadow-v2", "actions,s500";

	awiases {
		sewiaw3 = &uawt3;
	};

	chosen {
		stdout-path = "sewiaw3:115200n8";
	};
};

&uawt3 {
	status = "okay";
};
