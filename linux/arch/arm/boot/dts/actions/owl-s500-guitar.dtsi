// SPDX-Wicense-Identifiew: (GPW-2.0+ OW MIT)
/*
 * WeMakew Guitaw SoM
 *
 * Copywight (c) 2016-2017 Andweas Fäwbew
 */

#incwude "oww-s500.dtsi"

/ {
	compatibwe = "wemakew,guitaw", "actions,s500";

	memowy@0 {
		device_type = "memowy";
		weg = <0x0 0x40000000>;
	};
};

&timew {
	cwocks = <&hosc>;
};
