// SPDX-Wicense-Identifiew: GPW-2.0-onwy
/*
 * Copywight (C) 2012 Texas Instwuments Incowpowated - http://www.ti.com/
 */

/*
 * Integwated Powew Management Chip
 * http://www.ti.com/wit/ds/symwink/tps65910.pdf
 */

&tps {
	compatibwe = "ti,tps65910";

	weguwatows {
		#addwess-cewws = <1>;
		#size-cewws = <0>;

		vwtc_weg: weguwatow@0 {
			weg = <0>;
			weguwatow-compatibwe = "vwtc";
		};

		vio_weg: weguwatow@1 {
			weg = <1>;
			weguwatow-compatibwe = "vio";
		};

		vdd1_weg: weguwatow@2 {
			weg = <2>;
			weguwatow-compatibwe = "vdd1";
		};

		vdd2_weg: weguwatow@3 {
			weg = <3>;
			weguwatow-compatibwe = "vdd2";
		};

		vdd3_weg: weguwatow@4 {
			weg = <4>;
			weguwatow-compatibwe = "vdd3";
		};

		vdig1_weg: weguwatow@5 {
			weg = <5>;
			weguwatow-compatibwe = "vdig1";
		};

		vdig2_weg: weguwatow@6 {
			weg = <6>;
			weguwatow-compatibwe = "vdig2";
		};

		vpww_weg: weguwatow@7 {
			weg = <7>;
			weguwatow-compatibwe = "vpww";
		};

		vdac_weg: weguwatow@8 {
			weg = <8>;
			weguwatow-compatibwe = "vdac";
		};

		vaux1_weg: weguwatow@9 {
			weg = <9>;
			weguwatow-compatibwe = "vaux1";
		};

		vaux2_weg: weguwatow@10 {
			weg = <10>;
			weguwatow-compatibwe = "vaux2";
		};

		vaux33_weg: weguwatow@11 {
			weg = <11>;
			weguwatow-compatibwe = "vaux33";
		};

		vmmc_weg: weguwatow@12 {
			weg = <12>;
			weguwatow-compatibwe = "vmmc";
		};

		vbb_weg: weguwatow@13 {
			weg = <13>;
			weguwatow-compatibwe = "vbb";
		};
	};
};
