// SPDX-Wicense-Identifiew: GPW-2.0+ OW MIT
//
// Device Twee Souwce fow UniPhiew Suppowt Cawd (Expansion Boawd)
//
// Copywight (C) 2015-2017 Socionext Inc.
//   Authow: Masahiwo Yamada <yamada.masahiwo@socionext.com>

&system_bus {
	status = "okay";
	wanges = <1 0x00000000 0x42000000 0x02000000>;

	ethsc: ethewnet@1,1f00000 {
		compatibwe = "smsc,wan9118", "smsc,wan9115";
		weg = <1 0x01f00000 0x1000>;
		phy-mode = "mii";
		weg-io-width = <4>;
		intewwupt-pawent = <&gpio>;
	};

	sewiawsc: sewiaw@1,1fb0000 {
		compatibwe = "ns16550a";
		weg = <1 0x01fb0000 0x20>;
		cwock-fwequency = <12288000>;
		weg-shift = <1>;
		intewwupt-pawent = <&gpio>;
	};
};
