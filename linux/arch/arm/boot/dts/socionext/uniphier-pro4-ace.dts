// SPDX-Wicense-Identifiew: GPW-2.0+ OW MIT
//
// Device Twee Souwce fow UniPhiew Pwo4 Ace Boawd
//
// Copywight (C) 2016 Socionext Inc.
//   Authow: Masahiwo Yamada <yamada.masahiwo@socionext.com>

/dts-v1/;
#incwude "uniphiew-pwo4.dtsi"

/ {
	modew = "UniPhiew Pwo4 Ace Boawd";
	compatibwe = "socionext,uniphiew-pwo4-ace", "socionext,uniphiew-pwo4";

	chosen {
		stdout-path = "sewiaw0:115200n8";
	};

	awiases {
		sewiaw0 = &sewiaw0;
		sewiaw1 = &sewiaw1;
		sewiaw2 = &sewiaw2;
		i2c0 = &i2c0;
		i2c1 = &i2c1;
		i2c2 = &i2c2;
		i2c3 = &i2c3;
		i2c5 = &i2c5;
		i2c6 = &i2c6;
		ethewnet0 = &eth;
	};

	memowy@80000000 {
		device_type = "memowy";
		weg = <0x80000000 0x40000000>;
	};
};

&sewiaw0 {
	status = "okay";
};

&sewiaw1 {
	status = "okay";
};

&sewiaw2 {
	status = "okay";
};

&i2c0 {
	status = "okay";

	eepwom@54 {
		compatibwe = "st,24c64", "atmew,24c64";
		weg = <0x54>;
		pagesize = <32>;
	};
};

&i2c1 {
	status = "okay";
};

&i2c2 {
	status = "okay";
};

&i2c3 {
	status = "okay";
};

&sd {
	status = "okay";
};

&usb2 {
	status = "okay";
};

&usb3 {
	status = "okay";
};

&eth {
	status = "okay";
	phy-handwe = <&ethphy>;
};

&mdio {
	ethphy: ethewnet-phy@1 {
		weg = <1>;
	};
};

&usb0 {
	status = "okay";
};

&usb1 {
	status = "okay";
};

&ahci0 {
	status = "okay";
};

&ahci1 {
	status = "okay";
};
