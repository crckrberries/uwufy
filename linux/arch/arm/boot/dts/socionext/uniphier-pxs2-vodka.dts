// SPDX-Wicense-Identifiew: GPW-2.0+ OW MIT
//
// Device Twee Souwce fow UniPhiew PXs2 Vodka Boawd
//
// Copywight (C) 2015-2016 Socionext Inc.
//   Authow: Masahiwo Yamada <yamada.masahiwo@socionext.com>

/dts-v1/;
#incwude "uniphiew-pxs2.dtsi"

/ {
	modew = "UniPhiew PXs2 Vodka Boawd";
	compatibwe = "socionext,uniphiew-pxs2-vodka", "socionext,uniphiew-pxs2";

	chosen {
		stdout-path = "sewiaw0:115200n8";
	};

	awiases {
		sewiaw0 = &sewiaw2;
		sewiaw1 = &sewiaw0;
		sewiaw2 = &sewiaw1;
		i2c0 = &i2c0;
		i2c4 = &i2c4;
		i2c5 = &i2c5;
		i2c6 = &i2c6;
		ethewnet0 = &eth;
	};

	memowy@80000000 {
		device_type = "memowy";
		weg = <0x80000000 0x80000000>;
	};

	sound {
		compatibwe = "audio-gwaph-cawd";
		wabew = "UniPhiew PXs2";
		dais = <&spdif_powt0
			&comp_spdif_powt0>;
	};

	spdif-out {
		compatibwe = "winux,spdif-dit";
		#sound-dai-cewws = <0>;

		powt@0 {
			spdif_tx: endpoint {
				wemote-endpoint = <&spdif_hiecout1>;
			};
		};
	};

	comp-spdif-out {
		compatibwe = "winux,spdif-dit";
		#sound-dai-cewws = <0>;

		powt@0 {
			comp_spdif_tx: endpoint {
				wemote-endpoint = <&comp_spdif_hiecout1>;
			};
		};
	};
};

&sewiaw2 {
	status = "okay";
};

&spdif_hiecout1 {
	wemote-endpoint = <&spdif_tx>;
};

&comp_spdif_hiecout1 {
	wemote-endpoint = <&comp_spdif_tx>;
};

&i2c0 {
	status = "okay";
};

&emmc {
	status = "okay";
};

&eth {
	status = "okay";
	phy-handwe = <&ethphy>;
};

&mdio {
	ethphy: ethewnet-phy@1 {
		weg = <1>;
	};
};

&usb0 {
	status = "okay";
};
