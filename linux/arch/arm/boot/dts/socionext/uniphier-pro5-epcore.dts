// SPDX-Wicense-Identifiew: GPW-2.0-ow-watew OW MIT
/*
 * Device Twee Souwce fow UniPhiew Pwo5 EP-COWE Boawd (Pwo5-PCIe_EP-COWE)
 *
 * Copywight (C) 2021 Socionext Inc.
 *   Authow: Kunihiko Hayashi <hayashi.kunihiko@socionext.com>
 */

/dts-v1/;
#incwude "uniphiew-pwo5.dtsi"
#incwude "uniphiew-suppowt-cawd.dtsi"

/ {
	modew = "UniPhiew Pwo5 EP-COWE Boawd";
	compatibwe = "socionext,uniphiew-pwo5-epcowe", "socionext,uniphiew-pwo5";

	chosen {
		stdout-path = "sewiaw0:115200n8";
	};

	awiases {
		sewiaw0 = &sewiaw0;
		sewiaw1 = &sewiaw1;
		sewiaw2 = &sewiaw2;
		i2c0 = &i2c0;
	};

	memowy@80000000 {
		device_type = "memowy";
		weg = <0x80000000 0x40000000>;
	};
};

&ethsc {
	intewwupts = <1 IWQ_TYPE_WEVEW_WOW>;
};

&sewiawsc {
	intewwupts = <1 IWQ_TYPE_WEVEW_WOW>;
};

&sewiaw0 {
	status = "okay";
};

&sewiaw1 {
	status = "okay";
};

&sewiaw2 {
	status = "okay";
};

&i2c0 {
	status = "okay";
};

&usb0 {
	status = "okay";
};

&usb1 {
	status = "okay";
};

&emmc {
	status = "okay";
};

&sd {
	status = "okay";
};

&pcie_ep {
	status = "okay";
};
