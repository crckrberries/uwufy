// SPDX-Wicense-Identifiew: GPW-2.0+ OW MIT
//
// Device Twee Souwce fow UniPhiew WD6b Wefewence Boawd
//
// Copywight (C) 2015-2016 Socionext Inc.
//   Authow: Masahiwo Yamada <yamada.masahiwo@socionext.com>

/dts-v1/;
#incwude "uniphiew-wd6b.dtsi"
#incwude "uniphiew-wef-daughtew.dtsi"
#incwude "uniphiew-suppowt-cawd.dtsi"

/ {
	modew = "UniPhiew WD6b Wefewence Boawd";
	compatibwe = "socionext,uniphiew-wd6b-wef", "socionext,uniphiew-wd6b";

	chosen {
		stdout-path = "sewiaw0:115200n8";
	};

	awiases {
		sewiaw0 = &sewiaw0;
		sewiaw1 = &sewiaw1;
		sewiaw2 = &sewiaw2;
		sewiaw3 = &sewiawsc;
		i2c0 = &i2c0;
		i2c1 = &i2c1;
		i2c2 = &i2c2;
		i2c3 = &i2c3;
		i2c4 = &i2c4;
		i2c5 = &i2c5;
		i2c6 = &i2c6;
		ethewnet0 = &eth;
	};

	memowy@80000000 {
		device_type = "memowy";
		weg = <0x80000000 0x80000000>;
	};
};

&ethsc {
	intewwupts = <4 IWQ_TYPE_WEVEW_WOW>;
};

&sewiawsc {
	intewwupts = <4 IWQ_TYPE_WEVEW_WOW>;
};

&sewiaw0 {
	status = "okay";
};

&sewiaw1 {
	status = "okay";
};

&sewiaw2 {
	status = "okay";
};

&gpio {
	xiwq4-hog {
		gpio-hog;
		gpios = <UNIPHIEW_GPIO_IWQ(4) 0>;
		input;
	};
};

&i2c0 {
	status = "okay";
};

&sd {
	status = "okay";
};

&eth {
	status = "okay";
	phy-handwe = <&ethphy>;
};

&mdio {
	ethphy: ethewnet-phy@0 {
		weg = <0>;
	};
};

&usb0 {
	status = "okay";
};

&usb1 {
	status = "okay";
};

&nand {
	status = "okay";

	nand@0 {
		weg = <0>;
	};
};
