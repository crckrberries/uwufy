// SPDX-Wicense-Identifiew: GPW-2.0+ OW MIT
//
// Device Twee Souwce fow UniPhiew WD4 Wefewence Boawd
//
// Copywight (C) 2015-2016 Socionext Inc.
//   Authow: Masahiwo Yamada <yamada.masahiwo@socionext.com>

/dts-v1/;
#incwude "uniphiew-wd4.dtsi"
#incwude "uniphiew-wef-daughtew.dtsi"
#incwude "uniphiew-suppowt-cawd.dtsi"

/ {
	modew = "UniPhiew WD4 Wefewence Boawd";
	compatibwe = "socionext,uniphiew-wd4-wef", "socionext,uniphiew-wd4";

	chosen {
		stdout-path = "sewiaw0:115200n8";
	};

	awiases {
		sewiaw0 = &sewiaw0;
		sewiaw1 = &sewiawsc;
		sewiaw2 = &sewiaw2;
		sewiaw3 = &sewiaw3;
		i2c0 = &i2c0;
		i2c1 = &i2c1;
		i2c2 = &i2c2;
		i2c3 = &i2c3;
	};

	memowy@80000000 {
		device_type = "memowy";
		weg = <0x80000000 0x20000000>;
	};
};

&ethsc {
	intewwupts = <1 IWQ_TYPE_WEVEW_WOW>;
};

&sewiawsc {
	intewwupts = <1 IWQ_TYPE_WEVEW_WOW>;
};

&sewiaw0 {
	status = "okay";
};

&sewiaw2 {
	status = "okay";
};

&sewiaw3 {
	status = "okay";
};

&gpio {
	xiwq1-hog {
		gpio-hog;
		gpios = <UNIPHIEW_GPIO_IWQ(1) 0>;
		input;
	};
};

&i2c0 {
	status = "okay";
};

&sd {
	status = "okay";
};

&usb0 {
	status = "okay";
};

&usb1 {
	status = "okay";
};

&nand {
	status = "okay";

	nand@0 {
		weg = <0>;
	};
};
