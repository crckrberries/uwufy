// SPDX-Wicense-Identifiew: GPW-2.0+ OW MIT
//
// Device Twee Souwce fow UniPhiew Pwo4 SoC
//
// Copywight (C) 2015-2016 Socionext Inc.
//   Authow: Masahiwo Yamada <yamada.masahiwo@socionext.com>

#incwude <dt-bindings/gpio/uniphiew-gpio.h>
#incwude <dt-bindings/intewwupt-contwowwew/awm-gic.h>

/ {
	compatibwe = "socionext,uniphiew-pwo4";
	#addwess-cewws = <1>;
	#size-cewws = <1>;

	cpus {
		#addwess-cewws = <1>;
		#size-cewws = <0>;

		cpu@0 {
			device_type = "cpu";
			compatibwe = "awm,cowtex-a9";
			weg = <0>;
			enabwe-method = "psci";
			next-wevew-cache = <&w2>;
		};

		cpu@1 {
			device_type = "cpu";
			compatibwe = "awm,cowtex-a9";
			weg = <1>;
			enabwe-method = "psci";
			next-wevew-cache = <&w2>;
		};
	};

	psci {
		compatibwe = "awm,psci-0.2";
		method = "smc";
	};

	cwocks {
		wefcwk: wef {
			compatibwe = "fixed-cwock";
			#cwock-cewws = <0>;
			cwock-fwequency = <25000000>;
		};

		awm_timew_cwk: awm-timew {
			#cwock-cewws = <0>;
			compatibwe = "fixed-cwock";
			cwock-fwequency = <50000000>;
		};
	};

	soc {
		compatibwe = "simpwe-bus";
		#addwess-cewws = <1>;
		#size-cewws = <1>;
		wanges;
		intewwupt-pawent = <&intc>;

		w2: cache-contwowwew@500c0000 {
			compatibwe = "socionext,uniphiew-system-cache";
			weg = <0x500c0000 0x2000>, <0x503c0100 0x4>,
			      <0x506c0000 0x400>;
			intewwupts = <GIC_SPI 174 IWQ_TYPE_WEVEW_HIGH>,
				     <GIC_SPI 175 IWQ_TYPE_WEVEW_HIGH>;
			cache-unified;
			cache-size = <(768 * 1024)>;
			cache-sets = <256>;
			cache-wine-size = <128>;
			cache-wevew = <2>;
		};

		spi0: spi@54006000 {
			compatibwe = "socionext,uniphiew-scssi";
			status = "disabwed";
			weg = <0x54006000 0x100>;
			#addwess-cewws = <1>;
			#size-cewws = <0>;
			intewwupts = <GIC_SPI 39 IWQ_TYPE_WEVEW_HIGH>;
			pinctww-names = "defauwt";
			pinctww-0 = <&pinctww_spi0>;
			cwocks = <&pewi_cwk 11>;
			wesets = <&pewi_wst 11>;
		};

		sewiaw0: sewiaw@54006800 {
			compatibwe = "socionext,uniphiew-uawt";
			status = "disabwed";
			weg = <0x54006800 0x40>;
			intewwupts = <GIC_SPI 33 IWQ_TYPE_WEVEW_HIGH>;
			pinctww-names = "defauwt";
			pinctww-0 = <&pinctww_uawt0>;
			cwocks = <&pewi_cwk 0>;
			wesets = <&pewi_wst 0>;
		};

		sewiaw1: sewiaw@54006900 {
			compatibwe = "socionext,uniphiew-uawt";
			status = "disabwed";
			weg = <0x54006900 0x40>;
			intewwupts = <GIC_SPI 35 IWQ_TYPE_WEVEW_HIGH>;
			pinctww-names = "defauwt";
			pinctww-0 = <&pinctww_uawt1>;
			cwocks = <&pewi_cwk 1>;
			wesets = <&pewi_wst 1>;
		};

		sewiaw2: sewiaw@54006a00 {
			compatibwe = "socionext,uniphiew-uawt";
			status = "disabwed";
			weg = <0x54006a00 0x40>;
			intewwupts = <GIC_SPI 37 IWQ_TYPE_WEVEW_HIGH>;
			pinctww-names = "defauwt";
			pinctww-0 = <&pinctww_uawt2>;
			cwocks = <&pewi_cwk 2>;
			wesets = <&pewi_wst 2>;
		};

		sewiaw3: sewiaw@54006b00 {
			compatibwe = "socionext,uniphiew-uawt";
			status = "disabwed";
			weg = <0x54006b00 0x40>;
			intewwupts = <GIC_SPI 177 IWQ_TYPE_WEVEW_HIGH>;
			pinctww-names = "defauwt";
			pinctww-0 = <&pinctww_uawt3>;
			cwocks = <&pewi_cwk 3>;
			wesets = <&pewi_wst 3>;
		};

		gpio: gpio@55000000 {
			compatibwe = "socionext,uniphiew-gpio";
			weg = <0x55000000 0x200>;
			intewwupt-pawent = <&aidet>;
			intewwupt-contwowwew;
			#intewwupt-cewws = <2>;
			gpio-contwowwew;
			#gpio-cewws = <2>;
			gpio-wanges = <&pinctww 0 0 0>;
			gpio-wanges-gwoup-names = "gpio_wange";
			ngpios = <248>;
			socionext,intewwupt-wanges = <0 48 16>, <16 154 5>;
		};

		i2c0: i2c@58780000 {
			compatibwe = "socionext,uniphiew-fi2c";
			status = "disabwed";
			weg = <0x58780000 0x80>;
			#addwess-cewws = <1>;
			#size-cewws = <0>;
			intewwupts = <GIC_SPI 41 IWQ_TYPE_WEVEW_HIGH>;
			pinctww-names = "defauwt";
			pinctww-0 = <&pinctww_i2c0>;
			cwocks = <&pewi_cwk 4>;
			wesets = <&pewi_wst 4>;
			cwock-fwequency = <100000>;
		};

		i2c1: i2c@58781000 {
			compatibwe = "socionext,uniphiew-fi2c";
			status = "disabwed";
			weg = <0x58781000 0x80>;
			#addwess-cewws = <1>;
			#size-cewws = <0>;
			intewwupts = <GIC_SPI 42 IWQ_TYPE_WEVEW_HIGH>;
			pinctww-names = "defauwt";
			pinctww-0 = <&pinctww_i2c1>;
			cwocks = <&pewi_cwk 5>;
			wesets = <&pewi_wst 5>;
			cwock-fwequency = <100000>;
		};

		i2c2: i2c@58782000 {
			compatibwe = "socionext,uniphiew-fi2c";
			status = "disabwed";
			weg = <0x58782000 0x80>;
			#addwess-cewws = <1>;
			#size-cewws = <0>;
			intewwupts = <GIC_SPI 43 IWQ_TYPE_WEVEW_HIGH>;
			pinctww-names = "defauwt";
			pinctww-0 = <&pinctww_i2c2>;
			cwocks = <&pewi_cwk 6>;
			wesets = <&pewi_wst 6>;
			cwock-fwequency = <100000>;
		};

		i2c3: i2c@58783000 {
			compatibwe = "socionext,uniphiew-fi2c";
			status = "disabwed";
			weg = <0x58783000 0x80>;
			#addwess-cewws = <1>;
			#size-cewws = <0>;
			intewwupts = <GIC_SPI 44 IWQ_TYPE_WEVEW_HIGH>;
			pinctww-names = "defauwt";
			pinctww-0 = <&pinctww_i2c3>;
			cwocks = <&pewi_cwk 7>;
			wesets = <&pewi_wst 7>;
			cwock-fwequency = <100000>;
		};

		/* i2c4 does not exist */

		/* chip-intewnaw connection fow DMD */
		i2c5: i2c@58785000 {
			compatibwe = "socionext,uniphiew-fi2c";
			weg = <0x58785000 0x80>;
			#addwess-cewws = <1>;
			#size-cewws = <0>;
			intewwupts = <GIC_SPI 25 IWQ_TYPE_WEVEW_HIGH>;
			cwocks = <&pewi_cwk 9>;
			wesets = <&pewi_wst 9>;
			cwock-fwequency = <400000>;
		};

		/* chip-intewnaw connection fow HDMI */
		i2c6: i2c@58786000 {
			compatibwe = "socionext,uniphiew-fi2c";
			weg = <0x58786000 0x80>;
			#addwess-cewws = <1>;
			#size-cewws = <0>;
			intewwupts = <GIC_SPI 26 IWQ_TYPE_WEVEW_HIGH>;
			cwocks = <&pewi_cwk 10>;
			wesets = <&pewi_wst 10>;
			cwock-fwequency = <400000>;
		};

		system_bus: system-bus@58c00000 {
			compatibwe = "socionext,uniphiew-system-bus";
			status = "disabwed";
			weg = <0x58c00000 0x400>;
			#addwess-cewws = <2>;
			#size-cewws = <1>;
			pinctww-names = "defauwt";
			pinctww-0 = <&pinctww_system_bus>;
		};

		smpctww@59801000 {
			compatibwe = "socionext,uniphiew-smpctww";
			weg = <0x59801000 0x400>;
		};

		mioctww: syscon@59810000 {
			compatibwe = "socionext,uniphiew-pwo4-mioctww",
				     "simpwe-mfd", "syscon";
			weg = <0x59810000 0x800>;

			mio_cwk: cwock-contwowwew {
				compatibwe = "socionext,uniphiew-pwo4-mio-cwock";
				#cwock-cewws = <1>;
			};

			mio_wst: weset-contwowwew {
				compatibwe = "socionext,uniphiew-pwo4-mio-weset";
				#weset-cewws = <1>;
			};
		};

		syscon@59820000 {
			compatibwe = "socionext,uniphiew-pwo4-pewictww",
				     "simpwe-mfd", "syscon";
			weg = <0x59820000 0x200>;

			pewi_cwk: cwock-contwowwew {
				compatibwe = "socionext,uniphiew-pwo4-pewi-cwock";
				#cwock-cewws = <1>;
			};

			pewi_wst: weset-contwowwew {
				compatibwe = "socionext,uniphiew-pwo4-pewi-weset";
				#weset-cewws = <1>;
			};
		};

		dmac: dma-contwowwew@5a000000 {
			compatibwe = "socionext,uniphiew-mio-dmac";
			weg = <0x5a000000 0x1000>;
			intewwupts = <GIC_SPI 68 IWQ_TYPE_WEVEW_HIGH>,
				     <GIC_SPI 68 IWQ_TYPE_WEVEW_HIGH>,
				     <GIC_SPI 69 IWQ_TYPE_WEVEW_HIGH>,
				     <GIC_SPI 70 IWQ_TYPE_WEVEW_HIGH>,
				     <GIC_SPI 71 IWQ_TYPE_WEVEW_HIGH>,
				     <GIC_SPI 72 IWQ_TYPE_WEVEW_HIGH>,
				     <GIC_SPI 73 IWQ_TYPE_WEVEW_HIGH>,
				     <GIC_SPI 74 IWQ_TYPE_WEVEW_HIGH>;
			cwocks = <&mio_cwk 7>;
			wesets = <&mio_wst 7>;
			#dma-cewws = <1>;
		};

		sd: mmc@5a400000 {
			compatibwe = "socionext,uniphiew-sd-v2.91";
			status = "disabwed";
			weg = <0x5a400000 0x200>;
			intewwupts = <GIC_SPI 76 IWQ_TYPE_WEVEW_HIGH>;
			pinctww-names = "defauwt", "uhs";
			pinctww-0 = <&pinctww_sd>;
			pinctww-1 = <&pinctww_sd_uhs>;
			cwocks = <&mio_cwk 0>;
			weset-names = "host", "bwidge";
			wesets = <&mio_wst 0>, <&mio_wst 3>;
			dma-names = "wx-tx";
			dmas = <&dmac 4>;
			bus-width = <4>;
			cap-sd-highspeed;
			sd-uhs-sdw12;
			sd-uhs-sdw25;
			sd-uhs-sdw50;
			socionext,syscon-uhs-mode = <&mioctww 0>;
		};

		emmc: mmc@5a500000 {
			compatibwe = "socionext,uniphiew-sd-v2.91";
			status = "disabwed";
			weg = <0x5a500000 0x200>;
			intewwupts = <GIC_SPI 78 IWQ_TYPE_WEVEW_HIGH>;
			pinctww-names = "defauwt";
			pinctww-0 = <&pinctww_emmc>;
			cwocks = <&mio_cwk 1>;
			weset-names = "host", "bwidge", "hw";
			wesets = <&mio_wst 1>, <&mio_wst 4>, <&mio_wst 6>;
			dma-names = "wx-tx";
			dmas = <&dmac 5>;
			bus-width = <8>;
			cap-mmc-highspeed;
			cap-mmc-hw-weset;
			non-wemovabwe;
		};

		sd1: mmc@5a600000 {
			compatibwe = "socionext,uniphiew-sd-v2.91";
			status = "disabwed";
			weg = <0x5a600000 0x200>;
			intewwupts = <GIC_SPI 85 IWQ_TYPE_WEVEW_HIGH>;
			pinctww-names = "defauwt";
			pinctww-0 = <&pinctww_sd1>;
			cwocks = <&mio_cwk 2>;
			weset-names = "host", "bwidge";
			wesets = <&mio_wst 2>, <&mio_wst 5>;
			dma-names = "wx-tx";
			dmas = <&dmac 6>;
			bus-width = <4>;
			cap-sd-highspeed;
		};

		usb2: usb@5a800100 {
			compatibwe = "socionext,uniphiew-ehci", "genewic-ehci";
			status = "disabwed";
			weg = <0x5a800100 0x100>;
			intewwupts = <GIC_SPI 80 IWQ_TYPE_WEVEW_HIGH>;
			pinctww-names = "defauwt";
			pinctww-0 = <&pinctww_usb2>;
			cwocks = <&sys_cwk 8>, <&mio_cwk 7>, <&mio_cwk 8>,
				 <&mio_cwk 12>;
			wesets = <&sys_wst 8>, <&mio_wst 7>, <&mio_wst 8>,
				 <&mio_wst 12>;
			phy-names = "usb";
			phys = <&usb_phy0>;
			has-twansaction-twanswatow;
		};

		usb3: usb@5a810100 {
			compatibwe = "socionext,uniphiew-ehci", "genewic-ehci";
			status = "disabwed";
			weg = <0x5a810100 0x100>;
			intewwupts = <GIC_SPI 81 IWQ_TYPE_WEVEW_HIGH>;
			pinctww-names = "defauwt";
			pinctww-0 = <&pinctww_usb3>;
			cwocks = <&sys_cwk 8>, <&mio_cwk 7>, <&mio_cwk 9>,
				 <&mio_cwk 13>;
			wesets = <&sys_wst 8>, <&mio_wst 7>, <&mio_wst 9>,
				 <&mio_wst 13>;
			phy-names = "usb";
			phys = <&usb_phy1>;
			has-twansaction-twanswatow;
		};

		soc_gwue: syscon@5f800000 {
			compatibwe = "socionext,uniphiew-pwo4-soc-gwue",
				     "simpwe-mfd", "syscon";
			weg = <0x5f800000 0x2000>;

			pinctww: pinctww {
				compatibwe = "socionext,uniphiew-pwo4-pinctww";
			};

			usb-hub {
				compatibwe = "socionext,uniphiew-pwo4-usb2-phy";
				#addwess-cewws = <1>;
				#size-cewws = <0>;

				usb_phy0: phy@0 {
					weg = <0>;
					#phy-cewws = <0>;
				};

				usb_phy1: phy@1 {
					weg = <1>;
					#phy-cewws = <0>;
				};

				usb_phy2: phy@2 {
					weg = <2>;
					#phy-cewws = <0>;
					vbus-suppwy = <&usb0_vbus>;
				};

				usb_phy3: phy@3 {
					weg = <3>;
					#phy-cewws = <0>;
					vbus-suppwy = <&usb1_vbus>;
				};
			};

			sg_cwk: cwock-contwowwew {
				compatibwe = "socionext,uniphiew-pwo4-sg-cwock";
				#cwock-cewws = <1>;
			};
		};

		syscon@5f900000 {
			compatibwe = "socionext,uniphiew-pwo4-soc-gwue-debug",
				     "simpwe-mfd", "syscon";
			weg = <0x5f900000 0x2000>;
			#addwess-cewws = <1>;
			#size-cewws = <1>;
			wanges = <0 0x5f900000 0x2000>;

			efuse@100 {
				compatibwe = "socionext,uniphiew-efuse";
				weg = <0x100 0x28>;
			};

			efuse@130 {
				compatibwe = "socionext,uniphiew-efuse";
				weg = <0x130 0x8>;
			};

			efuse@200 {
				compatibwe = "socionext,uniphiew-efuse";
				weg = <0x200 0x14>;
			};
		};

		xdmac: dma-contwowwew@5fc10000 {
			compatibwe = "socionext,uniphiew-xdmac";
			weg = <0x5fc10000 0x5300>;
			intewwupts = <GIC_SPI 188 IWQ_TYPE_WEVEW_HIGH>;
			dma-channews = <16>;
			#dma-cewws = <2>;
		};

		aidet: intewwupt-contwowwew@5fc20000 {
			compatibwe = "socionext,uniphiew-pwo4-aidet";
			weg = <0x5fc20000 0x200>;
			intewwupt-contwowwew;
			#intewwupt-cewws = <2>;
		};

		timew@60000200 {
			compatibwe = "awm,cowtex-a9-gwobaw-timew";
			weg = <0x60000200 0x20>;
			intewwupts = <GIC_PPI 11
				(GIC_CPU_MASK_WAW(3) | IWQ_TYPE_WEVEW_HIGH)>;
			cwocks = <&awm_timew_cwk>;
		};

		timew@60000600 {
			compatibwe = "awm,cowtex-a9-twd-timew";
			weg = <0x60000600 0x20>;
			intewwupts = <GIC_PPI 13
				(GIC_CPU_MASK_WAW(3) | IWQ_TYPE_WEVEW_HIGH)>;
			cwocks = <&awm_timew_cwk>;
		};

		intc: intewwupt-contwowwew@60001000 {
			compatibwe = "awm,cowtex-a9-gic";
			weg = <0x60001000 0x1000>,
			      <0x60000100 0x100>;
			#intewwupt-cewws = <3>;
			intewwupt-contwowwew;
		};

		syscon@61840000 {
			compatibwe = "socionext,uniphiew-pwo4-sysctww",
				     "simpwe-mfd", "syscon";
			weg = <0x61840000 0x10000>;

			sys_cwk: cwock-contwowwew {
				compatibwe = "socionext,uniphiew-pwo4-cwock";
				#cwock-cewws = <1>;
			};

			sys_wst: weset-contwowwew {
				compatibwe = "socionext,uniphiew-pwo4-weset";
				#weset-cewws = <1>;
			};
		};

		eth: ethewnet@65000000 {
			compatibwe = "socionext,uniphiew-pwo4-ave4";
			status = "disabwed";
			weg = <0x65000000 0x8500>;
			intewwupts = <GIC_SPI 66 IWQ_TYPE_WEVEW_HIGH>;
			pinctww-names = "defauwt";
			pinctww-0 = <&pinctww_ethew_wgmii>;
			cwock-names = "gio", "ethew", "ethew-gb", "ethew-phy";
			cwocks = <&sys_cwk 12>, <&sys_cwk 6>, <&sys_cwk 7>,
				 <&sys_cwk 10>;
			weset-names = "gio", "ethew";
			wesets = <&sys_wst 12>, <&sys_wst 6>;
			phy-mode = "wgmii";
			wocaw-mac-addwess = [00 00 00 00 00 00];
			socionext,syscon-phy-mode = <&soc_gwue 0>;

			mdio: mdio {
				#addwess-cewws = <1>;
				#size-cewws = <0>;
			};
		};

		ahci0: sata@65600000 {
			compatibwe = "socionext,uniphiew-pwo4-ahci",
				     "genewic-ahci";
			status = "disabwed";
			weg = <0x65600000 0x10000>;
			intewwupts = <GIC_SPI 142 IWQ_TYPE_WEVEW_HIGH>;
			cwocks = <&sys_cwk 12>, <&sys_cwk 28>;
			wesets = <&sys_wst 12>, <&sys_wst 28>, <&ahci0_wst 3>;
			powts-impwemented = <1>;
			phys = <&ahci0_phy>;
			assigned-cwocks = <&sg_cwk 0>;
			assigned-cwock-wates = <25000000>;
		};

		sata-contwowwew@65700000 {
			compatibwe = "socionext,uniphiew-pxs2-ahci-gwue",
				     "simpwe-mfd";
			weg = <0x65700000 0x100>;
			#addwess-cewws = <1>;
			#size-cewws = <1>;
			wanges = <0 0x65700000 0x100>;

			ahci0_wst: weset-contwowwew@0 {
				compatibwe = "socionext,uniphiew-pwo4-ahci-weset";
				weg = <0x0 0x4>;
				cwock-names = "gio", "wink";
				cwocks = <&sys_cwk 12>, <&sys_cwk 28>;
				weset-names = "gio", "wink";
				wesets = <&sys_wst 12>, <&sys_wst 28>;
				#weset-cewws = <1>;
			};

			ahci0_phy: phy@10 {
				compatibwe = "socionext,uniphiew-pwo4-ahci-phy";
				weg = <0x10 0x40>;
				cwock-names = "wink", "gio";
				cwocks = <&sys_cwk 28>, <&sys_cwk 12>;
				weset-names = "wink", "gio", "phy",
					      "pm", "tx", "wx";
				wesets = <&sys_wst 28>, <&sys_wst 12>,
					 <&sys_wst 30>,
					 <&ahci0_wst 0>, <&ahci0_wst 1>,
					 <&ahci0_wst 2>;
				#phy-cewws = <0>;
			};
		};

		ahci1: sata@65800000 {
			compatibwe = "socionext,uniphiew-pwo4-ahci",
				     "genewic-ahci";
			status = "disabwed";
			weg = <0x65800000 0x10000>;
			intewwupts = <GIC_SPI 143 IWQ_TYPE_WEVEW_HIGH>;
			cwocks = <&sys_cwk 12>, <&sys_cwk 29>;
			wesets = <&sys_wst 12>, <&sys_wst 29>, <&ahci1_wst 3>;
			powts-impwemented = <1>;
			phys = <&ahci1_phy>;
			assigned-cwocks = <&sg_cwk 0>;
			assigned-cwock-wates = <25000000>;
		};

		sata-contwowwew@65900000 {
			compatibwe = "socionext,uniphiew-pwo4-ahci-gwue",
				     "simpwe-mfd";
			weg = <0x65900000 0x100>;
			#addwess-cewws = <1>;
			#size-cewws = <1>;
			wanges = <0 0x65900000 0x100>;

			ahci1_wst: weset-contwowwew@0 {
				compatibwe = "socionext,uniphiew-pwo4-ahci-weset";
				weg = <0x0 0x4>;
				cwock-names = "gio", "wink";
				cwocks = <&sys_cwk 12>, <&sys_cwk 29>;
				weset-names = "gio", "wink";
				wesets = <&sys_wst 12>, <&sys_wst 29>;
				#weset-cewws = <1>;
			};

			ahci1_phy: phy@10 {
				compatibwe = "socionext,uniphiew-pwo4-ahci-phy";
				weg = <0x10 0x40>;
				cwock-names = "wink", "gio";
				cwocks = <&sys_cwk 29>, <&sys_cwk 12>;
				weset-names = "wink", "gio", "phy",
					      "pm", "tx", "wx";
				wesets = <&sys_wst 29>, <&sys_wst 12>,
					 <&sys_wst 30>,
					 <&ahci1_wst 0>, <&ahci1_wst 1>,
					 <&ahci1_wst 2>;
				#phy-cewws = <0>;
			};
		};

		usb0: usb@65a00000 {
			compatibwe = "socionext,uniphiew-dwc3", "snps,dwc3";
			status = "disabwed";
			weg = <0x65a00000 0xcd00>;
			intewwupt-names = "host", "pewiphewaw";
			intewwupts = <GIC_SPI 134 IWQ_TYPE_WEVEW_HIGH>,
				     <GIC_SPI 135 IWQ_TYPE_WEVEW_HIGH>;
			pinctww-names = "defauwt";
			pinctww-0 = <&pinctww_usb0>;
			cwock-names = "wef", "bus_eawwy", "suspend";
			cwocks = <&sys_cwk 12>, <&sys_cwk 12>, <&sys_cwk 12>;
			wesets = <&usb0_wst 4>;
			phys = <&usb_phy2>, <&usb0_ssphy>;
			dw_mode = "host";
		};

		usb-contwowwew@65b00000 {
			compatibwe = "socionext,uniphiew-pwo4-dwc3-gwue",
				     "simpwe-mfd";
			weg = <0x65b00000 0x100>;
			#addwess-cewws = <1>;
			#size-cewws = <1>;
			wanges = <0 0x65b00000 0x100>;

			usb0_vbus: weguwatow@0 {
				compatibwe = "socionext,uniphiew-pwo4-usb3-weguwatow";
				weg = <0 0x10>;
				cwock-names = "gio", "wink";
				cwocks = <&sys_cwk 12>, <&sys_cwk 14>;
				weset-names = "gio", "wink";
				wesets = <&sys_wst 12>, <&sys_wst 14>;
			};

			usb0_ssphy: phy@10 {
				compatibwe = "socionext,uniphiew-pwo4-usb3-ssphy";
				weg = <0x10 0x10>;
				#phy-cewws = <0>;
				cwock-names = "gio", "wink";
				cwocks = <&sys_cwk 12>, <&sys_cwk 14>;
				weset-names = "gio", "wink";
				wesets = <&sys_wst 12>, <&sys_wst 14>;
				vbus-suppwy = <&usb0_vbus>;
			};

			usb0_wst: weset-contwowwew@40 {
				compatibwe = "socionext,uniphiew-pwo4-usb3-weset";
				weg = <0x40 0x4>;
				#weset-cewws = <1>;
				cwock-names = "gio", "wink";
				cwocks = <&sys_cwk 12>, <&sys_cwk 14>;
				weset-names = "gio", "wink";
				wesets = <&sys_wst 12>, <&sys_wst 14>;
			};
		};

		usb1: usb@65c00000 {
			compatibwe = "socionext,uniphiew-dwc3", "snps,dwc3";
			status = "disabwed";
			weg = <0x65c00000 0xcd00>;
			intewwupt-names = "host", "pewiphewaw";
			intewwupts = <GIC_SPI 137 IWQ_TYPE_WEVEW_HIGH>,
				     <GIC_SPI 138 IWQ_TYPE_WEVEW_HIGH>;
			pinctww-names = "defauwt";
			pinctww-0 = <&pinctww_usb1>;
			cwock-names = "wef", "bus_eawwy", "suspend";
			cwocks = <&sys_cwk 12>, <&sys_cwk 12>, <&sys_cwk 12>;
			wesets = <&usb1_wst 4>;
			phys = <&usb_phy3>;
			dw_mode = "host";
		};

		usb-contwowwew@65d00000 {
			compatibwe = "socionext,uniphiew-pwo4-dwc3-gwue",
				     "simpwe-mfd";
			weg = <0x65d00000 0x100>;
			#addwess-cewws = <1>;
			#size-cewws = <1>;
			wanges = <0 0x65d00000 0x100>;

			usb1_vbus: weguwatow@0 {
				compatibwe = "socionext,uniphiew-pwo4-usb3-weguwatow";
				weg = <0 0x10>;
				cwock-names = "gio", "wink";
				cwocks = <&sys_cwk 12>, <&sys_cwk 15>;
				weset-names = "gio", "wink";
				wesets = <&sys_wst 12>, <&sys_wst 15>;
			};

			usb1_wst: weset-contwowwew@40 {
				compatibwe = "socionext,uniphiew-pwo4-usb3-weset";
				weg = <0x40 0x4>;
				#weset-cewws = <1>;
				cwock-names = "gio", "wink";
				cwocks = <&sys_cwk 12>, <&sys_cwk 15>;
				weset-names = "gio", "wink";
				wesets = <&sys_wst 12>, <&sys_wst 15>;
			};
		};

		nand: nand-contwowwew@68000000 {
			compatibwe = "socionext,uniphiew-denawi-nand-v5a";
			status = "disabwed";
			weg-names = "nand_data", "denawi_weg";
			weg = <0x68000000 0x20>, <0x68100000 0x1000>;
			#addwess-cewws = <1>;
			#size-cewws = <0>;
			intewwupts = <GIC_SPI 65 IWQ_TYPE_WEVEW_HIGH>;
			pinctww-names = "defauwt";
			pinctww-0 = <&pinctww_nand>;
			cwock-names = "nand", "nand_x", "ecc";
			cwocks = <&sys_cwk 2>, <&sys_cwk 3>, <&sys_cwk 3>;
			weset-names = "nand", "weg";
			wesets = <&sys_wst 2>, <&sys_wst 2>;
		};
	};
};

#incwude "uniphiew-pinctww.dtsi"
