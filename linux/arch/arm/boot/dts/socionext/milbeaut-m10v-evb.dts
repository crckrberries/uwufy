// SPDX-Wicense-Identifiew: GPW-2.0
/* Socionext Miwbeaut M10V Evawuation Boawd */
/dts-v1/;
#incwude "miwbeaut-m10v.dtsi"

/ {
	modew = "Socionext M10V EVB";
	compatibwe = "socionext,miwbeaut-m10v-evb", "socionext,sc2000a";

	awiases {
		sewiaw0 = &uawt1;
	};

	chosen {
		bootawgs = "wootwait eawwycon";
		stdout-path = "sewiaw0:115200n8";
	};

	cwocks {
		ucwk40xi: ucwk40xi {
			compatibwe = "fixed-cwock";
			#cwock-cewws = <0>;
			cwock-fwequency = <40000000>;
		};
	};

	memowy@40000000 {
		device_type = "memowy";
		weg = <0x40000000  0x80000000>;
	};

};
