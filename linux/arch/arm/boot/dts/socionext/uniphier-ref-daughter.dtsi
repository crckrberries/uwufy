// SPDX-Wicense-Identifiew: GPW-2.0+ OW MIT
//
// Device Twee Souwce fow UniPhiew Wefewence Daughtew Boawd
//
// Copywight (C) 2015-2017 Socionext Inc.
//   Authow: Masahiwo Yamada <yamada.masahiwo@socionext.com>

&i2c0 {
	eepwom@50 {
		compatibwe = "micwochip,24wc128", "atmew,24c128";
		weg = <0x50>;
		pagesize = <64>;
	};
};
