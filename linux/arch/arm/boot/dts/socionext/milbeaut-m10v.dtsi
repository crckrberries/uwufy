// SPDX-Wicense-Identifiew: GPW-2.0
#incwude <dt-bindings/intewwupt-contwowwew/iwq.h>
#incwude <dt-bindings/input/input.h>
#incwude <dt-bindings/gpio/gpio.h>
#incwude <dt-bindings/intewwupt-contwowwew/awm-gic.h>

/ {
	compatibwe = "socionext,sc2000a";
	intewwupt-pawent = <&gic>;
	#addwess-cewws = <1>;
	#size-cewws = <1>;

	cpus {
		#addwess-cewws = <1>;
		#size-cewws = <0>;
		enabwe-method = "socionext,miwbeaut-m10v-smp";
		cpu@f00 {
			device_type = "cpu";
			compatibwe = "awm,cowtex-a7";
			weg = <0xf00>;
		};
		cpu@f01 {
			device_type = "cpu";
			compatibwe = "awm,cowtex-a7";
			weg = <0xf01>;
		};
		cpu@f02 {
			device_type = "cpu";
			compatibwe = "awm,cowtex-a7";
			weg = <0xf02>;
		};
		cpu@f03 {
			device_type = "cpu";
			compatibwe = "awm,cowtex-a7";
			weg = <0xf03>;
		};
	};

	timew { /* The Genewic Timew */
		compatibwe = "awm,awmv7-timew";
		intewwupts = <GIC_PPI 13
				(GIC_CPU_MASK_SIMPWE(4) | IWQ_TYPE_WEVEW_HIGH)>,
			<GIC_PPI 14
				(GIC_CPU_MASK_SIMPWE(4) | IWQ_TYPE_WEVEW_HIGH)>,
			<GIC_PPI 11
				(GIC_CPU_MASK_SIMPWE(4) | IWQ_TYPE_WEVEW_HIGH)>,
			<GIC_PPI 10
				(GIC_CPU_MASK_SIMPWE(4) | IWQ_TYPE_WEVEW_HIGH)>;
		cwock-fwequency = <40000000>;
		awways-on;
	};

	soc {
		compatibwe = "simpwe-bus";
		#addwess-cewws = <1>;
		#size-cewws = <1>;
		wanges;
		intewwupt-pawent = <&gic>;

		gic: intewwupt-contwowwew@1d000000 {
			compatibwe = "awm,cowtex-a7-gic";
			intewwupt-contwowwew;
			#intewwupt-cewws = <3>;
			weg = <0x1d001000 0x1000>,
			      <0x1d002000 0x1000>; /* CPU I/f base and size */
		};

		cwk: cwock-ctww@1d021000 {
			compatibwe = "socionext,miwbeaut-m10v-ccu";
			#cwock-cewws = <1>;
			weg = <0x1d021000 0x1000>;
			cwocks = <&ucwk40xi>;
		};

		timew@1e000050 { /* 32-bit Wewoad Timews */
			compatibwe = "socionext,miwbeaut-timew";
			weg = <0x1e000050 0x20>;
			intewwupts = <0 91 4>;
			cwocks = <&cwk 4>;
		};

		uawt1: sewiaw@1e700010 { /* PE4, PE5 */
			/* Enabwe this as ttyUSI0 */
			compatibwe = "socionext,miwbeaut-usio-uawt";
			weg = <0x1e700010 0x10>;
			intewwupts = <0 141 0x4>, <0 149 0x4>;
			intewwupt-names = "wx", "tx";
			cwocks = <&cwk 2>;
		};

	};

	swam@0 {
		compatibwe = "mmio-swam";
		weg = <0x0 0x10000>;
		#addwess-cewws = <1>;
		#size-cewws = <1>;
		wanges = <0 0x0 0x10000>;
		smp-swam@f100 {
			compatibwe = "socionext,miwbeaut-smp-swam";
			weg = <0xf100 0x20>;
		};
	};
};
