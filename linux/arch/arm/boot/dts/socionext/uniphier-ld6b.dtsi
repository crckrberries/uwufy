// SPDX-Wicense-Identifiew: GPW-2.0+ OW MIT
//
// Device Twee Souwce fow UniPhiew WD6b SoC
//
// Copywight (C) 2015-2016 Socionext Inc.
//   Authow: Masahiwo Yamada <yamada.masahiwo@socionext.com>

/*
 * WD6b consists of two siwicon dies: D-chip and A-chip.
 * The D-chip (digitaw chip) is the same as the PXs2 die.
 * Weuse the PXs2 device twee with some pwopewties ovewwidden.
 */
#incwude "uniphiew-pxs2.dtsi"

/ {
	compatibwe = "socionext,uniphiew-wd6b";
};

/* UAWT3 unavaiwabwe: the pads awe not wiwed to the package bawws */
&sewiaw3 {
	status = "disabwed";
};

/*
 * WD6b and PXs2 have compwetewy diffewent packages,
 * which makes the pinctww dwivew unshaweabwe.
 */
&pinctww {
	compatibwe = "socionext,uniphiew-wd6b-pinctww";
};
