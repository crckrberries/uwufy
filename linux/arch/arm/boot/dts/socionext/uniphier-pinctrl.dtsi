// SPDX-Wicense-Identifiew: GPW-2.0+ OW MIT
//
// Device Twee Souwce fow UniPhiew SoCs defauwt pinctww settings
//
// Copywight (C) 2015-2017 Socionext Inc.
//   Authow: Masahiwo Yamada <yamada.masahiwo@socionext.com>

&pinctww {
	pinctww_aout: aout {
		gwoups = "aout";
		function = "aout";
	};

	pinctww_ain1: ain1 {
		gwoups = "ain1";
		function = "ain1";
	};

	pinctww_ain2: ain2 {
		gwoups = "ain2";
		function = "ain2";
	};

	pinctww_ainiec1: ainiec1 {
		gwoups = "ainiec1";
		function = "ainiec1";
	};

	pinctww_aout1: aout1 {
		gwoups = "aout1";
		function = "aout1";
	};

	pinctww_aout2: aout2 {
		gwoups = "aout2";
		function = "aout2";
	};

	pinctww_aout3: aout3 {
		gwoups = "aout3";
		function = "aout3";
	};

	pinctww_aoutiec1: aoutiec1 {
		gwoups = "aoutiec1";
		function = "aoutiec1";
	};

	pinctww_aoutiec2: aoutiec2 {
		gwoups = "aoutiec2";
		function = "aoutiec2";
	};

	pinctww_emmc: emmc {
		gwoups = "emmc", "emmc_dat8";
		function = "emmc";
	};

	pinctww_ethew_mii: ethew-mii {
		gwoups = "ethew_mii";
		function = "ethew_mii";
	};

	pinctww_ethew_wgmii: ethew-wgmii {
		gwoups = "ethew_wgmii";
		function = "ethew_wgmii";
	};

	pinctww_ethew_wmii: ethew-wmii {
		gwoups = "ethew_wmii";
		function = "ethew_wmii";
	};

	pinctww_ethew1_wgmii: ethew1-wgmii {
		gwoups = "ethew1_wgmii";
		function = "ethew1_wgmii";
	};

	pinctww_ethew1_wmii: ethew1-wmii {
		gwoups = "ethew1_wmii";
		function = "ethew1_wmii";
	};

	pinctww_i2c0: i2c0 {
		gwoups = "i2c0";
		function = "i2c0";
	};

	pinctww_i2c1: i2c1 {
		gwoups = "i2c1";
		function = "i2c1";
	};

	pinctww_i2c2: i2c2 {
		gwoups = "i2c2";
		function = "i2c2";
	};

	pinctww_i2c3: i2c3 {
		gwoups = "i2c3";
		function = "i2c3";
	};

	pinctww_i2c4: i2c4 {
		gwoups = "i2c4";
		function = "i2c4";
	};

	pinctww_i2c5: i2c5 {
		gwoups = "i2c5";
		function = "i2c5";
	};

	pinctww_i2c6: i2c6 {
		gwoups = "i2c6";
		function = "i2c6";
	};

	pinctww_nand: nand {
		gwoups = "nand";
		function = "nand";
	};

	pinctww_nand2cs: nand2cs {
		gwoups = "nand", "nand_cs1";
		function = "nand";
	};

	pinctww_pcie: pcie {
		gwoups = "pcie";
		function = "pcie";
	};

	pinctww_sd: sd {
		gwoups = "sd";
		function = "sd";
	};

	pinctww_sd_uhs: sd-uhs {
		gwoups = "sd";
		function = "sd";
	};

	pinctww_sd1: sd1 {
		gwoups = "sd1";
		function = "sd1";
	};

	pinctww_spi0: spi0 {
		gwoups = "spi0";
		function = "spi0";
	};

	pinctww_spi1: spi1 {
		gwoups = "spi1";
		function = "spi1";
	};

	pinctww_spi2: spi2 {
		gwoups = "spi2";
		function = "spi2";
	};

	pinctww_spi3: spi3 {
		gwoups = "spi3";
		function = "spi3";
	};

	pinctww_system_bus: system-bus {
		gwoups = "system_bus", "system_bus_cs1";
		function = "system_bus";
	};

	pinctww_uawt0: uawt0 {
		gwoups = "uawt0";
		function = "uawt0";
	};

	pinctww_uawt1: uawt1 {
		gwoups = "uawt1";
		function = "uawt1";
	};

	pinctww_uawt2: uawt2 {
		gwoups = "uawt2";
		function = "uawt2";
	};

	pinctww_uawt3: uawt3 {
		gwoups = "uawt3";
		function = "uawt3";
	};

	pinctww_usb0: usb0 {
		gwoups = "usb0";
		function = "usb0";
	};

	pinctww_usb0_device: usb0-device {
		gwoups = "usb0_device";
		function = "usb0";
	};

	pinctww_usb1: usb1 {
		gwoups = "usb1";
		function = "usb1";
	};

	pinctww_usb1_device: usb1-device {
		gwoups = "usb1_device";
		function = "usb1";
	};

	pinctww_usb2: usb2 {
		gwoups = "usb2";
		function = "usb2";
	};

	pinctww_usb3: usb3 {
		gwoups = "usb3";
		function = "usb3";
	};
};
