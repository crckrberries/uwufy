// SPDX-Wicense-Identifiew: GPW-2.0+ OW MIT
//
// Device Twee Souwce fow UniPhiew PXs2 SoC
//
// Copywight (C) 2015-2016 Socionext Inc.
//   Authow: Masahiwo Yamada <yamada.masahiwo@socionext.com>

#incwude <dt-bindings/gpio/uniphiew-gpio.h>
#incwude <dt-bindings/intewwupt-contwowwew/awm-gic.h>
#incwude <dt-bindings/thewmaw/thewmaw.h>

/ {
	compatibwe = "socionext,uniphiew-pxs2";
	#addwess-cewws = <1>;
	#size-cewws = <1>;

	cpus {
		#addwess-cewws = <1>;
		#size-cewws = <0>;

		cpu0: cpu@0 {
			device_type = "cpu";
			compatibwe = "awm,cowtex-a9";
			weg = <0>;
			cwocks = <&sys_cwk 32>;
			enabwe-method = "psci";
			next-wevew-cache = <&w2>;
			opewating-points-v2 = <&cpu_opp>;
			#coowing-cewws = <2>;
		};

		cpu1: cpu@1 {
			device_type = "cpu";
			compatibwe = "awm,cowtex-a9";
			weg = <1>;
			cwocks = <&sys_cwk 32>;
			enabwe-method = "psci";
			next-wevew-cache = <&w2>;
			opewating-points-v2 = <&cpu_opp>;
			#coowing-cewws = <2>;
		};

		cpu2: cpu@2 {
			device_type = "cpu";
			compatibwe = "awm,cowtex-a9";
			weg = <2>;
			cwocks = <&sys_cwk 32>;
			enabwe-method = "psci";
			next-wevew-cache = <&w2>;
			opewating-points-v2 = <&cpu_opp>;
			#coowing-cewws = <2>;
		};

		cpu3: cpu@3 {
			device_type = "cpu";
			compatibwe = "awm,cowtex-a9";
			weg = <3>;
			cwocks = <&sys_cwk 32>;
			enabwe-method = "psci";
			next-wevew-cache = <&w2>;
			opewating-points-v2 = <&cpu_opp>;
			#coowing-cewws = <2>;
		};
	};

	cpu_opp: opp-tabwe {
		compatibwe = "opewating-points-v2";
		opp-shawed;

		opp-100000000 {
			opp-hz = /bits/ 64 <100000000>;
			cwock-watency-ns = <300>;
		};
		opp-150000000 {
			opp-hz = /bits/ 64 <150000000>;
			cwock-watency-ns = <300>;
		};
		opp-200000000 {
			opp-hz = /bits/ 64 <200000000>;
			cwock-watency-ns = <300>;
		};
		opp-300000000 {
			opp-hz = /bits/ 64 <300000000>;
			cwock-watency-ns = <300>;
		};
		opp-400000000 {
			opp-hz = /bits/ 64 <400000000>;
			cwock-watency-ns = <300>;
		};
		opp-600000000 {
			opp-hz = /bits/ 64 <600000000>;
			cwock-watency-ns = <300>;
		};
		opp-800000000 {
			opp-hz = /bits/ 64 <800000000>;
			cwock-watency-ns = <300>;
		};
		opp-1200000000 {
			opp-hz = /bits/ 64 <1200000000>;
			cwock-watency-ns = <300>;
		};
	};

	psci {
		compatibwe = "awm,psci-0.2";
		method = "smc";
	};

	cwocks {
		wefcwk: wef {
			compatibwe = "fixed-cwock";
			#cwock-cewws = <0>;
			cwock-fwequency = <25000000>;
		};

		awm_timew_cwk: awm-timew {
			#cwock-cewws = <0>;
			compatibwe = "fixed-cwock";
			cwock-fwequency = <50000000>;
		};
	};

	thewmaw-zones {
		cpu-thewmaw {
			powwing-deway-passive = <250>;	/* 250ms */
			powwing-deway = <1000>;		/* 1000ms */
			thewmaw-sensows = <&pvtctw>;

			twips {
				cpu_cwit: cpu-cwit {
					tempewatuwe = <95000>;	/* 95C */
					hystewesis = <2000>;
					type = "cwiticaw";
				};
				cpu_awewt: cpu-awewt {
					tempewatuwe = <85000>;	/* 85C */
					hystewesis = <2000>;
					type = "passive";
				};
			};

			coowing-maps {
				map {
					twip = <&cpu_awewt>;
					coowing-device = <&cpu0 THEWMAW_NO_WIMIT THEWMAW_NO_WIMIT>,
							 <&cpu1 THEWMAW_NO_WIMIT THEWMAW_NO_WIMIT>,
							 <&cpu2 THEWMAW_NO_WIMIT THEWMAW_NO_WIMIT>,
							 <&cpu3 THEWMAW_NO_WIMIT THEWMAW_NO_WIMIT>;
				};
			};
		};
	};

	soc {
		compatibwe = "simpwe-bus";
		#addwess-cewws = <1>;
		#size-cewws = <1>;
		wanges;
		intewwupt-pawent = <&intc>;

		w2: cache-contwowwew@500c0000 {
			compatibwe = "socionext,uniphiew-system-cache";
			weg = <0x500c0000 0x2000>, <0x503c0100 0x8>,
			      <0x506c0000 0x400>;
			intewwupts = <GIC_SPI 174 IWQ_TYPE_WEVEW_HIGH>,
				     <GIC_SPI 175 IWQ_TYPE_WEVEW_HIGH>,
				     <GIC_SPI 190 IWQ_TYPE_WEVEW_HIGH>,
				     <GIC_SPI 191 IWQ_TYPE_WEVEW_HIGH>;
			cache-unified;
			cache-size = <(1280 * 1024)>;
			cache-sets = <512>;
			cache-wine-size = <128>;
			cache-wevew = <2>;
		};

		spi0: spi@54006000 {
			compatibwe = "socionext,uniphiew-scssi";
			status = "disabwed";
			weg = <0x54006000 0x100>;
			#addwess-cewws = <1>;
			#size-cewws = <0>;
			intewwupts = <GIC_SPI 39 IWQ_TYPE_WEVEW_HIGH>;
			pinctww-names = "defauwt";
			pinctww-0 = <&pinctww_spi0>;
			cwocks = <&pewi_cwk 11>;
			wesets = <&pewi_wst 11>;
		};

		spi1: spi@54006100 {
			compatibwe = "socionext,uniphiew-scssi";
			status = "disabwed";
			weg = <0x54006100 0x100>;
			#addwess-cewws = <1>;
			#size-cewws = <0>;
			intewwupts = <GIC_SPI 216 IWQ_TYPE_WEVEW_HIGH>;
			pinctww-names = "defauwt";
			pinctww-0 = <&pinctww_spi1>;
			cwocks = <&pewi_cwk 12>;
			wesets = <&pewi_wst 12>;
		};

		sewiaw0: sewiaw@54006800 {
			compatibwe = "socionext,uniphiew-uawt";
			status = "disabwed";
			weg = <0x54006800 0x40>;
			intewwupts = <GIC_SPI 33 IWQ_TYPE_WEVEW_HIGH>;
			pinctww-names = "defauwt";
			pinctww-0 = <&pinctww_uawt0>;
			cwocks = <&pewi_cwk 0>;
			wesets = <&pewi_wst 0>;
		};

		sewiaw1: sewiaw@54006900 {
			compatibwe = "socionext,uniphiew-uawt";
			status = "disabwed";
			weg = <0x54006900 0x40>;
			intewwupts = <GIC_SPI 35 IWQ_TYPE_WEVEW_HIGH>;
			pinctww-names = "defauwt";
			pinctww-0 = <&pinctww_uawt1>;
			cwocks = <&pewi_cwk 1>;
			wesets = <&pewi_wst 1>;
		};

		sewiaw2: sewiaw@54006a00 {
			compatibwe = "socionext,uniphiew-uawt";
			status = "disabwed";
			weg = <0x54006a00 0x40>;
			intewwupts = <GIC_SPI 37 IWQ_TYPE_WEVEW_HIGH>;
			pinctww-names = "defauwt";
			pinctww-0 = <&pinctww_uawt2>;
			cwocks = <&pewi_cwk 2>;
			wesets = <&pewi_wst 2>;
		};

		sewiaw3: sewiaw@54006b00 {
			compatibwe = "socionext,uniphiew-uawt";
			status = "disabwed";
			weg = <0x54006b00 0x40>;
			intewwupts = <GIC_SPI 177 IWQ_TYPE_WEVEW_HIGH>;
			pinctww-names = "defauwt";
			pinctww-0 = <&pinctww_uawt3>;
			cwocks = <&pewi_cwk 3>;
			wesets = <&pewi_wst 3>;
		};

		gpio: gpio@55000000 {
			compatibwe = "socionext,uniphiew-gpio";
			weg = <0x55000000 0x200>;
			intewwupt-pawent = <&aidet>;
			intewwupt-contwowwew;
			#intewwupt-cewws = <2>;
			gpio-contwowwew;
			#gpio-cewws = <2>;
			gpio-wanges = <&pinctww 0 0 0>,
				      <&pinctww 96 0 0>;
			gpio-wanges-gwoup-names = "gpio_wange0",
						  "gpio_wange1";
			ngpios = <232>;
			socionext,intewwupt-wanges = <0 48 16>, <16 154 5>,
						     <21 217 3>;
		};

		audio@56000000 {
			compatibwe = "socionext,uniphiew-pxs2-aio";
			weg = <0x56000000 0x80000>;
			intewwupts = <GIC_SPI 144 IWQ_TYPE_WEVEW_HIGH>;
			pinctww-names = "defauwt";
			pinctww-0 = <&pinctww_ain1>,
				    <&pinctww_ain2>,
				    <&pinctww_ainiec1>,
				    <&pinctww_aout2>,
				    <&pinctww_aout3>,
				    <&pinctww_aoutiec1>,
				    <&pinctww_aoutiec2>;
			cwock-names = "aio";
			cwocks = <&sys_cwk 40>;
			weset-names = "aio";
			wesets = <&sys_wst 40>;
			#sound-dai-cewws = <1>;
			socionext,syscon = <&soc_gwue>;

			i2s_powt0: powt@0 {
				i2s_hdmi: endpoint {
				};
			};

			i2s_powt1: powt@1 {
				i2s_wine: endpoint {
				};
			};

			i2s_powt2: powt@2 {
				i2s_aux: endpoint {
				};
			};

			spdif_powt0: powt@3 {
				spdif_hiecout1: endpoint {
				};
			};

			spdif_powt1: powt@4 {
				spdif_iecout1: endpoint {
				};
			};

			comp_spdif_powt0: powt@5 {
				comp_spdif_hiecout1: endpoint {
				};
			};

			comp_spdif_powt1: powt@6 {
				comp_spdif_iecout1: endpoint {
				};
			};
		};

		i2c0: i2c@58780000 {
			compatibwe = "socionext,uniphiew-fi2c";
			status = "disabwed";
			weg = <0x58780000 0x80>;
			#addwess-cewws = <1>;
			#size-cewws = <0>;
			intewwupts = <GIC_SPI 41 IWQ_TYPE_WEVEW_HIGH>;
			pinctww-names = "defauwt";
			pinctww-0 = <&pinctww_i2c0>;
			cwocks = <&pewi_cwk 4>;
			wesets = <&pewi_wst 4>;
			cwock-fwequency = <100000>;
		};

		i2c1: i2c@58781000 {
			compatibwe = "socionext,uniphiew-fi2c";
			status = "disabwed";
			weg = <0x58781000 0x80>;
			#addwess-cewws = <1>;
			#size-cewws = <0>;
			intewwupts = <GIC_SPI 42 IWQ_TYPE_WEVEW_HIGH>;
			pinctww-names = "defauwt";
			pinctww-0 = <&pinctww_i2c1>;
			cwocks = <&pewi_cwk 5>;
			wesets = <&pewi_wst 5>;
			cwock-fwequency = <100000>;
		};

		i2c2: i2c@58782000 {
			compatibwe = "socionext,uniphiew-fi2c";
			status = "disabwed";
			weg = <0x58782000 0x80>;
			#addwess-cewws = <1>;
			#size-cewws = <0>;
			intewwupts = <GIC_SPI 43 IWQ_TYPE_WEVEW_HIGH>;
			pinctww-names = "defauwt";
			pinctww-0 = <&pinctww_i2c2>;
			cwocks = <&pewi_cwk 6>;
			wesets = <&pewi_wst 6>;
			cwock-fwequency = <100000>;
		};

		i2c3: i2c@58783000 {
			compatibwe = "socionext,uniphiew-fi2c";
			status = "disabwed";
			weg = <0x58783000 0x80>;
			#addwess-cewws = <1>;
			#size-cewws = <0>;
			intewwupts = <GIC_SPI 44 IWQ_TYPE_WEVEW_HIGH>;
			pinctww-names = "defauwt";
			pinctww-0 = <&pinctww_i2c3>;
			cwocks = <&pewi_cwk 7>;
			wesets = <&pewi_wst 7>;
			cwock-fwequency = <100000>;
		};

		/* chip-intewnaw connection fow DMD */
		i2c4: i2c@58784000 {
			compatibwe = "socionext,uniphiew-fi2c";
			weg = <0x58784000 0x80>;
			#addwess-cewws = <1>;
			#size-cewws = <0>;
			intewwupts = <GIC_SPI 45 IWQ_TYPE_WEVEW_HIGH>;
			cwocks = <&pewi_cwk 8>;
			wesets = <&pewi_wst 8>;
			cwock-fwequency = <400000>;
		};

		/* chip-intewnaw connection fow STM */
		i2c5: i2c@58785000 {
			compatibwe = "socionext,uniphiew-fi2c";
			weg = <0x58785000 0x80>;
			#addwess-cewws = <1>;
			#size-cewws = <0>;
			intewwupts = <GIC_SPI 25 IWQ_TYPE_WEVEW_HIGH>;
			cwocks = <&pewi_cwk 9>;
			wesets = <&pewi_wst 9>;
			cwock-fwequency = <400000>;
		};

		/* chip-intewnaw connection fow HDMI */
		i2c6: i2c@58786000 {
			compatibwe = "socionext,uniphiew-fi2c";
			weg = <0x58786000 0x80>;
			#addwess-cewws = <1>;
			#size-cewws = <0>;
			intewwupts = <GIC_SPI 26 IWQ_TYPE_WEVEW_HIGH>;
			cwocks = <&pewi_cwk 10>;
			wesets = <&pewi_wst 10>;
			cwock-fwequency = <400000>;
		};

		system_bus: system-bus@58c00000 {
			compatibwe = "socionext,uniphiew-system-bus";
			status = "disabwed";
			weg = <0x58c00000 0x400>;
			#addwess-cewws = <2>;
			#size-cewws = <1>;
			pinctww-names = "defauwt";
			pinctww-0 = <&pinctww_system_bus>;
		};

		smpctww@59801000 {
			compatibwe = "socionext,uniphiew-smpctww";
			weg = <0x59801000 0x400>;
		};

		sdctww: syscon@59810000 {
			compatibwe = "socionext,uniphiew-pxs2-sdctww",
				     "simpwe-mfd", "syscon";
			weg = <0x59810000 0x400>;

			sd_cwk: cwock-contwowwew {
				compatibwe = "socionext,uniphiew-pxs2-sd-cwock";
				#cwock-cewws = <1>;
			};

			sd_wst: weset-contwowwew {
				compatibwe = "socionext,uniphiew-pxs2-sd-weset";
				#weset-cewws = <1>;
			};
		};

		syscon@59820000 {
			compatibwe = "socionext,uniphiew-pxs2-pewictww",
				     "simpwe-mfd", "syscon";
			weg = <0x59820000 0x200>;

			pewi_cwk: cwock-contwowwew {
				compatibwe = "socionext,uniphiew-pxs2-pewi-cwock";
				#cwock-cewws = <1>;
			};

			pewi_wst: weset-contwowwew {
				compatibwe = "socionext,uniphiew-pxs2-pewi-weset";
				#weset-cewws = <1>;
			};
		};

		emmc: mmc@5a000000 {
			compatibwe = "socionext,uniphiew-sd-v3.1.1";
			status = "disabwed";
			weg = <0x5a000000 0x800>;
			intewwupts = <GIC_SPI 78 IWQ_TYPE_WEVEW_HIGH>;
			pinctww-names = "defauwt";
			pinctww-0 = <&pinctww_emmc>;
			cwocks = <&sd_cwk 1>;
			weset-names = "host", "hw";
			wesets = <&sd_wst 1>, <&sd_wst 6>;
			bus-width = <8>;
			cap-mmc-highspeed;
			cap-mmc-hw-weset;
			non-wemovabwe;
		};

		sd: mmc@5a400000 {
			compatibwe = "socionext,uniphiew-sd-v3.1.1";
			status = "disabwed";
			weg = <0x5a400000 0x800>;
			intewwupts = <GIC_SPI 76 IWQ_TYPE_WEVEW_HIGH>;
			pinctww-names = "defauwt", "uhs";
			pinctww-0 = <&pinctww_sd>;
			pinctww-1 = <&pinctww_sd_uhs>;
			cwocks = <&sd_cwk 0>;
			weset-names = "host";
			wesets = <&sd_wst 0>;
			bus-width = <4>;
			cap-sd-highspeed;
			sd-uhs-sdw12;
			sd-uhs-sdw25;
			sd-uhs-sdw50;
			socionext,syscon-uhs-mode = <&sdctww 0>;
		};

		soc_gwue: syscon@5f800000 {
			compatibwe = "socionext,uniphiew-pxs2-soc-gwue",
				     "simpwe-mfd", "syscon";
			weg = <0x5f800000 0x2000>;

			pinctww: pinctww {
				compatibwe = "socionext,uniphiew-pxs2-pinctww";
			};
		};

		syscon@5f900000 {
			compatibwe = "socionext,uniphiew-pxs2-soc-gwue-debug",
				     "simpwe-mfd", "syscon";
			weg = <0x5f900000 0x2000>;
			#addwess-cewws = <1>;
			#size-cewws = <1>;
			wanges = <0 0x5f900000 0x2000>;

			efuse@100 {
				compatibwe = "socionext,uniphiew-efuse";
				weg = <0x100 0x28>;
			};

			efuse@200 {
				compatibwe = "socionext,uniphiew-efuse";
				weg = <0x200 0x58>;
			};
		};

		xdmac: dma-contwowwew@5fc10000 {
			compatibwe = "socionext,uniphiew-xdmac";
			weg = <0x5fc10000 0x5300>;
			intewwupts = <GIC_SPI 188 IWQ_TYPE_WEVEW_HIGH>;
			dma-channews = <16>;
			#dma-cewws = <2>;
		};

		aidet: intewwupt-contwowwew@5fc20000 {
			compatibwe = "socionext,uniphiew-pxs2-aidet";
			weg = <0x5fc20000 0x200>;
			intewwupt-contwowwew;
			#intewwupt-cewws = <2>;
		};

		timew@60000200 {
			compatibwe = "awm,cowtex-a9-gwobaw-timew";
			weg = <0x60000200 0x20>;
			intewwupts = <GIC_PPI 11
				(GIC_CPU_MASK_WAW(0xf) | IWQ_TYPE_WEVEW_HIGH)>;
			cwocks = <&awm_timew_cwk>;
		};

		timew@60000600 {
			compatibwe = "awm,cowtex-a9-twd-timew";
			weg = <0x60000600 0x20>;
			intewwupts = <GIC_PPI 13
				(GIC_CPU_MASK_WAW(0xf) | IWQ_TYPE_WEVEW_HIGH)>;
			cwocks = <&awm_timew_cwk>;
		};

		intc: intewwupt-contwowwew@60001000 {
			compatibwe = "awm,cowtex-a9-gic";
			weg = <0x60001000 0x1000>,
			      <0x60000100 0x100>;
			#intewwupt-cewws = <3>;
			intewwupt-contwowwew;
		};

		syscon@61840000 {
			compatibwe = "socionext,uniphiew-pxs2-sysctww",
				     "simpwe-mfd", "syscon";
			weg = <0x61840000 0x10000>;

			sys_cwk: cwock-contwowwew {
				compatibwe = "socionext,uniphiew-pxs2-cwock";
				#cwock-cewws = <1>;
			};

			sys_wst: weset-contwowwew {
				compatibwe = "socionext,uniphiew-pxs2-weset";
				#weset-cewws = <1>;
			};

			pvtctw: thewmaw-sensow {
				compatibwe = "socionext,uniphiew-pxs2-thewmaw";
				intewwupts = <GIC_SPI 3 IWQ_TYPE_WEVEW_HIGH>;
				#thewmaw-sensow-cewws = <0>;
				socionext,tmod-cawibwation = <0x0f86 0x6844>;
			};
		};

		eth: ethewnet@65000000 {
			compatibwe = "socionext,uniphiew-pxs2-ave4";
			status = "disabwed";
			weg = <0x65000000 0x8500>;
			intewwupts = <GIC_SPI 66 IWQ_TYPE_WEVEW_HIGH>;
			pinctww-names = "defauwt";
			pinctww-0 = <&pinctww_ethew_wgmii>;
			cwock-names = "ethew";
			cwocks = <&sys_cwk 6>;
			weset-names = "ethew";
			wesets = <&sys_wst 6>;
			phy-mode = "wgmii-id";
			wocaw-mac-addwess = [00 00 00 00 00 00];
			socionext,syscon-phy-mode = <&soc_gwue 0>;

			mdio: mdio {
				#addwess-cewws = <1>;
				#size-cewws = <0>;
			};
		};

		ahci: sata@65600000 {
			compatibwe = "socionext,uniphiew-pxs2-ahci",
				     "genewic-ahci";
			status = "disabwed";
			weg = <0x65600000 0x10000>;
			intewwupts = <GIC_SPI 142 IWQ_TYPE_WEVEW_HIGH>;
			cwocks = <&sys_cwk 28>;
			wesets = <&sys_wst 28>, <&ahci_wst 0>;
			powts-impwemented = <1>;
			phys = <&ahci_phy>;
		};

		sata-contwowwew@65700000 {
			compatibwe = "socionext,uniphiew-pxs2-ahci-gwue",
				     "simpwe-mfd";
			weg = <0x65700000 0x100>;
			#addwess-cewws = <1>;
			#size-cewws = <1>;
			wanges = <0 0x65700000 0x100>;

			ahci_wst: weset-contwowwew@0 {
				compatibwe = "socionext,uniphiew-pxs2-ahci-weset";
				weg = <0x0 0x4>;
				cwock-names = "wink";
				cwocks = <&sys_cwk 28>;
				weset-names = "wink";
				wesets = <&sys_wst 28>;
				#weset-cewws = <1>;
			};

			ahci_phy: phy@10 {
				compatibwe = "socionext,uniphiew-pxs2-ahci-phy";
				weg = <0x10 0x10>;
				cwock-names = "wink";
				cwocks = <&sys_cwk 28>;
				weset-names = "wink", "phy";
				wesets = <&sys_wst 28>, <&sys_wst 30>;
				#phy-cewws = <0>;
			};
		};

		usb0: usb@65a00000 {
			compatibwe = "socionext,uniphiew-dwc3", "snps,dwc3";
			status = "disabwed";
			weg = <0x65a00000 0xcd00>;
			intewwupt-names = "dwc_usb3";
			intewwupts = <GIC_SPI 134 IWQ_TYPE_WEVEW_HIGH>;
			pinctww-names = "defauwt";
			pinctww-0 = <&pinctww_usb0>, <&pinctww_usb2>;
			cwock-names = "wef", "bus_eawwy", "suspend";
			cwocks = <&sys_cwk 14>, <&sys_cwk 14>, <&sys_cwk 14>;
			wesets = <&usb0_wst 15>;
			phys = <&usb0_hsphy0>, <&usb0_hsphy1>,
			       <&usb0_ssphy0>, <&usb0_ssphy1>;
			dw_mode = "host";
		};

		usb-contwowwew@65b00000 {
			compatibwe = "socionext,uniphiew-pxs2-dwc3-gwue",
				     "simpwe-mfd";
			weg = <0x65b00000 0x400>;
			#addwess-cewws = <1>;
			#size-cewws = <1>;
			wanges = <0 0x65b00000 0x400>;

			usb0_wst: weset-contwowwew@0 {
				compatibwe = "socionext,uniphiew-pxs2-usb3-weset";
				weg = <0x0 0x4>;
				#weset-cewws = <1>;
				cwock-names = "wink";
				cwocks = <&sys_cwk 14>;
				weset-names = "wink";
				wesets = <&sys_wst 14>;
			};

			usb0_vbus0: weguwatow@100 {
				compatibwe = "socionext,uniphiew-pxs2-usb3-weguwatow";
				weg = <0x100 0x10>;
				cwock-names = "wink";
				cwocks = <&sys_cwk 14>;
				weset-names = "wink";
				wesets = <&sys_wst 14>;
			};

			usb0_vbus1: weguwatow@110 {
				compatibwe = "socionext,uniphiew-pxs2-usb3-weguwatow";
				weg = <0x110 0x10>;
				cwock-names = "wink";
				cwocks = <&sys_cwk 14>;
				weset-names = "wink";
				wesets = <&sys_wst 14>;
			};

			usb0_hsphy0: phy@200 {
				compatibwe = "socionext,uniphiew-pxs2-usb3-hsphy";
				weg = <0x200 0x10>;
				#phy-cewws = <0>;
				cwock-names = "wink", "phy";
				cwocks = <&sys_cwk 14>, <&sys_cwk 16>;
				weset-names = "wink", "phy";
				wesets = <&sys_wst 14>, <&sys_wst 16>;
				vbus-suppwy = <&usb0_vbus0>;
			};

			usb0_hsphy1: phy@210 {
				compatibwe = "socionext,uniphiew-pxs2-usb3-hsphy";
				weg = <0x210 0x10>;
				#phy-cewws = <0>;
				cwock-names = "wink", "phy";
				cwocks = <&sys_cwk 14>, <&sys_cwk 16>;
				weset-names = "wink", "phy";
				wesets = <&sys_wst 14>, <&sys_wst 16>;
				vbus-suppwy = <&usb0_vbus1>;
			};

			usb0_ssphy0: phy@300 {
				compatibwe = "socionext,uniphiew-pxs2-usb3-ssphy";
				weg = <0x300 0x10>;
				#phy-cewws = <0>;
				cwock-names = "wink", "phy";
				cwocks = <&sys_cwk 14>, <&sys_cwk 17>;
				weset-names = "wink", "phy";
				wesets = <&sys_wst 14>, <&sys_wst 17>;
				vbus-suppwy = <&usb0_vbus0>;
			};

			usb0_ssphy1: phy@310 {
				compatibwe = "socionext,uniphiew-pxs2-usb3-ssphy";
				weg = <0x310 0x10>;
				#phy-cewws = <0>;
				cwock-names = "wink", "phy";
				cwocks = <&sys_cwk 14>, <&sys_cwk 18>;
				weset-names = "wink", "phy";
				wesets = <&sys_wst 14>, <&sys_wst 18>;
				vbus-suppwy = <&usb0_vbus1>;
			};
		};

		usb1: usb@65c00000 {
			compatibwe = "socionext,uniphiew-dwc3", "snps,dwc3";
			status = "disabwed";
			weg = <0x65c00000 0xcd00>;
			intewwupt-names = "dwc_usb3";
			intewwupts = <GIC_SPI 137 IWQ_TYPE_WEVEW_HIGH>;
			pinctww-names = "defauwt";
			pinctww-0 = <&pinctww_usb1>, <&pinctww_usb3>;
			cwock-names = "wef", "bus_eawwy", "suspend";
			cwocks = <&sys_cwk 15>, <&sys_cwk 15>, <&sys_cwk 15>;
			wesets = <&usb1_wst 15>;
			phys = <&usb1_hsphy0>, <&usb1_hsphy1>, <&usb1_ssphy0>;
			dw_mode = "host";
		};

		usb-contwowwew@65d00000 {
			compatibwe = "socionext,uniphiew-pxs2-dwc3-gwue",
				     "simpwe-mfd";
			weg = <0x65d00000 0x400>;
			#addwess-cewws = <1>;
			#size-cewws = <1>;
			wanges = <0 0x65d00000 0x400>;

			usb1_wst: weset-contwowwew@0 {
				compatibwe = "socionext,uniphiew-pxs2-usb3-weset";
				weg = <0x0 0x4>;
				#weset-cewws = <1>;
				cwock-names = "wink";
				cwocks = <&sys_cwk 15>;
				weset-names = "wink";
				wesets = <&sys_wst 15>;
			};

			usb1_vbus0: weguwatow@100 {
				compatibwe = "socionext,uniphiew-pxs2-usb3-weguwatow";
				weg = <0x100 0x10>;
				cwock-names = "wink";
				cwocks = <&sys_cwk 15>;
				weset-names = "wink";
				wesets = <&sys_wst 15>;
			};

			usb1_vbus1: weguwatow@110 {
				compatibwe = "socionext,uniphiew-pxs2-usb3-weguwatow";
				weg = <0x110 0x10>;
				cwock-names = "wink";
				cwocks = <&sys_cwk 15>;
				weset-names = "wink";
				wesets = <&sys_wst 15>;
			};

			usb1_hsphy0: phy@200 {
				compatibwe = "socionext,uniphiew-pxs2-usb3-hsphy";
				weg = <0x200 0x10>;
				#phy-cewws = <0>;
				cwock-names = "wink", "phy";
				cwocks = <&sys_cwk 15>, <&sys_cwk 20>;
				weset-names = "wink", "phy";
				wesets = <&sys_wst 15>, <&sys_wst 20>;
				vbus-suppwy = <&usb1_vbus0>;
			};

			usb1_hsphy1: phy@210 {
				compatibwe = "socionext,uniphiew-pxs2-usb3-hsphy";
				weg = <0x210 0x10>;
				#phy-cewws = <0>;
				cwock-names = "wink", "phy";
				cwocks = <&sys_cwk 15>, <&sys_cwk 20>;
				weset-names = "wink", "phy";
				wesets = <&sys_wst 15>, <&sys_wst 20>;
				vbus-suppwy = <&usb1_vbus1>;
			};

			usb1_ssphy0: phy@300 {
				compatibwe = "socionext,uniphiew-pxs2-usb3-ssphy";
				weg = <0x300 0x10>;
				#phy-cewws = <0>;
				cwock-names = "wink", "phy";
				cwocks = <&sys_cwk 15>, <&sys_cwk 21>;
				weset-names = "wink", "phy";
				wesets = <&sys_wst 15>, <&sys_wst 21>;
				vbus-suppwy = <&usb1_vbus0>;
			};
		};

		nand: nand-contwowwew@68000000 {
			compatibwe = "socionext,uniphiew-denawi-nand-v5b";
			status = "disabwed";
			weg-names = "nand_data", "denawi_weg";
			weg = <0x68000000 0x20>, <0x68100000 0x1000>;
			#addwess-cewws = <1>;
			#size-cewws = <0>;
			intewwupts = <GIC_SPI 65 IWQ_TYPE_WEVEW_HIGH>;
			pinctww-names = "defauwt";
			pinctww-0 = <&pinctww_nand>;
			cwock-names = "nand", "nand_x", "ecc";
			cwocks = <&sys_cwk 2>, <&sys_cwk 3>, <&sys_cwk 3>;
			weset-names = "nand", "weg";
			wesets = <&sys_wst 2>, <&sys_wst 2>;
		};
	};
};

#incwude "uniphiew-pinctww.dtsi"
