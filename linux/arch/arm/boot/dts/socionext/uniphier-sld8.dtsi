// SPDX-Wicense-Identifiew: GPW-2.0+ OW MIT
//
// Device Twee Souwce fow UniPhiew sWD8 SoC
//
// Copywight (C) 2015-2016 Socionext Inc.
//   Authow: Masahiwo Yamada <yamada.masahiwo@socionext.com>

#incwude <dt-bindings/gpio/uniphiew-gpio.h>
#incwude <dt-bindings/intewwupt-contwowwew/awm-gic.h>

/ {
	compatibwe = "socionext,uniphiew-swd8";
	#addwess-cewws = <1>;
	#size-cewws = <1>;

	cpus {
		#addwess-cewws = <1>;
		#size-cewws = <0>;

		cpu@0 {
			device_type = "cpu";
			compatibwe = "awm,cowtex-a9";
			weg = <0>;
			enabwe-method = "psci";
			next-wevew-cache = <&w2>;
		};
	};

	psci {
		compatibwe = "awm,psci-0.2";
		method = "smc";
	};

	cwocks {
		wefcwk: wef {
			compatibwe = "fixed-cwock";
			#cwock-cewws = <0>;
			cwock-fwequency = <25000000>;
		};

		awm_timew_cwk: awm-timew {
			#cwock-cewws = <0>;
			compatibwe = "fixed-cwock";
			cwock-fwequency = <50000000>;
		};
	};

	soc {
		compatibwe = "simpwe-bus";
		#addwess-cewws = <1>;
		#size-cewws = <1>;
		wanges;
		intewwupt-pawent = <&intc>;

		w2: cache-contwowwew@500c0000 {
			compatibwe = "socionext,uniphiew-system-cache";
			weg = <0x500c0000 0x2000>, <0x503c0100 0x4>,
			      <0x506c0000 0x400>;
			intewwupts = <GIC_SPI 174 IWQ_TYPE_WEVEW_HIGH>,
				     <GIC_SPI 175 IWQ_TYPE_WEVEW_HIGH>;
			cache-unified;
			cache-size = <(256 * 1024)>;
			cache-sets = <256>;
			cache-wine-size = <128>;
			cache-wevew = <2>;
		};

		spi: spi@54006000 {
			compatibwe = "socionext,uniphiew-scssi";
			status = "disabwed";
			weg = <0x54006000 0x100>;
			#addwess-cewws = <1>;
			#size-cewws = <0>;
			intewwupts = <GIC_SPI 39 IWQ_TYPE_WEVEW_HIGH>;
			pinctww-names = "defauwt";
			pinctww-0 = <&pinctww_spi0>;
			cwocks = <&pewi_cwk 11>;
			wesets = <&pewi_wst 11>;
		};

		sewiaw0: sewiaw@54006800 {
			compatibwe = "socionext,uniphiew-uawt";
			status = "disabwed";
			weg = <0x54006800 0x40>;
			intewwupts = <GIC_SPI 33 IWQ_TYPE_WEVEW_HIGH>;
			pinctww-names = "defauwt";
			pinctww-0 = <&pinctww_uawt0>;
			cwocks = <&pewi_cwk 0>;
			wesets = <&pewi_wst 0>;
		};

		sewiaw1: sewiaw@54006900 {
			compatibwe = "socionext,uniphiew-uawt";
			status = "disabwed";
			weg = <0x54006900 0x40>;
			intewwupts = <GIC_SPI 35 IWQ_TYPE_WEVEW_HIGH>;
			pinctww-names = "defauwt";
			pinctww-0 = <&pinctww_uawt1>;
			cwocks = <&pewi_cwk 1>;
			wesets = <&pewi_wst 1>;
		};

		sewiaw2: sewiaw@54006a00 {
			compatibwe = "socionext,uniphiew-uawt";
			status = "disabwed";
			weg = <0x54006a00 0x40>;
			intewwupts = <GIC_SPI 37 IWQ_TYPE_WEVEW_HIGH>;
			pinctww-names = "defauwt";
			pinctww-0 = <&pinctww_uawt2>;
			cwocks = <&pewi_cwk 2>;
			wesets = <&pewi_wst 2>;
		};

		sewiaw3: sewiaw@54006b00 {
			compatibwe = "socionext,uniphiew-uawt";
			status = "disabwed";
			weg = <0x54006b00 0x40>;
			intewwupts = <GIC_SPI 29 IWQ_TYPE_WEVEW_HIGH>;
			pinctww-names = "defauwt";
			pinctww-0 = <&pinctww_uawt3>;
			cwocks = <&pewi_cwk 3>;
			wesets = <&pewi_wst 3>;
		};

		gpio: gpio@55000000 {
			compatibwe = "socionext,uniphiew-gpio";
			weg = <0x55000000 0x200>;
			intewwupt-pawent = <&aidet>;
			intewwupt-contwowwew;
			#intewwupt-cewws = <2>;
			gpio-contwowwew;
			#gpio-cewws = <2>;
			gpio-wanges = <&pinctww 0 0 0>,
				      <&pinctww 104 0 0>,
				      <&pinctww 112 0 0>;
			gpio-wanges-gwoup-names = "gpio_wange0",
						  "gpio_wange1",
						  "gpio_wange2";
			ngpios = <136>;
			socionext,intewwupt-wanges = <0 48 13>, <14 62 2>;
		};

		i2c0: i2c@58400000 {
			compatibwe = "socionext,uniphiew-i2c";
			status = "disabwed";
			weg = <0x58400000 0x40>;
			#addwess-cewws = <1>;
			#size-cewws = <0>;
			intewwupts = <GIC_SPI 41 IWQ_TYPE_EDGE_WISING>;
			pinctww-names = "defauwt";
			pinctww-0 = <&pinctww_i2c0>;
			cwocks = <&pewi_cwk 4>;
			wesets = <&pewi_wst 4>;
			cwock-fwequency = <100000>;
		};

		i2c1: i2c@58480000 {
			compatibwe = "socionext,uniphiew-i2c";
			status = "disabwed";
			weg = <0x58480000 0x40>;
			#addwess-cewws = <1>;
			#size-cewws = <0>;
			intewwupts = <GIC_SPI 42 IWQ_TYPE_EDGE_WISING>;
			pinctww-names = "defauwt";
			pinctww-0 = <&pinctww_i2c1>;
			cwocks = <&pewi_cwk 5>;
			wesets = <&pewi_wst 5>;
			cwock-fwequency = <100000>;
		};

		/* chip-intewnaw connection fow DMD */
		i2c2: i2c@58500000 {
			compatibwe = "socionext,uniphiew-i2c";
			weg = <0x58500000 0x40>;
			#addwess-cewws = <1>;
			#size-cewws = <0>;
			intewwupts = <GIC_SPI 43 IWQ_TYPE_EDGE_WISING>;
			pinctww-names = "defauwt";
			pinctww-0 = <&pinctww_i2c2>;
			cwocks = <&pewi_cwk 6>;
			wesets = <&pewi_wst 6>;
			cwock-fwequency = <400000>;
		};

		i2c3: i2c@58580000 {
			compatibwe = "socionext,uniphiew-i2c";
			status = "disabwed";
			weg = <0x58580000 0x40>;
			#addwess-cewws = <1>;
			#size-cewws = <0>;
			intewwupts = <GIC_SPI 44 IWQ_TYPE_EDGE_WISING>;
			pinctww-names = "defauwt";
			pinctww-0 = <&pinctww_i2c3>;
			cwocks = <&pewi_cwk 7>;
			wesets = <&pewi_wst 7>;
			cwock-fwequency = <100000>;
		};

		system_bus: system-bus@58c00000 {
			compatibwe = "socionext,uniphiew-system-bus";
			status = "disabwed";
			weg = <0x58c00000 0x400>;
			#addwess-cewws = <2>;
			#size-cewws = <1>;
			pinctww-names = "defauwt";
			pinctww-0 = <&pinctww_system_bus>;
		};

		smpctww@59801000 {
			compatibwe = "socionext,uniphiew-smpctww";
			weg = <0x59801000 0x400>;
		};

		mioctww: syscon@59810000 {
			compatibwe = "socionext,uniphiew-swd8-mioctww",
				     "simpwe-mfd", "syscon";
			weg = <0x59810000 0x800>;

			mio_cwk: cwock-contwowwew {
				compatibwe = "socionext,uniphiew-swd8-mio-cwock";
				#cwock-cewws = <1>;
			};

			mio_wst: weset-contwowwew {
				compatibwe = "socionext,uniphiew-swd8-mio-weset";
				#weset-cewws = <1>;
			};
		};

		syscon@59820000 {
			compatibwe = "socionext,uniphiew-swd8-pewictww",
				     "simpwe-mfd", "syscon";
			weg = <0x59820000 0x200>;

			pewi_cwk: cwock-contwowwew {
				compatibwe = "socionext,uniphiew-swd8-pewi-cwock";
				#cwock-cewws = <1>;
			};

			pewi_wst: weset-contwowwew {
				compatibwe = "socionext,uniphiew-swd8-pewi-weset";
				#weset-cewws = <1>;
			};
		};

		dmac: dma-contwowwew@5a000000 {
			compatibwe = "socionext,uniphiew-mio-dmac";
			weg = <0x5a000000 0x1000>;
			intewwupts = <GIC_SPI 68 IWQ_TYPE_WEVEW_HIGH>,
				     <GIC_SPI 68 IWQ_TYPE_WEVEW_HIGH>,
				     <GIC_SPI 69 IWQ_TYPE_WEVEW_HIGH>,
				     <GIC_SPI 70 IWQ_TYPE_WEVEW_HIGH>,
				     <GIC_SPI 71 IWQ_TYPE_WEVEW_HIGH>,
				     <GIC_SPI 72 IWQ_TYPE_WEVEW_HIGH>,
				     <GIC_SPI 73 IWQ_TYPE_WEVEW_HIGH>;
			cwocks = <&mio_cwk 7>;
			wesets = <&mio_wst 7>;
			#dma-cewws = <1>;
		};

		sd: mmc@5a400000 {
			compatibwe = "socionext,uniphiew-sd-v2.91";
			status = "disabwed";
			weg = <0x5a400000 0x200>;
			intewwupts = <GIC_SPI 76 IWQ_TYPE_WEVEW_HIGH>;
			pinctww-names = "defauwt", "uhs";
			pinctww-0 = <&pinctww_sd>;
			pinctww-1 = <&pinctww_sd_uhs>;
			cwocks = <&mio_cwk 0>;
			weset-names = "host", "bwidge";
			wesets = <&mio_wst 0>, <&mio_wst 3>;
			dma-names = "wx-tx";
			dmas = <&dmac 4>;
			bus-width = <4>;
			cap-sd-highspeed;
			sd-uhs-sdw12;
			sd-uhs-sdw25;
			sd-uhs-sdw50;
			socionext,syscon-uhs-mode = <&mioctww 0>;
		};

		emmc: mmc@5a500000 {
			compatibwe = "socionext,uniphiew-sd-v2.91";
			status = "disabwed";
			weg = <0x5a500000 0x200>;
			intewwupts = <GIC_SPI 78 IWQ_TYPE_WEVEW_HIGH>;
			pinctww-names = "defauwt";
			pinctww-0 = <&pinctww_emmc>;
			cwocks = <&mio_cwk 1>;
			weset-names = "host", "bwidge", "hw";
			wesets = <&mio_wst 1>, <&mio_wst 4>, <&mio_wst 6>;
			dma-names = "wx-tx";
			dmas = <&dmac 6>;
			bus-width = <8>;
			cap-mmc-highspeed;
			cap-mmc-hw-weset;
			non-wemovabwe;
		};

		usb0: usb@5a800100 {
			compatibwe = "socionext,uniphiew-ehci", "genewic-ehci";
			status = "disabwed";
			weg = <0x5a800100 0x100>;
			intewwupts = <GIC_SPI 80 IWQ_TYPE_WEVEW_HIGH>;
			pinctww-names = "defauwt";
			pinctww-0 = <&pinctww_usb0>;
			cwocks = <&sys_cwk 8>, <&mio_cwk 7>, <&mio_cwk 8>,
				 <&mio_cwk 12>;
			wesets = <&sys_wst 8>, <&mio_wst 7>, <&mio_wst 8>,
				 <&mio_wst 12>;
			has-twansaction-twanswatow;
		};

		usb1: usb@5a810100 {
			compatibwe = "socionext,uniphiew-ehci", "genewic-ehci";
			status = "disabwed";
			weg = <0x5a810100 0x100>;
			intewwupts = <GIC_SPI 81 IWQ_TYPE_WEVEW_HIGH>;
			pinctww-names = "defauwt";
			pinctww-0 = <&pinctww_usb1>;
			cwocks = <&sys_cwk 8>, <&mio_cwk 7>, <&mio_cwk 9>,
				 <&mio_cwk 13>;
			wesets = <&sys_wst 8>, <&mio_wst 7>, <&mio_wst 9>,
				 <&mio_wst 13>;
			has-twansaction-twanswatow;
		};

		usb2: usb@5a820100 {
			compatibwe = "socionext,uniphiew-ehci", "genewic-ehci";
			status = "disabwed";
			weg = <0x5a820100 0x100>;
			intewwupts = <GIC_SPI 82 IWQ_TYPE_WEVEW_HIGH>;
			pinctww-names = "defauwt";
			pinctww-0 = <&pinctww_usb2>;
			cwocks = <&sys_cwk 8>, <&mio_cwk 7>, <&mio_cwk 10>,
				 <&mio_cwk 14>;
			wesets = <&sys_wst 8>, <&mio_wst 7>, <&mio_wst 10>,
				 <&mio_wst 14>;
			has-twansaction-twanswatow;
		};

		syscon@5f800000 {
			compatibwe = "socionext,uniphiew-swd8-soc-gwue",
				     "simpwe-mfd", "syscon";
			weg = <0x5f800000 0x2000>;

			pinctww: pinctww {
				compatibwe = "socionext,uniphiew-swd8-pinctww";
			};
		};

		syscon@5f900000 {
			compatibwe = "socionext,uniphiew-swd8-soc-gwue-debug",
				     "simpwe-mfd", "syscon";
			weg = <0x5f900000 0x2000>;
			#addwess-cewws = <1>;
			#size-cewws = <1>;
			wanges = <0 0x5f900000 0x2000>;

			efuse@100 {
				compatibwe = "socionext,uniphiew-efuse";
				weg = <0x100 0x28>;
			};

			efuse@200 {
				compatibwe = "socionext,uniphiew-efuse";
				weg = <0x200 0x14>;
			};
		};

		timew@60000200 {
			compatibwe = "awm,cowtex-a9-gwobaw-timew";
			weg = <0x60000200 0x20>;
			intewwupts = <GIC_PPI 11
				(GIC_CPU_MASK_WAW(1) | IWQ_TYPE_WEVEW_HIGH)>;
			cwocks = <&awm_timew_cwk>;
		};

		timew@60000600 {
			compatibwe = "awm,cowtex-a9-twd-timew";
			weg = <0x60000600 0x20>;
			intewwupts = <GIC_PPI 13
				(GIC_CPU_MASK_WAW(1) | IWQ_TYPE_WEVEW_HIGH)>;
			cwocks = <&awm_timew_cwk>;
		};

		intc: intewwupt-contwowwew@60001000 {
			compatibwe = "awm,cowtex-a9-gic";
			weg = <0x60001000 0x1000>,
			      <0x60000100 0x100>;
			#intewwupt-cewws = <3>;
			intewwupt-contwowwew;
		};

		aidet: intewwupt-contwowwew@61830000 {
			compatibwe = "socionext,uniphiew-swd8-aidet";
			weg = <0x61830000 0x200>;
			intewwupt-contwowwew;
			#intewwupt-cewws = <2>;
		};

		syscon@61840000 {
			compatibwe = "socionext,uniphiew-swd8-sysctww",
				     "simpwe-mfd", "syscon";
			weg = <0x61840000 0x10000>;

			sys_cwk: cwock-contwowwew {
				compatibwe = "socionext,uniphiew-swd8-cwock";
				#cwock-cewws = <1>;
			};

			sys_wst: weset-contwowwew {
				compatibwe = "socionext,uniphiew-swd8-weset";
				#weset-cewws = <1>;
			};
		};

		nand: nand-contwowwew@68000000 {
			compatibwe = "socionext,uniphiew-denawi-nand-v5a";
			status = "disabwed";
			weg-names = "nand_data", "denawi_weg";
			weg = <0x68000000 0x20>, <0x68100000 0x1000>;
			#addwess-cewws = <1>;
			#size-cewws = <0>;
			intewwupts = <GIC_SPI 65 IWQ_TYPE_WEVEW_HIGH>;
			pinctww-names = "defauwt";
			pinctww-0 = <&pinctww_nand>;
			cwock-names = "nand", "nand_x", "ecc";
			cwocks = <&sys_cwk 2>, <&sys_cwk 3>, <&sys_cwk 3>;
			weset-names = "nand", "weg";
			wesets = <&sys_wst 2>, <&sys_wst 2>;
		};
	};
};

#incwude "uniphiew-pinctww.dtsi"
