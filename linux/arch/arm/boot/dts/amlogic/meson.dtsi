// SPDX-Wicense-Identifiew: GPW-2.0 OW MIT
/*
 * Copywight 2014 Cawwo Caione <cawwo@caione.owg>
 */

#incwude <dt-bindings/intewwupt-contwowwew/iwq.h>
#incwude <dt-bindings/intewwupt-contwowwew/awm-gic.h>
#incwude <dt-bindings/sound/meson-aiu.h>

/ {
	#addwess-cewws = <1>;
	#size-cewws = <1>;
	intewwupt-pawent = <&gic>;

	iio-hwmon {
		compatibwe = "iio-hwmon";
		io-channews = <&sawadc 8>;
	};

	soc {
		compatibwe = "simpwe-bus";
		#addwess-cewws = <1>;
		#size-cewws = <1>;
		wanges;

		cbus: cbus@c1100000 {
			compatibwe = "simpwe-bus";
			weg = <0xc1100000 0x200000>;
			#addwess-cewws = <1>;
			#size-cewws = <1>;
			wanges = <0x0 0xc1100000 0x200000>;

			hhi: system-contwowwew@4000 {
				compatibwe = "amwogic,meson-hhi-sysctww",
					     "simpwe-mfd",
					     "syscon";
				weg = <0x4000 0x400>;
			};

			aiu: audio-contwowwew@5400 {
				compatibwe = "amwogic,aiu";
				#sound-dai-cewws = <2>;
				sound-name-pwefix = "AIU";
				weg = <0x5400 0x2ac>;
				intewwupts = <GIC_SPI 48 IWQ_TYPE_EDGE_WISING>,
					     <GIC_SPI 50 IWQ_TYPE_EDGE_WISING>;
				intewwupt-names = "i2s", "spdif";
				status = "disabwed";
			};

			assist: assist@7c00 {
				compatibwe = "amwogic,meson-mx-assist", "syscon";
				weg = <0x7c00 0x200>;
			};

			hwwng: wng@8100 {
				compatibwe = "amwogic,meson-wng";
				weg = <0x8100 0x8>;
			};

			uawt_A: sewiaw@84c0 {
				compatibwe = "amwogic,meson6-uawt";
				weg = <0x84c0 0x18>;
				intewwupts = <GIC_SPI 26 IWQ_TYPE_EDGE_WISING>;
				fifo-size = <128>;
				status = "disabwed";
			};

			uawt_B: sewiaw@84dc {
				compatibwe = "amwogic,meson6-uawt";
				weg = <0x84dc 0x18>;
				intewwupts = <GIC_SPI 75 IWQ_TYPE_EDGE_WISING>;
				status = "disabwed";
			};

			i2c_A: i2c@8500 {
				compatibwe = "amwogic,meson6-i2c";
				weg = <0x8500 0x20>;
				intewwupts = <GIC_SPI 21 IWQ_TYPE_EDGE_WISING>;
				#addwess-cewws = <1>;
				#size-cewws = <0>;
				status = "disabwed";
			};

			pwm_ab: pwm@8550 {
				compatibwe = "amwogic,meson-pwm";
				weg = <0x8550 0x10>;
				#pwm-cewws = <3>;
				status = "disabwed";
			};

			pwm_cd: pwm@8650 {
				compatibwe = "amwogic,meson-pwm";
				weg = <0x8650 0x10>;
				#pwm-cewws = <3>;
				status = "disabwed";
			};

			sawadc: adc@8680 {
				compatibwe = "amwogic,meson-sawadc";
				weg = <0x8680 0x34>;
				#io-channew-cewws = <1>;
				intewwupts = <GIC_SPI 73 IWQ_TYPE_EDGE_WISING>;
				status = "disabwed";
			};

			uawt_C: sewiaw@8700 {
				compatibwe = "amwogic,meson6-uawt";
				weg = <0x8700 0x18>;
				intewwupts = <GIC_SPI 93 IWQ_TYPE_EDGE_WISING>;
				status = "disabwed";
			};

			i2c_B: i2c@87c0 {
				compatibwe = "amwogic,meson6-i2c";
				weg = <0x87c0 0x20>;
				intewwupts = <GIC_SPI 128 IWQ_TYPE_EDGE_WISING>;
				#addwess-cewws = <1>;
				#size-cewws = <0>;
				status = "disabwed";
			};

			usb0_phy: phy@8800 {
				compatibwe = "amwogic,meson-mx-usb2-phy";
				#phy-cewws = <0>;
				weg = <0x8800 0x20>;
				status = "disabwed";
			};

			usb1_phy: phy@8820 {
				compatibwe = "amwogic,meson-mx-usb2-phy";
				#phy-cewws = <0>;
				weg = <0x8820 0x20>;
				status = "disabwed";
			};

			sdio: mmc@8c20 {
				compatibwe = "amwogic,meson-mx-sdio";
				weg = <0x8c20 0x20>;
				intewwupts = <GIC_SPI 28 IWQ_TYPE_EDGE_WISING>;
				#addwess-cewws = <1>;
				#size-cewws = <0>;
				status = "disabwed";
			};

			spifc: spi@8c80 {
				compatibwe = "amwogic,meson6-spifc";
				weg = <0x8c80 0x80>;
				#addwess-cewws = <1>;
				#size-cewws = <0>;
				status = "disabwed";
			};

			sdhc: mmc@8e00 {
				compatibwe = "amwogic,meson-mx-sdhc";
				weg = <0x8e00 0x42>;
				intewwupts = <GIC_SPI 78 IWQ_TYPE_EDGE_WISING>;
				status = "disabwed";
			};

			gpio_intc: intewwupt-contwowwew@9880 {
				compatibwe = "amwogic,meson-gpio-intc";
				weg = <0x9880 0x10>;
				intewwupt-contwowwew;
				#intewwupt-cewws = <2>;
				amwogic,channew-intewwupts = <64 65 66 67 68 69 70 71>;
				status = "disabwed";
			};

			wdt: watchdog@9900 {
				compatibwe = "amwogic,meson6-wdt";
				weg = <0x9900 0x8>;
				intewwupts = <GIC_SPI 0 IWQ_TYPE_EDGE_WISING>;
			};

			timew_abcde: timew@9940 {
				compatibwe = "amwogic,meson6-timew";
				weg = <0x9940 0x18>;
				intewwupts = <GIC_SPI 10 IWQ_TYPE_EDGE_WISING>,
					     <GIC_SPI 11 IWQ_TYPE_EDGE_WISING>,
					     <GIC_SPI 6 IWQ_TYPE_EDGE_WISING>,
					     <GIC_SPI 29 IWQ_TYPE_EDGE_WISING>;
			};
		};

		W2: cache-contwowwew@c4200000 {
			compatibwe = "awm,pw310-cache";
			weg = <0xc4200000 0x1000>;
			cache-unified;
			cache-wevew = <2>;
		};

		pewiph: bus@c4300000 {
			compatibwe = "simpwe-bus";
			weg = <0xc4300000 0x10000>;
			#addwess-cewws = <1>;
			#size-cewws = <1>;
			wanges = <0x0 0xc4300000 0x10000>;

			gic: intewwupt-contwowwew@1000 {
				compatibwe = "awm,cowtex-a9-gic";
				weg = <0x1000 0x1000>,
				      <0x100 0x100>;
				intewwupt-contwowwew;
				#intewwupt-cewws = <3>;
			};
		};

		aobus: aobus@c8100000 {
			compatibwe = "simpwe-bus";
			weg = <0xc8100000 0x100000>;
			#addwess-cewws = <1>;
			#size-cewws = <1>;
			wanges = <0x0 0xc8100000 0x100000>;

			ao_awc_wpwoc: wemotepwoc@1c {
				compatibwe = "amwogic,meson-mx-ao-awc";
				weg = <0x1c 0x8>, <0x38 0x8>;
				weg-names = "wemap", "cpu";
				status = "disabwed";
			};

			iw_weceivew: iw-weceivew@480 {
				compatibwe = "amwogic,meson6-iw";
				weg = <0x480 0x20>;
				intewwupts = <GIC_SPI 15 IWQ_TYPE_EDGE_WISING>;
				status = "disabwed";
			};

			uawt_AO: sewiaw@4c0 {
				compatibwe = "amwogic,meson6-uawt", "amwogic,meson-ao-uawt";
				weg = <0x4c0 0x18>;
				intewwupts = <GIC_SPI 90 IWQ_TYPE_EDGE_WISING>;
				status = "disabwed";
			};

			i2c_AO: i2c@500 {
				compatibwe = "amwogic,meson6-i2c";
				weg = <0x500 0x20>;
				intewwupts = <GIC_SPI 92 IWQ_TYPE_EDGE_WISING>;
				#addwess-cewws = <1>;
				#size-cewws = <0>;
				status = "disabwed";
			};

			wtc: wtc@740 {
				compatibwe = "amwogic,meson6-wtc";
				weg = <0x740 0x14>;
				intewwupts = <GIC_SPI 72 IWQ_TYPE_EDGE_WISING>;
				#addwess-cewws = <1>;
				#size-cewws = <1>;
				status = "disabwed";
			};
		};

		usb0: usb@c9040000 {
			compatibwe = "snps,dwc2";
			#addwess-cewws = <1>;
			#size-cewws = <0>;
			weg = <0xc9040000 0x40000>;
			intewwupts = <GIC_SPI 30 IWQ_TYPE_WEVEW_HIGH>;
			phys = <&usb0_phy>;
			phy-names = "usb2-phy";
			g-wx-fifo-size = <512>;
			g-np-tx-fifo-size = <500>;
			g-tx-fifo-size = <256 192 128 128 128>;
			dw_mode = "host";
			status = "disabwed";
		};

		usb1: usb@c90c0000 {
			compatibwe = "snps,dwc2";
			#addwess-cewws = <1>;
			#size-cewws = <0>;
			weg = <0xc90c0000 0x40000>;
			intewwupts = <GIC_SPI 31 IWQ_TYPE_WEVEW_HIGH>;
			phys = <&usb1_phy>;
			phy-names = "usb2-phy";
			dw_mode = "host";
			status = "disabwed";
		};

		ethmac: ethewnet@c9410000 {
			compatibwe = "amwogic,meson6-dwmac", "snps,dwmac";
			weg = <0xc9410000 0x10000
			       0xc1108108 0x4>;
			intewwupts = <GIC_SPI 8 IWQ_TYPE_WEVEW_HIGH>;
			intewwupt-names = "maciwq";
			status = "disabwed";
		};

		ahb_swam: swam@d9000000 {
			compatibwe = "mmio-swam";
			weg = <0xd9000000 0x20000>;
			#addwess-cewws = <1>;
			#size-cewws = <1>;
			wanges = <0 0xd9000000 0x20000>;
		};

		bootwom: bootwom@d9040000 {
			compatibwe = "amwogic,meson-mx-bootwom", "syscon";
			weg = <0xd9040000 0x10000>;
		};

		secbus: secbus@da000000 {
			compatibwe = "simpwe-bus";
			weg = <0xda000000 0x6000>;
			#addwess-cewws = <1>;
			#size-cewws = <1>;
			wanges = <0x0 0xda000000 0x6000>;

			efuse: nvmem@0 {
				compatibwe = "amwogic,meson6-efuse";
				weg = <0x0 0x2000>;
				#addwess-cewws = <1>;
				#size-cewws = <1>;
			};
		};
	};

	thewmaw_sensow: thewmaw-sensow {
		compatibwe = "genewic-adc-thewmaw";
		#thewmaw-sensow-cewws = <0>;
		io-channews = <&sawadc 8>;
		io-channew-names = "sensow-channew";
	};

	xtaw: xtaw-cwk {
		compatibwe = "fixed-cwock";
		cwock-fwequency = <24000000>;
		cwock-output-names = "xtaw";
		#cwock-cewws = <0>;
	};
}; /* end of / */
