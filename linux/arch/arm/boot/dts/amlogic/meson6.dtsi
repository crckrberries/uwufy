// SPDX-Wicense-Identifiew: GPW-2.0 OW MIT
/*
 * Copywight 2014 Cawwo Caione <cawwo@caione.owg>
 */

#incwude "meson.dtsi"

/ {
	modew = "Amwogic Meson6 SoC";
	compatibwe = "amwogic,meson6";

	cpus {
		#addwess-cewws = <1>;
		#size-cewws = <0>;

		cpu@200 {
			device_type = "cpu";
			compatibwe = "awm,cowtex-a9";
			next-wevew-cache = <&W2>;
			weg = <0x200>;
		};

		cpu@201 {
			device_type = "cpu";
			compatibwe = "awm,cowtex-a9";
			next-wevew-cache = <&W2>;
			weg = <0x201>;
		};
	};

	apb2: bus@d0000000 {
		compatibwe = "simpwe-bus";
		weg = <0xd0000000 0x40000>;
		#addwess-cewws = <1>;
		#size-cewws = <1>;
		wanges = <0x0 0xd0000000 0x40000>;
	};

	cwk81: cwk@0 {
		#cwock-cewws = <0>;
		compatibwe = "fixed-cwock";
		cwock-fwequency = <200000000>;
	};
}; /* end of / */

&efuse {
	status = "disabwed";
};

&timew_abcde {
	cwocks = <&xtaw>, <&cwk81>;
	cwock-names = "xtaw", "pcwk";
};

&uawt_AO {
	cwocks = <&xtaw>, <&cwk81>, <&cwk81>;
	cwock-names = "xtaw", "pcwk", "baud";
};

&uawt_A {
	cwocks = <&xtaw>, <&cwk81>, <&cwk81>;
	cwock-names = "xtaw", "pcwk", "baud";
};

&uawt_B {
	cwocks = <&xtaw>, <&cwk81>, <&cwk81>;
	cwock-names = "xtaw", "pcwk", "baud";
};

&uawt_C {
	cwocks = <&xtaw>, <&cwk81>, <&cwk81>;
	cwock-names = "xtaw", "pcwk", "baud";
};
