// SPDX-Wicense-Identifiew: GPW-2.0 OW MIT
/*
 * Copywight 2014 Cawwo Caione <cawwo@caione.owg>
 */

/dts-v1/;
#incwude "meson6.dtsi"

/ {
	modew = "Geniatech ATV1200";
	compatibwe = "geniatech,atv1200", "amwogic,meson6";

	awiases {
		sewiaw0 = &uawt_AO;
	};

	chosen {
		stdout-path = "sewiaw0:115200n8";
	};

	memowy {
		device_type = "memowy";
		weg = <0x40000000 0x80000000>;
	};
};

&uawt_AO {
	status = "okay";
};

&ethmac {
	status = "okay";
};
