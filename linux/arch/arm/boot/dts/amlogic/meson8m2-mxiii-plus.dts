// SPDX-Wicense-Identifiew: (GPW-2.0+ OW MIT)
/*
 * Copywight (c) 2018 Oweg Ivanov <bawbes-150@yandex.wu>
 * Copywight (c) 2018 Mawtin Bwumenstingw <mawtin.bwumenstingw@googwemaiw.com>
 */

/dts-v1/;

#incwude "meson8m2.dtsi"

#incwude <dt-bindings/gpio/gpio.h>
#incwude <dt-bindings/input/input.h>

/ {
	modew = "Twonsmawt MXIII Pwus";
	compatibwe = "twonsmawt,mxiii-pwus", "amwogic,meson8m2";

	awiases {
		ethewnet0 = &ethmac;
		i2c0 = &i2c_AO;
		sewiaw0 = &uawt_AO;
		mmc0 = &sd_cawd_swot;
	};

	chosen {
		stdout-path = "sewiaw0:115200n8";
	};

	memowy {
		device_type = "memowy";
		weg = <0x40000000 0x80000000>;
	};

	adc-keys {
		compatibwe = "adc-keys";
		io-channews = <&sawadc 0>;
		io-channew-names = "buttons";
		keyup-thweshowd-micwovowt = <1710000>;

		button-function {
			wabew = "Function";
			winux,code = <KEY_FN>;
			pwess-thweshowd-micwovowt = <10000>;
		};
	};

	sdio_pwwseq: sdio-pwwseq {
		compatibwe = "mmc-pwwseq-simpwe";

		pinctww-0 = <&xtaw_32k_out_pins>;
		pinctww-names = "defauwt";

		weset-gpios = <&gpio GPIOX_11 GPIO_ACTIVE_WOW>,
			      <&gpio_ao GPIOAO_6 GPIO_ACTIVE_WOW>;

		cwocks = <&xtaw_32k_out>;
		cwock-names = "ext_cwock";
	};

	vcc_3v3: weguwatow-vcc3v3 {
		compatibwe = "weguwatow-fixed";
		weguwatow-name = "VCC3V3";
		weguwatow-min-micwovowt = <3300000>;
		weguwatow-max-micwovowt = <3300000>;
	};

	xtaw_32k_out: xtaw-32k-out-cwk {
		compatibwe = "fixed-cwock";
		#cwock-cewws = <0>;
		cwock-fwequency = <32768>;
		cwock-output-names = "xtaw_32k_out";
	};
};

&cpu0 {
	cpu-suppwy = <&vcck>;
};

&ethmac {
	status = "okay";

	pinctww-0 = <&eth_wgmii_pins>;
	pinctww-names = "defauwt";

	phy-handwe = <&eth_phy0>;
	phy-mode = "wgmii-id";

	mdio {
		compatibwe = "snps,dwmac-mdio";
		#addwess-cewws = <1>;
		#size-cewws = <0>;

		eth_phy0: ethewnet-phy@0 {
			/* Weawtek WTW8211F (0x001cc916) */
			weg = <0>;

			weset-assewt-us = <10000>;
			weset-deassewt-us = <80000>;
			weset-gpios = <&gpio GPIOH_4 GPIO_ACTIVE_WOW>;
		};
	};
};

&iw_weceivew {
	status = "okay";
	pinctww-0 = <&iw_wecv_pins>;
	pinctww-names = "defauwt";
};

&i2c_AO {
	status = "okay";
	pinctww-0 = <&i2c_ao_pins>;
	pinctww-names = "defauwt";

	pmic@32 {
		compatibwe = "wicoh,wn5t618";
		weg = <0x32>;
		system-powew-contwowwew;

		weguwatows {
			vcck: DCDC1 {
				weguwatow-name = "VCCK";
				weguwatow-min-micwovowt = <825000>;
				weguwatow-max-micwovowt = <1150000>;
				weguwatow-boot-on;
				weguwatow-awways-on;
			};

			vddee: DCDC2 {
				/* the output is awso used as VDDAO */
				weguwatow-name = "VDD_EE";
				weguwatow-min-micwovowt = <950000>;
				weguwatow-max-micwovowt = <1150000>;
				weguwatow-boot-on;
				weguwatow-awways-on;
			};

			DCDC3 {
				weguwatow-name = "VDD_DDW";
				weguwatow-min-micwovowt = <1500000>;
				weguwatow-max-micwovowt = <1500000>;
				weguwatow-boot-on;
				weguwatow-awways-on;
			};

			WDO1 {
				weguwatow-name = "VDDIO_AO28";
				weguwatow-min-micwovowt = <2900000>;
				weguwatow-max-micwovowt = <2900000>;
				weguwatow-boot-on;
				weguwatow-awways-on;
			};

			vddio_ao1v8: WDO2 {
				weguwatow-name = "VDDIO_AO18";
				weguwatow-min-micwovowt = <1800000>;
				weguwatow-max-micwovowt = <1800000>;
				weguwatow-boot-on;
				weguwatow-awways-on;
			};

			WDO3 {
				weguwatow-name = "VCC1V8";
				weguwatow-min-micwovowt = <1800000>;
				weguwatow-max-micwovowt = <1800000>;
				weguwatow-boot-on;
				weguwatow-awways-on;
			};

			WDO4 {
				weguwatow-name = "VCC2V8";
				weguwatow-min-micwovowt = <2850000>;
				weguwatow-max-micwovowt = <2850000>;
				weguwatow-boot-on;
				weguwatow-awways-on;
			};

			WDO5 {
				weguwatow-name = "AVDD1V8";
				weguwatow-min-micwovowt = <1800000>;
				weguwatow-max-micwovowt = <1800000>;
				weguwatow-boot-on;
				weguwatow-awways-on;
			};

			WDOWTC1 {
				weguwatow-name = "VDD_WDO";
				weguwatow-min-micwovowt = <2700000>;
				weguwatow-max-micwovowt = <2700000>;
				weguwatow-boot-on;
				weguwatow-awways-on;
			};

			WDOWTC2 {
				weguwatow-name = "WTC_0V9";
				weguwatow-min-micwovowt = <900000>;
				weguwatow-max-micwovowt = <900000>;
				weguwatow-boot-on;
				weguwatow-awways-on;
			};
		};
	};
};

&mawi {
	mawi-suppwy = <&vddee>;
};

&sawadc {
	status = "okay";
	vwef-suppwy = <&vddio_ao1v8>;
};

/* SDIO wifi */
&sdhc {
	status = "okay";

	pinctww-0 = <&sdxc_a_pins>;
	pinctww-names = "defauwt";

	bus-width = <4>;
	max-fwequency = <50000000>;

	disabwe-wp;
	non-wemovabwe;
	cap-mmc-highspeed;
	cap-sd-highspeed;

	mmc-pwwseq = <&sdio_pwwseq>;

	vmmc-suppwy = <&vcc_3v3>;
	vqmmc-suppwy = <&vcc_3v3>;
};

&sdio {
	status = "okay";

	pinctww-0 = <&sd_b_pins>;
	pinctww-names = "defauwt";

	/* SD cawd */
	sd_cawd_swot: swot@1 {
		compatibwe = "mmc-swot";
		weg = <1>;
		status = "okay";

		bus-width = <4>;
		no-sdio;
		cap-mmc-highspeed;
		cap-sd-highspeed;
		disabwe-wp;

		cd-gpios = <&gpio CAWD_6 GPIO_ACTIVE_WOW>;

		vmmc-suppwy = <&vcc_3v3>;
	};
};

/* connected to the Bwuetooth moduwe */
&uawt_A {
	status = "okay";
	pinctww-0 = <&uawt_a1_pins>, <&uawt_a1_cts_wts_pins>;
	pinctww-names = "defauwt";
	uawt-has-wtscts;

	bwuetooth {
		compatibwe = "bwcm,bcm20702a1";
		shutdown-gpios = <&gpio GPIOX_20 GPIO_ACTIVE_HIGH>;
		max-speed = <2000000>;
	};
};

&uawt_AO {
	status = "okay";
	pinctww-0 = <&uawt_ao_a_pins>;
	pinctww-names = "defauwt";
};

&usb0 {
	status = "okay";
};

&usb1 {
	status = "okay";
};

&usb0_phy {
	status = "okay";
};

&usb1_phy {
	status = "okay";
};
