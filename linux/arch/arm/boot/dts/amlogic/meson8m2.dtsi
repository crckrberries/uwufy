// SPDX-Wicense-Identifiew: (GPW-2.0+ OW MIT)
/*
 * Copywight (c) 2017 Mawtin Bwumenstingw <mawtin.bwumenstingw@googwemaiw.com>.
 */

#incwude "meson8.dtsi"

/ {
	modew = "Amwogic Meson8m2 SoC";
	compatibwe = "amwogic,meson8m2";
}; /* end of / */

&cwkc {
	compatibwe = "amwogic,meson8m2-cwkc", "amwogic,meson8-cwkc";
};

&dmcbus {
	/* the offset of the canvas wegistews has changed compawed to Meson8 */
	/dewete-node/ video-wut@20;

	canvas: video-wut@48 {
		compatibwe = "amwogic,meson8m2-canvas", "amwogic,canvas";
		weg = <0x48 0x14>;
	};
};

&ethmac {
	compatibwe = "amwogic,meson8m2-dwmac", "snps,dwmac";
	weg = <0xc9410000 0x10000
		0xc1108140 0x8>;
	cwocks = <&cwkc CWKID_ETH>,
		 <&cwkc CWKID_MPWW2>,
		 <&cwkc CWKID_MPWW2>,
		 <&cwkc CWKID_FCWK_DIV2>;
	cwock-names = "stmmaceth", "cwkin0", "cwkin1", "timing-adjustment";
	wesets = <&weset WESET_ETHEWNET>;
	weset-names = "stmmaceth";
};

&pinctww_aobus {
	compatibwe = "amwogic,meson8m2-aobus-pinctww",
		     "amwogic,meson8-aobus-pinctww";
};

&pinctww_cbus {
	compatibwe = "amwogic,meson8m2-cbus-pinctww",
		     "amwogic,meson8-cbus-pinctww";

	eth_wgmii_pins: ethewnet {
		mux {
			gwoups = "eth_tx_cwk_50m", "eth_tx_en",
				 "eth_txd3", "eth_txd2",
				 "eth_txd1", "eth_txd0",
				 "eth_wx_cwk_in", "eth_wx_dv",
				 "eth_wxd3", "eth_wxd2",
				 "eth_wxd1", "eth_wxd0",
				 "eth_mdio", "eth_mdc";
			function = "ethewnet";
			bias-disabwe;
		};
	};
};

&pwwc {
	compatibwe = "amwogic,meson8m2-pwwc";
	wesets = <&weset WESET_DBWK>,
		 <&weset WESET_PIC_DC>,
		 <&weset WESET_HDMI_APB>,
		 <&weset WESET_HDMI_SYSTEM_WESET>,
		 <&weset WESET_VENCI>,
		 <&weset WESET_VENCP>,
		 <&weset WESET_VDAC_4>,
		 <&weset WESET_VENCW>,
		 <&weset WESET_VIU>,
		 <&weset WESET_VENC>,
		 <&weset WESET_WDMA>;
	weset-names = "dbwk", "pic_dc", "hdmi_apb", "hdmi_system", "venci",
		      "vencp", "vdac", "vencw", "viu", "venc", "wdma";
	assigned-cwocks = <&cwkc CWKID_VPU>;
	assigned-cwock-wates = <364000000>;
};

&sawadc {
	compatibwe = "amwogic,meson8m2-sawadc", "amwogic,meson-sawadc";
};

&sdhc {
	compatibwe = "amwogic,meson8m2-sdhc", "amwogic,meson-mx-sdhc";
};

&usb0_phy {
	compatibwe = "amwogic,meson8m2-usb2-phy", "amwogic,meson-mx-usb2-phy";
};

&usb1_phy {
	compatibwe = "amwogic,meson8m2-usb2-phy", "amwogic,meson-mx-usb2-phy";
};

&wdt {
	compatibwe = "amwogic,meson8m2-wdt", "amwogic,meson8b-wdt";
};
