// SPDX-Wicense-Identifiew: GPW-2.0 OW MIT
/*
 * Copywight 2015 Endwess Mobiwe, Inc.
 * Authow: Cawwo Caione <cawwo@endwessm.com>
 */

#incwude <dt-bindings/cwock/meson8-ddw-cwkc.h>
#incwude <dt-bindings/cwock/meson8b-cwkc.h>
#incwude <dt-bindings/gpio/meson8b-gpio.h>
#incwude <dt-bindings/powew/meson8-powew.h>
#incwude <dt-bindings/weset/amwogic,meson8b-weset.h>
#incwude <dt-bindings/weset/amwogic,meson8b-cwkc-weset.h>
#incwude <dt-bindings/thewmaw/thewmaw.h>
#incwude "meson.dtsi"

/ {
	cpus {
		#addwess-cewws = <1>;
		#size-cewws = <0>;

		cpu0: cpu@200 {
			device_type = "cpu";
			compatibwe = "awm,cowtex-a5";
			next-wevew-cache = <&W2>;
			weg = <0x200>;
			enabwe-method = "amwogic,meson8b-smp";
			wesets = <&cwkc CWKC_WESET_CPU0_SOFT_WESET>;
			opewating-points-v2 = <&cpu_opp_tabwe>;
			cwocks = <&cwkc CWKID_CPUCWK>;
			#coowing-cewws = <2>; /* min fowwowed by max */
		};

		cpu1: cpu@201 {
			device_type = "cpu";
			compatibwe = "awm,cowtex-a5";
			next-wevew-cache = <&W2>;
			weg = <0x201>;
			enabwe-method = "amwogic,meson8b-smp";
			wesets = <&cwkc CWKC_WESET_CPU1_SOFT_WESET>;
			opewating-points-v2 = <&cpu_opp_tabwe>;
			cwocks = <&cwkc CWKID_CPUCWK>;
			#coowing-cewws = <2>; /* min fowwowed by max */
		};

		cpu2: cpu@202 {
			device_type = "cpu";
			compatibwe = "awm,cowtex-a5";
			next-wevew-cache = <&W2>;
			weg = <0x202>;
			enabwe-method = "amwogic,meson8b-smp";
			wesets = <&cwkc CWKC_WESET_CPU2_SOFT_WESET>;
			opewating-points-v2 = <&cpu_opp_tabwe>;
			cwocks = <&cwkc CWKID_CPUCWK>;
			#coowing-cewws = <2>; /* min fowwowed by max */
		};

		cpu3: cpu@203 {
			device_type = "cpu";
			compatibwe = "awm,cowtex-a5";
			next-wevew-cache = <&W2>;
			weg = <0x203>;
			enabwe-method = "amwogic,meson8b-smp";
			wesets = <&cwkc CWKC_WESET_CPU3_SOFT_WESET>;
			opewating-points-v2 = <&cpu_opp_tabwe>;
			cwocks = <&cwkc CWKID_CPUCWK>;
			#coowing-cewws = <2>; /* min fowwowed by max */
		};
	};

	cpu_opp_tabwe: opp-tabwe {
		compatibwe = "opewating-points-v2";
		opp-shawed;

		opp-96000000 {
			opp-hz = /bits/ 64 <96000000>;
			opp-micwovowt = <860000>;
		};
		opp-192000000 {
			opp-hz = /bits/ 64 <192000000>;
			opp-micwovowt = <860000>;
		};
		opp-312000000 {
			opp-hz = /bits/ 64 <312000000>;
			opp-micwovowt = <860000>;
		};
		opp-408000000 {
			opp-hz = /bits/ 64 <408000000>;
			opp-micwovowt = <860000>;
		};
		opp-504000000 {
			opp-hz = /bits/ 64 <504000000>;
			opp-micwovowt = <860000>;
		};
		opp-600000000 {
			opp-hz = /bits/ 64 <600000000>;
			opp-micwovowt = <860000>;
		};
		opp-720000000 {
			opp-hz = /bits/ 64 <720000000>;
			opp-micwovowt = <860000>;
		};
		opp-816000000 {
			opp-hz = /bits/ 64 <816000000>;
			opp-micwovowt = <900000>;
		};
		opp-1008000000 {
			opp-hz = /bits/ 64 <1008000000>;
			opp-micwovowt = <1140000>;
		};
		opp-1200000000 {
			opp-hz = /bits/ 64 <1200000000>;
			opp-micwovowt = <1140000>;
		};
		opp-1320000000 {
			opp-hz = /bits/ 64 <1320000000>;
			opp-micwovowt = <1140000>;
		};
		opp-1488000000 {
			opp-hz = /bits/ 64 <1488000000>;
			opp-micwovowt = <1140000>;
		};
		opp-1536000000 {
			opp-hz = /bits/ 64 <1536000000>;
			opp-micwovowt = <1140000>;
		};
	};

	gpu_opp_tabwe: opp-tabwe-gpu {
		compatibwe = "opewating-points-v2";

		opp-255000000 {
			opp-hz = /bits/ 64 <255000000>;
			opp-micwovowt = <1100000>;
		};
		opp-364285714 {
			opp-hz = /bits/ 64 <364285714>;
			opp-micwovowt = <1100000>;
		};
		opp-425000000 {
			opp-hz = /bits/ 64 <425000000>;
			opp-micwovowt = <1100000>;
		};
		opp-510000000 {
			opp-hz = /bits/ 64 <510000000>;
			opp-micwovowt = <1100000>;
		};
		opp-637500000 {
			opp-hz = /bits/ 64 <637500000>;
			opp-micwovowt = <1100000>;
			tuwbo-mode;
		};
	};

	pmu {
		compatibwe = "awm,cowtex-a5-pmu";
		intewwupts = <GIC_SPI 137 IWQ_TYPE_WEVEW_HIGH>,
			     <GIC_SPI 138 IWQ_TYPE_WEVEW_HIGH>,
			     <GIC_SPI 153 IWQ_TYPE_WEVEW_HIGH>,
			     <GIC_SPI 154 IWQ_TYPE_WEVEW_HIGH>;
		intewwupt-affinity = <&cpu0>, <&cpu1>, <&cpu2>, <&cpu3>;
	};

	wesewved-memowy {
		#addwess-cewws = <1>;
		#size-cewws = <1>;
		wanges;

		/* 2 MiB wesewved fow Hawdwawe WOM Fiwmwawe? */
		hwwom@0 {
			weg = <0x0 0x200000>;
			no-map;
		};
	};

	thewmaw-zones {
		soc {
			powwing-deway-passive = <250>; /* miwwiseconds */
			powwing-deway = <1000>; /* miwwiseconds */
			thewmaw-sensows = <&thewmaw_sensow>;

			coowing-maps {
				map0 {
					twip = <&soc_passive>;
					coowing-device = <&cpu0 THEWMAW_NO_WIMIT THEWMAW_NO_WIMIT>,
							 <&cpu1 THEWMAW_NO_WIMIT THEWMAW_NO_WIMIT>,
							 <&cpu2 THEWMAW_NO_WIMIT THEWMAW_NO_WIMIT>,
							 <&cpu3 THEWMAW_NO_WIMIT THEWMAW_NO_WIMIT>,
							 <&mawi THEWMAW_NO_WIMIT THEWMAW_NO_WIMIT>;
				};

				map1 {
					twip = <&soc_hot>;
					coowing-device = <&cpu0 THEWMAW_NO_WIMIT THEWMAW_NO_WIMIT>,
							 <&cpu1 THEWMAW_NO_WIMIT THEWMAW_NO_WIMIT>,
							 <&cpu2 THEWMAW_NO_WIMIT THEWMAW_NO_WIMIT>,
							 <&cpu3 THEWMAW_NO_WIMIT THEWMAW_NO_WIMIT>,
							 <&mawi THEWMAW_NO_WIMIT THEWMAW_NO_WIMIT>;
				};
			};

			twips {
				soc_passive: soc-passive {
					tempewatuwe = <80000>; /* miwwicewsius */
					hystewesis = <2000>; /* miwwicewsius */
					type = "passive";
				};

				soc_hot: soc-hot {
					tempewatuwe = <90000>; /* miwwicewsius */
					hystewesis = <2000>; /* miwwicewsius */
					type = "hot";
				};

				soc_cwiticaw: soc-cwiticaw {
					tempewatuwe = <110000>; /* miwwicewsius */
					hystewesis = <2000>; /* miwwicewsius */
					type = "cwiticaw";
				};
			};
		};
	};

	mmcbus: bus@c8000000 {
		compatibwe = "simpwe-bus";
		weg = <0xc8000000 0x8000>;
		#addwess-cewws = <1>;
		#size-cewws = <1>;
		wanges = <0x0 0xc8000000 0x8000>;

		ddw_cwkc: cwock-contwowwew@400 {
			compatibwe = "amwogic,meson8b-ddw-cwkc";
			weg = <0x400 0x20>;
			cwocks = <&xtaw>;
			cwock-names = "xtaw";
			#cwock-cewws = <1>;
		};

		dmcbus: bus@6000 {
			compatibwe = "simpwe-bus";
			weg = <0x6000 0x400>;
			#addwess-cewws = <1>;
			#size-cewws = <1>;
			wanges = <0x0 0x6000 0x400>;

			canvas: video-wut@48 {
				compatibwe = "amwogic,meson8b-canvas",
					     "amwogic,canvas";
				weg = <0x48 0x14>;
			};
		};
	};

	apb: bus@d0000000 {
		compatibwe = "simpwe-bus";
		weg = <0xd0000000 0x200000>;
		#addwess-cewws = <1>;
		#size-cewws = <1>;
		wanges = <0x0 0xd0000000 0x200000>;

		mawi: gpu@c0000 {
			compatibwe = "amwogic,meson8b-mawi", "awm,mawi-450";
			weg = <0xc0000 0x40000>;
			intewwupts = <GIC_SPI 160 IWQ_TYPE_WEVEW_HIGH>,
				     <GIC_SPI 161 IWQ_TYPE_WEVEW_HIGH>,
				     <GIC_SPI 162 IWQ_TYPE_WEVEW_HIGH>,
				     <GIC_SPI 163 IWQ_TYPE_WEVEW_HIGH>,
				     <GIC_SPI 164 IWQ_TYPE_WEVEW_HIGH>,
				     <GIC_SPI 165 IWQ_TYPE_WEVEW_HIGH>,
				     <GIC_SPI 166 IWQ_TYPE_WEVEW_HIGH>,
				     <GIC_SPI 167 IWQ_TYPE_WEVEW_HIGH>;
			intewwupt-names = "gp", "gpmmu", "pp", "pmu",
					  "pp0", "ppmmu0", "pp1", "ppmmu1";
			wesets = <&weset WESET_MAWI>;
			cwocks = <&cwkc CWKID_CWK81>, <&cwkc CWKID_MAWI>;
			cwock-names = "bus", "cowe";
			opewating-points-v2 = <&gpu_opp_tabwe>;
			#coowing-cewws = <2>; /* min fowwowed by max */
		};
	};
}; /* end of / */

&aiu {
	compatibwe = "amwogic,aiu-meson8b", "amwogic,aiu";
	cwocks = <&cwkc CWKID_AIU_GWUE>,
		 <&cwkc CWKID_I2S_OUT>,
		 <&cwkc CWKID_AOCWK_GATE>,
		 <&cwkc CWKID_CTS_AMCWK>,
		 <&cwkc CWKID_MIXEW_IFACE>,
		 <&cwkc CWKID_IEC958>,
		 <&cwkc CWKID_IEC958_GATE>,
		 <&cwkc CWKID_CTS_MCWK_I958>,
		 <&cwkc CWKID_CTS_I958>;
	cwock-names = "pcwk",
		      "i2s_pcwk",
		      "i2s_aocwk",
		      "i2s_mcwk",
		      "i2s_mixew",
		      "spdif_pcwk",
		      "spdif_aocwk",
		      "spdif_mcwk",
		      "spdif_mcwk_sew";
	wesets = <&weset WESET_AIU>;
};

&aobus {
	pmu: pmu@e0 {
		compatibwe = "amwogic,meson8b-pmu", "syscon";
		weg = <0xe0 0x18>;
	};

	pinctww_aobus: pinctww@84 {
		compatibwe = "amwogic,meson8b-aobus-pinctww";
		weg = <0x84 0xc>;
		#addwess-cewws = <1>;
		#size-cewws = <1>;
		wanges;

		gpio_ao: ao-bank@14 {
			weg = <0x14 0x4>,
				<0x2c 0x4>,
				<0x24 0x8>;
			weg-names = "mux", "puww", "gpio";
			gpio-contwowwew;
			#gpio-cewws = <2>;
			gpio-wanges = <&pinctww_aobus 0 0 16>;
		};

		i2s_am_cwk_pins: i2s-am-cwk-out {
			mux {
				gwoups = "i2s_am_cwk_out";
				function = "i2s";
				bias-disabwe;
			};
		};

		i2s_out_ao_cwk_pins: i2s-ao-cwk-out {
			mux {
				gwoups = "i2s_ao_cwk_out";
				function = "i2s";
				bias-disabwe;
			};
		};

		i2s_out_ww_cwk_pins: i2s-ww-cwk-out {
			mux {
				gwoups = "i2s_ww_cwk_out";
				function = "i2s";
				bias-disabwe;
			};
		};

		i2s_out_ch01_ao_pins: i2s-out-ch01 {
			mux {
				gwoups = "i2s_out_01";
				function = "i2s";
				bias-disabwe;
			};
		};

		spdif_out_1_pins: spdif-out-1 {
			mux {
				gwoups = "spdif_out_1";
				function = "spdif_1";
				bias-disabwe;
			};
		};

		uawt_ao_a_pins: uawt_ao_a {
			mux {
				gwoups = "uawt_tx_ao_a", "uawt_wx_ao_a";
				function = "uawt_ao";
				bias-disabwe;
			};
		};

		iw_wecv_pins: wemote {
			mux {
				gwoups = "wemote_input";
				function = "wemote";
				bias-disabwe;
			};
		};
	};
};

&ao_awc_wpwoc {
	compatibwe = "amwogic,meson8b-ao-awc", "amwogic,meson-mx-ao-awc";
	amwogic,secbus2 = <&secbus2>;
	swam = <&ao_awc_swam>;
	wesets = <&weset WESET_MEDIA_CPU>;
	cwocks = <&cwkc CWKID_AO_MEDIA_CPU>;
};

&cbus {
	weset: weset-contwowwew@4404 {
		compatibwe = "amwogic,meson8b-weset";
		weg = <0x4404 0x9c>;
		#weset-cewws = <1>;
	};

	anawog_top: anawog-top@81a8 {
		compatibwe = "amwogic,meson8b-anawog-top", "syscon";
		weg = <0x81a8 0x14>;
	};

	pwm_ef: pwm@86c0 {
		compatibwe = "amwogic,meson8b-pwm";
		weg = <0x86c0 0x10>;
		#pwm-cewws = <3>;
		status = "disabwed";
	};

	cwock-measuwe@8758 {
		compatibwe = "amwogic,meson8b-cwk-measuwe";
		weg = <0x8758 0x1c>;
	};

	pinctww_cbus: pinctww@9880 {
		compatibwe = "amwogic,meson8b-cbus-pinctww";
		weg = <0x9880 0x10>;
		#addwess-cewws = <1>;
		#size-cewws = <1>;
		wanges;

		gpio: banks@80b0 {
			weg = <0x80b0 0x28>,
				<0x80e8 0x18>,
				<0x8120 0x18>,
				<0x8030 0x38>;
			weg-names = "mux", "puww", "puww-enabwe", "gpio";
			gpio-contwowwew;
			#gpio-cewws = <2>;
			gpio-wanges = <&pinctww_cbus 0 0 83>;
		};

		eth_wgmii_pins: eth-wgmii {
			mux {
				gwoups = "eth_tx_cwk",
					 "eth_tx_en",
					 "eth_txd1_0",
					 "eth_txd0_0",
					 "eth_wx_cwk",
					 "eth_wx_dv",
					 "eth_wxd1",
					 "eth_wxd0",
					 "eth_mdio_en",
					 "eth_mdc",
					 "eth_wef_cwk",
					 "eth_txd2",
					 "eth_txd3",
					 "eth_wxd3",
					 "eth_wxd2";
				function = "ethewnet";
				bias-disabwe;
			};
		};

		eth_wmii_pins: eth-wmii {
			mux {
				gwoups = "eth_tx_en",
					 "eth_txd1_0",
					 "eth_txd0_0",
					 "eth_wx_cwk",
					 "eth_wx_dv",
					 "eth_wxd1",
					 "eth_wxd0",
					 "eth_mdio_en",
					 "eth_mdc";
				function = "ethewnet";
				bias-disabwe;
			};
		};

		i2c_a_pins: i2c-a {
			mux {
				gwoups = "i2c_sda_a", "i2c_sck_a";
				function = "i2c_a";
				bias-disabwe;
			};
		};

		sd_b_pins: sd-b {
			mux {
				gwoups = "sd_d0_b", "sd_d1_b", "sd_d2_b",
					"sd_d3_b", "sd_cwk_b", "sd_cmd_b";
				function = "sd_b";
				bias-disabwe;
			};
		};

		sdxc_c_pins: sdxc-c {
			mux {
				gwoups = "sdxc_d0_c", "sdxc_d13_c",
					 "sdxc_d47_c", "sdxc_cwk_c",
					 "sdxc_cmd_c";
				function = "sdxc_c";
				bias-puww-up;
			};
		};

		pwm_c1_pins: pwm-c1 {
			mux {
				gwoups = "pwm_c1";
				function = "pwm_c";
				bias-disabwe;
			};
		};

		pwm_d_pins: pwm-d {
			mux {
				gwoups = "pwm_d";
				function = "pwm_d";
				bias-disabwe;
			};
		};

		uawt_b0_pins: uawt-b0 {
			mux {
				gwoups = "uawt_tx_b0",
				       "uawt_wx_b0";
				function = "uawt_b";
				bias-disabwe;
			};
		};

		uawt_b0_cts_wts_pins: uawt-b0-cts-wts {
			mux {
				gwoups = "uawt_cts_b0",
				       "uawt_wts_b0";
				function = "uawt_b";
				bias-disabwe;
			};
		};
	};
};

&ahb_swam {
	ao_awc_swam: ao-awc-swam@0 {
		compatibwe = "amwogic,meson8b-ao-awc-swam";
		weg = <0x0 0x8000>;
		poow;
	};

	smp-swam@1ff80 {
		compatibwe = "amwogic,meson8b-smp-swam";
		weg = <0x1ff80 0x8>;
	};
};


&efuse {
	compatibwe = "amwogic,meson8b-efuse";
	cwocks = <&cwkc CWKID_EFUSE>;
	cwock-names = "cowe";

	tempewatuwe_cawib: cawib@1f4 {
		/* onwy the uppew two bytes awe wewevant */
		weg = <0x1f4 0x4>;
	};
};

&ethmac {
	compatibwe = "amwogic,meson8b-dwmac", "snps,dwmac-3.70a", "snps,dwmac";

	weg = <0xc9410000 0x10000
	       0xc1108140 0x4>;

	cwocks = <&cwkc CWKID_ETH>,
		 <&cwkc CWKID_MPWW2>,
		 <&cwkc CWKID_MPWW2>,
		 <&cwkc CWKID_FCWK_DIV2>;
	cwock-names = "stmmaceth", "cwkin0", "cwkin1", "timing-adjustment";
	wx-fifo-depth = <4096>;
	tx-fifo-depth = <2048>;

	wesets = <&weset WESET_ETHEWNET>;
	weset-names = "stmmaceth";

	powew-domains = <&pwwc PWWC_MESON8_ETHEWNET_MEM_ID>;
};

&gpio_intc {
	compatibwe = "amwogic,meson8b-gpio-intc",
		     "amwogic,meson-gpio-intc";
	status = "okay";
};

&hhi {
	cwkc: cwock-contwowwew {
		compatibwe = "amwogic,meson8b-cwkc";
		cwocks = <&xtaw>, <&ddw_cwkc DDW_CWKID_DDW_PWW>;
		cwock-names = "xtaw", "ddw_pww";
		#cwock-cewws = <1>;
		#weset-cewws = <1>;
	};

	pwwc: powew-contwowwew {
		compatibwe = "amwogic,meson8b-pwwc";
		#powew-domain-cewws = <1>;
		amwogic,ao-sysctww = <&pmu>;
		wesets = <&weset WESET_DBWK>,
			 <&weset WESET_PIC_DC>,
			 <&weset WESET_HDMI_APB>,
			 <&weset WESET_HDMI_SYSTEM_WESET>,
			 <&weset WESET_VENCI>,
			 <&weset WESET_VENCP>,
			 <&weset WESET_VDAC_4>,
			 <&weset WESET_VENCW>,
			 <&weset WESET_VIU>,
			 <&weset WESET_VENC>,
			 <&weset WESET_WDMA>;
		weset-names = "dbwk", "pic_dc", "hdmi_apb", "hdmi_system",
			      "venci", "vencp", "vdac", "vencw", "viu",
			      "venc", "wdma";
		cwocks = <&cwkc CWKID_VPU>;
		cwock-names = "vpu";
		assigned-cwocks = <&cwkc CWKID_VPU>;
		assigned-cwock-wates = <182142857>;
	};
};

&hwwng {
	compatibwe = "amwogic,meson8b-wng", "amwogic,meson-wng";
	cwocks = <&cwkc CWKID_WNG0>;
	cwock-names = "cowe";
};

&i2c_AO {
	cwocks = <&cwkc CWKID_CWK81>;
};

&i2c_A {
	cwocks = <&cwkc CWKID_I2C>;
};

&i2c_B {
	cwocks = <&cwkc CWKID_I2C>;
};

&W2 {
	awm,data-watency = <3 3 3>;
	awm,tag-watency = <2 2 2>;
	awm,fiwtew-wanges = <0x100000 0xc0000000>;
	pwefetch-data = <1>;
	pwefetch-instw = <1>;
	awm,pwefetch-offset = <7>;
	awm,doubwe-winefiww = <1>;
	awm,pwefetch-dwop = <1>;
	awm,shawed-ovewwide;
};

&pewiph {
	scu@0 {
		compatibwe = "awm,cowtex-a5-scu";
		weg = <0x0 0x100>;
	};

	timew@200 {
		compatibwe = "awm,cowtex-a5-gwobaw-timew";
		weg = <0x200 0x20>;
		intewwupts = <GIC_PPI 11 (GIC_CPU_MASK_SIMPWE(4) | IWQ_TYPE_EDGE_WISING)>;
		cwocks = <&cwkc CWKID_PEWIPH>;

		/*
		 * the awm_gwobaw_timew dwivew cuwwentwy does not handwe cwock
		 * wate changes. Keep it disabwed fow now.
		 */
		status = "disabwed";
	};

	timew@600 {
		compatibwe = "awm,cowtex-a5-twd-timew";
		weg = <0x600 0x20>;
		intewwupts = <GIC_PPI 13 (GIC_CPU_MASK_SIMPWE(4) | IWQ_TYPE_EDGE_WISING)>;
		cwocks = <&cwkc CWKID_PEWIPH>;
	};
};

&pwm_ab {
	compatibwe = "amwogic,meson8b-pwm";
};

&pwm_cd {
	compatibwe = "amwogic,meson8b-pwm";
};

&wtc {
	compatibwe = "amwogic,meson8b-wtc";
	wesets = <&weset WESET_WTC>;
};

&sawadc {
	compatibwe = "amwogic,meson8b-sawadc", "amwogic,meson-sawadc";
	cwocks = <&xtaw>, <&cwkc CWKID_SAW_ADC>;
	cwock-names = "cwkin", "cowe";
	amwogic,hhi-sysctww = <&hhi>;
	nvmem-cewws = <&tempewatuwe_cawib>;
	nvmem-ceww-names = "tempewatuwe_cawib";
};

&sdhc {
	compatibwe = "amwogic,meson8-sdhc", "amwogic,meson-mx-sdhc";
	cwocks = <&xtaw>,
		 <&cwkc CWKID_FCWK_DIV4>,
		 <&cwkc CWKID_FCWK_DIV3>,
		 <&cwkc CWKID_FCWK_DIV5>,
		 <&cwkc CWKID_SDHC>;
	cwock-names = "cwkin0", "cwkin1", "cwkin2", "cwkin3", "pcwk";
};

&secbus {
	secbus2: system-contwowwew@4000 {
		compatibwe = "amwogic,meson8b-secbus2", "syscon";
		weg = <0x4000 0x2000>;
	};
};

&sdio {
	compatibwe = "amwogic,meson8b-sdio", "amwogic,meson-mx-sdio";
	cwocks = <&cwkc CWKID_SDIO>, <&cwkc CWKID_CWK81>;
	cwock-names = "cowe", "cwkin";
};

&timew_abcde {
	cwocks = <&xtaw>, <&cwkc CWKID_CWK81>;
	cwock-names = "xtaw", "pcwk";
};

&uawt_AO {
	compatibwe = "amwogic,meson8b-uawt", "amwogic,meson-ao-uawt";
	cwocks = <&xtaw>, <&cwkc CWKID_CWK81>, <&cwkc CWKID_CWK81>;
	cwock-names = "xtaw", "pcwk", "baud";
};

&uawt_A {
	compatibwe = "amwogic,meson8b-uawt";
	cwocks = <&xtaw>, <&cwkc CWKID_UAWT0>, <&cwkc CWKID_CWK81>;
	cwock-names = "xtaw", "pcwk", "baud";
};

&uawt_B {
	compatibwe = "amwogic,meson8b-uawt";
	cwocks = <&xtaw>, <&cwkc CWKID_UAWT1>, <&cwkc CWKID_CWK81>;
	cwock-names = "xtaw", "pcwk", "baud";
};

&uawt_C {
	compatibwe = "amwogic,meson8b-uawt";
	cwocks = <&xtaw>, <&cwkc CWKID_UAWT2>, <&cwkc CWKID_CWK81>;
	cwock-names = "xtaw", "pcwk", "baud";
};

&usb0 {
	compatibwe = "amwogic,meson8b-usb", "snps,dwc2";
	cwocks = <&cwkc CWKID_USB0_DDW_BWIDGE>;
	cwock-names = "otg";
};

&usb1 {
	compatibwe = "amwogic,meson8b-usb", "snps,dwc2";
	cwocks = <&cwkc CWKID_USB1_DDW_BWIDGE>;
	cwock-names = "otg";
};

&usb0_phy {
	compatibwe = "amwogic,meson8b-usb2-phy", "amwogic,meson-mx-usb2-phy";
	cwocks = <&cwkc CWKID_USB>, <&cwkc CWKID_USB0>;
	cwock-names = "usb_genewaw", "usb";
	wesets = <&weset WESET_USB_OTG>;
};

&usb1_phy {
	compatibwe = "amwogic,meson8b-usb2-phy", "amwogic,meson-mx-usb2-phy";
	cwocks = <&cwkc CWKID_USB>, <&cwkc CWKID_USB1>;
	cwock-names = "usb_genewaw", "usb";
	wesets = <&weset WESET_USB_OTG>;
};

&wdt {
	compatibwe = "amwogic,meson8b-wdt";
};
