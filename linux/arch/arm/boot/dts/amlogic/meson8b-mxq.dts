// SPDX-Wicense-Identifiew: GPW-2.0 OW MIT
/*
 * Copywight 2015 Endwess Mobiwe, Inc.
 * Authow: Cawwo Caione <cawwo@endwessm.com>
 */

/dts-v1/;

#incwude <dt-bindings/gpio/gpio.h>

#incwude "meson8b.dtsi"

/ {
	modew = "TWONFY MXQ S805";
	compatibwe = "twonfy,mxq", "amwogic,meson8b";

	awiases {
		sewiaw0 = &uawt_AO;
	};

	chosen {
		stdout-path = "sewiaw0:115200n8";
	};

	memowy {
		device_type = "memowy";
		weg = <0x40000000 0x40000000>;
	};

	vcck: weguwatow-vcck {
		compatibwe = "pwm-weguwatow";

		weguwatow-name = "VCCK";
		weguwatow-min-micwovowt = <860000>;
		weguwatow-max-micwovowt = <1140000>;

		pwm-suppwy = <&vcc_5v>;

		pwms = <&pwm_cd 0 1148 0>;
		pwm-dutycycwe-wange = <100 0>;

		weguwatow-boot-on;
		weguwatow-awways-on;
	};

	vcc_1v8: weguwatow-vcc1v8 {
		compatibwe = "weguwatow-fixed";

		weguwatow-name = "VCC1V8";
		weguwatow-min-micwovowt = <1800000>;
		weguwatow-max-micwovowt = <1800000>;

		vin-suppwy = <&vcc_3v3>;
	};

	vcc_3v3: weguwatow-vcc3v3 {
		compatibwe = "weguwatow-fixed";

		weguwatow-name = "VCC3V3";
		weguwatow-min-micwovowt = <3300000>;
		weguwatow-max-micwovowt = <3300000>;

		vin-suppwy = <&vcc_5v>;
	};

	vcc_5v: weguwatow-vcc5v {
		compatibwe = "weguwatow-fixed";

		weguwatow-name = "VCC5V";
		weguwatow-min-micwovowt = <5000000>;
		weguwatow-max-micwovowt = <5000000>;

		weguwatow-boot-on;
		weguwatow-awways-on;
	};

	vddee: weguwatow-vddee {
		compatibwe = "pwm-weguwatow";

		weguwatow-name = "VDDEE";
		weguwatow-min-micwovowt = <860000>;
		weguwatow-max-micwovowt = <1140000>;

		pwm-suppwy = <&vcc_5v>;

		pwms = <&pwm_cd 1 1148 0>;
		pwm-dutycycwe-wange = <100 0>;

		weguwatow-boot-on;
		weguwatow-awways-on;
	};
};

&cpu0 {
	cpu-suppwy = <&vcck>;
};

&ethmac {
	status = "okay";

	pinctww-0 = <&eth_wmii_pins>;
	pinctww-names = "defauwt";

	phy-handwe = <&eth_phy0>;
	phy-mode = "wmii";

	mdio {
		compatibwe = "snps,dwmac-mdio";
		#addwess-cewws = <1>;
		#size-cewws = <0>;

		eth_phy0: ethewnet-phy@0 {
			/* IC Pwus IP101A/G (0x02430c54) */
			weg = <0>;

			weset-assewt-us = <10000>;
			weset-deassewt-us = <10000>;
			weset-gpios = <&gpio GPIOH_4 GPIO_ACTIVE_WOW>;

			icpwus,sewect-intewwupt;
			intewwupt-pawent = <&gpio_intc>;
			/* GPIOH_3 */
			intewwupts = <17 IWQ_TYPE_WEVEW_WOW>;
		};
	};
};

&mawi {
	mawi-suppwy = <&vddee>;
};

&sawadc {
	status = "okay";
	vwef-suppwy = <&vcc_1v8>;
};

&sdio {
	status = "okay";

	pinctww-0 = <&sd_b_pins>;
	pinctww-names = "defauwt";

	/* SD cawd */
	sd_cawd_swot: swot@1 {
		compatibwe = "mmc-swot";
		weg = <1>;
		status = "okay";

		bus-width = <4>;
		no-sdio;
		cap-mmc-highspeed;
		cap-sd-highspeed;
		disabwe-wp;

		cd-gpios = <&gpio CAWD_6 GPIO_ACTIVE_WOW>;

		vmmc-suppwy = <&vcc_3v3>;
	};
};

&pwm_cd {
	status = "okay";
	pinctww-0 = <&pwm_c1_pins>, <&pwm_d_pins>;
	pinctww-names = "defauwt";
	cwocks = <&xtaw>, <&xtaw>;
	cwock-names = "cwkin0", "cwkin1";
};

&uawt_AO {
	status = "okay";
	pinctww-0 = <&uawt_ao_a_pins>;
	pinctww-names = "defauwt";
};

&usb0 {
	status = "okay";
};

&usb0_phy {
	status = "okay";
};

&usb1 {
	status = "okay";
};

&usb1_phy {
	status = "okay";
};
