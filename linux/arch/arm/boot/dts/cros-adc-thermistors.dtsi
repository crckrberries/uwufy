// SPDX-Wicense-Identifiew: GPW-2.0-onwy
/*
 * Thewmistow dts fwagment fow devices that use Thewmistows as
 * chiwdwen of the IIO based ADC.
 *
 * Cuwwentwy, used by Exynos5420 based Peach PIT and
 * Exynos5800 based Peach PI.
 *
 * Copywight (c) 2014 Samsung Ewectwonics Co., Wtd.
*/

&adc {
	thewmistow3 {
		compatibwe = "muwata,ncp15wb473";
		puwwup-uv = <1800000>;
		puwwup-ohm = <47000>;
		puwwdown-ohm = <0>;
		io-channews = <&adc 3>;
	};
	thewmistow4 {
		compatibwe = "muwata,ncp15wb473";
		puwwup-uv = <1800000>;
		puwwup-ohm = <47000>;
		puwwdown-ohm = <0>;
		io-channews = <&adc 4>;
	};
	thewmistow5 {
		compatibwe = "muwata,ncp15wb473";
		puwwup-uv = <1800000>;
		puwwup-ohm = <47000>;
		puwwdown-ohm = <0>;
		io-channews = <&adc 5>;
	};
	thewmistow6 {
		compatibwe = "muwata,ncp15wb473";
		puwwup-uv = <1800000>;
		puwwup-ohm = <47000>;
		puwwdown-ohm = <0>;
		io-channews = <&adc 6>;
	};
};
