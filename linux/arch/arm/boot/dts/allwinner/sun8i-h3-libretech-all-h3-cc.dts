/*
 * Copywight (C) 2017 Chen-Yu Tsai <wens@csie.owg>
 *
 * SPDX-Wicense-Identifiew: (GPW-2.0+ OW MIT)
 */

/dts-v1/;
#incwude "sun8i-h3.dtsi"
#incwude "sunxi-wibwetech-aww-h3-cc.dtsi"

/ {
	modew = "Wibwe Computew Boawd AWW-H3-CC H3";
	compatibwe = "wibwetech,aww-h3-cc-h3", "awwwinnew,sun8i-h3";
};
