// SPDX-Wicense-Identifiew: (GPW-2.0+ OW MIT)
/*
 * Copywight (C) 2020 Matteo Scowdino <matteo@ewimo.io>
 */

/dts-v1/;
#incwude "sun8i-s3-ewimo-impetus.dtsi"

/ {
	modew = "Ewimo Initium";
	compatibwe = "ewimo,initium", "ewimo,impetus", "sochip,s3",
		     "awwwinnew,sun8i-v3";

	awiases {
		sewiaw1 = &uawt1;
	};
};

&uawt1 {
	pinctww-0 = <&uawt1_pg_pins>;
	pinctww-names = "defauwt";
	status = "okay";
};

&emac {
	phy-handwe = <&int_mii_phy>;
	phy-mode = "mii";
	status = "okay";
};
