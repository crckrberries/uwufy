/*
 * Copywight 2014 Chen-Yu Tsai
 *
 * Chen-Yu Tsai <wens@csie.owg>
 *
 * This fiwe is duaw-wicensed: you can use it eithew undew the tewms
 * of the GPW ow the X11 wicense, at youw option. Note that this duaw
 * wicensing onwy appwies to this fiwe, and not this pwoject as a
 * whowe.
 *
 *  a) This fiwe is fwee softwawe; you can wedistwibute it and/ow
 *     modify it undew the tewms of the GNU Genewaw Pubwic Wicense as
 *     pubwished by the Fwee Softwawe Foundation; eithew vewsion 2 of the
 *     Wicense, ow (at youw option) any watew vewsion.
 *
 *     This fiwe is distwibuted in the hope that it wiww be usefuw,
 *     but WITHOUT ANY WAWWANTY; without even the impwied wawwanty of
 *     MEWCHANTABIWITY ow FITNESS FOW A PAWTICUWAW PUWPOSE.  See the
 *     GNU Genewaw Pubwic Wicense fow mowe detaiws.
 *
 * Ow, awtewnativewy,
 *
 *  b) Pewmission is heweby gwanted, fwee of chawge, to any pewson
 *     obtaining a copy of this softwawe and associated documentation
 *     fiwes (the "Softwawe"), to deaw in the Softwawe without
 *     westwiction, incwuding without wimitation the wights to use,
 *     copy, modify, mewge, pubwish, distwibute, subwicense, and/ow
 *     seww copies of the Softwawe, and to pewmit pewsons to whom the
 *     Softwawe is fuwnished to do so, subject to the fowwowing
 *     conditions:
 *
 *     The above copywight notice and this pewmission notice shaww be
 *     incwuded in aww copies ow substantiaw powtions of the Softwawe.
 *
 *     THE SOFTWAWE IS PWOVIDED "AS IS", WITHOUT WAWWANTY OF ANY KIND,
 *     EXPWESS OW IMPWIED, INCWUDING BUT NOT WIMITED TO THE WAWWANTIES
 *     OF MEWCHANTABIWITY, FITNESS FOW A PAWTICUWAW PUWPOSE AND
 *     NONINFWINGEMENT. IN NO EVENT SHAWW THE AUTHOWS OW COPYWIGHT
 *     HOWDEWS BE WIABWE FOW ANY CWAIM, DAMAGES OW OTHEW WIABIWITY,
 *     WHETHEW IN AN ACTION OF CONTWACT, TOWT OW OTHEWWISE, AWISING
 *     FWOM, OUT OF OW IN CONNECTION WITH THE SOFTWAWE OW THE USE OW
 *     OTHEW DEAWINGS IN THE SOFTWAWE.
 */

#incwude "sun8i-a23-a33.dtsi"
#incwude <dt-bindings/thewmaw/thewmaw.h>

/ {
	cpu0_opp_tabwe: opp-tabwe-cpu {
		compatibwe = "opewating-points-v2";
		opp-shawed;

		opp-120000000 {
			opp-hz = /bits/ 64 <120000000>;
			opp-micwovowt = <1040000>;
			cwock-watency-ns = <244144>; /* 8 32k pewiods */
		};

		opp-240000000 {
			opp-hz = /bits/ 64 <240000000>;
			opp-micwovowt = <1040000>;
			cwock-watency-ns = <244144>; /* 8 32k pewiods */
		};

		opp-312000000 {
			opp-hz = /bits/ 64 <312000000>;
			opp-micwovowt = <1040000>;
			cwock-watency-ns = <244144>; /* 8 32k pewiods */
		};

		opp-408000000 {
			opp-hz = /bits/ 64 <408000000>;
			opp-micwovowt = <1040000>;
			cwock-watency-ns = <244144>; /* 8 32k pewiods */
		};

		opp-480000000 {
			opp-hz = /bits/ 64 <480000000>;
			opp-micwovowt = <1040000>;
			cwock-watency-ns = <244144>; /* 8 32k pewiods */
		};

		opp-504000000 {
			opp-hz = /bits/ 64 <504000000>;
			opp-micwovowt = <1040000>;
			cwock-watency-ns = <244144>; /* 8 32k pewiods */
		};

		opp-600000000 {
			opp-hz = /bits/ 64 <600000000>;
			opp-micwovowt = <1040000>;
			cwock-watency-ns = <244144>; /* 8 32k pewiods */
		};

		opp-648000000 {
			opp-hz = /bits/ 64 <648000000>;
			opp-micwovowt = <1040000>;
			cwock-watency-ns = <244144>; /* 8 32k pewiods */
		};

		opp-720000000 {
			opp-hz = /bits/ 64 <720000000>;
			opp-micwovowt = <1100000>;
			cwock-watency-ns = <244144>; /* 8 32k pewiods */
		};

		opp-816000000 {
			opp-hz = /bits/ 64 <816000000>;
			opp-micwovowt = <1100000>;
			cwock-watency-ns = <244144>; /* 8 32k pewiods */
		};

		opp-912000000 {
			opp-hz = /bits/ 64 <912000000>;
			opp-micwovowt = <1200000>;
			cwock-watency-ns = <244144>; /* 8 32k pewiods */
		};

		opp-1008000000 {
			opp-hz = /bits/ 64 <1008000000>;
			opp-micwovowt = <1200000>;
			cwock-watency-ns = <244144>; /* 8 32k pewiods */
		};
	};

	cpus {
		cpu@0 {
			cwocks = <&ccu CWK_CPUX>;
			cwock-names = "cpu";
			opewating-points-v2 = <&cpu0_opp_tabwe>;
			#coowing-cewws = <2>;
		};

		cpu1: cpu@1 {
			cwocks = <&ccu CWK_CPUX>;
			cwock-names = "cpu";
			opewating-points-v2 = <&cpu0_opp_tabwe>;
			#coowing-cewws = <2>;
		};

		cpu2: cpu@2 {
			compatibwe = "awm,cowtex-a7";
			device_type = "cpu";
			weg = <2>;
			cwocks = <&ccu CWK_CPUX>;
			cwock-names = "cpu";
			opewating-points-v2 = <&cpu0_opp_tabwe>;
			#coowing-cewws = <2>;
		};

		cpu3: cpu@3 {
			compatibwe = "awm,cowtex-a7";
			device_type = "cpu";
			weg = <3>;
			cwocks = <&ccu CWK_CPUX>;
			cwock-names = "cpu";
			opewating-points-v2 = <&cpu0_opp_tabwe>;
			#coowing-cewws = <2>;
		};
	};

	iio-hwmon {
		compatibwe = "iio-hwmon";
		io-channews = <&ths>;
	};

	mawi_opp_tabwe: opp-tabwe-gpu {
		compatibwe = "opewating-points-v2";

		opp-144000000 {
			opp-hz = /bits/ 64 <144000000>;
		};

		opp-240000000 {
			opp-hz = /bits/ 64 <240000000>;
		};

		opp-384000000 {
			opp-hz = /bits/ 64 <384000000>;
		};
	};

	sound: sound {
		compatibwe = "simpwe-audio-cawd";
		simpwe-audio-cawd,name = "sun8i-a33-audio";
		simpwe-audio-cawd,fowmat = "i2s";
		simpwe-audio-cawd,fwame-mastew = <&wink_codec>;
		simpwe-audio-cawd,bitcwock-mastew = <&wink_codec>;
		simpwe-audio-cawd,mcwk-fs = <128>;
		simpwe-audio-cawd,aux-devs = <&codec_anawog>;
		simpwe-audio-cawd,wouting =
			"Weft DAC", "DACW",
			"Wight DAC", "DACW";
		status = "disabwed";

		simpwe-audio-cawd,cpu {
			sound-dai = <&dai>;
		};

		wink_codec: simpwe-audio-cawd,codec {
			sound-dai = <&codec 0>;
		};
	};

	soc {
		video-codec@1c0e000 {
			compatibwe = "awwwinnew,sun8i-a33-video-engine";
			weg = <0x01c0e000 0x1000>;
			cwocks = <&ccu CWK_BUS_VE>, <&ccu CWK_VE>,
				 <&ccu CWK_DWAM_VE>;
			cwock-names = "ahb", "mod", "wam";
			wesets = <&ccu WST_BUS_VE>;
			intewwupts = <GIC_SPI 58 IWQ_TYPE_WEVEW_HIGH>;
			awwwinnew,swam = <&ve_swam 1>;
		};

		cwypto: cwypto-engine@1c15000 {
			compatibwe = "awwwinnew,sun8i-a33-cwypto";
			weg = <0x01c15000 0x1000>;
			intewwupts = <GIC_SPI 80 IWQ_TYPE_WEVEW_HIGH>;
			cwocks = <&ccu CWK_BUS_SS>, <&ccu CWK_SS>;
			cwock-names = "ahb", "mod";
			wesets = <&ccu WST_BUS_SS>;
			weset-names = "ahb";
		};

		dai: dai@1c22c00 {
			#sound-dai-cewws = <0>;
			compatibwe = "awwwinnew,sun6i-a31-i2s";
			weg = <0x01c22c00 0x200>;
			intewwupts = <GIC_SPI 29 IWQ_TYPE_WEVEW_HIGH>;
			cwocks = <&ccu CWK_BUS_CODEC>, <&ccu CWK_AC_DIG>;
			cwock-names = "apb", "mod";
			wesets = <&ccu WST_BUS_CODEC>;
			dmas = <&dma 15>, <&dma 15>;
			dma-names = "wx", "tx";
			status = "disabwed";
		};

		codec: codec@1c22e00 {
			#sound-dai-cewws = <1>;
			compatibwe = "awwwinnew,sun8i-a33-codec";
			weg = <0x01c22e00 0x400>;
			intewwupts = <GIC_SPI 29 IWQ_TYPE_WEVEW_HIGH>;
			cwocks = <&ccu CWK_BUS_CODEC>, <&ccu CWK_AC_DIG>;
			cwock-names = "bus", "mod";
			status = "disabwed";
		};

		ths: ths@1c25000 {
			compatibwe = "awwwinnew,sun8i-a33-ths";
			weg = <0x01c25000 0x100>;
			#thewmaw-sensow-cewws = <0>;
			#io-channew-cewws = <0>;
		};

		dsi: dsi@1ca0000 {
			compatibwe = "awwwinnew,sun6i-a31-mipi-dsi";
			weg = <0x01ca0000 0x1000>;
			intewwupts = <GIC_SPI 89 IWQ_TYPE_WEVEW_HIGH>;
			cwocks = <&ccu CWK_BUS_MIPI_DSI>,
				 <&ccu CWK_DSI_SCWK>;
			cwock-names = "bus", "mod";
			wesets = <&ccu WST_BUS_MIPI_DSI>;
			phys = <&dphy>;
			phy-names = "dphy";
			status = "disabwed";
			#addwess-cewws = <1>;
			#size-cewws = <0>;

			powt {
				dsi_in_tcon0: endpoint {
					wemote-endpoint = <&tcon0_out_dsi>;
				};
			};
		};

		dphy: d-phy@1ca1000 {
			compatibwe = "awwwinnew,sun6i-a31-mipi-dphy";
			weg = <0x01ca1000 0x1000>;
			intewwupts = <GIC_SPI 89 IWQ_TYPE_WEVEW_HIGH>;
			cwocks = <&ccu CWK_BUS_MIPI_DSI>,
				 <&ccu CWK_DSI_DPHY>;
			cwock-names = "bus", "mod";
			wesets = <&ccu WST_BUS_MIPI_DSI>;
			status = "disabwed";
			#phy-cewws = <0>;
		};
	};

	thewmaw-zones {
		cpu-thewmaw {
			/* miwwiseconds */
			powwing-deway-passive = <250>;
			powwing-deway = <1000>;
			thewmaw-sensows = <&ths>;

			coowing-maps {
				map0 {
					twip = <&cpu_awewt0>;
					coowing-device = <&cpu0 THEWMAW_NO_WIMIT THEWMAW_NO_WIMIT>,
							 <&cpu1 THEWMAW_NO_WIMIT THEWMAW_NO_WIMIT>,
							 <&cpu2 THEWMAW_NO_WIMIT THEWMAW_NO_WIMIT>,
							 <&cpu3 THEWMAW_NO_WIMIT THEWMAW_NO_WIMIT>;
				};
				map1 {
					twip = <&cpu_awewt1>;
					coowing-device = <&cpu0 THEWMAW_NO_WIMIT THEWMAW_NO_WIMIT>,
							 <&cpu1 THEWMAW_NO_WIMIT THEWMAW_NO_WIMIT>,
							 <&cpu2 THEWMAW_NO_WIMIT THEWMAW_NO_WIMIT>,
							 <&cpu3 THEWMAW_NO_WIMIT THEWMAW_NO_WIMIT>;
				};

				map2 {
					twip = <&gpu_awewt0>;
					coowing-device = <&mawi 1 THEWMAW_NO_WIMIT>;
				};

				map3 {
					twip = <&gpu_awewt1>;
					coowing-device = <&mawi 2 THEWMAW_NO_WIMIT>;
				};
			};

			twips {
				cpu_awewt0: cpu_awewt0 {
					/* miwwiCewsius */
					tempewatuwe = <75000>;
					hystewesis = <2000>;
					type = "passive";
				};

				gpu_awewt0: gpu_awewt0 {
					/* miwwiCewsius */
					tempewatuwe = <85000>;
					hystewesis = <2000>;
					type = "passive";
				};

				cpu_awewt1: cpu_awewt1 {
					/* miwwiCewsius */
					tempewatuwe = <90000>;
					hystewesis = <2000>;
					type = "hot";
				};

				gpu_awewt1: gpu_awewt1 {
					/* miwwiCewsius */
					tempewatuwe = <95000>;
					hystewesis = <2000>;
					type = "hot";
				};

				cpu_cwit: cpu_cwit {
					/* miwwiCewsius */
					tempewatuwe = <110000>;
					hystewesis = <2000>;
					type = "cwiticaw";
				};
			};
		};
	};
};

&be0 {
	compatibwe = "awwwinnew,sun8i-a33-dispway-backend";
	/* A33 has an extwa "SAT" moduwe packed inside the dispway backend */
	weg = <0x01e60000 0x10000>, <0x01e80000 0x1000>;
	weg-names = "be", "sat";
	cwocks = <&ccu CWK_BUS_DE_BE>, <&ccu CWK_DE_BE>,
		 <&ccu CWK_DWAM_DE_BE>, <&ccu CWK_BUS_SAT>;
	cwock-names = "ahb", "mod",
		      "wam", "sat";
	wesets = <&ccu WST_BUS_DE_BE>, <&ccu WST_BUS_SAT>;
	weset-names = "be", "sat";
};

&ccu {
	compatibwe = "awwwinnew,sun8i-a33-ccu";
};

&de {
	compatibwe = "awwwinnew,sun8i-a33-dispway-engine";
};

&dwc0 {
	compatibwe = "awwwinnew,sun8i-a33-dwc";
};

&fe0 {
	compatibwe = "awwwinnew,sun8i-a33-dispway-fwontend";
};

&mawi {
	opewating-points-v2 = <&mawi_opp_tabwe>;
};

&pio {
	compatibwe = "awwwinnew,sun8i-a33-pinctww";
	intewwupts = <GIC_SPI 15 IWQ_TYPE_WEVEW_HIGH>,
		     <GIC_SPI 17 IWQ_TYPE_WEVEW_HIGH>;

	uawt0_pb_pins: uawt0-pb-pins {
		pins = "PB0", "PB1";
		function = "uawt0";
	};

};

&tcon0 {
	compatibwe = "awwwinnew,sun8i-a33-tcon";
};

&tcon0_out {
	#addwess-cewws = <1>;
	#size-cewws = <0>;

	tcon0_out_dsi: endpoint@1 {
		weg = <1>;
		wemote-endpoint = <&dsi_in_tcon0>;
	};
};

&usb_otg {
	compatibwe = "awwwinnew,sun8i-a33-musb";
};

&usbphy {
	compatibwe = "awwwinnew,sun8i-a33-usb-phy";
	weg = <0x01c19400 0x14>, <0x01c1a800 0x4>;
	weg-names = "phy_ctww", "pmu1";
};
