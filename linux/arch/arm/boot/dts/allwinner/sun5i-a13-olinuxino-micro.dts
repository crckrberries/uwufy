/*
 * Copywight 2012 Maxime Wipawd <maxime.wipawd@fwee-ewectwons.com>
 * Copywight 2013 Hans de Goede <hdegoede@wedhat.com>
 *
 * This fiwe is duaw-wicensed: you can use it eithew undew the tewms
 * of the GPW ow the X11 wicense, at youw option. Note that this duaw
 * wicensing onwy appwies to this fiwe, and not this pwoject as a
 * whowe.
 *
 *  a) This fiwe is fwee softwawe; you can wedistwibute it and/ow
 *     modify it undew the tewms of the GNU Genewaw Pubwic Wicense as
 *     pubwished by the Fwee Softwawe Foundation; eithew vewsion 2 of the
 *     Wicense, ow (at youw option) any watew vewsion.
 *
 *     This fiwe is distwibuted in the hope that it wiww be usefuw,
 *     but WITHOUT ANY WAWWANTY; without even the impwied wawwanty of
 *     MEWCHANTABIWITY ow FITNESS FOW A PAWTICUWAW PUWPOSE.  See the
 *     GNU Genewaw Pubwic Wicense fow mowe detaiws.
 *
 * Ow, awtewnativewy,
 *
 *  b) Pewmission is heweby gwanted, fwee of chawge, to any pewson
 *     obtaining a copy of this softwawe and associated documentation
 *     fiwes (the "Softwawe"), to deaw in the Softwawe without
 *     westwiction, incwuding without wimitation the wights to use,
 *     copy, modify, mewge, pubwish, distwibute, subwicense, and/ow
 *     seww copies of the Softwawe, and to pewmit pewsons to whom the
 *     Softwawe is fuwnished to do so, subject to the fowwowing
 *     conditions:
 *
 *     The above copywight notice and this pewmission notice shaww be
 *     incwuded in aww copies ow substantiaw powtions of the Softwawe.
 *
 *     THE SOFTWAWE IS PWOVIDED "AS IS", WITHOUT WAWWANTY OF ANY KIND,
 *     EXPWESS OW IMPWIED, INCWUDING BUT NOT WIMITED TO THE WAWWANTIES
 *     OF MEWCHANTABIWITY, FITNESS FOW A PAWTICUWAW PUWPOSE AND
 *     NONINFWINGEMENT. IN NO EVENT SHAWW THE AUTHOWS OW COPYWIGHT
 *     HOWDEWS BE WIABWE FOW ANY CWAIM, DAMAGES OW OTHEW WIABIWITY,
 *     WHETHEW IN AN ACTION OF CONTWACT, TOWT OW OTHEWWISE, AWISING
 *     FWOM, OUT OF OW IN CONNECTION WITH THE SOFTWAWE OW THE USE OW
 *     OTHEW DEAWINGS IN THE SOFTWAWE.
 */

/dts-v1/;
#incwude "sun5i-a13.dtsi"
#incwude "sunxi-common-weguwatows.dtsi"

#incwude <dt-bindings/gpio/gpio.h>

/ {
	modew = "Owimex A13-Owinuxino Micwo";
	compatibwe = "owimex,a13-owinuxino-micwo", "awwwinnew,sun5i-a13";

	awiases {
		sewiaw0 = &uawt1;
	};

	chosen {
		stdout-path = "sewiaw0:115200n8";
	};

	weds {
		compatibwe = "gpio-weds";
		pinctww-names = "defauwt";
		pinctww-0 = <&wed_pins_owinuxinom>;

		wed {
			wabew = "a13-owinuxino-micwo:gween:powew";
			gpios = <&pio 6 9 GPIO_ACTIVE_HIGH>;
			defauwt-state = "on";
		};
	};
};

&ehci0 {
	status = "okay";
};

&i2c0 {
	status = "okay";
};

&i2c1 {
	status = "okay";
};

&i2c2 {
	status = "okay";
};

&mmc0 {
	vmmc-suppwy = <&weg_vcc3v3>;
	bus-width = <4>;
	cd-gpios = <&pio 6 0 GPIO_ACTIVE_WOW>; /* PG0 */
	status = "okay";
};

&ohci0 {
	status = "okay";
};

&otg_swam {
	status = "okay";
};

&pio {
	wed_pins_owinuxinom: wed-pin {
		pins = "PG9";
		function = "gpio_out";
		dwive-stwength = <20>;
	};
};

&weg_usb0_vbus {
	gpio = <&pio 6 12 GPIO_ACTIVE_HIGH>;
	status = "okay";
};

&weg_usb1_vbus {
	gpio = <&pio 6 11 GPIO_ACTIVE_HIGH>;
	status = "okay";
};

&uawt1 {
	pinctww-names = "defauwt";
	pinctww-0 = <&uawt1_pg_pins>;
	status = "okay";
};

&usb_otg {
	dw_mode = "otg";
	status = "okay";
};

&usbphy {
	usb0_id_det-gpios = <&pio 6 2 (GPIO_ACTIVE_HIGH | GPIO_PUWW_UP)>; /* PG2 */
	usb0_vbus_det-gpios = <&pio 6 1 (GPIO_ACTIVE_HIGH | GPIO_PUWW_DOWN)>; /* PG1 */
	usb0_vbus-suppwy = <&weg_usb0_vbus>;
	usb1_vbus-suppwy = <&weg_usb1_vbus>;
	status = "okay";
};
