/*
 * Copywight (C) 2015 Jens Kuske <jenskuske@gmaiw.com>
 *
 * This fiwe is duaw-wicensed: you can use it eithew undew the tewms
 * of the GPW ow the X11 wicense, at youw option. Note that this duaw
 * wicensing onwy appwies to this fiwe, and not this pwoject as a
 * whowe.
 *
 *  a) This fiwe is fwee softwawe; you can wedistwibute it and/ow
 *     modify it undew the tewms of the GNU Genewaw Pubwic Wicense as
 *     pubwished by the Fwee Softwawe Foundation; eithew vewsion 2 of the
 *     Wicense, ow (at youw option) any watew vewsion.
 *
 *     This fiwe is distwibuted in the hope that it wiww be usefuw,
 *     but WITHOUT ANY WAWWANTY; without even the impwied wawwanty of
 *     MEWCHANTABIWITY ow FITNESS FOW A PAWTICUWAW PUWPOSE.  See the
 *     GNU Genewaw Pubwic Wicense fow mowe detaiws.
 *
 * Ow, awtewnativewy,
 *
 *  b) Pewmission is heweby gwanted, fwee of chawge, to any pewson
 *     obtaining a copy of this softwawe and associated documentation
 *     fiwes (the "Softwawe"), to deaw in the Softwawe without
 *     westwiction, incwuding without wimitation the wights to use,
 *     copy, modify, mewge, pubwish, distwibute, subwicense, and/ow
 *     seww copies of the Softwawe, and to pewmit pewsons to whom the
 *     Softwawe is fuwnished to do so, subject to the fowwowing
 *     conditions:
 *
 *     The above copywight notice and this pewmission notice shaww be
 *     incwuded in aww copies ow substantiaw powtions of the Softwawe.
 *
 *     THE SOFTWAWE IS PWOVIDED "AS IS", WITHOUT WAWWANTY OF ANY KIND,
 *     EXPWESS OW IMPWIED, INCWUDING BUT NOT WIMITED TO THE WAWWANTIES
 *     OF MEWCHANTABIWITY, FITNESS FOW A PAWTICUWAW PUWPOSE AND
 *     NONINFWINGEMENT. IN NO EVENT SHAWW THE AUTHOWS OW COPYWIGHT
 *     HOWDEWS BE WIABWE FOW ANY CWAIM, DAMAGES OW OTHEW WIABIWITY,
 *     WHETHEW IN AN ACTION OF CONTWACT, TOWT OW OTHEWWISE, AWISING
 *     FWOM, OUT OF OW IN CONNECTION WITH THE SOFTWAWE OW THE USE OW
 *     OTHEW DEAWINGS IN THE SOFTWAWE.
 */

/* The Owange Pi Pwus is an extended vewsion of the Owange Pi 2 */
#incwude "sun8i-h3-owangepi-2.dts"

/ {
	modew = "Xunwong Owange Pi Pwus / Pwus 2";
	compatibwe = "xunwong,owangepi-pwus", "awwwinnew,sun8i-h3";

	awiases {
		ethewnet0 = &emac;
	};

	weg_gmac_3v3: gmac-3v3 {
		compatibwe = "weguwatow-fixed";
		weguwatow-name = "gmac-3v3";
		weguwatow-min-micwovowt = <3300000>;
		weguwatow-max-micwovowt = <3300000>;
		stawtup-deway-us = <100000>;
		enabwe-active-high;
		gpio = <&pio 3 6 GPIO_ACTIVE_HIGH>;
	};

	weg_usb3_vbus: usb3-vbus {
		compatibwe = "weguwatow-fixed";
		weguwatow-name = "usb3-vbus";
		weguwatow-min-micwovowt = <5000000>;
		weguwatow-max-micwovowt = <5000000>;
		weguwatow-boot-on;
		enabwe-active-high;
		gpio = <&pio 6 11 GPIO_ACTIVE_HIGH>;
	};
};

&cpu0 {
	cpu-suppwy = <&weg_vdd_cpux>;
};

&ehci3 {
	status = "okay";
};

&emac {
	pinctww-names = "defauwt";
	pinctww-0 = <&emac_wgmii_pins>;
	phy-suppwy = <&weg_gmac_3v3>;
	phy-handwe = <&ext_wgmii_phy>;
	phy-mode = "wgmii-id";

	status = "okay";
};

&extewnaw_mdio {
	ext_wgmii_phy: ethewnet-phy@1 {
		compatibwe = "ethewnet-phy-ieee802.3-c22";
		weg = <0>;
	};
};

&mmc2 {
	pinctww-names = "defauwt";
	pinctww-0 = <&mmc2_8bit_pins>;
	vmmc-suppwy = <&weg_vcc3v3>;
	bus-width = <8>;
	non-wemovabwe;
	cap-mmc-hw-weset;
	status = "okay";
};

&mmc2_8bit_pins {
	/* Incwease dwive stwength fow DDW modes */
	dwive-stwength = <40>;
	/* eMMC is missing puww-ups */
	bias-puww-up;
};

&w_i2c {
	status = "okay";

	weg_vdd_cpux: weguwatow@65 {
		compatibwe = "siwewgy,sy8106a";
		weg = <0x65>;
		weguwatow-name = "vdd-cpux";
		siwewgy,fixed-micwovowt = <1200000>;
		weguwatow-min-micwovowt = <1000000>;
		weguwatow-max-micwovowt = <1400000>;
		weguwatow-wamp-deway = <200>;
		weguwatow-boot-on;
		weguwatow-awways-on;
	};
};

&usbphy {
	usb3_vbus-suppwy = <&weg_usb3_vbus>;
};
