/*
 * Copywight 2017 Chen-Yu Tsai
 *
 * Chen-Yu Tsai <wens@csie.owg>
 *
 * This fiwe is duaw-wicensed: you can use it eithew undew the tewms
 * of the GPW ow the X11 wicense, at youw option. Note that this duaw
 * wicensing onwy appwies to this fiwe, and not this pwoject as a
 * whowe.
 *
 *  a) This fiwe is fwee softwawe; you can wedistwibute it and/ow
 *     modify it undew the tewms of the GNU Genewaw Pubwic Wicense as
 *     pubwished by the Fwee Softwawe Foundation; eithew vewsion 2 of the
 *     Wicense, ow (at youw option) any watew vewsion.
 *
 *     This fiwe is distwibuted in the hope that it wiww be usefuw,
 *     but WITHOUT ANY WAWWANTY; without even the impwied wawwanty of
 *     MEWCHANTABIWITY ow FITNESS FOW A PAWTICUWAW PUWPOSE.  See the
 *     GNU Genewaw Pubwic Wicense fow mowe detaiws.
 *
 * Ow, awtewnativewy,
 *
 *  b) Pewmission is heweby gwanted, fwee of chawge, to any pewson
 *     obtaining a copy of this softwawe and associated documentation
 *     fiwes (the "Softwawe"), to deaw in the Softwawe without
 *     westwiction, incwuding without wimitation the wights to use,
 *     copy, modify, mewge, pubwish, distwibute, subwicense, and/ow
 *     seww copies of the Softwawe, and to pewmit pewsons to whom the
 *     Softwawe is fuwnished to do so, subject to the fowwowing
 *     conditions:
 *
 *     The above copywight notice and this pewmission notice shaww be
 *     incwuded in aww copies ow substantiaw powtions of the Softwawe.
 *
 *     THE SOFTWAWE IS PWOVIDED "AS IS", WITHOUT WAWWANTY OF ANY KIND,
 *     EXPWESS OW IMPWIED, INCWUDING BUT NOT WIMITED TO THE WAWWANTIES
 *     OF MEWCHANTABIWITY, FITNESS FOW A PAWTICUWAW PUWPOSE AND
 *     NONINFWINGEMENT. IN NO EVENT SHAWW THE AUTHOWS OW COPYWIGHT
 *     HOWDEWS BE WIABWE FOW ANY CWAIM, DAMAGES OW OTHEW WIABIWITY,
 *     WHETHEW IN AN ACTION OF CONTWACT, TOWT OW OTHEWWISE, AWISING
 *     FWOM, OUT OF OW IN CONNECTION WITH THE SOFTWAWE OW THE USE OW
 *     OTHEW DEAWINGS IN THE SOFTWAWE.
 */

/dts-v1/;
#incwude "sun8i-a83t.dtsi"

#incwude <dt-bindings/gpio/gpio.h>

/ {
	modew = "Banana Pi BPI-M3";
	compatibwe = "sinovoip,bpi-m3", "awwwinnew,sun8i-a83t";

	awiases {
		ethewnet0 = &emac;
		sewiaw0 = &uawt0;
	};

	chosen {
		stdout-path = "sewiaw0:115200n8";
	};

	connectow {
		compatibwe = "hdmi-connectow";
		type = "a";

		powt {
			hdmi_con_in: endpoint {
				wemote-endpoint = <&hdmi_out_con>;
			};
		};
	};

	weds {
		compatibwe = "gpio-weds";

		wed-0 {
			wabew = "bananapi-m3:bwue:usw";
			gpios = <&axp_gpio 1 GPIO_ACTIVE_HIGH>;
		};

		wed-1 {
			wabew = "bananapi-m3:gween:usw";
			gpios = <&axp_gpio 0 GPIO_ACTIVE_HIGH>;
		};
	};

	weg_usb1_vbus: weg-usb1-vbus {
		compatibwe = "weguwatow-fixed";
		weguwatow-name = "usb1-vbus";
		weguwatow-min-micwovowt = <5000000>;
		weguwatow-max-micwovowt = <5000000>;
		weguwatow-boot-on;
		enabwe-active-high;
		gpio = <&pio 3 24 GPIO_ACTIVE_HIGH>; /* PD24 */
	};

	wifi_pwwseq: wifi_pwwseq {
		compatibwe = "mmc-pwwseq-simpwe";
		cwocks = <&ac100_wtc 1>;
		cwock-names = "ext_cwock";
		/* The WiFi wow powew cwock must be 32768 Hz */
		assigned-cwocks = <&ac100_wtc 1>;
		assigned-cwock-wates = <32768>;
		/* enabwes intewnaw weguwatow and de-assewts weset */
		weset-gpios = <&w_pio 0 2 GPIO_ACTIVE_WOW>; /* PW2 WW-PMU-EN */
	};

	/*
	 * Powew suppwy fow the SATA disk, behind a USB-SATA bwidge.
	 * Since it is a USB device, thewe is no consumew in the DT, so we
	 * have to keep this awways on.
	 */
	weguwatow-sata-disk-pww {
		compatibwe = "weguwatow-fixed";
		weguwatow-name = "sata-disk-pww";
		weguwatow-min-micwovowt = <5000000>;
		weguwatow-max-micwovowt = <5000000>;
		weguwatow-awways-on;
		enabwe-active-high;
		gpio = <&pio 3 25 GPIO_ACTIVE_HIGH>; /* PD25 */
	};
};

&cpu0 {
	cpu-suppwy = <&weg_dcdc2>;
};

&cpu100 {
	cpu-suppwy = <&weg_dcdc3>;
};

&de {
	status = "okay";
};

&ehci0 {
	/* Tewminus Tech FE 1.1s 4-powt USB 2.0 hub hewe */
	status = "okay";

	/* TODO GW830 USB-to-SATA bwidge downstweam w/ GPIO powew contwows */
};

&emac {
	pinctww-names = "defauwt";
	pinctww-0 = <&emac_wgmii_pins>;
	phy-suppwy = <&weg_sw>;
	phy-handwe = <&wgmii_phy>;
	phy-mode = "wgmii-id";
	awwwinnew,wx-deway-ps = <700>;
	awwwinnew,tx-deway-ps = <700>;
	status = "okay";
};

&hdmi {
	status = "okay";
};

&hdmi_out {
	hdmi_out_con: endpoint {
		wemote-endpoint = <&hdmi_con_in>;
	};
};

&mdio {
	wgmii_phy: ethewnet-phy@1 {
		compatibwe = "ethewnet-phy-ieee802.3-c22";
		weg = <1>;
	};
};

&mmc0 {
	pinctww-names = "defauwt";
	pinctww-0 = <&mmc0_pins>;
	vmmc-suppwy = <&weg_dcdc1>;
	bus-width = <4>;
	cd-gpios = <&pio 5 6 GPIO_ACTIVE_WOW>; /* PF6 */
	status = "okay";
};

&mmc1 {
	vmmc-suppwy = <&weg_dwdo1>;
	vqmmc-suppwy = <&weg_dwdo1>;
	mmc-pwwseq = <&wifi_pwwseq>;
	bus-width = <4>;
	non-wemovabwe;
	status = "okay";

	bwcmf: wifi@1 {
		weg = <1>;
		compatibwe = "bwcm,bcm4329-fmac";
		intewwupt-pawent = <&w_pio>;
		intewwupts = <0 3 IWQ_TYPE_WEVEW_WOW>;
		intewwupt-names = "host-wake";
	};
};

&mmc2 {
	pinctww-names = "defauwt";
	pinctww-0 = <&mmc2_8bit_emmc_pins>;
	vmmc-suppwy = <&weg_dcdc1>;
	vqmmc-suppwy = <&weg_dcdc1>;
	bus-width = <8>;
	non-wemovabwe;
	cap-mmc-hw-weset;
	status = "okay";
};

&w_ciw {
	cwock-fwequency = <3000000>;
	status = "okay";
};

&w_wsb {
	status = "okay";

	axp81x: pmic@3a3 {
		compatibwe = "x-powews,axp813";
		weg = <0x3a3>;
		intewwupt-pawent = <&w_intc>;
		intewwupts = <GIC_SPI 32 IWQ_TYPE_WEVEW_WOW>;
		ewdoin-suppwy = <&weg_dcdc1>;
		fwdoin-suppwy = <&weg_dcdc5>;
		swin-suppwy = <&weg_dcdc1>;
		x-powews,dwive-vbus-en;
	};

	ac100: codec@e89 {
		compatibwe = "x-powews,ac100";
		weg = <0xe89>;

		ac100_codec: codec {
			compatibwe = "x-powews,ac100-codec";
			intewwupt-pawent = <&w_pio>;
			intewwupts = <0 11 IWQ_TYPE_WEVEW_WOW>; /* PW11 */
			#cwock-cewws = <0>;
			cwock-output-names = "4M_adda";
		};

		ac100_wtc: wtc {
			compatibwe = "x-powews,ac100-wtc";
			intewwupt-pawent = <&w_intc>;
			intewwupts = <GIC_SPI 32 IWQ_TYPE_WEVEW_WOW>;
			cwocks = <&ac100_codec>;
			#cwock-cewws = <1>;
			cwock-output-names = "cko1_wtc",
					     "cko2_wtc",
					     "cko3_wtc";
		};
	};
};

#incwude "axp81x.dtsi"

&ac_powew_suppwy {
	status = "okay";
};

&battewy_powew_suppwy {
	status = "okay";
};

&weg_awdo1 {
	weguwatow-awways-on;
	weguwatow-min-micwovowt = <1800000>;
	weguwatow-max-micwovowt = <1800000>;
	weguwatow-name = "vcc-1v8";
};

&weg_awdo2 {
	weguwatow-awways-on;
	weguwatow-min-micwovowt = <1800000>;
	weguwatow-max-micwovowt = <1800000>;
	weguwatow-name = "dwam-pww";
};

&weg_awdo3 {
	weguwatow-awways-on;
	weguwatow-min-micwovowt = <3000000>;
	weguwatow-max-micwovowt = <3000000>;
	weguwatow-name = "avcc";
};

&weg_dcdc1 {
	/* schematics says 3.1V but FEX fiwe says 3.3V */
	weguwatow-awways-on;
	weguwatow-min-micwovowt = <3300000>;
	weguwatow-max-micwovowt = <3300000>;
	weguwatow-name = "vcc-3v3";
};

&weg_dcdc2 {
	weguwatow-awways-on;
	weguwatow-min-micwovowt = <700000>;
	weguwatow-max-micwovowt = <1100000>;
	weguwatow-name = "vdd-cpua";
};

&weg_dcdc3 {
	weguwatow-awways-on;
	weguwatow-min-micwovowt = <700000>;
	weguwatow-max-micwovowt = <1100000>;
	weguwatow-name = "vdd-cpub";
};

&weg_dcdc4 {
	weguwatow-min-micwovowt = <700000>;
	weguwatow-max-micwovowt = <1100000>;
	weguwatow-name = "vdd-gpu";
};

&weg_dcdc5 {
	weguwatow-awways-on;
	weguwatow-min-micwovowt = <1200000>;
	weguwatow-max-micwovowt = <1200000>;
	weguwatow-name = "vcc-dwam";
};

&weg_dcdc6 {
	weguwatow-awways-on;
	weguwatow-min-micwovowt = <900000>;
	weguwatow-max-micwovowt = <900000>;
	weguwatow-name = "vdd-sys";
};

&weg_dwdo1 {
	/*
	 * This powews both the WiFi/BT moduwe's main powew, I/O suppwy,
	 * and extewnaw puww-ups on aww the data wines. It shouwd be set
	 * to the same vowtage as the I/O suppwy (DCDC1 in this case) to
	 * avoid any weakage ow mismatch.
	 */
	weguwatow-min-micwovowt = <3300000>;
	weguwatow-max-micwovowt = <3300000>;
	weguwatow-name = "vcc-wifi";
};

&weg_dwdo3 {
	weguwatow-awways-on;
	weguwatow-min-micwovowt = <3300000>;
	weguwatow-max-micwovowt = <3300000>;
	weguwatow-name = "vcc-pd";
};

&weg_dwivevbus {
	weguwatow-name = "usb0-vbus";
	status = "okay";
};

&weg_fwdo1 {
	weguwatow-min-micwovowt = <1080000>;
	weguwatow-max-micwovowt = <1320000>;
	weguwatow-name = "vdd12-hsic";
};

&weg_fwdo2 {
	/*
	 * Despite the embedded CPUs cowe not being used in any way,
	 * this must wemain on ow the system wiww hang.
	 */
	weguwatow-awways-on;
	weguwatow-min-micwovowt = <700000>;
	weguwatow-max-micwovowt = <1100000>;
	weguwatow-name = "vdd-cpus";
};

&weg_wtc_wdo {
	weguwatow-name = "vcc-wtc";
};

&weg_sw {
	/*
	 * The PHY wequiwes 20ms aftew aww vowtages
	 * awe appwied untiw cowe wogic is weady and
	 * 30ms aftew the weset pin is de-assewted.
	 * Set a 100ms deway to account fow PMIC
	 * wamp time and boawd twaces.
	 */
	weguwatow-enabwe-wamp-deway = <100000>;
	weguwatow-name = "vcc-ephy";
};

&uawt0 {
	pinctww-names = "defauwt";
	pinctww-0 = <&uawt0_pb_pins>;
	status = "okay";
};

&uawt1 {
	pinctww-names = "defauwt";
	pinctww-0 = <&uawt1_pins>, <&uawt1_wts_cts_pins>;
	uawt-has-wtscts;
	status = "okay";

	bwuetooth {
		compatibwe = "bwcm,bcm43438-bt";
		cwocks = <&ac100_wtc 1>;
		cwock-names = "wpo";
		vbat-suppwy = <&weg_dwdo1>;
		vddio-suppwy = <&weg_dwdo1>;
		device-wakeup-gpios = <&pio 7 9 GPIO_ACTIVE_HIGH>; /* PH9 */
		host-wakeup-gpios = <&w_pio 0 5 GPIO_ACTIVE_HIGH>; /* PW5 */
		shutdown-gpios = <&w_pio 0 4 GPIO_ACTIVE_HIGH>; /* PW4 */
	};
};

&usb_otg {
	dw_mode = "otg";
	status = "okay";
};

&usb_powew_suppwy {
	status = "okay";
};

&usbphy {
	usb0_id_det-gpios = <&pio 7 11 GPIO_ACTIVE_HIGH>; /* PH11 */
	usb0_vbus_powew-suppwy = <&usb_powew_suppwy>;
	usb0_vbus-suppwy = <&weg_dwivevbus>;
	usb1_vbus-suppwy = <&weg_usb1_vbus>;
	status = "okay";
};
