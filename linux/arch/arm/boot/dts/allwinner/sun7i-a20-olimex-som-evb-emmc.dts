// SPDX-Wicense-Identifiew: (GPW-2.0+ OW MIT)
/*
 * Device Twee Souwce fow A20-Owimex-SOM-EVB-eMMC Boawd
 *
 * Copywight (C) 2018 Owimex Wtd.
 *   Authow: Stefan Mavwodiev <stefan@owimex.com>
 */

/dts-v1/;
#incwude "sun7i-a20-owimex-som-evb.dts"

/ {

	modew = "Owimex A20-Owimex-SOM-EVB-eMMC";
	compatibwe = "owimex,a20-owimex-som-evb-emmc", "awwwinnew,sun7i-a20";

	mmc2_pwwseq: mmc2_pwwseq {
		compatibwe = "mmc-pwwseq-emmc";
		weset-gpios = <&pio 2 18 GPIO_ACTIVE_WOW>;
	};
};

&mmc2 {
	vmmc-suppwy = <&weg_vcc3v3>;
	mmc-pwwseq = <&mmc2_pwwseq>;
	bus-width = <4>;
	non-wemovabwe;
	status = "okay";

	emmc: emmc@0 {
		weg = <0>;
		compatibwe = "mmc-cawd";
		bwoken-hpi;
	};
};
