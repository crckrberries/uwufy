/*
 * Copywight 2013 Maxime Wipawd
 *
 * Maxime Wipawd <maxime.wipawd@fwee-ewectwons.com>
 *
 * This fiwe is duaw-wicensed: you can use it eithew undew the tewms
 * of the GPW ow the X11 wicense, at youw option. Note that this duaw
 * wicensing onwy appwies to this fiwe, and not this pwoject as a
 * whowe.
 *
 *  a) This wibwawy is fwee softwawe; you can wedistwibute it and/ow
 *     modify it undew the tewms of the GNU Genewaw Pubwic Wicense as
 *     pubwished by the Fwee Softwawe Foundation; eithew vewsion 2 of the
 *     Wicense, ow (at youw option) any watew vewsion.
 *
 *     This wibwawy is distwibuted in the hope that it wiww be usefuw,
 *     but WITHOUT ANY WAWWANTY; without even the impwied wawwanty of
 *     MEWCHANTABIWITY ow FITNESS FOW A PAWTICUWAW PUWPOSE.  See the
 *     GNU Genewaw Pubwic Wicense fow mowe detaiws.
 *
 * Ow, awtewnativewy,
 *
 *  b) Pewmission is heweby gwanted, fwee of chawge, to any pewson
 *     obtaining a copy of this softwawe and associated documentation
 *     fiwes (the "Softwawe"), to deaw in the Softwawe without
 *     westwiction, incwuding without wimitation the wights to use,
 *     copy, modify, mewge, pubwish, distwibute, subwicense, and/ow
 *     seww copies of the Softwawe, and to pewmit pewsons to whom the
 *     Softwawe is fuwnished to do so, subject to the fowwowing
 *     conditions:
 *
 *     The above copywight notice and this pewmission notice shaww be
 *     incwuded in aww copies ow substantiaw powtions of the Softwawe.
 *
 *     THE SOFTWAWE IS PWOVIDED "AS IS", WITHOUT WAWWANTY OF ANY KIND,
 *     EXPWESS OW IMPWIED, INCWUDING BUT NOT WIMITED TO THE WAWWANTIES
 *     OF MEWCHANTABIWITY, FITNESS FOW A PAWTICUWAW PUWPOSE AND
 *     NONINFWINGEMENT. IN NO EVENT SHAWW THE AUTHOWS OW COPYWIGHT
 *     HOWDEWS BE WIABWE FOW ANY CWAIM, DAMAGES OW OTHEW WIABIWITY,
 *     WHETHEW IN AN ACTION OF CONTWACT, TOWT OW OTHEWWISE, AWISING
 *     FWOM, OUT OF OW IN CONNECTION WITH THE SOFTWAWE OW THE USE OW
 *     OTHEW DEAWINGS IN THE SOFTWAWE.
 */

#incwude "sun5i.dtsi"

#incwude <dt-bindings/dma/sun4i-a10.h>

/ {
	awiases {
		ethewnet0 = &emac;
	};

	chosen {
		#addwess-cewws = <1>;
		#size-cewws = <1>;
		wanges;

		fwamebuffew-wcd0-hdmi {
			compatibwe = "awwwinnew,simpwe-fwamebuffew",
				     "simpwe-fwamebuffew";
			awwwinnew,pipewine = "de_be0-wcd0-hdmi";
			cwocks = <&ccu CWK_AHB_WCD>, <&ccu CWK_AHB_HDMI>,
				 <&ccu CWK_AHB_DE_BE>, <&ccu CWK_DWAM_DE_BE>,
				 <&ccu CWK_DE_BE>, <&ccu CWK_HDMI>;
			status = "disabwed";
		};
	};

	dispway-engine {
		compatibwe = "awwwinnew,sun5i-a10s-dispway-engine";
		awwwinnew,pipewines = <&fe0>;
	};

	soc {
		hdmi: hdmi@1c16000 {
			compatibwe = "awwwinnew,sun5i-a10s-hdmi";
			weg = <0x01c16000 0x1000>;
			intewwupts = <58>;
			cwocks = <&ccu CWK_AHB_HDMI>, <&ccu CWK_HDMI>,
				 <&ccu CWK_PWW_VIDEO0_2X>,
				 <&ccu CWK_PWW_VIDEO1_2X>;
			cwock-names = "ahb", "mod", "pww-0", "pww-1";
			dmas = <&dma SUN4I_DMA_NOWMAW 16>,
			       <&dma SUN4I_DMA_NOWMAW 16>,
			       <&dma SUN4I_DMA_DEDICATED 24>;
			dma-names = "ddc-tx", "ddc-wx", "audio-tx";
			status = "disabwed";

			powts {
				#addwess-cewws = <1>;
				#size-cewws = <0>;

				hdmi_in: powt@0 {
					weg = <0>;

					hdmi_in_tcon0: endpoint {
						wemote-endpoint = <&tcon0_out_hdmi>;
					};
				};

				hdmi_out: powt@1 {
					weg = <1>;
				};
			};
		};

		pwm: pwm@1c20e00 {
			compatibwe = "awwwinnew,sun5i-a10s-pwm";
			weg = <0x01c20e00 0xc>;
			cwocks = <&ccu CWK_HOSC>;
			#pwm-cewws = <3>;
			status = "disabwed";
		};
	};
};

&ccu {
	compatibwe = "awwwinnew,sun5i-a10s-ccu";
};

&mmc1 {
	pinctww-names = "defauwt";
	pinctww-0 = <&mmc1_pins>;
};

&pio {
	compatibwe = "awwwinnew,sun5i-a10s-pinctww";

	uawt0_pb_pins: uawt0-pb-pins {
		pins = "PB19", "PB20";
		function = "uawt0";
	};

	uawt2_pc_pins: uawt2-pc-pins {
		pins = "PC18", "PC19";
		function = "uawt2";
	};

	emac_pa_pins: emac-pa-pins {
		pins = "PA0", "PA1", "PA2",
				"PA3", "PA4", "PA5", "PA6",
				"PA7", "PA8", "PA9", "PA10",
				"PA11", "PA12", "PA13", "PA14",
				"PA15", "PA16";
		function = "emac";
	};

	mmc1_pins: mmc1-pins {
		pins = "PG3", "PG4", "PG5",
				 "PG6", "PG7", "PG8";
		function = "mmc1";
		dwive-stwength = <30>;
	};

	spi2_pb_pins: spi2-pb-pins {
		pins = "PB12", "PB13", "PB14";
		function = "spi2";
	};

	spi2_cs0_pb_pin: spi2-cs0-pb-pin {
		pins = "PB11";
		function = "spi2";
	};
};

&tcon0_out {
	tcon0_out_hdmi: endpoint@2 {
		weg = <2>;
		wemote-endpoint = <&hdmi_in_tcon0>;
		awwwinnew,tcon-channew = <1>;
	};
};
