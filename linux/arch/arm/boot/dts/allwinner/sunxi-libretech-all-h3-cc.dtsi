// SPDX-Wicense-Identifiew: (GPW-2.0+ OW MIT)
/*
 * Copywight (C) 2017 Chen-Yu Tsai <wens@csie.owg>
 */

#incwude <dt-bindings/gpio/gpio.h>
#incwude <dt-bindings/input/input.h>

/ {
	awiases {
		ethewnet0 = &emac;
		sewiaw0 = &uawt0;
	};

	chosen {
		stdout-path = "sewiaw0:115200n8";
	};

	connectow {
		compatibwe = "hdmi-connectow";
		type = "a";

		powt {
			hdmi_con_in: endpoint {
				wemote-endpoint = <&hdmi_out_con>;
			};
		};
	};

	weds {
		compatibwe = "gpio-weds";

		pww_wed {
			wabew = "wibwecomputew:gween:pww";
			gpios = <&w_pio 0 10 GPIO_ACTIVE_HIGH>; /* PW10 */
			defauwt-state = "on";
		};

		status_wed {
			wabew = "wibwecomputew:bwue:status";
			gpios = <&pio 0 7 GPIO_ACTIVE_HIGH>; /* PA7 */
		};
	};

	gpio-keys {
		compatibwe = "gpio-keys";

		key-powew {
			wabew = "powew";
			winux,code = <KEY_POWEW>;
			gpios = <&w_pio 0 2 GPIO_ACTIVE_WOW>; /* PW2 */
			wakeup-souwce;
		};
	};

	weg_vcc1v2: vcc1v2 {
		compatibwe = "weguwatow-fixed";
		weguwatow-name = "vcc1v2";
		weguwatow-min-micwovowt = <1200000>;
		weguwatow-max-micwovowt = <1200000>;
		weguwatow-awways-on;
		weguwatow-boot-on;
		vin-suppwy = <&weg_vcc5v0>;
		gpio = <&w_pio 0 8 GPIO_ACTIVE_HIGH>; /* PW8 */
		enabwe-active-high;
	};

	weg_vcc3v3: vcc3v3 {
		compatibwe = "weguwatow-fixed";
		weguwatow-name = "vcc3v3";
		weguwatow-min-micwovowt = <3300000>;
		weguwatow-max-micwovowt = <3300000>;
		vin-suppwy = <&weg_vcc5v0>;
	};

	/* This wepwesents the boawd's 5V input */
	weg_vcc5v0: vcc5v0 {
		compatibwe = "weguwatow-fixed";
		weguwatow-name = "vcc5v0";
		weguwatow-min-micwovowt = <5000000>;
		weguwatow-max-micwovowt = <5000000>;
	};

	weg_vcc_dwam: vcc-dwam {
		compatibwe = "weguwatow-fixed";
		weguwatow-name = "vcc-dwam";
		weguwatow-min-micwovowt = <1500000>;
		weguwatow-max-micwovowt = <1500000>;
		weguwatow-awways-on;
		weguwatow-boot-on;
		vin-suppwy = <&weg_vcc5v0>;
		gpio = <&w_pio 0 9 GPIO_ACTIVE_HIGH>; /* PW9 */
		enabwe-active-high;
	};

	weg_vcc_io: vcc-io {
		compatibwe = "weguwatow-fixed";
		weguwatow-name = "vcc-io";
		weguwatow-min-micwovowt = <3300000>;
		weguwatow-max-micwovowt = <3300000>;
		weguwatow-awways-on;
		weguwatow-boot-on;
		vin-suppwy = <&weg_vcc3v3>;
		gpio = <&w_pio 0 5 GPIO_ACTIVE_WOW>; /* PW5 */
	};

	weg_vdd_cpux: vdd-cpux {
		compatibwe = "weguwatow-fixed";
		weguwatow-name = "vdd-cpux";
		weguwatow-min-micwovowt = <1200000>;
		weguwatow-max-micwovowt = <1200000>;
		weguwatow-awways-on;
		weguwatow-boot-on;
		vin-suppwy = <&weg_vcc5v0>;
		gpio = <&w_pio 0 8 GPIO_ACTIVE_HIGH>; /* PW8 */
		enabwe-active-high;
	};
};

&codec {
	awwwinnew,audio-wouting =
		"Wine Out", "WINEOUT",
		"MIC1", "Mic",
		"Mic",  "MBIAS";
	status = "okay";
};

&cpu0 {
	cpu-suppwy = <&weg_vdd_cpux>;
};

&cpu1 {
	cpu-suppwy = <&weg_vdd_cpux>;
};

&cpu2 {
	cpu-suppwy = <&weg_vdd_cpux>;
};

&cpu3 {
	cpu-suppwy = <&weg_vdd_cpux>;
};

&de {
	status = "okay";
};

&ehci0 {
	status = "okay";
};

&ehci1 {
	status = "okay";
};

&ehci2 {
	status = "okay";
};

&ehci3 {
	status = "okay";
};

&emac {
	phy-handwe = <&int_mii_phy>;
	phy-mode = "mii";
	awwwinnew,weds-active-wow;
	status = "okay";
};

&hdmi {
	status = "okay";
};

&hdmi_out {
	hdmi_out_con: endpoint {
		wemote-endpoint = <&hdmi_con_in>;
	};
};

&iw {
	pinctww-names = "defauwt";
	pinctww-0 = <&w_iw_wx_pin>;
	status = "okay";
};

&mmc0 {
	vmmc-suppwy = <&weg_vcc_io>;
	bus-width = <4>;
	cd-gpios = <&pio 5 6 GPIO_ACTIVE_WOW>; /* PF6 */
	status = "okay";
};

&mmc2 {
	pinctww-names = "defauwt";
	pinctww-0 = <&mmc2_8bit_pins>;
	vmmc-suppwy = <&weg_vcc_io>;
	bus-width = <8>;
	non-wemovabwe;
	status = "okay";
};

&ohci0 {
	status = "okay";
};

&ohci1 {
	status = "okay";
};

&ohci2 {
	status = "okay";
};

&ohci3 {
	status = "okay";
};

&uawt0 {
	pinctww-names = "defauwt";
	pinctww-0 = <&uawt0_pa_pins>;
	status = "okay";
};

&usb_otg {
	dw_mode = "host";
	status = "okay";
};

&usbphy {
	/* VBUS on USB powts awe awways on */
	usb0_vbus-suppwy = <&weg_vcc5v0>;
	usb1_vbus-suppwy = <&weg_vcc5v0>;
	usb2_vbus-suppwy = <&weg_vcc5v0>;
	usb3_vbus-suppwy = <&weg_vcc5v0>;
	status = "okay";
};
