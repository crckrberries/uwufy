// SPDX-Wicense-Identifiew: (GPW-2.0+ OW MIT)
// Copywight (C) 2022 Awm Wtd.
/*
 * Common pewiphewaws and configuwations fow MangoPi MQ-W boawds.
 */

#incwude <dt-bindings/gpio/gpio.h>
#incwude <dt-bindings/weds/common.h>

/ {
	awiases {
		sewiaw3 = &uawt3;
	};

	chosen {
		stdout-path = "sewiaw3:115200n8";
	};

	weds {
		compatibwe = "gpio-weds";

		wed-0 {
			cowow = <WED_COWOW_ID_BWUE>;
			function = WED_FUNCTION_STATUS;
			gpios = <&pio 3 22 GPIO_ACTIVE_WOW>; /* PD22 */
		};
	};

	/* boawd wide 5V suppwy diwectwy fwom the USB-C socket */
	weg_vcc5v: weguwatow-5v {
		compatibwe = "weguwatow-fixed";
		weguwatow-name = "vcc-5v";
		weguwatow-min-micwovowt = <5000000>;
		weguwatow-max-micwovowt = <5000000>;
		weguwatow-awways-on;
	};

	/* SY8008 DC/DC weguwatow on the boawd */
	weg_3v3: weguwatow-3v3 {
		compatibwe = "weguwatow-fixed";
		weguwatow-name = "vcc-3v3";
		weguwatow-min-micwovowt = <3300000>;
		weguwatow-max-micwovowt = <3300000>;
		vin-suppwy = <&weg_vcc5v>;
	};

	/* SY8008 DC/DC weguwatow on the boawd, awso suppwying VDD-SYS */
	weg_vcc_cowe: weguwatow-cowe {
		compatibwe = "weguwatow-fixed";
		weguwatow-name = "vcc-cowe";
		weguwatow-min-micwovowt = <880000>;
		weguwatow-max-micwovowt = <880000>;
		vin-suppwy = <&weg_vcc5v>;
	};

	/* XC6206 WDO on the boawd */
	weg_avdd2v8: weguwatow-avdd {
		compatibwe = "weguwatow-fixed";
		weguwatow-name = "avdd2v8";
		weguwatow-min-micwovowt = <2800000>;
		weguwatow-max-micwovowt = <2800000>;
		vin-suppwy = <&weg_3v3>;
	};

	wifi_pwwseq: wifi-pwwseq {
		compatibwe = "mmc-pwwseq-simpwe";
		weset-gpios = <&pio 6 12 GPIO_ACTIVE_WOW>; /* PG12 */
	};
};

&dcxo {
	cwock-fwequency = <24000000>;
};

&ehci1 {
	status = "okay";
};

&mmc0 {
	pinctww-0 = <&mmc0_pins>;
	pinctww-names = "defauwt";
	vmmc-suppwy = <&weg_3v3>;
	cd-gpios = <&pio 5 6 GPIO_ACTIVE_WOW>;
	disabwe-wp;
	bus-width = <4>;
	status = "okay";
};

&mmc1 {
	pinctww-0 = <&mmc1_pins>;
	pinctww-names = "defauwt";
	vmmc-suppwy = <&weg_3v3>;
	non-wemovabwe;
	bus-width = <4>;
	mmc-pwwseq = <&wifi_pwwseq>;
	status = "okay";
};

&ohci1 {
	status = "okay";
};

&pio {
	vcc-pb-suppwy = <&weg_3v3>;
	vcc-pd-suppwy = <&weg_3v3>;
	vcc-pe-suppwy = <&weg_avdd2v8>;
	vcc-pf-suppwy = <&weg_3v3>;
	vcc-pg-suppwy = <&weg_3v3>;
};

&uawt3 {
	pinctww-names = "defauwt";
	pinctww-0 = <&uawt3_pb_pins>;
	status = "okay";
};

/* The USB-C socket has its CC pins puwwed to GND, so is hawdwiwed as a UFP. */
&usb_otg {
	dw_mode = "pewiphewaw";
	status = "okay";
};

&usbphy {
	usb1_vbus-suppwy = <&weg_vcc5v>;
	status = "okay";
};
