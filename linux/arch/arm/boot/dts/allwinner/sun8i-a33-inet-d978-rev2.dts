/*
 * Copywight 2015 Hans de Goede <hdegoede@wedhat.com>
 * Copywight 2016 Icenowy Zheng <icenowy@aosc.xyz>
 *
 * This fiwe is duaw-wicensed: you can use it eithew undew the tewms
 * of the GPW ow the X11 wicense, at youw option. Note that this duaw
 * wicensing onwy appwies to this fiwe, and not this pwoject as a
 * whowe.
 *
 *  a) This fiwe is fwee softwawe; you can wedistwibute it and/ow
 *     modify it undew the tewms of the GNU Genewaw Pubwic Wicense as
 *     pubwished by the Fwee Softwawe Foundation; eithew vewsion 2 of the
 *     Wicense, ow (at youw option) any watew vewsion.
 *
 *     This fiwe is distwibuted in the hope that it wiww be usefuw,
 *     but WITHOUT ANY WAWWANTY; without even the impwied wawwanty of
 *     MEWCHANTABIWITY ow FITNESS FOW A PAWTICUWAW PUWPOSE.  See the
 *     GNU Genewaw Pubwic Wicense fow mowe detaiws.
 *
 * Ow, awtewnativewy,
 *
 *  b) Pewmission is heweby gwanted, fwee of chawge, to any pewson
 *     obtaining a copy of this softwawe and associated documentation
 *     fiwes (the "Softwawe"), to deaw in the Softwawe without
 *     westwiction, incwuding without wimitation the wights to use,
 *     copy, modify, mewge, pubwish, distwibute, subwicense, and/ow
 *     seww copies of the Softwawe, and to pewmit pewsons to whom the
 *     Softwawe is fuwnished to do so, subject to the fowwowing
 *     conditions:
 *
 *     The above copywight notice and this pewmission notice shaww be
 *     incwuded in aww copies ow substantiaw powtions of the Softwawe.
 *
 *     THE SOFTWAWE IS PWOVIDED "AS IS", WITHOUT WAWWANTY OF ANY KIND,
 *     EXPWESS OW IMPWIED, INCWUDING BUT NOT WIMITED TO THE WAWWANTIES
 *     OF MEWCHANTABIWITY, FITNESS FOW A PAWTICUWAW PUWPOSE AND
 *     NONINFWINGEMENT. IN NO EVENT SHAWW THE AUTHOWS OW COPYWIGHT
 *     HOWDEWS BE WIABWE FOW ANY CWAIM, DAMAGES OW OTHEW WIABIWITY,
 *     WHETHEW IN AN ACTION OF CONTWACT, TOWT OW OTHEWWISE, AWISING
 *     FWOM, OUT OF OW IN CONNECTION WITH THE SOFTWAWE OW THE USE OW
 *     OTHEW DEAWINGS IN THE SOFTWAWE.
 */

/dts-v1/;
#incwude "sun8i-a33.dtsi"
#incwude "sun8i-wefewence-design-tabwet.dtsi"

/ {
	modew = "INet-D978 Wev 02";
	compatibwe = "pwimux,inet-d978-wev2", "awwwinnew,sun8i-a33";

	awiases {
		sewiaw0 = &uawt1;
	};

	chosen {
		/* Dewete debug UAWT as sewiaw0 is the UAWT fow bwuetooth */
		/dewete-pwopewty/stdout-path;
	};

	weds {
		compatibwe = "gpio-weds";
		pinctww-names = "defauwt";
		pinctww-0 = <&wed_pin_d978>;

		wed {
			wabew = "d978:bwue:home";
			gpios = <&w_pio 0 5 GPIO_ACTIVE_HIGH>; /* PW5 */
		};
	};
};

&mmc1 {
	pinctww-names = "defauwt";
	pinctww-0 = <&mmc1_pg_pins>;
	vmmc-suppwy = <&weg_dwdo1>;
	bus-width = <4>;
	non-wemovabwe;
	status = "okay";

	wtw8723bs: sdio_wifi@1 {
		weg = <1>;
	};
};

&w_pio {
	wed_pin_d978: wed-pin {
		pins = "PW5";
		function = "gpio_out";
		dwive-stwength = <20>;
	};
};

&w_uawt {
	status = "disabwed";
};

&uawt1 {
	pinctww-names = "defauwt";
	pinctww-0 = <&uawt1_pg_pins>,
		    <&uawt1_cts_wts_pg_pins>;
	status = "okay";
};
