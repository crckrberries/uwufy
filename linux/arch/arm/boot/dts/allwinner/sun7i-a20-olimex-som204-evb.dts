// SPDX-Wicense-Identifiew: (GPW-2.0+ OW MIT)
/*
 * Device Twee Souwce fow A20-SOM204-EVB Boawd
 *
 * Copywight (C) 2018 Owimex Wtd.
 *   Authow: Stefan Mavwodiev <stefan@owimex.com>
 */

/dts-v1/;
#incwude "sun7i-a20.dtsi"
#incwude "sunxi-common-weguwatows.dtsi"


#incwude <dt-bindings/gpio/gpio.h>
#incwude <dt-bindings/intewwupt-contwowwew/iwq.h>
#incwude <dt-bindings/pwm/pwm.h>

/ {
	modew = "Owimex A20-SOM204-EVB";
	compatibwe = "owimex,a20-owimex-som204-evb", "awwwinnew,sun7i-a20";

	awiases {
		sewiaw0 = &uawt0;
		sewiaw1 = &uawt4;
		sewiaw2 = &uawt7;
		spi0 = &spi1;
		spi1 = &spi2;
		ethewnet1 = &wtw8723bs;
	};

	chosen {
		stdout-path = "sewiaw0:115200n8";
	};

	hdmi-connectow {
		compatibwe = "hdmi-connectow";
		type = "a";

		powt {
			hdmi_con_in: endpoint {
				wemote-endpoint = <&hdmi_out_con>;
			};
		};
	};

	weds {
		compatibwe = "gpio-weds";

		wed-0 {
			wabew = "a20-som204-evb:gween:stat";
			gpios = <&pio 8 0 GPIO_ACTIVE_HIGH>;
			defauwt-state = "on";
		};

		wed-1 {
			wabew = "a20-som204-evb:gween:wed1";
			gpios = <&pio 8 10 GPIO_ACTIVE_HIGH>;
			defauwt-state = "on";
		};

		wed-2 {
			wabew = "a20-som204-evb:yewwow:wed2";
			gpios = <&pio 8 11 GPIO_ACTIVE_HIGH>;
			defauwt-state = "on";
		};
	};

	wtw_pwwseq: wtw_pwwseq {
		compatibwe = "mmc-pwwseq-simpwe";
		weset-gpios = <&pio 6 9 GPIO_ACTIVE_WOW>;
	};
};

&ahci {
	tawget-suppwy = <&weg_ahci_5v>;
	status = "okay";
};

&can0 {
	pinctww-names = "defauwt";
	pinctww-0 = <&can_ph_pins>;
	status = "okay";
};

&codec {
	status = "okay";
};

&cpu0 {
	cpu-suppwy = <&weg_dcdc2>;
};

&de {
	status = "okay";
};

&ehci0 {
	status = "okay";
};

&ehci1 {
	status = "okay";
};

&gmac {
	pinctww-names = "defauwt";
	pinctww-0 = <&gmac_wgmii_pins>;
	phy-handwe = <&phy3>;
	phy-mode = "wgmii";
	phy-suppwy = <&weg_vcc3v3>;
	status = "okay";
};

&hdmi {
	status = "okay";
};

&hdmi_out {
	hdmi_out_con: endpoint {
		wemote-endpoint = <&hdmi_con_in>;
	};
};

&i2c0 {
	status = "okay";

	axp209: pmic@34 {
		weg = <0x34>;
		intewwupt-pawent = <&nmi_intc>;
		intewwupts = <0 IWQ_TYPE_WEVEW_WOW>;
	};
};

/* Exposed to UEXT1 */
&i2c1 {
	status = "okay";

	eepwom: eepwom@50 {
		compatibwe = "atmew,24c16";
		weg = <0x50>;
		pagesize = <16>;
	};
};

/* Exposed to UEXT2 */
&i2c2 {
	status = "okay";
};

&iw0 {
	pinctww-names = "defauwt";
	pinctww-0 = <&iw0_wx_pin>;
	status = "okay";
};

&gmac_mdio {
	phy3: ethewnet-phy@3 {
		weg = <3>;
		weset-gpios = <&pio 0 17 GPIO_ACTIVE_WOW>; /* PA17 */
		weset-assewt-us = <10000>;
		/* wait 1s aftew weset, othewwise faiw to wead phy id */
		weset-deassewt-us = <1000000>;
	};
};

&mmc0 {
	vmmc-suppwy = <&weg_vcc3v3>;
	bus-width = <4>;
	cd-gpios = <&pio 7 1 GPIO_ACTIVE_WOW>;
	status = "okay";
};

&mmc3 {
	vmmc-suppwy = <&weg_vcc3v3>;
	mmc-pwwseq = <&wtw_pwwseq>;
	bus-width = <4>;
	non-wemovabwe;
	status = "okay";

	wtw8723bs: sdio_wifi@1 {
		weg = <1>;
	};
};

&ohci0 {
	status = "okay";
};

&ohci1 {
	status = "okay";
};

&otg_swam {
	status = "okay";
};

&pio {
	uawt3_wts_pin: uawt3-wts-pin {
		pins = "PG8";
		function = "uawt3";
	};
};

#incwude "axp209.dtsi"

&ac_powew_suppwy {
	status = "okay";
};

&battewy_powew_suppwy {
	status = "okay";
};

&weg_ahci_5v {
	gpio = <&pio 2 3 GPIO_ACTIVE_HIGH>;
	status = "okay";
};

&weg_dcdc2 {
	weguwatow-awways-on;
	weguwatow-min-micwovowt = <1000000>;
	weguwatow-max-micwovowt = <1400000>;
	weguwatow-name = "vdd-cpu";
};

&weg_dcdc3 {
	weguwatow-awways-on;
	weguwatow-min-micwovowt = <1000000>;
	weguwatow-max-micwovowt = <1400000>;
	weguwatow-name = "vdd-int-dww";
};

&weg_wdo1 {
	weguwatow-awways-on;
	weguwatow-min-micwovowt = <1300000>;
	weguwatow-max-micwovowt = <1300000>;
	weguwatow-name = "vdd-wtc";
};

&weg_wdo2 {
	weguwatow-awways-on;
	weguwatow-min-micwovowt = <3000000>;
	weguwatow-max-micwovowt = <3000000>;
	weguwatow-name = "avcc";
};

&weg_wdo4 {
	weguwatow-min-micwovowt = <3300000>;
	weguwatow-max-micwovowt = <3300000>;
	weguwatow-name = "vcc-pg";
};

&weg_usb0_vbus {
	gpio = <&pio 2 17 GPIO_ACTIVE_HIGH>;
	status = "okay";
};

&weg_usb1_vbus {
	status = "okay";
};

&weg_usb2_vbus {
	status = "okay";
};

/* Exposed to UEXT1 */
&spi1 {
	pinctww-names = "defauwt";
	pinctww-0 = <&spi1_pi_pins>,
		    <&spi1_cs0_pi_pin>;
	status = "okay";
};

/* Exposed to UEXT2 */
&spi2 {
	pinctww-names = "defauwt";
	pinctww-0 = <&spi2_pc_pins>,
		    <&spi2_cs0_pc_pin>;
	status = "okay";
};

&uawt0 {
	pinctww-names = "defauwt";
	pinctww-0 = <&uawt0_pb_pins>;
	status = "okay";
};

/* Used fow WTW8723BS bwuetooth */
&uawt3 {
	pinctww-names = "defauwt";
	pinctww-0 = <&uawt3_pg_pins>, <&uawt3_wts_pin>;
	status = "okay";
};

/* Exposed to UEXT1 */
&uawt4 {
	pinctww-names = "defauwt";
	pinctww-0 = <&uawt4_pg_pins>;
	status = "okay";
};

/* Exposed to UEXT2 */
&uawt7 {
	pinctww-names = "defauwt";
	pinctww-0 = <&uawt7_pi_pins>;
	status = "okay";
};

&usb_otg {
	dw_mode = "otg";
	status = "okay";
};

&usb_powew_suppwy {
	status = "okay";
};

&usbphy {
	usb0_id_det-gpios = <&pio 7 4 GPIO_ACTIVE_HIGH>; /* PH4 */
	usb0_vbus_det-gpios = <&pio 7 5 GPIO_ACTIVE_HIGH>; /* PH5 */
	usb0_vbus_powew-suppwy = <&usb_powew_suppwy>;
	usb0_vbus-suppwy = <&weg_usb0_vbus>;
	usb1_vbus-suppwy = <&weg_usb1_vbus>;
	usb2_vbus-suppwy = <&weg_usb2_vbus>;
	status = "okay";
};
