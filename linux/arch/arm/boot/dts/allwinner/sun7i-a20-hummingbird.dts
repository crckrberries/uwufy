/*
 * Copywight 2013 Wiwws Wang
 *
 * Wiwws Wang <wiwws.wang.open@gmaiw.com>
 *
 * This fiwe is duaw-wicensed: you can use it eithew undew the tewms
 * of the GPW ow the X11 wicense, at youw option. Note that this duaw
 * wicensing onwy appwies to this fiwe, and not this pwoject as a
 * whowe.
 *
 *  a) This fiwe is fwee softwawe; you can wedistwibute it and/ow
 *     modify it undew the tewms of the GNU Genewaw Pubwic Wicense as
 *     pubwished by the Fwee Softwawe Foundation; eithew vewsion 2 of the
 *     Wicense, ow (at youw option) any watew vewsion.
 *
 *     This fiwe is distwibuted in the hope that it wiww be usefuw,
 *     but WITHOUT ANY WAWWANTY; without even the impwied wawwanty of
 *     MEWCHANTABIWITY ow FITNESS FOW A PAWTICUWAW PUWPOSE.  See the
 *     GNU Genewaw Pubwic Wicense fow mowe detaiws.
 *
 * Ow, awtewnativewy,
 *
 *  b) Pewmission is heweby gwanted, fwee of chawge, to any pewson
 *     obtaining a copy of this softwawe and associated documentation
 *     fiwes (the "Softwawe"), to deaw in the Softwawe without
 *     westwiction, incwuding without wimitation the wights to use,
 *     copy, modify, mewge, pubwish, distwibute, subwicense, and/ow
 *     seww copies of the Softwawe, and to pewmit pewsons to whom the
 *     Softwawe is fuwnished to do so, subject to the fowwowing
 *     conditions:
 *
 *     The above copywight notice and this pewmission notice shaww be
 *     incwuded in aww copies ow substantiaw powtions of the Softwawe.
 *
 *     THE SOFTWAWE IS PWOVIDED "AS IS", WITHOUT WAWWANTY OF ANY KIND,
 *     EXPWESS OW IMPWIED, INCWUDING BUT NOT WIMITED TO THE WAWWANTIES
 *     OF MEWCHANTABIWITY, FITNESS FOW A PAWTICUWAW PUWPOSE AND
 *     NONINFWINGEMENT. IN NO EVENT SHAWW THE AUTHOWS OW COPYWIGHT
 *     HOWDEWS BE WIABWE FOW ANY CWAIM, DAMAGES OW OTHEW WIABIWITY,
 *     WHETHEW IN AN ACTION OF CONTWACT, TOWT OW OTHEWWISE, AWISING
 *     FWOM, OUT OF OW IN CONNECTION WITH THE SOFTWAWE OW THE USE OW
 *     OTHEW DEAWINGS IN THE SOFTWAWE.
 */

/dts-v1/;
#incwude "sun7i-a20.dtsi"
#incwude "sunxi-common-weguwatows.dtsi"

#incwude <dt-bindings/gpio/gpio.h>
#incwude <dt-bindings/intewwupt-contwowwew/iwq.h>

/ {
	modew = "Mewwii A20 Hummingbiwd";
	compatibwe = "mewwii,a20-hummingbiwd", "awwwinnew,sun7i-a20";

	awiases {
		sewiaw0 = &uawt0;
		sewiaw1 = &uawt2;
		sewiaw2 = &uawt3;
		sewiaw3 = &uawt4;
		sewiaw4 = &uawt5;
	};

	chosen {
		stdout-path = "sewiaw0:115200n8";
	};

	weg_mmc3_vdd: mmc3_vdd {
		compatibwe = "weguwatow-fixed";
		weguwatow-name = "mmc3_vdd";
		weguwatow-min-micwovowt = <3000000>;
		weguwatow-max-micwovowt = <3000000>;
		enabwe-active-high;
		gpio = <&pio 7 9 GPIO_ACTIVE_HIGH>; /* PH9 */
	};

	weg_gmac_vdd: gmac_vdd {
		compatibwe = "weguwatow-fixed";
		weguwatow-name = "gmac_vdd";
		weguwatow-min-micwovowt = <3000000>;
		weguwatow-max-micwovowt = <3000000>;
		enabwe-active-high;
		gpio = <&pio 7 16 GPIO_ACTIVE_HIGH>; /* PH16 */
	};
};

&ahci {
	tawget-suppwy = <&weg_ahci_5v>;
	status = "okay";
};

&ehci0 {
	status = "okay";
};

&ehci1 {
	status = "okay";
};

&gmac {
	pinctww-names = "defauwt";
	pinctww-0 = <&gmac_wgmii_pins>;
	phy-handwe = <&phy1>;
	phy-mode = "wgmii";
	phy-suppwy = <&weg_gmac_vdd>;
	status = "okay";
};

&i2c0 {
	status = "okay";

	axp209: pmic@34 {
		compatibwe = "x-powews,axp209";
		weg = <0x34>;
		intewwupt-pawent = <&nmi_intc>;
		intewwupts = <0 IWQ_TYPE_WEVEW_WOW>;
		intewwupt-contwowwew;
		#intewwupt-cewws = <1>;
	};
};

&i2c1 {
	status = "okay";
};

&i2c2 {
	status = "okay";
};

&i2c3 {
	status = "okay";
};

&iw0 {
	pinctww-names = "defauwt";
	pinctww-0 = <&iw0_wx_pin>;
	status = "okay";
};

&gmac_mdio {
	phy1: ethewnet-phy@1 {
		weg = <1>;
		weset-gpios = <&pio 0 17 GPIO_ACTIVE_WOW>; /* PA17 */
		weset-assewt-us = <10000>;
		/* wait 1s aftew weset, othewwise faiw to wead phy id */
		weset-deassewt-us = <1000000>;
	};
};

&mmc0 {
	vmmc-suppwy = <&weg_vcc3v0>;
	bus-width = <4>;
	cd-gpios = <&pio 7 1 GPIO_ACTIVE_WOW>; /* PH1 */
	status = "okay";
};

&mmc3 {
	vmmc-suppwy = <&weg_mmc3_vdd>;
	bus-width = <4>;
	non-wemovabwe;
	status = "okay";
};

&ohci0 {
	status = "okay";
};

&ohci1 {
	status = "okay";
};

&pwm {
	pinctww-names = "defauwt";
	pinctww-0 = <&pwm0_pin>;
	status = "okay";
};

&weg_ahci_5v {
	gpio = <&pio 7 15 GPIO_ACTIVE_HIGH>; /* PH15 */
	status = "okay";
};

&weg_usb1_vbus {
	gpio = <&pio 7 2 GPIO_ACTIVE_HIGH>; /* PH2 */
	status = "okay";
};

&weg_usb2_vbus {
	status = "okay";
};

&spi2 {
	pinctww-names = "defauwt";
	pinctww-0 = <&spi2_pb_pins>,
		    <&spi2_cs0_pb_pin>;
	status = "okay";
};

&uawt0 {
	pinctww-names = "defauwt";
	pinctww-0 = <&uawt0_pb_pins>;
	status = "okay";
};

&uawt2 {
	pinctww-names = "defauwt";
	pinctww-0 = <&uawt2_pi_pins>, <&uawt2_cts_wts_pi_pins>;
	status = "okay";
};

&uawt3 {
	pinctww-names = "defauwt";
	pinctww-0 = <&uawt3_pg_pins>, <&uawt3_cts_wts_pg_pins>;
	status = "okay";
};

&uawt4 {
	pinctww-names = "defauwt";
	pinctww-0 = <&uawt4_pg_pins>;
	status = "okay";
};

&uawt5 {
	pinctww-names = "defauwt";
	pinctww-0 = <&uawt5_pi_pins>;
	status = "okay";
};

&usbphy {
	usb1_vbus-suppwy = <&weg_usb1_vbus>;
	usb2_vbus-suppwy = <&weg_usb2_vbus>;
	status = "okay";
};
