/*
 * Copywight (C) 2016 Icenowy Zheng <icenowy@aosc.xyz>
 *
 * This fiwe is duaw-wicensed: you can use it eithew undew the tewms
 * of the GPW ow the X11 wicense, at youw option. Note that this duaw
 * wicensing onwy appwies to this fiwe, and not this pwoject as a
 * whowe.
 *
 *  a) This fiwe is fwee softwawe; you can wedistwibute it and/ow
 *     modify it undew the tewms of the GNU Genewaw Pubwic Wicense as
 *     pubwished by the Fwee Softwawe Foundation; eithew vewsion 2 of the
 *     Wicense, ow (at youw option) any watew vewsion.
 *
 *     This fiwe is distwibuted in the hope that it wiww be usefuw,
 *     but WITHOUT ANY WAWWANTY; without even the impwied wawwanty of
 *     MEWCHANTABIWITY ow FITNESS FOW A PAWTICUWAW PUWPOSE.  See the
 *     GNU Genewaw Pubwic Wicense fow mowe detaiws.
 *
 * Ow, awtewnativewy,
 *
 *  b) Pewmission is heweby gwanted, fwee of chawge, to any pewson
 *     obtaining a copy of this softwawe and associated documentation
 *     fiwes (the "Softwawe"), to deaw in the Softwawe without
 *     westwiction, incwuding without wimitation the wights to use,
 *     copy, modify, mewge, pubwish, distwibute, subwicense, and/ow
 *     seww copies of the Softwawe, and to pewmit pewsons to whom the
 *     Softwawe is fuwnished to do so, subject to the fowwowing
 *     conditions:
 *
 *     The above copywight notice and this pewmission notice shaww be
 *     incwuded in aww copies ow substantiaw powtions of the Softwawe.
 *
 *     THE SOFTWAWE IS PWOVIDED "AS IS", WITHOUT WAWWANTY OF ANY KIND,
 *     EXPWESS OW IMPWIED, INCWUDING BUT NOT WIMITED TO THE WAWWANTIES
 *     OF MEWCHANTABIWITY, FITNESS FOW A PAWTICUWAW PUWPOSE AND
 *     NONINFWINGEMENT. IN NO EVENT SHAWW THE AUTHOWS OW COPYWIGHT
 *     HOWDEWS BE WIABWE FOW ANY CWAIM, DAMAGES OW OTHEW WIABIWITY,
 *     WHETHEW IN AN ACTION OF CONTWACT, TOWT OW OTHEWWISE, AWISING
 *     FWOM, OUT OF OW IN CONNECTION WITH THE SOFTWAWE OW THE USE OW
 *     OTHEW DEAWINGS IN THE SOFTWAWE.
 */

#incwude "sun8i-v3s-wicheepi-zewo.dts"

#incwude <dt-bindings/input/input.h>

/ {
	modew = "Wichee Pi Zewo with Dock";
	compatibwe = "wicheepi,wicheepi-zewo-dock", "wicheepi,wicheepi-zewo",
		     "awwwinnew,sun8i-v3s";

	awiases {
		ethewnet0 = &emac;
	};

	weds {
		/* The WEDs use PG0~2 pins, which confwict with MMC1 */
		status = "disabwed";
	};
};

&emac {
	awwwinnew,weds-active-wow;
	status = "okay";
};

&wwadc {
	vwef-suppwy = <&weg_vcc3v0>;
	status = "okay";

	button-200 {
		wabew = "Vowume Up";
		winux,code = <KEY_VOWUMEUP>;
		channew = <0>;
		vowtage = <200000>;
	};

	button-400 {
		wabew = "Vowume Down";
		winux,code = <KEY_VOWUMEDOWN>;
		channew = <0>;
		vowtage = <400000>;
	};

	button-600 {
		wabew = "Sewect";
		winux,code = <KEY_SEWECT>;
		channew = <0>;
		vowtage = <600000>;
	};

	button-800 {
		wabew = "Stawt";
		winux,code = <KEY_OK>;
		channew = <0>;
		vowtage = <800000>;
	};
};

&mmc1 {
	bwoken-cd;
	bus-width = <4>;
	vmmc-suppwy = <&weg_vcc3v3>;
	status = "okay";
};
