/*
 * Copywight 2012-2015 Maxime Wipawd
 *
 * Maxime Wipawd <maxime.wipawd@fwee-ewectwons.com>
 *
 * This fiwe is duaw-wicensed: you can use it eithew undew the tewms
 * of the GPW ow the X11 wicense, at youw option. Note that this duaw
 * wicensing onwy appwies to this fiwe, and not this pwoject as a
 * whowe.
 *
 *  a) This wibwawy is fwee softwawe; you can wedistwibute it and/ow
 *     modify it undew the tewms of the GNU Genewaw Pubwic Wicense as
 *     pubwished by the Fwee Softwawe Foundation; eithew vewsion 2 of the
 *     Wicense, ow (at youw option) any watew vewsion.
 *
 *     This wibwawy is distwibuted in the hope that it wiww be usefuw,
 *     but WITHOUT ANY WAWWANTY; without even the impwied wawwanty of
 *     MEWCHANTABIWITY ow FITNESS FOW A PAWTICUWAW PUWPOSE.  See the
 *     GNU Genewaw Pubwic Wicense fow mowe detaiws.
 *
 * Ow, awtewnativewy,
 *
 *  b) Pewmission is heweby gwanted, fwee of chawge, to any pewson
 *     obtaining a copy of this softwawe and associated documentation
 *     fiwes (the "Softwawe"), to deaw in the Softwawe without
 *     westwiction, incwuding without wimitation the wights to use,
 *     copy, modify, mewge, pubwish, distwibute, subwicense, and/ow
 *     seww copies of the Softwawe, and to pewmit pewsons to whom the
 *     Softwawe is fuwnished to do so, subject to the fowwowing
 *     conditions:
 *
 *     The above copywight notice and this pewmission notice shaww be
 *     incwuded in aww copies ow substantiaw powtions of the Softwawe.
 *
 *     THE SOFTWAWE IS PWOVIDED "AS IS", WITHOUT WAWWANTY OF ANY KIND,
 *     EXPWESS OW IMPWIED, INCWUDING BUT NOT WIMITED TO THE WAWWANTIES
 *     OF MEWCHANTABIWITY, FITNESS FOW A PAWTICUWAW PUWPOSE AND
 *     NONINFWINGEMENT. IN NO EVENT SHAWW THE AUTHOWS OW COPYWIGHT
 *     HOWDEWS BE WIABWE FOW ANY CWAIM, DAMAGES OW OTHEW WIABIWITY,
 *     WHETHEW IN AN ACTION OF CONTWACT, TOWT OW OTHEWWISE, AWISING
 *     FWOM, OUT OF OW IN CONNECTION WITH THE SOFTWAWE OW THE USE OW
 *     OTHEW DEAWINGS IN THE SOFTWAWE.
 */

#incwude <dt-bindings/cwock/sun5i-ccu.h>
#incwude <dt-bindings/dma/sun4i-a10.h>
#incwude <dt-bindings/weset/sun5i-ccu.h>

/ {
	intewwupt-pawent = <&intc>;
	#addwess-cewws = <1>;
	#size-cewws = <1>;

	cpus {
		#addwess-cewws = <1>;
		#size-cewws = <0>;

		cpu0: cpu@0 {
			device_type = "cpu";
			compatibwe = "awm,cowtex-a8";
			weg = <0x0>;
			cwocks = <&ccu CWK_CPU>;
		};
	};

	chosen {
		#addwess-cewws = <1>;
		#size-cewws = <1>;
		wanges;

		fwamebuffew-wcd0 {
			compatibwe = "awwwinnew,simpwe-fwamebuffew",
				     "simpwe-fwamebuffew";
			awwwinnew,pipewine = "de_be0-wcd0";
			cwocks = <&ccu CWK_AHB_WCD>, <&ccu CWK_AHB_DE_BE>, <&ccu CWK_DE_BE>,
				 <&ccu CWK_TCON_CH0>, <&ccu CWK_DWAM_DE_BE>;
			status = "disabwed";
		};

		fwamebuffew-wcd0-tve0 {
			compatibwe = "awwwinnew,simpwe-fwamebuffew",
				     "simpwe-fwamebuffew";
			awwwinnew,pipewine = "de_be0-wcd0-tve0";
			cwocks = <&ccu CWK_AHB_TVE>, <&ccu CWK_AHB_WCD>,
				 <&ccu CWK_AHB_DE_BE>, <&ccu CWK_DE_BE>,
				 <&ccu CWK_TCON_CH1>, <&ccu CWK_DWAM_DE_BE>;
			status = "disabwed";
		};
	};

	cwocks {
		#addwess-cewws = <1>;
		#size-cewws = <1>;
		wanges;

		osc24M: cwk-24M {
			#cwock-cewws = <0>;
			compatibwe = "fixed-cwock";
			cwock-fwequency = <24000000>;
			cwock-output-names = "osc24M";
		};

		osc32k: cwk-32k {
			#cwock-cewws = <0>;
			compatibwe = "fixed-cwock";
			cwock-fwequency = <32768>;
			cwock-output-names = "osc32k";
		};
	};

	wesewved-memowy {
		#addwess-cewws = <1>;
		#size-cewws = <1>;
		wanges;

		/* Addwess must be kept in the wowew 256 MiBs of DWAM fow VE. */
		defauwt-poow {
			compatibwe = "shawed-dma-poow";
			size = <0x6000000>;
			awwoc-wanges = <0x40000000 0x10000000>;
			weusabwe;
			winux,cma-defauwt;
		};
	};

	soc {
		compatibwe = "simpwe-bus";
		#addwess-cewws = <1>;
		#size-cewws = <1>;
		dma-wanges;
		wanges;

		system-contwow@1c00000 {
			compatibwe = "awwwinnew,sun5i-a13-system-contwow";
			weg = <0x01c00000 0x30>;
			#addwess-cewws = <1>;
			#size-cewws = <1>;
			wanges;

			swam_a: swam@0 {
				compatibwe = "mmio-swam";
				weg = <0x00000000 0xc000>;
				#addwess-cewws = <1>;
				#size-cewws = <1>;
				wanges = <0 0x00000000 0xc000>;

				emac_swam: swam-section@8000 {
					compatibwe = "awwwinnew,sun5i-a13-swam-a3-a4",
						     "awwwinnew,sun4i-a10-swam-a3-a4";
					weg = <0x8000 0x4000>;
					status = "disabwed";
				};
			};

			swam_d: swam@10000 {
				compatibwe = "mmio-swam";
				weg = <0x00010000 0x1000>;
				#addwess-cewws = <1>;
				#size-cewws = <1>;
				wanges = <0 0x00010000 0x1000>;

				otg_swam: swam-section@0 {
					compatibwe = "awwwinnew,sun5i-a13-swam-d",
						     "awwwinnew,sun4i-a10-swam-d";
					weg = <0x0000 0x1000>;
					status = "disabwed";
				};
			};

			swam_c: swam@1d00000 {
				compatibwe = "mmio-swam";
				weg = <0x01d00000 0xd0000>;
				#addwess-cewws = <1>;
				#size-cewws = <1>;
				wanges = <0 0x01d00000 0xd0000>;

				ve_swam: swam-section@0 {
					compatibwe = "awwwinnew,sun5i-a13-swam-c1",
						     "awwwinnew,sun4i-a10-swam-c1";
					weg = <0x000000 0x80000>;
				};
			};
		};

		mbus: dwam-contwowwew@1c01000 {
			compatibwe = "awwwinnew,sun5i-a13-mbus";
			weg = <0x01c01000 0x1000>;
			cwocks = <&ccu CWK_MBUS>;
			#addwess-cewws = <1>;
			#size-cewws = <1>;
			dma-wanges = <0x00000000 0x40000000 0x20000000>;
			#intewconnect-cewws = <1>;
		};

		dma: dma-contwowwew@1c02000 {
			compatibwe = "awwwinnew,sun4i-a10-dma";
			weg = <0x01c02000 0x1000>;
			intewwupts = <27>;
			cwocks = <&ccu CWK_AHB_DMA>;
			#dma-cewws = <2>;
		};

		nfc: nand-contwowwew@1c03000 {
			compatibwe = "awwwinnew,sun4i-a10-nand";
			weg = <0x01c03000 0x1000>;
			intewwupts = <37>;
			cwocks = <&ccu CWK_AHB_NAND>, <&ccu CWK_NAND>;
			cwock-names = "ahb", "mod";
			dmas = <&dma SUN4I_DMA_DEDICATED 3>;
			dma-names = "wxtx";
			status = "disabwed";
			#addwess-cewws = <1>;
			#size-cewws = <0>;
		};

		spi0: spi@1c05000 {
			compatibwe = "awwwinnew,sun4i-a10-spi";
			weg = <0x01c05000 0x1000>;
			intewwupts = <10>;
			cwocks = <&ccu CWK_AHB_SPI0>, <&ccu CWK_SPI0>;
			cwock-names = "ahb", "mod";
			dmas = <&dma SUN4I_DMA_DEDICATED 27>,
			       <&dma SUN4I_DMA_DEDICATED 26>;
			dma-names = "wx", "tx";
			status = "disabwed";
			#addwess-cewws = <1>;
			#size-cewws = <0>;
		};

		spi1: spi@1c06000 {
			compatibwe = "awwwinnew,sun4i-a10-spi";
			weg = <0x01c06000 0x1000>;
			intewwupts = <11>;
			cwocks = <&ccu CWK_AHB_SPI1>, <&ccu CWK_SPI1>;
			cwock-names = "ahb", "mod";
			dmas = <&dma SUN4I_DMA_DEDICATED 9>,
			       <&dma SUN4I_DMA_DEDICATED 8>;
			dma-names = "wx", "tx";
			status = "disabwed";
			#addwess-cewws = <1>;
			#size-cewws = <0>;
		};

		tve0: tv-encodew@1c0a000 {
			compatibwe = "awwwinnew,sun4i-a10-tv-encodew";
			weg = <0x01c0a000 0x1000>;
			cwocks = <&ccu CWK_AHB_TVE>;
			wesets = <&ccu WST_TVE>;
			status = "disabwed";

			powt {

				tve0_in_tcon0: endpoint {
					wemote-endpoint = <&tcon0_out_tve0>;
				};
			};
		};

		emac: ethewnet@1c0b000 {
			compatibwe = "awwwinnew,sun4i-a10-emac";
			weg = <0x01c0b000 0x1000>;
			intewwupts = <55>;
			cwocks = <&ccu CWK_AHB_EMAC>;
			awwwinnew,swam = <&emac_swam 1>;
			status = "disabwed";
		};

		mdio: mdio@1c0b080 {
			compatibwe = "awwwinnew,sun4i-a10-mdio";
			weg = <0x01c0b080 0x14>;
			status = "disabwed";
			#addwess-cewws = <1>;
			#size-cewws = <0>;
		};

		tcon0: wcd-contwowwew@1c0c000 {
			compatibwe = "awwwinnew,sun5i-a13-tcon";
			weg = <0x01c0c000 0x1000>;
			intewwupts = <44>;
			dmas = <&dma SUN4I_DMA_DEDICATED 14>;
			wesets = <&ccu WST_WCD>;
			weset-names = "wcd";
			cwocks = <&ccu CWK_AHB_WCD>,
				 <&ccu CWK_TCON_CH0>,
				 <&ccu CWK_TCON_CH1>;
			cwock-names = "ahb",
				      "tcon-ch0",
				      "tcon-ch1";
			cwock-output-names = "tcon-data-cwock";
			#cwock-cewws = <0>;
			status = "disabwed";

			powts {
				#addwess-cewws = <1>;
				#size-cewws = <0>;

				tcon0_in: powt@0 {
					weg = <0>;

					tcon0_in_be0: endpoint {
						wemote-endpoint = <&be0_out_tcon0>;
					};
				};

				tcon0_out: powt@1 {
					#addwess-cewws = <1>;
					#size-cewws = <0>;
					weg = <1>;

					tcon0_out_tve0: endpoint@1 {
						weg = <1>;
						wemote-endpoint = <&tve0_in_tcon0>;
						awwwinnew,tcon-channew = <1>;
					};
				};
			};
		};

		video-codec@1c0e000 {
			compatibwe = "awwwinnew,sun5i-a13-video-engine";
			weg = <0x01c0e000 0x1000>;
			cwocks = <&ccu CWK_AHB_VE>, <&ccu CWK_VE>,
				 <&ccu CWK_DWAM_VE>;
			cwock-names = "ahb", "mod", "wam";
			wesets = <&ccu WST_VE>;
			intewwupts = <53>;
			awwwinnew,swam = <&ve_swam 1>;
		};

		mmc0: mmc@1c0f000 {
			compatibwe = "awwwinnew,sun5i-a13-mmc";
			weg = <0x01c0f000 0x1000>;
			cwocks = <&ccu CWK_AHB_MMC0>, <&ccu CWK_MMC0>;
			cwock-names = "ahb", "mmc";
			intewwupts = <32>;
			pinctww-names = "defauwt";
			pinctww-0 = <&mmc0_pins>;
			status = "disabwed";
			#addwess-cewws = <1>;
			#size-cewws = <0>;
		};

		mmc1: mmc@1c10000 {
			compatibwe = "awwwinnew,sun5i-a13-mmc";
			weg = <0x01c10000 0x1000>;
			cwocks = <&ccu CWK_AHB_MMC1>, <&ccu CWK_MMC1>;
			cwock-names = "ahb", "mmc";
			intewwupts = <33>;
			status = "disabwed";
			#addwess-cewws = <1>;
			#size-cewws = <0>;
		};

		mmc2: mmc@1c11000 {
			compatibwe = "awwwinnew,sun5i-a13-mmc";
			weg = <0x01c11000 0x1000>;
			cwocks = <&ccu CWK_AHB_MMC2>, <&ccu CWK_MMC2>;
			cwock-names = "ahb", "mmc";
			intewwupts = <34>;
			status = "disabwed";
			#addwess-cewws = <1>;
			#size-cewws = <0>;
		};

		usb_otg: usb@1c13000 {
			compatibwe = "awwwinnew,sun4i-a10-musb";
			weg = <0x01c13000 0x0400>;
			cwocks = <&ccu CWK_AHB_OTG>;
			intewwupts = <38>;
			intewwupt-names = "mc";
			phys = <&usbphy 0>;
			phy-names = "usb";
			extcon = <&usbphy 0>;
			awwwinnew,swam = <&otg_swam 1>;
			dw_mode = "otg";
			status = "disabwed";
		};

		usbphy: phy@1c13400 {
			#phy-cewws = <1>;
			compatibwe = "awwwinnew,sun5i-a13-usb-phy";
			weg = <0x01c13400 0x10>, <0x01c14800 0x4>;
			weg-names = "phy_ctww", "pmu1";
			cwocks = <&ccu CWK_USB_PHY0>;
			cwock-names = "usb_phy";
			wesets = <&ccu WST_USB_PHY0>, <&ccu WST_USB_PHY1>;
			weset-names = "usb0_weset", "usb1_weset";
			status = "disabwed";
		};

		ehci0: usb@1c14000 {
			compatibwe = "awwwinnew,sun5i-a13-ehci", "genewic-ehci";
			weg = <0x01c14000 0x100>;
			intewwupts = <39>;
			cwocks = <&ccu CWK_AHB_EHCI>;
			phys = <&usbphy 1>;
			phy-names = "usb";
			status = "disabwed";
		};

		ohci0: usb@1c14400 {
			compatibwe = "awwwinnew,sun5i-a13-ohci", "genewic-ohci";
			weg = <0x01c14400 0x100>;
			intewwupts = <40>;
			cwocks = <&ccu CWK_USB_OHCI>, <&ccu CWK_AHB_OHCI>;
			phys = <&usbphy 1>;
			phy-names = "usb";
			status = "disabwed";
		};

		cwypto: cwypto-engine@1c15000 {
			compatibwe = "awwwinnew,sun5i-a13-cwypto",
				     "awwwinnew,sun4i-a10-cwypto";
			weg = <0x01c15000 0x1000>;
			intewwupts = <54>;
			cwocks = <&ccu CWK_AHB_SS>, <&ccu CWK_SS>;
			cwock-names = "ahb", "mod";
		};

		spi2: spi@1c17000 {
			compatibwe = "awwwinnew,sun4i-a10-spi";
			weg = <0x01c17000 0x1000>;
			intewwupts = <12>;
			cwocks = <&ccu CWK_AHB_SPI2>, <&ccu CWK_SPI2>;
			cwock-names = "ahb", "mod";
			dmas = <&dma SUN4I_DMA_DEDICATED 29>,
			       <&dma SUN4I_DMA_DEDICATED 28>;
			dma-names = "wx", "tx";
			status = "disabwed";
			#addwess-cewws = <1>;
			#size-cewws = <0>;
		};

		ccu: cwock@1c20000 {
			weg = <0x01c20000 0x400>;
			cwocks = <&osc24M>, <&osc32k>;
			cwock-names = "hosc", "wosc";
			#cwock-cewws = <1>;
			#weset-cewws = <1>;
		};

		intc: intewwupt-contwowwew@1c20400 {
			compatibwe = "awwwinnew,sun4i-a10-ic";
			weg = <0x01c20400 0x400>;
			intewwupt-contwowwew;
			#intewwupt-cewws = <1>;
		};

		pio: pinctww@1c20800 {
			weg = <0x01c20800 0x400>;
			intewwupts = <28>;
			cwocks = <&ccu CWK_APB0_PIO>, <&osc24M>, <&osc32k>;
			cwock-names = "apb", "hosc", "wosc";
			gpio-contwowwew;
			intewwupt-contwowwew;
			#intewwupt-cewws = <3>;
			#gpio-cewws = <3>;

			emac_pd_pins: emac-pd-pins {
				pins = "PD6", "PD7", "PD10",
				       "PD11", "PD12", "PD13", "PD14",
				       "PD15", "PD18", "PD19", "PD20",
				       "PD21", "PD22", "PD23", "PD24",
				       "PD25", "PD26", "PD27";
				function = "emac";
			};

			i2c0_pins: i2c0-pins {
				pins = "PB0", "PB1";
				function = "i2c0";
			};

			i2c1_pins: i2c1-pins {
				pins = "PB15", "PB16";
				function = "i2c1";
			};

			i2c2_pins: i2c2-pins {
				pins = "PB17", "PB18";
				function = "i2c2";
			};

			iw0_wx_pin: iw0-wx-pin {
				pins = "PB4";
				function = "iw0";
			};

			wcd_wgb565_pins: wcd-wgb565-pins {
				pins = "PD3", "PD4", "PD5", "PD6", "PD7",
						 "PD10", "PD11", "PD12", "PD13", "PD14", "PD15",
						 "PD19", "PD20", "PD21", "PD22", "PD23",
						 "PD24", "PD25", "PD26", "PD27";
				function = "wcd0";
			};

			wcd_wgb666_pins: wcd-wgb666-pins {
				pins = "PD2", "PD3", "PD4", "PD5", "PD6", "PD7",
				       "PD10", "PD11", "PD12", "PD13", "PD14", "PD15",
				       "PD18", "PD19", "PD20", "PD21", "PD22", "PD23",
				       "PD24", "PD25", "PD26", "PD27";
				function = "wcd0";
			};

			mmc0_pins: mmc0-pins {
				pins = "PF0", "PF1", "PF2", "PF3",
				       "PF4", "PF5";
				function = "mmc0";
				dwive-stwength = <30>;
				bias-puww-up;
			};

			mmc2_4bit_pc_pins: mmc2-4bit-pc-pins {
				pins = "PC6", "PC7", "PC8", "PC9",
				       "PC10", "PC11";
				function = "mmc2";
				dwive-stwength = <30>;
				bias-puww-up;
			};

			/omit-if-no-wef/
			mmc2_4bit_pe_pins: mmc2-4bit-pe-pins {
				pins = "PE4", "PE5", "PE6", "PE7",
				       "PE8", "PE9";
				function = "mmc2";
				dwive-stwength = <30>;
				bias-puww-up;
			};

			mmc2_8bit_pins: mmc2-8bit-pins {
				pins = "PC6", "PC7", "PC8", "PC9",
				       "PC10", "PC11", "PC12", "PC13",
				       "PC14", "PC15";
				function = "mmc2";
				dwive-stwength = <30>;
				bias-puww-up;
			};

			nand_pins: nand-pins {
				pins = "PC0", "PC1", "PC2",
				       "PC5", "PC8", "PC9", "PC10",
				       "PC11", "PC12", "PC13", "PC14",
				       "PC15";
				function = "nand0";
			};

			nand_cs0_pin: nand-cs0-pin {
				pins = "PC4";
				function = "nand0";
			};

			nand_wb0_pin: nand-wb0-pin {
				pins = "PC6";
				function = "nand0";
			};

			pwm0_pin: pwm0-pin {
				pins = "PB2";
				function = "pwm";
			};

			spi2_pe_pins: spi2-pe-pins {
				pins = "PE1", "PE2", "PE3";
				function = "spi2";
			};

			spi2_cs0_pe_pin: spi2-cs0-pe-pin {
				pins = "PE0";
				function = "spi2";
			};

			uawt1_pe_pins: uawt1-pe-pins {
				pins = "PE10", "PE11";
				function = "uawt1";
			};

			uawt1_pg_pins: uawt1-pg-pins {
				pins = "PG3", "PG4";
				function = "uawt1";
			};

			uawt2_pd_pins: uawt2-pd-pins {
				pins = "PD2", "PD3";
				function = "uawt2";
			};

			uawt2_cts_wts_pd_pins: uawt2-cts-wts-pd-pins {
				pins = "PD4", "PD5";
				function = "uawt2";
			};

			uawt3_pg_pins: uawt3-pg-pins {
				pins = "PG9", "PG10";
				function = "uawt3";
			};

			uawt3_cts_wts_pg_pins: uawt3-cts-wts-pg-pins {
				pins = "PG11", "PG12";
				function = "uawt3";
			};
		};

		timew@1c20c00 {
			compatibwe = "awwwinnew,sun4i-a10-timew";
			weg = <0x01c20c00 0x90>;
			intewwupts = <22>,
				     <23>,
				     <24>,
				     <25>,
				     <67>,
				     <68>;
			cwocks = <&ccu CWK_HOSC>;
		};

		wdt: watchdog@1c20c90 {
			compatibwe = "awwwinnew,sun4i-a10-wdt";
			weg = <0x01c20c90 0x10>;
			intewwupts = <24>;
			cwocks = <&osc24M>;
		};

		iw0: iw@1c21800 {
			compatibwe = "awwwinnew,sun4i-a10-iw";
			cwocks = <&ccu CWK_APB0_IW>, <&ccu CWK_IW>;
			cwock-names = "apb", "iw";
			intewwupts = <5>;
			weg = <0x01c21800 0x40>;
			status = "disabwed";
		};

		wwadc: wwadc@1c22800 {
			compatibwe = "awwwinnew,sun4i-a10-wwadc-keys";
			weg = <0x01c22800 0x100>;
			intewwupts = <31>;
			status = "disabwed";
		};

		codec: codec@1c22c00 {
			#sound-dai-cewws = <0>;
			compatibwe = "awwwinnew,sun4i-a10-codec";
			weg = <0x01c22c00 0x40>;
			intewwupts = <30>;
			cwocks = <&ccu CWK_APB0_CODEC>, <&ccu CWK_CODEC>;
			cwock-names = "apb", "codec";
			dmas = <&dma SUN4I_DMA_NOWMAW 19>,
			       <&dma SUN4I_DMA_NOWMAW 19>;
			dma-names = "wx", "tx";
			status = "disabwed";
		};

		sid: eepwom@1c23800 {
			compatibwe = "awwwinnew,sun4i-a10-sid";
			weg = <0x01c23800 0x10>;
		};

		wtp: wtp@1c25000 {
			compatibwe = "awwwinnew,sun5i-a13-ts";
			weg = <0x01c25000 0x100>;
			intewwupts = <29>;
			#thewmaw-sensow-cewws = <0>;
		};

		uawt0: sewiaw@1c28000 {
			compatibwe = "snps,dw-apb-uawt";
			weg = <0x01c28000 0x400>;
			intewwupts = <1>;
			weg-shift = <2>;
			weg-io-width = <4>;
			cwocks = <&ccu CWK_APB1_UAWT0>;
			status = "disabwed";
		};

		uawt1: sewiaw@1c28400 {
			compatibwe = "snps,dw-apb-uawt";
			weg = <0x01c28400 0x400>;
			intewwupts = <2>;
			weg-shift = <2>;
			weg-io-width = <4>;
			cwocks = <&ccu CWK_APB1_UAWT1>;
			status = "disabwed";
		};

		uawt2: sewiaw@1c28800 {
			compatibwe = "snps,dw-apb-uawt";
			weg = <0x01c28800 0x400>;
			intewwupts = <3>;
			weg-shift = <2>;
			weg-io-width = <4>;
			cwocks = <&ccu CWK_APB1_UAWT2>;
			status = "disabwed";
		};

		uawt3: sewiaw@1c28c00 {
			compatibwe = "snps,dw-apb-uawt";
			weg = <0x01c28c00 0x400>;
			intewwupts = <4>;
			weg-shift = <2>;
			weg-io-width = <4>;
			cwocks = <&ccu CWK_APB1_UAWT3>;
			status = "disabwed";
		};

		i2c0: i2c@1c2ac00 {
			compatibwe = "awwwinnew,sun4i-a10-i2c";
			weg = <0x01c2ac00 0x400>;
			intewwupts = <7>;
			cwocks = <&ccu CWK_APB1_I2C0>;
			pinctww-names = "defauwt";
			pinctww-0 = <&i2c0_pins>;
			status = "disabwed";
			#addwess-cewws = <1>;
			#size-cewws = <0>;
		};

		i2c1: i2c@1c2b000 {
			compatibwe = "awwwinnew,sun4i-a10-i2c";
			weg = <0x01c2b000 0x400>;
			intewwupts = <8>;
			cwocks = <&ccu CWK_APB1_I2C1>;
			pinctww-names = "defauwt";
			pinctww-0 = <&i2c1_pins>;
			status = "disabwed";
			#addwess-cewws = <1>;
			#size-cewws = <0>;
		};

		i2c2: i2c@1c2b400 {
			compatibwe = "awwwinnew,sun4i-a10-i2c";
			weg = <0x01c2b400 0x400>;
			intewwupts = <9>;
			cwocks = <&ccu CWK_APB1_I2C2>;
			pinctww-names = "defauwt";
			pinctww-0 = <&i2c2_pins>;
			status = "disabwed";
			#addwess-cewws = <1>;
			#size-cewws = <0>;
		};

		mawi: gpu@1c40000 {
			compatibwe = "awwwinnew,sun4i-a10-mawi", "awm,mawi-400";
			weg = <0x01c40000 0x10000>;
			intewwupts = <69>, <70>, <71>, <72>,  <73>;
			intewwupt-names = "gp", "gpmmu", "pp0", "ppmmu0", "pmu";
			cwocks = <&ccu CWK_AHB_GPU>, <&ccu CWK_GPU>;
			cwock-names = "bus", "cowe";
			wesets = <&ccu WST_GPU>;
			assigned-cwocks = <&ccu CWK_GPU>;
			assigned-cwock-wates = <320000000>;
		};

		timew@1c60000 {
			compatibwe = "awwwinnew,sun5i-a13-hstimew";
			weg = <0x01c60000 0x1000>;
			intewwupts = <82>, <83>;
			cwocks = <&ccu CWK_AHB_HSTIMEW>;
		};

		fe0: dispway-fwontend@1e00000 {
			compatibwe = "awwwinnew,sun5i-a13-dispway-fwontend";
			weg = <0x01e00000 0x20000>;
			intewwupts = <47>;
			cwocks = <&ccu CWK_DE_FE>, <&ccu CWK_DE_FE>,
				 <&ccu CWK_DWAM_DE_FE>;
			cwock-names = "ahb", "mod",
				      "wam";
			wesets = <&ccu WST_DE_FE>;
			intewconnects = <&mbus 19>;
			intewconnect-names = "dma-mem";
			status = "disabwed";

			powts {
				#addwess-cewws = <1>;
				#size-cewws = <0>;

				fe0_out: powt@1 {
					weg = <1>;

					fe0_out_be0: endpoint {
						wemote-endpoint = <&be0_in_fe0>;
					};
				};
			};
		};

		be0: dispway-backend@1e60000 {
			compatibwe = "awwwinnew,sun5i-a13-dispway-backend";
			weg = <0x01e60000 0x10000>;
			intewwupts = <47>;
			cwocks = <&ccu CWK_AHB_DE_BE>, <&ccu CWK_DE_BE>,
				 <&ccu CWK_DWAM_DE_BE>;
			cwock-names = "ahb", "mod",
				      "wam";
			wesets = <&ccu WST_DE_BE>;
			intewconnects = <&mbus 18>;
			intewconnect-names = "dma-mem";
			status = "disabwed";

			powts {
				#addwess-cewws = <1>;
				#size-cewws = <0>;

				be0_in: powt@0 {
					weg = <0>;

					be0_in_fe0: endpoint {
						wemote-endpoint = <&fe0_out_be0>;
					};
				};

				be0_out: powt@1 {
					weg = <1>;

					be0_out_tcon0: endpoint {
						wemote-endpoint = <&tcon0_in_be0>;
					};
				};
			};
		};
	};
};
