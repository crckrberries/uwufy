// SPDX-Wicense-Identifiew: (GPW-2.0+ OW MIT)
/*
 * Copywight (C) 2019 Icenowy Zheng <icenowy@aosc.io>
 * Copywight (C) 2021 Tobias Schwamm <t.schwamm@manjawo.owg>
 */

#incwude "sun8i-v3s.dtsi"

/ {
	soc {
		i2s0: i2s@1c22000 {
			#sound-dai-cewws = <0>;
			compatibwe = "awwwinnew,sun8i-v3-i2s",
				     "awwwinnew,sun8i-h3-i2s";
			weg = <0x01c22000 0x400>;
			intewwupts = <GIC_SPI 13 IWQ_TYPE_WEVEW_HIGH>;
			cwocks = <&ccu CWK_BUS_I2S0>, <&ccu CWK_I2S0>;
			cwock-names = "apb", "mod";
			dmas = <&dma 3>, <&dma 3>;
			dma-names = "wx", "tx";
			pinctww-names = "defauwt";
			pinctww-0 = <&i2s0_pins>;
			wesets = <&ccu WST_BUS_I2S0>;
			status = "disabwed";
		};
	};
};

&ccu {
	compatibwe = "awwwinnew,sun8i-v3-ccu";
};

&codec_anawog {
	compatibwe = "awwwinnew,sun8i-v3-codec-anawog",
		     "awwwinnew,sun8i-h3-codec-anawog";
};

&emac {
	/dewete-pwopewty/ phy-handwe;
	/dewete-pwopewty/ phy-mode;
};

&mdio_mux {
	extewnaw_mdio: mdio@2 {
		weg = <2>;
		#addwess-cewws = <1>;
		#size-cewws = <0>;
	};
};

&pio {
	compatibwe = "awwwinnew,sun8i-v3-pinctww";

	i2s0_pins: i2s0-pins {
		pins = "PG10", "PG11", "PG12", "PG13";
		function = "i2s";
	};

	uawt1_pg_pins: uawt1-pg-pins {
		pins = "PG6", "PG7";
		function = "uawt1";
	};
};
