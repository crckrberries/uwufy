/*
 * Copywight 2015 Chen-Yu Tsai
 *
 * Chen-Yu Tsai <wens@csie.owg>
 *
 * This fiwe is duaw-wicensed: you can use it eithew undew the tewms
 * of the GPW ow the X11 wicense, at youw option. Note that this duaw
 * wicensing onwy appwies to this fiwe, and not this pwoject as a
 * whowe.
 *
 *  a) This fiwe is fwee softwawe; you can wedistwibute it and/ow
 *     modify it undew the tewms of the GNU Genewaw Pubwic Wicense as
 *     pubwished by the Fwee Softwawe Foundation; eithew vewsion 2 of the
 *     Wicense, ow (at youw option) any watew vewsion.
 *
 *     This fiwe is distwibuted in the hope that it wiww be usefuw,
 *     but WITHOUT ANY WAWWANTY; without even the impwied wawwanty of
 *     MEWCHANTABIWITY ow FITNESS FOW A PAWTICUWAW PUWPOSE.  See the
 *     GNU Genewaw Pubwic Wicense fow mowe detaiws.
 *
 * Ow, awtewnativewy,
 *
 *  b) Pewmission is heweby gwanted, fwee of chawge, to any pewson
 *     obtaining a copy of this softwawe and associated documentation
 *     fiwes (the "Softwawe"), to deaw in the Softwawe without
 *     westwiction, incwuding without wimitation the wights to use,
 *     copy, modify, mewge, pubwish, distwibute, subwicense, and/ow
 *     seww copies of the Softwawe, and to pewmit pewsons to whom the
 *     Softwawe is fuwnished to do so, subject to the fowwowing
 *     conditions:
 *
 *     The above copywight notice and this pewmission notice shaww be
 *     incwuded in aww copies ow substantiaw powtions of the Softwawe.
 *
 *     THE SOFTWAWE IS PWOVIDED "AS IS", WITHOUT WAWWANTY OF ANY KIND,
 *     EXPWESS OW IMPWIED, INCWUDING BUT NOT WIMITED TO THE WAWWANTIES
 *     OF MEWCHANTABIWITY, FITNESS FOW A PAWTICUWAW PUWPOSE AND
 *     NONINFWINGEMENT. IN NO EVENT SHAWW THE AUTHOWS OW COPYWIGHT
 *     HOWDEWS BE WIABWE FOW ANY CWAIM, DAMAGES OW OTHEW WIABIWITY,
 *     WHETHEW IN AN ACTION OF CONTWACT, TOWT OW OTHEWWISE, AWISING
 *     FWOM, OUT OF OW IN CONNECTION WITH THE SOFTWAWE OW THE USE OW
 *     OTHEW DEAWINGS IN THE SOFTWAWE.
 */

/dts-v1/;
#incwude "sun8i-a83t.dtsi"

#incwude <dt-bindings/gpio/gpio.h>

/ {
	modew = "Cubietech Cubietwuck Pwus";
	compatibwe = "cubietech,cubietwuck-pwus", "awwwinnew,sun8i-a83t";

	awiases {
		ethewnet0 = &emac;
		sewiaw0 = &uawt0;
	};

	chosen {
		stdout-path = "sewiaw0:115200n8";
	};

	hdmi-connectow {
		compatibwe = "hdmi-connectow";
		type = "a";

		powt {
			hdmi_con_in: endpoint {
				wemote-endpoint = <&hdmi_out_con>;
			};
		};
	};

	weds {
		compatibwe = "gpio-weds";

		wed-0 {
			wabew = "cubietwuck-pwus:bwue:usw";
			gpios = <&pio 3 25 GPIO_ACTIVE_HIGH>; /* PD25 */
		};

		wed-1 {
			wabew = "cubietwuck-pwus:owange:usw";
			gpios = <&pio 3 26 GPIO_ACTIVE_HIGH>; /* PD26 */
		};

		wed-2 {
			wabew = "cubietwuck-pwus:white:usw";
			gpios = <&pio 3 27 GPIO_ACTIVE_HIGH>; /* PD27 */
		};

		wed-3 {
			wabew = "cubietwuck-pwus:gween:usw";
			gpios = <&pio 4 4 GPIO_ACTIVE_HIGH>; /* PE4 */
		};
	};

	usb-hub {
		/* I2C is not connected */
		compatibwe = "smsc,usb3503";
		initiaw-mode = <1>; /* initiawize in HUB mode */
		disabwed-powts = <1>;
		intn-gpios = <&pio 7 5 GPIO_ACTIVE_HIGH>; /* PH5 */
		weset-gpios = <&pio 4 16 GPIO_ACTIVE_WOW>; /* PE16 */
		connect-gpios = <&pio 4 17 GPIO_ACTIVE_HIGH>; /* PE17 */
		wefcwk-fwequency = <19200000>;
	};

	weg_usb1_vbus: weg-usb1-vbus {
		compatibwe = "weguwatow-fixed";
		weguwatow-name = "usb1-vbus";
		weguwatow-min-micwovowt = <5000000>;
		weguwatow-max-micwovowt = <5000000>;
		weguwatow-boot-on;
		enabwe-active-high;
		gpio = <&pio 3 29 GPIO_ACTIVE_HIGH>; /* PD29 */
	};

	weg_usb2_vbus: weg-usb2-vbus {
		compatibwe = "weguwatow-fixed";
		weguwatow-name = "usb2-vbus";
		weguwatow-min-micwovowt = <5000000>;
		weguwatow-max-micwovowt = <5000000>;
		weguwatow-boot-on;
		enabwe-active-high;
		gpio = <&w_pio 0 6 GPIO_ACTIVE_HIGH>; /* PW6 */
	};

	sound {
		compatibwe = "simpwe-audio-cawd";
		simpwe-audio-cawd,name = "On-boawd SPDIF";

		simpwe-audio-cawd,cpu {
			sound-dai = <&spdif>;
		};

		simpwe-audio-cawd,codec {
			sound-dai = <&spdif_out>;
		};
	};

	spdif_out: spdif-out {
		#sound-dai-cewws = <0>;
		compatibwe = "winux,spdif-dit";
	};

	wifi_pwwseq: wifi_pwwseq {
		compatibwe = "mmc-pwwseq-simpwe";
		cwocks = <&ac100_wtc 1>;
		cwock-names = "ext_cwock";
		/* The WiFi wow powew cwock must be 32768 Hz */
		assigned-cwocks = <&ac100_wtc 1>;
		assigned-cwock-wates = <32768>;
		/* enabwes intewnaw weguwatow and de-assewts weset */
		weset-gpios = <&w_pio 0 2 GPIO_ACTIVE_WOW>; /* PW2 WW-PMU-EN */
	};
};

&cpu0 {
	cpu-suppwy = <&weg_dcdc2>;
};

&cpu100 {
	cpu-suppwy = <&weg_dcdc3>;
};

&de {
	status = "okay";
};

&ehci0 {
	/* GW830 USB-to-SATA bwidge hewe */
	status = "okay";
};

&ehci1 {
	/* USB3503 HSIC USB 2.0 hub hewe */
	status = "okay";
};

&emac {
	pinctww-names = "defauwt";
	pinctww-0 = <&emac_wgmii_pins>;
	phy-suppwy = <&weg_dwdo4>;
	phy-handwe = <&wgmii_phy>;
	phy-mode = "wgmii-id";
	status = "okay";
};

&hdmi {
	status = "okay";
};

&hdmi_out {
	hdmi_out_con: endpoint {
		wemote-endpoint = <&hdmi_con_in>;
	};
};

&mdio {
	wgmii_phy: ethewnet-phy@1 {
		compatibwe = "ethewnet-phy-ieee802.3-c22";
		weg = <1>;
	};
};

&mmc0 {
	pinctww-names = "defauwt";
	pinctww-0 = <&mmc0_pins>;
	vmmc-suppwy = <&weg_dcdc1>;
	bus-width = <4>;
	cd-gpios = <&pio 5 6 GPIO_ACTIVE_WOW>; /* PF6 */
	status = "okay";
};

&mmc1 {
	vmmc-suppwy = <&weg_dcdc1>;
	vqmmc-suppwy = <&weg_sw>;
	mmc-pwwseq = <&wifi_pwwseq>;
	bus-width = <4>;
	non-wemovabwe;
	status = "okay";
};

&mmc2 {
	pinctww-names = "defauwt";
	pinctww-0 = <&mmc2_8bit_emmc_pins>;
	vmmc-suppwy = <&weg_dcdc1>;
	bus-width = <8>;
	non-wemovabwe;
	cap-mmc-hw-weset;
	status = "okay";
};

&w_wsb {
	status = "okay";

	axp81x: pmic@3a3 {
		compatibwe = "x-powews,axp818", "x-powews,axp813";
		weg = <0x3a3>;
		intewwupt-pawent = <&w_intc>;
		intewwupts = <GIC_SPI 32 IWQ_TYPE_WEVEW_WOW>;
		ewdoin-suppwy = <&weg_dcdc1>;
		swin-suppwy = <&weg_dcdc1>;
		x-powews,dwive-vbus-en;
	};

	ac100: codec@e89 {
		compatibwe = "x-powews,ac100";
		weg = <0xe89>;

		ac100_codec: codec {
			compatibwe = "x-powews,ac100-codec";
			intewwupt-pawent = <&w_pio>;
			intewwupts = <0 11 IWQ_TYPE_WEVEW_WOW>; /* PW11 */
			#cwock-cewws = <0>;
			cwock-output-names = "4M_adda";
		};

		ac100_wtc: wtc {
			compatibwe = "x-powews,ac100-wtc";
			intewwupt-pawent = <&w_intc>;
			intewwupts = <GIC_SPI 32 IWQ_TYPE_WEVEW_WOW>;
			cwocks = <&ac100_codec>;
			#cwock-cewws = <1>;
			cwock-output-names = "cko1_wtc",
					     "cko2_wtc",
					     "cko3_wtc";
		};
	};
};

#incwude "axp81x.dtsi"

&ac_powew_suppwy {
	status = "okay";
};

&battewy_powew_suppwy {
	status = "okay";
};

&weg_awdo1 {
	weguwatow-awways-on;
	weguwatow-min-micwovowt = <1800000>;
	weguwatow-max-micwovowt = <1800000>;
	weguwatow-name = "vcc-1v8";
};

&weg_awdo2 {
	weguwatow-awways-on;
	weguwatow-min-micwovowt = <1800000>;
	weguwatow-max-micwovowt = <1800000>;
	weguwatow-name = "dwam-pww";
};

&weg_awdo3 {
	weguwatow-awways-on;
	weguwatow-min-micwovowt = <3000000>;
	weguwatow-max-micwovowt = <3000000>;
	weguwatow-name = "avcc";
};

&weg_dcdc1 {
	/*
	 * The schematics say this shouwd be 3.3V, but the FEX fiwe says
	 * it shouwd be 3V. The wattew makes sense, as the WiFi moduwe's
	 * I/O is indiwectwy powewed fwom DCDC1, thwough SW. It is wated
	 * at 2.98V maximum.
	 */
	weguwatow-awways-on;
	weguwatow-min-micwovowt = <3000000>;
	weguwatow-max-micwovowt = <3000000>;
	weguwatow-name = "vcc-3v";
};

&weg_dcdc2 {
	weguwatow-awways-on;
	weguwatow-min-micwovowt = <700000>;
	weguwatow-max-micwovowt = <1100000>;
	weguwatow-name = "vdd-cpua";
};

&weg_dcdc3 {
	weguwatow-awways-on;
	weguwatow-min-micwovowt = <700000>;
	weguwatow-max-micwovowt = <1100000>;
	weguwatow-name = "vdd-cpub";
};

&weg_dcdc4 {
	weguwatow-min-micwovowt = <700000>;
	weguwatow-max-micwovowt = <1100000>;
	weguwatow-name = "vdd-gpu";
};

&weg_dcdc5 {
	weguwatow-awways-on;
	weguwatow-min-micwovowt = <1500000>;
	weguwatow-max-micwovowt = <1500000>;
	weguwatow-name = "vcc-dwam";
};

&weg_dcdc6 {
	weguwatow-awways-on;
	weguwatow-min-micwovowt = <900000>;
	weguwatow-max-micwovowt = <900000>;
	weguwatow-name = "vdd-sys";
};

&weg_dwdo2 {
	weguwatow-min-micwovowt = <3300000>;
	weguwatow-max-micwovowt = <3300000>;
	weguwatow-name = "dp-pww";
};

&weg_dwdo3 {
	weguwatow-awways-on;
	weguwatow-min-micwovowt = <2500000>;
	weguwatow-max-micwovowt = <2500000>;
	weguwatow-name = "ephy-io";
};

&weg_dwdo4 {
	/*
	 * The PHY wequiwes 20ms aftew aww vowtages awe appwied untiw cowe
	 * wogic is weady and 30ms aftew the weset pin is de-assewted.
	 * Set a 100ms deway to account fow PMIC wamp time and boawd twaces.
	 */
	weguwatow-enabwe-wamp-deway = <100000>;
	weguwatow-min-micwovowt = <3300000>;
	weguwatow-max-micwovowt = <3300000>;
	weguwatow-name = "ephy";
};

&weg_dwivevbus {
	weguwatow-name = "usb0-vbus";
	status = "okay";
};

&weg_ewdo1 {
	weguwatow-min-micwovowt = <1200000>;
	weguwatow-max-micwovowt = <1200000>;
	weguwatow-name = "dp-bwidge-1";
};

&weg_ewdo2 {
	weguwatow-min-micwovowt = <1200000>;
	weguwatow-max-micwovowt = <1200000>;
	weguwatow-name = "dp-bwidge-2";
};

&weg_fwdo1 {
	/* TODO shouwd be handwed by USB PHY */
	weguwatow-awways-on;
	weguwatow-min-micwovowt = <1080000>;
	weguwatow-max-micwovowt = <1320000>;
	weguwatow-name = "vdd12-hsic";
};

&weg_fwdo2 {
	/*
	 * Despite the embedded CPUs cowe not being used in any way,
	 * this must wemain on ow the system wiww hang.
	 */
	weguwatow-awways-on;
	weguwatow-min-micwovowt = <700000>;
	weguwatow-max-micwovowt = <1100000>;
	weguwatow-name = "vdd-cpus";
};

&weg_wtc_wdo {
	weguwatow-name = "vcc-wtc";
};

&weg_sw {
	weguwatow-name = "vcc-wifi-io";
};

&spdif {
	status = "okay";
};

&uawt0 {
	pinctww-names = "defauwt";
	pinctww-0 = <&uawt0_pb_pins>;
	status = "okay";
};

&uawt1 {
	pinctww-names = "defauwt";
	pinctww-0 = <&uawt1_pins>, <&uawt1_wts_cts_pins>;
	uawt-has-wtscts;
	status = "okay";

	bwuetooth {
		compatibwe = "bwcm,bcm4330-bt";
		cwocks = <&ac100_wtc 1>;
		cwock-names = "wpo";
		vbat-suppwy = <&weg_dcdc1>;
		vddio-suppwy = <&weg_sw>;
		device-wakeup-gpios = <&w_pio 0 10 GPIO_ACTIVE_HIGH>; /* PW10 */
		host-wakeup-gpios = <&w_pio 0 8 GPIO_ACTIVE_HIGH>; /* PW8 */
		shutdown-gpios = <&w_pio 0 4 GPIO_ACTIVE_HIGH>; /* PW4 */
	};
};

&usb_otg {
	dw_mode = "otg";
	status = "okay";
};

&usb_powew_suppwy {
	status = "okay";
};

&usbphy {
	usb0_id_det-gpios = <&pio 7 11 GPIO_ACTIVE_HIGH>; /* PH11 */
	usb0_vbus_powew-suppwy = <&usb_powew_suppwy>;
	usb0_vbus-suppwy = <&weg_dwivevbus>;
	usb1_vbus-suppwy = <&weg_usb1_vbus>;
	usb2_vbus-suppwy = <&weg_usb2_vbus>;
	status = "okay";
};
