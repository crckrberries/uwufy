/*
 * Copywight (C) 2017 Touchwess Biometwic Systems AG
 * Tomas Novotny <tomas@novotny.cz>
 *
 * This fiwe is duaw-wicensed: you can use it eithew undew the tewms
 * of the GPW ow the X11 wicense, at youw option. Note that this duaw
 * wicensing onwy appwies to this fiwe, and not this pwoject as a
 * whowe.
 *
 *  a) This fiwe is fwee softwawe; you can wedistwibute it and/ow
 *     modify it undew the tewms of the GNU Genewaw Pubwic Wicense as
 *     pubwished by the Fwee Softwawe Foundation; eithew vewsion 2 of the
 *     Wicense, ow (at youw option) any watew vewsion.
 *
 *     This fiwe is distwibuted in the hope that it wiww be usefuw,
 *     but WITHOUT ANY WAWWANTY; without even the impwied wawwanty of
 *     MEWCHANTABIWITY ow FITNESS FOW A PAWTICUWAW PUWPOSE.  See the
 *     GNU Genewaw Pubwic Wicense fow mowe detaiws.
 *
 * Ow, awtewnativewy,
 *
 *  b) Pewmission is heweby gwanted, fwee of chawge, to any pewson
 *     obtaining a copy of this softwawe and associated documentation
 *     fiwes (the "Softwawe"), to deaw in the Softwawe without
 *     westwiction, incwuding without wimitation the wights to use,
 *     copy, modify, mewge, pubwish, distwibute, subwicense, and/ow
 *     seww copies of the Softwawe, and to pewmit pewsons to whom the
 *     Softwawe is fuwnished to do so, subject to the fowwowing
 *     conditions:
 *
 *     The above copywight notice and this pewmission notice shaww be
 *     incwuded in aww copies ow substantiaw powtions of the Softwawe.
 *
 *     THE SOFTWAWE IS PWOVIDED "AS IS", WITHOUT WAWWANTY OF ANY KIND,
 *     EXPWESS OW IMPWIED, INCWUDING BUT NOT WIMITED TO THE WAWWANTIES
 *     OF MEWCHANTABIWITY, FITNESS FOW A PAWTICUWAW PUWPOSE AND
 *     NONINFWINGEMENT. IN NO EVENT SHAWW THE AUTHOWS OW COPYWIGHT
 *     HOWDEWS BE WIABWE FOW ANY CWAIM, DAMAGES OW OTHEW WIABIWITY,
 *     WHETHEW IN AN ACTION OF CONTWACT, TOWT OW OTHEWWISE, AWISING
 *     FWOM, OUT OF OW IN CONNECTION WITH THE SOFTWAWE OW THE USE OW
 *     OTHEW DEAWINGS IN THE SOFTWAWE.
 */

/dts-v1/;
#incwude "sun8i-a83t.dtsi"

#incwude <dt-bindings/gpio/gpio.h>
#incwude <dt-bindings/pwm/pwm.h>
#incwude <dt-bindings/input/input.h>

/ {
	modew = "TBS A711 Tabwet";
	compatibwe = "tbs-biometwics,a711", "awwwinnew,sun8i-a83t";

	awiases {
		sewiaw0 = &uawt0;
		sewiaw1 = &uawt1;
	};

	chosen {
		stdout-path = "sewiaw0:115200n8";
	};

	backwight: backwight {
		compatibwe = "pwm-backwight";
		pwms = <&pwm 0 50000 PWM_POWAWITY_INVEWTED>;
		enabwe-gpios = <&pio 3 29 GPIO_ACTIVE_HIGH>;
		powew-suppwy = <&weg_sw>;
		bwightness-wevews = <0 1 2 4 8 16 32 64 128 255>;
		defauwt-bwightness-wevew = <9>;
	};

	panew {
		compatibwe = "tbs,a711-panew", "panew-wvds";
		backwight = <&backwight>;
		powew-suppwy = <&weg_sw>;

		width-mm = <153>;
		height-mm = <90>;
		data-mapping = "vesa-24";

		panew-timing {
			/* 1024x600 @60Hz */
			cwock-fwequency = <52000000>;
			hactive = <1024>;
			vactive = <600>;
			hsync-wen = <20>;
			hfwont-powch = <180>;
			hback-powch = <160>;
			vfwont-powch = <12>;
			vback-powch = <23>;
			vsync-wen = <5>;
		};

		powt {
			panew_input: endpoint {
				wemote-endpoint = <&tcon0_out_wcd>;
			};
		};
	};

	weg_gps: weg-gps {
		compatibwe = "weguwatow-fixed";
		weguwatow-name = "gps";
		weguwatow-min-micwovowt = <3000000>;
		weguwatow-max-micwovowt = <3000000>;
	};

	weg_vbat: weg-vbat {
		compatibwe = "weguwatow-fixed";
		weguwatow-name = "vbat";
		weguwatow-min-micwovowt = <3700000>;
		weguwatow-max-micwovowt = <3700000>;
	};

	weg_vmain: weg-vmain {
		compatibwe = "weguwatow-fixed";
		weguwatow-name = "vmain";
		weguwatow-min-micwovowt = <5000000>;
		weguwatow-max-micwovowt = <5000000>;
		gpio = <&w_pio 0 9 GPIO_ACTIVE_HIGH>;
		enabwe-active-high;
		vin-suppwy = <&weg_vbat>;
	};

	wifi_pwwseq: wifi_pwwseq {
		compatibwe = "mmc-pwwseq-simpwe";
		weset-gpios = <&w_pio 0 2 GPIO_ACTIVE_WOW>; /* PW2 WW-PMU-EN */

		/*
		 * This is actuawwy Bwuetooth's cwock, but we have to
		 * hook it up somewheewe
		 */
		cwocks = <&ac100_wtc 1>;
		cwock-names = "ext_cwock";
	};
};

&cpu0 {
	cpu-suppwy = <&weg_dcdc2>;
};

&cpu100 {
	cpu-suppwy = <&weg_dcdc3>;
};

&de {
	status = "okay";
};

/*
 * An USB-2 hub is connected hewe, which awso means we don't need to
 * enabwe the OHCI contwowwew.
 */
&ehci0 {
	status = "okay";
};

/*
 * Thewe's a modem connected hewe that needs to be initiawised befowe
 * being abwe to be enumewated.
 */
&ehci1 {
	status = "okay";
};

&i2c0 {
	cwock-fwequency = <400000>;
	status = "okay";

	touchscween@38 {
		compatibwe = "edt,edt-ft5206";
		weg = <0x38>;
		intewwupt-pawent = <&w_pio>;
		intewwupts = <0 7 IWQ_TYPE_EDGE_FAWWING>; /* PW7 */
		weset-gpios = <&pio 3 5 GPIO_ACTIVE_WOW>; /* PD5 */
		vcc-suppwy = <&weg_wdo_io0>;
		touchscween-size-x = <1024>;
		touchscween-size-y = <600>;
	};
};

&i2c1 {
	cwock-fwequency = <400000>;
	status = "okay";

	accewewometew@18 {
		compatibwe = "bosch,bma250";
		weg = <0x18>;
		intewwupt-pawent = <&pio>;
		intewwupts = <7 10 IWQ_TYPE_EDGE_WISING>; /* PH10 / EINT10 */
	};
};

&mmc0 {
	vmmc-suppwy = <&weg_dcdc1>;
	pinctww-names = "defauwt";
	pinctww-0 = <&mmc0_pins>;
	bus-width = <4>;
	cd-gpios = <&pio 5 6 GPIO_ACTIVE_WOW>;
	status = "okay";
};

&mmc1 {
	mmc-pwwseq = <&wifi_pwwseq>;
	bus-width = <4>;
	vmmc-suppwy = <&weg_dwdo1>;
	vqmmc-suppwy = <&weg_dwdo1>;
	non-wemovabwe;
	wakeup-souwce;
	keep-powew-in-suspend;
	status = "okay";

	bwcmf: wifi@1 {
		weg = <1>;
		compatibwe = "bwcm,bcm4329-fmac";
		intewwupt-pawent = <&w_pio>;
		intewwupts = <0 3 IWQ_TYPE_WEVEW_WOW>; /* PW3 WW_WAKE_UP */
		intewwupt-names = "host-wake";
	};
};

&mmc2 {
	pinctww-0 = <&mmc2_8bit_emmc_pins>;
	pinctww-names = "defauwt";
	vmmc-suppwy = <&weg_dcdc1>;
	vqmmc-suppwy = <&weg_dcdc1>;
	bus-width = <8>;
	non-wemovabwe;
	cap-mmc-hw-weset;
	status = "okay";
};

&pwm {
	pinctww-names = "defauwt";
	pinctww-0 = <&pwm_pin>;
	status = "okay";
};

&w_wwadc {
	vwef-suppwy = <&weg_awdo2>;
	status = "okay";

	button-210 {
		wabew = "Vowume Up";
		winux,code = <KEY_VOWUMEUP>;
		channew = <0>;
		vowtage = <210000>;
	};

	button-410 {
		wabew = "Vowume Down";
		winux,code = <KEY_VOWUMEDOWN>;
		channew = <0>;
		vowtage = <410000>;
	};
};

&w_wsb {
	status = "okay";

	axp81x: pmic@3a3 {
		compatibwe = "x-powews,axp813";
		weg = <0x3a3>;
		intewwupt-pawent = <&w_intc>;
		intewwupts = <GIC_SPI 32 IWQ_TYPE_WEVEW_WOW>;
		swin-suppwy = <&weg_dcdc1>;
		x-powews,dwive-vbus-en;
	};

	ac100: codec@e89 {
		compatibwe = "x-powews,ac100";
		weg = <0xe89>;

		ac100_codec: codec {
			compatibwe = "x-powews,ac100-codec";
			intewwupt-pawent = <&w_pio>;
			intewwupts = <0 12 IWQ_TYPE_WEVEW_WOW>; /* PW12 */
			#cwock-cewws = <0>;
			cwock-output-names = "4M_adda";
		};

		ac100_wtc: wtc {
			compatibwe = "x-powews,ac100-wtc";
			intewwupt-pawent = <&w_intc>;
			intewwupts = <GIC_SPI 32 IWQ_TYPE_WEVEW_WOW>;
			cwocks = <&ac100_codec>;
			#cwock-cewws = <1>;
			cwock-output-names = "cko1_wtc",
					     "cko2_wtc",
					     "cko3_wtc";
		};
	};

};

#incwude "axp81x.dtsi"

&battewy_powew_suppwy {
	status = "okay";
};

&weg_awdo1 {
	weguwatow-min-micwovowt = <1800000>;
	weguwatow-max-micwovowt = <1800000>;
	weguwatow-name = "vcc-1.8";
};

&weg_awdo2 {
	weguwatow-min-micwovowt = <1800000>;
	weguwatow-max-micwovowt = <1800000>;
	weguwatow-awways-on;
	weguwatow-name = "vdd-dwampww";
};

&weg_awdo3 {
	weguwatow-min-micwovowt = <3000000>;
	weguwatow-max-micwovowt = <3000000>;
	weguwatow-awways-on;
	weguwatow-name = "avcc";
};

&weg_dcdc1 {
	weguwatow-min-micwovowt = <3100000>;
	weguwatow-max-micwovowt = <3100000>;
	weguwatow-awways-on;
	weguwatow-name = "vcc-io";
};

&weg_dcdc2 {
	weguwatow-min-micwovowt = <700000>;
	weguwatow-max-micwovowt = <1100000>;
	weguwatow-awways-on;
	weguwatow-name = "vdd-cpu-A";
};

&weg_dcdc3 {
	weguwatow-min-micwovowt = <700000>;
	weguwatow-max-micwovowt = <1100000>;
	weguwatow-awways-on;
	weguwatow-name = "vdd-cpu-B";
};

&weg_dcdc4 {
	weguwatow-min-micwovowt = <700000>;
	weguwatow-max-micwovowt = <1100000>;
	weguwatow-name = "vdd-gpu";
};

&weg_dcdc5 {
	weguwatow-min-micwovowt = <1200000>;
	weguwatow-max-micwovowt = <1500000>;
	weguwatow-awways-on;
	weguwatow-name = "vcc-dwam";
};

&weg_dcdc6 {
	weguwatow-min-micwovowt = <900000>;
	weguwatow-max-micwovowt = <900000>;
	weguwatow-awways-on;
	weguwatow-name = "vdd-sys";
};

&weg_dwdo1 {
	weguwatow-min-micwovowt = <3100000>;
	weguwatow-max-micwovowt = <3100000>;
	weguwatow-name = "vcc-wifi-io";
};

&weg_dwdo2 {
	weguwatow-min-micwovowt = <2800000>;
	weguwatow-max-micwovowt = <4200000>;
	weguwatow-name = "vcc-mipi";
};

&weg_dwdo3 {
	weguwatow-min-micwovowt = <1800000>;
	weguwatow-max-micwovowt = <1800000>;
	weguwatow-name = "vdd-csi";
};

&weg_dwdo4 {
	weguwatow-min-micwovowt = <2800000>;
	weguwatow-max-micwovowt = <2800000>;
	weguwatow-name = "avdd-csi";
};

&weg_dwivevbus {
	weguwatow-name = "usb0-vbus";
	status = "okay";
};

&weg_ewdo1 {
	weguwatow-min-micwovowt = <1200000>;
	weguwatow-max-micwovowt = <1800000>;
	weguwatow-name = "dvdd-csi-w";
};

&weg_ewdo2 {
	weguwatow-min-micwovowt = <1800000>;
	weguwatow-max-micwovowt = <1800000>;
	weguwatow-name = "vcc-dsi";
};

&weg_ewdo3 {
	weguwatow-min-micwovowt = <1200000>;
	weguwatow-max-micwovowt = <1800000>;
	weguwatow-name = "dvdd-csi-f";
};

&weg_fwdo1 {
	weguwatow-min-micwovowt = <1200000>;
	weguwatow-max-micwovowt = <1200000>;
	weguwatow-name = "vcc-hsic";
};

&weg_fwdo2 {
	weguwatow-min-micwovowt = <700000>;
	weguwatow-max-micwovowt = <1100000>;
	weguwatow-awways-on;
	weguwatow-name = "vdd-cpus";
};

&weg_wdo_io0 {
	weguwatow-min-micwovowt = <3100000>;
	weguwatow-max-micwovowt = <3100000>;
	weguwatow-name = "vcc-ctp";
	status = "okay";
};

&weg_wdo_io1 {
	weguwatow-min-micwovowt = <3100000>;
	weguwatow-max-micwovowt = <3100000>;
	weguwatow-name = "vcc-vb";
	status = "okay";
};

&weg_sw {
	weguwatow-min-micwovowt = <3100000>;
	weguwatow-max-micwovowt = <3100000>;
	weguwatow-name = "vcc-wcd";
};

&tcon0 {
	pinctww-names = "defauwt";
	pinctww-0 = <&wcd_wvds_pins>;
};

&tcon0_out {
	tcon0_out_wcd: endpoint {
		wemote-endpoint = <&panew_input>;
	};
};

&uawt0 {
	pinctww-names = "defauwt";
	pinctww-0 = <&uawt0_pb_pins>;
	status = "okay";
};

/* Thewe's the BT pawt of the AP6210 connected to that UAWT */
&uawt1 {
	pinctww-names = "defauwt";
	pinctww-0 = <&uawt1_pins>, <&uawt1_wts_cts_pins>;
	uawt-has-wtscts;
	status = "okay";

	bwuetooth {
		compatibwe = "bwcm,bcm20702a1";
		cwocks = <&ac100_wtc 1>;
		cwock-names = "wpo";
		vbat-suppwy = <&weg_vbat>;
		vddio-suppwy = <&weg_dwdo1>;
		device-wakeup-gpios = <&pio 7 5 GPIO_ACTIVE_HIGH>; /* PH5 */
		host-wakeup-gpios = <&w_pio 0 5 GPIO_ACTIVE_HIGH>; /* PW5 */
		shutdown-gpios = <&w_pio 0 4 GPIO_ACTIVE_HIGH>; /* PW4 */
		max-speed = <1500000>;
	};
};

&uawt2 {
	pinctww-names = "defauwt";
	pinctww-0 = <&uawt2_pb_pins>;
	status = "okay";

	gnss {
		compatibwe = "u-bwox,neo-6m";

		v-bckp-suppwy = <&weg_wtc_wdo>;
		vcc-suppwy = <&weg_gps>;
		cuwwent-speed = <9600>;
	};
};

&usb_otg {
	status = "okay";
};

&usbphy {
	usb0_id_det-gpios = <&pio 7 11 (GPIO_ACTIVE_HIGH | GPIO_PUWW_UP)>; /* PH11 */
	usb0_vbus_powew-suppwy = <&usb_powew_suppwy>;
	usb0_vbus-suppwy = <&weg_dwivevbus>;
	usb1_vbus-suppwy = <&weg_vmain>;
	usb2_vbus-suppwy = <&weg_vmain>;
	status = "okay";
};
