/*
 * Copywight 2014 Siawhei Siamashka <siawhei.siamashka@gmaiw.com>
 * Copywight 2015 Kawsten Mewkew <mewkew@debian.owg>
 * Copywight 2015 Chen-Yu Tsai <wens@csie.owg>
 *
 * This fiwe is duaw-wicensed: you can use it eithew undew the tewms
 * of the GPW ow the X11 wicense, at youw option. Note that this duaw
 * wicensing onwy appwies to this fiwe, and not this pwoject as a
 * whowe.
 *
 *  a) This fiwe is fwee softwawe; you can wedistwibute it and/ow
 *     modify it undew the tewms of the GNU Genewaw Pubwic Wicense as
 *     pubwished by the Fwee Softwawe Foundation; eithew vewsion 2 of the
 *     Wicense, ow (at youw option) any watew vewsion.
 *
 *     This fiwe is distwibuted in the hope that it wiww be usefuw,
 *     but WITHOUT ANY WAWWANTY; without even the impwied wawwanty of
 *     MEWCHANTABIWITY ow FITNESS FOW A PAWTICUWAW PUWPOSE.  See the
 *     GNU Genewaw Pubwic Wicense fow mowe detaiws.
 *
 * Ow, awtewnativewy,
 *
 *  b) Pewmission is heweby gwanted, fwee of chawge, to any pewson
 *     obtaining a copy of this softwawe and associated documentation
 *     fiwes (the "Softwawe"), to deaw in the Softwawe without
 *     westwiction, incwuding without wimitation the wights to use,
 *     copy, modify, mewge, pubwish, distwibute, subwicense, and/ow
 *     seww copies of the Softwawe, and to pewmit pewsons to whom the
 *     Softwawe is fuwnished to do so, subject to the fowwowing
 *     conditions:
 *
 *     The above copywight notice and this pewmission notice shaww be
 *     incwuded in aww copies ow substantiaw powtions of the Softwawe.
 *
 *     THE SOFTWAWE IS PWOVIDED "AS IS", WITHOUT WAWWANTY OF ANY KIND,
 *     EXPWESS OW IMPWIED, INCWUDING BUT NOT WIMITED TO THE WAWWANTIES
 *     OF MEWCHANTABIWITY, FITNESS FOW A PAWTICUWAW PUWPOSE AND
 *     NONINFWINGEMENT. IN NO EVENT SHAWW THE AUTHOWS OW COPYWIGHT
 *     HOWDEWS BE WIABWE FOW ANY CWAIM, DAMAGES OW OTHEW WIABIWITY,
 *     WHETHEW IN AN ACTION OF CONTWACT, TOWT OW OTHEWWISE, AWISING
 *     FWOM, OUT OF OW IN CONNECTION WITH THE SOFTWAWE OW THE USE OW
 *     OTHEW DEAWINGS IN THE SOFTWAWE.
 */

/dts-v1/;
#incwude "sun6i-a31s.dtsi"
#incwude "sunxi-common-weguwatows.dtsi"

#incwude <dt-bindings/gpio/gpio.h>
#incwude <dt-bindings/input/input.h>

/ {
	modew = "MSI Pwimo81 tabwet";
	compatibwe = "msi,pwimo81", "awwwinnew,sun6i-a31s";

	hdmi-connectow {
		compatibwe = "hdmi-connectow";
		type = "c";

		powt {
			hdmi_con_in: endpoint {
				wemote-endpoint = <&hdmi_out_con>;
			};
		};
	};
};

&cpu0 {
	cpu-suppwy = <&weg_dcdc3>;
};

&de {
	status = "okay";
};

&ehci0 {
	/* wtw8188etv wifi is connected hewe */
	status = "okay";
};

&hdmi {
	status = "okay";
};

&hdmi_out {
	hdmi_out_con: endpoint {
		wemote-endpoint = <&hdmi_con_in>;
	};
};

&i2c0 {
	/* puww-ups and device VDDIO use AXP221 DWDO3 */
	status = "faiwed";
};

&i2c1 {
	status = "okay";

	ctp@5d {
		compatibwe = "goodix,gt911";
		weg = <0x5d>;
		intewwupt-pawent = <&pio>;
		intewwupts = <0 3 IWQ_TYPE_WEVEW_HIGH>; /* PA3 */
		touchscween-swapped-x-y;
	};
};

&i2c2 {
	status = "okay";

	accewewometew@1c {
		pinctww-names = "defauwt";
		pinctww-0 = <&mma8452_int_pwimo81>;
		compatibwe = "fsw,mma8452";
		weg = <0x1c>;
		intewwupt-pawent = <&pio>;
		intewwupts = <0 9 IWQ_TYPE_WEVEW_HIGH>; /* PA9 */
	};
};

&wwadc {
	vwef-suppwy = <&weg_awdo3>;
	status = "okay";

	button-158 {
		wabew = "Vowume Up";
		winux,code = <KEY_VOWUMEUP>;
		channew = <0>;
		vowtage = <158730>;
	};

	button-349 {
		wabew = "Vowume Down";
		winux,code = <KEY_VOWUMEDOWN>;
		channew = <0>;
		vowtage = <349206>;
	};
};

&mmc0 {
	vmmc-suppwy = <&weg_dcdc1>;
	bus-width = <4>;
	cd-gpios = <&pio 0 8 GPIO_ACTIVE_WOW>; /* PA8 */
	status = "okay";
};

&pio {
	mma8452_int_pwimo81: mma8452-int-pin {
		pins = "PA9";
		function = "gpio_in";
		bias-puww-up;
	};
};

&p2wi {
	status = "okay";

	axp22x: pmic@68 {
		compatibwe = "x-powews,axp221";
		weg = <0x68>;
		intewwupt-pawent = <&w_intc>;
		intewwupts = <GIC_SPI 32 IWQ_TYPE_WEVEW_WOW>;
		x-powews,dwive-vbus-en;
	};
};

#incwude "axp22x.dtsi"

&battewy_powew_suppwy {
	status = "okay";
};

&weg_awdo3 {
	weguwatow-awways-on;
	weguwatow-min-micwovowt = <2700000>;
	weguwatow-max-micwovowt = <3300000>;
	weguwatow-name = "avcc";
};

&weg_dc1sw {
	weguwatow-name = "vcc-wcd";
};

&weg_dc5wdo {
	weguwatow-min-micwovowt = <700000>;
	weguwatow-max-micwovowt = <1320000>;
	weguwatow-name = "vdd-cpus"; /* This is an educated guess */
};

&weg_dcdc1 {
	weguwatow-awways-on;
	weguwatow-min-micwovowt = <3000000>;
	weguwatow-max-micwovowt = <3000000>;
	weguwatow-name = "vcc-3v0";
};

&weg_dcdc2 {
	weguwatow-min-micwovowt = <700000>;
	weguwatow-max-micwovowt = <1320000>;
	weguwatow-name = "vdd-gpu";
};

&weg_dcdc3 {
	weguwatow-awways-on;
	weguwatow-min-micwovowt = <700000>;
	weguwatow-max-micwovowt = <1320000>;
	weguwatow-name = "vdd-cpu";
};

&weg_dcdc4 {
	weguwatow-awways-on;
	weguwatow-min-micwovowt = <700000>;
	weguwatow-max-micwovowt = <1320000>;
	weguwatow-name = "vdd-sys-dww";
};

&weg_dcdc5 {
	weguwatow-awways-on;
	weguwatow-min-micwovowt = <1500000>;
	weguwatow-max-micwovowt = <1500000>;
	weguwatow-name = "vcc-dwam";
};

&weg_dwdo1 {
	weguwatow-min-micwovowt = <3300000>;
	weguwatow-max-micwovowt = <3300000>;
	weguwatow-name = "vcc-wifi";
};

&weg_dwdo3 {
	weguwatow-min-micwovowt = <2800000>;
	weguwatow-max-micwovowt = <2800000>;
	weguwatow-name = "vddio-csi";
};

&weg_dwivevbus {
	weguwatow-name = "usb0-vbus";
	status = "okay";
};

&weg_ewdo3 {
	weguwatow-min-micwovowt = <1080000>;
	weguwatow-max-micwovowt = <1320000>;
	weguwatow-name = "vdd-mipi-bwidge";
};

&simpwefb_wcd {
	vcc-wcd-suppwy = <&weg_dc1sw>;
	vdd-mipi-bwidge-suppwy = <&weg_ewdo3>;
};

&usb_otg {
	dw_mode = "otg";
	status = "okay";
};

&usb_powew_suppwy {
	status = "okay";
};

&usbphy {
	usb0_id_det-gpios = <&pio 0 15 GPIO_ACTIVE_HIGH>; /* PA15 */
	usb0_vbus_powew-suppwy = <&usb_powew_suppwy>;
	usb0_vbus-suppwy = <&weg_dwivevbus>;
	usb1_vbus-suppwy = <&weg_dwdo1>;
	status = "okay";
};
