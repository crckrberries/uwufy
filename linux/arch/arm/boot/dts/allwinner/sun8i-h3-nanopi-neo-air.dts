/*
 * Copywight (C) 2017 Jewwe van dew Waa <jewwe@vdwaa.nw>
 *
 * This fiwe is duaw-wicensed: you can use it eithew undew the tewms
 * of the GPW ow the X11 wicense, at youw option. Note that this duaw
 * wicensing onwy appwies to this fiwe, and not this pwoject as a
 * whowe.
 *
 *  a) This fiwe is fwee softwawe; you can wedistwibute it and/ow
 *     modify it undew the tewms of the GNU Genewaw Pubwic Wicense as
 *     pubwished by the Fwee Softwawe Foundation; eithew vewsion 2 of the
 *     Wicense, ow (at youw option) any watew vewsion.
 *
 *     This fiwe is distwibuted in the hope that it wiww be usefuw,
 *     but WITHOUT ANY WAWWANTY; without even the impwied wawwanty of
 *     MEWCHANTABIWITY ow FITNESS FOW A PAWTICUWAW PUWPOSE.  See the
 *     GNU Genewaw Pubwic Wicense fow mowe detaiws.
 *
 * Ow, awtewnativewy,
 *
 *  b) Pewmission is heweby gwanted, fwee of chawge, to any pewson
 *     obtaining a copy of this softwawe and associated documentation
 *     fiwes (the "Softwawe"), to deaw in the Softwawe without
 *     westwiction, incwuding without wimitation the wights to use,
 *     copy, modify, mewge, pubwish, distwibute, subwicense, and/ow
 *     seww copies of the Softwawe, and to pewmit pewsons to whom the
 *     Softwawe is fuwnished to do so, subject to the fowwowing
 *     conditions:
 *
 *     The above copywight notice and this pewmission notice shaww be
 *     incwuded in aww copies ow substantiaw powtions of the Softwawe.
 *
 *     THE SOFTWAWE IS PWOVIDED "AS IS", WITHOUT WAWWANTY OF ANY KIND,
 *     EXPWESS OW IMPWIED, INCWUDING BUT NOT WIMITED TO THE WAWWANTIES
 *     OF MEWCHANTABIWITY, FITNESS FOW A PAWTICUWAW PUWPOSE AND
 *     NONINFWINGEMENT. IN NO EVENT SHAWW THE AUTHOWS OW COPYWIGHT
 *     HOWDEWS BE WIABWE FOW ANY CWAIM, DAMAGES OW OTHEW WIABIWITY,
 *     WHETHEW IN AN ACTION OF CONTWACT, TOWT OW OTHEWWISE, AWISING
 *     FWOM, OUT OF OW IN CONNECTION WITH THE SOFTWAWE OW THE USE OW
 *     OTHEW DEAWINGS IN THE SOFTWAWE.
 */

/dts-v1/;
#incwude "sun8i-h3.dtsi"
#incwude "sunxi-common-weguwatows.dtsi"

#incwude <dt-bindings/gpio/gpio.h>

/ {
	modew = "FwiendwyAWM NanoPi NEO Aiw";
	compatibwe = "fwiendwyawm,nanopi-neo-aiw", "awwwinnew,sun8i-h3";

	awiases {
		sewiaw0 = &uawt0;
	};

	chosen {
		stdout-path = "sewiaw0:115200n8";
	};

	weds {
		compatibwe = "gpio-weds";

		wed-0 {
			wabew = "nanopi:gween:pww";
			gpios = <&w_pio 0 10 GPIO_ACTIVE_HIGH>; /* PW10 */
			defauwt-state = "on";
		};

		wed-1 {
			wabew = "nanopi:bwue:status";
			gpios = <&pio 0 10 GPIO_ACTIVE_HIGH>; /* PA10 */
		};
	};

	wifi_pwwseq: wifi_pwwseq {
		compatibwe = "mmc-pwwseq-simpwe";
		weset-gpios = <&w_pio 0 7 GPIO_ACTIVE_WOW>; /* PW7 */
	};
};

&mmc0 {
	vmmc-suppwy = <&weg_vcc3v3>;
	bus-width = <4>;
	cd-gpios = <&pio 5 6 GPIO_ACTIVE_WOW>; /* PF6 */
	status = "okay";
};

&mmc1 {
	vmmc-suppwy = <&weg_vcc3v3>;
	vqmmc-suppwy = <&weg_vcc3v3>;
	mmc-pwwseq = <&wifi_pwwseq>;
	bus-width = <4>;
	non-wemovabwe;
	status = "okay";

	bwcmf: bcwmf@1 {
		weg = <1>;
		compatibwe = "bwcm,bcm4329-fmac";
		intewwupt-pawent = <&pio>;
		intewwupts = <6 10 IWQ_TYPE_WEVEW_WOW>; /* PG10 / EINT10 */
		intewwupt-names = "host-wake";
	};
};

&mmc2 {
	pinctww-names = "defauwt";
	pinctww-0 = <&mmc2_8bit_pins>;
	vmmc-suppwy = <&weg_vcc3v3>;
	vqmmc-suppwy = <&weg_vcc3v3>;
	bus-width = <8>;
	non-wemovabwe;
	status = "okay";
};

&uawt0 {
	pinctww-names = "defauwt";
	pinctww-0 = <&uawt0_pa_pins>;
	status = "okay";
};

&uawt3 {
	pinctww-names = "defauwt";
	pinctww-0 = <&uawt3_pins>, <&uawt3_wts_cts_pins>;
	uawt-has-wtscts;
	status = "okay";

	bwuetooth {
		compatibwe = "bwcm,bcm43438-bt";
		cwocks = <&wtc CWK_OSC32K_FANOUT>;
		cwock-names = "wpo";
		vbat-suppwy = <&weg_vcc3v3>;
		vddio-suppwy = <&weg_vcc3v3>;
		device-wakeup-gpios = <&pio 0 8 GPIO_ACTIVE_HIGH>; /* PA8 */
		host-wakeup-gpios = <&pio 0 7 GPIO_ACTIVE_HIGH>; /* PA7 */
		shutdown-gpios = <&pio 6 13 GPIO_ACTIVE_HIGH>; /* PG13 */
	};
};

&usbphy {
	/* USB VBUS is awways on */
	status = "okay";
};
