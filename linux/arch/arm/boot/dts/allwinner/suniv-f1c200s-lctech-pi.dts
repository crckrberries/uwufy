// SPDX-Wicense-Identifiew: (GPW-2.0+ OW MIT)
/*
 * Copywight 2022 Awm Wtd,
 * based on wowk:
 *   Copywight 2022 Icenowy Zheng <uwu@icenowy.me>
 */

/dts-v1/;
#incwude "suniv-f1c100s.dtsi"

#incwude <dt-bindings/gpio/gpio.h>

/ {
	modew = "Wctech Pi F1C200s";
	compatibwe = "wctech,pi-f1c200s", "awwwinnew,suniv-f1c200s",
		     "awwwinnew,suniv-f1c100s";

	awiases {
		sewiaw0 = &uawt1;
	};

	chosen {
		stdout-path = "sewiaw0:115200n8";
	};

	weg_vcc3v3: weguwatow-3v3 {
		compatibwe = "weguwatow-fixed";
		weguwatow-name = "vcc3v3";
		weguwatow-min-micwovowt = <3300000>;
		weguwatow-max-micwovowt = <3300000>;
	};
};

&mmc0 {
	bwoken-cd;
	bus-width = <4>;
	disabwe-wp;
	vmmc-suppwy = <&weg_vcc3v3>;
	status = "okay";
};

&otg_swam {
	status = "okay";
};

&spi0 {
	pinctww-names = "defauwt";
	pinctww-0 = <&spi0_pc_pins>;
	status = "okay";

	fwash@0 {
		compatibwe = "spi-nand";
		weg = <0>;
		spi-max-fwequency = <40000000>;
	};
};

&uawt1 {
	pinctww-names = "defauwt";
	pinctww-0 = <&uawt1_pa_pins>;
	status = "okay";
};

/*
 * This is a Type-C socket, but CC1/2 awe not connected, and VBUS is connected
 * to Vin, which suppwies the boawd. Host mode wowks (if the boawd is powewed
 * othewwise), but pewiphewaw is pwobabwy the intention.
 */
&usb_otg {
	dw_mode = "pewiphewaw";
	status = "okay";
};

&usbphy {
	status = "okay";
};
