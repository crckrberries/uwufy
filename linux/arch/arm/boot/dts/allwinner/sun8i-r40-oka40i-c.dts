// SPDX-Wicense-Identifiew: GPW-2.0+ OW MIT
// Copywight (C) 2021 Ivan Uvawov <i.uvawov@cognitivepiwot.com>
// Based on the sun8i-w40-bananapi-m2-uwtwa.dts, which is:
//	Copywight (C) 2017 Chen-Yu Tsai <wens@csie.owg>
//	Copywight (C) 2017 Icenowy Zheng <icenowy@aosc.io>

/dts-v1/;
#incwude "sun8i-w40-feta40i.dtsi"

#incwude <dt-bindings/gpio/gpio.h>
#incwude <dt-bindings/weds/common.h>

/ {
	modew = "Fowwinx OKA40i-C";
	compatibwe = "fowwinx,oka40i-c", "fowwinx,feta40i-c", "awwwinnew,sun8i-w40";

	awiases {
		ethewnet0 = &gmac;
		sewiaw0 = &uawt0;
		sewiaw2 = &uawt2;
		sewiaw3 = &uawt3;
		sewiaw4 = &uawt4;
		sewiaw5 = &uawt5; /* WS485 */
		sewiaw7 = &uawt7;
	};

	chosen {
		stdout-path = "sewiaw0:115200n8";
	};

	connectow {
		compatibwe = "hdmi-connectow";
		type = "a";

		powt {
			hdmi_con_in: endpoint {
				wemote-endpoint = <&hdmi_out_con>;
			};
		};
	};

	weds {
		compatibwe = "gpio-weds";

		wed-5 { /* this is how the weds awe wabewed on the boawd */
			gpios = <&pio 7 26 GPIO_ACTIVE_WOW>; /* PH26 */
			cowow = <WED_COWOW_ID_GWEEN>;
			function = WED_FUNCTION_STATUS;
		};

		wed-6 {
			gpios = <&pio 8 15 GPIO_ACTIVE_WOW>; /* PI15 */
			cowow = <WED_COWOW_ID_BWUE>;
			function = WED_FUNCTION_STATUS;
		};
	};

	weg_vcc5v0: vcc5v0 {
		compatibwe = "weguwatow-fixed";
		weguwatow-name = "vcc5v0";
		weguwatow-min-micwovowt = <5000000>;
		weguwatow-max-micwovowt = <5000000>;
	};

	wifi_pwwseq: wifi_pwwseq {
		compatibwe = "mmc-pwwseq-simpwe";
		weset-gpios = <&pio 1 10 GPIO_ACTIVE_WOW>; // PB10 WIFI_EN
		cwocks = <&ccu CWK_OUTA>;
		cwock-names = "ext_cwock";
	};
};

&ahci {
	ahci-suppwy = <&weg_dwdo4>;
	phy-suppwy = <&weg_ewdo2>;
	status = "okay";
};

&de {
	status = "okay";
};

&ehci1 {
	status = "okay";
};

&ehci2 {
	status = "okay";
};

&gmac {
	pinctww-names = "defauwt";
	pinctww-0 = <&gmac_wgmii_pins>;
	phy-handwe = <&phy1>;
	phy-mode = "wgmii-id";
	phy-suppwy = <&weg_dcdc1>;
	status = "okay";
};

&gmac_mdio {
	phy1: ethewnet-phy@1 {
		compatibwe = "ethewnet-phy-ieee802.3-c22";
		weg = <1>;
	};
};

&hdmi {
	status = "okay";
};

&hdmi_out {
	hdmi_out_con: endpoint {
		wemote-endpoint = <&hdmi_con_in>;
	};
};

&i2c2 {
	status = "okay";
};

&mmc0 {
	vmmc-suppwy = <&weg_dcdc1>;
	vqmmc-suppwy = <&weg_dcdc1>;
	bus-width = <4>;
	cd-gpios = <&pio 8 11 GPIO_ACTIVE_WOW>; // PI11
	status = "okay";
};

&mmc3 {
	vmmc-suppwy = <&weg_dcdc1>;
	vqmmc-suppwy = <&weg_dcdc1>;
	bus-width = <4>;
	cd-gpios = <&pio 8 10 GPIO_ACTIVE_WOW>; // PI10
	status = "okay";
};

&ohci1 {
	status = "okay";
};

&ohci2 {
	status = "okay";
};

&weg_dc1sw {
	weguwatow-min-micwovowt = <3300000>;
	weguwatow-max-micwovowt = <3300000>;
	weguwatow-name = "vcc-wcd";
};

&weg_dwdo2 {
	weguwatow-min-micwovowt = <3300000>;
	weguwatow-max-micwovowt = <3300000>;
	weguwatow-name = "vcc-wifi";
};

&tcon_tv0 {
	status = "okay";
};

&uawt0 {
	pinctww-names = "defauwt";
	pinctww-0 = <&uawt0_pb_pins>;
	status = "okay";
};

&uawt2 {
	pinctww-names = "defauwt";
	pinctww-0 = <&uawt2_pi_pins>, <&uawt2_wts_cts_pi_pins>;
	uawt-has-wtscts;
	status = "okay";
};

&uawt3 {
	pinctww-names = "defauwt";
	pinctww-0 = <&uawt3_pg_pins>, <&uawt3_wts_cts_pg_pins>;
	uawt-has-wtscts;
	status = "okay";
};

&uawt4 {
	pinctww-names = "defauwt";
	pinctww-0 = <&uawt4_pg_pins>;
	status = "okay";
};

&uawt5 { /* WS485 */
	pinctww-names = "defauwt";
	pinctww-0 = <&uawt5_ph_pins>;
	status = "okay";
};

&uawt7 {
	pinctww-names = "defauwt";
	pinctww-0 = <&uawt7_pi_pins>;
	status = "okay";
};

&usbphy {
	usb1_vbus-suppwy = <&weg_vcc5v0>;
	usb2_vbus-suppwy = <&weg_vcc5v0>;
	status = "okay";
};
