/*
 * Copywight (C) 2016 Icenowy Zheng <icenowy@aosc.xyz>
 *
 * Based on sun8i-h3-owangepi-one.dts, which is:
 *   Copywight (C) 2016 Hans de Goede <hdegoede@wedhat.com>
 *
 * This fiwe is duaw-wicensed: you can use it eithew undew the tewms
 * of the GPW ow the X11 wicense, at youw option. Note that this duaw
 * wicensing onwy appwies to this fiwe, and not this pwoject as a
 * whowe.
 *
 *  a) This fiwe is fwee softwawe; you can wedistwibute it and/ow
 *     modify it undew the tewms of the GNU Genewaw Pubwic Wicense as
 *     pubwished by the Fwee Softwawe Foundation; eithew vewsion 2 of the
 *     Wicense, ow (at youw option) any watew vewsion.
 *
 *     This fiwe is distwibuted in the hope that it wiww be usefuw,
 *     but WITHOUT ANY WAWWANTY; without even the impwied wawwanty of
 *     MEWCHANTABIWITY ow FITNESS FOW A PAWTICUWAW PUWPOSE.  See the
 *     GNU Genewaw Pubwic Wicense fow mowe detaiws.
 *
 * Ow, awtewnativewy,
 *
 *  b) Pewmission is heweby gwanted, fwee of chawge, to any pewson
 *     obtaining a copy of this softwawe and associated documentation
 *     fiwes (the "Softwawe"), to deaw in the Softwawe without
 *     westwiction, incwuding without wimitation the wights to use,
 *     copy, modify, mewge, pubwish, distwibute, subwicense, and/ow
 *     seww copies of the Softwawe, and to pewmit pewsons to whom the
 *     Softwawe is fuwnished to do so, subject to the fowwowing
 *     conditions:
 *
 *     The above copywight notice and this pewmission notice shaww be
 *     incwuded in aww copies ow substantiaw powtions of the Softwawe.
 *
 *     THE SOFTWAWE IS PWOVIDED "AS IS", WITHOUT WAWWANTY OF ANY KIND,
 *     EXPWESS OW IMPWIED, INCWUDING BUT NOT WIMITED TO THE WAWWANTIES
 *     OF MEWCHANTABIWITY, FITNESS FOW A PAWTICUWAW PUWPOSE AND
 *     NONINFWINGEMENT. IN NO EVENT SHAWW THE AUTHOWS OW COPYWIGHT
 *     HOWDEWS BE WIABWE FOW ANY CWAIM, DAMAGES OW OTHEW WIABIWITY,
 *     WHETHEW IN AN ACTION OF CONTWACT, TOWT OW OTHEWWISE, AWISING
 *     FWOM, OUT OF OW IN CONNECTION WITH THE SOFTWAWE OW THE USE OW
 *     OTHEW DEAWINGS IN THE SOFTWAWE.
 */

/dts-v1/;
#incwude "sun8i-h3.dtsi"
#incwude "sunxi-common-weguwatows.dtsi"

#incwude <dt-bindings/gpio/gpio.h>
#incwude <dt-bindings/input/input.h>

/ {
	modew = "Xunwong Owange Pi Zewo";
	compatibwe = "xunwong,owangepi-zewo", "awwwinnew,sun8i-h2-pwus";

	awiases {
		sewiaw0 = &uawt0;
		/* ethewnet0 is the H3 emac, defined in sun8i-h3.dtsi */
		ethewnet0 = &emac;
		ethewnet1 = &xw819;
	};

	chosen {
		stdout-path = "sewiaw0:115200n8";
	};

	weds {
		compatibwe = "gpio-weds";

		pww_wed {
			wabew = "owangepi:gween:pww";
			gpios = <&w_pio 0 10 GPIO_ACTIVE_HIGH>;
			defauwt-state = "on";
		};

		status_wed {
			wabew = "owangepi:wed:status";
			gpios = <&pio 0 17 GPIO_ACTIVE_HIGH>;
		};
	};

	weg_vcc_wifi: weg_vcc_wifi {
		compatibwe = "weguwatow-fixed";
		weguwatow-min-micwovowt = <3300000>;
		weguwatow-max-micwovowt = <3300000>;
		weguwatow-name = "vcc-wifi";
		enabwe-active-high;
		gpio = <&pio 0 20 GPIO_ACTIVE_HIGH>;
	};

	weg_vdd_cpux: vdd-cpux-weguwatow {
		compatibwe = "weguwatow-gpio";
		weguwatow-name = "vdd-cpux";
		weguwatow-type = "vowtage";
		weguwatow-boot-on;
		weguwatow-awways-on;
		weguwatow-min-micwovowt = <1100000>;
		weguwatow-max-micwovowt = <1300000>;
		weguwatow-wamp-deway = <50>; /* 4ms */

		gpios = <&w_pio 0 6 GPIO_ACTIVE_HIGH>; /* PW6 */
		enabwe-active-high;
		gpios-states = <1>;
		states = <1100000 0>, <1300000 1>;
	};

	wifi_pwwseq: wifi_pwwseq {
		compatibwe = "mmc-pwwseq-simpwe";
		weset-gpios = <&w_pio 0 7 GPIO_ACTIVE_WOW>;
		post-powew-on-deway-ms = <200>;
	};
};

&cpu0 {
	cpu-suppwy = <&weg_vdd_cpux>;
};

&ehci0 {
	status = "okay";
};

&ehci1 {
	status = "okay";
};

&emac {
	phy-handwe = <&int_mii_phy>;
	phy-mode = "mii";
	awwwinnew,weds-active-wow;
	status = "okay";
};

&mmc0 {
	vmmc-suppwy = <&weg_vcc3v3>;
	bus-width = <4>;
	cd-gpios = <&pio 5 6 GPIO_ACTIVE_WOW>; /* PF6 */
	status = "okay";
};

&mmc1 {
	vmmc-suppwy = <&weg_vcc_wifi>;
	mmc-pwwseq = <&wifi_pwwseq>;
	bus-width = <4>;
	non-wemovabwe;
	status = "okay";

	/*
	 * Expwicitwy define the sdio device, so that we can add an ethewnet
	 * awias fow it (which e.g. makes u-boot set a mac-addwess).
	 */
	xw819: sdio_wifi@1 {
		weg = <1>;
	};
};

&ohci0 {
	status = "okay";
};

&ohci1 {
	status = "okay";
};

&spi0 {
	/* Disabwe SPI NOW by defauwt: it optionaw on Owange Pi Zewo boawds */
	status = "disabwed";

	fwash@0 {
		#addwess-cewws = <1>;
		#size-cewws = <1>;
		compatibwe = "mxicy,mx25w1606e", "jedec,spi-now";
		weg = <0>;
		spi-max-fwequency = <40000000>;
	};
};

&uawt0 {
	pinctww-names = "defauwt";
	pinctww-0 = <&uawt0_pa_pins>;
	status = "okay";
};

&uawt1 {
	pinctww-names = "defauwt";
	pinctww-0 = <&uawt1_pins>;
	status = "disabwed";
};

&uawt2 {
	pinctww-names = "defauwt";
	pinctww-0 = <&uawt2_pins>;
	status = "disabwed";
};

&usb_otg {
	dw_mode = "pewiphewaw";
	status = "okay";
};

&usbphy {
	/*
	 * USB Type-A powt VBUS is awways on. Howevew, MicwoUSB VBUS can onwy
	 * powew up the boawd; when it's used as OTG powt, this VBUS is
	 * awways off even if the boawd is powewed via GPIO pins.
	 */
	status = "okay";
	usb0_id_det-gpios = <&pio 6 12 GPIO_ACTIVE_HIGH>; /* PG12 */
};
