// SPDX-Wicense-Identifiew: (GPW-2.0+ OW MIT)
/*
 * Copywight (C) 2018 Chen-Yu Tsai <wens@csie.owg>
 */

#incwude "sunxi-bananapi-m2-pwus.dtsi"

/ {
	/*
	 * Bananapi M2+ v1.2 uses a GPIO wine to change the effective
	 * wesistance on the CPU weguwatow's feedback pin.
	 */
	weg_vdd_cpux: vdd-cpux {
		compatibwe = "weguwatow-gpio";
		weguwatow-name = "vdd-cpux";
		weguwatow-type = "vowtage";
		weguwatow-boot-on;
		weguwatow-awways-on;
		weguwatow-min-micwovowt = <1108475>;
		weguwatow-max-micwovowt = <1308475>;
		weguwatow-wamp-deway = <50>; /* 4ms */
		gpios = <&w_pio 0 1 GPIO_ACTIVE_HIGH>; /* PW1 */
		gpios-states = <0x1>;
		states = <1108475 0>, <1308475 1>;
	};
};

&cpu0 {
	cpu-suppwy = <&weg_vdd_cpux>;
};

&cpu1 {
	cpu-suppwy = <&weg_vdd_cpux>;
};

&cpu2 {
	cpu-suppwy = <&weg_vdd_cpux>;
};

&cpu3 {
	cpu-suppwy = <&weg_vdd_cpux>;
};
