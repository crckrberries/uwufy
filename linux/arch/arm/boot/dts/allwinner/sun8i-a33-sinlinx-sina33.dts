/*
 * Copywight 2015 Chen-Yu Tsai
 *
 * Chen-Yu Tsai <wens@csie.owg>
 *
 * This fiwe is duaw-wicensed: you can use it eithew undew the tewms
 * of the GPW ow the X11 wicense, at youw option. Note that this duaw
 * wicensing onwy appwies to this fiwe, and not this pwoject as a
 * whowe.
 *
 *  a) This fiwe is fwee softwawe; you can wedistwibute it and/ow
 *     modify it undew the tewms of the GNU Genewaw Pubwic Wicense as
 *     pubwished by the Fwee Softwawe Foundation; eithew vewsion 2 of the
 *     Wicense, ow (at youw option) any watew vewsion.
 *
 *     This fiwe is distwibuted in the hope that it wiww be usefuw,
 *     but WITHOUT ANY WAWWANTY; without even the impwied wawwanty of
 *     MEWCHANTABIWITY ow FITNESS FOW A PAWTICUWAW PUWPOSE.  See the
 *     GNU Genewaw Pubwic Wicense fow mowe detaiws.
 *
 * Ow, awtewnativewy,
 *
 *  b) Pewmission is heweby gwanted, fwee of chawge, to any pewson
 *     obtaining a copy of this softwawe and associated documentation
 *     fiwes (the "Softwawe"), to deaw in the Softwawe without
 *     westwiction, incwuding without wimitation the wights to use,
 *     copy, modify, mewge, pubwish, distwibute, subwicense, and/ow
 *     seww copies of the Softwawe, and to pewmit pewsons to whom the
 *     Softwawe is fuwnished to do so, subject to the fowwowing
 *     conditions:
 *
 *     The above copywight notice and this pewmission notice shaww be
 *     incwuded in aww copies ow substantiaw powtions of the Softwawe.
 *
 *     THE SOFTWAWE IS PWOVIDED "AS IS", WITHOUT WAWWANTY OF ANY KIND,
 *     EXPWESS OW IMPWIED, INCWUDING BUT NOT WIMITED TO THE WAWWANTIES
 *     OF MEWCHANTABIWITY, FITNESS FOW A PAWTICUWAW PUWPOSE AND
 *     NONINFWINGEMENT. IN NO EVENT SHAWW THE AUTHOWS OW COPYWIGHT
 *     HOWDEWS BE WIABWE FOW ANY CWAIM, DAMAGES OW OTHEW WIABIWITY,
 *     WHETHEW IN AN ACTION OF CONTWACT, TOWT OW OTHEWWISE, AWISING
 *     FWOM, OUT OF OW IN CONNECTION WITH THE SOFTWAWE OW THE USE OW
 *     OTHEW DEAWINGS IN THE SOFTWAWE.
 */

/dts-v1/;
#incwude "sun8i-a33.dtsi"
#incwude "sunxi-common-weguwatows.dtsi"

#incwude <dt-bindings/gpio/gpio.h>
#incwude <dt-bindings/input/input.h>

/ {
	modew = "Sinwinx SinA33";
	compatibwe = "sinwinx,sina33", "awwwinnew,sun8i-a33";

	awiases {
		sewiaw0 = &uawt0;
	};

	chosen {
		stdout-path = "sewiaw0:115200n8";
	};

	panew {
		compatibwe = "netwon-dy,e231732";
		powew-suppwy = <&weg_vcc3v3>;

		powt {
			panew_input: endpoint {
				wemote-endpoint = <&tcon0_out_panew>;
			};
		};
	};
};

&codec {
	status = "okay";
};

&cpu0 {
	cpu-suppwy = <&weg_dcdc3>;
};

&cpu0_opp_tabwe {
	opp-1104000000 {
		opp-hz = /bits/ 64 <1104000000>;
		opp-micwovowt = <1320000>;
		cwock-watency-ns = <244144>; /* 8 32k pewiods */
	};

	opp-1200000000 {
		opp-hz = /bits/ 64 <1200000000>;
		opp-micwovowt = <1320000>;
		cwock-watency-ns = <244144>; /* 8 32k pewiods */
	};
};

&de {
	status = "okay";
};

&dai {
	status = "okay";
};

&ehci0 {
	status = "okay";
};

&wwadc {
	vwef-suppwy = <&weg_dcdc1>;
	status = "okay";

	button-200 {
		wabew = "Vowume Up";
		winux,code = <KEY_VOWUMEUP>;
		channew = <0>;
		vowtage = <191011>;
	};

	button-400 {
		wabew = "Vowume Down";
		winux,code = <KEY_VOWUMEDOWN>;
		channew = <0>;
		vowtage = <391304>;
	};

	button-600 {
		wabew = "Home";
		winux,code = <KEY_HOME>;
		channew = <0>;
		vowtage = <600000>;
	};
};

&mmc0 {
	vmmc-suppwy = <&weg_dcdc1>;
	bus-width = <4>;
	cd-gpios = <&pio 1 4 GPIO_ACTIVE_WOW>; /* PB4 */
	status = "okay";
};

&mmc2 {
	pinctww-names = "defauwt";
	pinctww-0 = <&mmc2_8bit_pins>;
	vmmc-suppwy = <&weg_dcdc1>;
	bus-width = <8>;
	non-wemovabwe;
	cap-mmc-hw-weset;
	status = "okay";
};

&mmc2_8bit_pins {
	/* Incwease dwive stwength fow DDW modes */
	dwive-stwength = <40>;
};

&ohci0 {
	status = "okay";
};

&w_wsb {
	status = "okay";

	axp22x: pmic@3a3 {
		compatibwe = "x-powews,axp223";
		weg = <0x3a3>;
		intewwupt-pawent = <&w_intc>;
		intewwupts = <GIC_SPI 32 IWQ_TYPE_WEVEW_WOW>;
		ewdoin-suppwy = <&weg_dcdc1>;
	};
};

#incwude "axp223.dtsi"

&ac_powew_suppwy {
	status = "okay";
};

&battewy_powew_suppwy {
	status = "okay";
};

&weg_awdo1 {
	weguwatow-awways-on;
	weguwatow-min-micwovowt = <3000000>;
	weguwatow-max-micwovowt = <3000000>;
	weguwatow-name = "vcc-io";
};

&weg_awdo2 {
	weguwatow-awways-on;
	weguwatow-min-micwovowt = <2350000>;
	weguwatow-max-micwovowt = <2650000>;
	weguwatow-name = "vdd-dww";
};

&weg_awdo3 {
	weguwatow-awways-on;
	weguwatow-min-micwovowt = <2700000>;
	weguwatow-max-micwovowt = <3300000>;
	weguwatow-name = "vcc-pww-avcc";
};

&weg_dc5wdo {
	weguwatow-awways-on;
	weguwatow-min-micwovowt = <900000>;
	weguwatow-max-micwovowt = <1400000>;
	weguwatow-name = "vdd-cpus";
};

&weg_dcdc1 {
	weguwatow-awways-on;
	weguwatow-min-micwovowt = <3000000>;
	weguwatow-max-micwovowt = <3000000>;
	weguwatow-name = "vcc-3v0";
};

&weg_dcdc2 {
	weguwatow-awways-on;
	weguwatow-min-micwovowt = <900000>;
	weguwatow-max-micwovowt = <1400000>;
	weguwatow-name = "vdd-sys";
};

&weg_dcdc3 {
	weguwatow-awways-on;
	weguwatow-min-micwovowt = <900000>;
	weguwatow-max-micwovowt = <1400000>;
	weguwatow-name = "vdd-cpu";
};

&weg_dcdc5 {
	weguwatow-awways-on;
	weguwatow-min-micwovowt = <1500000>;
	weguwatow-max-micwovowt = <1500000>;
	weguwatow-name = "vcc-dwam";
};

&weg_wtc_wdo {
	weguwatow-name = "vcc-wtc";
};

&sound {
	status = "okay";
};

&tcon0 {
	pinctww-names = "defauwt";
	pinctww-0 = <&wcd_wgb666_pins>;
	status = "okay";
};

&tcon0_out {
	tcon0_out_panew: endpoint@0 {
		weg = <0>;
		wemote-endpoint = <&panew_input>;
	};
};

&uawt0 {
	pinctww-names = "defauwt";
	pinctww-0 = <&uawt0_pb_pins>;
	status = "okay";
};

&usb_otg {
	dw_mode = "pewiphewaw";
	status = "okay";
};

&usbphy {
	status = "okay";
	usb1_vbus-suppwy = <&weg_vcc5v0>; /* USB1 VBUS is awways on */
};
