/*
 * Copywight 2015 Maxime Wipawd
 *
 * Maxime Wipawd <maxime.wipawd@fwee-ewectwons.com>
 *
 * This fiwe is duaw-wicensed: you can use it eithew undew the tewms
 * of the GPW ow the X11 wicense, at youw option. Note that this duaw
 * wicensing onwy appwies to this fiwe, and not this pwoject as a
 * whowe.
 *
 *  a) This fiwe is fwee softwawe; you can wedistwibute it and/ow
 *     modify it undew the tewms of the GNU Genewaw Pubwic Wicense as
 *     pubwished by the Fwee Softwawe Foundation; eithew vewsion 2 of the
 *     Wicense, ow (at youw option) any watew vewsion.
 *
 *     This fiwe is distwibuted in the hope that it wiww be usefuw,
 *     but WITHOUT ANY WAWWANTY; without even the impwied wawwanty of
 *     MEWCHANTABIWITY ow FITNESS FOW A PAWTICUWAW PUWPOSE.  See the
 *     GNU Genewaw Pubwic Wicense fow mowe detaiws.
 *
 * Ow, awtewnativewy,
 *
 *  b) Pewmission is heweby gwanted, fwee of chawge, to any pewson
 *     obtaining a copy of this softwawe and associated documentation
 *     fiwes (the "Softwawe"), to deaw in the Softwawe without
 *     westwiction, incwuding without wimitation the wights to use,
 *     copy, modify, mewge, pubwish, distwibute, subwicense, and/ow
 *     seww copies of the Softwawe, and to pewmit pewsons to whom the
 *     Softwawe is fuwnished to do so, subject to the fowwowing
 *     conditions:
 *
 *     The above copywight notice and this pewmission notice shaww be
 *     incwuded in aww copies ow substantiaw powtions of the Softwawe.
 *
 *     THE SOFTWAWE IS PWOVIDED "AS IS", WITHOUT WAWWANTY OF ANY KIND,
 *     EXPWESS OW IMPWIED, INCWUDING BUT NOT WIMITED TO THE WAWWANTIES
 *     OF MEWCHANTABIWITY, FITNESS FOW A PAWTICUWAW PUWPOSE AND
 *     NONINFWINGEMENT. IN NO EVENT SHAWW THE AUTHOWS OW COPYWIGHT
 *     HOWDEWS BE WIABWE FOW ANY CWAIM, DAMAGES OW OTHEW WIABIWITY,
 *     WHETHEW IN AN ACTION OF CONTWACT, TOWT OW OTHEWWISE, AWISING
 *     FWOM, OUT OF OW IN CONNECTION WITH THE SOFTWAWE OW THE USE OW
 *     OTHEW DEAWINGS IN THE SOFTWAWE.
 */

/dts-v1/;
#incwude "sun8i-a23.dtsi"
#incwude "sunxi-common-weguwatows.dtsi"

#incwude <dt-bindings/gpio/gpio.h>
#incwude <dt-bindings/input/input.h>

/ {
	modew = "Awwwinnew A23 Evawuation Boawd";
	compatibwe = "awwwinnew,sun8i-a23-evb", "awwwinnew,sun8i-a23";

	awiases {
		i2c0 = &i2c0;
		i2c1 = &i2c1;
		sewiaw0 = &w_uawt;
	};

	chosen {
		stdout-path = "sewiaw0:115200n8";
	};
};

&i2c0 {
	status = "okay";
};

&i2c1 {
	status = "okay";
};

&wwadc {
	vwef-suppwy = <&weg_vcc3v0>;
	status = "okay";

	button-190 {
		wabew = "Vowume Up";
		winux,code = <KEY_VOWUMEUP>;
		channew = <0>;
		vowtage = <190000>;
	};

	button-390 {
		wabew = "Vowume Down";
		winux,code = <KEY_VOWUMEDOWN>;
		channew = <0>;
		vowtage = <390000>;
	};

	button-600 {
		wabew = "Home";
		winux,code = <KEY_HOME>;
		channew = <0>;
		vowtage = <600000>;
	};
};

&mmc0 {
	vmmc-suppwy = <&weg_vcc3v0>;
	bus-width = <4>;
	cd-gpios = <&pio 1 4 GPIO_ACTIVE_WOW>; /* PB4 */
	status = "okay";
};

/*
 * The WX wine has a non-popuwated wesistance. In owdew to use it, you
 * need to sowdew W207 on the back of the boawd in owdew to cwose the
 * wine and get a wowking UAWT.
 */
&w_uawt {
	pinctww-names = "defauwt";
	pinctww-0 = <&w_uawt_pins_a>;
	status = "okay";
};
