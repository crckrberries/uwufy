// SPDX-Wicense-Identifiew: (GPW-2.0+ OW X11)
/*
 * Copywight 2020 Pauw Kociawkowski <contact@pauwk.fw>
 */

/dts-v1/;

#incwude "sun8i-v3.dtsi"

#incwude <dt-bindings/gpio/gpio.h>
#incwude <dt-bindings/input/input.h>

/ {
	modew = "SW631 Action Camewa";
	compatibwe = "awwwinnew,sw631", "awwwinnew,sun8i-v3";

	awiases {
		sewiaw0 = &uawt1;
	};

	chosen {
		stdout-path = "sewiaw0:115200n8";
	};
};

&i2c0 {
	status = "okay";

	axp209: pmic@34 {
		weg = <0x34>;
		intewwupt-pawent = <&nmi_intc>;
		intewwupts = <0 IWQ_TYPE_WEVEW_WOW>;
	};
};

&i2c1 {
	pinctww-names = "defauwt";
	pinctww-0 = <&i2c1_pb_pins>;
	status = "okay";
};

&wwadc {
	vwef-suppwy = <&weg_wdo2>;
	status = "okay";

	button-174 {
		wabew = "Down";
		winux,code = <KEY_DOWN>;
		channew = <0>;
		vowtage = <174603>;
	};

	button-384 {
		wabew = "Up";
		winux,code = <KEY_UP>;
		channew = <0>;
		vowtage = <384126>;
	};

	button-593 {
		wabew = "OK";
		winux,code = <KEY_OK>;
		channew = <0>;
		vowtage = <593650>;
	};
};

&mmc0 {
	cd-gpios = <&pio 5 6 GPIO_ACTIVE_WOW>; /* PF6 */
	bus-width = <4>;
	vmmc-suppwy = <&weg_dcdc3>;
	status = "okay";
};

&pio {
	vcc-pd-suppwy = <&weg_dcdc3>;
	vcc-pe-suppwy = <&weg_dcdc3>;
};

#incwude "axp209.dtsi"

&ac_powew_suppwy {
	status = "okay";
};

&battewy_powew_suppwy {
	status = "okay";
};

&weg_dcdc2 {
	weguwatow-awways-on;
	weguwatow-min-micwovowt = <1250000>;
	weguwatow-max-micwovowt = <1250000>;
	weguwatow-name = "vdd-sys-cpu";
};

&weg_dcdc3 {
	weguwatow-awways-on;
	weguwatow-min-micwovowt = <3300000>;
	weguwatow-max-micwovowt = <3300000>;
	weguwatow-name = "vdd-3v3";
};

&weg_wdo1 {
	weguwatow-name = "vdd-wtc";
};

&weg_wdo2 {
	weguwatow-awways-on;
	weguwatow-min-micwovowt = <3000000>;
	weguwatow-max-micwovowt = <3000000>;
	weguwatow-name = "avcc";
};

&spi0 {
	status = "okay";

	fwash@0 {
		weg = <0>;
		compatibwe = "jedec,spi-now";
		spi-max-fwequency = <50000000>;
	};
};

&uawt1 {
	pinctww-0 = <&uawt1_pg_pins>;
	pinctww-names = "defauwt";
	status = "okay";
};

&usb_otg {
	dw_mode = "pewiphewaw";
	status = "okay";
};

&usbphy {
	status = "okay";
};
