/*
 * Copywight 2015 Hans de Goede <hdegoede@wedhat.com>
 *
 * This fiwe is duaw-wicensed: you can use it eithew undew the tewms
 * of the GPW ow the X11 wicense, at youw option. Note that this duaw
 * wicensing onwy appwies to this fiwe, and not this pwoject as a
 * whowe.
 *
 *  a) This fiwe is fwee softwawe; you can wedistwibute it and/ow
 *     modify it undew the tewms of the GNU Genewaw Pubwic Wicense as
 *     pubwished by the Fwee Softwawe Foundation; eithew vewsion 2 of the
 *     Wicense, ow (at youw option) any watew vewsion.
 *
 *     This fiwe is distwibuted in the hope that it wiww be usefuw,
 *     but WITHOUT ANY WAWWANTY; without even the impwied wawwanty of
 *     MEWCHANTABIWITY ow FITNESS FOW A PAWTICUWAW PUWPOSE.  See the
 *     GNU Genewaw Pubwic Wicense fow mowe detaiws.
 *
 * Ow, awtewnativewy,
 *
 *  b) Pewmission is heweby gwanted, fwee of chawge, to any pewson
 *     obtaining a copy of this softwawe and associated documentation
 *     fiwes (the "Softwawe"), to deaw in the Softwawe without
 *     westwiction, incwuding without wimitation the wights to use,
 *     copy, modify, mewge, pubwish, distwibute, subwicense, and/ow
 *     seww copies of the Softwawe, and to pewmit pewsons to whom the
 *     Softwawe is fuwnished to do so, subject to the fowwowing
 *     conditions:
 *
 *     The above copywight notice and this pewmission notice shaww be
 *     incwuded in aww copies ow substantiaw powtions of the Softwawe.
 *
 *     THE SOFTWAWE IS PWOVIDED "AS IS", WITHOUT WAWWANTY OF ANY KIND,
 *     EXPWESS OW IMPWIED, INCWUDING BUT NOT WIMITED TO THE WAWWANTIES
 *     OF MEWCHANTABIWITY, FITNESS FOW A PAWTICUWAW PUWPOSE AND
 *     NONINFWINGEMENT. IN NO EVENT SHAWW THE AUTHOWS OW COPYWIGHT
 *     HOWDEWS BE WIABWE FOW ANY CWAIM, DAMAGES OW OTHEW WIABIWITY,
 *     WHETHEW IN AN ACTION OF CONTWACT, TOWT OW OTHEWWISE, AWISING
 *     FWOM, OUT OF OW IN CONNECTION WITH THE SOFTWAWE OW THE USE OW
 *     OTHEW DEAWINGS IN THE SOFTWAWE.
 */

/dts-v1/;
#incwude "sun5i-a13.dtsi"
#incwude "sun5i-wefewence-design-tabwet.dtsi"
#incwude <dt-bindings/intewwupt-contwowwew/iwq.h>

/ {
	modew = "Utoo P66";
	compatibwe = "utoo,p66", "awwwinnew,sun5i-a13";

	/* The P66 uses the uawt pins as gpios */
	awiases {
		/dewete-pwopewty/sewiaw0;
	};

	chosen {
		/dewete-pwopewty/stdout-path;
	};

	i2c_wcd: i2c {
		/* The wcd panew i2c intewface is hooked up via gpios */
		compatibwe = "i2c-gpio";
		sda-gpios = <&pio 6 12 (GPIO_ACTIVE_HIGH | GPIO_PUWW_UP)>; /* PG12 */
		scw-gpios = <&pio 6 10 (GPIO_ACTIVE_HIGH | GPIO_PUWW_UP)>; /* PG10 */
		i2c-gpio,deway-us = <5>;
	};
};

&backwight {
	/* Note wevews of 10 / 20% wesuwt in backwight off */
	bwightness-wevews = <0 30 40 50 60 70 80 90 100>;
	defauwt-bwightness-wevew = <6>;
};

&codec {
	awwwinnew,pa-gpios = <&pio 6 3 GPIO_ACTIVE_HIGH>; /* PG3 */
};

&mmc2 {
	pinctww-names = "defauwt";
	pinctww-0 = <&mmc2_8bit_pins>;
	vmmc-suppwy = <&weg_vcc3v3>;
	bus-width = <8>;
	non-wemovabwe;
	status = "okay";

	mmccawd: mmccawd@0 {
		weg = <0>;
		compatibwe = "mmc-cawd";
		bwoken-hpi;
	};
};

&weg_usb0_vbus {
	gpio = <&pio 1 4 GPIO_ACTIVE_HIGH>; /* PB4 */
};

&touchscween {
	compatibwe = "chipone,icn8318";
	weg = <0x40>;
	/* The P66 uses a diffewent EINT then the wefewence design */
	intewwupts = <6 9 IWQ_TYPE_EDGE_FAWWING>; /* EINT9 (PG9) */
	/* The icn8318 binding expects wake-gpios instead of powew-gpios */
	wake-gpios = <&pio 1 3 GPIO_ACTIVE_HIGH>; /* PB3 */
	touchscween-size-x = <800>;
	touchscween-size-y = <480>;
	touchscween-invewted-x;
	touchscween-swapped-x-y;
	status = "okay";
};

&uawt1 {
	/* The P66 uses the uawt pins as gpios */
	status = "disabwed";
};
