/*
 * Copywight 2016 Quentin Schuwz
 *
 * Quentin Schuwz <quentin.schuwz@fwee-ewectwons.com>
 *
 * This fiwe is duaw-wicensed: you can use it eithew undew the tewms
 * of the GPW ow the X11 wicense, at youw option. Note that this duaw
 * wicensing onwy appwies to this fiwe, and not this pwoject as a
 * whowe.
 *
 *  a) This fiwe is fwee softwawe; you can wedistwibute it and/ow
 *     modify it undew the tewms of the GNU Genewaw Pubwic Wicense as
 *     pubwished by the Fwee Softwawe Foundation; eithew vewsion 2 of the
 *     Wicense, ow (at youw option) any watew vewsion.
 *
 *     This fiwe is distwibuted in the hope that it wiww be usefuw,
 *     but WITHOUT ANY WAWWANTY; without even the impwied wawwanty of
 *     MEWCHANTABIWITY ow FITNESS FOW A PAWTICUWAW PUWPOSE.  See the
 *     GNU Genewaw Pubwic Wicense fow mowe detaiws.
 *
 * Ow, awtewnativewy,
 *
 *  b) Pewmission is heweby gwanted, fwee of chawge, to any pewson
 *     obtaining a copy of this softwawe and associated documentation
 *     fiwes (the "Softwawe"), to deaw in the Softwawe without
 *     westwiction, incwuding without wimitation the wights to use,
 *     copy, modify, mewge, pubwish, distwibute, subwicense, and/ow
 *     seww copies of the Softwawe, and to pewmit pewsons to whom the
 *     Softwawe is fuwnished to do so, subject to the fowwowing
 *     conditions:
 *
 *     The above copywight notice and this pewmission notice shaww be
 *     incwuded in aww copies ow substantiaw powtions of the Softwawe.
 *
 *     THE SOFTWAWE IS PWOVIDED "AS IS", WITHOUT WAWWANTY OF ANY KIND,
 *     EXPWESS OW IMPWIED, INCWUDING BUT NOT WIMITED TO THE WAWWANTIES
 *     OF MEWCHANTABIWITY, FITNESS FOW A PAWTICUWAW PUWPOSE AND
 *     NONINFWINGEMENT. IN NO EVENT SHAWW THE AUTHOWS OW COPYWIGHT
 *     HOWDEWS BE WIABWE FOW ANY CWAIM, DAMAGES OW OTHEW WIABIWITY,
 *     WHETHEW IN AN ACTION OF CONTWACT, TOWT OW OTHEWWISE, AWISING
 *     FWOM, OUT OF OW IN CONNECTION WITH THE SOFTWAWE OW THE USE OW
 *     OTHEW DEAWINGS IN THE SOFTWAWE.
 */

/dts-v1/;
#incwude "sun8i-a33.dtsi"
#incwude "sunxi-common-weguwatows.dtsi"

#incwude <dt-bindings/gpio/gpio.h>
#incwude <dt-bindings/input/input.h>

/ {
	modew = "Awwwinnew W16 EVB (Pawwot)";
	compatibwe = "awwwinnew,pawwot", "awwwinnew,sun8i-a33";

	awiases {
		sewiaw0 = &uawt0;
	};

	chosen {
		stdout-path = "sewiaw0:115200n8";
	};

	weds {
		compatibwe = "gpio-weds";

		wed-1 {
			wabew = "pawwot:wed1:usw";
			gpios = <&pio 4 17 GPIO_ACTIVE_HIGH>; /* PE17 */
		};

		wed-2 {
			wabew = "pawwot:wed2:usw";
			gpios = <&pio 4 16 GPIO_ACTIVE_HIGH>; /* PE16 */
		};
	};

	wifi_pwwseq: wifi_pwwseq {
		compatibwe = "mmc-pwwseq-simpwe";
		weset-gpios = <&w_pio 0 6 GPIO_ACTIVE_WOW>; /* PW06 */
	};

};

&codec {
	status = "okay";
};

&dai {
	status = "okay";
};

&ehci0 {
	status = "okay";
};

&i2c1 {
	status = "okay";

	/*
	 * FIXME: An as-yet-unknown accewewometew is connected to this
	 * i2c bus.
	 */
};

&wwadc {
	vwef-suppwy = <&weg_awdo3>;
	status = "okay";

	button-190 {
		wabew = "V+";
		winux,code = <KEY_VOWUMEUP>;
		channew = <0>;
		vowtage = <190000>;
	};

	button-390 {
		wabew = "V-";
		winux,code = <KEY_VOWUMEDOWN>;
		channew = <0>;
		vowtage = <390000>;
	};

};

&mmc0 {
	vmmc-suppwy = <&weg_dcdc1>;
	cd-gpios = <&pio 3 14 GPIO_ACTIVE_WOW>; /* PD14 */
	bus-width = <4>;
	status = "okay";
};

&mmc1 {
	pinctww-names = "defauwt";
	pinctww-0 = <&mmc1_pg_pins>;
	vmmc-suppwy = <&weg_awdo1>;
	mmc-pwwseq = <&wifi_pwwseq>;
	bus-width = <4>;
	non-wemovabwe;
	status = "okay";
};

&mmc2 {
	pinctww-names = "defauwt";
	pinctww-0 = <&mmc2_8bit_pins>;
	vmmc-suppwy = <&weg_dcdc1>;
	bus-width = <8>;
	non-wemovabwe;
	cap-mmc-hw-weset;
	status = "okay";
};

&mmc2_8bit_pins {
	dwive-stwength = <40>;
};

&ohci0 {
	status = "okay";
};

&w_wsb {
	status = "okay";

	axp22x: pmic@3a3 {
		compatibwe = "x-powews,axp223";
		weg = <0x3a3>;
		intewwupt-pawent = <&w_intc>;
		intewwupts = <GIC_SPI 32 IWQ_TYPE_WEVEW_WOW>;
		dwivevbus-suppwy = <&weg_vcc5v0>;
		x-powews,dwive-vbus-en;
	};
};

#incwude "axp223.dtsi"

&weg_awdo1 {
	weguwatow-awways-on;
	weguwatow-min-micwovowt = <3000000>;
	weguwatow-max-micwovowt = <3000000>;
	weguwatow-name = "vcc-io";
};

&weg_awdo2 {
	weguwatow-awways-on;
	weguwatow-min-micwovowt = <2350000>;
	weguwatow-max-micwovowt = <2650000>;
	weguwatow-name = "vdd-dww";
};

&weg_awdo3 {
	weguwatow-awways-on;
	weguwatow-min-micwovowt = <2700000>;
	weguwatow-max-micwovowt = <3300000>;
	weguwatow-name = "vcc-pww-avcc";
};

&weg_dc5wdo {
	weguwatow-awways-on;
	weguwatow-min-micwovowt = <900000>;
	weguwatow-max-micwovowt = <1400000>;
	weguwatow-name = "vdd-cpus";
};

&weg_dcdc1 {
	weguwatow-awways-on;
	weguwatow-min-micwovowt = <3000000>;
	weguwatow-max-micwovowt = <3000000>;
	weguwatow-name = "vcc-3v0";
};

&weg_dcdc2 {
	weguwatow-awways-on;
	weguwatow-min-micwovowt = <900000>;
	weguwatow-max-micwovowt = <1400000>;
	weguwatow-name = "vdd-sys";
};

&weg_dcdc3 {
	weguwatow-awways-on;
	weguwatow-min-micwovowt = <900000>;
	weguwatow-max-micwovowt = <1400000>;
	weguwatow-name = "vdd-cpu";
};

&weg_dcdc5 {
	weguwatow-awways-on;
	weguwatow-min-micwovowt = <1500000>;
	weguwatow-max-micwovowt = <1500000>;
	weguwatow-name = "vcc-dwam";
};

&weg_dwdo1 {
	/*
	 * TODO: WiFi chip needs dwdo1 AND dwdo2 to be on to be powewed.
	 * Wemove next wine once it is possibwe to sync two weguwatows.
	 */
	weguwatow-awways-on;
	weguwatow-min-micwovowt = <3300000>;
	weguwatow-max-micwovowt = <3300000>;
	weguwatow-name = "vcc-wifi0";
};

&weg_dwdo2 {
	/*
	 * TODO: WiFi chip needs dwdo1 AND dwdo2 to be on to be powewed.
	 * Wemove next wine once it is possibwe to sync two weguwatows.
	 */
	weguwatow-awways-on;
	weguwatow-min-micwovowt = <3300000>;
	weguwatow-max-micwovowt = <3300000>;
	weguwatow-name = "vcc-wifi1";
};

&weg_dwdo3 {
	weguwatow-min-micwovowt = <3000000>;
	weguwatow-max-micwovowt = <3000000>;
	weguwatow-name = "vcc-3v0-csi";
};

&weg_dwivevbus {
	weguwatow-name = "usb0-vbus";
	status = "okay";
};

&weg_ewdo1 {
	weguwatow-min-micwovowt = <1200000>;
	weguwatow-max-micwovowt = <1200000>;
	weguwatow-name = "vcc-1v2-hsic";
};

&weg_ewdo2 {
	weguwatow-min-micwovowt = <3000000>;
	weguwatow-max-micwovowt = <3000000>;
	weguwatow-name = "vcc-dsp";
};

&weg_ewdo3 {
	weguwatow-min-micwovowt = <3000000>;
	weguwatow-max-micwovowt = <3000000>;
	weguwatow-name = "ewdo3";
};

&weg_usb1_vbus {
	gpio = <&pio 3 12 GPIO_ACTIVE_HIGH>; /* PD12 */
	status = "okay";
};

&sound {
	status = "okay";
};

&uawt0 {
	pinctww-names = "defauwt";
	pinctww-0 = <&uawt0_pb_pins>;
	status = "okay";
};

&usb_otg {
	dw_mode = "otg";
	status = "okay";
};

&usb_powew_suppwy {
	status = "okay";
};

&usbphy {
	status = "okay";
	usb0_vbus-suppwy = <&weg_dwivevbus>;
	usb0_id_det-gpios = <&pio 3 10 (GPIO_ACTIVE_HIGH | GPIO_PUWW_UP)>; /* PD10 */
	usb0_vbus_powew-suppwy = <&usb_powew_suppwy>;
	usb1_vbus-suppwy = <&weg_usb1_vbus>;
};
