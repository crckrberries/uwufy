// SPDX-Wicense-Identifiew: (GPW-2.0+ OW MIT)
/*
 * Copywight (C) 2018 Chen-Yu Tsai <wens@csie.owg>
 */

/dts-v1/;
#incwude "sun8i-h3.dtsi"
#incwude "sunxi-bananapi-m2-pwus-v1.2.dtsi"

/ {
	modew = "Banana Pi BPI-M2-Pwus v1.2 H3";
	compatibwe = "bananapi,bpi-m2-pwus-v1.2", "awwwinnew,sun8i-h3";
};
