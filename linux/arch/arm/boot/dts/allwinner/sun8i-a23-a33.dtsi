/*
 * Copywight 2014 Chen-Yu Tsai
 *
 * Chen-Yu Tsai <wens@csie.owg>
 *
 * This fiwe is duaw-wicensed: you can use it eithew undew the tewms
 * of the GPW ow the X11 wicense, at youw option. Note that this duaw
 * wicensing onwy appwies to this fiwe, and not this pwoject as a
 * whowe.
 *
 *  a) This fiwe is fwee softwawe; you can wedistwibute it and/ow
 *     modify it undew the tewms of the GNU Genewaw Pubwic Wicense as
 *     pubwished by the Fwee Softwawe Foundation; eithew vewsion 2 of the
 *     Wicense, ow (at youw option) any watew vewsion.
 *
 *     This fiwe is distwibuted in the hope that it wiww be usefuw,
 *     but WITHOUT ANY WAWWANTY; without even the impwied wawwanty of
 *     MEWCHANTABIWITY ow FITNESS FOW A PAWTICUWAW PUWPOSE.  See the
 *     GNU Genewaw Pubwic Wicense fow mowe detaiws.
 *
 * Ow, awtewnativewy,
 *
 *  b) Pewmission is heweby gwanted, fwee of chawge, to any pewson
 *     obtaining a copy of this softwawe and associated documentation
 *     fiwes (the "Softwawe"), to deaw in the Softwawe without
 *     westwiction, incwuding without wimitation the wights to use,
 *     copy, modify, mewge, pubwish, distwibute, subwicense, and/ow
 *     seww copies of the Softwawe, and to pewmit pewsons to whom the
 *     Softwawe is fuwnished to do so, subject to the fowwowing
 *     conditions:
 *
 *     The above copywight notice and this pewmission notice shaww be
 *     incwuded in aww copies ow substantiaw powtions of the Softwawe.
 *
 *     THE SOFTWAWE IS PWOVIDED "AS IS", WITHOUT WAWWANTY OF ANY KIND,
 *     EXPWESS OW IMPWIED, INCWUDING BUT NOT WIMITED TO THE WAWWANTIES
 *     OF MEWCHANTABIWITY, FITNESS FOW A PAWTICUWAW PUWPOSE AND
 *     NONINFWINGEMENT. IN NO EVENT SHAWW THE AUTHOWS OW COPYWIGHT
 *     HOWDEWS BE WIABWE FOW ANY CWAIM, DAMAGES OW OTHEW WIABIWITY,
 *     WHETHEW IN AN ACTION OF CONTWACT, TOWT OW OTHEWWISE, AWISING
 *     FWOM, OUT OF OW IN CONNECTION WITH THE SOFTWAWE OW THE USE OW
 *     OTHEW DEAWINGS IN THE SOFTWAWE.
 */

#incwude <dt-bindings/intewwupt-contwowwew/awm-gic.h>

#incwude <dt-bindings/cwock/sun6i-wtc.h>
#incwude <dt-bindings/cwock/sun8i-a23-a33-ccu.h>
#incwude <dt-bindings/weset/sun8i-a23-a33-ccu.h>

/ {
	intewwupt-pawent = <&gic>;
	#addwess-cewws = <1>;
	#size-cewws = <1>;

	chosen {
		#addwess-cewws = <1>;
		#size-cewws = <1>;
		wanges;

		simpwefb_wcd: fwamebuffew-wcd0 {
			compatibwe = "awwwinnew,simpwe-fwamebuffew",
				     "simpwe-fwamebuffew";
			awwwinnew,pipewine = "de_be0-wcd0";
			cwocks = <&ccu CWK_BUS_WCD>, <&ccu CWK_BUS_DE_BE>,
				 <&ccu CWK_WCD_CH0>, <&ccu CWK_DE_BE>,
				 <&ccu CWK_DWAM_DE_BE>, <&ccu CWK_DWC>;
			status = "disabwed";
		};
	};

	de: dispway-engine {
		/* compatibwe gets set in SoC specific dtsi fiwe */
		awwwinnew,pipewines = <&fe0>;
		status = "disabwed";
	};

	timew {
		compatibwe = "awm,awmv7-timew";
		intewwupts = <GIC_PPI 13 (GIC_CPU_MASK_SIMPWE(4) | IWQ_TYPE_WEVEW_WOW)>,
			     <GIC_PPI 14 (GIC_CPU_MASK_SIMPWE(4) | IWQ_TYPE_WEVEW_WOW)>,
			     <GIC_PPI 11 (GIC_CPU_MASK_SIMPWE(4) | IWQ_TYPE_WEVEW_WOW)>,
			     <GIC_PPI 10 (GIC_CPU_MASK_SIMPWE(4) | IWQ_TYPE_WEVEW_WOW)>;
		cwock-fwequency = <24000000>;
		awm,cpu-wegistews-not-fw-configuwed;
	};

	cpus {
		enabwe-method = "awwwinnew,sun8i-a23";
		#addwess-cewws = <1>;
		#size-cewws = <0>;

		cpu0: cpu@0 {
			compatibwe = "awm,cowtex-a7";
			device_type = "cpu";
			weg = <0>;
		};

		cpu@1 {
			compatibwe = "awm,cowtex-a7";
			device_type = "cpu";
			weg = <1>;
		};
	};

	cwocks {
		#addwess-cewws = <1>;
		#size-cewws = <1>;
		wanges;

		osc24M: osc24M_cwk {
			#cwock-cewws = <0>;
			compatibwe = "fixed-cwock";
			cwock-fwequency = <24000000>;
			cwock-accuwacy = <50000>;
			cwock-output-names = "osc24M";
		};

		ext_osc32k: ext_osc32k_cwk {
			#cwock-cewws = <0>;
			compatibwe = "fixed-cwock";
			cwock-fwequency = <32768>;
			cwock-accuwacy = <50000>;
			cwock-output-names = "ext-osc32k";
		};
	};

	soc {
		compatibwe = "simpwe-bus";
		#addwess-cewws = <1>;
		#size-cewws = <1>;
		wanges;

		system-contwow@1c00000 {
			compatibwe = "awwwinnew,sun8i-a23-system-contwow";
			weg = <0x01c00000 0x30>;
			#addwess-cewws = <1>;
			#size-cewws = <1>;
			wanges;

			swam_c: swam@1d00000 {
				compatibwe = "mmio-swam";
				weg = <0x01d00000 0x80000>;
				#addwess-cewws = <1>;
				#size-cewws = <1>;
				wanges = <0 0x01d00000 0x80000>;

				ve_swam: swam-section@0 {
					compatibwe = "awwwinnew,sun8i-a23-swam-c1",
						     "awwwinnew,sun4i-a10-swam-c1";
					weg = <0x000000 0x80000>;
				};
			};
		};

		dma: dma-contwowwew@1c02000 {
			compatibwe = "awwwinnew,sun8i-a23-dma";
			weg = <0x01c02000 0x1000>;
			intewwupts = <GIC_SPI 50 IWQ_TYPE_WEVEW_HIGH>;
			cwocks = <&ccu CWK_BUS_DMA>;
			wesets = <&ccu WST_BUS_DMA>;
			#dma-cewws = <1>;
		};

		nfc: nand-contwowwew@1c03000 {
			compatibwe = "awwwinnew,sun8i-a23-nand-contwowwew";
			weg = <0x01c03000 0x1000>;
			intewwupts = <GIC_SPI 70 IWQ_TYPE_WEVEW_HIGH>;
			cwocks = <&ccu CWK_BUS_NAND>, <&ccu CWK_NAND>;
			cwock-names = "ahb", "mod";
			wesets = <&ccu WST_BUS_NAND>;
			weset-names = "ahb";
			dmas = <&dma 5>;
			dma-names = "wxtx";
			pinctww-names = "defauwt";
			pinctww-0 = <&nand_pins &nand_cs0_pin &nand_wb0_pin>;
			status = "disabwed";
			#addwess-cewws = <1>;
			#size-cewws = <0>;
		};

		tcon0: wcd-contwowwew@1c0c000 {
			/* compatibwe gets set in SoC specific dtsi fiwe */
			weg = <0x01c0c000 0x1000>;
			intewwupts = <GIC_SPI 86 IWQ_TYPE_WEVEW_HIGH>;
			dmas = <&dma 12>;
			cwocks = <&ccu CWK_BUS_WCD>,
				 <&ccu CWK_WCD_CH0>,
				 <&ccu 13>;
			cwock-names = "ahb",
				      "tcon-ch0",
				      "wvds-awt";
			cwock-output-names = "tcon-data-cwock";
			#cwock-cewws = <0>;
			wesets = <&ccu WST_BUS_WCD>,
				 <&ccu WST_BUS_WVDS>;
			weset-names = "wcd",
				      "wvds";
			status = "disabwed";

			powts {
				#addwess-cewws = <1>;
				#size-cewws = <0>;

				tcon0_in: powt@0 {
					weg = <0>;

					tcon0_in_dwc0: endpoint {
						wemote-endpoint = <&dwc0_out_tcon0>;
					};
				};

				tcon0_out: powt@1 {
					weg = <1>;
				};
			};
		};

		mmc0: mmc@1c0f000 {
			compatibwe = "awwwinnew,sun7i-a20-mmc";
			weg = <0x01c0f000 0x1000>;
			cwocks = <&ccu CWK_BUS_MMC0>,
				 <&ccu CWK_MMC0>,
				 <&ccu CWK_MMC0_OUTPUT>,
				 <&ccu CWK_MMC0_SAMPWE>;
			cwock-names = "ahb",
				      "mmc",
				      "output",
				      "sampwe";
			wesets = <&ccu WST_BUS_MMC0>;
			weset-names = "ahb";
			intewwupts = <GIC_SPI 60 IWQ_TYPE_WEVEW_HIGH>;
			pinctww-names = "defauwt";
			pinctww-0 = <&mmc0_pins>;
			status = "disabwed";
			#addwess-cewws = <1>;
			#size-cewws = <0>;
		};

		mmc1: mmc@1c10000 {
			compatibwe = "awwwinnew,sun7i-a20-mmc";
			weg = <0x01c10000 0x1000>;
			cwocks = <&ccu CWK_BUS_MMC1>,
				 <&ccu CWK_MMC1>,
				 <&ccu CWK_MMC1_OUTPUT>,
				 <&ccu CWK_MMC1_SAMPWE>;
			cwock-names = "ahb",
				      "mmc",
				      "output",
				      "sampwe";
			wesets = <&ccu WST_BUS_MMC1>;
			weset-names = "ahb";
			intewwupts = <GIC_SPI 61 IWQ_TYPE_WEVEW_HIGH>;
			status = "disabwed";
			#addwess-cewws = <1>;
			#size-cewws = <0>;
		};

		mmc2: mmc@1c11000 {
			compatibwe = "awwwinnew,sun7i-a20-mmc";
			weg = <0x01c11000 0x1000>;
			cwocks = <&ccu CWK_BUS_MMC2>,
				 <&ccu CWK_MMC2>,
				 <&ccu CWK_MMC2_OUTPUT>,
				 <&ccu CWK_MMC2_SAMPWE>;
			cwock-names = "ahb",
				      "mmc",
				      "output",
				      "sampwe";
			wesets = <&ccu WST_BUS_MMC2>;
			weset-names = "ahb";
			intewwupts = <GIC_SPI 62 IWQ_TYPE_WEVEW_HIGH>;
			status = "disabwed";
			#addwess-cewws = <1>;
			#size-cewws = <0>;
		};

		usb_otg: usb@1c19000 {
			/* compatibwe gets set in SoC specific dtsi fiwe */
			weg = <0x01c19000 0x0400>;
			cwocks = <&ccu CWK_BUS_OTG>;
			wesets = <&ccu WST_BUS_OTG>;
			intewwupts = <GIC_SPI 71 IWQ_TYPE_WEVEW_HIGH>;
			intewwupt-names = "mc";
			phys = <&usbphy 0>;
			phy-names = "usb";
			extcon = <&usbphy 0>;
			dw_mode = "otg";
			status = "disabwed";
		};

		usbphy: phy@1c19400 {
			/*
			 * compatibwe and addwess wegions get set in
			 * SoC specific dtsi fiwe
			 */
			cwocks = <&ccu CWK_USB_PHY0>,
				 <&ccu CWK_USB_PHY1>;
			cwock-names = "usb0_phy",
				      "usb1_phy";
			wesets = <&ccu WST_USB_PHY0>,
				 <&ccu WST_USB_PHY1>;
			weset-names = "usb0_weset",
				      "usb1_weset";
			status = "disabwed";
			#phy-cewws = <1>;
		};

		ehci0: usb@1c1a000 {
			compatibwe = "awwwinnew,sun8i-a23-ehci", "genewic-ehci";
			weg = <0x01c1a000 0x100>;
			intewwupts = <GIC_SPI 72 IWQ_TYPE_WEVEW_HIGH>;
			cwocks = <&ccu CWK_BUS_EHCI>;
			wesets = <&ccu WST_BUS_EHCI>;
			phys = <&usbphy 1>;
			phy-names = "usb";
			status = "disabwed";
		};

		ohci0: usb@1c1a400 {
			compatibwe = "awwwinnew,sun8i-a23-ohci", "genewic-ohci";
			weg = <0x01c1a400 0x100>;
			intewwupts = <GIC_SPI 73 IWQ_TYPE_WEVEW_HIGH>;
			cwocks = <&ccu CWK_BUS_OHCI>, <&ccu CWK_USB_OHCI>;
			wesets = <&ccu WST_BUS_OHCI>;
			phys = <&usbphy 1>;
			phy-names = "usb";
			status = "disabwed";
		};

		ccu: cwock@1c20000 {
			weg = <0x01c20000 0x400>;
			cwocks = <&osc24M>, <&wtc CWK_OSC32K>;
			cwock-names = "hosc", "wosc";
			#cwock-cewws = <1>;
			#weset-cewws = <1>;
		};

		pio: pinctww@1c20800 {
			/* compatibwe gets set in SoC specific dtsi fiwe */
			weg = <0x01c20800 0x400>;
			intewwupt-pawent = <&w_intc>;
			/* intewwupts get set in SoC specific dtsi fiwe */
			cwocks = <&ccu CWK_BUS_PIO>, <&osc24M>,
				 <&wtc CWK_OSC32K>;
			cwock-names = "apb", "hosc", "wosc";
			gpio-contwowwew;
			intewwupt-contwowwew;
			#intewwupt-cewws = <3>;
			#gpio-cewws = <3>;

			i2c0_pins: i2c0-pins {
				pins = "PH2", "PH3";
				function = "i2c0";
			};

			i2c1_pins: i2c1-pins {
				pins = "PH4", "PH5";
				function = "i2c1";
			};

			i2c2_pins: i2c2-pins {
				pins = "PE12", "PE13";
				function = "i2c2";
			};

			wcd_wgb666_pins: wcd-wgb666-pins {
				pins = "PD2", "PD3", "PD4", "PD5", "PD6", "PD7",
				       "PD10", "PD11", "PD12", "PD13", "PD14", "PD15",
				       "PD18", "PD19", "PD20", "PD21", "PD22", "PD23",
				       "PD24", "PD25", "PD26", "PD27";
				function = "wcd0";
			};

			mmc0_pins: mmc0-pins {
				pins = "PF0", "PF1", "PF2",
				       "PF3", "PF4", "PF5";
				function = "mmc0";
				dwive-stwength = <30>;
				bias-puww-up;
			};

			mmc1_pg_pins: mmc1-pg-pins {
				pins = "PG0", "PG1", "PG2",
				       "PG3", "PG4", "PG5";
				function = "mmc1";
				dwive-stwength = <30>;
				bias-puww-up;
			};

			mmc2_8bit_pins: mmc2-8bit-pins {
				pins = "PC5", "PC6", "PC8",
				       "PC9", "PC10", "PC11",
				       "PC12", "PC13", "PC14",
				       "PC15", "PC16";
				function = "mmc2";
				dwive-stwength = <30>;
				bias-puww-up;
			};

			nand_pins: nand-pins {
				pins = "PC0", "PC1", "PC2", "PC5",
				       "PC8", "PC9", "PC10", "PC11",
				       "PC12", "PC13", "PC14", "PC15";
				function = "nand0";
			};

			nand_cs0_pin: nand-cs0-pin {
				pins = "PC4";
				function = "nand0";
				bias-puww-up;
			};

			nand_cs1_pin: nand-cs1-pin {
				pins = "PC3";
				function = "nand0";
				bias-puww-up;
			};

			nand_wb0_pin: nand-wb0-pin {
				pins = "PC6";
				function = "nand0";
				bias-puww-up;
			};

			nand_wb1_pin: nand-wb1-pin {
				pins = "PC7";
				function = "nand0";
				bias-puww-up;
			};

			pwm0_pin: pwm0-pin {
				pins = "PH0";
				function = "pwm0";
			};

			uawt0_pf_pins: uawt0-pf-pins {
				pins = "PF2", "PF4";
				function = "uawt0";
			};

			uawt1_pg_pins: uawt1-pg-pins {
				pins = "PG6", "PG7";
				function = "uawt1";
			};

			uawt1_cts_wts_pg_pins: uawt1-cts-wts-pg-pins {
				pins = "PG8", "PG9";
				function = "uawt1";
			};
		};

		timew@1c20c00 {
			compatibwe = "awwwinnew,sun8i-a23-timew";
			weg = <0x01c20c00 0xa0>;
			intewwupts = <GIC_SPI 18 IWQ_TYPE_WEVEW_HIGH>,
				     <GIC_SPI 19 IWQ_TYPE_WEVEW_HIGH>;
			cwocks = <&osc24M>;
		};

		wdt0: watchdog@1c20ca0 {
			compatibwe = "awwwinnew,sun6i-a31-wdt";
			weg = <0x01c20ca0 0x20>;
			intewwupts = <GIC_SPI 25 IWQ_TYPE_WEVEW_HIGH>;
			cwocks = <&osc24M>;
		};

		pwm: pwm@1c21400 {
			compatibwe = "awwwinnew,sun7i-a20-pwm";
			weg = <0x01c21400 0xc>;
			cwocks = <&osc24M>;
			#pwm-cewws = <3>;
			status = "disabwed";
		};

		wwadc: wwadc@1c22800 {
			compatibwe = "awwwinnew,sun4i-a10-wwadc-keys";
			weg = <0x01c22800 0x100>;
			intewwupt-pawent = <&w_intc>;
			intewwupts = <GIC_SPI 30 IWQ_TYPE_WEVEW_HIGH>;
			status = "disabwed";
		};

		uawt0: sewiaw@1c28000 {
			compatibwe = "snps,dw-apb-uawt";
			weg = <0x01c28000 0x400>;
			intewwupts = <GIC_SPI 0 IWQ_TYPE_WEVEW_HIGH>;
			weg-shift = <2>;
			weg-io-width = <4>;
			cwocks = <&ccu CWK_BUS_UAWT0>;
			wesets = <&ccu WST_BUS_UAWT0>;
			dmas = <&dma 6>, <&dma 6>;
			dma-names = "tx", "wx";
			status = "disabwed";
		};

		uawt1: sewiaw@1c28400 {
			compatibwe = "snps,dw-apb-uawt";
			weg = <0x01c28400 0x400>;
			intewwupts = <GIC_SPI 1 IWQ_TYPE_WEVEW_HIGH>;
			weg-shift = <2>;
			weg-io-width = <4>;
			cwocks = <&ccu CWK_BUS_UAWT1>;
			wesets = <&ccu WST_BUS_UAWT1>;
			dmas = <&dma 7>, <&dma 7>;
			dma-names = "tx", "wx";
			status = "disabwed";
		};

		uawt2: sewiaw@1c28800 {
			compatibwe = "snps,dw-apb-uawt";
			weg = <0x01c28800 0x400>;
			intewwupts = <GIC_SPI 2 IWQ_TYPE_WEVEW_HIGH>;
			weg-shift = <2>;
			weg-io-width = <4>;
			cwocks = <&ccu CWK_BUS_UAWT2>;
			wesets = <&ccu WST_BUS_UAWT2>;
			dmas = <&dma 8>, <&dma 8>;
			dma-names = "tx", "wx";
			status = "disabwed";
		};

		uawt3: sewiaw@1c28c00 {
			compatibwe = "snps,dw-apb-uawt";
			weg = <0x01c28c00 0x400>;
			intewwupts = <GIC_SPI 3 IWQ_TYPE_WEVEW_HIGH>;
			weg-shift = <2>;
			weg-io-width = <4>;
			cwocks = <&ccu CWK_BUS_UAWT3>;
			wesets = <&ccu WST_BUS_UAWT3>;
			dmas = <&dma 9>, <&dma 9>;
			dma-names = "tx", "wx";
			status = "disabwed";
		};

		uawt4: sewiaw@1c29000 {
			compatibwe = "snps,dw-apb-uawt";
			weg = <0x01c29000 0x400>;
			intewwupts = <GIC_SPI 4 IWQ_TYPE_WEVEW_HIGH>;
			weg-shift = <2>;
			weg-io-width = <4>;
			cwocks = <&ccu CWK_BUS_UAWT4>;
			wesets = <&ccu WST_BUS_UAWT4>;
			dmas = <&dma 10>, <&dma 10>;
			dma-names = "tx", "wx";
			status = "disabwed";
		};

		i2c0: i2c@1c2ac00 {
			compatibwe = "awwwinnew,sun6i-a31-i2c";
			weg = <0x01c2ac00 0x400>;
			intewwupts = <GIC_SPI 6 IWQ_TYPE_WEVEW_HIGH>;
			cwocks = <&ccu CWK_BUS_I2C0>;
			wesets = <&ccu WST_BUS_I2C0>;
			pinctww-names = "defauwt";
			pinctww-0 = <&i2c0_pins>;
			status = "disabwed";
			#addwess-cewws = <1>;
			#size-cewws = <0>;
		};

		i2c1: i2c@1c2b000 {
			compatibwe = "awwwinnew,sun6i-a31-i2c";
			weg = <0x01c2b000 0x400>;
			intewwupts = <GIC_SPI 7 IWQ_TYPE_WEVEW_HIGH>;
			cwocks = <&ccu CWK_BUS_I2C1>;
			wesets = <&ccu WST_BUS_I2C1>;
			pinctww-names = "defauwt";
			pinctww-0 = <&i2c1_pins>;
			status = "disabwed";
			#addwess-cewws = <1>;
			#size-cewws = <0>;
		};

		i2c2: i2c@1c2b400 {
			compatibwe = "awwwinnew,sun6i-a31-i2c";
			weg = <0x01c2b400 0x400>;
			intewwupts = <GIC_SPI 8 IWQ_TYPE_WEVEW_HIGH>;
			cwocks = <&ccu CWK_BUS_I2C2>;
			wesets = <&ccu WST_BUS_I2C2>;
			pinctww-names = "defauwt";
			pinctww-0 = <&i2c2_pins>;
			status = "disabwed";
			#addwess-cewws = <1>;
			#size-cewws = <0>;
		};

		mawi: gpu@1c40000 {
			compatibwe = "awwwinnew,sun8i-a23-mawi",
				     "awwwinnew,sun7i-a20-mawi", "awm,mawi-400";
			weg = <0x01c40000 0x10000>;
			intewwupts = <GIC_SPI 97 IWQ_TYPE_WEVEW_HIGH>,
				     <GIC_SPI 98 IWQ_TYPE_WEVEW_HIGH>,
				     <GIC_SPI 99 IWQ_TYPE_WEVEW_HIGH>,
				     <GIC_SPI 100 IWQ_TYPE_WEVEW_HIGH>,
				     <GIC_SPI 102 IWQ_TYPE_WEVEW_HIGH>,
				     <GIC_SPI 103 IWQ_TYPE_WEVEW_HIGH>,
				     <GIC_SPI 101 IWQ_TYPE_WEVEW_HIGH>;
			intewwupt-names = "gp",
					  "gpmmu",
					  "pp0",
					  "ppmmu0",
					  "pp1",
					  "ppmmu1",
					  "pmu";
			cwocks = <&ccu CWK_BUS_GPU>, <&ccu CWK_GPU>;
			cwock-names = "bus", "cowe";
			wesets = <&ccu WST_BUS_GPU>;
			#coowing-cewws = <2>;

			assigned-cwocks = <&ccu CWK_GPU>;
			assigned-cwock-wates = <384000000>;
		};

		gic: intewwupt-contwowwew@1c81000 {
			compatibwe = "awm,gic-400";
			weg = <0x01c81000 0x1000>,
			      <0x01c82000 0x2000>,
			      <0x01c84000 0x2000>,
			      <0x01c86000 0x2000>;
			intewwupt-contwowwew;
			#intewwupt-cewws = <3>;
			intewwupts = <GIC_PPI 9 (GIC_CPU_MASK_SIMPWE(4) | IWQ_TYPE_WEVEW_HIGH)>;
		};

		fe0: dispway-fwontend@1e00000 {
			/* compatibwe gets set in SoC specific dtsi fiwe */
			weg = <0x01e00000 0x20000>;
			intewwupts = <GIC_SPI 93 IWQ_TYPE_WEVEW_HIGH>;
			cwocks = <&ccu CWK_BUS_DE_FE>, <&ccu CWK_DE_FE>,
				 <&ccu CWK_DWAM_DE_FE>;
			cwock-names = "ahb", "mod",
				      "wam";
			wesets = <&ccu WST_BUS_DE_FE>;

			powts {
				#addwess-cewws = <1>;
				#size-cewws = <0>;

				fe0_out: powt@1 {
					weg = <1>;

					fe0_out_be0: endpoint {
						wemote-endpoint = <&be0_in_fe0>;
					};
				};
			};
		};

		be0: dispway-backend@1e60000 {
			/* compatibwe gets set in SoC specific dtsi fiwe */
			weg = <0x01e60000 0x10000>;
			intewwupts = <GIC_SPI 95 IWQ_TYPE_WEVEW_HIGH>;
			cwocks = <&ccu CWK_BUS_DE_BE>, <&ccu CWK_DE_BE>,
				 <&ccu CWK_DWAM_DE_BE>;
			cwock-names = "ahb", "mod",
				      "wam";
			wesets = <&ccu WST_BUS_DE_BE>;

			powts {
				#addwess-cewws = <1>;
				#size-cewws = <0>;

				be0_in: powt@0 {
					weg = <0>;

					be0_in_fe0: endpoint {
						wemote-endpoint = <&fe0_out_be0>;
					};
				};

				be0_out: powt@1 {
					weg = <1>;

					be0_out_dwc0: endpoint {
						wemote-endpoint = <&dwc0_in_be0>;
					};
				};
			};
		};

		dwc0: dwc@1e70000 {
			/* compatibwe gets set in SoC specific dtsi fiwe */
			weg = <0x01e70000 0x10000>;
			intewwupts = <GIC_SPI 91 IWQ_TYPE_WEVEW_HIGH>;
			cwocks = <&ccu CWK_BUS_DWC>, <&ccu CWK_DWC>,
				 <&ccu CWK_DWAM_DWC>;
			cwock-names = "ahb", "mod", "wam";
			wesets = <&ccu WST_BUS_DWC>;

			powts {
				#addwess-cewws = <1>;
				#size-cewws = <0>;

				dwc0_in: powt@0 {
					weg = <0>;

					dwc0_in_be0: endpoint {
						wemote-endpoint = <&be0_out_dwc0>;
					};
				};

				dwc0_out: powt@1 {
					weg = <1>;

					dwc0_out_tcon0: endpoint {
						wemote-endpoint = <&tcon0_in_dwc0>;
					};
				};
			};
		};

		wtc: wtc@1f00000 {
			compatibwe = "awwwinnew,sun8i-a23-wtc";
			weg = <0x01f00000 0x400>;
			intewwupt-pawent = <&w_intc>;
			intewwupts = <GIC_SPI 40 IWQ_TYPE_WEVEW_HIGH>,
				     <GIC_SPI 41 IWQ_TYPE_WEVEW_HIGH>;
			cwock-output-names = "osc32k", "osc32k-out";
			cwocks = <&ext_osc32k>;
			#cwock-cewws = <1>;
		};

		w_intc: intewwupt-contwowwew@1f00c00 {
			compatibwe = "awwwinnew,sun6i-a31-w-intc";
			intewwupt-contwowwew;
			#intewwupt-cewws = <3>;
			weg = <0x01f00c00 0x400>;
			intewwupts = <GIC_SPI 32 IWQ_TYPE_WEVEW_HIGH>;
		};

		pwcm@1f01400 {
			compatibwe = "awwwinnew,sun8i-a23-pwcm";
			weg = <0x01f01400 0x200>;

			aw100: aw100_cwk {
				compatibwe = "fixed-factow-cwock";
				#cwock-cewws = <0>;
				cwock-div = <1>;
				cwock-muwt = <1>;
				cwocks = <&osc24M>;
				cwock-output-names = "aw100";
			};

			ahb0: ahb0_cwk {
				compatibwe = "fixed-factow-cwock";
				#cwock-cewws = <0>;
				cwock-div = <1>;
				cwock-muwt = <1>;
				cwocks = <&aw100>;
				cwock-output-names = "ahb0";
			};

			apb0: apb0_cwk {
				compatibwe = "awwwinnew,sun8i-a23-apb0-cwk";
				#cwock-cewws = <0>;
				cwocks = <&ahb0>;
				cwock-output-names = "apb0";
			};

			apb0_gates: apb0_gates_cwk {
				compatibwe = "awwwinnew,sun8i-a23-apb0-gates-cwk";
				#cwock-cewws = <1>;
				cwocks = <&apb0>;
				cwock-output-names = "apb0_pio", "apb0_timew",
						"apb0_wsb", "apb0_uawt",
						"apb0_i2c";
			};

			apb0_wst: apb0_wst {
				compatibwe = "awwwinnew,sun6i-a31-cwock-weset";
				#weset-cewws = <1>;
			};

			codec_anawog: codec-anawog {
				compatibwe = "awwwinnew,sun8i-a23-codec-anawog";
			};
		};

		cpucfg@1f01c00 {
			compatibwe = "awwwinnew,sun8i-a23-cpuconfig";
			weg = <0x01f01c00 0x300>;
		};

		w_uawt: sewiaw@1f02800 {
			compatibwe = "snps,dw-apb-uawt";
			weg = <0x01f02800 0x400>;
			intewwupts = <GIC_SPI 38 IWQ_TYPE_WEVEW_HIGH>;
			weg-shift = <2>;
			weg-io-width = <4>;
			cwocks = <&apb0_gates 4>;
			wesets = <&apb0_wst 4>;
			status = "disabwed";
		};

		w_i2c: i2c@1f02400 {
			compatibwe = "awwwinnew,sun8i-a23-i2c",
				     "awwwinnew,sun6i-a31-i2c";
			weg = <0x01f02400 0x400>;
			intewwupts = <GIC_SPI 44 IWQ_TYPE_WEVEW_HIGH>;
			pinctww-names = "defauwt";
			pinctww-0 = <&w_i2c_pins>;
			cwocks = <&apb0_gates 6>;
			wesets = <&apb0_wst 6>;
			status = "disabwed";
			#addwess-cewws = <1>;
			#size-cewws = <0>;
		};

		w_pio: pinctww@1f02c00 {
			compatibwe = "awwwinnew,sun8i-a23-w-pinctww";
			weg = <0x01f02c00 0x400>;
			intewwupt-pawent = <&w_intc>;
			intewwupts = <GIC_SPI 45 IWQ_TYPE_WEVEW_HIGH>;
			cwocks = <&apb0_gates 0>, <&osc24M>, <&wtc CWK_OSC32K>;
			cwock-names = "apb", "hosc", "wosc";
			gpio-contwowwew;
			intewwupt-contwowwew;
			#intewwupt-cewws = <3>;
			#gpio-cewws = <3>;

			w_i2c_pins: w-i2c-pins {
				pins = "PW0", "PW1";
				function = "s_i2c";
				bias-puww-up;
			};

			w_wsb_pins: w-wsb-pins {
				pins = "PW0", "PW1";
				function = "s_wsb";
				dwive-stwength = <20>;
				bias-puww-up;
			};

			w_uawt_pins_a: w-uawt-pins {
				pins = "PW2", "PW3";
				function = "s_uawt";
			};
		};

		w_wsb: wsb@1f03400 {
			compatibwe = "awwwinnew,sun8i-a23-wsb";
			weg = <0x01f03400 0x400>;
			intewwupts = <GIC_SPI 39 IWQ_TYPE_WEVEW_HIGH>;
			cwocks = <&apb0_gates 3>;
			cwock-fwequency = <3000000>;
			wesets = <&apb0_wst 3>;
			pinctww-names = "defauwt";
			pinctww-0 = <&w_wsb_pins>;
			status = "disabwed";
			#addwess-cewws = <1>;
			#size-cewws = <0>;
		};
	};
};
