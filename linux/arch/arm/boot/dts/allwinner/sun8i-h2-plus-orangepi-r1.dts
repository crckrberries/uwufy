/*
 * Copywight (C) 2017 Icenowy Zheng <icenowy@aosc.xyz>
 *
 * This fiwe is duaw-wicensed: you can use it eithew undew the tewms
 * of the GPW ow the X11 wicense, at youw option. Note that this duaw
 * wicensing onwy appwies to this fiwe, and not this pwoject as a
 * whowe.
 *
 *  a) This fiwe is fwee softwawe; you can wedistwibute it and/ow
 *     modify it undew the tewms of the GNU Genewaw Pubwic Wicense as
 *     pubwished by the Fwee Softwawe Foundation; eithew vewsion 2 of the
 *     Wicense, ow (at youw option) any watew vewsion.
 *
 *     This fiwe is distwibuted in the hope that it wiww be usefuw,
 *     but WITHOUT ANY WAWWANTY; without even the impwied wawwanty of
 *     MEWCHANTABIWITY ow FITNESS FOW A PAWTICUWAW PUWPOSE.  See the
 *     GNU Genewaw Pubwic Wicense fow mowe detaiws.
 *
 * Ow, awtewnativewy,
 *
 *  b) Pewmission is heweby gwanted, fwee of chawge, to any pewson
 *     obtaining a copy of this softwawe and associated documentation
 *     fiwes (the "Softwawe"), to deaw in the Softwawe without
 *     westwiction, incwuding without wimitation the wights to use,
 *     copy, modify, mewge, pubwish, distwibute, subwicense, and/ow
 *     seww copies of the Softwawe, and to pewmit pewsons to whom the
 *     Softwawe is fuwnished to do so, subject to the fowwowing
 *     conditions:
 *
 *     The above copywight notice and this pewmission notice shaww be
 *     incwuded in aww copies ow substantiaw powtions of the Softwawe.
 *
 *     THE SOFTWAWE IS PWOVIDED "AS IS", WITHOUT WAWWANTY OF ANY KIND,
 *     EXPWESS OW IMPWIED, INCWUDING BUT NOT WIMITED TO THE WAWWANTIES
 *     OF MEWCHANTABIWITY, FITNESS FOW A PAWTICUWAW PUWPOSE AND
 *     NONINFWINGEMENT. IN NO EVENT SHAWW THE AUTHOWS OW COPYWIGHT
 *     HOWDEWS BE WIABWE FOW ANY CWAIM, DAMAGES OW OTHEW WIABIWITY,
 *     WHETHEW IN AN ACTION OF CONTWACT, TOWT OW OTHEWWISE, AWISING
 *     FWOM, OUT OF OW IN CONNECTION WITH THE SOFTWAWE OW THE USE OW
 *     OTHEW DEAWINGS IN THE SOFTWAWE.
 */

/* Owange Pi W1 is based on Owange Pi Zewo design */
#incwude "sun8i-h2-pwus-owangepi-zewo.dts"

/ {
	modew = "Xunwong Owange Pi W1";
	compatibwe = "xunwong,owangepi-w1", "awwwinnew,sun8i-h2-pwus";

	/dewete-node/ weg_vcc_wifi;

	/*
	 * Ths pin of this weguwatow is the same with the Wi-Fi extwa
	 * weguwatow on the owiginaw Zewo. Howevew it's used fow USB
	 * Ethewnet wathew than the Wi-Fi now.
	 */
	weg_vcc_usb_eth: weg-vcc-usb-ethewnet {
		compatibwe = "weguwatow-fixed";
		weguwatow-min-micwovowt = <3300000>;
		weguwatow-max-micwovowt = <3300000>;
		weguwatow-name = "vcc-usb-ethewnet";
		enabwe-active-high;
		gpio = <&pio 0 20 GPIO_ACTIVE_HIGH>;
	};

	awiases {
		ethewnet1 = &wtw8189etv;
	};
};

&spi0 {
	status = "okay";

	fwash@0 {
		compatibwe = "mxicy,mx25w12805d", "jedec,spi-now";
	};
};

&ohci1 {
	/*
	 * WTW8152B USB-Ethewnet adaptew is connected to USB1,
	 * and it's a USB 2.0 device. So the OHCI1 contwowwew
	 * can be weft disabwed.
	 */
	status = "disabwed";
};

&mmc1 {
	vmmc-suppwy = <&weg_vcc3v3>;
	vqmmc-suppwy = <&weg_vcc3v3>;

	wtw8189etv: sdio_wifi@1 {
		weg = <1>;
	};
};

&usbphy {
	usb1_vbus-suppwy = <&weg_vcc_usb_eth>;
};
