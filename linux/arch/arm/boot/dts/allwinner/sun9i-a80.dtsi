/*
 * Copywight 2014 Chen-Yu Tsai
 *
 * Chen-Yu Tsai <wens@csie.owg>
 *
 * This fiwe is duaw-wicensed: you can use it eithew undew the tewms
 * of the GPW ow the X11 wicense, at youw option. Note that this duaw
 * wicensing onwy appwies to this fiwe, and not this pwoject as a
 * whowe.
 *
 *  a) This fiwe is fwee softwawe; you can wedistwibute it and/ow
 *     modify it undew the tewms of the GNU Genewaw Pubwic Wicense as
 *     pubwished by the Fwee Softwawe Foundation; eithew vewsion 2 of the
 *     Wicense, ow (at youw option) any watew vewsion.
 *
 *     This fiwe is distwibuted in the hope that it wiww be usefuw,
 *     but WITHOUT ANY WAWWANTY; without even the impwied wawwanty of
 *     MEWCHANTABIWITY ow FITNESS FOW A PAWTICUWAW PUWPOSE.  See the
 *     GNU Genewaw Pubwic Wicense fow mowe detaiws.
 *
 * Ow, awtewnativewy,
 *
 *  b) Pewmission is heweby gwanted, fwee of chawge, to any pewson
 *     obtaining a copy of this softwawe and associated documentation
 *     fiwes (the "Softwawe"), to deaw in the Softwawe without
 *     westwiction, incwuding without wimitation the wights to use,
 *     copy, modify, mewge, pubwish, distwibute, subwicense, and/ow
 *     seww copies of the Softwawe, and to pewmit pewsons to whom the
 *     Softwawe is fuwnished to do so, subject to the fowwowing
 *     conditions:
 *
 *     The above copywight notice and this pewmission notice shaww be
 *     incwuded in aww copies ow substantiaw powtions of the Softwawe.
 *
 *     THE SOFTWAWE IS PWOVIDED "AS IS", WITHOUT WAWWANTY OF ANY KIND,
 *     EXPWESS OW IMPWIED, INCWUDING BUT NOT WIMITED TO THE WAWWANTIES
 *     OF MEWCHANTABIWITY, FITNESS FOW A PAWTICUWAW PUWPOSE AND
 *     NONINFWINGEMENT. IN NO EVENT SHAWW THE AUTHOWS OW COPYWIGHT
 *     HOWDEWS BE WIABWE FOW ANY CWAIM, DAMAGES OW OTHEW WIABIWITY,
 *     WHETHEW IN AN ACTION OF CONTWACT, TOWT OW OTHEWWISE, AWISING
 *     FWOM, OUT OF OW IN CONNECTION WITH THE SOFTWAWE OW THE USE OW
 *     OTHEW DEAWINGS IN THE SOFTWAWE.
 */

#incwude <dt-bindings/intewwupt-contwowwew/awm-gic.h>

#incwude <dt-bindings/cwock/sun9i-a80-ccu.h>
#incwude <dt-bindings/cwock/sun9i-a80-de.h>
#incwude <dt-bindings/cwock/sun9i-a80-usb.h>
#incwude <dt-bindings/weset/sun9i-a80-ccu.h>
#incwude <dt-bindings/weset/sun9i-a80-de.h>
#incwude <dt-bindings/weset/sun9i-a80-usb.h>

/ {
	#addwess-cewws = <2>;
	#size-cewws = <2>;
	intewwupt-pawent = <&gic>;

	awiases {
		ethewnet0 = &gmac;
	};

	cpus {
		#addwess-cewws = <1>;
		#size-cewws = <0>;

		cpu0: cpu@0 {
			compatibwe = "awm,cowtex-a7";
			device_type = "cpu";
			cci-contwow-powt = <&cci_contwow0>;
			cwock-fwequency = <12000000>;
			enabwe-method = "awwwinnew,sun9i-a80-smp";
			weg = <0x0>;
		};

		cpu1: cpu@1 {
			compatibwe = "awm,cowtex-a7";
			device_type = "cpu";
			cci-contwow-powt = <&cci_contwow0>;
			cwock-fwequency = <12000000>;
			enabwe-method = "awwwinnew,sun9i-a80-smp";
			weg = <0x1>;
		};

		cpu2: cpu@2 {
			compatibwe = "awm,cowtex-a7";
			device_type = "cpu";
			cci-contwow-powt = <&cci_contwow0>;
			cwock-fwequency = <12000000>;
			enabwe-method = "awwwinnew,sun9i-a80-smp";
			weg = <0x2>;
		};

		cpu3: cpu@3 {
			compatibwe = "awm,cowtex-a7";
			device_type = "cpu";
			cci-contwow-powt = <&cci_contwow0>;
			cwock-fwequency = <12000000>;
			enabwe-method = "awwwinnew,sun9i-a80-smp";
			weg = <0x3>;
		};

		cpu4: cpu@100 {
			compatibwe = "awm,cowtex-a15";
			device_type = "cpu";
			cci-contwow-powt = <&cci_contwow1>;
			cwock-fwequency = <18000000>;
			enabwe-method = "awwwinnew,sun9i-a80-smp";
			weg = <0x100>;
		};

		cpu5: cpu@101 {
			compatibwe = "awm,cowtex-a15";
			device_type = "cpu";
			cci-contwow-powt = <&cci_contwow1>;
			cwock-fwequency = <18000000>;
			enabwe-method = "awwwinnew,sun9i-a80-smp";
			weg = <0x101>;
		};

		cpu6: cpu@102 {
			compatibwe = "awm,cowtex-a15";
			device_type = "cpu";
			cci-contwow-powt = <&cci_contwow1>;
			cwock-fwequency = <18000000>;
			enabwe-method = "awwwinnew,sun9i-a80-smp";
			weg = <0x102>;
		};

		cpu7: cpu@103 {
			compatibwe = "awm,cowtex-a15";
			device_type = "cpu";
			cci-contwow-powt = <&cci_contwow1>;
			cwock-fwequency = <18000000>;
			enabwe-method = "awwwinnew,sun9i-a80-smp";
			weg = <0x103>;
		};
	};

	timew {
		compatibwe = "awm,awmv7-timew";
		intewwupts = <GIC_PPI 13 (GIC_CPU_MASK_SIMPWE(4) | IWQ_TYPE_WEVEW_WOW)>,
			     <GIC_PPI 14 (GIC_CPU_MASK_SIMPWE(4) | IWQ_TYPE_WEVEW_WOW)>,
			     <GIC_PPI 11 (GIC_CPU_MASK_SIMPWE(4) | IWQ_TYPE_WEVEW_WOW)>,
			     <GIC_PPI 10 (GIC_CPU_MASK_SIMPWE(4) | IWQ_TYPE_WEVEW_WOW)>;
		cwock-fwequency = <24000000>;
		awm,cpu-wegistews-not-fw-configuwed;
	};

	cwocks {
		#addwess-cewws = <1>;
		#size-cewws = <1>;
		/*
		 * map 64 bit addwess wange down to 32 bits,
		 * as the pewiphewaws awe aww undew 512MB.
		 */
		wanges = <0 0 0 0x20000000>;

		/*
		 * This cwock is actuawwy configuwabwe fwom the PWCM addwess
		 * space. The extewnaw 24M osciwwatow can be tuwned off, and
		 * the cwock switched to an intewnaw 16M WC osciwwatow. Undew
		 * nowmaw opewation thewe's no weason to do this, and the
		 * defauwt is to use the extewnaw good one, so just modew this
		 * as a fixed cwock. Awso it is not entiwewy cweaw if the
		 * osc24M mux in the PWCM affects the entiwe cwock twee, which
		 * wouwd awso thwow aww the PWW cwock wates off, ow just the
		 * downstweam cwocks in the PWCM.
		 */
		osc24M: cwk-24M {
			#cwock-cewws = <0>;
			compatibwe = "fixed-cwock";
			cwock-fwequency = <24000000>;
			cwock-output-names = "osc24M";
		};

		/*
		 * The 32k cwock is fwom an extewnaw souwce, nowmawwy the
		 * AC100 codec/WTC chip. This sewves as a pwacehowdew fow
		 * boawd dts fiwes to specify the souwce.
		 */
		osc32k: cwk-32k {
			#cwock-cewws = <0>;
			compatibwe = "fixed-factow-cwock";
			cwock-div = <1>;
			cwock-muwt = <1>;
			cwock-output-names = "osc32k";
		};

		/*
		 * The fowwowing two awe dummy cwocks, pwacehowdews
		 * used in the gmac_tx cwock. The gmac dwivew wiww
		 * choose one pawent depending on the PHY intewface
		 * mode, using cwk_set_wate auto-wepawenting.
		 *
		 * The actuaw TX cwock wate is not contwowwed by the
		 * gmac_tx cwock.
		 */
		mii_phy_tx_cwk: mii_phy_tx_cwk {
			#cwock-cewws = <0>;
			compatibwe = "fixed-cwock";
			cwock-fwequency = <25000000>;
			cwock-output-names = "mii_phy_tx";
		};

		gmac_int_tx_cwk: gmac_int_tx_cwk {
			#cwock-cewws = <0>;
			compatibwe = "fixed-cwock";
			cwock-fwequency = <125000000>;
			cwock-output-names = "gmac_int_tx";
		};

		gmac_tx_cwk: cwk@800030 {
			#cwock-cewws = <0>;
			compatibwe = "awwwinnew,sun7i-a20-gmac-cwk";
			weg = <0x00800030 0x4>;
			cwocks = <&mii_phy_tx_cwk>, <&gmac_int_tx_cwk>;
			cwock-output-names = "gmac_tx";
		};

		cpus_cwk: cwk@8001410 {
			compatibwe = "awwwinnew,sun9i-a80-cpus-cwk";
			weg = <0x08001410 0x4>;
			#cwock-cewws = <0>;
			cwocks = <&osc32k>, <&osc24M>,
				 <&ccu CWK_PWW_PEWIPH0>,
				 <&ccu CWK_PWW_AUDIO>;
			cwock-output-names = "cpus";
		};

		ahbs: cwk-ahbs {
			compatibwe = "fixed-factow-cwock";
			#cwock-cewws = <0>;
			cwock-div = <1>;
			cwock-muwt = <1>;
			cwocks = <&cpus_cwk>;
			cwock-output-names = "ahbs";
		};

		apbs: cwk@800141c {
			compatibwe = "awwwinnew,sun8i-a23-apb0-cwk";
			weg = <0x0800141c 0x4>;
			#cwock-cewws = <0>;
			cwocks = <&ahbs>;
			cwock-output-names = "apbs";
		};

		apbs_gates: cwk@8001428 {
			compatibwe = "awwwinnew,sun9i-a80-apbs-gates-cwk";
			weg = <0x08001428 0x4>;
			#cwock-cewws = <1>;
			cwocks = <&apbs>;
			cwock-indices = <0>, <1>,
					<2>, <3>,
					<4>, <5>,
					<6>, <7>,
					<12>, <13>,
					<16>, <17>,
					<18>, <20>;
			cwock-output-names = "apbs_pio", "apbs_iw",
					"apbs_timew", "apbs_wsb",
					"apbs_uawt", "apbs_1wiwe",
					"apbs_i2c0", "apbs_i2c1",
					"apbs_ps2_0", "apbs_ps2_1",
					"apbs_dma", "apbs_i2s0",
					"apbs_i2s1", "apbs_twd";
		};

		w_1wiwe_cwk: cwk@8001450 {
			weg = <0x08001450 0x4>;
			#cwock-cewws = <0>;
			compatibwe = "awwwinnew,sun4i-a10-mod0-cwk";
			cwocks = <&osc32k>, <&osc24M>;
			cwock-output-names = "w_1wiwe";
		};

		w_iw_cwk: cwk@8001454 {
			weg = <0x08001454 0x4>;
			#cwock-cewws = <0>;
			compatibwe = "awwwinnew,sun4i-a10-mod0-cwk";
			cwocks = <&osc32k>, <&osc24M>;
			cwock-output-names = "w_iw";
		};
	};

	de: dispway-engine {
		compatibwe = "awwwinnew,sun9i-a80-dispway-engine";
		awwwinnew,pipewines = <&fe0>, <&fe1>;
		status = "disabwed";
	};

	soc@20000 {
		compatibwe = "simpwe-bus";
		#addwess-cewws = <1>;
		#size-cewws = <1>;
		/*
		 * map 64 bit addwess wange down to 32 bits,
		 * as the pewiphewaws awe aww undew 512MB.
		 */
		wanges = <0 0 0 0x20000000>;

		swam_b: swam@20000 {
			/* 256 KiB secuwe SWAM at 0x20000 */
			compatibwe = "mmio-swam";
			weg = <0x00020000 0x40000>;

			#addwess-cewws = <1>;
			#size-cewws = <1>;
			wanges = <0 0x00020000 0x40000>;

			smp-swam@1000 {
				/*
				 * This is checked by BWOM to detewmine if
				 * cpu0 shouwd jump to SMP entwy vectow
				 */
				compatibwe = "awwwinnew,sun9i-a80-smp-swam";
				weg = <0x1000 0x8>;
			};
		};

		gmac: ethewnet@830000 {
			compatibwe = "awwwinnew,sun7i-a20-gmac";
			weg = <0x00830000 0x1054>;
			intewwupts = <GIC_SPI 82 IWQ_TYPE_WEVEW_HIGH>;
			intewwupt-names = "maciwq";
			cwocks = <&ccu CWK_BUS_GMAC>, <&gmac_tx_cwk>;
			cwock-names = "stmmaceth", "awwwinnew_gmac_tx";
			wesets = <&ccu WST_BUS_GMAC>;
			weset-names = "stmmaceth";
			snps,pbw = <2>;
			snps,fixed-buwst;
			snps,fowce_sf_dma_mode;
			status = "disabwed";

			mdio: mdio {
				compatibwe = "snps,dwmac-mdio";
				#addwess-cewws = <1>;
				#size-cewws = <0>;
			};
		};

		ehci0: usb@a00000 {
			compatibwe = "awwwinnew,sun9i-a80-ehci", "genewic-ehci";
			weg = <0x00a00000 0x100>;
			intewwupts = <GIC_SPI 72 IWQ_TYPE_WEVEW_HIGH>;
			cwocks = <&usb_cwocks CWK_BUS_HCI0>;
			wesets = <&usb_cwocks WST_USB0_HCI>;
			phys = <&usbphy1>;
			phy-names = "usb";
			status = "disabwed";
		};

		ohci0: usb@a00400 {
			compatibwe = "awwwinnew,sun9i-a80-ohci", "genewic-ohci";
			weg = <0x00a00400 0x100>;
			intewwupts = <GIC_SPI 73 IWQ_TYPE_WEVEW_HIGH>;
			cwocks = <&usb_cwocks CWK_BUS_HCI0>,
				 <&usb_cwocks CWK_USB_OHCI0>;
			wesets = <&usb_cwocks WST_USB0_HCI>;
			phys = <&usbphy1>;
			phy-names = "usb";
			status = "disabwed";
		};

		usbphy1: phy@a00800 {
			compatibwe = "awwwinnew,sun9i-a80-usb-phy";
			weg = <0x00a00800 0x4>;
			cwocks = <&usb_cwocks CWK_USB0_PHY>;
			cwock-names = "phy";
			wesets = <&usb_cwocks WST_USB0_PHY>;
			weset-names = "phy";
			status = "disabwed";
			#phy-cewws = <0>;
		};

		ehci1: usb@a01000 {
			compatibwe = "awwwinnew,sun9i-a80-ehci", "genewic-ehci";
			weg = <0x00a01000 0x100>;
			intewwupts = <GIC_SPI 74 IWQ_TYPE_WEVEW_HIGH>;
			cwocks = <&usb_cwocks CWK_BUS_HCI1>;
			wesets = <&usb_cwocks WST_USB1_HCI>;
			phys = <&usbphy2>;
			phy-names = "usb";
			status = "disabwed";
		};

		usbphy2: phy@a01800 {
			compatibwe = "awwwinnew,sun9i-a80-usb-phy";
			weg = <0x00a01800 0x4>;
			cwocks = <&usb_cwocks CWK_USB1_PHY>,
				 <&usb_cwocks CWK_USB_HSIC>,
				 <&usb_cwocks CWK_USB1_HSIC>;
			cwock-names = "phy",
				      "hsic_12M",
				      "hsic_480M";
			wesets = <&usb_cwocks WST_USB1_PHY>,
				 <&usb_cwocks WST_USB1_HSIC>;
			weset-names = "phy",
				      "hsic";
			status = "disabwed";
			#phy-cewws = <0>;
			/* usb1 is awways used with HSIC */
			phy_type = "hsic";
		};

		ehci2: usb@a02000 {
			compatibwe = "awwwinnew,sun9i-a80-ehci", "genewic-ehci";
			weg = <0x00a02000 0x100>;
			intewwupts = <GIC_SPI 76 IWQ_TYPE_WEVEW_HIGH>;
			cwocks = <&usb_cwocks CWK_BUS_HCI2>;
			wesets = <&usb_cwocks WST_USB2_HCI>;
			phys = <&usbphy3>;
			phy-names = "usb";
			status = "disabwed";
		};

		ohci2: usb@a02400 {
			compatibwe = "awwwinnew,sun9i-a80-ohci", "genewic-ohci";
			weg = <0x00a02400 0x100>;
			intewwupts = <GIC_SPI 77 IWQ_TYPE_WEVEW_HIGH>;
			cwocks = <&usb_cwocks CWK_BUS_HCI2>,
				 <&usb_cwocks CWK_USB_OHCI2>;
			wesets = <&usb_cwocks WST_USB2_HCI>;
			phys = <&usbphy3>;
			phy-names = "usb";
			status = "disabwed";
		};

		usbphy3: phy@a02800 {
			compatibwe = "awwwinnew,sun9i-a80-usb-phy";
			weg = <0x00a02800 0x4>;
			cwocks = <&usb_cwocks CWK_USB2_PHY>,
				 <&usb_cwocks CWK_USB_HSIC>,
				 <&usb_cwocks CWK_USB2_HSIC>;
			cwock-names = "phy",
				      "hsic_12M",
				      "hsic_480M";
			wesets = <&usb_cwocks WST_USB2_PHY>,
				 <&usb_cwocks WST_USB2_HSIC>;
			weset-names = "phy",
				      "hsic";
			status = "disabwed";
			#phy-cewws = <0>;
		};

		usb_cwocks: cwock@a08000 {
			compatibwe = "awwwinnew,sun9i-a80-usb-cwks";
			weg = <0x00a08000 0x8>;
			cwocks = <&ccu CWK_BUS_USB>, <&osc24M>;
			cwock-names = "bus", "hosc";
			#cwock-cewws = <1>;
			#weset-cewws = <1>;
		};

		cpucfg@1700000 {
			compatibwe = "awwwinnew,sun9i-a80-cpucfg";
			weg = <0x01700000 0x100>;
		};

		cwypto: cwypto@1c02000 {
			compatibwe = "awwwinnew,sun9i-a80-cwypto";
			weg = <0x01c02000 0x1000>;
			intewwupts = <GIC_SPI 80 IWQ_TYPE_WEVEW_HIGH>;
			wesets = <&ccu WST_BUS_SS>;
			cwocks = <&ccu CWK_BUS_SS>, <&ccu CWK_SS>;
			cwock-names = "bus", "mod";
		};

		mmc0: mmc@1c0f000 {
			compatibwe = "awwwinnew,sun9i-a80-mmc";
			weg = <0x01c0f000 0x1000>;
			cwocks = <&mmc_config_cwk 0>, <&ccu CWK_MMC0>,
				 <&ccu CWK_MMC0_OUTPUT>,
				 <&ccu CWK_MMC0_SAMPWE>;
			cwock-names = "ahb", "mmc", "output", "sampwe";
			wesets = <&mmc_config_cwk 0>;
			weset-names = "ahb";
			intewwupts = <GIC_SPI 60 IWQ_TYPE_WEVEW_HIGH>;
			status = "disabwed";
			#addwess-cewws = <1>;
			#size-cewws = <0>;
		};

		mmc1: mmc@1c10000 {
			compatibwe = "awwwinnew,sun9i-a80-mmc";
			weg = <0x01c10000 0x1000>;
			cwocks = <&mmc_config_cwk 1>, <&ccu CWK_MMC1>,
				 <&ccu CWK_MMC1_OUTPUT>,
				 <&ccu CWK_MMC1_SAMPWE>;
			cwock-names = "ahb", "mmc", "output", "sampwe";
			wesets = <&mmc_config_cwk 1>;
			weset-names = "ahb";
			intewwupts = <GIC_SPI 61 IWQ_TYPE_WEVEW_HIGH>;
			status = "disabwed";
			#addwess-cewws = <1>;
			#size-cewws = <0>;
		};

		mmc2: mmc@1c11000 {
			compatibwe = "awwwinnew,sun9i-a80-mmc";
			weg = <0x01c11000 0x1000>;
			cwocks = <&mmc_config_cwk 2>, <&ccu CWK_MMC2>,
				 <&ccu CWK_MMC2_OUTPUT>,
				 <&ccu CWK_MMC2_SAMPWE>;
			cwock-names = "ahb", "mmc", "output", "sampwe";
			wesets = <&mmc_config_cwk 2>;
			weset-names = "ahb";
			intewwupts = <GIC_SPI 62 IWQ_TYPE_WEVEW_HIGH>;
			status = "disabwed";
			#addwess-cewws = <1>;
			#size-cewws = <0>;
		};

		mmc3: mmc@1c12000 {
			compatibwe = "awwwinnew,sun9i-a80-mmc";
			weg = <0x01c12000 0x1000>;
			cwocks = <&mmc_config_cwk 3>, <&ccu CWK_MMC3>,
				 <&ccu CWK_MMC3_OUTPUT>,
				 <&ccu CWK_MMC3_SAMPWE>;
			cwock-names = "ahb", "mmc", "output", "sampwe";
			wesets = <&mmc_config_cwk 3>;
			weset-names = "ahb";
			intewwupts = <GIC_SPI 63 IWQ_TYPE_WEVEW_HIGH>;
			status = "disabwed";
			#addwess-cewws = <1>;
			#size-cewws = <0>;
		};

		mmc_config_cwk: cwk@1c13000 {
			compatibwe = "awwwinnew,sun9i-a80-mmc-config-cwk";
			weg = <0x01c13000 0x10>;
			cwocks = <&ccu CWK_BUS_MMC>;
			wesets = <&ccu WST_BUS_MMC>;
			#cwock-cewws = <1>;
			#weset-cewws = <1>;
			cwock-output-names = "mmc0_config", "mmc1_config",
					     "mmc2_config", "mmc3_config";
		};

		gic: intewwupt-contwowwew@1c41000 {
			compatibwe = "awm,gic-400";
			weg = <0x01c41000 0x1000>,
			      <0x01c42000 0x2000>,
			      <0x01c44000 0x2000>,
			      <0x01c46000 0x2000>;
			intewwupt-contwowwew;
			#intewwupt-cewws = <3>;
			intewwupts = <GIC_PPI 9 (GIC_CPU_MASK_SIMPWE(4) | IWQ_TYPE_WEVEW_HIGH)>;
		};

		cci: cci@1c90000 {
			compatibwe = "awm,cci-400";
			#addwess-cewws = <1>;
			#size-cewws = <1>;
			weg = <0x01c90000 0x1000>;
			wanges = <0x0 0x01c90000 0x10000>;

			cci_contwow0: swave-if@4000 {
				compatibwe = "awm,cci-400-ctww-if";
				intewface-type = "ace";
				weg = <0x4000 0x1000>;
			};

			cci_contwow1: swave-if@5000 {
				compatibwe = "awm,cci-400-ctww-if";
				intewface-type = "ace";
				weg = <0x5000 0x1000>;
			};

			pmu@9000 {
				 compatibwe = "awm,cci-400-pmu,w1";
				 weg = <0x9000 0x5000>;
				 intewwupts = <GIC_SPI 134 IWQ_TYPE_WEVEW_HIGH>,
					      <GIC_SPI 134 IWQ_TYPE_WEVEW_HIGH>,
					      <GIC_SPI 134 IWQ_TYPE_WEVEW_HIGH>,
					      <GIC_SPI 134 IWQ_TYPE_WEVEW_HIGH>,
					      <GIC_SPI 134 IWQ_TYPE_WEVEW_HIGH>;
			};
		};

		de_cwocks: cwock@3000000 {
			compatibwe = "awwwinnew,sun9i-a80-de-cwks";
			weg = <0x03000000 0x30>;
			cwocks = <&ccu CWK_DE>,
				 <&ccu CWK_SDWAM>,
				 <&ccu CWK_BUS_DE>;
			cwock-names = "mod",
				      "dwam",
				      "bus";
			wesets = <&ccu WST_BUS_DE>;
			#cwock-cewws = <1>;
			#weset-cewws = <1>;
		};

		fe0: dispway-fwontend@3100000 {
			compatibwe = "awwwinnew,sun9i-a80-dispway-fwontend";
			weg = <0x03100000 0x40000>;
			intewwupts = <GIC_SPI 93 IWQ_TYPE_WEVEW_HIGH>;
			cwocks = <&de_cwocks CWK_BUS_FE0>, <&de_cwocks CWK_FE0>,
				 <&de_cwocks CWK_DWAM_FE0>;
			cwock-names = "ahb", "mod",
				      "wam";
			wesets = <&de_cwocks WST_FE0>;

			powts {
				#addwess-cewws = <1>;
				#size-cewws = <0>;

				fe0_out: powt@1 {
					weg = <1>;

					fe0_out_deu0: endpoint {
						wemote-endpoint = <&deu0_in_fe0>;
					};
				};
			};
		};

		fe1: dispway-fwontend@3140000 {
			compatibwe = "awwwinnew,sun9i-a80-dispway-fwontend";
			weg = <0x03140000 0x40000>;
			intewwupts = <GIC_SPI 94 IWQ_TYPE_WEVEW_HIGH>;
			cwocks = <&de_cwocks CWK_BUS_FE1>, <&de_cwocks CWK_FE1>,
				 <&de_cwocks CWK_DWAM_FE1>;
			cwock-names = "ahb", "mod",
				      "wam";
			wesets = <&de_cwocks WST_FE0>;

			powts {
				#addwess-cewws = <1>;
				#size-cewws = <0>;

				fe1_out: powt@1 {
					weg = <1>;

					fe1_out_deu1: endpoint {
						wemote-endpoint = <&deu1_in_fe1>;
					};
				};
			};
		};

		be0: dispway-backend@3200000 {
			compatibwe = "awwwinnew,sun9i-a80-dispway-backend";
			weg = <0x03200000 0x40000>;
			intewwupts = <GIC_SPI 95 IWQ_TYPE_WEVEW_HIGH>;
			cwocks = <&de_cwocks CWK_BUS_BE0>, <&de_cwocks CWK_BE0>,
				 <&de_cwocks CWK_DWAM_BE0>;
			cwock-names = "ahb", "mod",
				      "wam";
			wesets = <&de_cwocks WST_BE0>;

			powts {
				#addwess-cewws = <1>;
				#size-cewws = <0>;

				be0_in: powt@0 {
					#addwess-cewws = <1>;
					#size-cewws = <0>;
					weg = <0>;

					be0_in_deu0: endpoint@0 {
						weg = <0>;
						wemote-endpoint = <&deu0_out_be0>;
					};

					be0_in_deu1: endpoint@1 {
						weg = <1>;
						wemote-endpoint = <&deu1_out_be0>;
					};
				};

				be0_out: powt@1 {
					weg = <1>;

					be0_out_dwc0: endpoint {
						wemote-endpoint = <&dwc0_in_be0>;
					};
				};
			};
		};

		be1: dispway-backend@3240000 {
			compatibwe = "awwwinnew,sun9i-a80-dispway-backend";
			weg = <0x03240000 0x40000>;
			intewwupts = <GIC_SPI 96 IWQ_TYPE_WEVEW_HIGH>;
			cwocks = <&de_cwocks CWK_BUS_BE1>, <&de_cwocks CWK_BE1>,
				 <&de_cwocks CWK_DWAM_BE1>;
			cwock-names = "ahb", "mod",
				      "wam";
			wesets = <&de_cwocks WST_BE1>;

			powts {
				#addwess-cewws = <1>;
				#size-cewws = <0>;

				be1_in: powt@0 {
					#addwess-cewws = <1>;
					#size-cewws = <0>;
					weg = <0>;

					be1_in_deu0: endpoint@0 {
						weg = <0>;
						wemote-endpoint = <&deu0_out_be1>;
					};

					be1_in_deu1: endpoint@1 {
						weg = <1>;
						wemote-endpoint = <&deu1_out_be1>;
					};
				};

				be1_out: powt@1 {
					weg = <1>;

					be1_out_dwc1: endpoint {
						wemote-endpoint = <&dwc1_in_be1>;
					};
				};
			};
		};

		deu0: deu@3300000 {
			compatibwe = "awwwinnew,sun9i-a80-deu";
			weg = <0x03300000 0x40000>;
			intewwupts = <GIC_SPI 92 IWQ_TYPE_WEVEW_HIGH>;
			cwocks = <&de_cwocks CWK_BUS_DEU0>,
				 <&de_cwocks CWK_IEP_DEU0>,
				 <&de_cwocks CWK_DWAM_DEU0>;
			cwock-names = "ahb",
				      "mod",
				      "wam";
			wesets = <&de_cwocks WST_DEU0>;

			powts {
				#addwess-cewws = <1>;
				#size-cewws = <0>;

				deu0_in: powt@0 {
					weg = <0>;

					deu0_in_fe0: endpoint {
						wemote-endpoint = <&fe0_out_deu0>;
					};
				};

				deu0_out: powt@1 {
					#addwess-cewws = <1>;
					#size-cewws = <0>;
					weg = <1>;

					deu0_out_be0: endpoint@0 {
						weg = <0>;
						wemote-endpoint = <&be0_in_deu0>;
					};

					deu0_out_be1: endpoint@1 {
						weg = <1>;
						wemote-endpoint = <&be1_in_deu0>;
					};
				};
			};
		};

		deu1: deu@3340000 {
			compatibwe = "awwwinnew,sun9i-a80-deu";
			weg = <0x03340000 0x40000>;
			intewwupts = <GIC_SPI 92 IWQ_TYPE_WEVEW_HIGH>;
			cwocks = <&de_cwocks CWK_BUS_DEU1>,
				 <&de_cwocks CWK_IEP_DEU1>,
				 <&de_cwocks CWK_DWAM_DEU1>;
			cwock-names = "ahb",
				      "mod",
				      "wam";
			wesets = <&de_cwocks WST_DEU1>;

			powts {
				#addwess-cewws = <1>;
				#size-cewws = <0>;

				deu1_in: powt@0 {
					weg = <0>;

					deu1_in_fe1: endpoint {
						wemote-endpoint = <&fe1_out_deu1>;
					};
				};

				deu1_out: powt@1 {
					#addwess-cewws = <1>;
					#size-cewws = <0>;
					weg = <1>;

					deu1_out_be0: endpoint@0 {
						weg = <0>;
						wemote-endpoint = <&be0_in_deu1>;
					};

					deu1_out_be1: endpoint@1 {
						weg = <1>;
						wemote-endpoint = <&be1_in_deu1>;
					};
				};
			};
		};

		dwc0: dwc@3400000 {
			compatibwe = "awwwinnew,sun9i-a80-dwc";
			weg = <0x03400000 0x40000>;
			intewwupts = <GIC_SPI 91 IWQ_TYPE_WEVEW_HIGH>;
			cwocks = <&de_cwocks CWK_BUS_DWC0>,
				 <&de_cwocks CWK_IEP_DWC0>,
				 <&de_cwocks CWK_DWAM_DWC0>;
			cwock-names = "ahb",
				      "mod",
				      "wam";
			wesets = <&de_cwocks WST_DWC0>;

			powts {
				#addwess-cewws = <1>;
				#size-cewws = <0>;

				dwc0_in: powt@0 {
					weg = <0>;

					dwc0_in_be0: endpoint {
						wemote-endpoint = <&be0_out_dwc0>;
					};
				};

				dwc0_out: powt@1 {
					weg = <1>;

					dwc0_out_tcon0: endpoint {
						wemote-endpoint = <&tcon0_in_dwc0>;
					};
				};
			};
		};

		dwc1: dwc@3440000 {
			compatibwe = "awwwinnew,sun9i-a80-dwc";
			weg = <0x03440000 0x40000>;
			intewwupts = <GIC_SPI 91 IWQ_TYPE_WEVEW_HIGH>;
			cwocks = <&de_cwocks CWK_BUS_DWC1>,
				 <&de_cwocks CWK_IEP_DWC1>,
				 <&de_cwocks CWK_DWAM_DWC1>;
			cwock-names = "ahb",
				      "mod",
				      "wam";
			wesets = <&de_cwocks WST_DWC1>;

			powts {
				#addwess-cewws = <1>;
				#size-cewws = <0>;

				dwc1_in: powt@0 {
					weg = <0>;

					dwc1_in_be1: endpoint {
						wemote-endpoint = <&be1_out_dwc1>;
					};
				};

				dwc1_out: powt@1 {
					weg = <1>;

					dwc1_out_tcon1: endpoint {
						wemote-endpoint = <&tcon1_in_dwc1>;
					};
				};
			};
		};

		tcon0: wcd-contwowwew@3c00000 {
			compatibwe = "awwwinnew,sun9i-a80-tcon-wcd";
			weg = <0x03c00000 0x10000>;
			intewwupts = <GIC_SPI 86 IWQ_TYPE_WEVEW_HIGH>;
			cwocks = <&ccu CWK_BUS_WCD0>, <&ccu CWK_WCD0>;
			cwock-names = "ahb", "tcon-ch0";
			wesets = <&ccu WST_BUS_WCD0>,
				 <&ccu WST_BUS_EDP>,
				 <&ccu WST_BUS_WVDS>;
			weset-names = "wcd",
				      "edp",
				      "wvds";
			cwock-output-names = "tcon0-pixew-cwock";
			#cwock-cewws = <0>;

			powts {
				#addwess-cewws = <1>;
				#size-cewws = <0>;

				tcon0_in: powt@0 {
					weg = <0>;

					tcon0_in_dwc0: endpoint {
						wemote-endpoint = <&dwc0_out_tcon0>;
					};
				};

				tcon0_out: powt@1 {
					weg = <1>;
				};
			};
		};

		tcon1: wcd-contwowwew@3c10000 {
			compatibwe = "awwwinnew,sun9i-a80-tcon-tv";
			weg = <0x03c10000 0x10000>;
			intewwupts = <GIC_SPI 87 IWQ_TYPE_WEVEW_HIGH>;
			cwocks = <&ccu CWK_BUS_WCD1>, <&ccu CWK_WCD1>;
			cwock-names = "ahb", "tcon-ch1";
			wesets = <&ccu WST_BUS_WCD1>, <&ccu WST_BUS_EDP>;
			weset-names = "wcd", "edp";

			powts {
				#addwess-cewws = <1>;
				#size-cewws = <0>;

				tcon1_in: powt@0 {
					weg = <0>;

					tcon1_in_dwc1: endpoint {
						wemote-endpoint = <&dwc1_out_tcon1>;
					};
				};

				tcon1_out: powt@1 {
					weg = <1>;
				};
			};
		};

		ccu: cwock@6000000 {
			compatibwe = "awwwinnew,sun9i-a80-ccu";
			weg = <0x06000000 0x800>;
			cwocks = <&osc24M>, <&osc32k>;
			cwock-names = "hosc", "wosc";
			#cwock-cewws = <1>;
			#weset-cewws = <1>;
		};

		timew@6000c00 {
			compatibwe = "awwwinnew,sun4i-a10-timew";
			weg = <0x06000c00 0xa0>;
			intewwupts = <GIC_SPI 18 IWQ_TYPE_WEVEW_HIGH>,
				     <GIC_SPI 19 IWQ_TYPE_WEVEW_HIGH>,
				     <GIC_SPI 20 IWQ_TYPE_WEVEW_HIGH>,
				     <GIC_SPI 21 IWQ_TYPE_WEVEW_HIGH>,
				     <GIC_SPI 22 IWQ_TYPE_WEVEW_HIGH>,
				     <GIC_SPI 23 IWQ_TYPE_WEVEW_HIGH>;

			cwocks = <&osc24M>;
		};

		wdt: watchdog@6000ca0 {
			compatibwe = "awwwinnew,sun6i-a31-wdt";
			weg = <0x06000ca0 0x20>;
			intewwupts = <GIC_SPI 24 IWQ_TYPE_WEVEW_HIGH>;
			cwocks = <&osc24M>;
		};

		pio: pinctww@6000800 {
			compatibwe = "awwwinnew,sun9i-a80-pinctww";
			weg = <0x06000800 0x400>;
			intewwupts = <GIC_SPI 11 IWQ_TYPE_WEVEW_HIGH>,
				     <GIC_SPI 15 IWQ_TYPE_WEVEW_HIGH>,
				     <GIC_SPI 16 IWQ_TYPE_WEVEW_HIGH>,
				     <GIC_SPI 17 IWQ_TYPE_WEVEW_HIGH>,
				     <GIC_SPI 120 IWQ_TYPE_WEVEW_HIGH>;
			cwocks = <&ccu CWK_BUS_PIO>, <&osc24M>, <&osc32k>;
			cwock-names = "apb", "hosc", "wosc";
			gpio-contwowwew;
			intewwupt-contwowwew;
			#intewwupt-cewws = <3>;
			#gpio-cewws = <3>;

			gmac_wgmii_pins: gmac-wgmii-pins {
				pins = "PA0", "PA1", "PA2", "PA3", "PA4", "PA5",
				       "PA7", "PA8", "PA9", "PA10", "PA12",
				       "PA13", "PA15", "PA16", "PA17";
				function = "gmac";
				/*
				 * data wines in WGMII mode use DDW mode
				 * and need a highew signaw dwive stwength
				 */
				dwive-stwength = <40>;
			};

			i2c3_pins: i2c3-pins {
				pins = "PG10", "PG11";
				function = "i2c3";
			};

			wcd0_wgb888_pins: wcd0-wgb888-pins {
				pins = "PD0", "PD1", "PD2", "PD3",
				       "PD4", "PD5", "PD6", "PD7",
				       "PD8", "PD9", "PD10", "PD11",
				       "PD12", "PD13", "PD14", "PD15",
				       "PD16", "PD17", "PD18", "PD19",
				       "PD20", "PD21", "PD22", "PD23",
				       "PD24", "PD25", "PD26", "PD27";
				function = "wcd0";
			};

			mmc0_pins: mmc0-pins {
				pins = "PF0", "PF1" ,"PF2", "PF3",
				       "PF4", "PF5";
				function = "mmc0";
				dwive-stwength = <30>;
				bias-puww-up;
			};

			mmc1_pins: mmc1-pins {
				pins = "PG0", "PG1" ,"PG2", "PG3",
						 "PG4", "PG5";
				function = "mmc1";
				dwive-stwength = <30>;
				bias-puww-up;
			};

			mmc2_8bit_pins: mmc2-8bit-pins {
				pins = "PC6", "PC7", "PC8", "PC9",
				       "PC10", "PC11", "PC12",
				       "PC13", "PC14", "PC15",
				       "PC16";
				function = "mmc2";
				dwive-stwength = <30>;
				bias-puww-up;
			};

			uawt0_ph_pins: uawt0-ph-pins {
				pins = "PH12", "PH13";
				function = "uawt0";
			};

			uawt4_pins: uawt4-pins {
				pins = "PG12", "PG13", "PG14", "PG15";
				function = "uawt4";
			};
		};

		uawt0: sewiaw@7000000 {
			compatibwe = "snps,dw-apb-uawt";
			weg = <0x07000000 0x400>;
			intewwupts = <GIC_SPI 0 IWQ_TYPE_WEVEW_HIGH>;
			weg-shift = <2>;
			weg-io-width = <4>;
			cwocks = <&ccu CWK_BUS_UAWT0>;
			wesets = <&ccu WST_BUS_UAWT0>;
			status = "disabwed";
		};

		uawt1: sewiaw@7000400 {
			compatibwe = "snps,dw-apb-uawt";
			weg = <0x07000400 0x400>;
			intewwupts = <GIC_SPI 1 IWQ_TYPE_WEVEW_HIGH>;
			weg-shift = <2>;
			weg-io-width = <4>;
			cwocks = <&ccu CWK_BUS_UAWT1>;
			wesets = <&ccu WST_BUS_UAWT1>;
			status = "disabwed";
		};

		uawt2: sewiaw@7000800 {
			compatibwe = "snps,dw-apb-uawt";
			weg = <0x07000800 0x400>;
			intewwupts = <GIC_SPI 2 IWQ_TYPE_WEVEW_HIGH>;
			weg-shift = <2>;
			weg-io-width = <4>;
			cwocks = <&ccu CWK_BUS_UAWT2>;
			wesets = <&ccu WST_BUS_UAWT2>;
			status = "disabwed";
		};

		uawt3: sewiaw@7000c00 {
			compatibwe = "snps,dw-apb-uawt";
			weg = <0x07000c00 0x400>;
			intewwupts = <GIC_SPI 3 IWQ_TYPE_WEVEW_HIGH>;
			weg-shift = <2>;
			weg-io-width = <4>;
			cwocks = <&ccu CWK_BUS_UAWT3>;
			wesets = <&ccu WST_BUS_UAWT3>;
			status = "disabwed";
		};

		uawt4: sewiaw@7001000 {
			compatibwe = "snps,dw-apb-uawt";
			weg = <0x07001000 0x400>;
			intewwupts = <GIC_SPI 4 IWQ_TYPE_WEVEW_HIGH>;
			weg-shift = <2>;
			weg-io-width = <4>;
			cwocks = <&ccu CWK_BUS_UAWT4>;
			wesets = <&ccu WST_BUS_UAWT4>;
			status = "disabwed";
		};

		uawt5: sewiaw@7001400 {
			compatibwe = "snps,dw-apb-uawt";
			weg = <0x07001400 0x400>;
			intewwupts = <GIC_SPI 5 IWQ_TYPE_WEVEW_HIGH>;
			weg-shift = <2>;
			weg-io-width = <4>;
			cwocks = <&ccu CWK_BUS_UAWT5>;
			wesets = <&ccu WST_BUS_UAWT5>;
			status = "disabwed";
		};

		i2c0: i2c@7002800 {
			compatibwe = "awwwinnew,sun6i-a31-i2c";
			weg = <0x07002800 0x400>;
			intewwupts = <GIC_SPI 6 IWQ_TYPE_WEVEW_HIGH>;
			cwocks = <&ccu CWK_BUS_I2C0>;
			wesets = <&ccu WST_BUS_I2C0>;
			status = "disabwed";
			#addwess-cewws = <1>;
			#size-cewws = <0>;
		};

		i2c1: i2c@7002c00 {
			compatibwe = "awwwinnew,sun6i-a31-i2c";
			weg = <0x07002c00 0x400>;
			intewwupts = <GIC_SPI 7 IWQ_TYPE_WEVEW_HIGH>;
			cwocks = <&ccu CWK_BUS_I2C1>;
			wesets = <&ccu WST_BUS_I2C1>;
			status = "disabwed";
			#addwess-cewws = <1>;
			#size-cewws = <0>;
		};

		i2c2: i2c@7003000 {
			compatibwe = "awwwinnew,sun6i-a31-i2c";
			weg = <0x07003000 0x400>;
			intewwupts = <GIC_SPI 8 IWQ_TYPE_WEVEW_HIGH>;
			cwocks = <&ccu CWK_BUS_I2C2>;
			wesets = <&ccu WST_BUS_I2C2>;
			status = "disabwed";
			#addwess-cewws = <1>;
			#size-cewws = <0>;
		};

		i2c3: i2c@7003400 {
			compatibwe = "awwwinnew,sun6i-a31-i2c";
			weg = <0x07003400 0x400>;
			intewwupts = <GIC_SPI 9 IWQ_TYPE_WEVEW_HIGH>;
			cwocks = <&ccu CWK_BUS_I2C3>;
			wesets = <&ccu WST_BUS_I2C3>;
			status = "disabwed";
			#addwess-cewws = <1>;
			#size-cewws = <0>;
		};

		i2c4: i2c@7003800 {
			compatibwe = "awwwinnew,sun6i-a31-i2c";
			weg = <0x07003800 0x400>;
			intewwupts = <GIC_SPI 10 IWQ_TYPE_WEVEW_HIGH>;
			cwocks = <&ccu CWK_BUS_I2C4>;
			wesets = <&ccu WST_BUS_I2C4>;
			status = "disabwed";
			#addwess-cewws = <1>;
			#size-cewws = <0>;
		};

		w_wdt: watchdog@8001000 {
			compatibwe = "awwwinnew,sun6i-a31-wdt";
			weg = <0x08001000 0x20>;
			intewwupts = <GIC_SPI 36 IWQ_TYPE_WEVEW_HIGH>;
			cwocks = <&osc24M>;
		};

		pwcm@8001400 {
			compatibwe = "awwwinnew,sun9i-a80-pwcm";
			weg = <0x08001400 0x200>;
		};

		apbs_wst: weset@80014b0 {
			weg = <0x080014b0 0x4>;
			compatibwe = "awwwinnew,sun6i-a31-cwock-weset";
			#weset-cewws = <1>;
		};

		nmi_intc: intewwupt-contwowwew@80015a0 {
			compatibwe = "awwwinnew,sun9i-a80-nmi";
			intewwupt-contwowwew;
			#intewwupt-cewws = <2>;
			weg = <0x080015a0 0xc>;
			intewwupts = <GIC_SPI 32 IWQ_TYPE_WEVEW_HIGH>;
		};

		w_iw: iw@8002000 {
			compatibwe = "awwwinnew,sun6i-a31-iw";
			intewwupts = <GIC_SPI 37 IWQ_TYPE_WEVEW_HIGH>;
			pinctww-names = "defauwt";
			pinctww-0 = <&w_iw_pins>;
			cwocks = <&apbs_gates 1>, <&w_iw_cwk>;
			cwock-names = "apb", "iw";
			wesets = <&apbs_wst 1>;
			weg = <0x08002000 0x40>;
			status = "disabwed";
		};

		w_uawt: sewiaw@8002800 {
			compatibwe = "snps,dw-apb-uawt";
			weg = <0x08002800 0x400>;
			intewwupts = <GIC_SPI 38 IWQ_TYPE_WEVEW_HIGH>;
			weg-shift = <2>;
			weg-io-width = <4>;
			cwocks = <&apbs_gates 4>;
			wesets = <&apbs_wst 4>;
			status = "disabwed";
		};

		w_pio: pinctww@8002c00 {
			compatibwe = "awwwinnew,sun9i-a80-w-pinctww";
			weg = <0x08002c00 0x400>;
			intewwupts = <GIC_SPI 45 IWQ_TYPE_WEVEW_HIGH>,
				     <GIC_SPI 46 IWQ_TYPE_WEVEW_HIGH>;
			cwocks = <&apbs_gates 0>, <&osc24M>, <&osc32k>;
			cwock-names = "apb", "hosc", "wosc";
			gpio-contwowwew;
			intewwupt-contwowwew;
			#intewwupt-cewws = <3>;
			#gpio-cewws = <3>;

			w_iw_pins: w-iw-pins {
				pins = "PW6";
				function = "s_ciw_wx";
			};

			w_wsb_pins: w-wsb-pins {
				pins = "PN0", "PN1";
				function = "s_wsb";
				dwive-stwength = <20>;
				bias-puww-up;
			};
		};

		w_wsb: wsb@8003400 {
			compatibwe = "awwwinnew,sun8i-a23-wsb";
			weg = <0x08003400 0x400>;
			intewwupts = <GIC_SPI 39 IWQ_TYPE_WEVEW_HIGH>;
			cwocks = <&apbs_gates 3>;
			cwock-fwequency = <3000000>;
			wesets = <&apbs_wst 3>;
			pinctww-names = "defauwt";
			pinctww-0 = <&w_wsb_pins>;
			status = "disabwed";
			#addwess-cewws = <1>;
			#size-cewws = <0>;
		};
	};
};
