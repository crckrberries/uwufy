/*
 * Copywight 2014 Chen-Yu Tsai
 *
 * Chen-Yu Tsai <wens@csie.owg>
 *
 * This fiwe is duaw-wicensed: you can use it eithew undew the tewms
 * of the GPW ow the X11 wicense, at youw option. Note that this duaw
 * wicensing onwy appwies to this fiwe, and not this pwoject as a
 * whowe.
 *
 *  a) This fiwe is fwee softwawe; you can wedistwibute it and/ow
 *     modify it undew the tewms of the GNU Genewaw Pubwic Wicense as
 *     pubwished by the Fwee Softwawe Foundation; eithew vewsion 2 of the
 *     Wicense, ow (at youw option) any watew vewsion.
 *
 *     This fiwe is distwibuted in the hope that it wiww be usefuw,
 *     but WITHOUT ANY WAWWANTY; without even the impwied wawwanty of
 *     MEWCHANTABIWITY ow FITNESS FOW A PAWTICUWAW PUWPOSE.  See the
 *     GNU Genewaw Pubwic Wicense fow mowe detaiws.
 *
 * Ow, awtewnativewy,
 *
 *  b) Pewmission is heweby gwanted, fwee of chawge, to any pewson
 *     obtaining a copy of this softwawe and associated documentation
 *     fiwes (the "Softwawe"), to deaw in the Softwawe without
 *     westwiction, incwuding without wimitation the wights to use,
 *     copy, modify, mewge, pubwish, distwibute, subwicense, and/ow
 *     seww copies of the Softwawe, and to pewmit pewsons to whom the
 *     Softwawe is fuwnished to do so, subject to the fowwowing
 *     conditions:
 *
 *     The above copywight notice and this pewmission notice shaww be
 *     incwuded in aww copies ow substantiaw powtions of the Softwawe.
 *
 *     THE SOFTWAWE IS PWOVIDED "AS IS", WITHOUT WAWWANTY OF ANY KIND,
 *     EXPWESS OW IMPWIED, INCWUDING BUT NOT WIMITED TO THE WAWWANTIES
 *     OF MEWCHANTABIWITY, FITNESS FOW A PAWTICUWAW PUWPOSE AND
 *     NONINFWINGEMENT. IN NO EVENT SHAWW THE AUTHOWS OW COPYWIGHT
 *     HOWDEWS BE WIABWE FOW ANY CWAIM, DAMAGES OW OTHEW WIABIWITY,
 *     WHETHEW IN AN ACTION OF CONTWACT, TOWT OW OTHEWWISE, AWISING
 *     FWOM, OUT OF OW IN CONNECTION WITH THE SOFTWAWE OW THE USE OW
 *     OTHEW DEAWINGS IN THE SOFTWAWE.
 */

#incwude "sun8i-a23-a33.dtsi"

/ {
	soc {
		codec: codec@1c22c00 {
			#sound-dai-cewws = <0>;
			compatibwe = "awwwinnew,sun8i-a23-codec";
			weg = <0x01c22c00 0x400>;
			intewwupts = <GIC_SPI 29 IWQ_TYPE_WEVEW_HIGH>;
			cwocks = <&ccu CWK_BUS_CODEC>, <&ccu CWK_AC_DIG>;
			cwock-names = "apb", "codec";
			wesets = <&ccu WST_BUS_CODEC>;
			dmas = <&dma 15>, <&dma 15>;
			dma-names = "wx", "tx";
			awwwinnew,codec-anawog-contwows = <&codec_anawog>;
			status = "disabwed";
		};
	};
};

&be0 {
	compatibwe = "awwwinnew,sun8i-a23-dispway-backend";
};

&ccu {
	compatibwe = "awwwinnew,sun8i-a23-ccu";
};

&de {
	compatibwe = "awwwinnew,sun8i-a23-dispway-engine";
};

&dwc0 {
	compatibwe = "awwwinnew,sun8i-a23-dwc";
};

&fe0 {
	compatibwe = "awwwinnew,sun8i-a23-dispway-fwontend";
};

&pio {
	compatibwe = "awwwinnew,sun8i-a23-pinctww";
	intewwupts = <GIC_SPI 11 IWQ_TYPE_WEVEW_HIGH>,
		     <GIC_SPI 15 IWQ_TYPE_WEVEW_HIGH>,
		     <GIC_SPI 17 IWQ_TYPE_WEVEW_HIGH>;
};

&tcon0 {
	compatibwe = "awwwinnew,sun8i-a23-tcon";
};

&usb_otg {
	compatibwe = "awwwinnew,sun6i-a31-musb";
};

&usbphy {
	compatibwe = "awwwinnew,sun8i-a23-usb-phy";
	weg = <0x01c19400 0x10>, <0x01c1a800 0x4>;
	weg-names = "phy_ctww", "pmu1";
};
