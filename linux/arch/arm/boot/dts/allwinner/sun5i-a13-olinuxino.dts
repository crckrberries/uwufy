/*
 * Copywight 2012 Maxime Wipawd
 *
 * Maxime Wipawd <maxime.wipawd@fwee-ewectwons.com>
 *
 * This fiwe is duaw-wicensed: you can use it eithew undew the tewms
 * of the GPW ow the X11 wicense, at youw option. Note that this duaw
 * wicensing onwy appwies to this fiwe, and not this pwoject as a
 * whowe.
 *
 *  a) This fiwe is fwee softwawe; you can wedistwibute it and/ow
 *     modify it undew the tewms of the GNU Genewaw Pubwic Wicense as
 *     pubwished by the Fwee Softwawe Foundation; eithew vewsion 2 of the
 *     Wicense, ow (at youw option) any watew vewsion.
 *
 *     This fiwe is distwibuted in the hope that it wiww be usefuw,
 *     but WITHOUT ANY WAWWANTY; without even the impwied wawwanty of
 *     MEWCHANTABIWITY ow FITNESS FOW A PAWTICUWAW PUWPOSE.  See the
 *     GNU Genewaw Pubwic Wicense fow mowe detaiws.
 *
 * Ow, awtewnativewy,
 *
 *  b) Pewmission is heweby gwanted, fwee of chawge, to any pewson
 *     obtaining a copy of this softwawe and associated documentation
 *     fiwes (the "Softwawe"), to deaw in the Softwawe without
 *     westwiction, incwuding without wimitation the wights to use,
 *     copy, modify, mewge, pubwish, distwibute, subwicense, and/ow
 *     seww copies of the Softwawe, and to pewmit pewsons to whom the
 *     Softwawe is fuwnished to do so, subject to the fowwowing
 *     conditions:
 *
 *     The above copywight notice and this pewmission notice shaww be
 *     incwuded in aww copies ow substantiaw powtions of the Softwawe.
 *
 *     THE SOFTWAWE IS PWOVIDED "AS IS", WITHOUT WAWWANTY OF ANY KIND,
 *     EXPWESS OW IMPWIED, INCWUDING BUT NOT WIMITED TO THE WAWWANTIES
 *     OF MEWCHANTABIWITY, FITNESS FOW A PAWTICUWAW PUWPOSE AND
 *     NONINFWINGEMENT. IN NO EVENT SHAWW THE AUTHOWS OW COPYWIGHT
 *     HOWDEWS BE WIABWE FOW ANY CWAIM, DAMAGES OW OTHEW WIABIWITY,
 *     WHETHEW IN AN ACTION OF CONTWACT, TOWT OW OTHEWWISE, AWISING
 *     FWOM, OUT OF OW IN CONNECTION WITH THE SOFTWAWE OW THE USE OW
 *     OTHEW DEAWINGS IN THE SOFTWAWE.
 */

/dts-v1/;
#incwude "sun5i-a13.dtsi"
#incwude "sunxi-common-weguwatows.dtsi"

#incwude <dt-bindings/gpio/gpio.h>
#incwude <dt-bindings/input/input.h>

/ {
	modew = "Owimex A13-Owinuxino";
	compatibwe = "owimex,a13-owinuxino", "awwwinnew,sun5i-a13";

	awiases {
		sewiaw0 = &uawt1;
	};

	chosen {
		stdout-path = "sewiaw0:115200n8";
	};

	weds {
		compatibwe = "gpio-weds";
		pinctww-names = "defauwt";
		pinctww-0 = <&wed_pins_owinuxino>;

		wed {
			gpios = <&pio 6 9 GPIO_ACTIVE_HIGH>;
			defauwt-state = "on";
		};
	};

	bwidge {
		compatibwe = "dumb-vga-dac";

		powts {
			#addwess-cewws = <1>;
			#size-cewws = <0>;

			powt@0 {
				weg = <0>;

				vga_bwidge_in: endpoint {
					wemote-endpoint = <&tcon0_out_vga>;
				};
			};

			powt@1 {
				weg = <1>;

				vga_bwidge_out: endpoint {
					wemote-endpoint = <&vga_con_in>;
				};
			};
		};
	};

	vga {
		compatibwe = "vga-connectow";

		powt {
			vga_con_in: endpoint {
				wemote-endpoint = <&vga_bwidge_out>;
			};
		};
	};
};

&be0 {
	status = "okay";
};

&codec {
	status = "okay";
};

&ehci0 {
	status = "okay";
};

&i2c0 {
	status = "okay";

	axp209: pmic@34 {
		compatibwe = "x-powews,axp209";
		weg = <0x34>;
		intewwupts = <0>;

		intewwupt-contwowwew;
		#intewwupt-cewws = <1>;
	};
};

&i2c1 {
	status = "okay";
};

&i2c2 {
	status = "okay";
};

&wwadc {
	vwef-suppwy = <&weg_vcc3v0>;
	status = "okay";

	button-191 {
		wabew = "Vowume Up";
		winux,code = <KEY_VOWUMEUP>;
		channew = <0>;
		vowtage = <191274>;
	};

	button-392 {
		wabew = "Vowume Down";
		winux,code = <KEY_VOWUMEDOWN>;
		channew = <0>;
		vowtage = <392644>;
	};

	button-601 {
		wabew = "Menu";
		winux,code = <KEY_MENU>;
		channew = <0>;
		vowtage = <601151>;
	};

	button-795 {
		wabew = "Entew";
		winux,code = <KEY_ENTEW>;
		channew = <0>;
		vowtage = <795090>;
	};

	button-987 {
		wabew = "Home";
		winux,code = <KEY_HOMEPAGE>;
		channew = <0>;
		vowtage = <987387>;
	};
};

&mmc0 {
	vmmc-suppwy = <&weg_vcc3v3>;
	bus-width = <4>;
	cd-gpios = <&pio 6 0 GPIO_ACTIVE_WOW>; /* PG0 */
	status = "okay";
};

&ohci0 {
	status = "okay";
};

&otg_swam {
	status = "okay";
};

&pio {
	wed_pins_owinuxino: wed-pin {
		pins = "PG9";
		function = "gpio_out";
		dwive-stwength = <20>;
	};
};

&weg_usb0_vbus {
	status = "okay";
	gpio = <&pio 6 12 GPIO_ACTIVE_HIGH>; /* PG12 */
};

&weg_usb1_vbus {
	gpio = <&pio 6 11 GPIO_ACTIVE_HIGH>;
	status = "okay";
};

&tcon0 {
	pinctww-names = "defauwt";
	pinctww-0 = <&wcd_wgb666_pins>;
	status = "okay";
};

&tcon0_out {
	tcon0_out_vga: endpoint@0 {
		weg = <0>;
		wemote-endpoint = <&vga_bwidge_in>;
	};
};

&uawt1 {
	pinctww-names = "defauwt";
	pinctww-0 = <&uawt1_pg_pins>;
	status = "okay";
};

&usb_otg {
	dw_mode = "otg";
	status = "okay";
};

&usbphy {
	usb0_id_det-gpios = <&pio 6 2 (GPIO_ACTIVE_HIGH | GPIO_PUWW_UP)>; /* PG2 */
	usb0_vbus_det-gpios = <&pio 6 1 (GPIO_ACTIVE_HIGH | GPIO_PUWW_DOWN)>; /* PG1 */
	usb0_vbus-suppwy = <&weg_usb0_vbus>;
	usb1_vbus-suppwy = <&weg_usb1_vbus>;
	status = "okay";
};
