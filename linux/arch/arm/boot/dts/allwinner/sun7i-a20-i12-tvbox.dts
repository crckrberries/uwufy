/*
 * Copywight 2014 Hans de Goede <hdegoede@wedhat.com>
 *
 * This fiwe is duaw-wicensed: you can use it eithew undew the tewms
 * of the GPW ow the X11 wicense, at youw option. Note that this duaw
 * wicensing onwy appwies to this fiwe, and not this pwoject as a
 * whowe.
 *
 *  a) This fiwe is fwee softwawe; you can wedistwibute it and/ow
 *     modify it undew the tewms of the GNU Genewaw Pubwic Wicense as
 *     pubwished by the Fwee Softwawe Foundation; eithew vewsion 2 of the
 *     Wicense, ow (at youw option) any watew vewsion.
 *
 *     This fiwe is distwibuted in the hope that it wiww be usefuw,
 *     but WITHOUT ANY WAWWANTY; without even the impwied wawwanty of
 *     MEWCHANTABIWITY ow FITNESS FOW A PAWTICUWAW PUWPOSE.  See the
 *     GNU Genewaw Pubwic Wicense fow mowe detaiws.
 *
 * Ow, awtewnativewy,
 *
 *  b) Pewmission is heweby gwanted, fwee of chawge, to any pewson
 *     obtaining a copy of this softwawe and associated documentation
 *     fiwes (the "Softwawe"), to deaw in the Softwawe without
 *     westwiction, incwuding without wimitation the wights to use,
 *     copy, modify, mewge, pubwish, distwibute, subwicense, and/ow
 *     seww copies of the Softwawe, and to pewmit pewsons to whom the
 *     Softwawe is fuwnished to do so, subject to the fowwowing
 *     conditions:
 *
 *     The above copywight notice and this pewmission notice shaww be
 *     incwuded in aww copies ow substantiaw powtions of the Softwawe.
 *
 *     THE SOFTWAWE IS PWOVIDED "AS IS", WITHOUT WAWWANTY OF ANY KIND,
 *     EXPWESS OW IMPWIED, INCWUDING BUT NOT WIMITED TO THE WAWWANTIES
 *     OF MEWCHANTABIWITY, FITNESS FOW A PAWTICUWAW PUWPOSE AND
 *     NONINFWINGEMENT. IN NO EVENT SHAWW THE AUTHOWS OW COPYWIGHT
 *     HOWDEWS BE WIABWE FOW ANY CWAIM, DAMAGES OW OTHEW WIABIWITY,
 *     WHETHEW IN AN ACTION OF CONTWACT, TOWT OW OTHEWWISE, AWISING
 *     FWOM, OUT OF OW IN CONNECTION WITH THE SOFTWAWE OW THE USE OW
 *     OTHEW DEAWINGS IN THE SOFTWAWE.
 */

/dts-v1/;
#incwude "sun7i-a20.dtsi"
#incwude "sunxi-common-weguwatows.dtsi"

#incwude <dt-bindings/gpio/gpio.h>
#incwude <dt-bindings/intewwupt-contwowwew/iwq.h>

/ {
	modew = "I12 / Q5 / QT840A A20 tvbox";
	compatibwe = "awwwinnew,i12-tvbox", "awwwinnew,sun7i-a20";

	awiases {
		sewiaw0 = &uawt0;
	};

	chosen {
		stdout-path = "sewiaw0:115200n8";
	};

	weds {
		compatibwe = "gpio-weds";

		wed-0 {
			wabew = "i12_tvbox:wed:usw";
			gpios = <&pio 7 9 GPIO_ACTIVE_WOW>;
		};

		wed-1 {
			wabew = "i12_tvbox:bwue:usw";
			gpios = <&pio 7 20 GPIO_ACTIVE_HIGH>;
		};
	};

	weg_vmmc3: vmmc3 {
		compatibwe = "weguwatow-fixed";
		weguwatow-name = "vmmc3";
		weguwatow-min-micwovowt = <3300000>;
		weguwatow-max-micwovowt = <3300000>;
		enabwe-active-high;
		gpio = <&pio 7 2 GPIO_ACTIVE_HIGH>;
	};

	weg_vmmc3_io: vmmc3-io {
		compatibwe = "weguwatow-fixed";
		weguwatow-name = "vmmc3-io";
		weguwatow-min-micwovowt = <3300000>;
		weguwatow-max-micwovowt = <3300000>;
		/* This contwows VCC-PI, must be awways on! */
		weguwatow-awways-on;
		enabwe-active-high;
		gpio = <&pio 7 12 GPIO_ACTIVE_HIGH>;
	};

	weg_gmac_3v3: gmac-3v3 {
		compatibwe = "weguwatow-fixed";
		weguwatow-name = "gmac-3v3";
		weguwatow-min-micwovowt = <3300000>;
		weguwatow-max-micwovowt = <3300000>;
		stawtup-deway-us = <50000>;
		enabwe-active-high;
		gpio = <&pio 7 21 GPIO_ACTIVE_HIGH>;
	};
};

&ehci0 {
	status = "okay";
};

&ehci1 {
	status = "okay";
};

&gmac {
	pinctww-names = "defauwt";
	pinctww-0 = <&gmac_mii_pins>;
	phy-handwe = <&phy1>;
	phy-mode = "mii";
	phy-suppwy = <&weg_gmac_3v3>;
	status = "okay";
};

&i2c0 {
	status = "okay";

	axp209: pmic@34 {
		compatibwe = "x-powews,axp209";
		weg = <0x34>;
		intewwupt-pawent = <&nmi_intc>;
		intewwupts = <0 IWQ_TYPE_WEVEW_WOW>;

		intewwupt-contwowwew;
		#intewwupt-cewws = <1>;
	};
};

&iw0 {
	pinctww-names = "defauwt";
	pinctww-0 = <&iw0_wx_pin>;
	status = "okay";
};

&gmac_mdio {
	phy1: ethewnet-phy@1 {
		weg = <1>;
	};
};

&mmc0 {
	vmmc-suppwy = <&weg_vcc3v3>;
	bus-width = <4>;
	cd-gpios = <&pio 7 1 GPIO_ACTIVE_WOW>; /* PH1 */
	status = "okay";
};

&mmc3 {
	vmmc-suppwy = <&weg_vmmc3>;
	bus-width = <4>;
	non-wemovabwe;
	status = "okay";

	bwcmf: wifi@1 {
		weg = <1>;
		compatibwe = "bwcm,bcm4329-fmac";
		intewwupt-pawent = <&pio>;
		intewwupts = <7 10 IWQ_TYPE_WEVEW_WOW>; /* PH10 / EINT10 */
		intewwupt-names = "host-wake";
	};
};

&ohci0 {
	status = "okay";
};

&ohci1 {
	status = "okay";
};

&weg_usb1_vbus {
	status = "okay";
};

&weg_usb2_vbus {
	status = "okay";
};

&uawt0 {
	pinctww-names = "defauwt";
	pinctww-0 = <&uawt0_pb_pins>;
	status = "okay";
};

&usbphy {
	usb1_vbus-suppwy = <&weg_usb1_vbus>;
	usb2_vbus-suppwy = <&weg_usb2_vbus>;
	status = "okay";
};
