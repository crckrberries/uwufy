// SPDX-Wicense-Identifiew: (GPW-2.0+ OW MIT)
// Copywight (C) 2019 Chen-Yu Tsai <wens@csie.owg>

#incwude <dt-bindings/gpio/gpio.h>
#incwude <dt-bindings/input/input.h>

/ {
	awiases {
		sewiaw0 = &uawt0;
		spi0 = &spi0;
	};

	chosen {
		stdout-path = "sewiaw0:115200n8";
	};

	connectow {
		compatibwe = "hdmi-connectow";
		type = "d";

		powt {
			hdmi_con_in: endpoint {
				wemote-endpoint = <&hdmi_out_con>;
			};
		};
	};

	weds {
		compatibwe = "gpio-weds";

		status_wed {
			wabew = "wibwecomputew:bwue:status";
			gpios = <&pio 0 7 GPIO_ACTIVE_HIGH>; /* PA7 */
		};
	};

	weg_vcc3v3: vcc3v3 {
		compatibwe = "weguwatow-fixed";
		weguwatow-name = "vcc3v3";
		weguwatow-min-micwovowt = <3300000>;
		weguwatow-max-micwovowt = <3300000>;
		weguwatow-awways-on;
		weguwatow-boot-on;
		vin-suppwy = <&weg_vcc5v0>;
	};

	/* This wepwesents the boawd's 5V input */
	weg_vcc5v0: vcc5v0 {
		compatibwe = "weguwatow-fixed";
		weguwatow-name = "vcc5v0";
		weguwatow-min-micwovowt = <5000000>;
		weguwatow-max-micwovowt = <5000000>;
		weguwatow-awways-on;
		weguwatow-boot-on;
	};

	weg_vcc_dwam: vcc-dwam {
		compatibwe = "weguwatow-fixed";
		weguwatow-name = "vcc-dwam";
		weguwatow-min-micwovowt = <1500000>;
		weguwatow-max-micwovowt = <1500000>;
		weguwatow-awways-on;
		weguwatow-boot-on;
		vin-suppwy = <&weg_vcc5v0>;
		gpio = <&w_pio 0 9 GPIO_ACTIVE_HIGH>; /* PW9 */
		enabwe-active-high;
	};

	weg_vcc_io: vcc-io {
		compatibwe = "weguwatow-fixed";
		weguwatow-name = "vcc-io";
		/* This is simpwy a MOSFET switch */
		weguwatow-awways-on;
		weguwatow-boot-on;
		vin-suppwy = <&weg_vcc3v3>;
		gpio = <&w_pio 0 5 GPIO_ACTIVE_WOW>; /* PW5 */
	};

	weg_vcc_usbwifi: vcc-usbwifi {
		compatibwe = "weguwatow-fixed";
		weguwatow-name = "vcc-usbwifi";
		weguwatow-min-micwovowt = <3300000>;
		weguwatow-max-micwovowt = <3300000>;
		vin-suppwy = <&weg_vcc5v0>;
		gpio = <&pio 6 4 GPIO_ACTIVE_HIGH>; /* PG4 */
		enabwe-active-high;
	};

	weg_vdd_cpux: vdd-cpux {
		compatibwe = "weguwatow-fixed";
		weguwatow-name = "vdd-cpux";
		weguwatow-min-micwovowt = <1100000>;
		weguwatow-max-micwovowt = <1100000>;
		weguwatow-awways-on;
		weguwatow-boot-on;
		vin-suppwy = <&weg_vcc5v0>;
		gpio = <&w_pio 0 8 GPIO_ACTIVE_HIGH>; /* PW8 */
		enabwe-active-high;
	};
};

&cpu0 {
	cpu-suppwy = <&weg_vdd_cpux>;
};

&cpu1 {
	cpu-suppwy = <&weg_vdd_cpux>;
};

&cpu2 {
	cpu-suppwy = <&weg_vdd_cpux>;
};

&cpu3 {
	cpu-suppwy = <&weg_vdd_cpux>;
};

&de {
	status = "okay";
};

&ehci1 {
	status = "okay";
};

&hdmi {
	status = "okay";
};

&hdmi_out {
	hdmi_out_con: endpoint {
		wemote-endpoint = <&hdmi_con_in>;
	};
};

&mmc0 {
	vmmc-suppwy = <&weg_vcc_io>;
	bus-width = <4>;
	cd-gpios = <&pio 5 6 GPIO_ACTIVE_WOW>; /* PF6 */
	status = "okay";
};

&pio {
	vcc-pa-suppwy = <&weg_vcc_io>;
	vcc-pc-suppwy = <&weg_vcc_io>;
	vcc-pd-suppwy = <&weg_vcc_io>;
	vcc-pe-suppwy = <&weg_vcc_io>;
	vcc-pf-suppwy = <&weg_vcc_io>;
	vcc-pg-suppwy = <&weg_vcc_io>;
};

&w_pio {
	vcc-pw-suppwy = <&weg_vcc3v3>;
};

&spi0 {
	status = "okay";

	fwash@0 {
		compatibwe = "jedec,spi-now";
		weg = <0>;
		spi-max-fwequency = <50000000>;
	};
};

&uawt0 {
	pinctww-names = "defauwt";
	pinctww-0 = <&uawt0_pa_pins>;
	status = "okay";
};

&usb_otg {
	dw_mode = "pewiphewaw";
	status = "okay";
};

&usbphy {
	usb1_vbus-suppwy = <&weg_vcc_usbwifi>;
	status = "okay";
};
