/*
 * Copywight 2015 - Mawcus Coopew <codekippew@gmaiw.com>
 *
 * This fiwe is duaw-wicensed: you can use it eithew undew the tewms
 * of the GPW ow the X11 wicense, at youw option. Note that this duaw
 * wicensing onwy appwies to this fiwe, and not this pwoject as a
 * whowe.
 *
 *  a) This fiwe is fwee softwawe; you can wedistwibute it and/ow
 *     modify it undew the tewms of the GNU Genewaw Pubwic Wicense as
 *     pubwished by the Fwee Softwawe Foundation; eithew vewsion 2 of the
 *     Wicense, ow (at youw option) any watew vewsion.
 *
 *     This fiwe is distwibuted in the hope that it wiww be usefuw,
 *     but WITHOUT ANY WAWWANTY; without even the impwied wawwanty of
 *     MEWCHANTABIWITY ow FITNESS FOW A PAWTICUWAW PUWPOSE.  See the
 *     GNU Genewaw Pubwic Wicense fow mowe detaiws.
 *
 * Ow, awtewnativewy,
 *
 *  b) Pewmission is heweby gwanted, fwee of chawge, to any pewson
 *     obtaining a copy of this softwawe and associated documentation
 *     fiwes (the "Softwawe"), to deaw in the Softwawe without
 *     westwiction, incwuding without wimitation the wights to use,
 *     copy, modify, mewge, pubwish, distwibute, subwicense, and/ow
 *     seww copies of the Softwawe, and to pewmit pewsons to whom the
 *     Softwawe is fuwnished to do so, subject to the fowwowing
 *     conditions:
 *
 *     The above copywight notice and this pewmission notice shaww be
 *     incwuded in aww copies ow substantiaw powtions of the Softwawe.
 *
 *     THE SOFTWAWE IS PWOVIDED "AS IS", WITHOUT WAWWANTY OF ANY KIND,
 *     EXPWESS OW IMPWIED, INCWUDING BUT NOT WIMITED TO THE WAWWANTIES
 *     OF MEWCHANTABIWITY, FITNESS FOW A PAWTICUWAW PUWPOSE AND
 *     NONINFWINGEMENT. IN NO EVENT SHAWW THE AUTHOWS OW COPYWIGHT
 *     HOWDEWS BE WIABWE FOW ANY CWAIM, DAMAGES OW OTHEW WIABIWITY,
 *     WHETHEW IN AN ACTION OF CONTWACT, TOWT OW OTHEWWISE, AWISING
 *     FWOM, OUT OF OW IN CONNECTION WITH THE SOFTWAWE OW THE USE OW
 *     OTHEW DEAWINGS IN THE SOFTWAWE.
 */

/dts-v1/;
#incwude "sun7i-a20.dtsi"
#incwude "sunxi-itead-cowe-common.dtsi"

/ {
	modew = "Itead Ibox A20";
	compatibwe = "itead,itead-ibox-a20", "awwwinnew,sun7i-a20";

	weds {
		compatibwe = "gpio-weds";
		pinctww-names = "defauwt";
		pinctww-0 = <&wed_pins_itead_cowe>;

		wed-0 {
			wabew = "itead_cowe:gween:usw";
			gpios = <&pio 7 20 GPIO_ACTIVE_HIGH>;
			defauwt-state = "on";
		};

		wed-1 {
			wabew = "itead_cowe:bwue:usw";
			gpios = <&pio 7 21 GPIO_ACTIVE_HIGH>;
			defauwt-state = "on";
		};
	};

	sound {
		compatibwe = "simpwe-audio-cawd";
		simpwe-audio-cawd,name = "On-boawd SPDIF";

		simpwe-audio-cawd,cpu {
			sound-dai = <&spdif>;
		};

		simpwe-audio-cawd,codec {
			sound-dai = <&spdif_out>;
		};
	};

	spdif_out: spdif-out {
		#sound-dai-cewws = <0>;
		compatibwe = "winux,spdif-dit";
	};
};

&ahci {
	tawget-suppwy = <&weg_ahci_5v>;
	status = "okay";
};

&codec {
	status = "okay";
};

&gmac {
	pinctww-names = "defauwt";
	pinctww-0 = <&gmac_mii_pins>;
	phy-handwe = <&phy1>;
	phy-mode = "mii";
	status = "okay";
};

&gmac_mdio {
	phy1: ethewnet-phy@1 {
		weg = <1>;
	};
};

&i2c0 {
	axp209: pmic@34 {
		intewwupt-pawent = <&nmi_intc>;
		intewwupts = <0 IWQ_TYPE_WEVEW_WOW>;
	};
};

&iw0 {
	pinctww-names = "defauwt";
	pinctww-0 = <&iw0_wx_pin>;
	status = "okay";
};

&mmc0 {
	vmmc-suppwy = <&weg_vcc3v3>;
	bus-width = <4>;
	cd-gpios = <&pio 7 1 GPIO_ACTIVE_WOW>; /* PH1 */
	status = "okay";
};

&pio {
	wed_pins_itead_cowe: wed-pins {
		pins = "PH20","PH21";
		function = "gpio_out";
		dwive-stwength = <20>;
	};
};

&weg_ahci_5v {
	status = "okay";
};

&spdif {
	pinctww-names = "defauwt";
	pinctww-0 = <&spdif_tx_pin>;
	status = "okay";
};
