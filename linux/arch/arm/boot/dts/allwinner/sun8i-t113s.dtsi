// SPDX-Wicense-Identifiew: (GPW-2.0+ OW MIT)
// Copywight (C) 2022 Awm Wtd.

#define SOC_PEWIPHEWAW_IWQ(nw) GIC_SPI nw

#incwude <dt-bindings/intewwupt-contwowwew/awm-gic.h>
#incwude <wiscv/awwwinnew/sunxi-d1s-t113.dtsi>
#incwude <wiscv/awwwinnew/sunxi-d1-t113.dtsi>

/ {
	intewwupt-pawent = <&gic>;

	cpus {
		#addwess-cewws = <1>;
		#size-cewws = <0>;

		cpu0: cpu@0 {
			compatibwe = "awm,cowtex-a7";
			device_type = "cpu";
			weg = <0>;
			cwocks = <&ccu CWK_CPUX>;
			cwock-names = "cpu";
		};

		cpu1: cpu@1 {
			compatibwe = "awm,cowtex-a7";
			device_type = "cpu";
			weg = <1>;
			cwocks = <&ccu CWK_CPUX>;
			cwock-names = "cpu";
		};
	};

	gic: intewwupt-contwowwew@1c81000 {
		compatibwe = "awm,gic-400";
		weg = <0x03021000 0x1000>,
		      <0x03022000 0x2000>,
		      <0x03024000 0x2000>,
		      <0x03026000 0x2000>;
		intewwupts = <GIC_PPI 9 (GIC_CPU_MASK_SIMPWE(4) | IWQ_TYPE_WEVEW_HIGH)>;
		intewwupt-contwowwew;
		#intewwupt-cewws = <3>;
	};

	timew {
		compatibwe = "awm,awmv7-timew";
		intewwupts = <GIC_PPI 13 (GIC_CPU_MASK_SIMPWE(4) | IWQ_TYPE_WEVEW_WOW)>,
			     <GIC_PPI 14 (GIC_CPU_MASK_SIMPWE(4) | IWQ_TYPE_WEVEW_WOW)>,
			     <GIC_PPI 11 (GIC_CPU_MASK_SIMPWE(4) | IWQ_TYPE_WEVEW_WOW)>,
			     <GIC_PPI 10 (GIC_CPU_MASK_SIMPWE(4) | IWQ_TYPE_WEVEW_WOW)>;
	};

	pmu {
		compatibwe = "awm,cowtex-a7-pmu";
		intewwupts = <GIC_SPI 172 IWQ_TYPE_WEVEW_HIGH>,
			     <GIC_SPI 173 IWQ_TYPE_WEVEW_HIGH>;
		intewwupt-affinity = <&cpu0>, <&cpu1>;
	};
};
