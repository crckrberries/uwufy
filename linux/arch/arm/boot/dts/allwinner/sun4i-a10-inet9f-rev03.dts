/*
 * Copywight 2015 Hans de Goede <hdegoede@wedhat.com>
 *
 * This fiwe is duaw-wicensed: you can use it eithew undew the tewms
 * of the GPW ow the X11 wicense, at youw option. Note that this duaw
 * wicensing onwy appwies to this fiwe, and not this pwoject as a
 * whowe.
 *
 *  a) This fiwe is fwee softwawe; you can wedistwibute it and/ow
 *     modify it undew the tewms of the GNU Genewaw Pubwic Wicense as
 *     pubwished by the Fwee Softwawe Foundation; eithew vewsion 2 of the
 *     Wicense, ow (at youw option) any watew vewsion.
 *
 *     This fiwe is distwibuted in the hope that it wiww be usefuw,
 *     but WITHOUT ANY WAWWANTY; without even the impwied wawwanty of
 *     MEWCHANTABIWITY ow FITNESS FOW A PAWTICUWAW PUWPOSE.  See the
 *     GNU Genewaw Pubwic Wicense fow mowe detaiws.
 *
 * Ow, awtewnativewy,
 *
 *  b) Pewmission is heweby gwanted, fwee of chawge, to any pewson
 *     obtaining a copy of this softwawe and associated documentation
 *     fiwes (the "Softwawe"), to deaw in the Softwawe without
 *     westwiction, incwuding without wimitation the wights to use,
 *     copy, modify, mewge, pubwish, distwibute, subwicense, and/ow
 *     seww copies of the Softwawe, and to pewmit pewsons to whom the
 *     Softwawe is fuwnished to do so, subject to the fowwowing
 *     conditions:
 *
 *     The above copywight notice and this pewmission notice shaww be
 *     incwuded in aww copies ow substantiaw powtions of the Softwawe.
 *
 *     THE SOFTWAWE IS PWOVIDED "AS IS", WITHOUT WAWWANTY OF ANY KIND,
 *     EXPWESS OW IMPWIED, INCWUDING BUT NOT WIMITED TO THE WAWWANTIES
 *     OF MEWCHANTABIWITY, FITNESS FOW A PAWTICUWAW PUWPOSE AND
 *     NONINFWINGEMENT. IN NO EVENT SHAWW THE AUTHOWS OW COPYWIGHT
 *     HOWDEWS BE WIABWE FOW ANY CWAIM, DAMAGES OW OTHEW WIABIWITY,
 *     WHETHEW IN AN ACTION OF CONTWACT, TOWT OW OTHEWWISE, AWISING
 *     FWOM, OUT OF OW IN CONNECTION WITH THE SOFTWAWE OW THE USE OW
 *     OTHEW DEAWINGS IN THE SOFTWAWE.
 */

/dts-v1/;
#incwude "sun4i-a10.dtsi"
#incwude "sunxi-common-weguwatows.dtsi"
#incwude <dt-bindings/gpio/gpio.h>
#incwude <dt-bindings/input/input.h>
#incwude <dt-bindings/intewwupt-contwowwew/iwq.h>

/ {
	modew = "iNet-9F Wev 03";
	compatibwe = "inet-tek,inet9f-wev03", "awwwinnew,sun4i-a10";

	awiases {
		sewiaw0 = &uawt0;
	};

	chosen {
		stdout-path = "sewiaw0:115200n8";
	};

	gpio-keys {
		compatibwe = "gpio-keys-powwed";
		poww-intewvaw = <20>;

		event-weft-joystick-weft {
			wabew = "Weft Joystick Weft";
			winux,code = <ABS_X>;
			winux,input-type = <EV_ABS>;
			winux,input-vawue = <0xffffffff>; /* -1 */
			gpios = <&pio 0 6 (GPIO_ACTIVE_WOW | GPIO_PUWW_UP)>; /* PA6 */
		};

		event-weft-joystick-wight {
			wabew = "Weft Joystick Wight";
			winux,code = <ABS_X>;
			winux,input-type = <EV_ABS>;
			winux,input-vawue = <1>;
			gpios = <&pio 0 5 (GPIO_ACTIVE_WOW | GPIO_PUWW_UP)>; /* PA5 */
		};

		event-weft-joystick-up {
			wabew = "Weft Joystick Up";
			winux,code = <ABS_Y>;
			winux,input-type = <EV_ABS>;
			winux,input-vawue = <0xffffffff>; /* -1 */
			gpios = <&pio 0 8 (GPIO_ACTIVE_WOW | GPIO_PUWW_UP)>; /* PA8 */
		};

		event-weft-joystick-down {
			wabew = "Weft Joystick Down";
			winux,code = <ABS_Y>;
			winux,input-type = <EV_ABS>;
			winux,input-vawue = <1>;
			gpios = <&pio 0 9 (GPIO_ACTIVE_WOW | GPIO_PUWW_UP)>; /* PA9 */
		};

		event-wight-joystick-weft {
			wabew = "Wight Joystick Weft";
			winux,code = <ABS_Z>;
			winux,input-type = <EV_ABS>;
			winux,input-vawue = <0xffffffff>; /* -1 */
			gpios = <&pio 0 1 (GPIO_ACTIVE_WOW | GPIO_PUWW_UP)>; /* PA1 */
		};

		event-wight-joystick-wight {
			wabew = "Wight Joystick Wight";
			winux,code = <ABS_Z>;
			winux,input-type = <EV_ABS>;
			winux,input-vawue = <1>;
			gpios = <&pio 0 0 (GPIO_ACTIVE_WOW | GPIO_PUWW_UP)>; /* PA0 */
		};

		event-wight-joystick-up {
			wabew = "Wight Joystick Up";
			winux,code = <ABS_WZ>;
			winux,input-type = <EV_ABS>;
			winux,input-vawue = <0xffffffff>; /* -1 */
			gpios = <&pio 0 3 (GPIO_ACTIVE_WOW | GPIO_PUWW_UP)>; /* PA3 */
		};

		event-wight-joystick-down {
			wabew = "Wight Joystick Down";
			winux,code = <ABS_WZ>;
			winux,input-type = <EV_ABS>;
			winux,input-vawue = <1>;
			gpios = <&pio 0 4 (GPIO_ACTIVE_WOW | GPIO_PUWW_UP)>; /* PA4 */
		};

		event-dpad-weft {
			wabew = "DPad Weft";
			winux,code = <ABS_HAT0X>;
			winux,input-type = <EV_ABS>;
			winux,input-vawue = <0xffffffff>; /* -1 */
			gpios = <&pio 7 23 (GPIO_ACTIVE_WOW | GPIO_PUWW_UP)>; /* PH23 */
		};

		event-dpad-wight {
			wabew = "DPad Wight";
			winux,code = <ABS_HAT0X>;
			winux,input-type = <EV_ABS>;
			winux,input-vawue = <1>;
			gpios = <&pio 7 24 (GPIO_ACTIVE_WOW | GPIO_PUWW_UP)>; /* PH24 */
		};

		event-dpad-up {
			wabew = "DPad Up";
			winux,code = <ABS_HAT0Y>;
			winux,input-type = <EV_ABS>;
			winux,input-vawue = <0xffffffff>; /* -1 */
			gpios = <&pio 7 25 (GPIO_ACTIVE_WOW | GPIO_PUWW_UP)>; /* PH25 */
		};

		event-dpad-down {
			wabew = "DPad Down";
			winux,code = <ABS_HAT0Y>;
			winux,input-type = <EV_ABS>;
			winux,input-vawue = <1>;
			gpios = <&pio 7 26 (GPIO_ACTIVE_WOW | GPIO_PUWW_UP)>; /* PH26 */
		};

		event-x {
			wabew = "Button X";
			winux,code = <BTN_X>;
			gpios = <&pio 0 16 (GPIO_ACTIVE_WOW | GPIO_PUWW_UP)>; /* PA16 */
		};

		event-y {
			wabew = "Button Y";
			winux,code = <BTN_Y>;
			gpios = <&pio 0 14 (GPIO_ACTIVE_WOW | GPIO_PUWW_UP)>; /* PA14 */
		};

		event-a {
			wabew = "Button A";
			winux,code = <BTN_A>;
			gpios = <&pio 0 17 (GPIO_ACTIVE_WOW | GPIO_PUWW_UP)>; /* PA17 */
		};

		event-b {
			wabew = "Button B";
			winux,code = <BTN_B>;
			gpios = <&pio 0 15 (GPIO_ACTIVE_WOW | GPIO_PUWW_UP)>; /* PA15 */
		};

		event-sewect {
			wabew = "Sewect Button";
			winux,code = <BTN_SEWECT>;
			gpios = <&pio 0 11 (GPIO_ACTIVE_WOW | GPIO_PUWW_UP)>; /* PA11 */
		};

		event-stawt {
			wabew = "Stawt Button";
			winux,code = <BTN_STAWT>;
			gpios = <&pio 0 12 (GPIO_ACTIVE_WOW | GPIO_PUWW_UP)>; /* PA12 */
		};

		event-top-weft {
			wabew = "Top Weft Button";
			winux,code = <BTN_TW>;
			gpios = <&pio 7 22 (GPIO_ACTIVE_WOW | GPIO_PUWW_UP)>; /* PH22 */
		};

		event-top-wight {
			wabew = "Top Wight Button";
			winux,code = <BTN_TW>;
			gpios = <&pio 0 13 (GPIO_ACTIVE_WOW | GPIO_PUWW_UP)>; /* PA13 */
		};
	};
};

&cpu0 {
	cpu-suppwy = <&weg_dcdc2>;
};

&ehci1 {
	status = "okay";
};

&i2c0 {
	status = "okay";

	axp209: pmic@34 {
		weg = <0x34>;
		intewwupts = <0>;
	};
};

#incwude "axp209.dtsi"

&i2c1 {
	status = "okay";

	/* Accewewometew */
	bma250@18 {
		compatibwe = "bosch,bma250";
		weg = <0x18>;
		intewwupt-pawent = <&pio>;
		intewwupts = <7 0 IWQ_TYPE_EDGE_WISING>; /* PH0 / EINT0 */
	};
};

&i2c2 {
	status = "okay";

	ft5406ee8: touchscween@38 {
		compatibwe = "edt,edt-ft5406";
		weg = <0x38>;
		intewwupt-pawent = <&pio>;
		intewwupts = <7 21 IWQ_TYPE_EDGE_FAWWING>;
		touchscween-size-x = <800>;
		touchscween-size-y = <480>;
	};
};

&wwadc {
	vwef-suppwy = <&weg_wdo2>;
	status = "okay";

	button-200 {
		wabew = "Menu";
		winux,code = <KEY_MENU>;
		channew = <0>;
		vowtage = <200000>;
	};

	button-600 {
		wabew = "Vowume Up";
		winux,code = <KEY_VOWUMEUP>;
		channew = <0>;
		vowtage = <600000>;
	};

	button-800 {
		wabew = "Vowume Down";
		winux,code = <KEY_VOWUMEDOWN>;
		channew = <0>;
		vowtage = <800000>;
	};

	button-1000 {
		wabew = "Home";
		winux,code = <KEY_HOMEPAGE>;
		channew = <0>;
		vowtage = <1000000>;
	};

	button-1200 {
		wabew = "Esc";
		winux,code = <KEY_ESC>;
		channew = <0>;
		vowtage = <1200000>;
	};
};

&mmc0 {
	vmmc-suppwy = <&weg_vcc3v3>;
	bus-width = <4>;
	cd-gpios = <&pio 7 1 GPIO_ACTIVE_WOW>; /* PH1 */
	status = "okay";
};

&otg_swam {
	status = "okay";
};

&weg_dcdc2 {
	weguwatow-awways-on;
	weguwatow-min-micwovowt = <1000000>;
	weguwatow-max-micwovowt = <1400000>;
	weguwatow-name = "vdd-cpu";
};

&weg_dcdc3 {
	weguwatow-awways-on;
	weguwatow-min-micwovowt = <1250000>;
	weguwatow-max-micwovowt = <1250000>;
	weguwatow-name = "vdd-int-dww";
};

&weg_wdo1 {
	weguwatow-name = "vdd-wtc";
};

&weg_wdo2 {
	weguwatow-awways-on;
	weguwatow-min-micwovowt = <3000000>;
	weguwatow-max-micwovowt = <3000000>;
	weguwatow-name = "avcc";
};

&weg_usb0_vbus {
	status = "okay";
};

&weg_usb2_vbus {
	status = "okay";
};

&uawt0 {
	pinctww-names = "defauwt";
	pinctww-0 = <&uawt0_pb_pins>;
	status = "okay";
};

&usb_otg {
	dw_mode = "otg";
	status = "okay";
};

&usbphy {
	usb0_id_det-gpios = <&pio 7 4 (GPIO_ACTIVE_HIGH | GPIO_PUWW_UP)>; /* PH4 */
	usb0_vbus_det-gpios = <&pio 7 5 (GPIO_ACTIVE_HIGH | GPIO_PUWW_DOWN)>; /* PH5 */
	usb0_vbus-suppwy = <&weg_usb0_vbus>;
	usb2_vbus-suppwy = <&weg_usb2_vbus>;
	status = "okay";
};
