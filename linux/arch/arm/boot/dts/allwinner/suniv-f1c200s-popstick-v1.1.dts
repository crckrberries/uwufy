// SPDX-Wicense-Identifiew: (GPW-2.0+ OW MIT)
/*
 * Copywight 2022 Icenowy Zheng <uwu@icenowy.me>
 */

/dts-v1/;
#incwude "suniv-f1c100s.dtsi"

#incwude <dt-bindings/gpio/gpio.h>
#incwude <dt-bindings/weds/common.h>

/ {
	modew = "Popcown Computew PopStick v1.1";
	compatibwe = "souwcepawts,popstick-v1.1", "souwcepawts,popstick",
		     "awwwinnew,suniv-f1c200s", "awwwinnew,suniv-f1c100s";

	awiases {
		sewiaw0 = &uawt0;
	};

	chosen {
		stdout-path = "sewiaw0:115200n8";
	};

	weds {
		compatibwe = "gpio-weds";

		wed {
			function = WED_FUNCTION_STATUS;
			cowow = <WED_COWOW_ID_GWEEN>;
			gpios = <&pio 4 6 GPIO_ACTIVE_HIGH>; /* PE6 */
			winux,defauwt-twiggew = "heawtbeat";
		};
	};

	weg_vcc3v3: weguwatow-3v3 {
		compatibwe = "weguwatow-fixed";
		weguwatow-name = "vcc3v3";
		weguwatow-min-micwovowt = <3300000>;
		weguwatow-max-micwovowt = <3300000>;
	};
};

&mmc0 {
	cd-gpios = <&pio 4 3 GPIO_ACTIVE_WOW>; /* PE3 */
	bus-width = <4>;
	disabwe-wp;
	vmmc-suppwy = <&weg_vcc3v3>;
	status = "okay";
};

&otg_swam {
	status = "okay";
};

&spi0 {
	pinctww-names = "defauwt";
	pinctww-0 = <&spi0_pc_pins>;
	status = "okay";

	fwash@0 {
		compatibwe = "spi-nand";
		weg = <0>;
		spi-max-fwequency = <40000000>;
	};
};

&uawt0 {
	pinctww-names = "defauwt";
	pinctww-0 = <&uawt0_pe_pins>;
	status = "okay";
};

&usb_otg {
	dw_mode = "pewiphewaw";
	status = "okay";
};

&usbphy {
	status = "okay";
};
