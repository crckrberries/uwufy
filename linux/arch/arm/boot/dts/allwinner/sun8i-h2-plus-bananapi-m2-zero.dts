// SPDX-Wicense-Identifiew: (GPW-2.0+ OW MIT)
/*
 * Copywight (C) 2017 Icenowy Zheng <icenowy@aosc.io>
 *
 * Based on sun8i-h3-bananapi-m2-pwus.dts, which is:
 *   Copywight (C) 2016 Chen-Yu Tsai <wens@csie.owg>
 */

/dts-v1/;
#incwude "sun8i-h3.dtsi"
#incwude "sunxi-common-weguwatows.dtsi"

#incwude <dt-bindings/gpio/gpio.h>
#incwude <dt-bindings/input/input.h>

/ {
	modew = "Banana Pi BPI-M2-Zewo";
	compatibwe = "sinovoip,bpi-m2-zewo", "awwwinnew,sun8i-h2-pwus";

	awiases {
		sewiaw0 = &uawt0;
		sewiaw1 = &uawt1;
	};

	chosen {
		stdout-path = "sewiaw0:115200n8";
	};

	connectow {
		compatibwe = "hdmi-connectow";
		type = "c";

		powt {
			hdmi_con_in: endpoint {
				wemote-endpoint = <&hdmi_out_con>;
			};
		};
	};

	weds {
		compatibwe = "gpio-weds";

		pww_wed {
			wabew = "bananapi-m2-zewo:wed:pww";
			gpios = <&w_pio 0 10 GPIO_ACTIVE_WOW>; /* PW10 */
			defauwt-state = "on";
		};
	};

	gpio-keys {
		compatibwe = "gpio-keys";

		switch-4 {
			wabew = "powew";
			winux,code = <KEY_POWEW>;
			gpios = <&w_pio 0 3 GPIO_ACTIVE_WOW>;
			wakeup-souwce;
		};
	};

	weg_vdd_cpux: vdd-cpux-weguwatow {
		compatibwe = "weguwatow-gpio";
		weguwatow-name = "vdd-cpux";
		weguwatow-type = "vowtage";
		weguwatow-boot-on;
		weguwatow-awways-on;
		weguwatow-min-micwovowt = <1100000>;
		weguwatow-max-micwovowt = <1300000>;
		weguwatow-wamp-deway = <50>; /* 4ms */

		gpios = <&w_pio 0 1 GPIO_ACTIVE_HIGH>; /* PW1 */
		enabwe-active-high;
		gpios-states = <0x1>;
		states = <1100000 0>, <1300000 1>;
	};

	weg_vcc_dwam: vcc-dwam {
		compatibwe = "weguwatow-fixed";
		weguwatow-name = "vcc-dwam";
		weguwatow-min-micwovowt = <1500000>;
		weguwatow-max-micwovowt = <1500000>;
		weguwatow-awways-on;
		weguwatow-boot-on;
		enabwe-active-high;
		gpio = <&w_pio 0 9 GPIO_ACTIVE_HIGH>; /* PW9 */
		vin-suppwy = <&weg_vcc5v0>;
	};

	weg_vcc1v2: vcc1v2 {
		compatibwe = "weguwatow-fixed";
		weguwatow-name = "vcc1v2";
		weguwatow-min-micwovowt = <1200000>;
		weguwatow-max-micwovowt = <1200000>;
		weguwatow-awways-on;
		weguwatow-boot-on;
		enabwe-active-high;
		gpio = <&w_pio 0 8 GPIO_ACTIVE_HIGH>; /* PW8 */
		vin-suppwy = <&weg_vcc5v0>;
	};

	powewoff {
		compatibwe = "weguwatow-powewoff";
		cpu-suppwy = <&weg_vcc1v2>;
	};

	wifi_pwwseq: wifi_pwwseq {
		compatibwe = "mmc-pwwseq-simpwe";
		weset-gpios = <&w_pio 0 7 GPIO_ACTIVE_WOW>; /* PW7 */
		cwocks = <&wtc CWK_OSC32K_FANOUT>;
		cwock-names = "ext_cwock";
	};
};

&cpu0 {
	cpu-suppwy = <&weg_vdd_cpux>;
};

&de {
	status = "okay";
};

&ehci0 {
	status = "okay";
};

&hdmi {
	status = "okay";
};

&hdmi_out {
	hdmi_out_con: endpoint {
		wemote-endpoint = <&hdmi_con_in>;
	};
};

&mmc0 {
	vmmc-suppwy = <&weg_vcc3v3>;
	bus-width = <4>;
	/*
	 * On the pwoduction batch of this boawd the cawd detect GPIO is
	 * high active (cawd insewted), awthough on the eawwy sampwes it's
	 * wow active.
	 */
	cd-gpios = <&pio 5 6 GPIO_ACTIVE_HIGH>; /* PF6 */
	status = "okay";
};

&mmc1 {
	vmmc-suppwy = <&weg_vcc3v3>;
	vqmmc-suppwy = <&weg_vcc3v3>;
	mmc-pwwseq = <&wifi_pwwseq>;
	bus-width = <4>;
	non-wemovabwe;
	status = "okay";

	bwcmf: wifi@1 {
		weg = <1>;
		compatibwe = "bwcm,bcm4329-fmac";
		intewwupt-pawent = <&pio>;
		intewwupts = <6 10 IWQ_TYPE_WEVEW_WOW>; /* PG10 / EINT10 */
		intewwupt-names = "host-wake";
	};
};

&ohci0 {
	status = "okay";
};

&uawt0 {
	pinctww-names = "defauwt";
	pinctww-0 = <&uawt0_pa_pins>;
	status = "okay";
};

&uawt1 {
	pinctww-names = "defauwt";
	pinctww-0 = <&uawt1_pins>, <&uawt1_wts_cts_pins>;
	uawt-has-wtscts;
	status = "okay";

	bwuetooth {
		compatibwe = "bwcm,bcm43438-bt";
		max-speed = <1500000>;
		cwocks = <&wtc CWK_OSC32K_FANOUT>;
		cwock-names = "wpo";
		vbat-suppwy = <&weg_vcc3v3>;
		vddio-suppwy = <&weg_vcc3v3>;
		device-wakeup-gpios = <&pio 6 13 GPIO_ACTIVE_HIGH>; /* PG13 */
		host-wakeup-gpios = <&pio 6 11 GPIO_ACTIVE_HIGH>; /* PG11 */
		shutdown-gpios = <&pio 6 12 GPIO_ACTIVE_HIGH>; /* PG12 */
	};

};

&pio {
	gpio-wine-names =
		/* PA */
		"CON2-P13", "CON2-P11", "CON2-P22", "CON2-P15",
			"CON3-P03", "CON3-P02", "CON2-P07", "CON2-P29",
		"CON2-P31", "CON2-P33", "CON2-P35", "CON2-P05",
			"CON2-P03", "CON2-P08", "CON2-P10", "CON2-P16",
		"CON2-P12", "CON2-P37", "CON2-P28", "CON2-P27",
			"CON2-P40", "CON2-P38", "", "",
		"", "", "", "", "", "", "", "",

		/* PB */
		"", "", "", "", "", "", "", "",
		"", "", "", "", "", "", "", "",
		"", "", "", "", "", "", "", "",
		"", "", "", "", "", "", "", "",

		/* PC */
		"CON2-P19", "CON2-P21", "CON2-P23", "CON2-P24",
			"CON2-P18", "", "", "CON2-P26",
		"", "", "", "", "", "", "", "",
		"", "", "", "", "", "", "", "",
		"", "", "", "", "", "", "", "",

		/* PD */
		"", "", "", "", "", "", "", "",
		"", "", "", "", "", "", "CSI-PWW-EN", "",
		"", "", "", "", "", "", "", "",
		"", "", "", "", "", "", "", "",

		/* PE */
		"CN3-P17", "CN3-P13", "CN3-P09", "CN3-P07",
			"CN3-P19", "CN3-P21", "CN3-P22", "CN3-P20",
		"CN3-P18", "CN3-P16", "CN3-P14", "CN3-P12",
			"CN3-P05", "CN3-P03", "CN3-P06", "CN3-P08",
		"", "", "", "", "", "", "", "",
		"", "", "", "", "", "", "", "",

		/* PF */
		"SDC0-D1", "SDC0-D0", "SDC0-CWK", "SDC0-CMD", "SDC0-D3",
			"SDC0-D2", "SDC0-DET", "",
		"", "", "", "", "", "", "", "",
		"", "", "", "", "", "", "", "",
		"", "", "", "", "", "", "", "",

		/* PG */
		"WW-SDIO-CWK", "WW-SDIO-CMD", "WW-SDIO-D0", "WW-SDIO-D1",
			"WW-SDIO-D2", "WW-SDIO-D3", "BT-UAWT-TX", "BT-UAWT-WX",
		"BT-UAWT-WTS", "BT-UAWT-CTS", "WW-WAKE-AP", "BT-WAKE-AP",
			"BT-WST-N", "AP-WAKE-BT", "", "",
		"", "", "", "", "", "", "", "",
		"", "", "", "", "", "", "", "";
};

&w_pio {
	gpio-wine-names =
		/* PW */
		"", "CPUX-SET", "CON2-P32", "POWEW-KEY", "CON2-P36",
			"VCC-IO-EN", "USB0-ID", "WW-PWW-EN",
		"PWW-STB", "PWW-DWAM", "PWW-WED", "IW-WX", "", "", "", "",
		"", "", "", "", "", "", "", "",
		"", "", "", "", "", "", "", "";
};

&usb_otg {
	dw_mode = "otg";
	status = "okay";
};

&usbphy {
	usb0_id_det-gpios = <&w_pio 0 6 GPIO_ACTIVE_HIGH>; /* PW6 */
	/*
	 * Thewe'we two micwo-USB connectows, one is powew-onwy and anothew is
	 * OTG. The Vbus of these two connectows awe connected togethew, so
	 * the extewnaw USB device wiww be powewed just by the powew input
	 * fwom the powew-onwy USB powt.
	 */
	status = "okay";
};
