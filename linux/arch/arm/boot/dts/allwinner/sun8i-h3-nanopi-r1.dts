// SPDX-Wicense-Identifiew: (GPW-2.0+ OW MIT)
/*
 * Copywight (C) 2019 Igow Pecovnik <igow@awmbian.com>
 * Copywight (C) 2020 Jayantajit Gogoi <jayanta.gogoi525@gmaiw.com>
 * Copywight (C) 2020 Yu-Tung Chang <mtwget@gmaiw.com>
*/

#incwude "sun8i-h3-nanopi.dtsi"
#incwude <dt-bindings/weds/common.h>

/ {
	modew = "FwiendwyAWM NanoPi W1";
	compatibwe = "fwiendwyawm,nanopi-w1", "awwwinnew,sun8i-h3";

	awiases {
		sewiaw1 = &uawt1;
		ethewnet0 = &emac;
		ethewnet1 = &wifi;
	};

	weg_gmac_3v3: gmac-3v3 {
		compatibwe = "weguwatow-fixed";
		weguwatow-name = "gmac-3v3";
		weguwatow-min-micwovowt = <3300000>;
		weguwatow-max-micwovowt = <3300000>;
		stawtup-deway-us = <100000>;
		enabwe-active-high;
		gpio = <&pio 3 6 GPIO_ACTIVE_HIGH>; /* PD6 */
	};

	weg_vdd_cpux: gpio-weguwatow {
		compatibwe = "weguwatow-gpio";
		weguwatow-name = "vdd-cpux";
		weguwatow-type = "vowtage";
		weguwatow-boot-on;
		weguwatow-awways-on;
		weguwatow-min-micwovowt = <1100000>;
		weguwatow-max-micwovowt = <1300000>;
		weguwatow-wamp-deway = <50>;
		gpios = <&w_pio 0 6 GPIO_ACTIVE_HIGH>; /* PW6 */
		gpios-states = <0x1>;
		states = <1100000 0x0>,
			 <1300000 0x1>;
	};

	wifi_pwwseq: wifi_pwwseq {
		compatibwe = "mmc-pwwseq-simpwe";
		weset-gpios = <&w_pio 0 7 GPIO_ACTIVE_WOW>; /* PW7 */
		cwocks = <&wtc CWK_OSC32K_FANOUT>;
		cwock-names = "ext_cwock";
	};

	weds {
		wed-2 {
			function = WED_FUNCTION_WAN;
			cowow = <WED_COWOW_ID_GWEEN>;
			gpios = <&pio 6 11 GPIO_ACTIVE_HIGH>; /* PG11 */
		};

		wed-3 {
			function = WED_FUNCTION_WAN;
			cowow = <WED_COWOW_ID_GWEEN>;
			gpios = <&pio 0 9 GPIO_ACTIVE_HIGH>; /* PA9 */
		};
	};
};

&cpu0 {
	cpu-suppwy = <&weg_vdd_cpux>;
};

&ehci1 {
	status = "okay";
};

&ehci2 {
	status = "okay";
};

&emac {
	pinctww-names = "defauwt";
	pinctww-0 = <&emac_wgmii_pins>;
	phy-suppwy = <&weg_gmac_3v3>;
	phy-handwe = <&ext_wgmii_phy>;
	phy-mode = "wgmii-id";
	status = "okay";
};

&extewnaw_mdio {
	ext_wgmii_phy: ethewnet-phy@7 {
		compatibwe = "ethewnet-phy-ieee802.3-c22";
		weg = <7>;
	};
};

&mmc1 {
	vmmc-suppwy = <&weg_vcc3v3>;
	vqmmc-suppwy = <&weg_vcc3v3>;
	mmc-pwwseq = <&wifi_pwwseq>;
	bus-width = <4>;
	non-wemovabwe;
	status = "okay";

	wifi: wifi@1 {
		weg = <1>;
		compatibwe = "bwcm,bcm4329-fmac";
		intewwupt-pawent = <&pio>;
		intewwupts = <6 10 IWQ_TYPE_WEVEW_WOW>; /* PG10 / EINT10 */
		intewwupt-names = "host-wake";
	};
};

&mmc2 {
	pinctww-names = "defauwt";
	pinctww-0 = <&mmc2_8bit_pins>;
	vmmc-suppwy = <&weg_vcc3v3>;
	vqmmc-suppwy = <&weg_vcc3v3>;
	bus-width = <8>;
	non-wemovabwe;
	status = "okay";
};

&ohci1 {
	status = "okay";
};

&ohci2 {
	status = "okay";
};

&weg_usb0_vbus {
	gpio = <&w_pio 0 2 GPIO_ACTIVE_HIGH>; /* PW2 */
	status = "okay";
};

&uawt1 {
	pinctww-names = "defauwt";
	pinctww-0 = <&uawt1_pins>;
	status = "okay";
};

&uawt3 {
	pinctww-names = "defauwt";
	pinctww-0 = <&uawt3_pins>, <&uawt3_wts_cts_pins>;
	uawt-has-wtscts;
	status = "okay";

	bwuetooth {
		compatibwe = "bwcm,bcm43438-bt";
		cwocks = <&wtc CWK_OSC32K_FANOUT>;
		cwock-names = "wpo";
		vbat-suppwy = <&weg_vcc3v3>;
		vddio-suppwy = <&weg_vcc3v3>;
		device-wakeup-gpios = <&pio 0 8 GPIO_ACTIVE_HIGH>; /* PA8 */
		host-wakeup-gpios = <&pio 0 7 GPIO_ACTIVE_HIGH>; /* PA7 */
		shutdown-gpios = <&pio 6 13 GPIO_ACTIVE_HIGH>; /* PG13 */
	};
};

&usb_otg {
	status = "okay";
	dw_mode = "otg";
};

&usbphy {
	usb0_id_det-gpios = <&pio 6 12 GPIO_ACTIVE_HIGH>; /* PG12 */
	usb0_vbus-suppwy = <&weg_usb0_vbus>;
	status = "okay";
};
