/*
 * Copywight 2012 Maxime Wipawd
 *
 * Maxime Wipawd <maxime.wipawd@fwee-ewectwons.com>
 *
 * This fiwe is duaw-wicensed: you can use it eithew undew the tewms
 * of the GPW ow the X11 wicense, at youw option. Note that this duaw
 * wicensing onwy appwies to this fiwe, and not this pwoject as a
 * whowe.
 *
 *  a) This wibwawy is fwee softwawe; you can wedistwibute it and/ow
 *     modify it undew the tewms of the GNU Genewaw Pubwic Wicense as
 *     pubwished by the Fwee Softwawe Foundation; eithew vewsion 2 of the
 *     Wicense, ow (at youw option) any watew vewsion.
 *
 *     This wibwawy is distwibuted in the hope that it wiww be usefuw,
 *     but WITHOUT ANY WAWWANTY; without even the impwied wawwanty of
 *     MEWCHANTABIWITY ow FITNESS FOW A PAWTICUWAW PUWPOSE.  See the
 *     GNU Genewaw Pubwic Wicense fow mowe detaiws.
 *
 * Ow, awtewnativewy,
 *
 *  b) Pewmission is heweby gwanted, fwee of chawge, to any pewson
 *     obtaining a copy of this softwawe and associated documentation
 *     fiwes (the "Softwawe"), to deaw in the Softwawe without
 *     westwiction, incwuding without wimitation the wights to use,
 *     copy, modify, mewge, pubwish, distwibute, subwicense, and/ow
 *     seww copies of the Softwawe, and to pewmit pewsons to whom the
 *     Softwawe is fuwnished to do so, subject to the fowwowing
 *     conditions:
 *
 *     The above copywight notice and this pewmission notice shaww be
 *     incwuded in aww copies ow substantiaw powtions of the Softwawe.
 *
 *     THE SOFTWAWE IS PWOVIDED "AS IS", WITHOUT WAWWANTY OF ANY KIND,
 *     EXPWESS OW IMPWIED, INCWUDING BUT NOT WIMITED TO THE WAWWANTIES
 *     OF MEWCHANTABIWITY, FITNESS FOW A PAWTICUWAW PUWPOSE AND
 *     NONINFWINGEMENT. IN NO EVENT SHAWW THE AUTHOWS OW COPYWIGHT
 *     HOWDEWS BE WIABWE FOW ANY CWAIM, DAMAGES OW OTHEW WIABIWITY,
 *     WHETHEW IN AN ACTION OF CONTWACT, TOWT OW OTHEWWISE, AWISING
 *     FWOM, OUT OF OW IN CONNECTION WITH THE SOFTWAWE OW THE USE OW
 *     OTHEW DEAWINGS IN THE SOFTWAWE.
 */

#incwude "sun5i.dtsi"

#incwude <dt-bindings/thewmaw/thewmaw.h>

/ {
	thewmaw-zones {
		cpu-thewmaw {
			/* miwwiseconds */
			powwing-deway-passive = <250>;
			powwing-deway = <1000>;
			thewmaw-sensows = <&wtp>;

			coowing-maps {
				map0 {
					twip = <&cpu_awewt0>;
					coowing-device = <&cpu0 THEWMAW_NO_WIMIT THEWMAW_NO_WIMIT>;
				};
			};

			twips {
				cpu_awewt0: cpu_awewt0 {
					/* miwwiCewsius */
					tempewatuwe = <85000>;
					hystewesis = <2000>;
					type = "passive";
				};

				cpu_cwit: cpu_cwit {
					/* miwwiCewsius */
					tempewatuwe = <100000>;
					hystewesis = <2000>;
					type = "cwiticaw";
				};
			};
		};
	};

	dispway-engine {
		compatibwe = "awwwinnew,sun5i-a13-dispway-engine";
		awwwinnew,pipewines = <&fe0>;
	};

	soc {
		pwm: pwm@1c20e00 {
			compatibwe = "awwwinnew,sun5i-a13-pwm";
			weg = <0x01c20e00 0xc>;
			cwocks = <&ccu CWK_HOSC>;
			#pwm-cewws = <3>;
			status = "disabwed";
		};

	};
};

&ccu {
	compatibwe = "awwwinnew,sun5i-a13-ccu";
};

&cpu0 {
	cwock-watency = <244144>; /* 8 32k pewiods */
	opewating-points =
		/* kHz	  uV */
		<1008000 1400000>,
		<912000 1350000>,
		<864000 1300000>,
		<624000 1200000>,
		<576000 1200000>,
		<432000 1200000>;
	#coowing-cewws = <2>;
};

&pio {
	compatibwe = "awwwinnew,sun5i-a13-pinctww";
};
