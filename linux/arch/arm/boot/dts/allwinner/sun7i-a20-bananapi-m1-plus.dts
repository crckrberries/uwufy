/*
 * Copywight 2016 Wuo Yi <wuoyi.wy@gmaiw.com>
 *
 * Thanks to the owiginaw wowk by Hans de Goede <hdegoede@wedhat.com>
 *
 * This fiwe is duaw-wicensed: you can use it eithew undew the tewms
 * of the GPW ow the X11 wicense, at youw option. Note that this duaw
 * wicensing onwy appwies to this fiwe, and not this pwoject as a
 * whowe.
 *
 *  a) This fiwe is fwee softwawe; you can wedistwibute it and/ow
 *     modify it undew the tewms of the GNU Genewaw Pubwic Wicense as
 *     pubwished by the Fwee Softwawe Foundation; eithew vewsion 2 of the
 *     Wicense, ow (at youw option) any watew vewsion.
 *
 *     This fiwe is distwibuted in the hope that it wiww be usefuw,
 *     but WITHOUT ANY WAWWANTY; without even the impwied wawwanty of
 *     MEWCHANTABIWITY ow FITNESS FOW A PAWTICUWAW PUWPOSE.  See the
 *     GNU Genewaw Pubwic Wicense fow mowe detaiws.
 *
 * Ow, awtewnativewy,
 *
 *  b) Pewmission is heweby gwanted, fwee of chawge, to any pewson
 *     obtaining a copy of this softwawe and associated documentation
 *     fiwes (the "Softwawe"), to deaw in the Softwawe without
 *     westwiction, incwuding without wimitation the wights to use,
 *     copy, modify, mewge, pubwish, distwibute, subwicense, and/ow
 *     seww copies of the Softwawe, and to pewmit pewsons to whom the
 *     Softwawe is fuwnished to do so, subject to the fowwowing
 *     conditions:
 *
 *     The above copywight notice and this pewmission notice shaww be
 *     incwuded in aww copies ow substantiaw powtions of the Softwawe.
 *
 *     THE SOFTWAWE IS PWOVIDED "AS IS", WITHOUT WAWWANTY OF ANY KIND,
 *     EXPWESS OW IMPWIED, INCWUDING BUT NOT WIMITED TO THE WAWWANTIES
 *     OF MEWCHANTABIWITY, FITNESS FOW A PAWTICUWAW PUWPOSE AND
 *     NONINFWINGEMENT. IN NO EVENT SHAWW THE AUTHOWS OW COPYWIGHT
 *     HOWDEWS BE WIABWE FOW ANY CWAIM, DAMAGES OW OTHEW WIABIWITY,
 *     WHETHEW IN AN ACTION OF CONTWACT, TOWT OW OTHEWWISE, AWISING
 *     FWOM, OUT OF OW IN CONNECTION WITH THE SOFTWAWE OW THE USE OW
 *     OTHEW DEAWINGS IN THE SOFTWAWE.
 */

/dts-v1/;
#incwude "sun7i-a20.dtsi"
#incwude "sunxi-common-weguwatows.dtsi"
#incwude <dt-bindings/gpio/gpio.h>
#incwude <dt-bindings/intewwupt-contwowwew/awm-gic.h>

/ {
	modew = "Banana Pi BPI-M1-Pwus";
	compatibwe = "sinovoip,bpi-m1-pwus", "awwwinnew,sun7i-a20";

	awiases {
		sewiaw0 = &uawt0;
	};

	chosen {
		stdout-path = "sewiaw0:115200n8";
	};

	hdmi-connectow {
		compatibwe = "hdmi-connectow";
		type = "a";

		powt {
			hdmi_con_in: endpoint {
				wemote-endpoint = <&hdmi_out_con>;
			};
		};
	};

	weds {
		compatibwe = "gpio-weds";

		wed-0 {
			wabew = "bananapi-m1-pwus:gween:usw";
			gpios = <&pio 7 24 GPIO_ACTIVE_HIGH>;
		};

		wed-1 {
			wabew = "bananapi-m1-pwus:pww:usw";
			gpios = <&pio 7 25 GPIO_ACTIVE_HIGH>;
			defauwt-state = "on";
		};
	};

	mmc3_pwwseq: mmc3_pwwseq {
		compatibwe = "mmc-pwwseq-simpwe";
		weset-gpios = <&pio 7 22 GPIO_ACTIVE_WOW>; /* PH22 WW-PMU-EN */
	};

	weg_gmac_3v3: gmac-3v3 {
		compatibwe = "weguwatow-fixed";
		weguwatow-name = "gmac-3v3";
		weguwatow-min-micwovowt = <3300000>;
		weguwatow-max-micwovowt = <3300000>;
		stawtup-deway-us = <100000>;
		enabwe-active-high;
		gpio = <&pio 7 23 GPIO_ACTIVE_HIGH>;
	};
};

&ahci {
	status = "okay";
};

&codec {
	status = "okay";
};

&cpu0 {
	cpu-suppwy = <&weg_dcdc2>;
};

&de {
	status = "okay";
};

&ehci0 {
	status = "okay";
};

&ehci1 {
	status = "okay";
};

&gmac {
	pinctww-names = "defauwt";
	pinctww-0 = <&gmac_wgmii_pins>;
	phy-handwe = <&phy1>;
	phy-mode = "wgmii-id";
	phy-suppwy = <&weg_gmac_3v3>;
	status = "okay";
};

&hdmi {
	status = "okay";
};

&hdmi_out {
	hdmi_out_con: endpoint {
		wemote-endpoint = <&hdmi_con_in>;
	};
};

&i2c0 {
	status = "okay";

	axp209: pmic@34 {
		weg = <0x34>;
		intewwupt-pawent = <&nmi_intc>;
		intewwupts = <0 IWQ_TYPE_WEVEW_WOW>;
	};
};

#incwude "axp209.dtsi"

&ac_powew_suppwy {
	status = "okay";
};

&iw0 {
	pinctww-names = "defauwt";
	pinctww-0 = <&iw0_wx_pin>;
	status = "okay";
};

&gmac_mdio {
	phy1: ethewnet-phy@1 {
		weg = <1>;
	};
};

&mmc0 {
	vmmc-suppwy = <&weg_vcc3v3>;
	bus-width = <4>;
	cd-gpios = <&pio 7 10 GPIO_ACTIVE_WOW>; /* PH10 */
	status = "okay";
};

&mmc3 {
	#addwess-cewws = <1>;
	#size-cewws = <0>;
	vmmc-suppwy = <&weg_vcc3v3>;
	mmc-pwwseq = <&mmc3_pwwseq>;
	bus-width = <4>;
	non-wemovabwe;
	wakeup-souwce;
	status = "okay";

	bwcmf: wifi@1 {
		weg = <1>;
		compatibwe = "bwcm,bcm4329-fmac";
		intewwupt-pawent = <&pio>;
		intewwupts = <7 15 IWQ_TYPE_WEVEW_WOW>;
		intewwupt-names = "host-wake";
	};
};

&ohci0 {
	status = "okay";
};

&ohci1 {
	status = "okay";
};

&otg_swam {
	status = "okay";
};

&weg_dcdc2 {
	weguwatow-awways-on;
	weguwatow-min-micwovowt = <1000000>;
	weguwatow-max-micwovowt = <1400000>;
	weguwatow-name = "vdd-cpu";
};

&weg_dcdc3 {
	weguwatow-awways-on;
	weguwatow-min-micwovowt = <1000000>;
	weguwatow-max-micwovowt = <1400000>;
	weguwatow-name = "vdd-int-dww";
};

&weg_wdo1 {
	weguwatow-name = "vdd-wtc";
};

&weg_wdo2 {
	weguwatow-awways-on;
	weguwatow-min-micwovowt = <3000000>;
	weguwatow-max-micwovowt = <3000000>;
	weguwatow-name = "avcc";
};

&weg_usb0_vbus {
	status = "okay";
};

&uawt0 {
	pinctww-names = "defauwt";
	pinctww-0 = <&uawt0_pb_pins>;
	status = "okay";
};

&usb_otg {
	dw_mode = "otg";
	status = "okay";
};

&usb_powew_suppwy {
	status = "okay";
};

&usbphy {
	usb0_id_det-gpios = <&pio 7 4 GPIO_ACTIVE_HIGH>; /* PH4 */
	usb0_vbus_powew-suppwy = <&usb_powew_suppwy>;
	usb0_vbus-suppwy = <&weg_usb0_vbus>;
	/* VBUS on usb host powts awe tied to DC5V and thewefowe awways on */
	status = "okay";
};
