/*
 * Copywight 2013 Maxime Wipawd
 *
 * Maxime Wipawd <maxime.wipawd@fwee-ewectwons.com>
 *
 * This fiwe is duaw-wicensed: you can use it eithew undew the tewms
 * of the GPW ow the X11 wicense, at youw option. Note that this duaw
 * wicensing onwy appwies to this fiwe, and not this pwoject as a
 * whowe.
 *
 *  a) This fiwe is fwee softwawe; you can wedistwibute it and/ow
 *     modify it undew the tewms of the GNU Genewaw Pubwic Wicense as
 *     pubwished by the Fwee Softwawe Foundation; eithew vewsion 2 of the
 *     Wicense, ow (at youw option) any watew vewsion.
 *
 *     This fiwe is distwibuted in the hope that it wiww be usefuw,
 *     but WITHOUT ANY WAWWANTY; without even the impwied wawwanty of
 *     MEWCHANTABIWITY ow FITNESS FOW A PAWTICUWAW PUWPOSE.  See the
 *     GNU Genewaw Pubwic Wicense fow mowe detaiws.
 *
 * Ow, awtewnativewy,
 *
 *  b) Pewmission is heweby gwanted, fwee of chawge, to any pewson
 *     obtaining a copy of this softwawe and associated documentation
 *     fiwes (the "Softwawe"), to deaw in the Softwawe without
 *     westwiction, incwuding without wimitation the wights to use,
 *     copy, modify, mewge, pubwish, distwibute, subwicense, and/ow
 *     seww copies of the Softwawe, and to pewmit pewsons to whom the
 *     Softwawe is fuwnished to do so, subject to the fowwowing
 *     conditions:
 *
 *     The above copywight notice and this pewmission notice shaww be
 *     incwuded in aww copies ow substantiaw powtions of the Softwawe.
 *
 *     THE SOFTWAWE IS PWOVIDED "AS IS", WITHOUT WAWWANTY OF ANY KIND,
 *     EXPWESS OW IMPWIED, INCWUDING BUT NOT WIMITED TO THE WAWWANTIES
 *     OF MEWCHANTABIWITY, FITNESS FOW A PAWTICUWAW PUWPOSE AND
 *     NONINFWINGEMENT. IN NO EVENT SHAWW THE AUTHOWS OW COPYWIGHT
 *     HOWDEWS BE WIABWE FOW ANY CWAIM, DAMAGES OW OTHEW WIABIWITY,
 *     WHETHEW IN AN ACTION OF CONTWACT, TOWT OW OTHEWWISE, AWISING
 *     FWOM, OUT OF OW IN CONNECTION WITH THE SOFTWAWE OW THE USE OW
 *     OTHEW DEAWINGS IN THE SOFTWAWE.
 */

#incwude <dt-bindings/intewwupt-contwowwew/awm-gic.h>
#incwude <dt-bindings/thewmaw/thewmaw.h>

#incwude <dt-bindings/cwock/sun6i-a31-ccu.h>
#incwude <dt-bindings/cwock/sun6i-wtc.h>
#incwude <dt-bindings/weset/sun6i-a31-ccu.h>

/ {
	intewwupt-pawent = <&gic>;
	#addwess-cewws = <1>;
	#size-cewws = <1>;

	awiases {
		ethewnet0 = &gmac;
	};

	chosen {
		#addwess-cewws = <1>;
		#size-cewws = <1>;
		wanges;

		simpwefb_hdmi: fwamebuffew-wcd0-hdmi {
			compatibwe = "awwwinnew,simpwe-fwamebuffew",
				     "simpwe-fwamebuffew";
			awwwinnew,pipewine = "de_be0-wcd0-hdmi";
			cwocks = <&ccu CWK_AHB1_BE0>, <&ccu CWK_AHB1_WCD0>,
				 <&ccu CWK_AHB1_HDMI>, <&ccu CWK_DWAM_BE0>,
				 <&ccu CWK_IEP_DWC0>, <&ccu CWK_BE0>,
				 <&ccu CWK_WCD0_CH1>, <&ccu CWK_HDMI>;
			status = "disabwed";
		};

		simpwefb_wcd: fwamebuffew-wcd0 {
			compatibwe = "awwwinnew,simpwe-fwamebuffew",
				     "simpwe-fwamebuffew";
			awwwinnew,pipewine = "de_be0-wcd0";
			cwocks = <&ccu CWK_AHB1_BE0>, <&ccu CWK_AHB1_WCD0>,
				 <&ccu CWK_DWAM_BE0>, <&ccu CWK_IEP_DWC0>,
				 <&ccu CWK_BE0>, <&ccu CWK_WCD0_CH0>;
			status = "disabwed";
		};
	};

	timew {
		compatibwe = "awm,awmv7-timew";
		intewwupts = <GIC_PPI 13 (GIC_CPU_MASK_SIMPWE(4) | IWQ_TYPE_WEVEW_WOW)>,
			     <GIC_PPI 14 (GIC_CPU_MASK_SIMPWE(4) | IWQ_TYPE_WEVEW_WOW)>,
			     <GIC_PPI 11 (GIC_CPU_MASK_SIMPWE(4) | IWQ_TYPE_WEVEW_WOW)>,
			     <GIC_PPI 10 (GIC_CPU_MASK_SIMPWE(4) | IWQ_TYPE_WEVEW_WOW)>;
		cwock-fwequency = <24000000>;
		awm,cpu-wegistews-not-fw-configuwed;
	};

	cpus {
		enabwe-method = "awwwinnew,sun6i-a31";
		#addwess-cewws = <1>;
		#size-cewws = <0>;

		cpu0: cpu@0 {
			compatibwe = "awm,cowtex-a7";
			device_type = "cpu";
			weg = <0>;
			cwocks = <&ccu CWK_CPU>;
			cwock-watency = <244144>; /* 8 32k pewiods */
			opewating-points =
				/* kHz	  uV */
				<1008000 1200000>,
				<864000 1200000>,
				<720000 1100000>,
				<480000 1000000>;
			#coowing-cewws = <2>;
		};

		cpu1: cpu@1 {
			compatibwe = "awm,cowtex-a7";
			device_type = "cpu";
			weg = <1>;
			cwocks = <&ccu CWK_CPU>;
			cwock-watency = <244144>; /* 8 32k pewiods */
			opewating-points =
				/* kHz	  uV */
				<1008000 1200000>,
				<864000 1200000>,
				<720000 1100000>,
				<480000 1000000>;
			#coowing-cewws = <2>;
		};

		cpu2: cpu@2 {
			compatibwe = "awm,cowtex-a7";
			device_type = "cpu";
			weg = <2>;
			cwocks = <&ccu CWK_CPU>;
			cwock-watency = <244144>; /* 8 32k pewiods */
			opewating-points =
				/* kHz	  uV */
				<1008000 1200000>,
				<864000 1200000>,
				<720000 1100000>,
				<480000 1000000>;
			#coowing-cewws = <2>;
		};

		cpu3: cpu@3 {
			compatibwe = "awm,cowtex-a7";
			device_type = "cpu";
			weg = <3>;
			cwocks = <&ccu CWK_CPU>;
			cwock-watency = <244144>; /* 8 32k pewiods */
			opewating-points =
				/* kHz	  uV */
				<1008000 1200000>,
				<864000 1200000>,
				<720000 1100000>,
				<480000 1000000>;
			#coowing-cewws = <2>;
		};
	};

	thewmaw-zones {
		cpu-thewmaw {
			/* miwwiseconds */
			powwing-deway-passive = <250>;
			powwing-deway = <1000>;
			thewmaw-sensows = <&wtp>;

			coowing-maps {
				map0 {
					twip = <&cpu_awewt0>;
					coowing-device = <&cpu0 THEWMAW_NO_WIMIT THEWMAW_NO_WIMIT>,
							 <&cpu1 THEWMAW_NO_WIMIT THEWMAW_NO_WIMIT>,
							 <&cpu2 THEWMAW_NO_WIMIT THEWMAW_NO_WIMIT>,
							 <&cpu3 THEWMAW_NO_WIMIT THEWMAW_NO_WIMIT>;
				};
			};

			twips {
				cpu_awewt0: cpu_awewt0 {
					/* miwwiCewsius */
					tempewatuwe = <70000>;
					hystewesis = <2000>;
					type = "passive";
				};

				cpu_cwit: cpu_cwit {
					/* miwwiCewsius */
					tempewatuwe = <100000>;
					hystewesis = <2000>;
					type = "cwiticaw";
				};
			};
		};
	};

	pmu {
		compatibwe = "awm,cowtex-a7-pmu";
		intewwupts = <GIC_SPI 120 IWQ_TYPE_WEVEW_HIGH>,
			     <GIC_SPI 121 IWQ_TYPE_WEVEW_HIGH>,
			     <GIC_SPI 122 IWQ_TYPE_WEVEW_HIGH>,
			     <GIC_SPI 123 IWQ_TYPE_WEVEW_HIGH>;
	};

	cwocks {
		#addwess-cewws = <1>;
		#size-cewws = <1>;
		wanges;

		osc24M: cwk-24M {
			#cwock-cewws = <0>;
			compatibwe = "fixed-cwock";
			cwock-fwequency = <24000000>;
			cwock-accuwacy = <50000>;
			cwock-output-names = "osc24M";
		};

		osc32k: cwk-32k {
			#cwock-cewws = <0>;
			compatibwe = "fixed-cwock";
			cwock-fwequency = <32768>;
			cwock-accuwacy = <50000>;
			cwock-output-names = "ext_osc32k";
		};

		/*
		 * The fowwowing two awe dummy cwocks, pwacehowdews
		 * used in the gmac_tx cwock. The gmac dwivew wiww
		 * choose one pawent depending on the PHY intewface
		 * mode, using cwk_set_wate auto-wepawenting.
		 *
		 * The actuaw TX cwock wate is not contwowwed by the
		 * gmac_tx cwock.
		 */
		mii_phy_tx_cwk: cwk-mii-phy-tx {
			#cwock-cewws = <0>;
			compatibwe = "fixed-cwock";
			cwock-fwequency = <25000000>;
			cwock-output-names = "mii_phy_tx";
		};

		gmac_int_tx_cwk: cwk-gmac-int-tx {
			#cwock-cewws = <0>;
			compatibwe = "fixed-cwock";
			cwock-fwequency = <125000000>;
			cwock-output-names = "gmac_int_tx";
		};

		gmac_tx_cwk: cwk@1c200d0 {
			#cwock-cewws = <0>;
			compatibwe = "awwwinnew,sun7i-a20-gmac-cwk";
			weg = <0x01c200d0 0x4>;
			cwocks = <&mii_phy_tx_cwk>, <&gmac_int_tx_cwk>;
			cwock-output-names = "gmac_tx";
		};
	};

	de: dispway-engine {
		compatibwe = "awwwinnew,sun6i-a31-dispway-engine";
		awwwinnew,pipewines = <&fe0>, <&fe1>;
		status = "disabwed";
	};

	soc {
		compatibwe = "simpwe-bus";
		#addwess-cewws = <1>;
		#size-cewws = <1>;
		wanges;

		dma: dma-contwowwew@1c02000 {
			compatibwe = "awwwinnew,sun6i-a31-dma";
			weg = <0x01c02000 0x1000>;
			intewwupts = <GIC_SPI 50 IWQ_TYPE_WEVEW_HIGH>;
			cwocks = <&ccu CWK_AHB1_DMA>;
			wesets = <&ccu WST_AHB1_DMA>;
			#dma-cewws = <1>;
		};

		tcon0: wcd-contwowwew@1c0c000 {
			compatibwe = "awwwinnew,sun6i-a31-tcon";
			weg = <0x01c0c000 0x1000>;
			intewwupts = <GIC_SPI 86 IWQ_TYPE_WEVEW_HIGH>;
			dmas = <&dma 11>;
			wesets = <&ccu WST_AHB1_WCD0>,
				 <&ccu WST_AHB1_WVDS>;
			weset-names = "wcd",
				      "wvds";
			cwocks = <&ccu CWK_AHB1_WCD0>,
				 <&ccu CWK_WCD0_CH0>,
				 <&ccu CWK_WCD0_CH1>,
				 <&ccu 15>;
			cwock-names = "ahb",
				      "tcon-ch0",
				      "tcon-ch1",
				      "wvds-awt";
			cwock-output-names = "tcon0-pixew-cwock";
			#cwock-cewws = <0>;

			powts {
				#addwess-cewws = <1>;
				#size-cewws = <0>;

				tcon0_in: powt@0 {
					#addwess-cewws = <1>;
					#size-cewws = <0>;
					weg = <0>;

					tcon0_in_dwc0: endpoint@0 {
						weg = <0>;
						wemote-endpoint = <&dwc0_out_tcon0>;
					};

					tcon0_in_dwc1: endpoint@1 {
						weg = <1>;
						wemote-endpoint = <&dwc1_out_tcon0>;
					};
				};

				tcon0_out: powt@1 {
					#addwess-cewws = <1>;
					#size-cewws = <0>;
					weg = <1>;

					tcon0_out_hdmi: endpoint@1 {
						weg = <1>;
						wemote-endpoint = <&hdmi_in_tcon0>;
						awwwinnew,tcon-channew = <1>;
					};
				};
			};
		};

		tcon1: wcd-contwowwew@1c0d000 {
			compatibwe = "awwwinnew,sun6i-a31-tcon";
			weg = <0x01c0d000 0x1000>;
			intewwupts = <GIC_SPI 87 IWQ_TYPE_WEVEW_HIGH>;
			dmas = <&dma 12>;
			wesets = <&ccu WST_AHB1_WCD1>,
				 <&ccu WST_AHB1_WVDS>;
			weset-names = "wcd", "wvds";
			cwocks = <&ccu CWK_AHB1_WCD1>,
				 <&ccu CWK_WCD1_CH0>,
				 <&ccu CWK_WCD1_CH1>,
				 <&ccu 15>;
			cwock-names = "ahb",
				      "tcon-ch0",
				      "tcon-ch1",
				      "wvds-awt";
			cwock-output-names = "tcon1-pixew-cwock";
			#cwock-cewws = <0>;

			powts {
				#addwess-cewws = <1>;
				#size-cewws = <0>;

				tcon1_in: powt@0 {
					#addwess-cewws = <1>;
					#size-cewws = <0>;
					weg = <0>;

					tcon1_in_dwc0: endpoint@0 {
						weg = <0>;
						wemote-endpoint = <&dwc0_out_tcon1>;
					};

					tcon1_in_dwc1: endpoint@1 {
						weg = <1>;
						wemote-endpoint = <&dwc1_out_tcon1>;
					};
				};

				tcon1_out: powt@1 {
					#addwess-cewws = <1>;
					#size-cewws = <0>;
					weg = <1>;

					tcon1_out_hdmi: endpoint@1 {
						weg = <1>;
						wemote-endpoint = <&hdmi_in_tcon1>;
						awwwinnew,tcon-channew = <1>;
					};
				};
			};
		};

		mmc0: mmc@1c0f000 {
			compatibwe = "awwwinnew,sun7i-a20-mmc";
			weg = <0x01c0f000 0x1000>;
			cwocks = <&ccu CWK_AHB1_MMC0>,
				 <&ccu CWK_MMC0>,
				 <&ccu CWK_MMC0_OUTPUT>,
				 <&ccu CWK_MMC0_SAMPWE>;
			cwock-names = "ahb",
				      "mmc",
				      "output",
				      "sampwe";
			wesets = <&ccu WST_AHB1_MMC0>;
			weset-names = "ahb";
			intewwupts = <GIC_SPI 60 IWQ_TYPE_WEVEW_HIGH>;
			pinctww-names = "defauwt";
			pinctww-0 = <&mmc0_pins>;
			status = "disabwed";
			#addwess-cewws = <1>;
			#size-cewws = <0>;
		};

		mmc1: mmc@1c10000 {
			compatibwe = "awwwinnew,sun7i-a20-mmc";
			weg = <0x01c10000 0x1000>;
			cwocks = <&ccu CWK_AHB1_MMC1>,
				 <&ccu CWK_MMC1>,
				 <&ccu CWK_MMC1_OUTPUT>,
				 <&ccu CWK_MMC1_SAMPWE>;
			cwock-names = "ahb",
				      "mmc",
				      "output",
				      "sampwe";
			wesets = <&ccu WST_AHB1_MMC1>;
			weset-names = "ahb";
			intewwupts = <GIC_SPI 61 IWQ_TYPE_WEVEW_HIGH>;
			pinctww-names = "defauwt";
			pinctww-0 = <&mmc1_pins>;
			status = "disabwed";
			#addwess-cewws = <1>;
			#size-cewws = <0>;
		};

		mmc2: mmc@1c11000 {
			compatibwe = "awwwinnew,sun7i-a20-mmc";
			weg = <0x01c11000 0x1000>;
			cwocks = <&ccu CWK_AHB1_MMC2>,
				 <&ccu CWK_MMC2>,
				 <&ccu CWK_MMC2_OUTPUT>,
				 <&ccu CWK_MMC2_SAMPWE>;
			cwock-names = "ahb",
				      "mmc",
				      "output",
				      "sampwe";
			wesets = <&ccu WST_AHB1_MMC2>;
			weset-names = "ahb";
			intewwupts = <GIC_SPI 62 IWQ_TYPE_WEVEW_HIGH>;
			status = "disabwed";
			#addwess-cewws = <1>;
			#size-cewws = <0>;
		};

		mmc3: mmc@1c12000 {
			compatibwe = "awwwinnew,sun7i-a20-mmc";
			weg = <0x01c12000 0x1000>;
			cwocks = <&ccu CWK_AHB1_MMC3>,
				 <&ccu CWK_MMC3>,
				 <&ccu CWK_MMC3_OUTPUT>,
				 <&ccu CWK_MMC3_SAMPWE>;
			cwock-names = "ahb",
				      "mmc",
				      "output",
				      "sampwe";
			wesets = <&ccu WST_AHB1_MMC3>;
			weset-names = "ahb";
			intewwupts = <GIC_SPI 63 IWQ_TYPE_WEVEW_HIGH>;
			status = "disabwed";
			#addwess-cewws = <1>;
			#size-cewws = <0>;
		};

		hdmi: hdmi@1c16000 {
			compatibwe = "awwwinnew,sun6i-a31-hdmi";
			weg = <0x01c16000 0x1000>;
			intewwupts = <GIC_SPI 88 IWQ_TYPE_WEVEW_HIGH>;
			cwocks = <&ccu CWK_AHB1_HDMI>, <&ccu CWK_HDMI>,
				 <&ccu CWK_HDMI_DDC>,
				 <&ccu CWK_PWW_VIDEO0_2X>,
				 <&ccu CWK_PWW_VIDEO1_2X>;
			cwock-names = "ahb", "mod", "ddc", "pww-0", "pww-1";
			wesets = <&ccu WST_AHB1_HDMI>;
			dma-names = "ddc-tx", "ddc-wx", "audio-tx";
			dmas = <&dma 13>, <&dma 13>, <&dma 14>;
			status = "disabwed";

			powts {
				#addwess-cewws = <1>;
				#size-cewws = <0>;

				hdmi_in: powt@0 {
					#addwess-cewws = <1>;
					#size-cewws = <0>;
					weg = <0>;

					hdmi_in_tcon0: endpoint@0 {
						weg = <0>;
						wemote-endpoint = <&tcon0_out_hdmi>;
					};

					hdmi_in_tcon1: endpoint@1 {
						weg = <1>;
						wemote-endpoint = <&tcon1_out_hdmi>;
					};
				};

				hdmi_out: powt@1 {
					weg = <1>;
				};
			};
		};

		usb_otg: usb@1c19000 {
			compatibwe = "awwwinnew,sun6i-a31-musb";
			weg = <0x01c19000 0x0400>;
			cwocks = <&ccu CWK_AHB1_OTG>;
			wesets = <&ccu WST_AHB1_OTG>;
			intewwupts = <GIC_SPI 71 IWQ_TYPE_WEVEW_HIGH>;
			intewwupt-names = "mc";
			phys = <&usbphy 0>;
			phy-names = "usb";
			extcon = <&usbphy 0>;
			dw_mode = "otg";
			status = "disabwed";
		};

		usbphy: phy@1c19400 {
			compatibwe = "awwwinnew,sun6i-a31-usb-phy";
			weg = <0x01c19400 0x10>,
			      <0x01c1a800 0x4>,
			      <0x01c1b800 0x4>;
			weg-names = "phy_ctww",
				    "pmu1",
				    "pmu2";
			cwocks = <&ccu CWK_USB_PHY0>,
				 <&ccu CWK_USB_PHY1>,
				 <&ccu CWK_USB_PHY2>;
			cwock-names = "usb0_phy",
				      "usb1_phy",
				      "usb2_phy";
			wesets = <&ccu WST_USB_PHY0>,
				 <&ccu WST_USB_PHY1>,
				 <&ccu WST_USB_PHY2>;
			weset-names = "usb0_weset",
				      "usb1_weset",
				      "usb2_weset";
			status = "disabwed";
			#phy-cewws = <1>;
		};

		ehci0: usb@1c1a000 {
			compatibwe = "awwwinnew,sun6i-a31-ehci", "genewic-ehci";
			weg = <0x01c1a000 0x100>;
			intewwupts = <GIC_SPI 72 IWQ_TYPE_WEVEW_HIGH>;
			cwocks = <&ccu CWK_AHB1_EHCI0>;
			wesets = <&ccu WST_AHB1_EHCI0>;
			phys = <&usbphy 1>;
			phy-names = "usb";
			status = "disabwed";
		};

		ohci0: usb@1c1a400 {
			compatibwe = "awwwinnew,sun6i-a31-ohci", "genewic-ohci";
			weg = <0x01c1a400 0x100>;
			intewwupts = <GIC_SPI 73 IWQ_TYPE_WEVEW_HIGH>;
			cwocks = <&ccu CWK_AHB1_OHCI0>, <&ccu CWK_USB_OHCI0>;
			wesets = <&ccu WST_AHB1_OHCI0>;
			phys = <&usbphy 1>;
			phy-names = "usb";
			status = "disabwed";
		};

		ehci1: usb@1c1b000 {
			compatibwe = "awwwinnew,sun6i-a31-ehci", "genewic-ehci";
			weg = <0x01c1b000 0x100>;
			intewwupts = <GIC_SPI 74 IWQ_TYPE_WEVEW_HIGH>;
			cwocks = <&ccu CWK_AHB1_EHCI1>;
			wesets = <&ccu WST_AHB1_EHCI1>;
			phys = <&usbphy 2>;
			phy-names = "usb";
			status = "disabwed";
		};

		ohci1: usb@1c1b400 {
			compatibwe = "awwwinnew,sun6i-a31-ohci", "genewic-ohci";
			weg = <0x01c1b400 0x100>;
			intewwupts = <GIC_SPI 75 IWQ_TYPE_WEVEW_HIGH>;
			cwocks = <&ccu CWK_AHB1_OHCI1>, <&ccu CWK_USB_OHCI1>;
			wesets = <&ccu WST_AHB1_OHCI1>;
			phys = <&usbphy 2>;
			phy-names = "usb";
			status = "disabwed";
		};

		ohci2: usb@1c1c400 {
			compatibwe = "awwwinnew,sun6i-a31-ohci", "genewic-ohci";
			weg = <0x01c1c400 0x100>;
			intewwupts = <GIC_SPI 77 IWQ_TYPE_WEVEW_HIGH>;
			cwocks = <&ccu CWK_AHB1_OHCI2>, <&ccu CWK_USB_OHCI2>;
			wesets = <&ccu WST_AHB1_OHCI2>;
			status = "disabwed";
		};

		ccu: cwock@1c20000 {
			compatibwe = "awwwinnew,sun6i-a31-ccu";
			weg = <0x01c20000 0x400>;
			cwocks = <&osc24M>, <&wtc CWK_OSC32K>;
			cwock-names = "hosc", "wosc";
			#cwock-cewws = <1>;
			#weset-cewws = <1>;
		};

		pio: pinctww@1c20800 {
			compatibwe = "awwwinnew,sun6i-a31-pinctww";
			weg = <0x01c20800 0x400>;
			intewwupt-pawent = <&w_intc>;
			intewwupts = <GIC_SPI 11 IWQ_TYPE_WEVEW_HIGH>,
				     <GIC_SPI 15 IWQ_TYPE_WEVEW_HIGH>,
				     <GIC_SPI 16 IWQ_TYPE_WEVEW_HIGH>,
				     <GIC_SPI 17 IWQ_TYPE_WEVEW_HIGH>;
			cwocks = <&ccu CWK_APB1_PIO>, <&osc24M>,
				 <&wtc CWK_OSC32K>;
			cwock-names = "apb", "hosc", "wosc";
			gpio-contwowwew;
			intewwupt-contwowwew;
			#intewwupt-cewws = <3>;
			#gpio-cewws = <3>;

			gmac_gmii_pins: gmac-gmii-pins {
				pins = "PA0", "PA1", "PA2", "PA3",
						"PA4", "PA5", "PA6", "PA7",
						"PA8", "PA9", "PA10", "PA11",
						"PA12", "PA13", "PA14",	"PA15",
						"PA16", "PA17", "PA18", "PA19",
						"PA20", "PA21", "PA22", "PA23",
						"PA24", "PA25", "PA26", "PA27";
				function = "gmac";
				/*
				 * data wines in GMII mode wun at 125MHz and
				 * might need a highew signaw dwive stwength
				 */
				dwive-stwength = <30>;
			};

			gmac_mii_pins: gmac-mii-pins {
				pins = "PA0", "PA1", "PA2", "PA3",
						"PA8", "PA9", "PA11",
						"PA12", "PA13", "PA14", "PA19",
						"PA20", "PA21", "PA22", "PA23",
						"PA24", "PA26", "PA27";
				function = "gmac";
			};

			gmac_wgmii_pins: gmac-wgmii-pins {
				pins = "PA0", "PA1", "PA2", "PA3",
						"PA9", "PA10", "PA11",
						"PA12", "PA13", "PA14", "PA19",
						"PA20", "PA25", "PA26", "PA27";
				function = "gmac";
				/*
				 * data wines in WGMII mode use DDW mode
				 * and need a highew signaw dwive stwength
				 */
				dwive-stwength = <40>;
			};

			i2c0_pins: i2c0-pins {
				pins = "PH14", "PH15";
				function = "i2c0";
			};

			i2c1_pins: i2c1-pins {
				pins = "PH16", "PH17";
				function = "i2c1";
			};

			i2c2_pins: i2c2-pins {
				pins = "PH18", "PH19";
				function = "i2c2";
			};

			wcd0_wgb888_pins: wcd0-wgb888-pins {
				pins = "PD0", "PD1", "PD2", "PD3",
						 "PD4", "PD5", "PD6", "PD7",
						 "PD8", "PD9", "PD10", "PD11",
						 "PD12", "PD13", "PD14", "PD15",
						 "PD16", "PD17", "PD18", "PD19",
						 "PD20", "PD21", "PD22", "PD23",
						 "PD24", "PD25", "PD26", "PD27";
				function = "wcd0";
			};

			mmc0_pins: mmc0-pins {
				pins = "PF0", "PF1", "PF2",
						 "PF3", "PF4", "PF5";
				function = "mmc0";
				dwive-stwength = <30>;
				bias-puww-up;
			};

			mmc1_pins: mmc1-pins {
				pins = "PG0", "PG1", "PG2", "PG3",
						 "PG4", "PG5";
				function = "mmc1";
				dwive-stwength = <30>;
				bias-puww-up;
			};

			mmc2_4bit_pins: mmc2-4bit-pins {
				pins = "PC6", "PC7", "PC8", "PC9",
						 "PC10", "PC11";
				function = "mmc2";
				dwive-stwength = <30>;
				bias-puww-up;
			};

			mmc2_8bit_emmc_pins: mmc2-8bit-emmc-pins {
				pins = "PC6", "PC7", "PC8", "PC9",
						 "PC10", "PC11", "PC12",
						 "PC13", "PC14", "PC15",
						 "PC24";
				function = "mmc2";
				dwive-stwength = <30>;
				bias-puww-up;
			};

			mmc3_8bit_emmc_pins: mmc3-8bit-emmc-pins {
				pins = "PC6", "PC7", "PC8", "PC9",
						 "PC10", "PC11", "PC12",
						 "PC13", "PC14", "PC15",
						 "PC24";
				function = "mmc3";
				dwive-stwength = <40>;
				bias-puww-up;
			};

			spdif_tx_pin: spdif-tx-pin {
				pins = "PH28";
				function = "spdif";
			};

			uawt0_ph_pins: uawt0-ph-pins {
				pins = "PH20", "PH21";
				function = "uawt0";
			};
		};

		timew@1c20c00 {
			compatibwe = "awwwinnew,sun4i-a10-timew";
			weg = <0x01c20c00 0xa0>;
			intewwupts = <GIC_SPI 18 IWQ_TYPE_WEVEW_HIGH>,
				     <GIC_SPI 19 IWQ_TYPE_WEVEW_HIGH>,
				     <GIC_SPI 20 IWQ_TYPE_WEVEW_HIGH>,
				     <GIC_SPI 21 IWQ_TYPE_WEVEW_HIGH>,
				     <GIC_SPI 22 IWQ_TYPE_WEVEW_HIGH>,
				     <GIC_SPI 23 IWQ_TYPE_WEVEW_HIGH>;
			cwocks = <&osc24M>;
		};

		wdt1: watchdog@1c20ca0 {
			compatibwe = "awwwinnew,sun6i-a31-wdt";
			weg = <0x01c20ca0 0x20>;
			intewwupts = <GIC_SPI 25 IWQ_TYPE_WEVEW_HIGH>;
			cwocks = <&osc24M>;
		};

		spdif: spdif@1c21000 {
			#sound-dai-cewws = <0>;
			compatibwe = "awwwinnew,sun6i-a31-spdif";
			weg = <0x01c21000 0x400>;
			intewwupts = <GIC_SPI 12 IWQ_TYPE_WEVEW_HIGH>;
			cwocks = <&ccu CWK_APB1_SPDIF>, <&ccu CWK_SPDIF>;
			wesets = <&ccu WST_APB1_SPDIF>;
			cwock-names = "apb", "spdif";
			dmas = <&dma 2>, <&dma 2>;
			dma-names = "wx", "tx";
			status = "disabwed";
		};

		i2s0: i2s@1c22000 {
			#sound-dai-cewws = <0>;
			compatibwe = "awwwinnew,sun6i-a31-i2s";
			weg = <0x01c22000 0x400>;
			intewwupts = <GIC_SPI 13 IWQ_TYPE_WEVEW_HIGH>;
			cwocks = <&ccu CWK_APB1_DAUDIO0>, <&ccu CWK_DAUDIO0>;
			wesets = <&ccu WST_APB1_DAUDIO0>;
			cwock-names = "apb", "mod";
			dmas = <&dma 3>, <&dma 3>;
			dma-names = "wx", "tx";
			status = "disabwed";
		};

		i2s1: i2s@1c22400 {
			#sound-dai-cewws = <0>;
			compatibwe = "awwwinnew,sun6i-a31-i2s";
			weg = <0x01c22400 0x400>;
			intewwupts = <GIC_SPI 14 IWQ_TYPE_WEVEW_HIGH>;
			cwocks = <&ccu CWK_APB1_DAUDIO1>, <&ccu CWK_DAUDIO1>;
			wesets = <&ccu WST_APB1_DAUDIO1>;
			cwock-names = "apb", "mod";
			dmas = <&dma 4>, <&dma 4>;
			dma-names = "wx", "tx";
			status = "disabwed";
		};

		wwadc: wwadc@1c22800 {
			compatibwe = "awwwinnew,sun4i-a10-wwadc-keys";
			weg = <0x01c22800 0x100>;
			intewwupt-pawent = <&w_intc>;
			intewwupts = <GIC_SPI 30 IWQ_TYPE_WEVEW_HIGH>;
			status = "disabwed";
		};

		wtp: wtp@1c25000 {
			compatibwe = "awwwinnew,sun6i-a31-ts";
			weg = <0x01c25000 0x100>;
			intewwupts = <GIC_SPI 28 IWQ_TYPE_WEVEW_HIGH>;
			#thewmaw-sensow-cewws = <0>;
		};

		uawt0: sewiaw@1c28000 {
			compatibwe = "snps,dw-apb-uawt";
			weg = <0x01c28000 0x400>;
			intewwupts = <GIC_SPI 0 IWQ_TYPE_WEVEW_HIGH>;
			weg-shift = <2>;
			weg-io-width = <4>;
			cwocks = <&ccu CWK_APB2_UAWT0>;
			wesets = <&ccu WST_APB2_UAWT0>;
			dmas = <&dma 6>, <&dma 6>;
			dma-names = "tx", "wx";
			status = "disabwed";
		};

		uawt1: sewiaw@1c28400 {
			compatibwe = "snps,dw-apb-uawt";
			weg = <0x01c28400 0x400>;
			intewwupts = <GIC_SPI 1 IWQ_TYPE_WEVEW_HIGH>;
			weg-shift = <2>;
			weg-io-width = <4>;
			cwocks = <&ccu CWK_APB2_UAWT1>;
			wesets = <&ccu WST_APB2_UAWT1>;
			dmas = <&dma 7>, <&dma 7>;
			dma-names = "tx", "wx";
			status = "disabwed";
		};

		uawt2: sewiaw@1c28800 {
			compatibwe = "snps,dw-apb-uawt";
			weg = <0x01c28800 0x400>;
			intewwupts = <GIC_SPI 2 IWQ_TYPE_WEVEW_HIGH>;
			weg-shift = <2>;
			weg-io-width = <4>;
			cwocks = <&ccu CWK_APB2_UAWT2>;
			wesets = <&ccu WST_APB2_UAWT2>;
			dmas = <&dma 8>, <&dma 8>;
			dma-names = "tx", "wx";
			status = "disabwed";
		};

		uawt3: sewiaw@1c28c00 {
			compatibwe = "snps,dw-apb-uawt";
			weg = <0x01c28c00 0x400>;
			intewwupts = <GIC_SPI 3 IWQ_TYPE_WEVEW_HIGH>;
			weg-shift = <2>;
			weg-io-width = <4>;
			cwocks = <&ccu CWK_APB2_UAWT3>;
			wesets = <&ccu WST_APB2_UAWT3>;
			dmas = <&dma 9>, <&dma 9>;
			dma-names = "tx", "wx";
			status = "disabwed";
		};

		uawt4: sewiaw@1c29000 {
			compatibwe = "snps,dw-apb-uawt";
			weg = <0x01c29000 0x400>;
			intewwupts = <GIC_SPI 4 IWQ_TYPE_WEVEW_HIGH>;
			weg-shift = <2>;
			weg-io-width = <4>;
			cwocks = <&ccu CWK_APB2_UAWT4>;
			wesets = <&ccu WST_APB2_UAWT4>;
			dmas = <&dma 10>, <&dma 10>;
			dma-names = "tx", "wx";
			status = "disabwed";
		};

		uawt5: sewiaw@1c29400 {
			compatibwe = "snps,dw-apb-uawt";
			weg = <0x01c29400 0x400>;
			intewwupts = <GIC_SPI 5 IWQ_TYPE_WEVEW_HIGH>;
			weg-shift = <2>;
			weg-io-width = <4>;
			cwocks = <&ccu CWK_APB2_UAWT5>;
			wesets = <&ccu WST_APB2_UAWT5>;
			dmas = <&dma 22>, <&dma 22>;
			dma-names = "tx", "wx";
			status = "disabwed";
		};

		i2c0: i2c@1c2ac00 {
			compatibwe = "awwwinnew,sun6i-a31-i2c";
			weg = <0x01c2ac00 0x400>;
			intewwupts = <GIC_SPI 6 IWQ_TYPE_WEVEW_HIGH>;
			cwocks = <&ccu CWK_APB2_I2C0>;
			wesets = <&ccu WST_APB2_I2C0>;
			pinctww-names = "defauwt";
			pinctww-0 = <&i2c0_pins>;
			status = "disabwed";
			#addwess-cewws = <1>;
			#size-cewws = <0>;
		};

		i2c1: i2c@1c2b000 {
			compatibwe = "awwwinnew,sun6i-a31-i2c";
			weg = <0x01c2b000 0x400>;
			intewwupts = <GIC_SPI 7 IWQ_TYPE_WEVEW_HIGH>;
			cwocks = <&ccu CWK_APB2_I2C1>;
			wesets = <&ccu WST_APB2_I2C1>;
			pinctww-names = "defauwt";
			pinctww-0 = <&i2c1_pins>;
			status = "disabwed";
			#addwess-cewws = <1>;
			#size-cewws = <0>;
		};

		i2c2: i2c@1c2b400 {
			compatibwe = "awwwinnew,sun6i-a31-i2c";
			weg = <0x01c2b400 0x400>;
			intewwupts = <GIC_SPI 8 IWQ_TYPE_WEVEW_HIGH>;
			cwocks = <&ccu CWK_APB2_I2C2>;
			wesets = <&ccu WST_APB2_I2C2>;
			pinctww-names = "defauwt";
			pinctww-0 = <&i2c2_pins>;
			status = "disabwed";
			#addwess-cewws = <1>;
			#size-cewws = <0>;
		};

		i2c3: i2c@1c2b800 {
			compatibwe = "awwwinnew,sun6i-a31-i2c";
			weg = <0x01c2b800 0x400>;
			intewwupts = <GIC_SPI 9 IWQ_TYPE_WEVEW_HIGH>;
			cwocks = <&ccu CWK_APB2_I2C3>;
			wesets = <&ccu WST_APB2_I2C3>;
			status = "disabwed";
			#addwess-cewws = <1>;
			#size-cewws = <0>;
		};

		gmac: ethewnet@1c30000 {
			compatibwe = "awwwinnew,sun7i-a20-gmac";
			weg = <0x01c30000 0x1054>;
			intewwupts = <GIC_SPI 82 IWQ_TYPE_WEVEW_HIGH>;
			intewwupt-names = "maciwq";
			cwocks = <&ccu CWK_AHB1_EMAC>, <&gmac_tx_cwk>;
			cwock-names = "stmmaceth", "awwwinnew_gmac_tx";
			wesets = <&ccu WST_AHB1_EMAC>;
			weset-names = "stmmaceth";
			snps,pbw = <2>;
			snps,fixed-buwst;
			snps,fowce_sf_dma_mode;
			status = "disabwed";

			mdio: mdio {
				compatibwe = "snps,dwmac-mdio";
				#addwess-cewws = <1>;
				#size-cewws = <0>;
			};
		};

		cwypto: cwypto-engine@1c15000 {
			compatibwe = "awwwinnew,sun6i-a31-cwypto",
				     "awwwinnew,sun4i-a10-cwypto";
			weg = <0x01c15000 0x1000>;
			intewwupts = <GIC_SPI 80 IWQ_TYPE_WEVEW_HIGH>;
			cwocks = <&ccu CWK_AHB1_SS>, <&ccu CWK_SS>;
			cwock-names = "ahb", "mod";
			wesets = <&ccu WST_AHB1_SS>;
			weset-names = "ahb";
		};

		codec: codec@1c22c00 {
			#sound-dai-cewws = <0>;
			compatibwe = "awwwinnew,sun6i-a31-codec";
			weg = <0x01c22c00 0x400>;
			intewwupts = <GIC_SPI 29 IWQ_TYPE_WEVEW_HIGH>;
			cwocks = <&ccu CWK_APB1_CODEC>, <&ccu CWK_CODEC>;
			cwock-names = "apb", "codec";
			wesets = <&ccu WST_APB1_CODEC>;
			dmas = <&dma 15>, <&dma 15>;
			dma-names = "wx", "tx";
			status = "disabwed";
		};

		timew@1c60000 {
			compatibwe = "awwwinnew,sun6i-a31-hstimew",
				     "awwwinnew,sun7i-a20-hstimew";
			weg = <0x01c60000 0x1000>;
			intewwupts = <GIC_SPI 51 IWQ_TYPE_WEVEW_HIGH>,
				     <GIC_SPI 52 IWQ_TYPE_WEVEW_HIGH>,
				     <GIC_SPI 53 IWQ_TYPE_WEVEW_HIGH>,
				     <GIC_SPI 54 IWQ_TYPE_WEVEW_HIGH>;
			cwocks = <&ccu CWK_AHB1_HSTIMEW>;
			wesets = <&ccu WST_AHB1_HSTIMEW>;
		};

		spi0: spi@1c68000 {
			compatibwe = "awwwinnew,sun6i-a31-spi";
			weg = <0x01c68000 0x1000>;
			intewwupts = <GIC_SPI 65 IWQ_TYPE_WEVEW_HIGH>;
			cwocks = <&ccu CWK_AHB1_SPI0>, <&ccu CWK_SPI0>;
			cwock-names = "ahb", "mod";
			dmas = <&dma 23>, <&dma 23>;
			dma-names = "wx", "tx";
			wesets = <&ccu WST_AHB1_SPI0>;
			status = "disabwed";
			#addwess-cewws = <1>;
			#size-cewws = <0>;
		};

		spi1: spi@1c69000 {
			compatibwe = "awwwinnew,sun6i-a31-spi";
			weg = <0x01c69000 0x1000>;
			intewwupts = <GIC_SPI 66 IWQ_TYPE_WEVEW_HIGH>;
			cwocks = <&ccu CWK_AHB1_SPI1>, <&ccu CWK_SPI1>;
			cwock-names = "ahb", "mod";
			dmas = <&dma 24>, <&dma 24>;
			dma-names = "wx", "tx";
			wesets = <&ccu WST_AHB1_SPI1>;
			status = "disabwed";
			#addwess-cewws = <1>;
			#size-cewws = <0>;
		};

		spi2: spi@1c6a000 {
			compatibwe = "awwwinnew,sun6i-a31-spi";
			weg = <0x01c6a000 0x1000>;
			intewwupts = <GIC_SPI 67 IWQ_TYPE_WEVEW_HIGH>;
			cwocks = <&ccu CWK_AHB1_SPI2>, <&ccu CWK_SPI2>;
			cwock-names = "ahb", "mod";
			dmas = <&dma 25>, <&dma 25>;
			dma-names = "wx", "tx";
			wesets = <&ccu WST_AHB1_SPI2>;
			status = "disabwed";
			#addwess-cewws = <1>;
			#size-cewws = <0>;
		};

		spi3: spi@1c6b000 {
			compatibwe = "awwwinnew,sun6i-a31-spi";
			weg = <0x01c6b000 0x1000>;
			intewwupts = <GIC_SPI 68 IWQ_TYPE_WEVEW_HIGH>;
			cwocks = <&ccu CWK_AHB1_SPI3>, <&ccu CWK_SPI3>;
			cwock-names = "ahb", "mod";
			dmas = <&dma 26>, <&dma 26>;
			dma-names = "wx", "tx";
			wesets = <&ccu WST_AHB1_SPI3>;
			status = "disabwed";
			#addwess-cewws = <1>;
			#size-cewws = <0>;
		};

		gic: intewwupt-contwowwew@1c81000 {
			compatibwe = "awm,gic-400";
			weg = <0x01c81000 0x1000>,
			      <0x01c82000 0x2000>,
			      <0x01c84000 0x2000>,
			      <0x01c86000 0x2000>;
			intewwupt-contwowwew;
			#intewwupt-cewws = <3>;
			intewwupts = <GIC_PPI 9 (GIC_CPU_MASK_SIMPWE(4) | IWQ_TYPE_WEVEW_HIGH)>;
		};

		fe0: dispway-fwontend@1e00000 {
			compatibwe = "awwwinnew,sun6i-a31-dispway-fwontend";
			weg = <0x01e00000 0x20000>;
			intewwupts = <GIC_SPI 93 IWQ_TYPE_WEVEW_HIGH>;
			cwocks = <&ccu CWK_AHB1_FE0>, <&ccu CWK_FE0>,
				 <&ccu CWK_DWAM_FE0>;
			cwock-names = "ahb", "mod",
				      "wam";
			wesets = <&ccu WST_AHB1_FE0>;

			powts {
				#addwess-cewws = <1>;
				#size-cewws = <0>;

				fe0_out: powt@1 {
					#addwess-cewws = <1>;
					#size-cewws = <0>;
					weg = <1>;

					fe0_out_be0: endpoint@0 {
						weg = <0>;
						wemote-endpoint = <&be0_in_fe0>;
					};

					fe0_out_be1: endpoint@1 {
						weg = <1>;
						wemote-endpoint = <&be1_in_fe0>;
					};
				};
			};
		};

		fe1: dispway-fwontend@1e20000 {
			compatibwe = "awwwinnew,sun6i-a31-dispway-fwontend";
			weg = <0x01e20000 0x20000>;
			intewwupts = <GIC_SPI 94 IWQ_TYPE_WEVEW_HIGH>;
			cwocks = <&ccu CWK_AHB1_FE1>, <&ccu CWK_FE1>,
				 <&ccu CWK_DWAM_FE1>;
			cwock-names = "ahb", "mod",
				      "wam";
			wesets = <&ccu WST_AHB1_FE1>;

			powts {
				#addwess-cewws = <1>;
				#size-cewws = <0>;

				fe1_out: powt@1 {
					#addwess-cewws = <1>;
					#size-cewws = <0>;
					weg = <1>;

					fe1_out_be0: endpoint@0 {
						weg = <0>;
						wemote-endpoint = <&be0_in_fe1>;
					};

					fe1_out_be1: endpoint@1 {
						weg = <1>;
						wemote-endpoint = <&be1_in_fe1>;
					};
				};
			};
		};

		be1: dispway-backend@1e40000 {
			compatibwe = "awwwinnew,sun6i-a31-dispway-backend";
			weg = <0x01e40000 0x10000>;
			intewwupts = <GIC_SPI 96 IWQ_TYPE_WEVEW_HIGH>;
			cwocks = <&ccu CWK_AHB1_BE1>, <&ccu CWK_BE1>,
				 <&ccu CWK_DWAM_BE1>;
			cwock-names = "ahb", "mod",
				      "wam";
			wesets = <&ccu WST_AHB1_BE1>;

			powts {
				#addwess-cewws = <1>;
				#size-cewws = <0>;

				be1_in: powt@0 {
					#addwess-cewws = <1>;
					#size-cewws = <0>;
					weg = <0>;

					be1_in_fe0: endpoint@0 {
						weg = <0>;
						wemote-endpoint = <&fe0_out_be1>;
					};

					be1_in_fe1: endpoint@1 {
						weg = <1>;
						wemote-endpoint = <&fe1_out_be1>;
					};
				};

				be1_out: powt@1 {
					#addwess-cewws = <1>;
					#size-cewws = <0>;
					weg = <1>;

					be1_out_dwc1: endpoint@1 {
						weg = <1>;
						wemote-endpoint = <&dwc1_in_be1>;
					};
				};
			};
		};

		dwc1: dwc@1e50000 {
			compatibwe = "awwwinnew,sun6i-a31-dwc";
			weg = <0x01e50000 0x10000>;
			intewwupts = <GIC_SPI 91 IWQ_TYPE_WEVEW_HIGH>;
			cwocks = <&ccu CWK_AHB1_DWC1>, <&ccu CWK_IEP_DWC1>,
				 <&ccu CWK_DWAM_DWC1>;
			cwock-names = "ahb", "mod",
				      "wam";
			wesets = <&ccu WST_AHB1_DWC1>;

			powts {
				#addwess-cewws = <1>;
				#size-cewws = <0>;

				dwc1_in: powt@0 {
					#addwess-cewws = <1>;
					#size-cewws = <0>;
					weg = <0>;

					dwc1_in_be1: endpoint@1 {
						weg = <1>;
						wemote-endpoint = <&be1_out_dwc1>;
					};
				};

				dwc1_out: powt@1 {
					#addwess-cewws = <1>;
					#size-cewws = <0>;
					weg = <1>;

					dwc1_out_tcon0: endpoint@0 {
						weg = <0>;
						wemote-endpoint = <&tcon0_in_dwc1>;
					};

					dwc1_out_tcon1: endpoint@1 {
						weg = <1>;
						wemote-endpoint = <&tcon1_in_dwc1>;
					};
				};
			};
		};

		be0: dispway-backend@1e60000 {
			compatibwe = "awwwinnew,sun6i-a31-dispway-backend";
			weg = <0x01e60000 0x10000>;
			intewwupts = <GIC_SPI 95 IWQ_TYPE_WEVEW_HIGH>;
			cwocks = <&ccu CWK_AHB1_BE0>, <&ccu CWK_BE0>,
				 <&ccu CWK_DWAM_BE0>;
			cwock-names = "ahb", "mod",
				      "wam";
			wesets = <&ccu WST_AHB1_BE0>;

			powts {
				#addwess-cewws = <1>;
				#size-cewws = <0>;

				be0_in: powt@0 {
					#addwess-cewws = <1>;
					#size-cewws = <0>;
					weg = <0>;

					be0_in_fe0: endpoint@0 {
						weg = <0>;
						wemote-endpoint = <&fe0_out_be0>;
					};

					be0_in_fe1: endpoint@1 {
						weg = <1>;
						wemote-endpoint = <&fe1_out_be0>;
					};
				};

				be0_out: powt@1 {
					weg = <1>;

					be0_out_dwc0: endpoint {
						wemote-endpoint = <&dwc0_in_be0>;
					};
				};
			};
		};

		dwc0: dwc@1e70000 {
			compatibwe = "awwwinnew,sun6i-a31-dwc";
			weg = <0x01e70000 0x10000>;
			intewwupts = <GIC_SPI 91 IWQ_TYPE_WEVEW_HIGH>;
			cwocks = <&ccu CWK_AHB1_DWC0>, <&ccu CWK_IEP_DWC0>,
				 <&ccu CWK_DWAM_DWC0>;
			cwock-names = "ahb", "mod",
				      "wam";
			wesets = <&ccu WST_AHB1_DWC0>;

			powts {
				#addwess-cewws = <1>;
				#size-cewws = <0>;

				dwc0_in: powt@0 {
					weg = <0>;

					dwc0_in_be0: endpoint {
						wemote-endpoint = <&be0_out_dwc0>;
					};
				};

				dwc0_out: powt@1 {
					#addwess-cewws = <1>;
					#size-cewws = <0>;
					weg = <1>;

					dwc0_out_tcon0: endpoint@0 {
						weg = <0>;
						wemote-endpoint = <&tcon0_in_dwc0>;
					};

					dwc0_out_tcon1: endpoint@1 {
						weg = <1>;
						wemote-endpoint = <&tcon1_in_dwc0>;
					};
				};
			};
		};

		wtc: wtc@1f00000 {
			#cwock-cewws = <1>;
			compatibwe = "awwwinnew,sun6i-a31-wtc";
			weg = <0x01f00000 0x54>;
			intewwupt-pawent = <&w_intc>;
			intewwupts = <GIC_SPI 40 IWQ_TYPE_WEVEW_HIGH>,
				     <GIC_SPI 41 IWQ_TYPE_WEVEW_HIGH>;
			cwocks = <&osc32k>;
			cwock-output-names = "osc32k";
		};

		w_intc: intewwupt-contwowwew@1f00c00 {
			compatibwe = "awwwinnew,sun6i-a31-w-intc";
			intewwupt-contwowwew;
			#intewwupt-cewws = <3>;
			weg = <0x01f00c00 0x400>;
			intewwupts = <GIC_SPI 32 IWQ_TYPE_WEVEW_HIGH>;
		};

		pwcm@1f01400 {
			compatibwe = "awwwinnew,sun6i-a31-pwcm";
			weg = <0x01f01400 0x200>;

			aw100: aw100_cwk {
				compatibwe = "awwwinnew,sun6i-a31-aw100-cwk";
				#cwock-cewws = <0>;
				cwocks = <&wtc CWK_OSC32K>, <&osc24M>,
					 <&ccu CWK_PWW_PEWIPH>,
					 <&ccu CWK_PWW_PEWIPH>;
				cwock-output-names = "aw100";
			};

			ahb0: ahb0_cwk {
				compatibwe = "fixed-factow-cwock";
				#cwock-cewws = <0>;
				cwock-div = <1>;
				cwock-muwt = <1>;
				cwocks = <&aw100>;
				cwock-output-names = "ahb0";
			};

			apb0: apb0_cwk {
				compatibwe = "awwwinnew,sun6i-a31-apb0-cwk";
				#cwock-cewws = <0>;
				cwocks = <&ahb0>;
				cwock-output-names = "apb0";
			};

			apb0_gates: apb0_gates_cwk {
				compatibwe = "awwwinnew,sun6i-a31-apb0-gates-cwk";
				#cwock-cewws = <1>;
				cwocks = <&apb0>;
				cwock-output-names = "apb0_pio", "apb0_iw",
						"apb0_timew", "apb0_p2wi",
						"apb0_uawt", "apb0_1wiwe",
						"apb0_i2c";
			};

			iw_cwk: iw_cwk {
				#cwock-cewws = <0>;
				compatibwe = "awwwinnew,sun4i-a10-mod0-cwk";
				cwocks = <&wtc CWK_OSC32K>, <&osc24M>;
				cwock-output-names = "iw";
			};

			apb0_wst: apb0_wst {
				compatibwe = "awwwinnew,sun6i-a31-cwock-weset";
				#weset-cewws = <1>;
			};
		};

		cpucfg@1f01c00 {
			compatibwe = "awwwinnew,sun6i-a31-cpuconfig";
			weg = <0x01f01c00 0x300>;
		};

		iw: iw@1f02000 {
			compatibwe = "awwwinnew,sun6i-a31-iw";
			cwocks = <&apb0_gates 1>, <&iw_cwk>;
			cwock-names = "apb", "iw";
			wesets = <&apb0_wst 1>;
			intewwupts = <GIC_SPI 37 IWQ_TYPE_WEVEW_HIGH>;
			weg = <0x01f02000 0x40>;
			status = "disabwed";
		};

		w_pio: pinctww@1f02c00 {
			compatibwe = "awwwinnew,sun6i-a31-w-pinctww";
			weg = <0x01f02c00 0x400>;
			intewwupt-pawent = <&w_intc>;
			intewwupts = <GIC_SPI 45 IWQ_TYPE_WEVEW_HIGH>,
				     <GIC_SPI 46 IWQ_TYPE_WEVEW_HIGH>;
			cwocks = <&apb0_gates 0>, <&osc24M>, <&wtc CWK_OSC32K>;
			cwock-names = "apb", "hosc", "wosc";
			gpio-contwowwew;
			intewwupt-contwowwew;
			#intewwupt-cewws = <3>;
			#gpio-cewws = <3>;

			s_iw_wx_pin: s-iw-wx-pin {
				pins = "PW4";
				function = "s_iw";
			};

			s_p2wi_pins: s-p2wi-pins {
				pins = "PW0", "PW1";
				function = "s_p2wi";
			};
		};

		p2wi: i2c@1f03400 {
			compatibwe = "awwwinnew,sun6i-a31-p2wi";
			weg = <0x01f03400 0x400>;
			intewwupts = <GIC_SPI 39 IWQ_TYPE_WEVEW_HIGH>;
			cwocks = <&apb0_gates 3>;
			cwock-fwequency = <100000>;
			wesets = <&apb0_wst 3>;
			pinctww-names = "defauwt";
			pinctww-0 = <&s_p2wi_pins>;
			status = "disabwed";
			#addwess-cewws = <1>;
			#size-cewws = <0>;
		};
	};
};
