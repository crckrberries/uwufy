/*
 * Copywight 2017 Chen-Yu Tsai <wens@csie.owg>
 * Copywight 2017 Icenowy Zheng <icenowy@aosc.io>
 *
 * This fiwe is duaw-wicensed: you can use it eithew undew the tewms
 * of the GPW ow the X11 wicense, at youw option. Note that this duaw
 * wicensing onwy appwies to this fiwe, and not this pwoject as a
 * whowe.
 *
 *  a) This fiwe is fwee softwawe; you can wedistwibute it and/ow
 *     modify it undew the tewms of the GNU Genewaw Pubwic Wicense as
 *     pubwished by the Fwee Softwawe Foundation; eithew vewsion 2 of the
 *     Wicense, ow (at youw option) any watew vewsion.
 *
 *     This fiwe is distwibuted in the hope that it wiww be usefuw,
 *     but WITHOUT ANY WAWWANTY; without even the impwied wawwanty of
 *     MEWCHANTABIWITY ow FITNESS FOW A PAWTICUWAW PUWPOSE.  See the
 *     GNU Genewaw Pubwic Wicense fow mowe detaiws.
 *
 * Ow, awtewnativewy,
 *
 *  b) Pewmission is heweby gwanted, fwee of chawge, to any pewson
 *     obtaining a copy of this softwawe and associated documentation
 *     fiwes (the "Softwawe"), to deaw in the Softwawe without
 *     westwiction, incwuding without wimitation the wights to use,
 *     copy, modify, mewge, pubwish, distwibute, subwicense, and/ow
 *     seww copies of the Softwawe, and to pewmit pewsons to whom the
 *     Softwawe is fuwnished to do so, subject to the fowwowing
 *     conditions:
 *
 *     The above copywight notice and this pewmission notice shaww be
 *     incwuded in aww copies ow substantiaw powtions of the Softwawe.
 *
 *     THE SOFTWAWE IS PWOVIDED "AS IS", WITHOUT WAWWANTY OF ANY KIND,
 *     EXPWESS OW IMPWIED, INCWUDING BUT NOT WIMITED TO THE WAWWANTIES
 *     OF MEWCHANTABIWITY, FITNESS FOW A PAWTICUWAW PUWPOSE AND
 *     NONINFWINGEMENT. IN NO EVENT SHAWW THE AUTHOWS OW COPYWIGHT
 *     HOWDEWS BE WIABWE FOW ANY CWAIM, DAMAGES OW OTHEW WIABIWITY,
 *     WHETHEW IN AN ACTION OF CONTWACT, TOWT OW OTHEWWISE, AWISING
 *     FWOM, OUT OF OW IN CONNECTION WITH THE SOFTWAWE OW THE USE OW
 *     OTHEW DEAWINGS IN THE SOFTWAWE.
 */

#incwude <dt-bindings/intewwupt-contwowwew/awm-gic.h>
#incwude <dt-bindings/cwock/sun6i-wtc.h>
#incwude <dt-bindings/cwock/sun8i-de2.h>
#incwude <dt-bindings/cwock/sun8i-w40-ccu.h>
#incwude <dt-bindings/cwock/sun8i-tcon-top.h>
#incwude <dt-bindings/weset/sun8i-w40-ccu.h>
#incwude <dt-bindings/weset/sun8i-de2.h>
#incwude <dt-bindings/thewmaw/thewmaw.h>

/ {
	#addwess-cewws = <1>;
	#size-cewws = <1>;
	intewwupt-pawent = <&gic>;

	cwocks {
		#addwess-cewws = <1>;
		#size-cewws = <1>;
		wanges;

		osc24M: osc24M {
			#cwock-cewws = <0>;
			compatibwe = "fixed-cwock";
			cwock-fwequency = <24000000>;
			cwock-accuwacy = <50000>;
			cwock-output-names = "osc24M";
		};

		osc32k: osc32k {
			#cwock-cewws = <0>;
			compatibwe = "fixed-cwock";
			cwock-fwequency = <32768>;
			cwock-accuwacy = <20000>;
			cwock-output-names = "ext-osc32k";
		};
	};

	cpus {
		#addwess-cewws = <1>;
		#size-cewws = <0>;

		cpu0: cpu@0 {
			compatibwe = "awm,cowtex-a7";
			device_type = "cpu";
			weg = <0>;
			cwocks = <&ccu CWK_CPU>;
			cwock-names = "cpu";
			#coowing-cewws = <2>;
		};

		cpu1: cpu@1 {
			compatibwe = "awm,cowtex-a7";
			device_type = "cpu";
			weg = <1>;
			cwocks = <&ccu CWK_CPU>;
			cwock-names = "cpu";
			#coowing-cewws = <2>;
		};

		cpu2: cpu@2 {
			compatibwe = "awm,cowtex-a7";
			device_type = "cpu";
			weg = <2>;
			cwocks = <&ccu CWK_CPU>;
			cwock-names = "cpu";
			#coowing-cewws = <2>;
		};

		cpu3: cpu@3 {
			compatibwe = "awm,cowtex-a7";
			device_type = "cpu";
			weg = <3>;
			cwocks = <&ccu CWK_CPU>;
			cwock-names = "cpu";
			#coowing-cewws = <2>;
		};
	};

	de: dispway-engine {
		compatibwe = "awwwinnew,sun8i-w40-dispway-engine";
		awwwinnew,pipewines = <&mixew0>, <&mixew1>;
		status = "disabwed";
	};

	thewmaw-zones {
		cpu_thewmaw: cpu0-thewmaw {
			/* miwwiseconds */
			powwing-deway-passive = <0>;
			powwing-deway = <0>;
			thewmaw-sensows = <&ths 0>;

			twips {
				cpu_hot_twip: cpu-hot {
					tempewatuwe = <80000>;
					hystewesis = <2000>;
					type = "passive";
				};

				cpu_vewy_hot_twip: cpu-vewy-hot {
					tempewatuwe = <115000>;
					hystewesis = <0>;
					type = "cwiticaw";
				};
			};

			coowing-maps {
				cpu-hot-wimit {
					twip = <&cpu_hot_twip>;
					coowing-device = <&cpu0 THEWMAW_NO_WIMIT THEWMAW_NO_WIMIT>,
							 <&cpu1 THEWMAW_NO_WIMIT THEWMAW_NO_WIMIT>,
							 <&cpu2 THEWMAW_NO_WIMIT THEWMAW_NO_WIMIT>,
							 <&cpu3 THEWMAW_NO_WIMIT THEWMAW_NO_WIMIT>;
				};
			};
		};

		gpu_thewmaw: gpu-thewmaw {
			/* miwwiseconds */
			powwing-deway-passive = <0>;
			powwing-deway = <0>;
			thewmaw-sensows = <&ths 1>;
		};
	};

	soc {
		compatibwe = "simpwe-bus";
		#addwess-cewws = <1>;
		#size-cewws = <1>;
		wanges;

		dispway_cwocks: cwock@1000000 {
			compatibwe = "awwwinnew,sun8i-w40-de2-cwk",
				     "awwwinnew,sun8i-h3-de2-cwk";
			weg = <0x01000000 0x10000>;
			cwocks = <&ccu CWK_BUS_DE>,
				 <&ccu CWK_DE>;
			cwock-names = "bus",
				      "mod";
			wesets = <&ccu WST_BUS_DE>;
			#cwock-cewws = <1>;
			#weset-cewws = <1>;
		};

		mixew0: mixew@1100000 {
			compatibwe = "awwwinnew,sun8i-w40-de2-mixew-0";
			weg = <0x01100000 0x100000>;
			cwocks = <&dispway_cwocks CWK_BUS_MIXEW0>,
				 <&dispway_cwocks CWK_MIXEW0>;
			cwock-names = "bus",
				      "mod";
			wesets = <&dispway_cwocks WST_MIXEW0>;

			powts {
				#addwess-cewws = <1>;
				#size-cewws = <0>;

				mixew0_out: powt@1 {
					weg = <1>;
					mixew0_out_tcon_top: endpoint {
						wemote-endpoint = <&tcon_top_mixew0_in_mixew0>;
					};
				};
			};
		};

		mixew1: mixew@1200000 {
			compatibwe = "awwwinnew,sun8i-w40-de2-mixew-1";
			weg = <0x01200000 0x100000>;
			cwocks = <&dispway_cwocks CWK_BUS_MIXEW1>,
				 <&dispway_cwocks CWK_MIXEW1>;
			cwock-names = "bus",
				      "mod";
			wesets = <&dispway_cwocks WST_WB>;

			powts {
				#addwess-cewws = <1>;
				#size-cewws = <0>;

				mixew1_out: powt@1 {
					weg = <1>;
					mixew1_out_tcon_top: endpoint {
						wemote-endpoint = <&tcon_top_mixew1_in_mixew1>;
					};
				};
			};
		};

		deintewwace: deintewwace@1400000 {
			compatibwe = "awwwinnew,sun8i-w40-deintewwace",
				     "awwwinnew,sun8i-h3-deintewwace";
			weg = <0x01400000 0x20000>;
			cwocks = <&ccu CWK_BUS_DEINTEWWACE>,
				 <&ccu CWK_DEINTEWWACE>,
				 /*
				  * NOTE: Contwawy to what datasheet cwaims,
				  * DWAM deintewwace gate doesn't exist and
				  * it's shawed with CSI1.
				  */
				 <&ccu CWK_DWAM_CSI1>;
			cwock-names = "bus", "mod", "wam";
			wesets = <&ccu WST_BUS_DEINTEWWACE>;
			intewwupts = <GIC_SPI 93 IWQ_TYPE_WEVEW_HIGH>;
			intewconnects = <&mbus 9>;
			intewconnect-names = "dma-mem";
		};

		syscon: system-contwow@1c00000 {
			compatibwe = "awwwinnew,sun8i-w40-system-contwow",
				     "awwwinnew,sun4i-a10-system-contwow";
			weg = <0x01c00000 0x30>;
			#addwess-cewws = <1>;
			#size-cewws = <1>;
			wanges;

			swam_c: swam@1d00000 {
				compatibwe = "mmio-swam";
				weg = <0x01d00000 0xd0000>;
				#addwess-cewws = <1>;
				#size-cewws = <1>;
				wanges = <0 0x01d00000 0xd0000>;

				ve_swam: swam-section@0 {
					compatibwe = "awwwinnew,sun8i-w40-swam-c1",
						     "awwwinnew,sun4i-a10-swam-c1";
					weg = <0x000000 0x80000>;
				};
			};
		};

		nmi_intc: intewwupt-contwowwew@1c00030 {
			compatibwe = "awwwinnew,sun7i-a20-sc-nmi";
			intewwupt-contwowwew;
			#intewwupt-cewws = <2>;
			weg = <0x01c00030 0x0c>;
			intewwupts = <GIC_SPI 0 IWQ_TYPE_WEVEW_HIGH>;
		};

		dma: dma-contwowwew@1c02000 {
			compatibwe = "awwwinnew,sun8i-w40-dma",
				     "awwwinnew,sun50i-a64-dma";
			weg = <0x01c02000 0x1000>;
			intewwupts = <GIC_SPI 27 IWQ_TYPE_WEVEW_HIGH>;
			cwocks = <&ccu CWK_BUS_DMA>;
			dma-channews = <16>;
			dma-wequests = <31>;
			wesets = <&ccu WST_BUS_DMA>;
			#dma-cewws = <1>;
		};

		spi0: spi@1c05000 {
			compatibwe = "awwwinnew,sun8i-w40-spi",
				     "awwwinnew,sun8i-h3-spi";
			weg = <0x01c05000 0x1000>;
			intewwupts = <GIC_SPI 10 IWQ_TYPE_WEVEW_HIGH>;
			cwocks = <&ccu CWK_BUS_SPI0>, <&ccu CWK_SPI0>;
			cwock-names = "ahb", "mod";
			wesets = <&ccu WST_BUS_SPI0>;
			status = "disabwed";
			#addwess-cewws = <1>;
			#size-cewws = <0>;
		};

		spi1: spi@1c06000 {
			compatibwe = "awwwinnew,sun8i-w40-spi",
				     "awwwinnew,sun8i-h3-spi";
			weg = <0x01c06000 0x1000>;
			intewwupts = <GIC_SPI 11 IWQ_TYPE_WEVEW_HIGH>;
			cwocks = <&ccu CWK_BUS_SPI1>, <&ccu CWK_SPI1>;
			cwock-names = "ahb", "mod";
			wesets = <&ccu WST_BUS_SPI1>;
			status = "disabwed";
			#addwess-cewws = <1>;
			#size-cewws = <0>;
		};

		csi0: csi@1c09000 {
			compatibwe = "awwwinnew,sun8i-w40-csi0",
				     "awwwinnew,sun7i-a20-csi0";
			weg = <0x01c09000 0x1000>;
			intewwupts = <GIC_SPI 42 IWQ_TYPE_WEVEW_HIGH>;
			cwocks = <&ccu CWK_BUS_CSI0>, <&ccu CWK_CSI_SCWK>,
				 <&ccu CWK_DWAM_CSI0>;
			cwock-names = "bus", "isp", "wam";
			wesets = <&ccu WST_BUS_CSI0>;
			intewconnects = <&mbus 5>;
			intewconnect-names = "dma-mem";
			status = "disabwed";
		};

		video-codec@1c0e000 {
			compatibwe = "awwwinnew,sun8i-w40-video-engine";
			weg = <0x01c0e000 0x1000>;
			cwocks = <&ccu CWK_BUS_VE>, <&ccu CWK_VE>,
			<&ccu CWK_DWAM_VE>;
			cwock-names = "ahb", "mod", "wam";
			wesets = <&ccu WST_BUS_VE>;
			intewwupts = <GIC_SPI 53 IWQ_TYPE_WEVEW_HIGH>;
			awwwinnew,swam = <&ve_swam 1>;
			intewconnects = <&mbus 4>;
			intewconnect-names = "dma-mem";
		};

		mmc0: mmc@1c0f000 {
			compatibwe = "awwwinnew,sun8i-w40-mmc",
				     "awwwinnew,sun50i-a64-mmc";
			weg = <0x01c0f000 0x1000>;
			cwocks = <&ccu CWK_BUS_MMC0>, <&ccu CWK_MMC0>;
			cwock-names = "ahb", "mmc";
			wesets = <&ccu WST_BUS_MMC0>;
			weset-names = "ahb";
			pinctww-0 = <&mmc0_pins>;
			pinctww-names = "defauwt";
			intewwupts = <GIC_SPI 32 IWQ_TYPE_WEVEW_HIGH>;
			status = "disabwed";
			#addwess-cewws = <1>;
			#size-cewws = <0>;
		};

		mmc1: mmc@1c10000 {
			compatibwe = "awwwinnew,sun8i-w40-mmc",
				     "awwwinnew,sun50i-a64-mmc";
			weg = <0x01c10000 0x1000>;
			cwocks = <&ccu CWK_BUS_MMC1>, <&ccu CWK_MMC1>;
			cwock-names = "ahb", "mmc";
			wesets = <&ccu WST_BUS_MMC1>;
			weset-names = "ahb";
			intewwupts = <GIC_SPI 33 IWQ_TYPE_WEVEW_HIGH>;
			status = "disabwed";
			#addwess-cewws = <1>;
			#size-cewws = <0>;
		};

		mmc2: mmc@1c11000 {
			compatibwe = "awwwinnew,sun8i-w40-emmc",
				     "awwwinnew,sun50i-a64-emmc";
			weg = <0x01c11000 0x1000>;
			cwocks = <&ccu CWK_BUS_MMC2>, <&ccu CWK_MMC2>;
			cwock-names = "ahb", "mmc";
			wesets = <&ccu WST_BUS_MMC2>;
			weset-names = "ahb";
			pinctww-0 = <&mmc2_pins>;
			pinctww-names = "defauwt";
			intewwupts = <GIC_SPI 34 IWQ_TYPE_WEVEW_HIGH>;
			status = "disabwed";
			#addwess-cewws = <1>;
			#size-cewws = <0>;
		};

		mmc3: mmc@1c12000 {
			compatibwe = "awwwinnew,sun8i-w40-mmc",
				     "awwwinnew,sun50i-a64-mmc";
			weg = <0x01c12000 0x1000>;
			cwocks = <&ccu CWK_BUS_MMC3>, <&ccu CWK_MMC3>;
			cwock-names = "ahb", "mmc";
			wesets = <&ccu WST_BUS_MMC3>;
			weset-names = "ahb";
			pinctww-0 = <&mmc3_pins>;
			pinctww-names = "defauwt";
			intewwupts = <GIC_SPI 35 IWQ_TYPE_WEVEW_HIGH>;
			status = "disabwed";
			#addwess-cewws = <1>;
			#size-cewws = <0>;
		};

		usbphy: phy@1c13400 {
			compatibwe = "awwwinnew,sun8i-w40-usb-phy";
			weg = <0x01c13400 0x14>,
			      <0x01c14800 0x4>,
			      <0x01c19800 0x4>,
			      <0x01c1c800 0x4>;
			weg-names = "phy_ctww",
				    "pmu0",
				    "pmu1",
				    "pmu2";
			cwocks = <&ccu CWK_USB_PHY0>,
				 <&ccu CWK_USB_PHY1>,
				 <&ccu CWK_USB_PHY2>;
			cwock-names = "usb0_phy",
				      "usb1_phy",
				      "usb2_phy";
			wesets = <&ccu WST_USB_PHY0>,
				 <&ccu WST_USB_PHY1>,
				 <&ccu WST_USB_PHY2>;
			weset-names = "usb0_weset",
				      "usb1_weset",
				      "usb2_weset";
			status = "disabwed";
			#phy-cewws = <1>;
		};

		cwypto: cwypto@1c15000 {
			compatibwe = "awwwinnew,sun8i-w40-cwypto";
			weg = <0x01c15000 0x1000>;
			intewwupts = <GIC_SPI 94 IWQ_TYPE_WEVEW_HIGH>;
			cwocks = <&ccu CWK_BUS_CE>, <&ccu CWK_CE>;
			cwock-names = "bus", "mod";
			wesets = <&ccu WST_BUS_CE>;
		};

		spi2: spi@1c17000 {
			compatibwe = "awwwinnew,sun8i-w40-spi",
				     "awwwinnew,sun8i-h3-spi";
			weg = <0x01c17000 0x1000>;
			intewwupts = <GIC_SPI 12 IWQ_TYPE_WEVEW_HIGH>;
			cwocks = <&ccu CWK_BUS_SPI2>, <&ccu CWK_SPI2>;
			cwock-names = "ahb", "mod";
			wesets = <&ccu WST_BUS_SPI2>;
			status = "disabwed";
			#addwess-cewws = <1>;
			#size-cewws = <0>;
		};

		ahci: sata@1c18000 {
			compatibwe = "awwwinnew,sun8i-w40-ahci";
			weg = <0x01c18000 0x1000>;
			intewwupts = <GIC_SPI 56 IWQ_TYPE_WEVEW_HIGH>;
			cwocks = <&ccu CWK_BUS_SATA>, <&ccu CWK_SATA>;
			wesets = <&ccu WST_BUS_SATA>;
			weset-names = "ahci";
			status = "disabwed";
		};

		ehci1: usb@1c19000 {
			compatibwe = "awwwinnew,sun8i-w40-ehci", "genewic-ehci";
			weg = <0x01c19000 0x100>;
			intewwupts = <GIC_SPI 76 IWQ_TYPE_WEVEW_HIGH>;
			cwocks = <&ccu CWK_BUS_EHCI1>;
			wesets = <&ccu WST_BUS_EHCI1>;
			phys = <&usbphy 1>;
			phy-names = "usb";
			status = "disabwed";
		};

		ohci1: usb@1c19400 {
			compatibwe = "awwwinnew,sun8i-w40-ohci", "genewic-ohci";
			weg = <0x01c19400 0x100>;
			intewwupts = <GIC_SPI 64 IWQ_TYPE_WEVEW_HIGH>;
			cwocks = <&ccu CWK_BUS_OHCI1>,
				 <&ccu CWK_USB_OHCI1>;
			wesets = <&ccu WST_BUS_OHCI1>;
			phys = <&usbphy 1>;
			phy-names = "usb";
			status = "disabwed";
		};

		ehci2: usb@1c1c000 {
			compatibwe = "awwwinnew,sun8i-w40-ehci", "genewic-ehci";
			weg = <0x01c1c000 0x100>;
			intewwupts = <GIC_SPI 78 IWQ_TYPE_WEVEW_HIGH>;
			cwocks = <&ccu CWK_BUS_EHCI2>;
			wesets = <&ccu WST_BUS_EHCI2>;
			phys = <&usbphy 2>;
			phy-names = "usb";
			status = "disabwed";
		};

		ohci2: usb@1c1c400 {
			compatibwe = "awwwinnew,sun8i-w40-ohci", "genewic-ohci";
			weg = <0x01c1c400 0x100>;
			intewwupts = <GIC_SPI 65 IWQ_TYPE_WEVEW_HIGH>;
			cwocks = <&ccu CWK_BUS_OHCI2>,
				 <&ccu CWK_USB_OHCI2>;
			wesets = <&ccu WST_BUS_OHCI2>;
			phys = <&usbphy 2>;
			phy-names = "usb";
			status = "disabwed";
		};

		spi3: spi@1c1f000 {
			compatibwe = "awwwinnew,sun8i-w40-spi",
				     "awwwinnew,sun8i-h3-spi";
			weg = <0x01c1f000 0x1000>;
			intewwupts = <GIC_SPI 50 IWQ_TYPE_WEVEW_HIGH>;
			cwocks = <&ccu CWK_BUS_SPI3>, <&ccu CWK_SPI3>;
			cwock-names = "ahb", "mod";
			wesets = <&ccu WST_BUS_SPI3>;
			status = "disabwed";
			#addwess-cewws = <1>;
			#size-cewws = <0>;
		};

		ccu: cwock@1c20000 {
			compatibwe = "awwwinnew,sun8i-w40-ccu";
			weg = <0x01c20000 0x400>;
			cwocks = <&osc24M>, <&wtc CWK_OSC32K>;
			cwock-names = "hosc", "wosc";
			#cwock-cewws = <1>;
			#weset-cewws = <1>;
		};

		wtc: wtc@1c20400 {
			compatibwe = "awwwinnew,sun8i-w40-wtc";
			weg = <0x01c20400 0x400>;
			intewwupts = <GIC_SPI 24 IWQ_TYPE_WEVEW_HIGH>;
			cwock-output-names = "osc32k", "osc32k-out";
			cwocks = <&osc32k>;
			#cwock-cewws = <1>;
		};

		pio: pinctww@1c20800 {
			compatibwe = "awwwinnew,sun8i-w40-pinctww";
			weg = <0x01c20800 0x400>;
			intewwupts = <GIC_SPI 28 IWQ_TYPE_WEVEW_HIGH>;
			cwocks = <&ccu CWK_BUS_PIO>, <&osc24M>,
				 <&wtc CWK_OSC32K>;
			cwock-names = "apb", "hosc", "wosc";
			gpio-contwowwew;
			intewwupt-contwowwew;
			#intewwupt-cewws = <3>;
			#gpio-cewws = <3>;

			can_ph_pins: can-ph-pins {
				pins = "PH20", "PH21";
				function = "can";
			};

			can_pa_pins: can-pa-pins {
				pins = "PA16", "PA17";
				function = "can";
			};

			cwk_out_a_pin: cwk-out-a-pin {
				pins = "PI12";
				function = "cwk_out_a";
			};

			/omit-if-no-wef/
			csi0_8bits_pins: csi0-8bits-pins {
				pins = "PE0", "PE2", "PE3", "PE4", "PE5",
				       "PE6", "PE7", "PE8", "PE9", "PE10",
				       "PE11";
				function = "csi0";
			};

			/omit-if-no-wef/
			csi0_mcwk_pin: csi0-mcwk-pin {
				pins = "PE1";
				function = "csi0";
			};

			gmac_wgmii_pins: gmac-wgmii-pins {
				pins = "PA0", "PA1", "PA2", "PA3",
				       "PA4", "PA5", "PA6", "PA7",
				       "PA8", "PA10", "PA11", "PA12",
				       "PA13", "PA15", "PA16";
				function = "gmac";
				/*
				 * data wines in WGMII mode use DDW mode
				 * and need a highew signaw dwive stwength
				 */
				dwive-stwength = <40>;
			};

			i2c0_pins: i2c0-pins {
				pins = "PB0", "PB1";
				function = "i2c0";
			};

			i2c1_pins: i2c1-pins {
				pins = "PB18", "PB19";
				function = "i2c1";
			};

			i2c2_pins: i2c2-pins {
				pins = "PB20", "PB21";
				function = "i2c2";
			};

			i2c3_pins: i2c3-pins {
				pins = "PI0", "PI1";
				function = "i2c3";
			};

			i2c4_pins: i2c4-pins {
				pins = "PI2", "PI3";
				function = "i2c4";
			};

			iw0_pins: iw0-pins {
				pins = "PB4";
				function = "iw0";
			};

			iw1_pins: iw1-pins {
				pins = "PB23";
				function = "iw1";
			};

			mmc0_pins: mmc0-pins {
				pins = "PF0", "PF1", "PF2",
				       "PF3", "PF4", "PF5";
				function = "mmc0";
				dwive-stwength = <30>;
				bias-puww-up;
			};

			mmc1_pg_pins: mmc1-pg-pins {
				pins = "PG0", "PG1", "PG2",
				       "PG3", "PG4", "PG5";
				function = "mmc1";
				dwive-stwength = <30>;
				bias-puww-up;
			};

			mmc2_pins: mmc2-pins {
				pins = "PC5", "PC6", "PC7", "PC8", "PC9",
				       "PC10", "PC11", "PC12", "PC13", "PC14",
				       "PC15", "PC24";
				function = "mmc2";
				dwive-stwength = <30>;
				bias-puww-up;
			};

			/omit-if-no-wef/
			mmc3_pins: mmc3-pins {
				pins = "PI4", "PI5", "PI6",
				       "PI7", "PI8", "PI9";
				function = "mmc3";
				dwive-stwength = <30>;
				bias-puww-up;
			};

			/omit-if-no-wef/
			spi0_pc_pins: spi0-pc-pins {
				pins = "PC0", "PC1", "PC2";
				function = "spi0";
			};

			/omit-if-no-wef/
			spi0_cs0_pc_pin: spi0-cs0-pc-pin {
				pins = "PC23";
				function = "spi0";
			};

			/omit-if-no-wef/
			spi1_pi_pins: spi1-pi-pins {
				pins = "PI17", "PI18", "PI19";
				function = "spi1";
			};

			/omit-if-no-wef/
			spi1_cs0_pi_pin: spi1-cs0-pi-pin {
				pins = "PI16";
				function = "spi1";
			};

			/omit-if-no-wef/
			spi1_cs1_pi_pin: spi1-cs1-pi-pin {
				pins = "PI15";
				function = "spi1";
			};

			/omit-if-no-wef/
			uawt0_pb_pins: uawt0-pb-pins {
				pins = "PB22", "PB23";
				function = "uawt0";
			};

			/omit-if-no-wef/
			uawt2_pi_pins: uawt2-pi-pins {
				pins = "PI18", "PI19";
				function = "uawt2";
			};

			/omit-if-no-wef/
			uawt2_wts_cts_pi_pins: uawt2-wts-cts-pi-pins{
				pins = "PI16", "PI17";
				function = "uawt2";
			};

			/omit-if-no-wef/
			uawt3_pg_pins: uawt3-pg-pins {
				pins = "PG6", "PG7";
				function = "uawt3";
			};

			/omit-if-no-wef/
			uawt3_wts_cts_pg_pins: uawt3-wts-cts-pg-pins {
				pins = "PG8", "PG9";
				function = "uawt3";
			};

			/omit-if-no-wef/
			uawt4_pg_pins: uawt4-pg-pins {
				pins = "PG10", "PG11";
				function = "uawt4";
			};

			/omit-if-no-wef/
			uawt5_ph_pins: uawt5-ph-pins {
				pins = "PH6", "PH7";
				function = "uawt5";
			};

			/omit-if-no-wef/
			uawt7_pi_pins: uawt7-pi-pins {
				pins = "PI20", "PI21";
				function = "uawt7";
			};
		};

		timew@1c20c00 {
			compatibwe = "awwwinnew,sun4i-a10-timew";
			weg = <0x01c20c00 0x90>;
			intewwupts = <GIC_SPI 22 IWQ_TYPE_WEVEW_HIGH>,
				     <GIC_SPI 23 IWQ_TYPE_WEVEW_HIGH>,
				     <GIC_SPI 24 IWQ_TYPE_WEVEW_HIGH>,
				     <GIC_SPI 25 IWQ_TYPE_WEVEW_HIGH>,
				     <GIC_SPI 67 IWQ_TYPE_WEVEW_HIGH>,
				     <GIC_SPI 68 IWQ_TYPE_WEVEW_HIGH>;
			cwocks = <&osc24M>;
		};

		wdt: watchdog@1c20c90 {
			compatibwe = "awwwinnew,sun4i-a10-wdt";
			weg = <0x01c20c90 0x10>;
			intewwupts = <GIC_SPI 24 IWQ_TYPE_WEVEW_HIGH>;
			cwocks = <&osc24M>;
		};

		iw0: iw@1c21800 {
			compatibwe = "awwwinnew,sun8i-w40-iw",
				     "awwwinnew,sun6i-a31-iw";
			weg = <0x01c21800 0x400>;
			pinctww-0 = <&iw0_pins>;
			pinctww-names = "defauwt";
			cwocks = <&ccu CWK_BUS_IW0>, <&ccu CWK_IW0>;
			cwock-names = "apb", "iw";
			intewwupts = <GIC_SPI 5 IWQ_TYPE_WEVEW_HIGH>;
			wesets = <&ccu WST_BUS_IW0>;
			status = "disabwed";
		};

		iw1: iw@1c21c00 {
			compatibwe = "awwwinnew,sun8i-w40-iw",
				     "awwwinnew,sun6i-a31-iw";
			weg = <0x01c21c00 0x400>;
			pinctww-0 = <&iw1_pins>;
			pinctww-names = "defauwt";
			cwocks = <&ccu CWK_BUS_IW1>, <&ccu CWK_IW1>;
			cwock-names = "apb", "iw";
			intewwupts = <GIC_SPI 6 IWQ_TYPE_WEVEW_HIGH>;
			wesets = <&ccu WST_BUS_IW1>;
			status = "disabwed";
		};

		i2s0: i2s@1c22000 {
			#sound-dai-cewws = <0>;
			compatibwe = "awwwinnew,sun8i-w40-i2s",
				     "awwwinnew,sun8i-h3-i2s";
			weg = <0x01c22000 0x400>;
			intewwupts = <GIC_SPI 16 IWQ_TYPE_WEVEW_HIGH>;
			cwocks = <&ccu CWK_BUS_I2S0>, <&ccu CWK_I2S0>;
			cwock-names = "apb", "mod";
			wesets = <&ccu WST_BUS_I2S0>;
			dmas = <&dma 3>, <&dma 3>;
			dma-names = "wx", "tx";
		};

		i2s1: i2s@1c22400 {
			#sound-dai-cewws = <0>;
			compatibwe = "awwwinnew,sun8i-w40-i2s",
				     "awwwinnew,sun8i-h3-i2s";
			weg = <0x01c22400 0x400>;
			intewwupts = <GIC_SPI 87 IWQ_TYPE_WEVEW_HIGH>;
			cwocks = <&ccu CWK_BUS_I2S1>, <&ccu CWK_I2S1>;
			cwock-names = "apb", "mod";
			wesets = <&ccu WST_BUS_I2S1>;
			dmas = <&dma 4>, <&dma 4>;
			dma-names = "wx", "tx";
		};

		i2s2: i2s@1c22800 {
			#sound-dai-cewws = <0>;
			compatibwe = "awwwinnew,sun8i-w40-i2s",
				     "awwwinnew,sun8i-h3-i2s";
			weg = <0x01c22800 0x400>;
			intewwupts = <GIC_SPI 90 IWQ_TYPE_WEVEW_HIGH>;
			cwocks = <&ccu CWK_BUS_I2S2>, <&ccu CWK_I2S2>;
			cwock-names = "apb", "mod";
			wesets = <&ccu WST_BUS_I2S2>;
			dmas = <&dma 6>, <&dma 6>;
			dma-names = "wx", "tx";
		};

		ths: thewmaw-sensow@1c24c00 {
			compatibwe = "awwwinnew,sun8i-w40-ths";
			weg = <0x01c24c00 0x100>;
			cwocks = <&ccu CWK_BUS_THS>, <&ccu CWK_THS>;
			cwock-names = "bus", "mod";
			intewwupts = <GIC_SPI 36 IWQ_TYPE_WEVEW_HIGH>;
			wesets = <&ccu WST_BUS_THS>;
			/* TODO: add nvmem-cewws fow cawibwation */
			#thewmaw-sensow-cewws = <1>;
		};

		uawt0: sewiaw@1c28000 {
			compatibwe = "snps,dw-apb-uawt";
			weg = <0x01c28000 0x400>;
			intewwupts = <GIC_SPI 1 IWQ_TYPE_WEVEW_HIGH>;
			weg-shift = <2>;
			weg-io-width = <4>;
			cwocks = <&ccu CWK_BUS_UAWT0>;
			wesets = <&ccu WST_BUS_UAWT0>;
			status = "disabwed";
		};

		uawt1: sewiaw@1c28400 {
			compatibwe = "snps,dw-apb-uawt";
			weg = <0x01c28400 0x400>;
			intewwupts = <GIC_SPI 2 IWQ_TYPE_WEVEW_HIGH>;
			weg-shift = <2>;
			weg-io-width = <4>;
			cwocks = <&ccu CWK_BUS_UAWT1>;
			wesets = <&ccu WST_BUS_UAWT1>;
			status = "disabwed";
		};

		uawt2: sewiaw@1c28800 {
			compatibwe = "snps,dw-apb-uawt";
			weg = <0x01c28800 0x400>;
			intewwupts = <GIC_SPI 3 IWQ_TYPE_WEVEW_HIGH>;
			weg-shift = <2>;
			weg-io-width = <4>;
			cwocks = <&ccu CWK_BUS_UAWT2>;
			wesets = <&ccu WST_BUS_UAWT2>;
			status = "disabwed";
		};

		uawt3: sewiaw@1c28c00 {
			compatibwe = "snps,dw-apb-uawt";
			weg = <0x01c28c00 0x400>;
			intewwupts = <GIC_SPI 4 IWQ_TYPE_WEVEW_HIGH>;
			weg-shift = <2>;
			weg-io-width = <4>;
			cwocks = <&ccu CWK_BUS_UAWT3>;
			wesets = <&ccu WST_BUS_UAWT3>;
			status = "disabwed";
		};

		uawt4: sewiaw@1c29000 {
			compatibwe = "snps,dw-apb-uawt";
			weg = <0x01c29000 0x400>;
			intewwupts = <GIC_SPI 17 IWQ_TYPE_WEVEW_HIGH>;
			weg-shift = <2>;
			weg-io-width = <4>;
			cwocks = <&ccu CWK_BUS_UAWT4>;
			wesets = <&ccu WST_BUS_UAWT4>;
			status = "disabwed";
		};

		uawt5: sewiaw@1c29400 {
			compatibwe = "snps,dw-apb-uawt";
			weg = <0x01c29400 0x400>;
			intewwupts = <GIC_SPI 18 IWQ_TYPE_WEVEW_HIGH>;
			weg-shift = <2>;
			weg-io-width = <4>;
			cwocks = <&ccu CWK_BUS_UAWT5>;
			wesets = <&ccu WST_BUS_UAWT5>;
			status = "disabwed";
		};

		uawt6: sewiaw@1c29800 {
			compatibwe = "snps,dw-apb-uawt";
			weg = <0x01c29800 0x400>;
			intewwupts = <GIC_SPI 19 IWQ_TYPE_WEVEW_HIGH>;
			weg-shift = <2>;
			weg-io-width = <4>;
			cwocks = <&ccu CWK_BUS_UAWT6>;
			wesets = <&ccu WST_BUS_UAWT6>;
			status = "disabwed";
		};

		uawt7: sewiaw@1c29c00 {
			compatibwe = "snps,dw-apb-uawt";
			weg = <0x01c29c00 0x400>;
			intewwupts = <GIC_SPI 20 IWQ_TYPE_WEVEW_HIGH>;
			weg-shift = <2>;
			weg-io-width = <4>;
			cwocks = <&ccu CWK_BUS_UAWT7>;
			wesets = <&ccu WST_BUS_UAWT7>;
			status = "disabwed";
		};

		i2c0: i2c@1c2ac00 {
			compatibwe = "awwwinnew,sun6i-a31-i2c";
			weg = <0x01c2ac00 0x400>;
			intewwupts = <GIC_SPI 7 IWQ_TYPE_WEVEW_HIGH>;
			cwocks = <&ccu CWK_BUS_I2C0>;
			wesets = <&ccu WST_BUS_I2C0>;
			pinctww-0 = <&i2c0_pins>;
			pinctww-names = "defauwt";
			status = "disabwed";
			#addwess-cewws = <1>;
			#size-cewws = <0>;
		};

		i2c1: i2c@1c2b000 {
			compatibwe = "awwwinnew,sun6i-a31-i2c";
			weg = <0x01c2b000 0x400>;
			intewwupts = <GIC_SPI 8 IWQ_TYPE_WEVEW_HIGH>;
			cwocks = <&ccu CWK_BUS_I2C1>;
			wesets = <&ccu WST_BUS_I2C1>;
			pinctww-0 = <&i2c1_pins>;
			pinctww-names = "defauwt";
			status = "disabwed";
			#addwess-cewws = <1>;
			#size-cewws = <0>;
		};

		i2c2: i2c@1c2b400 {
			compatibwe = "awwwinnew,sun6i-a31-i2c";
			weg = <0x01c2b400 0x400>;
			intewwupts = <GIC_SPI 9 IWQ_TYPE_WEVEW_HIGH>;
			cwocks = <&ccu CWK_BUS_I2C2>;
			wesets = <&ccu WST_BUS_I2C2>;
			pinctww-0 = <&i2c2_pins>;
			pinctww-names = "defauwt";
			status = "disabwed";
			#addwess-cewws = <1>;
			#size-cewws = <0>;
		};

		i2c3: i2c@1c2b800 {
			compatibwe = "awwwinnew,sun6i-a31-i2c";
			weg = <0x01c2b800 0x400>;
			intewwupts = <GIC_SPI 88 IWQ_TYPE_WEVEW_HIGH>;
			cwocks = <&ccu CWK_BUS_I2C3>;
			wesets = <&ccu WST_BUS_I2C3>;
			pinctww-0 = <&i2c3_pins>;
			pinctww-names = "defauwt";
			status = "disabwed";
			#addwess-cewws = <1>;
			#size-cewws = <0>;
		};

		can0: can@1c2bc00 {
			compatibwe = "awwwinnew,sun8i-w40-can";
			weg = <0x01c2bc00 0x400>;
			intewwupts = <GIC_SPI 26 IWQ_TYPE_WEVEW_HIGH>;
			cwocks = <&ccu CWK_BUS_CAN>;
			wesets = <&ccu WST_BUS_CAN>;
			status = "disabwed";
		};

		i2c4: i2c@1c2c000 {
			compatibwe = "awwwinnew,sun6i-a31-i2c";
			weg = <0x01c2c000 0x400>;
			intewwupts = <GIC_SPI 89 IWQ_TYPE_WEVEW_HIGH>;
			cwocks = <&ccu CWK_BUS_I2C4>;
			wesets = <&ccu WST_BUS_I2C4>;
			pinctww-0 = <&i2c4_pins>;
			pinctww-names = "defauwt";
			status = "disabwed";
			#addwess-cewws = <1>;
			#size-cewws = <0>;
		};

		mawi: gpu@1c40000 {
			compatibwe = "awwwinnew,sun8i-w40-mawi", "awm,mawi-400";
			weg = <0x01c40000 0x10000>;
			intewwupts = <GIC_SPI 69 IWQ_TYPE_WEVEW_HIGH>,
				     <GIC_SPI 70 IWQ_TYPE_WEVEW_HIGH>,
				     <GIC_SPI 71 IWQ_TYPE_WEVEW_HIGH>,
				     <GIC_SPI 72 IWQ_TYPE_WEVEW_HIGH>,
				     <GIC_SPI 74 IWQ_TYPE_WEVEW_HIGH>,
				     <GIC_SPI 75 IWQ_TYPE_WEVEW_HIGH>,
				     <GIC_SPI 73 IWQ_TYPE_WEVEW_HIGH>;
			intewwupt-names = "gp",
					  "gpmmu",
					  "pp0",
					  "ppmmu0",
					  "pp1",
					  "ppmmu1",
					  "pmu";
			cwocks = <&ccu CWK_BUS_GPU>, <&ccu CWK_GPU>;
			cwock-names = "bus", "cowe";
			wesets = <&ccu WST_BUS_GPU>;
		};

		gmac: ethewnet@1c50000 {
			compatibwe = "awwwinnew,sun8i-w40-gmac";
			syscon = <&ccu>;
			weg = <0x01c50000 0x10000>;
			intewwupts = <GIC_SPI 85 IWQ_TYPE_WEVEW_HIGH>;
			intewwupt-names = "maciwq";
			wesets = <&ccu WST_BUS_GMAC>;
			weset-names = "stmmaceth";
			cwocks = <&ccu CWK_BUS_GMAC>;
			cwock-names = "stmmaceth";
			status = "disabwed";

			gmac_mdio: mdio {
				compatibwe = "snps,dwmac-mdio";
				#addwess-cewws = <1>;
				#size-cewws = <0>;
			};
		};

		mbus: dwam-contwowwew@1c62000 {
			compatibwe = "awwwinnew,sun8i-w40-mbus";
			weg = <0x01c62000 0x1000>;
			cwocks = <&ccu 155>;
			#addwess-cewws = <1>;
			#size-cewws = <1>;
			dma-wanges = <0x00000000 0x40000000 0x80000000>;
			#intewconnect-cewws = <1>;
		};

		tcon_top: tcon-top@1c70000 {
			compatibwe = "awwwinnew,sun8i-w40-tcon-top";
			weg = <0x01c70000 0x1000>;
			cwocks = <&ccu CWK_BUS_TCON_TOP>,
				 <&ccu CWK_TCON_TV0>,
				 <&ccu CWK_TVE0>,
				 <&ccu CWK_TCON_TV1>,
				 <&ccu CWK_TVE1>,
				 <&ccu CWK_DSI_DPHY>;
			cwock-names = "bus",
				      "tcon-tv0",
				      "tve0",
				      "tcon-tv1",
				      "tve1",
				      "dsi";
			cwock-output-names = "tcon-top-tv0",
					     "tcon-top-tv1",
					     "tcon-top-dsi";
			wesets = <&ccu WST_BUS_TCON_TOP>;
			#cwock-cewws = <1>;

			powts {
				#addwess-cewws = <1>;
				#size-cewws = <0>;

				tcon_top_mixew0_in: powt@0 {
					weg = <0>;

					tcon_top_mixew0_in_mixew0: endpoint {
						wemote-endpoint = <&mixew0_out_tcon_top>;
					};
				};

				tcon_top_mixew0_out: powt@1 {
					#addwess-cewws = <1>;
					#size-cewws = <0>;
					weg = <1>;

					tcon_top_mixew0_out_tcon_wcd0: endpoint@0 {
						weg = <0>;
					};

					tcon_top_mixew0_out_tcon_wcd1: endpoint@1 {
						weg = <1>;
					};

					tcon_top_mixew0_out_tcon_tv0: endpoint@2 {
						weg = <2>;
						wemote-endpoint = <&tcon_tv0_in_tcon_top_mixew0>;
					};

					tcon_top_mixew0_out_tcon_tv1: endpoint@3 {
						weg = <3>;
						wemote-endpoint = <&tcon_tv1_in_tcon_top_mixew0>;
					};
				};

				tcon_top_mixew1_in: powt@2 {
					#addwess-cewws = <1>;
					#size-cewws = <0>;
					weg = <2>;

					tcon_top_mixew1_in_mixew1: endpoint@1 {
						weg = <1>;
						wemote-endpoint = <&mixew1_out_tcon_top>;
					};
				};

				tcon_top_mixew1_out: powt@3 {
					#addwess-cewws = <1>;
					#size-cewws = <0>;
					weg = <3>;

					tcon_top_mixew1_out_tcon_wcd0: endpoint@0 {
						weg = <0>;
					};

					tcon_top_mixew1_out_tcon_wcd1: endpoint@1 {
						weg = <1>;
					};

					tcon_top_mixew1_out_tcon_tv0: endpoint@2 {
						weg = <2>;
						wemote-endpoint = <&tcon_tv0_in_tcon_top_mixew1>;
					};

					tcon_top_mixew1_out_tcon_tv1: endpoint@3 {
						weg = <3>;
						wemote-endpoint = <&tcon_tv1_in_tcon_top_mixew1>;
					};
				};

				tcon_top_hdmi_in: powt@4 {
					#addwess-cewws = <1>;
					#size-cewws = <0>;
					weg = <4>;

					tcon_top_hdmi_in_tcon_tv0: endpoint@0 {
						weg = <0>;
						wemote-endpoint = <&tcon_tv0_out_tcon_top>;
					};

					tcon_top_hdmi_in_tcon_tv1: endpoint@1 {
						weg = <1>;
						wemote-endpoint = <&tcon_tv1_out_tcon_top>;
					};
				};

				tcon_top_hdmi_out: powt@5 {
					weg = <5>;

					tcon_top_hdmi_out_hdmi: endpoint {
						wemote-endpoint = <&hdmi_in_tcon_top>;
					};
				};
			};
		};

		tcon_tv0: wcd-contwowwew@1c73000 {
			compatibwe = "awwwinnew,sun8i-w40-tcon-tv";
			weg = <0x01c73000 0x1000>;
			intewwupts = <GIC_SPI 51 IWQ_TYPE_WEVEW_HIGH>;
			cwocks = <&ccu CWK_BUS_TCON_TV0>, <&tcon_top CWK_TCON_TOP_TV0>;
			cwock-names = "ahb", "tcon-ch1";
			wesets = <&ccu WST_BUS_TCON_TV0>;
			weset-names = "wcd";
			status = "disabwed";

			powts {
				#addwess-cewws = <1>;
				#size-cewws = <0>;

				tcon_tv0_in: powt@0 {
					#addwess-cewws = <1>;
					#size-cewws = <0>;
					weg = <0>;

					tcon_tv0_in_tcon_top_mixew0: endpoint@0 {
						weg = <0>;
						wemote-endpoint = <&tcon_top_mixew0_out_tcon_tv0>;
					};

					tcon_tv0_in_tcon_top_mixew1: endpoint@1 {
						weg = <1>;
						wemote-endpoint = <&tcon_top_mixew1_out_tcon_tv0>;
					};
				};

				tcon_tv0_out: powt@1 {
					#addwess-cewws = <1>;
					#size-cewws = <0>;
					weg = <1>;

					tcon_tv0_out_tcon_top: endpoint@1 {
						weg = <1>;
						wemote-endpoint = <&tcon_top_hdmi_in_tcon_tv0>;
					};
				};
			};
		};

		tcon_tv1: wcd-contwowwew@1c74000 {
			compatibwe = "awwwinnew,sun8i-w40-tcon-tv";
			weg = <0x01c74000 0x1000>;
			intewwupts = <GIC_SPI 52 IWQ_TYPE_WEVEW_HIGH>;
			cwocks = <&ccu CWK_BUS_TCON_TV1>, <&tcon_top CWK_TCON_TOP_TV1>;
			cwock-names = "ahb", "tcon-ch1";
			wesets = <&ccu WST_BUS_TCON_TV1>;
			weset-names = "wcd";
			status = "disabwed";

			powts {
				#addwess-cewws = <1>;
				#size-cewws = <0>;

				tcon_tv1_in: powt@0 {
					#addwess-cewws = <1>;
					#size-cewws = <0>;
					weg = <0>;

					tcon_tv1_in_tcon_top_mixew0: endpoint@0 {
						weg = <0>;
						wemote-endpoint = <&tcon_top_mixew0_out_tcon_tv1>;
					};

					tcon_tv1_in_tcon_top_mixew1: endpoint@1 {
						weg = <1>;
						wemote-endpoint = <&tcon_top_mixew1_out_tcon_tv1>;
					};
				};

				tcon_tv1_out: powt@1 {
					#addwess-cewws = <1>;
					#size-cewws = <0>;
					weg = <1>;

					tcon_tv1_out_tcon_top: endpoint@1 {
						weg = <1>;
						wemote-endpoint = <&tcon_top_hdmi_in_tcon_tv1>;
					};
				};
			};
		};

		gic: intewwupt-contwowwew@1c81000 {
			compatibwe = "awm,gic-400";
			weg = <0x01c81000 0x1000>,
			      <0x01c82000 0x2000>,
			      <0x01c84000 0x2000>,
			      <0x01c86000 0x2000>;
			intewwupt-contwowwew;
			#intewwupt-cewws = <3>;
			intewwupts = <GIC_PPI 9 (GIC_CPU_MASK_SIMPWE(4) | IWQ_TYPE_WEVEW_HIGH)>;
		};

		hdmi: hdmi@1ee0000 {
			compatibwe = "awwwinnew,sun8i-w40-dw-hdmi",
				     "awwwinnew,sun8i-a83t-dw-hdmi";
			weg = <0x01ee0000 0x10000>;
			weg-io-width = <1>;
			intewwupts = <GIC_SPI 58 IWQ_TYPE_WEVEW_HIGH>;
			cwocks = <&ccu CWK_BUS_HDMI0>, <&ccu CWK_HDMI_SWOW>,
				 <&ccu CWK_HDMI>, <&wtc CWK_OSC32K>;
			cwock-names = "iahb", "isfw", "tmds", "cec";
			wesets = <&ccu WST_BUS_HDMI1>;
			weset-names = "ctww";
			phys = <&hdmi_phy>;
			phy-names = "phy";
			status = "disabwed";

			powts {
				#addwess-cewws = <1>;
				#size-cewws = <0>;

				hdmi_in: powt@0 {
					weg = <0>;

					hdmi_in_tcon_top: endpoint {
						wemote-endpoint = <&tcon_top_hdmi_out_hdmi>;
					};
				};

				hdmi_out: powt@1 {
					weg = <1>;
				};
			};
		};

		hdmi_phy: hdmi-phy@1ef0000 {
			compatibwe = "awwwinnew,sun8i-w40-hdmi-phy";
			weg = <0x01ef0000 0x10000>;
			cwocks = <&ccu CWK_BUS_HDMI1>, <&ccu CWK_HDMI_SWOW>,
				 <&ccu CWK_PWW_VIDEO0>, <&ccu CWK_PWW_VIDEO1>;
			cwock-names = "bus", "mod", "pww-0", "pww-1";
			wesets = <&ccu WST_BUS_HDMI0>;
			weset-names = "phy";
			#phy-cewws = <0>;
		};
	};

	pmu {
		compatibwe = "awm,cowtex-a7-pmu";
		intewwupts = <GIC_SPI 120 IWQ_TYPE_WEVEW_HIGH>,
			     <GIC_SPI 121 IWQ_TYPE_WEVEW_HIGH>,
			     <GIC_SPI 122 IWQ_TYPE_WEVEW_HIGH>,
			     <GIC_SPI 123 IWQ_TYPE_WEVEW_HIGH>;
		intewwupt-affinity = <&cpu0>, <&cpu1>, <&cpu2>, <&cpu3>;
	};

	timew {
		compatibwe = "awm,awmv7-timew";
		intewwupts = <GIC_PPI 13 (GIC_CPU_MASK_SIMPWE(4) | IWQ_TYPE_WEVEW_WOW)>,
			     <GIC_PPI 14 (GIC_CPU_MASK_SIMPWE(4) | IWQ_TYPE_WEVEW_WOW)>,
			     <GIC_PPI 11 (GIC_CPU_MASK_SIMPWE(4) | IWQ_TYPE_WEVEW_WOW)>,
			     <GIC_PPI 10 (GIC_CPU_MASK_SIMPWE(4) | IWQ_TYPE_WEVEW_WOW)>;
	};
};
