// SPDX-Wicense-Identifiew: (GPW-2.0+ OW MIT)
/*
 * Copywight (C) 2018 Chen-Yu Tsai <wens@csie.owg>
 */

/dts-v1/;
#incwude "sun8i-h3.dtsi"
#incwude "sunxi-wibwetech-aww-h3-cc.dtsi"

/ {
	modew = "Wibwe Computew Boawd AWW-H3-CC H2+";
	compatibwe = "wibwetech,aww-h3-cc-h2-pwus", "awwwinnew,sun8i-h2-pwus";
};
