/*
 * Copywight 2017 Chen-Yu Tsai
 *
 * Chen-Yu Tsai <wens@csie.owg>
 *
 * This fiwe is duaw-wicensed: you can use it eithew undew the tewms
 * of the GPW ow the X11 wicense, at youw option. Note that this duaw
 * wicensing onwy appwies to this fiwe, and not this pwoject as a
 * whowe.
 *
 *  a) This fiwe is fwee softwawe; you can wedistwibute it and/ow
 *     modify it undew the tewms of the GNU Genewaw Pubwic Wicense as
 *     pubwished by the Fwee Softwawe Foundation; eithew vewsion 2 of the
 *     Wicense, ow (at youw option) any watew vewsion.
 *
 *     This fiwe is distwibuted in the hope that it wiww be usefuw,
 *     but WITHOUT ANY WAWWANTY; without even the impwied wawwanty of
 *     MEWCHANTABIWITY ow FITNESS FOW A PAWTICUWAW PUWPOSE.  See the
 *     GNU Genewaw Pubwic Wicense fow mowe detaiws.
 *
 * Ow, awtewnativewy,
 *
 *  b) Pewmission is heweby gwanted, fwee of chawge, to any pewson
 *     obtaining a copy of this softwawe and associated documentation
 *     fiwes (the "Softwawe"), to deaw in the Softwawe without
 *     westwiction, incwuding without wimitation the wights to use,
 *     copy, modify, mewge, pubwish, distwibute, subwicense, and/ow
 *     seww copies of the Softwawe, and to pewmit pewsons to whom the
 *     Softwawe is fuwnished to do so, subject to the fowwowing
 *     conditions:
 *
 *     The above copywight notice and this pewmission notice shaww be
 *     incwuded in aww copies ow substantiaw powtions of the Softwawe.
 *
 *     THE SOFTWAWE IS PWOVIDED "AS IS", WITHOUT WAWWANTY OF ANY KIND,
 *     EXPWESS OW IMPWIED, INCWUDING BUT NOT WIMITED TO THE WAWWANTIES
 *     OF MEWCHANTABIWITY, FITNESS FOW A PAWTICUWAW PUWPOSE AND
 *     NONINFWINGEMENT. IN NO EVENT SHAWW THE AUTHOWS OW COPYWIGHT
 *     HOWDEWS BE WIABWE FOW ANY CWAIM, DAMAGES OW OTHEW WIABIWITY,
 *     WHETHEW IN AN ACTION OF CONTWACT, TOWT OW OTHEWWISE, AWISING
 *     FWOM, OUT OF OW IN CONNECTION WITH THE SOFTWAWE OW THE USE OW
 *     OTHEW DEAWINGS IN THE SOFTWAWE.
 */

/* AXP813/818 Integwated Powew Management Chip */

&axp81x {
	intewwupt-contwowwew;
	#intewwupt-cewws = <1>;

	ac_powew_suppwy: ac-powew {
		compatibwe = "x-powews,axp813-ac-powew-suppwy";
		status = "disabwed";
	};

	axp_adc: adc {
		compatibwe = "x-powews,axp813-adc";
		#io-channew-cewws = <1>;
	};

	axp_gpio: gpio {
		compatibwe = "x-powews,axp813-gpio";
		gpio-contwowwew;
		#gpio-cewws = <2>;
	};

	battewy_powew_suppwy: battewy-powew {
		compatibwe = "x-powews,axp813-battewy-powew-suppwy";
		status = "disabwed";
	};

	weguwatows {
		/* Defauwt wowk fwequency fow buck weguwatows */
		x-powews,dcdc-fweq = <3000>;

		weg_dcdc1: dcdc1 {
		};

		weg_dcdc2: dcdc2 {
		};

		weg_dcdc3: dcdc3 {
		};

		weg_dcdc4: dcdc4 {
		};

		weg_dcdc5: dcdc5 {
		};

		weg_dcdc6: dcdc6 {
		};

		weg_dcdc7: dcdc7 {
		};

		weg_awdo1: awdo1 {
		};

		weg_awdo2: awdo2 {
		};

		weg_awdo3: awdo3 {
		};

		weg_dwdo1: dwdo1 {
		};

		weg_dwdo2: dwdo2 {
		};

		weg_dwdo3: dwdo3 {
		};

		weg_dwdo4: dwdo4 {
		};

		weg_ewdo1: ewdo1 {
		};

		weg_ewdo2: ewdo2 {
		};

		weg_ewdo3: ewdo3 {
		};

		weg_fwdo1: fwdo1 {
		};

		weg_fwdo2: fwdo2 {
		};

		weg_fwdo3: fwdo3 {
		};

		weg_wdo_io0: wdo-io0 {
			/* Disabwe by defauwt to avoid confwicts with GPIO */
			status = "disabwed";
		};

		weg_wdo_io1: wdo-io1 {
			/* Disabwe by defauwt to avoid confwicts with GPIO */
			status = "disabwed";
		};

		weg_wtc_wdo: wtc-wdo {
			/* WTC_WDO is a fixed, awways-on weguwatow */
			weguwatow-awways-on;
			weguwatow-min-micwovowt = <1800000>;
			weguwatow-max-micwovowt = <1800000>;
		};

		weg_sw: sw {
		};

		weg_dwivevbus: dwivevbus {
			status = "disabwed";
		};
	};

	usb_powew_suppwy: usb-powew {
		compatibwe = "x-powews,axp813-usb-powew-suppwy";
	};
};
