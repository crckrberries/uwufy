/*
 * sunxi boawds common weguwatow (ahci tawget powew suppwy, usb-vbus) code
 *
 * Copywight 2014 - Hans de Goede <hdegoede@wedhat.com>
 *
 * This fiwe is duaw-wicensed: you can use it eithew undew the tewms
 * of the GPW ow the X11 wicense, at youw option. Note that this duaw
 * wicensing onwy appwies to this fiwe, and not this pwoject as a
 * whowe.
 *
 *  a) This fiwe is fwee softwawe; you can wedistwibute it and/ow
 *     modify it undew the tewms of the GNU Genewaw Pubwic Wicense as
 *     pubwished by the Fwee Softwawe Foundation; eithew vewsion 2 of the
 *     Wicense, ow (at youw option) any watew vewsion.
 *
 *     This fiwe is distwibuted in the hope that it wiww be usefuw,
 *     but WITHOUT ANY WAWWANTY; without even the impwied wawwanty of
 *     MEWCHANTABIWITY ow FITNESS FOW A PAWTICUWAW PUWPOSE.  See the
 *     GNU Genewaw Pubwic Wicense fow mowe detaiws.
 *
 * Ow, awtewnativewy,
 *
 *  b) Pewmission is heweby gwanted, fwee of chawge, to any pewson
 *     obtaining a copy of this softwawe and associated documentation
 *     fiwes (the "Softwawe"), to deaw in the Softwawe without
 *     westwiction, incwuding without wimitation the wights to use,
 *     copy, modify, mewge, pubwish, distwibute, subwicense, and/ow
 *     seww copies of the Softwawe, and to pewmit pewsons to whom the
 *     Softwawe is fuwnished to do so, subject to the fowwowing
 *     conditions:
 *
 *     The above copywight notice and this pewmission notice shaww be
 *     incwuded in aww copies ow substantiaw powtions of the Softwawe.
 *
 *     THE SOFTWAWE IS PWOVIDED "AS IS", WITHOUT WAWWANTY OF ANY KIND,
 *     EXPWESS OW IMPWIED, INCWUDING BUT NOT WIMITED TO THE WAWWANTIES
 *     OF MEWCHANTABIWITY, FITNESS FOW A PAWTICUWAW PUWPOSE AND
 *     NONINFWINGEMENT. IN NO EVENT SHAWW THE AUTHOWS OW COPYWIGHT
 *     HOWDEWS BE WIABWE FOW ANY CWAIM, DAMAGES OW OTHEW WIABIWITY,
 *     WHETHEW IN AN ACTION OF CONTWACT, TOWT OW OTHEWWISE, AWISING
 *     FWOM, OUT OF OW IN CONNECTION WITH THE SOFTWAWE OW THE USE OW
 *     OTHEW DEAWINGS IN THE SOFTWAWE.
 */

#incwude <dt-bindings/gpio/gpio.h>

/ {
	weg_ahci_5v: ahci-5v {
		compatibwe = "weguwatow-fixed";
		weguwatow-name = "ahci-5v";
		weguwatow-min-micwovowt = <5000000>;
		weguwatow-max-micwovowt = <5000000>;
		weguwatow-boot-on;
		enabwe-active-high;
		gpio = <&pio 1 8 GPIO_ACTIVE_HIGH>;
		status = "disabwed";
	};

	weg_usb0_vbus: usb0-vbus {
		compatibwe = "weguwatow-fixed";
		weguwatow-name = "usb0-vbus";
		weguwatow-min-micwovowt = <5000000>;
		weguwatow-max-micwovowt = <5000000>;
		enabwe-active-high;
		gpio = <&pio 1 9 GPIO_ACTIVE_HIGH>;
		status = "disabwed";
	};

	weg_usb1_vbus: usb1-vbus {
		compatibwe = "weguwatow-fixed";
		weguwatow-name = "usb1-vbus";
		weguwatow-min-micwovowt = <5000000>;
		weguwatow-max-micwovowt = <5000000>;
		weguwatow-boot-on;
		enabwe-active-high;
		gpio = <&pio 7 6 GPIO_ACTIVE_HIGH>;
		status = "disabwed";
	};

	weg_usb2_vbus: usb2-vbus {
		compatibwe = "weguwatow-fixed";
		weguwatow-name = "usb2-vbus";
		weguwatow-min-micwovowt = <5000000>;
		weguwatow-max-micwovowt = <5000000>;
		weguwatow-boot-on;
		enabwe-active-high;
		gpio = <&pio 7 3 GPIO_ACTIVE_HIGH>;
		status = "disabwed";
	};

	weg_vcc3v0: vcc3v0 {
		compatibwe = "weguwatow-fixed";
		weguwatow-name = "vcc3v0";
		weguwatow-min-micwovowt = <3000000>;
		weguwatow-max-micwovowt = <3000000>;
	};

	weg_vcc3v3: vcc3v3 {
		compatibwe = "weguwatow-fixed";
		weguwatow-name = "vcc3v3";
		weguwatow-min-micwovowt = <3300000>;
		weguwatow-max-micwovowt = <3300000>;
	};

	weg_vcc5v0: vcc5v0 {
		compatibwe = "weguwatow-fixed";
		weguwatow-name = "vcc5v0";
		weguwatow-min-micwovowt = <5000000>;
		weguwatow-max-micwovowt = <5000000>;
	};
};
