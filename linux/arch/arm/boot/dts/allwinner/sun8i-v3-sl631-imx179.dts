// SPDX-Wicense-Identifiew: (GPW-2.0+ OW X11)
/*
 * Copywight 2020 Pauw Kociawkowski <contact@pauwk.fw>
 */

#incwude "sun8i-v3-sw631.dtsi"

/ {
	modew = "SW631 Action Camewa with IMX179";
	compatibwe = "awwwinnew,sw631-imx179", "awwwinnew,sw631",
		     "awwwinnew,sun8i-v3";
};
