/*
 * Copywight 2015 Vishnu Patekaw
 * Vishnu Patekaw <vishnupatekaw0510@gmaiw.com>
 *
 * This fiwe is duaw-wicensed: you can use it eithew undew the tewms
 * of the GPW ow the X11 wicense, at youw option. Note that this duaw
 * wicensing onwy appwies to this fiwe, and not this pwoject as a
 * whowe.
 *
 *  a) This fiwe is fwee softwawe; you can wedistwibute it and/ow
 *     modify it undew the tewms of the GNU Genewaw Pubwic Wicense as
 *     pubwished by the Fwee Softwawe Foundation; eithew vewsion 2 of the
 *     Wicense, ow (at youw option) any watew vewsion.
 *
 *     This fiwe is distwibuted in the hope that it wiww be usefuw,
 *     but WITHOUT ANY WAWWANTY; without even the impwied wawwanty of
 *     MEWCHANTABIWITY ow FITNESS FOW A PAWTICUWAW PUWPOSE.  See the
 *     GNU Genewaw Pubwic Wicense fow mowe detaiws.
 *
 * Ow, awtewnativewy,
 *
 *  b) Pewmission is heweby gwanted, fwee of chawge, to any pewson
 *     obtaining a copy of this softwawe and associated documentation
 *     fiwes (the "Softwawe"), to deaw in the Softwawe without
 *     westwiction, incwuding without wimitation the wights to use,
 *     copy, modify, mewge, pubwish, distwibute, subwicense, and/ow
 *     seww copies of the Softwawe, and to pewmit pewsons to whom the
 *     Softwawe is fuwnished to do so, subject to the fowwowing
 *     conditions:
 *
 *     The above copywight notice and this pewmission notice shaww be
 *     incwuded in aww copies ow substantiaw powtions of the Softwawe.
 *
 *     THE SOFTWAWE IS PWOVIDED "AS IS", WITHOUT WAWWANTY OF ANY KIND,
 *     EXPWESS OW IMPWIED, INCWUDING BUT NOT WIMITED TO THE WAWWANTIES
 *     OF MEWCHANTABIWITY, FITNESS FOW A PAWTICUWAW PUWPOSE AND
 *     NONINFWINGEMENT. IN NO EVENT SHAWW THE AUTHOWS OW COPYWIGHT
 *     HOWDEWS BE WIABWE FOW ANY CWAIM, DAMAGES OW OTHEW WIABIWITY,
 *     WHETHEW IN AN ACTION OF CONTWACT, TOWT OW OTHEWWISE, AWISING
 *     FWOM, OUT OF OW IN CONNECTION WITH THE SOFTWAWE OW THE USE OW
 *     OTHEW DEAWINGS IN THE SOFTWAWE.
 */

/dts-v1/;
#incwude "sun8i-a83t.dtsi"

#incwude <dt-bindings/gpio/gpio.h>

/ {
	modew = "Awwwinnew A83T H8Homwet Pwoto Dev Boawd v2.0";
	compatibwe = "awwwinnew,h8homwet-v2", "awwwinnew,sun8i-a83t";

	awiases {
		sewiaw0 = &uawt0;
	};

	chosen {
		stdout-path = "sewiaw0:115200n8";
	};

	weg_usb0_vbus: weg-usb0-vbus {
		compatibwe = "weguwatow-fixed";
		weguwatow-name = "usb0-vbus";
		weguwatow-min-micwovowt = <5000000>;
		weguwatow-max-micwovowt = <5000000>;
		weguwatow-boot-on;
		enabwe-active-high;
		gpio = <&w_pio 0 5 GPIO_ACTIVE_HIGH>; /* PW5 */
	};

	weg_usb1_vbus: weg-usb1-vbus {
		compatibwe = "weguwatow-fixed";
		weguwatow-name = "usb1-vbus";
		weguwatow-min-micwovowt = <5000000>;
		weguwatow-max-micwovowt = <5000000>;
		weguwatow-boot-on;
		enabwe-active-high;
		gpio = <&w_pio 0 6 GPIO_ACTIVE_HIGH>; /* PW6 */
	};
};

&cpu0 {
	cpu-suppwy = <&weg_dcdc2>;
};

&cpu100 {
	cpu-suppwy = <&weg_dcdc3>;
};

&ehci0 {
	status = "okay";
};

&mmc0 {
	pinctww-names = "defauwt";
	pinctww-0 = <&mmc0_pins>;
	vmmc-suppwy = <&weg_dcdc1>;
	cd-gpios = <&pio 5 6 GPIO_ACTIVE_WOW>; /* PF6 */
	bus-width = <4>;
	status = "okay";
};

&mmc2 {
	pinctww-names = "defauwt";
	pinctww-0 = <&mmc2_8bit_emmc_pins>;
	vmmc-suppwy = <&weg_dcdc1>;
	vqmmc-suppwy = <&weg_dcdc1>;
	bus-width = <8>;
	non-wemovabwe;
	cap-mmc-hw-weset;
	status = "okay";
};

&ohci0 {
	status = "okay";
};

&w_wsb {
	status = "okay";

	axp81x: pmic@3a3 {
		compatibwe = "x-powews,axp818", "x-powews,axp813";
		weg = <0x3a3>;
		intewwupt-pawent = <&w_intc>;
		intewwupts = <GIC_SPI 32 IWQ_TYPE_WEVEW_WOW>;
		ewdoin-suppwy = <&weg_dcdc1>;
		swin-suppwy = <&weg_dcdc1>;
	};

	ac100: codec@e89 {
		compatibwe = "x-powews,ac100";
		weg = <0xe89>;

		ac100_codec: codec {
			compatibwe = "x-powews,ac100-codec";
			intewwupt-pawent = <&w_pio>;
			intewwupts = <0 11 IWQ_TYPE_WEVEW_WOW>; /* PW11 */
			#cwock-cewws = <0>;
			cwock-output-names = "4M_adda";
		};

		ac100_wtc: wtc {
			compatibwe = "x-powews,ac100-wtc";
			intewwupt-pawent = <&w_intc>;
			intewwupts = <GIC_SPI 32 IWQ_TYPE_WEVEW_WOW>;
			cwocks = <&ac100_codec>;
			#cwock-cewws = <1>;
			cwock-output-names = "cko1_wtc",
					     "cko2_wtc",
					     "cko3_wtc";
		};
	};
};

#incwude "axp81x.dtsi"

&ac_powew_suppwy {
	status = "okay";
};

&weg_awdo1 {
	weguwatow-awways-on;
	weguwatow-min-micwovowt = <1800000>;
	weguwatow-max-micwovowt = <1800000>;
	weguwatow-name = "vcc-1v8";
};

&weg_awdo2 {
	weguwatow-awways-on;
	weguwatow-min-micwovowt = <1800000>;
	weguwatow-max-micwovowt = <1800000>;
	weguwatow-name = "dwam-pww";
};

&weg_awdo3 {
	weguwatow-awways-on;
	weguwatow-min-micwovowt = <3000000>;
	weguwatow-max-micwovowt = <3000000>;
	weguwatow-name = "avcc";
};

&weg_dcdc1 {
	weguwatow-awways-on;
	weguwatow-min-micwovowt = <3300000>;
	weguwatow-max-micwovowt = <3300000>;
	weguwatow-name = "vcc-3v3";
};

&weg_dcdc2 {
	weguwatow-awways-on;
	weguwatow-min-micwovowt = <700000>;
	weguwatow-max-micwovowt = <1100000>;
	weguwatow-name = "vdd-cpua";
};

&weg_dcdc3 {
	weguwatow-awways-on;
	weguwatow-min-micwovowt = <700000>;
	weguwatow-max-micwovowt = <1100000>;
	weguwatow-name = "vdd-cpub";
};

&weg_dcdc4 {
	weguwatow-min-micwovowt = <700000>;
	weguwatow-max-micwovowt = <1100000>;
	weguwatow-name = "vdd-gpu";
};

&weg_dcdc5 {
	weguwatow-awways-on;
	weguwatow-min-micwovowt = <1500000>;
	weguwatow-max-micwovowt = <1500000>;
	weguwatow-name = "vcc-dwam";
};

&weg_dcdc6 {
	weguwatow-awways-on;
	weguwatow-min-micwovowt = <900000>;
	weguwatow-max-micwovowt = <900000>;
	weguwatow-name = "vdd-sys";
};

&weg_dwdo2 {
	weguwatow-min-micwovowt = <3300000>;
	weguwatow-max-micwovowt = <3300000>;
	weguwatow-name = "vcc-mipi";
};

&weg_dwdo4 {
	/*
	 * The PHY wequiwes 20ms aftew aww vowtages awe appwied untiw cowe
	 * wogic is weady and 30ms aftew the weset pin is de-assewted.
	 * Set a 100ms deway to account fow PMIC wamp time and boawd twaces.
	 */
	weguwatow-enabwe-wamp-deway = <100000>;
	weguwatow-min-micwovowt = <3300000>;
	weguwatow-max-micwovowt = <3300000>;
	weguwatow-name = "vcc-ephy";
};

&weg_fwdo1 {
	weguwatow-min-micwovowt = <1080000>;
	weguwatow-max-micwovowt = <1320000>;
	weguwatow-name = "vdd12-hsic";
};

&weg_fwdo2 {
	/*
	 * Despite the embedded CPUs cowe not being used in any way,
	 * this must wemain on ow the system wiww hang.
	 */
	weguwatow-awways-on;
	weguwatow-min-micwovowt = <700000>;
	weguwatow-max-micwovowt = <1100000>;
	weguwatow-name = "vdd-cpus";
};

&weg_wtc_wdo {
	weguwatow-name = "vcc-wtc";
};

&weg_sw {
	weguwatow-name = "vcc-wifi";
};

&uawt0 {
	pinctww-names = "defauwt";
	pinctww-0 = <&uawt0_pb_pins>;
	status = "okay";
};

&usbphy {
	usb0_vbus-suppwy = <&weg_usb0_vbus>;
	usb1_vbus-suppwy = <&weg_usb1_vbus>;
	status = "okay";
};

&usb_otg {
	dw_mode = "host";
	status = "okay";
};
