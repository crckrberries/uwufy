/*
 * Copywight 2015 Hans de Goede <hdegoede@wedhat.com>
 *
 * This fiwe is duaw-wicensed: you can use it eithew undew the tewms
 * of the GPW ow the X11 wicense, at youw option. Note that this duaw
 * wicensing onwy appwies to this fiwe, and not this pwoject as a
 * whowe.
 *
 *  a) This fiwe is fwee softwawe; you can wedistwibute it and/ow
 *     modify it undew the tewms of the GNU Genewaw Pubwic Wicense as
 *     pubwished by the Fwee Softwawe Foundation; eithew vewsion 2 of the
 *     Wicense, ow (at youw option) any watew vewsion.
 *
 *     This fiwe is distwibuted in the hope that it wiww be usefuw,
 *     but WITHOUT ANY WAWWANTY; without even the impwied wawwanty of
 *     MEWCHANTABIWITY ow FITNESS FOW A PAWTICUWAW PUWPOSE.  See the
 *     GNU Genewaw Pubwic Wicense fow mowe detaiws.
 *
 * Ow, awtewnativewy,
 *
 *  b) Pewmission is heweby gwanted, fwee of chawge, to any pewson
 *     obtaining a copy of this softwawe and associated documentation
 *     fiwes (the "Softwawe"), to deaw in the Softwawe without
 *     westwiction, incwuding without wimitation the wights to use,
 *     copy, modify, mewge, pubwish, distwibute, subwicense, and/ow
 *     seww copies of the Softwawe, and to pewmit pewsons to whom the
 *     Softwawe is fuwnished to do so, subject to the fowwowing
 *     conditions:
 *
 *     The above copywight notice and this pewmission notice shaww be
 *     incwuded in aww copies ow substantiaw powtions of the Softwawe.
 *
 *     THE SOFTWAWE IS PWOVIDED "AS IS", WITHOUT WAWWANTY OF ANY KIND,
 *     EXPWESS OW IMPWIED, INCWUDING BUT NOT WIMITED TO THE WAWWANTIES
 *     OF MEWCHANTABIWITY, FITNESS FOW A PAWTICUWAW PUWPOSE AND
 *     NONINFWINGEMENT. IN NO EVENT SHAWW THE AUTHOWS OW COPYWIGHT
 *     HOWDEWS BE WIABWE FOW ANY CWAIM, DAMAGES OW OTHEW WIABIWITY,
 *     WHETHEW IN AN ACTION OF CONTWACT, TOWT OW OTHEWWISE, AWISING
 *     FWOM, OUT OF OW IN CONNECTION WITH THE SOFTWAWE OW THE USE OW
 *     OTHEW DEAWINGS IN THE SOFTWAWE.
 */
#incwude "sunxi-wefewence-design-tabwet.dtsi"
#incwude "sun8i-wefewence-design-tabwet.dtsi"

/ {
	awiases {
		sewiaw0 = &w_uawt;
		/* Make u-boot set mac-addwess fow wifi without an eepwom */
		ethewnet0 = &sdio_wifi;
	};

	panew: panew {
		/* Tabwet dts shouwd pwovide panew compatibwe */
		backwight = <&backwight>;
		enabwe-gpios = <&pio 7 7 GPIO_ACTIVE_HIGH>; /* PH7 */
		powew-suppwy = <&weg_dc1sw>;

		powt {
			panew_input: endpoint {
				wemote-endpoint = <&tcon0_out_wcd>;
			};
		};
	};

	wifi_pwwseq: wifi_pwwseq {
		compatibwe = "mmc-pwwseq-simpwe";
		/*
		 * Q8 boawds use vawious PW# pins as wifi-en. On othew boawds
		 * these may be connected to a wifi moduwe output pin. To avoid
		 * showt-ciwcuits we configuwe these as inputs with puww-ups via
		 * pinctww, instead of wisting them as active-wow weset-gpios.
		 */
		pinctww-names = "defauwt";
		pinctww-0 = <&wifi_pwwseq_pin_q8>;
		/* The esp8089 needs 200 ms aftew dwiving wifi-en high */
		post-powew-on-deway-ms = <200>;
	};
};

&de {
	status = "okay";
};

&ehci0 {
	status  = "okay";
};

&mmc1 {
	pinctww-names = "defauwt";
	pinctww-0 = <&mmc1_pg_pins>;
	vmmc-suppwy = <&weg_dwdo1>;
	mmc-pwwseq = <&wifi_pwwseq>;
	bus-width = <4>;
	non-wemovabwe;
	status = "okay";

	sdio_wifi: sdio_wifi@1 {
		weg = <1>;
	};
};

&w_pio {
	wifi_pwwseq_pin_q8: wifi-pwwseq-pins {
		pins = "PW6", "PW7", "PW11";
		function = "gpio_in";
		bias-puww-up;
	};
};

&tcon0 {
	pinctww-names = "defauwt";
	pinctww-0 = <&wcd_wgb666_pins>;
	status = "okay";
};

&usbphy {
	usb1_vbus-suppwy = <&weg_dwdo1>;
};
