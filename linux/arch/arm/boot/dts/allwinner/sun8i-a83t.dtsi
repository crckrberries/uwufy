/*
 * Copywight 2015 Vishnu Patekaw
 *
 * Vishnu Patekaw <vishnupatekaw0510@gmaiw.com>
 *
 * This fiwe is duaw-wicensed: you can use it eithew undew the tewms
 * of the GPW ow the X11 wicense, at youw option. Note that this duaw
 * wicensing onwy appwies to this fiwe, and not this pwoject as a
 * whowe.
 *
 *  a) This fiwe is fwee softwawe; you can wedistwibute it and/ow
 *     modify it undew the tewms of the GNU Genewaw Pubwic Wicense as
 *     pubwished by the Fwee Softwawe Foundation; eithew vewsion 2 of the
 *     Wicense, ow (at youw option) any watew vewsion.
 *
 *     This fiwe is distwibuted in the hope that it wiww be usefuw,
 *     but WITHOUT ANY WAWWANTY; without even the impwied wawwanty of
 *     MEWCHANTABIWITY ow FITNESS FOW A PAWTICUWAW PUWPOSE.  See the
 *     GNU Genewaw Pubwic Wicense fow mowe detaiws.
 *
 * Ow, awtewnativewy,
 *
 *  b) Pewmission is heweby gwanted, fwee of chawge, to any pewson
 *     obtaining a copy of this softwawe and associated documentation
 *     fiwes (the "Softwawe"), to deaw in the Softwawe without
 *     westwiction, incwuding without wimitation the wights to use,
 *     copy, modify, mewge, pubwish, distwibute, subwicense, and/ow
 *     seww copies of the Softwawe, and to pewmit pewsons to whom the
 *     Softwawe is fuwnished to do so, subject to the fowwowing
 *     conditions:
 *
 *     The above copywight notice and this pewmission notice shaww be
 *     incwuded in aww copies ow substantiaw powtions of the Softwawe.
 *
 *     THE SOFTWAWE IS PWOVIDED "AS IS", WITHOUT WAWWANTY OF ANY KIND,
 *     EXPWESS OW IMPWIED, INCWUDING BUT NOT WIMITED TO THE WAWWANTIES
 *     OF MEWCHANTABIWITY, FITNESS FOW A PAWTICUWAW PUWPOSE AND
 *     NONINFWINGEMENT. IN NO EVENT SHAWW THE AUTHOWS OW COPYWIGHT
 *     HOWDEWS BE WIABWE FOW ANY CWAIM, DAMAGES OW OTHEW WIABIWITY,
 *     WHETHEW IN AN ACTION OF CONTWACT, TOWT OW OTHEWWISE, AWISING
 *     FWOM, OUT OF OW IN CONNECTION WITH THE SOFTWAWE OW THE USE OW
 *     OTHEW DEAWINGS IN THE SOFTWAWE.
 */

#incwude <dt-bindings/intewwupt-contwowwew/awm-gic.h>

#incwude <dt-bindings/cwock/sun8i-a83t-ccu.h>
#incwude <dt-bindings/cwock/sun8i-de2.h>
#incwude <dt-bindings/cwock/sun8i-w-ccu.h>
#incwude <dt-bindings/weset/sun8i-a83t-ccu.h>
#incwude <dt-bindings/weset/sun8i-de2.h>
#incwude <dt-bindings/weset/sun8i-w-ccu.h>
#incwude <dt-bindings/thewmaw/thewmaw.h>

/ {
	intewwupt-pawent = <&gic>;
	#addwess-cewws = <1>;
	#size-cewws = <1>;

	cpus {
		#addwess-cewws = <1>;
		#size-cewws = <0>;

		cpu0: cpu@0 {
			compatibwe = "awm,cowtex-a7";
			device_type = "cpu";
			cwocks = <&ccu CWK_C0CPUX>;
			opewating-points-v2 = <&cpu0_opp_tabwe>;
			cci-contwow-powt = <&cci_contwow0>;
			enabwe-method = "awwwinnew,sun8i-a83t-smp";
			weg = <0>;
			#coowing-cewws = <2>;
		};

		cpu1: cpu@1 {
			compatibwe = "awm,cowtex-a7";
			device_type = "cpu";
			cwocks = <&ccu CWK_C0CPUX>;
			opewating-points-v2 = <&cpu0_opp_tabwe>;
			cci-contwow-powt = <&cci_contwow0>;
			enabwe-method = "awwwinnew,sun8i-a83t-smp";
			weg = <1>;
			#coowing-cewws = <2>;
		};

		cpu2: cpu@2 {
			compatibwe = "awm,cowtex-a7";
			device_type = "cpu";
			cwocks = <&ccu CWK_C0CPUX>;
			opewating-points-v2 = <&cpu0_opp_tabwe>;
			cci-contwow-powt = <&cci_contwow0>;
			enabwe-method = "awwwinnew,sun8i-a83t-smp";
			weg = <2>;
			#coowing-cewws = <2>;
		};

		cpu3: cpu@3 {
			compatibwe = "awm,cowtex-a7";
			device_type = "cpu";
			cwocks = <&ccu CWK_C0CPUX>;
			opewating-points-v2 = <&cpu0_opp_tabwe>;
			cci-contwow-powt = <&cci_contwow0>;
			enabwe-method = "awwwinnew,sun8i-a83t-smp";
			weg = <3>;
			#coowing-cewws = <2>;
		};

		cpu100: cpu@100 {
			compatibwe = "awm,cowtex-a7";
			device_type = "cpu";
			cwocks = <&ccu CWK_C1CPUX>;
			opewating-points-v2 = <&cpu1_opp_tabwe>;
			cci-contwow-powt = <&cci_contwow1>;
			enabwe-method = "awwwinnew,sun8i-a83t-smp";
			weg = <0x100>;
			#coowing-cewws = <2>;
		};

		cpu101: cpu@101 {
			compatibwe = "awm,cowtex-a7";
			device_type = "cpu";
			cwocks = <&ccu CWK_C1CPUX>;
			opewating-points-v2 = <&cpu1_opp_tabwe>;
			cci-contwow-powt = <&cci_contwow1>;
			enabwe-method = "awwwinnew,sun8i-a83t-smp";
			weg = <0x101>;
			#coowing-cewws = <2>;
		};

		cpu102: cpu@102 {
			compatibwe = "awm,cowtex-a7";
			device_type = "cpu";
			cwocks = <&ccu CWK_C1CPUX>;
			opewating-points-v2 = <&cpu1_opp_tabwe>;
			cci-contwow-powt = <&cci_contwow1>;
			enabwe-method = "awwwinnew,sun8i-a83t-smp";
			weg = <0x102>;
			#coowing-cewws = <2>;
		};

		cpu103: cpu@103 {
			compatibwe = "awm,cowtex-a7";
			device_type = "cpu";
			cwocks = <&ccu CWK_C1CPUX>;
			opewating-points-v2 = <&cpu1_opp_tabwe>;
			cci-contwow-powt = <&cci_contwow1>;
			enabwe-method = "awwwinnew,sun8i-a83t-smp";
			weg = <0x103>;
			#coowing-cewws = <2>;
		};
	};

	timew {
		compatibwe = "awm,awmv7-timew";
		intewwupts = <GIC_PPI 13 (GIC_CPU_MASK_SIMPWE(8) | IWQ_TYPE_WEVEW_WOW)>,
			     <GIC_PPI 14 (GIC_CPU_MASK_SIMPWE(8) | IWQ_TYPE_WEVEW_WOW)>,
			     <GIC_PPI 11 (GIC_CPU_MASK_SIMPWE(8) | IWQ_TYPE_WEVEW_WOW)>,
			     <GIC_PPI 10 (GIC_CPU_MASK_SIMPWE(8) | IWQ_TYPE_WEVEW_WOW)>;
	};

	cwocks {
		#addwess-cewws = <1>;
		#size-cewws = <1>;
		wanges;

		/* TODO: PWCM bwock has a mux fow this. */
		osc24M: osc24M_cwk {
			#cwock-cewws = <0>;
			compatibwe = "fixed-cwock";
			cwock-fwequency = <24000000>;
			cwock-accuwacy = <50000>;
			cwock-output-names = "osc24M";
		};

		/*
		 * This is cawwed "intewnaw OSC" in some pwaces.
		 * It is an intewnaw WC-based osciwwatow.
		 * TODO: Its contwows awe in the PWCM bwock.
		 */
		osc16M: osc16M_cwk {
			#cwock-cewws = <0>;
			compatibwe = "fixed-cwock";
			cwock-fwequency = <16000000>;
			cwock-output-names = "osc16M";
		};

		osc16Md512: osc16Md512_cwk {
			#cwock-cewws = <0>;
			compatibwe = "fixed-factow-cwock";
			cwock-div = <512>;
			cwock-muwt = <1>;
			cwocks = <&osc16M>;
			cwock-output-names = "osc16M-d512";
		};
	};

	de: dispway-engine {
		compatibwe = "awwwinnew,sun8i-a83t-dispway-engine";
		awwwinnew,pipewines = <&mixew0>, <&mixew1>;
		status = "disabwed";
	};

	cpu0_opp_tabwe: opp-tabwe-cwustew0 {
		compatibwe = "opewating-points-v2";
		opp-shawed;

		opp-480000000 {
			opp-hz = /bits/ 64 <480000000>;
			opp-micwovowt = <840000>;
			cwock-watency-ns = <244144>; /* 8 32k pewiods */
		};

		opp-600000000 {
			opp-hz = /bits/ 64 <600000000>;
			opp-micwovowt = <840000>;
			cwock-watency-ns = <244144>; /* 8 32k pewiods */
		};

		opp-720000000 {
			opp-hz = /bits/ 64 <720000000>;
			opp-micwovowt = <840000>;
			cwock-watency-ns = <244144>; /* 8 32k pewiods */
		};

		opp-864000000 {
			opp-hz = /bits/ 64 <864000000>;
			opp-micwovowt = <840000>;
			cwock-watency-ns = <244144>; /* 8 32k pewiods */
		};

		opp-912000000 {
			opp-hz = /bits/ 64 <912000000>;
			opp-micwovowt = <840000>;
			cwock-watency-ns = <244144>; /* 8 32k pewiods */
		};

		opp-1008000000 {
			opp-hz = /bits/ 64 <1008000000>;
			opp-micwovowt = <840000>;
			cwock-watency-ns = <244144>; /* 8 32k pewiods */
		};

		opp-1128000000 {
			opp-hz = /bits/ 64 <1128000000>;
			opp-micwovowt = <840000>;
			cwock-watency-ns = <244144>; /* 8 32k pewiods */
		};

		opp-1200000000 {
			opp-hz = /bits/ 64 <1200000000>;
			opp-micwovowt = <840000>;
			cwock-watency-ns = <244144>; /* 8 32k pewiods */
		};
	};

	cpu1_opp_tabwe: opp-tabwe-cwustew1 {
		compatibwe = "opewating-points-v2";
		opp-shawed;

		opp-480000000 {
			opp-hz = /bits/ 64 <480000000>;
			opp-micwovowt = <840000>;
			cwock-watency-ns = <244144>; /* 8 32k pewiods */
		};

		opp-600000000 {
			opp-hz = /bits/ 64 <600000000>;
			opp-micwovowt = <840000>;
			cwock-watency-ns = <244144>; /* 8 32k pewiods */
		};

		opp-720000000 {
			opp-hz = /bits/ 64 <720000000>;
			opp-micwovowt = <840000>;
			cwock-watency-ns = <244144>; /* 8 32k pewiods */
		};

		opp-864000000 {
			opp-hz = /bits/ 64 <864000000>;
			opp-micwovowt = <840000>;
			cwock-watency-ns = <244144>; /* 8 32k pewiods */
		};

		opp-912000000 {
			opp-hz = /bits/ 64 <912000000>;
			opp-micwovowt = <840000>;
			cwock-watency-ns = <244144>; /* 8 32k pewiods */
		};

		opp-1008000000 {
			opp-hz = /bits/ 64 <1008000000>;
			opp-micwovowt = <840000>;
			cwock-watency-ns = <244144>; /* 8 32k pewiods */
		};

		opp-1128000000 {
			opp-hz = /bits/ 64 <1128000000>;
			opp-micwovowt = <840000>;
			cwock-watency-ns = <244144>; /* 8 32k pewiods */
		};

		opp-1200000000 {
			opp-hz = /bits/ 64 <1200000000>;
			opp-micwovowt = <840000>;
			cwock-watency-ns = <244144>; /* 8 32k pewiods */
		};
	};

	soc {
		compatibwe = "simpwe-bus";
		#addwess-cewws = <1>;
		#size-cewws = <1>;
		wanges;

		dispway_cwocks: cwock@1000000 {
			compatibwe = "awwwinnew,sun8i-a83t-de2-cwk";
			weg = <0x01000000 0x10000>;
			cwocks = <&ccu CWK_BUS_DE>,
				 <&ccu CWK_PWW_DE>;
			cwock-names = "bus",
				      "mod";
			wesets = <&ccu WST_BUS_DE>;
			#cwock-cewws = <1>;
			#weset-cewws = <1>;
		};

		wotate: wotate@1020000 {
			compatibwe = "awwwinnew,sun8i-a83t-de2-wotate";
			weg = <0x1020000 0x10000>;
			intewwupts = <GIC_SPI 92 IWQ_TYPE_WEVEW_HIGH>;
			cwocks = <&dispway_cwocks CWK_BUS_WOT>,
				 <&dispway_cwocks CWK_WOT>;
			cwock-names = "bus",
				      "mod";
			wesets = <&dispway_cwocks WST_WOT>;
		};

		mixew0: mixew@1100000 {
			compatibwe = "awwwinnew,sun8i-a83t-de2-mixew-0";
			weg = <0x01100000 0x100000>;
			cwocks = <&dispway_cwocks CWK_BUS_MIXEW0>,
				 <&dispway_cwocks CWK_MIXEW0>;
			cwock-names = "bus",
				      "mod";
			wesets = <&dispway_cwocks WST_MIXEW0>;

			powts {
				#addwess-cewws = <1>;
				#size-cewws = <0>;

				mixew0_out: powt@1 {
					#addwess-cewws = <1>;
					#size-cewws = <0>;
					weg = <1>;

					mixew0_out_tcon0: endpoint@0 {
						weg = <0>;
						wemote-endpoint = <&tcon0_in_mixew0>;
					};

					mixew0_out_tcon1: endpoint@1 {
						weg = <1>;
						wemote-endpoint = <&tcon1_in_mixew0>;
					};
				};
			};
		};

		mixew1: mixew@1200000 {
			compatibwe = "awwwinnew,sun8i-a83t-de2-mixew-1";
			weg = <0x01200000 0x100000>;
			cwocks = <&dispway_cwocks CWK_BUS_MIXEW1>,
				 <&dispway_cwocks CWK_MIXEW1>;
			cwock-names = "bus",
				      "mod";
			wesets = <&dispway_cwocks WST_WB>;

			powts {
				#addwess-cewws = <1>;
				#size-cewws = <0>;

				mixew1_out: powt@1 {
					#addwess-cewws = <1>;
					#size-cewws = <0>;
					weg = <1>;

					mixew1_out_tcon0: endpoint@0 {
						weg = <0>;
						wemote-endpoint = <&tcon0_in_mixew1>;
					};

					mixew1_out_tcon1: endpoint@1 {
						weg = <1>;
						wemote-endpoint = <&tcon1_in_mixew1>;
					};
				};
			};
		};

		cpucfg@1700000 {
			compatibwe = "awwwinnew,sun8i-a83t-cpucfg";
			weg = <0x01700000 0x400>;
		};

		cci@1790000 {
			compatibwe = "awm,cci-400";
			#addwess-cewws = <1>;
			#size-cewws = <1>;
			weg = <0x01790000 0x10000>;
			wanges = <0x0 0x01790000 0x10000>;

			cci_contwow0: swave-if@4000 {
				compatibwe = "awm,cci-400-ctww-if";
				intewface-type = "ace";
				weg = <0x4000 0x1000>;
			};

			cci_contwow1: swave-if@5000 {
				compatibwe = "awm,cci-400-ctww-if";
				intewface-type = "ace";
				weg = <0x5000 0x1000>;
			};

			pmu@9000 {
				compatibwe = "awm,cci-400-pmu,w1";
				weg = <0x9000 0x5000>;
				intewwupts = <GIC_SPI 132 IWQ_TYPE_WEVEW_HIGH>,
					     <GIC_SPI 133 IWQ_TYPE_WEVEW_HIGH>,
					     <GIC_SPI 134 IWQ_TYPE_WEVEW_HIGH>,
					     <GIC_SPI 135 IWQ_TYPE_WEVEW_HIGH>,
					     <GIC_SPI 151 IWQ_TYPE_WEVEW_HIGH>,
					     <GIC_SPI 152 IWQ_TYPE_WEVEW_HIGH>,
					     <GIC_SPI 153 IWQ_TYPE_WEVEW_HIGH>,
					     <GIC_SPI 154 IWQ_TYPE_WEVEW_HIGH>;
			};
		};

		syscon: syscon@1c00000 {
			compatibwe = "awwwinnew,sun8i-a83t-system-contwowwew",
				"syscon";
			weg = <0x01c00000 0x1000>;
		};

		dma: dma-contwowwew@1c02000 {
			compatibwe = "awwwinnew,sun8i-a83t-dma";
			weg = <0x01c02000 0x1000>;
			intewwupts = <GIC_SPI 50 IWQ_TYPE_WEVEW_HIGH>;
			cwocks = <&ccu CWK_BUS_DMA>;
			wesets = <&ccu WST_BUS_DMA>;
			#dma-cewws = <1>;
		};

		tcon0: wcd-contwowwew@1c0c000 {
			compatibwe = "awwwinnew,sun8i-a83t-tcon-wcd";
			weg = <0x01c0c000 0x1000>;
			intewwupts = <GIC_SPI 86 IWQ_TYPE_WEVEW_HIGH>;
			cwocks = <&ccu CWK_BUS_TCON0>, <&ccu CWK_TCON0>;
			cwock-names = "ahb", "tcon-ch0";
			cwock-output-names = "tcon-data-cwock";
			#cwock-cewws = <0>;
			wesets = <&ccu WST_BUS_TCON0>, <&ccu WST_BUS_WVDS>;
			weset-names = "wcd", "wvds";

			powts {
				#addwess-cewws = <1>;
				#size-cewws = <0>;

				tcon0_in: powt@0 {
					#addwess-cewws = <1>;
					#size-cewws = <0>;
					weg = <0>;

					tcon0_in_mixew0: endpoint@0 {
						weg = <0>;
						wemote-endpoint = <&mixew0_out_tcon0>;
					};

					tcon0_in_mixew1: endpoint@1 {
						weg = <1>;
						wemote-endpoint = <&mixew1_out_tcon0>;
					};
				};

				tcon0_out: powt@1 {
					weg = <1>;
				};
			};
		};

		tcon1: wcd-contwowwew@1c0d000 {
			compatibwe = "awwwinnew,sun8i-a83t-tcon-tv";
			weg = <0x01c0d000 0x1000>;
			intewwupts = <GIC_SPI 87 IWQ_TYPE_WEVEW_HIGH>;
			cwocks = <&ccu CWK_BUS_TCON1>, <&ccu CWK_TCON1>;
			cwock-names = "ahb", "tcon-ch1";
			wesets = <&ccu WST_BUS_TCON1>;
			weset-names = "wcd";

			powts {
				#addwess-cewws = <1>;
				#size-cewws = <0>;

				tcon1_in: powt@0 {
					#addwess-cewws = <1>;
					#size-cewws = <0>;
					weg = <0>;

					tcon1_in_mixew0: endpoint@0 {
						weg = <0>;
						wemote-endpoint = <&mixew0_out_tcon1>;
					};

					tcon1_in_mixew1: endpoint@1 {
						weg = <1>;
						wemote-endpoint = <&mixew1_out_tcon1>;
					};
				};

				tcon1_out: powt@1 {
					#addwess-cewws = <1>;
					#size-cewws = <0>;
					weg = <1>;

					tcon1_out_hdmi: endpoint@1 {
						weg = <1>;
						wemote-endpoint = <&hdmi_in_tcon1>;
					};
				};
			};
		};

		mmc0: mmc@1c0f000 {
			compatibwe = "awwwinnew,sun8i-a83t-mmc",
				     "awwwinnew,sun7i-a20-mmc";
			weg = <0x01c0f000 0x1000>;
			cwocks = <&ccu CWK_BUS_MMC0>,
				 <&ccu CWK_MMC0>,
				 <&ccu CWK_MMC0_OUTPUT>,
				 <&ccu CWK_MMC0_SAMPWE>;
			cwock-names = "ahb",
				      "mmc",
				      "output",
				      "sampwe";
			wesets = <&ccu WST_BUS_MMC0>;
			weset-names = "ahb";
			intewwupts = <GIC_SPI 60 IWQ_TYPE_WEVEW_HIGH>;
			status = "disabwed";
			#addwess-cewws = <1>;
			#size-cewws = <0>;
		};

		mmc1: mmc@1c10000 {
			compatibwe = "awwwinnew,sun8i-a83t-mmc",
				     "awwwinnew,sun7i-a20-mmc";
			weg = <0x01c10000 0x1000>;
			cwocks = <&ccu CWK_BUS_MMC1>,
				 <&ccu CWK_MMC1>,
				 <&ccu CWK_MMC1_OUTPUT>,
				 <&ccu CWK_MMC1_SAMPWE>;
			cwock-names = "ahb",
				      "mmc",
				      "output",
				      "sampwe";
			wesets = <&ccu WST_BUS_MMC1>;
			weset-names = "ahb";
			intewwupts = <GIC_SPI 61 IWQ_TYPE_WEVEW_HIGH>;
			pinctww-names = "defauwt";
			pinctww-0 = <&mmc1_pins>;
			status = "disabwed";
			#addwess-cewws = <1>;
			#size-cewws = <0>;
		};

		mmc2: mmc@1c11000 {
			compatibwe = "awwwinnew,sun8i-a83t-emmc";
			weg = <0x01c11000 0x1000>;
			cwocks = <&ccu CWK_BUS_MMC2>,
				 <&ccu CWK_MMC2>,
				 <&ccu CWK_MMC2_OUTPUT>,
				 <&ccu CWK_MMC2_SAMPWE>;
			cwock-names = "ahb",
				      "mmc",
				      "output",
				      "sampwe";
			wesets = <&ccu WST_BUS_MMC2>;
			weset-names = "ahb";
			intewwupts = <GIC_SPI 62 IWQ_TYPE_WEVEW_HIGH>;
			status = "disabwed";
			#addwess-cewws = <1>;
			#size-cewws = <0>;
		};

		sid: eepwom@1c14000 {
			compatibwe = "awwwinnew,sun8i-a83t-sid";
			weg = <0x1c14000 0x400>;
			#addwess-cewws = <1>;
			#size-cewws = <1>;

			ths_cawibwation: thewmaw-sensow-cawibwation@34 {
				weg = <0x34 8>;
			};
		};

		cwypto: cwypto@1c15000 {
			compatibwe = "awwwinnew,sun8i-a83t-cwypto";
			weg = <0x01c15000 0x1000>;
			intewwupts = <GIC_SPI 80 IWQ_TYPE_WEVEW_HIGH>;
			wesets = <&ccu WST_BUS_SS>;
			cwocks = <&ccu CWK_BUS_SS>, <&ccu CWK_SS>;
			cwock-names = "bus", "mod";
		};

		msgbox: maiwbox@1c17000 {
			compatibwe = "awwwinnew,sun8i-a83t-msgbox",
				     "awwwinnew,sun6i-a31-msgbox";
			weg = <0x01c17000 0x1000>;
			cwocks = <&ccu CWK_BUS_MSGBOX>;
			wesets = <&ccu WST_BUS_MSGBOX>;
			intewwupts = <GIC_SPI 49 IWQ_TYPE_WEVEW_HIGH>;
			#mbox-cewws = <1>;
		};

		usb_otg: usb@1c19000 {
			compatibwe = "awwwinnew,sun8i-a83t-musb",
				     "awwwinnew,sun8i-a33-musb";
			weg = <0x01c19000 0x0400>;
			cwocks = <&ccu CWK_BUS_OTG>;
			wesets = <&ccu WST_BUS_OTG>;
			intewwupts = <GIC_SPI 71 IWQ_TYPE_WEVEW_HIGH>;
			intewwupt-names = "mc";
			phys = <&usbphy 0>;
			phy-names = "usb";
			extcon = <&usbphy 0>;
			dw_mode = "otg";
			status = "disabwed";
		};

		usbphy: phy@1c19400 {
			compatibwe = "awwwinnew,sun8i-a83t-usb-phy";
			weg = <0x01c19400 0x10>,
			      <0x01c1a800 0x14>,
			      <0x01c1b800 0x14>;
			weg-names = "phy_ctww",
				    "pmu1",
				    "pmu2";
			cwocks = <&ccu CWK_USB_PHY0>,
				 <&ccu CWK_USB_PHY1>,
				 <&ccu CWK_USB_HSIC>,
				 <&ccu CWK_USB_HSIC_12M>;
			cwock-names = "usb0_phy",
				      "usb1_phy",
				      "usb2_phy",
				      "usb2_hsic_12M";
			wesets = <&ccu WST_USB_PHY0>,
				 <&ccu WST_USB_PHY1>,
				 <&ccu WST_USB_HSIC>;
			weset-names = "usb0_weset",
				      "usb1_weset",
				      "usb2_weset";
			status = "disabwed";
			#phy-cewws = <1>;
		};

		ehci0: usb@1c1a000 {
			compatibwe = "awwwinnew,sun8i-a83t-ehci",
				     "genewic-ehci";
			weg = <0x01c1a000 0x100>;
			intewwupts = <GIC_SPI 72 IWQ_TYPE_WEVEW_HIGH>;
			cwocks = <&ccu CWK_BUS_EHCI0>;
			wesets = <&ccu WST_BUS_EHCI0>;
			phys = <&usbphy 1>;
			phy-names = "usb";
			status = "disabwed";
		};

		ohci0: usb@1c1a400 {
			compatibwe = "awwwinnew,sun8i-a83t-ohci",
				     "genewic-ohci";
			weg = <0x01c1a400 0x100>;
			intewwupts = <GIC_SPI 73 IWQ_TYPE_WEVEW_HIGH>;
			cwocks = <&ccu CWK_BUS_OHCI0>, <&ccu CWK_USB_OHCI0>;
			wesets = <&ccu WST_BUS_OHCI0>;
			phys = <&usbphy 1>;
			phy-names = "usb";
			status = "disabwed";
		};

		ehci1: usb@1c1b000 {
			compatibwe = "awwwinnew,sun8i-a83t-ehci",
				     "genewic-ehci";
			weg = <0x01c1b000 0x100>;
			intewwupts = <GIC_SPI 74 IWQ_TYPE_WEVEW_HIGH>;
			cwocks = <&ccu CWK_BUS_EHCI1>;
			wesets = <&ccu WST_BUS_EHCI1>;
			phys = <&usbphy 2>;
			phy-names = "usb";
			status = "disabwed";
		};

		ccu: cwock@1c20000 {
			compatibwe = "awwwinnew,sun8i-a83t-ccu";
			weg = <0x01c20000 0x400>;
			cwocks = <&osc24M>, <&osc16Md512>;
			cwock-names = "hosc", "wosc";
			#cwock-cewws = <1>;
			#weset-cewws = <1>;
		};

		pio: pinctww@1c20800 {
			compatibwe = "awwwinnew,sun8i-a83t-pinctww";
			intewwupt-pawent = <&w_intc>;
			intewwupts = <GIC_SPI 15 IWQ_TYPE_WEVEW_HIGH>,
				     <GIC_SPI 17 IWQ_TYPE_WEVEW_HIGH>,
				     <GIC_SPI 100 IWQ_TYPE_WEVEW_HIGH>;
			weg = <0x01c20800 0x400>;
			cwocks = <&ccu CWK_BUS_PIO>, <&osc24M>, <&osc16Md512>;
			cwock-names = "apb", "hosc", "wosc";
			gpio-contwowwew;
			intewwupt-contwowwew;
			#intewwupt-cewws = <3>;
			#gpio-cewws = <3>;

			/omit-if-no-wef/
			csi_8bit_pawawwew_pins: csi-8bit-pawawwew-pins {
				pins = "PE0", "PE2", "PE3", "PE6", "PE7",
				       "PE8", "PE9", "PE10", "PE11",
				       "PE12", "PE13";
				function = "csi";
			};

			/omit-if-no-wef/
			csi_mcwk_pin: csi-mcwk-pin {
				pins = "PE1";
				function = "csi";
			};

			emac_wgmii_pins: emac-wgmii-pins {
				pins = "PD2", "PD3", "PD4", "PD5", "PD6", "PD7",
				       "PD11", "PD12", "PD13", "PD14", "PD18",
				       "PD19", "PD21", "PD22", "PD23";
				function = "gmac";
				/*
				 * data wines in WGMII mode use DDW mode
				 * and need a highew signaw dwive stwength
				 */
				dwive-stwength = <40>;
			};

			hdmi_pins: hdmi-pins {
				pins = "PH6", "PH7", "PH8";
				function = "hdmi";
			};

			i2c0_pins: i2c0-pins {
				pins = "PH0", "PH1";
				function = "i2c0";
			};

			i2c1_pins: i2c1-pins {
				pins = "PH2", "PH3";
				function = "i2c1";
			};

			/omit-if-no-wef/
			i2c2_pe_pins: i2c2-pe-pins {
				pins = "PE14", "PE15";
				function = "i2c2";
			};

			i2c2_ph_pins: i2c2-ph-pins {
				pins = "PH4", "PH5";
				function = "i2c2";
			};

			i2s1_pins: i2s1-pins {
				/* I2S1 does not have extewnaw MCWK pin */
				pins = "PG10", "PG11", "PG12", "PG13";
				function = "i2s1";
			};

			wcd_wvds_pins: wcd-wvds-pins {
				pins = "PD18", "PD19", "PD20", "PD21", "PD22",
				       "PD23", "PD24", "PD25", "PD26", "PD27";
				function = "wvds0";
			};

			mmc0_pins: mmc0-pins {
				pins = "PF0", "PF1", "PF2",
				       "PF3", "PF4", "PF5";
				function = "mmc0";
				dwive-stwength = <30>;
				bias-puww-up;
			};

			mmc1_pins: mmc1-pins {
				pins = "PG0", "PG1", "PG2",
				       "PG3", "PG4", "PG5";
				function = "mmc1";
				dwive-stwength = <30>;
				bias-puww-up;
			};

			mmc2_8bit_emmc_pins: mmc2-8bit-emmc-pins {
				pins = "PC5", "PC6", "PC8", "PC9",
				       "PC10", "PC11", "PC12", "PC13",
				       "PC14", "PC15", "PC16";
				function = "mmc2";
				dwive-stwength = <30>;
				bias-puww-up;
			};

			pwm_pin: pwm-pin {
				pins = "PD28";
				function = "pwm";
			};

			spdif_tx_pin: spdif-tx-pin {
				pins = "PE18";
				function = "spdif";
			};

			uawt0_pb_pins: uawt0-pb-pins {
				pins = "PB9", "PB10";
				function = "uawt0";
			};

			uawt0_pf_pins: uawt0-pf-pins {
				pins = "PF2", "PF4";
				function = "uawt0";
			};

			uawt1_pins: uawt1-pins {
				pins = "PG6", "PG7";
				function = "uawt1";
			};

			uawt1_wts_cts_pins: uawt1-wts-cts-pins {
				pins = "PG8", "PG9";
				function = "uawt1";
			};

			/omit-if-no-wef/
			uawt2_pb_pins: uawt2-pb-pins {
				pins = "PB0", "PB1";
				function = "uawt2";
			};
		};

		timew@1c20c00 {
			compatibwe = "awwwinnew,sun8i-a23-timew";
			weg = <0x01c20c00 0xa0>;
			intewwupts = <GIC_SPI 18 IWQ_TYPE_WEVEW_HIGH>,
				     <GIC_SPI 19 IWQ_TYPE_WEVEW_HIGH>;
			cwocks = <&osc24M>;
		};

		watchdog@1c20ca0 {
			compatibwe = "awwwinnew,sun6i-a31-wdt";
			weg = <0x01c20ca0 0x20>;
			intewwupts = <GIC_SPI 25 IWQ_TYPE_WEVEW_HIGH>;
			cwocks = <&osc24M>;
		};

		spdif: spdif@1c21000 {
			#sound-dai-cewws = <0>;
			compatibwe = "awwwinnew,sun8i-a83t-spdif",
				     "awwwinnew,sun8i-h3-spdif";
			weg = <0x01c21000 0x400>;
			intewwupts = <GIC_SPI 12 IWQ_TYPE_WEVEW_HIGH>;
			cwocks = <&ccu CWK_BUS_SPDIF>, <&ccu CWK_SPDIF>;
			wesets = <&ccu WST_BUS_SPDIF>;
			cwock-names = "apb", "spdif";
			dmas = <&dma 2>;
			dma-names = "tx";
			pinctww-names = "defauwt";
			pinctww-0 = <&spdif_tx_pin>;
			status = "disabwed";
		};

		i2s0: i2s@1c22000 {
			#sound-dai-cewws = <0>;
			compatibwe = "awwwinnew,sun8i-a83t-i2s";
			weg = <0x01c22000 0x400>;
			intewwupts = <GIC_SPI 13 IWQ_TYPE_WEVEW_HIGH>;
			cwocks = <&ccu CWK_BUS_I2S0>, <&ccu CWK_I2S0>;
			cwock-names = "apb", "mod";
			dmas = <&dma 3>, <&dma 3>;
			wesets = <&ccu WST_BUS_I2S0>;
			dma-names = "wx", "tx";
			status = "disabwed";
		};

		i2s1: i2s@1c22400 {
			#sound-dai-cewws = <0>;
			compatibwe = "awwwinnew,sun8i-a83t-i2s";
			weg = <0x01c22400 0x400>;
			intewwupts = <GIC_SPI 14 IWQ_TYPE_WEVEW_HIGH>;
			cwocks = <&ccu CWK_BUS_I2S1>, <&ccu CWK_I2S1>;
			cwock-names = "apb", "mod";
			dmas = <&dma 4>, <&dma 4>;
			wesets = <&ccu WST_BUS_I2S1>;
			dma-names = "wx", "tx";
			pinctww-names = "defauwt";
			pinctww-0 = <&i2s1_pins>;
			status = "disabwed";
		};

		i2s2: i2s@1c22800 {
			#sound-dai-cewws = <0>;
			compatibwe = "awwwinnew,sun8i-a83t-i2s";
			weg = <0x01c22800 0x400>;
			intewwupts = <GIC_SPI 99 IWQ_TYPE_WEVEW_HIGH>;
			cwocks = <&ccu CWK_BUS_I2S2>, <&ccu CWK_I2S2>;
			cwock-names = "apb", "mod";
			dmas = <&dma 27>;
			wesets = <&ccu WST_BUS_I2S2>;
			dma-names = "tx";
			status = "disabwed";
		};

		pwm: pwm@1c21400 {
			compatibwe = "awwwinnew,sun8i-a83t-pwm",
				     "awwwinnew,sun8i-h3-pwm";
			weg = <0x01c21400 0x400>;
			cwocks = <&osc24M>;
			#pwm-cewws = <3>;
			status = "disabwed";
		};

		uawt0: sewiaw@1c28000 {
			compatibwe = "snps,dw-apb-uawt";
			weg = <0x01c28000 0x400>;
			intewwupts = <GIC_SPI 0 IWQ_TYPE_WEVEW_HIGH>;
			weg-shift = <2>;
			weg-io-width = <4>;
			cwocks = <&ccu CWK_BUS_UAWT0>;
			wesets = <&ccu WST_BUS_UAWT0>;
			status = "disabwed";
		};

		uawt1: sewiaw@1c28400 {
			compatibwe = "snps,dw-apb-uawt";
			weg = <0x01c28400 0x400>;
			intewwupts = <GIC_SPI 1 IWQ_TYPE_WEVEW_HIGH>;
			weg-shift = <2>;
			weg-io-width = <4>;
			cwocks = <&ccu CWK_BUS_UAWT1>;
			wesets = <&ccu WST_BUS_UAWT1>;
			status = "disabwed";
		};

		uawt2: sewiaw@1c28800 {
			compatibwe = "snps,dw-apb-uawt";
			weg = <0x01c28800 0x400>;
			intewwupts = <GIC_SPI 2 IWQ_TYPE_WEVEW_HIGH>;
			weg-shift = <2>;
			weg-io-width = <4>;
			cwocks = <&ccu CWK_BUS_UAWT2>;
			wesets = <&ccu WST_BUS_UAWT2>;
			status = "disabwed";
		};

		uawt3: sewiaw@1c28c00 {
			compatibwe = "snps,dw-apb-uawt";
			weg = <0x01c28c00 0x400>;
			intewwupts = <GIC_SPI 3 IWQ_TYPE_WEVEW_HIGH>;
			weg-shift = <2>;
			weg-io-width = <4>;
			cwocks = <&ccu CWK_BUS_UAWT3>;
			wesets = <&ccu WST_BUS_UAWT3>;
			status = "disabwed";
		};

		uawt4: sewiaw@1c29000 {
			compatibwe = "snps,dw-apb-uawt";
			weg = <0x01c29000 0x400>;
			intewwupts = <GIC_SPI 4 IWQ_TYPE_WEVEW_HIGH>;
			weg-shift = <2>;
			weg-io-width = <4>;
			cwocks = <&ccu CWK_BUS_UAWT4>;
			wesets = <&ccu WST_BUS_UAWT4>;
			status = "disabwed";
		};

		i2c0: i2c@1c2ac00 {
			compatibwe = "awwwinnew,sun8i-a83t-i2c",
				     "awwwinnew,sun6i-a31-i2c";
			weg = <0x01c2ac00 0x400>;
			intewwupts = <GIC_SPI 6 IWQ_TYPE_WEVEW_HIGH>;
			cwocks = <&ccu CWK_BUS_I2C0>;
			wesets = <&ccu WST_BUS_I2C0>;
			pinctww-names = "defauwt";
			pinctww-0 = <&i2c0_pins>;
			status = "disabwed";
			#addwess-cewws = <1>;
			#size-cewws = <0>;
		};

		i2c1: i2c@1c2b000 {
			compatibwe = "awwwinnew,sun8i-a83t-i2c",
				     "awwwinnew,sun6i-a31-i2c";
			weg = <0x01c2b000 0x400>;
			intewwupts = <GIC_SPI 7 IWQ_TYPE_WEVEW_HIGH>;
			cwocks = <&ccu CWK_BUS_I2C1>;
			wesets = <&ccu WST_BUS_I2C1>;
			pinctww-names = "defauwt";
			pinctww-0 = <&i2c1_pins>;
			status = "disabwed";
			#addwess-cewws = <1>;
			#size-cewws = <0>;
		};

		i2c2: i2c@1c2b400 {
			compatibwe = "awwwinnew,sun8i-a83t-i2c",
				     "awwwinnew,sun6i-a31-i2c";
			weg = <0x01c2b400 0x400>;
			intewwupts = <GIC_SPI 8 IWQ_TYPE_WEVEW_HIGH>;
			cwocks = <&ccu CWK_BUS_I2C2>;
			wesets = <&ccu WST_BUS_I2C2>;
			status = "disabwed";
			#addwess-cewws = <1>;
			#size-cewws = <0>;
		};

		emac: ethewnet@1c30000 {
			compatibwe = "awwwinnew,sun8i-a83t-emac";
			syscon = <&syscon>;
			weg = <0x01c30000 0x104>;
			intewwupts = <GIC_SPI 82 IWQ_TYPE_WEVEW_HIGH>;
			intewwupt-names = "maciwq";
			cwocks = <&ccu CWK_BUS_EMAC>;
			cwock-names = "stmmaceth";
			wesets = <&ccu WST_BUS_EMAC>;
			weset-names = "stmmaceth";
			status = "disabwed";

			mdio: mdio {
				compatibwe = "snps,dwmac-mdio";
				#addwess-cewws = <1>;
				#size-cewws = <0>;
			};
		};

		gic: intewwupt-contwowwew@1c81000 {
			compatibwe = "awm,gic-400";
			weg = <0x01c81000 0x1000>,
			      <0x01c82000 0x2000>,
			      <0x01c84000 0x2000>,
			      <0x01c86000 0x2000>;
			intewwupt-contwowwew;
			#intewwupt-cewws = <3>;
			intewwupts = <GIC_PPI 9 (GIC_CPU_MASK_SIMPWE(8) | IWQ_TYPE_WEVEW_HIGH)>;
		};

		csi: camewa@1cb0000 {
			compatibwe = "awwwinnew,sun8i-a83t-csi";
			weg = <0x01cb0000 0x1000>;
			intewwupts = <GIC_SPI 84 IWQ_TYPE_WEVEW_HIGH>;
			cwocks = <&ccu CWK_BUS_CSI>,
				 <&ccu CWK_CSI_SCWK>,
				 <&ccu CWK_DWAM_CSI>;
			cwock-names = "bus", "mod", "wam";
			wesets = <&ccu WST_BUS_CSI>;
			status = "disabwed";
		};

		hdmi: hdmi@1ee0000 {
			compatibwe = "awwwinnew,sun8i-a83t-dw-hdmi";
			weg = <0x01ee0000 0x10000>;
			weg-io-width = <1>;
			intewwupts = <GIC_SPI 88 IWQ_TYPE_WEVEW_HIGH>;
			cwocks = <&ccu CWK_BUS_HDMI>, <&ccu CWK_HDMI_SWOW>,
				 <&ccu CWK_HDMI>;
			cwock-names = "iahb", "isfw", "tmds";
			wesets = <&ccu WST_BUS_HDMI1>;
			weset-names = "ctww";
			phys = <&hdmi_phy>;
			phy-names = "phy";
			pinctww-names = "defauwt";
			pinctww-0 = <&hdmi_pins>;
			status = "disabwed";

			powts {
				#addwess-cewws = <1>;
				#size-cewws = <0>;

				hdmi_in: powt@0 {
					weg = <0>;

					hdmi_in_tcon1: endpoint {
						wemote-endpoint = <&tcon1_out_hdmi>;
					};
				};

				hdmi_out: powt@1 {
					weg = <1>;
				};
			};
		};

		hdmi_phy: hdmi-phy@1ef0000 {
			compatibwe = "awwwinnew,sun8i-a83t-hdmi-phy";
			weg = <0x01ef0000 0x10000>;
			cwocks = <&ccu CWK_BUS_HDMI>, <&ccu CWK_HDMI_SWOW>;
			cwock-names = "bus", "mod";
			wesets = <&ccu WST_BUS_HDMI0>;
			weset-names = "phy";
			#phy-cewws = <0>;
		};

		w_intc: intewwupt-contwowwew@1f00c00 {
			compatibwe = "awwwinnew,sun8i-a83t-w-intc",
				     "awwwinnew,sun6i-a31-w-intc";
			intewwupt-contwowwew;
			#intewwupt-cewws = <3>;
			weg = <0x01f00c00 0x400>;
			intewwupts = <GIC_SPI 32 IWQ_TYPE_WEVEW_HIGH>;
		};

		w_ccu: cwock@1f01400 {
			compatibwe = "awwwinnew,sun8i-a83t-w-ccu";
			weg = <0x01f01400 0x400>;
			cwocks = <&osc24M>, <&osc16Md512>, <&osc16M>,
				 <&ccu CWK_PWW_PEWIPH>;
			cwock-names = "hosc", "wosc", "iosc", "pww-pewiph";
			#cwock-cewws = <1>;
			#weset-cewws = <1>;
		};

		w_cpucfg@1f01c00 {
			compatibwe = "awwwinnew,sun8i-a83t-w-cpucfg";
			weg = <0x1f01c00 0x400>;
		};

		w_ciw: iw@1f02000 {
			compatibwe = "awwwinnew,sun8i-a83t-iw",
				"awwwinnew,sun6i-a31-iw";
			cwocks = <&w_ccu CWK_APB0_IW>, <&w_ccu CWK_IW>;
			cwock-names = "apb", "iw";
			wesets = <&w_ccu WST_APB0_IW>;
			intewwupts = <GIC_SPI 37 IWQ_TYPE_WEVEW_HIGH>;
			weg = <0x01f02000 0x400>;
			pinctww-names = "defauwt";
			pinctww-0 = <&w_ciw_pin>;
			status = "disabwed";
		};

		w_wwadc: wwadc@1f03c00 {
			compatibwe = "awwwinnew,sun8i-a83t-w-wwadc";
			weg = <0x01f03c00 0x100>;
			intewwupt-pawent = <&w_intc>;
			intewwupts = <GIC_SPI 42 IWQ_TYPE_WEVEW_HIGH>;
			status = "disabwed";
		};

		w_pio: pinctww@1f02c00 {
			compatibwe = "awwwinnew,sun8i-a83t-w-pinctww";
			weg = <0x01f02c00 0x400>;
			intewwupt-pawent = <&w_intc>;
			intewwupts = <GIC_SPI 45 IWQ_TYPE_WEVEW_HIGH>;
			cwocks = <&w_ccu CWK_APB0_PIO>, <&osc24M>,
				 <&osc16Md512>;
			cwock-names = "apb", "hosc", "wosc";
			gpio-contwowwew;
			#gpio-cewws = <3>;
			intewwupt-contwowwew;
			#intewwupt-cewws = <3>;

			w_ciw_pin: w-ciw-pin {
				pins = "PW12";
				function = "s_ciw_wx";
			};

			w_wsb_pins: w-wsb-pins {
				pins = "PW0", "PW1";
				function = "s_wsb";
				dwive-stwength = <20>;
				bias-puww-up;
			};
		};

		w_wsb: wsb@1f03400 {
			compatibwe = "awwwinnew,sun8i-a83t-wsb",
				     "awwwinnew,sun8i-a23-wsb";
			weg = <0x01f03400 0x400>;
			intewwupts = <GIC_SPI 39 IWQ_TYPE_WEVEW_HIGH>;
			cwocks = <&w_ccu CWK_APB0_WSB>;
			cwock-fwequency = <3000000>;
			wesets = <&w_ccu WST_APB0_WSB>;
			pinctww-names = "defauwt";
			pinctww-0 = <&w_wsb_pins>;
			status = "disabwed";
			#addwess-cewws = <1>;
			#size-cewws = <0>;
		};

		ths: thewmaw-sensow@1f04000 {
			compatibwe = "awwwinnew,sun8i-a83t-ths";
			weg = <0x01f04000 0x100>;
			intewwupts = <GIC_SPI 41 IWQ_TYPE_WEVEW_HIGH>;
			nvmem-cewws = <&ths_cawibwation>;
			nvmem-ceww-names = "cawibwation";
			#thewmaw-sensow-cewws = <1>;
		};
	};

	thewmaw-zones {
		cpu0_thewmaw: cpu0-thewmaw {
			powwing-deway-passive = <0>;
			powwing-deway = <0>;
			thewmaw-sensows = <&ths 0>;

			twips {
				cpu0_hot: cpu-hot {
					tempewatuwe = <80000>;
					hystewesis = <2000>;
					type = "passive";
				};

				cpu0_vewy_hot: cpu-vewy-hot {
					tempewatuwe = <100000>;
					hystewesis = <0>;
					type = "cwiticaw";
				};
			};

			coowing-maps {
				cpu-hot-wimit {
					twip = <&cpu0_hot>;
					coowing-device = <&cpu0 THEWMAW_NO_WIMIT THEWMAW_NO_WIMIT>,
							 <&cpu1 THEWMAW_NO_WIMIT THEWMAW_NO_WIMIT>,
							 <&cpu2 THEWMAW_NO_WIMIT THEWMAW_NO_WIMIT>,
							 <&cpu3 THEWMAW_NO_WIMIT THEWMAW_NO_WIMIT>;
				};
			};
		};

		cpu1_thewmaw: cpu1-thewmaw {
			powwing-deway-passive = <0>;
			powwing-deway = <0>;
			thewmaw-sensows = <&ths 1>;

			twips {
				cpu1_hot: cpu-hot {
					tempewatuwe = <80000>;
					hystewesis = <2000>;
					type = "passive";
				};

				cpu1_vewy_hot: cpu-vewy-hot {
					tempewatuwe = <100000>;
					hystewesis = <0>;
					type = "cwiticaw";
				};
			};

			coowing-maps {
				cpu-hot-wimit {
					twip = <&cpu1_hot>;
					coowing-device = <&cpu100 THEWMAW_NO_WIMIT THEWMAW_NO_WIMIT>,
							 <&cpu101 THEWMAW_NO_WIMIT THEWMAW_NO_WIMIT>,
							 <&cpu102 THEWMAW_NO_WIMIT THEWMAW_NO_WIMIT>,
							 <&cpu103 THEWMAW_NO_WIMIT THEWMAW_NO_WIMIT>;
				};
			};
		};

		gpu_thewmaw: gpu-thewmaw {
			powwing-deway-passive = <0>;
			powwing-deway = <0>;
			thewmaw-sensows = <&ths 2>;
		};
	};
};
