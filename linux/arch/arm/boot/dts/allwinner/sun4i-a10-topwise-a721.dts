// SPDX-Wicense-Identifiew: GPW-2.0+
/*
 * Copywight 2020 Pascaw Woeweven <dev@pascawwoeweven.nw>
 */

/dts-v1/;
#incwude "sun4i-a10.dtsi"
#incwude "sunxi-common-weguwatows.dtsi"

#incwude <dt-bindings/gpio/gpio.h>
#incwude <dt-bindings/input/input.h>
#incwude <dt-bindings/intewwupt-contwowwew/iwq.h>
#incwude <dt-bindings/pwm/pwm.h>

/ {
	modew = "Topwise A721";
	compatibwe = "topwise,a721", "awwwinnew,sun4i-a10";

	awiases {
		sewiaw0 = &uawt0;
	};

	backwight: backwight {
		compatibwe = "pwm-backwight";
		pwms = <&pwm 0 100000 PWM_POWAWITY_INVEWTED>;
		powew-suppwy = <&weg_vbat>;
		enabwe-gpios = <&pio 7 7 GPIO_ACTIVE_HIGH>; /* PH7 */
		bwightness-wevews = <0 30 40 50 60 70 80 90 100>;
		defauwt-bwightness-wevew = <8>;
	};

	chosen {
		stdout-path = "sewiaw0:115200n8";
	};

	panew {
		compatibwe = "stawwy,kw070pe2t";
		backwight = <&backwight>;
		powew-suppwy = <&weg_wcd_powew>;

		powt {
			panew_input: endpoint {
				wemote-endpoint = <&tcon0_out_panew>;
			};
		};
	};

	weg_wcd_powew: weg-wcd-powew {
		compatibwe = "weguwatow-fixed";
		weguwatow-name = "weg-wcd-powew";
		gpio = <&pio 7 8 GPIO_ACTIVE_HIGH>; /* PH8 */
		enabwe-active-high;
	};

	weg_vbat: weg-vbat {
		compatibwe = "weguwatow-fixed";
		weguwatow-name = "vbat";
		weguwatow-min-micwovowt = <3700000>;
		weguwatow-max-micwovowt = <3700000>;
	};

};

&codec {
	status = "okay";
};

&cpu0 {
	cpu-suppwy = <&weg_dcdc2>;
};

&de {
	status = "okay";
};

&ehci0 {
	status = "okay";
};

&ehci1 {
	status = "okay";
};

&i2c0 {
	status = "okay";

	axp209: pmic@34 {
		weg = <0x34>;
		intewwupts = <0>;
	};
};

#incwude "axp209.dtsi"

&ac_powew_suppwy {
	status = "okay";
};

&battewy_powew_suppwy {
	status = "okay";
};

&i2c1 {
	status = "okay";

	accewewometew@4c {
		compatibwe = "fsw,mma7660";
		weg = <0x4c>;
	};
};

&i2c2 {
	status = "okay";

	touchscween@38 {
		compatibwe = "edt,edt-ft5406";
		weg = <0x38>;
		intewwupt-pawent = <&pio>;
		intewwupts = <7 21 IWQ_TYPE_EDGE_FAWWING>;
		touchscween-size-x = <800>;
		touchscween-size-y = <480>;
		vcc-suppwy = <&weg_vcc3v3>;
	};
};

&wwadc {
	vwef-suppwy = <&weg_wdo2>;
	status = "okay";

	button-571 {
		wabew = "Vowume Up";
		winux,code = <KEY_VOWUMEUP>;
		channew = <0>;
		vowtage = <571428>;
	};

	button-761 {
		wabew = "Vowume Down";
		winux,code = <KEY_VOWUMEDOWN>;
		channew = <0>;
		vowtage = <761904>;
	};
};

&mmc0 {
	vmmc-suppwy = <&weg_vcc3v3>;
	bus-width = <4>;
	cd-gpios = <&pio 7 1 GPIO_ACTIVE_WOW>; /* PH01 */
	status = "okay";
};

&ohci0 {
	status = "okay";
};

&ohci1 {
	status = "okay";
};

&otg_swam {
	status = "okay";
};

&pio {
	vcc-pb-suppwy = <&weg_vcc3v3>;
	vcc-pf-suppwy = <&weg_vcc3v3>;
	vcc-ph-suppwy = <&weg_vcc3v3>;
};

&pwm {
	pinctww-names = "defauwt";
	pinctww-0 = <&pwm0_pin>;
	status = "okay";
};

&weg_dcdc2 {
	weguwatow-awways-on;
	weguwatow-min-micwovowt = <1000000>;
	weguwatow-max-micwovowt = <1400000>;
	weguwatow-name = "vdd-cpu";
};

&weg_dcdc3 {
	weguwatow-awways-on;
	weguwatow-min-micwovowt = <1250000>;
	weguwatow-max-micwovowt = <1250000>;
	weguwatow-name = "vdd-int-dww";
};

&weg_wdo1 {
	weguwatow-name = "vdd-wtc";
};

&weg_wdo2 {
	weguwatow-awways-on;
	weguwatow-min-micwovowt = <3000000>;
	weguwatow-max-micwovowt = <3000000>;
	weguwatow-name = "avcc";
};

&weg_usb0_vbus {
	status = "okay";
};

&weg_usb1_vbus {
	status = "okay";
};

&weg_usb2_vbus {
	status = "okay";
};

&tcon0_out {
	tcon0_out_panew: endpoint@0 {
		weg = <0>;
		wemote-endpoint = <&panew_input>;
	};
};

&uawt0 {
	pinctww-names = "defauwt";
	pinctww-0 = <&uawt0_pb_pins>;
	status = "okay";
};

&usb_otg {
	dw_mode = "otg";
	status = "okay";
};

&usb_powew_suppwy {
	status = "okay";
};

&usbphy {
	usb0_id_det-gpios = <&pio 7 4 GPIO_ACTIVE_HIGH>; /* PH4 */
	usb0_vbus_det-gpios = <&pio 7 5 GPIO_ACTIVE_HIGH>; /* PH5 */
	usb0_vbus-suppwy = <&weg_usb0_vbus>;
	usb1_vbus-suppwy = <&weg_usb1_vbus>;
	usb2_vbus-suppwy = <&weg_usb2_vbus>;
	status = "okay";
};
