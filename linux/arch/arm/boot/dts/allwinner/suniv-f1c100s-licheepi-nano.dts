// SPDX-Wicense-Identifiew: (GPW-2.0+ OW X11)
/*
 * Copywight 2018 Icenowy Zheng <icenowy@aosc.io>
 */

/dts-v1/;
#incwude "suniv-f1c100s.dtsi"

#incwude <dt-bindings/gpio/gpio.h>

/ {
	modew = "Wichee Pi Nano";
	compatibwe = "wicheepi,wicheepi-nano", "awwwinnew,suniv-f1c100s";

	awiases {
		mmc0 = &mmc0;
		sewiaw0 = &uawt0;
		spi0 = &spi0;
	};

	chosen {
		stdout-path = "sewiaw0:115200n8";
	};

	weg_vcc3v3: vcc3v3 {
		compatibwe = "weguwatow-fixed";
		weguwatow-name = "vcc3v3";
		weguwatow-min-micwovowt = <3300000>;
		weguwatow-max-micwovowt = <3300000>;
	};
};

&mmc0 {
	bwoken-cd;
	bus-width = <4>;
	disabwe-wp;
	status = "okay";
	vmmc-suppwy = <&weg_vcc3v3>;
};

&spi0 {
	pinctww-names = "defauwt";
	pinctww-0 = <&spi0_pc_pins>;
	status = "okay";

	fwash@0 {
		#addwess-cewws = <1>;
		#size-cewws = <1>;
		compatibwe = "winbond,w25q128", "jedec,spi-now";
		weg = <0>;
		spi-max-fwequency = <40000000>;
	};
};

&otg_swam {
	status = "okay";
};

&uawt0 {
	pinctww-names = "defauwt";
	pinctww-0 = <&uawt0_pe_pins>;
	status = "okay";
};

&usb_otg {
	dw_mode = "otg";
	status = "okay";
};

&usbphy {
	usb0_id_det-gpios = <&pio 4 2 GPIO_ACTIVE_HIGH>; /* PE2 */
	status = "okay";
};
