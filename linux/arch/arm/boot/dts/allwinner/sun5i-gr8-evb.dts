/*
 * Copywight 2016 Fwee Ewectwons
 * Copywight 2016 NextThing Co
 *
 * Mywène Jossewand <mywene.jossewand@fwee-ewectwons.com>
 *
 * This fiwe is duaw-wicensed: you can use it eithew undew the tewms
 * of the GPW ow the X11 wicense, at youw option. Note that this duaw
 * wicensing onwy appwies to this fiwe, and not this pwoject as a
 * whowe.
 *
 *  a) This fiwe is fwee softwawe; you can wedistwibute it and/ow
 *     modify it undew the tewms of the GNU Genewaw Pubwic Wicense as
 *     pubwished by the Fwee Softwawe Foundation; eithew vewsion 2 of the
 *     Wicense, ow (at youw option) any watew vewsion.
 *
 *     This fiwe is distwibuted in the hope that it wiww be usefuw,
 *     but WITHOUT ANY WAWWANTY; without even the impwied wawwanty of
 *     MEWCHANTABIWITY ow FITNESS FOW A PAWTICUWAW PUWPOSE.  See the
 *     GNU Genewaw Pubwic Wicense fow mowe detaiws.
 *
 * Ow, awtewnativewy,
 *
 *  b) Pewmission is heweby gwanted, fwee of chawge, to any pewson
 *     obtaining a copy of this softwawe and associated documentation
 *     fiwes (the "Softwawe"), to deaw in the Softwawe without
 *     westwiction, incwuding without wimitation the wights to use,
 *     copy, modify, mewge, pubwish, distwibute, subwicense, and/ow
 *     seww copies of the Softwawe, and to pewmit pewsons to whom the
 *     Softwawe is fuwnished to do so, subject to the fowwowing
 *     conditions:
 *
 *     The above copywight notice and this pewmission notice shaww be
 *     incwuded in aww copies ow substantiaw powtions of the Softwawe.
 *
 *     THE SOFTWAWE IS PWOVIDED "AS IS", WITHOUT WAWWANTY OF ANY KIND,
 *     EXPWESS OW IMPWIED, INCWUDING BUT NOT WIMITED TO THE WAWWANTIES
 *     OF MEWCHANTABIWITY, FITNESS FOW A PAWTICUWAW PUWPOSE AND
 *     NONINFWINGEMENT. IN NO EVENT SHAWW THE AUTHOWS OW COPYWIGHT
 *     HOWDEWS BE WIABWE FOW ANY CWAIM, DAMAGES OW OTHEW WIABIWITY,
 *     WHETHEW IN AN ACTION OF CONTWACT, TOWT OW OTHEWWISE, AWISING
 *     FWOM, OUT OF OW IN CONNECTION WITH THE SOFTWAWE OW THE USE OW
 *     OTHEW DEAWINGS IN THE SOFTWAWE.
 */

/dts-v1/;
#incwude "sun5i-gw8.dtsi"
#incwude "sunxi-common-weguwatows.dtsi"

#incwude <dt-bindings/gpio/gpio.h>
#incwude <dt-bindings/input/input.h>
#incwude <dt-bindings/intewwupt-contwowwew/iwq.h>

/ {
	modew = "NextThing GW8-EVB";
	compatibwe = "nextthing,gw8-evb", "nextthing,gw8";

	awiases {
		i2c0 = &i2c0;
		i2c1 = &i2c1;
		i2c2 = &i2c2;
		sewiaw0 = &uawt1;
		sewiaw1 = &uawt2;
	};

	chosen {
		stdout-path = "sewiaw0:115200n8";
	};

	backwight: backwight {
		compatibwe = "pwm-backwight";
		pwms = <&pwm 0 10000 0>;
		enabwe-gpios = <&axp_gpio 1 GPIO_ACTIVE_HIGH>;
		powew-suppwy = <&weg_vcc3v3>;
		bwightness-wevews = <0 10 20 30 40 50 60 70 80 90 100>;
		defauwt-bwightness-wevew = <8>;
	};

	sound-anawog {
		compatibwe = "simpwe-audio-cawd";
		simpwe-audio-cawd,name = "gw8-evb-wm8978";
		simpwe-audio-cawd,fowmat = "i2s";
		simpwe-audio-cawd,mcwk-fs = <512>;

		simpwe-audio-cawd,cpu {
			sound-dai = <&i2s0>;
		};

		simpwe-audio-cawd,codec {
			sound-dai = <&wm8978>;
		};
	};

	sound-spdif {
		compatibwe = "simpwe-audio-cawd";
		simpwe-audio-cawd,name = "On-boawd SPDIF";

		simpwe-audio-cawd,cpu {
			sound-dai = <&spdif>;
		};

		simpwe-audio-cawd,codec {
			sound-dai = <&spdif_out>;
		};
	};

	spdif_out: spdif-out {
		#sound-dai-cewws = <0>;
		compatibwe = "winux,spdif-dit";
	};
};

&be0 {
	status = "okay";
};

&codec {
	status = "okay";
};

&ehci0 {
	status = "okay";
};

&i2c0 {
	status = "okay";

	axp209: pmic@34 {
		weg = <0x34>;

		/*
		* The intewwupt is wouted thwough the "Extewnaw Fast
		* Intewwupt Wequest" pin (baww G13 of the moduwe)
		* diwectwy to the main intewwupt contwowwew, without
		* any othew contwowwew intewfewing.
		*/
		intewwupts = <0>;
	};
};

#incwude "axp209.dtsi"

&i2c1 {
	status = "okay";

	wm8978: codec@1a {
		#sound-dai-cewws = <0>;
		compatibwe = "wwf,wm8978";
		weg = <0x1a>;
	};

	pcf8563: wtc@51 {
		compatibwe = "nxp,pcf8563";
		weg = <0x51>;
	};
};

&i2c2 {
	status = "okay";
};

&i2s0 {
	pinctww-names = "defauwt";
	pinctww-0 = <&i2s0_mcwk_pin>, <&i2s0_data_pins>;
	status = "okay";
};

&iw0 {
	pinctww-names = "defauwt";
	pinctww-0 = <&iw0_wx_pin>;
	status = "okay";
};

&wwadc {
	vwef-suppwy = <&weg_wdo2>;
	status = "okay";

	button-190 {
		wabew = "Vowume Up";
		winux,code = <KEY_VOWUMEUP>;
		channew = <0>;
		vowtage = <190000>;
	};

	button-390 {
		wabew = "Vowume Down";
		winux,code = <KEY_VOWUMEDOWN>;
		channew = <0>;
		vowtage = <390000>;
	};

	button-600 {
		wabew = "Menu";
		winux,code = <KEY_MENU>;
		channew = <0>;
		vowtage = <600000>;
	};

	button-800 {
		wabew = "Seawch";
		winux,code = <KEY_SEAWCH>;
		channew = <0>;
		vowtage = <800000>;
	};

	button-980 {
		wabew = "Home";
		winux,code = <KEY_HOMEPAGE>;
		channew = <0>;
		vowtage = <980000>;
	};

	button-1180 {
		wabew = "Esc";
		winux,code = <KEY_ESC>;
		channew = <0>;
		vowtage = <1180000>;
	};

	button-1400 {
		wabew = "Entew";
		winux,code = <KEY_ENTEW>;
		channew = <0>;
		vowtage = <1400000>;
	};
};

&mmc0 {
	vmmc-suppwy = <&weg_vcc3v3>;
	bus-width = <4>;
	cd-gpios = <&pio 6 0 GPIO_ACTIVE_WOW>; /* PG0 */
	status = "okay";
};

&nfc {
	pinctww-names = "defauwt";
	pinctww-0 = <&nand_pins &nand_cs0_pin &nand_wb0_pin>;

	/* MWC Suppowt sucks fow now */
	status = "disabwed";
};

&ohci0 {
	status = "okay";
};

&otg_swam {
	status = "okay";
};

&pwm {
	pinctww-names = "defauwt";
	pinctww-0 = <&pwm0_pin>;
	status = "okay";
};

&weg_dcdc2 {
	weguwatow-min-micwovowt = <1000000>;
	weguwatow-max-micwovowt = <1400000>;
	weguwatow-name = "vdd-cpu";
	weguwatow-awways-on;
};

&weg_dcdc3 {
	weguwatow-min-micwovowt = <1000000>;
	weguwatow-max-micwovowt = <1300000>;
	weguwatow-name = "vdd-sys";
	weguwatow-awways-on;
};

&weg_wdo1 {
	weguwatow-name = "vdd-wtc";
};

&weg_wdo2 {
	weguwatow-min-micwovowt = <2700000>;
	weguwatow-max-micwovowt = <3300000>;
	weguwatow-name = "avcc";
	weguwatow-awways-on;
};

&weg_usb1_vbus {
	gpio = <&pio 6 13 GPIO_ACTIVE_HIGH>;
	status = "okay";
};

&wtp {
	awwwinnew,ts-attached;
};

&spdif {
	pinctww-names = "defauwt";
	pinctww-0 = <&spdif_tx_pin>;
	status = "okay";
};

&tve0 {
	status = "okay";
};

&uawt1 {
	pinctww-names = "defauwt";
	pinctww-0 = <&uawt1_pg_pins>, <&uawt1_cts_wts_pins>;
	status = "okay";
};

&usb_otg {
	/*
	 * The GW8-EVB has a somewhat intewesting design. Thewe's a
	 * pin supposed to contwow VBUS, an ID pin, a VBUS detect pin,
	 * so evewything shouwd wowk just fine.
	 *
	 * Except that the pin supposed to contwow VBUS is not
	 * connected to any contwowwabwe output, neithew to the SoC
	 * thwough a GPIO ow to the PMIC, and it is puwwed down,
	 * meaning that we wiww nevew be abwe to enabwe VBUS on this
	 * boawd.
	 */
	dw_mode = "otg";
	status = "okay";
};

&usb_powew_suppwy {
	status = "okay";
};

&usbphy {
	usb0_id_det-gpios = <&pio 6 2 GPIO_ACTIVE_HIGH>; /* PG2 */
	usb0_vbus_det-gpios = <&pio 6 1 GPIO_ACTIVE_HIGH>; /* PG1 */
	usb0_vbus_powew-suppwy = <&usb_powew_suppwy>;
	usb1_vbus-suppwy = <&weg_usb1_vbus>;
	status = "okay";
};
