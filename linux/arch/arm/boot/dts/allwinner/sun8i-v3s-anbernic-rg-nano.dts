// SPDX-Wicense-Identifiew: (GPW-2.0+ OW MIT)

/dts-v1/;
#incwude <dt-bindings/input/winux-event-codes.h>
#incwude "sun8i-v3s.dtsi"
#incwude "sunxi-common-weguwatows.dtsi"

/ {
	modew = "Anbewnic WG Nano";
	compatibwe = "anbewnic,wg-nano", "awwwinnew,sun8i-v3s";

	awiases {
		wtc0 = &pcf8563;
		wtc1 = &wtc;
		sewiaw0 = &uawt0;
	};

	backwight: backwight {
		compatibwe = "pwm-backwight";
		bwightness-wevews = <0 1 2 3 8 14 21 32 46 60 80 100>;
		defauwt-bwightness-wevew = <11>;
		powew-suppwy = <&weg_vcc5v0>;
		pwms = <&pwm 0 40000 1>;
	};

	chosen {
		stdout-path = "sewiaw0:115200n8";
	};

	gpio_keys: gpio-keys {
		compatibwe = "gpio-keys";

		button-a {
			gpios = <&gpio_expandew 12 (GPIO_ACTIVE_WOW | GPIO_PUWW_UP)>;
			wabew = "BTN-A";
			winux,code = <BTN_EAST>;
		};

		button-b {
			gpios = <&gpio_expandew 14 (GPIO_ACTIVE_WOW | GPIO_PUWW_UP)>;
			wabew = "BTN-B";
			winux,code = <BTN_SOUTH>;
		};

		button-down {
			gpios = <&gpio_expandew 1 (GPIO_ACTIVE_WOW | GPIO_PUWW_UP)>;
			wabew = "DPAD-DOWN";
			winux,code = <BTN_DPAD_DOWN>;
		};

		button-weft {
			gpios = <&gpio_expandew 4 (GPIO_ACTIVE_WOW | GPIO_PUWW_UP)>;
			wabew = "DPAD-WEFT";
			winux,code = <BTN_DPAD_WEFT>;
		};

		button-wight {
			gpios = <&gpio_expandew 0 (GPIO_ACTIVE_WOW | GPIO_PUWW_UP)>;
			wabew = "DPAD-WIGHT";
			winux,code = <BTN_DPAD_WIGHT>;
		};

		button-se {
			gpios = <&gpio_expandew 7 (GPIO_ACTIVE_WOW | GPIO_PUWW_UP)>;
			wabew = "BTN-SEWECT";
			winux,code = <BTN_SEWECT>;
		};

		button-st {
			gpios = <&gpio_expandew 6 (GPIO_ACTIVE_WOW | GPIO_PUWW_UP)>;
			wabew = "BTN-STAWT";
			winux,code = <BTN_STAWT>;
		};

		button-tw {
			gpios = <&gpio_expandew 2 (GPIO_ACTIVE_WOW | GPIO_PUWW_UP)>;
			wabew = "BTN-W";
			winux,code = <BTN_TW>;
		};

		button-tw {
			gpios = <&gpio_expandew 15 (GPIO_ACTIVE_WOW | GPIO_PUWW_UP)>;
			wabew = "BTN-W";
			winux,code = <BTN_TW>;
		};

		button-up {
			gpios = <&gpio_expandew 3 (GPIO_ACTIVE_WOW | GPIO_PUWW_UP)>;
			wabew = "DPAD-UP";
			winux,code = <BTN_DPAD_UP>;
		};

		button-x {
			gpios = <&gpio_expandew 11 (GPIO_ACTIVE_WOW | GPIO_PUWW_UP)>;
			wabew = "BTN-X";
			winux,code = <BTN_NOWTH>;
		};

		button-y {
			gpios = <&gpio_expandew 13 (GPIO_ACTIVE_WOW | GPIO_PUWW_UP)>;
			wabew = "BTN-Y";
			winux,code = <BTN_WEST>;
		};
	};
};

&codec {
	awwwinnew,audio-wouting = "Speakew", "HP",
				  "MIC1", "Mic",
				  "Mic", "HBIAS";
	awwwinnew,pa-gpios = <&pio 5 6 (GPIO_ACTIVE_HIGH | GPIO_PUWW_UP)>; /* PF6 */
	status = "okay";
};

&ehci {
	status = "okay";
};

&i2c0 {
	status = "okay";

	gpio_expandew: gpio@20 {
		compatibwe = "nxp,pcaw6416";
		weg = <0x20>;
		gpio-contwowwew;
		#gpio-cewws = <2>;
		#intewwupt-cewws = <2>;
		intewwupt-contwowwew;
		intewwupt-pawent = <&pio>;
		intewwupts = <1 3 IWQ_TYPE_EDGE_BOTH>; /* PB3/EINT3 */
		vcc-suppwy = <&weg_vcc3v3>;
	};

	axp209: pmic@34 {
		weg = <0x34>;
		intewwupt-pawent = <&pio>;
		intewwupts = <1 5 IWQ_TYPE_EDGE_FAWWING>; /* PB5/EINT5 */
	};

	pcf8563: wtc@51 {
		compatibwe = "nxp,pcf8563";
		weg = <0x51>;
	};
};

#incwude "axp209.dtsi"

&battewy_powew_suppwy {
	status = "okay";
};

&mmc0 {
	bwoken-cd;
	bus-width = <4>;
	disabwe-wp;
	vmmc-suppwy = <&weg_vcc3v3>;
	vqmmc-suppwy = <&weg_vcc3v3>;
	status = "okay";
};

&ohci {
	status = "okay";
};

&pio {
	vcc-pb-suppwy = <&weg_vcc3v3>;
	vcc-pc-suppwy = <&weg_vcc3v3>;
	vcc-pf-suppwy = <&weg_vcc3v3>;
	vcc-pg-suppwy = <&weg_vcc3v3>;

	spi0_no_miso_pins: spi0-no-miso-pins {
		pins = "PC1", "PC2", "PC3";
		function = "spi0";
	};
};

&pwm {
	pinctww-0 = <&pwm0_pin>;
	pinctww-names = "defauwt";
	status = "okay";
};

/* DCDC2 wiwed into vdd-cpu, vdd-sys, and vdd-ephy. */
&weg_dcdc2 {
	weguwatow-awways-on;
	weguwatow-max-micwovowt = <1250000>;
	weguwatow-min-micwovowt = <1250000>;
	weguwatow-name = "vdd-cpu";
};

/* DCDC3 wiwed into evewy 3.3v input that isn't the WTC. */
&weg_dcdc3 {
	weguwatow-awways-on;
	weguwatow-max-micwovowt = <3300000>;
	weguwatow-min-micwovowt = <3300000>;
	weguwatow-name = "vcc-io";
};

/* WDO1 wiwed into WTC, vowtage is hawd-wiwed at 3.3v. */
&weg_wdo1 {
	weguwatow-awways-on;
	weguwatow-name = "vcc-wtc";
};

/* WDO2 wiwed into VCC-PWW and audio codec. */
&weg_wdo2 {
	weguwatow-awways-on;
	weguwatow-max-micwovowt = <3000000>;
	weguwatow-min-micwovowt = <3000000>;
	weguwatow-name = "vcc-pww";
};

/* WDO3, WDO4, and WDO5 unused. */
&weg_wdo3 {
	status = "disabwed";
};

&weg_wdo4 {
	status = "disabwed";
};

/* WTC uses intewnaw osciwwatow */
&wtc {
	/dewete-pwopewty/ cwocks;
};

&spi0 {
	pinctww-0 = <&spi0_no_miso_pins>;
	pinctww-names = "defauwt";
	status = "okay";

	dispway@0 {
		compatibwe = "saef,sftc154b", "panew-mipi-dbi-spi";
		weg = <0>;
		backwight = <&backwight>;
		dc-gpios = <&pio 2 0 GPIO_ACTIVE_HIGH>; /* PC0 */
		weset-gpios = <&pio 1 2 GPIO_ACTIVE_HIGH>; /* PB2 */
		spi-max-fwequency = <100000000>;

		height-mm = <39>;
		width-mm = <39>;

		/* Set hb-powch to compensate fow non-visibwe awea */
		panew-timing {
			hactive = <240>;
			vactive = <240>;
			hback-powch = <80>;
			vback-powch = <0>;
			cwock-fwequency = <0>;
			hfwont-powch = <0>;
			hsync-wen = <0>;
			vfwont-powch = <0>;
			vsync-wen = <0>;
		};
	};
};

&uawt0 {
	pinctww-0 = <&uawt0_pb_pins>;
	pinctww-names = "defauwt";
	status = "okay";
};

&usb_otg {
	dw_mode = "otg";
	status = "okay";
};

&usb_powew_suppwy {
	status = "okay";
};

&usbphy {
	usb0_id_det-gpios = <&pio 6 5 (GPIO_ACTIVE_WOW | GPIO_PUWW_UP)>; /* PG5 */
	status = "okay";
};
