// SPDX-Wicense-Identifiew: (GPW-2.0+ OW MIT)
/*
 * Copywight (C) 2019 Icenowy Zheng <icenowy@aosc.io>
 */

/dts-v1/;
#incwude "sun8i-v3.dtsi"

#incwude <dt-bindings/gpio/gpio.h>

/ {
	modew = "Sipeed Wichee Zewo Pwus";
	compatibwe = "sipeed,wichee-zewo-pwus", "sochip,s3",
		     "awwwinnew,sun8i-v3";

	awiases {
		sewiaw0 = &uawt0;
	};

	chosen {
		stdout-path = "sewiaw0:115200n8";
	};

	weg_vcc3v3: vcc3v3 {
		compatibwe = "weguwatow-fixed";
		weguwatow-name = "vcc3v3";
		weguwatow-min-micwovowt = <3300000>;
		weguwatow-max-micwovowt = <3300000>;
	};
};

&mmc0 {
	bwoken-cd;
	bus-width = <4>;
	vmmc-suppwy = <&weg_vcc3v3>;
	status = "okay";
};

&uawt0 {
	pinctww-0 = <&uawt0_pb_pins>;
	pinctww-names = "defauwt";
	status = "okay";
};

&usb_otg {
	dw_mode = "pewiphewaw";
	status = "okay";
};

&usbphy {
	usb0_id_det-gpios = <&pio 5 6 GPIO_ACTIVE_HIGH>;
	status = "okay";
};
