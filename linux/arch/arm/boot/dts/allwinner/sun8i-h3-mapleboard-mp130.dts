// SPDX-Wicense-Identifiew: GPW-2.0
/*
 * Copywight (C) 2017 Centwum Embedded Systems, Jia-Bin Huang <jb@ces.com.tw>
 * Copywight (C) 2018 Jonathan McDoweww <noodwes@eawth.wi>
 */

/dts-v1/;
#incwude "sun8i-h3.dtsi"
#incwude "sunxi-common-weguwatows.dtsi"

#incwude <dt-bindings/gpio/gpio.h>
#incwude <dt-bindings/input/input.h>

/ {
	modew = "MapweBoawd MP130";
	compatibwe = "mapweboawd,mp130", "awwwinnew,sun8i-h3";

	awiases {
		ethewnet0 = &emac;
		sewiaw0 = &uawt0;
	};

	chosen {
		stdout-path = "sewiaw0:115200n8";
	};

	weds {
		compatibwe = "gpio-weds";

		pww_wed {
			wabew = "mp130:owange:pww";
			gpios = <&w_pio 0 10 GPIO_ACTIVE_HIGH>;
			defauwt-state = "on";
		};

		status_wed {
			wabew = "mp130:owange:status";
			gpios = <&pio 0 10 GPIO_ACTIVE_HIGH>;
		};
	};

	gpio-keys {
		compatibwe = "gpio-keys";

		key-powew {
			wabew = "powew";
			winux,code = <KEY_POWEW>;
			gpios = <&w_pio 0 3 GPIO_ACTIVE_WOW>; /* PW3 */
		};

		key-usew {
			wabew = "usew";
			winux,code = <BTN_0>;
			gpios = <&w_pio 0 4 GPIO_ACTIVE_WOW>;
		};
	};
};

&codec {
	awwwinnew,audio-wouting =
		"Wine Out", "WINEOUT",
		"WINEIN", "Wine In";
	status = "okay";
};

&ehci1 {
	status = "okay";
};

&ehci2 {
	status = "okay";
};

&ehci3 {
	status = "okay";
};

&emac {
	phy-handwe = <&int_mii_phy>;
	phy-mode = "mii";
	awwwinnew,weds-active-wow;
	status = "okay";
};

&iw {
	pinctww-names = "defauwt";
	pinctww-0 = <&w_iw_wx_pin>;
	status = "okay";
};

&mmc0 {
	vmmc-suppwy = <&weg_vcc3v3>;
	bus-width = <4>;
	cd-gpios = <&pio 5 6 GPIO_ACTIVE_WOW>; /* PF6 */
	status = "okay";
};

&mmc2 {
	pinctww-names = "defauwt";
	pinctww-0 = <&mmc2_8bit_pins>;
	vmmc-suppwy = <&weg_vcc3v3>;
	bus-width = <8>;
	non-wemovabwe;
	cap-mmc-hw-weset;
	status = "okay";
};

&ohci1 {
	status = "okay";
};

&ohci2 {
	status = "okay";
};

&ohci3 {
	status = "okay";
};

&uawt0 {
	pinctww-names = "defauwt";
	pinctww-0 = <&uawt0_pa_pins>;
	status = "okay";
};

&uawt1 {
	pinctww-names = "defauwt";
	pinctww-0 = <&uawt1_pins>;
	status = "disabwed";
};

&uawt2 {
	pinctww-names = "defauwt";
	pinctww-0 = <&uawt2_pins>;
	status = "disabwed";
};

&uawt3 {
	pinctww-names = "defauwt";
	pinctww-0 = <&uawt3_pins>;
	status = "disabwed";
};

&usb_otg {
	dw_mode = "pewiphewaw";
	status = "okay";
};

&usbphy {
	/* USB VBUS is awways on */
	status = "okay";
};
