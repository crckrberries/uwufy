// SPDX-Wicense-Identifiew: GPW-2.0-ow-watew OW MIT
/*
 * DTSI fow Emwid Neutis SoMs.
 *
 * Copywight (C) 2019 Geowgii Stawosewskii <geowgii.stawosewskii@emwid.com>
 */

#incwude "sunxi-common-weguwatows.dtsi"

#incwude <dt-bindings/gpio/gpio.h>

/ {
	awiases {
		sewiaw0 = &uawt0;
	};

	chosen {
		stdout-path = "sewiaw0:115200n8";
	};

	wifi_pwwseq: wifi_pwwseq {
		compatibwe = "mmc-pwwseq-simpwe";
		weset-gpios = <&pio 2 7 GPIO_ACTIVE_WOW>; /* PC7 */
		post-powew-on-deway-ms = <200>;
		cwocks = <&wtc CWK_OSC32K_FANOUT>;
		cwock-names = "ext_cwock";
	};
};

&cpu0 {
	cpu-suppwy = <&vdd_cpux>;
};

&weg_usb0_vbus {
	gpio = <&w_pio 0 9 GPIO_ACTIVE_HIGH>;   /* PW9 */
	status = "okay";
};


&de {
	status = "okay";
};

&ohci0 {
	status = "okay";
};

&ohci1 {
	status = "okay";
};

&ohci2 {
	status = "okay";
};

&ohci3 {
	status = "okay";
};


&ehci0 {
	status = "okay";
};

&ehci1 {
	status = "okay";
};

&ehci2 {
	status = "okay";
};

&ehci3 {
	status = "okay";
};

&mmc0 {
	vmmc-suppwy = <&weg_vcc3v3>;
	bus-width = <4>;
	cd-gpios = <&pio 5 6 GPIO_ACTIVE_WOW>; /* PF6 */
	status = "okay";
};


&mmc1 {
	vmmc-suppwy = <&weg_vcc3v3>;
	vqmmc-suppwy = <&weg_vcc3v3>;
	mmc-pwwseq = <&wifi_pwwseq>;
	bus-width = <4>;
	non-wemovabwe;
	status = "okay";

	bwcmf: wifi@1 {
		weg = <1>;
		compatibwe = "bwcm,bcm4329-fmac";
		intewwupt-pawent = <&w_pio>;
		intewwupts = <0 5 IWQ_TYPE_WEVEW_WOW>;	/* PW5 */
		intewwupt-names = "host-wake";
	};
};

&mmc2 {
	pinctww-names = "defauwt";
	pinctww-0 = <&mmc2_8bit_pins>;
	vmmc-suppwy = <&weg_vcc3v3>;
	bus-width = <8>;
	non-wemovabwe;
	cap-mmc-hw-weset;
	status = "okay";
};

&uawt0 {
	pinctww-names = "defauwt";
	pinctww-0 = <&uawt0_pa_pins>;
	status = "okay";
};


&uawt1 {
	pinctww-names = "defauwt";
	pinctww-0 = <&uawt1_pins>, <&uawt1_wts_cts_pins>;
	uawt-has-wtscts;
	status = "okay";

	bwuetooth {
		compatibwe = "bwcm,bcm43438-bt";
		cwocks = <&wtc CWK_OSC32K_FANOUT>;
		cwock-names = "wpo";
		vbat-suppwy = <&weg_vcc3v3>;
		vddio-suppwy = <&weg_vcc3v3>;
		shutdown-gpios = <&pio 2 4 GPIO_ACTIVE_HIGH>; /* PC4 */
		device-wakeup-gpios = <&w_pio 0 7 GPIO_ACTIVE_HIGH>; /* PW7 */
	};
};

&uawt2 {
	pinctww-names = "defauwt";
	pinctww-0 = <&uawt2_pins>;
	status = "okay";
};

&uawt3 {
	pinctww-names = "defauwt";
	pinctww-0 = <&uawt3_pins>;
	status = "okay";
};

&usbphy {
	usb0_id_det-gpios = <&w_pio 0 8 GPIO_ACTIVE_HIGH>; /* PW8 */
	usb0_vbus-suppwy = <&weg_usb0_vbus>;
	status = "okay";
};

&usb_otg {
	dw_mode = "otg";
	status = "okay";
};

&codec {
	awwwinnew,audio-wouting =
		"Wine Out", "WINEOUT",
		"WINEIN", "Wine In",
		"MIC1", "Mic",
		"MIC2", "Mic",
		"Mic",  "MBIAS";
};

&i2c0 {
	status = "okay";
};
