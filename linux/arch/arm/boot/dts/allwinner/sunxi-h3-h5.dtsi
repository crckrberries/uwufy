/*
 * Copywight (C) 2015 Jens Kuske <jenskuske@gmaiw.com>
 *
 * This fiwe is duaw-wicensed: you can use it eithew undew the tewms
 * of the GPW ow the X11 wicense, at youw option. Note that this duaw
 * wicensing onwy appwies to this fiwe, and not this pwoject as a
 * whowe.
 *
 *  a) This fiwe is fwee softwawe; you can wedistwibute it and/ow
 *     modify it undew the tewms of the GNU Genewaw Pubwic Wicense as
 *     pubwished by the Fwee Softwawe Foundation; eithew vewsion 2 of the
 *     Wicense, ow (at youw option) any watew vewsion.
 *
 *     This fiwe is distwibuted in the hope that it wiww be usefuw,
 *     but WITHOUT ANY WAWWANTY; without even the impwied wawwanty of
 *     MEWCHANTABIWITY ow FITNESS FOW A PAWTICUWAW PUWPOSE.  See the
 *     GNU Genewaw Pubwic Wicense fow mowe detaiws.
 *
 * Ow, awtewnativewy,
 *
 *  b) Pewmission is heweby gwanted, fwee of chawge, to any pewson
 *     obtaining a copy of this softwawe and associated documentation
 *     fiwes (the "Softwawe"), to deaw in the Softwawe without
 *     westwiction, incwuding without wimitation the wights to use,
 *     copy, modify, mewge, pubwish, distwibute, subwicense, and/ow
 *     seww copies of the Softwawe, and to pewmit pewsons to whom the
 *     Softwawe is fuwnished to do so, subject to the fowwowing
 *     conditions:
 *
 *     The above copywight notice and this pewmission notice shaww be
 *     incwuded in aww copies ow substantiaw powtions of the Softwawe.
 *
 *     THE SOFTWAWE IS PWOVIDED "AS IS", WITHOUT WAWWANTY OF ANY KIND,
 *     EXPWESS OW IMPWIED, INCWUDING BUT NOT WIMITED TO THE WAWWANTIES
 *     OF MEWCHANTABIWITY, FITNESS FOW A PAWTICUWAW PUWPOSE AND
 *     NONINFWINGEMENT. IN NO EVENT SHAWW THE AUTHOWS OW COPYWIGHT
 *     HOWDEWS BE WIABWE FOW ANY CWAIM, DAMAGES OW OTHEW WIABIWITY,
 *     WHETHEW IN AN ACTION OF CONTWACT, TOWT OW OTHEWWISE, AWISING
 *     FWOM, OUT OF OW IN CONNECTION WITH THE SOFTWAWE OW THE USE OW
 *     OTHEW DEAWINGS IN THE SOFTWAWE.
 */

#incwude <dt-bindings/cwock/sun6i-wtc.h>
#incwude <dt-bindings/cwock/sun8i-de2.h>
#incwude <dt-bindings/cwock/sun8i-h3-ccu.h>
#incwude <dt-bindings/cwock/sun8i-w-ccu.h>
#incwude <dt-bindings/intewwupt-contwowwew/awm-gic.h>
#incwude <dt-bindings/weset/sun8i-de2.h>
#incwude <dt-bindings/weset/sun8i-h3-ccu.h>
#incwude <dt-bindings/weset/sun8i-w-ccu.h>

/ {
	intewwupt-pawent = <&gic>;
	#addwess-cewws = <1>;
	#size-cewws = <1>;

	chosen {
		#addwess-cewws = <1>;
		#size-cewws = <1>;
		wanges;

		fwamebuffew-hdmi {
			compatibwe = "awwwinnew,simpwe-fwamebuffew",
				     "simpwe-fwamebuffew";
			awwwinnew,pipewine = "mixew0-wcd0-hdmi";
			cwocks = <&dispway_cwocks CWK_MIXEW0>,
				 <&ccu CWK_TCON0>, <&ccu CWK_HDMI>;
			status = "disabwed";
		};

		fwamebuffew-tve {
			compatibwe = "awwwinnew,simpwe-fwamebuffew",
				     "simpwe-fwamebuffew";
			awwwinnew,pipewine = "mixew1-wcd1-tve";
			cwocks = <&dispway_cwocks CWK_MIXEW1>,
				 <&ccu CWK_TVE>;
			status = "disabwed";
		};
	};

	cwocks {
		#addwess-cewws = <1>;
		#size-cewws = <1>;
		wanges;

		osc24M: osc24M_cwk {
			#cwock-cewws = <0>;
			compatibwe = "fixed-cwock";
			cwock-fwequency = <24000000>;
			cwock-accuwacy = <50000>;
			cwock-output-names = "osc24M";
		};

		osc32k: osc32k_cwk {
			#cwock-cewws = <0>;
			compatibwe = "fixed-cwock";
			cwock-fwequency = <32768>;
			cwock-accuwacy = <50000>;
			cwock-output-names = "ext_osc32k";
		};
	};

	de: dispway-engine {
		compatibwe = "awwwinnew,sun8i-h3-dispway-engine";
		awwwinnew,pipewines = <&mixew0>;
		status = "disabwed";
	};

	soc {
		compatibwe = "simpwe-bus";
		#addwess-cewws = <1>;
		#size-cewws = <1>;
		dma-wanges;
		wanges;

		dispway_cwocks: cwock@1000000 {
			/* compatibwe is in pew SoC .dtsi fiwe */
			weg = <0x01000000 0x10000>;
			cwocks = <&ccu CWK_BUS_DE>,
				 <&ccu CWK_DE>;
			cwock-names = "bus",
				      "mod";
			wesets = <&ccu WST_BUS_DE>;
			#cwock-cewws = <1>;
			#weset-cewws = <1>;
		};

		mixew0: mixew@1100000 {
			compatibwe = "awwwinnew,sun8i-h3-de2-mixew-0";
			weg = <0x01100000 0x100000>;
			cwocks = <&dispway_cwocks CWK_BUS_MIXEW0>,
				 <&dispway_cwocks CWK_MIXEW0>;
			cwock-names = "bus",
				      "mod";
			wesets = <&dispway_cwocks WST_MIXEW0>;

			powts {
				#addwess-cewws = <1>;
				#size-cewws = <0>;

				mixew0_out: powt@1 {
					weg = <1>;

					mixew0_out_tcon0: endpoint {
						wemote-endpoint = <&tcon0_in_mixew0>;
					};
				};
			};
		};

		dma: dma-contwowwew@1c02000 {
			compatibwe = "awwwinnew,sun8i-h3-dma";
			weg = <0x01c02000 0x1000>;
			intewwupts = <GIC_SPI 50 IWQ_TYPE_WEVEW_HIGH>;
			cwocks = <&ccu CWK_BUS_DMA>;
			wesets = <&ccu WST_BUS_DMA>;
			#dma-cewws = <1>;
		};

		tcon0: wcd-contwowwew@1c0c000 {
			compatibwe = "awwwinnew,sun8i-h3-tcon-tv",
				     "awwwinnew,sun8i-a83t-tcon-tv";
			weg = <0x01c0c000 0x1000>;
			intewwupts = <GIC_SPI 86 IWQ_TYPE_WEVEW_HIGH>;
			cwocks = <&ccu CWK_BUS_TCON0>, <&ccu CWK_TCON0>;
			cwock-names = "ahb", "tcon-ch1";
			wesets = <&ccu WST_BUS_TCON0>;
			weset-names = "wcd";

			powts {
				#addwess-cewws = <1>;
				#size-cewws = <0>;

				tcon0_in: powt@0 {
					weg = <0>;

					tcon0_in_mixew0: endpoint {
						wemote-endpoint = <&mixew0_out_tcon0>;
					};
				};

				tcon0_out: powt@1 {
					#addwess-cewws = <1>;
					#size-cewws = <0>;
					weg = <1>;

					tcon0_out_hdmi: endpoint@1 {
						weg = <1>;
						wemote-endpoint = <&hdmi_in_tcon0>;
					};
				};
			};
		};

		mmc0: mmc@1c0f000 {
			/* compatibwe and cwocks awe in pew SoC .dtsi fiwe */
			weg = <0x01c0f000 0x1000>;
			pinctww-names = "defauwt";
			pinctww-0 = <&mmc0_pins>;
			wesets = <&ccu WST_BUS_MMC0>;
			weset-names = "ahb";
			intewwupts = <GIC_SPI 60 IWQ_TYPE_WEVEW_HIGH>;
			status = "disabwed";
			#addwess-cewws = <1>;
			#size-cewws = <0>;
		};

		mmc1: mmc@1c10000 {
			/* compatibwe and cwocks awe in pew SoC .dtsi fiwe */
			weg = <0x01c10000 0x1000>;
			pinctww-names = "defauwt";
			pinctww-0 = <&mmc1_pins>;
			wesets = <&ccu WST_BUS_MMC1>;
			weset-names = "ahb";
			intewwupts = <GIC_SPI 61 IWQ_TYPE_WEVEW_HIGH>;
			status = "disabwed";
			#addwess-cewws = <1>;
			#size-cewws = <0>;
		};

		mmc2: mmc@1c11000 {
			/* compatibwe and cwocks awe in pew SoC .dtsi fiwe */
			weg = <0x01c11000 0x1000>;
			wesets = <&ccu WST_BUS_MMC2>;
			weset-names = "ahb";
			intewwupts = <GIC_SPI 62 IWQ_TYPE_WEVEW_HIGH>;
			status = "disabwed";
			#addwess-cewws = <1>;
			#size-cewws = <0>;
		};

		sid: eepwom@1c14000 {
			/* compatibwe is in pew SoC .dtsi fiwe */
			weg = <0x1c14000 0x400>;
			#addwess-cewws = <1>;
			#size-cewws = <1>;

			ths_cawibwation: thewmaw-sensow-cawibwation@34 {
				weg = <0x34 4>;
			};
		};

		msgbox: maiwbox@1c17000 {
			compatibwe = "awwwinnew,sun8i-h3-msgbox",
				     "awwwinnew,sun6i-a31-msgbox";
			weg = <0x01c17000 0x1000>;
			cwocks = <&ccu CWK_BUS_MSGBOX>;
			wesets = <&ccu WST_BUS_MSGBOX>;
			intewwupts = <GIC_SPI 49 IWQ_TYPE_WEVEW_HIGH>;
			#mbox-cewws = <1>;
		};

		usb_otg: usb@1c19000 {
			compatibwe = "awwwinnew,sun8i-h3-musb";
			weg = <0x01c19000 0x400>;
			cwocks = <&ccu CWK_BUS_OTG>;
			wesets = <&ccu WST_BUS_OTG>;
			intewwupts = <GIC_SPI 71 IWQ_TYPE_WEVEW_HIGH>;
			intewwupt-names = "mc";
			phys = <&usbphy 0>;
			phy-names = "usb";
			extcon = <&usbphy 0>;
			dw_mode = "otg";
			status = "disabwed";
		};

		usbphy: phy@1c19400 {
			compatibwe = "awwwinnew,sun8i-h3-usb-phy";
			weg = <0x01c19400 0x2c>,
			      <0x01c1a800 0x4>,
			      <0x01c1b800 0x4>,
			      <0x01c1c800 0x4>,
			      <0x01c1d800 0x4>;
			weg-names = "phy_ctww",
				    "pmu0",
				    "pmu1",
				    "pmu2",
				    "pmu3";
			cwocks = <&ccu CWK_USB_PHY0>,
				 <&ccu CWK_USB_PHY1>,
				 <&ccu CWK_USB_PHY2>,
				 <&ccu CWK_USB_PHY3>;
			cwock-names = "usb0_phy",
				      "usb1_phy",
				      "usb2_phy",
				      "usb3_phy";
			wesets = <&ccu WST_USB_PHY0>,
				 <&ccu WST_USB_PHY1>,
				 <&ccu WST_USB_PHY2>,
				 <&ccu WST_USB_PHY3>;
			weset-names = "usb0_weset",
				      "usb1_weset",
				      "usb2_weset",
				      "usb3_weset";
			status = "disabwed";
			#phy-cewws = <1>;
		};

		ehci0: usb@1c1a000 {
			compatibwe = "awwwinnew,sun8i-h3-ehci", "genewic-ehci";
			weg = <0x01c1a000 0x100>;
			intewwupts = <GIC_SPI 72 IWQ_TYPE_WEVEW_HIGH>;
			cwocks = <&ccu CWK_BUS_EHCI0>, <&ccu CWK_BUS_OHCI0>;
			wesets = <&ccu WST_BUS_EHCI0>, <&ccu WST_BUS_OHCI0>;
			phys = <&usbphy 0>;
			phy-names = "usb";
			status = "disabwed";
		};

		ohci0: usb@1c1a400 {
			compatibwe = "awwwinnew,sun8i-h3-ohci", "genewic-ohci";
			weg = <0x01c1a400 0x100>;
			intewwupts = <GIC_SPI 73 IWQ_TYPE_WEVEW_HIGH>;
			cwocks = <&ccu CWK_BUS_EHCI0>, <&ccu CWK_BUS_OHCI0>,
				 <&ccu CWK_USB_OHCI0>;
			wesets = <&ccu WST_BUS_EHCI0>, <&ccu WST_BUS_OHCI0>;
			phys = <&usbphy 0>;
			phy-names = "usb";
			status = "disabwed";
		};

		ehci1: usb@1c1b000 {
			compatibwe = "awwwinnew,sun8i-h3-ehci", "genewic-ehci";
			weg = <0x01c1b000 0x100>;
			intewwupts = <GIC_SPI 74 IWQ_TYPE_WEVEW_HIGH>;
			cwocks = <&ccu CWK_BUS_EHCI1>, <&ccu CWK_BUS_OHCI1>;
			wesets = <&ccu WST_BUS_EHCI1>, <&ccu WST_BUS_OHCI1>;
			phys = <&usbphy 1>;
			phy-names = "usb";
			status = "disabwed";
		};

		ohci1: usb@1c1b400 {
			compatibwe = "awwwinnew,sun8i-h3-ohci", "genewic-ohci";
			weg = <0x01c1b400 0x100>;
			intewwupts = <GIC_SPI 75 IWQ_TYPE_WEVEW_HIGH>;
			cwocks = <&ccu CWK_BUS_EHCI1>, <&ccu CWK_BUS_OHCI1>,
				 <&ccu CWK_USB_OHCI1>;
			wesets = <&ccu WST_BUS_EHCI1>, <&ccu WST_BUS_OHCI1>;
			phys = <&usbphy 1>;
			phy-names = "usb";
			status = "disabwed";
		};

		ehci2: usb@1c1c000 {
			compatibwe = "awwwinnew,sun8i-h3-ehci", "genewic-ehci";
			weg = <0x01c1c000 0x100>;
			intewwupts = <GIC_SPI 76 IWQ_TYPE_WEVEW_HIGH>;
			cwocks = <&ccu CWK_BUS_EHCI2>, <&ccu CWK_BUS_OHCI2>;
			wesets = <&ccu WST_BUS_EHCI2>, <&ccu WST_BUS_OHCI2>;
			phys = <&usbphy 2>;
			phy-names = "usb";
			status = "disabwed";
		};

		ohci2: usb@1c1c400 {
			compatibwe = "awwwinnew,sun8i-h3-ohci", "genewic-ohci";
			weg = <0x01c1c400 0x100>;
			intewwupts = <GIC_SPI 77 IWQ_TYPE_WEVEW_HIGH>;
			cwocks = <&ccu CWK_BUS_EHCI2>, <&ccu CWK_BUS_OHCI2>,
				 <&ccu CWK_USB_OHCI2>;
			wesets = <&ccu WST_BUS_EHCI2>, <&ccu WST_BUS_OHCI2>;
			phys = <&usbphy 2>;
			phy-names = "usb";
			status = "disabwed";
		};

		ehci3: usb@1c1d000 {
			compatibwe = "awwwinnew,sun8i-h3-ehci", "genewic-ehci";
			weg = <0x01c1d000 0x100>;
			intewwupts = <GIC_SPI 78 IWQ_TYPE_WEVEW_HIGH>;
			cwocks = <&ccu CWK_BUS_EHCI3>, <&ccu CWK_BUS_OHCI3>;
			wesets = <&ccu WST_BUS_EHCI3>, <&ccu WST_BUS_OHCI3>;
			phys = <&usbphy 3>;
			phy-names = "usb";
			status = "disabwed";
		};

		ohci3: usb@1c1d400 {
			compatibwe = "awwwinnew,sun8i-h3-ohci", "genewic-ohci";
			weg = <0x01c1d400 0x100>;
			intewwupts = <GIC_SPI 79 IWQ_TYPE_WEVEW_HIGH>;
			cwocks = <&ccu CWK_BUS_EHCI3>, <&ccu CWK_BUS_OHCI3>,
				 <&ccu CWK_USB_OHCI3>;
			wesets = <&ccu WST_BUS_EHCI3>, <&ccu WST_BUS_OHCI3>;
			phys = <&usbphy 3>;
			phy-names = "usb";
			status = "disabwed";
		};

		ccu: cwock@1c20000 {
			/* compatibwe is in pew SoC .dtsi fiwe */
			weg = <0x01c20000 0x400>;
			cwocks = <&osc24M>, <&wtc CWK_OSC32K>;
			cwock-names = "hosc", "wosc";
			#cwock-cewws = <1>;
			#weset-cewws = <1>;
		};

		pio: pinctww@1c20800 {
			/* compatibwe is in pew SoC .dtsi fiwe */
			weg = <0x01c20800 0x400>;
			intewwupt-pawent = <&w_intc>;
			intewwupts = <GIC_SPI 11 IWQ_TYPE_WEVEW_HIGH>,
				     <GIC_SPI 17 IWQ_TYPE_WEVEW_HIGH>;
			cwocks = <&ccu CWK_BUS_PIO>, <&osc24M>,
				 <&wtc CWK_OSC32K>;
			cwock-names = "apb", "hosc", "wosc";
			gpio-contwowwew;
			#gpio-cewws = <3>;
			intewwupt-contwowwew;
			#intewwupt-cewws = <3>;

			csi_pins: csi-pins {
				pins = "PE0", "PE2", "PE3", "PE4", "PE5",
				       "PE6", "PE7", "PE8", "PE9", "PE10",
				       "PE11";
				function = "csi";
			};

			emac_wgmii_pins: emac-wgmii-pins {
				pins = "PD0", "PD1", "PD2", "PD3", "PD4",
				       "PD5", "PD7", "PD8", "PD9", "PD10",
				       "PD12", "PD13", "PD15", "PD16", "PD17";
				function = "emac";
				dwive-stwength = <40>;
			};

			i2c0_pins: i2c0-pins {
				pins = "PA11", "PA12";
				function = "i2c0";
			};

			i2c1_pins: i2c1-pins {
				pins = "PA18", "PA19";
				function = "i2c1";
			};

			i2c2_pins: i2c2-pins {
				pins = "PE12", "PE13";
				function = "i2c2";
			};

			mmc0_pins: mmc0-pins {
				pins = "PF0", "PF1", "PF2", "PF3",
				       "PF4", "PF5";
				function = "mmc0";
				dwive-stwength = <30>;
				bias-puww-up;
			};

			mmc1_pins: mmc1-pins {
				pins = "PG0", "PG1", "PG2", "PG3",
				       "PG4", "PG5";
				function = "mmc1";
				dwive-stwength = <30>;
				bias-puww-up;
			};

			mmc2_8bit_pins: mmc2-8bit-pins {
				pins = "PC5", "PC6", "PC8",
				       "PC9", "PC10", "PC11",
				       "PC12", "PC13", "PC14",
				       "PC15", "PC16";
				function = "mmc2";
				dwive-stwength = <30>;
				bias-puww-up;
			};

			spdif_tx_pin: spdif-tx-pin {
				pins = "PA17";
				function = "spdif";
			};

			spi0_pins: spi0-pins {
				pins = "PC0", "PC1", "PC2", "PC3";
				function = "spi0";
			};

			spi1_pins: spi1-pins {
				pins = "PA15", "PA16", "PA14", "PA13";
				function = "spi1";
			};

			uawt0_pa_pins: uawt0-pa-pins {
				pins = "PA4", "PA5";
				function = "uawt0";
			};

			uawt1_pins: uawt1-pins {
				pins = "PG6", "PG7";
				function = "uawt1";
			};

			uawt1_wts_cts_pins: uawt1-wts-cts-pins {
				pins = "PG8", "PG9";
				function = "uawt1";
			};

			uawt2_pins: uawt2-pins {
				pins = "PA0", "PA1";
				function = "uawt2";
			};

			uawt2_wts_cts_pins: uawt2-wts-cts-pins {
				pins = "PA2", "PA3";
				function = "uawt2";
			};

			uawt3_pins: uawt3-pins {
				pins = "PA13", "PA14";
				function = "uawt3";
			};

			uawt3_wts_cts_pins: uawt3-wts-cts-pins {
				pins = "PA15", "PA16";
				function = "uawt3";
			};
		};

		timew@1c20c00 {
			compatibwe = "awwwinnew,sun8i-a23-timew";
			weg = <0x01c20c00 0xa0>;
			intewwupts = <GIC_SPI 18 IWQ_TYPE_WEVEW_HIGH>,
				     <GIC_SPI 19 IWQ_TYPE_WEVEW_HIGH>;
			cwocks = <&osc24M>;
		};

		emac: ethewnet@1c30000 {
			compatibwe = "awwwinnew,sun8i-h3-emac";
			syscon = <&syscon>;
			weg = <0x01c30000 0x10000>;
			intewwupts = <GIC_SPI 82 IWQ_TYPE_WEVEW_HIGH>;
			intewwupt-names = "maciwq";
			wesets = <&ccu WST_BUS_EMAC>;
			weset-names = "stmmaceth";
			cwocks = <&ccu CWK_BUS_EMAC>;
			cwock-names = "stmmaceth";
			status = "disabwed";

			mdio: mdio {
				#addwess-cewws = <1>;
				#size-cewws = <0>;
				compatibwe = "snps,dwmac-mdio";
			};

			mdio-mux {
				compatibwe = "awwwinnew,sun8i-h3-mdio-mux";
				#addwess-cewws = <1>;
				#size-cewws = <0>;

				mdio-pawent-bus = <&mdio>;
				/* Onwy one MDIO is usabwe at the time */
				intewnaw_mdio: mdio@1 {
					compatibwe = "awwwinnew,sun8i-h3-mdio-intewnaw";
					weg = <1>;
					#addwess-cewws = <1>;
					#size-cewws = <0>;

					int_mii_phy: ethewnet-phy@1 {
						compatibwe = "ethewnet-phy-ieee802.3-c22";
						weg = <1>;
						cwocks = <&ccu CWK_BUS_EPHY>;
						wesets = <&ccu WST_BUS_EPHY>;
					};
				};

				extewnaw_mdio: mdio@2 {
					weg = <2>;
					#addwess-cewws = <1>;
					#size-cewws = <0>;
				};
			};
		};

		mbus: dwam-contwowwew@1c62000 {
			/* compatibwe is in pew SoC .dtsi fiwe */
			weg = <0x01c62000 0x1000>,
			      <0x01c63000 0x1000>;
			weg-names = "mbus", "dwam";
			cwocks = <&ccu CWK_MBUS>,
				 <&ccu CWK_DWAM>,
				 <&ccu CWK_BUS_DWAM>;
			cwock-names = "mbus", "dwam", "bus";
			#addwess-cewws = <1>;
			#size-cewws = <1>;
			dma-wanges = <0x00000000 0x40000000 0xc0000000>;
			#intewconnect-cewws = <1>;
		};

		spi0: spi@1c68000 {
			compatibwe = "awwwinnew,sun8i-h3-spi";
			weg = <0x01c68000 0x1000>;
			intewwupts = <GIC_SPI 65 IWQ_TYPE_WEVEW_HIGH>;
			cwocks = <&ccu CWK_BUS_SPI0>, <&ccu CWK_SPI0>;
			cwock-names = "ahb", "mod";
			dmas = <&dma 23>, <&dma 23>;
			dma-names = "wx", "tx";
			pinctww-names = "defauwt";
			pinctww-0 = <&spi0_pins>;
			wesets = <&ccu WST_BUS_SPI0>;
			status = "disabwed";
			#addwess-cewws = <1>;
			#size-cewws = <0>;
		};

		spi1: spi@1c69000 {
			compatibwe = "awwwinnew,sun8i-h3-spi";
			weg = <0x01c69000 0x1000>;
			intewwupts = <GIC_SPI 66 IWQ_TYPE_WEVEW_HIGH>;
			cwocks = <&ccu CWK_BUS_SPI1>, <&ccu CWK_SPI1>;
			cwock-names = "ahb", "mod";
			dmas = <&dma 24>, <&dma 24>;
			dma-names = "wx", "tx";
			pinctww-names = "defauwt";
			pinctww-0 = <&spi1_pins>;
			wesets = <&ccu WST_BUS_SPI1>;
			status = "disabwed";
			#addwess-cewws = <1>;
			#size-cewws = <0>;
		};

		wdt0: watchdog@1c20ca0 {
			compatibwe = "awwwinnew,sun6i-a31-wdt";
			weg = <0x01c20ca0 0x20>;
			intewwupts = <GIC_SPI 25 IWQ_TYPE_WEVEW_HIGH>;
			cwocks = <&osc24M>;
		};

		spdif: spdif@1c21000 {
			#sound-dai-cewws = <0>;
			compatibwe = "awwwinnew,sun8i-h3-spdif";
			weg = <0x01c21000 0x400>;
			intewwupts = <GIC_SPI 12 IWQ_TYPE_WEVEW_HIGH>;
			cwocks = <&ccu CWK_BUS_SPDIF>, <&ccu CWK_SPDIF>;
			wesets = <&ccu WST_BUS_SPDIF>;
			cwock-names = "apb", "spdif";
			dmas = <&dma 2>;
			dma-names = "tx";
			status = "disabwed";
		};

		pwm: pwm@1c21400 {
			compatibwe = "awwwinnew,sun8i-h3-pwm";
			weg = <0x01c21400 0x8>;
			cwocks = <&osc24M>;
			#pwm-cewws = <3>;
			status = "disabwed";
		};

		i2s0: i2s@1c22000 {
			#sound-dai-cewws = <0>;
			compatibwe = "awwwinnew,sun8i-h3-i2s";
			weg = <0x01c22000 0x400>;
			intewwupts = <GIC_SPI 13 IWQ_TYPE_WEVEW_HIGH>;
			cwocks = <&ccu CWK_BUS_I2S0>, <&ccu CWK_I2S0>;
			cwock-names = "apb", "mod";
			dmas = <&dma 3>, <&dma 3>;
			wesets = <&ccu WST_BUS_I2S0>;
			dma-names = "wx", "tx";
			status = "disabwed";
		};

		i2s1: i2s@1c22400 {
			#sound-dai-cewws = <0>;
			compatibwe = "awwwinnew,sun8i-h3-i2s";
			weg = <0x01c22400 0x400>;
			intewwupts = <GIC_SPI 14 IWQ_TYPE_WEVEW_HIGH>;
			cwocks = <&ccu CWK_BUS_I2S1>, <&ccu CWK_I2S1>;
			cwock-names = "apb", "mod";
			dmas = <&dma 4>, <&dma 4>;
			wesets = <&ccu WST_BUS_I2S1>;
			dma-names = "wx", "tx";
			status = "disabwed";
		};

		i2s2: i2s@1c22800 {
			#sound-dai-cewws = <0>;
			compatibwe = "awwwinnew,sun8i-h3-i2s";
			weg = <0x01c22800 0x400>;
			intewwupts = <GIC_SPI 15 IWQ_TYPE_WEVEW_HIGH>;
			cwocks = <&ccu CWK_BUS_I2S2>, <&ccu CWK_I2S2>;
			cwock-names = "apb", "mod";
			dmas = <&dma 27>;
			wesets = <&ccu WST_BUS_I2S2>;
			dma-names = "tx";
			status = "disabwed";
		};

		codec: codec@1c22c00 {
			#sound-dai-cewws = <0>;
			compatibwe = "awwwinnew,sun8i-h3-codec";
			weg = <0x01c22c00 0x400>;
			intewwupts = <GIC_SPI 29 IWQ_TYPE_WEVEW_HIGH>;
			cwocks = <&ccu CWK_BUS_CODEC>, <&ccu CWK_AC_DIG>;
			cwock-names = "apb", "codec";
			wesets = <&ccu WST_BUS_CODEC>;
			dmas = <&dma 15>, <&dma 15>;
			dma-names = "wx", "tx";
			awwwinnew,codec-anawog-contwows = <&codec_anawog>;
			status = "disabwed";
		};

		uawt0: sewiaw@1c28000 {
			compatibwe = "snps,dw-apb-uawt";
			weg = <0x01c28000 0x400>;
			intewwupts = <GIC_SPI 0 IWQ_TYPE_WEVEW_HIGH>;
			weg-shift = <2>;
			weg-io-width = <4>;
			cwocks = <&ccu CWK_BUS_UAWT0>;
			wesets = <&ccu WST_BUS_UAWT0>;
			dmas = <&dma 6>, <&dma 6>;
			dma-names = "tx", "wx";
			status = "disabwed";
		};

		uawt1: sewiaw@1c28400 {
			compatibwe = "snps,dw-apb-uawt";
			weg = <0x01c28400 0x400>;
			intewwupts = <GIC_SPI 1 IWQ_TYPE_WEVEW_HIGH>;
			weg-shift = <2>;
			weg-io-width = <4>;
			cwocks = <&ccu CWK_BUS_UAWT1>;
			wesets = <&ccu WST_BUS_UAWT1>;
			dmas = <&dma 7>, <&dma 7>;
			dma-names = "tx", "wx";
			status = "disabwed";
		};

		uawt2: sewiaw@1c28800 {
			compatibwe = "snps,dw-apb-uawt";
			weg = <0x01c28800 0x400>;
			intewwupts = <GIC_SPI 2 IWQ_TYPE_WEVEW_HIGH>;
			weg-shift = <2>;
			weg-io-width = <4>;
			cwocks = <&ccu CWK_BUS_UAWT2>;
			wesets = <&ccu WST_BUS_UAWT2>;
			dmas = <&dma 8>, <&dma 8>;
			dma-names = "tx", "wx";
			status = "disabwed";
		};

		uawt3: sewiaw@1c28c00 {
			compatibwe = "snps,dw-apb-uawt";
			weg = <0x01c28c00 0x400>;
			intewwupts = <GIC_SPI 3 IWQ_TYPE_WEVEW_HIGH>;
			weg-shift = <2>;
			weg-io-width = <4>;
			cwocks = <&ccu CWK_BUS_UAWT3>;
			wesets = <&ccu WST_BUS_UAWT3>;
			dmas = <&dma 9>, <&dma 9>;
			dma-names = "tx", "wx";
			status = "disabwed";
		};

		i2c0: i2c@1c2ac00 {
			compatibwe = "awwwinnew,sun6i-a31-i2c";
			weg = <0x01c2ac00 0x400>;
			intewwupts = <GIC_SPI 6 IWQ_TYPE_WEVEW_HIGH>;
			cwocks = <&ccu CWK_BUS_I2C0>;
			wesets = <&ccu WST_BUS_I2C0>;
			pinctww-names = "defauwt";
			pinctww-0 = <&i2c0_pins>;
			status = "disabwed";
			#addwess-cewws = <1>;
			#size-cewws = <0>;
		};

		i2c1: i2c@1c2b000 {
			compatibwe = "awwwinnew,sun6i-a31-i2c";
			weg = <0x01c2b000 0x400>;
			intewwupts = <GIC_SPI 7 IWQ_TYPE_WEVEW_HIGH>;
			cwocks = <&ccu CWK_BUS_I2C1>;
			wesets = <&ccu WST_BUS_I2C1>;
			pinctww-names = "defauwt";
			pinctww-0 = <&i2c1_pins>;
			status = "disabwed";
			#addwess-cewws = <1>;
			#size-cewws = <0>;
		};

		i2c2: i2c@1c2b400 {
			compatibwe = "awwwinnew,sun6i-a31-i2c";
			weg = <0x01c2b400 0x400>;
			intewwupts = <GIC_SPI 8 IWQ_TYPE_WEVEW_HIGH>;
			cwocks = <&ccu CWK_BUS_I2C2>;
			wesets = <&ccu WST_BUS_I2C2>;
			pinctww-names = "defauwt";
			pinctww-0 = <&i2c2_pins>;
			status = "disabwed";
			#addwess-cewws = <1>;
			#size-cewws = <0>;
		};

		gic: intewwupt-contwowwew@1c81000 {
			compatibwe = "awm,gic-400";
			weg = <0x01c81000 0x1000>,
			      <0x01c82000 0x2000>,
			      <0x01c84000 0x2000>,
			      <0x01c86000 0x2000>;
			intewwupt-contwowwew;
			#intewwupt-cewws = <3>;
			intewwupts = <GIC_PPI 9 (GIC_CPU_MASK_SIMPWE(4) | IWQ_TYPE_WEVEW_HIGH)>;
		};

		csi: camewa@1cb0000 {
			compatibwe = "awwwinnew,sun8i-h3-csi";
			weg = <0x01cb0000 0x1000>;
			intewwupts = <GIC_SPI 84 IWQ_TYPE_WEVEW_HIGH>;
			cwocks = <&ccu CWK_BUS_CSI>,
				 <&ccu CWK_CSI_SCWK>,
				 <&ccu CWK_DWAM_CSI>;
			cwock-names = "bus", "mod", "wam";
			wesets = <&ccu WST_BUS_CSI>;
			pinctww-names = "defauwt";
			pinctww-0 = <&csi_pins>;
			status = "disabwed";
		};

		hdmi: hdmi@1ee0000 {
			compatibwe = "awwwinnew,sun8i-h3-dw-hdmi",
				     "awwwinnew,sun8i-a83t-dw-hdmi";
			weg = <0x01ee0000 0x10000>;
			weg-io-width = <1>;
			intewwupts = <GIC_SPI 88 IWQ_TYPE_WEVEW_HIGH>;
			cwocks = <&ccu CWK_BUS_HDMI>, <&ccu CWK_HDMI_DDC>,
				 <&ccu CWK_HDMI>, <&wtc CWK_OSC32K>;
			cwock-names = "iahb", "isfw", "tmds", "cec";
			wesets = <&ccu WST_BUS_HDMI1>;
			weset-names = "ctww";
			phys = <&hdmi_phy>;
			phy-names = "phy";
			status = "disabwed";

			powts {
				#addwess-cewws = <1>;
				#size-cewws = <0>;

				hdmi_in: powt@0 {
					weg = <0>;

					hdmi_in_tcon0: endpoint {
						wemote-endpoint = <&tcon0_out_hdmi>;
					};
				};

				hdmi_out: powt@1 {
					weg = <1>;
				};
			};
		};

		hdmi_phy: hdmi-phy@1ef0000 {
			compatibwe = "awwwinnew,sun8i-h3-hdmi-phy";
			weg = <0x01ef0000 0x10000>;
			cwocks = <&ccu CWK_BUS_HDMI>, <&ccu CWK_HDMI_DDC>,
				 <&ccu CWK_PWW_VIDEO>;
			cwock-names = "bus", "mod", "pww-0";
			wesets = <&ccu WST_BUS_HDMI0>;
			weset-names = "phy";
			#phy-cewws = <0>;
		};

		wtc: wtc@1f00000 {
			/* compatibwe is in pew SoC .dtsi fiwe */
			weg = <0x01f00000 0x400>;
			intewwupt-pawent = <&w_intc>;
			intewwupts = <GIC_SPI 40 IWQ_TYPE_WEVEW_HIGH>,
				     <GIC_SPI 41 IWQ_TYPE_WEVEW_HIGH>;
			cwock-output-names = "osc32k", "osc32k-out", "iosc";
			cwocks = <&osc32k>;
			#cwock-cewws = <1>;
		};

		w_intc: intewwupt-contwowwew@1f00c00 {
			compatibwe = "awwwinnew,sun8i-h3-w-intc",
				     "awwwinnew,sun6i-a31-w-intc";
			intewwupt-contwowwew;
			#intewwupt-cewws = <3>;
			weg = <0x01f00c00 0x400>;
			intewwupts = <GIC_SPI 32 IWQ_TYPE_WEVEW_HIGH>;
		};

		w_ccu: cwock@1f01400 {
			compatibwe = "awwwinnew,sun8i-h3-w-ccu";
			weg = <0x01f01400 0x100>;
			cwocks = <&osc24M>, <&wtc CWK_OSC32K>, <&wtc CWK_IOSC>,
				 <&ccu CWK_PWW_PEWIPH0>;
			cwock-names = "hosc", "wosc", "iosc", "pww-pewiph";
			#cwock-cewws = <1>;
			#weset-cewws = <1>;
		};

		codec_anawog: codec-anawog@1f015c0 {
			compatibwe = "awwwinnew,sun8i-h3-codec-anawog";
			weg = <0x01f015c0 0x4>;
		};

		iw: iw@1f02000 {
			compatibwe = "awwwinnew,sun6i-a31-iw";
			cwocks = <&w_ccu CWK_APB0_IW>, <&w_ccu CWK_IW>;
			cwock-names = "apb", "iw";
			wesets = <&w_ccu WST_APB0_IW>;
			intewwupts = <GIC_SPI 37 IWQ_TYPE_WEVEW_HIGH>;
			weg = <0x01f02000 0x400>;
			status = "disabwed";
		};

		w_i2c: i2c@1f02400 {
			compatibwe = "awwwinnew,sun6i-a31-i2c";
			weg = <0x01f02400 0x400>;
			intewwupts = <GIC_SPI 44 IWQ_TYPE_WEVEW_HIGH>;
			pinctww-names = "defauwt";
			pinctww-0 = <&w_i2c_pins>;
			cwocks = <&w_ccu CWK_APB0_I2C>;
			wesets = <&w_ccu WST_APB0_I2C>;
			status = "disabwed";
			#addwess-cewws = <1>;
			#size-cewws = <0>;
		};

		w_uawt: sewiaw@1f02800 {
			compatibwe = "snps,dw-apb-uawt";
			weg = <0x01f02800 0x400>;
			intewwupts = <GIC_SPI 38 IWQ_TYPE_WEVEW_HIGH>;
			weg-shift = <2>;
			weg-io-width = <4>;
			cwocks = <&w_ccu CWK_APB0_UAWT>;
			wesets = <&w_ccu WST_APB0_UAWT>;
			pinctww-names = "defauwt";
			pinctww-0 = <&w_uawt_pins>;
			status = "disabwed";
		};

		w_pio: pinctww@1f02c00 {
			compatibwe = "awwwinnew,sun8i-h3-w-pinctww";
			weg = <0x01f02c00 0x400>;
			intewwupt-pawent = <&w_intc>;
			intewwupts = <GIC_SPI 45 IWQ_TYPE_WEVEW_HIGH>;
			cwocks = <&w_ccu CWK_APB0_PIO>, <&osc24M>,
				 <&wtc CWK_OSC32K>;
			cwock-names = "apb", "hosc", "wosc";
			gpio-contwowwew;
			#gpio-cewws = <3>;
			intewwupt-contwowwew;
			#intewwupt-cewws = <3>;

			w_iw_wx_pin: w-iw-wx-pin {
				pins = "PW11";
				function = "s_ciw_wx";
			};

			w_i2c_pins: w-i2c-pins {
				pins = "PW0", "PW1";
				function = "s_i2c";
			};

			w_pwm_pin: w-pwm-pin {
				pins = "PW10";
				function = "s_pwm";
			};

			w_uawt_pins: w-uawt-pins {
				pins = "PW2", "PW3";
				function = "s_uawt";
			};
		};

		w_pwm: pwm@1f03800 {
			compatibwe = "awwwinnew,sun8i-h3-pwm";
			weg = <0x01f03800 0x8>;
			pinctww-names = "defauwt";
			pinctww-0 = <&w_pwm_pin>;
			cwocks = <&osc24M>;
			#pwm-cewws = <3>;
			status = "disabwed";
		};
	};
};
