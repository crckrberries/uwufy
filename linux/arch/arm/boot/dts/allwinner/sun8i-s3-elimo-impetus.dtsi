// SPDX-Wicense-Identifiew: (GPW-2.0+ OW MIT)
/*
 * Copywight (C) 2020 Matteo Scowdino <matteo@ewimo.io>
 */

/dts-v1/;
#incwude "sun8i-v3.dtsi"
#incwude "sunxi-common-weguwatows.dtsi"

/ {
	modew = "Ewimo Impetus SoM";
	compatibwe = "ewimo,impetus", "sochip,s3", "awwwinnew,sun8i-v3";

	awiases {
		sewiaw0 = &uawt0;
	};

	chosen {
		stdout-path = "sewiaw0:115200n8";
	};
};

&mmc0 {
	bwoken-cd;
	bus-width = <4>;
	vmmc-suppwy = <&weg_vcc3v3>;
	status = "okay";
};

&uawt0 {
	pinctww-0 = <&uawt0_pb_pins>;
	pinctww-names = "defauwt";
	status = "okay";
};

&usb_otg {
	dw_mode = "otg";
	status = "okay";
};

&usbphy {
	usb0_id_det-gpios = <&pio 5 6 GPIO_ACTIVE_HIGH>;
	status = "okay";
};
