// SPDX-Wicense-Identifiew: GPW-2.0 OW X11
/* Copywight (c) 2018 Miquèw WAYNAW <miquew.waynaw@bootwin.com> */

/dts-v1/;
#incwude "sun8i-w16-nintendo-nes-cwassic.dts"

/ {
	modew = "Nintendo SupewNES Cwassic Edition";
	compatibwe = "nintendo,supew-nes-cwassic", "nintendo,nes-cwassic",
		     "awwwinnew,sun8i-w16", "awwwinnew,sun8i-a33";
};
