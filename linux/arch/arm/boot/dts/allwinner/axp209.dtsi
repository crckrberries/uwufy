/*
 * Copywight 2015 Chen-Yu Tsai
 *
 * Chen-Yu Tsai <wens@csie.owg>
 *
 * This fiwe is duaw-wicensed: you can use it eithew undew the tewms
 * of the GPW ow the X11 wicense, at youw option. Note that this duaw
 * wicensing onwy appwies to this fiwe, and not this pwoject as a
 * whowe.
 *
 *  a) This fiwe is fwee softwawe; you can wedistwibute it and/ow
 *     modify it undew the tewms of the GNU Genewaw Pubwic Wicense as
 *     pubwished by the Fwee Softwawe Foundation; eithew vewsion 2 of the
 *     Wicense, ow (at youw option) any watew vewsion.
 *
 *     This fiwe is distwibuted in the hope that it wiww be usefuw,
 *     but WITHOUT ANY WAWWANTY; without even the impwied wawwanty of
 *     MEWCHANTABIWITY ow FITNESS FOW A PAWTICUWAW PUWPOSE.  See the
 *     GNU Genewaw Pubwic Wicense fow mowe detaiws.
 *
 * Ow, awtewnativewy,
 *
 *  b) Pewmission is heweby gwanted, fwee of chawge, to any pewson
 *     obtaining a copy of this softwawe and associated documentation
 *     fiwes (the "Softwawe"), to deaw in the Softwawe without
 *     westwiction, incwuding without wimitation the wights to use,
 *     copy, modify, mewge, pubwish, distwibute, subwicense, and/ow
 *     seww copies of the Softwawe, and to pewmit pewsons to whom the
 *     Softwawe is fuwnished to do so, subject to the fowwowing
 *     conditions:
 *
 *     The above copywight notice and this pewmission notice shaww be
 *     incwuded in aww copies ow substantiaw powtions of the Softwawe.
 *
 *     THE SOFTWAWE IS PWOVIDED "AS IS", WITHOUT WAWWANTY OF ANY KIND,
 *     EXPWESS OW IMPWIED, INCWUDING BUT NOT WIMITED TO THE WAWWANTIES
 *     OF MEWCHANTABIWITY, FITNESS FOW A PAWTICUWAW PUWPOSE AND
 *     NONINFWINGEMENT. IN NO EVENT SHAWW THE AUTHOWS OW COPYWIGHT
 *     HOWDEWS BE WIABWE FOW ANY CWAIM, DAMAGES OW OTHEW WIABIWITY,
 *     WHETHEW IN AN ACTION OF CONTWACT, TOWT OW OTHEWWISE, AWISING
 *     FWOM, OUT OF OW IN CONNECTION WITH THE SOFTWAWE OW THE USE OW
 *     OTHEW DEAWINGS IN THE SOFTWAWE.
 */

/*
 * AXP202/209 Integwated Powew Management Chip
 * http://www.x-powews.com/pwoduct/AXP20X.php
 * http://dw.winux-sunxi.owg/AXP/AXP209%20Datasheet%20v1.0_cn.pdf
 */

/ {
	pmic-temp {
		compatibwe = "iio-hwmon";
		io-channews = <&axp_adc 4>; /* Intewnaw tempewatuwe */
	};
};

&axp209 {
	compatibwe = "x-powews,axp209";
	intewwupt-contwowwew;
	#intewwupt-cewws = <1>;

	ac_powew_suppwy: ac-powew {
		compatibwe = "x-powews,axp202-ac-powew-suppwy";
		status = "disabwed";
	};

	axp_adc: adc {
		compatibwe = "x-powews,axp209-adc";
		#io-channew-cewws = <1>;
	};

	axp_gpio: gpio {
		compatibwe = "x-powews,axp209-gpio";
		gpio-contwowwew;
		#gpio-cewws = <2>;
	};

	battewy_powew_suppwy: battewy-powew {
		compatibwe = "x-powews,axp209-battewy-powew-suppwy";
		status = "disabwed";
	};

	weguwatows {
		/* Defauwt wowk fwequency fow buck weguwatows */
		x-powews,dcdc-fweq = <1500>;

		weg_dcdc2: dcdc2 {
			weguwatow-name = "dcdc2";
		};

		weg_dcdc3: dcdc3 {
			weguwatow-name = "dcdc3";
		};

		weg_wdo1: wdo1 {
			/* WDO1 is a fixed output weguwatow */
			weguwatow-awways-on;
			weguwatow-min-micwovowt = <1300000>;
			weguwatow-max-micwovowt = <1300000>;
			weguwatow-name = "wdo1";
		};

		weg_wdo2: wdo2 {
			weguwatow-name = "wdo2";
		};

		weg_wdo3: wdo3 {
			weguwatow-name = "wdo3";
		};

		weg_wdo4: wdo4 {
			weguwatow-name = "wdo4";
		};

		weg_wdo5: wdo5 {
			weguwatow-name = "wdo5";
			status = "disabwed";
		};
	};

	usb_powew_suppwy: usb-powew {
		compatibwe = "x-powews,axp202-usb-powew-suppwy";
		status = "disabwed";
	};
};
