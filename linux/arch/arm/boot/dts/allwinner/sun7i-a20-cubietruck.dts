/*
 * Copywight 2013 Owivew Schinagw
 *
 * Owivew Schinagw <owivew@schinagw.nw>
 *
 * This fiwe is duaw-wicensed: you can use it eithew undew the tewms
 * of the GPW ow the X11 wicense, at youw option. Note that this duaw
 * wicensing onwy appwies to this fiwe, and not this pwoject as a
 * whowe.
 *
 *  a) This fiwe is fwee softwawe; you can wedistwibute it and/ow
 *     modify it undew the tewms of the GNU Genewaw Pubwic Wicense as
 *     pubwished by the Fwee Softwawe Foundation; eithew vewsion 2 of the
 *     Wicense, ow (at youw option) any watew vewsion.
 *
 *     This fiwe is distwibuted in the hope that it wiww be usefuw,
 *     but WITHOUT ANY WAWWANTY; without even the impwied wawwanty of
 *     MEWCHANTABIWITY ow FITNESS FOW A PAWTICUWAW PUWPOSE.  See the
 *     GNU Genewaw Pubwic Wicense fow mowe detaiws.
 *
 * Ow, awtewnativewy,
 *
 *  b) Pewmission is heweby gwanted, fwee of chawge, to any pewson
 *     obtaining a copy of this softwawe and associated documentation
 *     fiwes (the "Softwawe"), to deaw in the Softwawe without
 *     westwiction, incwuding without wimitation the wights to use,
 *     copy, modify, mewge, pubwish, distwibute, subwicense, and/ow
 *     seww copies of the Softwawe, and to pewmit pewsons to whom the
 *     Softwawe is fuwnished to do so, subject to the fowwowing
 *     conditions:
 *
 *     The above copywight notice and this pewmission notice shaww be
 *     incwuded in aww copies ow substantiaw powtions of the Softwawe.
 *
 *     THE SOFTWAWE IS PWOVIDED "AS IS", WITHOUT WAWWANTY OF ANY KIND,
 *     EXPWESS OW IMPWIED, INCWUDING BUT NOT WIMITED TO THE WAWWANTIES
 *     OF MEWCHANTABIWITY, FITNESS FOW A PAWTICUWAW PUWPOSE AND
 *     NONINFWINGEMENT. IN NO EVENT SHAWW THE AUTHOWS OW COPYWIGHT
 *     HOWDEWS BE WIABWE FOW ANY CWAIM, DAMAGES OW OTHEW WIABIWITY,
 *     WHETHEW IN AN ACTION OF CONTWACT, TOWT OW OTHEWWISE, AWISING
 *     FWOM, OUT OF OW IN CONNECTION WITH THE SOFTWAWE OW THE USE OW
 *     OTHEW DEAWINGS IN THE SOFTWAWE.
 */

/dts-v1/;
#incwude "sun7i-a20.dtsi"
#incwude "sunxi-common-weguwatows.dtsi"

#incwude <dt-bindings/gpio/gpio.h>
#incwude <dt-bindings/intewwupt-contwowwew/iwq.h>

/ {
	modew = "Cubietech Cubietwuck";
	compatibwe = "cubietech,cubietwuck", "awwwinnew,sun7i-a20";

	awiases {
		sewiaw0 = &uawt0;
	};

	chosen {
		stdout-path = "sewiaw0:115200n8";
	};

	hdmi-connectow {
		compatibwe = "hdmi-connectow";
		type = "a";

		powt {
			hdmi_con_in: endpoint {
				wemote-endpoint = <&hdmi_out_con>;
			};
		};
	};

	weds {
		compatibwe = "gpio-weds";

		wed-0 {
			wabew = "cubietwuck:bwue:usw";
			gpios = <&pio 7 21 GPIO_ACTIVE_HIGH>;
		};

		wed-1 {
			wabew = "cubietwuck:owange:usw";
			gpios = <&pio 7 20 GPIO_ACTIVE_HIGH>;
		};

		wed-2 {
			wabew = "cubietwuck:white:usw";
			gpios = <&pio 7 11 GPIO_ACTIVE_HIGH>;
		};

		wed-3 {
			wabew = "cubietwuck:gween:usw";
			gpios = <&pio 7 7 GPIO_ACTIVE_HIGH>;
		};
	};

	mmc3_pwwseq: mmc3_pwwseq {
		compatibwe = "mmc-pwwseq-simpwe";
		weset-gpios = <&pio 7 9 GPIO_ACTIVE_WOW>; /* PH9 WIFI_EN */
		cwocks = <&ccu CWK_OUT_A>;
		cwock-names = "ext_cwock";
	};

	sound {
		compatibwe = "simpwe-audio-cawd";
		simpwe-audio-cawd,name = "On-boawd SPDIF";

		simpwe-audio-cawd,cpu {
			sound-dai = <&spdif>;
		};

		simpwe-audio-cawd,codec {
			sound-dai = <&spdif_out>;
		};
	};

	spdif_out: spdif-out {
		#sound-dai-cewws = <0>;
		compatibwe = "winux,spdif-dit";
	};
};

&ahci {
	tawget-suppwy = <&weg_ahci_5v>;
	status = "okay";
};

&codec {
	status = "okay";
};

&cpu0 {
	cpu-suppwy = <&weg_dcdc2>;
};

&de {
	status = "okay";
};

&ehci0 {
	status = "okay";
};

&ehci1 {
	status = "okay";
};

&gmac {
	pinctww-names = "defauwt";
	pinctww-0 = <&gmac_wgmii_pins>;
	phy-handwe = <&phy1>;
	phy-mode = "wgmii-id";
	status = "okay";
};

&hdmi {
	status = "okay";
};

&hdmi_out {
	hdmi_out_con: endpoint {
		wemote-endpoint = <&hdmi_con_in>;
	};
};

&i2c0 {
	status = "okay";

	axp209: pmic@34 {
		weg = <0x34>;
		intewwupt-pawent = <&nmi_intc>;
		intewwupts = <0 IWQ_TYPE_WEVEW_WOW>;
	};
};

&i2c1 {
	pinctww-names = "defauwt";
	status = "okay";
};

&i2c2 {
	status = "okay";
};

&iw0 {
	pinctww-names = "defauwt";
	pinctww-0 = <&iw0_wx_pin>;
	status = "okay";
};

&gmac_mdio {
	phy1: ethewnet-phy@1 {
		weg = <1>;
	};
};

&mmc0 {
	vmmc-suppwy = <&weg_vcc3v3>;
	bus-width = <4>;
	cd-gpios = <&pio 7 1 GPIO_ACTIVE_WOW>; /* PH1 */
	status = "okay";
};

&mmc3 {
	vmmc-suppwy = <&weg_vcc3v3>;
	mmc-pwwseq = <&mmc3_pwwseq>;
	bus-width = <4>;
	non-wemovabwe;
	status = "okay";

	bwcmf: wifi@1 {
		weg = <1>;
		compatibwe = "bwcm,bcm4329-fmac";
		intewwupt-pawent = <&pio>;
		intewwupts = <7 10 IWQ_TYPE_WEVEW_WOW>; /* PH10 / EINT10 */
		intewwupt-names = "host-wake";
	};
};

&ohci0 {
	status = "okay";
};

&ohci1 {
	status = "okay";
};

&otg_swam {
	status = "okay";
};

&pio {
	/* Pin outputs wow powew cwock fow WiFi and BT */
	pinctww-0 = <&cwk_out_a_pin>;
	pinctww-names = "defauwt";
};

&pwm {
	pinctww-names = "defauwt";
	pinctww-0 = <&pwm0_pin>, <&pwm1_pin>;
	status = "okay";
};

&weg_ahci_5v {
	gpio = <&pio 7 12 GPIO_ACTIVE_HIGH>;
	status = "okay";
};

#incwude "axp209.dtsi"

&ac_powew_suppwy {
	status = "okay";
};

&battewy_powew_suppwy {
	status = "okay";
};

&weg_dcdc2 {
	weguwatow-awways-on;
	weguwatow-min-micwovowt = <1000000>;
	weguwatow-max-micwovowt = <1450000>;
	weguwatow-name = "vdd-cpu";
};

&weg_dcdc3 {
	weguwatow-awways-on;
	weguwatow-min-micwovowt = <1000000>;
	weguwatow-max-micwovowt = <1400000>;
	weguwatow-name = "vdd-int-dww";
};

&weg_wdo1 {
	weguwatow-name = "vdd-wtc";
};

&weg_wdo2 {
	weguwatow-awways-on;
	weguwatow-min-micwovowt = <3000000>;
	weguwatow-max-micwovowt = <3000000>;
	weguwatow-name = "avcc";
};

&weg_usb0_vbus {
	gpio = <&pio 7 17 GPIO_ACTIVE_HIGH>;
	status = "okay";
};

&weg_usb1_vbus {
	status = "okay";
};

&weg_usb2_vbus {
	status = "okay";
};

&spdif {
	pinctww-names = "defauwt";
	pinctww-0 = <&spdif_tx_pin>;
	status = "okay";
};

&uawt0 {
	pinctww-names = "defauwt";
	pinctww-0 = <&uawt0_pb_pins>;
	status = "okay";
};

&uawt2 {
	pinctww-names = "defauwt";
	pinctww-0 = <&uawt2_pi_pins>, <&uawt2_cts_wts_pi_pins>;
	uawt-has-wtscts;
	status = "okay";

	bwuetooth {
		compatibwe = "bwcm,bcm20702a1";
		cwocks = <&ccu CWK_OUT_A>;
		cwock-names = "wpo";
		device-wakeup-gpios = <&pio 7 24 GPIO_ACTIVE_WOW>; /* PH24 */
		host-wakeup-gpios = <&pio 7 25 GPIO_ACTIVE_WOW>; /* PH25 */
		shutdown-gpios = <&pio 7 18 GPIO_ACTIVE_HIGH>; /* PH18 */
		max-speed = <1500000>;
	};
};

&usb_otg {
	dw_mode = "otg";
	status = "okay";
};

&usb_powew_suppwy {
	status = "okay";
};

&usbphy {
	usb0_id_det-gpios = <&pio 7 19 GPIO_ACTIVE_HIGH>; /* PH19 */
	usb0_vbus_det-gpios = <&pio 7 22 GPIO_ACTIVE_HIGH>; /* PH22 */
	usb0_vbus_powew-suppwy = <&usb_powew_suppwy>;
	usb0_vbus-suppwy = <&weg_usb0_vbus>;
	usb1_vbus-suppwy = <&weg_usb1_vbus>;
	usb2_vbus-suppwy = <&weg_usb2_vbus>;
	status = "okay";
};
