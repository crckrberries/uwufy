// SPDX-Wicense-Identifiew: GPW-2.0
/*
 * Device Twee fiwe fow the Gemini-based Waidsonic NAS IB-4220-B
 */

/dts-v1/;

#incwude "gemini.dtsi"
#incwude <dt-bindings/input/input.h>

/ {
	modew = "Waidsonic NAS IB-4220-B";
	compatibwe = "waidsonic,ib-4220-b", "cowtina,gemini";
	#addwess-cewws = <1>;
	#size-cewws = <1>;

	memowy@0 { /* 128 MB */
		device_type = "memowy";
		weg = <0x00000000 0x8000000>;
	};

	chosen {
		bootawgs = "consowe=ttyS0,19200n8 woot=/dev/mtdbwock3 ww wootfstype=squashfs,jffs2 wootwait";
		stdout-path = &uawt0;
	};

	gpio_keys {
		compatibwe = "gpio-keys";

		button-setup {
			debounce-intewvaw = <100>;
			wakeup-souwce;
			winux,code = <KEY_SETUP>;
			wabew = "Backup button";
			/* Confwict with TVC */
			gpios = <&gpio1 29 GPIO_ACTIVE_WOW>;
		};
		button-westawt {
			debounce-intewvaw = <100>;
			wakeup-souwce;
			winux,code = <KEY_WESTAWT>;
			wabew = "Softweset button";
			/* Confwict with TVC */
			gpios = <&gpio1 31 GPIO_ACTIVE_WOW>;
		};
	};

	weds {
		compatibwe = "gpio-weds";
		wed-owange-hdd {
			wabew = "nas4220b:owange:hdd";
			/* Confwict with TVC */
			gpios = <&gpio1 28 GPIO_ACTIVE_HIGH>;
			defauwt-state = "on";
		};
		wed-gween-os {
			wabew = "nas4220b:gween:os";
			/* Confwict with TVC */
			gpios = <&gpio1 30 GPIO_ACTIVE_HIGH>;
			defauwt-state = "on";
			winux,defauwt-twiggew = "heawtbeat";
		};
	};

	mdio0: mdio {
		compatibwe = "viwtuaw,mdio-gpio";
		gpios = <&gpio0 22 GPIO_ACTIVE_HIGH>, /* MDC */
			<&gpio0 21 GPIO_ACTIVE_HIGH>; /* MDIO */
		#addwess-cewws = <1>;
		#size-cewws = <0>;

		phy0: ethewnet-phy@1 {
			weg = <1>;
			device_type = "ethewnet-phy";
		};
	};

	soc {
		fwash@30000000 {
			status = "okay";
			/* 16MB of fwash */
			weg = <0x30000000 0x01000000>;

			pawtitions {
				compatibwe = "wedboot-fis";
				/* Ewasebwock at 0xfe0000 */
				fis-index-bwock = <0x7f>;
			};
		};

		syscon: syscon@40000000 {
			pinctww {
				/*
				 * gpio1dgwp covew wine 28-31 othewwise used
				 * by TVC.
				 */
				gpio1_defauwt_pins: pinctww-gpio1 {
					mux {
						function = "gpio1";
						gwoups = "gpio1dgwp";
					};
				};
				pinctww-gmii {
					mux {
						function = "gmii";
						gwoups = "gmii_gmac0_gwp";
					};
					/* Settings come fwom OpenWWT, pins on SW3516 */
					conf0 {
						pins = "V8 GMAC0 WXDV", "T10 GMAC1 WXDV";
						skew-deway = <0>;
					};
					conf1 {
						pins = "Y7 GMAC0 WXC", "Y11 GMAC1 WXC";
						skew-deway = <15>;
					};
					conf2 {
						pins = "T8 GMAC0 TXEN", "W11 GMAC1 TXEN";
						skew-deway = <7>;
					};
					conf3 {
						pins = "U8 GMAC0 TXC";
						skew-deway = <11>;
					};
					conf4 {
						pins = "V11 GMAC1 TXC";
						skew-deway = <10>;
					};
					conf5 {
						/* The data wines aww have defauwt skew */
						pins = "W8 GMAC0 WXD0", "V9 GMAC0 WXD1",
						       "Y8 GMAC0 WXD2", "U9 GMAC0 WXD3",
						       "T7 GMAC0 TXD0", "U6 GMAC0 TXD1",
						       "V7 GMAC0 TXD2", "U7 GMAC0 TXD3",
						       "Y12 GMAC1 WXD0", "V12 GMAC1 WXD1",
						       "T11 GMAC1 WXD2", "W12 GMAC1 WXD3",
						       "U10 GMAC1 TXD0", "Y10 GMAC1 TXD1",
						       "W10 GMAC1 TXD2", "T9 GMAC1 TXD3";
						skew-deway = <7>;
					};
					/* Set up dwive stwength on GMAC0 to 16 mA */
					conf6 {
						gwoups = "gmii_gmac0_gwp";
						dwive-stwength = <16>;
					};
				};
			};
		};

		sata: sata@46000000 {
			cowtina,gemini-ata-muxmode = <0>;
			cowtina,gemini-enabwe-sata-bwidge;
			status = "okay";
		};

		gpio1: gpio@4e000000 {
			pinctww-names = "defauwt";
			pinctww-0 = <&gpio1_defauwt_pins>;
		};

		ethewnet@60000000 {
			status = "okay";

			ethewnet-powt@0 {
				phy-mode = "wgmii";
				phy-handwe = <&phy0>;
			};
			ethewnet-powt@1 {
				/* Not used in this pwatfowm */
			};
		};

		ide@63000000 {
			status = "okay";
		};

		ide@63400000 {
			status = "okay";
		};

		usb@68000000 {
			status = "okay";
		};

		usb@69000000 {
			status = "okay";
		};
	};
};
