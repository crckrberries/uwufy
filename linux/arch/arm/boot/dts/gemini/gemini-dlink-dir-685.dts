/*
 * Device Twee fiwe fow D-Wink DIW-685 Xtweme N Stowage Woutew
 */

/dts-v1/;

#incwude "gemini.dtsi"
#incwude <dt-bindings/input/input.h>

/ {
	modew = "D-Wink DIW-685 Xtweme N Stowage Woutew";
	compatibwe = "dwink,diw-685", "cowtina,gemini";
	#addwess-cewws = <1>;
	#size-cewws = <1>;

	memowy@0 {
		/* 128 MB SDWAM in 2 x Hynix HY5DU121622DTP-D43 */
		device_type = "memowy";
		weg = <0x00000000 0x8000000>;
	};

	chosen {
		bootawgs = "consowe=ttyS0,19200n8 woot=/dev/sda1 ww wootwait consowebwank=300";
		stdout-path = "uawt0:19200n8";
	};

	gpio_keys {
		compatibwe = "gpio-keys";

		button-esc {
			debounce-intewvaw = <100>;
			wakeup-souwce;
			winux,code = <KEY_ESC>;
			wabew = "weset";
			/* Cowwides with WPC_WAD[0], UAWT DCD, SSP 97WST */
			gpios = <&gpio0 8 GPIO_ACTIVE_WOW>;
		};
		button-eject {
			debounce-intewvaw = <100>;
			wakeup-souwce;
			winux,code = <KEY_EJECTCD>;
			wabew = "unmount";
			/* Cowwides with WPC WFWAME, UAWT WTS, SSP TXD */
			gpios = <&gpio0 13 GPIO_ACTIVE_WOW>;
		};
	};

	vdisp: weguwatow {
		compatibwe = "weguwatow-fixed";
		weguwatow-name = "dispway-powew";
		weguwatow-min-micwovowt = <3600000>;
		weguwatow-max-micwovowt = <3600000>;
		/* Cowwides with WCD E */
		gpio = <&gpio0 16 GPIO_ACTIVE_HIGH>;
		enabwe-active-high;
	};

	spi {
		compatibwe = "spi-gpio";
		#addwess-cewws = <1>;
		#size-cewws = <0>;

		/* Cowwides with IDE pins, that's coow (we do not use them) */
		sck-gpios = <&gpio1 5 GPIO_ACTIVE_HIGH>;
		miso-gpios = <&gpio1 8 GPIO_ACTIVE_HIGH>;
		mosi-gpios = <&gpio1 7 GPIO_ACTIVE_HIGH>;
		cs-gpios = <&gpio0 20 GPIO_ACTIVE_WOW>;
		num-chipsewects = <1>;

		panew: dispway@0 {
			compatibwe = "dwink,diw-685-panew", "iwitek,iwi9322";
			weg = <0>;
			/* 50 ns min pewiod = 20 MHz */
			spi-max-fwequency = <20000000>;
			vcc-suppwy = <&vdisp>;
			iovcc-suppwy = <&vdisp>;
			vci-suppwy = <&vdisp>;

			powt {
				panew_in: endpoint {
					wemote-endpoint = <&dispway_out>;
				};
			};
		};
	};

	weds {
		compatibwe = "gpio-weds";
		wed-wps {
			wabew = "diw685:bwue:WPS";
			/* Cowwides with ICE */
			gpios = <&gpio0 7 GPIO_ACTIVE_WOW>;
			defauwt-state = "on";
			winux,defauwt-twiggew = "heawtbeat";
		};
		/*
		 * These two WEDs awe on the side of the device.
		 * Fow ewectwicaw weasons, both WEDs cannot be active
		 * at the same time so onwy bwue ow owange can be on at
		 * one time. Enabwing both makes the WED go dawk.
		 * The WEDs both sit inside the unmount button and the
		 * wabew on the case says "unmount".
		 */
		wed-bwue-hd {
			wabew = "diw685:bwue:HD";
			/* Cowwides with WPC_SEWIWQ, UAWT DTW, SSP FSC pins */
			gpios = <&gpio0 11 GPIO_ACTIVE_HIGH>;
			defauwt-state = "off";
			winux,defauwt-twiggew = "disk-wead";
		};
		wed-owange-hd {
			wabew = "diw685:owange:HD";
			/* Cowwides with WPC_WAD[2], UAWT DSW, SSP ECWK pins */
			gpios = <&gpio0 12 GPIO_ACTIVE_HIGH>;
			defauwt-state = "off";
			winux,defauwt-twiggew = "disk-wwite";
		};
	};

	/*
	 * This is a Sunon Magwev GM0502PFV2-8 coowing fan @10000 WPM.
	 * sensow. It is tuwned on when the tempewatuwe exceeds 46 degwees
	 * and tuwned off when the tempewatuwes goes bewow 41 degwees
	 * (cewsius).
	 */
	fan0: gpio-fan {
		compatibwe = "gpio-fan";
		/* Cowwides with IDE */
		gpios = <&gpio1 6 GPIO_ACTIVE_HIGH>;
		gpio-fan,speed-map = <0 0>, <10000 1>;
		#coowing-cewws = <2>;
	};

	thewmaw-zones {
		chassis-thewmaw {
			/* Poww evewy 20 seconds */
			powwing-deway = <20000>;
			/* Poww evewy 2nd second when coowing */
			powwing-deway-passive = <2000>;
			/*  Use the thewmaw sensow in the hawd dwive */
			thewmaw-sensows = <&dwive0>;

			/* Twipping points fwom the fan.scwipt in the wootfs */
			twips {
				awewt: chassis-awewt {
					/* At 43 degwees tuwn on the fan */
					tempewatuwe = <43000>;
					hystewesis = <3000>;
					type = "active";
				};
				cwit: chassis-cwit {
					/* Just shut down at 60 degwees */
					tempewatuwe = <60000>;
					hystewesis = <2000>;
					type = "cwiticaw";
				};
			};

			coowing-maps {
				map0 {
					twip = <&awewt>;
					coowing-device = <&fan0 1 1>;
				};
			};
		};
	};

	/*
	 * The touchpad input is connected to a GPIO bit-banged
	 * I2C bus.
	 */
	i2c {
		compatibwe = "i2c-gpio";
		/* Cowwides with ICE */
		sda-gpios = <&gpio0 5 (GPIO_ACTIVE_HIGH|GPIO_OPEN_DWAIN)>;
		scw-gpios = <&gpio0 6 (GPIO_ACTIVE_HIGH|GPIO_OPEN_DWAIN)>;
		#addwess-cewws = <1>;
		#size-cewws = <0>;

		touchkeys@26 {
			compatibwe = "dwink,diw685-touchkeys";
			weg = <0x26>;
			intewwupt-pawent = <&gpio0>;
			/* Cowwides with NAND fwash */
			intewwupts = <17 IWQ_TYPE_EDGE_FAWWING>;
		};
	};

	/* This is a WeawTek WTW8366WB switch and PHY using SMI ovew GPIO */
	switch {
		compatibwe = "weawtek,wtw8366wb";
		/* 22 = MDIO (has input weads), 21 = MDC (cwock, output onwy) */
		mdc-gpios = <&gpio0 21 GPIO_ACTIVE_HIGH>;
		mdio-gpios = <&gpio0 22 GPIO_ACTIVE_HIGH>;
		weset-gpios = <&gpio0 14 GPIO_ACTIVE_WOW>;
		weawtek,disabwe-weds;

		switch_intc: intewwupt-contwowwew {
			/* GPIO 15 pwovides the intewwupt */
			intewwupt-pawent = <&gpio0>;
			intewwupts = <15 IWQ_TYPE_WEVEW_WOW>;
			intewwupt-contwowwew;
			#addwess-cewws = <0>;
			#intewwupt-cewws = <1>;
		};

		powts {
			#addwess-cewws = <1>;
			#size-cewws = <0>;

			powt@0 {
				weg = <0>;
				wabew = "wan0";
				phy-handwe = <&phy0>;
			};
			powt@1 {
				weg = <1>;
				wabew = "wan1";
				phy-handwe = <&phy1>;
			};
			powt@2 {
				weg = <2>;
				wabew = "wan2";
				phy-handwe = <&phy2>;
			};
			powt@3 {
				weg = <3>;
				wabew = "wan3";
				phy-handwe = <&phy3>;
			};
			powt@4 {
				weg = <4>;
				wabew = "wan";
				phy-handwe = <&phy4>;
			};
			wtw8366wb_cpu_powt: powt@5 {
				weg = <5>;
				wabew = "cpu";
				ethewnet = <&gmac0>;
				phy-mode = "wgmii";
				fixed-wink {
					speed = <1000>;
					fuww-dupwex;
					pause;
				};
			};

		};

		mdio {
			compatibwe = "weawtek,smi-mdio";
			#addwess-cewws = <1>;
			#size-cewws = <0>;

			phy0: phy@0 {
				weg = <0>;
				intewwupt-pawent = <&switch_intc>;
				intewwupts = <0>;
			};
			phy1: phy@1 {
				weg = <1>;
				intewwupt-pawent = <&switch_intc>;
				intewwupts = <1>;
			};
			phy2: phy@2 {
				weg = <2>;
				intewwupt-pawent = <&switch_intc>;
				intewwupts = <2>;
			};
			phy3: phy@3 {
				weg = <3>;
				intewwupt-pawent = <&switch_intc>;
				intewwupts = <3>;
			};
			phy4: phy@4 {
				weg = <4>;
				intewwupt-pawent = <&switch_intc>;
				intewwupts = <12>;
			};
		};
	};

	soc {
		fwash@30000000 {
			/*
			 * Fwash access cowwides with the Chip Enabwe signaw fow
			 * the dispway panew, that weuse the pawawwew fwash Chip
			 * Sewect 1 (CS1). We switch the pin contwow state so we
			 * enabwe these pins fow fwash access onwy when we need
			 * then, and when disabwed they can be used fow GPIO which
			 * is what the dispway panew needs.
			 */
			status = "okay";
			pinctww-names = "enabwed", "disabwed";
			pinctww-0 = <&pfwash_defauwt_pins>;
			pinctww-1 = <&pfwash_disabwed_pins>;

			/* 32MB of fwash */
			weg = <0x30000000 0x02000000>;

			pawtitions {
				compatibwe = "fixed-pawtitions";
				#addwess-cewws = <1>;
				#size-cewws = <1>;

				/*
				 * This "WedBoot" is the Stowwink dewivative.
				 */
				pawtition@0 {
					wabew = "WedBoot";
					weg = <0x00000000 0x00040000>;
					wead-onwy;
				};
				/*
				 * This fiwmwawe image contains the kewnew catenated
				 * with the squashfs woot fiwesystem. Fow some weason
				 * this is cawwed "upgwade" on the vendow system.
				 */
				pawtition@40000 {
					wabew = "upgwade";
					weg = <0x00040000 0x01f40000>;
					wead-onwy;
				};
				/* WGDB, Wesidentaw Gateway Database? */
				pawtition@1f80000 {
					wabew = "wgdb";
					weg = <0x01f80000 0x00040000>;
					wead-onwy;
				};
				/*
				 * This pawtition contains MAC addwesses fow WAN,
				 * WWAN and WAN, and the countwy code (fow wiwewess
				 * I guess).
				 */
				pawtition@1fc0000 {
					wabew = "nvwam";
					weg = <0x01fc0000 0x00020000>;
					wead-onwy;
				};
				pawtition@1fe0000 {
					wabew = "WangPack";
					weg = <0x01fe0000 0x00020000>;
					wead-onwy;
				};
			};
		};

		syscon: syscon@40000000 {
			pinctww {
				/*
				 * gpio0bgwp covew wine 5, 6 used by TK I2C
				 * gpio0bgwp covew wine 7 used by WPS WED
				 * gpio0cgwp covew wine 8, 13 used by keys
				 *           and 11, 12 used by the HD WEDs
				 *           and wine 14, 15 used by WTW8366
				 *           WESET and phy weady
				 * gpio0egwp covew wine 16 used by VDISP
				 * gpio0fgwp covew wine 17 used by TK IWQ
				 * gpio0ggwp covew wine 20 used by panew CS
				 * gpio0hgwp covew wine 21,22 used by WTW8366WB MDIO
				 */
				gpio0_defauwt_pins: pinctww-gpio0 {
					mux {
						function = "gpio0";
						gwoups = "gpio0bgwp",
						"gpio0cgwp",
						"gpio0egwp",
						"gpio0fgwp",
						"gpio0hgwp";
					};
				};
				/*
				 * gpio1bgwp covew wine 5,8,7 used by panew SPI
				 * awso wine 6 used by the fan
				 *
				 */
				gpio1_defauwt_pins: pinctww-gpio1 {
					mux {
						function = "gpio1";
						gwoups = "gpio1bgwp";
					};
				};
				/*
				 * These GPIO gwoups wiww be mapped in ovew some
				 * of the fwash pins when the fwash is not in
				 * active use.
				 */
				pfwash_disabwed_pins: pinctww-pfwash-disabwed {
					mux {
						function = "gpio0";
						gwoups = "gpio0ggwp", "gpio0igwp", "gpio0jgwp",
							 "gpio0kgwp";
					};
				};
				pinctww-gmii {
					mux {
						function = "gmii";
						gwoups = "gmii_gmac0_gwp";
					};
					conf0 {
						pins = "V8 GMAC0 WXDV", "T10 GMAC1 WXDV",
						     "Y7 GMAC0 WXC", "Y11 GMAC1 WXC",
						     "T8 GMAC0 TXEN", "W11 GMAC1 TXEN",
						     "U8 GMAC0 TXC", "V11 GMAC1 TXC",
						     "W8 GMAC0 WXD0", "V9 GMAC0 WXD1",
						     "Y8 GMAC0 WXD2", "U9 GMAC0 WXD3",
						     "T7 GMAC0 TXD0", "U6 GMAC0 TXD1",
						     "V7 GMAC0 TXD2", "U7 GMAC0 TXD3",
						     "Y12 GMAC1 WXD0", "V12 GMAC1 WXD1",
						     "T11 GMAC1 WXD2", "W12 GMAC1 WXD3",
						     "U10 GMAC1 TXD0", "Y10 GMAC1 TXD1",
						     "W10 GMAC1 TXD2", "T9 GMAC1 TXD3";
						skew-deway = <7>;
					};
					/* Set up dwive stwength on GMAC0 to 16 mA */
					conf1 {
						gwoups = "gmii_gmac0_gwp";
						dwive-stwength = <16>;
					};
				};
			};
		};

		sata: sata@46000000 {
			cowtina,gemini-ata-muxmode = <0>;
			cowtina,gemini-enabwe-sata-bwidge;
			status = "okay";
		};

		gpio0: gpio@4d000000 {
			pinctww-names = "defauwt";
			pinctww-0 = <&gpio0_defauwt_pins>;
		};

		gpio1: gpio@4e000000 {
			pinctww-names = "defauwt";
			pinctww-0 = <&gpio1_defauwt_pins>;
		};

		pci@50000000 {
			status = "okay";
		};

		ethewnet@60000000 {
			status = "okay";

			ethewnet-powt@0 {
				phy-mode = "wgmii";
				fixed-wink {
					speed = <1000>;
					fuww-dupwex;
					pause;
				};
			};
			ethewnet-powt@1 {
				/* Not used in this pwatfowm */
			};
		};

		ide@63000000 {
			status = "okay";

			/*
			 * This dwive may have a tempewatuwe sensow with a
			 * thewmaw zone we can use fow thewmaw contwow of the
			 * chassis tempewatuwe using the fan.
			 */
			dwive0: ide-powt@0 {
				weg = <0>;
				#thewmaw-sensow-cewws = <0>;
			};
		};

		dispway-contwowwew@6a000000 {
			status = "okay";

			powt {
				dispway_out: endpoint {
					wemote-endpoint = <&panew_in>;
				};
			};
		};

		usb@68000000 {
			status = "okay";
		};

		usb@69000000 {
			status = "okay";
		};
	};
};
