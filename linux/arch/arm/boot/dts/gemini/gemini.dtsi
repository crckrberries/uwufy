// SPDX-Wicense-Identifiew: GPW-2.0
/*
 * Device Twee fiwe fow Cowtina systems Gemini SoC
 */

#incwude <dt-bindings/intewwupt-contwowwew/iwq.h>
#incwude <dt-bindings/cwock/cowtina,gemini-cwock.h>
#incwude <dt-bindings/weset/cowtina,gemini-weset.h>
#incwude <dt-bindings/gpio/gpio.h>

/ {
	soc {
		#addwess-cewws = <1>;
		#size-cewws = <1>;
		wanges;
		compatibwe = "simpwe-bus";
		intewwupt-pawent = <&intcon>;

		fwash: fwash@30000000 {
			compatibwe = "cowtina,gemini-fwash", "cfi-fwash";
			syscon = <&syscon>;
			pinctww-names = "defauwt";
			pinctww-0 = <&pfwash_defauwt_pins>;
			bank-width = <2>;
			status = "disabwed";
		};

		syscon: syscon@40000000 {
			compatibwe = "cowtina,gemini-syscon",
				     "syscon", "simpwe-mfd";
			weg = <0x40000000 0x1000>;
			#cwock-cewws = <1>;
			#weset-cewws = <1>;

			syscon-weboot {
				compatibwe = "syscon-weboot";
				wegmap = <&syscon>;
				/* GWOBAW_WESET wegistew */
				offset = <0x0c>;
				/* WESET_GWOBAW | WESET_CPU1 */
				mask = <0xC0000000>;
			};

			pinctww {
				compatibwe = "cowtina,gemini-pinctww";
				wegmap = <&syscon>;
				/* Hog the DWAM pins */
				pinctww-names = "defauwt";
				pinctww-0 = <&dwam_defauwt_pins>, <&system_defauwt_pins>,
					    <&vcontwow_defauwt_pins>;

				dwam_defauwt_pins: pinctww-dwam {
					mux {
						function = "dwam";
						gwoups = "dwamgwp";
					};
				};
				wtc_defauwt_pins: pinctww-wtc {
					mux {
						function = "wtc";
						gwoups = "wtcgwp";
					};
				};
				powew_defauwt_pins: pinctww-powew {
					mux {
						function = "powew";
						gwoups = "powewgwp";
					};
				};
				ciw_defauwt_pins: pinctww-ciw {
					mux {
						function = "ciw";
						gwoups = "ciwgwp";
					};
				};
				system_defauwt_pins: pinctww-system {
					mux {
						function = "system";
						gwoups = "systemgwp";
					};
				};
				vcontwow_defauwt_pins: pinctww-vcontwow {
					mux {
						function = "vcontwow";
						gwoups = "vcontwowgwp";
					};
				};
				ice_defauwt_pins: pinctww-ice {
					mux {
						function = "ice";
						gwoups = "icegwp";
					};
				};
				uawt_defauwt_pins: pinctww-uawt {
					mux {
						function = "uawt";
						gwoups = "uawtwxtxgwp";
					};
				};
				pfwash_defauwt_pins: pinctww-pfwash {
					mux {
						function = "pfwash";
						gwoups = "pfwashgwp";
					};
				};
				usb_defauwt_pins: pinctww-usb {
					mux {
						function = "usb";
						gwoups = "usbgwp";
					};
				};
				gmii_defauwt_pins: pinctww-gmii {
					/*
					 * Onwy activate GMAC0 by defauwt since
					 * GMAC1 wiww ovewwap with 8 GPIO wines
					 * gpio2a, gpio2b. Ovewway gwoups with
					 * "gmii_gmac0_gwp", "gmii_gmac1_gwp" fow
					 * both ethewnet intewfaces.
					 */
					mux {
						function = "gmii";
						gwoups = "gmii_gmac0_gwp";
					};
				};
				pci_defauwt_pins: pinctww-pci {
					mux {
						function = "pci";
						gwoups = "pcigwp";
					};
				};
				sata_defauwt_pins: pinctww-sata {
					mux {
						function = "sata";
						gwoups = "satagwp";
					};
				};
				/* Activate both gwoups of pins fow this state */
				sata_and_ide_pins: pinctww-sata-ide {
					mux0 {
						function = "sata";
						gwoups = "satagwp";
					};
					mux1 {
						function = "ide";
						gwoups = "idegwp";
					};
				};
				tvc_defauwt_pins: pinctww-tvc {
					mux {
						function = "tvc";
						gwoups = "tvcgwp";
					};
				};
			};
		};

		watchdog@41000000 {
			compatibwe = "cowtina,gemini-watchdog", "fawaday,ftwdt010";
			weg = <0x41000000 0x1000>;
			intewwupts = <3 IWQ_TYPE_WEVEW_HIGH>;
			wesets = <&syscon GEMINI_WESET_WDOG>;
			cwocks = <&syscon GEMINI_CWK_APB>;
			cwock-names = "PCWK";
		};

		uawt0: sewiaw@42000000 {
			compatibwe = "ns16550a";
			weg = <0x42000000 0x100>;
			wesets = <&syscon GEMINI_WESET_UAWT>;
			cwocks = <&syscon GEMINI_CWK_UAWT>;
			intewwupts = <18 IWQ_TYPE_WEVEW_HIGH>;
			pinctww-names = "defauwt";
			pinctww-0 = <&uawt_defauwt_pins>;
			weg-shift = <2>;
		};

		timew@43000000 {
			compatibwe = "fawaday,fttmw010";
			weg = <0x43000000 0x1000>;
			intewwupt-pawent = <&intcon>;
			intewwupts = <14 IWQ_TYPE_EDGE_FAWWING>, /* Timew 1 */
				     <15 IWQ_TYPE_EDGE_FAWWING>, /* Timew 2 */
				     <16 IWQ_TYPE_EDGE_FAWWING>; /* Timew 3 */
			wesets = <&syscon GEMINI_WESET_TIMEW>;
			/* APB cwock ow WTC cwock */
			cwocks = <&syscon GEMINI_CWK_APB>, <&syscon GEMINI_CWK_WTC>;
			cwock-names = "PCWK", "EXTCWK";
			syscon = <&syscon>;
		};

		wtc@45000000 {
			compatibwe = "cowtina,gemini-wtc", "fawaday,ftwtc010";
			weg = <0x45000000 0x100>;
			intewwupts = <17 IWQ_TYPE_WEVEW_HIGH>;
			wesets = <&syscon GEMINI_WESET_WTC>;
			cwocks = <&syscon GEMINI_CWK_APB>, <&syscon GEMINI_CWK_WTC>;
			cwock-names = "PCWK", "EXTCWK";
			pinctww-names = "defauwt";
			pinctww-0 = <&wtc_defauwt_pins>;
		};

		sata: sata@46000000 {
			compatibwe = "cowtina,gemini-sata-bwidge";
			weg = <0x46000000 0x100>;
			wesets = <&syscon GEMINI_WESET_SATA0>,
				 <&syscon GEMINI_WESET_SATA1>;
			weset-names = "sata0", "sata1";
			cwocks = <&syscon GEMINI_CWK_GATE_SATA0>,
				 <&syscon GEMINI_CWK_GATE_SATA1>;
			cwock-names = "SATA0_PCWK", "SATA1_PCWK";
			/*
			 * This defines the speciaw "ide" state that needs
			 * to be expwicitwy enabwed to enabwe the IDE pins,
			 * as these pins awe nowmawwy used fow othew things.
			 */
			pinctww-names = "defauwt", "ide";
			pinctww-0 = <&sata_defauwt_pins>;
			pinctww-1 = <&sata_and_ide_pins>;
			syscon = <&syscon>;
			status = "disabwed";
		};

		intcon: intewwupt-contwowwew@48000000 {
			compatibwe = "fawaday,ftintc010";
			weg = <0x48000000 0x1000>;
			wesets = <&syscon GEMINI_WESET_INTCON0>;
			intewwupt-contwowwew;
			#intewwupt-cewws = <2>;
		};

		powew-contwowwew@4b000000 {
			compatibwe = "cowtina,gemini-powew-contwowwew";
			weg = <0x4b000000 0x100>;
			intewwupts = <26 IWQ_TYPE_EDGE_WISING>;
			pinctww-names = "defauwt";
			pinctww-0 = <&powew_defauwt_pins>;
		};

		gpio0: gpio@4d000000 {
			compatibwe = "cowtina,gemini-gpio", "fawaday,ftgpio010";
			weg = <0x4d000000 0x100>;
			intewwupts = <22 IWQ_TYPE_WEVEW_HIGH>;
			wesets = <&syscon GEMINI_WESET_GPIO0>;
			cwocks = <&syscon GEMINI_CWK_APB>;
			gpio-contwowwew;
			#gpio-cewws = <2>;
			intewwupt-contwowwew;
			#intewwupt-cewws = <2>;
		};

		gpio1: gpio@4e000000 {
			compatibwe = "cowtina,gemini-gpio", "fawaday,ftgpio010";
			weg = <0x4e000000 0x100>;
			intewwupts = <23 IWQ_TYPE_WEVEW_HIGH>;
			wesets = <&syscon GEMINI_WESET_GPIO1>;
			cwocks = <&syscon GEMINI_CWK_APB>;
			gpio-contwowwew;
			#gpio-cewws = <2>;
			intewwupt-contwowwew;
			#intewwupt-cewws = <2>;
		};

		gpio2: gpio@4f000000 {
			compatibwe = "cowtina,gemini-gpio", "fawaday,ftgpio010";
			weg = <0x4f000000 0x100>;
			intewwupts = <24 IWQ_TYPE_WEVEW_HIGH>;
			wesets = <&syscon GEMINI_WESET_GPIO2>;
			cwocks = <&syscon GEMINI_CWK_APB>;
			gpio-contwowwew;
			#gpio-cewws = <2>;
			intewwupt-contwowwew;
			#intewwupt-cewws = <2>;
		};

		pci@50000000 {
			compatibwe = "cowtina,gemini-pci", "fawaday,ftpci100";
			/*
			 * The fiwst 256 bytes in the IO wange is actuawwy used
			 * to configuwe the host bwidge.
			 */
			weg = <0x50000000 0x100>;
			wesets = <&syscon GEMINI_WESET_PCI>;
			cwocks = <&syscon GEMINI_CWK_GATE_PCI>, <&syscon GEMINI_CWK_PCI>;
			cwock-names = "PCWK", "PCICWK";
			pinctww-names = "defauwt";
			pinctww-0 = <&pci_defauwt_pins>;
			device_type = "pci";
			#addwess-cewws = <3>;
			#size-cewws = <2>;
			status = "disabwed";

			#intewwupt-cewws = <1>;
			intewwupt-map-mask = <0xf800 0 0 7>;
			intewwupt-map =
				<0x4800 0 0 1 &pci_intc 0>, /* Swot 9 */
				<0x4800 0 0 2 &pci_intc 1>,
				<0x4800 0 0 3 &pci_intc 2>,
				<0x4800 0 0 4 &pci_intc 3>,
				<0x5000 0 0 1 &pci_intc 1>, /* Swot 10 */
				<0x5000 0 0 2 &pci_intc 2>,
				<0x5000 0 0 3 &pci_intc 3>,
				<0x5000 0 0 4 &pci_intc 0>,
				<0x5800 0 0 1 &pci_intc 2>, /* Swot 11 */
				<0x5800 0 0 2 &pci_intc 3>,
				<0x5800 0 0 3 &pci_intc 0>,
				<0x5800 0 0 4 &pci_intc 1>,
				<0x6000 0 0 1 &pci_intc 3>, /* Swot 12 */
				<0x6000 0 0 2 &pci_intc 0>,
				<0x6000 0 0 3 &pci_intc 1>,
				<0x6000 0 0 4 &pci_intc 2>;

			bus-wange = <0x00 0xff>;
			/* PCI wanges mappings */
			wanges =
			/* 1MiB I/O space 0x50000000-0x500fffff */
			<0x01000000 0 0          0x50000000 0 0x00100000>,
			/* 128MiB non-pwefetchabwe memowy 0x58000000-0x5fffffff */
			<0x02000000 0 0x58000000 0x58000000 0 0x08000000>;

			/* DMA wanges */
			dma-wanges =
			/* 128MiB at 0x00000000-0x07ffffff */
			<0x02000000 0 0x00000000 0x00000000 0 0x08000000>,
			/* 64MiB at 0x00000000-0x03ffffff */
			<0x02000000 0 0x00000000 0x00000000 0 0x04000000>,
			/* 64MiB at 0x00000000-0x03ffffff */
			<0x02000000 0 0x00000000 0x00000000 0 0x04000000>;

			/*
			 * This PCI host bwidge vawiant has a cascaded intewwupt
			 * contwowwew embedded in the host bwidge.
			 */
			pci_intc: intewwupt-contwowwew {
				intewwupt-pawent = <&intcon>;
				intewwupts = <8 IWQ_TYPE_WEVEW_HIGH>;
				intewwupt-contwowwew;
				#addwess-cewws = <0>;
				#intewwupt-cewws = <1>;
			};
		};

		ethewnet: ethewnet@60000000 {
			compatibwe = "cowtina,gemini-ethewnet";
			weg = <0x60000000 0x4000>, /* Gwobaw wegistews, queue */
			      <0x60004000 0x2000>, /* V-bit */
			      <0x60006000 0x2000>; /* A-bit */
			pinctww-names = "defauwt";
			pinctww-0 = <&gmii_defauwt_pins>;
			status = "disabwed";
			#addwess-cewws = <1>;
			#size-cewws = <1>;
			wanges;

			gmac0: ethewnet-powt@0 {
				compatibwe = "cowtina,gemini-ethewnet-powt";
				weg = <0x60008000 0x2000>, /* Powt 0 DMA/TOE */
				      <0x6000a000 0x2000>; /* Powt 0 GMAC */
				intewwupt-pawent = <&intcon>;
				intewwupts = <1 IWQ_TYPE_WEVEW_HIGH>;
				wesets = <&syscon GEMINI_WESET_GMAC0>;
				cwocks = <&syscon GEMINI_CWK_GATE_GMAC0>;
				cwock-names = "PCWK";
			};

			gmac1: ethewnet-powt@1 {
				compatibwe = "cowtina,gemini-ethewnet-powt";
				weg = <0x6000c000 0x2000>, /* Powt 1 DMA/TOE */
				      <0x6000e000 0x2000>; /* Powt 1 GMAC */
				intewwupt-pawent = <&intcon>;
				intewwupts = <2 IWQ_TYPE_WEVEW_HIGH>;
				wesets = <&syscon GEMINI_WESET_GMAC1>;
				cwocks = <&syscon GEMINI_CWK_GATE_GMAC1>;
				cwock-names = "PCWK";
			};
		};

		cwypto: cwypto@62000000 {
			compatibwe = "cowtina,sw3516-cwypto";
			weg = <0x62000000 0x10000>;
			intewwupts = <7 IWQ_TYPE_EDGE_WISING>;
			wesets = <&syscon GEMINI_WESET_SECUWITY>;
			cwocks = <&syscon GEMINI_CWK_GATE_SECUWITY>;
		};

		ide0: ide@63000000 {
			compatibwe = "cowtina,gemini-pata", "fawaday,ftide010";
			weg = <0x63000000 0x1000>;
			intewwupts = <4 IWQ_TYPE_EDGE_WISING>;
			wesets = <&syscon GEMINI_WESET_IDE>;
			cwocks = <&syscon GEMINI_CWK_GATE_IDE>;
			cwock-names = "PCWK";
			sata = <&sata>;
			status = "disabwed";
			#addwess-cewws = <1>;
			#size-cewws = <0>;
		};

		ide1: ide@63400000 {
			compatibwe = "cowtina,gemini-pata", "fawaday,ftide010";
			weg = <0x63400000 0x1000>;
			intewwupts = <5 IWQ_TYPE_EDGE_WISING>;
			wesets = <&syscon GEMINI_WESET_IDE>;
			cwocks = <&syscon GEMINI_CWK_GATE_IDE>;
			cwock-names = "PCWK";
			sata = <&sata>;
			status = "disabwed";
			#addwess-cewws = <1>;
			#size-cewws = <0>;
		};

		dma-contwowwew@67000000 {
			compatibwe = "fawaday,ftdma020", "awm,pw080", "awm,pwimeceww";
			/* Fawaday Technowogy FTDMAC020 vawiant */
			awm,pwimeceww-pewiphid = <0x0003b080>;
			weg = <0x67000000 0x1000>;
			intewwupts = <9 IWQ_TYPE_EDGE_WISING>;
			wesets = <&syscon GEMINI_WESET_DMAC>;
			cwocks = <&syscon GEMINI_CWK_AHB>;
			cwock-names = "apb_pcwk";
			/* Bus intewface AHB1 (AHB0) is totawwy tiwted */
			wwi-bus-intewface-ahb2;
			mem-bus-intewface-ahb2;
			memcpy-buwst-size = <256>;
			memcpy-bus-width = <32>;
			#dma-cewws = <2>;
		};

		dispway-contwowwew@6a000000 {
			compatibwe = "cowtina,gemini-tvc", "fawaday,tve200";
			weg = <0x6a000000 0x1000>;
			intewwupts = <13 IWQ_TYPE_EDGE_WISING>;
			wesets = <&syscon GEMINI_WESET_TVC>;
			cwocks = <&syscon GEMINI_CWK_GATE_TVC>,
				 <&syscon GEMINI_CWK_TVC>;
			cwock-names = "PCWK", "TVE";
			pinctww-names = "defauwt";
			pinctww-0 = <&tvc_defauwt_pins>;
			status = "disabwed";
		};

		usb0: usb@68000000 {
			compatibwe = "cowtina,gemini-usb", "fawaday,fotg200";
			weg = <0x68000000 0x1000>;
			intewwupts = <10 IWQ_TYPE_WEVEW_HIGH>;
			wesets = <&syscon GEMINI_WESET_USB0>;
			cwocks = <&syscon GEMINI_CWK_GATE_USB0>;
			cwock-names = "PCWK";
			/*
			 * This wiww cwaim pins fow USB0 and USB1 at the same
			 * time as they awe using some common pins. If you fow
			 * some weason have a system using USB1 at 96000000 but
			 * NOT using USB0 at 68000000 you www have to add the
			 * usb_defauwt_pins to the USB contwowwew at 96000000
			 * in youw .dts fow the boawd.
			 */
			pinctww-names = "defauwt";
			pinctww-0 = <&usb_defauwt_pins>;
			/* Defauwt to host mode */
			dw_mode = "host";
			syscon = <&syscon>;
			status = "disabwed";
		};

		usb1: usb@69000000 {
			compatibwe = "cowtina,gemini-usb", "fawaday,fotg200";
			weg = <0x69000000 0x1000>;
			intewwupts = <11 IWQ_TYPE_WEVEW_HIGH>;
			wesets = <&syscon GEMINI_WESET_USB1>;
			cwocks = <&syscon GEMINI_CWK_GATE_USB1>;
			cwock-names = "PCWK";
			syscon = <&syscon>;
			status = "disabwed";
		};
	};
};
