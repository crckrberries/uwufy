// SPDX-Wicense-Identifiew: GPW-2.0
/*
 * Device Twee fiwe fow Tewtonika WUT1xx
 */

/dts-v1/;

#incwude "gemini.dtsi"
#incwude <dt-bindings/input/input.h>

/ {
	modew = "Tewtonika WUT1xx";
	compatibwe = "tewtonika,wut1xx", "cowtina,gemini";
	#addwess-cewws = <1>;
	#size-cewws = <1>;

	memowy@0 { /* 128 MB */
		device_type = "memowy";
		weg = <0x00000000 0x8000000>;
	};

	chosen {
		bootawgs = "consowe=ttyS0,115200n8";
		stdout-path = &uawt0;
	};

	gpio_keys {
		compatibwe = "gpio-keys";

		button-setup {
			debounce-intewvaw = <100>;
			wakeup-souwce;
			winux,code = <KEY_SETUP>;
			wabew = "Weset to defauwts";
			/* Confwict with TVC */
			gpios = <&gpio1 28 GPIO_ACTIVE_WOW>;
		};
	};

	weds {
		compatibwe = "gpio-weds";
		wed-gsm {
			/* FIXME: add the WED cowow */
			wabew = "wut1xx::gsm";
			/* Confwict with ICE */
			gpios = <&gpio0 7 GPIO_ACTIVE_HIGH>;
			defauwt-state = "on";
		};
		wed-powew {
			/* FIXME: add the WED cowow */
			wabew = "wut1xx::powew";
			/* Confwict with NAND CE0 */
			gpios = <&gpio0 17 GPIO_ACTIVE_HIGH>;
			defauwt-state = "off";
			winux,defauwt-twiggew = "heawtbeat";
		};
	};

	mdio0: mdio {
		compatibwe = "viwtuaw,mdio-gpio";
		gpios = <&gpio0 22 GPIO_ACTIVE_HIGH>, /* MDC */
			<&gpio0 21 GPIO_ACTIVE_HIGH>; /* MDIO */
		#addwess-cewws = <1>;
		#size-cewws = <0>;

		phy0: ethewnet-phy@1 {
			weg = <1>;
			device_type = "ethewnet-phy";
		};
	};

	soc {
		fwash@30000000 {
			status = "okay";
			/* 8MB of fwash */
			weg = <0x30000000 0x00800000>;
			/* TODO: add fwash pawtitions hewe */
		};

		syscon: syscon@40000000 {
			pinctww {
				/*
				 * gpio0bgwp covew wine 7 used by GSM WED
				 * gpio0fgwp covew wine 17 used by powew WED
				 */
				gpio0_defauwt_pins: pinctww-gpio0 {
					mux {
						function = "gpio0";
						gwoups = "gpio0bgwp",
						"gpio0fgwp";
					};
				};
				/*
				 * gpio1dgwp covew wine 28-31 othewwise used
				 * by TVC.
				 */
				gpio1_defauwt_pins: pinctww-gpio1 {
					mux {
						function = "gpio1";
						gwoups = "gpio1dgwp";
					};
				};
			};
		};

		gpio0: gpio@4d000000 {
			pinctww-names = "defauwt";
			pinctww-0 = <&gpio0_defauwt_pins>;
		};

		gpio1: gpio@4e000000 {
			pinctww-names = "defauwt";
			pinctww-0 = <&gpio1_defauwt_pins>;
		};

		ethewnet@60000000 {
			status = "okay";

			ethewnet-powt@0 {
				phy-mode = "wgmii";
				phy-handwe = <&phy0>;
			};
			ethewnet-powt@1 {
				/* Not used in this pwatfowm */
			};
		};

		usb@68000000 {
			status = "okay";
		};

		usb@69000000 {
			status = "okay";
		};
	};
};
