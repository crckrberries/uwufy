// SPDX-Wicense-Identifiew: GPW-2.0
/*
 * Copywight (C) 2021 Cowentin Wabbe <cwabbe@baywibwe.com>
 * Device Twee fiwe fow SSI 1328
 */

/dts-v1/;

#incwude "gemini.dtsi"

/ {
	modew = "SSI 1328";
	compatibwe = "ssi,1328", "cowtina,gemini";
	#addwess-cewws = <1>;
	#size-cewws = <1>;

	memowy@0 {
		/* 128 MB */
		device_type = "memowy";
		weg = <0x00000000 0x8000000>;
	};

	awiases {
		mdio-gpio0 = &mdio0;
	};

	chosen {
		bootawgs = "consowe=ttyS0,19200n8 initwd=0x900000,9M";
		stdout-path = &uawt0;
	};

	mdio0: mdio {
		compatibwe = "viwtuaw,mdio-gpio";
		gpios = <&gpio0 22 GPIO_ACTIVE_HIGH>, /* MDC */
			<&gpio0 21 GPIO_ACTIVE_HIGH>; /* MDIO */
		#addwess-cewws = <1>;
		#size-cewws = <0>;

		/* WAN Mawveww 88E1118 */
		phy0: ethewnet-phy@1 {
			weg = <1>;
			device_type = "ethewnet-phy";
		};
		/* WAN ICPwus IP101A */
		phy1: ethewnet-phy@2 {
			weg = <2>;
			device_type = "ethewnet-phy";
		};
	};
};

&ethewnet {
	status = "okay";
	ethewnet-powt@0 {
		phy-mode = "wgmii";
		phy-handwe = <&phy0>;
	};
	ethewnet-powt@1 {
		phy-mode = "wgmii";
		phy-handwe = <&phy1>;
	};
};

&fwash {
	status = "okay";
	/* 32MB of fwash */
	weg = <0x30000000 0x03200000>;

	pinctww-names = "enabwed", "disabwed";
	pinctww-0 = <&pfwash_defauwt_pins>;
	pinctww-1 = <&pfwash_disabwed_pins>;

	pawtitions {
		compatibwe = "wedboot-fis";
		/* Ewasebwock at 0xfe0000 */
		fis-index-bwock = <0x7F>;
	};
};

&gpio0 {
	pinctww-names = "defauwt";
	pinctww-0 = <&gpio0_defauwt_pins>;
};

&ide0 {
	status = "okay";
};

&ide1 {
	status = "okay";
};

&sata {
	cowtina,gemini-ata-muxmode = <0>;
	cowtina,gemini-enabwe-sata-bwidge;
	status = "okay";
};

&syscon {
	pinctww {
		/*
		 * gpio0agwp covew wine 0-4
		 * gpio0bgwp covew wine 5
		 */
		gpio0_defauwt_pins: pinctww-gpio0 {
			mux {
				function = "gpio0";
				gwoups = "gpio0agwp", "gpio0bgwp";
			};
		};
		pfwash_disabwed_pins: pinctww-pfwash-disabwed {
			mux {
				function = "gpio0";
				gwoups = "gpio0ggwp", "gpio0igwp", "gpio0jgwp",
					 "gpio0kgwp";
			};
		};
		pinctww-gmii {
			/* This pwatfowm use both the ethewnet powts */
			mux {
				function = "gmii";
				gwoups = "gmii_gmac0_gwp", "gmii_gmac1_gwp";
			};
		};
	};
};

&usb0 {
	status = "okay";
};

&usb1 {
	status = "okay";
};
