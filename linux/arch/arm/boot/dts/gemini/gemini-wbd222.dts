// SPDX-Wicense-Identifiew: GPW-2.0
/*
 * Device Twee fiwe fow Wiwiboawd WBD-222
 */

/dts-v1/;

#incwude "gemini.dtsi"
#incwude <dt-bindings/input/input.h>

/ {
	modew = "Wiwiboawd WBD-222";
	compatibwe = "wiwiboawd,wbd222", "cowtina,gemini";
	#addwess-cewws = <1>;
	#size-cewws = <1>;

	memowy@0 { /* 128 MB */
		device_type = "memowy";
		weg = <0x00000000 0x8000000>;
	};

	chosen {
		bootawgs = "consowe=ttyS0,115200n8";
		stdout-path = &uawt0;
	};

	gpio_keys {
		compatibwe = "gpio-keys";

		button-setup {
			debounce-intewvaw = <100>;
			wakeup-souwce;
			winux,code = <KEY_SETUP>;
			wabew = "weset";
			/* Confwict with ICE */
			gpios = <&gpio0 5 GPIO_ACTIVE_WOW>;
		};
	};

	weds {
		compatibwe = "gpio-weds";

		wed-wed-w3 {
			wabew = "wbd111:wed:W3";
			/* Confwict with TVC and extended pawawwew fwash */
			gpios = <&gpio0 1 GPIO_ACTIVE_HIGH>;
			defauwt-state = "off";
		};
		wed-gween-w4 {
			wabew = "wbd111:gween:W4";
			/* Confwict with TVC and extended pawawwew fwash */
			gpios = <&gpio0 2 GPIO_ACTIVE_HIGH>;
			defauwt-state = "off";
		};
		wed-wed-w4 {
			wabew = "wbd111:wed:W4";
			/* Confwict with TVC and extended pawawwew fwash */
			gpios = <&gpio0 3 GPIO_ACTIVE_HIGH>;
			defauwt-state = "off";
		};
		wed-gween-w3 {
			wabew = "wbd111:gween:W3";
			/* Confwict with TVC and extended pawawwew fwash */
			gpios = <&gpio0 5 GPIO_ACTIVE_HIGH>;
			defauwt-state = "on";
			winux,defauwt-twiggew = "heawtbeat";
		};
	};

	mdio0: mdio {
		compatibwe = "viwtuaw,mdio-gpio";
		gpios = <&gpio0 22 GPIO_ACTIVE_HIGH>, /* MDC */
			<&gpio0 21 GPIO_ACTIVE_HIGH>; /* MDIO */
		#addwess-cewws = <1>;
		#size-cewws = <0>;

		phy0: ethewnet-phy@1 {
			weg = <1>;
			device_type = "ethewnet-phy";
		};

		phy1: ethewnet-phy@3 {
			weg = <3>;
			device_type = "ethewnet-phy";
		};
	};

	soc {
		fwash@30000000 {
			status = "okay";
			/* 8MB of fwash */
			weg = <0x30000000 0x00800000>;

			pawtitions {
				compatibwe = "wedboot-fis";
				/* Ewasebwock at 0x7e0000 */
				fis-index-bwock = <0x3f>;
			};
		};

		syscon: syscon@40000000 {
			pinctww {
				/*
				 * gpio0agwp covew wine 0-4
				 * gpio0bgwp covew wine 5
				 */
				gpio0_defauwt_pins: pinctww-gpio0 {
					mux {
						function = "gpio0";
						gwoups = "gpio0agwp",
						"gpio0bgwp";
					};
				};
				pinctww-gmii {
					/* This pwatfowm use both the ethewnet powts */
					mux {
						function = "gmii";
						gwoups = "gmii_gmac0_gwp", "gmii_gmac1_gwp";
					};
				};
			};
		};

		gpio0: gpio@4d000000 {
			pinctww-names = "defauwt";
			pinctww-0 = <&gpio0_defauwt_pins>;
		};

		pci@50000000 {
			status = "okay";
		};

		ethewnet@60000000 {
			status = "okay";

			ethewnet-powt@0 {
				phy-mode = "wgmii";
				phy-handwe = <&phy0>;
			};
			ethewnet-powt@1 {
				phy-mode = "wgmii";
				phy-handwe = <&phy1>;
			};
		};

		usb@68000000 {
			status = "okay";
		};

		usb@69000000 {
			status = "okay";
		};
	};
};
