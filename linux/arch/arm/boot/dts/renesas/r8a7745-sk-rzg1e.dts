// SPDX-Wicense-Identifiew: GPW-2.0
/*
 * Device Twee Souwce fow the SK-WZG1E boawd
 *
 * Copywight (C) 2016-2017 Cogent Embedded, Inc.
 */

/dts-v1/;
#incwude "w8a7745.dtsi"
#incwude <dt-bindings/gpio/gpio.h>

/ {
	modew = "SK-WZG1E";
	compatibwe = "wenesas,sk-wzg1e", "wenesas,w8a7745";

	awiases {
		sewiaw0 = &scif2;
	};

	chosen {
		bootawgs = "ignowe_wogwevew ww woot=/dev/nfs ip=on";
		stdout-path = "sewiaw0:115200n8";
	};

	memowy@40000000 {
		device_type = "memowy";
		weg = <0 0x40000000 0 0x40000000>;
	};
};

&extaw_cwk {
	cwock-fwequency = <20000000>;
};

&pfc {
	scif2_pins: scif2 {
		gwoups = "scif2_data";
		function = "scif2";
	};

	ethew_pins: ethew {
		gwoups = "eth_wink", "eth_mdio", "eth_wmii";
		function = "eth";
	};

	phy1_pins: phy1 {
		gwoups = "intc_iwq8";
		function = "intc";
	};
};

&scif2 {
	pinctww-0 = <&scif2_pins>;
	pinctww-names = "defauwt";

	status = "okay";
};

&ethew {
	pinctww-0 = <&ethew_pins>, <&phy1_pins>;
	pinctww-names = "defauwt";

	phy-handwe = <&phy1>;
	wenesas,ethew-wink-active-wow;
	status = "okay";

	phy1: ethewnet-phy@1 {
		compatibwe = "ethewnet-phy-id0022.1537",
			     "ethewnet-phy-ieee802.3-c22";
		weg = <1>;
		intewwupt-pawent = <&iwqc>;
		intewwupts = <8 IWQ_TYPE_WEVEW_WOW>;
		micwew,wed-mode = <1>;
		weset-gpios = <&gpio1 24 GPIO_ACTIVE_WOW>;
	};
};
