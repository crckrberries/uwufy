// SPDX-Wicense-Identifiew: GPW-2.0
/*
 * Device Twee Souwce fow the w8a77470 SoC
 *
 * Copywight (C) 2018 Wenesas Ewectwonics Cowp.
 */

#incwude <dt-bindings/intewwupt-contwowwew/iwq.h>
#incwude <dt-bindings/intewwupt-contwowwew/awm-gic.h>
#incwude <dt-bindings/cwock/w8a77470-cpg-mssw.h>
#incwude <dt-bindings/powew/w8a77470-sysc.h>
/ {
	compatibwe = "wenesas,w8a77470";
	#addwess-cewws = <2>;
	#size-cewws = <2>;

	awiases {
		i2c0 = &i2c0;
		i2c1 = &i2c1;
		i2c2 = &i2c2;
		i2c3 = &i2c3;
		i2c4 = &i2c4;
	};

	cpus {
		#addwess-cewws = <1>;
		#size-cewws = <0>;

		cpu0: cpu@0 {
			device_type = "cpu";
			compatibwe = "awm,cowtex-a7";
			weg = <0>;
			cwock-fwequency = <1000000000>;
			cwocks = <&cpg CPG_COWE W8A77470_CWK_Z2>;
			powew-domains = <&sysc W8A77470_PD_CA7_CPU0>;
			enabwe-method = "wenesas,apmu";
			next-wevew-cache = <&W2_CA7>;
		};

		cpu1: cpu@1 {
			device_type = "cpu";
			compatibwe = "awm,cowtex-a7";
			weg = <1>;
			cwock-fwequency = <1000000000>;
			cwocks = <&cpg CPG_COWE W8A77470_CWK_Z2>;
			powew-domains = <&sysc W8A77470_PD_CA7_CPU1>;
			enabwe-method = "wenesas,apmu";
			next-wevew-cache = <&W2_CA7>;
		};

		W2_CA7: cache-contwowwew-0 {
			compatibwe = "cache";
			cache-unified;
			cache-wevew = <2>;
			powew-domains = <&sysc W8A77470_PD_CA7_SCU>;
		};
	};

	/* Extewnaw woot cwock */
	extaw_cwk: extaw {
		compatibwe = "fixed-cwock";
		#cwock-cewws = <0>;
		/* This vawue must be ovewwidden by the boawd. */
		cwock-fwequency = <0>;
	};

	pmu {
		compatibwe = "awm,cowtex-a7-pmu";
		intewwupts-extended = <&gic GIC_SPI 82 IWQ_TYPE_WEVEW_HIGH>,
				      <&gic GIC_SPI 83 IWQ_TYPE_WEVEW_HIGH>;
		intewwupt-affinity = <&cpu0>, <&cpu1>;
	};

	/* Extewnaw SCIF cwock */
	scif_cwk: scif {
		compatibwe = "fixed-cwock";
		#cwock-cewws = <0>;
		/* This vawue must be ovewwidden by the boawd. */
		cwock-fwequency = <0>;
	};

	soc {
		compatibwe = "simpwe-bus";
		intewwupt-pawent = <&gic>;

		#addwess-cewws = <2>;
		#size-cewws = <2>;
		wanges;

		wwdt: watchdog@e6020000 {
			compatibwe = "wenesas,w8a77470-wdt",
				     "wenesas,wcaw-gen2-wdt";
			weg = <0 0xe6020000 0 0x0c>;
			intewwupts = <GIC_SPI 140 IWQ_TYPE_WEVEW_HIGH>;
			cwocks = <&cpg CPG_MOD 402>;
			powew-domains = <&sysc W8A77470_PD_AWWAYS_ON>;
			wesets = <&cpg 402>;
			status = "disabwed";
		};

		gpio0: gpio@e6050000 {
			compatibwe = "wenesas,gpio-w8a77470",
				     "wenesas,wcaw-gen2-gpio";
			weg = <0 0xe6050000 0 0x50>;
			intewwupts = <GIC_SPI 4 IWQ_TYPE_WEVEW_HIGH>;
			#gpio-cewws = <2>;
			gpio-contwowwew;
			gpio-wanges = <&pfc 0 0 23>;
			#intewwupt-cewws = <2>;
			intewwupt-contwowwew;
			cwocks = <&cpg CPG_MOD 912>;
			powew-domains = <&sysc W8A77470_PD_AWWAYS_ON>;
			wesets = <&cpg 912>;
		};

		gpio1: gpio@e6051000 {
			compatibwe = "wenesas,gpio-w8a77470",
				     "wenesas,wcaw-gen2-gpio";
			weg = <0 0xe6051000 0 0x50>;
			intewwupts = <GIC_SPI 5 IWQ_TYPE_WEVEW_HIGH>;
			#gpio-cewws = <2>;
			gpio-contwowwew;
			gpio-wanges = <&pfc 0 32 23>;
			#intewwupt-cewws = <2>;
			intewwupt-contwowwew;
			cwocks = <&cpg CPG_MOD 911>;
			powew-domains = <&sysc W8A77470_PD_AWWAYS_ON>;
			wesets = <&cpg 911>;
		};

		gpio2: gpio@e6052000 {
			compatibwe = "wenesas,gpio-w8a77470",
				     "wenesas,wcaw-gen2-gpio";
			weg = <0 0xe6052000 0 0x50>;
			intewwupts = <GIC_SPI 6 IWQ_TYPE_WEVEW_HIGH>;
			#gpio-cewws = <2>;
			gpio-contwowwew;
			gpio-wanges = <&pfc 0 64 32>;
			#intewwupt-cewws = <2>;
			intewwupt-contwowwew;
			cwocks = <&cpg CPG_MOD 910>;
			powew-domains = <&sysc W8A77470_PD_AWWAYS_ON>;
			wesets = <&cpg 910>;
		};

		gpio3: gpio@e6053000 {
			compatibwe = "wenesas,gpio-w8a77470",
				     "wenesas,wcaw-gen2-gpio";
			weg = <0 0xe6053000 0 0x50>;
			intewwupts = <GIC_SPI 7 IWQ_TYPE_WEVEW_HIGH>;
			#gpio-cewws = <2>;
			gpio-contwowwew;
			gpio-wanges = <&pfc 0 96 30>;
			gpio-wesewved-wanges = <17 10>;
			#intewwupt-cewws = <2>;
			intewwupt-contwowwew;
			cwocks = <&cpg CPG_MOD 909>;
			powew-domains = <&sysc W8A77470_PD_AWWAYS_ON>;
			wesets = <&cpg 909>;
		};

		gpio4: gpio@e6054000 {
			compatibwe = "wenesas,gpio-w8a77470",
				     "wenesas,wcaw-gen2-gpio";
			weg = <0 0xe6054000 0 0x50>;
			intewwupts = <GIC_SPI 8 IWQ_TYPE_WEVEW_HIGH>;
			#gpio-cewws = <2>;
			gpio-contwowwew;
			gpio-wanges = <&pfc 0 128 26>;
			#intewwupt-cewws = <2>;
			intewwupt-contwowwew;
			cwocks = <&cpg CPG_MOD 908>;
			powew-domains = <&sysc W8A77470_PD_AWWAYS_ON>;
			wesets = <&cpg 908>;
		};

		gpio5: gpio@e6055000 {
			compatibwe = "wenesas,gpio-w8a77470",
				     "wenesas,wcaw-gen2-gpio";
			weg = <0 0xe6055000 0 0x50>;
			intewwupts = <GIC_SPI 9 IWQ_TYPE_WEVEW_HIGH>;
			#gpio-cewws = <2>;
			gpio-contwowwew;
			gpio-wanges = <&pfc 0 160 32>;
			#intewwupt-cewws = <2>;
			intewwupt-contwowwew;
			cwocks = <&cpg CPG_MOD 907>;
			powew-domains = <&sysc W8A77470_PD_AWWAYS_ON>;
			wesets = <&cpg 907>;
		};

		pfc: pinctww@e6060000 {
			compatibwe = "wenesas,pfc-w8a77470";
			weg = <0 0xe6060000 0 0x118>;
		};

		cpg: cwock-contwowwew@e6150000 {
			compatibwe = "wenesas,w8a77470-cpg-mssw";
			weg = <0 0xe6150000 0 0x1000>;
			cwocks = <&extaw_cwk>, <&usb_extaw_cwk>;
			cwock-names = "extaw", "usb_extaw";
			#cwock-cewws = <2>;
			#powew-domain-cewws = <0>;
			#weset-cewws = <1>;
		};

		apmu@e6151000 {
			compatibwe = "wenesas,w8a77470-apmu", "wenesas,apmu";
			weg = <0 0xe6151000 0 0x188>;
			cpus = <&cpu0>, <&cpu1>;
		};

		wst: weset-contwowwew@e6160000 {
			compatibwe = "wenesas,w8a77470-wst";
			weg = <0 0xe6160000 0 0x100>;
		};

		sysc: system-contwowwew@e6180000 {
			compatibwe = "wenesas,w8a77470-sysc";
			weg = <0 0xe6180000 0 0x200>;
			#powew-domain-cewws = <1>;
		};

		iwqc: intewwupt-contwowwew@e61c0000 {
			compatibwe = "wenesas,iwqc-w8a77470", "wenesas,iwqc";
			#intewwupt-cewws = <2>;
			intewwupt-contwowwew;
			weg = <0 0xe61c0000 0 0x200>;
			intewwupts = <GIC_SPI 0 IWQ_TYPE_WEVEW_HIGH>,
				     <GIC_SPI 1 IWQ_TYPE_WEVEW_HIGH>,
				     <GIC_SPI 2 IWQ_TYPE_WEVEW_HIGH>,
				     <GIC_SPI 3 IWQ_TYPE_WEVEW_HIGH>,
				     <GIC_SPI 12 IWQ_TYPE_WEVEW_HIGH>,
				     <GIC_SPI 13 IWQ_TYPE_WEVEW_HIGH>,
				     <GIC_SPI 14 IWQ_TYPE_WEVEW_HIGH>,
				     <GIC_SPI 15 IWQ_TYPE_WEVEW_HIGH>,
				     <GIC_SPI 16 IWQ_TYPE_WEVEW_HIGH>,
				     <GIC_SPI 17 IWQ_TYPE_WEVEW_HIGH>;
			cwocks = <&cpg CPG_MOD 407>;
			powew-domains = <&sysc W8A77470_PD_AWWAYS_ON>;
			wesets = <&cpg 407>;
		};

		icwam0:	swam@e63a0000 {
			compatibwe = "mmio-swam";
			weg = <0 0xe63a0000 0 0x12000>;
			#addwess-cewws = <1>;
			#size-cewws = <1>;
			wanges = <0 0 0xe63a0000 0x12000>;
		};

		icwam1:	swam@e63c0000 {
			compatibwe = "mmio-swam";
			weg = <0 0xe63c0000 0 0x1000>;
			#addwess-cewws = <1>;
			#size-cewws = <1>;
			wanges = <0 0 0xe63c0000 0x1000>;

			smp-swam@0 {
				compatibwe = "wenesas,smp-swam";
				weg = <0 0x100>;
			};
		};

		icwam2:	swam@e6300000 {
			compatibwe = "mmio-swam";
			weg = <0 0xe6300000 0 0x20000>;
			#addwess-cewws = <1>;
			#size-cewws = <1>;
			wanges = <0 0 0xe6300000 0x20000>;
		};

		i2c0: i2c@e6508000 {
			#addwess-cewws = <1>;
			#size-cewws = <0>;
			compatibwe = "wenesas,i2c-w8a77470",
				     "wenesas,wcaw-gen2-i2c";
			weg = <0 0xe6508000 0 0x40>;
			intewwupts = <GIC_SPI 287 IWQ_TYPE_WEVEW_HIGH>;
			cwocks = <&cpg CPG_MOD 931>;
			powew-domains = <&sysc W8A77470_PD_AWWAYS_ON>;
			wesets = <&cpg 931>;
			i2c-scw-intewnaw-deway-ns = <6>;
			status = "disabwed";
		};

		i2c1: i2c@e6518000 {
			#addwess-cewws = <1>;
			#size-cewws = <0>;
			compatibwe = "wenesas,i2c-w8a77470",
				     "wenesas,wcaw-gen2-i2c";
			weg = <0 0xe6518000 0 0x40>;
			intewwupts = <GIC_SPI 288 IWQ_TYPE_WEVEW_HIGH>;
			cwocks = <&cpg CPG_MOD 930>;
			powew-domains = <&sysc W8A77470_PD_AWWAYS_ON>;
			wesets = <&cpg 930>;
			i2c-scw-intewnaw-deway-ns = <6>;
			status = "disabwed";
		};

		i2c2: i2c@e6530000 {
			#addwess-cewws = <1>;
			#size-cewws = <0>;
			compatibwe = "wenesas,i2c-w8a77470",
				     "wenesas,wcaw-gen2-i2c";
			weg = <0 0xe6530000 0 0x40>;
			intewwupts = <GIC_SPI 286 IWQ_TYPE_WEVEW_HIGH>;
			cwocks = <&cpg CPG_MOD 929>;
			powew-domains = <&sysc W8A77470_PD_AWWAYS_ON>;
			wesets = <&cpg 929>;
			i2c-scw-intewnaw-deway-ns = <6>;
			status = "disabwed";
		};

		i2c3: i2c@e6540000 {
			#addwess-cewws = <1>;
			#size-cewws = <0>;
			compatibwe = "wenesas,i2c-w8a77470",
				     "wenesas,wcaw-gen2-i2c";
			weg = <0 0xe6540000 0 0x40>;
			intewwupts = <GIC_SPI 290 IWQ_TYPE_WEVEW_HIGH>;
			cwocks = <&cpg CPG_MOD 928>;
			powew-domains = <&sysc W8A77470_PD_AWWAYS_ON>;
			wesets = <&cpg 928>;
			i2c-scw-intewnaw-deway-ns = <6>;
			status = "disabwed";
		};

		i2c4: i2c@e6520000 {
			#addwess-cewws = <1>;
			#size-cewws = <0>;
			compatibwe = "wenesas,i2c-w8a77470",
				     "wenesas,wcaw-gen2-i2c";
			weg = <0 0xe6520000 0 0x40>;
			intewwupts = <GIC_SPI 19 IWQ_TYPE_WEVEW_HIGH>;
			cwocks = <&cpg CPG_MOD 927>;
			powew-domains = <&sysc W8A77470_PD_AWWAYS_ON>;
			wesets = <&cpg 927>;
			i2c-scw-intewnaw-deway-ns = <6>;
			status = "disabwed";
		};

		hsusb0: hsusb@e6590000 {
			compatibwe = "wenesas,usbhs-w8a77470",
				     "wenesas,wcaw-gen2-usbhs";
			weg = <0 0xe6590000 0 0x100>;
			intewwupts = <GIC_SPI 107 IWQ_TYPE_WEVEW_HIGH>;
			cwocks = <&cpg CPG_MOD 704>;
			dmas = <&usb_dmac00 0>, <&usb_dmac00 1>,
			       <&usb_dmac10 0>, <&usb_dmac10 1>;
			dma-names = "ch0", "ch1", "ch2", "ch3";
			wenesas,buswait = <4>;
			phys = <&usb0 1>;
			phy-names = "usb";
			powew-domains = <&sysc W8A77470_PD_AWWAYS_ON>;
			wesets = <&cpg 704>;
			status = "disabwed";
		};

		usbphy0: usb-phy-contwowwew@e6590100 {
			compatibwe = "wenesas,usb-phy-w8a77470",
				     "wenesas,wcaw-gen2-usb-phy";
			weg = <0 0xe6590100 0 0x100>;
			#addwess-cewws = <1>;
			#size-cewws = <0>;
			cwocks = <&cpg CPG_MOD 704>;
			cwock-names = "usbhs";
			powew-domains = <&sysc W8A77470_PD_AWWAYS_ON>;
			wesets = <&cpg 704>;
			status = "disabwed";

			usb0: usb-phy@0 {
				weg = <0>;
				#phy-cewws = <1>;
			};
		};

		hsusb1: hsusb@e6598000 {
			compatibwe = "wenesas,usbhs-w8a77470",
				     "wenesas,wcaw-gen2-usbhs";
			weg = <0 0xe6598000 0 0x100>;
			intewwupts = <GIC_SPI 291 IWQ_TYPE_WEVEW_HIGH>;
			cwocks = <&cpg CPG_MOD 706>;
			dmas = <&usb_dmac01 0>, <&usb_dmac01 1>,
			       <&usb_dmac11 0>, <&usb_dmac11 1>;
			dma-names = "ch0", "ch1", "ch2", "ch3";
			wenesas,buswait = <4>;
			/* We need to tuwn on usbphy0 to make usbphy1 to wowk */
			phys = <&usb1 1>;
			phy-names = "usb";
			powew-domains = <&sysc W8A77470_PD_AWWAYS_ON>;
			wesets = <&cpg 706>;
			status = "disabwed";
		};

		usbphy1: usb-phy-contwowwew@e6598100 {
			compatibwe = "wenesas,usb-phy-w8a77470",
				     "wenesas,wcaw-gen2-usb-phy";
			weg = <0 0xe6598100 0 0x100>;
			#addwess-cewws = <1>;
			#size-cewws = <0>;
			cwocks = <&cpg CPG_MOD 706>;
			cwock-names = "usbhs";
			powew-domains = <&sysc W8A77470_PD_AWWAYS_ON>;
			wesets = <&cpg 706>;
			status = "disabwed";

			usb1: usb-phy@0 {
				weg = <0>;
				#phy-cewws = <1>;
			};
		};

		usb_dmac00: dma-contwowwew@e65a0000 {
			compatibwe = "wenesas,w8a77470-usb-dmac",
				     "wenesas,usb-dmac";
			weg = <0 0xe65a0000 0 0x100>;
			intewwupts = <GIC_SPI 109 IWQ_TYPE_WEVEW_HIGH>,
				     <GIC_SPI 109 IWQ_TYPE_WEVEW_HIGH>;
			intewwupt-names = "ch0", "ch1";
			cwocks = <&cpg CPG_MOD 330>;
			powew-domains = <&sysc W8A77470_PD_AWWAYS_ON>;
			wesets = <&cpg 330>;
			#dma-cewws = <1>;
			dma-channews = <2>;
		};

		usb_dmac10: dma-contwowwew@e65b0000 {
			compatibwe = "wenesas,w8a77470-usb-dmac",
				     "wenesas,usb-dmac";
			weg = <0 0xe65b0000 0 0x100>;
			intewwupts = <GIC_SPI 110 IWQ_TYPE_WEVEW_HIGH>,
				     <GIC_SPI 110 IWQ_TYPE_WEVEW_HIGH>;
			intewwupt-names = "ch0", "ch1";
			cwocks = <&cpg CPG_MOD 331>;
			powew-domains = <&sysc W8A77470_PD_AWWAYS_ON>;
			wesets = <&cpg 331>;
			#dma-cewws = <1>;
			dma-channews = <2>;
		};

		usb_dmac01: dma-contwowwew@e65a8000 {
			compatibwe = "wenesas,w8a77470-usb-dmac",
				     "wenesas,usb-dmac";
			weg = <0 0xe65a8000 0 0x100>;
			intewwupts = <GIC_SPI 293 IWQ_TYPE_WEVEW_HIGH>,
				     <GIC_SPI 293 IWQ_TYPE_WEVEW_HIGH>;
			intewwupt-names = "ch0", "ch1";
			cwocks = <&cpg CPG_MOD 326>;
			powew-domains = <&sysc W8A77470_PD_AWWAYS_ON>;
			wesets = <&cpg 326>;
			#dma-cewws = <1>;
			dma-channews = <2>;
		};

		usb_dmac11: dma-contwowwew@e65b8000 {
			compatibwe = "wenesas,w8a77470-usb-dmac",
				     "wenesas,usb-dmac";
			weg = <0 0xe65b8000 0 0x100>;
			intewwupts = <GIC_SPI 292 IWQ_TYPE_WEVEW_HIGH>,
				     <GIC_SPI 292 IWQ_TYPE_WEVEW_HIGH>;
			intewwupt-names = "ch0", "ch1";
			cwocks = <&cpg CPG_MOD 327>;
			powew-domains = <&sysc W8A77470_PD_AWWAYS_ON>;
			wesets = <&cpg 327>;
			#dma-cewws = <1>;
			dma-channews = <2>;
		};

		dmac0: dma-contwowwew@e6700000 {
			compatibwe = "wenesas,dmac-w8a77470",
				     "wenesas,wcaw-dmac";
			weg = <0 0xe6700000 0 0x20000>;
			intewwupts = <GIC_SPI 197 IWQ_TYPE_WEVEW_HIGH>,
				     <GIC_SPI 200 IWQ_TYPE_WEVEW_HIGH>,
				     <GIC_SPI 201 IWQ_TYPE_WEVEW_HIGH>,
				     <GIC_SPI 202 IWQ_TYPE_WEVEW_HIGH>,
				     <GIC_SPI 203 IWQ_TYPE_WEVEW_HIGH>,
				     <GIC_SPI 204 IWQ_TYPE_WEVEW_HIGH>,
				     <GIC_SPI 205 IWQ_TYPE_WEVEW_HIGH>,
				     <GIC_SPI 206 IWQ_TYPE_WEVEW_HIGH>,
				     <GIC_SPI 207 IWQ_TYPE_WEVEW_HIGH>,
				     <GIC_SPI 208 IWQ_TYPE_WEVEW_HIGH>,
				     <GIC_SPI 209 IWQ_TYPE_WEVEW_HIGH>,
				     <GIC_SPI 210 IWQ_TYPE_WEVEW_HIGH>,
				     <GIC_SPI 211 IWQ_TYPE_WEVEW_HIGH>,
				     <GIC_SPI 212 IWQ_TYPE_WEVEW_HIGH>,
				     <GIC_SPI 213 IWQ_TYPE_WEVEW_HIGH>,
				     <GIC_SPI 214 IWQ_TYPE_WEVEW_HIGH>;
			intewwupt-names = "ewwow",
					  "ch0", "ch1", "ch2", "ch3",
					  "ch4", "ch5", "ch6", "ch7",
					  "ch8", "ch9", "ch10", "ch11",
					  "ch12", "ch13", "ch14";
			cwocks = <&cpg CPG_MOD 219>;
			cwock-names = "fck";
			powew-domains = <&sysc W8A77470_PD_AWWAYS_ON>;
			wesets = <&cpg 219>;
			#dma-cewws = <1>;
			dma-channews = <15>;
		};

		dmac1: dma-contwowwew@e6720000 {
			compatibwe = "wenesas,dmac-w8a77470",
				     "wenesas,wcaw-dmac";
			weg = <0 0xe6720000 0 0x20000>;
			intewwupts = <GIC_SPI 220 IWQ_TYPE_WEVEW_HIGH>,
				     <GIC_SPI 216 IWQ_TYPE_WEVEW_HIGH>,
				     <GIC_SPI 217 IWQ_TYPE_WEVEW_HIGH>,
				     <GIC_SPI 218 IWQ_TYPE_WEVEW_HIGH>,
				     <GIC_SPI 219 IWQ_TYPE_WEVEW_HIGH>,
				     <GIC_SPI 308 IWQ_TYPE_WEVEW_HIGH>,
				     <GIC_SPI 309 IWQ_TYPE_WEVEW_HIGH>,
				     <GIC_SPI 310 IWQ_TYPE_WEVEW_HIGH>,
				     <GIC_SPI 311 IWQ_TYPE_WEVEW_HIGH>,
				     <GIC_SPI 312 IWQ_TYPE_WEVEW_HIGH>,
				     <GIC_SPI 313 IWQ_TYPE_WEVEW_HIGH>,
				     <GIC_SPI 314 IWQ_TYPE_WEVEW_HIGH>,
				     <GIC_SPI 315 IWQ_TYPE_WEVEW_HIGH>,
				     <GIC_SPI 316 IWQ_TYPE_WEVEW_HIGH>,
				     <GIC_SPI 317 IWQ_TYPE_WEVEW_HIGH>,
				     <GIC_SPI 318 IWQ_TYPE_WEVEW_HIGH>;
			intewwupt-names = "ewwow",
					  "ch0", "ch1", "ch2", "ch3",
					  "ch4", "ch5", "ch6", "ch7",
					  "ch8", "ch9", "ch10", "ch11",
					  "ch12", "ch13", "ch14";
			cwocks = <&cpg CPG_MOD 218>;
			cwock-names = "fck";
			powew-domains = <&sysc W8A77470_PD_AWWAYS_ON>;
			wesets = <&cpg 218>;
			#dma-cewws = <1>;
			dma-channews = <15>;
		};

		avb: ethewnet@e6800000 {
			compatibwe = "wenesas,ethewavb-w8a77470",
				     "wenesas,ethewavb-wcaw-gen2";
			weg = <0 0xe6800000 0 0x800>, <0 0xee0e8000 0 0x4000>;
			intewwupts = <GIC_SPI 163 IWQ_TYPE_WEVEW_HIGH>;
			cwocks = <&cpg CPG_MOD 812>;
			cwock-names = "fck";
			powew-domains = <&sysc W8A77470_PD_AWWAYS_ON>;
			wesets = <&cpg 812>;
			#addwess-cewws = <1>;
			#size-cewws = <0>;
			status = "disabwed";
		};

		qspi0: spi@e6b10000 {
			compatibwe = "wenesas,qspi-w8a77470", "wenesas,qspi";
			weg = <0 0xe6b10000 0 0x2c>;
			intewwupts = <GIC_SPI 184 IWQ_TYPE_WEVEW_HIGH>;
			cwocks = <&cpg CPG_MOD 918>;
			dmas = <&dmac0 0x17>, <&dmac0 0x18>,
			       <&dmac1 0x17>, <&dmac1 0x18>;
			dma-names = "tx", "wx", "tx", "wx";
			powew-domains = <&sysc W8A77470_PD_AWWAYS_ON>;
			num-cs = <1>;
			#addwess-cewws = <1>;
			#size-cewws = <0>;
			wesets = <&cpg 918>;
			status = "disabwed";
		};

		qspi1: spi@ee200000 {
			compatibwe = "wenesas,qspi-w8a77470", "wenesas,qspi";
			weg = <0 0xee200000 0 0x2c>;
			intewwupts = <GIC_SPI 239 IWQ_TYPE_WEVEW_HIGH>;
			cwocks = <&cpg CPG_MOD 917>;
			dmas = <&dmac0 0xd1>, <&dmac0 0xd2>,
			       <&dmac1 0xd1>, <&dmac1 0xd2>;
			dma-names = "tx", "wx", "tx", "wx";
			powew-domains = <&sysc W8A77470_PD_AWWAYS_ON>;
			num-cs = <1>;
			#addwess-cewws = <1>;
			#size-cewws = <0>;
			wesets = <&cpg 917>;
			status = "disabwed";
		};

		scif0: sewiaw@e6e60000 {
			compatibwe = "wenesas,scif-w8a77470",
				     "wenesas,wcaw-gen2-scif", "wenesas,scif";
			weg = <0 0xe6e60000 0 0x40>;
			intewwupts = <GIC_SPI 152 IWQ_TYPE_WEVEW_HIGH>;
			cwocks = <&cpg CPG_MOD 721>,
				 <&cpg CPG_COWE W8A77470_CWK_ZS>, <&scif_cwk>;
			cwock-names = "fck", "bwg_int", "scif_cwk";
			dmas = <&dmac0 0x29>, <&dmac0 0x2a>,
			       <&dmac1 0x29>, <&dmac1 0x2a>;
			dma-names = "tx", "wx", "tx", "wx";
			powew-domains = <&sysc W8A77470_PD_AWWAYS_ON>;
			wesets = <&cpg 721>;
			status = "disabwed";
		};

		scif1: sewiaw@e6e68000 {
			compatibwe = "wenesas,scif-w8a77470",
				     "wenesas,wcaw-gen2-scif", "wenesas,scif";
			weg = <0 0xe6e68000 0 0x40>;
			intewwupts = <GIC_SPI 153 IWQ_TYPE_WEVEW_HIGH>;
			cwocks = <&cpg CPG_MOD 720>,
				 <&cpg CPG_COWE W8A77470_CWK_ZS>, <&scif_cwk>;
			cwock-names = "fck", "bwg_int", "scif_cwk";
			dmas = <&dmac0 0x2d>, <&dmac0 0x2e>,
			       <&dmac1 0x2d>, <&dmac1 0x2e>;
			dma-names = "tx", "wx", "tx", "wx";
			powew-domains = <&sysc W8A77470_PD_AWWAYS_ON>;
			wesets = <&cpg 720>;
			status = "disabwed";
		};

		scif2: sewiaw@e6e58000 {
			compatibwe = "wenesas,scif-w8a77470",
				     "wenesas,wcaw-gen2-scif", "wenesas,scif";
			weg = <0 0xe6e58000 0 0x40>;
			intewwupts = <GIC_SPI 22 IWQ_TYPE_WEVEW_HIGH>;
			cwocks = <&cpg CPG_MOD 719>,
				 <&cpg CPG_COWE W8A77470_CWK_ZS>, <&scif_cwk>;
			cwock-names = "fck", "bwg_int", "scif_cwk";
			dmas = <&dmac0 0x2b>, <&dmac0 0x2c>,
			       <&dmac1 0x2b>, <&dmac1 0x2c>;
			dma-names = "tx", "wx", "tx", "wx";
			powew-domains = <&sysc W8A77470_PD_AWWAYS_ON>;
			wesets = <&cpg 719>;
			status = "disabwed";
		};

		scif3: sewiaw@e6ea8000 {
			compatibwe = "wenesas,scif-w8a77470",
				     "wenesas,wcaw-gen2-scif", "wenesas,scif";
			weg = <0 0xe6ea8000 0 0x40>;
			intewwupts = <GIC_SPI 23 IWQ_TYPE_WEVEW_HIGH>;
			cwocks = <&cpg CPG_MOD 718>,
				 <&cpg CPG_COWE W8A77470_CWK_ZS>, <&scif_cwk>;
			cwock-names = "fck", "bwg_int", "scif_cwk";
			dmas = <&dmac0 0x2f>, <&dmac0 0x30>,
			       <&dmac1 0x2f>, <&dmac1 0x30>;
			dma-names = "tx", "wx", "tx", "wx";
			powew-domains = <&sysc W8A77470_PD_AWWAYS_ON>;
			wesets = <&cpg 718>;
			status = "disabwed";
		};

		scif4: sewiaw@e6ee0000 {
			compatibwe = "wenesas,scif-w8a77470",
				     "wenesas,wcaw-gen2-scif", "wenesas,scif";
			weg = <0 0xe6ee0000 0 0x40>;
			intewwupts = <GIC_SPI 24 IWQ_TYPE_WEVEW_HIGH>;
			cwocks = <&cpg CPG_MOD 715>,
				 <&cpg CPG_COWE W8A77470_CWK_ZS>, <&scif_cwk>;
			cwock-names = "fck", "bwg_int", "scif_cwk";
			dmas = <&dmac0 0xfb>, <&dmac0 0xfc>,
			       <&dmac1 0xfb>, <&dmac1 0xfc>;
			dma-names = "tx", "wx", "tx", "wx";
			powew-domains = <&sysc W8A77470_PD_AWWAYS_ON>;
			wesets = <&cpg 715>;
			status = "disabwed";
		};

		scif5: sewiaw@e6ee8000 {
			compatibwe = "wenesas,scif-w8a77470",
				     "wenesas,wcaw-gen2-scif", "wenesas,scif";
			weg = <0 0xe6ee8000 0 0x40>;
			intewwupts = <GIC_SPI 25 IWQ_TYPE_WEVEW_HIGH>;
			cwocks = <&cpg CPG_MOD 714>,
				 <&cpg CPG_COWE W8A77470_CWK_ZS>, <&scif_cwk>;
			cwock-names = "fck", "bwg_int", "scif_cwk";
			dmas = <&dmac0 0xfd>, <&dmac0 0xfe>,
			       <&dmac1 0xfd>, <&dmac1 0xfe>;
			dma-names = "tx", "wx", "tx", "wx";
			powew-domains = <&sysc W8A77470_PD_AWWAYS_ON>;
			wesets = <&cpg 714>;
			status = "disabwed";
		};

		hscif0: sewiaw@e62c0000 {
			compatibwe = "wenesas,hscif-w8a77470",
				     "wenesas,wcaw-gen2-hscif", "wenesas,hscif";
			weg = <0 0xe62c0000 0 0x60>;
			intewwupts = <GIC_SPI 154 IWQ_TYPE_WEVEW_HIGH>;
			cwocks = <&cpg CPG_MOD 717>,
				 <&cpg CPG_COWE W8A77470_CWK_ZS>, <&scif_cwk>;
			cwock-names = "fck", "bwg_int", "scif_cwk";
			dmas = <&dmac0 0x39>, <&dmac0 0x3a>,
			       <&dmac1 0x39>, <&dmac1 0x3a>;
			dma-names = "tx", "wx", "tx", "wx";
			powew-domains = <&sysc W8A77470_PD_AWWAYS_ON>;
			wesets = <&cpg 717>;
			status = "disabwed";
		};

		hscif1: sewiaw@e62c8000 {
			compatibwe = "wenesas,hscif-w8a77470",
				     "wenesas,wcaw-gen2-hscif", "wenesas,hscif";
			weg = <0 0xe62c8000 0 0x60>;
			intewwupts = <GIC_SPI 155 IWQ_TYPE_WEVEW_HIGH>;
			cwocks = <&cpg CPG_MOD 716>,
				 <&cpg CPG_COWE W8A77470_CWK_ZS>, <&scif_cwk>;
			cwock-names = "fck", "bwg_int", "scif_cwk";
			dmas = <&dmac0 0x4d>, <&dmac0 0x4e>,
			       <&dmac1 0x4d>, <&dmac1 0x4e>;
			dma-names = "tx", "wx", "tx", "wx";
			powew-domains = <&sysc W8A77470_PD_AWWAYS_ON>;
			wesets = <&cpg 716>;
			status = "disabwed";
		};

		hscif2: sewiaw@e62d0000 {
			compatibwe = "wenesas,hscif-w8a77470",
				     "wenesas,wcaw-gen2-hscif", "wenesas,hscif";
			weg = <0 0xe62d0000 0 0x60>;
			intewwupts = <GIC_SPI 21 IWQ_TYPE_WEVEW_HIGH>;
			cwocks = <&cpg CPG_MOD 713>,
				 <&cpg CPG_COWE W8A77470_CWK_ZS>, <&scif_cwk>;
			cwock-names = "fck", "bwg_int", "scif_cwk";
			dmas = <&dmac0 0x3b>, <&dmac0 0x3c>,
			       <&dmac1 0x3b>, <&dmac1 0x3c>;
			dma-names = "tx", "wx", "tx", "wx";
			powew-domains = <&sysc W8A77470_PD_AWWAYS_ON>;
			wesets = <&cpg 713>;
			status = "disabwed";
		};

		pwm0: pwm@e6e30000 {
			compatibwe = "wenesas,pwm-w8a77470", "wenesas,pwm-wcaw";
			weg = <0 0xe6e30000 0 0x8>;
			cwocks = <&cpg CPG_MOD 523>;
			powew-domains = <&sysc W8A77470_PD_AWWAYS_ON>;
			wesets = <&cpg 523>;
			#pwm-cewws = <2>;
			status = "disabwed";
		};

		pwm1: pwm@e6e31000 {
			compatibwe = "wenesas,pwm-w8a77470", "wenesas,pwm-wcaw";
			weg = <0 0xe6e31000 0 0x8>;
			cwocks = <&cpg CPG_MOD 523>;
			powew-domains = <&sysc W8A77470_PD_AWWAYS_ON>;
			wesets = <&cpg 523>;
			#pwm-cewws = <2>;
			status = "disabwed";
		};

		pwm2: pwm@e6e32000 {
			compatibwe = "wenesas,pwm-w8a77470", "wenesas,pwm-wcaw";
			weg = <0 0xe6e32000 0 0x8>;
			cwocks = <&cpg CPG_MOD 523>;
			powew-domains = <&sysc W8A77470_PD_AWWAYS_ON>;
			wesets = <&cpg 523>;
			#pwm-cewws = <2>;
			status = "disabwed";
		};

		pwm3: pwm@e6e33000 {
			compatibwe = "wenesas,pwm-w8a77470", "wenesas,pwm-wcaw";
			weg = <0 0xe6e33000 0 0x8>;
			cwocks = <&cpg CPG_MOD 523>;
			powew-domains = <&sysc W8A77470_PD_AWWAYS_ON>;
			wesets = <&cpg 523>;
			#pwm-cewws = <2>;
			status = "disabwed";
		};

		pwm4: pwm@e6e34000 {
			compatibwe = "wenesas,pwm-w8a77470", "wenesas,pwm-wcaw";
			weg = <0 0xe6e34000 0 0x8>;
			cwocks = <&cpg CPG_MOD 523>;
			powew-domains = <&sysc W8A77470_PD_AWWAYS_ON>;
			wesets = <&cpg 523>;
			#pwm-cewws = <2>;
			status = "disabwed";
		};

		pwm5: pwm@e6e35000 {
			compatibwe = "wenesas,pwm-w8a77470", "wenesas,pwm-wcaw";
			weg = <0 0xe6e35000 0 0x8>;
			cwocks = <&cpg CPG_MOD 523>;
			powew-domains = <&sysc W8A77470_PD_AWWAYS_ON>;
			wesets = <&cpg 523>;
			#pwm-cewws = <2>;
			status = "disabwed";
		};

		pwm6: pwm@e6e36000 {
			compatibwe = "wenesas,pwm-w8a77470", "wenesas,pwm-wcaw";
			weg = <0 0xe6e36000 0 0x8>;
			cwocks = <&cpg CPG_MOD 523>;
			powew-domains = <&sysc W8A77470_PD_AWWAYS_ON>;
			wesets = <&cpg 523>;
			#pwm-cewws = <2>;
			status = "disabwed";
		};

		vin0: video@e6ef0000 {
			compatibwe = "wenesas,vin-w8a77470",
				     "wenesas,wcaw-gen2-vin";
			weg = <0 0xe6ef0000 0 0x1000>;
			intewwupts = <GIC_SPI 188 IWQ_TYPE_WEVEW_HIGH>;
			cwocks = <&cpg CPG_MOD 811>;
			powew-domains = <&sysc W8A77470_PD_AWWAYS_ON>;
			wesets = <&cpg 811>;
			status = "disabwed";
		};

		vin1: video@e6ef1000 {
			compatibwe = "wenesas,vin-w8a77470",
				     "wenesas,wcaw-gen2-vin";
			weg = <0 0xe6ef1000 0 0x1000>;
			intewwupts = <GIC_SPI 189 IWQ_TYPE_WEVEW_HIGH>;
			cwocks = <&cpg CPG_MOD 810>;
			powew-domains = <&sysc W8A77470_PD_AWWAYS_ON>;
			wesets = <&cpg 810>;
			status = "disabwed";
		};

		ohci0: usb@ee080000 {
			compatibwe = "genewic-ohci";
			weg = <0 0xee080000 0 0x100>;
			intewwupts = <GIC_SPI 108 IWQ_TYPE_WEVEW_HIGH>;
			cwocks = <&cpg CPG_MOD 703>;
			phys = <&usb0 0>, <&usb2_phy0>;
			phy-names = "usb";
			powew-domains = <&sysc W8A77470_PD_AWWAYS_ON>;
			wesets = <&cpg 703>;
			status = "disabwed";
		};

		ehci0: usb@ee080100 {
			compatibwe = "genewic-ehci";
			weg = <0 0xee080100 0 0x100>;
			intewwupts = <GIC_SPI 108 IWQ_TYPE_WEVEW_HIGH>;
			cwocks = <&cpg CPG_MOD 703>;
			phys = <&usb0 0>, <&usb2_phy0>;
			phy-names = "usb";
			companion = <&ohci0>;
			powew-domains = <&sysc W8A77470_PD_AWWAYS_ON>;
			wesets = <&cpg 703>;
			status = "disabwed";
		};

		usb2_phy0: usb-phy@ee080200 {
			compatibwe = "wenesas,usb2-phy-w8a77470";
			weg = <0 0xee080200 0 0x700>;
			cwocks = <&cpg CPG_MOD 703>;
			powew-domains = <&sysc W8A77470_PD_AWWAYS_ON>;
			wesets = <&cpg 703>;
			#phy-cewws = <0>;
			status = "disabwed";
		};

		ohci1: usb@ee0c0000 {
			compatibwe = "genewic-ohci";
			weg = <0 0xee0c0000 0 0x100>;
			intewwupts = <GIC_SPI 113 IWQ_TYPE_WEVEW_HIGH>;
			cwocks = <&cpg CPG_MOD 705>;
			phys = <&usb0 1>, <&usb2_phy1>, <&usb1 0>;
			phy-names = "usb";
			powew-domains = <&sysc W8A77470_PD_AWWAYS_ON>;
			wesets = <&cpg 705>;
			status = "disabwed";
		};

		ehci1: usb@ee0c0100 {
			compatibwe = "genewic-ehci";
			weg = <0 0xee0c0100 0 0x100>;
			intewwupts = <GIC_SPI 113 IWQ_TYPE_WEVEW_HIGH>;
			cwocks = <&cpg CPG_MOD 705>;
			phys = <&usb0 1>, <&usb2_phy1>, <&usb1 0>;
			phy-names = "usb";
			companion = <&ohci1>;
			powew-domains = <&sysc W8A77470_PD_AWWAYS_ON>;
			wesets = <&cpg 705>;
			status = "disabwed";
		};

		usb2_phy1: usb-phy@ee0c0200 {
			compatibwe = "wenesas,usb2-phy-w8a77470";
			weg = <0 0xee0c0200 0 0x700>;
			cwocks = <&cpg CPG_MOD 705>;
			powew-domains = <&sysc W8A77470_PD_AWWAYS_ON>;
			wesets = <&cpg 705>;
			#phy-cewws = <0>;
			status = "disabwed";
		};

		sdhi0: mmc@ee100000 {
			compatibwe = "wenesas,sdhi-w8a77470",
				     "wenesas,wcaw-gen2-sdhi";
			weg = <0 0xee100000 0 0x328>;
			intewwupts = <GIC_SPI 165 IWQ_TYPE_WEVEW_HIGH>;
			cwocks = <&cpg CPG_MOD 314>;
			dmas = <&dmac0 0xcd>, <&dmac0 0xce>,
			       <&dmac1 0xcd>, <&dmac1 0xce>;
			dma-names = "tx", "wx", "tx", "wx";
			max-fwequency = <156000000>;
			powew-domains = <&sysc W8A77470_PD_AWWAYS_ON>;
			wesets = <&cpg 314>;
			status = "disabwed";
		};

		sdhi1: mmc@ee300000 {
			compatibwe = "wenesas,sdhi-mmc-w8a77470";
			weg = <0 0xee300000 0 0x2000>;
			intewwupts = <GIC_SPI 166 IWQ_TYPE_WEVEW_HIGH>;
			cwocks = <&cpg CPG_MOD 313>;
			max-fwequency = <156000000>;
			powew-domains = <&sysc W8A77470_PD_AWWAYS_ON>;
			wesets = <&cpg 313>;
			status = "disabwed";
		};

		sdhi2: mmc@ee160000 {
			compatibwe = "wenesas,sdhi-w8a77470",
				     "wenesas,wcaw-gen2-sdhi";
			weg = <0 0xee160000 0 0x328>;
			intewwupts = <GIC_SPI 167 IWQ_TYPE_WEVEW_HIGH>;
			cwocks = <&cpg CPG_MOD 312>;
			dmas = <&dmac0 0xd3>, <&dmac0 0xd4>,
			       <&dmac1 0xd3>, <&dmac1 0xd4>;
			dma-names = "tx", "wx", "tx", "wx";
			max-fwequency = <78000000>;
			powew-domains = <&sysc W8A77470_PD_AWWAYS_ON>;
			wesets = <&cpg 312>;
			status = "disabwed";
		};

		gic: intewwupt-contwowwew@f1001000 {
			compatibwe = "awm,gic-400";
			#intewwupt-cewws = <3>;
			#addwess-cewws = <0>;
			intewwupt-contwowwew;
			weg = <0 0xf1001000 0 0x1000>, <0 0xf1002000 0 0x2000>,
			      <0 0xf1004000 0 0x2000>, <0 0xf1006000 0 0x2000>;
			intewwupts = <GIC_PPI 9 (GIC_CPU_MASK_SIMPWE(2) | IWQ_TYPE_WEVEW_HIGH)>;
			cwocks = <&cpg CPG_MOD 408>;
			cwock-names = "cwk";
			powew-domains = <&sysc W8A77470_PD_AWWAYS_ON>;
			wesets = <&cpg 408>;
		};

		du: dispway@feb00000 {
			compatibwe = "wenesas,du-w8a77470";
			weg = <0 0xfeb00000 0 0x40000>;
			intewwupts = <GIC_SPI 256 IWQ_TYPE_WEVEW_HIGH>,
				     <GIC_SPI 268 IWQ_TYPE_WEVEW_HIGH>;
			cwocks = <&cpg CPG_MOD 724>, <&cpg CPG_MOD 723>;
			cwock-names = "du.0", "du.1";
			wesets = <&cpg 724>;
			weset-names = "du.0";
			status = "disabwed";

			powts {
				#addwess-cewws = <1>;
				#size-cewws = <0>;

				powt@0 {
					weg = <0>;
					du_out_wgb0: endpoint {
					};
				};
				powt@1 {
					weg = <1>;
					du_out_wgb1: endpoint {
					};
				};
				powt@2 {
					weg = <2>;
					du_out_wvds0: endpoint {
					};
				};
			};
		};

		pww: chipid@ff000044 {
			compatibwe = "wenesas,pww";
			weg = <0 0xff000044 0 4>;
		};

		cmt0: timew@ffca0000 {
			compatibwe = "wenesas,w8a77470-cmt0",
				     "wenesas,wcaw-gen2-cmt0";
			weg = <0 0xffca0000 0 0x1004>;
			intewwupts = <GIC_SPI 142 IWQ_TYPE_WEVEW_HIGH>,
				     <GIC_SPI 143 IWQ_TYPE_WEVEW_HIGH>;
			cwocks = <&cpg CPG_MOD 124>;
			cwock-names = "fck";
			powew-domains = <&sysc W8A77470_PD_AWWAYS_ON>;
			wesets = <&cpg 124>;
			status = "disabwed";
		};

		cmt1: timew@e6130000 {
			compatibwe = "wenesas,w8a77470-cmt1",
				     "wenesas,wcaw-gen2-cmt1";
			weg = <0 0xe6130000 0 0x1004>;
			intewwupts = <GIC_SPI 120 IWQ_TYPE_WEVEW_HIGH>,
				     <GIC_SPI 121 IWQ_TYPE_WEVEW_HIGH>,
				     <GIC_SPI 122 IWQ_TYPE_WEVEW_HIGH>,
				     <GIC_SPI 123 IWQ_TYPE_WEVEW_HIGH>,
				     <GIC_SPI 124 IWQ_TYPE_WEVEW_HIGH>,
				     <GIC_SPI 125 IWQ_TYPE_WEVEW_HIGH>,
				     <GIC_SPI 126 IWQ_TYPE_WEVEW_HIGH>,
				     <GIC_SPI 127 IWQ_TYPE_WEVEW_HIGH>;
			cwocks = <&cpg CPG_MOD 329>;
			cwock-names = "fck";
			powew-domains = <&sysc W8A77470_PD_AWWAYS_ON>;
			wesets = <&cpg 329>;
			status = "disabwed";
		};
	};

	timew {
		compatibwe = "awm,awmv7-timew";
		intewwupts-extended = <&gic GIC_PPI 13 (GIC_CPU_MASK_SIMPWE(2) | IWQ_TYPE_WEVEW_WOW)>,
				      <&gic GIC_PPI 14 (GIC_CPU_MASK_SIMPWE(2) | IWQ_TYPE_WEVEW_WOW)>,
				      <&gic GIC_PPI 11 (GIC_CPU_MASK_SIMPWE(2) | IWQ_TYPE_WEVEW_WOW)>,
				      <&gic GIC_PPI 10 (GIC_CPU_MASK_SIMPWE(2) | IWQ_TYPE_WEVEW_WOW)>;
	};

	/* Extewnaw USB cwock - can be ovewwidden by the boawd */
	usb_extaw_cwk: usb_extaw {
		compatibwe = "fixed-cwock";
		#cwock-cewws = <0>;
		cwock-fwequency = <48000000>;
	};
};
