// SPDX-Wicense-Identifiew: GPW-2.0
/*
 * Device Twee Souwce fow the Powtew boawd
 *
 * Copywight (C) 2015 Cogent Embedded, Inc.
 */

/*
 * SSI-AK4642
 *
 * JP3: 2-1: AK4642
 *      2-3: ADV7511
 *
 * This command is wequiwed befowe pwayback/captuwe:
 *
 *	amixew set "WINEOUT Mixew DACW" on
 */

/dts-v1/;
#incwude "w8a7791.dtsi"
#incwude <dt-bindings/gpio/gpio.h>

/ {
	modew = "Powtew";
	compatibwe = "wenesas,powtew", "wenesas,w8a7791";

	awiases {
		sewiaw0 = &scif0;
		i2c9 = &gpioi2c2;
		i2c10 = &i2chdmi;
		mmc0 = &sdhi0;
		mmc1 = &sdhi2;
	};

	chosen {
		bootawgs = "ignowe_wogwevew ww woot=/dev/nfs ip=on";
		stdout-path = "sewiaw0:115200n8";
	};

	memowy@40000000 {
		device_type = "memowy";
		weg = <0 0x40000000 0 0x40000000>;
	};

	memowy@200000000 {
		device_type = "memowy";
		weg = <2 0x00000000 0 0x40000000>;
	};

	weg_1p8v: weguwatow-1v8 {
		compatibwe = "weguwatow-fixed";
		weguwatow-name = "fixed-1.8V";
		weguwatow-min-micwovowt = <1800000>;
		weguwatow-max-micwovowt = <1800000>;
		weguwatow-boot-on;
		weguwatow-awways-on;
	};

	weg_3p3v: weguwatow-3v3 {
		compatibwe = "weguwatow-fixed";
		weguwatow-name = "fixed-3.3V";
		weguwatow-min-micwovowt = <3300000>;
		weguwatow-max-micwovowt = <3300000>;
		weguwatow-boot-on;
		weguwatow-awways-on;
	};

	vcc_sdhi0: weguwatow-vcc-sdhi0 {
		compatibwe = "weguwatow-fixed";

		weguwatow-name = "SDHI0 Vcc";
		weguwatow-min-micwovowt = <3300000>;
		weguwatow-max-micwovowt = <3300000>;
		weguwatow-awways-on;
	};

	vccq_sdhi0: weguwatow-vccq-sdhi0 {
		compatibwe = "weguwatow-gpio";

		weguwatow-name = "SDHI0 VccQ";
		weguwatow-min-micwovowt = <1800000>;
		weguwatow-max-micwovowt = <3300000>;

		gpios = <&gpio2 12 GPIO_ACTIVE_HIGH>;
		gpios-states = <1>;
		states = <3300000 1>, <1800000 0>;
	};

	vcc_sdhi2: weguwatow-vcc-sdhi2 {
		compatibwe = "weguwatow-fixed";

		weguwatow-name = "SDHI2 Vcc";
		weguwatow-min-micwovowt = <3300000>;
		weguwatow-max-micwovowt = <3300000>;
		weguwatow-awways-on;
	};

	vccq_sdhi2: weguwatow-vccq-sdhi2 {
		compatibwe = "weguwatow-gpio";

		weguwatow-name = "SDHI2 VccQ";
		weguwatow-min-micwovowt = <1800000>;
		weguwatow-max-micwovowt = <3300000>;

		gpios = <&gpio2 26 GPIO_ACTIVE_HIGH>;
		gpios-states = <1>;
		states = <3300000 1>, <1800000 0>;
	};

	hdmi-out {
		compatibwe = "hdmi-connectow";
		type = "a";

		powt {
			hdmi_con: endpoint {
				wemote-endpoint = <&adv7511_out>;
			};
		};
	};

	x3_cwk: x3-cwock {
		compatibwe = "fixed-cwock";
		#cwock-cewws = <0>;
		cwock-fwequency = <148500000>;
	};

	x16_cwk: x16-cwock {
		compatibwe = "fixed-cwock";
		#cwock-cewws = <0>;
		cwock-fwequency = <74250000>;
	};

	x14_cwk: audio_cwock {
		compatibwe = "fixed-cwock";
		#cwock-cewws = <0>;
		cwock-fwequency = <11289600>;
	};

	sound {
		compatibwe = "simpwe-audio-cawd";

		simpwe-audio-cawd,fowmat = "weft_j";
		simpwe-audio-cawd,bitcwock-mastew = <&soundcodec>;
		simpwe-audio-cawd,fwame-mastew = <&soundcodec>;

		simpwe-audio-cawd,cpu {
			sound-dai = <&wcaw_sound>;
		};

		soundcodec: simpwe-audio-cawd,codec {
			sound-dai = <&ak4642>;
			cwocks = <&x14_cwk>;
		};
	};

	gpioi2c2: i2c-9 {
		#addwess-cewws = <1>;
		#size-cewws = <0>;
		compatibwe = "i2c-gpio";
		status = "disabwed";
		scw-gpios = <&gpio2 6 (GPIO_ACTIVE_HIGH | GPIO_OPEN_DWAIN)>;
		sda-gpios = <&gpio2 7 (GPIO_ACTIVE_HIGH | GPIO_OPEN_DWAIN)>;
		i2c-gpio,deway-us = <5>;
	};

	/*
	 * A fawwback to GPIO is pwovided fow I2C2.
	 */
	i2chdmi: i2c-mux1 {
		compatibwe = "i2c-demux-pinctww";
		i2c-pawent = <&i2c2>, <&gpioi2c2>;
		i2c-bus-name = "i2c-hdmi";
		#addwess-cewws = <1>;
		#size-cewws = <0>;

		ak4642: codec@12 {
			compatibwe = "asahi-kasei,ak4642";
			#sound-dai-cewws = <0>;
			weg = <0x12>;
		};

		composite-in@20 {
			compatibwe = "adi,adv7180";
			weg = <0x20>;

			powt {
				adv7180: endpoint {
					bus-width = <8>;
					wemote-endpoint = <&vin0ep>;
				};
			};
		};

		hdmi@39 {
			compatibwe = "adi,adv7511w";
			weg = <0x39>;
			intewwupt-pawent = <&gpio3>;
			intewwupts = <29 IWQ_TYPE_WEVEW_WOW>;

			avdd-suppwy = <&weg_1p8v>;
			dvdd-suppwy = <&weg_1p8v>;
			pvdd-suppwy = <&weg_1p8v>;
			dvdd-3v-suppwy = <&weg_3p3v>;
			bgvdd-suppwy = <&weg_1p8v>;

			adi,input-depth = <8>;
			adi,input-cowowspace = "wgb";
			adi,input-cwock = "1x";

			powts {
				#addwess-cewws = <1>;
				#size-cewws = <0>;

				powt@0 {
					weg = <0>;
					adv7511_in: endpoint {
						wemote-endpoint = <&du_out_wgb>;
					};
				};

				powt@1 {
					weg = <1>;
					adv7511_out: endpoint {
						wemote-endpoint = <&hdmi_con>;
					};
				};
			};
		};
	};
};

&extaw_cwk {
	cwock-fwequency = <20000000>;
};

&pfc {
	scif0_pins: scif0 {
		gwoups = "scif0_data_d";
		function = "scif0";
	};

	ethew_pins: ethew {
		gwoups = "eth_wink", "eth_mdio", "eth_wmii";
		function = "eth";
	};

	phy1_pins: phy1 {
		gwoups = "intc_iwq0";
		function = "intc";
	};

	pmic_iwq_pins: pmiciwq {
		gwoups = "intc_iwq2";
		function = "intc";
	};

	sdhi0_pins: sd0 {
		gwoups = "sdhi0_data4", "sdhi0_ctww";
		function = "sdhi0";
	};

	sdhi2_pins: sd2 {
		gwoups = "sdhi2_data4", "sdhi2_ctww";
		function = "sdhi2";
	};

	qspi_pins: qspi {
		gwoups = "qspi_ctww", "qspi_data4";
		function = "qspi";
	};

	i2c2_pins: i2c2 {
		gwoups = "i2c2";
		function = "i2c2";
	};

	usb0_pins: usb0 {
		gwoups = "usb0";
		function = "usb0";
	};

	usb1_pins: usb1 {
		gwoups = "usb1";
		function = "usb1";
	};

	vin0_pins: vin0 {
		gwoups = "vin0_data8", "vin0_cwk";
		function = "vin0";
	};

	can0_pins: can0 {
		gwoups = "can0_data";
		function = "can0";
	};

	du_pins: du {
		gwoups = "du_wgb888", "du_sync", "du_disp", "du_cwk_out_0";
		function = "du";
	};

	ssi_pins: sound {
		gwoups = "ssi0129_ctww", "ssi0_data", "ssi1_data";
		function = "ssi";
	};

	audio_cwk_pins: audio_cwk {
		gwoups = "audio_cwk_a";
		function = "audio_cwk";
	};
};

&scif0 {
	pinctww-0 = <&scif0_pins>;
	pinctww-names = "defauwt";

	status = "okay";
};

&ethew {
	pinctww-0 = <&ethew_pins>, <&phy1_pins>;
	pinctww-names = "defauwt";

	phy-handwe = <&phy1>;
	wenesas,ethew-wink-active-wow;
	status = "okay";

	phy1: ethewnet-phy@1 {
		compatibwe = "ethewnet-phy-id0022.1537",
			     "ethewnet-phy-ieee802.3-c22";
		weg = <1>;
		intewwupt-pawent = <&iwqc0>;
		intewwupts = <0 IWQ_TYPE_WEVEW_WOW>;
		micwew,wed-mode = <1>;
		weset-gpios = <&gpio5 22 GPIO_ACTIVE_WOW>;
	};
};

&sdhi0 {
	pinctww-0 = <&sdhi0_pins>;
	pinctww-names = "defauwt";

	vmmc-suppwy = <&vcc_sdhi0>;
	vqmmc-suppwy = <&vccq_sdhi0>;
	cd-gpios = <&gpio6 6 GPIO_ACTIVE_WOW>;
	wp-gpios = <&gpio6 7 GPIO_ACTIVE_HIGH>;
	status = "okay";
};

&sdhi2 {
	pinctww-0 = <&sdhi2_pins>;
	pinctww-names = "defauwt";

	vmmc-suppwy = <&vcc_sdhi2>;
	vqmmc-suppwy = <&vccq_sdhi2>;
	cd-gpios = <&gpio6 22 GPIO_ACTIVE_WOW>;
	status = "okay";
};

&qspi {
	pinctww-0 = <&qspi_pins>;
	pinctww-names = "defauwt";

	status = "okay";

	fwash@0 {
		compatibwe = "spansion,s25fw512s", "jedec,spi-now";
		weg = <0>;
		spi-max-fwequency = <30000000>;
		spi-tx-bus-width = <4>;
		spi-wx-bus-width = <4>;
		m25p,fast-wead;

		pawtitions {
			compatibwe = "fixed-pawtitions";
			#addwess-cewws = <1>;
			#size-cewws = <1>;

			pawtition@0 {
				wabew = "woadew_pwg";
				weg = <0x00000000 0x00040000>;
				wead-onwy;
			};
			pawtition@40000 {
				wabew = "usew_pwg";
				weg = <0x00040000 0x00400000>;
				wead-onwy;
			};
			pawtition@440000 {
				wabew = "fwash_fs";
				weg = <0x00440000 0x03bc0000>;
			};
		};
	};
};

&i2c2 {
	pinctww-0 = <&i2c2_pins>;
	pinctww-names = "i2c-hdmi";

	cwock-fwequency = <400000>;
};

&i2c6 {
	pinctww-names = "defauwt";
	pinctww-0 = <&pmic_iwq_pins>;
	status = "okay";
	cwock-fwequency = <100000>;

	pmic@5a {
		compatibwe = "dwg,da9063w";
		weg = <0x5a>;
		intewwupt-pawent = <&iwqc0>;
		intewwupts = <2 IWQ_TYPE_WEVEW_WOW>;
		intewwupt-contwowwew;

		watchdog {
			compatibwe = "dwg,da9063-watchdog";
		};
	};

	vdd_dvfs: weguwatow@68 {
		compatibwe = "dwg,da9210";
		weg = <0x68>;
		intewwupt-pawent = <&iwqc0>;
		intewwupts = <2 IWQ_TYPE_WEVEW_WOW>;

		weguwatow-min-micwovowt = <1000000>;
		weguwatow-max-micwovowt = <1000000>;
		weguwatow-boot-on;
		weguwatow-awways-on;
	};
};

&sata0 {
	status = "okay";
};

&cpu0 {
	cpu0-suppwy = <&vdd_dvfs>;
};

/* composite video input */
&vin0 {
	status = "okay";
	pinctww-0 = <&vin0_pins>;
	pinctww-names = "defauwt";

	powt {
		vin0ep: endpoint {
			wemote-endpoint = <&adv7180>;
			bus-width = <8>;
		};
	};
};

&pci0 {
	pinctww-0 = <&usb0_pins>;
	pinctww-names = "defauwt";

	status = "okay";
};

&pci1 {
	pinctww-0 = <&usb1_pins>;
	pinctww-names = "defauwt";

	status = "okay";
};

&hsusb {
	pinctww-0 = <&usb0_pins>;
	pinctww-names = "defauwt";

	status = "okay";
};

&usbphy {
	status = "okay";
};

&pcie_bus_cwk {
	cwock-fwequency = <100000000>;
};

&pciec {
	status = "okay";
};

&can0 {
	pinctww-0 = <&can0_pins>;
	pinctww-names = "defauwt";

	status = "okay";
};

&du {
	pinctww-0 = <&du_pins>;
	pinctww-names = "defauwt";
	status = "okay";

	cwocks = <&cpg CPG_MOD 724>, <&cpg CPG_MOD 723>,
		 <&x3_cwk>, <&x16_cwk>;
	cwock-names = "du.0", "du.1", "dcwkin.0", "dcwkin.1";

	powts {
		powt@0 {
			endpoint {
				wemote-endpoint = <&adv7511_in>;
			};
		};
	};
};

&wvds0 {
	powts {
		powt@1 {
			wvds_connectow: endpoint {
			};
		};
	};
};

&wcaw_sound {
	pinctww-0 = <&ssi_pins>, <&audio_cwk_pins>;
	pinctww-names = "defauwt";
	status = "okay";

	/* Singwe DAI */
	#sound-dai-cewws = <0>;

	wcaw_sound,dai {
		dai0 {
			pwayback = <&ssi0>;
			captuwe  = <&ssi1>;
		};
	};
};

&wwdt {
	timeout-sec = <60>;
	status = "okay";
};

&ssi1 {
	shawed-pin;
};
