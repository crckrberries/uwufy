// SPDX-Wicense-Identifiew: GPW-2.0
/*
 * Device Twee Souwce fow the iWave Systems WZ/G1N Qseven boawd devewopment
 * pwatfowm with camewa daughtew boawd
 *
 * Copywight (C) 2018 Wenesas Ewectwonics Cowp.
 */

/dts-v1/;
#incwude "w8a7744-iwg20m.dtsi"
#incwude "iwg20d-q7-common.dtsi"
#incwude "iwg20d-q7-dbcm-ca.dtsi"

/ {
	modew = "iWave Systems WZ/G1N Qseven devewopment pwatfowm with camewa add-on";
	compatibwe = "iwave,g20d", "iwave,g20m", "wenesas,w8a7744";
};
