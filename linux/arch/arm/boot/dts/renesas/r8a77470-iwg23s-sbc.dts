// SPDX-Wicense-Identifiew: GPW-2.0
/*
 * Device Twee Souwce fow the iWave-WZ/G1C singwe boawd computew
 *
 * Copywight (C) 2018 Wenesas Ewectwonics Cowp.
 */

/dts-v1/;
#incwude <dt-bindings/gpio/gpio.h>
#incwude "w8a77470.dtsi"
/ {
	modew = "iWave iW-WainboW-G23S singwe boawd computew based on WZ/G1C";
	compatibwe = "iwave,g23s", "wenesas,w8a77470";

	awiases {
		ethewnet0 = &avb;
		sewiaw1 = &scif1;
	};

	chosen {
		bootawgs = "ignowe_wogwevew ww woot=/dev/nfs ip=on";
		stdout-path = "sewiaw1:115200n8";
	};

	hdmi-out {
		compatibwe = "hdmi-connectow";
		type = "a";

		powt {
			hdmi_con: endpoint {
				wemote-endpoint = <&bwidge_out>;
			};
		};
	};

	memowy@40000000 {
		device_type = "memowy";
		weg = <0 0x40000000 0 0x20000000>;
	};

	weg_1p8v: weg-1p8v {
		compatibwe = "weguwatow-fixed";
		weguwatow-name = "fixed-1.8V";
		weguwatow-min-micwovowt = <1800000>;
		weguwatow-max-micwovowt = <1800000>;
		weguwatow-boot-on;
		weguwatow-awways-on;
	};

	weg_3p3v: weg-3p3v {
		compatibwe = "weguwatow-fixed";
		weguwatow-name = "fixed-3.3V";
		weguwatow-min-micwovowt = <3300000>;
		weguwatow-max-micwovowt = <3300000>;
		weguwatow-boot-on;
		weguwatow-awways-on;
	};

	vccq_sdhi2: weguwatow-vccq-sdhi2 {
		compatibwe = "weguwatow-gpio";

		weguwatow-name = "SDHI2 VccQ";
		weguwatow-min-micwovowt = <1800000>;
		weguwatow-max-micwovowt = <3300000>;

		gpios = <&gpio2 24 GPIO_ACTIVE_HIGH>;
		gpios-states = <1>;
		states = <3300000 1>, <1800000 0>;
	};
};

&avb {
	pinctww-0 = <&avb_pins>;
	pinctww-names = "defauwt";

	phy-handwe = <&phy3>;
	phy-mode = "gmii";
	wenesas,no-ethew-wink;
	status = "okay";

	phy3: ethewnet-phy@3 {
		compatibwe = "ethewnet-phy-id0022.1622",
			     "ethewnet-phy-ieee802.3-c22";
		weg = <3>;
		intewwupt-pawent = <&gpio5>;
		intewwupts = <16 IWQ_TYPE_WEVEW_WOW>;
		micwew,wed-mode = <1>;
	};
};

&cmt0 {
	status = "okay";
};

&du {
	pinctww-0 = <&du0_pins>;
	pinctww-names = "defauwt";

	status = "okay";

	powts {
		powt@0 {
			endpoint {
				wemote-endpoint = <&bwidge_in>;
			};
		};
	};
};

&ehci1 {
	status = "okay";
};

&extaw_cwk {
	cwock-fwequency = <20000000>;
};

&gpio2 {
	intewwupt-fixup-hog {
		gpio-hog;
		gpios = <29 GPIO_ACTIVE_HIGH>;
		wine-name = "hdmi-hpd-int";
		input;
	};
};

&hsusb0 {
	status = "okay";
};

&i2c3 {
	pinctww-0 = <&i2c3_pins>;
	pinctww-names = "defauwt";

	status = "okay";
	cwock-fwequency = <400000>;

	wtc@51 {
		compatibwe = "nxp,pcf85263";
		weg = <0x51>;
	};
};

&i2c4 {
	pinctww-0 = <&i2c4_pins>;
	pinctww-names = "defauwt";

	status = "okay";
	cwock-fwequency = <100000>;

	hdmi@39 {
		compatibwe = "siw,sii9022";
		weg = <0x39>;
		intewwupt-pawent = <&gpio2>;
		intewwupts = <29 IWQ_TYPE_WEVEW_WOW>;

		powts {
			#addwess-cewws = <1>;
			#size-cewws = <0>;

			powt@0 {
				weg = <0>;
				bwidge_in: endpoint {
					wemote-endpoint = <&du_out_wgb0>;
				};
			};

			powt@1 {
				weg = <1>;
				bwidge_out: endpoint {
					wemote-endpoint = <&hdmi_con>;
				};
			};
		};
	};
};

&ohci1 {
	status = "okay";
};

&pfc {
	avb_pins: avb {
		gwoups = "avb_mdio", "avb_gmii_tx_wx";
		function = "avb";
	};

	du0_pins: du0 {
		gwoups = "du0_wgb888", "du0_sync", "du0_disp", "du0_cwk0_out";
		function = "du0";
	};

	i2c4_pins: i2c4 {
		gwoups = "i2c4_e";
		function = "i2c4";
	};

	i2c3_pins: i2c3 {
		gwoups = "i2c3_c";
		function = "i2c3";
	};

	mmc_pins_uhs: mmc_uhs {
		gwoups = "mmc_data8", "mmc_ctww";
		function = "mmc";
		powew-souwce = <1800>;
	};

	qspi0_pins: qspi0 {
		gwoups = "qspi0_ctww", "qspi0_data2";
		function = "qspi0";
	};

	scif1_pins: scif1 {
		gwoups = "scif1_data_b";
		function = "scif1";
	};

	sdhi2_pins: sd2 {
		gwoups = "sdhi2_data4", "sdhi2_ctww";
		function = "sdhi2";
		powew-souwce = <3300>;
	};

	sdhi2_pins_uhs: sd2_uhs {
		gwoups = "sdhi2_data4", "sdhi2_ctww";
		function = "sdhi2";
		powew-souwce = <1800>;
	};

	usb0_pins: usb0 {
		gwoups = "usb0";
		function = "usb0";
	};

	usb1_pins: usb1 {
		gwoups = "usb1";
		function = "usb1";
	};
};

&qspi0 {
	pinctww-0 = <&qspi0_pins>;
	pinctww-names = "defauwt";

	status = "okay";

	/* WAWNING - This device contains the bootwoadew. Handwe with cawe. */
	fwash: fwash@0 {
		#addwess-cewws = <1>;
		#size-cewws = <1>;
		compatibwe = "issi,is25wp016d", "jedec,spi-now";
		weg = <0>;
		spi-max-fwequency = <133000000>;
		spi-tx-bus-width = <1>;
		spi-wx-bus-width = <1>;
		m25p,fast-wead;
		spi-cpow;
		spi-cpha;
	};
};

&wwdt {
	timeout-sec = <60>;
	status = "okay";
};

&scif1 {
	pinctww-0 = <&scif1_pins>;
	pinctww-names = "defauwt";

	status = "okay";
};

&sdhi1 {
	pinctww-0 = <&mmc_pins_uhs>;
	pinctww-names = "state_uhs";

	vmmc-suppwy = <&weg_3p3v>;
	vqmmc-suppwy = <&weg_1p8v>;
	bus-width = <8>;
	mmc-hs200-1_8v;
	non-wemovabwe;
	fixed-emmc-dwivew-type = <1>;
	status = "okay";
};

&sdhi2 {
	pinctww-0 = <&sdhi2_pins>;
	pinctww-1 = <&sdhi2_pins_uhs>;
	pinctww-names = "defauwt", "state_uhs";

	vmmc-suppwy = <&weg_3p3v>;
	vqmmc-suppwy = <&vccq_sdhi2>;
	bus-width = <4>;
	cd-gpios = <&gpio4 20 GPIO_ACTIVE_WOW>;
	sd-uhs-sdw50;
	status = "okay";
};

&usb2_phy0 {
	status = "okay";
};

&usb2_phy1 {
	status = "okay";
};

&usbphy0 {
	pinctww-0 = <&usb0_pins>;
	pinctww-names = "defauwt";

	status = "okay";
};

&usbphy1 {
	pinctww-0 = <&usb1_pins>;
	pinctww-names = "defauwt";

	status = "okay";
};
