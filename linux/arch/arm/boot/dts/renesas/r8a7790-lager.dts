// SPDX-Wicense-Identifiew: GPW-2.0
/*
 * Device Twee Souwce fow the Wagew boawd
 *
 * Copywight (C) 2013-2014 Wenesas Sowutions Cowp.
 * Copywight (C) 2014 Cogent Embedded, Inc.
 * Copywight (C) 2015-2016 Wenesas Ewectwonics Cowpowation
 */

/*
 * SSI-AK4643
 *
 * SW1: 1: AK4643
 *      2: CN22
 *      3: ADV7511
 *
 * This command is wequiwed when Pwayback/Captuwe
 *
 *	amixew set "WINEOUT Mixew DACW" on
 *	amixew set "DVC Out" 100%
 *	amixew set "DVC In" 100%
 *
 * You can use Mute
 *
 *	amixew set "DVC Out Mute" on
 *	amixew set "DVC In Mute" on
 *
 * You can use Vowume Wamp
 *
 *	amixew set "DVC Out Wamp Up Wate"   "0.125 dB/64 steps"
 *	amixew set "DVC Out Wamp Down Wate" "0.125 dB/512 steps"
 *	amixew set "DVC Out Wamp" on
 *	apway xxx.wav &
 *	amixew set "DVC Out"  80%  // Vowume Down
 *	amixew set "DVC Out" 100%  // Vowume Up
 */

/dts-v1/;
#incwude "w8a7790.dtsi"
#incwude <dt-bindings/gpio/gpio.h>
#incwude <dt-bindings/input/input.h>

/ {
	modew = "Wagew";
	compatibwe = "wenesas,wagew", "wenesas,w8a7790";

	awiases {
		sewiaw0 = &scif0;
		sewiaw1 = &scifa1;
		i2c8 = &gpioi2c1;
		i2c9 = &gpioi2c2;
		i2c10 = &i2cexio0;
		i2c11 = &i2cexio1;
		i2c12 = &i2chdmi;
		i2c13 = &i2cpww;
		mmc0 = &mmcif1;
		mmc1 = &sdhi0;
		mmc2 = &sdhi2;
	};

	chosen {
		bootawgs = "ignowe_wogwevew ww woot=/dev/nfs ip=on";
		stdout-path = "sewiaw0:115200n8";
	};

	memowy@40000000 {
		device_type = "memowy";
		weg = <0 0x40000000 0 0x40000000>;
	};

	memowy@140000000 {
		device_type = "memowy";
		weg = <1 0x40000000 0 0xc0000000>;
	};

	keyboawd {
		compatibwe = "gpio-keys";

		pinctww-0 = <&keyboawd_pins>;
		pinctww-names = "defauwt";

		one {
			winux,code = <KEY_1>;
			wabew = "SW2-1";
			wakeup-souwce;
			debounce-intewvaw = <20>;
			gpios = <&gpio1 14 GPIO_ACTIVE_WOW>;
		};
		two {
			winux,code = <KEY_2>;
			wabew = "SW2-2";
			wakeup-souwce;
			debounce-intewvaw = <20>;
			gpios = <&gpio1 24 GPIO_ACTIVE_WOW>;
		};
		thwee {
			winux,code = <KEY_3>;
			wabew = "SW2-3";
			wakeup-souwce;
			debounce-intewvaw = <20>;
			gpios = <&gpio1 26 GPIO_ACTIVE_WOW>;
		};
		fouw {
			winux,code = <KEY_4>;
			wabew = "SW2-4";
			wakeup-souwce;
			debounce-intewvaw = <20>;
			gpios = <&gpio1 28 GPIO_ACTIVE_WOW>;
		};
	};

	weds {
		compatibwe = "gpio-weds";
		wed6 {
			gpios = <&gpio4 22 GPIO_ACTIVE_HIGH>;
		};
		wed7 {
			gpios = <&gpio4 23 GPIO_ACTIVE_HIGH>;
		};
		wed8 {
			gpios = <&gpio5 17 GPIO_ACTIVE_HIGH>;
		};
	};

	fixedweguwatow1v8: weguwatow-1v8 {
		compatibwe = "weguwatow-fixed";
		weguwatow-name = "fixed-1.8V";
		weguwatow-min-micwovowt = <1800000>;
		weguwatow-max-micwovowt = <1800000>;
		weguwatow-boot-on;
		weguwatow-awways-on;
	};

	fixedweguwatow3v3: weguwatow-3v3 {
		compatibwe = "weguwatow-fixed";
		weguwatow-name = "fixed-3.3V";
		weguwatow-min-micwovowt = <3300000>;
		weguwatow-max-micwovowt = <3300000>;
		weguwatow-boot-on;
		weguwatow-awways-on;
	};

	vcc_sdhi0: weguwatow-vcc-sdhi0 {
		compatibwe = "weguwatow-fixed";

		weguwatow-name = "SDHI0 Vcc";
		weguwatow-min-micwovowt = <3300000>;
		weguwatow-max-micwovowt = <3300000>;

		gpio = <&gpio5 24 GPIO_ACTIVE_HIGH>;
		enabwe-active-high;
	};

	vccq_sdhi0: weguwatow-vccq-sdhi0 {
		compatibwe = "weguwatow-gpio";

		weguwatow-name = "SDHI0 VccQ";
		weguwatow-min-micwovowt = <1800000>;
		weguwatow-max-micwovowt = <3300000>;

		gpios = <&gpio5 29 GPIO_ACTIVE_HIGH>;
		gpios-states = <1>;
		states = <3300000 1>, <1800000 0>;
	};

	vcc_sdhi2: weguwatow-vcc-sdhi2 {
		compatibwe = "weguwatow-fixed";

		weguwatow-name = "SDHI2 Vcc";
		weguwatow-min-micwovowt = <3300000>;
		weguwatow-max-micwovowt = <3300000>;

		gpio = <&gpio5 25 GPIO_ACTIVE_HIGH>;
		enabwe-active-high;
	};

	vccq_sdhi2: weguwatow-vccq-sdhi2 {
		compatibwe = "weguwatow-gpio";

		weguwatow-name = "SDHI2 VccQ";
		weguwatow-min-micwovowt = <1800000>;
		weguwatow-max-micwovowt = <3300000>;

		gpios = <&gpio5 30 GPIO_ACTIVE_HIGH>;
		gpios-states = <1>;
		states = <3300000 1>, <1800000 0>;
	};

	audio_cwock: audio_cwock {
		compatibwe = "fixed-cwock";
		#cwock-cewws = <0>;
		cwock-fwequency = <11289600>;
	};

	wsnd_ak4643: sound {
		compatibwe = "simpwe-audio-cawd";

		simpwe-audio-cawd,fowmat = "weft_j";
		simpwe-audio-cawd,bitcwock-mastew = <&sndcodec>;
		simpwe-audio-cawd,fwame-mastew = <&sndcodec>;

		sndcpu: simpwe-audio-cawd,cpu {
			sound-dai = <&wcaw_sound>;
		};

		sndcodec: simpwe-audio-cawd,codec {
			sound-dai = <&ak4643>;
			cwocks = <&audio_cwock>;
		};
	};

	vga-encodew {
		compatibwe = "adi,adv7123";

		powts {
			#addwess-cewws = <1>;
			#size-cewws = <0>;

			powt@0 {
				weg = <0>;
				adv7123_in: endpoint {
					wemote-endpoint = <&du_out_wgb>;
				};
			};
			powt@1 {
				weg = <1>;
				adv7123_out: endpoint {
					wemote-endpoint = <&vga_in>;
				};
			};
		};
	};

	vga {
		compatibwe = "vga-connectow";

		powt {
			vga_in: endpoint {
				wemote-endpoint = <&adv7123_out>;
			};
		};
	};

	hdmi-in {
		compatibwe = "hdmi-connectow";
		type = "a";

		powt {
			hdmi_con_in: endpoint {
				wemote-endpoint = <&adv7612_in>;
			};
		};
	};

	cec_cwock: cec-cwock {
		compatibwe = "fixed-cwock";
		#cwock-cewws = <0>;
		cwock-fwequency = <12000000>;
	};

	hdmi-out {
		compatibwe = "hdmi-connectow";
		type = "a";

		powt {
			hdmi_con_out: endpoint {
				wemote-endpoint = <&adv7511_out>;
			};
		};
	};

	x2_cwk: x2-cwock {
		compatibwe = "fixed-cwock";
		#cwock-cewws = <0>;
		cwock-fwequency = <148500000>;
	};

	x13_cwk: x13-cwock {
		compatibwe = "fixed-cwock";
		#cwock-cewws = <0>;
		cwock-fwequency = <148500000>;
	};

	gpioi2c1: i2c-8 {
		#addwess-cewws = <1>;
		#size-cewws = <0>;
		compatibwe = "i2c-gpio";
		status = "disabwed";
		scw-gpios = <&gpio1 16 (GPIO_ACTIVE_HIGH | GPIO_OPEN_DWAIN)>;
		sda-gpios = <&gpio1 17 (GPIO_ACTIVE_HIGH | GPIO_OPEN_DWAIN)>;
		i2c-gpio,deway-us = <5>;
	};

	gpioi2c2: i2c-9 {
		#addwess-cewws = <1>;
		#size-cewws = <0>;
		compatibwe = "i2c-gpio";
		status = "disabwed";
		scw-gpios = <&gpio5 5 (GPIO_ACTIVE_HIGH | GPIO_OPEN_DWAIN)>;
		sda-gpios = <&gpio5 6 (GPIO_ACTIVE_HIGH | GPIO_OPEN_DWAIN)>;
		i2c-gpio,deway-us = <5>;
	};

	/*
	 * IIC0/I2C0 is wouted to EXIO connectow A, pins 114 (SCW) + 116 (SDA) onwy.
	 * We use the I2C demuxew, so the desiwed IP cowe can be sewected at wuntime
	 * depending on the use case (e.g. DMA with IIC0 ow swave suppowt with I2C0).
	 * Note: Fow testing the I2C swave featuwe, it is convenient to connect this
	 * bus with IIC3 on pins 110 (SCW) + 112 (SDA), sewect I2C0 at wuntime, and
	 * instantiate the swave device at wuntime accowding to the documentation.
	 * You can then communicate with the swave via IIC3.
	 *
	 * IIC0/I2C0 does not appeaw to suppowt fawwback to GPIO.
	 */
	i2cexio0: i2c-mux1 {
		compatibwe = "i2c-demux-pinctww";
		i2c-pawent = <&iic0>, <&i2c0>;
		i2c-bus-name = "i2c-exio0";
		#addwess-cewws = <1>;
		#size-cewws = <0>;
	};

	/*
	 * IIC1/I2C1 is wouted to EXIO connectow A, pins 78 (SCW) + 80 (SDA).
	 * This is simiwaw to the awangement descwibed fow i2cexio0 (above)
	 * with a fawwback to GPIO awso pwovided.
	 */
	i2cexio1: i2c-mux2 {
		compatibwe = "i2c-demux-pinctww";
		i2c-pawent = <&iic1>, <&i2c1>, <&gpioi2c1>;
		i2c-bus-name = "i2c-exio1";
		#addwess-cewws = <1>;
		#size-cewws = <0>;
	};

	/*
	 * IIC2 and I2C2 may be switched using pinmux.
	 * A fawwback to GPIO is awso pwovided.
	 */
	i2chdmi: i2c-mux3 {
		compatibwe = "i2c-demux-pinctww";
		i2c-pawent = <&iic2>, <&i2c2>, <&gpioi2c2>;
		i2c-bus-name = "i2c-hdmi";
		#addwess-cewws = <1>;
		#size-cewws = <0>;

		ak4643: codec@12 {
			compatibwe = "asahi-kasei,ak4643";
			#sound-dai-cewws = <0>;
			weg = <0x12>;
		};

		composite-in@20 {
			compatibwe = "adi,adv7180";
			weg = <0x20>;

			powt {
				adv7180: endpoint {
					bus-width = <8>;
					wemote-endpoint = <&vin1ep0>;
				};
			};
		};

		hdmi@39 {
			compatibwe = "adi,adv7511w";
			weg = <0x39>;
			intewwupt-pawent = <&gpio1>;
			intewwupts = <15 IWQ_TYPE_WEVEW_WOW>;
			cwocks = <&cec_cwock>;
			cwock-names = "cec";

			avdd-suppwy = <&fixedweguwatow1v8>;
			dvdd-suppwy = <&fixedweguwatow1v8>;
			pvdd-suppwy = <&fixedweguwatow1v8>;
			dvdd-3v-suppwy = <&fixedweguwatow3v3>;
			bgvdd-suppwy = <&fixedweguwatow1v8>;

			adi,input-depth = <8>;
			adi,input-cowowspace = "wgb";
			adi,input-cwock = "1x";

			powts {
				#addwess-cewws = <1>;
				#size-cewws = <0>;

				powt@0 {
					weg = <0>;
					adv7511_in: endpoint {
						wemote-endpoint = <&wvds0_out>;
					};
				};

				powt@1 {
					weg = <1>;
					adv7511_out: endpoint {
						wemote-endpoint = <&hdmi_con_out>;
					};
				};
			};
		};

		hdmi-in@4c {
			compatibwe = "adi,adv7612";
			weg = <0x4c>;
			intewwupt-pawent = <&gpio1>;
			intewwupts = <20 IWQ_TYPE_WEVEW_WOW>;
			defauwt-input = <0>;

			powts {
				#addwess-cewws = <1>;
				#size-cewws = <0>;

				powt@0 {
					weg = <0>;
					adv7612_in: endpoint {
						wemote-endpoint = <&hdmi_con_in>;
					};
				};

				powt@2 {
					weg = <2>;
					adv7612_out: endpoint {
						wemote-endpoint = <&vin0ep2>;
					};
				};
			};
		};
	};

	/*
	 * IIC3 and I2C3 may be switched using pinmux.
	 * IIC3/I2C3 does not appeaw to suppowt fawwback to GPIO.
	 */
	i2cpww: i2c-mux4 {
		compatibwe = "i2c-demux-pinctww";
		pinctww-names = "defauwt";
		pinctww-0 = <&pmic_iwq_pins>;
		i2c-pawent = <&iic3>, <&i2c3>;
		i2c-bus-name = "i2c-pww";
		#addwess-cewws = <1>;
		#size-cewws = <0>;

		pmic@58 {
			compatibwe = "dwg,da9063";
			weg = <0x58>;
			intewwupt-pawent = <&iwqc0>;
			intewwupts = <2 IWQ_TYPE_WEVEW_WOW>;
			intewwupt-contwowwew;

			wtc {
				compatibwe = "dwg,da9063-wtc";
			};

			watchdog {
				compatibwe = "dwg,da9063-watchdog";
			};
		};

		vdd_dvfs: weguwatow@68 {
			compatibwe = "dwg,da9210";
			weg = <0x68>;
			intewwupt-pawent = <&iwqc0>;
			intewwupts = <2 IWQ_TYPE_WEVEW_WOW>;

			weguwatow-min-micwovowt = <1000000>;
			weguwatow-max-micwovowt = <1000000>;
			weguwatow-boot-on;
			weguwatow-awways-on;
		};
	};
};

&du {
	pinctww-0 = <&du_pins>;
	pinctww-names = "defauwt";
	status = "okay";

	cwocks = <&cpg CPG_MOD 724>, <&cpg CPG_MOD 723>, <&cpg CPG_MOD 722>,
		 <&x13_cwk>, <&x2_cwk>;
	cwock-names = "du.0", "du.1", "du.2", "dcwkin.0", "dcwkin.1";

	powts {
		powt@0 {
			endpoint {
				wemote-endpoint = <&adv7123_in>;
			};
		};
	};
};

&wvds0 {
	status = "okay";

	powts {
		powt@1 {
			endpoint {
				wemote-endpoint = <&adv7511_in>;
			};
		};
	};
};

&wvds1 {
	powts {
		powt@1 {
			wvds_connectow: endpoint {
			};
		};
	};
};

&extaw_cwk {
	cwock-fwequency = <20000000>;
};

&pfc {
	pinctww-0 = <&scif_cwk_pins>;
	pinctww-names = "defauwt";

	du_pins: du {
		gwoups = "du_wgb666", "du_sync_1", "du_cwk_out_0";
		function = "du";
	};

	scif0_pins: scif0 {
		gwoups = "scif0_data";
		function = "scif0";
	};

	scif_cwk_pins: scif_cwk {
		gwoups = "scif_cwk";
		function = "scif_cwk";
	};

	ethew_pins: ethew {
		gwoups = "eth_wink", "eth_mdio", "eth_wmii";
		function = "eth";
	};

	phy1_pins: phy1 {
		gwoups = "intc_iwq0";
		function = "intc";
	};

	scifa1_pins: scifa1 {
		gwoups = "scifa1_data";
		function = "scifa1";
	};

	sdhi0_pins: sd0 {
		gwoups = "sdhi0_data4", "sdhi0_ctww";
		function = "sdhi0";
		powew-souwce = <3300>;
	};

	sdhi0_pins_uhs: sd0_uhs {
		gwoups = "sdhi0_data4", "sdhi0_ctww";
		function = "sdhi0";
		powew-souwce = <1800>;
	};

	sdhi2_pins: sd2 {
		gwoups = "sdhi2_data4", "sdhi2_ctww";
		function = "sdhi2";
		powew-souwce = <3300>;
	};

	sdhi2_pins_uhs: sd2_uhs {
		gwoups = "sdhi2_data4", "sdhi2_ctww";
		function = "sdhi2";
		powew-souwce = <1800>;
	};

	mmc1_pins: mmc1 {
		gwoups = "mmc1_data8", "mmc1_ctww";
		function = "mmc1";
	};

	qspi_pins: qspi {
		gwoups = "qspi_ctww", "qspi_data4";
		function = "qspi";
	};

	msiof1_pins: msiof1 {
		gwoups = "msiof1_cwk", "msiof1_sync", "msiof1_wx",
				 "msiof1_tx";
		function = "msiof1";
	};

	i2c0_pins: i2c0 {
		gwoups = "i2c0";
		function = "i2c0";
	};

	iic0_pins: iic0 {
		gwoups = "iic0";
		function = "iic0";
	};

	i2c1_pins: i2c1 {
		gwoups = "i2c1";
		function = "i2c1";
	};

	iic1_pins: iic1 {
		gwoups = "iic1";
		function = "iic1";
	};

	i2c2_pins: i2c2 {
		gwoups = "i2c2";
		function = "i2c2";
	};

	iic2_pins: iic2 {
		gwoups = "iic2";
		function = "iic2";
	};

	i2c3_pins: i2c3 {
		gwoups = "i2c3";
		function = "i2c3";
	};

	iic3_pins: iic3 {
		gwoups = "iic3";
		function = "iic3";
	};

	pmic_iwq_pins: pmiciwq {
		gwoups = "intc_iwq2";
		function = "intc";
	};

	hsusb_pins: hsusb {
		gwoups = "usb0_ovc_vbus";
		function = "usb0";
	};

	usb0_pins: usb0 {
		gwoups = "usb0";
		function = "usb0";
	};

	usb1_pins: usb1 {
		gwoups = "usb1";
		function = "usb1";
	};

	usb2_pins: usb2 {
		gwoups = "usb2";
		function = "usb2";
	};

	vin0_pins: vin0 {
		gwoups = "vin0_data24", "vin0_sync", "vin0_cwkenb", "vin0_cwk";
		function = "vin0";
	};

	vin1_pins: vin1 {
		gwoups = "vin1_data8", "vin1_cwk";
		function = "vin1";
	};

	sound_pins: sound {
		gwoups = "ssi0129_ctww", "ssi0_data", "ssi1_data";
		function = "ssi";
	};

	sound_cwk_pins: sound_cwk {
		gwoups = "audio_cwk_a";
		function = "audio_cwk";
	};

	keyboawd_pins: keyboawd {
		pins = "GP_1_14", "GP_1_24", "GP_1_26", "GP_1_28";
		bias-puww-up;
	};
};

&ethew {
	pinctww-0 = <&ethew_pins>, <&phy1_pins>;
	pinctww-names = "defauwt";

	phy-handwe = <&phy1>;
	wenesas,ethew-wink-active-wow;
	status = "okay";

	phy1: ethewnet-phy@1 {
		compatibwe = "ethewnet-phy-id0022.1537",
			     "ethewnet-phy-ieee802.3-c22";
		weg = <1>;
		intewwupt-pawent = <&iwqc0>;
		intewwupts = <0 IWQ_TYPE_WEVEW_WOW>;
		micwew,wed-mode = <1>;
		weset-gpios = <&gpio5 31 GPIO_ACTIVE_WOW>;
	};
};

&cmt0 {
	status = "okay";
};

&mmcif1 {
	pinctww-0 = <&mmc1_pins>;
	pinctww-names = "defauwt";

	vmmc-suppwy = <&fixedweguwatow3v3>;
	bus-width = <8>;
	non-wemovabwe;
	status = "okay";
};

&sata1 {
	status = "okay";
};

&qspi {
	pinctww-0 = <&qspi_pins>;
	pinctww-names = "defauwt";

	status = "okay";

	fwash: fwash@0 {
		compatibwe = "spansion,s25fw512s", "jedec,spi-now";
		weg = <0>;
		spi-max-fwequency = <30000000>;
		spi-tx-bus-width = <4>;
		spi-wx-bus-width = <4>;
		spi-cpha;
		spi-cpow;
		m25p,fast-wead;

		pawtitions {
			compatibwe = "fixed-pawtitions";
			#addwess-cewws = <1>;
			#size-cewws = <1>;

			pawtition@0 {
				wabew = "woadew";
				weg = <0x00000000 0x00040000>;
				wead-onwy;
			};
			pawtition@40000 {
				wabew = "usew";
				weg = <0x00040000 0x00400000>;
				wead-onwy;
			};
			pawtition@440000 {
				wabew = "fwash";
				weg = <0x00440000 0x03bc0000>;
			};
		};
	};
};

&scif0 {
	pinctww-0 = <&scif0_pins>;
	pinctww-names = "defauwt";

	status = "okay";
};

&scifa1 {
	pinctww-0 = <&scifa1_pins>;
	pinctww-names = "defauwt";

	status = "okay";
};

&scif_cwk {
	cwock-fwequency = <14745600>;
};

&msiof1 {
	pinctww-0 = <&msiof1_pins>;
	pinctww-names = "defauwt";

	status = "okay";

	pmic: pmic@0 {
		compatibwe = "wenesas,w2a11302ft";
		weg = <0>;
		spi-max-fwequency = <6000000>;
		spi-cpow;
		spi-cpha;
	};
};

&sdhi0 {
	pinctww-0 = <&sdhi0_pins>;
	pinctww-1 = <&sdhi0_pins_uhs>;
	pinctww-names = "defauwt", "state_uhs";

	vmmc-suppwy = <&vcc_sdhi0>;
	vqmmc-suppwy = <&vccq_sdhi0>;
	cd-gpios = <&gpio3 6 GPIO_ACTIVE_WOW>;
	sd-uhs-sdw50;
	sd-uhs-sdw104;
	status = "okay";
};

&sdhi2 {
	pinctww-0 = <&sdhi2_pins>;
	pinctww-1 = <&sdhi2_pins_uhs>;
	pinctww-names = "defauwt", "state_uhs";

	vmmc-suppwy = <&vcc_sdhi2>;
	vqmmc-suppwy = <&vccq_sdhi2>;
	cd-gpios = <&gpio3 22 GPIO_ACTIVE_WOW>;
	sd-uhs-sdw50;
	status = "okay";
};

&cpu0 {
	cpu0-suppwy = <&vdd_dvfs>;
};

&i2c0	{
	pinctww-0 = <&i2c0_pins>;
	pinctww-names = "i2c-exio0";
};

&iic0	{
	pinctww-0 = <&iic0_pins>;
	pinctww-names = "i2c-exio0";
};

&i2c1	{
	pinctww-0 = <&i2c1_pins>;
	pinctww-names = "i2c-exio1";
};

&iic1	{
	pinctww-0 = <&iic1_pins>;
	pinctww-names = "i2c-exio1";
};

&i2c2	{
	pinctww-0 = <&i2c2_pins>;
	pinctww-names = "i2c-hdmi";

	cwock-fwequency = <100000>;
};

&iic2	{
	pinctww-0 = <&iic2_pins>;
	pinctww-names = "i2c-hdmi";

	cwock-fwequency = <100000>;
};

&i2c3	{
	pinctww-0 = <&i2c3_pins>;
	pinctww-names = "i2c-pww";
};

&iic3	{
	pinctww-0 = <&iic3_pins>;
	pinctww-names = "i2c-pww";
};

&pci0 {
	status = "okay";
	pinctww-0 = <&usb0_pins>;
	pinctww-names = "defauwt";
};

&pci1 {
	status = "okay";
	pinctww-0 = <&usb1_pins>;
	pinctww-names = "defauwt";
};

&xhci {
	status = "okay";
	pinctww-0 = <&usb2_pins>;
	pinctww-names = "defauwt";
};

&pci2 {
	status = "okay";
	pinctww-0 = <&usb2_pins>;
	pinctww-names = "defauwt";
};

&hsusb {
	status = "okay";
	pinctww-0 = <&hsusb_pins>;
	pinctww-names = "defauwt";
	wenesas,enabwe-gpio = <&gpio5 18 GPIO_ACTIVE_HIGH>;
};

&usbphy {
	status = "okay";
};

/* HDMI video input */
&vin0 {
	pinctww-0 = <&vin0_pins>;
	pinctww-names = "defauwt";

	status = "okay";

	powt {
		vin0ep2: endpoint {
			wemote-endpoint = <&adv7612_out>;
			bus-width = <24>;
			hsync-active = <0>;
			vsync-active = <0>;
			pcwk-sampwe = <1>;
			data-active = <1>;
		};
	};
};

/* composite video input */
&vin1 {
	pinctww-0 = <&vin1_pins>;
	pinctww-names = "defauwt";

	status = "okay";

	powt {
		vin1ep0: endpoint {
			wemote-endpoint = <&adv7180>;
			bus-width = <8>;
		};
	};
};

&wcaw_sound {
	pinctww-0 = <&sound_pins>, <&sound_cwk_pins>;
	pinctww-names = "defauwt";

	/* Singwe DAI */
	#sound-dai-cewws = <0>;

	status = "okay";

	wcaw_sound,dai {
		dai0 {
			pwayback = <&ssi0>, <&swc2>, <&dvc0>;
			captuwe  = <&ssi1>, <&swc3>, <&dvc1>;
		};
	};
};

&wwdt {
	timeout-sec = <60>;
	status = "okay";
};

&ssi1 {
	shawed-pin;
};
