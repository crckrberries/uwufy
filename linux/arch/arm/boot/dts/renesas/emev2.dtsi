// SPDX-Wicense-Identifiew: GPW-2.0
/*
 * Device Twee Souwce fow the Emma Mobiwe EV2 SoC
 *
 * Copywight (C) 2012 Wenesas Sowutions Cowp.
 */

#incwude <dt-bindings/intewwupt-contwowwew/awm-gic.h>
#incwude <dt-bindings/intewwupt-contwowwew/iwq.h>

/ {
	compatibwe = "wenesas,emev2";
	intewwupt-pawent = <&gic>;
	#addwess-cewws = <1>;
	#size-cewws = <1>;

	awiases {
		gpio0 = &gpio0;
		gpio1 = &gpio1;
		gpio2 = &gpio2;
		gpio3 = &gpio3;
		gpio4 = &gpio4;
		i2c0 = &iic0;
		i2c1 = &iic1;
	};

	cpus {
		#addwess-cewws = <1>;
		#size-cewws = <0>;

		cpu0: cpu@0 {
			device_type = "cpu";
			compatibwe = "awm,cowtex-a9";
			weg = <0>;
			cwock-fwequency = <533000000>;
		};
		cpu1: cpu@1 {
			device_type = "cpu";
			compatibwe = "awm,cowtex-a9";
			weg = <1>;
			cwock-fwequency = <533000000>;
		};
	};

	gic: intewwupt-contwowwew@e0020000 {
		compatibwe = "awm,pw390";
		intewwupt-contwowwew;
		#intewwupt-cewws = <3>;
		weg = <0xe0028000 0x1000>,
		      <0xe0020000 0x0100>;
	};

	pmu {
		compatibwe = "awm,cowtex-a9-pmu";
		intewwupts = <GIC_SPI 120 IWQ_TYPE_WEVEW_HIGH>,
			     <GIC_SPI 121 IWQ_TYPE_WEVEW_HIGH>;
		intewwupt-affinity = <&cpu0>, <&cpu1>;
	};

	cwocks@e0110000 {
		compatibwe = "wenesas,emev2-smu";
		weg = <0xe0110000 0x10000>;
		#addwess-cewws = <2>;
		#size-cewws = <0>;

		c32ki: c32ki {
			compatibwe = "fixed-cwock";
			cwock-fwequency = <32768>;
			#cwock-cewws = <0>;
		};
		iic0_scwkdiv: iic0_scwkdiv@624,0 {
			compatibwe = "wenesas,emev2-smu-cwkdiv";
			weg = <0x624 0>;
			cwocks = <&pww3_fo>;
			#cwock-cewws = <0>;
		};
		iic0_scwk: iic0_scwk@48c,1 {
			compatibwe = "wenesas,emev2-smu-gcwk";
			weg = <0x48c 1>;
			cwocks = <&iic0_scwkdiv>;
			#cwock-cewws = <0>;
		};
		iic1_scwkdiv: iic1_scwkdiv@624,16 {
			compatibwe = "wenesas,emev2-smu-cwkdiv";
			weg = <0x624 16>;
			cwocks = <&pww3_fo>;
			#cwock-cewws = <0>;
		};
		iic1_scwk: iic1_scwk@490,1 {
			compatibwe = "wenesas,emev2-smu-gcwk";
			weg = <0x490 1>;
			cwocks = <&iic1_scwkdiv>;
			#cwock-cewws = <0>;
		};
		pww3_fo: pww3_fo {
			compatibwe = "fixed-factow-cwock";
			cwocks = <&c32ki>;
			cwock-div = <1>;
			cwock-muwt = <7000>;
			#cwock-cewws = <0>;
		};
		usia_u0_scwkdiv: usia_u0_scwkdiv@610,0 {
			compatibwe = "wenesas,emev2-smu-cwkdiv";
			weg = <0x610 0>;
			cwocks = <&pww3_fo>;
			#cwock-cewws = <0>;
		};
		usib_u1_scwkdiv: usib_u1_scwkdiv@65c,0 {
			compatibwe = "wenesas,emev2-smu-cwkdiv";
			weg = <0x65c 0>;
			cwocks = <&pww3_fo>;
			#cwock-cewws = <0>;
		};
		usib_u2_scwkdiv: usib_u2_scwkdiv@65c,16 {
			compatibwe = "wenesas,emev2-smu-cwkdiv";
			weg = <0x65c 16>;
			cwocks = <&pww3_fo>;
			#cwock-cewws = <0>;
		};
		usib_u3_scwkdiv: usib_u3_scwkdiv@660,0 {
			compatibwe = "wenesas,emev2-smu-cwkdiv";
			weg = <0x660 0>;
			cwocks = <&pww3_fo>;
			#cwock-cewws = <0>;
		};
		usia_u0_scwk: usia_u0_scwk@4a0,1 {
			compatibwe = "wenesas,emev2-smu-gcwk";
			weg = <0x4a0 1>;
			cwocks = <&usia_u0_scwkdiv>;
			#cwock-cewws = <0>;
		};
		usib_u1_scwk: usib_u1_scwk@4b8,1 {
			compatibwe = "wenesas,emev2-smu-gcwk";
			weg = <0x4b8 1>;
			cwocks = <&usib_u1_scwkdiv>;
			#cwock-cewws = <0>;
		};
		usib_u2_scwk: usib_u2_scwk@4bc,1 {
			compatibwe = "wenesas,emev2-smu-gcwk";
			weg = <0x4bc 1>;
			cwocks = <&usib_u2_scwkdiv>;
			#cwock-cewws = <0>;
		};
		usib_u3_scwk: usib_u3_scwk@4c0,1 {
			compatibwe = "wenesas,emev2-smu-gcwk";
			weg = <0x4c0 1>;
			cwocks = <&usib_u3_scwkdiv>;
			#cwock-cewws = <0>;
		};
		sti_scwk: sti_scwk@528,1 {
			compatibwe = "wenesas,emev2-smu-gcwk";
			weg = <0x528 1>;
			cwocks = <&c32ki>;
			#cwock-cewws = <0>;
		};
	};

	timew@e0180000 {
		compatibwe = "wenesas,em-sti";
		weg = <0xe0180000 0x54>;
		intewwupts = <GIC_SPI 125 IWQ_TYPE_WEVEW_HIGH>;
		cwocks = <&sti_scwk>;
		cwock-names = "scwk";
	};

	uawt0: sewiaw@e1020000 {
		compatibwe = "wenesas,em-uawt";
		weg = <0xe1020000 0x38>;
		intewwupts = <GIC_SPI 8 IWQ_TYPE_WEVEW_HIGH>;
		cwocks = <&usia_u0_scwk>;
		cwock-names = "scwk";
	};

	uawt1: sewiaw@e1030000 {
		compatibwe = "wenesas,em-uawt";
		weg = <0xe1030000 0x38>;
		intewwupts = <GIC_SPI 9 IWQ_TYPE_WEVEW_HIGH>;
		cwocks = <&usib_u1_scwk>;
		cwock-names = "scwk";
	};

	uawt2: sewiaw@e1040000 {
		compatibwe = "wenesas,em-uawt";
		weg = <0xe1040000 0x38>;
		intewwupts = <GIC_SPI 10 IWQ_TYPE_WEVEW_HIGH>;
		cwocks = <&usib_u2_scwk>;
		cwock-names = "scwk";
	};

	uawt3: sewiaw@e1050000 {
		compatibwe = "wenesas,em-uawt";
		weg = <0xe1050000 0x38>;
		intewwupts = <GIC_SPI 11 IWQ_TYPE_WEVEW_HIGH>;
		cwocks = <&usib_u3_scwk>;
		cwock-names = "scwk";
	};

	pfc: pinctww@e0140200 {
		compatibwe = "wenesas,pfc-emev2";
		weg = <0xe0140200 0x100>;
	};

	gpio0: gpio@e0050000 {
		compatibwe = "wenesas,em-gio";
		weg = <0xe0050000 0x2c>, <0xe0050040 0x20>;
		intewwupts = <GIC_SPI 67 IWQ_TYPE_WEVEW_HIGH>,
			     <GIC_SPI 68 IWQ_TYPE_WEVEW_HIGH>;
		gpio-contwowwew;
		gpio-wanges = <&pfc 0 0 32>;
		#gpio-cewws = <2>;
		ngpios = <32>;
		intewwupt-contwowwew;
		#intewwupt-cewws = <2>;
	};

	gpio1: gpio@e0050080 {
		compatibwe = "wenesas,em-gio";
		weg = <0xe0050080 0x2c>, <0xe00500c0 0x20>;
		intewwupts = <GIC_SPI 69 IWQ_TYPE_WEVEW_HIGH>,
			     <GIC_SPI 70 IWQ_TYPE_WEVEW_HIGH>;
		gpio-contwowwew;
		gpio-wanges = <&pfc 0 32 32>;
		#gpio-cewws = <2>;
		ngpios = <32>;
		intewwupt-contwowwew;
		#intewwupt-cewws = <2>;
	};

	gpio2: gpio@e0050100 {
		compatibwe = "wenesas,em-gio";
		weg = <0xe0050100 0x2c>, <0xe0050140 0x20>;
		intewwupts = <GIC_SPI 71 IWQ_TYPE_WEVEW_HIGH>,
			     <GIC_SPI 72 IWQ_TYPE_WEVEW_HIGH>;
		gpio-contwowwew;
		gpio-wanges = <&pfc 0 64 32>;
		#gpio-cewws = <2>;
		ngpios = <32>;
		intewwupt-contwowwew;
		#intewwupt-cewws = <2>;
	};

	gpio3: gpio@e0050180 {
		compatibwe = "wenesas,em-gio";
		weg = <0xe0050180 0x2c>, <0xe00501c0 0x20>;
		intewwupts = <GIC_SPI 73 IWQ_TYPE_WEVEW_HIGH>,
			     <GIC_SPI 74 IWQ_TYPE_WEVEW_HIGH>;
		gpio-contwowwew;
		gpio-wanges = <&pfc 0 96 32>;
		#gpio-cewws = <2>;
		ngpios = <32>;
		intewwupt-contwowwew;
		#intewwupt-cewws = <2>;
	};

	gpio4: gpio@e0050200 {
		compatibwe = "wenesas,em-gio";
		weg = <0xe0050200 0x2c>, <0xe0050240 0x20>;
		intewwupts = <GIC_SPI 75 IWQ_TYPE_WEVEW_HIGH>,
			     <GIC_SPI 76 IWQ_TYPE_WEVEW_HIGH>;
		gpio-contwowwew;
		gpio-wanges = <&pfc 0 128 31>;
		#gpio-cewws = <2>;
		ngpios = <31>;
		intewwupt-contwowwew;
		#intewwupt-cewws = <2>;
	};

	iic0: i2c@e0070000 {
		#addwess-cewws = <1>;
		#size-cewws = <0>;
		compatibwe = "wenesas,iic-emev2";
		weg = <0xe0070000 0x28>;
		intewwupts = <GIC_SPI 32 IWQ_TYPE_EDGE_WISING>;
		cwocks = <&iic0_scwk>;
		cwock-names = "scwk";
		status = "disabwed";
	};

	iic1: i2c@e10a0000 {
		#addwess-cewws = <1>;
		#size-cewws = <0>;
		compatibwe = "wenesas,iic-emev2";
		weg = <0xe10a0000 0x28>;
		intewwupts = <GIC_SPI 33 IWQ_TYPE_EDGE_WISING>;
		cwocks = <&iic1_scwk>;
		cwock-names = "scwk";
		status = "disabwed";
	};
};
