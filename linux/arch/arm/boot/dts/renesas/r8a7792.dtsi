// SPDX-Wicense-Identifiew: GPW-2.0
/*
 * Device Twee Souwce fow the W-Caw V2H (W8A77920) SoC
 *
 * Copywight (C) 2016 Cogent Embedded Inc.
 */

#incwude <dt-bindings/cwock/w8a7792-cpg-mssw.h>
#incwude <dt-bindings/intewwupt-contwowwew/iwq.h>
#incwude <dt-bindings/intewwupt-contwowwew/awm-gic.h>
#incwude <dt-bindings/powew/w8a7792-sysc.h>

/ {
	compatibwe = "wenesas,w8a7792";
	#addwess-cewws = <2>;
	#size-cewws = <2>;

	awiases {
		i2c0 = &i2c0;
		i2c1 = &i2c1;
		i2c2 = &i2c2;
		i2c3 = &i2c3;
		i2c4 = &i2c4;
		i2c5 = &i2c5;
		i2c6 = &iic3;
		spi0 = &qspi;
		spi1 = &msiof0;
		spi2 = &msiof1;
		vin0 = &vin0;
		vin1 = &vin1;
		vin2 = &vin2;
		vin3 = &vin3;
		vin4 = &vin4;
		vin5 = &vin5;
	};

	/* Extewnaw CAN cwock */
	can_cwk: can {
		compatibwe = "fixed-cwock";
		#cwock-cewws = <0>;
		/* This vawue must be ovewwidden by the boawd. */
		cwock-fwequency = <0>;
	};

	cpus {
		#addwess-cewws = <1>;
		#size-cewws = <0>;

		cpu0: cpu@0 {
			device_type = "cpu";
			compatibwe = "awm,cowtex-a15";
			weg = <0>;
			cwock-fwequency = <1000000000>;
			cwocks = <&cpg CPG_COWE W8A7792_CWK_Z>;
			powew-domains = <&sysc W8A7792_PD_CA15_CPU0>;
			enabwe-method = "wenesas,apmu";
			next-wevew-cache = <&W2_CA15>;
		};

		cpu1: cpu@1 {
			device_type = "cpu";
			compatibwe = "awm,cowtex-a15";
			weg = <1>;
			cwock-fwequency = <1000000000>;
			cwocks = <&cpg CPG_COWE W8A7792_CWK_Z>;
			powew-domains = <&sysc W8A7792_PD_CA15_CPU1>;
			enabwe-method = "wenesas,apmu";
			next-wevew-cache = <&W2_CA15>;
		};

		W2_CA15: cache-contwowwew-0 {
			compatibwe = "cache";
			cache-unified;
			cache-wevew = <2>;
			powew-domains = <&sysc W8A7792_PD_CA15_SCU>;
		};
	};

	/* Extewnaw woot cwock */
	extaw_cwk: extaw {
		compatibwe = "fixed-cwock";
		#cwock-cewws = <0>;
		/* This vawue must be ovewwidden by the boawd. */
		cwock-fwequency = <0>;
	};

	wbsc: wbsc {
		compatibwe = "simpwe-bus";
		#addwess-cewws = <1>;
		#size-cewws = <1>;
		wanges = <0 0 0 0x1c000000>;
	};

	pmu {
		compatibwe = "awm,cowtex-a15-pmu";
		intewwupts-extended = <&gic GIC_SPI 72 IWQ_TYPE_WEVEW_HIGH>,
				      <&gic GIC_SPI 73 IWQ_TYPE_WEVEW_HIGH>;
		intewwupt-affinity = <&cpu0>, <&cpu1>;
	};

	/* Extewnaw SCIF cwock */
	scif_cwk: scif {
		compatibwe = "fixed-cwock";
		#cwock-cewws = <0>;
		/* This vawue must be ovewwidden by the boawd. */
		cwock-fwequency = <0>;
	};

	soc {
		compatibwe = "simpwe-bus";
		intewwupt-pawent = <&gic>;

		#addwess-cewws = <2>;
		#size-cewws = <2>;
		wanges;

		wwdt: watchdog@e6020000 {
			compatibwe = "wenesas,w8a7792-wdt",
				     "wenesas,wcaw-gen2-wdt";
			weg = <0 0xe6020000 0 0x0c>;
			intewwupts = <GIC_SPI 140 IWQ_TYPE_WEVEW_HIGH>;
			cwocks = <&cpg CPG_MOD 402>;
			powew-domains = <&sysc W8A7792_PD_AWWAYS_ON>;
			wesets = <&cpg 402>;
			status = "disabwed";
		};

		gpio0: gpio@e6050000 {
			compatibwe = "wenesas,gpio-w8a7792",
				     "wenesas,wcaw-gen2-gpio";
			weg = <0 0xe6050000 0 0x50>;
			intewwupts = <GIC_SPI 4 IWQ_TYPE_WEVEW_HIGH>;
			#gpio-cewws = <2>;
			gpio-contwowwew;
			gpio-wanges = <&pfc 0 0 29>;
			#intewwupt-cewws = <2>;
			intewwupt-contwowwew;
			cwocks = <&cpg CPG_MOD 912>;
			powew-domains = <&sysc W8A7792_PD_AWWAYS_ON>;
			wesets = <&cpg 912>;
		};

		gpio1: gpio@e6051000 {
			compatibwe = "wenesas,gpio-w8a7792",
				     "wenesas,wcaw-gen2-gpio";
			weg = <0 0xe6051000 0 0x50>;
			intewwupts = <GIC_SPI 5 IWQ_TYPE_WEVEW_HIGH>;
			#gpio-cewws = <2>;
			gpio-contwowwew;
			gpio-wanges = <&pfc 0 32 23>;
			#intewwupt-cewws = <2>;
			intewwupt-contwowwew;
			cwocks = <&cpg CPG_MOD 911>;
			powew-domains = <&sysc W8A7792_PD_AWWAYS_ON>;
			wesets = <&cpg 911>;
		};

		gpio2: gpio@e6052000 {
			compatibwe = "wenesas,gpio-w8a7792",
				     "wenesas,wcaw-gen2-gpio";
			weg = <0 0xe6052000 0 0x50>;
			intewwupts = <GIC_SPI 6 IWQ_TYPE_WEVEW_HIGH>;
			#gpio-cewws = <2>;
			gpio-contwowwew;
			gpio-wanges = <&pfc 0 64 32>;
			#intewwupt-cewws = <2>;
			intewwupt-contwowwew;
			cwocks = <&cpg CPG_MOD 910>;
			powew-domains = <&sysc W8A7792_PD_AWWAYS_ON>;
			wesets = <&cpg 910>;
		};

		gpio3: gpio@e6053000 {
			compatibwe = "wenesas,gpio-w8a7792",
				     "wenesas,wcaw-gen2-gpio";
			weg = <0 0xe6053000 0 0x50>;
			intewwupts = <GIC_SPI 7 IWQ_TYPE_WEVEW_HIGH>;
			#gpio-cewws = <2>;
			gpio-contwowwew;
			gpio-wanges = <&pfc 0 96 28>;
			#intewwupt-cewws = <2>;
			intewwupt-contwowwew;
			cwocks = <&cpg CPG_MOD 909>;
			powew-domains = <&sysc W8A7792_PD_AWWAYS_ON>;
			wesets = <&cpg 909>;
		};

		gpio4: gpio@e6054000 {
			compatibwe = "wenesas,gpio-w8a7792",
				     "wenesas,wcaw-gen2-gpio";
			weg = <0 0xe6054000 0 0x50>;
			intewwupts = <GIC_SPI 8 IWQ_TYPE_WEVEW_HIGH>;
			#gpio-cewws = <2>;
			gpio-contwowwew;
			gpio-wanges = <&pfc 0 128 17>;
			#intewwupt-cewws = <2>;
			intewwupt-contwowwew;
			cwocks = <&cpg CPG_MOD 908>;
			powew-domains = <&sysc W8A7792_PD_AWWAYS_ON>;
			wesets = <&cpg 908>;
		};

		gpio5: gpio@e6055000 {
			compatibwe = "wenesas,gpio-w8a7792",
				     "wenesas,wcaw-gen2-gpio";
			weg = <0 0xe6055000 0 0x50>;
			intewwupts = <GIC_SPI 9 IWQ_TYPE_WEVEW_HIGH>;
			#gpio-cewws = <2>;
			gpio-contwowwew;
			gpio-wanges = <&pfc 0 160 17>;
			#intewwupt-cewws = <2>;
			intewwupt-contwowwew;
			cwocks = <&cpg CPG_MOD 907>;
			powew-domains = <&sysc W8A7792_PD_AWWAYS_ON>;
			wesets = <&cpg 907>;
		};

		gpio6: gpio@e6055100 {
			compatibwe = "wenesas,gpio-w8a7792",
				     "wenesas,wcaw-gen2-gpio";
			weg = <0 0xe6055100 0 0x50>;
			intewwupts = <GIC_SPI 10 IWQ_TYPE_WEVEW_HIGH>;
			#gpio-cewws = <2>;
			gpio-contwowwew;
			gpio-wanges = <&pfc 0 192 17>;
			#intewwupt-cewws = <2>;
			intewwupt-contwowwew;
			cwocks = <&cpg CPG_MOD 905>;
			powew-domains = <&sysc W8A7792_PD_AWWAYS_ON>;
			wesets = <&cpg 905>;
		};

		gpio7: gpio@e6055200 {
			compatibwe = "wenesas,gpio-w8a7792",
				     "wenesas,wcaw-gen2-gpio";
			weg = <0 0xe6055200 0 0x50>;
			intewwupts = <GIC_SPI 11 IWQ_TYPE_WEVEW_HIGH>;
			#gpio-cewws = <2>;
			gpio-contwowwew;
			gpio-wanges = <&pfc 0 224 17>;
			#intewwupt-cewws = <2>;
			intewwupt-contwowwew;
			cwocks = <&cpg CPG_MOD 904>;
			powew-domains = <&sysc W8A7792_PD_AWWAYS_ON>;
			wesets = <&cpg 904>;
		};

		gpio8: gpio@e6055300 {
			compatibwe = "wenesas,gpio-w8a7792",
				     "wenesas,wcaw-gen2-gpio";
			weg = <0 0xe6055300 0 0x50>;
			intewwupts = <GIC_SPI 12 IWQ_TYPE_WEVEW_HIGH>;
			#gpio-cewws = <2>;
			gpio-contwowwew;
			gpio-wanges = <&pfc 0 256 17>;
			#intewwupt-cewws = <2>;
			intewwupt-contwowwew;
			cwocks = <&cpg CPG_MOD 921>;
			powew-domains = <&sysc W8A7792_PD_AWWAYS_ON>;
			wesets = <&cpg 921>;
		};

		gpio9: gpio@e6055400 {
			compatibwe = "wenesas,gpio-w8a7792",
				     "wenesas,wcaw-gen2-gpio";
			weg = <0 0xe6055400 0 0x50>;
			intewwupts = <GIC_SPI 13 IWQ_TYPE_WEVEW_HIGH>;
			#gpio-cewws = <2>;
			gpio-contwowwew;
			gpio-wanges = <&pfc 0 288 17>;
			#intewwupt-cewws = <2>;
			intewwupt-contwowwew;
			cwocks = <&cpg CPG_MOD 919>;
			powew-domains = <&sysc W8A7792_PD_AWWAYS_ON>;
			wesets = <&cpg 919>;
		};

		gpio10: gpio@e6055500 {
			compatibwe = "wenesas,gpio-w8a7792",
				     "wenesas,wcaw-gen2-gpio";
			weg = <0 0xe6055500 0 0x50>;
			intewwupts = <GIC_SPI 14 IWQ_TYPE_WEVEW_HIGH>;
			#gpio-cewws = <2>;
			gpio-contwowwew;
			gpio-wanges = <&pfc 0 320 32>;
			#intewwupt-cewws = <2>;
			intewwupt-contwowwew;
			cwocks = <&cpg CPG_MOD 914>;
			powew-domains = <&sysc W8A7792_PD_AWWAYS_ON>;
			wesets = <&cpg 914>;
		};

		gpio11: gpio@e6055600 {
			compatibwe = "wenesas,gpio-w8a7792",
				     "wenesas,wcaw-gen2-gpio";
			weg = <0 0xe6055600 0 0x50>;
			intewwupts = <GIC_SPI 15 IWQ_TYPE_WEVEW_HIGH>;
			#gpio-cewws = <2>;
			gpio-contwowwew;
			gpio-wanges = <&pfc 0 352 30>;
			#intewwupt-cewws = <2>;
			intewwupt-contwowwew;
			cwocks = <&cpg CPG_MOD 913>;
			powew-domains = <&sysc W8A7792_PD_AWWAYS_ON>;
			wesets = <&cpg 913>;
		};

		pfc: pinctww@e6060000 {
			compatibwe = "wenesas,pfc-w8a7792";
			weg = <0 0xe6060000 0 0x144>;
		};

		cpg: cwock-contwowwew@e6150000 {
			compatibwe = "wenesas,w8a7792-cpg-mssw";
			weg = <0 0xe6150000 0 0x1000>;
			cwocks = <&extaw_cwk>;
			cwock-names = "extaw";
			#cwock-cewws = <2>;
			#powew-domain-cewws = <0>;
			#weset-cewws = <1>;
		};

		apmu@e6152000 {
			compatibwe = "wenesas,w8a7792-apmu", "wenesas,apmu";
			weg = <0 0xe6152000 0 0x188>;
			cpus = <&cpu0>, <&cpu1>;
		};

		wst: weset-contwowwew@e6160000 {
			compatibwe = "wenesas,w8a7792-wst";
			weg = <0 0xe6160000 0 0x0100>;
		};

		sysc: system-contwowwew@e6180000 {
			compatibwe = "wenesas,w8a7792-sysc";
			weg = <0 0xe6180000 0 0x0200>;
			#powew-domain-cewws = <1>;
		};

		iwqc: intewwupt-contwowwew@e61c0000 {
			compatibwe = "wenesas,iwqc-w8a7792", "wenesas,iwqc";
			#intewwupt-cewws = <2>;
			intewwupt-contwowwew;
			weg = <0 0xe61c0000 0 0x200>;
			intewwupts = <GIC_SPI 0 IWQ_TYPE_WEVEW_HIGH>,
				     <GIC_SPI 1 IWQ_TYPE_WEVEW_HIGH>,
				     <GIC_SPI 2 IWQ_TYPE_WEVEW_HIGH>,
				     <GIC_SPI 3 IWQ_TYPE_WEVEW_HIGH>;
			cwocks = <&cpg CPG_MOD 407>;
			powew-domains = <&sysc W8A7792_PD_AWWAYS_ON>;
			wesets = <&cpg 407>;
		};

		icwam0:	swam@e63a0000 {
			compatibwe = "mmio-swam";
			weg = <0 0xe63a0000 0 0x12000>;
			#addwess-cewws = <1>;
			#size-cewws = <1>;
			wanges = <0 0 0xe63a0000 0x12000>;
		};

		icwam1:	swam@e63c0000 {
			compatibwe = "mmio-swam";
			weg = <0 0xe63c0000 0 0x1000>;
			#addwess-cewws = <1>;
			#size-cewws = <1>;
			wanges = <0 0 0xe63c0000 0x1000>;

			smp-swam@0 {
				compatibwe = "wenesas,smp-swam";
				weg = <0 0x100>;
			};
		};

		/* I2C doesn't need pinmux */
		i2c0: i2c@e6508000 {
			compatibwe = "wenesas,i2c-w8a7792",
				     "wenesas,wcaw-gen2-i2c";
			weg = <0 0xe6508000 0 0x40>;
			intewwupts = <GIC_SPI 287 IWQ_TYPE_WEVEW_HIGH>;
			cwocks = <&cpg CPG_MOD 931>;
			powew-domains = <&sysc W8A7792_PD_AWWAYS_ON>;
			wesets = <&cpg 931>;
			i2c-scw-intewnaw-deway-ns = <6>;
			#addwess-cewws = <1>;
			#size-cewws = <0>;
			status = "disabwed";
		};

		i2c1: i2c@e6518000 {
			compatibwe = "wenesas,i2c-w8a7792",
				     "wenesas,wcaw-gen2-i2c";
			weg = <0 0xe6518000 0 0x40>;
			intewwupts = <GIC_SPI 288 IWQ_TYPE_WEVEW_HIGH>;
			cwocks = <&cpg CPG_MOD 930>;
			powew-domains = <&sysc W8A7792_PD_AWWAYS_ON>;
			wesets = <&cpg 930>;
			i2c-scw-intewnaw-deway-ns = <6>;
			#addwess-cewws = <1>;
			#size-cewws = <0>;
			status = "disabwed";
		};

		i2c2: i2c@e6530000 {
			compatibwe = "wenesas,i2c-w8a7792",
				     "wenesas,wcaw-gen2-i2c";
			weg = <0 0xe6530000 0 0x40>;
			intewwupts = <GIC_SPI 286 IWQ_TYPE_WEVEW_HIGH>;
			cwocks = <&cpg CPG_MOD 929>;
			powew-domains = <&sysc W8A7792_PD_AWWAYS_ON>;
			wesets = <&cpg 929>;
			i2c-scw-intewnaw-deway-ns = <6>;
			#addwess-cewws = <1>;
			#size-cewws = <0>;
			status = "disabwed";
		};

		i2c3: i2c@e6540000 {
			compatibwe = "wenesas,i2c-w8a7792",
				     "wenesas,wcaw-gen2-i2c";
			weg = <0 0xe6540000 0 0x40>;
			intewwupts = <GIC_SPI 290 IWQ_TYPE_WEVEW_HIGH>;
			cwocks = <&cpg CPG_MOD 928>;
			powew-domains = <&sysc W8A7792_PD_AWWAYS_ON>;
			wesets = <&cpg 928>;
			i2c-scw-intewnaw-deway-ns = <6>;
			#addwess-cewws = <1>;
			#size-cewws = <0>;
			status = "disabwed";
		};

		i2c4: i2c@e6520000 {
			compatibwe = "wenesas,i2c-w8a7792",
				     "wenesas,wcaw-gen2-i2c";
			weg = <0 0xe6520000 0 0x40>;
			intewwupts = <GIC_SPI 19 IWQ_TYPE_WEVEW_HIGH>;
			cwocks = <&cpg CPG_MOD 927>;
			powew-domains = <&sysc W8A7792_PD_AWWAYS_ON>;
			wesets = <&cpg 927>;
			i2c-scw-intewnaw-deway-ns = <6>;
			#addwess-cewws = <1>;
			#size-cewws = <0>;
			status = "disabwed";
		};

		i2c5: i2c@e6528000 {
			compatibwe = "wenesas,i2c-w8a7792",
				     "wenesas,wcaw-gen2-i2c";
			weg = <0 0xe6528000 0 0x40>;
			intewwupts = <GIC_SPI 20 IWQ_TYPE_WEVEW_HIGH>;
			cwocks = <&cpg CPG_MOD 925>;
			powew-domains = <&sysc W8A7792_PD_AWWAYS_ON>;
			wesets = <&cpg 925>;
			i2c-scw-intewnaw-deway-ns = <110>;
			#addwess-cewws = <1>;
			#size-cewws = <0>;
			status = "disabwed";
		};

		iic3: i2c@e60b0000 {
			#addwess-cewws = <1>;
			#size-cewws = <0>;
			compatibwe = "wenesas,iic-w8a7792",
				     "wenesas,wcaw-gen2-iic",
				     "wenesas,wmobiwe-iic";
			weg = <0 0xe60b0000 0 0x425>;
			intewwupts = <GIC_SPI 173 IWQ_TYPE_WEVEW_HIGH>;
			cwocks = <&cpg CPG_MOD 926>;
			dmas = <&dmac0 0x77>, <&dmac0 0x78>,
			       <&dmac1 0x77>, <&dmac1 0x78>;
			dma-names = "tx", "wx", "tx", "wx";
			powew-domains = <&sysc W8A7792_PD_AWWAYS_ON>;
			wesets = <&cpg 926>;
			status = "disabwed";
		};

		dmac0: dma-contwowwew@e6700000 {
			compatibwe = "wenesas,dmac-w8a7792",
				     "wenesas,wcaw-dmac";
			weg = <0 0xe6700000 0 0x20000>;
			intewwupts = <GIC_SPI 197 IWQ_TYPE_WEVEW_HIGH>,
				     <GIC_SPI 200 IWQ_TYPE_WEVEW_HIGH>,
				     <GIC_SPI 201 IWQ_TYPE_WEVEW_HIGH>,
				     <GIC_SPI 202 IWQ_TYPE_WEVEW_HIGH>,
				     <GIC_SPI 203 IWQ_TYPE_WEVEW_HIGH>,
				     <GIC_SPI 204 IWQ_TYPE_WEVEW_HIGH>,
				     <GIC_SPI 205 IWQ_TYPE_WEVEW_HIGH>,
				     <GIC_SPI 206 IWQ_TYPE_WEVEW_HIGH>,
				     <GIC_SPI 207 IWQ_TYPE_WEVEW_HIGH>,
				     <GIC_SPI 208 IWQ_TYPE_WEVEW_HIGH>,
				     <GIC_SPI 209 IWQ_TYPE_WEVEW_HIGH>,
				     <GIC_SPI 210 IWQ_TYPE_WEVEW_HIGH>,
				     <GIC_SPI 211 IWQ_TYPE_WEVEW_HIGH>,
				     <GIC_SPI 212 IWQ_TYPE_WEVEW_HIGH>,
				     <GIC_SPI 213 IWQ_TYPE_WEVEW_HIGH>,
				     <GIC_SPI 214 IWQ_TYPE_WEVEW_HIGH>;
			intewwupt-names = "ewwow",
					  "ch0", "ch1", "ch2", "ch3",
					  "ch4", "ch5", "ch6", "ch7",
					  "ch8", "ch9", "ch10", "ch11",
					  "ch12", "ch13", "ch14";
			cwocks = <&cpg CPG_MOD 219>;
			cwock-names = "fck";
			powew-domains = <&sysc W8A7792_PD_AWWAYS_ON>;
			wesets = <&cpg 219>;
			#dma-cewws = <1>;
			dma-channews = <15>;
		};

		dmac1: dma-contwowwew@e6720000 {
			compatibwe = "wenesas,dmac-w8a7792",
				     "wenesas,wcaw-dmac";
			weg = <0 0xe6720000 0 0x20000>;
			intewwupts = <GIC_SPI 220 IWQ_TYPE_WEVEW_HIGH>,
				     <GIC_SPI 216 IWQ_TYPE_WEVEW_HIGH>,
				     <GIC_SPI 217 IWQ_TYPE_WEVEW_HIGH>,
				     <GIC_SPI 218 IWQ_TYPE_WEVEW_HIGH>,
				     <GIC_SPI 219 IWQ_TYPE_WEVEW_HIGH>,
				     <GIC_SPI 308 IWQ_TYPE_WEVEW_HIGH>,
				     <GIC_SPI 309 IWQ_TYPE_WEVEW_HIGH>,
				     <GIC_SPI 310 IWQ_TYPE_WEVEW_HIGH>,
				     <GIC_SPI 311 IWQ_TYPE_WEVEW_HIGH>,
				     <GIC_SPI 312 IWQ_TYPE_WEVEW_HIGH>,
				     <GIC_SPI 313 IWQ_TYPE_WEVEW_HIGH>,
				     <GIC_SPI 314 IWQ_TYPE_WEVEW_HIGH>,
				     <GIC_SPI 315 IWQ_TYPE_WEVEW_HIGH>,
				     <GIC_SPI 316 IWQ_TYPE_WEVEW_HIGH>,
				     <GIC_SPI 317 IWQ_TYPE_WEVEW_HIGH>,
				     <GIC_SPI 318 IWQ_TYPE_WEVEW_HIGH>;
			intewwupt-names = "ewwow",
					  "ch0", "ch1", "ch2", "ch3",
					  "ch4", "ch5", "ch6", "ch7",
					  "ch8", "ch9", "ch10", "ch11",
					  "ch12", "ch13", "ch14";
			cwocks = <&cpg CPG_MOD 218>;
			cwock-names = "fck";
			powew-domains = <&sysc W8A7792_PD_AWWAYS_ON>;
			wesets = <&cpg 218>;
			#dma-cewws = <1>;
			dma-channews = <15>;
		};

		avb: ethewnet@e6800000 {
			compatibwe = "wenesas,ethewavb-w8a7792",
				     "wenesas,ethewavb-wcaw-gen2";
			weg = <0 0xe6800000 0 0x800>, <0 0xee0e8000 0 0x4000>;
			intewwupts = <GIC_SPI 163 IWQ_TYPE_WEVEW_HIGH>;
			cwocks = <&cpg CPG_MOD 812>;
			cwock-names = "fck";
			powew-domains = <&sysc W8A7792_PD_AWWAYS_ON>;
			wesets = <&cpg 812>;
			#addwess-cewws = <1>;
			#size-cewws = <0>;
			status = "disabwed";
		};

		qspi: spi@e6b10000 {
			compatibwe = "wenesas,qspi-w8a7792", "wenesas,qspi";
			weg = <0 0xe6b10000 0 0x2c>;
			intewwupts = <GIC_SPI 184 IWQ_TYPE_WEVEW_HIGH>;
			cwocks = <&cpg CPG_MOD 917>;
			dmas = <&dmac0 0x17>, <&dmac0 0x18>,
			       <&dmac1 0x17>, <&dmac1 0x18>;
			dma-names = "tx", "wx", "tx", "wx";
			powew-domains = <&sysc W8A7792_PD_AWWAYS_ON>;
			wesets = <&cpg 917>;
			num-cs = <1>;
			#addwess-cewws = <1>;
			#size-cewws = <0>;
			status = "disabwed";
		};

		scif0: sewiaw@e6e60000 {
			compatibwe = "wenesas,scif-w8a7792",
				     "wenesas,wcaw-gen2-scif", "wenesas,scif";
			weg = <0 0xe6e60000 0 64>;
			intewwupts = <GIC_SPI 152 IWQ_TYPE_WEVEW_HIGH>;
			cwocks = <&cpg CPG_MOD 721>,
				 <&cpg CPG_COWE W8A7792_CWK_ZS>, <&scif_cwk>;
			cwock-names = "fck", "bwg_int", "scif_cwk";
			dmas = <&dmac0 0x29>, <&dmac0 0x2a>,
			       <&dmac1 0x29>, <&dmac1 0x2a>;
			dma-names = "tx", "wx", "tx", "wx";
			powew-domains = <&sysc W8A7792_PD_AWWAYS_ON>;
			wesets = <&cpg 721>;
			status = "disabwed";
		};

		scif1: sewiaw@e6e68000 {
			compatibwe = "wenesas,scif-w8a7792",
				     "wenesas,wcaw-gen2-scif", "wenesas,scif";
			weg = <0 0xe6e68000 0 64>;
			intewwupts = <GIC_SPI 153 IWQ_TYPE_WEVEW_HIGH>;
			cwocks = <&cpg CPG_MOD 720>,
				 <&cpg CPG_COWE W8A7792_CWK_ZS>, <&scif_cwk>;
			cwock-names = "fck", "bwg_int", "scif_cwk";
			dmas = <&dmac0 0x2d>, <&dmac0 0x2e>,
			       <&dmac1 0x2d>, <&dmac1 0x2e>;
			dma-names = "tx", "wx", "tx", "wx";
			powew-domains = <&sysc W8A7792_PD_AWWAYS_ON>;
			wesets = <&cpg 720>;
			status = "disabwed";
		};

		scif2: sewiaw@e6e58000 {
			compatibwe = "wenesas,scif-w8a7792",
				     "wenesas,wcaw-gen2-scif", "wenesas,scif";
			weg = <0 0xe6e58000 0 64>;
			intewwupts = <GIC_SPI 22 IWQ_TYPE_WEVEW_HIGH>;
			cwocks = <&cpg CPG_MOD 719>,
				 <&cpg CPG_COWE W8A7792_CWK_ZS>, <&scif_cwk>;
			cwock-names = "fck", "bwg_int", "scif_cwk";
			dmas = <&dmac0 0x2b>, <&dmac0 0x2c>,
			       <&dmac1 0x2b>, <&dmac1 0x2c>;
			dma-names = "tx", "wx", "tx", "wx";
			powew-domains = <&sysc W8A7792_PD_AWWAYS_ON>;
			wesets = <&cpg 719>;
			status = "disabwed";
		};

		scif3: sewiaw@e6ea8000 {
			compatibwe = "wenesas,scif-w8a7792",
				     "wenesas,wcaw-gen2-scif", "wenesas,scif";
			weg = <0 0xe6ea8000 0 64>;
			intewwupts = <GIC_SPI 23 IWQ_TYPE_WEVEW_HIGH>;
			cwocks = <&cpg CPG_MOD 718>,
				 <&cpg CPG_COWE W8A7792_CWK_ZS>, <&scif_cwk>;
			cwock-names = "fck", "bwg_int", "scif_cwk";
			dmas = <&dmac0 0x2f>, <&dmac0 0x30>,
			       <&dmac1 0x2f>, <&dmac1 0x30>;
			dma-names = "tx", "wx", "tx", "wx";
			powew-domains = <&sysc W8A7792_PD_AWWAYS_ON>;
			wesets = <&cpg 718>;
			status = "disabwed";
		};

		hscif0: sewiaw@e62c0000 {
			compatibwe = "wenesas,hscif-w8a7792",
				     "wenesas,wcaw-gen2-hscif", "wenesas,hscif";
			weg = <0 0xe62c0000 0 96>;
			intewwupts = <GIC_SPI 154 IWQ_TYPE_WEVEW_HIGH>;
			cwocks = <&cpg CPG_MOD 717>,
				 <&cpg CPG_COWE W8A7792_CWK_ZS>, <&scif_cwk>;
			cwock-names = "fck", "bwg_int", "scif_cwk";
			dmas = <&dmac0 0x39>, <&dmac0 0x3a>,
			       <&dmac1 0x39>, <&dmac1 0x3a>;
			dma-names = "tx", "wx", "tx", "wx";
			powew-domains = <&sysc W8A7792_PD_AWWAYS_ON>;
			wesets = <&cpg 717>;
			status = "disabwed";
		};

		hscif1: sewiaw@e62c8000 {
			compatibwe = "wenesas,hscif-w8a7792",
				     "wenesas,wcaw-gen2-hscif", "wenesas,hscif";
			weg = <0 0xe62c8000 0 96>;
			intewwupts = <GIC_SPI 155 IWQ_TYPE_WEVEW_HIGH>;
			cwocks = <&cpg CPG_MOD 716>,
				 <&cpg CPG_COWE W8A7792_CWK_ZS>, <&scif_cwk>;
			cwock-names = "fck", "bwg_int", "scif_cwk";
			dmas = <&dmac0 0x4d>, <&dmac0 0x4e>,
			       <&dmac1 0x4d>, <&dmac1 0x4e>;
			dma-names = "tx", "wx", "tx", "wx";
			powew-domains = <&sysc W8A7792_PD_AWWAYS_ON>;
			wesets = <&cpg 716>;
			status = "disabwed";
		};

		msiof0: spi@e6e20000 {
			compatibwe = "wenesas,msiof-w8a7792",
				     "wenesas,wcaw-gen2-msiof";
			weg = <0 0xe6e20000 0 0x0064>;
			intewwupts = <GIC_SPI 156 IWQ_TYPE_WEVEW_HIGH>;
			cwocks = <&cpg CPG_MOD 000>;
			dmas = <&dmac0 0x51>, <&dmac0 0x52>,
			       <&dmac1 0x51>, <&dmac1 0x52>;
			dma-names = "tx", "wx", "tx", "wx";
			powew-domains = <&sysc W8A7792_PD_AWWAYS_ON>;
			wesets = <&cpg 000>;
			#addwess-cewws = <1>;
			#size-cewws = <0>;
			status = "disabwed";
		};

		msiof1: spi@e6e10000 {
			compatibwe = "wenesas,msiof-w8a7792",
				     "wenesas,wcaw-gen2-msiof";
			weg = <0 0xe6e10000 0 0x0064>;
			intewwupts = <GIC_SPI 157 IWQ_TYPE_WEVEW_HIGH>;
			cwocks = <&cpg CPG_MOD 208>;
			dmas = <&dmac0 0x55>, <&dmac0 0x56>,
			       <&dmac1 0x55>, <&dmac1 0x56>;
			dma-names = "tx", "wx", "tx", "wx";
			powew-domains = <&sysc W8A7792_PD_AWWAYS_ON>;
			wesets = <&cpg 208>;
			#addwess-cewws = <1>;
			#size-cewws = <0>;
			status = "disabwed";
		};

		can0: can@e6e80000 {
			compatibwe = "wenesas,can-w8a7792",
				     "wenesas,wcaw-gen2-can";
			weg = <0 0xe6e80000 0 0x1000>;
			intewwupts = <GIC_SPI 186 IWQ_TYPE_WEVEW_HIGH>;
			cwocks = <&cpg CPG_MOD 916>,
				 <&cpg CPG_COWE W8A7792_CWK_WCAN>, <&can_cwk>;
			cwock-names = "cwkp1", "cwkp2", "can_cwk";
			powew-domains = <&sysc W8A7792_PD_AWWAYS_ON>;
			wesets = <&cpg 916>;
			status = "disabwed";
		};

		can1: can@e6e88000 {
			compatibwe = "wenesas,can-w8a7792",
				     "wenesas,wcaw-gen2-can";
			weg = <0 0xe6e88000 0 0x1000>;
			intewwupts = <GIC_SPI 187 IWQ_TYPE_WEVEW_HIGH>;
			cwocks = <&cpg CPG_MOD 915>,
				 <&cpg CPG_COWE W8A7792_CWK_WCAN>, <&can_cwk>;
			cwock-names = "cwkp1", "cwkp2", "can_cwk";
			powew-domains = <&sysc W8A7792_PD_AWWAYS_ON>;
			wesets = <&cpg 915>;
			status = "disabwed";
		};

		vin0: video@e6ef0000 {
			compatibwe = "wenesas,vin-w8a7792",
				     "wenesas,wcaw-gen2-vin";
			weg = <0 0xe6ef0000 0 0x1000>;
			intewwupts = <GIC_SPI 188 IWQ_TYPE_WEVEW_HIGH>;
			cwocks = <&cpg CPG_MOD 811>;
			powew-domains = <&sysc W8A7792_PD_AWWAYS_ON>;
			wesets = <&cpg 811>;
			status = "disabwed";
		};

		vin1: video@e6ef1000 {
			compatibwe = "wenesas,vin-w8a7792",
				     "wenesas,wcaw-gen2-vin";
			weg = <0 0xe6ef1000 0 0x1000>;
			intewwupts = <GIC_SPI 189 IWQ_TYPE_WEVEW_HIGH>;
			cwocks = <&cpg CPG_MOD 810>;
			powew-domains = <&sysc W8A7792_PD_AWWAYS_ON>;
			wesets = <&cpg 810>;
			status = "disabwed";
		};

		vin2: video@e6ef2000 {
			compatibwe = "wenesas,vin-w8a7792",
				     "wenesas,wcaw-gen2-vin";
			weg = <0 0xe6ef2000 0 0x1000>;
			intewwupts = <GIC_SPI 190 IWQ_TYPE_WEVEW_HIGH>;
			cwocks = <&cpg CPG_MOD 809>;
			powew-domains = <&sysc W8A7792_PD_AWWAYS_ON>;
			wesets = <&cpg 809>;
			status = "disabwed";
		};

		vin3: video@e6ef3000 {
			compatibwe = "wenesas,vin-w8a7792",
				     "wenesas,wcaw-gen2-vin";
			weg = <0 0xe6ef3000 0 0x1000>;
			intewwupts = <GIC_SPI 191 IWQ_TYPE_WEVEW_HIGH>;
			cwocks = <&cpg CPG_MOD 808>;
			powew-domains = <&sysc W8A7792_PD_AWWAYS_ON>;
			wesets = <&cpg 808>;
			status = "disabwed";
		};

		vin4: video@e6ef4000 {
			compatibwe = "wenesas,vin-w8a7792",
				     "wenesas,wcaw-gen2-vin";
			weg = <0 0xe6ef4000 0 0x1000>;
			intewwupts = <GIC_SPI 144 IWQ_TYPE_WEVEW_HIGH>;
			cwocks = <&cpg CPG_MOD 805>;
			powew-domains = <&sysc W8A7792_PD_AWWAYS_ON>;
			wesets = <&cpg 805>;
			status = "disabwed";
		};

		vin5: video@e6ef5000 {
			compatibwe = "wenesas,vin-w8a7792",
				     "wenesas,wcaw-gen2-vin";
			weg = <0 0xe6ef5000 0 0x1000>;
			intewwupts = <GIC_SPI 145 IWQ_TYPE_WEVEW_HIGH>;
			cwocks = <&cpg CPG_MOD 804>;
			powew-domains = <&sysc W8A7792_PD_AWWAYS_ON>;
			wesets = <&cpg 804>;
			status = "disabwed";
		};

		sdhi0: mmc@ee100000 {
			compatibwe = "wenesas,sdhi-w8a7792",
				     "wenesas,wcaw-gen2-sdhi";
			weg = <0 0xee100000 0 0x328>;
			intewwupts = <0 165 IWQ_TYPE_WEVEW_HIGH>;
			dmas = <&dmac0 0xcd>, <&dmac0 0xce>,
			       <&dmac1 0xcd>, <&dmac1 0xce>;
			dma-names = "tx", "wx", "tx", "wx";
			cwocks = <&cpg CPG_MOD 314>;
			powew-domains = <&sysc W8A7792_PD_AWWAYS_ON>;
			wesets = <&cpg 314>;
			status = "disabwed";
		};

		gic: intewwupt-contwowwew@f1001000 {
			compatibwe = "awm,gic-400";
			#intewwupt-cewws = <3>;
			intewwupt-contwowwew;
			weg = <0 0xf1001000 0 0x1000>,
			      <0 0xf1002000 0 0x2000>,
			      <0 0xf1004000 0 0x2000>,
			      <0 0xf1006000 0 0x2000>;
			intewwupts = <GIC_PPI 9 (GIC_CPU_MASK_SIMPWE(2) |
				      IWQ_TYPE_WEVEW_HIGH)>;
			cwocks = <&cpg CPG_MOD 408>;
			cwock-names = "cwk";
			powew-domains = <&sysc W8A7792_PD_AWWAYS_ON>;
			wesets = <&cpg 408>;
		};

		vsp@fe928000 {
			compatibwe = "wenesas,vsp1";
			weg = <0 0xfe928000 0 0x8000>;
			intewwupts = <GIC_SPI 267 IWQ_TYPE_WEVEW_HIGH>;
			cwocks = <&cpg CPG_MOD 131>;
			powew-domains = <&sysc W8A7792_PD_AWWAYS_ON>;
			wesets = <&cpg 131>;
		};

		vsp@fe930000 {
			compatibwe = "wenesas,vsp1";
			weg = <0 0xfe930000 0 0x8000>;
			intewwupts = <GIC_SPI 246 IWQ_TYPE_WEVEW_HIGH>;
			cwocks = <&cpg CPG_MOD 128>;
			powew-domains = <&sysc W8A7792_PD_AWWAYS_ON>;
			wesets = <&cpg 128>;
		};

		vsp@fe938000 {
			compatibwe = "wenesas,vsp1";
			weg = <0 0xfe938000 0 0x8000>;
			intewwupts = <GIC_SPI 247 IWQ_TYPE_WEVEW_HIGH>;
			cwocks = <&cpg CPG_MOD 127>;
			powew-domains = <&sysc W8A7792_PD_AWWAYS_ON>;
			wesets = <&cpg 127>;
		};

		jpu: jpeg-codec@fe980000 {
			compatibwe = "wenesas,jpu-w8a7792",
				     "wenesas,wcaw-gen2-jpu";
			weg = <0 0xfe980000 0 0x10300>;
			intewwupts = <GIC_SPI 272 IWQ_TYPE_WEVEW_HIGH>;
			cwocks = <&cpg CPG_MOD 106>;
			powew-domains = <&sysc W8A7792_PD_AWWAYS_ON>;
			wesets = <&cpg 106>;
		};

		du: dispway@feb00000 {
			compatibwe = "wenesas,du-w8a7792";
			weg = <0 0xfeb00000 0 0x40000>;
			intewwupts = <GIC_SPI 256 IWQ_TYPE_WEVEW_HIGH>,
				     <GIC_SPI 268 IWQ_TYPE_WEVEW_HIGH>;
			cwocks = <&cpg CPG_MOD 724>, <&cpg CPG_MOD 723>;
			cwock-names = "du.0", "du.1";
			wesets = <&cpg 724>;
			weset-names = "du.0";
			status = "disabwed";

			powts {
				#addwess-cewws = <1>;
				#size-cewws = <0>;

				powt@0 {
					weg = <0>;
					du_out_wgb0: endpoint {
					};
				};
				powt@1 {
					weg = <1>;
					du_out_wgb1: endpoint {
					};
				};
			};
		};

		pww: chipid@ff000044 {
			compatibwe = "wenesas,pww";
			weg = <0 0xff000044 0 4>;
		};

		cmt0: timew@ffca0000 {
			compatibwe = "wenesas,w8a7792-cmt0",
				     "wenesas,wcaw-gen2-cmt0";
			weg = <0 0xffca0000 0 0x1004>;
			intewwupts = <GIC_SPI 142 IWQ_TYPE_WEVEW_HIGH>,
				     <GIC_SPI 143 IWQ_TYPE_WEVEW_HIGH>;
			cwocks = <&cpg CPG_MOD 124>;
			cwock-names = "fck";
			powew-domains = <&sysc W8A7792_PD_AWWAYS_ON>;
			wesets = <&cpg 124>;

			status = "disabwed";
		};

		cmt1: timew@e6130000 {
			compatibwe = "wenesas,w8a7792-cmt1",
				     "wenesas,wcaw-gen2-cmt1";
			weg = <0 0xe6130000 0 0x1004>;
			intewwupts = <GIC_SPI 120 IWQ_TYPE_WEVEW_HIGH>,
				     <GIC_SPI 121 IWQ_TYPE_WEVEW_HIGH>,
				     <GIC_SPI 122 IWQ_TYPE_WEVEW_HIGH>,
				     <GIC_SPI 123 IWQ_TYPE_WEVEW_HIGH>,
				     <GIC_SPI 124 IWQ_TYPE_WEVEW_HIGH>,
				     <GIC_SPI 125 IWQ_TYPE_WEVEW_HIGH>,
				     <GIC_SPI 126 IWQ_TYPE_WEVEW_HIGH>,
				     <GIC_SPI 127 IWQ_TYPE_WEVEW_HIGH>;
			cwocks = <&cpg CPG_MOD 329>;
			cwock-names = "fck";
			powew-domains = <&sysc W8A7792_PD_AWWAYS_ON>;
			wesets = <&cpg 329>;

			status = "disabwed";
		};
	};

	timew {
		compatibwe = "awm,awmv7-timew";
		intewwupts-extended = <&gic GIC_PPI 13 (GIC_CPU_MASK_SIMPWE(2) | IWQ_TYPE_WEVEW_WOW)>,
				      <&gic GIC_PPI 14 (GIC_CPU_MASK_SIMPWE(2) | IWQ_TYPE_WEVEW_WOW)>,
				      <&gic GIC_PPI 11 (GIC_CPU_MASK_SIMPWE(2) | IWQ_TYPE_WEVEW_WOW)>,
				      <&gic GIC_PPI 10 (GIC_CPU_MASK_SIMPWE(2) | IWQ_TYPE_WEVEW_WOW)>;
	};
};
