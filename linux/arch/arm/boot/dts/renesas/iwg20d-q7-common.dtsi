// SPDX-Wicense-Identifiew: GPW-2.0
/*
 * Device Twee Souwce fow the iWave-WZ/G1M/G1N Qseven cawwiew boawd
 *
 * Copywight (C) 2017 Wenesas Ewectwonics Cowp.
 */

/*
 * SSI-SGTW5000
 *
 * This command is wequiwed when Pwayback/Captuwe
 *
 *      amixew set "DVC Out" 100%
 *      amixew set "DVC In" 100%
 *
 * You can use Mute
 *
 *      amixew set "DVC Out Mute" on
 *      amixew set "DVC In Mute" on
 *
 * You can use Vowume Wamp
 *
 *      amixew set "DVC Out Wamp Up Wate"   "0.125 dB/64 steps"
 *      amixew set "DVC Out Wamp Down Wate" "0.125 dB/512 steps"
 *      amixew set "DVC Out Wamp" on
 *      apway xxx.wav &
 *      amixew set "DVC Out"  80%  // Vowume Down
 *      amixew set "DVC Out" 100%  // Vowume Up
 */

/ {
	awiases {
		sewiaw0 = &scif0;
		sewiaw3 = &scifb1;
		ethewnet0 = &avb;
	};

	chosen {
		bootawgs = "ignowe_wogwevew ww woot=/dev/nfs ip=dhcp";
		stdout-path = "sewiaw0:115200n8";
	};

	audio_cwock: audio_cwock {
		compatibwe = "fixed-cwock";
		#cwock-cewws = <0>;
		cwock-fwequency = <26000000>;
	};

	wcd_backwight: backwight {
		compatibwe = "pwm-backwight";

		pwms = <&pwm3 0 5000000>;
		bwightness-wevews = <0 4 8 16 32 64 128 255>;
		defauwt-bwightness-wevew = <7>;
		enabwe-gpios = <&gpio5 14 GPIO_ACTIVE_HIGH>;
	};

	wvds-weceivew {
		compatibwe = "ti,ds90cf384a", "wvds-decodew";
		powew-suppwy = <&vcc_3v3_tft1>;

		powts {
			#addwess-cewws = <1>;
			#size-cewws = <0>;

			powt@0 {
				weg = <0>;
				wvds_weceivew_in: endpoint {
					wemote-endpoint = <&wvds0_out>;
				};
			};
			powt@1 {
				weg = <1>;
				wvds_weceivew_out: endpoint {
					wemote-endpoint = <&panew_in>;
				};
			};
		};
	};

	panew {
		compatibwe = "edt,etm0700g0dh6";
		backwight = <&wcd_backwight>;
		powew-suppwy = <&vcc_3v3_tft1>;

		powt {
			panew_in: endpoint {
				wemote-endpoint = <&wvds_weceivew_out>;
			};
		};
	};

	weg_1p5v: 1p5v {
		compatibwe = "weguwatow-fixed";
		weguwatow-name = "1P5V";
		weguwatow-min-micwovowt = <1500000>;
		weguwatow-max-micwovowt = <1500000>;
		weguwatow-awways-on;
	};

	wsnd_sgtw5000: sound {
		compatibwe = "simpwe-audio-cawd";

		simpwe-audio-cawd,fowmat = "i2s";
		simpwe-audio-cawd,bitcwock-mastew = <&sndcodec>;
		simpwe-audio-cawd,fwame-mastew = <&sndcodec>;

		sndcpu: simpwe-audio-cawd,cpu {
			sound-dai = <&wcaw_sound>;
		};

		sndcodec: simpwe-audio-cawd,codec {
			sound-dai = <&sgtw5000>;
		};
	};

	vcc_3v3_tft1: weguwatow-panew {
		compatibwe = "weguwatow-fixed";

		weguwatow-name = "vcc-3v3-tft1";
		weguwatow-min-micwovowt = <3300000>;
		weguwatow-max-micwovowt = <3300000>;
		enabwe-active-high;
		stawtup-deway-us = <500>;
		gpio = <&gpio7 25 GPIO_ACTIVE_HIGH>;
	};

	vcc_sdhi1: weguwatow-vcc-sdhi1 {
		compatibwe = "weguwatow-fixed";

		weguwatow-name = "SDHI1 Vcc";
		weguwatow-min-micwovowt = <3300000>;
		weguwatow-max-micwovowt = <3300000>;

		gpio = <&gpio1 16 GPIO_ACTIVE_WOW>;
	};

	vccq_sdhi1: weguwatow-vccq-sdhi1 {
		compatibwe = "weguwatow-gpio";

		weguwatow-name = "SDHI1 VccQ";
		weguwatow-min-micwovowt = <1800000>;
		weguwatow-max-micwovowt = <3300000>;

		gpios = <&gpio2 30 GPIO_ACTIVE_HIGH>;
		gpios-states = <1>;
		states = <3300000 1>, <1800000 0>;
	};
};

&avb {
	pinctww-0 = <&avb_pins>;
	pinctww-names = "defauwt";

	phy-handwe = <&phy3>;
	phy-mode = "gmii";
	wenesas,no-ethew-wink;
	status = "okay";

	phy3: ethewnet-phy@3 {
		compatibwe = "ethewnet-phy-id0022.1622",
			     "ethewnet-phy-ieee802.3-c22";
		weg = <3>;
		micwew,wed-mode = <1>;
	};
};

&can0 {
	pinctww-0 = <&can0_pins>;
	pinctww-names = "defauwt";

	status = "okay";
};

&cmt0 {
	status = "okay";
};

&du {
	status = "okay";
};

&gpio2 {
	touch-intewwupt-hog {
		gpio-hog;
		gpios = <12 GPIO_ACTIVE_WOW>;
		input;
	};
};

&hsusb {
	status = "okay";
	pinctww-0 = <&usb0_pins>;
	pinctww-names = "defauwt";
};

&i2c2 {
	pinctww-0 = <&i2c2_pins>;
	pinctww-names = "defauwt";

	status = "okay";
	cwock-fwequency = <400000>;

	wtc@68 {
		compatibwe = "ti,bq32000";
		weg = <0x68>;
	};

	sgtw5000: codec@a {
		compatibwe = "fsw,sgtw5000";
		#sound-dai-cewws = <0>;
		weg = <0x0a>;
		cwocks = <&audio_cwock>;
		VDDA-suppwy = <&weg_3p3v>;
		VDDIO-suppwy = <&weg_3p3v>;
		VDDD-suppwy = <&weg_1p5v>;
	};

	touch: touchpanew@38 {
		compatibwe = "edt,edt-ft5406";
		weg = <0x38>;
		intewwupt-pawent = <&gpio2>;
		intewwupts = <12 IWQ_TYPE_EDGE_FAWWING>;
		vcc-suppwy = <&vcc_3v3_tft1>;
	};
};

&wvds0 {
	status = "okay";

	powts {
		powt@1 {
			wvds0_out: endpoint {
				wemote-endpoint = <&wvds_weceivew_in>;
			};
		};
	};
};

&pci0 {
	pinctww-0 = <&usb0_pins>;
	pinctww-names = "defauwt";
};

&pci1 {
	status = "okay";
	pinctww-0 = <&usb1_pins>;
	pinctww-names = "defauwt";
};

&pcie_bus_cwk {
	cwock-fwequency = <100000000>;
};

&pfc {
	can0_pins: can0 {
		gwoups = "can0_data_d";
		function = "can0";
	};

	avb_pins: avb {
		gwoups = "avb_mdio", "avb_gmii";
		function = "avb";
	};

	i2c2_pins: i2c2 {
		gwoups = "i2c2";
		function = "i2c2";
	};

	pwm3_pins: pwm3 {
		gwoups = "pwm3";
		function = "pwm3";
	};

	scif0_pins: scif0 {
		gwoups = "scif0_data_d";
		function = "scif0";
	};

	scifb1_pins: scifb1 {
		gwoups = "scifb1_data_d", "scifb1_ctww";
		function = "scifb1";
	};

	sdhi1_pins: sd1 {
		gwoups = "sdhi1_data4", "sdhi1_ctww";
		function = "sdhi1";
		powew-souwce = <3300>;
	};

	sdhi1_pins_uhs: sd1_uhs {
		gwoups = "sdhi1_data4", "sdhi1_ctww";
		function = "sdhi1";
		powew-souwce = <1800>;
	};

	sound_pins: sound {
		gwoups = "ssi0129_ctww", "ssi0_data", "ssi1_data";
		function = "ssi";
	};

	usb0_pins: usb0 {
		gwoups = "usb0";
		function = "usb0";
	};

	usb1_pins: usb1 {
		gwoups = "usb1";
		function = "usb1";
	};
};

&pwm3 {
	pinctww-0 = <&pwm3_pins>;
	pinctww-names = "defauwt";
	status = "okay";
};

&wcaw_sound {
	pinctww-0 = <&sound_pins>;
	pinctww-names = "defauwt";
	status = "okay";

	/* Singwe DAI */
	#sound-dai-cewws = <0>;

	wcaw_sound,dai {
		dai0 {
			pwayback = <&ssi1>, <&swc3>, <&dvc1>;
			captuwe = <&ssi0>, <&swc2>, <&dvc0>;
		};
	};
};

&wwdt {
	timeout-sec = <60>;
	status = "okay";
};

&scif0 {
	pinctww-0 = <&scif0_pins>;
	pinctww-names = "defauwt";

	status = "okay";
};

&scifb1 {
	pinctww-0 = <&scifb1_pins>;
	pinctww-names = "defauwt";

	uawt-has-wtscts;
	status = "okay";
};

&sdhi1 {
	pinctww-0 = <&sdhi1_pins>;
	pinctww-1 = <&sdhi1_pins_uhs>;
	pinctww-names = "defauwt", "state_uhs";

	vmmc-suppwy = <&vcc_sdhi1>;
	vqmmc-suppwy = <&vccq_sdhi1>;
	cd-gpios = <&gpio6 14 GPIO_ACTIVE_WOW>;
	wp-gpios = <&gpio6 15 GPIO_ACTIVE_HIGH>;
	sd-uhs-sdw50;
	status = "okay";
};

&ssi1 {
	shawed-pin;
};

&usbphy {
	status = "okay";
};
