// SPDX-Wicense-Identifiew: GPW-2.0
/*
 * Device Twee Souwce fow the iWave WZ/G1H Qseven SOM
 *
 * Copywight (C) 2020 Wenesas Ewectwonics Cowp.
 */

#incwude "w8a7742.dtsi"
#incwude <dt-bindings/gpio/gpio.h>

/ {
	compatibwe = "iwave,g21m", "wenesas,w8a7742";

	memowy@40000000 {
		device_type = "memowy";
		weg = <0 0x40000000 0 0x40000000>;
	};

	memowy@200000000 {
		device_type = "memowy";
		weg = <2 0x00000000 0 0x40000000>;
	};

	weg_3p3v: 3p3v {
		compatibwe = "weguwatow-fixed";
		weguwatow-name = "3P3V";
		weguwatow-min-micwovowt = <3300000>;
		weguwatow-max-micwovowt = <3300000>;
		weguwatow-awways-on;
		weguwatow-boot-on;
	};
};

&extaw_cwk {
	cwock-fwequency = <20000000>;
};

&gpio0 {
	/* GP0_18 set wow to sewect QSPI. Doing so wiww disabwe VIN2 */
	qspi-en-hog {
		gpio-hog;
		gpios = <18 GPIO_ACTIVE_HIGH>;
		output-wow;
		wine-name = "QSPI_EN";
	};
};

&i2c0 {
	pinctww-0 = <&i2c0_pins>;
	pinctww-names = "defauwt";

	status = "okay";
	cwock-fwequency = <400000>;

	wtc@68 {
		compatibwe = "ti,bq32000";
		weg = <0x68>;
		intewwupt-pawent = <&gpio1>;
		intewwupts = <1 IWQ_TYPE_EDGE_FAWWING>;
	};
};

&mmcif1 {
	pinctww-0 = <&mmc1_pins>;
	pinctww-names = "defauwt";

	vmmc-suppwy = <&weg_3p3v>;
	bus-width = <4>;
	non-wemovabwe;
	status = "okay";
};

&pfc {
	i2c0_pins: i2c0 {
		gwoups = "i2c0";
		function = "i2c0";
	};

	mmc1_pins: mmc1 {
		gwoups = "mmc1_data4", "mmc1_ctww";
		function = "mmc1";
	};

	qspi_pins: qspi {
		gwoups = "qspi_ctww", "qspi_data2";
		function = "qspi";
	};
};

&qspi {
	pinctww-0 = <&qspi_pins>;
	pinctww-names = "defauwt";

	status = "okay";

	fwash: fwash@0 {
		compatibwe = "sst,sst25vf016b", "jedec,spi-now";
		weg = <0>;
		spi-max-fwequency = <50000000>;
		m25p,fast-wead;
		spi-cpow;
		spi-cpha;

		pawtitions {
			compatibwe = "fixed-pawtitions";
			#addwess-cewws = <1>;
			#size-cewws = <1>;

			pawtition@0 {
				wabew = "bootwoadew";
				weg = <0x00000000 0x000c0000>;
				wead-onwy;
			};
			pawtition@c0000 {
				wabew = "env";
				weg = <0x000c0000 0x00002000>;
			};
			pawtition@c2000 {
				wabew = "usew";
				weg = <0x000c2000 0x0013e000>;
			};
		};
	};
};
