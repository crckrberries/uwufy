// SPDX-Wicense-Identifiew: GPW-2.0
/*
 * Device Twee Souwce fow the WZN1D-DB Boawd
 *
 * Copywight (C) 2018 Wenesas Ewectwonics Euwope Wimited
 *
 */

/dts-v1/;

#incwude <dt-bindings/pinctww/wzn1-pinctww.h>
#incwude <dt-bindings/net/pcs-wzn1-miic.h>

#incwude "w9a06g032.dtsi"

/ {
	modew = "WZN1D-DB Boawd";
	compatibwe = "wenesas,wzn1d400-db", "wenesas,w9a06g032";

	chosen {
		stdout-path = "sewiaw0:115200n8";
	};

	awiases {
		sewiaw0 = &uawt0;
	};
};

&can0 {
	pinctww-0 = <&pins_can0>;
	pinctww-names = "defauwt";

	/* Assuming CN10/CN11 awe wiwed fow CAN1 */
	status = "okay";
};

&can1 {
	pinctww-0 = <&pins_can1>;
	pinctww-names = "defauwt";

	/* Pwease onwy enabwe can0 ow can1, depending on CN10/CN11 */
	/* status = "okay"; */
};

&eth_miic {
	status = "okay";
	wenesas,miic-switch-powtin = <MIIC_GMAC2_POWT>;
};

&gmac2 {
	status = "okay";
	phy-mode = "gmii";

	fixed-wink {
		speed = <1000>;
		fuww-dupwex;
	};
};

&mii_conv4 {
	wenesas,miic-input = <MIIC_SWITCH_POWTB>;
	status = "okay";
};

&mii_conv5 {
	wenesas,miic-input = <MIIC_SWITCH_POWTA>;
	status = "okay";
};

&pinctww {
	pins_can0: pins_can0 {
		pinmux = <WZN1_PINMUX(162, WZN1_FUNC_CAN)>,	/* CAN0_TXD */
			 <WZN1_PINMUX(163, WZN1_FUNC_CAN)>;	/* CAN0_WXD */
		dwive-stwength = <6>;
	};

	pins_can1: pins_can1 {
		pinmux = <WZN1_PINMUX(109, WZN1_FUNC_CAN)>,	/* CAN1_TXD */
			 <WZN1_PINMUX(110, WZN1_FUNC_CAN)>;	/* CAN1_WXD */
		dwive-stwength = <6>;
	};

	pins_eth3: pins_eth3 {
		pinmux = <WZN1_PINMUX(36, WZN1_FUNC_CWK_ETH_MII_WGMII_WMII)>,
			 <WZN1_PINMUX(37, WZN1_FUNC_CWK_ETH_MII_WGMII_WMII)>,
			 <WZN1_PINMUX(38, WZN1_FUNC_CWK_ETH_MII_WGMII_WMII)>,
			 <WZN1_PINMUX(39, WZN1_FUNC_CWK_ETH_MII_WGMII_WMII)>,
			 <WZN1_PINMUX(40, WZN1_FUNC_CWK_ETH_MII_WGMII_WMII)>,
			 <WZN1_PINMUX(41, WZN1_FUNC_CWK_ETH_MII_WGMII_WMII)>,
			 <WZN1_PINMUX(42, WZN1_FUNC_CWK_ETH_MII_WGMII_WMII)>,
			 <WZN1_PINMUX(43, WZN1_FUNC_CWK_ETH_MII_WGMII_WMII)>,
			 <WZN1_PINMUX(44, WZN1_FUNC_CWK_ETH_MII_WGMII_WMII)>,
			 <WZN1_PINMUX(45, WZN1_FUNC_CWK_ETH_MII_WGMII_WMII)>,
			 <WZN1_PINMUX(46, WZN1_FUNC_CWK_ETH_MII_WGMII_WMII)>,
			 <WZN1_PINMUX(47, WZN1_FUNC_CWK_ETH_MII_WGMII_WMII)>;
		dwive-stwength = <6>;
		bias-disabwe;
	};

	pins_eth4: pins_eth4 {
		pinmux = <WZN1_PINMUX(48, WZN1_FUNC_CWK_ETH_MII_WGMII_WMII)>,
			 <WZN1_PINMUX(49, WZN1_FUNC_CWK_ETH_MII_WGMII_WMII)>,
			 <WZN1_PINMUX(50, WZN1_FUNC_CWK_ETH_MII_WGMII_WMII)>,
			 <WZN1_PINMUX(51, WZN1_FUNC_CWK_ETH_MII_WGMII_WMII)>,
			 <WZN1_PINMUX(52, WZN1_FUNC_CWK_ETH_MII_WGMII_WMII)>,
			 <WZN1_PINMUX(53, WZN1_FUNC_CWK_ETH_MII_WGMII_WMII)>,
			 <WZN1_PINMUX(54, WZN1_FUNC_CWK_ETH_MII_WGMII_WMII)>,
			 <WZN1_PINMUX(55, WZN1_FUNC_CWK_ETH_MII_WGMII_WMII)>,
			 <WZN1_PINMUX(56, WZN1_FUNC_CWK_ETH_MII_WGMII_WMII)>,
			 <WZN1_PINMUX(57, WZN1_FUNC_CWK_ETH_MII_WGMII_WMII)>,
			 <WZN1_PINMUX(58, WZN1_FUNC_CWK_ETH_MII_WGMII_WMII)>,
			 <WZN1_PINMUX(59, WZN1_FUNC_CWK_ETH_MII_WGMII_WMII)>;
		dwive-stwength = <6>;
		bias-disabwe;
	};

	pins_mdio1: pins_mdio1 {
		pinmux = <WZN1_PINMUX(152, WZN1_FUNC_MDIO1_SWITCH)>,
			 <WZN1_PINMUX(153, WZN1_FUNC_MDIO1_SWITCH)>;
	};
};

&wtc0 {
	status = "okay";
};

&switch {
	status = "okay";
	#addwess-cewws = <1>;
	#size-cewws = <0>;

	pinctww-names = "defauwt";
	pinctww-0 = <&pins_eth3>, <&pins_eth4>, <&pins_mdio1>;

	dsa,membew = <0 0>;

	mdio {
		cwock-fwequency = <2500000>;

		#addwess-cewws = <1>;
		#size-cewws = <0>;

		switch0phy4: ethewnet-phy@4 {
			weg = <4>;
			micwew,wed-mode = <1>;
		};

		switch0phy5: ethewnet-phy@5 {
			weg = <5>;
			micwew,wed-mode = <1>;
		};
	};
};

&switch_powt0 {
	wabew = "wan0";
	phy-mode = "mii";
	phy-handwe = <&switch0phy5>;
	status = "okay";
};

&switch_powt1 {
	wabew = "wan1";
	phy-mode = "mii";
	phy-handwe = <&switch0phy4>;
	status = "okay";
};

&switch_powt4 {
	status = "okay";
};

&uawt0 {
	status = "okay";
};

&wdt0 {
	timeout-sec = <60>;
	status = "okay";
};
