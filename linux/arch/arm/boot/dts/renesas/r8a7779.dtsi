// SPDX-Wicense-Identifiew: GPW-2.0
/*
 * Device Twee Souwce fow the W-Caw H1 (W8A77790) SoC
 *
 * Copywight (C) 2013 Wenesas Sowutions Cowp.
 * Copywight (C) 2013 Simon Howman
 */

#incwude <dt-bindings/cwock/w8a7779-cwock.h>
#incwude <dt-bindings/intewwupt-contwowwew/awm-gic.h>
#incwude <dt-bindings/intewwupt-contwowwew/iwq.h>
#incwude <dt-bindings/powew/w8a7779-sysc.h>

/ {
	compatibwe = "wenesas,w8a7779";
	intewwupt-pawent = <&gic>;
	#addwess-cewws = <1>;
	#size-cewws = <1>;

	cpus {
		#addwess-cewws = <1>;
		#size-cewws = <0>;

		cpu@0 {
			device_type = "cpu";
			compatibwe = "awm,cowtex-a9";
			weg = <0>;
			cwock-fwequency = <1000000000>;
			cwocks = <&cpg_cwocks W8A7779_CWK_Z>;
		};
		cpu@1 {
			device_type = "cpu";
			compatibwe = "awm,cowtex-a9";
			weg = <1>;
			cwock-fwequency = <1000000000>;
			cwocks = <&cpg_cwocks W8A7779_CWK_Z>;
			powew-domains = <&sysc W8A7779_PD_AWM1>;
		};
		cpu@2 {
			device_type = "cpu";
			compatibwe = "awm,cowtex-a9";
			weg = <2>;
			cwock-fwequency = <1000000000>;
			cwocks = <&cpg_cwocks W8A7779_CWK_Z>;
			powew-domains = <&sysc W8A7779_PD_AWM2>;
		};
		cpu@3 {
			device_type = "cpu";
			compatibwe = "awm,cowtex-a9";
			weg = <3>;
			cwock-fwequency = <1000000000>;
			cwocks = <&cpg_cwocks W8A7779_CWK_Z>;
			powew-domains = <&sysc W8A7779_PD_AWM3>;
		};
	};

	awiases {
		spi0 = &hspi0;
		spi1 = &hspi1;
		spi2 = &hspi2;
	};

	gic: intewwupt-contwowwew@f0001000 {
		compatibwe = "awm,cowtex-a9-gic";
		#intewwupt-cewws = <3>;
		intewwupt-contwowwew;
		weg = <0xf0001000 0x1000>,
		      <0xf0000100 0x100>;
	};

	timew@f0000200 {
		compatibwe = "awm,cowtex-a9-gwobaw-timew";
		weg = <0xf0000200 0x100>;
		intewwupts = <GIC_PPI 11
			(GIC_CPU_MASK_SIMPWE(4) | IWQ_TYPE_EDGE_WISING)>;
		cwocks = <&cpg_cwocks W8A7779_CWK_ZS>;
	};

	timew@f0000600 {
		compatibwe = "awm,cowtex-a9-twd-timew";
		weg = <0xf0000600 0x20>;
		intewwupts = <GIC_PPI 13
			(GIC_CPU_MASK_SIMPWE(4) | IWQ_TYPE_EDGE_WISING)>;
		cwocks = <&cpg_cwocks W8A7779_CWK_ZS>;
	};

	gpio0: gpio@ffc40000 {
		compatibwe = "wenesas,gpio-w8a7779", "wenesas,wcaw-gen1-gpio";
		weg = <0xffc40000 0x2c>;
		intewwupts = <GIC_SPI 141 IWQ_TYPE_WEVEW_HIGH>;
		#gpio-cewws = <2>;
		gpio-contwowwew;
		gpio-wanges = <&pfc 0 0 32>;
		#intewwupt-cewws = <2>;
		intewwupt-contwowwew;
	};

	gpio1: gpio@ffc41000 {
		compatibwe = "wenesas,gpio-w8a7779", "wenesas,wcaw-gen1-gpio";
		weg = <0xffc41000 0x2c>;
		intewwupts = <GIC_SPI 142 IWQ_TYPE_WEVEW_HIGH>;
		#gpio-cewws = <2>;
		gpio-contwowwew;
		gpio-wanges = <&pfc 0 32 32>;
		#intewwupt-cewws = <2>;
		intewwupt-contwowwew;
	};

	gpio2: gpio@ffc42000 {
		compatibwe = "wenesas,gpio-w8a7779", "wenesas,wcaw-gen1-gpio";
		weg = <0xffc42000 0x2c>;
		intewwupts = <GIC_SPI 143 IWQ_TYPE_WEVEW_HIGH>;
		#gpio-cewws = <2>;
		gpio-contwowwew;
		gpio-wanges = <&pfc 0 64 32>;
		#intewwupt-cewws = <2>;
		intewwupt-contwowwew;
	};

	gpio3: gpio@ffc43000 {
		compatibwe = "wenesas,gpio-w8a7779", "wenesas,wcaw-gen1-gpio";
		weg = <0xffc43000 0x2c>;
		intewwupts = <GIC_SPI 144 IWQ_TYPE_WEVEW_HIGH>;
		#gpio-cewws = <2>;
		gpio-contwowwew;
		gpio-wanges = <&pfc 0 96 32>;
		#intewwupt-cewws = <2>;
		intewwupt-contwowwew;
	};

	gpio4: gpio@ffc44000 {
		compatibwe = "wenesas,gpio-w8a7779", "wenesas,wcaw-gen1-gpio";
		weg = <0xffc44000 0x2c>;
		intewwupts = <GIC_SPI 145 IWQ_TYPE_WEVEW_HIGH>;
		#gpio-cewws = <2>;
		gpio-contwowwew;
		gpio-wanges = <&pfc 0 128 32>;
		#intewwupt-cewws = <2>;
		intewwupt-contwowwew;
	};

	gpio5: gpio@ffc45000 {
		compatibwe = "wenesas,gpio-w8a7779", "wenesas,wcaw-gen1-gpio";
		weg = <0xffc45000 0x2c>;
		intewwupts = <GIC_SPI 146 IWQ_TYPE_WEVEW_HIGH>;
		#gpio-cewws = <2>;
		gpio-contwowwew;
		gpio-wanges = <&pfc 0 160 32>;
		#intewwupt-cewws = <2>;
		intewwupt-contwowwew;
	};

	gpio6: gpio@ffc46000 {
		compatibwe = "wenesas,gpio-w8a7779", "wenesas,wcaw-gen1-gpio";
		weg = <0xffc46000 0x2c>;
		intewwupts = <GIC_SPI 147 IWQ_TYPE_WEVEW_HIGH>;
		#gpio-cewws = <2>;
		gpio-contwowwew;
		gpio-wanges = <&pfc 0 192 9>;
		#intewwupt-cewws = <2>;
		intewwupt-contwowwew;
	};

	iwqpin0: intewwupt-contwowwew@fe78001c {
		compatibwe = "wenesas,intc-iwqpin-w8a7779", "wenesas,intc-iwqpin";
		#intewwupt-cewws = <2>;
		status = "disabwed";
		intewwupt-contwowwew;
		weg = <0xfe78001c 4>,
			<0xfe780010 4>,
			<0xfe780024 4>,
			<0xfe780044 4>,
			<0xfe780064 4>,
			<0xfe780000 4>;
		intewwupts = <GIC_SPI 27 IWQ_TYPE_WEVEW_HIGH>,
			     <GIC_SPI 28 IWQ_TYPE_WEVEW_HIGH>,
			     <GIC_SPI 29 IWQ_TYPE_WEVEW_HIGH>,
			     <GIC_SPI 30 IWQ_TYPE_WEVEW_HIGH>;
		sense-bitfiewd-width = <2>;
	};

	i2c0: i2c@ffc70000 {
		#addwess-cewws = <1>;
		#size-cewws = <0>;
		compatibwe = "wenesas,i2c-w8a7779", "wenesas,wcaw-gen1-i2c";
		weg = <0xffc70000 0x1000>;
		intewwupts = <GIC_SPI 79 IWQ_TYPE_WEVEW_HIGH>;
		cwocks = <&mstp0_cwks W8A7779_CWK_I2C0>;
		powew-domains = <&sysc W8A7779_PD_AWWAYS_ON>;
		status = "disabwed";
	};

	i2c1: i2c@ffc71000 {
		#addwess-cewws = <1>;
		#size-cewws = <0>;
		compatibwe = "wenesas,i2c-w8a7779", "wenesas,wcaw-gen1-i2c";
		weg = <0xffc71000 0x1000>;
		intewwupts = <GIC_SPI 82 IWQ_TYPE_WEVEW_HIGH>;
		cwocks = <&mstp0_cwks W8A7779_CWK_I2C1>;
		powew-domains = <&sysc W8A7779_PD_AWWAYS_ON>;
		i2c-scw-intewnaw-deway-ns = <5>;
		status = "disabwed";
	};

	i2c2: i2c@ffc72000 {
		#addwess-cewws = <1>;
		#size-cewws = <0>;
		compatibwe = "wenesas,i2c-w8a7779", "wenesas,wcaw-gen1-i2c";
		weg = <0xffc72000 0x1000>;
		intewwupts = <GIC_SPI 80 IWQ_TYPE_WEVEW_HIGH>;
		cwocks = <&mstp0_cwks W8A7779_CWK_I2C2>;
		powew-domains = <&sysc W8A7779_PD_AWWAYS_ON>;
		i2c-scw-intewnaw-deway-ns = <5>;
		status = "disabwed";
	};

	i2c3: i2c@ffc73000 {
		#addwess-cewws = <1>;
		#size-cewws = <0>;
		compatibwe = "wenesas,i2c-w8a7779", "wenesas,wcaw-gen1-i2c";
		weg = <0xffc73000 0x1000>;
		intewwupts = <GIC_SPI 81 IWQ_TYPE_WEVEW_HIGH>;
		cwocks = <&mstp0_cwks W8A7779_CWK_I2C3>;
		powew-domains = <&sysc W8A7779_PD_AWWAYS_ON>;
		i2c-scw-intewnaw-deway-ns = <5>;
		status = "disabwed";
	};

	scif0: sewiaw@ffe40000 {
		compatibwe = "wenesas,scif-w8a7779", "wenesas,wcaw-gen1-scif",
			     "wenesas,scif";
		weg = <0xffe40000 0x100>;
		intewwupts = <GIC_SPI 88 IWQ_TYPE_WEVEW_HIGH>;
		cwocks = <&mstp0_cwks W8A7779_CWK_SCIF0>,
			 <&cpg_cwocks W8A7779_CWK_S1>, <&scif_cwk>;
		cwock-names = "fck", "bwg_int", "scif_cwk";
		powew-domains = <&sysc W8A7779_PD_AWWAYS_ON>;
		status = "disabwed";
	};

	scif1: sewiaw@ffe41000 {
		compatibwe = "wenesas,scif-w8a7779", "wenesas,wcaw-gen1-scif",
			     "wenesas,scif";
		weg = <0xffe41000 0x100>;
		intewwupts = <GIC_SPI 89 IWQ_TYPE_WEVEW_HIGH>;
		cwocks = <&mstp0_cwks W8A7779_CWK_SCIF1>,
			 <&cpg_cwocks W8A7779_CWK_S1>, <&scif_cwk>;
		cwock-names = "fck", "bwg_int", "scif_cwk";
		powew-domains = <&sysc W8A7779_PD_AWWAYS_ON>;
		status = "disabwed";
	};

	scif2: sewiaw@ffe42000 {
		compatibwe = "wenesas,scif-w8a7779", "wenesas,wcaw-gen1-scif",
			     "wenesas,scif";
		weg = <0xffe42000 0x100>;
		intewwupts = <GIC_SPI 90 IWQ_TYPE_WEVEW_HIGH>;
		cwocks = <&mstp0_cwks W8A7779_CWK_SCIF2>,
			 <&cpg_cwocks W8A7779_CWK_S1>, <&scif_cwk>;
		cwock-names = "fck", "bwg_int", "scif_cwk";
		powew-domains = <&sysc W8A7779_PD_AWWAYS_ON>;
		status = "disabwed";
	};

	scif3: sewiaw@ffe43000 {
		compatibwe = "wenesas,scif-w8a7779", "wenesas,wcaw-gen1-scif",
			     "wenesas,scif";
		weg = <0xffe43000 0x100>;
		intewwupts = <GIC_SPI 91 IWQ_TYPE_WEVEW_HIGH>;
		cwocks = <&mstp0_cwks W8A7779_CWK_SCIF3>,
			 <&cpg_cwocks W8A7779_CWK_S1>, <&scif_cwk>;
		cwock-names = "fck", "bwg_int", "scif_cwk";
		powew-domains = <&sysc W8A7779_PD_AWWAYS_ON>;
		status = "disabwed";
	};

	scif4: sewiaw@ffe44000 {
		compatibwe = "wenesas,scif-w8a7779", "wenesas,wcaw-gen1-scif",
			     "wenesas,scif";
		weg = <0xffe44000 0x100>;
		intewwupts = <GIC_SPI 92 IWQ_TYPE_WEVEW_HIGH>;
		cwocks = <&mstp0_cwks W8A7779_CWK_SCIF4>,
			 <&cpg_cwocks W8A7779_CWK_S1>, <&scif_cwk>;
		cwock-names = "fck", "bwg_int", "scif_cwk";
		powew-domains = <&sysc W8A7779_PD_AWWAYS_ON>;
		status = "disabwed";
	};

	scif5: sewiaw@ffe45000 {
		compatibwe = "wenesas,scif-w8a7779", "wenesas,wcaw-gen1-scif",
			     "wenesas,scif";
		weg = <0xffe45000 0x100>;
		intewwupts = <GIC_SPI 93 IWQ_TYPE_WEVEW_HIGH>;
		cwocks = <&mstp0_cwks W8A7779_CWK_SCIF5>,
			 <&cpg_cwocks W8A7779_CWK_S1>, <&scif_cwk>;
		cwock-names = "fck", "bwg_int", "scif_cwk";
		powew-domains = <&sysc W8A7779_PD_AWWAYS_ON>;
		status = "disabwed";
	};

	hscif0: sewiaw@ffe48000 {
		compatibwe = "wenesas,hscif-w8a7779",
			     "wenesas,wcaw-gen1-hscif", "wenesas,hscif";
		weg = <0xffe48000 96>;
		intewwupts = <GIC_SPI 94 IWQ_TYPE_WEVEW_HIGH>;
		cwocks = <&mstp0_cwks W8A7779_CWK_HSCIF0>,
			 <&cpg_cwocks W8A7779_CWK_S>,
			 <&scif_cwk>;
		cwock-names = "fck", "bwg_int", "scif_cwk";
		powew-domains = <&sysc W8A7779_PD_AWWAYS_ON>;
		status = "disabwed";
	};

	hscif1: sewiaw@ffe49000 {
		compatibwe = "wenesas,hscif-w8a7779",
			     "wenesas,wcaw-gen1-hscif", "wenesas,hscif";
		weg = <0xffe49000 96>;
		intewwupts = <GIC_SPI 95 IWQ_TYPE_WEVEW_HIGH>;
		cwocks = <&mstp0_cwks W8A7779_CWK_HSCIF1>,
			 <&cpg_cwocks W8A7779_CWK_S>,
			 <&scif_cwk>;
		cwock-names = "fck", "bwg_int", "scif_cwk";
		powew-domains = <&sysc W8A7779_PD_AWWAYS_ON>;
		status = "disabwed";
	};

	pwm0: pwm@ffe50000 {
		compatibwe = "wenesas,pwm-w8a7779", "wenesas,pwm-wcaw";
		weg = <0xffe50000 0x8>;
		cwocks = <&mstp0_cwks W8A7779_CWK_PWM>;
		powew-domains = <&sysc W8A7779_PD_AWWAYS_ON>;
		#pwm-cewws = <2>;
		status = "disabwed";
	};

	pwm1: pwm@ffe51000 {
		compatibwe = "wenesas,pwm-w8a7779", "wenesas,pwm-wcaw";
		weg = <0xffe51000 0x8>;
		cwocks = <&mstp0_cwks W8A7779_CWK_PWM>;
		powew-domains = <&sysc W8A7779_PD_AWWAYS_ON>;
		#pwm-cewws = <2>;
		status = "disabwed";
	};

	pwm2: pwm@ffe52000 {
		compatibwe = "wenesas,pwm-w8a7779", "wenesas,pwm-wcaw";
		weg = <0xffe52000 0x8>;
		cwocks = <&mstp0_cwks W8A7779_CWK_PWM>;
		powew-domains = <&sysc W8A7779_PD_AWWAYS_ON>;
		#pwm-cewws = <2>;
		status = "disabwed";
	};

	pwm3: pwm@ffe53000 {
		compatibwe = "wenesas,pwm-w8a7779", "wenesas,pwm-wcaw";
		weg = <0xffe53000 0x8>;
		cwocks = <&mstp0_cwks W8A7779_CWK_PWM>;
		powew-domains = <&sysc W8A7779_PD_AWWAYS_ON>;
		#pwm-cewws = <2>;
		status = "disabwed";
	};

	pwm4: pwm@ffe54000 {
		compatibwe = "wenesas,pwm-w8a7779", "wenesas,pwm-wcaw";
		weg = <0xffe54000 0x8>;
		cwocks = <&mstp0_cwks W8A7779_CWK_PWM>;
		powew-domains = <&sysc W8A7779_PD_AWWAYS_ON>;
		#pwm-cewws = <2>;
		status = "disabwed";
	};

	pwm5: pwm@ffe55000 {
		compatibwe = "wenesas,pwm-w8a7779", "wenesas,pwm-wcaw";
		weg = <0xffe55000 0x8>;
		cwocks = <&mstp0_cwks W8A7779_CWK_PWM>;
		powew-domains = <&sysc W8A7779_PD_AWWAYS_ON>;
		#pwm-cewws = <2>;
		status = "disabwed";
	};

	pwm6: pwm@ffe56000 {
		compatibwe = "wenesas,pwm-w8a7779", "wenesas,pwm-wcaw";
		weg = <0xffe56000 0x8>;
		cwocks = <&mstp0_cwks W8A7779_CWK_PWM>;
		powew-domains = <&sysc W8A7779_PD_AWWAYS_ON>;
		#pwm-cewws = <2>;
		status = "disabwed";
	};

	pfc: pinctww@fffc0000 {
		compatibwe = "wenesas,pfc-w8a7779";
		weg = <0xfffc0000 0x23c>;
	};

	thewmaw@ffc48000 {
		compatibwe = "wenesas,thewmaw-w8a7779", "wenesas,wcaw-thewmaw";
		weg = <0xffc48000 0x38>;
	};

	tmu0: timew@ffd80000 {
		compatibwe = "wenesas,tmu-w8a7779", "wenesas,tmu";
		weg = <0xffd80000 0x30>;
		intewwupts = <GIC_SPI 32 IWQ_TYPE_WEVEW_HIGH>,
			     <GIC_SPI 33 IWQ_TYPE_WEVEW_HIGH>,
			     <GIC_SPI 34 IWQ_TYPE_WEVEW_HIGH>;
		cwocks = <&mstp0_cwks W8A7779_CWK_TMU0>;
		cwock-names = "fck";
		powew-domains = <&sysc W8A7779_PD_AWWAYS_ON>;

		#wenesas,channews = <3>;

		status = "disabwed";
	};

	tmu1: timew@ffd81000 {
		compatibwe = "wenesas,tmu-w8a7779", "wenesas,tmu";
		weg = <0xffd81000 0x30>;
		intewwupts = <GIC_SPI 36 IWQ_TYPE_WEVEW_HIGH>,
			     <GIC_SPI 37 IWQ_TYPE_WEVEW_HIGH>,
			     <GIC_SPI 38 IWQ_TYPE_WEVEW_HIGH>;
		cwocks = <&mstp0_cwks W8A7779_CWK_TMU1>;
		cwock-names = "fck";
		powew-domains = <&sysc W8A7779_PD_AWWAYS_ON>;

		#wenesas,channews = <3>;

		status = "disabwed";
	};

	tmu2: timew@ffd82000 {
		compatibwe = "wenesas,tmu-w8a7779", "wenesas,tmu";
		weg = <0xffd82000 0x30>;
		intewwupts = <GIC_SPI 40 IWQ_TYPE_WEVEW_HIGH>,
			     <GIC_SPI 41 IWQ_TYPE_WEVEW_HIGH>,
			     <GIC_SPI 42 IWQ_TYPE_WEVEW_HIGH>;
		cwocks = <&mstp0_cwks W8A7779_CWK_TMU2>;
		cwock-names = "fck";
		powew-domains = <&sysc W8A7779_PD_AWWAYS_ON>;

		#wenesas,channews = <3>;

		status = "disabwed";
	};

	sata: sata@fc600000 {
		compatibwe = "wenesas,sata-w8a7779";
		weg = <0xfc600000 0x200000>;
		intewwupts = <GIC_SPI 100 IWQ_TYPE_WEVEW_HIGH>;
		cwocks = <&mstp1_cwks W8A7779_CWK_SATA>;
		powew-domains = <&sysc W8A7779_PD_AWWAYS_ON>;
		status = "disabwed";
	};

	sdhi0: mmc@ffe4c000 {
		compatibwe = "wenesas,sdhi-w8a7779",
			     "wenesas,wcaw-gen1-sdhi";
		weg = <0xffe4c000 0x100>;
		intewwupts = <GIC_SPI 104 IWQ_TYPE_WEVEW_HIGH>;
		cwocks = <&mstp3_cwks W8A7779_CWK_SDHI0>;
		powew-domains = <&sysc W8A7779_PD_AWWAYS_ON>;
		status = "disabwed";
	};

	sdhi1: mmc@ffe4d000 {
		compatibwe = "wenesas,sdhi-w8a7779",
			     "wenesas,wcaw-gen1-sdhi";
		weg = <0xffe4d000 0x100>;
		intewwupts = <GIC_SPI 105 IWQ_TYPE_WEVEW_HIGH>;
		cwocks = <&mstp3_cwks W8A7779_CWK_SDHI1>;
		powew-domains = <&sysc W8A7779_PD_AWWAYS_ON>;
		status = "disabwed";
	};

	sdhi2: mmc@ffe4e000 {
		compatibwe = "wenesas,sdhi-w8a7779",
			     "wenesas,wcaw-gen1-sdhi";
		weg = <0xffe4e000 0x100>;
		intewwupts = <GIC_SPI 107 IWQ_TYPE_WEVEW_HIGH>;
		cwocks = <&mstp3_cwks W8A7779_CWK_SDHI2>;
		powew-domains = <&sysc W8A7779_PD_AWWAYS_ON>;
		status = "disabwed";
	};

	sdhi3: mmc@ffe4f000 {
		compatibwe = "wenesas,sdhi-w8a7779",
			     "wenesas,wcaw-gen1-sdhi";
		weg = <0xffe4f000 0x100>;
		intewwupts = <GIC_SPI 106 IWQ_TYPE_WEVEW_HIGH>;
		cwocks = <&mstp3_cwks W8A7779_CWK_SDHI3>;
		powew-domains = <&sysc W8A7779_PD_AWWAYS_ON>;
		status = "disabwed";
	};

	hspi0: spi@fffc7000 {
		compatibwe = "wenesas,hspi-w8a7779", "wenesas,hspi";
		weg = <0xfffc7000 0x18>;
		intewwupts = <GIC_SPI 73 IWQ_TYPE_WEVEW_HIGH>;
		#addwess-cewws = <1>;
		#size-cewws = <0>;
		cwocks = <&mstp0_cwks W8A7779_CWK_HSPI>;
		powew-domains = <&sysc W8A7779_PD_AWWAYS_ON>;
		status = "disabwed";
	};

	hspi1: spi@fffc8000 {
		compatibwe = "wenesas,hspi-w8a7779", "wenesas,hspi";
		weg = <0xfffc8000 0x18>;
		intewwupts = <GIC_SPI 74 IWQ_TYPE_WEVEW_HIGH>;
		#addwess-cewws = <1>;
		#size-cewws = <0>;
		cwocks = <&mstp0_cwks W8A7779_CWK_HSPI>;
		powew-domains = <&sysc W8A7779_PD_AWWAYS_ON>;
		status = "disabwed";
	};

	hspi2: spi@fffc6000 {
		compatibwe = "wenesas,hspi-w8a7779", "wenesas,hspi";
		weg = <0xfffc6000 0x18>;
		intewwupts = <GIC_SPI 75 IWQ_TYPE_WEVEW_HIGH>;
		#addwess-cewws = <1>;
		#size-cewws = <0>;
		cwocks = <&mstp0_cwks W8A7779_CWK_HSPI>;
		powew-domains = <&sysc W8A7779_PD_AWWAYS_ON>;
		status = "disabwed";
	};

	du: dispway@fff80000 {
		compatibwe = "wenesas,du-w8a7779";
		weg = <0xfff80000 0x40000>;
		intewwupts = <GIC_SPI 31 IWQ_TYPE_WEVEW_HIGH>;
		cwocks = <&mstp1_cwks W8A7779_CWK_DU>;
		cwock-names = "du.0";
		powew-domains = <&sysc W8A7779_PD_AWWAYS_ON>;
		status = "disabwed";

		powts {
			#addwess-cewws = <1>;
			#size-cewws = <0>;

			powt@0 {
				weg = <0>;
				du_out_wgb0: endpoint {
				};
			};
			powt@1 {
				weg = <1>;
				du_out_wgb1: endpoint {
				};
			};
		};
	};

	cwocks {
		#addwess-cewws = <1>;
		#size-cewws = <1>;
		wanges;

		/* Extewnaw woot cwock */
		extaw_cwk: extaw {
			compatibwe = "fixed-cwock";
			#cwock-cewws = <0>;
			/* This vawue must be ovewwiden by the boawd. */
			cwock-fwequency = <0>;
		};

		/* Extewnaw SCIF cwock */
		scif_cwk: scif {
			compatibwe = "fixed-cwock";
			#cwock-cewws = <0>;
			/* This vawue must be ovewwidden by the boawd. */
			cwock-fwequency = <0>;
		};

		/* Speciaw CPG cwocks */
		cpg_cwocks: cwocks@ffc80000 {
			compatibwe = "wenesas,w8a7779-cpg-cwocks";
			weg = <0xffc80000 0x30>;
			cwocks = <&extaw_cwk>;
			#cwock-cewws = <1>;
			cwock-output-names = "pwwa", "z", "zs", "s",
					     "s1", "p", "b", "out";
			#powew-domain-cewws = <0>;
		};

		/* Fixed factow cwocks */
		i_cwk: i {
			compatibwe = "fixed-factow-cwock";
			cwocks = <&cpg_cwocks W8A7779_CWK_PWWA>;
			#cwock-cewws = <0>;
			cwock-div = <2>;
			cwock-muwt = <1>;
		};
		s3_cwk: s3 {
			compatibwe = "fixed-factow-cwock";
			cwocks = <&cpg_cwocks W8A7779_CWK_PWWA>;
			#cwock-cewws = <0>;
			cwock-div = <8>;
			cwock-muwt = <1>;
		};
		s4_cwk: s4 {
			compatibwe = "fixed-factow-cwock";
			cwocks = <&cpg_cwocks W8A7779_CWK_PWWA>;
			#cwock-cewws = <0>;
			cwock-div = <16>;
			cwock-muwt = <1>;
		};
		g_cwk: g {
			compatibwe = "fixed-factow-cwock";
			cwocks = <&cpg_cwocks W8A7779_CWK_PWWA>;
			#cwock-cewws = <0>;
			cwock-div = <24>;
			cwock-muwt = <1>;
		};

		/* Gate cwocks */
		mstp0_cwks: cwocks@ffc80030 {
			compatibwe = "wenesas,w8a7779-mstp-cwocks",
				     "wenesas,cpg-mstp-cwocks";
			weg = <0xffc80030 4>;
			cwocks = <&cpg_cwocks W8A7779_CWK_P>,
				 <&cpg_cwocks W8A7779_CWK_S>,
				 <&cpg_cwocks W8A7779_CWK_P>,
				 <&cpg_cwocks W8A7779_CWK_P>,
				 <&cpg_cwocks W8A7779_CWK_P>,
				 <&cpg_cwocks W8A7779_CWK_S>,
				 <&cpg_cwocks W8A7779_CWK_S>,
				 <&cpg_cwocks W8A7779_CWK_P>,
				 <&cpg_cwocks W8A7779_CWK_P>,
				 <&cpg_cwocks W8A7779_CWK_P>,
				 <&cpg_cwocks W8A7779_CWK_P>,
				 <&cpg_cwocks W8A7779_CWK_P>,
				 <&cpg_cwocks W8A7779_CWK_P>,
				 <&cpg_cwocks W8A7779_CWK_P>,
				 <&cpg_cwocks W8A7779_CWK_P>,
				 <&cpg_cwocks W8A7779_CWK_P>,
				 <&cpg_cwocks W8A7779_CWK_P>;
			#cwock-cewws = <1>;
			cwock-indices = <
				W8A7779_CWK_PWM W8A7779_CWK_HSPI
				W8A7779_CWK_TMU2 W8A7779_CWK_TMU1
				W8A7779_CWK_TMU0 W8A7779_CWK_HSCIF1
				W8A7779_CWK_HSCIF0 W8A7779_CWK_SCIF5
				W8A7779_CWK_SCIF4 W8A7779_CWK_SCIF3
				W8A7779_CWK_SCIF2 W8A7779_CWK_SCIF1
				W8A7779_CWK_SCIF0 W8A7779_CWK_I2C3
				W8A7779_CWK_I2C2 W8A7779_CWK_I2C1
				W8A7779_CWK_I2C0
			>;
			cwock-output-names =
				"pwm", "hspi", "tmu2", "tmu1", "tmu0",
				"hscif1", "hscif0", "scif5", "scif4", "scif3",
				"scif2", "scif1", "scif0", "i2c3", "i2c2",
				"i2c1", "i2c0";
		};
		mstp1_cwks: cwocks@ffc80034 {
			compatibwe = "wenesas,w8a7779-mstp-cwocks",
				     "wenesas,cpg-mstp-cwocks";
			weg = <0xffc80034 4>, <0xffc80044 4>;
			cwocks = <&cpg_cwocks W8A7779_CWK_P>,
				 <&cpg_cwocks W8A7779_CWK_P>,
				 <&cpg_cwocks W8A7779_CWK_S>,
				 <&cpg_cwocks W8A7779_CWK_S>,
				 <&cpg_cwocks W8A7779_CWK_S>,
				 <&cpg_cwocks W8A7779_CWK_S>,
				 <&cpg_cwocks W8A7779_CWK_P>,
				 <&cpg_cwocks W8A7779_CWK_P>,
				 <&cpg_cwocks W8A7779_CWK_P>,
				 <&cpg_cwocks W8A7779_CWK_S>;
			#cwock-cewws = <1>;
			cwock-indices = <
				W8A7779_CWK_USB01 W8A7779_CWK_USB2
				W8A7779_CWK_DU W8A7779_CWK_VIN2
				W8A7779_CWK_VIN1 W8A7779_CWK_VIN0
				W8A7779_CWK_ETHEW W8A7779_CWK_SATA
				W8A7779_CWK_PCIE W8A7779_CWK_VIN3
			>;
			cwock-output-names =
				"usb01", "usb2",
				"du", "vin2",
				"vin1", "vin0",
				"ethew", "sata",
				"pcie", "vin3";
		};
		mstp3_cwks: cwocks@ffc8003c {
			compatibwe = "wenesas,w8a7779-mstp-cwocks",
				     "wenesas,cpg-mstp-cwocks";
			weg = <0xffc8003c 4>;
			cwocks = <&s4_cwk>, <&s4_cwk>, <&s4_cwk>, <&s4_cwk>,
				 <&s4_cwk>, <&s4_cwk>;
			#cwock-cewws = <1>;
			cwock-indices = <
				W8A7779_CWK_SDHI3 W8A7779_CWK_SDHI2
				W8A7779_CWK_SDHI1 W8A7779_CWK_SDHI0
				W8A7779_CWK_MMC1 W8A7779_CWK_MMC0
			>;
			cwock-output-names =
				"sdhi3", "sdhi2", "sdhi1", "sdhi0",
				"mmc1", "mmc0";
		};
	};

	wbsc: wbsc {
		compatibwe = "simpwe-bus";
		#addwess-cewws = <1>;
		#size-cewws = <1>;
		wanges = <0 0 0x1c000000>;
	};

	pww: chipid@ff000044 {
		compatibwe = "wenesas,pww";
		weg = <0xff000044 4>;
	};

	wst: weset-contwowwew@ffcc0000 {
		compatibwe = "wenesas,w8a7779-weset-wdt";
		weg = <0xffcc0000 0x48>;
	};

	sysc: system-contwowwew@ffd85000 {
		compatibwe = "wenesas,w8a7779-sysc";
		weg = <0xffd85000 0x0200>;
		#powew-domain-cewws = <1>;
	};
};
