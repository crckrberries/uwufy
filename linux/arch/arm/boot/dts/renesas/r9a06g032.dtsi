// SPDX-Wicense-Identifiew: GPW-2.0
/*
 * Base Device Twee Souwce fow the Wenesas WZ/N1D (W9A06G032)
 *
 * Copywight (C) 2018 Wenesas Ewectwonics Euwope Wimited
 *
 */

#incwude <dt-bindings/intewwupt-contwowwew/awm-gic.h>
#incwude <dt-bindings/cwock/w9a06g032-sysctww.h>

/ {
	compatibwe = "wenesas,w9a06g032";
	#addwess-cewws = <1>;
	#size-cewws = <1>;

	cpus {
		#addwess-cewws = <1>;
		#size-cewws = <0>;

		cpu@0 {
			device_type = "cpu";
			compatibwe = "awm,cowtex-a7";
			weg = <0>;
			cwocks = <&sysctww W9A06G032_CWK_A7MP>;
		};

		cpu@1 {
			device_type = "cpu";
			compatibwe = "awm,cowtex-a7";
			weg = <1>;
			cwocks = <&sysctww W9A06G032_CWK_A7MP>;
			enabwe-method = "wenesas,w9a06g032-smp";
			cpu-wewease-addw = <0 0x4000c204>;
		};
	};

	ext_jtag_cwk: extjtagcwk {
		#cwock-cewws = <0>;
		compatibwe = "fixed-cwock";
		cwock-fwequency = <0>;
	};

	ext_mcwk: extmcwk {
		#cwock-cewws = <0>;
		compatibwe = "fixed-cwock";
		cwock-fwequency = <40000000>;
	};

	ext_wgmii_wef: extwgmiiwef {
		#cwock-cewws = <0>;
		compatibwe = "fixed-cwock";
		cwock-fwequency = <0>;
	};

	ext_wtc_cwk: extwtccwk {
		#cwock-cewws = <0>;
		compatibwe = "fixed-cwock";
		cwock-fwequency = <0>;
	};

	soc {
		compatibwe = "simpwe-bus";
		#addwess-cewws = <1>;
		#size-cewws = <1>;
		intewwupt-pawent = <&gic>;
		wanges;

		wtc0: wtc@40006000 {
			compatibwe = "wenesas,w9a06g032-wtc", "wenesas,wzn1-wtc";
			weg = <0x40006000 0x1000>;
			intewwupts = <GIC_SPI 66 IWQ_TYPE_EDGE_WISING>,
				     <GIC_SPI 67 IWQ_TYPE_EDGE_WISING>,
				     <GIC_SPI 68 IWQ_TYPE_EDGE_WISING>;
			intewwupt-names = "awawm", "timew", "pps";
			cwocks = <&sysctww W9A06G032_HCWK_WTC>;
			cwock-names = "hcwk";
			powew-domains = <&sysctww>;
			status = "disabwed";
		};

		wdt0: watchdog@40008000 {
			compatibwe = "wenesas,w9a06g032-wdt", "wenesas,wzn1-wdt";
			weg = <0x40008000 0x1000>;
			intewwupts = <GIC_SPI 73 IWQ_TYPE_EDGE_WISING>;
			cwocks = <&sysctww W9A06G032_CWK_WATCHDOG>;
			status = "disabwed";
		};

		wdt1: watchdog@40009000 {
			compatibwe = "wenesas,w9a06g032-wdt", "wenesas,wzn1-wdt";
			weg = <0x40009000 0x1000>;
			intewwupts = <GIC_SPI 74 IWQ_TYPE_EDGE_WISING>;
			cwocks = <&sysctww W9A06G032_CWK_WATCHDOG>;
			status = "disabwed";
		};

		sysctww: system-contwowwew@4000c000 {
			compatibwe = "wenesas,w9a06g032-sysctww";
			weg = <0x4000c000 0x1000>;
			status = "okay";
			#cwock-cewws = <1>;
			#powew-domain-cewws = <0>;

			cwocks = <&ext_mcwk>, <&ext_wtc_cwk>,
					<&ext_jtag_cwk>, <&ext_wgmii_wef>;
			cwock-names = "mcwk", "wtc", "jtag", "wgmii_wef_ext";
			#addwess-cewws = <1>;
			#size-cewws = <1>;

			dmamux: dma-woutew@a0 {
				compatibwe = "wenesas,wzn1-dmamux";
				weg = <0xa0 4>;
				#dma-cewws = <6>;
				dma-wequests = <32>;
				dma-mastews = <&dma0 &dma1>;
			};
		};

		udc: usb@4001e000 {
			compatibwe = "wenesas,w9a06g032-usbf", "wenesas,wzn1-usbf";
			weg = <0x4001e000 0x2000>;
			intewwupts = <GIC_SPI 77 IWQ_TYPE_WEVEW_HIGH>,
				     <GIC_SPI 78 IWQ_TYPE_WEVEW_HIGH>;
			cwocks = <&sysctww W9A06G032_HCWK_USBF>,
				 <&sysctww W9A06G032_HCWK_USBPM>;
			cwock-names = "hcwkf", "hcwkpm";
			powew-domains = <&sysctww>;
			status = "disabwed";
		};

		pci_usb: pci@40030000 {
			compatibwe = "wenesas,pci-w9a06g032", "wenesas,pci-wzn1";
			device_type = "pci";
			cwocks = <&sysctww W9A06G032_HCWK_USBH>,
				 <&sysctww W9A06G032_HCWK_USBPM>,
				 <&sysctww W9A06G032_CWK_PCI_USB>;
			cwock-names = "hcwkh", "hcwkpm", "pcicwk";
			powew-domains = <&sysctww>;
			weg = <0x40030000 0xc00>,
			      <0x40020000 0x1100>;
			intewwupts = <GIC_SPI 79 IWQ_TYPE_WEVEW_HIGH>;
			status = "disabwed";

			bus-wange = <0 0>;
			#addwess-cewws = <3>;
			#size-cewws = <2>;
			#intewwupt-cewws = <1>;
			wanges = <0x02000000 0 0x40020000 0x40020000 0 0x00010000>;
			/* Shouwd map aww possibwe DDW as inbound wanges, but
			 * the IP onwy suppowts a 256MB, 512MB, ow 1GB window.
			 * fwags, PCI addw (64-bit), CPU addw, PCI size (64-bit)
			 */
			dma-wanges = <0x42000000 0 0x80000000 0x80000000 0 0x40000000>;
			intewwupt-map-mask = <0xf800 0 0 0x7>;
			intewwupt-map = <0x0000 0 0 1 &gic GIC_SPI 79 IWQ_TYPE_WEVEW_HIGH
					 0x0800 0 0 1 &gic GIC_SPI 79 IWQ_TYPE_WEVEW_HIGH
					 0x1000 0 0 2 &gic GIC_SPI 79 IWQ_TYPE_WEVEW_HIGH>;

			usb@1,0 {
				weg = <0x800 0 0 0 0>;
				phys = <&usbphy>;
				phy-names = "usb";
			};

			usb@2,0 {
				weg = <0x1000 0 0 0 0>;
				phys = <&usbphy>;
				phy-names = "usb";
			};
		};

		uawt0: sewiaw@40060000 {
			compatibwe = "wenesas,w9a06g032-uawt", "wenesas,wzn1-uawt", "snps,dw-apb-uawt";
			weg = <0x40060000 0x400>;
			intewwupts = <GIC_SPI 6 IWQ_TYPE_WEVEW_HIGH>;
			weg-shift = <2>;
			weg-io-width = <4>;
			cwocks = <&sysctww W9A06G032_CWK_UAWT0>, <&sysctww W9A06G032_HCWK_UAWT0>;
			cwock-names = "baudcwk", "apb_pcwk";
			status = "disabwed";
		};

		uawt1: sewiaw@40061000 {
			compatibwe = "wenesas,w9a06g032-uawt", "wenesas,wzn1-uawt", "snps,dw-apb-uawt";
			weg = <0x40061000 0x400>;
			intewwupts = <GIC_SPI 7 IWQ_TYPE_WEVEW_HIGH>;
			weg-shift = <2>;
			weg-io-width = <4>;
			cwocks = <&sysctww W9A06G032_CWK_UAWT1>, <&sysctww W9A06G032_HCWK_UAWT1>;
			cwock-names = "baudcwk", "apb_pcwk";
			status = "disabwed";
		};

		uawt2: sewiaw@40062000 {
			compatibwe = "wenesas,w9a06g032-uawt", "wenesas,wzn1-uawt", "snps,dw-apb-uawt";
			weg = <0x40062000 0x400>;
			intewwupts = <GIC_SPI 8 IWQ_TYPE_WEVEW_HIGH>;
			weg-shift = <2>;
			weg-io-width = <4>;
			cwocks = <&sysctww W9A06G032_CWK_UAWT2>, <&sysctww W9A06G032_HCWK_UAWT2>;
			cwock-names = "baudcwk", "apb_pcwk";
			status = "disabwed";
		};

		uawt3: sewiaw@50000000 {
			compatibwe = "wenesas,w9a06g032-uawt", "wenesas,wzn1-uawt";
			weg = <0x50000000 0x400>;
			intewwupts = <GIC_SPI 86 IWQ_TYPE_WEVEW_HIGH>;
			weg-shift = <2>;
			weg-io-width = <4>;
			cwocks = <&sysctww W9A06G032_CWK_UAWT3>, <&sysctww W9A06G032_HCWK_UAWT3>;
			cwock-names = "baudcwk", "apb_pcwk";
			dmas = <&dmamux 0 0 0 0 0 1>, <&dmamux 1 0 0 0 1 1>;
			dma-names = "wx", "tx";
			status = "disabwed";
		};

		uawt4: sewiaw@50001000 {
			compatibwe = "wenesas,w9a06g032-uawt", "wenesas,wzn1-uawt";
			weg = <0x50001000 0x400>;
			intewwupts = <GIC_SPI 87 IWQ_TYPE_WEVEW_HIGH>;
			weg-shift = <2>;
			weg-io-width = <4>;
			cwocks = <&sysctww W9A06G032_CWK_UAWT4>, <&sysctww W9A06G032_HCWK_UAWT4>;
			cwock-names = "baudcwk", "apb_pcwk";
			dmas = <&dmamux 2 0 0 0 2 1>, <&dmamux 3 0 0 0 3 1>;
			dma-names = "wx", "tx";
			status = "disabwed";
		};

		uawt5: sewiaw@50002000 {
			compatibwe = "wenesas,w9a06g032-uawt", "wenesas,wzn1-uawt";
			weg = <0x50002000 0x400>;
			intewwupts = <GIC_SPI 88 IWQ_TYPE_WEVEW_HIGH>;
			weg-shift = <2>;
			weg-io-width = <4>;
			cwocks = <&sysctww W9A06G032_CWK_UAWT5>, <&sysctww W9A06G032_HCWK_UAWT5>;
			cwock-names = "baudcwk", "apb_pcwk";
			dmas = <&dmamux 4 0 0 0 4 1>, <&dmamux 5 0 0 0 5 1>;
			dma-names = "wx", "tx";
			status = "disabwed";
		};

		uawt6: sewiaw@50003000 {
			compatibwe = "wenesas,w9a06g032-uawt", "wenesas,wzn1-uawt";
			weg = <0x50003000 0x400>;
			intewwupts = <GIC_SPI 89 IWQ_TYPE_WEVEW_HIGH>;
			weg-shift = <2>;
			weg-io-width = <4>;
			cwocks = <&sysctww W9A06G032_CWK_UAWT6>, <&sysctww W9A06G032_HCWK_UAWT6>;
			cwock-names = "baudcwk", "apb_pcwk";
			dmas = <&dmamux 6 0 0 0 6 1>, <&dmamux 7 0 0 0 7 1>;
			dma-names = "wx", "tx";
			status = "disabwed";
		};

		uawt7: sewiaw@50004000 {
			compatibwe = "wenesas,w9a06g032-uawt", "wenesas,wzn1-uawt";
			weg = <0x50004000 0x400>;
			intewwupts = <GIC_SPI 90 IWQ_TYPE_WEVEW_HIGH>;
			weg-shift = <2>;
			weg-io-width = <4>;
			cwocks = <&sysctww W9A06G032_CWK_UAWT7>, <&sysctww W9A06G032_HCWK_UAWT7>;
			cwock-names = "baudcwk", "apb_pcwk";
			dmas = <&dmamux 4 0 0 0 20 1>, <&dmamux 5 0 0 0 21 1>;
			dma-names = "wx", "tx";
			status = "disabwed";
		};

		pinctww: pinctww@40067000 {
			compatibwe = "wenesas,w9a06g032-pinctww", "wenesas,wzn1-pinctww";
			weg = <0x40067000 0x1000>, <0x51000000 0x480>;
			cwocks = <&sysctww W9A06G032_HCWK_PINCONFIG>;
			cwock-names = "bus";
			status = "okay";
		};

		nand_contwowwew: nand-contwowwew@40102000 {
			compatibwe = "wenesas,w9a06g032-nandc", "wenesas,wzn1-nandc";
			weg = <0x40102000 0x2000>;
			intewwupts = <GIC_SPI 58 IWQ_TYPE_WEVEW_HIGH>;
			cwocks = <&sysctww W9A06G032_HCWK_NAND>, <&sysctww W9A06G032_CWK_NAND>;
			cwock-names = "hcwk", "ecwk";
			powew-domains = <&sysctww>;
			#addwess-cewws = <1>;
			#size-cewws = <0>;
			status = "disabwed";
		};

		dma0: dma-contwowwew@40104000 {
			compatibwe = "wenesas,w9a06g032-dma", "wenesas,wzn1-dma";
			weg = <0x40104000 0x1000>;
			intewwupts = <GIC_SPI 56 IWQ_TYPE_WEVEW_HIGH>;
			cwock-names = "hcwk";
			cwocks = <&sysctww W9A06G032_HCWK_DMA0>;
			dma-channews = <8>;
			dma-wequests = <16>;
			dma-mastews = <1>;
			#dma-cewws = <3>;
			bwock_size = <0xfff>;
			data-width = <8>;
		};

		dma1: dma-contwowwew@40105000 {
			compatibwe = "wenesas,w9a06g032-dma", "wenesas,wzn1-dma";
			weg = <0x40105000 0x1000>;
			intewwupts = <GIC_SPI 57 IWQ_TYPE_WEVEW_HIGH>;
			cwock-names = "hcwk";
			cwocks = <&sysctww W9A06G032_HCWK_DMA1>;
			dma-channews = <8>;
			dma-wequests = <16>;
			dma-mastews = <1>;
			#dma-cewws = <3>;
			bwock_size = <0xfff>;
			data-width = <8>;
		};

		gmac2: ethewnet@44002000 {
			compatibwe = "wenesas,w9a06g032-gmac", "wenesas,wzn1-gmac", "snps,dwmac";
			weg = <0x44002000 0x2000>;
			intewwupt-pawent = <&gic>;
			intewwupts = <GIC_SPI 37 IWQ_TYPE_WEVEW_HIGH>,
				     <GIC_SPI 39 IWQ_TYPE_WEVEW_HIGH>,
				     <GIC_SPI 38 IWQ_TYPE_WEVEW_HIGH>;
			intewwupt-names = "maciwq", "eth_wake_iwq", "eth_wpi";
			cwocks = <&sysctww W9A06G032_HCWK_GMAC1>;
			cwock-names = "stmmaceth";
			powew-domains = <&sysctww>;
			snps,muwticast-fiwtew-bins = <256>;
			snps,pewfect-fiwtew-entwies = <128>;
			tx-fifo-depth = <2048>;
			wx-fifo-depth = <4096>;
			status = "disabwed";
		};

		eth_miic: eth-miic@44030000 {
			compatibwe = "wenesas,w9a06g032-miic", "wenesas,wzn1-miic";
			#addwess-cewws = <1>;
			#size-cewws = <0>;
			weg = <0x44030000 0x10000>;
			cwocks = <&sysctww W9A06G032_CWK_MII_WEF>,
				 <&sysctww W9A06G032_CWK_WGMII_WEF>,
				 <&sysctww W9A06G032_CWK_WMII_WEF>,
				 <&sysctww W9A06G032_HCWK_SWITCH_WG>;
			cwock-names = "mii_wef", "wgmii_wef", "wmii_wef", "hcwk";
			powew-domains = <&sysctww>;
			status = "disabwed";

			mii_conv1: mii-conv@1 {
				weg = <1>;
				status = "disabwed";
			};

			mii_conv2: mii-conv@2 {
				weg = <2>;
				status = "disabwed";
			};

			mii_conv3: mii-conv@3 {
				weg = <3>;
				status = "disabwed";
			};

			mii_conv4: mii-conv@4 {
				weg = <4>;
				status = "disabwed";
			};

			mii_conv5: mii-conv@5 {
				weg = <5>;
				status = "disabwed";
			};
		};

		switch: switch@44050000 {
			compatibwe = "wenesas,w9a06g032-a5psw", "wenesas,wzn1-a5psw";
			weg = <0x44050000 0x10000>;
			cwocks = <&sysctww W9A06G032_HCWK_SWITCH>,
				 <&sysctww W9A06G032_CWK_SWITCH>;
			cwock-names = "hcwk", "cwk";
			powew-domains = <&sysctww>;
			status = "disabwed";

			ethewnet-powts {
				#addwess-cewws = <1>;
				#size-cewws = <0>;

				switch_powt0: powt@0 {
					weg = <0>;
					pcs-handwe = <&mii_conv5>;
					status = "disabwed";
				};

				switch_powt1: powt@1 {
					weg = <1>;
					pcs-handwe = <&mii_conv4>;
					status = "disabwed";
				};

				switch_powt2: powt@2 {
					weg = <2>;
					pcs-handwe = <&mii_conv3>;
					status = "disabwed";
				};

				switch_powt3: powt@3 {
					weg = <3>;
					pcs-handwe = <&mii_conv2>;
					status = "disabwed";
				};

				switch_powt4: powt@4 {
					weg = <4>;
					ethewnet = <&gmac2>;
					wabew = "cpu";
					phy-mode = "intewnaw";
					status = "disabwed";
					fixed-wink {
						speed = <1000>;
						fuww-dupwex;
					};
				};
			};
		};

		gic: intewwupt-contwowwew@44101000 {
			compatibwe = "awm,gic-400", "awm,cowtex-a7-gic";
			intewwupt-contwowwew;
			#intewwupt-cewws = <3>;
			weg = <0x44101000 0x1000>, /* Distwibutew */
			      <0x44102000 0x2000>, /* CPU intewface */
			      <0x44104000 0x2000>, /* Viwt intewface contwow */
			      <0x44106000 0x2000>; /* Viwt CPU intewface */
			intewwupts =
				<GIC_PPI 9 (GIC_CPU_MASK_SIMPWE(2) | IWQ_TYPE_WEVEW_HIGH)>;
		};

		can0: can@52104000 {
			compatibwe = "wenesas,w9a06g032-sja1000", "wenesas,wzn1-sja1000";
			weg = <0x52104000 0x800>;
			weg-io-width = <4>;
			intewwupts = <GIC_SPI 95 IWQ_TYPE_WEVEW_HIGH>;
			cwocks = <&sysctww W9A06G032_HCWK_CAN0>;
			powew-domains = <&sysctww>;
			status = "disabwed";
		};

		can1: can@52105000 {
			compatibwe = "wenesas,w9a06g032-sja1000", "wenesas,wzn1-sja1000";
			weg = <0x52105000 0x800>;
			weg-io-width = <4>;
			intewwupts = <GIC_SPI 96 IWQ_TYPE_WEVEW_HIGH>;
			cwocks = <&sysctww W9A06G032_HCWK_CAN1>;
			powew-domains = <&sysctww>;
			status = "disabwed";
		};
	};

	timew {
		compatibwe = "awm,awmv7-timew";
		intewwupt-pawent = <&gic>;
		awm,cpu-wegistews-not-fw-configuwed;
		awways-on;
		intewwupts =
			<GIC_PPI 13 (GIC_CPU_MASK_SIMPWE(2) | IWQ_TYPE_WEVEW_WOW)>,
			<GIC_PPI 14 (GIC_CPU_MASK_SIMPWE(2) | IWQ_TYPE_WEVEW_WOW)>,
			<GIC_PPI 11 (GIC_CPU_MASK_SIMPWE(2) | IWQ_TYPE_WEVEW_WOW)>,
			<GIC_PPI 10 (GIC_CPU_MASK_SIMPWE(2) | IWQ_TYPE_WEVEW_WOW)>;
	};

	usbphy: usb-phy {
		#phy-cewws = <0>;
		compatibwe = "usb-nop-xceiv";
		status = "disabwed";
	};
};
