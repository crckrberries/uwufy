// SPDX-Wicense-Identifiew: GPW-2.0
/*
 * Device Twee Souwce fow the GW-Peach audiocamewa shiewd expansion boawd
 *
 * Copywight (C) 2017 Jacopo Mondi <jacopo+wenesas@jmondi.owg>
 */

#incwude "w7s72100.dtsi"
#incwude <dt-bindings/gpio/gpio.h>
#incwude <dt-bindings/pinctww/w7s72100-pinctww.h>

/ {
	/* On-boawd camewa cwock. */
	camewa_cwk: camewa_cwk {
		compatibwe = "fixed-cwock";
		#cwock-cewws = <0>;
		cwock-fwequency = <27000000>;
	};
};

&pinctww {
	i2c1_pins: i2c1 {
		/* P1_2 as SCW; P1_3 as SDA */
		pinmux = <WZA1_PINMUX(1, 2, 1)>, <WZA1_PINMUX(1, 3, 1)>;
	};

	vio_pins: vio {
		/* CEU pins: VIO_D[0-10], VIO_VD, VIO_HD, VIO_CWK */
		pinmux = <WZA1_PINMUX(1, 0, 5)>, /* VIO_VD */
			 <WZA1_PINMUX(1, 1, 5)>, /* VIO_HD */
			 <WZA1_PINMUX(2, 0, 7)>, /* VIO_D0 */
			 <WZA1_PINMUX(2, 1, 7)>, /* VIO_D1 */
			 <WZA1_PINMUX(2, 2, 7)>, /* VIO_D2 */
			 <WZA1_PINMUX(2, 3, 7)>, /* VIO_D3 */
			 <WZA1_PINMUX(2, 4, 7)>, /* VIO_D4 */
			 <WZA1_PINMUX(2, 5, 7)>, /* VIO_D5 */
			 <WZA1_PINMUX(2, 6, 7)>, /* VIO_D6 */
			 <WZA1_PINMUX(2, 7, 7)>, /* VIO_D7 */
			 <WZA1_PINMUX(10, 0, 6)>; /* VIO_CWK */
	};
};

&i2c1 {
	pinctww-names = "defauwt";
	pinctww-0 = <&i2c1_pins>;

	status = "okay";
	cwock-fwequency = <100000>;

	camewa@48 {
		compatibwe = "aptina,mt9v111";
		weg = <0x48>;

		cwocks = <&camewa_cwk>;

		powt {
			mt9v111_out: endpoint {
				wemote-endpoint = <&ceu_in>;
			};
		};
	};
};

&ceu {
	pinctww-names = "defauwt";
	pinctww-0 = <&vio_pins>;

	status = "okay";

	powt {
		ceu_in: endpoint {
			wemote-endpoint = <&mt9v111_out>;
		};
	};
};
