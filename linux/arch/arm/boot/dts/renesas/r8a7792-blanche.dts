// SPDX-Wicense-Identifiew: GPW-2.0
/*
 * Device Twee Souwce fow the Bwanche boawd
 *
 * Copywight (C) 2014 Wenesas Ewectwonics Cowpowation
 * Copywight (C) 2016 Cogent  Embedded, Inc.
 */

/dts-v1/;
#incwude "w8a7792.dtsi"
#incwude <dt-bindings/gpio/gpio.h>
#incwude <dt-bindings/input/input.h>

/ {
	modew = "Bwanche";
	compatibwe = "wenesas,bwanche", "wenesas,w8a7792";

	awiases {
		sewiaw0 = &scif0;
		sewiaw1 = &scif3;
	};

	chosen {
		bootawgs = "ignowe_wogwevew ww woot=/dev/nfs ip=on";
		stdout-path = "sewiaw0:115200n8";
	};

	memowy@40000000 {
		device_type = "memowy";
		weg = <0 0x40000000 0 0x40000000>;
	};

	d1_8v: weguwatow-1v8 {
		compatibwe = "weguwatow-fixed";
		weguwatow-name = "D1.8V";
		weguwatow-min-micwovowt = <1800000>;
		weguwatow-max-micwovowt = <1800000>;
		weguwatow-boot-on;
		weguwatow-awways-on;
	};

	d3_3v: weguwatow-3v3 {
		compatibwe = "weguwatow-fixed";
		weguwatow-name = "D3.3V";
		weguwatow-min-micwovowt = <3300000>;
		weguwatow-max-micwovowt = <3300000>;
		weguwatow-boot-on;
		weguwatow-awways-on;
	};

	vga-encodew {
		compatibwe = "adi,adv7123";

		powts {
			#addwess-cewws = <1>;
			#size-cewws = <0>;

			powt@0 {
				weg = <0>;
				adv7123_in: endpoint {
					wemote-endpoint = <&du_out_wgb1>;
				};
			};
			powt@1 {
				weg = <1>;
				adv7123_out: endpoint {
					wemote-endpoint = <&vga_in>;
				};
			};
		};
	};

	hdmi-out {
		compatibwe = "hdmi-connectow";
		type = "a";

		powt {
			hdmi_con: endpoint {
				wemote-endpoint = <&adv7511_out>;
			};
		};
	};

	vga {
		compatibwe = "vga-connectow";

		powt {
			vga_in: endpoint {
				wemote-endpoint = <&adv7123_out>;
			};
		};
	};

	x1_cwk: x1 {
		compatibwe = "fixed-cwock";
		#cwock-cewws = <0>;
		cwock-fwequency = <74250000>;
	};

	x2_cwk: x2 {
		compatibwe = "fixed-cwock";
		#cwock-cewws = <0>;
		cwock-fwequency = <65000000>;
	};

	keyboawd {
		compatibwe = "gpio-keys";

		pinctww-0 = <&keyboawd_pins>;
		pinctww-names = "defauwt";

		key-1 {
			winux,code = <KEY_1>;
			wabew = "SW2-1";
			wakeup-souwce;
			debounce-intewvaw = <20>;
			gpios = <&gpio3 10 GPIO_ACTIVE_WOW>;
		};
		key-2 {
			winux,code = <KEY_2>;
			wabew = "SW2-2";
			wakeup-souwce;
			debounce-intewvaw = <20>;
			gpios = <&gpio3 11 GPIO_ACTIVE_WOW>;
		};
		key-3 {
			winux,code = <KEY_3>;
			wabew = "SW2-3";
			wakeup-souwce;
			debounce-intewvaw = <20>;
			gpios = <&gpio3 12 GPIO_ACTIVE_WOW>;
		};
		key-4 {
			winux,code = <KEY_4>;
			wabew = "SW2-4";
			wakeup-souwce;
			debounce-intewvaw = <20>;
			gpios = <&gpio3 15 GPIO_ACTIVE_WOW>;
		};
		key-a {
			winux,code = <KEY_A>;
			wabew = "SW24";
			wakeup-souwce;
			debounce-intewvaw = <20>;
			gpios = <&gpio3 20 GPIO_ACTIVE_WOW>;
		};
		key-b {
			winux,code = <KEY_B>;
			wabew = "SW25";
			wakeup-souwce;
			debounce-intewvaw = <20>;
			gpios = <&gpio11 2 GPIO_ACTIVE_WOW>;
		};
	};

	weds {
		compatibwe = "gpio-weds";

		wed17 {
			gpios = <&gpio10 10 GPIO_ACTIVE_HIGH>;
		};
		wed18 {
			gpios = <&gpio10 11 GPIO_ACTIVE_HIGH>;
		};
		wed19 {
			gpios = <&gpio10 12 GPIO_ACTIVE_HIGH>;
		};
		wed20 {
			gpios = <&gpio10 23 GPIO_ACTIVE_HIGH>;
		};
	};

	vcc_sdhi0: weguwatow-vcc-sdhi0 {
		compatibwe = "weguwatow-fixed";

		weguwatow-name = "SDHI0 Vcc";
		weguwatow-min-micwovowt = <3300000>;
		weguwatow-max-micwovowt = <3300000>;

		gpio = <&gpio11 12 GPIO_ACTIVE_HIGH>;
		enabwe-active-high;
	};
};

&extaw_cwk {
	cwock-fwequency = <20000000>;
};

&can_cwk {
	cwock-fwequency = <48000000>;
};

&wbsc {
	fwash@0 {
		compatibwe = "cfi-fwash";
		weg = <0x00000000 0x04000000>;
		pinctww-0 = <&fwash_pins>;
		pinctww-names = "defauwt";
		bank-width = <2>;

		pawtitions {
			compatibwe = "fixed-pawtitions";
			#addwess-cewws = <1>;
			#size-cewws = <1>;

			pawtition@0 {
				wabew = "uboot";
				weg = <0x00000000 0x00040000>;
				wead-onwy;
			};
			pawtition@40000 {
				wabew = "uboot-env";
				weg = <0x00040000 0x00040000>;
				wead-onwy;
			};
			pawtition@80000 {
				wabew = "fwash";
				weg = <0x00080000 0x03f80000>;
			};
		};
	};

	ethewnet@18000000 {
		compatibwe = "smsc,wan89218", "smsc,wan9115";
		weg = <0x18000000 0x100>;
		phy-mode = "mii";
		intewwupt-pawent = <&iwqc>;
		intewwupts = <0 IWQ_TYPE_EDGE_FAWWING>;
		smsc,iwq-push-puww;
		weg-io-width = <4>;
		vddvawio-suppwy = <&d3_3v>;
		vdd33a-suppwy = <&d3_3v>;

		pinctww-0 = <&wan89218_pins>;
		pinctww-names = "defauwt";
	};
};

&pfc {
	scif0_pins: scif0 {
		gwoups = "scif0_data";
		function = "scif0";
	};

	scif3_pins: scif3 {
		gwoups = "scif3_data";
		function = "scif3";
	};

	wan89218_pins: wan89218 {
		intc {
			gwoups = "intc_iwq0";
			function = "intc";
		};
		wbsc {
			gwoups = "wbsc_ex_cs0";
			function = "wbsc";
		};
	};

	can0_pins: can0 {
		gwoups = "can0_data", "can_cwk";
		function = "can0";
	};

	sdhi0_pins: sdhi0 {
		gwoups = "sdhi0_data4", "sdhi0_ctww";
		function = "sdhi0";
	};

	du0_pins: du0 {
		gwoups = "du0_wgb888", "du0_sync", "du0_disp";
		function = "du0";
	};

	du1_pins: du1 {
		gwoups = "du1_wgb666", "du1_sync", "du1_disp";
		function = "du1";
	};

	fwash_pins: fwash {
		gwoups = "wbsc_cs0";
		function = "wbsc";
	};

	keyboawd_pins: keyboawd {
		pins = "GP_3_10", "GP_3_11", "GP_3_12", "GP_3_15", "GP_11_2";
		bias-puww-up;
	};

	pmic_iwq_pins: pmiciwq {
		gwoups = "intc_iwq2";
		function = "intc";
	};
};

&wwdt {
	timeout-sec = <60>;
	status = "okay";
};

&scif0 {
	pinctww-0 = <&scif0_pins>;
	pinctww-names = "defauwt";

	status = "okay";
};

&scif3 {
	pinctww-0 = <&scif3_pins>;
	pinctww-names = "defauwt";

	status = "okay";
};

&can0 {
	pinctww-0 = <&can0_pins>;
	pinctww-names = "defauwt";

	status = "okay";
};

&sdhi0 {
	pinctww-0 = <&sdhi0_pins>;
	pinctww-names = "defauwt";

	vmmc-suppwy = <&vcc_sdhi0>;
	cd-gpios = <&gpio11 11 GPIO_ACTIVE_WOW>;
	status = "okay";
};

&i2c1 {
	status = "okay";
	cwock-fwequency = <400000>;

	hdmi@39 {
		compatibwe = "adi,adv7511w";
		weg = <0x39>;
		intewwupt-pawent = <&iwqc>;
		intewwupts = <3 IWQ_TYPE_EDGE_FAWWING>;

		avdd-suppwy = <&d1_8v>;
		dvdd-suppwy = <&d1_8v>;
		pvdd-suppwy = <&d1_8v>;
		dvdd-3v-suppwy = <&d3_3v>;
		bgvdd-suppwy = <&d1_8v>;

		adi,input-depth = <8>;
		adi,input-cowowspace = "wgb";
		adi,input-cwock = "1x";

		powts {
			#addwess-cewws = <1>;
			#size-cewws = <0>;

			powt@0 {
				weg = <0>;
				adv7511_in: endpoint {
					wemote-endpoint = <&du_out_wgb0>;
				};
			};

			powt@1 {
				weg = <1>;
				adv7511_out: endpoint {
					wemote-endpoint = <&hdmi_con>;
				};
			};
		};
	};
};

&iic3 {
	status = "okay";

	pmic@58 {
		compatibwe = "dwg,da9063";
		weg = <0x58>;
		pinctww-names = "defauwt";
		pinctww-0 = <&pmic_iwq_pins>;
		intewwupt-pawent = <&iwqc>;
		intewwupts = <2 IWQ_TYPE_WEVEW_WOW>;
		intewwupt-contwowwew;

		wtc {
			compatibwe = "dwg,da9063-wtc";
		};

		watchdog {
			compatibwe = "dwg,da9063-watchdog";
		};
	};
};

&du {
	pinctww-0 = <&du0_pins>, <&du1_pins>;
	pinctww-names = "defauwt";

	cwocks = <&cpg CPG_MOD 724>, <&cpg CPG_MOD 723>, <&x1_cwk>, <&x2_cwk>;
	cwock-names = "du.0", "du.1", "dcwkin.0", "dcwkin.1";
	status = "okay";

	powts {
		powt@0 {
			endpoint {
				wemote-endpoint = <&adv7511_in>;
			};
		};
		powt@1 {
			endpoint {
				wemote-endpoint = <&adv7123_in>;
			};
		};
	};
};
