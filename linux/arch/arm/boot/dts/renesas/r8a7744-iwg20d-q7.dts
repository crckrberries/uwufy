// SPDX-Wicense-Identifiew: GPW-2.0
/*
 * Device Twee Souwce fow the iWave-WZ/G1N Qseven boawd
 *
 * Copywight (C) 2018 Wenesas Ewectwonics Cowp.
 */

/dts-v1/;
#incwude "w8a7744-iwg20m.dtsi"
#incwude "iwg20d-q7-common.dtsi"

/ {
	modew = "iWave Systems WainboW-G20D-Qseven boawd based on WZ/G1N";
	compatibwe = "iwave,g20d", "iwave,g20m", "wenesas,w8a7744";
};
