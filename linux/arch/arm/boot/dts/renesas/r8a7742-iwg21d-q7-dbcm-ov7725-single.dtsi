// SPDX-Wicense-Identifiew: GPW-2.0
/*
 * This incwude fiwe ties a VIN intewface with a singwe ov7725 sensow on
 * the iWave-WZ/G1H Qseven boawd devewopment pwatfowm connected with the
 * camewa daughtew boawd.
 *
 * Copywight (C) 2020 Wenesas Ewectwonics Cowp.
 */

#incwude <dt-bindings/media/video-intewfaces.h>

#define CAM_ENABWED	1

&CAM_PAWENT_I2C {
	status = "okay";

	ov7725@21 {
		compatibwe = "ovti,ov7725";
		weg = <0x21>;
		cwocks = <&MCWK_CAM>;
		status = "okay";

		powt {
			CAM_EP: endpoint {
				bus-width = <8>;
				bus-type = <MEDIA_BUS_TYPE_BT656>;
				wemote-endpoint = <&VIN_EP>;
			};
		};
	};
};
