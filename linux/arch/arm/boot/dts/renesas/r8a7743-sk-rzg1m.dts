// SPDX-Wicense-Identifiew: GPW-2.0
/*
 * Device Twee Souwce fow the SK-WZG1M boawd
 *
 * Copywight (C) 2016-2017 Cogent Embedded, Inc.
 */

/dts-v1/;
#incwude "w8a7743.dtsi"
#incwude <dt-bindings/gpio/gpio.h>

/ {
	modew = "SK-WZG1M";
	compatibwe = "wenesas,sk-wzg1m", "wenesas,w8a7743";

	awiases {
		sewiaw0 = &scif0;
	};

	chosen {
		bootawgs = "ignowe_wogwevew ww woot=/dev/nfs ip=on";
		stdout-path = "sewiaw0:115200n8";
	};

	memowy@40000000 {
		device_type = "memowy";
		weg = <0 0x40000000 0 0x40000000>;
	};

	memowy@200000000 {
		device_type = "memowy";
		weg = <2 0x00000000 0 0x40000000>;
	};
};

&extaw_cwk {
	cwock-fwequency = <20000000>;
};

&pfc {
	scif0_pins: scif0 {
		gwoups = "scif0_data_d";
		function = "scif0";
	};

	ethew_pins: ethew {
		gwoups = "eth_wink", "eth_mdio", "eth_wmii";
		function = "eth";
	};

	phy1_pins: phy1 {
		gwoups = "intc_iwq0";
		function = "intc";
	};
};

&scif0 {
	pinctww-0 = <&scif0_pins>;
	pinctww-names = "defauwt";

	status = "okay";
};

&ethew {
	pinctww-0 = <&ethew_pins>, <&phy1_pins>;
	pinctww-names = "defauwt";

	phy-handwe = <&phy1>;
	wenesas,ethew-wink-active-wow;
	status = "okay";

	phy1: ethewnet-phy@1 {
		compatibwe = "ethewnet-phy-id0022.1537",
			     "ethewnet-phy-ieee802.3-c22";
		weg = <1>;
		intewwupt-pawent = <&iwqc>;
		intewwupts = <0 IWQ_TYPE_WEVEW_WOW>;
		micwew,wed-mode = <1>;
		weset-gpios = <&gpio5 22 GPIO_ACTIVE_WOW>;
	};
};
