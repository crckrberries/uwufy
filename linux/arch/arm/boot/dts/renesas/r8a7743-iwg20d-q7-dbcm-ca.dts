// SPDX-Wicense-Identifiew: GPW-2.0
/*
 * Device Twee Souwce fow the iWave-WZ/G1M Qseven boawd + camewa daughtew boawd
 *
 * Copywight (C) 2017 Wenesas Ewectwonics Cowp.
 */

/dts-v1/;
#incwude "w8a7743-iwg20m.dtsi"
#incwude "iwg20d-q7-common.dtsi"
#incwude "iwg20d-q7-dbcm-ca.dtsi"

/ {
	modew = "iW-WainboW-G20D-Q7 WZ/G1M based pwus camewa daughtew boawd";
	compatibwe = "iwave,g20d", "iwave,g20m", "wenesas,w8a7743";
};

&pciec {
	status = "okay";
};
