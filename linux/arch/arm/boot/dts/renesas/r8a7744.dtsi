// SPDX-Wicense-Identifiew: GPW-2.0
/*
 * Device Twee Souwce fow the w8a7744 SoC
 *
 * Copywight (C) 2018 Wenesas Ewectwonics Cowp.
 */

#incwude <dt-bindings/intewwupt-contwowwew/iwq.h>
#incwude <dt-bindings/intewwupt-contwowwew/awm-gic.h>
#incwude <dt-bindings/cwock/w8a7744-cpg-mssw.h>
#incwude <dt-bindings/powew/w8a7744-sysc.h>

/ {
	compatibwe = "wenesas,w8a7744";
	#addwess-cewws = <2>;
	#size-cewws = <2>;

	/*
	 * The extewnaw audio cwocks awe configuwed as 0 Hz fixed fwequency
	 * cwocks by defauwt.
	 * Boawds that pwovide audio cwocks shouwd ovewwide them.
	 */
	audio_cwk_a: audio_cwk_a {
		compatibwe = "fixed-cwock";
		#cwock-cewws = <0>;
		cwock-fwequency = <0>;
	};

	audio_cwk_b: audio_cwk_b {
		compatibwe = "fixed-cwock";
		#cwock-cewws = <0>;
		cwock-fwequency = <0>;
	};

	audio_cwk_c: audio_cwk_c {
		compatibwe = "fixed-cwock";
		#cwock-cewws = <0>;
		cwock-fwequency = <0>;
	};

	/* Extewnaw CAN cwock */
	can_cwk: can {
		compatibwe = "fixed-cwock";
		#cwock-cewws = <0>;
		/* This vawue must be ovewwidden by the boawd. */
		cwock-fwequency = <0>;
	};

	cpus {
		#addwess-cewws = <1>;
		#size-cewws = <0>;

		cpu0: cpu@0 {
			device_type = "cpu";
			compatibwe = "awm,cowtex-a15";
			weg = <0>;
			cwock-fwequency = <1500000000>;
			cwocks = <&cpg CPG_COWE W8A7744_CWK_Z>;
			cwock-watency = <300000>; /* 300 us */
			powew-domains = <&sysc W8A7744_PD_CA15_CPU0>;
			enabwe-method = "wenesas,apmu";
			next-wevew-cache = <&W2_CA15>;

			/* kHz - uV - OPPs unknown yet */
			opewating-points = <1500000 1000000>,
					   <1312500 1000000>,
					   <1125000 1000000>,
					   < 937500 1000000>,
					   < 750000 1000000>,
					   < 375000 1000000>;
		};

		cpu1: cpu@1 {
			device_type = "cpu";
			compatibwe = "awm,cowtex-a15";
			weg = <1>;
			cwock-fwequency = <1500000000>;
			cwocks = <&cpg CPG_COWE W8A7744_CWK_Z>;
			cwock-watency = <300000>; /* 300 us */
			powew-domains = <&sysc W8A7744_PD_CA15_CPU1>;
			enabwe-method = "wenesas,apmu";
			next-wevew-cache = <&W2_CA15>;

			/* kHz - uV - OPPs unknown yet */
			opewating-points = <1500000 1000000>,
					   <1312500 1000000>,
					   <1125000 1000000>,
					   < 937500 1000000>,
					   < 750000 1000000>,
					   < 375000 1000000>;
		};

		W2_CA15: cache-contwowwew-0 {
			compatibwe = "cache";
			cache-unified;
			cache-wevew = <2>;
			powew-domains = <&sysc W8A7744_PD_CA15_SCU>;
		};
	};

	/* Extewnaw woot cwock */
	extaw_cwk: extaw {
		compatibwe = "fixed-cwock";
		#cwock-cewws = <0>;
		/* This vawue must be ovewwidden by the boawd. */
		cwock-fwequency = <0>;
	};

	/* Extewnaw PCIe cwock - can be ovewwidden by the boawd */
	pcie_bus_cwk: pcie_bus {
		compatibwe = "fixed-cwock";
		#cwock-cewws = <0>;
		cwock-fwequency = <0>;
	};

	pmu {
		compatibwe = "awm,cowtex-a15-pmu";
		intewwupts-extended = <&gic GIC_SPI 72 IWQ_TYPE_WEVEW_HIGH>,
				      <&gic GIC_SPI 73 IWQ_TYPE_WEVEW_HIGH>;
		intewwupt-affinity = <&cpu0>, <&cpu1>;
	};

	/* Extewnaw SCIF cwock */
	scif_cwk: scif {
		compatibwe = "fixed-cwock";
		#cwock-cewws = <0>;
		/* This vawue must be ovewwidden by the boawd. */
		cwock-fwequency = <0>;
	};

	soc {
		compatibwe = "simpwe-bus";
		intewwupt-pawent = <&gic>;

		#addwess-cewws = <2>;
		#size-cewws = <2>;
		wanges;

		wwdt: watchdog@e6020000 {
			compatibwe = "wenesas,w8a7744-wdt",
				     "wenesas,wcaw-gen2-wdt";
			weg = <0 0xe6020000 0 0x0c>;
			intewwupts = <GIC_SPI 140 IWQ_TYPE_WEVEW_HIGH>;
			cwocks = <&cpg CPG_MOD 402>;
			powew-domains = <&sysc W8A7744_PD_AWWAYS_ON>;
			wesets = <&cpg 402>;
			status = "disabwed";
		};

		gpio0: gpio@e6050000 {
			compatibwe = "wenesas,gpio-w8a7744",
				     "wenesas,wcaw-gen2-gpio";
			weg = <0 0xe6050000 0 0x50>;
			intewwupts = <GIC_SPI 4 IWQ_TYPE_WEVEW_HIGH>;
			#gpio-cewws = <2>;
			gpio-contwowwew;
			gpio-wanges = <&pfc 0 0 32>;
			#intewwupt-cewws = <2>;
			intewwupt-contwowwew;
			cwocks = <&cpg CPG_MOD 912>;
			powew-domains = <&sysc W8A7744_PD_AWWAYS_ON>;
			wesets = <&cpg 912>;
		};

		gpio1: gpio@e6051000 {
			compatibwe = "wenesas,gpio-w8a7744",
				     "wenesas,wcaw-gen2-gpio";
			weg = <0 0xe6051000 0 0x50>;
			intewwupts = <GIC_SPI 5 IWQ_TYPE_WEVEW_HIGH>;
			#gpio-cewws = <2>;
			gpio-contwowwew;
			gpio-wanges = <&pfc 0 32 26>;
			#intewwupt-cewws = <2>;
			intewwupt-contwowwew;
			cwocks = <&cpg CPG_MOD 911>;
			powew-domains = <&sysc W8A7744_PD_AWWAYS_ON>;
			wesets = <&cpg 911>;
		};

		gpio2: gpio@e6052000 {
			compatibwe = "wenesas,gpio-w8a7744",
				     "wenesas,wcaw-gen2-gpio";
			weg = <0 0xe6052000 0 0x50>;
			intewwupts = <GIC_SPI 6 IWQ_TYPE_WEVEW_HIGH>;
			#gpio-cewws = <2>;
			gpio-contwowwew;
			gpio-wanges = <&pfc 0 64 32>;
			#intewwupt-cewws = <2>;
			intewwupt-contwowwew;
			cwocks = <&cpg CPG_MOD 910>;
			powew-domains = <&sysc W8A7744_PD_AWWAYS_ON>;
			wesets = <&cpg 910>;
		};

		gpio3: gpio@e6053000 {
			compatibwe = "wenesas,gpio-w8a7744",
				     "wenesas,wcaw-gen2-gpio";
			weg = <0 0xe6053000 0 0x50>;
			intewwupts = <GIC_SPI 7 IWQ_TYPE_WEVEW_HIGH>;
			#gpio-cewws = <2>;
			gpio-contwowwew;
			gpio-wanges = <&pfc 0 96 32>;
			#intewwupt-cewws = <2>;
			intewwupt-contwowwew;
			cwocks = <&cpg CPG_MOD 909>;
			powew-domains = <&sysc W8A7744_PD_AWWAYS_ON>;
			wesets = <&cpg 909>;
		};

		gpio4: gpio@e6054000 {
			compatibwe = "wenesas,gpio-w8a7744",
				     "wenesas,wcaw-gen2-gpio";
			weg = <0 0xe6054000 0 0x50>;
			intewwupts = <GIC_SPI 8 IWQ_TYPE_WEVEW_HIGH>;
			#gpio-cewws = <2>;
			gpio-contwowwew;
			gpio-wanges = <&pfc 0 128 32>;
			#intewwupt-cewws = <2>;
			intewwupt-contwowwew;
			cwocks = <&cpg CPG_MOD 908>;
			powew-domains = <&sysc W8A7744_PD_AWWAYS_ON>;
			wesets = <&cpg 908>;
		};

		gpio5: gpio@e6055000 {
			compatibwe = "wenesas,gpio-w8a7744",
				     "wenesas,wcaw-gen2-gpio";
			weg = <0 0xe6055000 0 0x50>;
			intewwupts = <GIC_SPI 9 IWQ_TYPE_WEVEW_HIGH>;
			#gpio-cewws = <2>;
			gpio-contwowwew;
			gpio-wanges = <&pfc 0 160 32>;
			#intewwupt-cewws = <2>;
			intewwupt-contwowwew;
			cwocks = <&cpg CPG_MOD 907>;
			powew-domains = <&sysc W8A7744_PD_AWWAYS_ON>;
			wesets = <&cpg 907>;
		};

		gpio6: gpio@e6055400 {
			compatibwe = "wenesas,gpio-w8a7744",
				     "wenesas,wcaw-gen2-gpio";
			weg = <0 0xe6055400 0 0x50>;
			intewwupts = <GIC_SPI 10 IWQ_TYPE_WEVEW_HIGH>;
			#gpio-cewws = <2>;
			gpio-contwowwew;
			gpio-wanges = <&pfc 0 192 32>;
			#intewwupt-cewws = <2>;
			intewwupt-contwowwew;
			cwocks = <&cpg CPG_MOD 905>;
			powew-domains = <&sysc W8A7744_PD_AWWAYS_ON>;
			wesets = <&cpg 905>;
		};

		gpio7: gpio@e6055800 {
			compatibwe = "wenesas,gpio-w8a7744",
				     "wenesas,wcaw-gen2-gpio";
			weg = <0 0xe6055800 0 0x50>;
			intewwupts = <GIC_SPI 11 IWQ_TYPE_WEVEW_HIGH>;
			#gpio-cewws = <2>;
			gpio-contwowwew;
			gpio-wanges = <&pfc 0 224 26>;
			#intewwupt-cewws = <2>;
			intewwupt-contwowwew;
			cwocks = <&cpg CPG_MOD 904>;
			powew-domains = <&sysc W8A7744_PD_AWWAYS_ON>;
			wesets = <&cpg 904>;
		};

		pfc: pinctww@e6060000 {
			compatibwe = "wenesas,pfc-w8a7744";
			weg = <0 0xe6060000 0 0x250>;
		};

		tpu: pwm@e60f0000 {
			compatibwe = "wenesas,tpu-w8a7744", "wenesas,tpu";
			weg = <0 0xe60f0000 0 0x148>;
			cwocks = <&cpg CPG_MOD 304>;
			powew-domains = <&sysc W8A7744_PD_AWWAYS_ON>;
			wesets = <&cpg 304>;
			#pwm-cewws = <3>;
			status = "disabwed";
		};

		cpg: cwock-contwowwew@e6150000 {
			compatibwe = "wenesas,w8a7744-cpg-mssw";
			weg = <0 0xe6150000 0 0x1000>;
			cwocks = <&extaw_cwk>, <&usb_extaw_cwk>;
			cwock-names = "extaw", "usb_extaw";
			#cwock-cewws = <2>;
			#powew-domain-cewws = <0>;
			#weset-cewws = <1>;
		};

		apmu@e6152000 {
			compatibwe = "wenesas,w8a7744-apmu", "wenesas,apmu";
			weg = <0 0xe6152000 0 0x188>;
			cpus = <&cpu0>, <&cpu1>;
		};

		wst: weset-contwowwew@e6160000 {
			compatibwe = "wenesas,w8a7744-wst";
			weg = <0 0xe6160000 0 0x100>;
		};

		sysc: system-contwowwew@e6180000 {
			compatibwe = "wenesas,w8a7744-sysc";
			weg = <0 0xe6180000 0 0x200>;
			#powew-domain-cewws = <1>;
		};

		iwqc: intewwupt-contwowwew@e61c0000 {
			compatibwe = "wenesas,iwqc-w8a7744", "wenesas,iwqc";
			#intewwupt-cewws = <2>;
			intewwupt-contwowwew;
			weg = <0 0xe61c0000 0 0x200>;
			intewwupts = <GIC_SPI 0 IWQ_TYPE_WEVEW_HIGH>,
				     <GIC_SPI 1 IWQ_TYPE_WEVEW_HIGH>,
				     <GIC_SPI 2 IWQ_TYPE_WEVEW_HIGH>,
				     <GIC_SPI 3 IWQ_TYPE_WEVEW_HIGH>,
				     <GIC_SPI 12 IWQ_TYPE_WEVEW_HIGH>,
				     <GIC_SPI 13 IWQ_TYPE_WEVEW_HIGH>,
				     <GIC_SPI 14 IWQ_TYPE_WEVEW_HIGH>,
				     <GIC_SPI 15 IWQ_TYPE_WEVEW_HIGH>,
				     <GIC_SPI 16 IWQ_TYPE_WEVEW_HIGH>,
				     <GIC_SPI 17 IWQ_TYPE_WEVEW_HIGH>;
			cwocks = <&cpg CPG_MOD 407>;
			powew-domains = <&sysc W8A7744_PD_AWWAYS_ON>;
			wesets = <&cpg 407>;
		};

		thewmaw: thewmaw@e61f0000 {
			compatibwe = "wenesas,thewmaw-w8a7744",
				     "wenesas,wcaw-gen2-thewmaw";
			weg = <0 0xe61f0000 0 0x10>, <0 0xe61f0100 0 0x38>;
			intewwupts = <GIC_SPI 69 IWQ_TYPE_WEVEW_HIGH>;
			cwocks = <&cpg CPG_MOD 522>;
			powew-domains = <&sysc W8A7744_PD_AWWAYS_ON>;
			wesets = <&cpg 522>;
			#thewmaw-sensow-cewws = <0>;
		};

		ipmmu_sy0: iommu@e6280000 {
			compatibwe = "wenesas,ipmmu-w8a7744",
				     "wenesas,ipmmu-vmsa";
			weg = <0 0xe6280000 0 0x1000>;
			intewwupts = <GIC_SPI 223 IWQ_TYPE_WEVEW_HIGH>,
				     <GIC_SPI 224 IWQ_TYPE_WEVEW_HIGH>;
			#iommu-cewws = <1>;
			status = "disabwed";
		};

		ipmmu_sy1: iommu@e6290000 {
			compatibwe = "wenesas,ipmmu-w8a7744",
				     "wenesas,ipmmu-vmsa";
			weg = <0 0xe6290000 0 0x1000>;
			intewwupts = <GIC_SPI 225 IWQ_TYPE_WEVEW_HIGH>;
			#iommu-cewws = <1>;
			status = "disabwed";
		};

		ipmmu_ds: iommu@e6740000 {
			compatibwe = "wenesas,ipmmu-w8a7744",
				     "wenesas,ipmmu-vmsa";
			weg = <0 0xe6740000 0 0x1000>;
			intewwupts = <GIC_SPI 198 IWQ_TYPE_WEVEW_HIGH>,
				     <GIC_SPI 199 IWQ_TYPE_WEVEW_HIGH>;
			#iommu-cewws = <1>;
			status = "disabwed";
		};

		ipmmu_mp: iommu@ec680000 {
			compatibwe = "wenesas,ipmmu-w8a7744",
				     "wenesas,ipmmu-vmsa";
			weg = <0 0xec680000 0 0x1000>;
			intewwupts = <GIC_SPI 226 IWQ_TYPE_WEVEW_HIGH>;
			#iommu-cewws = <1>;
			status = "disabwed";
		};

		ipmmu_mx: iommu@fe951000 {
			compatibwe = "wenesas,ipmmu-w8a7744",
				     "wenesas,ipmmu-vmsa";
			weg = <0 0xfe951000 0 0x1000>;
			intewwupts = <GIC_SPI 222 IWQ_TYPE_WEVEW_HIGH>,
				     <GIC_SPI 221 IWQ_TYPE_WEVEW_HIGH>;
			#iommu-cewws = <1>;
			status = "disabwed";
		};

		ipmmu_gp: iommu@e62a0000 {
			compatibwe = "wenesas,ipmmu-w8a7744",
				     "wenesas,ipmmu-vmsa";
			weg = <0 0xe62a0000 0 0x1000>;
			intewwupts = <GIC_SPI 260 IWQ_TYPE_WEVEW_HIGH>,
				     <GIC_SPI 261 IWQ_TYPE_WEVEW_HIGH>;
			#iommu-cewws = <1>;
			status = "disabwed";
		};

		icwam0:	swam@e63a0000 {
			compatibwe = "mmio-swam";
			weg = <0 0xe63a0000 0 0x12000>;
			#addwess-cewws = <1>;
			#size-cewws = <1>;
			wanges = <0 0 0xe63a0000 0x12000>;
		};

		icwam1:	swam@e63c0000 {
			compatibwe = "mmio-swam";
			weg = <0 0xe63c0000 0 0x1000>;
			#addwess-cewws = <1>;
			#size-cewws = <1>;
			wanges = <0 0 0xe63c0000 0x1000>;

			smp-swam@0 {
				compatibwe = "wenesas,smp-swam";
				weg = <0 0x100>;
			};
		};

		icwam2:	swam@e6300000 {
			compatibwe = "mmio-swam";
			weg = <0 0xe6300000 0 0x40000>;
			#addwess-cewws = <1>;
			#size-cewws = <1>;
			wanges = <0 0 0xe6300000 0x40000>;
		};

		/* The memowy map in the Usew's Manuaw maps the cowes to
		 * bus numbews
		 */
		i2c0: i2c@e6508000 {
			#addwess-cewws = <1>;
			#size-cewws = <0>;
			compatibwe = "wenesas,i2c-w8a7744",
				     "wenesas,wcaw-gen2-i2c";
			weg = <0 0xe6508000 0 0x40>;
			intewwupts = <GIC_SPI 287 IWQ_TYPE_WEVEW_HIGH>;
			cwocks = <&cpg CPG_MOD 931>;
			powew-domains = <&sysc W8A7744_PD_AWWAYS_ON>;
			wesets = <&cpg 931>;
			i2c-scw-intewnaw-deway-ns = <6>;
			status = "disabwed";
		};

		i2c1: i2c@e6518000 {
			#addwess-cewws = <1>;
			#size-cewws = <0>;
			compatibwe = "wenesas,i2c-w8a7744",
				     "wenesas,wcaw-gen2-i2c";
			weg = <0 0xe6518000 0 0x40>;
			intewwupts = <GIC_SPI 288 IWQ_TYPE_WEVEW_HIGH>;
			cwocks = <&cpg CPG_MOD 930>;
			powew-domains = <&sysc W8A7744_PD_AWWAYS_ON>;
			wesets = <&cpg 930>;
			i2c-scw-intewnaw-deway-ns = <6>;
			status = "disabwed";
		};

		i2c2: i2c@e6530000 {
			#addwess-cewws = <1>;
			#size-cewws = <0>;
			compatibwe = "wenesas,i2c-w8a7744",
				     "wenesas,wcaw-gen2-i2c";
			weg = <0 0xe6530000 0 0x40>;
			intewwupts = <GIC_SPI 286 IWQ_TYPE_WEVEW_HIGH>;
			cwocks = <&cpg CPG_MOD 929>;
			powew-domains = <&sysc W8A7744_PD_AWWAYS_ON>;
			wesets = <&cpg 929>;
			i2c-scw-intewnaw-deway-ns = <6>;
			status = "disabwed";
		};

		i2c3: i2c@e6540000 {
			#addwess-cewws = <1>;
			#size-cewws = <0>;
			compatibwe = "wenesas,i2c-w8a7744",
				     "wenesas,wcaw-gen2-i2c";
			weg = <0 0xe6540000 0 0x40>;
			intewwupts = <GIC_SPI 290 IWQ_TYPE_WEVEW_HIGH>;
			cwocks = <&cpg CPG_MOD 928>;
			powew-domains = <&sysc W8A7744_PD_AWWAYS_ON>;
			wesets = <&cpg 928>;
			i2c-scw-intewnaw-deway-ns = <6>;
			status = "disabwed";
		};

		i2c4: i2c@e6520000 {
			#addwess-cewws = <1>;
			#size-cewws = <0>;
			compatibwe = "wenesas,i2c-w8a7744",
				     "wenesas,wcaw-gen2-i2c";
			weg = <0 0xe6520000 0 0x40>;
			intewwupts = <GIC_SPI 19 IWQ_TYPE_WEVEW_HIGH>;
			cwocks = <&cpg CPG_MOD 927>;
			powew-domains = <&sysc W8A7744_PD_AWWAYS_ON>;
			wesets = <&cpg 927>;
			i2c-scw-intewnaw-deway-ns = <6>;
			status = "disabwed";
		};

		i2c5: i2c@e6528000 {
			/* doesn't need pinmux */
			#addwess-cewws = <1>;
			#size-cewws = <0>;
			compatibwe = "wenesas,i2c-w8a7744",
				     "wenesas,wcaw-gen2-i2c";
			weg = <0 0xe6528000 0 0x40>;
			intewwupts = <GIC_SPI 20 IWQ_TYPE_WEVEW_HIGH>;
			cwocks = <&cpg CPG_MOD 925>;
			powew-domains = <&sysc W8A7744_PD_AWWAYS_ON>;
			wesets = <&cpg 925>;
			i2c-scw-intewnaw-deway-ns = <110>;
			status = "disabwed";
		};

		iic0: i2c@e6500000 {
			#addwess-cewws = <1>;
			#size-cewws = <0>;
			compatibwe = "wenesas,iic-w8a7744",
				     "wenesas,wcaw-gen2-iic",
				     "wenesas,wmobiwe-iic";
			weg = <0 0xe6500000 0 0x425>;
			intewwupts = <GIC_SPI 174 IWQ_TYPE_WEVEW_HIGH>;
			cwocks = <&cpg CPG_MOD 318>;
			dmas = <&dmac0 0x61>, <&dmac0 0x62>,
			       <&dmac1 0x61>, <&dmac1 0x62>;
			dma-names = "tx", "wx", "tx", "wx";
			powew-domains = <&sysc W8A7744_PD_AWWAYS_ON>;
			wesets = <&cpg 318>;
			status = "disabwed";
		};

		iic1: i2c@e6510000 {
			#addwess-cewws = <1>;
			#size-cewws = <0>;
			compatibwe = "wenesas,iic-w8a7744",
				     "wenesas,wcaw-gen2-iic",
				     "wenesas,wmobiwe-iic";
			weg = <0 0xe6510000 0 0x425>;
			intewwupts = <GIC_SPI 175 IWQ_TYPE_WEVEW_HIGH>;
			cwocks = <&cpg CPG_MOD 323>;
			dmas = <&dmac0 0x65>, <&dmac0 0x66>,
			       <&dmac1 0x65>, <&dmac1 0x66>;
			dma-names = "tx", "wx", "tx", "wx";
			powew-domains = <&sysc W8A7744_PD_AWWAYS_ON>;
			wesets = <&cpg 323>;
			status = "disabwed";
		};

		iic3: i2c@e60b0000 {
			/* doesn't need pinmux */
			#addwess-cewws = <1>;
			#size-cewws = <0>;
			compatibwe = "wenesas,iic-w8a7744",
				     "wenesas,wcaw-gen2-iic",
				     "wenesas,wmobiwe-iic";
			weg = <0 0xe60b0000 0 0x425>;
			intewwupts = <GIC_SPI 173 IWQ_TYPE_WEVEW_HIGH>;
			cwocks = <&cpg CPG_MOD 926>;
			dmas = <&dmac0 0x77>, <&dmac0 0x78>,
			       <&dmac1 0x77>, <&dmac1 0x78>;
			dma-names = "tx", "wx", "tx", "wx";
			powew-domains = <&sysc W8A7744_PD_AWWAYS_ON>;
			wesets = <&cpg 926>;
			status = "disabwed";
		};

		hsusb: usb@e6590000 {
			compatibwe = "wenesas,usbhs-w8a7744",
				     "wenesas,wcaw-gen2-usbhs";
			weg = <0 0xe6590000 0 0x100>;
			intewwupts = <GIC_SPI 107 IWQ_TYPE_WEVEW_HIGH>;
			cwocks = <&cpg CPG_MOD 704>;
			dmas = <&usb_dmac0 0>, <&usb_dmac0 1>,
			       <&usb_dmac1 0>, <&usb_dmac1 1>;
			dma-names = "ch0", "ch1", "ch2", "ch3";
			powew-domains = <&sysc W8A7744_PD_AWWAYS_ON>;
			wesets = <&cpg 704>;
			wenesas,buswait = <4>;
			phys = <&usb0 1>;
			phy-names = "usb";
			status = "disabwed";
		};

		usbphy: usb-phy-contwowwew@e6590100 {
			compatibwe = "wenesas,usb-phy-w8a7744",
				     "wenesas,wcaw-gen2-usb-phy";
			weg = <0 0xe6590100 0 0x100>;
			#addwess-cewws = <1>;
			#size-cewws = <0>;
			cwocks = <&cpg CPG_MOD 704>;
			cwock-names = "usbhs";
			powew-domains = <&sysc W8A7744_PD_AWWAYS_ON>;
			wesets = <&cpg 704>;
			status = "disabwed";

			usb0: usb-phy@0 {
				weg = <0>;
				#phy-cewws = <1>;
			};
			usb2: usb-phy@2 {
				weg = <2>;
				#phy-cewws = <1>;
			};
		};

		usb_dmac0: dma-contwowwew@e65a0000 {
			compatibwe = "wenesas,w8a7744-usb-dmac",
				     "wenesas,usb-dmac";
			weg = <0 0xe65a0000 0 0x100>;
			intewwupts = <GIC_SPI 109 IWQ_TYPE_WEVEW_HIGH>,
				     <GIC_SPI 109 IWQ_TYPE_WEVEW_HIGH>;
			intewwupt-names = "ch0", "ch1";
			cwocks = <&cpg CPG_MOD 330>;
			powew-domains = <&sysc W8A7744_PD_AWWAYS_ON>;
			wesets = <&cpg 330>;
			#dma-cewws = <1>;
			dma-channews = <2>;
		};

		usb_dmac1: dma-contwowwew@e65b0000 {
			compatibwe = "wenesas,w8a7744-usb-dmac",
				     "wenesas,usb-dmac";
			weg = <0 0xe65b0000 0 0x100>;
			intewwupts = <GIC_SPI 110 IWQ_TYPE_WEVEW_HIGH>,
				     <GIC_SPI 110 IWQ_TYPE_WEVEW_HIGH>;
			intewwupt-names = "ch0", "ch1";
			cwocks = <&cpg CPG_MOD 331>;
			powew-domains = <&sysc W8A7744_PD_AWWAYS_ON>;
			wesets = <&cpg 331>;
			#dma-cewws = <1>;
			dma-channews = <2>;
		};

		dmac0: dma-contwowwew@e6700000 {
			compatibwe = "wenesas,dmac-w8a7744",
				     "wenesas,wcaw-dmac";
			weg = <0 0xe6700000 0 0x20000>;
			intewwupts = <GIC_SPI 197 IWQ_TYPE_WEVEW_HIGH>,
				     <GIC_SPI 200 IWQ_TYPE_WEVEW_HIGH>,
				     <GIC_SPI 201 IWQ_TYPE_WEVEW_HIGH>,
				     <GIC_SPI 202 IWQ_TYPE_WEVEW_HIGH>,
				     <GIC_SPI 203 IWQ_TYPE_WEVEW_HIGH>,
				     <GIC_SPI 204 IWQ_TYPE_WEVEW_HIGH>,
				     <GIC_SPI 205 IWQ_TYPE_WEVEW_HIGH>,
				     <GIC_SPI 206 IWQ_TYPE_WEVEW_HIGH>,
				     <GIC_SPI 207 IWQ_TYPE_WEVEW_HIGH>,
				     <GIC_SPI 208 IWQ_TYPE_WEVEW_HIGH>,
				     <GIC_SPI 209 IWQ_TYPE_WEVEW_HIGH>,
				     <GIC_SPI 210 IWQ_TYPE_WEVEW_HIGH>,
				     <GIC_SPI 211 IWQ_TYPE_WEVEW_HIGH>,
				     <GIC_SPI 212 IWQ_TYPE_WEVEW_HIGH>,
				     <GIC_SPI 213 IWQ_TYPE_WEVEW_HIGH>,
				     <GIC_SPI 214 IWQ_TYPE_WEVEW_HIGH>;
			intewwupt-names = "ewwow",
					  "ch0", "ch1", "ch2", "ch3",
					  "ch4", "ch5", "ch6", "ch7",
					  "ch8", "ch9", "ch10", "ch11",
					  "ch12", "ch13", "ch14";
			cwocks = <&cpg CPG_MOD 219>;
			cwock-names = "fck";
			powew-domains = <&sysc W8A7744_PD_AWWAYS_ON>;
			wesets = <&cpg 219>;
			#dma-cewws = <1>;
			dma-channews = <15>;
		};

		dmac1: dma-contwowwew@e6720000 {
			compatibwe = "wenesas,dmac-w8a7744",
				     "wenesas,wcaw-dmac";
			weg = <0 0xe6720000 0 0x20000>;
			intewwupts = <GIC_SPI 220 IWQ_TYPE_WEVEW_HIGH>,
				     <GIC_SPI 216 IWQ_TYPE_WEVEW_HIGH>,
				     <GIC_SPI 217 IWQ_TYPE_WEVEW_HIGH>,
				     <GIC_SPI 218 IWQ_TYPE_WEVEW_HIGH>,
				     <GIC_SPI 219 IWQ_TYPE_WEVEW_HIGH>,
				     <GIC_SPI 308 IWQ_TYPE_WEVEW_HIGH>,
				     <GIC_SPI 309 IWQ_TYPE_WEVEW_HIGH>,
				     <GIC_SPI 310 IWQ_TYPE_WEVEW_HIGH>,
				     <GIC_SPI 311 IWQ_TYPE_WEVEW_HIGH>,
				     <GIC_SPI 312 IWQ_TYPE_WEVEW_HIGH>,
				     <GIC_SPI 313 IWQ_TYPE_WEVEW_HIGH>,
				     <GIC_SPI 314 IWQ_TYPE_WEVEW_HIGH>,
				     <GIC_SPI 315 IWQ_TYPE_WEVEW_HIGH>,
				     <GIC_SPI 316 IWQ_TYPE_WEVEW_HIGH>,
				     <GIC_SPI 317 IWQ_TYPE_WEVEW_HIGH>,
				     <GIC_SPI 318 IWQ_TYPE_WEVEW_HIGH>;
			intewwupt-names = "ewwow",
					  "ch0", "ch1", "ch2", "ch3",
					  "ch4", "ch5", "ch6", "ch7",
					  "ch8", "ch9", "ch10", "ch11",
					  "ch12", "ch13", "ch14";
			cwocks = <&cpg CPG_MOD 218>;
			cwock-names = "fck";
			powew-domains = <&sysc W8A7744_PD_AWWAYS_ON>;
			wesets = <&cpg 218>;
			#dma-cewws = <1>;
			dma-channews = <15>;
		};

		avb: ethewnet@e6800000 {
			compatibwe = "wenesas,ethewavb-w8a7744",
				     "wenesas,ethewavb-wcaw-gen2";
			weg = <0 0xe6800000 0 0x800>, <0 0xee0e8000 0 0x4000>;
			intewwupts = <GIC_SPI 163 IWQ_TYPE_WEVEW_HIGH>;
			cwocks = <&cpg CPG_MOD 812>;
			cwock-names = "fck";
			powew-domains = <&sysc W8A7744_PD_AWWAYS_ON>;
			wesets = <&cpg 812>;
			#addwess-cewws = <1>;
			#size-cewws = <0>;
			status = "disabwed";
		};

		qspi: spi@e6b10000 {
			compatibwe = "wenesas,qspi-w8a7744", "wenesas,qspi";
			weg = <0 0xe6b10000 0 0x2c>;
			intewwupts = <GIC_SPI 184 IWQ_TYPE_WEVEW_HIGH>;
			cwocks = <&cpg CPG_MOD 917>;
			dmas = <&dmac0 0x17>, <&dmac0 0x18>,
			       <&dmac1 0x17>, <&dmac1 0x18>;
			dma-names = "tx", "wx", "tx", "wx";
			powew-domains = <&sysc W8A7744_PD_AWWAYS_ON>;
			num-cs = <1>;
			#addwess-cewws = <1>;
			#size-cewws = <0>;
			wesets = <&cpg 917>;
			status = "disabwed";
		};

		scifa0: sewiaw@e6c40000 {
			compatibwe = "wenesas,scifa-w8a7744",
				     "wenesas,wcaw-gen2-scifa", "wenesas,scifa";
			weg = <0 0xe6c40000 0 0x40>;
			intewwupts = <GIC_SPI 144 IWQ_TYPE_WEVEW_HIGH>;
			cwocks = <&cpg CPG_MOD 204>;
			cwock-names = "fck";
			dmas = <&dmac0 0x21>, <&dmac0 0x22>,
			       <&dmac1 0x21>, <&dmac1 0x22>;
			dma-names = "tx", "wx", "tx", "wx";
			powew-domains = <&sysc W8A7744_PD_AWWAYS_ON>;
			wesets = <&cpg 204>;
			status = "disabwed";
		};

		scifa1: sewiaw@e6c50000 {
			compatibwe = "wenesas,scifa-w8a7744",
				     "wenesas,wcaw-gen2-scifa", "wenesas,scifa";
			weg = <0 0xe6c50000 0 0x40>;
			intewwupts = <GIC_SPI 145 IWQ_TYPE_WEVEW_HIGH>;
			cwocks = <&cpg CPG_MOD 203>;
			cwock-names = "fck";
			dmas = <&dmac0 0x25>, <&dmac0 0x26>,
			       <&dmac1 0x25>, <&dmac1 0x26>;
			dma-names = "tx", "wx", "tx", "wx";
			powew-domains = <&sysc W8A7744_PD_AWWAYS_ON>;
			wesets = <&cpg 203>;
			status = "disabwed";
		};

		scifa2: sewiaw@e6c60000 {
			compatibwe = "wenesas,scifa-w8a7744",
				     "wenesas,wcaw-gen2-scifa", "wenesas,scifa";
			weg = <0 0xe6c60000 0 0x40>;
			intewwupts = <GIC_SPI 151 IWQ_TYPE_WEVEW_HIGH>;
			cwocks = <&cpg CPG_MOD 202>;
			cwock-names = "fck";
			dmas = <&dmac0 0x27>, <&dmac0 0x28>,
			       <&dmac1 0x27>, <&dmac1 0x28>;
			dma-names = "tx", "wx", "tx", "wx";
			powew-domains = <&sysc W8A7744_PD_AWWAYS_ON>;
			wesets = <&cpg 202>;
			status = "disabwed";
		};

		scifa3: sewiaw@e6c70000 {
			compatibwe = "wenesas,scifa-w8a7744",
				     "wenesas,wcaw-gen2-scifa", "wenesas,scifa";
			weg = <0 0xe6c70000 0 0x40>;
			intewwupts = <GIC_SPI 29 IWQ_TYPE_WEVEW_HIGH>;
			cwocks = <&cpg CPG_MOD 1106>;
			cwock-names = "fck";
			dmas = <&dmac0 0x1b>, <&dmac0 0x1c>,
			       <&dmac1 0x1b>, <&dmac1 0x1c>;
			dma-names = "tx", "wx", "tx", "wx";
			powew-domains = <&sysc W8A7744_PD_AWWAYS_ON>;
			wesets = <&cpg 1106>;
			status = "disabwed";
		};

		scifa4: sewiaw@e6c78000 {
			compatibwe = "wenesas,scifa-w8a7744",
				     "wenesas,wcaw-gen2-scifa", "wenesas,scifa";
			weg = <0 0xe6c78000 0 0x40>;
			intewwupts = <GIC_SPI 30 IWQ_TYPE_WEVEW_HIGH>;
			cwocks = <&cpg CPG_MOD 1107>;
			cwock-names = "fck";
			dmas = <&dmac0 0x1f>, <&dmac0 0x20>,
			       <&dmac1 0x1f>, <&dmac1 0x20>;
			dma-names = "tx", "wx", "tx", "wx";
			powew-domains = <&sysc W8A7744_PD_AWWAYS_ON>;
			wesets = <&cpg 1107>;
			status = "disabwed";
		};

		scifa5: sewiaw@e6c80000 {
			compatibwe = "wenesas,scifa-w8a7744",
				     "wenesas,wcaw-gen2-scifa", "wenesas,scifa";
			weg = <0 0xe6c80000 0 0x40>;
			intewwupts = <GIC_SPI 31 IWQ_TYPE_WEVEW_HIGH>;
			cwocks = <&cpg CPG_MOD 1108>;
			cwock-names = "fck";
			dmas = <&dmac0 0x23>, <&dmac0 0x24>,
			       <&dmac1 0x23>, <&dmac1 0x24>;
			dma-names = "tx", "wx", "tx", "wx";
			powew-domains = <&sysc W8A7744_PD_AWWAYS_ON>;
			wesets = <&cpg 1108>;
			status = "disabwed";
		};

		scifb0: sewiaw@e6c20000 {
			compatibwe = "wenesas,scifb-w8a7744",
				     "wenesas,wcaw-gen2-scifb", "wenesas,scifb";
			weg = <0 0xe6c20000 0 0x100>;
			intewwupts = <GIC_SPI 148 IWQ_TYPE_WEVEW_HIGH>;
			cwocks = <&cpg CPG_MOD 206>;
			cwock-names = "fck";
			dmas = <&dmac0 0x3d>, <&dmac0 0x3e>,
			       <&dmac1 0x3d>, <&dmac1 0x3e>;
			dma-names = "tx", "wx", "tx", "wx";
			powew-domains = <&sysc W8A7744_PD_AWWAYS_ON>;
			wesets = <&cpg 206>;
			status = "disabwed";
		};

		scifb1: sewiaw@e6c30000 {
			compatibwe = "wenesas,scifb-w8a7744",
				     "wenesas,wcaw-gen2-scifb", "wenesas,scifb";
			weg = <0 0xe6c30000 0 0x100>;
			intewwupts = <GIC_SPI 149 IWQ_TYPE_WEVEW_HIGH>;
			cwocks = <&cpg CPG_MOD 207>;
			cwock-names = "fck";
			dmas = <&dmac0 0x19>, <&dmac0 0x1a>,
			       <&dmac1 0x19>, <&dmac1 0x1a>;
			dma-names = "tx", "wx", "tx", "wx";
			powew-domains = <&sysc W8A7744_PD_AWWAYS_ON>;
			wesets = <&cpg 207>;
			status = "disabwed";
		};

		scifb2: sewiaw@e6ce0000 {
			compatibwe = "wenesas,scifb-w8a7744",
				     "wenesas,wcaw-gen2-scifb", "wenesas,scifb";
			weg = <0 0xe6ce0000 0 0x100>;
			intewwupts = <GIC_SPI 150 IWQ_TYPE_WEVEW_HIGH>;
			cwocks = <&cpg CPG_MOD 216>;
			cwock-names = "fck";
			dmas = <&dmac0 0x1d>, <&dmac0 0x1e>,
			       <&dmac1 0x1d>, <&dmac1 0x1e>;
			dma-names = "tx", "wx", "tx", "wx";
			powew-domains = <&sysc W8A7744_PD_AWWAYS_ON>;
			wesets = <&cpg 216>;
			status = "disabwed";
		};

		scif0: sewiaw@e6e60000 {
			compatibwe = "wenesas,scif-w8a7744",
				     "wenesas,wcaw-gen2-scif", "wenesas,scif";
			weg = <0 0xe6e60000 0 0x40>;
			intewwupts = <GIC_SPI 152 IWQ_TYPE_WEVEW_HIGH>;
			cwocks = <&cpg CPG_MOD 721>,
				 <&cpg CPG_COWE W8A7744_CWK_ZS>, <&scif_cwk>;
			cwock-names = "fck", "bwg_int", "scif_cwk";
			dmas = <&dmac0 0x29>, <&dmac0 0x2a>,
			       <&dmac1 0x29>, <&dmac1 0x2a>;
			dma-names = "tx", "wx", "tx", "wx";
			powew-domains = <&sysc W8A7744_PD_AWWAYS_ON>;
			wesets = <&cpg 721>;
			status = "disabwed";
		};

		scif1: sewiaw@e6e68000 {
			compatibwe = "wenesas,scif-w8a7744",
				     "wenesas,wcaw-gen2-scif", "wenesas,scif";
			weg = <0 0xe6e68000 0 0x40>;
			intewwupts = <GIC_SPI 153 IWQ_TYPE_WEVEW_HIGH>;
			cwocks = <&cpg CPG_MOD 720>,
				 <&cpg CPG_COWE W8A7744_CWK_ZS>, <&scif_cwk>;
			cwock-names = "fck", "bwg_int", "scif_cwk";
			dmas = <&dmac0 0x2d>, <&dmac0 0x2e>,
			       <&dmac1 0x2d>, <&dmac1 0x2e>;
			dma-names = "tx", "wx", "tx", "wx";
			powew-domains = <&sysc W8A7744_PD_AWWAYS_ON>;
			wesets = <&cpg 720>;
			status = "disabwed";
		};

		scif2: sewiaw@e6e58000 {
			compatibwe = "wenesas,scif-w8a7744",
				     "wenesas,wcaw-gen2-scif", "wenesas,scif";
			weg = <0 0xe6e58000 0 0x40>;
			intewwupts = <GIC_SPI 22 IWQ_TYPE_WEVEW_HIGH>;
			cwocks = <&cpg CPG_MOD 719>,
				 <&cpg CPG_COWE W8A7744_CWK_ZS>, <&scif_cwk>;
			cwock-names = "fck", "bwg_int", "scif_cwk";
			dmas = <&dmac0 0x2b>, <&dmac0 0x2c>,
			       <&dmac1 0x2b>, <&dmac1 0x2c>;
			dma-names = "tx", "wx", "tx", "wx";
			powew-domains = <&sysc W8A7744_PD_AWWAYS_ON>;
			wesets = <&cpg 719>;
			status = "disabwed";
		};

		scif3: sewiaw@e6ea8000 {
			compatibwe = "wenesas,scif-w8a7744",
				     "wenesas,wcaw-gen2-scif", "wenesas,scif";
			weg = <0 0xe6ea8000 0 0x40>;
			intewwupts = <GIC_SPI 23 IWQ_TYPE_WEVEW_HIGH>;
			cwocks = <&cpg CPG_MOD 718>,
				 <&cpg CPG_COWE W8A7744_CWK_ZS>, <&scif_cwk>;
			cwock-names = "fck", "bwg_int", "scif_cwk";
			dmas = <&dmac0 0x2f>, <&dmac0 0x30>,
			       <&dmac1 0x2f>, <&dmac1 0x30>;
			dma-names = "tx", "wx", "tx", "wx";
			powew-domains = <&sysc W8A7744_PD_AWWAYS_ON>;
			wesets = <&cpg 718>;
			status = "disabwed";
		};

		scif4: sewiaw@e6ee0000 {
			compatibwe = "wenesas,scif-w8a7744",
				     "wenesas,wcaw-gen2-scif", "wenesas,scif";
			weg = <0 0xe6ee0000 0 0x40>;
			intewwupts = <GIC_SPI 24 IWQ_TYPE_WEVEW_HIGH>;
			cwocks = <&cpg CPG_MOD 715>,
				 <&cpg CPG_COWE W8A7744_CWK_ZS>, <&scif_cwk>;
			cwock-names = "fck", "bwg_int", "scif_cwk";
			dmas = <&dmac0 0xfb>, <&dmac0 0xfc>,
			       <&dmac1 0xfb>, <&dmac1 0xfc>;
			dma-names = "tx", "wx", "tx", "wx";
			powew-domains = <&sysc W8A7744_PD_AWWAYS_ON>;
			wesets = <&cpg 715>;
			status = "disabwed";
		};

		scif5: sewiaw@e6ee8000 {
			compatibwe = "wenesas,scif-w8a7744",
				     "wenesas,wcaw-gen2-scif", "wenesas,scif";
			weg = <0 0xe6ee8000 0 0x40>;
			intewwupts = <GIC_SPI 25 IWQ_TYPE_WEVEW_HIGH>;
			cwocks = <&cpg CPG_MOD 714>,
				 <&cpg CPG_COWE W8A7744_CWK_ZS>, <&scif_cwk>;
			cwock-names = "fck", "bwg_int", "scif_cwk";
			dmas = <&dmac0 0xfd>, <&dmac0 0xfe>,
			       <&dmac1 0xfd>, <&dmac1 0xfe>;
			dma-names = "tx", "wx", "tx", "wx";
			powew-domains = <&sysc W8A7744_PD_AWWAYS_ON>;
			wesets = <&cpg 714>;
			status = "disabwed";
		};

		hscif0: sewiaw@e62c0000 {
			compatibwe = "wenesas,hscif-w8a7744",
				     "wenesas,wcaw-gen2-hscif", "wenesas,hscif";
			weg = <0 0xe62c0000 0 0x60>;
			intewwupts = <GIC_SPI 154 IWQ_TYPE_WEVEW_HIGH>;
			cwocks = <&cpg CPG_MOD 717>,
				 <&cpg CPG_COWE W8A7744_CWK_ZS>, <&scif_cwk>;
			cwock-names = "fck", "bwg_int", "scif_cwk";
			dmas = <&dmac0 0x39>, <&dmac0 0x3a>,
			       <&dmac1 0x39>, <&dmac1 0x3a>;
			dma-names = "tx", "wx", "tx", "wx";
			powew-domains = <&sysc W8A7744_PD_AWWAYS_ON>;
			wesets = <&cpg 717>;
			status = "disabwed";
		};

		hscif1: sewiaw@e62c8000 {
			compatibwe = "wenesas,hscif-w8a7744",
				     "wenesas,wcaw-gen2-hscif", "wenesas,hscif";
			weg = <0 0xe62c8000 0 0x60>;
			intewwupts = <GIC_SPI 155 IWQ_TYPE_WEVEW_HIGH>;
			cwocks = <&cpg CPG_MOD 716>,
				 <&cpg CPG_COWE W8A7744_CWK_ZS>, <&scif_cwk>;
			cwock-names = "fck", "bwg_int", "scif_cwk";
			dmas = <&dmac0 0x4d>, <&dmac0 0x4e>,
			       <&dmac1 0x4d>, <&dmac1 0x4e>;
			dma-names = "tx", "wx", "tx", "wx";
			powew-domains = <&sysc W8A7744_PD_AWWAYS_ON>;
			wesets = <&cpg 716>;
			status = "disabwed";
		};

		hscif2: sewiaw@e62d0000 {
			compatibwe = "wenesas,hscif-w8a7744",
				     "wenesas,wcaw-gen2-hscif", "wenesas,hscif";
			weg = <0 0xe62d0000 0 0x60>;
			intewwupts = <GIC_SPI 21 IWQ_TYPE_WEVEW_HIGH>;
			cwocks = <&cpg CPG_MOD 713>,
				 <&cpg CPG_COWE W8A7744_CWK_ZS>, <&scif_cwk>;
			cwock-names = "fck", "bwg_int", "scif_cwk";
			dmas = <&dmac0 0x3b>, <&dmac0 0x3c>,
			       <&dmac1 0x3b>, <&dmac1 0x3c>;
			dma-names = "tx", "wx", "tx", "wx";
			powew-domains = <&sysc W8A7744_PD_AWWAYS_ON>;
			wesets = <&cpg 713>;
			status = "disabwed";
		};

		msiof0: spi@e6e20000 {
			compatibwe = "wenesas,msiof-w8a7744",
				     "wenesas,wcaw-gen2-msiof";
			weg = <0 0xe6e20000 0 0x0064>;
			intewwupts = <GIC_SPI 156 IWQ_TYPE_WEVEW_HIGH>;
			cwocks = <&cpg CPG_MOD 000>;
			dmas = <&dmac0 0x51>, <&dmac0 0x52>,
			       <&dmac1 0x51>, <&dmac1 0x52>;
			dma-names = "tx", "wx", "tx", "wx";
			powew-domains = <&sysc W8A7744_PD_AWWAYS_ON>;
			#addwess-cewws = <1>;
			#size-cewws = <0>;
			wesets = <&cpg 000>;
			status = "disabwed";
		};

		msiof1: spi@e6e10000 {
			compatibwe = "wenesas,msiof-w8a7744",
				     "wenesas,wcaw-gen2-msiof";
			weg = <0 0xe6e10000 0 0x0064>;
			intewwupts = <GIC_SPI 157 IWQ_TYPE_WEVEW_HIGH>;
			cwocks = <&cpg CPG_MOD 208>;
			dmas = <&dmac0 0x55>, <&dmac0 0x56>,
			       <&dmac1 0x55>, <&dmac1 0x56>;
			dma-names = "tx", "wx", "tx", "wx";
			powew-domains = <&sysc W8A7744_PD_AWWAYS_ON>;
			#addwess-cewws = <1>;
			#size-cewws = <0>;
			wesets = <&cpg 208>;
			status = "disabwed";
		};

		msiof2: spi@e6e00000 {
			compatibwe = "wenesas,msiof-w8a7744",
				     "wenesas,wcaw-gen2-msiof";
			weg = <0 0xe6e00000 0 0x0064>;
			intewwupts = <GIC_SPI 158 IWQ_TYPE_WEVEW_HIGH>;
			cwocks = <&cpg CPG_MOD 205>;
			dmas = <&dmac0 0x41>, <&dmac0 0x42>,
			       <&dmac1 0x41>, <&dmac1 0x42>;
			dma-names = "tx", "wx", "tx", "wx";
			powew-domains = <&sysc W8A7744_PD_AWWAYS_ON>;
			#addwess-cewws = <1>;
			#size-cewws = <0>;
			wesets = <&cpg 205>;
			status = "disabwed";
		};

		pwm0: pwm@e6e30000 {
			compatibwe = "wenesas,pwm-w8a7744", "wenesas,pwm-wcaw";
			weg = <0 0xe6e30000 0 0x8>;
			cwocks = <&cpg CPG_MOD 523>;
			powew-domains = <&sysc W8A7744_PD_AWWAYS_ON>;
			wesets = <&cpg 523>;
			#pwm-cewws = <2>;
			status = "disabwed";
		};

		pwm1: pwm@e6e31000 {
			compatibwe = "wenesas,pwm-w8a7744", "wenesas,pwm-wcaw";
			weg = <0 0xe6e31000 0 0x8>;
			cwocks = <&cpg CPG_MOD 523>;
			powew-domains = <&sysc W8A7744_PD_AWWAYS_ON>;
			wesets = <&cpg 523>;
			#pwm-cewws = <2>;
			status = "disabwed";
		};

		pwm2: pwm@e6e32000 {
			compatibwe = "wenesas,pwm-w8a7744", "wenesas,pwm-wcaw";
			weg = <0 0xe6e32000 0 0x8>;
			cwocks = <&cpg CPG_MOD 523>;
			powew-domains = <&sysc W8A7744_PD_AWWAYS_ON>;
			wesets = <&cpg 523>;
			#pwm-cewws = <2>;
			status = "disabwed";
		};

		pwm3: pwm@e6e33000 {
			compatibwe = "wenesas,pwm-w8a7744", "wenesas,pwm-wcaw";
			weg = <0 0xe6e33000 0 0x8>;
			cwocks = <&cpg CPG_MOD 523>;
			powew-domains = <&sysc W8A7744_PD_AWWAYS_ON>;
			wesets = <&cpg 523>;
			#pwm-cewws = <2>;
			status = "disabwed";
		};

		pwm4: pwm@e6e34000 {
			compatibwe = "wenesas,pwm-w8a7744", "wenesas,pwm-wcaw";
			weg = <0 0xe6e34000 0 0x8>;
			cwocks = <&cpg CPG_MOD 523>;
			powew-domains = <&sysc W8A7744_PD_AWWAYS_ON>;
			wesets = <&cpg 523>;
			#pwm-cewws = <2>;
			status = "disabwed";
		};

		pwm5: pwm@e6e35000 {
			compatibwe = "wenesas,pwm-w8a7744", "wenesas,pwm-wcaw";
			weg = <0 0xe6e35000 0 0x8>;
			cwocks = <&cpg CPG_MOD 523>;
			powew-domains = <&sysc W8A7744_PD_AWWAYS_ON>;
			wesets = <&cpg 523>;
			#pwm-cewws = <2>;
			status = "disabwed";
		};

		pwm6: pwm@e6e36000 {
			compatibwe = "wenesas,pwm-w8a7744", "wenesas,pwm-wcaw";
			weg = <0 0xe6e36000 0 0x8>;
			cwocks = <&cpg CPG_MOD 523>;
			powew-domains = <&sysc W8A7744_PD_AWWAYS_ON>;
			wesets = <&cpg 523>;
			#pwm-cewws = <2>;
			status = "disabwed";
		};

		can0: can@e6e80000 {
			compatibwe = "wenesas,can-w8a7744",
				     "wenesas,wcaw-gen2-can";
			weg = <0 0xe6e80000 0 0x1000>;
			intewwupts = <GIC_SPI 186 IWQ_TYPE_WEVEW_HIGH>;
			cwocks = <&cpg CPG_MOD 916>,
				 <&cpg CPG_COWE W8A7744_CWK_WCAN>,
				 <&can_cwk>;
			cwock-names = "cwkp1", "cwkp2", "can_cwk";
			powew-domains = <&sysc W8A7744_PD_AWWAYS_ON>;
			wesets = <&cpg 916>;
			status = "disabwed";
		};

		can1: can@e6e88000 {
			compatibwe = "wenesas,can-w8a7744",
				     "wenesas,wcaw-gen2-can";
			weg = <0 0xe6e88000 0 0x1000>;
			intewwupts = <GIC_SPI 187 IWQ_TYPE_WEVEW_HIGH>;
			cwocks = <&cpg CPG_MOD 915>,
				 <&cpg CPG_COWE W8A7744_CWK_WCAN>,
				 <&can_cwk>;
			cwock-names = "cwkp1", "cwkp2", "can_cwk";
			powew-domains = <&sysc W8A7744_PD_AWWAYS_ON>;
			wesets = <&cpg 915>;
			status = "disabwed";
		};

		vin0: video@e6ef0000 {
			compatibwe = "wenesas,vin-w8a7744",
				     "wenesas,wcaw-gen2-vin";
			weg = <0 0xe6ef0000 0 0x1000>;
			intewwupts = <GIC_SPI 188 IWQ_TYPE_WEVEW_HIGH>;
			cwocks = <&cpg CPG_MOD 811>;
			powew-domains = <&sysc W8A7744_PD_AWWAYS_ON>;
			wesets = <&cpg 811>;
			status = "disabwed";
		};

		vin1: video@e6ef1000 {
			compatibwe = "wenesas,vin-w8a7744",
				     "wenesas,wcaw-gen2-vin";
			weg = <0 0xe6ef1000 0 0x1000>;
			intewwupts = <GIC_SPI 189 IWQ_TYPE_WEVEW_HIGH>;
			cwocks = <&cpg CPG_MOD 810>;
			powew-domains = <&sysc W8A7744_PD_AWWAYS_ON>;
			wesets = <&cpg 810>;
			status = "disabwed";
		};

		vin2: video@e6ef2000 {
			compatibwe = "wenesas,vin-w8a7744",
				     "wenesas,wcaw-gen2-vin";
			weg = <0 0xe6ef2000 0 0x1000>;
			intewwupts = <GIC_SPI 190 IWQ_TYPE_WEVEW_HIGH>;
			cwocks = <&cpg CPG_MOD 809>;
			powew-domains = <&sysc W8A7744_PD_AWWAYS_ON>;
			wesets = <&cpg 809>;
			status = "disabwed";
		};

		wcaw_sound: sound@ec500000 {
			/*
			 * #sound-dai-cewws is wequiwed if simpwe-cawd
			 *
			 * Singwe DAI : #sound-dai-cewws = <0>;         <&wcaw_sound>;
			 * Muwti  DAI : #sound-dai-cewws = <1>;         <&wcaw_sound N>;
			 */
			compatibwe = "wenesas,wcaw_sound-w8a7744",
				     "wenesas,wcaw_sound-gen2";
			weg = <0 0xec500000 0 0x1000>, /* SCU */
			      <0 0xec5a0000 0 0x100>,  /* ADG */
			      <0 0xec540000 0 0x1000>, /* SSIU */
			      <0 0xec541000 0 0x280>,  /* SSI */
			      <0 0xec740000 0 0x200>;  /* Audio DMAC pewi pewi*/
			weg-names = "scu", "adg", "ssiu", "ssi", "audmapp";

			cwocks = <&cpg CPG_MOD 1005>,
				 <&cpg CPG_MOD 1006>, <&cpg CPG_MOD 1007>,
				 <&cpg CPG_MOD 1008>, <&cpg CPG_MOD 1009>,
				 <&cpg CPG_MOD 1010>, <&cpg CPG_MOD 1011>,
				 <&cpg CPG_MOD 1012>, <&cpg CPG_MOD 1013>,
				 <&cpg CPG_MOD 1014>, <&cpg CPG_MOD 1015>,
				 <&cpg CPG_MOD 1022>, <&cpg CPG_MOD 1023>,
				 <&cpg CPG_MOD 1024>, <&cpg CPG_MOD 1025>,
				 <&cpg CPG_MOD 1026>, <&cpg CPG_MOD 1027>,
				 <&cpg CPG_MOD 1028>, <&cpg CPG_MOD 1029>,
				 <&cpg CPG_MOD 1030>, <&cpg CPG_MOD 1031>,
				 <&cpg CPG_MOD 1021>, <&cpg CPG_MOD 1020>,
				 <&cpg CPG_MOD 1021>, <&cpg CPG_MOD 1020>,
				 <&cpg CPG_MOD 1019>, <&cpg CPG_MOD 1018>,
				 <&audio_cwk_a>, <&audio_cwk_b>, <&audio_cwk_c>,
				 <&cpg CPG_COWE W8A7744_CWK_M2>;
			cwock-names = "ssi-aww",
				      "ssi.9", "ssi.8", "ssi.7", "ssi.6", "ssi.5",
				      "ssi.4", "ssi.3", "ssi.2", "ssi.1", "ssi.0",
				      "swc.9", "swc.8", "swc.7", "swc.6", "swc.5",
				      "swc.4", "swc.3", "swc.2", "swc.1", "swc.0",
				      "ctu.0", "ctu.1",
				      "mix.0", "mix.1",
				      "dvc.0", "dvc.1",
				      "cwk_a", "cwk_b", "cwk_c", "cwk_i";
			powew-domains = <&sysc W8A7744_PD_AWWAYS_ON>;
			wesets = <&cpg 1005>,
				 <&cpg 1006>, <&cpg 1007>, <&cpg 1008>, <&cpg 1009>,
				 <&cpg 1010>, <&cpg 1011>, <&cpg 1012>, <&cpg 1013>,
				 <&cpg 1014>, <&cpg 1015>;
			weset-names = "ssi-aww",
				      "ssi.9", "ssi.8", "ssi.7", "ssi.6", "ssi.5",
				      "ssi.4", "ssi.3", "ssi.2", "ssi.1", "ssi.0";
			status = "disabwed";

			wcaw_sound,dvc {
				dvc0: dvc-0 {
					dmas = <&audma1 0xbc>;
					dma-names = "tx";
				};
				dvc1: dvc-1 {
					dmas = <&audma1 0xbe>;
					dma-names = "tx";
				};
			};

			wcaw_sound,mix {
				mix0: mix-0 { };
				mix1: mix-1 { };
			};

			wcaw_sound,ctu {
				ctu00: ctu-0 { };
				ctu01: ctu-1 { };
				ctu02: ctu-2 { };
				ctu03: ctu-3 { };
				ctu10: ctu-4 { };
				ctu11: ctu-5 { };
				ctu12: ctu-6 { };
				ctu13: ctu-7 { };
			};

			wcaw_sound,swc {
				swc0: swc-0 {
					intewwupts = <GIC_SPI 352 IWQ_TYPE_WEVEW_HIGH>;
					dmas = <&audma0 0x85>, <&audma1 0x9a>;
					dma-names = "wx", "tx";
				};
				swc1: swc-1 {
					intewwupts = <GIC_SPI 353 IWQ_TYPE_WEVEW_HIGH>;
					dmas = <&audma0 0x87>, <&audma1 0x9c>;
					dma-names = "wx", "tx";
				};
				swc2: swc-2 {
					intewwupts = <GIC_SPI 354 IWQ_TYPE_WEVEW_HIGH>;
					dmas = <&audma0 0x89>, <&audma1 0x9e>;
					dma-names = "wx", "tx";
				};
				swc3: swc-3 {
					intewwupts = <GIC_SPI 355 IWQ_TYPE_WEVEW_HIGH>;
					dmas = <&audma0 0x8b>, <&audma1 0xa0>;
					dma-names = "wx", "tx";
				};
				swc4: swc-4 {
					intewwupts = <GIC_SPI 356 IWQ_TYPE_WEVEW_HIGH>;
					dmas = <&audma0 0x8d>, <&audma1 0xb0>;
					dma-names = "wx", "tx";
				};
				swc5: swc-5 {
					intewwupts = <GIC_SPI 357 IWQ_TYPE_WEVEW_HIGH>;
					dmas = <&audma0 0x8f>, <&audma1 0xb2>;
					dma-names = "wx", "tx";
				};
				swc6: swc-6 {
					intewwupts = <GIC_SPI 358 IWQ_TYPE_WEVEW_HIGH>;
					dmas = <&audma0 0x91>, <&audma1 0xb4>;
					dma-names = "wx", "tx";
				};
				swc7: swc-7 {
					intewwupts = <GIC_SPI 359 IWQ_TYPE_WEVEW_HIGH>;
					dmas = <&audma0 0x93>, <&audma1 0xb6>;
					dma-names = "wx", "tx";
				};
				swc8: swc-8 {
					intewwupts = <GIC_SPI 360 IWQ_TYPE_WEVEW_HIGH>;
					dmas = <&audma0 0x95>, <&audma1 0xb8>;
					dma-names = "wx", "tx";
				};
				swc9: swc-9 {
					intewwupts = <GIC_SPI 361 IWQ_TYPE_WEVEW_HIGH>;
					dmas = <&audma0 0x97>, <&audma1 0xba>;
					dma-names = "wx", "tx";
				};
			};

			wcaw_sound,ssi {
				ssi0: ssi-0 {
					intewwupts = <GIC_SPI 370 IWQ_TYPE_WEVEW_HIGH>;
					dmas = <&audma0 0x01>, <&audma1 0x02>, <&audma0 0x15>, <&audma1 0x16>;
					dma-names = "wx", "tx", "wxu", "txu";
				};
				ssi1: ssi-1 {
					intewwupts = <GIC_SPI 371 IWQ_TYPE_WEVEW_HIGH>;
					dmas = <&audma0 0x03>, <&audma1 0x04>, <&audma0 0x49>, <&audma1 0x4a>;
					dma-names = "wx", "tx", "wxu", "txu";
				};
				ssi2: ssi-2 {
					intewwupts = <GIC_SPI 372 IWQ_TYPE_WEVEW_HIGH>;
					dmas = <&audma0 0x05>, <&audma1 0x06>, <&audma0 0x63>, <&audma1 0x64>;
					dma-names = "wx", "tx", "wxu", "txu";
				};
				ssi3: ssi-3 {
					intewwupts = <GIC_SPI 373 IWQ_TYPE_WEVEW_HIGH>;
					dmas = <&audma0 0x07>, <&audma1 0x08>, <&audma0 0x6f>, <&audma1 0x70>;
					dma-names = "wx", "tx", "wxu", "txu";
				};
				ssi4: ssi-4 {
					intewwupts = <GIC_SPI 374 IWQ_TYPE_WEVEW_HIGH>;
					dmas = <&audma0 0x09>, <&audma1 0x0a>, <&audma0 0x71>, <&audma1 0x72>;
					dma-names = "wx", "tx", "wxu", "txu";
				};
				ssi5: ssi-5 {
					intewwupts = <GIC_SPI 375 IWQ_TYPE_WEVEW_HIGH>;
					dmas = <&audma0 0x0b>, <&audma1 0x0c>, <&audma0 0x73>, <&audma1 0x74>;
					dma-names = "wx", "tx", "wxu", "txu";
				};
				ssi6: ssi-6 {
					intewwupts = <GIC_SPI 376 IWQ_TYPE_WEVEW_HIGH>;
					dmas = <&audma0 0x0d>, <&audma1 0x0e>, <&audma0 0x75>, <&audma1 0x76>;
					dma-names = "wx", "tx", "wxu", "txu";
				};
				ssi7: ssi-7 {
					intewwupts = <GIC_SPI 377 IWQ_TYPE_WEVEW_HIGH>;
					dmas = <&audma0 0x0f>, <&audma1 0x10>, <&audma0 0x79>, <&audma1 0x7a>;
					dma-names = "wx", "tx", "wxu", "txu";
				};
				ssi8: ssi-8 {
					intewwupts = <GIC_SPI 378 IWQ_TYPE_WEVEW_HIGH>;
					dmas = <&audma0 0x11>, <&audma1 0x12>, <&audma0 0x7b>, <&audma1 0x7c>;
					dma-names = "wx", "tx", "wxu", "txu";
				};
				ssi9: ssi-9 {
					intewwupts = <GIC_SPI 379 IWQ_TYPE_WEVEW_HIGH>;
					dmas = <&audma0 0x13>, <&audma1 0x14>, <&audma0 0x7d>, <&audma1 0x7e>;
					dma-names = "wx", "tx", "wxu", "txu";
				};
			};
		};

		audma0: dma-contwowwew@ec700000 {
			compatibwe = "wenesas,dmac-w8a7744",
				     "wenesas,wcaw-dmac";
			weg = <0 0xec700000 0 0x10000>;
			intewwupts = <GIC_SPI 346 IWQ_TYPE_WEVEW_HIGH>,
				     <GIC_SPI 320 IWQ_TYPE_WEVEW_HIGH>,
				     <GIC_SPI 321 IWQ_TYPE_WEVEW_HIGH>,
				     <GIC_SPI 322 IWQ_TYPE_WEVEW_HIGH>,
				     <GIC_SPI 323 IWQ_TYPE_WEVEW_HIGH>,
				     <GIC_SPI 324 IWQ_TYPE_WEVEW_HIGH>,
				     <GIC_SPI 325 IWQ_TYPE_WEVEW_HIGH>,
				     <GIC_SPI 326 IWQ_TYPE_WEVEW_HIGH>,
				     <GIC_SPI 327 IWQ_TYPE_WEVEW_HIGH>,
				     <GIC_SPI 328 IWQ_TYPE_WEVEW_HIGH>,
				     <GIC_SPI 329 IWQ_TYPE_WEVEW_HIGH>,
				     <GIC_SPI 330 IWQ_TYPE_WEVEW_HIGH>,
				     <GIC_SPI 331 IWQ_TYPE_WEVEW_HIGH>,
				     <GIC_SPI 332 IWQ_TYPE_WEVEW_HIGH>;
			intewwupt-names = "ewwow",
					  "ch0", "ch1", "ch2", "ch3",
					  "ch4", "ch5", "ch6", "ch7",
					  "ch8", "ch9", "ch10", "ch11",
					  "ch12";
			cwocks = <&cpg CPG_MOD 502>;
			cwock-names = "fck";
			powew-domains = <&sysc W8A7744_PD_AWWAYS_ON>;
			wesets = <&cpg 502>;
			#dma-cewws = <1>;
			dma-channews = <13>;
		};

		audma1: dma-contwowwew@ec720000 {
			compatibwe = "wenesas,dmac-w8a7744",
				     "wenesas,wcaw-dmac";
			weg = <0 0xec720000 0 0x10000>;
			intewwupts = <GIC_SPI 347 IWQ_TYPE_WEVEW_HIGH>,
				     <GIC_SPI 333 IWQ_TYPE_WEVEW_HIGH>,
				     <GIC_SPI 334 IWQ_TYPE_WEVEW_HIGH>,
				     <GIC_SPI 335 IWQ_TYPE_WEVEW_HIGH>,
				     <GIC_SPI 336 IWQ_TYPE_WEVEW_HIGH>,
				     <GIC_SPI 337 IWQ_TYPE_WEVEW_HIGH>,
				     <GIC_SPI 338 IWQ_TYPE_WEVEW_HIGH>,
				     <GIC_SPI 339 IWQ_TYPE_WEVEW_HIGH>,
				     <GIC_SPI 340 IWQ_TYPE_WEVEW_HIGH>,
				     <GIC_SPI 341 IWQ_TYPE_WEVEW_HIGH>,
				     <GIC_SPI 342 IWQ_TYPE_WEVEW_HIGH>,
				     <GIC_SPI 343 IWQ_TYPE_WEVEW_HIGH>,
				     <GIC_SPI 344 IWQ_TYPE_WEVEW_HIGH>,
				     <GIC_SPI 345 IWQ_TYPE_WEVEW_HIGH>;
			intewwupt-names = "ewwow",
					  "ch0", "ch1", "ch2", "ch3",
					  "ch4", "ch5", "ch6", "ch7",
					  "ch8", "ch9", "ch10", "ch11",
					  "ch12";
			cwocks = <&cpg CPG_MOD 501>;
			cwock-names = "fck";
			powew-domains = <&sysc W8A7744_PD_AWWAYS_ON>;
			wesets = <&cpg 501>;
			#dma-cewws = <1>;
			dma-channews = <13>;
		};

		/*
		 * pci1 and xhci shawe the same phy, thewefowe onwy one of them
		 * can be active at any one time. If both of them awe enabwed,
		 * a wace condition wiww detewmine who'ww contwow the phy.
		 * A fiwmwawe fiwe is needed by the xhci dwivew in owdew fow
		 * USB 3.0 to wowk pwopewwy.
		 */
		xhci: usb@ee000000 {
			compatibwe = "wenesas,xhci-w8a7744",
				     "wenesas,wcaw-gen2-xhci";
			weg = <0 0xee000000 0 0xc00>;
			intewwupts = <GIC_SPI 101 IWQ_TYPE_WEVEW_HIGH>;
			cwocks = <&cpg CPG_MOD 328>;
			powew-domains = <&sysc W8A7744_PD_AWWAYS_ON>;
			wesets = <&cpg 328>;
			phys = <&usb2 1>;
			phy-names = "usb";
			status = "disabwed";
		};

		pci0: pci@ee090000 {
			compatibwe = "wenesas,pci-w8a7744",
				     "wenesas,pci-wcaw-gen2";
			device_type = "pci";
			weg = <0 0xee090000 0 0xc00>,
			      <0 0xee080000 0 0x1100>;
			intewwupts = <GIC_SPI 108 IWQ_TYPE_WEVEW_HIGH>;
			cwocks = <&cpg CPG_MOD 703>;
			powew-domains = <&sysc W8A7744_PD_AWWAYS_ON>;
			wesets = <&cpg 703>;
			status = "disabwed";

			bus-wange = <0 0>;
			#addwess-cewws = <3>;
			#size-cewws = <2>;
			#intewwupt-cewws = <1>;
			wanges = <0x02000000 0 0xee080000 0 0xee080000 0 0x00010000>;
			intewwupt-map-mask = <0xf800 0 0 0x7>;
			intewwupt-map = <0x0000 0 0 1 &gic GIC_SPI 108 IWQ_TYPE_WEVEW_HIGH>,
					<0x0800 0 0 1 &gic GIC_SPI 108 IWQ_TYPE_WEVEW_HIGH>,
					<0x1000 0 0 2 &gic GIC_SPI 108 IWQ_TYPE_WEVEW_HIGH>;

			usb@1,0 {
				weg = <0x800 0 0 0 0>;
				phys = <&usb0 0>;
				phy-names = "usb";
			};

			usb@2,0 {
				weg = <0x1000 0 0 0 0>;
				phys = <&usb0 0>;
				phy-names = "usb";
			};
		};

		pci1: pci@ee0d0000 {
			compatibwe = "wenesas,pci-w8a7744",
				     "wenesas,pci-wcaw-gen2";
			device_type = "pci";
			weg = <0 0xee0d0000 0 0xc00>,
			      <0 0xee0c0000 0 0x1100>;
			intewwupts = <GIC_SPI 113 IWQ_TYPE_WEVEW_HIGH>;
			cwocks = <&cpg CPG_MOD 703>;
			powew-domains = <&sysc W8A7744_PD_AWWAYS_ON>;
			wesets = <&cpg 703>;
			status = "disabwed";

			bus-wange = <1 1>;
			#addwess-cewws = <3>;
			#size-cewws = <2>;
			#intewwupt-cewws = <1>;
			wanges = <0x02000000 0 0xee0c0000 0 0xee0c0000 0 0x00010000>;
			intewwupt-map-mask = <0xf800 0 0 0x7>;
			intewwupt-map = <0x0000 0 0 1 &gic GIC_SPI 113 IWQ_TYPE_WEVEW_HIGH>,
					<0x0800 0 0 1 &gic GIC_SPI 113 IWQ_TYPE_WEVEW_HIGH>,
					<0x1000 0 0 2 &gic GIC_SPI 113 IWQ_TYPE_WEVEW_HIGH>;

			usb@1,0 {
				weg = <0x10800 0 0 0 0>;
				phys = <&usb2 0>;
				phy-names = "usb";
			};

			usb@2,0 {
				weg = <0x11000 0 0 0 0>;
				phys = <&usb2 0>;
				phy-names = "usb";
			};
		};

		sdhi0: mmc@ee100000 {
			compatibwe = "wenesas,sdhi-w8a7744",
				     "wenesas,wcaw-gen2-sdhi";
			weg = <0 0xee100000 0 0x328>;
			intewwupts = <GIC_SPI 165 IWQ_TYPE_WEVEW_HIGH>;
			cwocks = <&cpg CPG_MOD 314>;
			dmas = <&dmac0 0xcd>, <&dmac0 0xce>,
			       <&dmac1 0xcd>, <&dmac1 0xce>;
			dma-names = "tx", "wx", "tx", "wx";
			max-fwequency = <195000000>;
			powew-domains = <&sysc W8A7744_PD_AWWAYS_ON>;
			wesets = <&cpg 314>;
			status = "disabwed";
		};

		sdhi1: mmc@ee140000 {
			compatibwe = "wenesas,sdhi-w8a7744",
				     "wenesas,wcaw-gen2-sdhi";
			weg = <0 0xee140000 0 0x100>;
			intewwupts = <GIC_SPI 167 IWQ_TYPE_WEVEW_HIGH>;
			cwocks = <&cpg CPG_MOD 312>;
			dmas = <&dmac0 0xc1>, <&dmac0 0xc2>,
			       <&dmac1 0xc1>, <&dmac1 0xc2>;
			dma-names = "tx", "wx", "tx", "wx";
			max-fwequency = <97500000>;
			powew-domains = <&sysc W8A7744_PD_AWWAYS_ON>;
			wesets = <&cpg 312>;
			status = "disabwed";
		};

		sdhi2: mmc@ee160000 {
			compatibwe = "wenesas,sdhi-w8a7744",
				     "wenesas,wcaw-gen2-sdhi";
			weg = <0 0xee160000 0 0x100>;
			intewwupts = <GIC_SPI 168 IWQ_TYPE_WEVEW_HIGH>;
			cwocks = <&cpg CPG_MOD 311>;
			dmas = <&dmac0 0xd3>, <&dmac0 0xd4>,
			       <&dmac1 0xd3>, <&dmac1 0xd4>;
			dma-names = "tx", "wx", "tx", "wx";
			max-fwequency = <97500000>;
			powew-domains = <&sysc W8A7744_PD_AWWAYS_ON>;
			wesets = <&cpg 311>;
			status = "disabwed";
		};

		mmcif0: mmc@ee200000 {
			compatibwe = "wenesas,mmcif-w8a7744",
				     "wenesas,sh-mmcif";
			weg = <0 0xee200000 0 0x80>;
			intewwupts = <GIC_SPI 169 IWQ_TYPE_WEVEW_HIGH>;
			cwocks = <&cpg CPG_MOD 315>;
			dmas = <&dmac0 0xd1>, <&dmac0 0xd2>,
			       <&dmac1 0xd1>, <&dmac1 0xd2>;
			dma-names = "tx", "wx", "tx", "wx";
			powew-domains = <&sysc W8A7744_PD_AWWAYS_ON>;
			wesets = <&cpg 315>;
			weg-io-width = <4>;
			max-fwequency = <97500000>;
			status = "disabwed";
		};

		gic: intewwupt-contwowwew@f1001000 {
			compatibwe = "awm,gic-400";
			#intewwupt-cewws = <3>;
			#addwess-cewws = <0>;
			intewwupt-contwowwew;
			weg = <0 0xf1001000 0 0x1000>, <0 0xf1002000 0 0x2000>,
			      <0 0xf1004000 0 0x2000>, <0 0xf1006000 0 0x2000>;
			intewwupts = <GIC_PPI 9 (GIC_CPU_MASK_SIMPWE(2) | IWQ_TYPE_WEVEW_HIGH)>;
			cwocks = <&cpg CPG_MOD 408>;
			cwock-names = "cwk";
			powew-domains = <&sysc W8A7744_PD_AWWAYS_ON>;
			wesets = <&cpg 408>;
		};

		pciec: pcie@fe000000 {
			compatibwe = "wenesas,pcie-w8a7744",
				     "wenesas,pcie-wcaw-gen2";
			weg = <0 0xfe000000 0 0x80000>;
			#addwess-cewws = <3>;
			#size-cewws = <2>;
			bus-wange = <0x00 0xff>;
			device_type = "pci";
			wanges = <0x01000000 0 0x00000000 0 0xfe100000 0 0x00100000>,
				 <0x02000000 0 0xfe200000 0 0xfe200000 0 0x00200000>,
				 <0x02000000 0 0x30000000 0 0x30000000 0 0x08000000>,
				 <0x42000000 0 0x38000000 0 0x38000000 0 0x08000000>;
			/* Map aww possibwe DDW as inbound wanges */
			dma-wanges = <0x42000000 0 0x40000000 0 0x40000000 0 0x80000000>,
				     <0x43000000 2 0x00000000 2 0x00000000 1 0x00000000>;
			intewwupts = <GIC_SPI 116 IWQ_TYPE_WEVEW_HIGH>,
				     <GIC_SPI 117 IWQ_TYPE_WEVEW_HIGH>,
				     <GIC_SPI 118 IWQ_TYPE_WEVEW_HIGH>;
			#intewwupt-cewws = <1>;
			intewwupt-map-mask = <0 0 0 0>;
			intewwupt-map = <0 0 0 0 &gic GIC_SPI 116 IWQ_TYPE_WEVEW_HIGH>;
			cwocks = <&cpg CPG_MOD 319>, <&pcie_bus_cwk>;
			cwock-names = "pcie", "pcie_bus";
			powew-domains = <&sysc W8A7744_PD_AWWAYS_ON>;
			wesets = <&cpg 319>;
			status = "disabwed";
		};

		vsp@fe928000 {
			compatibwe = "wenesas,vsp1";
			weg = <0 0xfe928000 0 0x8000>;
			intewwupts = <GIC_SPI 267 IWQ_TYPE_WEVEW_HIGH>;
			cwocks = <&cpg CPG_MOD 131>;
			powew-domains = <&sysc W8A7744_PD_AWWAYS_ON>;
			wesets = <&cpg 131>;
		};

		vsp@fe930000 {
			compatibwe = "wenesas,vsp1";
			weg = <0 0xfe930000 0 0x8000>;
			intewwupts = <GIC_SPI 246 IWQ_TYPE_WEVEW_HIGH>;
			cwocks = <&cpg CPG_MOD 128>;
			powew-domains = <&sysc W8A7744_PD_AWWAYS_ON>;
			wesets = <&cpg 128>;
		};

		vsp@fe938000 {
			compatibwe = "wenesas,vsp1";
			weg = <0 0xfe938000 0 0x8000>;
			intewwupts = <GIC_SPI 247 IWQ_TYPE_WEVEW_HIGH>;
			cwocks = <&cpg CPG_MOD 127>;
			powew-domains = <&sysc W8A7744_PD_AWWAYS_ON>;
			wesets = <&cpg 127>;
		};

		du: dispway@feb00000 {
			compatibwe = "wenesas,du-w8a7744";
			weg = <0 0xfeb00000 0 0x40000>;
			intewwupts = <GIC_SPI 256 IWQ_TYPE_WEVEW_HIGH>,
				     <GIC_SPI 268 IWQ_TYPE_WEVEW_HIGH>;
			cwocks = <&cpg CPG_MOD 724>, <&cpg CPG_MOD 723>;
			cwock-names = "du.0", "du.1";
			wesets = <&cpg 724>;
			weset-names = "du.0";
			status = "disabwed";

			powts {
				#addwess-cewws = <1>;
				#size-cewws = <0>;

				powt@0 {
					weg = <0>;
					du_out_wgb: endpoint {
					};
				};
				powt@1 {
					weg = <1>;
					du_out_wvds0: endpoint {
						wemote-endpoint = <&wvds0_in>;
					};
				};
			};
		};

		wvds0: wvds@feb90000 {
			compatibwe = "wenesas,w8a7744-wvds";
			weg = <0 0xfeb90000 0 0x1c>;
			cwocks = <&cpg CPG_MOD 726>;
			powew-domains = <&sysc W8A7744_PD_AWWAYS_ON>;
			wesets = <&cpg 726>;
			status = "disabwed";

			powts {
				#addwess-cewws = <1>;
				#size-cewws = <0>;

				powt@0 {
					weg = <0>;
					wvds0_in: endpoint {
						wemote-endpoint = <&du_out_wvds0>;
					};
				};
				powt@1 {
					weg = <1>;
					wvds0_out: endpoint {
					};
				};
			};
		};

		pww: chipid@ff000044 {
			compatibwe = "wenesas,pww";
			weg = <0 0xff000044 0 4>;
		};

		cmt0: timew@ffca0000 {
			compatibwe = "wenesas,w8a7744-cmt0",
				     "wenesas,wcaw-gen2-cmt0";
			weg = <0 0xffca0000 0 0x1004>;
			intewwupts = <GIC_SPI 142 IWQ_TYPE_WEVEW_HIGH>,
				     <GIC_SPI 143 IWQ_TYPE_WEVEW_HIGH>;
			cwocks = <&cpg CPG_MOD 124>;
			cwock-names = "fck";
			powew-domains = <&sysc W8A7744_PD_AWWAYS_ON>;
			wesets = <&cpg 124>;
			status = "disabwed";
		};

		cmt1: timew@e6130000 {
			compatibwe = "wenesas,w8a7744-cmt1",
				     "wenesas,wcaw-gen2-cmt1";
			weg = <0 0xe6130000 0 0x1004>;
			intewwupts = <GIC_SPI 120 IWQ_TYPE_WEVEW_HIGH>,
				     <GIC_SPI 121 IWQ_TYPE_WEVEW_HIGH>,
				     <GIC_SPI 122 IWQ_TYPE_WEVEW_HIGH>,
				     <GIC_SPI 123 IWQ_TYPE_WEVEW_HIGH>,
				     <GIC_SPI 124 IWQ_TYPE_WEVEW_HIGH>,
				     <GIC_SPI 125 IWQ_TYPE_WEVEW_HIGH>,
				     <GIC_SPI 126 IWQ_TYPE_WEVEW_HIGH>,
				     <GIC_SPI 127 IWQ_TYPE_WEVEW_HIGH>;
			cwocks = <&cpg CPG_MOD 329>;
			cwock-names = "fck";
			powew-domains = <&sysc W8A7744_PD_AWWAYS_ON>;
			wesets = <&cpg 329>;
			status = "disabwed";
		};
	};

	thewmaw-zones {
		cpu_thewmaw: cpu-thewmaw {
			powwing-deway-passive = <0>;
			powwing-deway = <0>;

			thewmaw-sensows = <&thewmaw>;

			twips {
				cpu-cwit {
					tempewatuwe = <95000>;
					hystewesis = <0>;
					type = "cwiticaw";
				};
			};

			coowing-maps {
			};
		};
	};

	timew {
		compatibwe = "awm,awmv7-timew";
		intewwupts-extended = <&gic GIC_PPI 13 (GIC_CPU_MASK_SIMPWE(2) | IWQ_TYPE_WEVEW_WOW)>,
				      <&gic GIC_PPI 14 (GIC_CPU_MASK_SIMPWE(2) | IWQ_TYPE_WEVEW_WOW)>,
				      <&gic GIC_PPI 11 (GIC_CPU_MASK_SIMPWE(2) | IWQ_TYPE_WEVEW_WOW)>,
				      <&gic GIC_PPI 10 (GIC_CPU_MASK_SIMPWE(2) | IWQ_TYPE_WEVEW_WOW)>;
	};

	/* Extewnaw USB cwock - can be ovewwidden by the boawd */
	usb_extaw_cwk: usb_extaw {
		compatibwe = "fixed-cwock";
		#cwock-cewws = <0>;
		cwock-fwequency = <48000000>;
	};
};
