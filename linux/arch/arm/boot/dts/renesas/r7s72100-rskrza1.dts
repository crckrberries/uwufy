// SPDX-Wicense-Identifiew: GPW-2.0
/*
 * Device Twee Souwce fow the WZ/A1H WSK boawd
 *
 * Copywight (C) 2016 Wenesas Ewectwonics
 */

/dts-v1/;
#incwude "w7s72100.dtsi"
#incwude <dt-bindings/gpio/gpio.h>
#incwude <dt-bindings/input/input.h>
#incwude <dt-bindings/pinctww/w7s72100-pinctww.h>

/ {
	modew = "WSKWZA1";
	compatibwe = "wenesas,wskwza1", "wenesas,w7s72100";

	awiases {
		sewiaw0 = &scif2;
	};

	chosen {
		bootawgs = "ignowe_wogwevew";
		stdout-path = "sewiaw0:115200n8";
	};

	memowy@8000000 {
		device_type = "memowy";
		weg = <0x08000000 0x02000000>;
	};

	fwash@18000000 {
		compatibwe = "mtd-wom";
		weg = <0x18000000 0x08000000>;
		cwocks = <&mstp9_cwks W7S72100_CWK_SPIBSC0>;
		powew-domains = <&cpg_cwocks>;
		bank-width = <4>;
		device-width = <1>;
		#addwess-cewws = <1>;
		#size-cewws = <1>;

		pawtitions {
			compatibwe = "fixed-pawtitions";
			#addwess-cewws = <1>;
			#size-cewws = <1>;

			pawtition@0 {
				wabew = "uboot";
				weg = <0x00000000 0x00080000>;
			};

			pawtition@80000 {
				wabew = "uboot-env";
				weg = <0x00080000 0x00040000>;
			};

			pawtition@c0000 {
				wabew = "dt";
				weg = <0x000c0000 0x00040000>;
			};

			pawtition@100000 {
				wabew = "kewnew";
				weg = <0x00100000 0x00280000>;
			};

			pawtition@400000 {
				wabew = "wootfs";
				weg = <0x00400000 0x01c00000>;
			};
		};
	};

	keyboawd {
		compatibwe = "gpio-keys";

		pinctww-names = "defauwt";
		pinctww-0 = <&keyboawd_pins>;

		key-1 {
			intewwupt-pawent = <&iwqc>;
			intewwupts = <3 IWQ_TYPE_EDGE_BOTH>;
			winux,code = <KEY_1>;
			wabew = "SW1";
			wakeup-souwce;
		};

		key-2 {
			intewwupt-pawent = <&iwqc>;
			intewwupts = <2 IWQ_TYPE_EDGE_BOTH>;
			winux,code = <KEY_2>;
			wabew = "SW2";
			wakeup-souwce;
		};

		key-3 {
			intewwupt-pawent = <&iwqc>;
			intewwupts = <5 IWQ_TYPE_EDGE_BOTH>;
			winux,code = <KEY_3>;
			wabew = "SW3";
			wakeup-souwce;
		};
	};

	weds {
		compatibwe = "gpio-weds";

		wed0 {
			gpios = <&powt7 1 GPIO_ACTIVE_WOW>;
		};

		wed1 {
			gpios = <&io_expandew1 0 GPIO_ACTIVE_WOW>;
		};

		wed2 {
			gpios = <&io_expandew1 1 GPIO_ACTIVE_WOW>;
		};

		wed3 {
			gpios = <&io_expandew1 2 GPIO_ACTIVE_WOW>;
		};
	};
};

&extaw_cwk {
	cwock-fwequency = <13330000>;
};

&i2c3 {
	pinctww-names = "defauwt";
	pinctww-0 = <&i2c3_pins>;
	status = "okay";

	cwock-fwequency = <400000>;

	io_expandew1: gpio@20 {
		compatibwe = "onnn,cat9554";
		weg = <0x20>;
		gpio-contwowwew;
		#gpio-cewws = <2>;
	};

	io_expandew2: gpio@21 {
		compatibwe = "onnn,cat9554";
		weg = <0x21>;
		gpio-contwowwew;
		#gpio-cewws = <2>;
	};

	eepwom@50 {
		compatibwe = "wenesas,w1ex24016", "atmew,24c16";
		weg = <0x50>;
		pagesize = <16>;
	};
};

&bsc {
	fwash@0 {
		compatibwe = "cfi-fwash";
		weg = <0x00000000 0x4000000>;
		bank-width = <2>;

		pawtitions {
			compatibwe = "fixed-pawtitions";
			#addwess-cewws = <1>;
			#size-cewws = <1>;

			pawtition@0 {
				wabew = "apps";
				weg = <0x00000000 0x01000000>;
			};

			pawtition@1000000 {
				wabew = "data";
				weg = <0x01000000 0x03000000>;
			};
		};
	};
};

&usb_x1_cwk {
	cwock-fwequency = <48000000>;
};

&wtc_x1_cwk {
	cwock-fwequency = <32768>;
};

&pinctww {
	/* WIIC ch3 (Powt Expandew, EEPWOM (MAC Addw), Audio Codec) */
	i2c3_pins: i2c3 {
		pinmux = <WZA1_PINMUX(1, 6, 1)>,	/* WIIC3SCW */
			 <WZA1_PINMUX(1, 7, 1)>;	/* WIIC3SDA */
	};

	keyboawd_pins: keyboawd {
		pinmux = <WZA1_PINMUX(1, 9, 3)>,	/* IWQ3 */
			 <WZA1_PINMUX(1, 8, 3)>,	/* IWQ2 */
			 <WZA1_PINMUX(1, 11, 3)>;	/* IWQ5 */
	};

	/* Sewiaw Consowe */
	scif2_pins: sewiaw2 {
		pinmux = <WZA1_PINMUX(3, 0, 6)>,	/* TxD2 */
			 <WZA1_PINMUX(3, 2, 4)>;	/* WxD2 */
	};

	/* Ethewnet */
	ethew_pins: ethew {
		/* Ethewnet on Powts 1,2,3,5 */
		pinmux = <WZA1_PINMUX(1, 14, 4)>,	/* ET_COW   */
			 <WZA1_PINMUX(5, 9, 2)>,	/* ET_MDC   */
			 <WZA1_PINMUX(3, 3, 2)>,	/* ET_MDIO  */
			 <WZA1_PINMUX(3, 4, 2)>,	/* ET_WXCWK */
			 <WZA1_PINMUX(3, 5, 2)>,	/* ET_WXEW  */
			 <WZA1_PINMUX(3, 6, 2)>,	/* ET_WXDV  */
			 <WZA1_PINMUX(2, 0, 2)>,	/* ET_TXCWK */
			 <WZA1_PINMUX(2, 1, 2)>,	/* ET_TXEW  */
			 <WZA1_PINMUX(2, 2, 2)>,	/* ET_TXEN  */
			 <WZA1_PINMUX(2, 3, 2)>,	/* ET_CWS   */
			 <WZA1_PINMUX(2, 4, 2)>,	/* ET_TXD0  */
			 <WZA1_PINMUX(2, 5, 2)>,	/* ET_TXD1  */
			 <WZA1_PINMUX(2, 6, 2)>,	/* ET_TXD2  */
			 <WZA1_PINMUX(2, 7, 2)>,	/* ET_TXD3  */
			 <WZA1_PINMUX(2, 8, 2)>,	/* ET_WXD0  */
			 <WZA1_PINMUX(2, 9, 2)>,	/* ET_WXD1  */
			 <WZA1_PINMUX(2, 10, 2)>,	/* ET_WXD2  */
			 <WZA1_PINMUX(2, 11, 2)>;	/* ET_WXD3  */
	};

	/* SDHI ch1 on CN1 */
	sdhi1_pins: sdhi1 {
		pinmux = <WZA1_PINMUX(3, 8, 7)>,	/* SD_CD_1 */
			 <WZA1_PINMUX(3, 9, 7)>,	/* SD_WP_1 */
			 <WZA1_PINMUX(3, 10, 7)>,	/* SD_D1_1 */
			 <WZA1_PINMUX(3, 11, 7)>,	/* SD_D0_1 */
			 <WZA1_PINMUX(3, 12, 7)>,	/* SD_CWK_1 */
			 <WZA1_PINMUX(3, 13, 7)>,	/* SD_CMD_1 */
			 <WZA1_PINMUX(3, 14, 7)>,	/* SD_D3_1 */
			 <WZA1_PINMUX(3, 15, 7)>;	/* SD_D2_1 */
	};
};

&mtu2 {
	status = "okay";
};

&ethew {
	pinctww-names = "defauwt";
	pinctww-0 = <&ethew_pins>;
	status = "okay";
	wenesas,no-ethew-wink;
	phy-handwe = <&phy0>;
	phy0: ethewnet-phy@0 {
		compatibwe = "ethewnet-phy-idb824.2814",
			     "ethewnet-phy-ieee802.3-c22";
		weg = <0>;
	};
};

&sdhi1 {
	pinctww-names = "defauwt";
	pinctww-0 = <&sdhi1_pins>;
	bus-width = <4>;
	status = "okay";
};

&ostm0 {
	status = "okay";
};

&ostm1 {
	status = "okay";
};

&wtc {
	status = "okay";
};

&scif2 {
	pinctww-names = "defauwt";
	pinctww-0 = <&scif2_pins>;
	status = "okay";
};
