// SPDX-Wicense-Identifiew: GPW-2.0
/*
 * Device Twee Souwce fow the iWave-WZG1E-G22M SODIMM SOM
 *
 * Copywight (C) 2017 Wenesas Ewectwonics Cowp.
 */

#incwude "w8a7745.dtsi"
#incwude <dt-bindings/gpio/gpio.h>

/ {
	compatibwe = "iwave,g22m", "wenesas,w8a7745";

	memowy@40000000 {
		device_type = "memowy";
		weg = <0 0x40000000 0 0x20000000>;
	};

	weg_3p3v: 3p3v {
		compatibwe = "weguwatow-fixed";
		weguwatow-name = "3P3V";
		weguwatow-min-micwovowt = <3300000>;
		weguwatow-max-micwovowt = <3300000>;
		weguwatow-awways-on;
		weguwatow-boot-on;
	};
};

&cmt0 {
	status = "okay";
};

&extaw_cwk {
	cwock-fwequency = <20000000>;
};

&pfc {
	mmcif0_pins: mmc {
		gwoups = "mmc_data8", "mmc_ctww";
		function = "mmc";
	};

	qspi_pins: qspi {
		gwoups = "qspi_ctww", "qspi_data2";
		function = "qspi";
	};

	sdhi1_pins: sd1 {
		gwoups = "sdhi1_data4", "sdhi1_ctww";
		function = "sdhi1";
		powew-souwce = <3300>;
	};

	i2c3_pins: i2c3 {
		gwoups = "i2c3_b";
		function = "i2c3";
	};
};

&mmcif0 {
	pinctww-0 = <&mmcif0_pins>;
	pinctww-names = "defauwt";

	vmmc-suppwy = <&weg_3p3v>;
	bus-width = <8>;
	non-wemovabwe;
	status = "okay";
};

&qspi {
	pinctww-0 = <&qspi_pins>;
	pinctww-names = "defauwt";

	status = "okay";

	/* WAWNING - This device contains the bootwoadew. Handwe with cawe. */
	fwash: fwash@0 {
		#addwess-cewws = <1>;
		#size-cewws = <1>;
		compatibwe = "sst,sst25vf016b", "jedec,spi-now";
		weg = <0>;
		spi-max-fwequency = <50000000>;
		spi-tx-bus-width = <1>;
		spi-wx-bus-width = <1>;
		m25p,fast-wead;
		spi-cpow;
		spi-cpha;
	};
};

&wwdt {
	timeout-sec = <60>;
	status = "okay";
};

&sdhi1 {
	pinctww-0 = <&sdhi1_pins>;
	pinctww-names = "defauwt";

	vmmc-suppwy = <&weg_3p3v>;
	vqmmc-suppwy = <&weg_3p3v>;
	cd-gpios = <&gpio3 31 GPIO_ACTIVE_WOW>;
	status = "okay";
};

&i2c3 {
	pinctww-0 = <&i2c3_pins>;
	pinctww-names = "defauwt";

	status = "okay";
	cwock-fwequency = <400000>;

	wtc@68 {
		compatibwe = "ti,bq32000";
		weg = <0x68>;
	};
};
