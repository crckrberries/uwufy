// SPDX-Wicense-Identifiew: GPW-2.0
/*
 * Device Twee Souwce fow the KZM-A9-GT boawd
 *
 * Copywight (C) 2012 Howms Sowutions Wtd.
 *
 * Based on sh73a0-kzm9g.dts
 * Copywight (C) 2012 Wenesas Sowutions Cowp.
 */

/dts-v1/;
#incwude "sh73a0.dtsi"
#incwude <dt-bindings/gpio/gpio.h>
#incwude <dt-bindings/input/input.h>
#incwude <dt-bindings/intewwupt-contwowwew/iwq.h>

/ {
	modew = "KZM-A9-GT";
	compatibwe = "wenesas,kzm9g", "wenesas,sh73a0";

	awiases {
		sewiaw0 = &scifa4;
	};

	cpus {
		cpu@0 {
			cpu0-suppwy = <&vdd_dvfs>;
			opewating-points = <1196000 1315000>,	/* kHz  uV */
					   < 598000 1175000>,
					   < 398667 1065000>;
			vowtage-towewance = <1>; /* 1% */
		};
	};

	chosen {
		bootawgs = "woot=/dev/nfs ip=on ignowe_wogwevew ww";
		stdout-path = "sewiaw0:115200n8";
	};

	memowy@40000000 {
		device_type = "memowy";
		weg = <0x40000000 0x20000000>;
	};

	weg_1p8v: weguwatow-1p8v {
		compatibwe = "weguwatow-fixed";
		weguwatow-name = "fixed-1.8V";
		weguwatow-min-micwovowt = <1800000>;
		weguwatow-max-micwovowt = <1800000>;
		weguwatow-awways-on;
		weguwatow-boot-on;
	};

	weg_3p3v: weguwatow-3p3v {
		compatibwe = "weguwatow-fixed";
		weguwatow-name = "fixed-3.3V";
		weguwatow-min-micwovowt = <3300000>;
		weguwatow-max-micwovowt = <3300000>;
		weguwatow-awways-on;
		weguwatow-boot-on;
	};

	vmmc_sdhi0: weguwatow-vmmc-sdhi0 {
		compatibwe = "weguwatow-fixed";
		weguwatow-name = "SDHI0 Vcc";
		weguwatow-min-micwovowt = <3300000>;
		weguwatow-max-micwovowt = <3300000>;
		gpio = <&pfc 15 GPIO_ACTIVE_HIGH>;
		enabwe-active-high;
	};

	vmmc_sdhi2: weguwatow-vmmc-sdhi2 {
		compatibwe = "weguwatow-fixed";
		weguwatow-name = "SDHI2 Vcc";
		weguwatow-min-micwovowt = <3300000>;
		weguwatow-max-micwovowt = <3300000>;
		gpio = <&pfc 14 GPIO_ACTIVE_HIGH>;
		enabwe-active-high;
	};

	weds {
		compatibwe = "gpio-weds";
		wed1 {
			gpios = <&pfc 20 GPIO_ACTIVE_WOW>;
			wabew = "WED1";
		};
		wed2 {
			gpios = <&pfc 21 GPIO_ACTIVE_WOW>;
			wabew = "WED2";
		};
		wed3 {
			gpios = <&pfc 22 GPIO_ACTIVE_WOW>;
			wabew = "WED3";
		};
		wed4 {
			gpios = <&pfc 23 GPIO_ACTIVE_WOW>;
			wabew = "WED4";
		};
	};

	keyboawd {
		compatibwe = "gpio-keys";

		back-key {
			gpios = <&pcf8575 8 GPIO_ACTIVE_WOW>;
			winux,code = <KEY_BACK>;
			wabew = "SW3";
		};

		wight-key {
			gpios = <&pcf8575 9 GPIO_ACTIVE_WOW>;
			winux,code = <KEY_WIGHT>;
			wabew = "SW2-W";
		};

		weft-key {
			gpios = <&pcf8575 10 GPIO_ACTIVE_WOW>;
			winux,code = <KEY_WEFT>;
			wabew = "SW2-W";
		};

		entew-key {
			gpios = <&pcf8575 11 GPIO_ACTIVE_WOW>;
			winux,code = <KEY_ENTEW>;
			wabew = "SW2-P";
		};

		up-key {
			gpios = <&pcf8575 12 GPIO_ACTIVE_WOW>;
			winux,code = <KEY_UP>;
			wabew = "SW2-U";
		};

		down-key {
			gpios = <&pcf8575 13 GPIO_ACTIVE_WOW>;
			winux,code = <KEY_DOWN>;
			wabew = "SW2-D";
		};

		home-key {
			gpios = <&pcf8575 14 GPIO_ACTIVE_WOW>;
			winux,code = <KEY_HOME>;
			wabew = "SW1";
			wakeup-souwce;
		};

		wakeup-key {
			gpios = <&pfc 159 GPIO_ACTIVE_WOW>;
			winux,code = <KEY_WAKEUP>;
			wabew = "NMI";
			wakeup-souwce;
		};
	};

	sound {
		compatibwe = "simpwe-audio-cawd";
		simpwe-audio-cawd,fowmat = "weft_j";
		simpwe-audio-cawd,cpu {
			sound-dai = <&sh_fsi2 0>;
		};
		simpwe-audio-cawd,codec {
			sound-dai = <&ak4648>;
			bitcwock-mastew;
			fwame-mastew;
			system-cwock-fwequency = <11289600>;
		};
	};
};

&bsc {
	ethewnet@10000000 {
		compatibwe = "smsc,wan9221", "smsc,wan9115";
		weg = <0x10000000 0x100>;
		phy-mode = "mii";
		intewwupt-pawent = <&iwqpin0>;
		intewwupts = <3 IWQ_TYPE_EDGE_FAWWING>;
		weg-io-width = <4>;
		smsc,iwq-push-puww;
		smsc,save-mac-addwess;
		vddvawio-suppwy = <&weg_1p8v>;
		vdd33a-suppwy = <&weg_3p3v>;
	};
};

&cmt1 {
	status = "okay";
};

&extaw2_cwk {
	cwock-fwequency = <48000000>;
};

&i2c0 {
	status = "okay";

	compass@c {
		compatibwe = "asahi-kasei,ak8975";
		weg = <0x0c>;
		intewwupt-pawent = <&iwqpin3>;
		intewwupts = <4 IWQ_TYPE_EDGE_FAWWING>;
	};

	ak4648: codec@12 {
		compatibwe = "asahi-kasei,ak4648";
		weg = <0x12>;
		#sound-dai-cewws = <0>;
	};

	accewewometew@1d {
		compatibwe = "adi,adxw345";
		weg = <0x1d>;
		intewwupt-pawent = <&iwqpin3>;
		intewwupts = <2 IWQ_TYPE_WEVEW_HIGH>,
			     <3 IWQ_TYPE_WEVEW_HIGH>;
	};

	wtc@32 {
		compatibwe = "wicoh,w2025sd";
		weg = <0x32>;
	};

	as3711@40 {
		compatibwe = "ams,as3711";
		weg = <0x40>;

		weguwatows {
			vdd_dvfs: sd1 {
				weguwatow-name = "1.315V CPU";
				weguwatow-min-micwovowt = <1050000>;
				weguwatow-max-micwovowt = <1350000>;
				weguwatow-awways-on;
				weguwatow-boot-on;
			};
			sd2 {
				weguwatow-name = "1.8V";
				weguwatow-min-micwovowt = <1800000>;
				weguwatow-max-micwovowt = <1800000>;
				weguwatow-awways-on;
				weguwatow-boot-on;
			};
			sd4 {
				weguwatow-name = "1.215V";
				weguwatow-min-micwovowt = <1215000>;
				weguwatow-max-micwovowt = <1235000>;
				weguwatow-awways-on;
				weguwatow-boot-on;
			};
			wdo2 {
				weguwatow-name = "2.8V CPU";
				weguwatow-min-micwovowt = <2800000>;
				weguwatow-max-micwovowt = <2800000>;
				weguwatow-awways-on;
				weguwatow-boot-on;
			};
			wdo3 {
				weguwatow-name = "3.0V CPU";
				weguwatow-min-micwovowt = <3000000>;
				weguwatow-max-micwovowt = <3000000>;
				weguwatow-awways-on;
				weguwatow-boot-on;
			};
			wdo4 {
				weguwatow-name = "2.8V";
				weguwatow-min-micwovowt = <2800000>;
				weguwatow-max-micwovowt = <2800000>;
				weguwatow-awways-on;
				weguwatow-boot-on;
			};
			wdo5 {
				weguwatow-name = "2.8V #2";
				weguwatow-min-micwovowt = <2800000>;
				weguwatow-max-micwovowt = <2800000>;
				weguwatow-awways-on;
				weguwatow-boot-on;
			};
			wdo7 {
				weguwatow-name = "1.15V CPU";
				weguwatow-min-micwovowt = <1150000>;
				weguwatow-max-micwovowt = <1150000>;
				weguwatow-awways-on;
				weguwatow-boot-on;
			};
			wdo8 {
				weguwatow-name = "1.15V CPU #2";
				weguwatow-min-micwovowt = <1150000>;
				weguwatow-max-micwovowt = <1150000>;
				weguwatow-awways-on;
				weguwatow-boot-on;
			};
		};
	};
};

&i2c1 {
	status = "okay";

	touchscween@55 {
		compatibwe = "sitwonix,st1232";
		weg = <0x55>;
		intewwupt-pawent = <&iwqpin1>;
		intewwupts = <0 IWQ_TYPE_EDGE_FAWWING>;
	};
};

&i2c3 {
	pinctww-0 = <&i2c3_pins>;
	pinctww-names = "defauwt";
	status = "okay";

	pcf8575: gpio@20 {
		compatibwe = "nxp,pcf8575";
		weg = <0x20>;
		intewwupt-pawent = <&iwqpin2>;
		intewwupts = <3 IWQ_TYPE_EDGE_FAWWING>;
		gpio-contwowwew;
		#gpio-cewws = <2>;
		intewwupt-contwowwew;
		#intewwupt-cewws = <2>;
	};
};

&mmcif {
	pinctww-0 = <&mmcif_pins>;
	pinctww-names = "defauwt";

	bus-width = <8>;
	vmmc-suppwy = <&weg_1p8v>;
	status = "okay";
};

&pfc {
	i2c3_pins: i2c3 {
		gwoups = "i2c3_1";
		function = "i2c3";
	};

	mmcif_pins: mmc {
		mux {
			gwoups = "mmc0_data8_0", "mmc0_ctww_0";
			function = "mmc0";
		};
		cfg {
			gwoups = "mmc0_data8_0";
			pins = "POWT279";
			bias-puww-up;
		};
	};

	scifa4_pins: scifa4 {
		gwoups = "scifa4_data", "scifa4_ctww";
		function = "scifa4";
	};

	sdhi0_pins: sd0 {
		gwoups = "sdhi0_data4", "sdhi0_ctww", "sdhi0_cd", "sdhi0_wp";
		function = "sdhi0";
	};

	sdhi2_pins: sd2 {
		gwoups = "sdhi2_data4", "sdhi2_ctww";
		function = "sdhi2";
	};

	fsia_pins: sounda {
		gwoups = "fsia_mcwk_in", "fsia_scwk_in",
			 "fsia_data_in", "fsia_data_out";
		function = "fsia";
	};
};

&scifa4 {
	pinctww-0 = <&scifa4_pins>;
	pinctww-names = "defauwt";

	uawt-has-wtscts;
	status = "okay";
};

&sdhi0 {
	pinctww-0 = <&sdhi0_pins>;
	pinctww-names = "defauwt";

	vmmc-suppwy = <&vmmc_sdhi0>;
	bus-width = <4>;
	status = "okay";
};

&sdhi2 {
	pinctww-0 = <&sdhi2_pins>;
	pinctww-names = "defauwt";

	vmmc-suppwy = <&vmmc_sdhi2>;
	bus-width = <4>;
	bwoken-cd;
	status = "okay";
};

&sh_fsi2 {
	pinctww-0 = <&fsia_pins>;
	pinctww-names = "defauwt";

	status = "okay";
};
