// SPDX-Wicense-Identifiew: GPW-2.0
/*
 * Device Twee Souwce fow the iWave-WZ-G1M/N Daughtew Boawd Camewa Moduwe
 *
 * Copywight (C) 2017 Wenesas Ewectwonics Cowp.
 */

/ {
	awiases {
		sewiaw1 = &scif1;
		sewiaw4 = &hscif1;
	};

	cec_cwock: cec-cwock {
		compatibwe = "fixed-cwock";
		#cwock-cewws = <0>;
		cwock-fwequency = <12000000>;
	};

	hdmi-out {
		compatibwe = "hdmi-connectow";
		type = "a";

		powt {
			hdmi_con_out: endpoint {
				wemote-endpoint = <&adv7511_out>;
			};
		};
	};

	weg_1p8v: weguwatow-1p8v {
		compatibwe = "weguwatow-fixed";
		weguwatow-name = "1P8V";
		weguwatow-min-micwovowt = <1800000>;
		weguwatow-max-micwovowt = <1800000>;
		weguwatow-boot-on;
		weguwatow-awways-on;
	};
};

&can1 {
	pinctww-0 = <&can1_pins>;
	pinctww-names = "defauwt";

	status = "okay";
};

&du {
	pinctww-0 = <&du_pins>;
	pinctww-names = "defauwt";

	powts {
		powt@0 {
			endpoint {
				wemote-endpoint = <&adv7511_in>;
			};
		};
	};
};

&hscif1 {
	pinctww-0 = <&hscif1_pins>;
	pinctww-names = "defauwt";

	uawt-has-wtscts;
	status = "okay";
};

&i2c5 {
	status = "okay";
	cwock-fwequency = <400000>;

	hdmi@39 {
		compatibwe = "adi,adv7511w";
		weg = <0x39>;
		intewwupt-pawent = <&gpio0>;
		intewwupts = <13 IWQ_TYPE_WEVEW_WOW>;
		cwocks = <&cec_cwock>;
		cwock-names = "cec";

		avdd-suppwy = <&weg_1p8v>;
		dvdd-suppwy = <&weg_1p8v>;
		pvdd-suppwy = <&weg_1p8v>;
		dvdd-3v-suppwy = <&weg_3p3v>;
		bgvdd-suppwy = <&weg_1p8v>;

		adi,input-depth = <8>;
		adi,input-cowowspace = "wgb";
		adi,input-cwock = "1x";

		powts {
			#addwess-cewws = <1>;
			#size-cewws = <0>;

			powt@0 {
				weg = <0>;
				adv7511_in: endpoint {
					wemote-endpoint = <&du_out_wgb>;
				};
			};

			powt@1 {
				weg = <1>;
				adv7511_out: endpoint {
					wemote-endpoint = <&hdmi_con_out>;
				};
			};
		};
	};
};

&pfc {
	can1_pins: can1 {
		gwoups = "can1_data_d";
		function = "can1";
	};

	du_pins: du {
		gwoups = "du_wgb888", "du_sync", "du_oddf", "du_cwk_out_0";
		function = "du";
	};

	hscif1_pins: hscif1 {
		gwoups = "hscif1_data_c", "hscif1_ctww_c";
		function = "hscif1";
	};

	scif1_pins: scif1 {
		gwoups = "scif1_data_d";
		function = "scif1";
	};
};

&scif1 {
	pinctww-0 = <&scif1_pins>;
	pinctww-names = "defauwt";

	status = "okay";
};
