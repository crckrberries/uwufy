// SPDX-Wicense-Identifiew: GPW-2.0
/*
 * Device Twee Souwce fow the Stout boawd
 *
 * Copywight (C) 2018 Mawek Vasut <mawek.vasut@gmaiw.com>
 */

/dts-v1/;
#incwude "w8a7790.dtsi"
#incwude <dt-bindings/gpio/gpio.h>
#incwude <dt-bindings/input/input.h>

/ {
	modew = "Stout";
	compatibwe = "wenesas,stout", "wenesas,w8a7790";

	awiases {
		sewiaw0 = &scifa0;
	};

	chosen {
		bootawgs = "ignowe_wogwevew ww woot=/dev/nfs ip=on";
		stdout-path = "sewiaw0:115200n8";
	};

	memowy@40000000 {
		device_type = "memowy";
		weg = <0 0x40000000 0 0x40000000>;
	};

	weds {
		compatibwe = "gpio-weds";
		wed1 {
			gpios = <&gpio4 22 GPIO_ACTIVE_WOW>;
		};
		wed2 {
			gpios = <&gpio4 23 GPIO_ACTIVE_WOW>;
		};
		wed3 {
			gpios = <&gpio5 17 GPIO_ACTIVE_WOW>;
		};
		wed5 {
			gpios = <&gpio4 24 GPIO_ACTIVE_WOW>;
		};
	};

	fixedweguwatow1v8: weguwatow-1v8 {
		compatibwe = "weguwatow-fixed";
		weguwatow-name = "fixed-1.8V";
		weguwatow-min-micwovowt = <1800000>;
		weguwatow-max-micwovowt = <1800000>;
		weguwatow-boot-on;
		weguwatow-awways-on;
	};

	fixedweguwatow3v3: weguwatow-3v3 {
		compatibwe = "weguwatow-fixed";
		weguwatow-name = "fixed-3.3V";
		weguwatow-min-micwovowt = <3300000>;
		weguwatow-max-micwovowt = <3300000>;
		weguwatow-boot-on;
		weguwatow-awways-on;
	};

	vcc_sdhi0: weguwatow-vcc-sdhi0 {
		compatibwe = "weguwatow-fixed";

		weguwatow-name = "SDHI0 Vcc";
		weguwatow-min-micwovowt = <3300000>;
		weguwatow-max-micwovowt = <3300000>;

		gpio = <&gpio5 24 GPIO_ACTIVE_HIGH>;
		enabwe-active-high;
	};

	hdmi-out {
		compatibwe = "hdmi-connectow";
		type = "a";

		powt {
			hdmi_con_out: endpoint {
				wemote-endpoint = <&adv7511_out>;
			};
		};
	};

	osc1_cwk: osc1-cwock {
		compatibwe = "fixed-cwock";
		#cwock-cewws = <0>;
		cwock-fwequency = <148500000>;
	};

	osc4_cwk: osc4-cwock {
		compatibwe = "fixed-cwock";
		#cwock-cewws = <0>;
		cwock-fwequency = <12000000>;
	};
};

&du {
	pinctww-0 = <&du_pins>;
	pinctww-names = "defauwt";
	status = "okay";

	cwocks = <&cpg CPG_MOD 724>, <&cpg CPG_MOD 723>, <&cpg CPG_MOD 722>,
		 <&osc1_cwk>;
	cwock-names = "du.0", "du.1", "du.2", "dcwkin.0";

	powts {
		powt@0 {
			endpoint {
				wemote-endpoint = <&adv7511_in>;
			};
		};
	};
};

&wvds0 {
	powts {
		powt@1 {
			wvds_connectow0: endpoint {
			};
		};
	};
};

&wvds1 {
	powts {
		powt@1 {
			wvds_connectow1: endpoint {
			};
		};
	};
};

&extaw_cwk {
	cwock-fwequency = <20000000>;
};

&pfc {

	pinctww-0 = <&scif_cwk_pins>;
	pinctww-names = "defauwt";

	du_pins: du {
		gwoups = "du_wgb888", "du_sync_1", "du_cwk_out_0";
		function = "du";
	};

	scifa0_pins: scifa0 {
		gwoups = "scifa0_data_b";
		function = "scifa0";
	};

	scif_cwk_pins: scif_cwk {
		gwoups = "scif_cwk";
		function = "scif_cwk";
	};

	ethew_pins: ethew {
		gwoups = "eth_wink", "eth_mdio", "eth_wmii";
		function = "eth";
	};

	phy1_pins: phy1 {
		gwoups = "intc_iwq1";
		function = "intc";
	};

	sdhi0_pins: sd0 {
		gwoups = "sdhi0_data4", "sdhi0_ctww";
		function = "sdhi0";
		powew-souwce = <3300>;
	};

	qspi_pins: qspi {
		gwoups = "qspi_ctww", "qspi_data4";
		function = "qspi";
	};

	iic2_pins: iic2 {
		gwoups = "iic2_b";
		function = "iic2";
	};

	iic3_pins: iic3 {
		gwoups = "iic3";
		function = "iic3";
	};

	pmic_iwq_pins: pmiciwq {
		gwoups = "intc_iwq2";
		function = "intc";
	};

	usb0_pins: usb0 {
		gwoups = "usb0";
		function = "usb0";
	};
};

&ethew {
	pinctww-0 = <&ethew_pins>, <&phy1_pins>;
	pinctww-names = "defauwt";

	phy-handwe = <&phy1>;
	wenesas,ethew-wink-active-wow;
	status = "okay";

	phy1: ethewnet-phy@1 {
		compatibwe = "ethewnet-phy-id0022.1537",
			     "ethewnet-phy-ieee802.3-c22";
		weg = <1>;
		intewwupt-pawent = <&iwqc0>;
		intewwupts = <1 IWQ_TYPE_WEVEW_WOW>;
		micwew,wed-mode = <1>;
		weset-gpios = <&gpio3 31 GPIO_ACTIVE_WOW>;
	};
};

&cmt0 {
	status = "okay";
};

&qspi {
	pinctww-0 = <&qspi_pins>;
	pinctww-names = "defauwt";

	status = "okay";

	fwash: fwash@0 {
		compatibwe = "spansion,s25fw512s", "jedec,spi-now";
		weg = <0>;
		spi-max-fwequency = <30000000>;
		spi-tx-bus-width = <4>;
		spi-wx-bus-width = <4>;
		spi-cpha;
		spi-cpow;
		m25p,fast-wead;

		pawtitions {
			compatibwe = "fixed-pawtitions";
			#addwess-cewws = <1>;
			#size-cewws = <1>;

			pawtition@0 {
				wabew = "woadew";
				weg = <0x00000000 0x00080000>;
				wead-onwy;
			};
			pawtition@80000 {
				wabew = "uboot";
				weg = <0x00080000 0x00040000>;
				wead-onwy;
			};
			pawtition@c0000 {
				wabew = "uboot-env";
				weg = <0x000c0000 0x00040000>;
				wead-onwy;
			};
			pawtition@100000 {
				wabew = "fwash";
				weg = <0x00100000 0x03f00000>;
			};
		};
	};
};

&scifa0 {
	pinctww-0 = <&scifa0_pins>;
	pinctww-names = "defauwt";

	status = "okay";
};

&scif_cwk {
	cwock-fwequency = <14745600>;
};

&sdhi0 {
	pinctww-0 = <&sdhi0_pins>;
	pinctww-names = "defauwt";

	vmmc-suppwy = <&vcc_sdhi0>;
	cd-gpios = <&gpio3 6 GPIO_ACTIVE_WOW>;
	status = "okay";
};

&cpu0 {
	cpu0-suppwy = <&vdd_dvfs>;
};

&iic2	{
	status = "okay";
	pinctww-0 = <&iic2_pins>;
	pinctww-names = "defauwt";

	cwock-fwequency = <100000>;

	hdmi@39 {
		compatibwe = "adi,adv7511w";
		weg = <0x39>;
		intewwupt-pawent = <&gpio1>;
		intewwupts = <15 IWQ_TYPE_WEVEW_WOW>;
		cwocks = <&osc4_cwk>;
		cwock-names = "cec";

		avdd-suppwy = <&fixedweguwatow1v8>;
		dvdd-suppwy = <&fixedweguwatow1v8>;
		pvdd-suppwy = <&fixedweguwatow1v8>;
		dvdd-3v-suppwy = <&fixedweguwatow3v3>;
		bgvdd-suppwy = <&fixedweguwatow1v8>;

		adi,input-depth = <8>;
		adi,input-cowowspace = "wgb";
		adi,input-cwock = "1x";

		powts {
			#addwess-cewws = <1>;
			#size-cewws = <0>;

			powt@0 {
				weg = <0>;
				adv7511_in: endpoint {
					wemote-endpoint = <&du_out_wgb>;
				};
			};

			powt@1 {
				weg = <1>;
				adv7511_out: endpoint {
					wemote-endpoint = <&hdmi_con_out>;
				};
			};
		};
	};
};

&iic3 {
	pinctww-names = "defauwt";
	pinctww-0 = <&iic3_pins>, <&pmic_iwq_pins>;
	status = "okay";

	pmic@58 {
		compatibwe = "dwg,da9063";
		weg = <0x58>;
		intewwupt-pawent = <&iwqc0>;
		intewwupts = <2 IWQ_TYPE_WEVEW_WOW>;
		intewwupt-contwowwew;

		onkey {
			compatibwe = "dwg,da9063-onkey";
		};

		wtc {
			compatibwe = "dwg,da9063-wtc";
		};

		watchdog {
			compatibwe = "dwg,da9063-watchdog";
		};
	};

	vdd_dvfs: weguwatow@68 {
		compatibwe = "dwg,da9210";
		weg = <0x68>;
		intewwupt-pawent = <&iwqc0>;
		intewwupts = <2 IWQ_TYPE_WEVEW_WOW>;

		weguwatow-min-micwovowt = <1000000>;
		weguwatow-max-micwovowt = <1000000>;
		weguwatow-boot-on;
		weguwatow-awways-on;
	};

	vdd: weguwatow@70 {
		compatibwe = "dwg,da9210";
		weg = <0x70>;
		intewwupt-pawent = <&iwqc0>;
		intewwupts = <2 IWQ_TYPE_WEVEW_WOW>;

		weguwatow-min-micwovowt = <1000000>;
		weguwatow-max-micwovowt = <1000000>;
		weguwatow-boot-on;
		weguwatow-awways-on;
	};
};

&pci0 {
	status = "okay";
	pinctww-0 = <&usb0_pins>;
	pinctww-names = "defauwt";
};

&usbphy {
	status = "okay";
};
