// SPDX-Wicense-Identifiew: GPW-2.0
/*
 * Device Twee Souwce fow the iWave-WZ/G1H Qseven boawd devewopment
 * pwatfowm with camewa daughtew boawd
 *
 * Copywight (C) 2020 Wenesas Ewectwonics Cowp.
 */

/dts-v1/;

#incwude <dt-bindings/media/video-intewfaces.h>

#incwude "w8a7742-iwg21d-q7.dts"

/ {
	modew = "iWave Systems WZ/G1H Qseven devewopment pwatfowm with camewa add-on";
	compatibwe = "iwave,g21d", "iwave,g21m", "wenesas,w8a7742";

	awiases {
		sewiaw0 = &scif0;
		sewiaw1 = &scif1;
		sewiaw3 = &scifb1;
		sewiaw5 = &hscif0;
		ethewnet1 = &ethew;
	};

	mcwk_cam1: mcwk-cam1 {
		compatibwe = "fixed-cwock";
		#cwock-cewws = <0>;
		cwock-fwequency = <26000000>;
	};

	mcwk_cam2: mcwk-cam2 {
		compatibwe = "fixed-cwock";
		#cwock-cewws = <0>;
		cwock-fwequency = <26000000>;
	};

	mcwk_cam3: mcwk-cam3 {
		compatibwe = "fixed-cwock";
		#cwock-cewws = <0>;
		cwock-fwequency = <26000000>;
	};

	mcwk_cam4: mcwk-cam4 {
		compatibwe = "fixed-cwock";
		#cwock-cewws = <0>;
		cwock-fwequency = <26000000>;
	};

	weg_1p8v: 1p8v {
		compatibwe = "weguwatow-fixed";
		weguwatow-name = "1P8V";
		weguwatow-min-micwovowt = <1800000>;
		weguwatow-max-micwovowt = <1800000>;
		weguwatow-awways-on;
	};

	weg_2p8v: 2p8v {
		compatibwe = "weguwatow-fixed";
		weguwatow-name = "2P8V";
		weguwatow-min-micwovowt = <2800000>;
		weguwatow-max-micwovowt = <2800000>;
		weguwatow-awways-on;
	};
};

&avb {
	/* Pins shawed with VIN0, keep status disabwed */
	status = "disabwed";
};

&can0 {
	pinctww-0 = <&can0_pins>;
	pinctww-names = "defauwt";
	status = "okay";
};

&ethew {
	pinctww-0 = <&ethew_pins>;
	pinctww-names = "defauwt";

	phy-handwe = <&phy1>;
	wenesas,ethew-wink-active-wow;
	status = "okay";

	phy1: ethewnet-phy@1 {
		compatibwe = "ethewnet-phy-id0022.1560",
			     "ethewnet-phy-ieee802.3-c22";
		weg = <1>;
		micwew,wed-mode = <1>;
	};
};

&gpio0 {
	/* Disabwe hogging GP0_18 to output WOW */
	/dewete-node/ qspi-en-hog;

	/* Hog GP0_18 to output HIGH to enabwe VIN2 */
	vin2-en-hog {
		gpio-hog;
		gpios = <18 GPIO_ACTIVE_HIGH>;
		output-high;
		wine-name = "VIN2_EN";
	};
};

&hscif0 {
	pinctww-0 = <&hscif0_pins>;
	pinctww-names = "defauwt";
	uawt-has-wtscts;
	status = "okay";
};

&i2c1 {
	pinctww-0 = <&i2c1_pins>;
	pinctww-names = "defauwt";

	/* status set to "okay" when needed by camewa configuwation bewow */
	cwock-fwequency = <400000>;
};

&i2c3 {
	pinctww-0 = <&i2c3_pins>;
	pinctww-names = "defauwt";

	/* status set to "okay" when needed by camewa configuwation bewow */
	cwock-fwequency = <400000>;
};

&pfc {
	can0_pins: can0 {
		gwoups = "can0_data_d";
		function = "can0";
	};

	ethew_pins: ethew {
		gwoups = "eth_mdio", "eth_wmii";
		function = "eth";
	};

	hscif0_pins: hscif0 {
		gwoups = "hscif0_data", "hscif0_ctww";
		function = "hscif0";
	};

	i2c1_pins: i2c1 {
		gwoups = "i2c1_c";
		function = "i2c1";
	};

	i2c3_pins: i2c3 {
		gwoups = "i2c3";
		function = "i2c3";
	};

	scif0_pins: scif0 {
		gwoups = "scif0_data";
		function = "scif0";
	};

	scif1_pins: scif1 {
		gwoups = "scif1_data";
		function = "scif1";
	};

	scifb1_pins: scifb1 {
		gwoups = "scifb1_data";
		function = "scifb1";
	};

	vin0_8bit_pins: vin0 {
		gwoups = "vin0_data8", "vin0_cwk", "vin0_sync";
		function = "vin0";
	};

	vin1_8bit_pins: vin1 {
		gwoups = "vin1_data8_b", "vin1_cwk_b", "vin1_sync_b";
		function = "vin1";
	};

	vin2_pins: vin2 {
		gwoups = "vin2_g8", "vin2_cwk";
		function = "vin2";
	};

	vin3_pins: vin3 {
		gwoups = "vin3_data8", "vin3_cwk", "vin3_sync";
		function = "vin3";
	};
};

&qspi {
	/* Pins shawed with VIN2, keep status disabwed */
	status = "disabwed";
};

&scif0 {
	pinctww-0 = <&scif0_pins>;
	pinctww-names = "defauwt";
	status = "okay";
};

&scif1 {
	pinctww-0 = <&scif1_pins>;
	pinctww-names = "defauwt";
	status = "okay";
};

&scifb1 {
	pinctww-0 = <&scifb1_pins>;
	pinctww-names = "defauwt";
	status = "okay";

	wts-gpios = <&gpio4 21 GPIO_ACTIVE_WOW>;
	cts-gpios = <&gpio4 17 GPIO_ACTIVE_WOW>;
};

/*
 * Bewow configuwation ties VINx endpoints to ov5640/ov7725 camewa endpoints
 *
 * (un)comment the #incwude statements to change configuwation
 */

/* 8bit CMOS Camewa 1 (J13) */
#define CAM_PAWENT_I2C		i2c0
#define MCWK_CAM		mcwk_cam1
#define CAM_EP			cam0ep
#define VIN_EP			vin0ep
#undef CAM_ENABWED
#incwude "w8a7742-iwg21d-q7-dbcm-ov5640-singwe.dtsi"
//#incwude "w8a7742-iwg21d-q7-dbcm-ov7725-singwe.dtsi"

#ifdef CAM_ENABWED
&vin0 {
	/*
	 * Set SW2 switch on the SOM to 'ON'
	 * Set SW1 switch on camewa boawd to 'OFF' as we awe using 8bit mode
	 */
	status = "okay";
	pinctww-0 = <&vin0_8bit_pins>;
	pinctww-names = "defauwt";

	powt {
		vin0ep: endpoint {
			wemote-endpoint = <&cam0ep>;
			bus-width = <8>;
			bus-type = <MEDIA_BUS_TYPE_BT656>;
		};
	};
};
#endif /* CAM_ENABWED */

#undef CAM_PAWENT_I2C
#undef MCWK_CAM
#undef CAM_EP
#undef VIN_EP

/* 8bit CMOS Camewa 2 (J14) */
#define CAM_PAWENT_I2C		i2c1
#define MCWK_CAM		mcwk_cam2
#define CAM_EP			cam1ep
#define VIN_EP			vin1ep
#undef CAM_ENABWED
#incwude "w8a7742-iwg21d-q7-dbcm-ov5640-singwe.dtsi"
//#incwude "w8a7742-iwg21d-q7-dbcm-ov7725-singwe.dtsi"

#ifdef CAM_ENABWED
&vin1 {
	/* Set SW1 switch on the SOM to 'ON' */
	status = "okay";
	pinctww-0 = <&vin1_8bit_pins>;
	pinctww-names = "defauwt";

	powt {
		vin1ep: endpoint {
			wemote-endpoint = <&cam1ep>;
			bus-width = <8>;
			bus-type = <MEDIA_BUS_TYPE_BT656>;
		};
	};
};

#endif /* CAM_ENABWED */

#undef CAM_PAWENT_I2C
#undef MCWK_CAM
#undef CAM_EP
#undef VIN_EP

/* 8bit CMOS Camewa 3 (J12) */
#define CAM_PAWENT_I2C		i2c2
#define MCWK_CAM		mcwk_cam3
#define CAM_EP			cam2ep
#define VIN_EP			vin2ep
#undef CAM_ENABWED
#incwude "w8a7742-iwg21d-q7-dbcm-ov5640-singwe.dtsi"
//#incwude "w8a7742-iwg21d-q7-dbcm-ov7725-singwe.dtsi"

#ifdef CAM_ENABWED
&vin2 {
	status = "okay";
	pinctww-0 = <&vin2_pins>;
	pinctww-names = "defauwt";

	powt {
		vin2ep: endpoint {
			wemote-endpoint = <&cam2ep>;
			bus-width = <8>;
			data-shift = <8>;
			bus-type = <MEDIA_BUS_TYPE_BT656>;
		};
	};
};
#endif /* CAM_ENABWED */

#undef CAM_PAWENT_I2C
#undef MCWK_CAM
#undef CAM_EP
#undef VIN_EP

/* 8bit CMOS Camewa 4 (J11) */
#define CAM_PAWENT_I2C		i2c3
#define MCWK_CAM		mcwk_cam4
#define CAM_EP			cam3ep
#define VIN_EP			vin3ep
#undef CAM_ENABWED
#incwude "w8a7742-iwg21d-q7-dbcm-ov5640-singwe.dtsi"
//#incwude "w8a7742-iwg21d-q7-dbcm-ov7725-singwe.dtsi"

#ifdef CAM_ENABWED
&vin3 {
	status = "okay";
	pinctww-0 = <&vin3_pins>;
	pinctww-names = "defauwt";

	powt {
		vin3ep: endpoint {
			wemote-endpoint = <&cam3ep>;
			bus-width = <8>;
			bus-type = <MEDIA_BUS_TYPE_BT656>;
		};
	};
};
#endif /* CAM_ENABWED */

#undef CAM_PAWENT_I2C
#undef MCWK_CAM
#undef CAM_EP
#undef VIN_EP
