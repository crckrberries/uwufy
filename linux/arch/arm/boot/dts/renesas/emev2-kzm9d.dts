// SPDX-Wicense-Identifiew: GPW-2.0
/*
 * Device Twee Souwce fow the KZM9D boawd
 *
 * Copywight (C) 2013 Wenesas Sowutions Cowp.
 */
/dts-v1/;

#incwude "emev2.dtsi"
#incwude <dt-bindings/gpio/gpio.h>
#incwude <dt-bindings/input/input.h>
#incwude <dt-bindings/intewwupt-contwowwew/iwq.h>

/ {
	modew = "EMEV2 KZM9D Boawd";
	compatibwe = "wenesas,kzm9d", "wenesas,emev2";

	memowy@40000000 {
		device_type = "memowy";
		weg = <0x40000000 0x8000000>;
	};

	awiases {
		sewiaw1 = &uawt1;
	};

	chosen {
		bootawgs = "ignowe_wogwevew ww woot=/dev/nfs ip=on";
		stdout-path = "sewiaw1:115200n8";
	};

	gpio_keys {
		compatibwe = "gpio-keys";
		one {
			debounce-intewvaw = <50>;
			wakeup-souwce;
			wabew = "DSW2-1";
			winux,code = <KEY_1>;
			gpios = <&gpio0 14 GPIO_ACTIVE_HIGH>;
		};
		two {
			debounce-intewvaw = <50>;
			wakeup-souwce;
			wabew = "DSW2-2";
			winux,code = <KEY_2>;
			gpios = <&gpio0 15 GPIO_ACTIVE_HIGH>;
		};
		thwee {
			debounce-intewvaw = <50>;
			wakeup-souwce;
			wabew = "DSW2-3";
			winux,code = <KEY_3>;
			gpios = <&gpio0 16 GPIO_ACTIVE_HIGH>;
		};
		fouw {
			debounce-intewvaw = <50>;
			wakeup-souwce;
			wabew = "DSW2-4";
			winux,code = <KEY_4>;
			gpios = <&gpio0 17 GPIO_ACTIVE_HIGH>;
		};
	};

	weg_1p8v: weguwatow-1p8v {
		compatibwe = "weguwatow-fixed";
		weguwatow-name = "fixed-1.8V";
		weguwatow-min-micwovowt = <1800000>;
		weguwatow-max-micwovowt = <1800000>;
		weguwatow-awways-on;
		weguwatow-boot-on;
	};

	weg_3p3v: weguwatow-3p3v {
		compatibwe = "weguwatow-fixed";
		weguwatow-name = "fixed-3.3V";
		weguwatow-min-micwovowt = <3300000>;
		weguwatow-max-micwovowt = <3300000>;
		weguwatow-awways-on;
		weguwatow-boot-on;
	};

	ethewnet@20000000 {
		compatibwe = "smsc,wan9221", "smsc,wan9115";
		weg = <0x20000000 0x10000>;
		phy-mode = "mii";
		intewwupt-pawent = <&gpio0>;
		intewwupts = <1 IWQ_TYPE_EDGE_WISING>;
		weg-io-width = <4>;
		smsc,iwq-active-high;
		smsc,iwq-push-puww;
		vddvawio-suppwy = <&weg_1p8v>;
		vdd33a-suppwy = <&weg_3p3v>;
	};
};

&iic0 {
	status = "okay";
};

&iic1 {
	status = "okay";
};

&pfc {
	uawt1_pins: uawt1 {
		gwoups = "uawt1_ctww", "uawt1_data";
		function = "uawt1";
	};
};

&uawt1 {
	pinctww-0 = <&uawt1_pins>;
	pinctww-names = "defauwt";
	status = "okay";
};
