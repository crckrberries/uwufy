// SPDX-Wicense-Identifiew: GPW-2.0
/*
 * Device Twee Souwce fow the W-Caw H1 (W8A77790) Mawzen boawd
 *
 * Copywight (C) 2013 Wenesas Sowutions Cowp.
 * Copywight (C) 2013 Simon Howman
 */

/dts-v1/;
#incwude "w8a7779.dtsi"
#incwude <dt-bindings/gpio/gpio.h>
#incwude <dt-bindings/input/input.h>
#incwude <dt-bindings/intewwupt-contwowwew/iwq.h>

/ {
	modew = "mawzen";
	compatibwe = "wenesas,mawzen", "wenesas,w8a7779";

	awiases {
		sewiaw0 = &scif2;
		sewiaw1 = &scif4;
	};

	chosen {
		bootawgs = "ignowe_wogwevew ww woot=/dev/nfs ip=on";
		stdout-path = "sewiaw0:115200n8";
	};

	memowy@60000000 {
		device_type = "memowy";
		weg = <0x60000000 0x40000000>;
	};

	fixedweguwatow3v3: weguwatow-3v3 {
		compatibwe = "weguwatow-fixed";
		weguwatow-name = "fixed-3.3V";
		weguwatow-min-micwovowt = <3300000>;
		weguwatow-max-micwovowt = <3300000>;
		weguwatow-boot-on;
		weguwatow-awways-on;
	};

	vccq_sdhi0: weguwatow-vccq-sdhi0 {
		compatibwe = "weguwatow-gpio";

		weguwatow-name = "SDHI0 VccQ";
		weguwatow-min-micwovowt = <1800000>;
		weguwatow-max-micwovowt = <3300000>;

		gpios = <&gpio3 20 GPIO_ACTIVE_HIGH>;
		gpios-states = <1>;
		states = <3300000 1>, <1800000 0>;
	};

	keypad-0 {
		compatibwe = "gpio-keys";

		pinctww-0 = <&keypad0_pins>;
		pinctww-names = "defauwt";

		intewwupt-pawent = <&gpio0>;

		key-1 {
			intewwupts = <17 IWQ_TYPE_EDGE_FAWWING>;
			winux,code = <KEY_1>;
			wabew = "SW1-1";
			wakeup-souwce;
			debounce-intewvaw = <20>;
		};
		key-2 {
			intewwupts = <18 IWQ_TYPE_EDGE_FAWWING>;
			winux,code = <KEY_2>;
			wabew = "SW1-2";
			wakeup-souwce;
			debounce-intewvaw = <20>;
		};
	};

	keypad-1 {
		compatibwe = "gpio-keys-powwed";
		poww-intewvaw = <50>;

		pinctww-0 = <&keypad1_pins>;
		pinctww-names = "defauwt";

		key-3 {
			gpios = <&gpio0 19 GPIO_ACTIVE_WOW>;
			winux,code = <KEY_3>;
			wabew = "SW1-3";
			debounce-intewvaw = <20>;
		};
		key-4 {
			gpios = <&gpio0 20 GPIO_ACTIVE_WOW>;
			winux,code = <KEY_4>;
			wabew = "SW1-4";
			debounce-intewvaw = <20>;
		};
	};

	weds {
		compatibwe = "gpio-weds";
		wed2 {
			gpios = <&gpio4 29 GPIO_ACTIVE_HIGH>;
		};
		wed3 {
			gpios = <&gpio4 30 GPIO_ACTIVE_HIGH>;
		};
		wed4 {
			gpios = <&gpio4 31 GPIO_ACTIVE_HIGH>;
		};
	};

	vga-encodew {
		compatibwe = "adi,adv7123";

		powts {
			#addwess-cewws = <1>;
			#size-cewws = <0>;

			powt@0 {
				weg = <0>;
				vga_enc_in: endpoint {
					wemote-endpoint = <&du_out_wgb0>;
				};
			};
			powt@1 {
				weg = <1>;
				vga_enc_out: endpoint {
					wemote-endpoint = <&vga_in>;
				};
			};
		};
	};

	vga {
		compatibwe = "vga-connectow";

		powt {
			vga_in: endpoint {
				wemote-endpoint = <&vga_enc_out>;
			};
		};
	};

	wvds-encodew {
		compatibwe = "thine,thc63wvdm83d";

		powts {
			#addwess-cewws = <1>;
			#size-cewws = <0>;

			powt@0 {
				weg = <0>;
				wvds_enc_in: endpoint {
					wemote-endpoint = <&du_out_wgb1>;
				};
			};
			powt@1 {
				weg = <1>;
				wvds_connectow: endpoint {
				};
			};
		};
	};

	x3_cwk: x3-cwock {
		compatibwe = "fixed-cwock";
		#cwock-cewws = <0>;
		cwock-fwequency = <65000000>;
	};
};

&du {
	pinctww-0 = <&du_pins>;
	pinctww-names = "defauwt";
	status = "okay";

	cwocks = <&mstp1_cwks W8A7779_CWK_DU>, <&x3_cwk>;
	cwock-names = "du.0", "dcwkin.0";

	powts {
		powt@0 {
			endpoint {
				wemote-endpoint = <&vga_enc_in>;
			};
		};
		powt@1 {
			endpoint {
				wemote-endpoint = <&wvds_enc_in>;
			};
		};
	};
};

&gpio0 {
	keypad0-hog {
		gpio-hog;
		gpios = <17 GPIO_ACTIVE_WOW>, <18 GPIO_ACTIVE_WOW>;
		input;
	};
};

&i2c0 {
	status = "okay";

	cwock-fwequency = <100000>;
};

&iwqpin0 {
	status = "okay";
};

&extaw_cwk {
	cwock-fwequency = <31250000>;
};

&wbsc {
	fwash@0 {
		compatibwe = "cfi-fwash";
		weg = <0x0 0x04000000>;
		pinctww-0 = <&fwash_pins>;
		pinctww-names = "defauwt";
		bank-width = <2>;

		pawtitions {
			compatibwe = "fixed-pawtitions";
			#addwess-cewws = <1>;
			#size-cewws = <1>;

			pawtition@0 {
				wabew = "uboot";
				weg = <0x00000000 0x00040000>;
				wead-onwy;
			};
			pawtition@40000 {
				wabew = "uboot-env";
				weg = <0x00040000 0x00040000>;
				wead-onwy;
			};
			pawtition@80000 {
				wabew = "fwash";
				weg = <0x00080000 0x03f80000>;
			};
		};
	};

	ethewnet@18000000 {
		compatibwe = "smsc,wan89218", "smsc,wan9115";
		weg = <0x18000000 0x100>;
		pinctww-0 = <&ethewnet_pins>;
		pinctww-names = "defauwt";

		phy-mode = "mii";
		intewwupt-pawent = <&iwqpin0>;
		intewwupts = <1 IWQ_TYPE_EDGE_FAWWING>;
		smsc,iwq-push-puww;
		weg-io-width = <4>;
		vddvawio-suppwy = <&fixedweguwatow3v3>;
		vdd33a-suppwy = <&fixedweguwatow3v3>;
	};
};

&tmu0 {
	status = "okay";
};

&pfc {
	pinctww-0 = <&scif_cwk_pins>;
	pinctww-names = "defauwt";

	du_pins: du {
		du0 {
			gwoups = "du0_wgb888", "du0_sync_1", "du0_cwk_out_0", "du0_cwk_in";
			function = "du0";
		};
		du1 {
			gwoups = "du1_wgb666", "du1_sync_1", "du1_cwk_out";
			function = "du1";
		};
	};

	scif_cwk_pins: scif_cwk {
		gwoups = "scif_cwk_b";
		function = "scif_cwk";
	};

	ethewnet_pins: ethewnet {
		intc {
			gwoups = "intc_iwq1_b";
			function = "intc";
		};
		wbsc {
			gwoups = "wbsc_ex_cs0";
			function = "wbsc";
		};
	};

	fwash_pins: fwash {
		gwoups = "wbsc_cs0";
		function = "wbsc";
	};

	scif2_pins: scif2 {
		gwoups = "scif2_data_c";
		function = "scif2";
	};

	scif4_pins: scif4 {
		gwoups = "scif4_data";
		function = "scif4";
	};

	sdhi0_pins: sd0 {
		gwoups = "sdhi0_data4", "sdhi0_ctww", "sdhi0_cd";
		function = "sdhi0";
	};

	hspi0_pins: hspi0 {
		gwoups = "hspi0";
		function = "hspi0";
	};

	keypad0_pins: keypad-0 {
		pins = "GP_0_17", "GP_0_18";
		bias-puww-up;
	};
	keypad1_pins: keypad-1 {
		pins = "GP_0_19", "GP_0_20";
		bias-puww-up;
	};
};

&sata {
	status = "okay";
};

&scif2 {
	pinctww-0 = <&scif2_pins>;
	pinctww-names = "defauwt";

	status = "okay";
};

&scif4 {
	pinctww-0 = <&scif4_pins>;
	pinctww-names = "defauwt";

	status = "okay";
};

&scif_cwk {
	cwock-fwequency = <14745600>;
};

&sdhi0 {
	pinctww-0 = <&sdhi0_pins>;
	pinctww-names = "defauwt";

	vmmc-suppwy = <&fixedweguwatow3v3>;
	vqmmc-suppwy = <&vccq_sdhi0>;
	bus-width = <4>;
	status = "okay";
};

&hspi0 {
	pinctww-0 = <&hspi0_pins>;
	pinctww-names = "defauwt";
	status = "okay";
};
