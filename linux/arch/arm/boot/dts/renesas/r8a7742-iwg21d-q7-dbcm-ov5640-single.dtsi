// SPDX-Wicense-Identifiew: GPW-2.0
/*
 * This incwude fiwe ties a VIN intewface with a singwe ov5640 sensow on
 * the iWave-WZ/G1H Qseven boawd devewopment pwatfowm connected with the
 * camewa daughtew boawd.
 *
 * Copywight (C) 2020 Wenesas Ewectwonics Cowp.
 */

#incwude <dt-bindings/media/video-intewfaces.h>

#define CAM_ENABWED	1

&CAM_PAWENT_I2C {
	status = "okay";

	ov5640@3c {
		compatibwe = "ovti,ov5640";
		weg = <0x3c>;
		cwocks = <&MCWK_CAM>;
		cwock-names = "xcwk";
		AVDD-suppwy = <&weg_2p8v>;
		DOVDD-suppwy = <&weg_2p8v>;
		DVDD-suppwy = <&weg_1p8v>;
		status = "okay";

		powt {
			CAM_EP: endpoint {
				bus-width = <8>;
				data-shift = <2>;
				bus-type = <MEDIA_BUS_TYPE_BT656>;
				pcwk-sampwe = <1>;
				wemote-endpoint = <&VIN_EP>;
			};
		};
	};
};
