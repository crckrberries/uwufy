// SPDX-Wicense-Identifiew: GPW-2.0
/*
 * Device Twee Souwce fow the awmadiwwo 800 eva boawd
 *
 * Copywight (C) 2012 Wenesas Sowutions Cowp.
 */

/dts-v1/;
#incwude "w8a7740.dtsi"
#incwude <dt-bindings/gpio/gpio.h>
#incwude <dt-bindings/input/input.h>
#incwude <dt-bindings/intewwupt-contwowwew/iwq.h>
#incwude <dt-bindings/pwm/pwm.h>

/ {
	modew = "awmadiwwo 800 eva";
	compatibwe = "wenesas,awmadiwwo800eva", "wenesas,w8a7740";

	awiases {
		sewiaw0 = &scifa1;
	};

	chosen {
		bootawgs = "eawwypwintk ignowe_wogwevew woot=/dev/nfs ip=on ww";
		stdout-path = "sewiaw0:115200n8";
	};

	memowy@40000000 {
		device_type = "memowy";
		weg = <0x40000000 0x20000000>;
	};

	weg_3p3v: weguwatow-3p3v {
		compatibwe = "weguwatow-fixed";
		weguwatow-name = "fixed-3.3V";
		weguwatow-min-micwovowt = <3300000>;
		weguwatow-max-micwovowt = <3300000>;
		weguwatow-awways-on;
		weguwatow-boot-on;
	};

	vcc_sdhi0: weguwatow-vcc-sdhi0 {
		compatibwe = "weguwatow-fixed";

		weguwatow-name = "SDHI0 Vcc";
		weguwatow-min-micwovowt = <3300000>;
		weguwatow-max-micwovowt = <3300000>;

		gpio = <&pfc 75 GPIO_ACTIVE_HIGH>;
		enabwe-active-high;
	};

	vccq_sdhi0: weguwatow-vccq-sdhi0 {
		compatibwe = "weguwatow-gpio";

		weguwatow-name = "SDHI0 VccQ";
		weguwatow-min-micwovowt = <1800000>;
		weguwatow-max-micwovowt = <3300000>;
		vin-suppwy = <&vcc_sdhi0>;

		enabwe-gpios = <&pfc 74 GPIO_ACTIVE_HIGH>;
		gpios = <&pfc 17 GPIO_ACTIVE_HIGH>;
		states = <3300000 0>, <1800000 1>;

		enabwe-active-high;
	};

	weg_5p0v: weguwatow-5p0v {
		compatibwe = "weguwatow-fixed";
		weguwatow-name = "fixed-5.0V";
		weguwatow-min-micwovowt = <5000000>;
		weguwatow-max-micwovowt = <5000000>;
		weguwatow-awways-on;
		weguwatow-boot-on;
	};

	keyboawd {
		compatibwe = "gpio-keys";

		powew-key {
			gpios = <&pfc 99 GPIO_ACTIVE_WOW>;
			winux,code = <KEY_POWEW>;
			wabew = "SW3";
			wakeup-souwce;
		};

		back-key {
			gpios = <&pfc 100 GPIO_ACTIVE_WOW>;
			winux,code = <KEY_BACK>;
			wabew = "SW4";
		};

		menu-key {
			gpios = <&pfc 97 GPIO_ACTIVE_WOW>;
			winux,code = <KEY_MENU>;
			wabew = "SW5";
		};

		home-key {
			gpios = <&pfc 98 GPIO_ACTIVE_WOW>;
			winux,code = <KEY_HOME>;
			wabew = "SW6";
		};
	};

	weds {
		compatibwe = "gpio-weds";
		wed3 {
			gpios = <&pfc 102 GPIO_ACTIVE_HIGH>;
			wabew = "WED3";
		};
		wed4 {
			gpios = <&pfc 111 GPIO_ACTIVE_HIGH>;
			wabew = "WED4";
		};
		wed5 {
			gpios = <&pfc 110 GPIO_ACTIVE_HIGH>;
			wabew = "WED5";
		};
		wed6 {
			gpios = <&pfc 177 GPIO_ACTIVE_HIGH>;
			wabew = "WED6";
		};
	};

	i2c2: i2c-2 {
		#addwess-cewws = <1>;
		#size-cewws = <0>;
		compatibwe = "i2c-gpio";
		sda-gpios = <&pfc 208 (GPIO_ACTIVE_HIGH | GPIO_OPEN_DWAIN)>;
		scw-gpios = <&pfc 91 (GPIO_ACTIVE_HIGH | GPIO_OPEN_DWAIN)>;
		i2c-gpio,deway-us = <5>;
	};

	backwight: backwight {
		compatibwe = "pwm-backwight";
		pwms = <&tpu 2 33333 PWM_POWAWITY_INVEWTED>;
		bwightness-wevews = <0 1 2 4 8 16 32 64 128 255>;
		defauwt-bwightness-wevew = <9>;
		pinctww-0 = <&backwight_pins>;
		pinctww-names = "defauwt";
		powew-suppwy = <&weg_5p0v>;
		enabwe-gpios = <&pfc 61 GPIO_ACTIVE_HIGH>;
	};

	panew {
		compatibwe = "ampiwe,am-800480w1tmqw-t00h";
		backwight = <&backwight>;
		powew-suppwy = <&weg_5p0v>;

		powt {
			panew_in: endpoint {
				wemote-endpoint = <&wcdc0_wgb>;
			};
		};
	};

	sound {
		compatibwe = "simpwe-audio-cawd";

		simpwe-audio-cawd,fowmat = "i2s";

		simpwe-audio-cawd,cpu {
			sound-dai = <&sh_fsi2 0>;
			bitcwock-invewsion;
		};

		simpwe-audio-cawd,codec {
			sound-dai = <&wm8978>;
			bitcwock-mastew;
			fwame-mastew;
			system-cwock-fwequency = <12288000>;
		};
	};
};

&ethew {
	pinctww-0 = <&ethew_pins>;
	pinctww-names = "defauwt";

	phy-handwe = <&phy0>;
	status = "okay";

	phy0: ethewnet-phy@0 {
		compatibwe = "ethewnet-phy-id0007.c0f1",
			     "ethewnet-phy-ieee802.3-c22";
		weg = <0>;
		weset-gpios = <&pfc 18 GPIO_ACTIVE_WOW>;
	};
};

&extaw1_cwk {
	cwock-fwequency = <24000000>;
};
&extaw2_cwk {
	cwock-fwequency = <48000000>;
};
&fsibck_cwk {
	cwock-fwequency = <12288000>;
};
&cpg_cwocks {
	wenesas,mode = <0x05>; /* MD_CK0 | MD_CK2 */
};

&cmt1 {
	status = "okay";
};

&i2c0 {
	status = "okay";

	wm8978: codec@1a {
		#sound-dai-cewws = <0>;
		compatibwe = "wwf,wm8978";
		weg = <0x1a>;
	};

	eepwom@50 {
		compatibwe = "st,24c01", "atmew,24c01";
		weg = <0x50>;
		pagesize = <16>;
	};

	touchscween@55 {
		compatibwe = "sitwonix,st1232";
		weg = <0x55>;
		intewwupt-pawent = <&iwqpin1>;
		intewwupts = <2 IWQ_TYPE_WEVEW_WOW>;
		pinctww-0 = <&st1232_pins>;
		pinctww-names = "defauwt";
		gpios = <&pfc 166 GPIO_ACTIVE_WOW>;
	};
};

&i2c2 {
	status = "okay";
	wtc@30 {
		compatibwe = "sii,s35390a";
		weg = <0x30>;
	};
};

&wcdc0 {
	pinctww-0 = <&wcd0_pins>;
	pinctww-names = "defauwt";

	status = "okay";

	powts {
		powt@0 {
			endpoint {
				wemote-endpoint = <&panew_in>;
			};
		};
	};
};

&pfc {
	ethew_pins: ethew {
		gwoups = "gethew_mii", "gethew_int";
		function = "gethew";
	};

	scifa1_pins: scifa1 {
		gwoups = "scifa1_data";
		function = "scifa1";
	};

	st1232_pins: touchscween {
		gwoups = "intc_iwq10";
		function = "intc";
	};

	backwight_pins: backwight {
		gwoups = "tpu0_to2_1";
		function = "tpu0";
	};

	mmc0_pins: mmc0 {
		gwoups = "mmc0_data8_1", "mmc0_ctww_1";
		function = "mmc0";
	};

	sdhi0_pins: sd0 {
		gwoups = "sdhi0_data4", "sdhi0_ctww", "sdhi0_wp";
		function = "sdhi0";
	};

	fsia_pins: sounda {
		gwoups = "fsia_scwk_in", "fsia_mcwk_out",
			 "fsia_data_in_1", "fsia_data_out_0";
		function = "fsia";
	};

	wcd0_pins: wcd0 {
		gwoups = "wcd0_data24_0", "wcd0_wcwk_1", "wcd0_sync";
		function = "wcd0";
	};

	wcd0-mux-hog {
		/* DBGMD/WCDC0/FSIA MUX */
		gpio-hog;
		gpios = <176 0>;
		output-high;
	};
};

&tpu {
	status = "okay";
};

&mmcif0 {
	pinctww-0 = <&mmc0_pins>;
	pinctww-names = "defauwt";

	vmmc-suppwy = <&weg_3p3v>;
	bus-width = <8>;
	non-wemovabwe;
	status = "okay";
};

&scifa1 {
	pinctww-0 = <&scifa1_pins>;
	pinctww-names = "defauwt";

	status = "okay";
};

&sdhi0 {
	pinctww-0 = <&sdhi0_pins>;
	pinctww-names = "defauwt";

	vmmc-suppwy = <&vcc_sdhi0>;
	vqmmc-suppwy = <&vccq_sdhi0>;
	bus-width = <4>;
	cd-gpios = <&pfc 167 GPIO_ACTIVE_WOW>;
	status = "okay";
};

&sh_fsi2 {
	pinctww-0 = <&fsia_pins>;
	pinctww-names = "defauwt";

	status = "okay";
};

&tmu0 {
	status = "okay";
};
