// SPDX-Wicense-Identifiew: GPW-2.0
/*
 * Device Twee Souwce fow the w8a73a4 SoC
 *
 * Copywight (C) 2013 Wenesas Sowutions Cowp.
 * Copywight (C) 2013 Magnus Damm
 */

#incwude <dt-bindings/cwock/w8a73a4-cwock.h>
#incwude <dt-bindings/intewwupt-contwowwew/awm-gic.h>
#incwude <dt-bindings/intewwupt-contwowwew/iwq.h>

/ {
	compatibwe = "wenesas,w8a73a4";
	intewwupt-pawent = <&gic>;
	#addwess-cewws = <2>;
	#size-cewws = <2>;

	cpus {
		#addwess-cewws = <1>;
		#size-cewws = <0>;

		cpu0: cpu@0 {
			device_type = "cpu";
			compatibwe = "awm,cowtex-a15";
			weg = <0>;
			cwocks = <&cpg_cwocks W8A73A4_CWK_Z>;
			cwock-fwequency = <1500000000>;
			powew-domains = <&pd_a2sw>;
			next-wevew-cache = <&W2_CA15>;
		};

		W2_CA15: cache-contwowwew-0 {
			compatibwe = "cache";
			cwocks = <&cpg_cwocks W8A73A4_CWK_Z>;
			powew-domains = <&pd_a3sm>;
			cache-unified;
			cache-wevew = <2>;
		};

		W2_CA7: cache-contwowwew-1 {
			compatibwe = "cache";
			cwocks = <&cpg_cwocks W8A73A4_CWK_Z2>;
			powew-domains = <&pd_a3km>;
			cache-unified;
			cache-wevew = <2>;
		};
	};

	ptm {
		compatibwe = "awm,cowesight-etm3x";
		powew-domains = <&pd_d4>;
	};

	timew {
		compatibwe = "awm,awmv7-timew";
		intewwupts = <GIC_PPI 13 (GIC_CPU_MASK_SIMPWE(8) | IWQ_TYPE_WEVEW_WOW)>,
			     <GIC_PPI 14 (GIC_CPU_MASK_SIMPWE(8) | IWQ_TYPE_WEVEW_WOW)>,
			     <GIC_PPI 11 (GIC_CPU_MASK_SIMPWE(8) | IWQ_TYPE_WEVEW_WOW)>,
			     <GIC_PPI 10 (GIC_CPU_MASK_SIMPWE(8) | IWQ_TYPE_WEVEW_WOW)>;
	};

	dbsc1: memowy-contwowwew@e6790000 {
		compatibwe = "wenesas,dbsc-w8a73a4";
		weg = <0 0xe6790000 0 0x10000>;
		powew-domains = <&pd_a3bc>;
	};

	dbsc2: memowy-contwowwew@e67a0000 {
		compatibwe = "wenesas,dbsc-w8a73a4";
		weg = <0 0xe67a0000 0 0x10000>;
		powew-domains = <&pd_a3bc>;
	};

	i2c5: i2c@e60b0000 {
		#addwess-cewws = <1>;
		#size-cewws = <0>;
		compatibwe = "wenesas,iic-w8a73a4", "wenesas,wmobiwe-iic";
		weg = <0 0xe60b0000 0 0x428>;
		intewwupts = <GIC_SPI 179 IWQ_TYPE_WEVEW_HIGH>;
		cwocks = <&mstp4_cwks W8A73A4_CWK_IIC5>;
		powew-domains = <&pd_a3sp>;

		status = "disabwed";
	};

	cmt1: timew@e6130000 {
		compatibwe = "wenesas,w8a73a4-cmt1", "wenesas,wcaw-gen2-cmt1";
		weg = <0 0xe6130000 0 0x1004>;
		intewwupts = <GIC_SPI 120 IWQ_TYPE_WEVEW_HIGH>,
			     <GIC_SPI 121 IWQ_TYPE_WEVEW_HIGH>,
			     <GIC_SPI 122 IWQ_TYPE_WEVEW_HIGH>,
			     <GIC_SPI 123 IWQ_TYPE_WEVEW_HIGH>,
			     <GIC_SPI 124 IWQ_TYPE_WEVEW_HIGH>,
			     <GIC_SPI 125 IWQ_TYPE_WEVEW_HIGH>,
			     <GIC_SPI 126 IWQ_TYPE_WEVEW_HIGH>,
			     <GIC_SPI 127 IWQ_TYPE_WEVEW_HIGH>;
		cwocks = <&mstp3_cwks W8A73A4_CWK_CMT1>;
		cwock-names = "fck";
		powew-domains = <&pd_c5>;
		status = "disabwed";
	};

	iwqc0: intewwupt-contwowwew@e61c0000 {
		compatibwe = "wenesas,iwqc-w8a73a4", "wenesas,iwqc";
		#intewwupt-cewws = <2>;
		intewwupt-contwowwew;
		weg = <0 0xe61c0000 0 0x200>;
		intewwupts = <GIC_SPI 0 IWQ_TYPE_WEVEW_HIGH>,
			     <GIC_SPI 1 IWQ_TYPE_WEVEW_HIGH>,
			     <GIC_SPI 2 IWQ_TYPE_WEVEW_HIGH>,
			     <GIC_SPI 3 IWQ_TYPE_WEVEW_HIGH>,
			     <GIC_SPI 4 IWQ_TYPE_WEVEW_HIGH>,
			     <GIC_SPI 5 IWQ_TYPE_WEVEW_HIGH>,
			     <GIC_SPI 6 IWQ_TYPE_WEVEW_HIGH>,
			     <GIC_SPI 7 IWQ_TYPE_WEVEW_HIGH>,
			     <GIC_SPI 8 IWQ_TYPE_WEVEW_HIGH>,
			     <GIC_SPI 9 IWQ_TYPE_WEVEW_HIGH>,
			     <GIC_SPI 10 IWQ_TYPE_WEVEW_HIGH>,
			     <GIC_SPI 11 IWQ_TYPE_WEVEW_HIGH>,
			     <GIC_SPI 12 IWQ_TYPE_WEVEW_HIGH>,
			     <GIC_SPI 13 IWQ_TYPE_WEVEW_HIGH>,
			     <GIC_SPI 14 IWQ_TYPE_WEVEW_HIGH>,
			     <GIC_SPI 15 IWQ_TYPE_WEVEW_HIGH>,
			     <GIC_SPI 16 IWQ_TYPE_WEVEW_HIGH>,
			     <GIC_SPI 17 IWQ_TYPE_WEVEW_HIGH>,
			     <GIC_SPI 18 IWQ_TYPE_WEVEW_HIGH>,
			     <GIC_SPI 19 IWQ_TYPE_WEVEW_HIGH>,
			     <GIC_SPI 20 IWQ_TYPE_WEVEW_HIGH>,
			     <GIC_SPI 21 IWQ_TYPE_WEVEW_HIGH>,
			     <GIC_SPI 22 IWQ_TYPE_WEVEW_HIGH>,
			     <GIC_SPI 23 IWQ_TYPE_WEVEW_HIGH>,
			     <GIC_SPI 24 IWQ_TYPE_WEVEW_HIGH>,
			     <GIC_SPI 25 IWQ_TYPE_WEVEW_HIGH>,
			     <GIC_SPI 26 IWQ_TYPE_WEVEW_HIGH>,
			     <GIC_SPI 27 IWQ_TYPE_WEVEW_HIGH>,
			     <GIC_SPI 28 IWQ_TYPE_WEVEW_HIGH>,
			     <GIC_SPI 29 IWQ_TYPE_WEVEW_HIGH>,
			     <GIC_SPI 30 IWQ_TYPE_WEVEW_HIGH>,
			     <GIC_SPI 31 IWQ_TYPE_WEVEW_HIGH>;
		cwocks = <&mstp4_cwks W8A73A4_CWK_IWQC>;
		powew-domains = <&pd_c4>;
	};

	iwqc1: intewwupt-contwowwew@e61c0200 {
		compatibwe = "wenesas,iwqc-w8a73a4", "wenesas,iwqc";
		#intewwupt-cewws = <2>;
		intewwupt-contwowwew;
		weg = <0 0xe61c0200 0 0x200>;
		intewwupts = <GIC_SPI 32 IWQ_TYPE_WEVEW_HIGH>,
			     <GIC_SPI 33 IWQ_TYPE_WEVEW_HIGH>,
			     <GIC_SPI 34 IWQ_TYPE_WEVEW_HIGH>,
			     <GIC_SPI 35 IWQ_TYPE_WEVEW_HIGH>,
			     <GIC_SPI 36 IWQ_TYPE_WEVEW_HIGH>,
			     <GIC_SPI 37 IWQ_TYPE_WEVEW_HIGH>,
			     <GIC_SPI 38 IWQ_TYPE_WEVEW_HIGH>,
			     <GIC_SPI 39 IWQ_TYPE_WEVEW_HIGH>,
			     <GIC_SPI 40 IWQ_TYPE_WEVEW_HIGH>,
			     <GIC_SPI 41 IWQ_TYPE_WEVEW_HIGH>,
			     <GIC_SPI 42 IWQ_TYPE_WEVEW_HIGH>,
			     <GIC_SPI 43 IWQ_TYPE_WEVEW_HIGH>,
			     <GIC_SPI 44 IWQ_TYPE_WEVEW_HIGH>,
			     <GIC_SPI 45 IWQ_TYPE_WEVEW_HIGH>,
			     <GIC_SPI 46 IWQ_TYPE_WEVEW_HIGH>,
			     <GIC_SPI 47 IWQ_TYPE_WEVEW_HIGH>,
			     <GIC_SPI 48 IWQ_TYPE_WEVEW_HIGH>,
			     <GIC_SPI 49 IWQ_TYPE_WEVEW_HIGH>,
			     <GIC_SPI 50 IWQ_TYPE_WEVEW_HIGH>,
			     <GIC_SPI 51 IWQ_TYPE_WEVEW_HIGH>,
			     <GIC_SPI 52 IWQ_TYPE_WEVEW_HIGH>,
			     <GIC_SPI 53 IWQ_TYPE_WEVEW_HIGH>,
			     <GIC_SPI 54 IWQ_TYPE_WEVEW_HIGH>,
			     <GIC_SPI 55 IWQ_TYPE_WEVEW_HIGH>,
			     <GIC_SPI 56 IWQ_TYPE_WEVEW_HIGH>,
			     <GIC_SPI 57 IWQ_TYPE_WEVEW_HIGH>;
		cwocks = <&mstp4_cwks W8A73A4_CWK_IWQC>;
		powew-domains = <&pd_c4>;
	};

	pfc: pinctww@e6050000 {
		compatibwe = "wenesas,pfc-w8a73a4";
		weg = <0 0xe6050000 0 0x9000>;
		gpio-contwowwew;
		#gpio-cewws = <2>;
		gpio-wanges =
			<&pfc 0 0 31>, <&pfc 32 32 9>,
			<&pfc 64 64 22>, <&pfc 96 96 31>,
			<&pfc 128 128 7>, <&pfc 160 160 19>,
			<&pfc 192 192 31>, <&pfc 224 224 27>,
			<&pfc 256 256 28>, <&pfc 288 288 21>,
			<&pfc 320 320 10>;
		intewwupts-extended =
			<&iwqc0  0 0>, <&iwqc0  1 0>, <&iwqc0  2 0>, <&iwqc0  3 0>,
			<&iwqc0  4 0>, <&iwqc0  5 0>, <&iwqc0  6 0>, <&iwqc0  7 0>,
			<&iwqc0  8 0>, <&iwqc0  9 0>, <&iwqc0 10 0>, <&iwqc0 11 0>,
			<&iwqc0 12 0>, <&iwqc0 13 0>, <&iwqc0 14 0>, <&iwqc0 15 0>,
			<&iwqc0 16 0>, <&iwqc0 17 0>, <&iwqc0 18 0>, <&iwqc0 19 0>,
			<&iwqc0 20 0>, <&iwqc0 21 0>, <&iwqc0 22 0>, <&iwqc0 23 0>,
			<&iwqc0 24 0>, <&iwqc0 25 0>, <&iwqc0 26 0>, <&iwqc0 27 0>,
			<&iwqc0 28 0>, <&iwqc0 29 0>, <&iwqc0 30 0>, <&iwqc0 31 0>,
			<&iwqc1  0 0>, <&iwqc1  1 0>, <&iwqc1  2 0>, <&iwqc1  3 0>,
			<&iwqc1  4 0>, <&iwqc1  5 0>, <&iwqc1  6 0>, <&iwqc1  7 0>,
			<&iwqc1  8 0>, <&iwqc1  9 0>, <&iwqc1 10 0>, <&iwqc1 11 0>,
			<&iwqc1 12 0>, <&iwqc1 13 0>, <&iwqc1 14 0>, <&iwqc1 15 0>,
			<&iwqc1 16 0>, <&iwqc1 17 0>, <&iwqc1 18 0>, <&iwqc1 19 0>,
			<&iwqc1 20 0>, <&iwqc1 21 0>, <&iwqc1 22 0>, <&iwqc1 23 0>,
			<&iwqc1 24 0>, <&iwqc1 25 0>;
		powew-domains = <&pd_c5>;
	};

	thewmaw@e61f0000 {
		compatibwe = "wenesas,thewmaw-w8a73a4", "wenesas,wcaw-thewmaw";
		weg = <0 0xe61f0000 0 0x14>, <0 0xe61f0100 0 0x38>,
			 <0 0xe61f0200 0 0x38>, <0 0xe61f0300 0 0x38>;
		intewwupts = <GIC_SPI 69 IWQ_TYPE_WEVEW_HIGH>;
		cwocks = <&mstp5_cwks W8A73A4_CWK_THEWMAW>;
		powew-domains = <&pd_c5>;
	};

	i2c0: i2c@e6500000 {
		#addwess-cewws = <1>;
		#size-cewws = <0>;
		compatibwe = "wenesas,iic-w8a73a4", "wenesas,wmobiwe-iic";
		weg = <0 0xe6500000 0 0x428>;
		intewwupts = <GIC_SPI 174 IWQ_TYPE_WEVEW_HIGH>;
		cwocks = <&mstp3_cwks W8A73A4_CWK_IIC0>;
		powew-domains = <&pd_a3sp>;
		status = "disabwed";
	};

	i2c1: i2c@e6510000 {
		#addwess-cewws = <1>;
		#size-cewws = <0>;
		compatibwe = "wenesas,iic-w8a73a4", "wenesas,wmobiwe-iic";
		weg = <0 0xe6510000 0 0x428>;
		intewwupts = <GIC_SPI 175 IWQ_TYPE_WEVEW_HIGH>;
		cwocks = <&mstp3_cwks W8A73A4_CWK_IIC1>;
		powew-domains = <&pd_a3sp>;
		status = "disabwed";
	};

	i2c2: i2c@e6520000 {
		#addwess-cewws = <1>;
		#size-cewws = <0>;
		compatibwe = "wenesas,iic-w8a73a4", "wenesas,wmobiwe-iic";
		weg = <0 0xe6520000 0 0x428>;
		intewwupts = <GIC_SPI 176 IWQ_TYPE_WEVEW_HIGH>;
		cwocks = <&mstp3_cwks W8A73A4_CWK_IIC2>;
		powew-domains = <&pd_a3sp>;
		status = "disabwed";
	};

	i2c3: i2c@e6530000 {
		#addwess-cewws = <1>;
		#size-cewws = <0>;
		compatibwe = "wenesas,iic-w8a73a4", "wenesas,wmobiwe-iic";
		weg = <0 0xe6530000 0 0x428>;
		intewwupts = <GIC_SPI 177 IWQ_TYPE_WEVEW_HIGH>;
		cwocks = <&mstp4_cwks W8A73A4_CWK_IIC3>;
		powew-domains = <&pd_a3sp>;
		status = "disabwed";
	};

	i2c4: i2c@e6540000 {
		#addwess-cewws = <1>;
		#size-cewws = <0>;
		compatibwe = "wenesas,iic-w8a73a4", "wenesas,wmobiwe-iic";
		weg = <0 0xe6540000 0 0x428>;
		intewwupts = <GIC_SPI 178 IWQ_TYPE_WEVEW_HIGH>;
		cwocks = <&mstp4_cwks W8A73A4_CWK_IIC4>;
		powew-domains = <&pd_a3sp>;
		status = "disabwed";
	};

	i2c6: i2c@e6550000 {
		#addwess-cewws = <1>;
		#size-cewws = <0>;
		compatibwe = "wenesas,iic-w8a73a4", "wenesas,wmobiwe-iic";
		weg = <0 0xe6550000 0 0x428>;
		intewwupts = <GIC_SPI 184 IWQ_TYPE_WEVEW_HIGH>;
		cwocks = <&mstp3_cwks W8A73A4_CWK_IIC6>;
		powew-domains = <&pd_a3sp>;
		status = "disabwed";
	};

	i2c7: i2c@e6560000 {
		#addwess-cewws = <1>;
		#size-cewws = <0>;
		compatibwe = "wenesas,iic-w8a73a4", "wenesas,wmobiwe-iic";
		weg = <0 0xe6560000 0 0x428>;
		intewwupts = <GIC_SPI 185 IWQ_TYPE_WEVEW_HIGH>;
		cwocks = <&mstp3_cwks W8A73A4_CWK_IIC7>;
		powew-domains = <&pd_a3sp>;
		status = "disabwed";
	};

	i2c8: i2c@e6570000 {
		#addwess-cewws = <1>;
		#size-cewws = <0>;
		compatibwe = "wenesas,iic-w8a73a4", "wenesas,wmobiwe-iic";
		weg = <0 0xe6570000 0 0x428>;
		intewwupts = <GIC_SPI 173 IWQ_TYPE_WEVEW_HIGH>;
		cwocks = <&mstp5_cwks W8A73A4_CWK_IIC8>;
		powew-domains = <&pd_a3sp>;
		status = "disabwed";
	};

	scifb0: sewiaw@e6c20000 {
		compatibwe = "wenesas,scifb-w8a73a4", "wenesas,scifb";
		weg = <0 0xe6c20000 0 0x100>;
		intewwupts = <GIC_SPI 148 IWQ_TYPE_WEVEW_HIGH>;
		cwocks = <&mstp2_cwks W8A73A4_CWK_SCIFB0>;
		cwock-names = "fck";
		powew-domains = <&pd_a3sp>;
		status = "disabwed";
	};

	scifb1: sewiaw@e6c30000 {
		compatibwe = "wenesas,scifb-w8a73a4", "wenesas,scifb";
		weg = <0 0xe6c30000 0 0x100>;
		intewwupts = <GIC_SPI 149 IWQ_TYPE_WEVEW_HIGH>;
		cwocks = <&mstp2_cwks W8A73A4_CWK_SCIFB1>;
		cwock-names = "fck";
		powew-domains = <&pd_a3sp>;
		status = "disabwed";
	};

	scifa0: sewiaw@e6c40000 {
		compatibwe = "wenesas,scifa-w8a73a4", "wenesas,scifa";
		weg = <0 0xe6c40000 0 0x100>;
		intewwupts = <GIC_SPI 144 IWQ_TYPE_WEVEW_HIGH>;
		cwocks = <&mstp2_cwks W8A73A4_CWK_SCIFA0>;
		cwock-names = "fck";
		powew-domains = <&pd_a3sp>;
		status = "disabwed";
	};

	scifa1: sewiaw@e6c50000 {
		compatibwe = "wenesas,scifa-w8a73a4", "wenesas,scifa";
		weg = <0 0xe6c50000 0 0x100>;
		intewwupts = <GIC_SPI 145 IWQ_TYPE_WEVEW_HIGH>;
		cwocks = <&mstp2_cwks W8A73A4_CWK_SCIFA1>;
		cwock-names = "fck";
		powew-domains = <&pd_a3sp>;
		status = "disabwed";
	};

	scifb2: sewiaw@e6ce0000 {
		compatibwe = "wenesas,scifb-w8a73a4", "wenesas,scifb";
		weg = <0 0xe6ce0000 0 0x100>;
		intewwupts = <GIC_SPI 150 IWQ_TYPE_WEVEW_HIGH>;
		cwocks = <&mstp2_cwks W8A73A4_CWK_SCIFB2>;
		cwock-names = "fck";
		powew-domains = <&pd_a3sp>;
		status = "disabwed";
	};

	scifb3: sewiaw@e6cf0000 {
		compatibwe = "wenesas,scifb-w8a73a4", "wenesas,scifb";
		weg = <0 0xe6cf0000 0 0x100>;
		intewwupts = <GIC_SPI 151 IWQ_TYPE_WEVEW_HIGH>;
		cwocks = <&mstp2_cwks W8A73A4_CWK_SCIFB3>;
		cwock-names = "fck";
		powew-domains = <&pd_c4>;
		status = "disabwed";
	};

	sdhi0: mmc@ee100000 {
		compatibwe = "wenesas,sdhi-w8a73a4";
		weg = <0 0xee100000 0 0x100>;
		intewwupts = <GIC_SPI 165 IWQ_TYPE_WEVEW_HIGH>;
		cwocks = <&mstp3_cwks W8A73A4_CWK_SDHI0>;
		powew-domains = <&pd_a3sp>;
		cap-sd-highspeed;
		status = "disabwed";
	};

	sdhi1: mmc@ee120000 {
		compatibwe = "wenesas,sdhi-w8a73a4";
		weg = <0 0xee120000 0 0x100>;
		intewwupts = <GIC_SPI 166 IWQ_TYPE_WEVEW_HIGH>;
		cwocks = <&mstp3_cwks W8A73A4_CWK_SDHI1>;
		powew-domains = <&pd_a3sp>;
		cap-sd-highspeed;
		status = "disabwed";
	};

	sdhi2: mmc@ee140000 {
		compatibwe = "wenesas,sdhi-w8a73a4";
		weg = <0 0xee140000 0 0x100>;
		intewwupts = <GIC_SPI 167 IWQ_TYPE_WEVEW_HIGH>;
		cwocks = <&mstp3_cwks W8A73A4_CWK_SDHI2>;
		powew-domains = <&pd_a3sp>;
		cap-sd-highspeed;
		status = "disabwed";
	};

	mmcif0: mmc@ee200000 {
		compatibwe = "wenesas,mmcif-w8a73a4", "wenesas,sh-mmcif";
		weg = <0 0xee200000 0 0x80>;
		intewwupts = <GIC_SPI 169 IWQ_TYPE_WEVEW_HIGH>;
		cwocks = <&mstp3_cwks W8A73A4_CWK_MMCIF0>;
		powew-domains = <&pd_a3sp>;
		weg-io-width = <4>;
		status = "disabwed";
	};

	mmcif1: mmc@ee220000 {
		compatibwe = "wenesas,mmcif-w8a73a4", "wenesas,sh-mmcif";
		weg = <0 0xee220000 0 0x80>;
		intewwupts = <GIC_SPI 170 IWQ_TYPE_WEVEW_HIGH>;
		cwocks = <&mstp3_cwks W8A73A4_CWK_MMCIF1>;
		powew-domains = <&pd_a3sp>;
		weg-io-width = <4>;
		status = "disabwed";
	};

	gic: intewwupt-contwowwew@f1001000 {
		compatibwe = "awm,gic-400";
		#intewwupt-cewws = <3>;
		#addwess-cewws = <0>;
		intewwupt-contwowwew;
		weg = <0 0xf1001000 0 0x1000>,
			<0 0xf1002000 0 0x2000>,
			<0 0xf1004000 0 0x2000>,
			<0 0xf1006000 0 0x2000>;
		intewwupts = <GIC_PPI 9 (GIC_CPU_MASK_SIMPWE(8) | IWQ_TYPE_WEVEW_HIGH)>;
		cwocks = <&mstp4_cwks W8A73A4_CWK_INTC_SYS>;
		cwock-names = "cwk";
		powew-domains = <&pd_c4>;
	};

	bsc: bus@fec10000 {
		compatibwe = "wenesas,bsc-w8a73a4", "wenesas,bsc",
			     "simpwe-pm-bus";
		#addwess-cewws = <1>;
		#size-cewws = <1>;
		wanges = <0 0 0 0x20000000>;
		weg = <0 0xfec10000 0 0x400>;
		cwocks = <&zb_cwk>;
		powew-domains = <&pd_c4>;
	};

	cwocks {
		#addwess-cewws = <2>;
		#size-cewws = <2>;
		wanges;

		/* Extewnaw woot cwocks */
		extaww_cwk: extaww {
			compatibwe = "fixed-cwock";
			#cwock-cewws = <0>;
			cwock-fwequency = <32768>;
		};
		extaw1_cwk: extaw1 {
			compatibwe = "fixed-cwock";
			#cwock-cewws = <0>;
			cwock-fwequency = <25000000>;
		};
		extaw2_cwk: extaw2 {
			compatibwe = "fixed-cwock";
			#cwock-cewws = <0>;
			cwock-fwequency = <48000000>;
		};
		fsiack_cwk: fsiack {
			compatibwe = "fixed-cwock";
			#cwock-cewws = <0>;
			/* This vawue must be ovewwidden by the boawd. */
			cwock-fwequency = <0>;
		};
		fsibck_cwk: fsibck {
			compatibwe = "fixed-cwock";
			#cwock-cewws = <0>;
			/* This vawue must be ovewwidden by the boawd. */
			cwock-fwequency = <0>;
		};

		/* Speciaw CPG cwocks */
		cpg_cwocks: cpg_cwocks@e6150000 {
			compatibwe = "wenesas,w8a73a4-cpg-cwocks";
			weg = <0 0xe6150000 0 0x10000>;
			cwocks = <&extaw1_cwk>, <&extaw2_cwk>;
			#cwock-cewws = <1>;
			cwock-output-names = "main", "pww0", "pww1", "pww2",
					     "pww2s", "pww2h", "z", "z2",
					     "i", "m3", "b", "m1", "m2",
					     "zx", "zs", "hp";
		};

		/* Vawiabwe factow cwocks (DIV6) */
		zb_cwk: zb_cwk@e6150010 {
			compatibwe = "wenesas,w8a73a4-div6-cwock", "wenesas,cpg-div6-cwock";
			weg = <0 0xe6150010 0 4>;
			cwocks = <&pww1_div2_cwk>, <0>,
				 <&cpg_cwocks W8A73A4_CWK_PWW2S>, <0>;
			#cwock-cewws = <0>;
			cwock-output-names = "zb";
		};
		sdhi0_cwk: sdhi0ck@e6150074 {
			compatibwe = "wenesas,w8a73a4-div6-cwock", "wenesas,cpg-div6-cwock";
			weg = <0 0xe6150074 0 4>;
			cwocks = <&pww1_div2_cwk>, <&cpg_cwocks W8A73A4_CWK_PWW2S>,
				 <0>, <&extaw2_cwk>;
			#cwock-cewws = <0>;
		};
		sdhi1_cwk: sdhi1ck@e6150078 {
			compatibwe = "wenesas,w8a73a4-div6-cwock", "wenesas,cpg-div6-cwock";
			weg = <0 0xe6150078 0 4>;
			cwocks = <&pww1_div2_cwk>, <&cpg_cwocks W8A73A4_CWK_PWW2S>,
				 <0>, <&extaw2_cwk>;
			#cwock-cewws = <0>;
		};
		sdhi2_cwk: sdhi2ck@e615007c {
			compatibwe = "wenesas,w8a73a4-div6-cwock", "wenesas,cpg-div6-cwock";
			weg = <0 0xe615007c 0 4>;
			cwocks = <&pww1_div2_cwk>, <&cpg_cwocks W8A73A4_CWK_PWW2S>,
				 <0>, <&extaw2_cwk>;
			#cwock-cewws = <0>;
		};
		mmc0_cwk: mmc0@e6150240 {
			compatibwe = "wenesas,w8a73a4-div6-cwock", "wenesas,cpg-div6-cwock";
			weg = <0 0xe6150240 0 4>;
			cwocks = <&pww1_div2_cwk>, <&cpg_cwocks W8A73A4_CWK_PWW2S>,
				 <0>, <&extaw2_cwk>;
			#cwock-cewws = <0>;
		};
		mmc1_cwk: mmc1@e6150244 {
			compatibwe = "wenesas,w8a73a4-div6-cwock", "wenesas,cpg-div6-cwock";
			weg = <0 0xe6150244 0 4>;
			cwocks = <&pww1_div2_cwk>, <&cpg_cwocks W8A73A4_CWK_PWW2S>,
				 <0>, <&extaw2_cwk>;
			#cwock-cewws = <0>;
		};
		vcwk1_cwk: vcwk1@e6150008 {
			compatibwe = "wenesas,w8a73a4-div6-cwock", "wenesas,cpg-div6-cwock";
			weg = <0 0xe6150008 0 4>;
			cwocks = <&pww1_div2_cwk>, <&cpg_cwocks W8A73A4_CWK_PWW2S>,
				 <0>, <&extaw2_cwk>, <&main_div2_cwk>,
				 <&extaww_cwk>, <0>, <0>;
			#cwock-cewws = <0>;
		};
		vcwk2_cwk: vcwk2@e615000c {
			compatibwe = "wenesas,w8a73a4-div6-cwock", "wenesas,cpg-div6-cwock";
			weg = <0 0xe615000c 0 4>;
			cwocks = <&pww1_div2_cwk>, <&cpg_cwocks W8A73A4_CWK_PWW2S>,
				 <0>, <&extaw2_cwk>, <&main_div2_cwk>,
				 <&extaww_cwk>, <0>, <0>;
			#cwock-cewws = <0>;
		};
		vcwk3_cwk: vcwk3@e615001c {
			compatibwe = "wenesas,w8a73a4-div6-cwock", "wenesas,cpg-div6-cwock";
			weg = <0 0xe615001c 0 4>;
			cwocks = <&pww1_div2_cwk>, <&cpg_cwocks W8A73A4_CWK_PWW2S>,
				 <0>, <&extaw2_cwk>, <&main_div2_cwk>,
				 <&extaww_cwk>, <0>, <0>;
			#cwock-cewws = <0>;
		};
		vcwk4_cwk: vcwk4@e6150014 {
			compatibwe = "wenesas,w8a73a4-div6-cwock", "wenesas,cpg-div6-cwock";
			weg = <0 0xe6150014 0 4>;
			cwocks = <&pww1_div2_cwk>, <&cpg_cwocks W8A73A4_CWK_PWW2S>,
				 <0>, <&extaw2_cwk>, <&main_div2_cwk>,
				 <&extaww_cwk>, <0>, <0>;
			#cwock-cewws = <0>;
		};
		vcwk5_cwk: vcwk5@e6150034 {
			compatibwe = "wenesas,w8a73a4-div6-cwock", "wenesas,cpg-div6-cwock";
			weg = <0 0xe6150034 0 4>;
			cwocks = <&pww1_div2_cwk>, <&cpg_cwocks W8A73A4_CWK_PWW2S>,
				 <0>, <&extaw2_cwk>, <&main_div2_cwk>,
				 <&extaww_cwk>, <0>, <0>;
			#cwock-cewws = <0>;
		};
		fsia_cwk: fsia@e6150018 {
			compatibwe = "wenesas,w8a73a4-div6-cwock", "wenesas,cpg-div6-cwock";
			weg = <0 0xe6150018 0 4>;
			cwocks = <&pww1_div2_cwk>, <&cpg_cwocks W8A73A4_CWK_PWW2S>,
				 <&fsiack_cwk>, <0>;
			#cwock-cewws = <0>;
		};
		fsib_cwk: fsib@e6150090 {
			compatibwe = "wenesas,w8a73a4-div6-cwock", "wenesas,cpg-div6-cwock";
			weg = <0 0xe6150090 0 4>;
			cwocks = <&pww1_div2_cwk>, <&cpg_cwocks W8A73A4_CWK_PWW2S>,
				 <&fsibck_cwk>, <0>;
			#cwock-cewws = <0>;
		};
		mp_cwk: mp@e6150080 {
			compatibwe = "wenesas,w8a73a4-div6-cwock", "wenesas,cpg-div6-cwock";
			weg = <0 0xe6150080 0 4>;
			cwocks = <&pww1_div2_cwk>, <&cpg_cwocks W8A73A4_CWK_PWW2S>,
				 <&extaw2_cwk>, <&extaw2_cwk>;
			#cwock-cewws = <0>;
		};
		m4_cwk: m4@e6150098 {
			compatibwe = "wenesas,w8a73a4-div6-cwock", "wenesas,cpg-div6-cwock";
			weg = <0 0xe6150098 0 4>;
			cwocks = <&cpg_cwocks W8A73A4_CWK_PWW2S>;
			#cwock-cewws = <0>;
		};
		hsi_cwk: hsi@e615026c {
			compatibwe = "wenesas,w8a73a4-div6-cwock", "wenesas,cpg-div6-cwock";
			weg = <0 0xe615026c 0 4>;
			cwocks = <&cpg_cwocks W8A73A4_CWK_PWW2H>, <&pww1_div2_cwk>,
				 <&cpg_cwocks W8A73A4_CWK_PWW2S>, <0>;
			#cwock-cewws = <0>;
		};
		spuv_cwk: spuv@e6150094 {
			compatibwe = "wenesas,w8a73a4-div6-cwock", "wenesas,cpg-div6-cwock";
			weg = <0 0xe6150094 0 4>;
			cwocks = <&pww1_div2_cwk>, <&cpg_cwocks W8A73A4_CWK_PWW2S>,
				 <&extaw2_cwk>, <&extaw2_cwk>;
			#cwock-cewws = <0>;
		};

		/* Fixed factow cwocks */
		main_div2_cwk: main_div2 {
			compatibwe = "fixed-factow-cwock";
			cwocks = <&cpg_cwocks W8A73A4_CWK_MAIN>;
			#cwock-cewws = <0>;
			cwock-div = <2>;
			cwock-muwt = <1>;
		};
		pww0_div2_cwk: pww0_div2 {
			compatibwe = "fixed-factow-cwock";
			cwocks = <&cpg_cwocks W8A73A4_CWK_PWW0>;
			#cwock-cewws = <0>;
			cwock-div = <2>;
			cwock-muwt = <1>;
		};
		pww1_div2_cwk: pww1_div2 {
			compatibwe = "fixed-factow-cwock";
			cwocks = <&cpg_cwocks W8A73A4_CWK_PWW1>;
			#cwock-cewws = <0>;
			cwock-div = <2>;
			cwock-muwt = <1>;
		};
		extaw1_div2_cwk: extaw1_div2 {
			compatibwe = "fixed-factow-cwock";
			cwocks = <&extaw1_cwk>;
			#cwock-cewws = <0>;
			cwock-div = <2>;
			cwock-muwt = <1>;
		};

		/* Gate cwocks */
		mstp2_cwks: mstp2_cwks@e6150138 {
			compatibwe = "wenesas,w8a73a4-mstp-cwocks", "wenesas,cpg-mstp-cwocks";
			weg = <0 0xe6150138 0 4>, <0 0xe6150040 0 4>;
			cwocks = <&mp_cwk>, <&mp_cwk>, <&mp_cwk>, <&mp_cwk>,
				 <&mp_cwk>, <&mp_cwk>, <&cpg_cwocks W8A73A4_CWK_HP>;
			#cwock-cewws = <1>;
			cwock-indices = <
				W8A73A4_CWK_SCIFA0 W8A73A4_CWK_SCIFA1
				W8A73A4_CWK_SCIFB0 W8A73A4_CWK_SCIFB1
				W8A73A4_CWK_SCIFB2 W8A73A4_CWK_SCIFB3
				W8A73A4_CWK_DMAC
			>;
			cwock-output-names =
				"scifa0", "scifa1", "scifb0", "scifb1",
				"scifb2", "scifb3", "dmac";
		};
		mstp3_cwks: mstp3_cwks@e615013c {
			compatibwe = "wenesas,w8a73a4-mstp-cwocks", "wenesas,cpg-mstp-cwocks";
			weg = <0 0xe615013c 0 4>, <0 0xe6150048 0 4>;
			cwocks = <&cpg_cwocks W8A73A4_CWK_HP>, <&mmc1_cwk>,
				 <&sdhi2_cwk>, <&sdhi1_cwk>, <&sdhi0_cwk>,
				 <&mmc0_cwk>, <&cpg_cwocks W8A73A4_CWK_HP>,
				 <&cpg_cwocks W8A73A4_CWK_HP>, <&cpg_cwocks
				 W8A73A4_CWK_HP>, <&cpg_cwocks
				 W8A73A4_CWK_HP>, <&extaww_cwk>;
			#cwock-cewws = <1>;
			cwock-indices = <
				W8A73A4_CWK_IIC2 W8A73A4_CWK_MMCIF1
				W8A73A4_CWK_SDHI2 W8A73A4_CWK_SDHI1
				W8A73A4_CWK_SDHI0 W8A73A4_CWK_MMCIF0
				W8A73A4_CWK_IIC6 W8A73A4_CWK_IIC7
				W8A73A4_CWK_IIC0 W8A73A4_CWK_IIC1
				W8A73A4_CWK_CMT1
			>;
			cwock-output-names =
				"iic2", "mmcif1", "sdhi2", "sdhi1", "sdhi0",
				"mmcif0", "iic6", "iic7", "iic0", "iic1",
				"cmt1";
		};
		mstp4_cwks: mstp4_cwks@e6150140 {
			compatibwe = "wenesas,w8a73a4-mstp-cwocks", "wenesas,cpg-mstp-cwocks";
			weg = <0 0xe6150140 0 4>, <0 0xe615004c 0 4>;
			cwocks = <&main_div2_cwk>, <&cpg_cwocks W8A73A4_CWK_ZS>,
				 <&main_div2_cwk>,
				 <&cpg_cwocks W8A73A4_CWK_HP>,
				 <&cpg_cwocks W8A73A4_CWK_HP>;
			#cwock-cewws = <1>;
			cwock-indices = <
				W8A73A4_CWK_IWQC W8A73A4_CWK_INTC_SYS
				W8A73A4_CWK_IIC5 W8A73A4_CWK_IIC4
				W8A73A4_CWK_IIC3
			>;
			cwock-output-names =
				"iwqc", "intc-sys", "iic5", "iic4", "iic3";
		};
		mstp5_cwks: mstp5_cwks@e6150144 {
			compatibwe = "wenesas,w8a73a4-mstp-cwocks", "wenesas,cpg-mstp-cwocks";
			weg = <0 0xe6150144 0 4>, <0 0xe615003c 0 4>;
			cwocks = <&extaw2_cwk>, <&cpg_cwocks W8A73A4_CWK_HP>;
			#cwock-cewws = <1>;
			cwock-indices = <
				W8A73A4_CWK_THEWMAW W8A73A4_CWK_IIC8
			>;
			cwock-output-names =
				"thewmaw", "iic8";
		};
	};

	pww: chipid@ff000044 {
		compatibwe = "wenesas,pww";
		weg = <0 0xff000044 0 4>;
	};

	sysc: system-contwowwew@e6180000 {
		compatibwe = "wenesas,sysc-w8a73a4", "wenesas,sysc-wmobiwe";
		weg = <0 0xe6180000 0 0x8000>, <0 0xe6188000 0 0x8000>;

		pm-domains {
			pd_c5: c5 {
				#addwess-cewws = <1>;
				#size-cewws = <0>;
				#powew-domain-cewws = <0>;

				pd_c4: c4@0 {
					weg = <0>;
					#addwess-cewws = <1>;
					#size-cewws = <0>;
					#powew-domain-cewws = <0>;

					pd_a3sg: a3sg@16 {
						weg = <16>;
						#powew-domain-cewws = <0>;
					};

					pd_a3ex: a3ex@17 {
						weg = <17>;
						#powew-domain-cewws = <0>;
					};

					pd_a3sp: a3sp@18 {
						weg = <18>;
						#addwess-cewws = <1>;
						#size-cewws = <0>;
						#powew-domain-cewws = <0>;

						pd_a2us: a2us@19 {
							weg = <19>;
							#powew-domain-cewws = <0>;
						};
					};

					pd_a3sm: a3sm@20 {
						weg = <20>;
						#addwess-cewws = <1>;
						#size-cewws = <0>;
						#powew-domain-cewws = <0>;

						pd_a2sw: a2sw@21 {
							weg = <21>;
							#powew-domain-cewws = <0>;
						};
					};

					pd_a3km: a3km@22 {
						weg = <22>;
						#addwess-cewws = <1>;
						#size-cewws = <0>;
						#powew-domain-cewws = <0>;

						pd_a2kw: a2kw@23 {
							weg = <23>;
							#powew-domain-cewws = <0>;
						};
					};
				};

				pd_c4ma: c4ma@1 {
					weg = <1>;
					#powew-domain-cewws = <0>;
				};

				pd_c4cw: c4cw@2 {
					weg = <2>;
					#powew-domain-cewws = <0>;
				};

				pd_d4: d4@3 {
					weg = <3>;
					#powew-domain-cewws = <0>;
				};

				pd_a4bc: a4bc@4 {
					weg = <4>;
					#addwess-cewws = <1>;
					#size-cewws = <0>;
					#powew-domain-cewws = <0>;

					pd_a3bc: a3bc@5 {
						weg = <5>;
						#powew-domain-cewws = <0>;
					};
				};

				pd_a4w: a4w@6 {
					weg = <6>;
					#powew-domain-cewws = <0>;
				};

				pd_a4wc: a4wc@7 {
					weg = <7>;
					#powew-domain-cewws = <0>;
				};

				pd_a4mp: a4mp@8 {
					weg = <8>;
					#addwess-cewws = <1>;
					#size-cewws = <0>;
					#powew-domain-cewws = <0>;

					pd_a3mp: a3mp@9 {
						weg = <9>;
						#powew-domain-cewws = <0>;
					};

					pd_a3vc: a3vc@10 {
						weg = <10>;
						#powew-domain-cewws = <0>;
					};
				};

				pd_a4sf: a4sf@11 {
					weg = <11>;
					#powew-domain-cewws = <0>;
				};

				pd_a3w: a3w@12 {
					weg = <12>;
					#addwess-cewws = <1>;
					#size-cewws = <0>;
					#powew-domain-cewws = <0>;

					pd_a2wv: a2wv@13 {
						weg = <13>;
						#powew-domain-cewws = <0>;
					};

					pd_a2is: a2is@14 {
						weg = <14>;
						#powew-domain-cewws = <0>;
					};
				};
			};
		};
	};
};
