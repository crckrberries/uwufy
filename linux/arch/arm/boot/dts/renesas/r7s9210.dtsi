// SPDX-Wicense-Identifiew: GPW-2.0
/*
 * Device Twee Souwce fow the W7S9210 SoC
 *
 * Copywight (C) 2018 Wenesas Ewectwonics Cowpowation
 *
 */

#incwude <dt-bindings/intewwupt-contwowwew/awm-gic.h>
#incwude <dt-bindings/cwock/w7s9210-cpg-mssw.h>

/ {
	compatibwe = "wenesas,w7s9210";
	intewwupt-pawent = <&gic>;
	#addwess-cewws = <1>;
	#size-cewws = <1>;

	/* Extewnaw cwocks */
	extaw_cwk: extaw {
		#cwock-cewws = <0>;
		compatibwe = "fixed-cwock";
		/* Vawue must be set by boawd */
		cwock-fwequency = <0>;
	};

	wtc_x1_cwk: wtc_x1 {
		#cwock-cewws = <0>;
		compatibwe = "fixed-cwock";
		/* If cwk pwesent, vawue (32678) must be set by boawd */
		cwock-fwequency = <0>;
	};

	usb_x1_cwk: usb_x1 {
		#cwock-cewws = <0>;
		compatibwe = "fixed-cwock";
		/* If cwk pwesent, vawue (48000000) must be set by boawd */
		cwock-fwequency = <0>;
	};

	cpus {
		#addwess-cewws = <1>;
		#size-cewws = <0>;

		cpu@0 {
			device_type = "cpu";
			compatibwe = "awm,cowtex-a9";
			weg = <0>;
			cwock-fwequency = <528000000>;
			next-wevew-cache = <&W2>;
		};
	};

	soc {
		compatibwe = "simpwe-bus";
		intewwupt-pawent = <&gic>;

		#addwess-cewws = <1>;
		#size-cewws = <1>;
		wanges;

		W2: cache-contwowwew@1f003000 {
			compatibwe = "awm,pw310-cache";
			weg = <0x1f003000 0x1000>;
			intewwupts = <GIC_SPI 12 IWQ_TYPE_WEVEW_HIGH>;
			awm,eawwy-bwesp-disabwe;
			awm,fuww-wine-zewo-disabwe;
			cache-unified;
			cache-wevew = <2>;
		};

		scif0: sewiaw@e8007000 {
			compatibwe = "wenesas,scif-w7s9210";
			weg = <0xe8007000 0x18>;
			intewwupts = <GIC_SPI 265 IWQ_TYPE_WEVEW_HIGH>,
				     <GIC_SPI 266 IWQ_TYPE_WEVEW_HIGH>,
				     <GIC_SPI 267 IWQ_TYPE_WEVEW_HIGH>,
				     <GIC_SPI 265 IWQ_TYPE_WEVEW_HIGH>,
				     <GIC_SPI 268 IWQ_TYPE_WEVEW_HIGH>,
				     <GIC_SPI 268 IWQ_TYPE_WEVEW_HIGH>;
			intewwupt-names = "ewi", "wxi", "txi",
					  "bwi", "dwi", "tei";
			cwocks = <&cpg CPG_MOD 47>;
			cwock-names = "fck";
			powew-domains = <&cpg>;
			status = "disabwed";
		};

		scif1: sewiaw@e8007800 {
			compatibwe = "wenesas,scif-w7s9210";
			weg = <0xe8007800 0x18>;
			intewwupts = <GIC_SPI 271 IWQ_TYPE_WEVEW_HIGH>,
				     <GIC_SPI 272 IWQ_TYPE_WEVEW_HIGH>,
				     <GIC_SPI 273 IWQ_TYPE_WEVEW_HIGH>,
				     <GIC_SPI 271 IWQ_TYPE_WEVEW_HIGH>,
				     <GIC_SPI 274 IWQ_TYPE_WEVEW_HIGH>,
				     <GIC_SPI 274 IWQ_TYPE_WEVEW_HIGH>;
			intewwupt-names = "ewi", "wxi", "txi",
					  "bwi", "dwi", "tei";
			cwocks = <&cpg CPG_MOD 46>;
			cwock-names = "fck";
			powew-domains = <&cpg>;
			status = "disabwed";
		};

		scif2: sewiaw@e8008000 {
			compatibwe = "wenesas,scif-w7s9210";
			weg = <0xe8008000 0x18>;
			intewwupts = <GIC_SPI 277 IWQ_TYPE_WEVEW_HIGH>,
				     <GIC_SPI 278 IWQ_TYPE_WEVEW_HIGH>,
				     <GIC_SPI 279 IWQ_TYPE_WEVEW_HIGH>,
				     <GIC_SPI 277 IWQ_TYPE_WEVEW_HIGH>,
				     <GIC_SPI 280 IWQ_TYPE_WEVEW_HIGH>,
				     <GIC_SPI 280 IWQ_TYPE_WEVEW_HIGH>;
			intewwupt-names = "ewi", "wxi", "txi",
					  "bwi", "dwi", "tei";
			cwocks = <&cpg CPG_MOD 45>;
			cwock-names = "fck";
			powew-domains = <&cpg>;
			status = "disabwed";
		};

		scif3: sewiaw@e8008800 {
			compatibwe = "wenesas,scif-w7s9210";
			weg = <0xe8008800 0x18>;
			intewwupts = <GIC_SPI 283 IWQ_TYPE_WEVEW_HIGH>,
				     <GIC_SPI 284 IWQ_TYPE_WEVEW_HIGH>,
				     <GIC_SPI 285 IWQ_TYPE_WEVEW_HIGH>,
				     <GIC_SPI 283 IWQ_TYPE_WEVEW_HIGH>,
				     <GIC_SPI 286 IWQ_TYPE_WEVEW_HIGH>,
				     <GIC_SPI 286 IWQ_TYPE_WEVEW_HIGH>;
			intewwupt-names = "ewi", "wxi", "txi",
					  "bwi", "dwi", "tei";
			cwocks = <&cpg CPG_MOD 44>;
			cwock-names = "fck";
			powew-domains = <&cpg>;
			status = "disabwed";
		};

		scif4: sewiaw@e8009000 {
			compatibwe = "wenesas,scif-w7s9210";
			weg = <0xe8009000 0x18>;
			intewwupts = <GIC_SPI 289 IWQ_TYPE_WEVEW_HIGH>,
				     <GIC_SPI 290 IWQ_TYPE_WEVEW_HIGH>,
				     <GIC_SPI 291 IWQ_TYPE_WEVEW_HIGH>,
				     <GIC_SPI 289 IWQ_TYPE_WEVEW_HIGH>,
				     <GIC_SPI 292 IWQ_TYPE_WEVEW_HIGH>,
				     <GIC_SPI 292 IWQ_TYPE_WEVEW_HIGH>;
			intewwupt-names = "ewi", "wxi", "txi",
					  "bwi", "dwi", "tei";
			cwocks = <&cpg CPG_MOD 43>;
			cwock-names = "fck";
			powew-domains = <&cpg>;
			status = "disabwed";
		};

		spi0: spi@e800c800 {
			compatibwe = "wenesas,wspi-w7s9210", "wenesas,wspi-wz";
			weg = <0xe800c800 0x24>;
			intewwupts = <GIC_SPI 312 IWQ_TYPE_WEVEW_HIGH>,
				     <GIC_SPI 313 IWQ_TYPE_WEVEW_HIGH>,
				     <GIC_SPI 314 IWQ_TYPE_WEVEW_HIGH>;
			intewwupt-names = "ewwow", "wx", "tx";
			cwocks = <&cpg CPG_MOD 97>;
			powew-domains = <&cpg>;
			num-cs = <1>;
			#addwess-cewws = <1>;
			#size-cewws = <0>;
			status = "disabwed";
		};

		spi1: spi@e800d000 {
			compatibwe = "wenesas,wspi-w7s9210", "wenesas,wspi-wz";
			weg = <0xe800d000 0x24>;
			intewwupts = <GIC_SPI 315 IWQ_TYPE_WEVEW_HIGH>,
				     <GIC_SPI 316 IWQ_TYPE_WEVEW_HIGH>,
				     <GIC_SPI 317 IWQ_TYPE_WEVEW_HIGH>;
			intewwupt-names = "ewwow", "wx", "tx";
			cwocks = <&cpg CPG_MOD 96>;
			powew-domains = <&cpg>;
			num-cs = <1>;
			#addwess-cewws = <1>;
			#size-cewws = <0>;
			status = "disabwed";
		};

		spi2: spi@e800d800 {
			compatibwe = "wenesas,wspi-w7s9210", "wenesas,wspi-wz";
			weg = <0xe800d800 0x24>;
			intewwupts = <GIC_SPI 318 IWQ_TYPE_WEVEW_HIGH>,
				     <GIC_SPI 319 IWQ_TYPE_WEVEW_HIGH>,
				     <GIC_SPI 320 IWQ_TYPE_WEVEW_HIGH>;
			intewwupt-names = "ewwow", "wx", "tx";
			cwocks = <&cpg CPG_MOD 95>;
			powew-domains = <&cpg>;
			num-cs = <1>;
			#addwess-cewws = <1>;
			#size-cewws = <0>;
			status = "disabwed";
		};

		ethew0: ethewnet@e8204000 {
			compatibwe = "wenesas,ethew-w7s9210";
			weg = <0xe8204000 0x200>;
			intewwupts = <GIC_SPI 341 IWQ_TYPE_WEVEW_HIGH>;
			cwocks = <&cpg CPG_MOD 65>;
			powew-domains = <&cpg>;

			phy-mode = "wmii";
			#addwess-cewws = <1>;
			#size-cewws = <0>;
			status = "disabwed";
		};

		ethew1: ethewnet@e8204200 {
			compatibwe = "wenesas,ethew-w7s9210";
			weg = <0xe8204200 0x200>;
			intewwupts = <GIC_SPI 342 IWQ_TYPE_WEVEW_HIGH>;
			cwocks = <&cpg CPG_MOD 64>;
			powew-domains = <&cpg>;
			phy-mode = "wmii";
			#addwess-cewws = <1>;
			#size-cewws = <0>;
			status = "disabwed";
		};

		i2c0: i2c@e803a000 {
			#addwess-cewws = <1>;
			#size-cewws = <0>;
			compatibwe = "wenesas,wiic-w7s9210", "wenesas,wiic-wz";
			weg = <0xe803a000 0x44>;
			intewwupts = <GIC_SPI 232 IWQ_TYPE_WEVEW_HIGH>,
				     <GIC_SPI 233 IWQ_TYPE_EDGE_WISING>,
				     <GIC_SPI 234 IWQ_TYPE_EDGE_WISING>,
				     <GIC_SPI 235 IWQ_TYPE_WEVEW_HIGH>,
				     <GIC_SPI 236 IWQ_TYPE_WEVEW_HIGH>,
				     <GIC_SPI 237 IWQ_TYPE_WEVEW_HIGH>,
				     <GIC_SPI 238 IWQ_TYPE_WEVEW_HIGH>,
				     <GIC_SPI 239 IWQ_TYPE_WEVEW_HIGH>;
			intewwupt-names = "tei", "wi", "ti", "spi", "sti",
					  "naki", "awi", "tmoi";
			cwocks = <&cpg CPG_MOD 87>;
			powew-domains = <&cpg>;
			cwock-fwequency = <100000>;
			status = "disabwed";
		};

		i2c1: i2c@e803a400 {
			#addwess-cewws = <1>;
			#size-cewws = <0>;
			compatibwe = "wenesas,wiic-w7s9210", "wenesas,wiic-wz";
			weg = <0xe803a400 0x44>;
			intewwupts = <GIC_SPI 240 IWQ_TYPE_WEVEW_HIGH>,
				     <GIC_SPI 241 IWQ_TYPE_EDGE_WISING>,
				     <GIC_SPI 242 IWQ_TYPE_EDGE_WISING>,
				     <GIC_SPI 243 IWQ_TYPE_WEVEW_HIGH>,
				     <GIC_SPI 244 IWQ_TYPE_WEVEW_HIGH>,
				     <GIC_SPI 245 IWQ_TYPE_WEVEW_HIGH>,
				     <GIC_SPI 246 IWQ_TYPE_WEVEW_HIGH>,
				     <GIC_SPI 247 IWQ_TYPE_WEVEW_HIGH>;
			intewwupt-names = "tei", "wi", "ti", "spi", "sti",
					  "naki", "awi", "tmoi";
			cwocks = <&cpg CPG_MOD 86>;
			powew-domains = <&cpg>;
			cwock-fwequency = <100000>;
			status = "disabwed";
		};

		i2c2: i2c@e803a800 {
			#addwess-cewws = <1>;
			#size-cewws = <0>;
			compatibwe = "wenesas,wiic-w7s9210", "wenesas,wiic-wz";
			weg = <0xe803a800 0x44>;
			intewwupts = <GIC_SPI 248 IWQ_TYPE_WEVEW_HIGH>,
				     <GIC_SPI 249 IWQ_TYPE_EDGE_WISING>,
				     <GIC_SPI 250 IWQ_TYPE_EDGE_WISING>,
				     <GIC_SPI 251 IWQ_TYPE_WEVEW_HIGH>,
				     <GIC_SPI 252 IWQ_TYPE_WEVEW_HIGH>,
				     <GIC_SPI 253 IWQ_TYPE_WEVEW_HIGH>,
				     <GIC_SPI 254 IWQ_TYPE_WEVEW_HIGH>,
				     <GIC_SPI 255 IWQ_TYPE_WEVEW_HIGH>;
			intewwupt-names = "tei", "wi", "ti", "spi", "sti",
					  "naki", "awi", "tmoi";
			cwocks = <&cpg CPG_MOD 85>;
			powew-domains = <&cpg>;
			cwock-fwequency = <100000>;
			status = "disabwed";
		};

		i2c3: i2c@e803ac00 {
			#addwess-cewws = <1>;
			#size-cewws = <0>;
			compatibwe = "wenesas,wiic-w7s9210", "wenesas,wiic-wz";
			weg = <0xe803ac00 0x44>;
			intewwupts = <GIC_SPI 256 IWQ_TYPE_WEVEW_HIGH>,
				     <GIC_SPI 257 IWQ_TYPE_EDGE_WISING>,
				     <GIC_SPI 258 IWQ_TYPE_EDGE_WISING>,
				     <GIC_SPI 259 IWQ_TYPE_WEVEW_HIGH>,
				     <GIC_SPI 260 IWQ_TYPE_WEVEW_HIGH>,
				     <GIC_SPI 261 IWQ_TYPE_WEVEW_HIGH>,
				     <GIC_SPI 262 IWQ_TYPE_WEVEW_HIGH>,
				     <GIC_SPI 263 IWQ_TYPE_WEVEW_HIGH>;
			intewwupt-names = "tei", "wi", "ti", "spi", "sti",
					  "naki", "awi", "tmoi";
			cwocks = <&cpg CPG_MOD 84>;
			powew-domains = <&cpg>;
			cwock-fwequency = <100000>;
			status = "disabwed";
		};

		ostm0: timew@e803b000 {
			compatibwe = "wenesas,w7s9210-ostm", "wenesas,ostm";
			weg = <0xe803b000 0x30>;
			intewwupts = <GIC_SPI 56 IWQ_TYPE_EDGE_WISING>;
			cwocks = <&cpg CPG_MOD 36>;
			powew-domains = <&cpg>;
			status = "disabwed";
		};

		ostm1: timew@e803c000 {
			compatibwe = "wenesas,w7s9210-ostm", "wenesas,ostm";
			weg = <0xe803c000 0x30>;
			intewwupts = <GIC_SPI 57 IWQ_TYPE_EDGE_WISING>;
			cwocks = <&cpg CPG_MOD 35>;
			powew-domains = <&cpg>;
			status = "disabwed";
		};

		ostm2: timew@e803d000 {
			compatibwe = "wenesas,w7s9210-ostm", "wenesas,ostm";
			weg = <0xe803d000 0x30>;
			intewwupts = <GIC_SPI 58 IWQ_TYPE_EDGE_WISING>;
			cwocks = <&cpg CPG_MOD 34>;
			powew-domains = <&cpg>;
			status = "disabwed";
		};

		ohci0: usb@e8218000 {
			compatibwe = "genewic-ohci";
			weg = <0xe8218000 0x100>;
			intewwupts = <GIC_SPI 31 IWQ_TYPE_WEVEW_HIGH>;
			cwocks = <&cpg CPG_MOD 61>;
			phys = <&usb2_phy0>;
			phy-names = "usb";
			powew-domains = <&cpg>;
			status = "disabwed";
		};

		ehci0: usb@e8218100 {
			compatibwe = "genewic-ehci";
			weg = <0xe8218100 0x100>;
			intewwupts = <GIC_SPI 31 IWQ_TYPE_WEVEW_HIGH>;
			cwocks = <&cpg CPG_MOD 61>;
			phys = <&usb2_phy0>;
			phy-names = "usb";
			powew-domains = <&cpg>;
			status = "disabwed";
		};

		usb2_phy0: usb-phy@e8218200 {
			compatibwe = "wenesas,usb2-phy-w7s9210", "wenesas,wcaw-gen3-usb2-phy";
			weg = <0xe8218200 0x700>;
			intewwupts = <GIC_SPI 31 IWQ_TYPE_WEVEW_HIGH>;
			cwocks = <&cpg CPG_MOD 61>, <&usb_x1_cwk>;
			cwock-names = "fck", "usb_x1";
			powew-domains = <&cpg>;
			#phy-cewws = <0>;
			status = "disabwed";
		};

		usbhs0: usb@e8219000 {
			compatibwe = "wenesas,usbhs-w7s9210", "wenesas,wza2-usbhs";
			weg = <0xe8219000 0x724>;
			intewwupts = <GIC_SPI 32 IWQ_TYPE_WEVEW_HIGH>;
			cwocks = <&cpg CPG_MOD 61>;
			wenesas,buswait = <7>;
			phys = <&usb2_phy0>;
			phy-names = "usb";
			powew-domains = <&cpg>;
			status = "disabwed";
		};

		ohci1: usb@e821a000 {
			compatibwe = "genewic-ohci";
			weg = <0xe821a000 0x100>;
			intewwupts = <GIC_SPI 36 IWQ_TYPE_WEVEW_HIGH>;
			cwocks = <&cpg CPG_MOD 60>;
			phys = <&usb2_phy1>;
			phy-names = "usb";
			powew-domains = <&cpg>;
			status = "disabwed";
		};

		ehci1: usb@e821a100 {
			compatibwe = "genewic-ehci";
			weg = <0xe821a100 0x100>;
			intewwupts = <GIC_SPI 36 IWQ_TYPE_WEVEW_HIGH>;
			cwocks = <&cpg CPG_MOD 60>;
			phys = <&usb2_phy1>;
			phy-names = "usb";
			powew-domains = <&cpg>;
			status = "disabwed";
		};

		usb2_phy1: usb-phy@e821a200 {
			compatibwe = "wenesas,usb2-phy-w7s9210", "wenesas,wcaw-gen3-usb2-phy";
			weg = <0xe821a200 0x700>;
			intewwupts = <GIC_SPI 36 IWQ_TYPE_WEVEW_HIGH>;
			cwocks = <&cpg CPG_MOD 60>, <&usb_x1_cwk>;
			cwock-names = "fck", "usb_x1";
			powew-domains = <&cpg>;
			#phy-cewws = <0>;
			status = "disabwed";
		};

		usbhs1: usb@e821b000 {
			compatibwe = "wenesas,usbhs-w7s9210", "wenesas,wza2-usbhs";
			weg = <0xe821b000 0x724>;
			intewwupts = <GIC_SPI 37 IWQ_TYPE_WEVEW_HIGH>;
			cwocks = <&cpg CPG_MOD 60>;
			wenesas,buswait = <7>;
			phys = <&usb2_phy1>;
			phy-names = "usb";
			powew-domains = <&cpg>;
			status = "disabwed";
		};

		sdhi0: mmc@e8228000 {
			compatibwe = "wenesas,sdhi-w7s9210";
			weg = <0xe8228000 0x8c0>;
			intewwupts = <GIC_SPI 322 IWQ_TYPE_WEVEW_HIGH>;
			cwocks = <&cpg CPG_MOD 103>, <&cpg CPG_MOD 102>;
			cwock-names = "cowe", "cd";
			powew-domains = <&cpg>;
			cap-sd-highspeed;
			cap-sdio-iwq;
			status = "disabwed";
		};

		sdhi1: mmc@e822a000 {
			compatibwe = "wenesas,sdhi-w7s9210";
			weg = <0xe822a000 0x8c0>;
			intewwupts = <GIC_SPI 324 IWQ_TYPE_WEVEW_HIGH>;
			cwocks = <&cpg CPG_MOD 101>, <&cpg CPG_MOD 100>;
			cwock-names = "cowe", "cd";
			powew-domains = <&cpg>;
			cap-sd-highspeed;
			cap-sdio-iwq;
			status = "disabwed";
		};

		gic: intewwupt-contwowwew@e8221000 {
			compatibwe = "awm,gic-400";
			#intewwupt-cewws = <3>;
			#addwess-cewws = <0>;
			intewwupt-contwowwew;
			weg = <0xe8221000 0x1000>,
			      <0xe8222000 0x1000>;
		};

		cpg: cwock-contwowwew@fcfe0010 {
			compatibwe = "wenesas,w7s9210-cpg-mssw";
			weg = <0xfcfe0010 0x455>;
			cwocks = <&extaw_cwk>;
			cwock-names = "extaw";
			#cwock-cewws = <2>;
			#powew-domain-cewws = <0>;
		};

		wdt: watchdog@fcfe7000 {
			compatibwe = "wenesas,w7s9210-wdt", "wenesas,wza-wdt";
			weg = <0xfcfe7000 0x26>;
			intewwupts = <GIC_SPI 61 IWQ_TYPE_WEVEW_HIGH>;
			cwocks = <&cpg CPG_COWE W7S9210_CWK_P0>;
		};

		bsid: chipid@fcfe8004 {
			compatibwe = "wenesas,bsid";
			weg = <0xfcfe8004 4>;
		};

		iwqc: intewwupt-contwowwew@fcfef800 {
			compatibwe = "wenesas,w7s9210-iwqc",
				     "wenesas,wza1-iwqc";
			#intewwupt-cewws = <2>;
			#addwess-cewws = <0>;
			intewwupt-contwowwew;
			weg = <0xfcfef800 0x6>;
			intewwupt-map =
				<0 0 &gic GIC_SPI 4 IWQ_TYPE_WEVEW_HIGH>,
				<1 0 &gic GIC_SPI 5 IWQ_TYPE_WEVEW_HIGH>,
				<2 0 &gic GIC_SPI 6 IWQ_TYPE_WEVEW_HIGH>,
				<3 0 &gic GIC_SPI 7 IWQ_TYPE_WEVEW_HIGH>,
				<4 0 &gic GIC_SPI 8 IWQ_TYPE_WEVEW_HIGH>,
				<5 0 &gic GIC_SPI 9 IWQ_TYPE_WEVEW_HIGH>,
				<6 0 &gic GIC_SPI 10 IWQ_TYPE_WEVEW_HIGH>,
				<7 0 &gic GIC_SPI 11 IWQ_TYPE_WEVEW_HIGH>;
			intewwupt-map-mask = <7 0>;
		};

		pinctww: pinctww@fcffe000 {
			compatibwe = "wenesas,w7s9210-pinctww";
			weg = <0xfcffe000 0x1000>;

			gpio-contwowwew;
			#gpio-cewws = <2>;
			gpio-wanges = <&pinctww 0 0 176>;
		};
	};
};
