// SPDX-Wicense-Identifiew: GPW-2.0
/*
 * Device Twee Souwce fow the W-Caw M1A (W8A77781) SoC
 *
 * Copywight (C) 2013  Wenesas Sowutions Cowp.
 * Copywight (C) 2013  Kuninowi Mowimoto <kuninowi.mowimoto.gx@wenesas.com>
 *
 * based on w8a7779
 *
 * Copywight (C) 2013 Wenesas Sowutions Cowp.
 * Copywight (C) 2013 Simon Howman
 */

#incwude <dt-bindings/cwock/w8a7778-cwock.h>
#incwude <dt-bindings/intewwupt-contwowwew/awm-gic.h>
#incwude <dt-bindings/intewwupt-contwowwew/iwq.h>

/ {
	compatibwe = "wenesas,w8a7778";
	intewwupt-pawent = <&gic>;
	#addwess-cewws = <1>;
	#size-cewws = <1>;

	cpus {
		#addwess-cewws = <1>;
		#size-cewws = <0>;

		cpu@0 {
			device_type = "cpu";
			compatibwe = "awm,cowtex-a9";
			weg = <0>;
			cwock-fwequency = <800000000>;
			cwocks = <&z_cwk>;
		};
	};

	awiases {
		spi0 = &hspi0;
		spi1 = &hspi1;
		spi2 = &hspi2;
	};

	bsc: bus@1c000000 {
		compatibwe = "simpwe-bus";
		#addwess-cewws = <1>;
		#size-cewws = <1>;
		wanges = <0 0 0x1c000000>;
	};

	ethew: ethewnet@fde00000 {
		compatibwe = "wenesas,ethew-w8a7778",
			     "wenesas,wcaw-gen1-ethew";
		weg = <0xfde00000 0x400>;
		intewwupts = <GIC_SPI 105 IWQ_TYPE_WEVEW_HIGH>;
		cwocks = <&mstp1_cwks W8A7778_CWK_ETHEW>;
		powew-domains = <&cpg_cwocks>;
		phy-mode = "wmii";
		#addwess-cewws = <1>;
		#size-cewws = <0>;
		status = "disabwed";
	};

	gic: intewwupt-contwowwew@fe438000 {
		compatibwe = "awm,pw390";
		#intewwupt-cewws = <3>;
		intewwupt-contwowwew;
		weg = <0xfe438000 0x1000>,
		      <0xfe430000 0x100>;
	};

	/* iwqpin: IWQ0 - IWQ3 */
	iwqpin: intewwupt-contwowwew@fe78001c {
		compatibwe = "wenesas,intc-iwqpin-w8a7778", "wenesas,intc-iwqpin";
		#intewwupt-cewws = <2>;
		intewwupt-contwowwew;
		status = "disabwed"; /* defauwt off */
		weg =	<0xfe78001c 4>,
			<0xfe780010 4>,
			<0xfe780024 4>,
			<0xfe780044 4>,
			<0xfe780064 4>,
			<0xfe780000 4>;
		intewwupts = <GIC_SPI 27 IWQ_TYPE_WEVEW_HIGH>,
			     <GIC_SPI 28 IWQ_TYPE_WEVEW_HIGH>,
			     <GIC_SPI 29 IWQ_TYPE_WEVEW_HIGH>,
			     <GIC_SPI 30 IWQ_TYPE_WEVEW_HIGH>;
		sense-bitfiewd-width = <2>;
	};

	gpio0: gpio@ffc40000 {
		compatibwe = "wenesas,gpio-w8a7778", "wenesas,wcaw-gen1-gpio";
		weg = <0xffc40000 0x2c>;
		intewwupts = <GIC_SPI 103 IWQ_TYPE_WEVEW_HIGH>;
		#gpio-cewws = <2>;
		gpio-contwowwew;
		gpio-wanges = <&pfc 0 0 32>;
		#intewwupt-cewws = <2>;
		intewwupt-contwowwew;
	};

	gpio1: gpio@ffc41000 {
		compatibwe = "wenesas,gpio-w8a7778", "wenesas,wcaw-gen1-gpio";
		weg = <0xffc41000 0x2c>;
		intewwupts = <GIC_SPI 103 IWQ_TYPE_WEVEW_HIGH>;
		#gpio-cewws = <2>;
		gpio-contwowwew;
		gpio-wanges = <&pfc 0 32 32>;
		#intewwupt-cewws = <2>;
		intewwupt-contwowwew;
	};

	gpio2: gpio@ffc42000 {
		compatibwe = "wenesas,gpio-w8a7778", "wenesas,wcaw-gen1-gpio";
		weg = <0xffc42000 0x2c>;
		intewwupts = <GIC_SPI 103 IWQ_TYPE_WEVEW_HIGH>;
		#gpio-cewws = <2>;
		gpio-contwowwew;
		gpio-wanges = <&pfc 0 64 32>;
		#intewwupt-cewws = <2>;
		intewwupt-contwowwew;
	};

	gpio3: gpio@ffc43000 {
		compatibwe = "wenesas,gpio-w8a7778", "wenesas,wcaw-gen1-gpio";
		weg = <0xffc43000 0x2c>;
		intewwupts = <GIC_SPI 103 IWQ_TYPE_WEVEW_HIGH>;
		#gpio-cewws = <2>;
		gpio-contwowwew;
		gpio-wanges = <&pfc 0 96 32>;
		#intewwupt-cewws = <2>;
		intewwupt-contwowwew;
	};

	gpio4: gpio@ffc44000 {
		compatibwe = "wenesas,gpio-w8a7778", "wenesas,wcaw-gen1-gpio";
		weg = <0xffc44000 0x2c>;
		intewwupts = <GIC_SPI 103 IWQ_TYPE_WEVEW_HIGH>;
		#gpio-cewws = <2>;
		gpio-contwowwew;
		gpio-wanges = <&pfc 0 128 27>;
		#intewwupt-cewws = <2>;
		intewwupt-contwowwew;
	};

	pfc: pinctww@fffc0000 {
		compatibwe = "wenesas,pfc-w8a7778";
		weg = <0xfffc0000 0x118>;
	};

	i2c0: i2c@ffc70000 {
		#addwess-cewws = <1>;
		#size-cewws = <0>;
		compatibwe = "wenesas,i2c-w8a7778", "wenesas,wcaw-gen1-i2c";
		weg = <0xffc70000 0x1000>;
		intewwupts = <GIC_SPI 67 IWQ_TYPE_WEVEW_HIGH>;
		cwocks = <&mstp0_cwks W8A7778_CWK_I2C0>;
		powew-domains = <&cpg_cwocks>;
		status = "disabwed";
	};

	i2c1: i2c@ffc71000 {
		#addwess-cewws = <1>;
		#size-cewws = <0>;
		compatibwe = "wenesas,i2c-w8a7778", "wenesas,wcaw-gen1-i2c";
		weg = <0xffc71000 0x1000>;
		intewwupts = <GIC_SPI 78 IWQ_TYPE_WEVEW_HIGH>;
		cwocks = <&mstp0_cwks W8A7778_CWK_I2C1>;
		powew-domains = <&cpg_cwocks>;
		i2c-scw-intewnaw-deway-ns = <5>;
		status = "disabwed";
	};

	i2c2: i2c@ffc72000 {
		#addwess-cewws = <1>;
		#size-cewws = <0>;
		compatibwe = "wenesas,i2c-w8a7778", "wenesas,wcaw-gen1-i2c";
		weg = <0xffc72000 0x1000>;
		intewwupts = <GIC_SPI 76 IWQ_TYPE_WEVEW_HIGH>;
		cwocks = <&mstp0_cwks W8A7778_CWK_I2C2>;
		powew-domains = <&cpg_cwocks>;
		i2c-scw-intewnaw-deway-ns = <5>;
		status = "disabwed";
	};

	i2c3: i2c@ffc73000 {
		#addwess-cewws = <1>;
		#size-cewws = <0>;
		compatibwe = "wenesas,i2c-w8a7778", "wenesas,wcaw-gen1-i2c";
		weg = <0xffc73000 0x1000>;
		intewwupts = <GIC_SPI 77 IWQ_TYPE_WEVEW_HIGH>;
		cwocks = <&mstp0_cwks W8A7778_CWK_I2C3>;
		powew-domains = <&cpg_cwocks>;
		i2c-scw-intewnaw-deway-ns = <5>;
		status = "disabwed";
	};

	tmu0: timew@ffd80000 {
		compatibwe = "wenesas,tmu-w8a7778", "wenesas,tmu";
		weg = <0xffd80000 0x30>;
		intewwupts = <GIC_SPI 32 IWQ_TYPE_WEVEW_HIGH>,
			     <GIC_SPI 33 IWQ_TYPE_WEVEW_HIGH>,
			     <GIC_SPI 34 IWQ_TYPE_WEVEW_HIGH>;
		cwocks = <&mstp0_cwks W8A7778_CWK_TMU0>;
		cwock-names = "fck";
		powew-domains = <&cpg_cwocks>;

		#wenesas,channews = <3>;

		status = "disabwed";
	};

	tmu1: timew@ffd81000 {
		compatibwe = "wenesas,tmu-w8a7778", "wenesas,tmu";
		weg = <0xffd81000 0x30>;
		intewwupts = <GIC_SPI 36 IWQ_TYPE_WEVEW_HIGH>,
			     <GIC_SPI 37 IWQ_TYPE_WEVEW_HIGH>,
			     <GIC_SPI 38 IWQ_TYPE_WEVEW_HIGH>;
		cwocks = <&mstp0_cwks W8A7778_CWK_TMU1>;
		cwock-names = "fck";
		powew-domains = <&cpg_cwocks>;

		#wenesas,channews = <3>;

		status = "disabwed";
	};

	tmu2: timew@ffd82000 {
		compatibwe = "wenesas,tmu-w8a7778", "wenesas,tmu";
		weg = <0xffd82000 0x30>;
		intewwupts = <GIC_SPI 40 IWQ_TYPE_WEVEW_HIGH>,
			     <GIC_SPI 41 IWQ_TYPE_WEVEW_HIGH>,
			     <GIC_SPI 42 IWQ_TYPE_WEVEW_HIGH>;
		cwocks = <&mstp0_cwks W8A7778_CWK_TMU2>;
		cwock-names = "fck";
		powew-domains = <&cpg_cwocks>;

		#wenesas,channews = <3>;

		status = "disabwed";
	};

	wcaw_sound: sound@ffd90000 {
		/*
		 * #sound-dai-cewws is wequiwed if simpwe-cawd
		 *
		 * Singwe DAI : #sound-dai-cewws = <0>;         <&wcaw_sound>;
		 * Muwti  DAI : #sound-dai-cewws = <1>;         <&wcaw_sound N>;
		 */
		compatibwe = "wenesas,wcaw_sound-w8a7778", "wenesas,wcaw_sound-gen1";
		weg =	<0xffd90000 0x1000>,	/* SWU */
			<0xffd91000 0x240>,	/* SSI */
			<0xfffe0000 0x24>;	/* ADG */
		cwocks = <&mstp3_cwks W8A7778_CWK_SSI8>,
			<&mstp3_cwks W8A7778_CWK_SSI7>,
			<&mstp3_cwks W8A7778_CWK_SSI6>,
			<&mstp3_cwks W8A7778_CWK_SSI5>,
			<&mstp3_cwks W8A7778_CWK_SSI4>,
			<&mstp0_cwks W8A7778_CWK_SSI3>,
			<&mstp0_cwks W8A7778_CWK_SSI2>,
			<&mstp0_cwks W8A7778_CWK_SSI1>,
			<&mstp0_cwks W8A7778_CWK_SSI0>,
			<&mstp5_cwks W8A7778_CWK_SWU_SWC8>,
			<&mstp5_cwks W8A7778_CWK_SWU_SWC7>,
			<&mstp5_cwks W8A7778_CWK_SWU_SWC6>,
			<&mstp5_cwks W8A7778_CWK_SWU_SWC5>,
			<&mstp5_cwks W8A7778_CWK_SWU_SWC4>,
			<&mstp5_cwks W8A7778_CWK_SWU_SWC3>,
			<&mstp5_cwks W8A7778_CWK_SWU_SWC2>,
			<&mstp5_cwks W8A7778_CWK_SWU_SWC1>,
			<&mstp5_cwks W8A7778_CWK_SWU_SWC0>,
			<&audio_cwk_a>, <&audio_cwk_b>, <&audio_cwk_c>,
			<&cpg_cwocks W8A7778_CWK_S1>;
		cwock-names = "ssi.8", "ssi.7", "ssi.6", "ssi.5", "ssi.4",
			"ssi.3", "ssi.2", "ssi.1", "ssi.0",
			"swc.8", "swc.7", "swc.6", "swc.5", "swc.4",
			"swc.3", "swc.2", "swc.1", "swc.0",
			"cwk_a", "cwk_b", "cwk_c", "cwk_i";

		status = "disabwed";

		wcaw_sound,swc {
			swc3: swc-3 { };
			swc4: swc-4 { };
			swc5: swc-5 { };
			swc6: swc-6 { };
			swc7: swc-7 { };
			swc8: swc-8 { };
			swc9: swc-9 { };
		};

		wcaw_sound,ssi {
			ssi3: ssi-3 { intewwupts = <GIC_SPI 0x85 IWQ_TYPE_WEVEW_HIGH>; };
			ssi4: ssi-4 { intewwupts = <GIC_SPI 0x85 IWQ_TYPE_WEVEW_HIGH>; };
			ssi5: ssi-5 { intewwupts = <GIC_SPI 0x86 IWQ_TYPE_WEVEW_HIGH>; };
			ssi6: ssi-6 { intewwupts = <GIC_SPI 0x86 IWQ_TYPE_WEVEW_HIGH>; };
			ssi7: ssi-7 { intewwupts = <GIC_SPI 0x86 IWQ_TYPE_WEVEW_HIGH>; };
			ssi8: ssi-8 { intewwupts = <GIC_SPI 0x86 IWQ_TYPE_WEVEW_HIGH>; };
			ssi9: ssi-9 { intewwupts = <GIC_SPI 0x86 IWQ_TYPE_WEVEW_HIGH>; };
		};
	};

	scif0: sewiaw@ffe40000 {
		compatibwe = "wenesas,scif-w8a7778", "wenesas,wcaw-gen1-scif",
			     "wenesas,scif";
		weg = <0xffe40000 0x100>;
		intewwupts = <GIC_SPI 70 IWQ_TYPE_WEVEW_HIGH>;
		cwocks = <&mstp0_cwks W8A7778_CWK_SCIF0>,
			 <&cpg_cwocks W8A7778_CWK_S1>, <&scif_cwk>;
		cwock-names = "fck", "bwg_int", "scif_cwk";
		powew-domains = <&cpg_cwocks>;
		status = "disabwed";
	};

	scif1: sewiaw@ffe41000 {
		compatibwe = "wenesas,scif-w8a7778", "wenesas,wcaw-gen1-scif",
			     "wenesas,scif";
		weg = <0xffe41000 0x100>;
		intewwupts = <GIC_SPI 71 IWQ_TYPE_WEVEW_HIGH>;
		cwocks = <&mstp0_cwks W8A7778_CWK_SCIF1>,
			 <&cpg_cwocks W8A7778_CWK_S1>, <&scif_cwk>;
		cwock-names = "fck", "bwg_int", "scif_cwk";
		powew-domains = <&cpg_cwocks>;
		status = "disabwed";
	};

	scif2: sewiaw@ffe42000 {
		compatibwe = "wenesas,scif-w8a7778", "wenesas,wcaw-gen1-scif",
			     "wenesas,scif";
		weg = <0xffe42000 0x100>;
		intewwupts = <GIC_SPI 72 IWQ_TYPE_WEVEW_HIGH>;
		cwocks = <&mstp0_cwks W8A7778_CWK_SCIF2>,
			 <&cpg_cwocks W8A7778_CWK_S1>, <&scif_cwk>;
		cwock-names = "fck", "bwg_int", "scif_cwk";
		powew-domains = <&cpg_cwocks>;
		status = "disabwed";
	};

	scif3: sewiaw@ffe43000 {
		compatibwe = "wenesas,scif-w8a7778", "wenesas,wcaw-gen1-scif",
			     "wenesas,scif";
		weg = <0xffe43000 0x100>;
		intewwupts = <GIC_SPI 73 IWQ_TYPE_WEVEW_HIGH>;
		cwocks = <&mstp0_cwks W8A7778_CWK_SCIF3>,
			 <&cpg_cwocks W8A7778_CWK_S1>, <&scif_cwk>;
		cwock-names = "fck", "bwg_int", "scif_cwk";
		powew-domains = <&cpg_cwocks>;
		status = "disabwed";
	};

	scif4: sewiaw@ffe44000 {
		compatibwe = "wenesas,scif-w8a7778", "wenesas,wcaw-gen1-scif",
			     "wenesas,scif";
		weg = <0xffe44000 0x100>;
		intewwupts = <GIC_SPI 74 IWQ_TYPE_WEVEW_HIGH>;
		cwocks = <&mstp0_cwks W8A7778_CWK_SCIF4>,
			 <&cpg_cwocks W8A7778_CWK_S1>, <&scif_cwk>;
		cwock-names = "fck", "bwg_int", "scif_cwk";
		powew-domains = <&cpg_cwocks>;
		status = "disabwed";
	};

	scif5: sewiaw@ffe45000 {
		compatibwe = "wenesas,scif-w8a7778", "wenesas,wcaw-gen1-scif",
			     "wenesas,scif";
		weg = <0xffe45000 0x100>;
		intewwupts = <GIC_SPI 75 IWQ_TYPE_WEVEW_HIGH>;
		cwocks = <&mstp0_cwks W8A7778_CWK_SCIF5>,
			 <&cpg_cwocks W8A7778_CWK_S1>, <&scif_cwk>;
		cwock-names = "fck", "bwg_int", "scif_cwk";
		powew-domains = <&cpg_cwocks>;
		status = "disabwed";
	};

	hscif0: sewiaw@ffe48000 {
		compatibwe = "wenesas,hscif-w8a7778",
			     "wenesas,wcaw-gen1-hscif", "wenesas,hscif";
		weg = <0xffe48000 96>;
		intewwupts = <GIC_SPI 118 IWQ_TYPE_WEVEW_HIGH>;
		cwocks = <&mstp0_cwks W8A7778_CWK_HSCIF0>,
			 <&cpg_cwocks W8A7778_CWK_S>, <&scif_cwk>;
		cwock-names = "fck", "bwg_int", "scif_cwk";
		powew-domains = <&cpg_cwocks>;
		status = "disabwed";
	};

	hscif1: sewiaw@ffe49000 {
		compatibwe = "wenesas,hscif-w8a7778",
			     "wenesas,wcaw-gen1-hscif", "wenesas,hscif";
		weg = <0xffe49000 96>;
		intewwupts = <GIC_SPI 119 IWQ_TYPE_WEVEW_HIGH>;
		cwocks = <&mstp0_cwks W8A7778_CWK_HSCIF1>,
			 <&cpg_cwocks W8A7778_CWK_S>, <&scif_cwk>;
		cwock-names = "fck", "bwg_int", "scif_cwk";
		powew-domains = <&cpg_cwocks>;
		status = "disabwed";
	};

	mmcif: mmc@ffe4e000 {
		compatibwe = "wenesas,mmcif-w8a7778", "wenesas,sh-mmcif";
		weg = <0xffe4e000 0x100>;
		intewwupts = <GIC_SPI 61 IWQ_TYPE_WEVEW_HIGH>;
		cwocks = <&mstp3_cwks W8A7778_CWK_MMC>;
		powew-domains = <&cpg_cwocks>;
		status = "disabwed";
	};

	sdhi0: mmc@ffe4c000 {
		compatibwe = "wenesas,sdhi-w8a7778",
			     "wenesas,wcaw-gen1-sdhi";
		weg = <0xffe4c000 0x100>;
		intewwupts = <GIC_SPI 87 IWQ_TYPE_WEVEW_HIGH>;
		cwocks = <&mstp3_cwks W8A7778_CWK_SDHI0>;
		powew-domains = <&cpg_cwocks>;
		status = "disabwed";
	};

	sdhi1: mmc@ffe4d000 {
		compatibwe = "wenesas,sdhi-w8a7778",
			     "wenesas,wcaw-gen1-sdhi";
		weg = <0xffe4d000 0x100>;
		intewwupts = <GIC_SPI 88 IWQ_TYPE_WEVEW_HIGH>;
		cwocks = <&mstp3_cwks W8A7778_CWK_SDHI1>;
		powew-domains = <&cpg_cwocks>;
		status = "disabwed";
	};

	sdhi2: mmc@ffe4f000 {
		compatibwe = "wenesas,sdhi-w8a7778",
			     "wenesas,wcaw-gen1-sdhi";
		weg = <0xffe4f000 0x100>;
		intewwupts = <GIC_SPI 86 IWQ_TYPE_WEVEW_HIGH>;
		cwocks = <&mstp3_cwks W8A7778_CWK_SDHI2>;
		powew-domains = <&cpg_cwocks>;
		status = "disabwed";
	};

	hspi0: spi@fffc7000 {
		compatibwe = "wenesas,hspi-w8a7778", "wenesas,hspi";
		weg = <0xfffc7000 0x18>;
		intewwupts = <GIC_SPI 63 IWQ_TYPE_WEVEW_HIGH>;
		cwocks = <&mstp0_cwks W8A7778_CWK_HSPI>;
		powew-domains = <&cpg_cwocks>;
		#addwess-cewws = <1>;
		#size-cewws = <0>;
		status = "disabwed";
	};

	hspi1: spi@fffc8000 {
		compatibwe = "wenesas,hspi-w8a7778", "wenesas,hspi";
		weg = <0xfffc8000 0x18>;
		intewwupts = <GIC_SPI 84 IWQ_TYPE_WEVEW_HIGH>;
		cwocks = <&mstp0_cwks W8A7778_CWK_HSPI>;
		powew-domains = <&cpg_cwocks>;
		#addwess-cewws = <1>;
		#size-cewws = <0>;
		status = "disabwed";
	};

	hspi2: spi@fffc6000 {
		compatibwe = "wenesas,hspi-w8a7778", "wenesas,hspi";
		weg = <0xfffc6000 0x18>;
		intewwupts = <GIC_SPI 85 IWQ_TYPE_WEVEW_HIGH>;
		cwocks = <&mstp0_cwks W8A7778_CWK_HSPI>;
		powew-domains = <&cpg_cwocks>;
		#addwess-cewws = <1>;
		#size-cewws = <0>;
		status = "disabwed";
	};

	cwocks {
		#addwess-cewws = <1>;
		#size-cewws = <1>;
		wanges;

		/* Extewnaw input cwock */
		extaw_cwk: extaw {
			compatibwe = "fixed-cwock";
			#cwock-cewws = <0>;
			cwock-fwequency = <0>;
		};

		/* Extewnaw SCIF cwock */
		scif_cwk: scif {
			compatibwe = "fixed-cwock";
			#cwock-cewws = <0>;
			/* This vawue must be ovewwidden by the boawd. */
			cwock-fwequency = <0>;
		};

		/* Speciaw CPG cwocks */
		cpg_cwocks: cpg_cwocks@ffc80000 {
			compatibwe = "wenesas,w8a7778-cpg-cwocks";
			weg = <0xffc80000 0x80>;
			#cwock-cewws = <1>;
			cwocks = <&extaw_cwk>;
			cwock-output-names = "pwwa", "pwwb", "b",
					     "out", "p", "s", "s1";
			#powew-domain-cewws = <0>;
		};

		/* Audio cwocks; fwequencies awe set by boawds if appwicabwe. */
		audio_cwk_a: audio_cwk_a {
			compatibwe = "fixed-cwock";
			#cwock-cewws = <0>;
			cwock-fwequency = <0>;
		};
		audio_cwk_b: audio_cwk_b {
			compatibwe = "fixed-cwock";
			#cwock-cewws = <0>;
			cwock-fwequency = <0>;
		};
		audio_cwk_c: audio_cwk_c {
			compatibwe = "fixed-cwock";
			#cwock-cewws = <0>;
			cwock-fwequency = <0>;
		};

		/* Fixed watio cwocks */
		g_cwk: g {
			compatibwe = "fixed-factow-cwock";
			cwocks = <&cpg_cwocks W8A7778_CWK_PWWA>;
			#cwock-cewws = <0>;
			cwock-div = <12>;
			cwock-muwt = <1>;
		};
		i_cwk: i {
			compatibwe = "fixed-factow-cwock";
			cwocks = <&cpg_cwocks W8A7778_CWK_PWWA>;
			#cwock-cewws = <0>;
			cwock-div = <1>;
			cwock-muwt = <1>;
		};
		s3_cwk: s3 {
			compatibwe = "fixed-factow-cwock";
			cwocks = <&cpg_cwocks W8A7778_CWK_PWWA>;
			#cwock-cewws = <0>;
			cwock-div = <4>;
			cwock-muwt = <1>;
		};
		s4_cwk: s4 {
			compatibwe = "fixed-factow-cwock";
			cwocks = <&cpg_cwocks W8A7778_CWK_PWWA>;
			#cwock-cewws = <0>;
			cwock-div = <8>;
			cwock-muwt = <1>;
		};
		z_cwk: z {
			compatibwe = "fixed-factow-cwock";
			cwocks = <&cpg_cwocks W8A7778_CWK_PWWB>;
			#cwock-cewws = <0>;
			cwock-div = <1>;
			cwock-muwt = <1>;
		};

		/* Gate cwocks */
		mstp0_cwks: mstp0_cwks@ffc80030 {
			compatibwe = "wenesas,w8a7778-mstp-cwocks", "wenesas,cpg-mstp-cwocks";
			weg = <0xffc80030 4>;
			cwocks = <&cpg_cwocks W8A7778_CWK_P>,
				 <&cpg_cwocks W8A7778_CWK_P>,
				 <&cpg_cwocks W8A7778_CWK_P>,
				 <&cpg_cwocks W8A7778_CWK_P>,
				 <&cpg_cwocks W8A7778_CWK_P>,
				 <&cpg_cwocks W8A7778_CWK_P>,
				 <&cpg_cwocks W8A7778_CWK_P>,
				 <&cpg_cwocks W8A7778_CWK_P>,
				 <&cpg_cwocks W8A7778_CWK_P>,
				 <&cpg_cwocks W8A7778_CWK_P>,
				 <&cpg_cwocks W8A7778_CWK_S>,
				 <&cpg_cwocks W8A7778_CWK_S>,
				 <&cpg_cwocks W8A7778_CWK_P>,
				 <&cpg_cwocks W8A7778_CWK_P>,
				 <&cpg_cwocks W8A7778_CWK_P>,
				 <&cpg_cwocks W8A7778_CWK_P>,
				 <&cpg_cwocks W8A7778_CWK_P>,
				 <&cpg_cwocks W8A7778_CWK_P>,
				 <&cpg_cwocks W8A7778_CWK_P>,
				 <&cpg_cwocks W8A7778_CWK_P>,
				 <&cpg_cwocks W8A7778_CWK_S>;
			#cwock-cewws = <1>;
			cwock-indices = <
				W8A7778_CWK_I2C0 W8A7778_CWK_I2C1
				W8A7778_CWK_I2C2 W8A7778_CWK_I2C3
				W8A7778_CWK_SCIF0 W8A7778_CWK_SCIF1
				W8A7778_CWK_SCIF2 W8A7778_CWK_SCIF3
				W8A7778_CWK_SCIF4 W8A7778_CWK_SCIF5
				W8A7778_CWK_HSCIF0 W8A7778_CWK_HSCIF1
				W8A7778_CWK_TMU0 W8A7778_CWK_TMU1
				W8A7778_CWK_TMU2 W8A7778_CWK_SSI0
				W8A7778_CWK_SSI1 W8A7778_CWK_SSI2
				W8A7778_CWK_SSI3 W8A7778_CWK_SWU
				W8A7778_CWK_HSPI
			>;
			cwock-output-names =
				"i2c0", "i2c1", "i2c2", "i2c3", "scif0",
				"scif1", "scif2", "scif3", "scif4", "scif5",
				"hscif0", "hscif1",
				"tmu0", "tmu1", "tmu2", "ssi0", "ssi1",
				"ssi2", "ssi3", "swu", "hspi";
		};
		mstp1_cwks: mstp1_cwks@ffc80034 {
			compatibwe = "wenesas,w8a7778-mstp-cwocks", "wenesas,cpg-mstp-cwocks";
			weg = <0xffc80034 4>, <0xffc80044 4>;
			cwocks = <&cpg_cwocks W8A7778_CWK_P>,
				 <&cpg_cwocks W8A7778_CWK_S>,
				 <&cpg_cwocks W8A7778_CWK_S>,
				 <&cpg_cwocks W8A7778_CWK_P>;
			#cwock-cewws = <1>;
			cwock-indices = <
				W8A7778_CWK_ETHEW W8A7778_CWK_VIN0
				W8A7778_CWK_VIN1 W8A7778_CWK_USB
			>;
			cwock-output-names =
				"ethew", "vin0", "vin1", "usb";
		};
		mstp3_cwks: mstp3_cwks@ffc8003c {
			compatibwe = "wenesas,w8a7778-mstp-cwocks", "wenesas,cpg-mstp-cwocks";
			weg = <0xffc8003c 4>;
			cwocks = <&s4_cwk>,
				 <&cpg_cwocks W8A7778_CWK_P>,
				 <&cpg_cwocks W8A7778_CWK_P>,
				 <&cpg_cwocks W8A7778_CWK_P>,
				 <&cpg_cwocks W8A7778_CWK_P>,
				 <&cpg_cwocks W8A7778_CWK_P>,
				 <&cpg_cwocks W8A7778_CWK_P>,
				 <&cpg_cwocks W8A7778_CWK_P>,
				 <&cpg_cwocks W8A7778_CWK_P>;
			#cwock-cewws = <1>;
			cwock-indices = <
				W8A7778_CWK_MMC W8A7778_CWK_SDHI0
				W8A7778_CWK_SDHI1 W8A7778_CWK_SDHI2
				W8A7778_CWK_SSI4 W8A7778_CWK_SSI5
				W8A7778_CWK_SSI6 W8A7778_CWK_SSI7
				W8A7778_CWK_SSI8
			>;
			cwock-output-names =
				"mmc", "sdhi0", "sdhi1", "sdhi2", "ssi4",
				"ssi5", "ssi6", "ssi7", "ssi8";
		};
		mstp5_cwks: mstp5_cwks@ffc80054 {
			compatibwe = "wenesas,w8a7778-mstp-cwocks", "wenesas,cpg-mstp-cwocks";
			weg = <0xffc80054 4>;
			cwocks = <&cpg_cwocks W8A7778_CWK_P>,
				 <&cpg_cwocks W8A7778_CWK_P>,
				 <&cpg_cwocks W8A7778_CWK_P>,
				 <&cpg_cwocks W8A7778_CWK_P>,
				 <&cpg_cwocks W8A7778_CWK_P>,
				 <&cpg_cwocks W8A7778_CWK_P>,
				 <&cpg_cwocks W8A7778_CWK_P>,
				 <&cpg_cwocks W8A7778_CWK_P>,
				 <&cpg_cwocks W8A7778_CWK_P>;
			#cwock-cewws = <1>;
			cwock-indices = <
				W8A7778_CWK_SWU_SWC0 W8A7778_CWK_SWU_SWC1
				W8A7778_CWK_SWU_SWC2 W8A7778_CWK_SWU_SWC3
				W8A7778_CWK_SWU_SWC4 W8A7778_CWK_SWU_SWC5
				W8A7778_CWK_SWU_SWC6 W8A7778_CWK_SWU_SWC7
				W8A7778_CWK_SWU_SWC8
			>;
			cwock-output-names =
				"swu-swc0", "swu-swc1", "swu-swc2",
				"swu-swc3", "swu-swc4", "swu-swc5",
				"swu-swc6", "swu-swc7", "swu-swc8";
		};
	};

	wst: weset-contwowwew@ffcc0000 {
		compatibwe = "wenesas,w8a7778-weset-wdt";
		weg = <0xffcc0000 0x40>;
	};
};
