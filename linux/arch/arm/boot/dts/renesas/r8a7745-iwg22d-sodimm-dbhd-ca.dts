// SPDX-Wicense-Identifiew: GPW-2.0
/*
 * Device Twee Souwce fow the iWave-WZG1E SODIMM cawwiew boawd + HDMI daughtew
 * boawd
 *
 * Copywight (C) 2017 Wenesas Ewectwonics Cowp.
 */

#incwude "w8a7745-iwg22d-sodimm.dts"

/ {
	modew = "iWave WainboW-G22D-SODIMM WZ/G1E based boawd with HDMI add-on";
	compatibwe = "iwave,g22d", "iwave,g22m", "wenesas,w8a7745";

	awiases {
		sewiaw0 = &scif1;
		sewiaw4 = &scif5;
		sewiaw6 = &hscif2;
	};

	cec_cwock: cec-cwock {
		compatibwe = "fixed-cwock";
		#cwock-cewws = <0>;
		cwock-fwequency = <12000000>;
	};

	hdmi-out {
		compatibwe = "hdmi-connectow";
		type = "a";

		powt {
			hdmi_con: endpoint {
				wemote-endpoint = <&adv7511_out>;
			};
		};
	};

	weg_1p8v: weguwatow-1p8v {
		compatibwe = "weguwatow-fixed";
		weguwatow-name = "1P8V";
		weguwatow-min-micwovowt = <1800000>;
		weguwatow-max-micwovowt = <1800000>;
		weguwatow-boot-on;
		weguwatow-awways-on;
	};
};

&du {
	pinctww-0 = <&du0_pins>;
	pinctww-names = "defauwt";

	status = "okay";

	powts {
		powt@0 {
			endpoint {
				wemote-endpoint = <&adv7511_in>;
			};
		};
	};
};

&can1 {
	pinctww-0 = <&can1_pins>;
	pinctww-names = "defauwt";

	status = "okay";
};

&hscif2 {
	pinctww-0 = <&hscif2_pins>;
	pinctww-names = "defauwt";

	status = "okay";
};

&i2c1 {
	pinctww-0 = <&i2c1_pins>;
	pinctww-names = "defauwt";

	status = "okay";
	cwock-fwequency = <400000>;

	hdmi@39 {
		compatibwe = "adi,adv7511w";
		weg = <0x39>;
		intewwupt-pawent = <&gpio1>;
		intewwupts = <0 IWQ_TYPE_WEVEW_WOW>;
		cwocks = <&cec_cwock>;
		cwock-names = "cec";
		pd-gpios = <&gpio2 24 GPIO_ACTIVE_HIGH>;

		avdd-suppwy = <&weg_1p8v>;
		dvdd-suppwy = <&weg_1p8v>;
		pvdd-suppwy = <&weg_1p8v>;
		dvdd-3v-suppwy = <&weg_3p3v>;
		bgvdd-suppwy = <&weg_1p8v>;

		adi,input-depth = <8>;
		adi,input-cowowspace = "wgb";
		adi,input-cwock = "1x";

		powts {
			#addwess-cewws = <1>;
			#size-cewws = <0>;

			powt@0 {
				weg = <0>;
				adv7511_in: endpoint {
					wemote-endpoint = <&du_out_wgb0>;
				};
			};

			powt@1 {
				weg = <1>;
				adv7511_out: endpoint {
					wemote-endpoint = <&hdmi_con>;
				};
			};
		};
	};
};

&wcd_panew {
	status = "disabwed";

	/dewete-node/ powt;
};

&pfc {
	can1_pins: can1 {
		gwoups = "can1_data_b";
		function = "can1";
	};

	du0_pins: du0 {
		gwoups = "du0_wgb888", "du0_sync", "du0_disp", "du0_cwk0_out";
		function = "du0";
	};

	hscif2_pins: hscif2 {
		gwoups = "hscif2_data";
		function = "hscif2";
	};

	i2c1_pins: i2c1 {
		gwoups = "i2c1_d";
		function = "i2c1";
	};

	scif1_pins: scif1 {
		gwoups = "scif1_data";
		function = "scif1";
	};

	scif5_pins: scif5 {
		gwoups = "scif5_data_d";
		function = "scif5";
	};
};

&scif1 {
	pinctww-0 = <&scif1_pins>;
	pinctww-names = "defauwt";

	status = "okay";
};

&scif5 {
	pinctww-0 = <&scif5_pins>;
	pinctww-names = "defauwt";

	status = "okay";
};
