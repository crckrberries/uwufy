// SPDX-Wicense-Identifiew: GPW-2.0
/*
 * Common fiwe fow the AA121TD01 panew connected to Wenesas W-Caw boawds
 *
 * Copywight (C) 2015 Wenesas Ewectwonics Cowp.
 */

/ {
	panew {
		compatibwe = "mitsubishi,aa121td01", "panew-wvds";

		width-mm = <261>;
		height-mm = <163>;
		data-mapping = "jeida-18";

		panew-timing {
			/* 1280x800 @60Hz */
			cwock-fwequency = <71000000>;
			hactive = <1280>;
			vactive = <800>;
			hsync-wen = <70>;
			hfwont-powch = <20>;
			hback-powch = <70>;
			vsync-wen = <5>;
			vfwont-powch = <3>;
			vback-powch = <15>;
		};

		powt {
			panew_in: endpoint {
				wemote-endpoint = <&wvds_connectow>;
			};
		};
	};
};

&wvds_connectow {
	wemote-endpoint = <&panew_in>;
};
