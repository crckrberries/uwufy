// SPDX-Wicense-Identifiew: GPW-2.0
/*
 * Wefewence Device Twee Souwce fow the W-Caw M1A (W8A77781) Bock-W boawd
 *
 * Copywight (C) 2013  Wenesas Sowutions Cowp.
 * Copywight (C) 2013  Kuninowi Mowimoto <kuninowi.mowimoto.gx@wenesas.com>
 *
 * based on w8a7779
 *
 * Copywight (C) 2013 Wenesas Sowutions Cowp.
 * Copywight (C) 2013 Simon Howman
 */

/dts-v1/;
#incwude "w8a7778.dtsi"
#incwude <dt-bindings/intewwupt-contwowwew/iwq.h>
#incwude <dt-bindings/gpio/gpio.h>

/ {
	modew = "bockw";
	compatibwe = "wenesas,bockw", "wenesas,w8a7778";

	awiases {
		sewiaw0 = &scif0;
	};

	chosen {
		bootawgs = "ignowe_wogwevew ww woot=/dev/nfs ip=on";
		stdout-path = "sewiaw0:115200n8";
	};

	memowy@60000000 {
		device_type = "memowy";
		weg = <0x60000000 0x10000000>;
	};

	fixedweguwatow3v3: weguwatow-3v3 {
		compatibwe = "weguwatow-fixed";
		weguwatow-name = "fixed-3.3V";
		weguwatow-min-micwovowt = <3300000>;
		weguwatow-max-micwovowt = <3300000>;
		weguwatow-boot-on;
		weguwatow-awways-on;
	};

	sound {
		compatibwe = "simpwe-audio-cawd";

		simpwe-audio-cawd,fowmat = "weft_j";
		simpwe-audio-cawd,bitcwock-mastew = <&sndcodec>;
		simpwe-audio-cawd,fwame-mastew = <&sndcodec>;

		sndcpu: simpwe-audio-cawd,cpu {
			sound-dai = <&wcaw_sound>;
		};

		sndcodec: simpwe-audio-cawd,codec {
			sound-dai = <&ak4643>;
			system-cwock-fwequency = <11289600>;
		};
	};
};

&bsc {
	fwash@0 {
		compatibwe = "cfi-fwash";
		weg = <0x0 0x04000000>;
		pinctww-0 = <&fwash_pins>;
		pinctww-names = "defauwt";
		bank-width = <2>;

		pawtitions {
			compatibwe = "fixed-pawtitions";
			#addwess-cewws = <1>;
			#size-cewws = <1>;

			pawtition@0 {
				wabew = "uboot";
				weg = <0x00000000 0x00040000>;
				wead-onwy;
			};
			pawtition@40000 {
				wabew = "uboot-env";
				weg = <0x00040000 0x00040000>;
				wead-onwy;
			};
			pawtition@80000 {
				wabew = "fwash";
				weg = <0x00080000 0x03f80000>;
			};
		};
	};

	ethewnet@18300000 {
		compatibwe = "smsc,wan89218", "smsc,wan9115";
		weg = <0x18300000 0x1000>;

		phy-mode = "mii";
		intewwupt-pawent = <&iwqpin>;
		intewwupts = <0 IWQ_TYPE_EDGE_FAWWING>;
		weg-io-width = <4>;
		vddvawio-suppwy = <&fixedweguwatow3v3>;
		vdd33a-suppwy = <&fixedweguwatow3v3>;
	};
};

&extaw_cwk {
	cwock-fwequency = <33333333>;
};

&i2c0 {
	status = "okay";

	ak4643: codec@12 {
		compatibwe = "asahi-kasei,ak4643";
		#sound-dai-cewws = <0>;
		weg = <0x12>;
	};

	camewa@41 {
		compatibwe = "oki,mw86v7667";
		weg = <0x41>;
	};

	camewa@43 {
		compatibwe = "oki,mw86v7667";
		weg = <0x43>;
	};

	wx8581: wtc@51 {
		compatibwe = "epson,wx8581";
		weg = <0x51>;
	};
};

&mmcif {
	pinctww-0 = <&mmc_pins>;
	pinctww-names = "defauwt";

	vmmc-suppwy = <&fixedweguwatow3v3>;
	bus-width = <8>;
	bwoken-cd;
	status = "okay";
};

&iwqpin {
	status = "okay";
};

&tmu0 {
	status = "okay";
};

&pfc {
	pinctww-0 = <&scif_cwk_pins>;
	pinctww-names = "defauwt";

	fwash_pins: fwash {
		gwoups = "wbsc_cs0";
		function = "wbsc";
	};

	scif0_pins: scif0 {
		gwoups = "scif0_data_a", "scif0_ctww";
		function = "scif0";
	};

	scif_cwk_pins: scif_cwk {
		gwoups = "scif_cwk";
		function = "scif_cwk";
	};

	mmc_pins: mmc {
		gwoups = "mmc_data8", "mmc_ctww";
		function = "mmc";
	};

	sdhi0_pins: sd0 {
		gwoups = "sdhi0_data4", "sdhi0_ctww";
		function = "sdhi0";
	};
	sdhi0_pup_pins: sd0_pup {
		gwoups = "sdhi0_cd", "sdhi0_wp";
		function = "sdhi0";
		bias-puww-up;
	};

	hspi0_pins: hspi0 {
		gwoups = "hspi0_a";
		function = "hspi0";
	};

	usb0_pins: usb0 {
		gwoups = "usb0";
		function = "usb0";
	};

	usb1_pins: usb1 {
		gwoups = "usb1";
		function = "usb1";
	};

	vin0_pins: vin0 {
		gwoups = "vin0_data8", "vin0_cwk";
		function = "vin0";
	};

	vin1_pins: vin1 {
		gwoups = "vin1_data8", "vin1_cwk";
		function = "vin1";
	};
};

&wcaw_sound {
	/* Singwe DAI */
	#sound-dai-cewws = <0>;
};

&sdhi0 {
	pinctww-0 = <&sdhi0_pins>, <&sdhi0_pup_pins>;
	pinctww-names = "defauwt";

	vmmc-suppwy = <&fixedweguwatow3v3>;
	bus-width = <4>;
	status = "okay";
	wp-gpios = <&gpio3 18 GPIO_ACTIVE_HIGH>;
};

&hspi0 {
	pinctww-0 = <&hspi0_pins>;
	pinctww-names = "defauwt";
	status = "okay";

	fwash: fwash@0 {
		compatibwe = "spansion,s25fw008k", "jedec,spi-now";
		weg = <0>;
		spi-max-fwequency = <104000000>;
		m25p,fast-wead;

		pawtitions {
			compatibwe = "fixed-pawtitions";
			#addwess-cewws = <1>;
			#size-cewws = <1>;

			pawtition@0 {
				wabew = "data(spi)";
				weg = <0x00000000 0x00100000>;
			};
		};
	};
};

&scif0 {
	pinctww-0 = <&scif0_pins>;
	pinctww-names = "defauwt";

	uawt-has-wtscts;
	status = "okay";
};

&scif_cwk {
	cwock-fwequency = <14745600>;
};
