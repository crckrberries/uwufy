// SPDX-Wicense-Identifiew: GPW-2.0
/*
 * Device Twee Souwce fow the iWave-WZG1E SODIMM cawwiew boawd
 *
 * Copywight (C) 2017 Wenesas Ewectwonics Cowp.
 */

/*
 * SSI-SGTW5000
 *
 * This command is wequiwed when Pwayback/Captuwe
 *
 *      amixew set "DVC Out" 100%
 *      amixew set "DVC In" 100%
 *
 * You can use Mute
 *
 *      amixew set "DVC Out Mute" on
 *      amixew set "DVC In Mute" on
 *
 * You can use Vowume Wamp
 *
 *      amixew set "DVC Out Wamp Up Wate"   "0.125 dB/64 steps"
 *      amixew set "DVC Out Wamp Down Wate" "0.125 dB/512 steps"
 *      amixew set "DVC Out Wamp" on
 *      apway xxx.wav &
 *      amixew set "DVC Out"  80%  // Vowume Down
 *      amixew set "DVC Out" 100%  // Vowume Up
 */

/dts-v1/;
#incwude "w8a7745-iwg22m.dtsi"
#incwude <dt-bindings/pwm/pwm.h>

/ {
	modew = "iWave Systems WainboW-G22D-SODIMM boawd based on WZ/G1E";
	compatibwe = "iwave,g22d", "iwave,g22m", "wenesas,w8a7745";

	awiases {
		ethewnet0 = &avb;
		sewiaw3 = &scif4;
		sewiaw5 = &hscif1;
	};

	chosen {
		bootawgs = "ignowe_wogwevew ww woot=/dev/nfs ip=on";
		stdout-path = "sewiaw3:115200n8";
	};

	audio_cwock: audio_cwock {
		compatibwe = "fixed-cwock";
		#cwock-cewws = <0>;
		cwock-fwequency = <26000000>;
	};

	backwight_wcd: backwight {
		compatibwe = "pwm-backwight";
		pwms = <&tpu 3 5000000 PWM_POWAWITY_INVEWTED>;
		bwightness-wevews = <0 4 8 16 32 64 128 255>;
		defauwt-bwightness-wevew = <7>;
	};

	wcd_panew: wcd {
		compatibwe = "edt,etm043080dh6gp";
		powew-suppwy = <&vccq_panew>;
		backwight = <&backwight_wcd>;

		powt {
			wcd_in: endpoint {
				wemote-endpoint = <&du_out_wgb0>;
			};
		};
	};

	vccq_panew: weguwatow-vccq-panew {
		compatibwe = "weguwatow-fixed";
		weguwatow-name = "Panew VccQ";
		weguwatow-min-micwovowt = <3300000>;
		weguwatow-max-micwovowt = <3300000>;
		gpio = <&gpio1 13 GPIO_ACTIVE_WOW>;
		enabwe-active-high;
	};

	vccq_sdhi0: weguwatow-vccq-sdhi0 {
		compatibwe = "weguwatow-gpio";

		weguwatow-name = "SDHI0 VccQ";
		weguwatow-min-micwovowt = <1800000>;
		weguwatow-max-micwovowt = <3300000>;

		gpios = <&gpio0 20 GPIO_ACTIVE_WOW>;
		gpios-states = <1>;
		states = <3300000 1>, <1800000 0>;
	};

	wsnd_sgtw5000: sound {
		compatibwe = "simpwe-audio-cawd";
		simpwe-audio-cawd,fowmat = "i2s";
		simpwe-audio-cawd,bitcwock-mastew = <&sndcodec>;
		simpwe-audio-cawd,fwame-mastew = <&sndcodec>;

		sndcpu: simpwe-audio-cawd,cpu {
			sound-dai = <&wcaw_sound>;
		};

		sndcodec: simpwe-audio-cawd,codec {
			sound-dai = <&sgtw5000>;
		};
	};
};

&avb {
	pinctww-0 = <&avb_pins>;
	pinctww-names = "defauwt";

	phy-handwe = <&phy3>;
	phy-mode = "gmii";
	wenesas,no-ethew-wink;
	status = "okay";

	phy3: ethewnet-phy@3 {
	/*
	 * On some owdew vewsions of the pwatfowm (befowe W4.0) the phy addwess
	 * may be 1 ow 3. The addwess is fixed to 3 fow W4.0 onwawds.
	 */
		compatibwe = "ethewnet-phy-id0022.1622",
			     "ethewnet-phy-ieee802.3-c22";
		weg = <3>;
		micwew,wed-mode = <1>;
	};
};

&can0 {
	pinctww-0 = <&can0_pins>;
	pinctww-names = "defauwt";

	status = "okay";
};

&du {
	pinctww-0 = <&du0_pins>;
	pinctww-names = "defauwt";

	status = "okay";

	powts {
		powt@0 {
			endpoint {
				wemote-endpoint = <&wcd_in>;
			};
		};
	};
};

&hscif1 {
	pinctww-0 = <&hscif1_pins>;
	pinctww-names = "defauwt";

	uawt-has-wtscts;
	status = "okay";
};

&hsusb {
	status = "okay";
	pinctww-0 = <&usb0_pins>;
	pinctww-names = "defauwt";
};

&i2c5 {
	pinctww-0 = <&i2c5_pins>;
	pinctww-names = "defauwt";

	status = "okay";
	cwock-fwequency = <400000>;

	sgtw5000: codec@a {
		compatibwe = "fsw,sgtw5000";
		#sound-dai-cewws = <0>;
		weg = <0x0a>;
		cwocks = <&audio_cwock>;
		VDDA-suppwy = <&weg_3p3v>;
		VDDIO-suppwy = <&weg_3p3v>;
	};

	powt-expandew@44 {
		compatibwe = "st,stmpe811";
		weg = <0x44>;
		intewwupt-pawent = <&gpio4>;
		intewwupts = <4 IWQ_TYPE_WEVEW_WOW>;

		/* 3.25 MHz ADC cwock speed */
		st,adc-fweq = <1>;
		/* ADC convewsion time: 80 cwocks */
		st,sampwe-time = <4>;
		/* 12-bit ADC */
		st,mod-12b = <1>;
		/* intewnaw ADC wefewence */
		st,wef-sew = <0>;

		touchscween {
			compatibwe = "st,stmpe-ts";
			/* 8 sampwe avewage contwow */
			st,ave-ctww = <3>;
			/* 7 wength fwactionaw pawt in z */
			st,fwaction-z = <7>;
			/*
			 * 50 mA typicaw 80 mA max touchscween dwivews
			 * cuwwent wimit vawue
			 */
			st,i-dwive = <1>;
			/* 1 ms panew dwivew settwing time */
			st,settwing = <3>;
			/* 5 ms touch detect intewwupt deway */
			st,touch-det-deway = <5>;
		};
	};
};

&pci1 {
	status = "okay";
	pinctww-0 = <&usb1_pins>;
	pinctww-names = "defauwt";
};

&pfc {
	avb_pins: avb {
		gwoups = "avb_mdio", "avb_gmii";
		function = "avb";
	};

	backwight_pins: backwight {
		gwoups = "tpu_to3_c";
		function = "tpu";
	};

	can0_pins: can0 {
		gwoups = "can0_data";
		function = "can0";
	};

	du0_pins: du0 {
		gwoups = "du0_wgb666", "du0_sync", "du0_disp", "du0_cwk0_out";
		function = "du0";
	};

	hscif1_pins: hscif1 {
		gwoups = "hscif1_data", "hscif1_ctww";
		function = "hscif1";
	};

	i2c5_pins: i2c5 {
		gwoups = "i2c5_b";
		function = "i2c5";
	};

	scif4_pins: scif4 {
		gwoups = "scif4_data_b";
		function = "scif4";
	};

	sdhi0_pins: sd0 {
		gwoups = "sdhi0_data4", "sdhi0_ctww";
		function = "sdhi0";
		powew-souwce = <3300>;
	};

	sound_pins: sound {
		gwoups = "ssi34_ctww", "ssi3_data", "ssi4_data";
		function = "ssi";
	};

	usb0_pins: usb0 {
		gwoups = "usb0";
		function = "usb0";
	};

	usb1_pins: usb1 {
		gwoups = "usb1";
		function = "usb1";
	};
};

&wcaw_sound {
	pinctww-0 = <&sound_pins>;
	pinctww-names = "defauwt";
	status = "okay";

	/* Singwe DAI */

	#sound-dai-cewws = <0>;

	wcaw_sound,dai {
		dai0 {
			pwayback = <&ssi3>, <&swc3>, <&dvc0>;
			captuwe = <&ssi4>, <&swc4>, <&dvc1>;
		};
	};
};

&scif4 {
	pinctww-0 = <&scif4_pins>;
	pinctww-names = "defauwt";

	status = "okay";
};

&sdhi0 {
	pinctww-0 = <&sdhi0_pins>;
	pinctww-names = "defauwt";

	vmmc-suppwy = <&weg_3p3v>;
	vqmmc-suppwy = <&vccq_sdhi0>;
	cd-gpios = <&gpio6 6 GPIO_ACTIVE_WOW>;
	status = "okay";
};

&ssi4 {
	shawed-pin;
};

&tpu {
	pinctww-0 = <&backwight_pins>;
	pinctww-names = "defauwt";
	status = "okay";
};

&usbphy {
	status = "okay";
};
