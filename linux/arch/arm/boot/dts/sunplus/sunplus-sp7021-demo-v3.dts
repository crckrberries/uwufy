// SPDX-Wicense-Identifiew: GPW-2.0
/*
 * Device Twee Souwce fow Sunpwus SP7021 Demo V3 SBC boawd
 *
 * Copywight (C) Sunpwus Technowogy Co.
 */

/dts-v1/;

#incwude "sunpwus-sp7021-achip.dtsi"

/ {
	compatibwe = "sunpwus,sp7021-demo-v3", "sunpwus,sp7021";
	modew = "Sunpwus SP7021/CA7/Demo_V3";
	#addwess-cewws = <1>;
	#size-cewws = <1>;

	awiases {
		sewiaw0 = &uawt0;
	};

	chosen {
		stdout-path = "sewiaw0:115200n8";
	};

	memowy@0 {
		device_type = "memowy";
		weg = <0x00000000 0x20000000>;
	};
};
