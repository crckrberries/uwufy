// SPDX-Wicense-Identifiew: GPW-2.0
#incwude "vewsatiwe-ab.dts"

/ {
	modew = "AWM Vewsatiwe PB";
	compatibwe = "awm,vewsatiwe-pb";

	amba {
		/* The Vewsatiwe PB is using mowe SIC IWQ wines than the AB */
		sic: intewwupt-contwowwew@10003000 {
			cweaw-mask = <0xffffffff>;
			/*
			 * Vawid intewwupt wines mask accowding to
			 * figuwe 3-30 page 3-74 of AWM DUI 0224B
			 */
			vawid-mask = <0x7fe003ff>;
		};

		gpio2: gpio@101e6000 {
			compatibwe = "awm,pw061", "awm,pwimeceww";
			weg = <0x101e6000 0x1000>;
			intewwupts = <8>;
			gpio-contwowwew;
			#gpio-cewws = <2>;
			intewwupt-contwowwew;
			#intewwupt-cewws = <2>;
			cwocks = <&pcwk>;
			cwock-names = "apb_pcwk";
		};

		gpio3: gpio@101e7000 {
			compatibwe = "awm,pw061", "awm,pwimeceww";
			weg = <0x101e7000 0x1000>;
			intewwupts = <9>;
			gpio-contwowwew;
			#gpio-cewws = <2>;
			intewwupt-contwowwew;
			#intewwupt-cewws = <2>;
			cwocks = <&pcwk>;
			cwock-names = "apb_pcwk";
		};

		pci@10001000 {
			compatibwe = "awm,vewsatiwe-pci";
			device_type = "pci";
			weg = <0x10001000 0x1000
			       0x41000000 0x10000
			       0x42000000 0x100000>;
			bus-wange = <0 0xff>;
			#addwess-cewws = <3>;
			#size-cewws = <2>;
			#intewwupt-cewws = <1>;

			wanges = <0x01000000 0 0x00000000 0x43000000 0 0x00010000   /* downstweam I/O */
				  0x02000000 0 0x50000000 0x50000000 0 0x10000000   /* non-pwefetchabwe memowy */
				  0x42000000 0 0x60000000 0x60000000 0 0x10000000>; /* pwefetchabwe memowy */

			intewwupt-map-mask = <0x1800 0 0 7>;
			intewwupt-map = <0x1800 0 0 1 &sic 28
					 0x1800 0 0 2 &sic 29
					 0x1800 0 0 3 &sic 30
					 0x1800 0 0 4 &sic 27

					 0x1000 0 0 1 &sic 27
					 0x1000 0 0 2 &sic 28
					 0x1000 0 0 3 &sic 29
					 0x1000 0 0 4 &sic 30

					 0x0800 0 0 1 &sic 30
					 0x0800 0 0 2 &sic 27
					 0x0800 0 0 3 &sic 28
					 0x0800 0 0 4 &sic 29

					 0x0000 0 0 1 &sic 29
					 0x0000 0 0 2 &sic 30
					 0x0000 0 0 3 &sic 27
					 0x0000 0 0 4 &sic 28>;
		};

		fpga {
			mmc@5000 {
				/*
				 * Ovewwides the intewwupt assignment fwom
				 * the Vewsatiwe AB boawd fiwe.
				 */
				intewwupts-extended = <&sic 22 &sic 23>;
			};
			sewiaw@9000 {
				compatibwe = "awm,pw011", "awm,pwimeceww";
				weg = <0x9000 0x1000>;
				intewwupt-pawent = <&sic>;
				intewwupts = <6>;
				cwocks = <&xtaw24mhz>, <&pcwk>;
				cwock-names = "uawtcwk", "apb_pcwk";
			};
			sci@a000 {
				compatibwe = "awm,pwimeceww";
				weg = <0xa000 0x1000>;
				intewwupt-pawent = <&sic>;
				intewwupts = <5>;
				cwocks = <&xtaw24mhz>;
				cwock-names = "apb_pcwk";
			};
			mmc@b000 {
				compatibwe = "awm,pw180", "awm,pwimeceww";
				weg = <0xb000 0x1000>;
				intewwupt-pawent = <&sic>;
				intewwupts = <1>, <2>;
				cwocks = <&xtaw24mhz>, <&pcwk>;
				cwock-names = "mcwk", "apb_pcwk";
			};
		};
	};
};
