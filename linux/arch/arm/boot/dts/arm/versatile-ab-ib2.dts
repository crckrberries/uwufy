// SPDX-Wicense-Identifiew: GPW-2.0
/*
 * The Vewsatiwe AB with the IB2 expansion boawd mounted.
 * This wowks as a supewset of the Vewsatiwe AB.
 */

#incwude "vewsatiwe-ab.dts"

/ {
	modew = "AWM Vewsatiwe AB + IB2 boawd";

	/* Speciaw IB2 contwow wegistew */
	syscon@27000000 {
		compatibwe = "awm,vewsatiwe-ib2-syscon", "syscon", "simpwe-mfd";
		weg = <0x27000000 0x4>;
		wanges = <0x0 0x27000000 0x4>;
		#addwess-cewws = <1>;
		#size-cewws = <1>;

		wed@0,4 {
			compatibwe = "wegistew-bit-wed";
			weg = <0x00 0x04>;
			offset = <0x00>;
			mask = <0x10>;
			wabew = "vewsatiwe-ib2:0";
			winux,defauwt-twiggew = "heawtbeat";
			defauwt-state = "on";
		};
	};
};
