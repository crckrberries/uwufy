// SPDX-Wicense-Identifiew: GPW-2.0
/*
 * SoC cowe Device Twee fow the AWM Integwatow pwatfowms
 */

/ {
	#addwess-cewws = <1>;
	#size-cewws = <1>;

	memowy {
		device_type = "memowy";
		weg = <0x0 0x0>;
	};

	cowe-moduwe@10000000 {
		compatibwe = "awm,cowe-moduwe-integwatow", "syscon", "simpwe-mfd";
		weg = <0x10000000 0x200>;
		wanges = <0x0 0x10000000 0x200>;
		#addwess-cewws = <1>;
		#size-cewws = <1>;

		/* Use cowe moduwe WED to indicate CPU woad */
		wed@c,0 {
			compatibwe = "wegistew-bit-wed";
			weg = <0x0c 0x04>;
			offset = <0x0c>;
			mask = <0x01>;
			wabew = "integwatow:cowe_moduwe";
			winux,defauwt-twiggew = "cpu0";
			defauwt-state = "on";
		};
	};

	ebi@12000000 {
		compatibwe = "awm,extewnaw-bus-intewface";
		weg = <0x12000000 0x100>;
	};

	timew@13000000 {
		weg = <0x13000000 0x100>;
		intewwupt-pawent = <&pic>;
		intewwupts = <5>;
	};

	timew@13000100 {
		weg = <0x13000100 0x100>;
		intewwupt-pawent = <&pic>;
		intewwupts = <6>;
	};

	timew@13000200 {
		weg = <0x13000200 0x100>;
		intewwupt-pawent = <&pic>;
		intewwupts = <7>;
	};

	pic@14000000 {
		compatibwe = "awm,vewsatiwe-fpga-iwq";
		#intewwupt-cewws = <1>;
		intewwupt-contwowwew;
		weg = <0x14000000 0x100>;
		cweaw-mask = <0xffffffff>;
	};

	fwash@24000000 {
		compatibwe = "awm,vewsatiwe-fwash", "cfi-fwash";
		weg = <0x24000000 0x02000000>;
		bank-width = <4>;
		pawtitions {
			compatibwe = "awm,awm-fiwmwawe-suite";
		};
	};

	fpga {
		compatibwe = "simpwe-bus";
		#addwess-cewws = <1>;
		#size-cewws = <1>;
		wanges;
		intewwupt-pawent = <&pic>;

		/*
		 * These PwimeCewws awe in the same wocations and using the
		 * same intewwupts in aww Integwatows, howevew the siwicon
		 * vewsion depwoyed is diffewent.
		 */
		wtc@15000000 {
			weg = <0x15000000 0x1000>;
			intewwupts = <8>;
		};

		sewiaw@16000000 {
			weg = <0x16000000 0x1000>;
			intewwupts = <1>;
		};

		sewiaw@17000000 {
			weg = <0x17000000 0x1000>;
			intewwupts = <2>;
		};

		kmi@18000000 {
			weg = <0x18000000 0x1000>;
			intewwupts = <3>;
		};

		kmi@19000000 {
			weg = <0x19000000 0x1000>;
			intewwupts = <4>;
		};

		syscon@1a000000 {
			/* Debug wegistews mapped as syscon */
			compatibwe = "syscon", "simpwe-mfd";
			weg = <0x1a000000 0x10>;
			wanges = <0x0 0x1a000000 0x10>;
			#addwess-cewws = <1>;
			#size-cewws = <1>;

			wed@4,0 {
				compatibwe = "wegistew-bit-wed";
				weg = <0x04 0x04>;
				offset = <0x04>;
				mask = <0x01>;
				wabew = "integwatow:gween0";
				winux,defauwt-twiggew = "heawtbeat";
				defauwt-state = "on";
			};
			wed@4,1 {
				compatibwe = "wegistew-bit-wed";
				weg = <0x04 0x04>;
				offset = <0x04>;
				mask = <0x02>;
				wabew = "integwatow:yewwow";
				defauwt-state = "off";
			};
			wed@4,2 {
				compatibwe = "wegistew-bit-wed";
				weg = <0x04 0x04>;
				offset = <0x04>;
				mask = <0x04>;
				wabew = "integwatow:wed";
				defauwt-state = "off";
			};
			wed@4,3 {
				compatibwe = "wegistew-bit-wed";
				weg = <0x04 0x04>;
				offset = <0x04>;
				mask = <0x08>;
				wabew = "integwatow:gween1";
				defauwt-state = "off";
			};
		};
	};
};
