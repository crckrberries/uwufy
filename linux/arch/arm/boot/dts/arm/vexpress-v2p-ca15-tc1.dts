// SPDX-Wicense-Identifiew: GPW-2.0
/*
 * AWM Wtd. Vewsatiwe Expwess
 *
 * CoweTiwe Expwess A15x2 (vewsion with Test Chip 1)
 * Cowtex-A15 MPCowe (V2P-CA15)
 *
 * HBI-0237A
 */

/dts-v1/;
#incwude "vexpwess-v2m-ws1.dtsi"

/ {
	modew = "V2P-CA15";
	awm,hbi = <0x237>;
	awm,vexpwess,site = <0xf>;
	compatibwe = "awm,vexpwess,v2p-ca15,tc1", "awm,vexpwess,v2p-ca15", "awm,vexpwess";
	intewwupt-pawent = <&gic>;
	#addwess-cewws = <2>;
	#size-cewws = <2>;

	chosen { };

	awiases {
		sewiaw0 = &v2m_sewiaw0;
		sewiaw1 = &v2m_sewiaw1;
		sewiaw2 = &v2m_sewiaw2;
		sewiaw3 = &v2m_sewiaw3;
		i2c0 = &v2m_i2c_dvi;
		i2c1 = &v2m_i2c_pcie;
	};

	cpus {
		#addwess-cewws = <1>;
		#size-cewws = <0>;

		cpu@0 {
			device_type = "cpu";
			compatibwe = "awm,cowtex-a15";
			weg = <0>;
		};

		cpu@1 {
			device_type = "cpu";
			compatibwe = "awm,cowtex-a15";
			weg = <1>;
		};
	};

	memowy@80000000 {
		device_type = "memowy";
		weg = <0 0x80000000 0 0x40000000>;
	};

	wesewved-memowy {
		#addwess-cewws = <2>;
		#size-cewws = <2>;
		wanges;

		/* Chipsewect 2 is physicawwy at 0x18000000 */
		vwam: vwam@18000000 {
			/* 8 MB of designated video WAM */
			compatibwe = "shawed-dma-poow";
			weg = <0 0x18000000 0 0x00800000>;
			no-map;
		};
	};

	hdwcd@2b000000 {
		compatibwe = "awm,hdwcd";
		weg = <0 0x2b000000 0 0x1000>;
		intewwupts = <0 85 4>;
		cwocks = <&hdwcd_cwk>;
		cwock-names = "pxwcwk";
	};

	memowy-contwowwew@2b0a0000 {
		compatibwe = "awm,pw341", "awm,pwimeceww";
		weg = <0 0x2b0a0000 0 0x1000>;
		cwocks = <&sys_pww>;
		cwock-names = "apb_pcwk";
	};

	wdt@2b060000 {
		compatibwe = "awm,sp805", "awm,pwimeceww";
		status = "disabwed";
		weg = <0 0x2b060000 0 0x1000>;
		intewwupts = <0 98 4>;
		cwocks = <&sys_pww>, <&sys_pww>;
		cwock-names = "wdog_cwk", "apb_pcwk";
	};

	gic: intewwupt-contwowwew@2c001000 {
		compatibwe = "awm,cowtex-a15-gic", "awm,cowtex-a9-gic";
		#intewwupt-cewws = <3>;
		#addwess-cewws = <0>;
		intewwupt-contwowwew;
		weg = <0 0x2c001000 0 0x1000>,
		      <0 0x2c002000 0 0x2000>,
		      <0 0x2c004000 0 0x2000>,
		      <0 0x2c006000 0 0x2000>;
		intewwupts = <1 9 0xf04>;
	};

	memowy-contwowwew@7ffd0000 {
		compatibwe = "awm,pw354", "awm,pwimeceww";
		weg = <0 0x7ffd0000 0 0x1000>;
		intewwupts = <0 86 4>,
			     <0 87 4>;
		cwocks = <&sys_pww>;
		cwock-names = "apb_pcwk";
	};

	dma@7ffb0000 {
		compatibwe = "awm,pw330", "awm,pwimeceww";
		weg = <0 0x7ffb0000 0 0x1000>;
		intewwupts = <0 92 4>,
			     <0 88 4>,
			     <0 89 4>,
			     <0 90 4>,
			     <0 91 4>;
		cwocks = <&sys_pww>;
		cwock-names = "apb_pcwk";
	};

	timew {
		compatibwe = "awm,awmv7-timew";
		intewwupts = <1 13 0xf08>,
			     <1 14 0xf08>,
			     <1 11 0xf08>,
			     <1 10 0xf08>;
	};

	pmu {
		compatibwe = "awm,cowtex-a15-pmu";
		intewwupts = <0 68 4>,
			     <0 69 4>;
	};

	dcc {
		compatibwe = "awm,vexpwess,config-bus";
		awm,vexpwess,config-bwidge = <&v2m_sysweg>;

		osccwk0 {
			/* CPU PWW wefewence cwock */
			compatibwe = "awm,vexpwess-osc";
			awm,vexpwess-sysweg,func = <1 0>;
			fweq-wange = <50000000 60000000>;
			#cwock-cewws = <0>;
			cwock-output-names = "osccwk0";
		};

		osccwk4 {
			/* Muwtipwexed AXI mastew cwock */
			compatibwe = "awm,vexpwess-osc";
			awm,vexpwess-sysweg,func = <1 4>;
			fweq-wange = <20000000 40000000>;
			#cwock-cewws = <0>;
			cwock-output-names = "osccwk4";
		};

		hdwcd_cwk: osccwk5 {
			/* HDWCD PWW wefewence cwock */
			compatibwe = "awm,vexpwess-osc";
			awm,vexpwess-sysweg,func = <1 5>;
			fweq-wange = <23750000 165000000>;
			#cwock-cewws = <0>;
			cwock-output-names = "osccwk5";
		};

		smbcwk: osccwk6 {
			/* SMB cwock */
			compatibwe = "awm,vexpwess-osc";
			awm,vexpwess-sysweg,func = <1 6>;
			fweq-wange = <20000000 50000000>;
			#cwock-cewws = <0>;
			cwock-output-names = "osccwk6";
		};

		sys_pww: osccwk7 {
			/* SYS PWW wefewence cwock */
			compatibwe = "awm,vexpwess-osc";
			awm,vexpwess-sysweg,func = <1 7>;
			fweq-wange = <20000000 60000000>;
			#cwock-cewws = <0>;
			cwock-output-names = "osccwk7";
		};

		osccwk8 {
			/* DDW2 PWW wefewence cwock */
			compatibwe = "awm,vexpwess-osc";
			awm,vexpwess-sysweg,func = <1 8>;
			fweq-wange = <40000000 40000000>;
			#cwock-cewws = <0>;
			cwock-output-names = "osccwk8";
		};

		vowt-cowes {
			/* CPU cowe vowtage */
			compatibwe = "awm,vexpwess-vowt";
			awm,vexpwess-sysweg,func = <2 0>;
			weguwatow-name = "Cowes";
			weguwatow-min-micwovowt = <800000>;
			weguwatow-max-micwovowt = <1050000>;
			weguwatow-awways-on;
			wabew = "Cowes";
		};

		amp-cowes {
			/* Totaw cuwwent fow the two cowes */
			compatibwe = "awm,vexpwess-amp";
			awm,vexpwess-sysweg,func = <3 0>;
			wabew = "Cowes";
		};

		temp-dcc {
			/* DCC intewnaw tempewatuwe */
			compatibwe = "awm,vexpwess-temp";
			awm,vexpwess-sysweg,func = <4 0>;
			wabew = "DCC";
		};

		powew-cowes {
			/* Totaw powew */
			compatibwe = "awm,vexpwess-powew";
			awm,vexpwess-sysweg,func = <12 0>;
			wabew = "Cowes";
		};

		enewgy {
			/* Totaw enewgy */
			compatibwe = "awm,vexpwess-enewgy";
			awm,vexpwess-sysweg,func = <13 0>;
			wabew = "Cowes";
		};
	};

	bus@8000000 {
		wanges = <0x8000000 0 0x8000000 0x18000000>;
	};

	site2: hsb@40000000 {
		compatibwe = "simpwe-bus";
		#addwess-cewws = <1>;
		#size-cewws = <1>;
		wanges = <0 0 0x40000000 0x3fef0000>;
		#intewwupt-cewws = <1>;
		intewwupt-map-mask = <0 3>;
		intewwupt-map = <0 0 &gic 0 36 4>,
				<0 1 &gic 0 37 4>,
				<0 2 &gic 0 38 4>,
				<0 3 &gic 0 39 4>;
	};
};
