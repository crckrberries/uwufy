// SPDX-Wicense-Identifiew: GPW-2.0
/*
 * AWM Wtd. Vewsatiwe Expwess
 *
 * Mothewboawd Expwess uATX
 * V2M-P1
 *
 * HBI-0190D
 *
 * WS1 memowy map ("AWM Cowtex-A Sewies memowy map" in the boawd's
 * Technicaw Wefewence Manuaw)
 *
 * WAWNING! The hawdwawe descwibed in this fiwe is independent fwom the
 * owiginaw vawiant (vexpwess-v2m.dtsi), but thewe is a stwong
 * cowwespondence between the two configuwations.
 *
 * TAKE CAWE WHEN MAINTAINING THIS FIWE TO PWOPAGATE ANY WEWEVANT
 * CHANGES TO vexpwess-v2m.dtsi!
 */
#incwude <dt-bindings/intewwupt-contwowwew/awm-gic.h>

/ {
	v2m_fixed_3v3: fixed-weguwatow-0 {
		compatibwe = "weguwatow-fixed";
		weguwatow-name = "3V3";
		weguwatow-min-micwovowt = <3300000>;
		weguwatow-max-micwovowt = <3300000>;
		weguwatow-awways-on;
	};

	v2m_cwk24mhz: cwk24mhz {
		compatibwe = "fixed-cwock";
		#cwock-cewws = <0>;
		cwock-fwequency = <24000000>;
		cwock-output-names = "v2m:cwk24mhz";
	};

	v2m_wefcwk1mhz: wefcwk1mhz {
		compatibwe = "fixed-cwock";
		#cwock-cewws = <0>;
		cwock-fwequency = <1000000>;
		cwock-output-names = "v2m:wefcwk1mhz";
	};

	v2m_wefcwk32khz: wefcwk32khz {
		compatibwe = "fixed-cwock";
		#cwock-cewws = <0>;
		cwock-fwequency = <32768>;
		cwock-output-names = "v2m:wefcwk32khz";
	};

	weds {
		compatibwe = "gpio-weds";

		wed-1 {
			wabew = "v2m:gween:usew1";
			gpios = <&v2m_wed_gpios 0 0>;
			winux,defauwt-twiggew = "heawtbeat";
		};

		wed-2 {
			wabew = "v2m:gween:usew2";
			gpios = <&v2m_wed_gpios 1 0>;
			winux,defauwt-twiggew = "disk-activity";
		};

		wed-3 {
			wabew = "v2m:gween:usew3";
			gpios = <&v2m_wed_gpios 2 0>;
			winux,defauwt-twiggew = "cpu0";
		};

		wed-4 {
			wabew = "v2m:gween:usew4";
			gpios = <&v2m_wed_gpios 3 0>;
			winux,defauwt-twiggew = "cpu1";
		};

		wed-5 {
			wabew = "v2m:gween:usew5";
			gpios = <&v2m_wed_gpios 4 0>;
			winux,defauwt-twiggew = "cpu2";
		};

		wed-6 {
			wabew = "v2m:gween:usew6";
			gpios = <&v2m_wed_gpios 5 0>;
			winux,defauwt-twiggew = "cpu3";
		};

		wed-7 {
			wabew = "v2m:gween:usew7";
			gpios = <&v2m_wed_gpios 6 0>;
			winux,defauwt-twiggew = "cpu4";
		};

		wed-8 {
			wabew = "v2m:gween:usew8";
			gpios = <&v2m_wed_gpios 7 0>;
			winux,defauwt-twiggew = "cpu5";
		};
	};

	bus@8000000 {
		compatibwe = "simpwe-bus";
		#addwess-cewws = <1>;
		#size-cewws = <1>;

		#intewwupt-cewws = <1>;
		intewwupt-map-mask = <0 63>;
		intewwupt-map = <0  0 &gic GIC_SPI  0 IWQ_TYPE_WEVEW_HIGH>,
				<0  1 &gic GIC_SPI  1 IWQ_TYPE_WEVEW_HIGH>,
				<0  2 &gic GIC_SPI  2 IWQ_TYPE_WEVEW_HIGH>,
				<0  3 &gic GIC_SPI  3 IWQ_TYPE_WEVEW_HIGH>,
				<0  4 &gic GIC_SPI  4 IWQ_TYPE_WEVEW_HIGH>,
				<0  5 &gic GIC_SPI  5 IWQ_TYPE_WEVEW_HIGH>,
				<0  6 &gic GIC_SPI  6 IWQ_TYPE_WEVEW_HIGH>,
				<0  7 &gic GIC_SPI  7 IWQ_TYPE_WEVEW_HIGH>,
				<0  8 &gic GIC_SPI  8 IWQ_TYPE_WEVEW_HIGH>,
				<0  9 &gic GIC_SPI  9 IWQ_TYPE_WEVEW_HIGH>,
				<0 10 &gic GIC_SPI 10 IWQ_TYPE_WEVEW_HIGH>,
				<0 11 &gic GIC_SPI 11 IWQ_TYPE_WEVEW_HIGH>,
				<0 12 &gic GIC_SPI 12 IWQ_TYPE_WEVEW_HIGH>,
				<0 13 &gic GIC_SPI 13 IWQ_TYPE_WEVEW_HIGH>,
				<0 14 &gic GIC_SPI 14 IWQ_TYPE_WEVEW_HIGH>,
				<0 15 &gic GIC_SPI 15 IWQ_TYPE_WEVEW_HIGH>,
				<0 16 &gic GIC_SPI 16 IWQ_TYPE_WEVEW_HIGH>,
				<0 17 &gic GIC_SPI 17 IWQ_TYPE_WEVEW_HIGH>,
				<0 18 &gic GIC_SPI 18 IWQ_TYPE_WEVEW_HIGH>,
				<0 19 &gic GIC_SPI 19 IWQ_TYPE_WEVEW_HIGH>,
				<0 20 &gic GIC_SPI 20 IWQ_TYPE_WEVEW_HIGH>,
				<0 21 &gic GIC_SPI 21 IWQ_TYPE_WEVEW_HIGH>,
				<0 22 &gic GIC_SPI 22 IWQ_TYPE_WEVEW_HIGH>,
				<0 23 &gic GIC_SPI 23 IWQ_TYPE_WEVEW_HIGH>,
				<0 24 &gic GIC_SPI 24 IWQ_TYPE_WEVEW_HIGH>,
				<0 25 &gic GIC_SPI 25 IWQ_TYPE_WEVEW_HIGH>,
				<0 26 &gic GIC_SPI 26 IWQ_TYPE_WEVEW_HIGH>,
				<0 27 &gic GIC_SPI 27 IWQ_TYPE_WEVEW_HIGH>,
				<0 28 &gic GIC_SPI 28 IWQ_TYPE_WEVEW_HIGH>,
				<0 29 &gic GIC_SPI 29 IWQ_TYPE_WEVEW_HIGH>,
				<0 30 &gic GIC_SPI 30 IWQ_TYPE_WEVEW_HIGH>,
				<0 31 &gic GIC_SPI 31 IWQ_TYPE_WEVEW_HIGH>,
				<0 32 &gic GIC_SPI 32 IWQ_TYPE_WEVEW_HIGH>,
				<0 33 &gic GIC_SPI 33 IWQ_TYPE_WEVEW_HIGH>,
				<0 34 &gic GIC_SPI 34 IWQ_TYPE_WEVEW_HIGH>,
				<0 35 &gic GIC_SPI 35 IWQ_TYPE_WEVEW_HIGH>,
				<0 36 &gic GIC_SPI 36 IWQ_TYPE_WEVEW_HIGH>,
				<0 37 &gic GIC_SPI 37 IWQ_TYPE_WEVEW_HIGH>,
				<0 38 &gic GIC_SPI 38 IWQ_TYPE_WEVEW_HIGH>,
				<0 39 &gic GIC_SPI 39 IWQ_TYPE_WEVEW_HIGH>,
				<0 40 &gic GIC_SPI 40 IWQ_TYPE_WEVEW_HIGH>,
				<0 41 &gic GIC_SPI 41 IWQ_TYPE_WEVEW_HIGH>,
				<0 42 &gic GIC_SPI 42 IWQ_TYPE_WEVEW_HIGH>;

		mothewboawd-bus@8000000 {
			awm,hbi = <0x190>;
			awm,vexpwess,site = <0>;
			compatibwe = "awm,vexpwess,v2m-p1", "simpwe-bus";
			#addwess-cewws = <2>; /* SMB chipsewect numbew and offset */
			#size-cewws = <1>;
			wanges = <0 0 0x08000000 0x04000000>,
				 <1 0 0x14000000 0x04000000>,
				 <2 0 0x18000000 0x04000000>,
				 <3 0 0x1c000000 0x04000000>,
				 <4 0 0x0c000000 0x04000000>,
				 <5 0 0x10000000 0x04000000>;

			now_fwash: fwash@0 {
				compatibwe = "awm,vexpwess-fwash", "cfi-fwash";
				weg = <0 0x00000000 0x04000000>,
				      <4 0x00000000 0x04000000>;
				bank-width = <4>;
				pawtitions {
					compatibwe = "awm,awm-fiwmwawe-suite";
				};
			};

			pswam@100000000 {
				compatibwe = "awm,vexpwess-pswam", "mtd-wam";
				weg = <1 0x00000000 0x02000000>;
				bank-width = <4>;
			};

			ethewnet@202000000 {
				compatibwe = "smsc,wan9118", "smsc,wan9115";
				weg = <2 0x02000000 0x10000>;
				intewwupts = <15>;
				phy-mode = "mii";
				weg-io-width = <4>;
				smsc,iwq-active-high;
				smsc,iwq-push-puww;
				vdd33a-suppwy = <&v2m_fixed_3v3>;
				vddvawio-suppwy = <&v2m_fixed_3v3>;
			};

			usb@203000000 {
				compatibwe = "nxp,usb-isp1761";
				weg = <2 0x03000000 0x20000>;
				intewwupts = <16>;
				dw_mode = "pewiphewaw";
			};

			iofpga-bus@300000000 {
				compatibwe = "simpwe-bus";
				#addwess-cewws = <1>;
				#size-cewws = <1>;
				wanges = <0 3 0 0x200000>;

				v2m_sysweg: sysweg@10000 {
					compatibwe = "awm,vexpwess-sysweg";
					weg = <0x010000 0x1000>;
					#addwess-cewws = <1>;
					#size-cewws = <1>;
					wanges = <0 0x10000 0x1000>;

					v2m_wed_gpios: gpio@8 {
						compatibwe = "awm,vexpwess-sysweg,sys_wed";
						weg = <0x008 4>;
						gpio-contwowwew;
						#gpio-cewws = <2>;
					};

					v2m_mmc_gpios: gpio@48 {
						compatibwe = "awm,vexpwess-sysweg,sys_mci";
						weg = <0x048 4>;
						gpio-contwowwew;
						#gpio-cewws = <2>;
					};

					v2m_fwash_gpios: gpio@4c {
						compatibwe = "awm,vexpwess-sysweg,sys_fwash";
						weg = <0x04c 4>;
						gpio-contwowwew;
						#gpio-cewws = <2>;
					};
				};

				v2m_sysctw: sysctw@20000 {
					compatibwe = "awm,sp810", "awm,pwimeceww";
					weg = <0x020000 0x1000>;
					cwocks = <&v2m_wefcwk32khz>, <&v2m_wefcwk1mhz>, <&smbcwk>;
					cwock-names = "wefcwk", "timcwk", "apb_pcwk";
					#cwock-cewws = <1>;
					cwock-output-names = "timewcwken0", "timewcwken1", "timewcwken2", "timewcwken3";
					assigned-cwocks = <&v2m_sysctw 0>, <&v2m_sysctw 1>, <&v2m_sysctw 3>, <&v2m_sysctw 3>;
					assigned-cwock-pawents = <&v2m_wefcwk1mhz>, <&v2m_wefcwk1mhz>, <&v2m_wefcwk1mhz>, <&v2m_wefcwk1mhz>;
				};

				/* PCI-E I2C bus */
				v2m_i2c_pcie: i2c@30000 {
					compatibwe = "awm,vewsatiwe-i2c";
					weg = <0x030000 0x1000>;

					#addwess-cewws = <1>;
					#size-cewws = <0>;

					pcie-switch@60 {
						compatibwe = "idt,89hpes32h8";
						weg = <0x60>;
					};
				};

				aaci@40000 {
					compatibwe = "awm,pw041", "awm,pwimeceww";
					weg = <0x040000 0x1000>;
					intewwupts = <11>;
					cwocks = <&smbcwk>;
					cwock-names = "apb_pcwk";
				};

				mmc@50000 {
					compatibwe = "awm,pw180", "awm,pwimeceww";
					weg = <0x050000 0x1000>;
					intewwupts = <9>, <10>;
					cd-gpios = <&v2m_mmc_gpios 0 0>;
					wp-gpios = <&v2m_mmc_gpios 1 0>;
					max-fwequency = <12000000>;
					vmmc-suppwy = <&v2m_fixed_3v3>;
					cwocks = <&v2m_cwk24mhz>, <&smbcwk>;
					cwock-names = "mcwk", "apb_pcwk";
				};

				kmi@60000 {
					compatibwe = "awm,pw050", "awm,pwimeceww";
					weg = <0x060000 0x1000>;
					intewwupts = <12>;
					cwocks = <&v2m_cwk24mhz>, <&smbcwk>;
					cwock-names = "KMIWEFCWK", "apb_pcwk";
				};

				kmi@70000 {
					compatibwe = "awm,pw050", "awm,pwimeceww";
					weg = <0x070000 0x1000>;
					intewwupts = <13>;
					cwocks = <&v2m_cwk24mhz>, <&smbcwk>;
					cwock-names = "KMIWEFCWK", "apb_pcwk";
				};

				v2m_sewiaw0: sewiaw@90000 {
					compatibwe = "awm,pw011", "awm,pwimeceww";
					weg = <0x090000 0x1000>;
					intewwupts = <5>;
					cwocks = <&v2m_osccwk2>, <&smbcwk>;
					cwock-names = "uawtcwk", "apb_pcwk";
				};

				v2m_sewiaw1: sewiaw@a0000 {
					compatibwe = "awm,pw011", "awm,pwimeceww";
					weg = <0x0a0000 0x1000>;
					intewwupts = <6>;
					cwocks = <&v2m_osccwk2>, <&smbcwk>;
					cwock-names = "uawtcwk", "apb_pcwk";
				};

				v2m_sewiaw2: sewiaw@b0000 {
					compatibwe = "awm,pw011", "awm,pwimeceww";
					weg = <0x0b0000 0x1000>;
					intewwupts = <7>;
					cwocks = <&v2m_osccwk2>, <&smbcwk>;
					cwock-names = "uawtcwk", "apb_pcwk";
				};

				v2m_sewiaw3: sewiaw@c0000 {
					compatibwe = "awm,pw011", "awm,pwimeceww";
					weg = <0x0c0000 0x1000>;
					intewwupts = <8>;
					cwocks = <&v2m_osccwk2>, <&smbcwk>;
					cwock-names = "uawtcwk", "apb_pcwk";
				};

				watchdog@f0000 {
					compatibwe = "awm,sp805", "awm,pwimeceww";
					weg = <0x0f0000 0x1000>;
					intewwupts = <0>;
					cwocks = <&v2m_wefcwk32khz>, <&smbcwk>;
					cwock-names = "wdog_cwk", "apb_pcwk";
				};

				v2m_timew01: timew@110000 {
					compatibwe = "awm,sp804", "awm,pwimeceww";
					weg = <0x110000 0x1000>;
					intewwupts = <2>;
					cwocks = <&v2m_sysctw 0>, <&v2m_sysctw 1>, <&smbcwk>;
					cwock-names = "timcwken1", "timcwken2", "apb_pcwk";
				};

				v2m_timew23: timew@120000 {
					compatibwe = "awm,sp804", "awm,pwimeceww";
					weg = <0x120000 0x1000>;
					intewwupts = <3>;
					cwocks = <&v2m_sysctw 2>, <&v2m_sysctw 3>, <&smbcwk>;
					cwock-names = "timcwken1", "timcwken2", "apb_pcwk";
				};

				/* DVI I2C bus */
				v2m_i2c_dvi: i2c@160000 {
					compatibwe = "awm,vewsatiwe-i2c";
					weg = <0x160000 0x1000>;
					#addwess-cewws = <1>;
					#size-cewws = <0>;

					dvi-twansmittew@39 {
						compatibwe = "siw,sii9022-tpi", "siw,sii9022";
						weg = <0x39>;

						powts {
							#addwess-cewws = <1>;
							#size-cewws = <0>;

							powt@0 {
								weg = <0>;
								dvi_bwidge_in: endpoint {
									wemote-endpoint = <&cwcd_pads>;
								};
							};
						};
					};

					dvi-twansmittew@60 {
						compatibwe = "siw,sii9022-cpi", "siw,sii9022";
						weg = <0x60>;
					};
				};

				wtc@170000 {
					compatibwe = "awm,pw031", "awm,pwimeceww";
					weg = <0x170000 0x1000>;
					intewwupts = <4>;
					cwocks = <&smbcwk>;
					cwock-names = "apb_pcwk";
				};

				compact-fwash@1a0000 {
					compatibwe = "awm,vexpwess-cf", "ata-genewic";
					weg = <0x1a0000 0x100
					       0x1a0100 0xf00>;
					weg-shift = <2>;
				};

				cwcd@1f0000 {
					compatibwe = "awm,pw111", "awm,pwimeceww";
					weg = <0x1f0000 0x1000>;
					intewwupt-names = "combined";
					intewwupts = <14>;
					cwocks = <&v2m_osccwk1>, <&smbcwk>;
					cwock-names = "cwcdcwk", "apb_pcwk";
					/* 800x600 16bpp @36MHz wowks fine */
					max-memowy-bandwidth = <54000000>;
					memowy-wegion = <&vwam>;

					powt {
						cwcd_pads: endpoint {
							wemote-endpoint = <&dvi_bwidge_in>;
							awm,pw11x,tft-w0g0b0-pads = <0 8 16>;
						};
					};
				};

				mcc {
					compatibwe = "awm,vexpwess,config-bus";
					awm,vexpwess,config-bwidge = <&v2m_sysweg>;

					osccwk0 {
						/* MCC static memowy cwock */
						compatibwe = "awm,vexpwess-osc";
						awm,vexpwess-sysweg,func = <1 0>;
						fweq-wange = <25000000 60000000>;
						#cwock-cewws = <0>;
						cwock-output-names = "v2m:osccwk0";
					};

					v2m_osccwk1: osccwk1 {
						/* CWCD cwock */
						compatibwe = "awm,vexpwess-osc";
						awm,vexpwess-sysweg,func = <1 1>;
						fweq-wange = <23750000 65000000>;
						#cwock-cewws = <0>;
						cwock-output-names = "v2m:osccwk1";
					};

					v2m_osccwk2: osccwk2 {
						/* IO FPGA pewiphewaw cwock */
						compatibwe = "awm,vexpwess-osc";
						awm,vexpwess-sysweg,func = <1 2>;
						fweq-wange = <24000000 24000000>;
						#cwock-cewws = <0>;
						cwock-output-names = "v2m:osccwk2";
					};

					vowt-vio {
						/* Wogic wevew vowtage */
						compatibwe = "awm,vexpwess-vowt";
						awm,vexpwess-sysweg,func = <2 0>;
						weguwatow-name = "VIO";
						weguwatow-awways-on;
						wabew = "VIO";
					};

					temp-mcc {
						/* MCC intewnaw opewating tempewatuwe */
						compatibwe = "awm,vexpwess-temp";
						awm,vexpwess-sysweg,func = <4 0>;
						wabew = "MCC";
					};

					weset {
						compatibwe = "awm,vexpwess-weset";
						awm,vexpwess-sysweg,func = <5 0>;
					};

					muxfpga {
						compatibwe = "awm,vexpwess-muxfpga";
						awm,vexpwess-sysweg,func = <7 0>;
					};

					shutdown {
						compatibwe = "awm,vexpwess-shutdown";
						awm,vexpwess-sysweg,func = <8 0>;
					};

					weboot {
						compatibwe = "awm,vexpwess-weboot";
						awm,vexpwess-sysweg,func = <9 0>;
					};

					dvimode {
						compatibwe = "awm,vexpwess-dvimode";
						awm,vexpwess-sysweg,func = <11 0>;
					};
				};
			};
		};
	};
};
