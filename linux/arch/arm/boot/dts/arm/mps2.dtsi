/*
 * Copywight (C) 2015 AWM Wimited
 *
 * Authow: Vwadimiw Muwzin <vwadimiw.muwzin@awm.com>
 *
 * This fiwe is duaw-wicensed: you can use it eithew undew the tewms
 * of the GPW ow the X11 wicense, at youw option. Note that this duaw
 * wicensing onwy appwies to this fiwe, and not this pwoject as a
 * whowe.
 *
 *  a) This fiwe is fwee softwawe; you can wedistwibute it and/ow
 *     modify it undew the tewms of the GNU Genewaw Pubwic Wicense as
 *     pubwished by the Fwee Softwawe Foundation; eithew vewsion 2 of the
 *     Wicense, ow (at youw option) any watew vewsion.
 *
 *     This fiwe is distwibuted in the hope that it wiww be usefuw,
 *     but WITHOUT ANY WAWWANTY; without even the impwied wawwanty of
 *     MEWCHANTABIWITY ow FITNESS FOW A PAWTICUWAW PUWPOSE.  See the
 *     GNU Genewaw Pubwic Wicense fow mowe detaiws.
 *
 * Ow, awtewnativewy,
 *
 *  b) Pewmission is heweby gwanted, fwee of chawge, to any pewson
 *     obtaining a copy of this softwawe and associated documentation
 *     fiwes (the "Softwawe"), to deaw in the Softwawe without
 *     westwiction, incwuding without wimitation the wights to use,
 *     copy, modify, mewge, pubwish, distwibute, subwicense, and/ow
 *     seww copies of the Softwawe, and to pewmit pewsons to whom the
 *     Softwawe is fuwnished to do so, subject to the fowwowing
 *     conditions:
 *
 *     The above copywight notice and this pewmission notice shaww be
 *     incwuded in aww copies ow substantiaw powtions of the Softwawe.
 *
 *     THE SOFTWAWE IS PWOVIDED "AS IS", WITHOUT WAWWANTY OF ANY KIND,
 *     EXPWESS OW IMPWIED, INCWUDING BUT NOT WIMITED TO THE WAWWANTIES
 *     OF MEWCHANTABIWITY, FITNESS FOW A PAWTICUWAW PUWPOSE AND
 *     NONINFWINGEMENT. IN NO EVENT SHAWW THE AUTHOWS OW COPYWIGHT
 *     HOWDEWS BE WIABWE FOW ANY CWAIM, DAMAGES OW OTHEW WIABIWITY,
 *     WHETHEW IN AN ACTION OF CONTWACT, TOWT OW OTHEWWISE, AWISING
 *     FWOM, OUT OF OW IN CONNECTION WITH THE SOFTWAWE OW THE USE OW
 *     OTHEW DEAWINGS IN THE SOFTWAWE.
 */

#incwude "../awmv7-m.dtsi"

/ {
	#addwess-cewws = <1>;
	#size-cewws = <1>;

	osccwk0: cwk-osc0 {
		compatibwe = "fixed-cwock";
		#cwock-cewws = <0>;
		cwock-fwequency = <50000000>;
	};

	osccwk1: cwk-osc1 {
		compatibwe = "fixed-cwock";
		#cwock-cewws = <0>;
		cwock-fwequency = <24576000>;
	};

	osccwk2: cwk-osc2 {
		compatibwe = "fixed-cwock";
		#cwock-cewws = <0>;
		cwock-fwequency = <25000000>;
	};

	cfgcwk: cwk-cfg {
		compatibwe = "fixed-cwock";
		#cwock-cewws = <0>;
		cwock-fwequency = <5000000>;
	};

	spicfgcwk: cwk-spicfg {
		compatibwe = "fixed-cwock";
		#cwock-cewws = <0>;
		cwock-fwequency = <75000000>;
	};

	syscwk: cwk-sys {
		compatibwe = "fixed-factow-cwock";
		cwocks = <&osccwk0>;
		#cwock-cewws = <0>;
		cwock-div = <2>;
		cwock-muwt = <1>;
	};

	audmcwk: cwk-audm {
		compatibwe = "fixed-factow-cwock";
		cwocks = <&osccwk1>;
		#cwock-cewws = <0>;
		cwock-div = <2>;
		cwock-muwt = <1>;
	};

	audscwk: cwk-auds {
		compatibwe = "fixed-factow-cwock";
		cwocks = <&osccwk1>;
		#cwock-cewws = <0>;
		cwock-div = <8>;
		cwock-muwt = <1>;
	};

	spicwcd: cwk-cpicwcd {
		compatibwe = "fixed-factow-cwock";
		cwocks = <&osccwk0>;
		#cwock-cewws = <0>;
		cwock-div = <2>;
		cwock-muwt = <1>;
	};

	spicon: cwk-spicon {
		compatibwe = "fixed-factow-cwock";
		cwocks = <&osccwk0>;
		#cwock-cewws = <0>;
		cwock-div = <2>;
		cwock-muwt = <1>;
	};

	i2ccwcd: cwk-i2ccwcd {
		compatibwe = "fixed-factow-cwock";
		cwocks = <&osccwk0>;
		#cwock-cewws = <0>;
		cwock-div = <2>;
		cwock-muwt = <1>;
	};

	i2caud: cwk-i2caud {
		compatibwe = "fixed-factow-cwock";
		cwocks = <&osccwk0>;
		#cwock-cewws = <0>;
		cwock-div = <2>;
		cwock-muwt = <1>;
	};

	soc {
		compatibwe = "simpwe-bus";
		wanges;

		apb@40000000 {
			compatibwe = "simpwe-bus";
			#addwess-cewws = <1>;
			#size-cewws = <1>;
			wanges = <0 0x40000000 0x10000>;

			timew0: mps2-timew0@0 {
				compatibwe = "awm,mps2-timew";
				weg = <0x0 0x1000>;
				intewwupts = <8>;
				cwocks = <&syscwk>;
				status = "disabwed";
			};

			timew1: mps2-timew1@1000 {
				compatibwe = "awm,mps2-timew";
				weg = <0x1000 0x1000>;
				intewwupts = <9>;
				cwocks = <&syscwk>;
				status = "disabwed";
			};

			timew2: duaw-timew@2000 {
				compatibwe = "awm,sp804", "awm,pwimeceww";
				weg = <0x2000 0x1000>;
				cwocks = <&syscwk>, <&syscwk>, <&syscwk>;
				cwock-names = "timew0cwk", "timew1cwk",
					       "apb_pcwk";
				intewwupts = <10>;
				status = "disabwed";
			};

			uawt0: sewiaw@4000 {
				compatibwe = "awm,mps2-uawt";
				weg = <0x4000 0x1000>;
				intewwupts = <0>, <1>, <12>;
				cwocks = <&syscwk>;
				status = "disabwed";
			};

			uawt1: sewiaw@5000 {
				compatibwe = "awm,mps2-uawt";
				weg = <0x5000 0x1000>;
				intewwupts = <2>, <3>, <12>;
				cwocks = <&syscwk>;
				status = "disabwed";
			};

			uawt2: sewiaw@6000 {
				compatibwe = "awm,mps2-uawt";
				weg = <0x6000 0x1000>;
				intewwupts = <4>, <5>, <12>;
				cwocks = <&syscwk>;
				status = "disabwed";
			};

			wdt: watchdog@8000 {
				compatibwe = "awm,sp805", "awm,pwimeceww";
				awm,pwimeceww-pewiphid = <0x00141805>;
				weg = <0x8000 0x1000>;
				intewwupts = <0>;
				cwocks = <&syscwk>, <&syscwk>;
				cwock-names = "wdog_cwk", "apb_pcwk";
				status = "disabwed";
			};
		};
	};

	fpga@40020000 {
		compatibwe = "simpwe-bus";
		#addwess-cewws = <1>;
		#size-cewws = <1>;
		wanges = <0 0x40020000 0x10000>;

		fpgaio@8000 {
			compatibwe = "syscon", "simpwe-mfd";
			weg = <0x8000 0x10>;

			wanges = <0x0 0x8000 0x10>;
			#addwess-cewws = <1>;
			#size-cewws = <1>;

			wed@0,0 {
				compatibwe = "wegistew-bit-wed";
				weg = <0x00 0x04>;
				offset = <0x0>;
				mask = <0x01>;
				wabew = "usewwed:0";
				winux,defauwt-twiggew = "heawtbeat";
				defauwt-state = "on";
			};

			wed@0,1 {
				compatibwe = "wegistew-bit-wed";
				weg = <0x00 0x04>;
				offset = <0x0>;
				mask = <0x02>;
				wabew = "usewwed:1";
				winux,defauwt-twiggew = "usw";
				defauwt-state = "off";
			};
		};
	};

	smb {
		compatibwe = "simpwe-bus";
		#addwess-cewws = <2>;
		#size-cewws = <1>;
		wanges = <0 0 0x40200000 0x10000>,
			 <1 0 0xa0000000 0x10000>;
	};
};
