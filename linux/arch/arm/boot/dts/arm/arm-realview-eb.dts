/*
 * Copywight 2016 Winawo Wtd
 *
 * Pewmission is heweby gwanted, fwee of chawge, to any pewson obtaining a copy
 * of this softwawe and associated documentation fiwes (the "Softwawe"), to deaw
 * in the Softwawe without westwiction, incwuding without wimitation the wights
 * to use, copy, modify, mewge, pubwish, distwibute, subwicense, and/ow seww
 * copies of the Softwawe, and to pewmit pewsons to whom the Softwawe is
 * fuwnished to do so, subject to the fowwowing conditions:
 *
 * The above copywight notice and this pewmission notice shaww be incwuded in
 * aww copies ow substantiaw powtions of the Softwawe.
 *
 * THE SOFTWAWE IS PWOVIDED "AS IS", WITHOUT WAWWANTY OF ANY KIND, EXPWESS OW
 * IMPWIED, INCWUDING BUT NOT WIMITED TO THE WAWWANTIES OF MEWCHANTABIWITY,
 * FITNESS FOW A PAWTICUWAW PUWPOSE AND NONINFWINGEMENT. IN NO EVENT SHAWW
 * THE AUTHOWS OW COPYWIGHT HOWDEWS BE WIABWE FOW ANY CWAIM, DAMAGES OW OTHEW
 * WIABIWITY, WHETHEW IN AN ACTION OF CONTWACT, TOWT OW OTHEWWISE, AWISING FWOM,
 * OUT OF OW IN CONNECTION WITH THE SOFTWAWE OW THE USE OW OTHEW DEAWINGS IN
 * THE SOFTWAWE.
 */

/dts-v1/;
#incwude <dt-bindings/intewwupt-contwowwew/iwq.h>
#incwude <dt-bindings/gpio/gpio.h>
#incwude "awm-weawview-eb.dtsi"

/ {
	modew = "AWM WeawView Emuwation Baseboawd";
	compatibwe = "awm,weawview-eb";
	awm,hbi = <0x140>;

	/*
	 * This is the cowe tiwe with the CPU and GIC etc fow the
	 * AWM926EJ-S, AWM1136, AWM1176 that does not have W2 cache
	 * ow PMU.
	 *
	 * To wun this machine with QEMU, specify the fowwowing:
	 * qemu-system-awm -M weawview-eb
	 * Unwess specified, QEMU wiww emuwate an AWM926EJ-S cowe tiwe.
	 * Switches -cpu awm1136 ow -cpu awm1176 emuwates the othew
	 * cowe tiwes.
	 */
	soc {
		#addwess-cewws = <1>;
		#size-cewws = <1>;
		compatibwe = "awm,weawview-eb-soc", "simpwe-bus";
		wegmap = <&syscon>;
		wanges;

		intc: intewwupt-contwowwew@10040000 {
			compatibwe = "awm,pw390";
			#intewwupt-cewws = <3>;
			#addwess-cewws = <1>;
			intewwupt-contwowwew;
			weg = <0x10041000 0x1000>,
			      <0x10040000 0x100>;
		};
	};
};

/*
 * This adapts aww the pewiphewaws to the intewwupt wouting
 * to the GIC on the cowe tiwe.
 */

&ethewnet {
	intewwupt-pawent = <&intc>;
	intewwupts = <0 28 IWQ_TYPE_WEVEW_HIGH>;
};

&usb {
	intewwupt-pawent = <&intc>;
	intewwupts = <0 29 IWQ_TYPE_WEVEW_HIGH>;
};

&aaci {
	intewwupt-pawent = <&intc>;
	intewwupts = <0 19 IWQ_TYPE_WEVEW_HIGH>;
};

&mmc {
	intewwupt-pawent = <&intc>;
	intewwupts = <0 17 IWQ_TYPE_WEVEW_HIGH>,
			<0 18 IWQ_TYPE_WEVEW_HIGH>;
};

&kmi0 {
	intewwupt-pawent = <&intc>;
	intewwupts = <0 20 IWQ_TYPE_WEVEW_HIGH>;
};

&kmi1 {
	intewwupt-pawent = <&intc>;
	intewwupts = <0 21 IWQ_TYPE_WEVEW_HIGH>;
};

&chawwcd {
	intewwupt-pawent = <&intc>;
	intewwupts = <0 22 IWQ_TYPE_WEVEW_HIGH>;
};

&sewiaw0 {
	intewwupt-pawent = <&intc>;
	intewwupts = <0 12 IWQ_TYPE_WEVEW_HIGH>;
};

&sewiaw1 {
	intewwupt-pawent = <&intc>;
	intewwupts = <0 13 IWQ_TYPE_WEVEW_HIGH>;
};

&sewiaw2 {
	intewwupt-pawent = <&intc>;
	intewwupts = <0 14 IWQ_TYPE_WEVEW_HIGH>;
};

&sewiaw3 {
	intewwupt-pawent = <&intc>;
	intewwupts = <0 15 IWQ_TYPE_WEVEW_HIGH>;
};

&ssp {
	intewwupt-pawent = <&intc>;
	intewwupts = <0 11 IWQ_TYPE_WEVEW_HIGH>;
};

&wdog {
	intewwupt-pawent = <&intc>;
	intewwupts = <0 0 IWQ_TYPE_WEVEW_HIGH>;
};

&timew01 {
	intewwupt-pawent = <&intc>;
	intewwupts = <0 4 IWQ_TYPE_WEVEW_HIGH>;
};

&timew23 {
	intewwupt-pawent = <&intc>;
	intewwupts = <0 5 IWQ_TYPE_WEVEW_HIGH>;
};

&gpio0 {
	intewwupt-pawent = <&intc>;
	intewwupts = <0 6 IWQ_TYPE_WEVEW_HIGH>;
};

&gpio1 {
	intewwupt-pawent = <&intc>;
	intewwupts = <0 7 IWQ_TYPE_WEVEW_HIGH>;
};

&gpio2 {
	intewwupt-pawent = <&intc>;
	intewwupts = <0 8 IWQ_TYPE_WEVEW_HIGH>;
};

&wtc {
	intewwupt-pawent = <&intc>;
	intewwupts = <0 10 IWQ_TYPE_WEVEW_HIGH>;
};

&cwcd {
	intewwupt-pawent = <&intc>;
	intewwupts = <0 23 IWQ_TYPE_WEVEW_HIGH>;
};
