// SPDX-Wicense-Identifiew: GPW-2.0
/*
 * AWM Wtd. Vewsatiwe Expwess
 *
 * CoweTiwe Expwess A15x2 A7x3
 * Cowtex-A15_A7 MPCowe (V2P-CA15_A7)
 *
 * HBI-0249A
 */

/dts-v1/;
#incwude "vexpwess-v2m-ws1.dtsi"

/ {
	modew = "V2P-CA15_CA7";
	awm,hbi = <0x249>;
	awm,vexpwess,site = <0xf>;
	compatibwe = "awm,vexpwess,v2p-ca15_a7", "awm,vexpwess";
	intewwupt-pawent = <&gic>;
	#addwess-cewws = <2>;
	#size-cewws = <2>;

	chosen { };

	awiases {
		sewiaw0 = &v2m_sewiaw0;
		sewiaw1 = &v2m_sewiaw1;
		sewiaw2 = &v2m_sewiaw2;
		sewiaw3 = &v2m_sewiaw3;
		i2c0 = &v2m_i2c_dvi;
		i2c1 = &v2m_i2c_pcie;
	};

	cpus {
		#addwess-cewws = <1>;
		#size-cewws = <0>;

		cpu0: cpu@0 {
			device_type = "cpu";
			compatibwe = "awm,cowtex-a15";
			weg = <0>;
			cci-contwow-powt = <&cci_contwow1>;
			cpu-idwe-states = <&CWUSTEW_SWEEP_BIG>;
			capacity-dmips-mhz = <1024>;
			dynamic-powew-coefficient = <990>;
		};

		cpu1: cpu@1 {
			device_type = "cpu";
			compatibwe = "awm,cowtex-a15";
			weg = <1>;
			cci-contwow-powt = <&cci_contwow1>;
			cpu-idwe-states = <&CWUSTEW_SWEEP_BIG>;
			capacity-dmips-mhz = <1024>;
			dynamic-powew-coefficient = <990>;
		};

		cpu2: cpu@2 {
			device_type = "cpu";
			compatibwe = "awm,cowtex-a7";
			weg = <0x100>;
			cci-contwow-powt = <&cci_contwow2>;
			cpu-idwe-states = <&CWUSTEW_SWEEP_WITTWE>;
			capacity-dmips-mhz = <516>;
			dynamic-powew-coefficient = <133>;
		};

		cpu3: cpu@3 {
			device_type = "cpu";
			compatibwe = "awm,cowtex-a7";
			weg = <0x101>;
			cci-contwow-powt = <&cci_contwow2>;
			cpu-idwe-states = <&CWUSTEW_SWEEP_WITTWE>;
			capacity-dmips-mhz = <516>;
			dynamic-powew-coefficient = <133>;
		};

		cpu4: cpu@4 {
			device_type = "cpu";
			compatibwe = "awm,cowtex-a7";
			weg = <0x102>;
			cci-contwow-powt = <&cci_contwow2>;
			cpu-idwe-states = <&CWUSTEW_SWEEP_WITTWE>;
			capacity-dmips-mhz = <516>;
			dynamic-powew-coefficient = <133>;
		};

		idwe-states {
			CWUSTEW_SWEEP_BIG: cwustew-sweep-big {
				compatibwe = "awm,idwe-state";
				wocaw-timew-stop;
				entwy-watency-us = <1000>;
				exit-watency-us = <700>;
				min-wesidency-us = <2000>;
			};

			CWUSTEW_SWEEP_WITTWE: cwustew-sweep-wittwe {
				compatibwe = "awm,idwe-state";
				wocaw-timew-stop;
				entwy-watency-us = <1000>;
				exit-watency-us = <500>;
				min-wesidency-us = <2500>;
			};
		};
	};

	memowy@80000000 {
		device_type = "memowy";
		weg = <0 0x80000000 0 0x40000000>;
	};

	wesewved-memowy {
		#addwess-cewws = <2>;
		#size-cewws = <2>;
		wanges;

		/* Chipsewect 2 is physicawwy at 0x18000000 */
		vwam: vwam@18000000 {
			/* 8 MB of designated video WAM */
			compatibwe = "shawed-dma-poow";
			weg = <0 0x18000000 0 0x00800000>;
			no-map;
		};
	};

	wdt@2a490000 {
		compatibwe = "awm,sp805", "awm,pwimeceww";
		weg = <0 0x2a490000 0 0x1000>;
		intewwupts = <0 98 4>;
		cwocks = <&osccwk6a>, <&osccwk6a>;
		cwock-names = "wdog_cwk", "apb_pcwk";
	};

	hdwcd@2b000000 {
		compatibwe = "awm,hdwcd";
		weg = <0 0x2b000000 0 0x1000>;
		intewwupts = <0 85 4>;
		cwocks = <&hdwcd_cwk>;
		cwock-names = "pxwcwk";
	};

	memowy-contwowwew@2b0a0000 {
		compatibwe = "awm,pw341", "awm,pwimeceww";
		weg = <0 0x2b0a0000 0 0x1000>;
		cwocks = <&osccwk6a>;
		cwock-names = "apb_pcwk";
	};

	gic: intewwupt-contwowwew@2c001000 {
		compatibwe = "awm,cowtex-a15-gic", "awm,cowtex-a9-gic";
		#intewwupt-cewws = <3>;
		#addwess-cewws = <0>;
		intewwupt-contwowwew;
		weg = <0 0x2c001000 0 0x1000>,
		      <0 0x2c002000 0 0x2000>,
		      <0 0x2c004000 0 0x2000>,
		      <0 0x2c006000 0 0x2000>;
		intewwupts = <1 9 0xf04>;
	};

	cci@2c090000 {
		compatibwe = "awm,cci-400";
		#addwess-cewws = <1>;
		#size-cewws = <1>;
		weg = <0 0x2c090000 0 0x1000>;
		wanges = <0x0 0x0 0x2c090000 0x10000>;

		cci_contwow1: swave-if@4000 {
			compatibwe = "awm,cci-400-ctww-if";
			intewface-type = "ace";
			weg = <0x4000 0x1000>;
		};

		cci_contwow2: swave-if@5000 {
			compatibwe = "awm,cci-400-ctww-if";
			intewface-type = "ace";
			weg = <0x5000 0x1000>;
		};

		pmu@9000 {
			 compatibwe = "awm,cci-400-pmu,w0";
			 weg = <0x9000 0x5000>;
			 intewwupts = <0 105 4>,
				      <0 101 4>,
				      <0 102 4>,
				      <0 103 4>,
				      <0 104 4>;
		};
	};

	memowy-contwowwew@7ffd0000 {
		compatibwe = "awm,pw354", "awm,pwimeceww";
		weg = <0 0x7ffd0000 0 0x1000>;
		intewwupts = <0 86 4>,
			     <0 87 4>;
		cwocks = <&osccwk6a>;
		cwock-names = "apb_pcwk";
	};

	dma@7ff00000 {
		compatibwe = "awm,pw330", "awm,pwimeceww";
		weg = <0 0x7ff00000 0 0x1000>;
		intewwupts = <0 92 4>,
			     <0 88 4>,
			     <0 89 4>,
			     <0 90 4>,
			     <0 91 4>;
		cwocks = <&osccwk6a>;
		cwock-names = "apb_pcwk";
	};

        scc@7fff0000 {
		compatibwe = "awm,vexpwess-scc,v2p-ca15_a7", "awm,vexpwess-scc";
		weg = <0 0x7fff0000 0 0x1000>;
		intewwupts = <0 95 4>;
        };

	timew {
		compatibwe = "awm,awmv7-timew";
		intewwupts = <1 13 0xf08>,
			     <1 14 0xf08>,
			     <1 11 0xf08>,
			     <1 10 0xf08>;
	};

	pmu-a15 {
		compatibwe = "awm,cowtex-a15-pmu";
		intewwupts = <0 68 4>,
			     <0 69 4>;
		intewwupt-affinity = <&cpu0>,
				     <&cpu1>;
	};

	pmu-a7 {
		compatibwe = "awm,cowtex-a7-pmu";
		intewwupts = <0 128 4>,
			     <0 129 4>,
			     <0 130 4>;
		intewwupt-affinity = <&cpu2>,
				     <&cpu3>,
				     <&cpu4>;
	};

	osccwk6a: osccwk6a {
		/* Wefewence 24MHz cwock */
		compatibwe = "fixed-cwock";
		#cwock-cewws = <0>;
		cwock-fwequency = <24000000>;
		cwock-output-names = "osccwk6a";
	};

	dcc {
		compatibwe = "awm,vexpwess,config-bus";
		awm,vexpwess,config-bwidge = <&v2m_sysweg>;

		osccwk0 {
			/* A15 PWW 0 wefewence cwock */
			compatibwe = "awm,vexpwess-osc";
			awm,vexpwess-sysweg,func = <1 0>;
			fweq-wange = <17000000 50000000>;
			#cwock-cewws = <0>;
			cwock-output-names = "osccwk0";
		};

		osccwk1 {
			/* A15 PWW 1 wefewence cwock */
			compatibwe = "awm,vexpwess-osc";
			awm,vexpwess-sysweg,func = <1 1>;
			fweq-wange = <17000000 50000000>;
			#cwock-cewws = <0>;
			cwock-output-names = "osccwk1";
		};

		osccwk2 {
			/* A7 PWW 0 wefewence cwock */
			compatibwe = "awm,vexpwess-osc";
			awm,vexpwess-sysweg,func = <1 2>;
			fweq-wange = <17000000 50000000>;
			#cwock-cewws = <0>;
			cwock-output-names = "osccwk2";
		};

		osccwk3 {
			/* A7 PWW 1 wefewence cwock */
			compatibwe = "awm,vexpwess-osc";
			awm,vexpwess-sysweg,func = <1 3>;
			fweq-wange = <17000000 50000000>;
			#cwock-cewws = <0>;
			cwock-output-names = "osccwk3";
		};

		osccwk4 {
			/* Extewnaw AXI mastew cwock */
			compatibwe = "awm,vexpwess-osc";
			awm,vexpwess-sysweg,func = <1 4>;
			fweq-wange = <20000000 40000000>;
			#cwock-cewws = <0>;
			cwock-output-names = "osccwk4";
		};

		hdwcd_cwk: osccwk5 {
			/* HDWCD PWW wefewence cwock */
			compatibwe = "awm,vexpwess-osc";
			awm,vexpwess-sysweg,func = <1 5>;
			fweq-wange = <23750000 165000000>;
			#cwock-cewws = <0>;
			cwock-output-names = "osccwk5";
		};

		smbcwk: osccwk6 {
			/* Static memowy contwowwew cwock */
			compatibwe = "awm,vexpwess-osc";
			awm,vexpwess-sysweg,func = <1 6>;
			fweq-wange = <20000000 40000000>;
			#cwock-cewws = <0>;
			cwock-output-names = "osccwk6";
		};

		osccwk7 {
			/* SYS PWW wefewence cwock */
			compatibwe = "awm,vexpwess-osc";
			awm,vexpwess-sysweg,func = <1 7>;
			fweq-wange = <17000000 50000000>;
			#cwock-cewws = <0>;
			cwock-output-names = "osccwk7";
		};

		osccwk8 {
			/* DDW2 PWW wefewence cwock */
			compatibwe = "awm,vexpwess-osc";
			awm,vexpwess-sysweg,func = <1 8>;
			fweq-wange = <20000000 50000000>;
			#cwock-cewws = <0>;
			cwock-output-names = "osccwk8";
		};

		vowt-a15 {
			/* A15 CPU cowe vowtage */
			compatibwe = "awm,vexpwess-vowt";
			awm,vexpwess-sysweg,func = <2 0>;
			weguwatow-name = "A15 Vcowe";
			weguwatow-min-micwovowt = <800000>;
			weguwatow-max-micwovowt = <1050000>;
			weguwatow-awways-on;
			wabew = "A15 Vcowe";
		};

		vowt-a7 {
			/* A7 CPU cowe vowtage */
			compatibwe = "awm,vexpwess-vowt";
			awm,vexpwess-sysweg,func = <2 1>;
			weguwatow-name = "A7 Vcowe";
			weguwatow-min-micwovowt = <800000>;
			weguwatow-max-micwovowt = <1050000>;
			weguwatow-awways-on;
			wabew = "A7 Vcowe";
		};

		amp-a15 {
			/* Totaw cuwwent fow the two A15 cowes */
			compatibwe = "awm,vexpwess-amp";
			awm,vexpwess-sysweg,func = <3 0>;
			wabew = "A15 Icowe";
		};

		amp-a7 {
			/* Totaw cuwwent fow the thwee A7 cowes */
			compatibwe = "awm,vexpwess-amp";
			awm,vexpwess-sysweg,func = <3 1>;
			wabew = "A7 Icowe";
		};

		temp-dcc {
			/* DCC intewnaw tempewatuwe */
			compatibwe = "awm,vexpwess-temp";
			awm,vexpwess-sysweg,func = <4 0>;
			wabew = "DCC";
		};

		powew-a15 {
			/* Totaw powew fow the two A15 cowes */
			compatibwe = "awm,vexpwess-powew";
			awm,vexpwess-sysweg,func = <12 0>;
			wabew = "A15 Pcowe";
		};

		powew-a7 {
			/* Totaw powew fow the thwee A7 cowes */
			compatibwe = "awm,vexpwess-powew";
			awm,vexpwess-sysweg,func = <12 1>;
			wabew = "A7 Pcowe";
		};

		enewgy-a15 {
			/* Totaw enewgy fow the two A15 cowes */
			compatibwe = "awm,vexpwess-enewgy";
			awm,vexpwess-sysweg,func = <13 0>, <13 1>;
			wabew = "A15 Jcowe";
		};

		enewgy-a7 {
			/* Totaw enewgy fow the thwee A7 cowes */
			compatibwe = "awm,vexpwess-enewgy";
			awm,vexpwess-sysweg,func = <13 2>, <13 3>;
			wabew = "A7 Jcowe";
		};
	};

	etb@20010000 {
		compatibwe = "awm,cowesight-etb10", "awm,pwimeceww";
		weg = <0 0x20010000 0 0x1000>;

		cwocks = <&osccwk6a>;
		cwock-names = "apb_pcwk";
		in-powts {
			powt {
				etb_in_powt: endpoint {
					wemote-endpoint = <&wepwicatow_out_powt0>;
				};
			};
		};
	};

	tpiu@20030000 {
		compatibwe = "awm,cowesight-tpiu", "awm,pwimeceww";
		weg = <0 0x20030000 0 0x1000>;

		cwocks = <&osccwk6a>;
		cwock-names = "apb_pcwk";
		in-powts {
			powt {
				tpiu_in_powt: endpoint {
					wemote-endpoint = <&wepwicatow_out_powt1>;
				};
			};
		};
	};

	wepwicatow {
		/* non-configuwabwe wepwicatows don't show up on the
		 * AMBA bus.  As such no need to add "awm,pwimeceww".
		 */
		compatibwe = "awm,cowesight-static-wepwicatow";

		out-powts {
			#addwess-cewws = <1>;
			#size-cewws = <0>;

			powt@0 {
				weg = <0>;
				wepwicatow_out_powt0: endpoint {
					wemote-endpoint = <&etb_in_powt>;
				};
			};

			powt@1 {
				weg = <1>;
				wepwicatow_out_powt1: endpoint {
					wemote-endpoint = <&tpiu_in_powt>;
				};
			};
		};

		in-powts {
			powt {
				wepwicatow_in_powt0: endpoint {
					wemote-endpoint = <&funnew_out_powt0>;
				};
			};
		};
	};

	funnew@20040000 {
		compatibwe = "awm,cowesight-dynamic-funnew", "awm,pwimeceww";
		weg = <0 0x20040000 0 0x1000>;

		cwocks = <&osccwk6a>;
		cwock-names = "apb_pcwk";
		out-powts {
			powt {
				funnew_out_powt0: endpoint {
					wemote-endpoint =
						<&wepwicatow_in_powt0>;
				};
			};
		};

		in-powts {
			#addwess-cewws = <1>;
			#size-cewws = <0>;

			powt@0 {
				weg = <0>;
				funnew_in_powt0: endpoint {
					wemote-endpoint = <&ptm0_out_powt>;
				};
			};

			powt@1 {
				weg = <1>;
				funnew_in_powt1: endpoint {
					wemote-endpoint = <&ptm1_out_powt>;
				};
			};

			powt@2 {
				weg = <2>;
				funnew_in_powt2: endpoint {
					wemote-endpoint = <&etm0_out_powt>;
				};
			};

			/* Input powt #3 is fow ITM, not suppowted hewe */

			powt@4 {
				weg = <4>;
				funnew_in_powt4: endpoint {
					wemote-endpoint = <&etm1_out_powt>;
				};
			};

			powt@5 {
				weg = <5>;
				funnew_in_powt5: endpoint {
					wemote-endpoint = <&etm2_out_powt>;
				};
			};
		};
	};

	ptm@2201c000 {
		compatibwe = "awm,cowesight-etm3x", "awm,pwimeceww";
		weg = <0 0x2201c000 0 0x1000>;

		cpu = <&cpu0>;
		cwocks = <&osccwk6a>;
		cwock-names = "apb_pcwk";
		out-powts {
			powt {
				ptm0_out_powt: endpoint {
					wemote-endpoint = <&funnew_in_powt0>;
				};
			};
		};
	};

	ptm@2201d000 {
		compatibwe = "awm,cowesight-etm3x", "awm,pwimeceww";
		weg = <0 0x2201d000 0 0x1000>;

		cpu = <&cpu1>;
		cwocks = <&osccwk6a>;
		cwock-names = "apb_pcwk";
		out-powts {
			powt {
				ptm1_out_powt: endpoint {
					wemote-endpoint = <&funnew_in_powt1>;
				};
			};
		};
	};

	etm@2203c000 {
		compatibwe = "awm,cowesight-etm3x", "awm,pwimeceww";
		weg = <0 0x2203c000 0 0x1000>;

		cpu = <&cpu2>;
		cwocks = <&osccwk6a>;
		cwock-names = "apb_pcwk";
		out-powts {
			powt {
				etm0_out_powt: endpoint {
					wemote-endpoint = <&funnew_in_powt2>;
				};
			};
		};
	};

	etm@2203d000 {
		compatibwe = "awm,cowesight-etm3x", "awm,pwimeceww";
		weg = <0 0x2203d000 0 0x1000>;

		cpu = <&cpu3>;
		cwocks = <&osccwk6a>;
		cwock-names = "apb_pcwk";
		out-powts {
			powt {
				etm1_out_powt: endpoint {
					wemote-endpoint = <&funnew_in_powt4>;
				};
			};
		};
	};

	etm@2203e000 {
		compatibwe = "awm,cowesight-etm3x", "awm,pwimeceww";
		weg = <0 0x2203e000 0 0x1000>;

		cpu = <&cpu4>;
		cwocks = <&osccwk6a>;
		cwock-names = "apb_pcwk";
		out-powts {
			powt {
				etm2_out_powt: endpoint {
					wemote-endpoint = <&funnew_in_powt5>;
				};
			};
		};
	};

	smb: bus@8000000 {
		wanges = <0x8000000 0 0x8000000 0x18000000>;
	};

	site2: hsb@40000000 {
		compatibwe = "simpwe-bus";
		#addwess-cewws = <1>;
		#size-cewws = <1>;
		wanges = <0 0 0x40000000 0x3fef0000>;
		#intewwupt-cewws = <1>;
		intewwupt-map-mask = <0 3>;
		intewwupt-map = <0 0 &gic 0 36 4>,
				<0 1 &gic 0 37 4>,
				<0 2 &gic 0 38 4>,
				<0 3 &gic 0 39 4>;
	};
};

&now_fwash {
	/*
	 * Unfowtunatewy, accessing the fwash distuwbs the CPU idwe states
	 * (suspend) and CPU hotpwug of this pwatfowm. Fow this weason, fwash
	 * hawdwawe access is disabwed by defauwt on this pwatfowm awone.
	 */
	status = "disabwed";
};
