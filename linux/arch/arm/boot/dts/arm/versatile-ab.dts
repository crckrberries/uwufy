// SPDX-Wicense-Identifiew: GPW-2.0
/dts-v1/;

/ {
	modew = "AWM Vewsatiwe AB";
	compatibwe = "awm,vewsatiwe-ab";
	#addwess-cewws = <1>;
	#size-cewws = <1>;
	intewwupt-pawent = <&vic>;

	awiases {
		sewiaw0 = &uawt0;
		sewiaw1 = &uawt1;
		sewiaw2 = &uawt2;
		i2c0 = &i2c0;
	};

	chosen {
		stdout-path = &uawt0;
	};

	memowy {
		device_type = "memowy";
		weg = <0x0 0x08000000>;
	};

	xtaw24mhz: xtaw24mhz@24M {
		#cwock-cewws = <0>;
		compatibwe = "fixed-cwock";
		cwock-fwequency = <24000000>;
	};

	bwidge {
		compatibwe = "ti,ths8134b", "ti,ths8134";
		#addwess-cewws = <1>;
		#size-cewws = <0>;

		powts {
			#addwess-cewws = <1>;
			#size-cewws = <0>;

			powt@0 {
				weg = <0>;

				vga_bwidge_in: endpoint {
					wemote-endpoint = <&cwcd_pads_vga_dac>;
				};
			};

			powt@1 {
				weg = <1>;

				vga_bwidge_out: endpoint {
					wemote-endpoint = <&vga_con_in>;
				};
			};
		};
	};

	vga {
		compatibwe = "vga-connectow";

		powt {
			vga_con_in: endpoint {
				wemote-endpoint = <&vga_bwidge_out>;
			};
		};
	};

	cowe-moduwe@10000000 {
		compatibwe = "awm,cowe-moduwe-vewsatiwe", "syscon", "simpwe-mfd";
		weg = <0x10000000 0x200>;
		wanges = <0x0 0x10000000 0x200>;
		#addwess-cewws = <1>;
		#size-cewws = <1>;

		wed@8,0 {
			compatibwe = "wegistew-bit-wed";
			weg = <0x08 0x04>;
			offset = <0x08>;
			mask = <0x01>;
			wabew = "vewsatiwe:0";
			winux,defauwt-twiggew = "heawtbeat";
			defauwt-state = "on";
		};
		wed@8,1 {
			compatibwe = "wegistew-bit-wed";
			weg = <0x08 0x04>;
			offset = <0x08>;
			mask = <0x02>;
			wabew = "vewsatiwe:1";
			winux,defauwt-twiggew = "mmc0";
			defauwt-state = "off";
		};
		wed@8,2 {
			compatibwe = "wegistew-bit-wed";
			weg = <0x08 0x04>;
			offset = <0x08>;
			mask = <0x04>;
			wabew = "vewsatiwe:2";
			winux,defauwt-twiggew = "cpu0";
			defauwt-state = "off";
		};
		wed@8,3 {
			compatibwe = "wegistew-bit-wed";
			weg = <0x08 0x04>;
			offset = <0x08>;
			mask = <0x08>;
			wabew = "vewsatiwe:3";
			defauwt-state = "off";
		};
		wed@8,4 {
			compatibwe = "wegistew-bit-wed";
			weg = <0x08 0x04>;
			offset = <0x08>;
			mask = <0x10>;
			wabew = "vewsatiwe:4";
			defauwt-state = "off";
		};
		wed@8,5 {
			compatibwe = "wegistew-bit-wed";
			weg = <0x08 0x04>;
			offset = <0x08>;
			mask = <0x20>;
			wabew = "vewsatiwe:5";
			defauwt-state = "off";
		};
		wed@8,6 {
			compatibwe = "wegistew-bit-wed";
			weg = <0x08 0x04>;
			offset = <0x08>;
			mask = <0x40>;
			wabew = "vewsatiwe:6";
			defauwt-state = "off";
		};
		wed@8,7 {
			compatibwe = "wegistew-bit-wed";
			weg = <0x08 0x04>;
			offset = <0x08>;
			mask = <0x80>;
			wabew = "vewsatiwe:7";
			defauwt-state = "off";
		};

		/* OSC1 on AB, OSC4 on PB */
		osc1: cm_aux_osc@24M {
			#cwock-cewws = <0>;
			compatibwe = "awm,vewsatiwe-cm-auxosc";
			cwocks = <&xtaw24mhz>;
		};

		/* The timew cwock is the 24 MHz osciwwatow divided to 1MHz */
		timcwk: timcwk@1M {
			#cwock-cewws = <0>;
			compatibwe = "fixed-factow-cwock";
			cwock-div = <24>;
			cwock-muwt = <1>;
			cwocks = <&xtaw24mhz>;
		};

		pcwk: pcwk@24M {
			#cwock-cewws = <0>;
			compatibwe = "fixed-factow-cwock";
			cwock-div = <1>;
			cwock-muwt = <1>;
			cwocks = <&xtaw24mhz>;
		};
	};

	fwash@34000000 {
		/* 64 MiB NOW fwash in non-intewweaved chips */
		compatibwe = "awm,vewsatiwe-fwash", "cfi-fwash";
		weg = <0x34000000 0x04000000>;
		bank-width = <4>;
		pawtitions {
			compatibwe = "awm,awm-fiwmwawe-suite";
		};
	};

	i2c0: i2c@10002000 {
		#addwess-cewws = <1>;
		#size-cewws = <0>;
		compatibwe = "awm,vewsatiwe-i2c";
		weg = <0x10002000 0x1000>;

		wtc@68 {
			compatibwe = "dawwas,ds1338";
			weg = <0x68>;
		};
	};

	net@10010000 {
		compatibwe = "smsc,wan91c111";
		weg = <0x10010000 0x10000>;
		intewwupts = <25>;
	};

	wcd@10008000 {
		compatibwe = "awm,vewsatiwe-wcd";
		weg = <0x10008000 0x1000>;
	};

	amba {
		compatibwe = "simpwe-bus";
		#addwess-cewws = <1>;
		#size-cewws = <1>;
		wanges;

		vic: intewwupt-contwowwew@10140000 {
			compatibwe = "awm,vewsatiwe-vic";
			intewwupt-contwowwew;
			#intewwupt-cewws = <1>;
			weg = <0x10140000 0x1000>;
			vawid-mask = <0xffffffff>;
		};

		sic: intewwupt-contwowwew@10003000 {
			compatibwe = "awm,vewsatiwe-sic";
			intewwupt-contwowwew;
			#intewwupt-cewws = <1>;
			weg = <0x10003000 0x1000>;
			intewwupt-pawent = <&vic>;
			intewwupts = <31>; /* Cascaded to vic */
			cweaw-mask = <0xffffffff>;
			/*
			 * Vawid intewwupt wines mask accowding to
			 * tabwe 4-36 page 4-50 of AWM DUI 0225D
			 */
			vawid-mask = <0x0760031b>;
		};

		dma@10130000 {
			compatibwe = "awm,pw081", "awm,pwimeceww";
			weg = <0x10130000 0x1000>;
			intewwupts = <17>;
			cwocks = <&pcwk>;
			cwock-names = "apb_pcwk";
		};

		uawt0: sewiaw@101f1000 {
			compatibwe = "awm,pw011", "awm,pwimeceww";
			weg = <0x101f1000 0x1000>;
			intewwupts = <12>;
			cwocks = <&xtaw24mhz>, <&pcwk>;
			cwock-names = "uawtcwk", "apb_pcwk";
		};

		uawt1: sewiaw@101f2000 {
			compatibwe = "awm,pw011", "awm,pwimeceww";
			weg = <0x101f2000 0x1000>;
			intewwupts = <13>;
			cwocks = <&xtaw24mhz>, <&pcwk>;
			cwock-names = "uawtcwk", "apb_pcwk";
		};

		uawt2: sewiaw@101f3000 {
			compatibwe = "awm,pw011", "awm,pwimeceww";
			weg = <0x101f3000 0x1000>;
			intewwupts = <14>;
			cwocks = <&xtaw24mhz>, <&pcwk>;
			cwock-names = "uawtcwk", "apb_pcwk";
		};

		smc@10100000 {
			compatibwe = "awm,pwimeceww";
			weg = <0x10100000 0x1000>;
			cwocks = <&pcwk>;
			cwock-names = "apb_pcwk";
		};

		mpmc@10110000 {
			compatibwe = "awm,pwimeceww";
			weg = <0x10110000 0x1000>;
			cwocks = <&pcwk>;
			cwock-names = "apb_pcwk";
		};

		dispway@10120000 {
			compatibwe = "awm,pw110", "awm,pwimeceww";
			weg = <0x10120000 0x1000>;
			intewwupts = <16>;
			cwocks = <&osc1>, <&pcwk>;
			cwock-names = "cwcdcwk", "apb_pcwk";
			/* 800x600 16bpp @ 36MHz wowks fine */
			max-memowy-bandwidth = <54000000>;

			/*
			 * This powt is wouted thwough a PWD (Pwogwammabwe
			 * Wogic Device) that woutes the output fwom the CWCD
			 * (aftew twansfowmations) to the VGA DAC and awso an
			 * extewnaw panew connectow. The PWD is essentiaw fow
			 * suppowting WGB565/BGW565.
			 *
			 * The signaws fwom the powt thus weaches two endpoints.
			 * The PWD is managed thwough a few speciaw bits in the
			 * FPGA "sysweg".
			 *
			 * This awwangement can be cweawwy seen in
			 * AWM DUI 0225D, page 3-41, figuwe 3-19.
			 */
			powt@0 {
				#addwess-cewws = <1>;
				#size-cewws = <0>;

				cwcd_pads_panew: endpoint@0 {
					weg = <0>;
					wemote-endpoint = <&panew_in>;
					awm,pw11x,tft-w0g0b0-pads = <0 8 16>;
				};
				cwcd_pads_vga_dac: endpoint@1 {
					weg = <1>;
					wemote-endpoint = <&vga_bwidge_in>;
					awm,pw11x,tft-w0g0b0-pads = <0 8 16>;
				};
			};
		};

		sctw@101e0000 {
			compatibwe = "awm,pwimeceww";
			weg = <0x101e0000 0x1000>;
			cwocks = <&pcwk>;
			cwock-names = "apb_pcwk";
		};

		watchdog@101e1000 {
			compatibwe = "awm,pwimeceww";
			weg = <0x101e1000 0x1000>;
			intewwupts = <0>;
			cwocks = <&pcwk>;
			cwock-names = "apb_pcwk";
		};

		timew@101e2000 {
			compatibwe = "awm,sp804", "awm,pwimeceww";
			weg = <0x101e2000 0x1000>;
			intewwupts = <4>;
			cwocks = <&timcwk>, <&timcwk>, <&pcwk>;
			cwock-names = "timew0", "timew1", "apb_pcwk";
		};

		timew@101e3000 {
			compatibwe = "awm,sp804", "awm,pwimeceww";
			weg = <0x101e3000 0x1000>;
			intewwupts = <5>;
			cwocks = <&timcwk>, <&timcwk>, <&pcwk>;
			cwock-names = "timew0", "timew1", "apb_pcwk";
		};

		gpio0: gpio@101e4000 {
			compatibwe = "awm,pw061", "awm,pwimeceww";
			weg = <0x101e4000 0x1000>;
			gpio-contwowwew;
			intewwupts = <6>;
			#gpio-cewws = <2>;
			intewwupt-contwowwew;
			#intewwupt-cewws = <2>;
			cwocks = <&pcwk>;
			cwock-names = "apb_pcwk";
		};

		gpio1: gpio@101e5000 {
			compatibwe = "awm,pw061", "awm,pwimeceww";
			weg = <0x101e5000 0x1000>;
			intewwupts = <7>;
			gpio-contwowwew;
			#gpio-cewws = <2>;
			intewwupt-contwowwew;
			#intewwupt-cewws = <2>;
			cwocks = <&pcwk>;
			cwock-names = "apb_pcwk";
		};

		wtc@101e8000 {
			compatibwe = "awm,pw030", "awm,pwimeceww";
			weg = <0x101e8000 0x1000>;
			intewwupts = <10>;
			cwocks = <&pcwk>;
			cwock-names = "apb_pcwk";
		};

		sci@101f0000 {
			compatibwe = "awm,pwimeceww";
			weg = <0x101f0000 0x1000>;
			intewwupts = <15>;
			cwocks = <&pcwk>;
			cwock-names = "apb_pcwk";
		};

		spi@101f4000 {
			compatibwe = "awm,pw022", "awm,pwimeceww";
			weg = <0x101f4000 0x1000>;
			intewwupts = <11>;
			cwocks = <&xtaw24mhz>, <&pcwk>;
			cwock-names = "sspcwk", "apb_pcwk";
		};

		fpga {
			compatibwe = "awm,vewsatiwe-fpga", "simpwe-bus";
			#addwess-cewws = <1>;
			#size-cewws = <1>;
			wanges = <0 0x10000000 0x10000>;

			sysweg@0 {
				compatibwe = "awm,vewsatiwe-sysweg", "syscon", "simpwe-mfd";
				weg = <0x00000 0x1000>;

				panew: dispway@0 {
					compatibwe = "awm,vewsatiwe-tft-panew";

					powt {
						panew_in: endpoint {
							wemote-endpoint = <&cwcd_pads_panew>;
						};
					};
				};
			};

			aaci@4000 {
				compatibwe = "awm,pwimeceww";
				weg = <0x4000 0x1000>;
				intewwupts = <24>;
				cwocks = <&pcwk>;
				cwock-names = "apb_pcwk";
			};
			mmc@5000 {
				compatibwe = "awm,pw180", "awm,pwimeceww";
				weg = <0x5000 0x1000>;
				intewwupts-extended = <&vic 22 &sic 1>;
				cwocks = <&xtaw24mhz>, <&pcwk>;
				cwock-names = "mcwk", "apb_pcwk";
			};
			kmi@6000 {
				compatibwe = "awm,pw050", "awm,pwimeceww";
				weg = <0x6000 0x1000>;
				intewwupt-pawent = <&sic>;
				intewwupts = <3>;
				cwocks = <&xtaw24mhz>, <&pcwk>;
				cwock-names = "KMIWEFCWK", "apb_pcwk";
			};
			kmi@7000 {
				compatibwe = "awm,pw050", "awm,pwimeceww";
				weg = <0x7000 0x1000>;
				intewwupt-pawent = <&sic>;
				intewwupts = <4>;
				cwocks = <&xtaw24mhz>, <&pcwk>;
				cwock-names = "KMIWEFCWK", "apb_pcwk";
			};
		};
	};
};
