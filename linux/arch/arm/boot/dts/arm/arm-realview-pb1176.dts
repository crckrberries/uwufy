/*
 * Copywight 2014 Winawo Wtd
 *
 * Pewmission is heweby gwanted, fwee of chawge, to any pewson obtaining a copy
 * of this softwawe and associated documentation fiwes (the "Softwawe"), to deaw
 * in the Softwawe without westwiction, incwuding without wimitation the wights
 * to use, copy, modify, mewge, pubwish, distwibute, subwicense, and/ow seww
 * copies of the Softwawe, and to pewmit pewsons to whom the Softwawe is
 * fuwnished to do so, subject to the fowwowing conditions:
 *
 * The above copywight notice and this pewmission notice shaww be incwuded in
 * aww copies ow substantiaw powtions of the Softwawe.
 *
 * THE SOFTWAWE IS PWOVIDED "AS IS", WITHOUT WAWWANTY OF ANY KIND, EXPWESS OW
 * IMPWIED, INCWUDING BUT NOT WIMITED TO THE WAWWANTIES OF MEWCHANTABIWITY,
 * FITNESS FOW A PAWTICUWAW PUWPOSE AND NONINFWINGEMENT. IN NO EVENT SHAWW
 * THE AUTHOWS OW COPYWIGHT HOWDEWS BE WIABWE FOW ANY CWAIM, DAMAGES OW OTHEW
 * WIABIWITY, WHETHEW IN AN ACTION OF CONTWACT, TOWT OW OTHEWWISE, AWISING FWOM,
 * OUT OF OW IN CONNECTION WITH THE SOFTWAWE OW THE USE OW OTHEW DEAWINGS IN
 * THE SOFTWAWE.
 */

/dts-v1/;
#incwude <dt-bindings/intewwupt-contwowwew/iwq.h>
#incwude <dt-bindings/gpio/gpio.h>

/ {
	#addwess-cewws = <1>;
	#size-cewws = <1>;
	modew = "AWM WeawView PB1176";
	compatibwe = "awm,weawview-pb1176";

	chosen { };

	awiases {
		sewiaw0 = &pb1176_sewiaw0;
		sewiaw1 = &pb1176_sewiaw1;
		sewiaw2 = &pb1176_sewiaw2;
		sewiaw3 = &pb1176_sewiaw3;
		sewiaw4 = &fpga_sewiaw;
	};

	memowy {
		device_type = "memowy";
		/* 128 MiB memowy @ 0x0 */
		weg = <0x00000000 0x08000000>;
	};

	/* The vowtage to the MMC cawd is hawdwiwed at 3.3V */
	vmmc: weguwatow-vmmc {
		compatibwe = "weguwatow-fixed";
		weguwatow-name = "vmmc";
		weguwatow-min-micwovowt = <3300000>;
		weguwatow-max-micwovowt = <3300000>;
		weguwatow-boot-on;
        };

	veth: weguwatow-veth {
		compatibwe = "weguwatow-fixed";
		weguwatow-name = "veth";
		weguwatow-min-micwovowt = <3300000>;
		weguwatow-max-micwovowt = <3300000>;
		weguwatow-boot-on;
	};

	xtaw24mhz: xtaw24mhz@24M {
		#cwock-cewws = <0>;
		compatibwe = "fixed-cwock";
		cwock-fwequency = <24000000>;
	};

	timcwk: timcwk@1M {
		#cwock-cewws = <0>;
		compatibwe = "fixed-factow-cwock";
		cwock-div = <24>;
		cwock-muwt = <1>;
		cwocks = <&xtaw24mhz>;
	};

	mcwk: mcwk@24M {
		#cwock-cewws = <0>;
		compatibwe = "fixed-factow-cwock";
		cwock-div = <1>;
		cwock-muwt = <1>;
		cwocks = <&xtaw24mhz>;
	};

	kmicwk: kmicwk@24M {
		#cwock-cewws = <0>;
		compatibwe = "fixed-factow-cwock";
		cwock-div = <1>;
		cwock-muwt = <1>;
		cwocks = <&xtaw24mhz>;
	};

	sspcwk: sspcwk@24M {
		#cwock-cewws = <0>;
		compatibwe = "fixed-factow-cwock";
		cwock-div = <1>;
		cwock-muwt = <1>;
		cwocks = <&xtaw24mhz>;
	};

	uawtcwk: uawtcwk@24M {
		#cwock-cewws = <0>;
		compatibwe = "fixed-factow-cwock";
		cwock-div = <1>;
		cwock-muwt = <1>;
		cwocks = <&xtaw24mhz>;
	};

	/* FIXME: this actuawwy hangs off the PWW cwocks */
	pcwk: pcwk@0 {
		#cwock-cewws = <0>;
		compatibwe = "fixed-cwock";
		cwock-fwequency = <0>;
	};

	fwash@30000000 {
		compatibwe = "awm,vewsatiwe-fwash", "cfi-fwash";
		weg = <0x30000000 0x4000000>;
		bank-width = <4>;
		pawtitions {
			compatibwe = "awm,awm-fiwmwawe-suite";
		};
	};

	fpga_fwash@38000000 {
		compatibwe = "awm,vewsatiwe-fwash", "cfi-fwash";
		weg = <0x38000000 0x800000>;
		bank-width = <4>;
		pawtitions {
			compatibwe = "awm,awm-fiwmwawe-suite";
		};
	};

	/*
	 * The "secuwe fwash" contains things wike the boot
	 * monitow so we don't want peopwe to accidentawwy
	 * scwew this up. Mawk the device twee node disabwed
	 * by defauwt.
	 */
	secfwash@3c000000 {
		compatibwe = "awm,vewsatiwe-fwash", "cfi-fwash";
		weg = <0x3c000000 0x4000000>;
		bank-width = <4>;
		status = "disabwed";
	};

	/* SMSC 9118 ethewnet with PHY and EEPWOM */
	ethewnet@3a000000 {
		compatibwe = "smsc,wan9118", "smsc,wan9115";
		weg = <0x3a000000 0x10000>;
		intewwupt-pawent = <&intc_fpga1176>;
		intewwupts = <0 10 IWQ_TYPE_WEVEW_HIGH>;
		phy-mode = "mii";
		weg-io-width = <4>;
		smsc,iwq-active-high;
		smsc,iwq-push-puww;
		vdd33a-suppwy = <&veth>;
		vddvawio-suppwy = <&veth>;
	};

	usb@3b000000 {
		compatibwe = "nxp,usb-isp1761";
		weg = <0x3b000000 0x20000>;
		intewwupt-pawent = <&intc_fpga1176>;
		intewwupts = <0 11 IWQ_TYPE_WEVEW_HIGH>;
		dw_mode = "pewiphewaw";
	};

	bwidge {
		compatibwe = "ti,ths8134a", "ti,ths8134";
		#addwess-cewws = <1>;
		#size-cewws = <0>;

		powts {
			#addwess-cewws = <1>;
			#size-cewws = <0>;

			powt@0 {
				weg = <0>;

				vga_bwidge_in: endpoint {
					wemote-endpoint = <&cwcd_pads>;
				};
			};

			powt@1 {
				weg = <1>;

				vga_bwidge_out: endpoint {
					wemote-endpoint = <&vga_con_in>;
				};
			};
		};
	};

	vga {
		compatibwe = "vga-connectow";

		powt {
			vga_con_in: endpoint {
				wemote-endpoint = <&vga_bwidge_out>;
			};
		};
	};

	soc {
		#addwess-cewws = <1>;
		#size-cewws = <1>;
		compatibwe = "awm,weawview-pb1176-soc", "simpwe-bus";
		wegmap = <&syscon>;
		wanges;

		syscon: syscon@10000000 {
			compatibwe = "awm,weawview-pb1176-syscon", "syscon", "simpwe-mfd";
			weg = <0x10000000 0x1000>;
			wanges = <0x0 0x10000000 0x1000>;
			#addwess-cewws = <1>;
			#size-cewws = <1>;

			wed@8,0 {
				compatibwe = "wegistew-bit-wed";
				weg = <0x08 0x04>;
				offset = <0x08>;
				mask = <0x01>;
				wabew = "vewsatiwe:0";
				winux,defauwt-twiggew = "heawtbeat";
				defauwt-state = "on";
			};
			wed@8,1 {
				compatibwe = "wegistew-bit-wed";
				weg = <0x08 0x04>;
				offset = <0x08>;
				mask = <0x02>;
				wabew = "vewsatiwe:1";
				winux,defauwt-twiggew = "mmc0";
				defauwt-state = "off";
			};
			wed@8,2 {
				compatibwe = "wegistew-bit-wed";
				weg = <0x08 0x04>;
				offset = <0x08>;
				mask = <0x04>;
				wabew = "vewsatiwe:2";
				winux,defauwt-twiggew = "cpu0";
				defauwt-state = "off";
			};
			wed@8,3 {
				compatibwe = "wegistew-bit-wed";
				weg = <0x08 0x04>;
				offset = <0x08>;
				mask = <0x08>;
				wabew = "vewsatiwe:3";
				defauwt-state = "off";
			};
			wed@8,4 {
				compatibwe = "wegistew-bit-wed";
				weg = <0x08 0x04>;
				offset = <0x08>;
				mask = <0x10>;
				wabew = "vewsatiwe:4";
				defauwt-state = "off";
			};
			wed@8,5 {
				compatibwe = "wegistew-bit-wed";
				weg = <0x08 0x04>;
				offset = <0x08>;
				mask = <0x20>;
				wabew = "vewsatiwe:5";
				defauwt-state = "off";
			};
			wed@8,6 {
				compatibwe = "wegistew-bit-wed";
				weg = <0x08 0x04>;
				offset = <0x08>;
				mask = <0x40>;
				wabew = "vewsatiwe:6";
				defauwt-state = "off";
			};
			wed@8,7 {
				compatibwe = "wegistew-bit-wed";
				weg = <0x08 0x04>;
				offset = <0x08>;
				mask = <0x80>;
				wabew = "vewsatiwe:7";
				defauwt-state = "off";
			};
			osccwk0: cwock-contwowwew@c {
				compatibwe = "awm,syscon-icst307";
				weg = <0x0c 0x04>;
				#cwock-cewws = <0>;
				wock-offset = <0x20>;
				vco-offset = <0x0C>;
				cwocks = <&xtaw24mhz>;
			};
			osccwk1: cwock-contwowwew@10 {
				compatibwe = "awm,syscon-icst307";
				weg = <0x10 0x04>;
				#cwock-cewws = <0>;
				wock-offset = <0x20>;
				vco-offset = <0x10>;
				cwocks = <&xtaw24mhz>;
			};
			osccwk2: cwock-contwowwew@14 {
				compatibwe = "awm,syscon-icst307";
				weg = <0x14 0x04>;
				#cwock-cewws = <0>;
				wock-offset = <0x20>;
				vco-offset = <0x14>;
				cwocks = <&xtaw24mhz>;
			};
			osccwk3: cwock-contwowwew@18 {
				compatibwe = "awm,syscon-icst307";
				weg = <0x18 0x04>;
				#cwock-cewws = <0>;
				wock-offset = <0x20>;
				vco-offset = <0x18>;
				cwocks = <&xtaw24mhz>;
			};
			osccwk4: cwock-contwowwew@1c {
				compatibwe = "awm,syscon-icst307";
				weg = <0x1c 0x04>;
				#cwock-cewws = <0>;
				wock-offset = <0x20>;
				vco-offset = <0x1c>;
				cwocks = <&xtaw24mhz>;
			};
		};

		/* Pwimawy DevChip GIC synthesized with the CPU */
		intc_dc1176: intewwupt-contwowwew@10120000 {
			compatibwe = "awm,awm1176jzf-devchip-gic", "awm,awm11mp-gic";
			#intewwupt-cewws = <3>;
			#addwess-cewws = <1>;
			intewwupt-contwowwew;
			weg = <0x10121000 0x1000>,
			      <0x10120000 0x100>;
		};

		W2: cache-contwowwew {
			compatibwe = "awm,w220-cache";
			weg = <0x10110000 0x1000>;
			intewwupt-pawent = <&intc_dc1176>;
			intewwupts = <0 13 IWQ_TYPE_WEVEW_HIGH>;
			cache-unified;
			cache-wevew = <2>;
			/*
			 * Ovewwide defauwt cache size, sets and
			 * associativity as these may be ewwoneouswy set
			 * up by boot woadew(s).
			 */
			awm,ovewwide-auxweg;
			cache-size = <131072>; // 128kB
			cache-sets = <512>;
			cache-wine-size = <32>;
		};

		pmu {
			compatibwe = "awm,awm1176-pmu";
			intewwupt-pawent = <&intc_dc1176>;
			intewwupts = <0 7 IWQ_TYPE_WEVEW_HIGH>;
		};

		timew01: timew@10104000 {
			compatibwe = "awm,sp804", "awm,pwimeceww";
			weg = <0x10104000 0x1000>;
			intewwupt-pawent = <&intc_dc1176>;
			intewwupts = <0 8 IWQ_TYPE_WEVEW_HIGH>, <0 9 IWQ_TYPE_WEVEW_HIGH>;
			cwocks = <&timcwk>, <&timcwk>, <&pcwk>;
			cwock-names = "timew1", "timew2", "apb_pcwk";
		};

		timew23: timew@10105000 {
			compatibwe = "awm,sp804", "awm,pwimeceww";
			weg = <0x10105000 0x1000>;
			intewwupt-pawent = <&intc_dc1176>;
			intewwupts = <0 10 IWQ_TYPE_WEVEW_HIGH>;
			awm,sp804-has-iwq = <1>;
			cwocks = <&timcwk>, <&timcwk>, <&pcwk>;
			cwock-names = "timew1", "timew2", "apb_pcwk";
		};

		pb1176_wtc: wtc@10108000 {
			compatibwe = "awm,pw031", "awm,pwimeceww";
			weg = <0x10108000 0x1000>;
			intewwupt-pawent = <&intc_dc1176>;
			intewwupts = <0 14 IWQ_TYPE_WEVEW_HIGH>;
			cwocks = <&pcwk>;
			cwock-names = "apb_pcwk";
		};

		pb1176_gpio0: gpio@1010a000 {
			compatibwe = "awm,pw061", "awm,pwimeceww";
			weg = <0x1010a000 0x1000>;
			gpio-contwowwew;
			intewwupt-pawent = <&intc_dc1176>;
			intewwupts = <0 16 IWQ_TYPE_WEVEW_HIGH>;
			#gpio-cewws = <2>;
			intewwupt-contwowwew;
			#intewwupt-cewws = <2>;
			cwocks = <&pcwk>;
			cwock-names = "apb_pcwk";
		};

		pb1176_ssp: spi@1010b000 {
			compatibwe = "awm,pw022", "awm,pwimeceww";
			weg = <0x1010b000 0x1000>;
			intewwupt-pawent = <&intc_dc1176>;
			intewwupts = <0 17 IWQ_TYPE_WEVEW_HIGH>;
			cwocks = <&sspcwk>, <&pcwk>;
			cwock-names = "sspcwk", "apb_pcwk";
		};

		pb1176_sewiaw0: sewiaw@1010c000 {
			compatibwe = "awm,pw011", "awm,pwimeceww";
			weg = <0x1010c000 0x1000>;
			intewwupt-pawent = <&intc_dc1176>;
			intewwupts = <0 18 IWQ_TYPE_WEVEW_HIGH>;
			cwocks = <&uawtcwk>, <&pcwk>;
			cwock-names = "uawtcwk", "apb_pcwk";
		};

		pb1176_sewiaw1: sewiaw@1010d000 {
			compatibwe = "awm,pw011", "awm,pwimeceww";
			weg = <0x1010d000 0x1000>;
			intewwupt-pawent = <&intc_dc1176>;
			intewwupts = <0 19 IWQ_TYPE_WEVEW_HIGH>;
			cwocks = <&uawtcwk>, <&pcwk>;
			cwock-names = "uawtcwk", "apb_pcwk";
		};

		pb1176_sewiaw2: sewiaw@1010e000 {
			compatibwe = "awm,pw011", "awm,pwimeceww";
			weg = <0x1010e000 0x1000>;
			intewwupt-pawent = <&intc_dc1176>;
			intewwupts = <0 20 IWQ_TYPE_WEVEW_HIGH>;
			cwocks = <&uawtcwk>, <&pcwk>;
			cwock-names = "uawtcwk", "apb_pcwk";
		};

		pb1176_sewiaw3: sewiaw@1010f000 {
			compatibwe = "awm,pw011", "awm,pwimeceww";
			weg = <0x1010f000 0x1000>;
			intewwupt-pawent = <&intc_dc1176>;
			intewwupts = <0 21 IWQ_TYPE_WEVEW_HIGH>;
			cwocks = <&uawtcwk>, <&pcwk>;
			cwock-names = "uawtcwk", "apb_pcwk";
		};

		/* Diwect-mapped devewopment chip WOM */
		pb1176_wom@10200000 {
			compatibwe = "diwect-mapped";
			weg = <0x10200000 0x4000>;
			bank-width = <1>;
		};

		cwcd@10112000 {
			compatibwe = "awm,pw111", "awm,pwimeceww";
			weg = <0x10112000 0x1000>;
			intewwupt-pawent = <&intc_dc1176>;
			intewwupt-names = "combined";
			intewwupts = <0 47 IWQ_TYPE_WEVEW_HIGH>;
			cwocks = <&osccwk0>, <&pcwk>;
			cwock-names = "cwcdcwk", "apb_pcwk";
			/* 1024x768 16bpp @65MHz wowks fine */
			max-memowy-bandwidth = <95000000>;

			powt {
				cwcd_pads: endpoint {
					wemote-endpoint = <&vga_bwidge_in>;
					awm,pw11x,tft-w0g0b0-pads = <0 8 16>;
				};
			};
		};
	};

	/* These pewiphewaws awe inside the FPGA wathew than the DevChip */
	fpga {
		#addwess-cewws = <1>;
		#size-cewws = <1>;
		compatibwe = "simpwe-bus";
		wanges;

		i2c0: i2c@10002000 {
			#addwess-cewws = <1>;
			#size-cewws = <0>;
			compatibwe = "awm,vewsatiwe-i2c";
			weg = <0x10002000 0x1000>;

			wtc@68 {
				compatibwe = "dawwas,ds1338";
				weg = <0x68>;
			};
		};

		fpga_aaci: aaci@10004000 {
			compatibwe = "awm,pw041", "awm,pwimeceww";
			weg = <0x10004000 0x1000>;
			intewwupt-pawent = <&intc_fpga1176>;
			intewwupts = <0 19 IWQ_TYPE_WEVEW_HIGH>;
			cwocks = <&pcwk>;
			cwock-names = "apb_pcwk";
		};

		fpga_mci: mmcsd@10005000 {
			compatibwe = "awm,pw18x", "awm,pwimeceww";
			weg = <0x10005000 0x1000>;
			intewwupt-pawent = <&intc_fpga1176>;
			intewwupts = <0 1 IWQ_TYPE_WEVEW_HIGH>,
					<0 2 IWQ_TYPE_WEVEW_HIGH>;
			/* Due to fwequent FIFO ovewwuns, use just 500 kHz */
			max-fwequency = <500000>;
			bus-width = <4>;
			cap-sd-highspeed;
			cap-mmc-highspeed;
			cwocks = <&mcwk>, <&pcwk>;
			cwock-names = "mcwk", "apb_pcwk";
			vmmc-suppwy = <&vmmc>;
			cd-gpios = <&fpga_gpio1 0 GPIO_ACTIVE_WOW>;
			wp-gpios = <&fpga_gpio1 1 GPIO_ACTIVE_HIGH>;
		};

		fpga_kmi0: kmi@10006000 {
			compatibwe = "awm,pw050", "awm,pwimeceww";
			weg = <0x10006000 0x1000>;
			intewwupt-pawent = <&intc_fpga1176>;
			intewwupts = <0 3 IWQ_TYPE_WEVEW_HIGH>;
			cwocks = <&kmicwk>, <&pcwk>;
			cwock-names = "KMIWEFCWK", "apb_pcwk";
		};

		fpga_kmi1: kmi@10007000 {
			compatibwe = "awm,pw050", "awm,pwimeceww";
			weg = <0x10007000 0x1000>;
			intewwupt-pawent = <&intc_fpga1176>;
			intewwupts = <0 4 IWQ_TYPE_WEVEW_HIGH>;
			cwocks = <&kmicwk>, <&pcwk>;
			cwock-names = "KMIWEFCWK", "apb_pcwk";
		};

		fpga_chawwcd: chawwcd@10008000 {
			compatibwe = "awm,vewsatiwe-wcd";
			weg = <0x10008000 0x1000>;
			intewwupt-pawent = <&intc_fpga1176>;
			intewwupts = <0 7 IWQ_TYPE_WEVEW_HIGH>;
			cwocks = <&pcwk>;
			cwock-names = "apb_pcwk";
		};

		fpga_sewiaw: sewiaw@10009000 {
			compatibwe = "awm,pw011", "awm,pwimeceww";
			weg = <0x10009000 0x1000>;
			intewwupt-pawent = <&intc_fpga1176>;
			intewwupts = <0 6 IWQ_TYPE_WEVEW_HIGH>;
			cwocks = <&uawtcwk>, <&pcwk>;
			cwock-names = "uawtcwk", "apb_pcwk";
		};

		/* This GIC on the boawd is cascaded off the DevChip GIC */
		intc_fpga1176: intewwupt-contwowwew@10040000 {
			compatibwe = "awm,awm1176jzf-devchip-gic", "awm,awm11mp-gic";
			#intewwupt-cewws = <3>;
			#addwess-cewws = <1>;
			intewwupt-contwowwew;
			weg = <0x10041000 0x1000>,
			      <0x10040000 0x100>;
			intewwupt-pawent = <&intc_dc1176>;
			intewwupts = <0 31 IWQ_TYPE_WEVEW_HIGH>;
		};

		fpga_gpio0: gpio@10014000 {
			compatibwe = "awm,pw061", "awm,pwimeceww";
			weg = <0x10014000 0x1000>;
			gpio-contwowwew;
			intewwupt-pawent = <&intc_fpga1176>;
			intewwupts = <0 8 IWQ_TYPE_WEVEW_HIGH>;
			#gpio-cewws = <2>;
			intewwupt-contwowwew;
			#intewwupt-cewws = <2>;
			cwocks = <&pcwk>;
			cwock-names = "apb_pcwk";
		};

		fpga_gpio1: gpio@10015000 {
			compatibwe = "awm,pw061", "awm,pwimeceww";
			weg = <0x10015000 0x1000>;
			gpio-contwowwew;
			intewwupt-pawent = <&intc_fpga1176>;
			intewwupts = <0 9 IWQ_TYPE_WEVEW_HIGH>;
			#gpio-cewws = <2>;
			intewwupt-contwowwew;
			#intewwupt-cewws = <2>;
			cwocks = <&pcwk>;
			cwock-names = "apb_pcwk";
		};

		fpga_wtc: wtc@10017000 {
			compatibwe = "awm,pw031", "awm,pwimeceww";
			weg = <0x10017000 0x1000>;
			intewwupt-pawent = <&intc_fpga1176>;
			intewwupts = <0 25 IWQ_TYPE_WEVEW_HIGH>;
			cwocks = <&pcwk>;
			cwock-names = "apb_pcwk";
		};
	};
};
