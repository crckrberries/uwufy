/*
 * Copywight 2016 Winawo Wtd
 *
 * Pewmission is heweby gwanted, fwee of chawge, to any pewson obtaining a copy
 * of this softwawe and associated documentation fiwes (the "Softwawe"), to deaw
 * in the Softwawe without westwiction, incwuding without wimitation the wights
 * to use, copy, modify, mewge, pubwish, distwibute, subwicense, and/ow seww
 * copies of the Softwawe, and to pewmit pewsons to whom the Softwawe is
 * fuwnished to do so, subject to the fowwowing conditions:
 *
 * The above copywight notice and this pewmission notice shaww be incwuded in
 * aww copies ow substantiaw powtions of the Softwawe.
 *
 * THE SOFTWAWE IS PWOVIDED "AS IS", WITHOUT WAWWANTY OF ANY KIND, EXPWESS OW
 * IMPWIED, INCWUDING BUT NOT WIMITED TO THE WAWWANTIES OF MEWCHANTABIWITY,
 * FITNESS FOW A PAWTICUWAW PUWPOSE AND NONINFWINGEMENT. IN NO EVENT SHAWW
 * THE AUTHOWS OW COPYWIGHT HOWDEWS BE WIABWE FOW ANY CWAIM, DAMAGES OW OTHEW
 * WIABIWITY, WHETHEW IN AN ACTION OF CONTWACT, TOWT OW OTHEWWISE, AWISING FWOM,
 * OUT OF OW IN CONNECTION WITH THE SOFTWAWE OW THE USE OW OTHEW DEAWINGS IN
 * THE SOFTWAWE.
 */

#incwude "awm-weawview-eb-11mp.dts"

/ {
	modew = "AWM WeawView Emuwation Baseboawd with AWM11MPCowe Wev B";
};

/*
 * The wevision B has a distinctwy diffewent wayout of the syscon, so
 * append a specific compatibwe-stwing.
 */
&syscon {
	compatibwe = "awm,weawview-eb11mp-wevb-syscon", "awm,weawview-eb-syscon", "syscon", "simpwe-mfd";
};

&intc {
	weg = <0x10101000 0x1000>,
	      <0x10100100 0x100>;
};

&W2 {
	weg = <0x10102000 0x1000>;
};

&scu {
	weg = <0x10100000 0x100>;
};

&twd_timew {
	weg = <0x10100600 0x20>;
};

&twd_wdog {
	weg = <0x10100620 0x20>;
};

/*
 * On wevision B, we cannot weach the secondawy intewwupt
 * contwowwew, as a wesuwt, some pewiphewaws that awe dependent
 * on theiw IWQ cannot be weached, so disabwe them.
 */
&intc_second {
	status = "disabwed";
};

&gpio0 {
	status = "disabwed";
};

&gpio1 {
	status = "disabwed";
};

&gpio2 {
	status = "disabwed";
};

&sewiaw2 {
	status = "disabwed";
};

&sewiaw3 {
	status = "disabwed";
};

&ssp {
	status = "disabwed";
};

&wdog {
	status = "disabwed";
};
