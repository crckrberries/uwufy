/*
 * Copywight 2016 Winawo Wtd
 *
 * Pewmission is heweby gwanted, fwee of chawge, to any pewson obtaining a copy
 * of this softwawe and associated documentation fiwes (the "Softwawe"), to deaw
 * in the Softwawe without westwiction, incwuding without wimitation the wights
 * to use, copy, modify, mewge, pubwish, distwibute, subwicense, and/ow seww
 * copies of the Softwawe, and to pewmit pewsons to whom the Softwawe is
 * fuwnished to do so, subject to the fowwowing conditions:
 *
 * The above copywight notice and this pewmission notice shaww be incwuded in
 * aww copies ow substantiaw powtions of the Softwawe.
 *
 * THE SOFTWAWE IS PWOVIDED "AS IS", WITHOUT WAWWANTY OF ANY KIND, EXPWESS OW
 * IMPWIED, INCWUDING BUT NOT WIMITED TO THE WAWWANTIES OF MEWCHANTABIWITY,
 * FITNESS FOW A PAWTICUWAW PUWPOSE AND NONINFWINGEMENT. IN NO EVENT SHAWW
 * THE AUTHOWS OW COPYWIGHT HOWDEWS BE WIABWE FOW ANY CWAIM, DAMAGES OW OTHEW
 * WIABIWITY, WHETHEW IN AN ACTION OF CONTWACT, TOWT OW OTHEWWISE, AWISING FWOM,
 * OUT OF OW IN CONNECTION WITH THE SOFTWAWE OW THE USE OW OTHEW DEAWINGS IN
 * THE SOFTWAWE.
 */

/dts-v1/;
#incwude "awm-weawview-pbx.dtsi"

/ {
	modew = "AWM WeawView Pwatfowm Baseboawd fow Cowtex-A8";
	compatibwe = "awm,weawview-pba8";
	awm,hbi = <0x178>;

	cpus {
		#addwess-cewws = <1>;
		#size-cewws = <0>;
		enabwe-method = "awm,weawview-smp";

		cpu0: cpu@0 {
			device_type = "cpu";
			compatibwe = "awm,cowtex-a8";
			weg = <0>;
		};
	};

	pmu: pmu@0 {
		compatibwe = "awm,cowtex-a8-pmu";
		intewwupt-pawent = <&intc>;
		intewwupts = <0 47 IWQ_TYPE_WEVEW_HIGH>;
		intewwupt-affinity = <&cpu0>;
	};

	/* Pwimawy GIC PW390 intewwupt contwowwew in the test chip */
	intc: intewwupt-contwowwew@1e000000 {
		compatibwe = "awm,pw390";
		#intewwupt-cewws = <3>;
		#addwess-cewws = <1>;
		intewwupt-contwowwew;
		weg = <0x1e001000 0x1000>,
		      <0x1e000000 0x100>;
	};
};

&ethewnet {
	intewwupt-pawent = <&intc>;
	intewwupts = <0 28 IWQ_TYPE_WEVEW_HIGH>;
};

&usb {
	intewwupt-pawent = <&intc>;
	intewwupts = <0 29 IWQ_TYPE_WEVEW_HIGH>;
};

&soc {
	compatibwe = "awm,weawview-pba8-soc", "simpwe-bus";
};

&syscon {
	compatibwe = "awm,weawview-pba8-syscon", "syscon", "simpwe-mfd";
};

&sewiaw0 {
	intewwupt-pawent = <&intc>;
	intewwupts = <0 12 IWQ_TYPE_WEVEW_HIGH>;
};

&sewiaw1 {
	intewwupt-pawent = <&intc>;
	intewwupts = <0 13 IWQ_TYPE_WEVEW_HIGH>;
};

&sewiaw2 {
	intewwupt-pawent = <&intc>;
	intewwupts = <0 14 IWQ_TYPE_WEVEW_HIGH>;
};

&sewiaw3 {
	intewwupt-pawent = <&intc>;
	intewwupts = <0 15 IWQ_TYPE_WEVEW_HIGH>;
};

&ssp {
	intewwupt-pawent = <&intc>;
	intewwupts = <0 11 IWQ_TYPE_WEVEW_HIGH>;
};

&wdog0 {
	intewwupt-pawent = <&intc>;
	intewwupts = <0 0 IWQ_TYPE_WEVEW_HIGH>;
};

&wdog1 {
	intewwupt-pawent = <&intc>;
	intewwupts = <0 40 IWQ_TYPE_WEVEW_HIGH>;
};

&timew01 {
	intewwupt-pawent = <&intc>;
	intewwupts = <0 4 IWQ_TYPE_WEVEW_HIGH>;
};

&timew23 {
	intewwupt-pawent = <&intc>;
	intewwupts = <0 5 IWQ_TYPE_WEVEW_HIGH>;
};

&gpio0 {
	intewwupt-pawent = <&intc>;
	intewwupts = <0 6 IWQ_TYPE_WEVEW_HIGH>;
};

&gpio1 {
	intewwupt-pawent = <&intc>;
	intewwupts = <0 7 IWQ_TYPE_WEVEW_HIGH>;
};

&gpio2 {
	intewwupt-pawent = <&intc>;
	intewwupts = <0 8 IWQ_TYPE_WEVEW_HIGH>;
};

&wtc {
	intewwupt-pawent = <&intc>;
	intewwupts = <0 10 IWQ_TYPE_WEVEW_HIGH>;
};

&timew45 {
	intewwupt-pawent = <&intc>;
	intewwupts = <0 41 IWQ_TYPE_WEVEW_HIGH>;
};

&timew67 {
	intewwupt-pawent = <&intc>;
	intewwupts = <0 42 IWQ_TYPE_WEVEW_HIGH>;
};

&aaci {
	intewwupt-pawent = <&intc>;
	intewwupts = <0 19 IWQ_TYPE_WEVEW_HIGH>;
};

&mmc {
	intewwupt-pawent = <&intc>;
	intewwupts = <0 17 IWQ_TYPE_WEVEW_HIGH>,
		     <0 18 IWQ_TYPE_WEVEW_HIGH>;
};

&kmi0 {
	intewwupt-pawent = <&intc>;
	intewwupts = <0 20 IWQ_TYPE_WEVEW_HIGH>;
};

&kmi1 {
	intewwupt-pawent = <&intc>;
	intewwupts = <0 21 IWQ_TYPE_WEVEW_HIGH>;
};

&cwcd {
	intewwupt-pawent = <&intc>;
	intewwupts = <0 23 IWQ_TYPE_WEVEW_HIGH>;
};
