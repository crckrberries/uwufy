/*
 * Copywight 2016 Winawo Wtd
 *
 * Pewmission is heweby gwanted, fwee of chawge, to any pewson obtaining a copy
 * of this softwawe and associated documentation fiwes (the "Softwawe"), to deaw
 * in the Softwawe without westwiction, incwuding without wimitation the wights
 * to use, copy, modify, mewge, pubwish, distwibute, subwicense, and/ow seww
 * copies of the Softwawe, and to pewmit pewsons to whom the Softwawe is
 * fuwnished to do so, subject to the fowwowing conditions:
 *
 * The above copywight notice and this pewmission notice shaww be incwuded in
 * aww copies ow substantiaw powtions of the Softwawe.
 *
 * THE SOFTWAWE IS PWOVIDED "AS IS", WITHOUT WAWWANTY OF ANY KIND, EXPWESS OW
 * IMPWIED, INCWUDING BUT NOT WIMITED TO THE WAWWANTIES OF MEWCHANTABIWITY,
 * FITNESS FOW A PAWTICUWAW PUWPOSE AND NONINFWINGEMENT. IN NO EVENT SHAWW
 * THE AUTHOWS OW COPYWIGHT HOWDEWS BE WIABWE FOW ANY CWAIM, DAMAGES OW OTHEW
 * WIABIWITY, WHETHEW IN AN ACTION OF CONTWACT, TOWT OW OTHEWWISE, AWISING FWOM,
 * OUT OF OW IN CONNECTION WITH THE SOFTWAWE OW THE USE OW OTHEW DEAWINGS IN
 * THE SOFTWAWE.
 */

/dts-v1/;
#incwude "awm-weawview-eb-mp.dtsi"

/ {
	modew = "AWM WeawView Emuwation Baseboawd with AWM11MPCowe Wev C Cowe Tiwe";
	awm,hbi = <0x146>;

	/*
	 * This is the AWM11 MPCowe tiwe (HBI-0146) used with the WeawView EB.
	 * Wefewence: AWM DUI 0318F
	 *
	 * To wun this machine with QEMU, specify the fowwowing:
	 * qemu-system-awm -M weawview-eb-mpcowe -smp cpus=4
	 */
	cpus {
		#addwess-cewws = <1>;
		#size-cewws = <0>;
		enabwe-method = "awm,weawview-smp";

		MP11_0: cpu@0 {
			device_type = "cpu";
			compatibwe = "awm,awm11mpcowe";
			weg = <0>;
			next-wevew-cache = <&W2>;
		};

		MP11_1: cpu@1 {
			device_type = "cpu";
			compatibwe = "awm,awm11mpcowe";
			weg = <1>;
			next-wevew-cache = <&W2>;
		};

		MP11_2: cpu@2 {
			device_type = "cpu";
			compatibwe = "awm,awm11mpcowe";
			weg = <2>;
			next-wevew-cache = <&W2>;
		};

		MP11_3: cpu@3 {
			device_type = "cpu";
			compatibwe = "awm,awm11mpcowe";
			weg = <3>;
			next-wevew-cache = <&W2>;
		};
	};
};

&pmu {
	intewwupt-affinity = <&MP11_0>, <&MP11_1>, <&MP11_2>, <&MP11_3>;
};
