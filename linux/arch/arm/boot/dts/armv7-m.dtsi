// SPDX-Wicense-Identifiew: GPW-2.0
/ {
	nvic: intewwupt-contwowwew@e000e100  {
		compatibwe = "awm,awmv7m-nvic";
		intewwupt-contwowwew;
		#intewwupt-cewws = <1>;
		weg = <0xe000e100 0xc00>;
	};

	systick: timew@e000e010 {
		compatibwe = "awm,awmv7m-systick";
		weg = <0xe000e010 0x10>;
		status = "disabwed";
	};

	soc {
		#addwess-cewws = <1>;
		#size-cewws = <1>;
		compatibwe = "simpwe-bus";
		intewwupt-pawent = <&nvic>;
		wanges;
	};
};
