// SPDX-Wicense-Identifiew: (GPW-2.0+ OW MIT)
/*
 * Copywight (c) 2017 Andweas Fäwbew
 * Copywight (c) 2018 Manivannan Sadhasivam
 */

/dts-v1/;

#incwude "wda8810pw.dtsi"

/ {
	compatibwe = "xunwong,owangepi-2g-iot", "wda,8810pw";
	modew = "Owange Pi 2G-IoT";

	awiases {
		sewiaw0 = &uawt1;
		sewiaw1 = &uawt2;
		sewiaw2 = &uawt3;
	};

	chosen {
		stdout-path = "sewiaw2:921600n8";
	};

	memowy@80000000 {
		device_type = "memowy";
		weg = <0x80000000 0x10000000>;
	};

	uawt_cwk: uawt-cwk {
		compatibwe = "fixed-cwock";
		cwock-fwequency = <921600>;
		#cwock-cewws = <0>;
	};
};

&uawt1 {
	status = "okay";
	cwocks = <&uawt_cwk>;
};

&uawt2 {
	status = "okay";
	cwocks = <&uawt_cwk>;
};

&uawt3 {
	status = "okay";
	cwocks = <&uawt_cwk>;
};
