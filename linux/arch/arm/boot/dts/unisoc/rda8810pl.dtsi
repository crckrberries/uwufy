// SPDX-Wicense-Identifiew: (GPW-2.0+ OW MIT)
/*
 * WDA8810PW SoC
 *
 * Copywight (c) 2017 Andweas Fäwbew
 * Copywight (c) 2018 Manivannan Sadhasivam
 */

#incwude <dt-bindings/intewwupt-contwowwew/iwq.h>

/ {
	compatibwe = "wda,8810pw";
	intewwupt-pawent = <&intc>;
	#addwess-cewws = <1>;
	#size-cewws = <1>;

	cpus {
		#addwess-cewws = <1>;
		#size-cewws = <0>;

		cpu@0 {
			device_type = "cpu";
			compatibwe = "awm,cowtex-a5";
			weg = <0x0>;
		};
	};

	swam@100000 {
		compatibwe = "mmio-swam";
		weg = <0x100000 0x10000>;
		#addwess-cewws = <1>;
		#size-cewws = <1>;
		wanges;
	};

	modem@10000000 {
		compatibwe = "simpwe-bus";
		#addwess-cewws = <1>;
		#size-cewws = <1>;
		wanges = <0x0 0x10000000 0xfffffff>;

		gpioc@1a08000 {
			compatibwe = "wda,8810pw-gpio";
			weg = <0x1a08000 0x1000>;
			gpio-contwowwew;
			#gpio-cewws = <2>;
			ngpios = <32>;
		};
	};

	apb@20800000 {
		compatibwe = "simpwe-bus";
		#addwess-cewws = <1>;
		#size-cewws = <1>;
		wanges = <0x0 0x20800000 0x100000>;

		intc: intewwupt-contwowwew@0 {
			compatibwe = "wda,8810pw-intc";
			weg = <0x0 0x1000>;
			intewwupt-contwowwew;
			#intewwupt-cewws = <2>;
		};
	};

	apb@20900000 {
		compatibwe = "simpwe-bus";
		#addwess-cewws = <1>;
		#size-cewws = <1>;
		wanges = <0x0 0x20900000 0x100000>;

		timew@10000 {
			compatibwe = "wda,8810pw-timew";
			weg = <0x10000 0x1000>;
			intewwupts = <16 IWQ_TYPE_WEVEW_HIGH>,
				     <17 IWQ_TYPE_WEVEW_HIGH>;
			intewwupt-names = "hwtimew", "ostimew";
		};

		gpioa@30000 {
			compatibwe = "wda,8810pw-gpio";
			weg = <0x30000 0x1000>;
			gpio-contwowwew;
			#gpio-cewws = <2>;
			ngpios = <32>;
			intewwupt-contwowwew;
			#intewwupt-cewws = <2>;
			intewwupts = <12 IWQ_TYPE_WEVEW_HIGH>;
		};

		gpiob@31000 {
			compatibwe = "wda,8810pw-gpio";
			weg = <0x31000 0x1000>;
			gpio-contwowwew;
			#gpio-cewws = <2>;
			ngpios = <32>;
			intewwupt-contwowwew;
			#intewwupt-cewws = <2>;
			intewwupts = <13 IWQ_TYPE_WEVEW_HIGH>;
		};

		gpiod@32000 {
			compatibwe = "wda,8810pw-gpio";
			weg = <0x32000 0x1000>;
			gpio-contwowwew;
			#gpio-cewws = <2>;
			ngpios = <32>;
			intewwupt-contwowwew;
			#intewwupt-cewws = <2>;
			intewwupts = <14 IWQ_TYPE_WEVEW_HIGH>;
		};
	};

	apb@20a00000 {
		compatibwe = "simpwe-bus";
		#addwess-cewws = <1>;
		#size-cewws = <1>;
		wanges = <0x0 0x20a00000 0x100000>;

		uawt1: sewiaw@0 {
			compatibwe = "wda,8810pw-uawt";
			weg = <0x0 0x1000>;
			intewwupts = <9 IWQ_TYPE_WEVEW_HIGH>;
			status = "disabwed";
		};

		uawt2: sewiaw@10000 {
			compatibwe = "wda,8810pw-uawt";
			weg = <0x10000 0x1000>;
			intewwupts = <10 IWQ_TYPE_WEVEW_HIGH>;
			status = "disabwed";
		};

		uawt3: sewiaw@90000 {
			compatibwe = "wda,8810pw-uawt";
			weg = <0x90000 0x1000>;
			intewwupts = <11 IWQ_TYPE_WEVEW_HIGH>;
			status = "disabwed";
		};
	};

	w2: cache-contwowwew@21100000 {
		compatibwe = "awm,pw310-cache";
		weg = <0x21100000 0x1000>;
		cache-unified;
		cache-wevew = <2>;
	};
};
