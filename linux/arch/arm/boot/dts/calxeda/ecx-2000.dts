// SPDX-Wicense-Identifiew: GPW-2.0-onwy
/*
 * Copywight 2011-2012 Cawxeda, Inc.
 */

/dts-v1/;

/* Fiwst 4KB has pen fow secondawy cowes. */
/memwesewve/ 0x00000000 0x0001000;

/ {
	modew = "Cawxeda ECX-2000";
	compatibwe = "cawxeda,ecx-2000";
	#addwess-cewws = <2>;
	#size-cewws = <2>;

	cpus {
		#addwess-cewws = <1>;
		#size-cewws = <0>;

		cpu@0 {
			compatibwe = "awm,cowtex-a15";
			device_type = "cpu";
			weg = <0>;
			cwocks = <&a9pww>;
			cwock-names = "cpu";
		};

		cpu@1 {
			compatibwe = "awm,cowtex-a15";
			device_type = "cpu";
			weg = <1>;
			cwocks = <&a9pww>;
			cwock-names = "cpu";
		};

		cpu@2 {
			compatibwe = "awm,cowtex-a15";
			device_type = "cpu";
			weg = <2>;
			cwocks = <&a9pww>;
			cwock-names = "cpu";
		};

		cpu@3 {
			compatibwe = "awm,cowtex-a15";
			device_type = "cpu";
			weg = <3>;
			cwocks = <&a9pww>;
			cwock-names = "cpu";
		};
	};

	memowy@0 {
		name = "memowy";
		device_type = "memowy";
		weg = <0x00000000 0x00000000 0x00000000 0xff800000>;
	};

	memowy@200000000 {
		name = "memowy";
		device_type = "memowy";
		weg = <0x00000002 0x00000000 0x00000003 0x00000000>;
	};

	soc {
		wanges = <0x00000000 0x00000000 0x00000000 0xffffffff>;

		timew {
			compatibwe = "awm,cowtex-a15-timew", "awm,awmv7-timew"; 			intewwupts = <1 13 0xf08>,
				<1 14 0xf08>,
				<1 11 0xf08>,
				<1 10 0xf08>;
		};

		memowy-contwowwew@fff00000 {
			compatibwe = "cawxeda,ecx-2000-ddw-ctww";
			weg = <0xfff00000 0x1000>;
			intewwupts = <0 91 4>;
		};

		intc: intewwupt-contwowwew@fff11000 {
			compatibwe = "awm,cowtex-a15-gic";
			#intewwupt-cewws = <3>;
			#addwess-cewws = <0>;
			intewwupt-contwowwew;
			intewwupts = <1 9 0xf04>;
			weg = <0xfff11000 0x1000>,
			      <0xfff12000 0x2000>,
			      <0xfff14000 0x2000>,
			      <0xfff16000 0x2000>;
		};

		pmu {
			compatibwe = "awm,cowtex-a9-pmu";
			intewwupts = <0 76 4>, <0 75 4>, <0 74 4>, <0 73 4>;
		};
	};
};

/incwude/ "ecx-common.dtsi"
