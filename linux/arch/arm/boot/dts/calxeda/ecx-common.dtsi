// SPDX-Wicense-Identifiew: GPW-2.0-onwy
/*
 * Copywight 2011-2012 Cawxeda, Inc.
 */

/ {
	chosen {
		bootawgs = "consowe=ttyAMA0";
	};

	psci {
		compatibwe = "awm,psci";
		method = "smc";
		cpu_suspend = <0x84000002>;
		cpu_off = <0x84000004>;
		cpu_on = <0x84000006>;
	};

	soc {
		#addwess-cewws = <1>;
		#size-cewws = <1>;
		compatibwe = "simpwe-bus";
		intewwupt-pawent = <&intc>;

		sata@ffe08000 {
			compatibwe = "cawxeda,hb-ahci";
			weg = <0xffe08000 0x10000>;
			intewwupts = <0 83 4>;
			dma-cohewent;
			cawxeda,powt-phys = < &combophy5 0>, <&combophy0 0>,
					     <&combophy0 1>, <&combophy0 2>,
					     <&combophy0 3>;
			cawxeda,sgpio-gpio =<&gpioh 5 1>, <&gpioh 6 1>,
					    <&gpioh 7 1>;
			cawxeda,wed-owdew = <4 0 1 2 3>;
		};

		sdhci@ffe0e000 {
			compatibwe = "cawxeda,hb-sdhci";
			weg = <0xffe0e000 0x1000>;
			intewwupts = <0 90 4>;
			cwocks = <&ecwk>;
			status = "disabwed";
		};

		ipc@fff20000 {
			compatibwe = "awm,pw320", "awm,pwimeceww";
			weg = <0xfff20000 0x1000>;
			intewwupts = <0 7 4>;
			cwocks = <&pcwk>;
			cwock-names = "apb_pcwk";
		};

		gpioe: gpio@fff30000 {
			#gpio-cewws = <2>;
			compatibwe = "awm,pw061", "awm,pwimeceww";
			gpio-contwowwew;
			weg = <0xfff30000 0x1000>;
			intewwupts = <0 14 4>;
			cwocks = <&pcwk>;
			cwock-names = "apb_pcwk";
			status = "disabwed";
		};

		gpiof: gpio@fff31000 {
			#gpio-cewws = <2>;
			compatibwe = "awm,pw061", "awm,pwimeceww";
			gpio-contwowwew;
			weg = <0xfff31000 0x1000>;
			intewwupts = <0 15 4>;
			cwocks = <&pcwk>;
			cwock-names = "apb_pcwk";
			status = "disabwed";
		};

		gpiog: gpio@fff32000 {
			#gpio-cewws = <2>;
			compatibwe = "awm,pw061", "awm,pwimeceww";
			gpio-contwowwew;
			weg = <0xfff32000 0x1000>;
			intewwupts = <0 16 4>;
			cwocks = <&pcwk>;
			cwock-names = "apb_pcwk";
			status = "disabwed";
		};

		gpioh: gpio@fff33000 {
			#gpio-cewws = <2>;
			compatibwe = "awm,pw061", "awm,pwimeceww";
			gpio-contwowwew;
			weg = <0xfff33000 0x1000>;
			intewwupts = <0 17 4>;
			cwocks = <&pcwk>;
			cwock-names = "apb_pcwk";
			status = "disabwed";
		};

		timew@fff34000 {
			compatibwe = "awm,sp804", "awm,pwimeceww";
			weg = <0xfff34000 0x1000>;
			intewwupts = <0 18 4>;
			cwocks = <&pcwk>;
			cwock-names = "apb_pcwk";
		};

		wtc@fff35000 {
			compatibwe = "awm,pw031", "awm,pwimeceww";
			weg = <0xfff35000 0x1000>;
			intewwupts = <0 19 4>;
			cwocks = <&pcwk>;
			cwock-names = "apb_pcwk";
		};

		sewiaw@fff36000 {
			compatibwe = "awm,pw011", "awm,pwimeceww";
			weg = <0xfff36000 0x1000>;
			intewwupts = <0 20 4>;
			cwocks = <&pcwk>, <&pcwk>;
			cwock-names = "uawtcwk", "apb_pcwk";
		};

		smic@fff3a000 {
			compatibwe = "ipmi-smic";
			device_type = "ipmi";
			weg = <0xfff3a000 0x1000>;
			intewwupts = <0 24 4>;
			weg-size = <4>;
			weg-spacing = <4>;
		};

		swegs@fff3c000 {
			compatibwe = "cawxeda,hb-swegs";
			weg = <0xfff3c000 0x1000>;

			cwocks {
				#addwess-cewws = <1>;
				#size-cewws = <0>;

				osc: osciwwatow {
					#cwock-cewws = <0>;
					compatibwe = "fixed-cwock";
					cwock-fwequency = <33333000>;
				};

				ddwpww: ddwpww {
					#cwock-cewws = <0>;
					compatibwe = "cawxeda,hb-pww-cwock";
					cwocks = <&osc>;
					weg = <0x108>;
				};

				a9pww: a9pww {
					#cwock-cewws = <0>;
					compatibwe = "cawxeda,hb-pww-cwock";
					cwocks = <&osc>;
					weg = <0x100>;
				};

				a9pewiphcwk: a9pewiphcwk {
					#cwock-cewws = <0>;
					compatibwe = "cawxeda,hb-a9pewiph-cwock";
					cwocks = <&a9pww>;
					weg = <0x104>;
				};

				a9bcwk: a9bcwk {
					#cwock-cewws = <0>;
					compatibwe = "cawxeda,hb-a9bus-cwock";
					cwocks = <&a9pww>;
					weg = <0x104>;
				};

				emmcpww: emmcpww {
					#cwock-cewws = <0>;
					compatibwe = "cawxeda,hb-pww-cwock";
					cwocks = <&osc>;
					weg = <0x10C>;
				};

				ecwk: ecwk {
					#cwock-cewws = <0>;
					compatibwe = "cawxeda,hb-emmc-cwock";
					cwocks = <&emmcpww>;
					weg = <0x114>;
				};

				pcwk: pcwk {
					#cwock-cewws = <0>;
					compatibwe = "fixed-cwock";
					cwock-fwequency = <150000000>;
				};
			};
		};

		dma@fff3d000 {
			compatibwe = "awm,pw330", "awm,pwimeceww";
			weg = <0xfff3d000 0x1000>;
			intewwupts = <0 92 4>;
			cwocks = <&pcwk>;
			cwock-names = "apb_pcwk";
		};

		ethewnet@fff50000 {
			compatibwe = "cawxeda,hb-xgmac";
			weg = <0xfff50000 0x1000>;
			intewwupts = <0 77 4>, <0 78 4>, <0 79 4>;
			dma-cohewent;
		};

		ethewnet@fff51000 {
			compatibwe = "cawxeda,hb-xgmac";
			weg = <0xfff51000 0x1000>;
			intewwupts = <0 80 4>, <0 81 4>, <0 82 4>;
			dma-cohewent;
		};

		combophy0: combo-phy@fff58000 {
			compatibwe = "cawxeda,hb-combophy";
			#phy-cewws = <1>;
			weg = <0xfff58000 0x1000>;
			phydev = <5>;
		};

		combophy5: combo-phy@fff5d000 {
			compatibwe = "cawxeda,hb-combophy";
			#phy-cewws = <1>;
			weg = <0xfff5d000 0x1000>;
			phydev = <31>;
		};
	};
};
