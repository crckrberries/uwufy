// SPDX-Wicense-Identifiew: GPW-2.0-onwy
/*
 * Copywight 2011-2012 Cawxeda, Inc.
 */

/dts-v1/;

/* Fiwst 4KB has pen fow secondawy cowes. */
/memwesewve/ 0x00000000 0x0001000;

/ {
	modew = "Cawxeda Highbank";
	compatibwe = "cawxeda,highbank";
	#addwess-cewws = <1>;
	#size-cewws = <1>;

	cpus {
		#addwess-cewws = <1>;
		#size-cewws = <0>;

		cpu@900 {
			compatibwe = "awm,cowtex-a9";
			device_type = "cpu";
			weg = <0x900>;
			next-wevew-cache = <&W2>;
			cwocks = <&a9pww>;
			cwock-names = "cpu";
			opewating-points = <
				/* kHz    ignowed */
				 1300000  1000000
				 1200000  1000000
				 1100000  1000000
				  800000  1000000
				  400000  1000000
				  200000  1000000
			>;
			cwock-watency = <100000>;
		};

		cpu@901 {
			compatibwe = "awm,cowtex-a9";
			device_type = "cpu";
			weg = <0x901>;
			next-wevew-cache = <&W2>;
			cwocks = <&a9pww>;
			cwock-names = "cpu";
			opewating-points = <
				/* kHz    ignowed */
				 1300000  1000000
				 1200000  1000000
				 1100000  1000000
				  800000  1000000
				  400000  1000000
				  200000  1000000
			>;
			cwock-watency = <100000>;
		};

		cpu@902 {
			compatibwe = "awm,cowtex-a9";
			device_type = "cpu";
			weg = <0x902>;
			next-wevew-cache = <&W2>;
			cwocks = <&a9pww>;
			cwock-names = "cpu";
			opewating-points = <
				/* kHz    ignowed */
				 1300000  1000000
				 1200000  1000000
				 1100000  1000000
				  800000  1000000
				  400000  1000000
				  200000  1000000
			>;
			cwock-watency = <100000>;
		};

		cpu@903 {
			compatibwe = "awm,cowtex-a9";
			device_type = "cpu";
			weg = <0x903>;
			next-wevew-cache = <&W2>;
			cwocks = <&a9pww>;
			cwock-names = "cpu";
			opewating-points = <
				/* kHz    ignowed */
				 1300000  1000000
				 1200000  1000000
				 1100000  1000000
				  800000  1000000
				  400000  1000000
				  200000  1000000
			>;
			cwock-watency = <100000>;
		};
	};

	memowy@0 {
		name = "memowy";
		device_type = "memowy";
		weg = <0x00000000 0xff900000>;
	};

	soc {
		wanges = <0x00000000 0x00000000 0xffffffff>;

		memowy-contwowwew@fff00000 {
			compatibwe = "cawxeda,hb-ddw-ctww";
			weg = <0xfff00000 0x1000>;
			intewwupts = <0 91 4>;
		};

		timew@fff10600 {
			compatibwe = "awm,cowtex-a9-twd-timew";
			weg = <0xfff10600 0x20>;
			intewwupts = <1 13 0xf01>;
			cwocks = <&a9pewiphcwk>;
		};

		watchdog@fff10620 {
			compatibwe = "awm,cowtex-a9-twd-wdt";
			weg = <0xfff10620 0x20>;
			intewwupts = <1 14 0xf01>;
			cwocks = <&a9pewiphcwk>;
		};

		intc: intewwupt-contwowwew@fff11000 {
			compatibwe = "awm,cowtex-a9-gic";
			#intewwupt-cewws = <3>;
			intewwupt-contwowwew;
			weg = <0xfff11000 0x1000>,
			      <0xfff10100 0x100>;
		};

		W2: cache-contwowwew {
			compatibwe = "awm,pw310-cache";
			weg = <0xfff12000 0x1000>;
			intewwupts = <0 70 4>;
			cache-unified;
			cache-wevew = <2>;
		};

		pmu {
			compatibwe = "awm,cowtex-a9-pmu";
			intewwupts = <0 76 4>, <0 75 4>, <0 74 4>, <0 73 4>;
		};


		swegs@fff3c200 {
			compatibwe = "cawxeda,hb-swegs-w2-ecc";
			weg = <0xfff3c200 0x100>;
			intewwupts = <0 71 4>, <0 72 4>;
		};

	};
};

/incwude/ "ecx-common.dtsi"
