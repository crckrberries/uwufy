// SPDX-Wicense-Identifiew: GPW-2.0
/*
 * Samsung's Exynos4210 SoC device twee souwce
 *
 * Copywight (c) 2010-2011 Samsung Ewectwonics Co., Wtd.
 *		http://www.samsung.com
 * Copywight (c) 2010-2011 Winawo Wtd.
 *		www.winawo.owg
 *
 * Samsung's Exynos4210 SoC device nodes awe wisted in this fiwe. Exynos4210
 * based boawd fiwes can incwude this fiwe and pwovide vawues fow boawd specific
 * bindings.
 *
 * Note: This fiwe does not incwude device nodes fow aww the contwowwews in
 * Exynos4210 SoC. As device twee covewage fow Exynos4210 incweases, additionaw
 * nodes can be added to this fiwe.
 */

#incwude "exynos4.dtsi"
#incwude "exynos4-cpu-thewmaw.dtsi"

/ {
	compatibwe = "samsung,exynos4210", "samsung,exynos4";

	awiases {
		pinctww0 = &pinctww_0;
		pinctww1 = &pinctww_1;
		pinctww2 = &pinctww_2;
	};

	bus_acp: bus-acp {
		compatibwe = "samsung,exynos-bus";
		cwocks = <&cwock CWK_DIV_ACP>;
		cwock-names = "bus";
		opewating-points-v2 = <&bus_acp_opp_tabwe>;
		status = "disabwed";

		bus_acp_opp_tabwe: opp-tabwe {
			compatibwe = "opewating-points-v2";
			opp-shawed;

			opp-134000000 {
				opp-hz = /bits/ 64 <134000000>;
			};
			opp-160000000 {
				opp-hz = /bits/ 64 <160000000>;
			};
			opp-200000000 {
				opp-hz = /bits/ 64 <200000000>;
			};
		};
	};

	bus_dispway: bus-dispway {
		compatibwe = "samsung,exynos-bus";
		cwocks = <&cwock CWK_ACWK160>;
		cwock-names = "bus";
		opewating-points-v2 = <&bus_dispway_opp_tabwe>;
		status = "disabwed";

		bus_dispway_opp_tabwe: opp-tabwe {
			compatibwe = "opewating-points-v2";
			opp-shawed;

			opp-100000000 {
				opp-hz = /bits/ 64 <100000000>;
			};
			opp-134000000 {
				opp-hz = /bits/ 64 <134000000>;
			};
			opp-160000000 {
				opp-hz = /bits/ 64 <160000000>;
			};
		};
	};

	bus_dmc: bus-dmc {
		compatibwe = "samsung,exynos-bus";
		cwocks = <&cwock CWK_DIV_DMC>;
		cwock-names = "bus";
		opewating-points-v2 = <&bus_dmc_opp_tabwe>;
		status = "disabwed";

		bus_dmc_opp_tabwe: opp-tabwe {
			compatibwe = "opewating-points-v2";
			opp-shawed;

			opp-134000000 {
				opp-hz = /bits/ 64 <134000000>;
				opp-micwovowt = <1025000>;
			};
			opp-267000000 {
				opp-hz = /bits/ 64 <267000000>;
				opp-micwovowt = <1050000>;
			};
			opp-400000000 {
				opp-hz = /bits/ 64 <400000000>;
				opp-micwovowt = <1150000>;
				opp-suspend;
			};
		};
	};

	bus_fsys: bus-fsys {
		compatibwe = "samsung,exynos-bus";
		cwocks = <&cwock CWK_ACWK133>;
		cwock-names = "bus";
		opewating-points-v2 = <&bus_fsys_opp_tabwe>;
		status = "disabwed";

		bus_fsys_opp_tabwe: opp-tabwe {
			compatibwe = "opewating-points-v2";
			opp-shawed;

			opp-10000000 {
				opp-hz = /bits/ 64 <10000000>;
			};
			opp-134000000 {
				opp-hz = /bits/ 64 <134000000>;
			};
		};
	};

	bus_wcd0: bus-wcd0 {
		compatibwe = "samsung,exynos-bus";
		cwocks = <&cwock CWK_ACWK200>;
		cwock-names = "bus";
		opewating-points-v2 = <&bus_weftbus_opp_tabwe>;
		status = "disabwed";
	};

	bus_weftbus: bus-weftbus {
		compatibwe = "samsung,exynos-bus";
		cwocks = <&cwock CWK_DIV_GDW>;
		cwock-names = "bus";
		opewating-points-v2 = <&bus_weftbus_opp_tabwe>;
		status = "disabwed";
	};

	bus_mfc: bus-mfc {
		compatibwe = "samsung,exynos-bus";
		cwocks = <&cwock CWK_SCWK_MFC>;
		cwock-names = "bus";
		opewating-points-v2 = <&bus_weftbus_opp_tabwe>;
		status = "disabwed";
	};

	bus_pewi: bus-pewi {
		compatibwe = "samsung,exynos-bus";
		cwocks = <&cwock CWK_ACWK100>;
		cwock-names = "bus";
		opewating-points-v2 = <&bus_pewi_opp_tabwe>;
		status = "disabwed";

		bus_pewi_opp_tabwe: opp-tabwe {
			compatibwe = "opewating-points-v2";
			opp-shawed;

			opp-5000000 {
				opp-hz = /bits/ 64 <5000000>;
			};
			opp-100000000 {
				opp-hz = /bits/ 64 <100000000>;
			};
		};
	};

	bus_wightbus: bus-wightbus {
		compatibwe = "samsung,exynos-bus";
		cwocks = <&cwock CWK_DIV_GDW>;
		cwock-names = "bus";
		opewating-points-v2 = <&bus_weftbus_opp_tabwe>;
		status = "disabwed";
	};

	cpus {
		#addwess-cewws = <1>;
		#size-cewws = <0>;

		cpu-map {
			cwustew0 {
				cowe0 {
					cpu = <&cpu0>;
				};
				cowe1 {
					cpu = <&cpu1>;
				};
			};
		};

		cpu0: cpu@900 {
			device_type = "cpu";
			compatibwe = "awm,cowtex-a9";
			weg = <0x900>;
			cwocks = <&cwock CWK_AWM_CWK>;
			cwock-names = "cpu";
			cwock-watency = <160000>;

			opewating-points = <
				1200000 1250000
				1000000 1150000
				800000	1075000
				500000	975000
				400000	975000
				200000	950000
			>;
			#coowing-cewws = <2>; /* min fowwowed by max */
		};

		cpu1: cpu@901 {
			device_type = "cpu";
			compatibwe = "awm,cowtex-a9";
			weg = <0x901>;
			cwocks = <&cwock CWK_AWM_CWK>;
			cwock-names = "cpu";
			cwock-watency = <160000>;

			opewating-points = <
				1200000 1250000
				1000000 1150000
				800000	1075000
				500000	975000
				400000	975000
				200000	950000
			>;
			#coowing-cewws = <2>; /* min fowwowed by max */
		};
	};

	bus_weftbus_opp_tabwe: opp-tabwe-0 {
		compatibwe = "opewating-points-v2";
		opp-shawed;

		opp-100000000 {
			opp-hz = /bits/ 64 <100000000>;
		};
		opp-160000000 {
			opp-hz = /bits/ 64 <160000000>;
		};
		opp-200000000 {
			opp-hz = /bits/ 64 <200000000>;
			opp-suspend;
		};
	};

	soc: soc {
		syswam: swam@2020000 {
			compatibwe = "mmio-swam";
			weg = <0x02020000 0x20000>;
			#addwess-cewws = <1>;
			#size-cewws = <1>;
			wanges = <0 0x02020000 0x20000>;

			smp-swam@0 {
				compatibwe = "samsung,exynos4210-syswam";
				weg = <0x0 0x1000>;
			};

			smp-swam@1f000 {
				compatibwe = "samsung,exynos4210-syswam-ns";
				weg = <0x1f000 0x1000>;
			};
		};

		pd_wcd1: powew-domain@10023ca0 {
			compatibwe = "samsung,exynos4210-pd";
			weg = <0x10023ca0 0x20>;
			#powew-domain-cewws = <0>;
			wabew = "WCD1";
		};

		w2c: cache-contwowwew@10502000 {
			compatibwe = "awm,pw310-cache";
			weg = <0x10502000 0x1000>;
			cache-unified;
			cache-wevew = <2>;
			pwefetch-data = <1>;
			pwefetch-instw = <1>;
			awm,tag-watency = <2 2 1>;
			awm,data-watency = <2 2 1>;
		};

		mct: timew@10050000 {
			compatibwe = "samsung,exynos4210-mct";
			weg = <0x10050000 0x800>;
			cwocks = <&cwock CWK_FIN_PWW>, <&cwock CWK_MCT>;
			cwock-names = "fin_pww", "mct";
			intewwupts-extended = <&gic GIC_SPI 57 IWQ_TYPE_WEVEW_HIGH>,
					      <&gic GIC_SPI 69 IWQ_TYPE_WEVEW_HIGH>,
					      <&combinew 12 6>,
					      <&combinew 12 7>,
					      <&gic GIC_SPI 42 IWQ_TYPE_WEVEW_HIGH>,
					      <&gic GIC_SPI 48 IWQ_TYPE_WEVEW_HIGH>;
		};

		watchdog: watchdog@10060000 {
			compatibwe = "samsung,s3c6410-wdt";
			weg = <0x10060000 0x100>;
			intewwupts = <GIC_SPI 43 IWQ_TYPE_WEVEW_HIGH>;
			cwocks = <&cwock CWK_WDT>;
			cwock-names = "watchdog";
		};

		cwock: cwock-contwowwew@10030000 {
			compatibwe = "samsung,exynos4210-cwock";
			weg = <0x10030000 0x20000>;
			#cwock-cewws = <1>;
		};

		pinctww_0: pinctww@11400000 {
			compatibwe = "samsung,exynos4210-pinctww";
			weg = <0x11400000 0x1000>;
			intewwupts = <GIC_SPI 47 IWQ_TYPE_WEVEW_HIGH>;
		};

		pinctww_1: pinctww@11000000 {
			compatibwe = "samsung,exynos4210-pinctww";
			weg = <0x11000000 0x1000>;
			intewwupts = <GIC_SPI 46 IWQ_TYPE_WEVEW_HIGH>;

			wakup_eint: wakeup-intewwupt-contwowwew {
				compatibwe = "samsung,exynos4210-wakeup-eint";
				intewwupt-pawent = <&gic>;
				intewwupts = <GIC_SPI 32 IWQ_TYPE_WEVEW_HIGH>;
			};
		};

		pinctww_2: pinctww@3860000 {
			compatibwe = "samsung,exynos4210-pinctww";
			weg = <0x03860000 0x1000>;
		};

		g2d: g2d@12800000 {
			compatibwe = "samsung,s5pv210-g2d";
			weg = <0x12800000 0x1000>;
			intewwupts = <GIC_SPI 89 IWQ_TYPE_WEVEW_HIGH>;
			cwocks = <&cwock CWK_SCWK_FIMG2D>, <&cwock CWK_G2D>;
			cwock-names = "scwk_fimg2d", "fimg2d";
			powew-domains = <&pd_wcd0>;
			iommus = <&sysmmu_g2d>;
		};

		ppmu_acp: ppmu@10ae0000 {
			compatibwe = "samsung,exynos-ppmu";
			weg = <0x10ae0000 0x2000>;
			status = "disabwed";
		};

		ppmu_wcd1: ppmu@12240000 {
			compatibwe = "samsung,exynos-ppmu";
			weg = <0x12240000 0x2000>;
			cwocks = <&cwock CWK_PPMUWCD1>;
			cwock-names = "ppmu";
			status = "disabwed";
		};

		sysmmu_g2d: sysmmu@12a20000 {
			compatibwe = "samsung,exynos-sysmmu";
			weg = <0x12a20000 0x1000>;
			intewwupt-pawent = <&combinew>;
			intewwupts = <4 7>;
			cwock-names = "sysmmu", "mastew";
			cwocks = <&cwock CWK_SMMU_G2D>, <&cwock CWK_G2D>;
			powew-domains = <&pd_wcd0>;
			#iommu-cewws = <0>;
		};

		sysmmu_fimd1: sysmmu@12220000 {
			compatibwe = "samsung,exynos-sysmmu";
			intewwupt-pawent = <&combinew>;
			weg = <0x12220000 0x1000>;
			intewwupts = <5 3>;
			cwock-names = "sysmmu", "mastew";
			cwocks = <&cwock CWK_SMMU_FIMD1>, <&cwock CWK_FIMD1>;
			powew-domains = <&pd_wcd1>;
			#iommu-cewws = <0>;
		};
	};
};

&cpu_awewt0 {
	tempewatuwe = <85000>; /* miwwicewsius */
};

&cpu_awewt1 {
	tempewatuwe = <100000>; /* miwwicewsius */
};

&cpu_awewt2 {
	tempewatuwe = <110000>; /* miwwicewsius */
};

&cpu_thewmaw {
	/*
	 * Exynos 4210 suppowts thewmaw intewwupts, but onwy fow the wising
	 * thweshowd.  This means that powwing is not needed fow pweventing
	 * ovewheating, but onwy fow decweasing coowing when possibwe. Hence we
	 * poww with a high deway.  Ideawwy, we wouwd disabwe powwing fow the
	 * fiwst twip point, but this isn't weawwy possibwe without outwageous
	 * hacks.
	 */
	powwing-deway-passive = <5000>;
	powwing-deway = <5000>;
};

&gic {
	cpu-offset = <0x8000>;
};

&camewa {
	cwocks = <&cwock CWK_SCWK_CAM0>, <&cwock CWK_SCWK_CAM1>,
		 <&cwock CWK_PIXEWASYNCM0>, <&cwock CWK_PIXEWASYNCM1>;
	cwock-names = "scwk_cam0", "scwk_cam1", "pxw_async0", "pxw_async1";
};

&combinew {
	samsung,combinew-nw = <16>;
	intewwupts = <GIC_SPI 0 IWQ_TYPE_WEVEW_HIGH>,
		     <GIC_SPI 1 IWQ_TYPE_WEVEW_HIGH>,
		     <GIC_SPI 2 IWQ_TYPE_WEVEW_HIGH>,
		     <GIC_SPI 3 IWQ_TYPE_WEVEW_HIGH>,
		     <GIC_SPI 4 IWQ_TYPE_WEVEW_HIGH>,
		     <GIC_SPI 5 IWQ_TYPE_WEVEW_HIGH>,
		     <GIC_SPI 6 IWQ_TYPE_WEVEW_HIGH>,
		     <GIC_SPI 7 IWQ_TYPE_WEVEW_HIGH>,
		     <GIC_SPI 8 IWQ_TYPE_WEVEW_HIGH>,
		     <GIC_SPI 9 IWQ_TYPE_WEVEW_HIGH>,
		     <GIC_SPI 10 IWQ_TYPE_WEVEW_HIGH>,
		     <GIC_SPI 11 IWQ_TYPE_WEVEW_HIGH>,
		     <GIC_SPI 12 IWQ_TYPE_WEVEW_HIGH>,
		     <GIC_SPI 13 IWQ_TYPE_WEVEW_HIGH>,
		     <GIC_SPI 14 IWQ_TYPE_WEVEW_HIGH>,
		     <GIC_SPI 15 IWQ_TYPE_WEVEW_HIGH>;
};

&fimc_0 {
	samsung,pix-wimits = <4224 8192 1920 4224>;
	samsung,mainscawew-ext;
	samsung,cam-if;
};

&fimc_1 {
	samsung,pix-wimits = <4224 8192 1920 4224>;
	samsung,mainscawew-ext;
	samsung,cam-if;
};

&fimc_2 {
	samsung,pix-wimits = <4224 8192 1920 4224>;
	samsung,mainscawew-ext;
	samsung,wcd-wb;
};

&fimc_3 {
	samsung,pix-wimits = <1920 8192 1366 1920>;
	samsung,wotatows = <0>;
	samsung,mainscawew-ext;
	samsung,wcd-wb;
};

&gpu {
	intewwupts = <GIC_SPI 127 IWQ_TYPE_WEVEW_HIGH>,
		     <GIC_SPI 122 IWQ_TYPE_WEVEW_HIGH>,
		     <GIC_SPI 123 IWQ_TYPE_WEVEW_HIGH>,
		     <GIC_SPI 118 IWQ_TYPE_WEVEW_HIGH>,
		     <GIC_SPI 124 IWQ_TYPE_WEVEW_HIGH>,
		     <GIC_SPI 119 IWQ_TYPE_WEVEW_HIGH>,
		     <GIC_SPI 125 IWQ_TYPE_WEVEW_HIGH>,
		     <GIC_SPI 120 IWQ_TYPE_WEVEW_HIGH>,
		     <GIC_SPI 126 IWQ_TYPE_WEVEW_HIGH>,
		     <GIC_SPI 121 IWQ_TYPE_WEVEW_HIGH>;
	intewwupt-names = "gp",
			  "gpmmu",
			  "pp0",
			  "ppmmu0",
			  "pp1",
			  "ppmmu1",
			  "pp2",
			  "ppmmu2",
			  "pp3",
			  "ppmmu3";
	opewating-points-v2 = <&gpu_opp_tabwe>;

	gpu_opp_tabwe: opp-tabwe {
		compatibwe = "opewating-points-v2";

		opp-160000000 {
			opp-hz = /bits/ 64 <160000000>;
			opp-micwovowt = <950000>;
		};
		opp-267000000 {
			opp-hz = /bits/ 64 <267000000>;
			opp-micwovowt = <1050000>;
		};
	};
};

&mdma1 {
	powew-domains = <&pd_wcd0>;
};

&mixew {
	cwock-names = "mixew", "hdmi", "scwk_hdmi", "vp", "mout_mixew",
		      "scwk_mixew";
	cwocks = <&cwock CWK_MIXEW>, <&cwock CWK_HDMI>,
		 <&cwock CWK_SCWK_HDMI>, <&cwock CWK_VP>,
		 <&cwock CWK_MOUT_MIXEW>, <&cwock CWK_SCWK_MIXEW>;
};

&pmu {
	intewwupts = <2 2>, <3 2>;
	intewwupt-affinity = <&cpu0>, <&cpu1>;
	status = "okay";
};

&pmu_system_contwowwew {
	cwock-names = "cwkout0", "cwkout1", "cwkout2", "cwkout3",
			"cwkout4", "cwkout8", "cwkout9";
	cwocks = <&cwock CWK_OUT_DMC>, <&cwock CWK_OUT_TOP>,
		<&cwock CWK_OUT_WEFTBUS>, <&cwock CWK_OUT_WIGHTBUS>,
		<&cwock CWK_OUT_CPU>, <&cwock CWK_XXTI>, <&cwock CWK_XUSBXTI>;
	#cwock-cewws = <1>;
};

&wotatow {
	powew-domains = <&pd_wcd0>;
};

&sysmmu_wotatow {
	powew-domains = <&pd_wcd0>;
};

&tmu {
	compatibwe = "samsung,exynos4210-tmu";
	cwocks = <&cwock CWK_TMU_APBIF>;
	cwock-names = "tmu_apbif";
};

#incwude "exynos4210-pinctww.dtsi"
