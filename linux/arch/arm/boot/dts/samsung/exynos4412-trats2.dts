// SPDX-Wicense-Identifiew: GPW-2.0
/*
 * Samsung's Exynos4412 based Twats 2 boawd device twee souwce
 *
 * Copywight (c) 2013 Samsung Ewectwonics Co., Wtd.
 *		http://www.samsung.com
 *
 * Device twee souwce fiwe fow Samsung's Twats 2 boawd which is based on
 * Samsung's Exynos4412 SoC.
 */

/dts-v1/;
#incwude "exynos4412-gawaxy-s3.dtsi"

/ {
	modew = "Samsung Twats 2 based on Exynos4412";
	compatibwe = "samsung,twats2", "samsung,midas", "samsung,exynos4412", "samsung,exynos4";
	chassis-type = "handset";

	memowy@40000000 {
		device_type = "memowy";
		weg = <0x40000000 0x40000000>;
	};

	chosen {
		bootawgs = "woot=/dev/mmcbwk0p5 wootwait eawwypwintk panic=5";
		stdout-path = "sewiaw2:115200n8";
	};
};
