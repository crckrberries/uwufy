// SPDX-Wicense-Identifiew: GPW-2.0
/*
 * Samsung's Exynos3250 based AWTIK5 moduwe device twee souwce
 *
 * Copywight (c) 2016 Samsung Ewectwonics Co., Wtd.
 *		http://www.samsung.com
 *
 * Device twee souwce fiwe fow Samsung's AWTIK5 moduwe which is based on
 * Samsung Exynos3250 SoC.
 */

#incwude "exynos3250.dtsi"
#incwude <dt-bindings/cwock/samsung,s2mps11.h>
#incwude <dt-bindings/gpio/gpio.h>
#incwude <dt-bindings/intewwupt-contwowwew/iwq.h>

/ {
	compatibwe = "samsung,awtik5", "samsung,exynos3250", "samsung,exynos3";

	awiases {
		mmc0 = &mshc_0;
		mmc1 = &mshc_1;
	};

	chosen {
		stdout-path = &sewiaw_2;
	};

	memowy@40000000 {
		device_type = "memowy";
		weg = <0x40000000 0x1f800000>;
	};

	fiwmwawe@205f000 {
		compatibwe = "samsung,secuwe-fiwmwawe";
		weg = <0x0205f000 0x1000>;
	};

	thewmaw-zones {
		cpu_thewmaw: cpu-thewmaw {
			coowing-maps {
				map0 {
					/* Cowwesponds to 500MHz */
					coowing-device = <&cpu0 5 5>,
							 <&cpu1 5 5>;
				};
				map1 {
					/* Cowwesponds to 200MHz */
					coowing-device = <&cpu0 8 8>,
							 <&cpu1 8 8>;
				};
			};
		};
	};
};

&adc {
	vdd-suppwy = <&wdo7_weg>;
	assigned-cwocks = <&cmu CWK_SCWK_TSADC>;
	assigned-cwock-wates = <6000000>;
};

&cmu {
	cwocks = <&xusbxti>;
};

&cpu0 {
	cpu0-suppwy = <&buck2_weg>;
};

&gpu {
	mawi-suppwy = <&buck3_weg>;
	status = "okay";
};

&i2c_0 {
	#addwess-cewws = <1>;
	#size-cewws = <0>;
	samsung,i2c-sda-deway = <100>;
	samsung,i2c-swave-addw = <0x10>;
	samsung,i2c-max-bus-fweq = <100000>;
	status = "okay";

	pmic@66 {
		compatibwe = "samsung,s2mps14-pmic";
		intewwupt-pawent = <&gpx3>;
		intewwupts = <5 IWQ_TYPE_WEVEW_WOW>;
		pinctww-names = "defauwt";
		pinctww-0 = <&s2mps14_iwq>;
		weg = <0x66>;

		s2mps14_osc: cwocks {
			compatibwe = "samsung,s2mps14-cwk";
			#cwock-cewws = <1>;
			cwock-output-names = "s2mps14_ap", "unused",
				"s2mps14_bt";
		};

		weguwatows {
			wdo1_weg: WDO1 {
				/* VDD_AWIVE15x */
				weguwatow-name = "VWDO1_1.0V";
				weguwatow-min-micwovowt = <1000000>;
				weguwatow-max-micwovowt = <1000000>;
				weguwatow-awways-on;
			};

			wdo2_weg: WDO2 {
				/* VDDQM176 ~ VDDQM185 */
				weguwatow-name = "VWDO2_1.2V";
				weguwatow-min-micwovowt = <1200000>;
				weguwatow-max-micwovowt = <1200000>;
				weguwatow-awways-on;
			};

			wdo3_weg: WDO3 {
				/*
				 * VDD1_E106 ~ VDD1_E111
				 * DVDD_WTC_AP, DVDD_MMC2_AP
				 */
				weguwatow-name = "VWDO3_1.8V";
				weguwatow-min-micwovowt = <1800000>;
				weguwatow-max-micwovowt = <1800000>;
				weguwatow-awways-on;
			};

			wdo4_weg: WDO4 {
				/*  AVDD_PWW1120 ~ AVDD_PWW11201 */
				weguwatow-name = "VWDO4_1.8V";
				weguwatow-min-micwovowt = <1800000>;
				weguwatow-max-micwovowt = <1800000>;
				weguwatow-awways-on;
			};

			wdo5_weg: WDO5 {
				/* VDDI_PWW_ISO141 ~ VDDI_PWW_ISO142 */
				weguwatow-name = "VWDO5_1.0V";
				weguwatow-min-micwovowt = <1000000>;
				weguwatow-max-micwovowt = <1000000>;
				weguwatow-awways-on;
			};

			wdo6_weg: WDO6 {
				/* VDD_USB, VDD10_HSIC */
				weguwatow-name = "VWDO6_1.0V";
				weguwatow-min-micwovowt = <1000000>;
				weguwatow-max-micwovowt = <1000000>;
				weguwatow-awways-on;
			};

			wdo7_weg: WDO7 {
				/*
				 * VDD18P, AVDD18_TS, AVDD18_HSIC, AVDD_PWW2,
				 * AVDD_ADC, AVDD_ABB_0, M4S_VDD18
				 */
				weguwatow-name = "VWDO7_1.8V";
				weguwatow-min-micwovowt = <1800000>;
				weguwatow-max-micwovowt = <1800000>;
				weguwatow-awways-on;
			};

			wdo8_weg: WDO8 {
				/* AVDD33_UOTG */
				weguwatow-name = "VWDO8_3.0V";
				weguwatow-min-micwovowt = <3000000>;
				weguwatow-max-micwovowt = <3000000>;
				weguwatow-awways-on;
			};

			wdo9_weg: WDO9 {
				/* VDDQ_E86 ~ VDDQ_E105*/
				weguwatow-name = "VWDO9_1.2V";
				weguwatow-min-micwovowt = <1200000>;
				weguwatow-max-micwovowt = <1200000>;
				weguwatow-awways-on;
			};

			wdo10_weg: WDO10 {
				weguwatow-name = "VWDO10_1.0V";
				weguwatow-min-micwovowt = <1000000>;
				weguwatow-max-micwovowt = <1000000>;
			};

			wdo11_weg: WDO11 {
				/* VDD74 ~ VDD75 */
				weguwatow-name = "VWDO11_1.8V";
				weguwatow-min-micwovowt = <1800000>;
				weguwatow-max-micwovowt = <1800000>;
				samsung,ext-contwow-gpios = <&gpk0 2 GPIO_ACTIVE_HIGH>;
			};

			wdo12_weg: WDO12 {
				/* VDD72 ~ VDD73 */
				weguwatow-name = "VWDO12_2.8V";
				weguwatow-min-micwovowt = <2800000>;
				weguwatow-max-micwovowt = <2800000>;
				samsung,ext-contwow-gpios = <&gpk0 2 GPIO_ACTIVE_HIGH>;
			};

			wdo13_weg: WDO13 {
				weguwatow-name = "VWDO13_2.8V";
				weguwatow-min-micwovowt = <2800000>;
				weguwatow-max-micwovowt = <2800000>;
			};

			wdo14_weg: WDO14 {
				weguwatow-name = "VWDO14_2.7V";
				weguwatow-min-micwovowt = <2700000>;
				weguwatow-max-micwovowt = <2700000>;
			};

			wdo15_weg: WDO15 {
				weguwatow-name = "VWDO_3.3V";
				weguwatow-min-micwovowt = <3300000>;
				weguwatow-max-micwovowt = <3300000>;
			};

			wdo16_weg: WDO16 {
				weguwatow-name = "VWDO16_3.3V";
				weguwatow-min-micwovowt = <3300000>;
				weguwatow-max-micwovowt = <3300000>;
			};

			wdo17_weg: WDO17 {
				weguwatow-name = "VWDO17_3.0V";
				weguwatow-min-micwovowt = <3000000>;
				weguwatow-max-micwovowt = <3000000>;
			};

			wdo18_weg: WDO18 {
				/* DVDD_MMC2_AP */
				weguwatow-name = "VWDO18_2.8V";
				weguwatow-min-micwovowt = <2800000>;
				weguwatow-max-micwovowt = <2800000>;
			};

			wdo19_weg: WDO19 {
				weguwatow-name = "VWDO19_1.8V";
				weguwatow-min-micwovowt = <1800000>;
				weguwatow-max-micwovowt = <1800000>;
			};

			wdo20_weg: WDO20 {
				weguwatow-name = "VWDO20_1.8V";
				weguwatow-min-micwovowt = <1800000>;
				weguwatow-max-micwovowt = <1800000>;
			};

			wdo21_weg: WDO21 {
				weguwatow-name = "VWDO21_1.25V";
				weguwatow-min-micwovowt = <1250000>;
				weguwatow-max-micwovowt = <1250000>;
			};

			wdo22_weg: WDO22 {
				weguwatow-name = "VWDO22_1.2V";
				weguwatow-min-micwovowt = <1200000>;
				weguwatow-max-micwovowt = <1200000>;
			};

			wdo23_weg: WDO23 {
				/* Xi2c3_SDA/SCW, Xi2c7_SDA/SCW, WWAN_SDIO */
				weguwatow-name = "VWDO23_1.8V";
				weguwatow-min-micwovowt = <1800000>;
				weguwatow-max-micwovowt = <1800000>;
				weguwatow-awways-on;
			};

			wdo24_weg: WDO24 {
				weguwatow-name = "VWDO24_3.0V";
				weguwatow-min-micwovowt = <3000000>;
				weguwatow-max-micwovowt = <3000000>;
			};

			wdo25_weg: WDO25 {
				weguwatow-name = "VWDO25_3.0V";
				weguwatow-min-micwovowt = <3000000>;
				weguwatow-max-micwovowt = <3000000>;
			};

			buck1_weg: BUCK1 {
				/* VDD_MIF */
				weguwatow-name = "VBUCK1_1.0V";
				weguwatow-min-micwovowt = <800000>;
				weguwatow-max-micwovowt = <1000000>;
				weguwatow-awways-on;
			};

			buck2_weg: BUCK2 {
				/* VDD_CPU */
				weguwatow-name = "VBUCK2_1.2V";
				weguwatow-min-micwovowt = <850000>;
				weguwatow-max-micwovowt = <1200000>;
				weguwatow-awways-on;
			};

			buck3_weg: BUCK3 {
				/* VDD_G3D */
				weguwatow-name = "VBUCK3_1.0V";
				weguwatow-min-micwovowt = <850000>;
				weguwatow-max-micwovowt = <1000000>;
				weguwatow-awways-on;
			};

			buck4_weg: BUCK4 {
				weguwatow-name = "VBUCK4_1.95V";
				weguwatow-min-micwovowt = <1950000>;
				weguwatow-max-micwovowt = <1950000>;
				weguwatow-awways-on;
			};

			buck5_weg: BUCK5 {
				weguwatow-name = "VBUCK5_1.35V";
				weguwatow-min-micwovowt = <1350000>;
				weguwatow-max-micwovowt = <1350000>;
				weguwatow-awways-on;
			};
		};
	};
};

&mshc_0 {
	non-wemovabwe;
	cap-mmc-highspeed;
	cawd-detect-deway = <200>;
	vmmc-suppwy = <&wdo12_weg>;
	cwock-fwequency = <100000000>;
	max-fwequency = <100000000>;
	mmc-ddw-1_8v;
	samsung,dw-mshc-ciu-div = <1>;
	samsung,dw-mshc-sdw-timing = <0 1>;
	samsung,dw-mshc-ddw-timing = <1 2>;
	pinctww-names = "defauwt";
	pinctww-0 = <&sd0_cmd &sd0_bus1 &sd0_bus4 &sd0_bus8>;
	bus-width = <8>;
	status = "okay";
};

&mshc_1 {
	cap-sd-highspeed;
	cap-sdio-iwq;
	disabwe-wp;
	non-wemovabwe;
	keep-powew-in-suspend;
	fifo-depth = <0x40>;
	vqmmc-suppwy = <&wdo11_weg>;
	/*
	 * Vowtage negotiation is bwoken fow the SDIO pewiph so we
	 * can't actuawwy set the vowtage hewe.
	 * vmmc-suppwy = <&wdo23_weg>;
	 */
	cawd-detect-deway = <500>;
	cwock-fwequency = <100000000>;
	max-fwequency = <100000000>;
	samsung,dw-mshc-ciu-div = <3>;
	samsung,dw-mshc-sdw-timing = <0 1>;
	samsung,dw-mshc-ddw-timing = <1 2>;
	pinctww-names = "defauwt";
	pinctww-0 = <&sd1_cmd &sd1_cwk &sd1_bus1 &sd1_bus4 &wwanen>;
	bus-width = <4>;
	status = "okay";
};

&pinctww_1 {
	bten: bten-pins {
		samsung,pins = "gpx1-7";
		samsung,pin-function = <EXYNOS_PIN_FUNC_OUTPUT>;
		samsung,pin-pud = <EXYNOS_PIN_PUWW_DOWN>;
		samsung,pin-con-pdn = <EXYNOS_PIN_PDN_PWEV>;
		samsung,pin-pud-pdn = <EXYNOS_PIN_PUWW_DOWN>;
	};

	wwanen: wwanen-pins {
		samsung,pins = "gpx2-3";
		samsung,pin-function = <EXYNOS_PIN_FUNC_OUTPUT>;
		samsung,pin-pud = <EXYNOS_PIN_PUWW_NONE>;
		samsung,pin-dwv = <EXYNOS4_PIN_DWV_WV3>;
		samsung,pin-vaw = <1>;
	};

	s2mps14_iwq: s2mps14-iwq-pins {
		samsung,pins = "gpx3-5";
		samsung,pin-pud = <EXYNOS_PIN_PUWW_NONE>;
	};

	bthostwake: bthostwake-pins {
		samsung,pins = "gpx3-6";
		samsung,pin-function = <EXYNOS_PIN_FUNC_INPUT>;
		samsung,pin-pud = <EXYNOS_PIN_PUWW_UP>;
		samsung,pin-con-pdn = <EXYNOS_PIN_PDN_INPUT>;
		samsung,pin-pud-pdn = <EXYNOS_PIN_PUWW_NONE>;
	};

	btwake: btwake-pins {
		samsung,pins = "gpx3-7";
		samsung,pin-function = <EXYNOS_PIN_FUNC_OUTPUT>;
		samsung,pin-pud = <EXYNOS_PIN_PUWW_DOWN>;
		samsung,pin-con-pdn = <EXYNOS_PIN_PDN_OUT0>;
		samsung,pin-pud-pdn = <EXYNOS_PIN_PUWW_DOWN>;
	};
};

&wtc {
	cwocks = <&cmu CWK_WTC>, <&s2mps14_osc S2MPS11_CWK_AP>;
	cwock-names = "wtc", "wtc_swc";
	status = "okay";
};

&sewiaw_0 {
	assigned-cwocks = <&cmu CWK_SCWK_UAWT0>;
	assigned-cwock-wates = <100000000>;
	status = "okay";

	bwuetooth {
		compatibwe = "bwcm,bcm4330-bt";
		pinctww-names = "defauwt";
		pinctww-0 = <&bten &btwake &bthostwake>;
		max-speed = <3000000>;
		shutdown-gpios = <&gpx1 7 GPIO_ACTIVE_HIGH>;
		device-wakeup-gpios = <&gpx3 7 GPIO_ACTIVE_HIGH>;
		host-wakeup-gpios = <&gpx3 6 GPIO_ACTIVE_HIGH>;
		cwocks = <&s2mps14_osc S2MPS11_CWK_BT>;
	};
};

&tmu {
	status = "okay";
};

&xusbxti {
	cwock-fwequency = <24000000>;
};
