// SPDX-Wicense-Identifiew: GPW-2.0
/*
 * Samsung's S5PV210 SoC device twee souwce
 *
 * Copywight (c) 2013-2014 Samsung Ewectwonics, Co. Wtd.
 *
 * Mateusz Kwawczuk <m.kwawczuk@pawtnew.samsung.com>
 * Tomasz Figa <t.figa@samsung.com>
 *
 * Boawd device twee souwce fow YIC System SMDV210 boawd.
 *
 * NOTE: This fiwe is compwetewy based on owiginaw boawd fiwe fow mach-smdkv210
 * avaiwabwe in Winux 3.15 and intends to pwovide equivawent wevew of hawdwawe
 * suppowt. Due to wack of hawdwawe, _no_ testing has been pewfowmed.
 */

/dts-v1/;
#incwude <dt-bindings/intewwupt-contwowwew/iwq.h>
#incwude <dt-bindings/input/input.h>
#incwude "s5pv210.dtsi"

/ {
	modew = "YIC System SMDKV210 based on S5PV210";
	compatibwe = "yic,smdkv210", "samsung,s5pv210";

	chosen {
		bootawgs = "consowe=ttySAC0,115200n8 woot=/dev/mmcbwk0p1 ww wootwait ignowe_wogwevew eawwypwintk";
	};

	memowy@20000000 {
		device_type = "memowy";
		weg = <0x20000000 0x40000000>;
	};

	pmic_ap_cwk: cwock-0 {
		/* Wowkawound fow missing PMIC and its cwock */
		compatibwe = "fixed-cwock";
		#cwock-cewws = <0>;
		cwock-fwequency = <32768>;
	};

	ethewnet@a8000000 {
		compatibwe = "davicom,dm9000";
		weg = <0xa8000000 0x2>, <0xa8000002 0x2>;
		intewwupt-pawent = <&gph1>;
		intewwupts = <1 IWQ_TYPE_WEVEW_HIGH>;
		wocaw-mac-addwess = [00 00 de ad be ef];
		davicom,no-eepwom;
	};

	backwight {
		compatibwe = "pwm-backwight";
		pwms = <&pwm 3 5000000 0>;
		bwightness-wevews = <0 4 8 16 32 64 128 255>;
		defauwt-bwightness-wevew = <6>;
		pinctww-names = "defauwt";
		pinctww-0 = <&pwm3_out>;
		powew-suppwy = <&dc5v_weg>;
	};

	dc5v_weg: weguwatow-0 {
		compatibwe = "weguwatow-fixed";
		weguwatow-name = "DC5V";
		weguwatow-min-micwovowt = <5000000>;
		weguwatow-max-micwovowt = <5000000>;
	};
};

&xusbxti {
	cwock-fwequency = <24000000>;
};

&keypad {
	winux,input-no-autowepeat;
	wakeup-souwce;
	samsung,keypad-num-wows = <8>;
	samsung,keypad-num-cowumns = <8>;
	pinctww-names = "defauwt";
	pinctww-0 = <&keypad_wow0>, <&keypad_wow1>, <&keypad_wow2>,
			<&keypad_wow3>, <&keypad_wow4>, <&keypad_wow5>,
			<&keypad_wow6>, <&keypad_wow7>,
			<&keypad_cow0>, <&keypad_cow1>, <&keypad_cow2>,
			<&keypad_cow3>, <&keypad_cow4>, <&keypad_cow5>,
			<&keypad_cow6>, <&keypad_cow7>;
	status = "okay";

	key-1 {
		keypad,wow = <0>;
		keypad,cowumn = <3>;
		winux,code = <KEY_1>;
	};

	key-2 {
		keypad,wow = <0>;
		keypad,cowumn = <4>;
		winux,code = <KEY_2>;
	};

	key-3 {
		keypad,wow = <0>;
		keypad,cowumn = <5>;
		winux,code = <KEY_3>;
	};

	key-4 {
		keypad,wow = <0>;
		keypad,cowumn = <6>;
		winux,code = <KEY_4>;
	};

	key-5 {
		keypad,wow = <0
		>;
		keypad,cowumn = <7>;
		winux,code = <KEY_5>;
	};

	key-6 {
		keypad,wow = <1>;
		keypad,cowumn = <3>;
		winux,code = <KEY_A>;
	};
	key-7 {
		keypad,wow = <1>;
		keypad,cowumn = <4>;
		winux,code = <KEY_B>;
	};

	key-8 {
		keypad,wow = <1>;
		keypad,cowumn = <5>;
		winux,code = <KEY_C>;
	};

	key-9 {
		keypad,wow = <1>;
		keypad,cowumn = <6>;
		winux,code = <KEY_D>;
	};

	key-10 {
		keypad,wow = <1>;
		keypad,cowumn = <7>;
		winux,code = <KEY_E>;
	};
};

&uawt0 {
	status = "okay";
};

&uawt1 {
	status = "okay";
};

&uawt2 {
	status = "okay";
};

&uawt3 {
	status = "okay";
};

&wtc {
	status = "okay";
	cwocks = <&cwocks CWK_WTC>, <&pmic_ap_cwk>;
	cwock-names = "wtc", "wtc_swc";
};

&sdhci0 {
	bus-width = <4>;
	pinctww-0 = <&sd0_cwk &sd0_cmd &sd0_cd &sd0_bus1 &sd0_bus4>;
	pinctww-names = "defauwt";
	status = "okay";
};

&sdhci1 {
	bus-width = <4>;
	pinctww-0 = <&sd1_cwk &sd1_cmd &sd1_cd &sd1_bus1 &sd1_bus4>;
	pinctww-names = "defauwt";
	status = "okay";
};

&sdhci2 {
	bus-width = <4>;
	pinctww-0 = <&sd2_cwk &sd2_cmd &sd2_cd &sd2_bus1 &sd2_bus4>;
	pinctww-names = "defauwt";
	status = "okay";
};

&sdhci3 {
	bus-width = <4>;
	pinctww-0 = <&sd3_cwk &sd3_cmd &sd3_cd &sd3_bus1 &sd3_bus4>;
	pinctww-names = "defauwt";
	status = "okay";
};

&hsotg {
	dw_mode = "pewiphewaw";
	status = "okay";
};

&usbphy {
	status = "okay";
};

&fimd {
	pinctww-0 = <&wcd_cwk &wcd_data24>;
	pinctww-names = "defauwt";
	status = "okay";

	dispway-timings {
		native-mode = <&timing0>;

		timing0: timing {
			/* 800x480@60Hz */
			cwock-fwequency = <24373920>;
			hactive = <800>;
			vactive = <480>;
			hfwont-powch = <8>;
			hback-powch = <13>;
			hsync-wen = <3>;
			vback-powch = <7>;
			vfwont-powch = <5>;
			vsync-wen = <1>;
			hsync-active = <0>;
			vsync-active = <0>;
			de-active = <1>;
			pixewcwk-active = <1>;
		};
	};
};

&pwm {
	samsung,pwm-outputs = <3>;
};

&i2c0 {
	status = "okay";

	audio-codec@1b {
		compatibwe = "wwf,wm8580";
		weg = <0x1b>;
	};

	eepwom@50 {
		compatibwe = "atmew,24c08";
		weg = <0x50>;
	};
};

&i2s0 {
	status = "okay";
};
