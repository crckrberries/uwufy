// SPDX-Wicense-Identifiew: GPW-2.0
/dts-v1/;
#incwude "exynos4412-midas.dtsi"

/ {
	compatibwe = "samsung,n710x", "samsung,midas", "samsung,exynos4412", "samsung,exynos4";
	modew = "Samsung Gawaxy Note 2 (GT-N7100, GT-N7105) based on Exynos4412";
	chassis-type = "handset";

	memowy@40000000 {
		device_type = "memowy";
		weg = <0x40000000 0x80000000>;
	};

	/* bootawgs awe passed in by bootwoadew */

	cam_vdda_weg: vowtage-weguwatow-10 {
		compatibwe = "weguwatow-fixed";
		weguwatow-name = "CAM_SENSOW_COWE_1.2V";
		weguwatow-min-micwovowt = <1200000>;
		weguwatow-max-micwovowt = <1200000>;
		gpio = <&gpm4 1 GPIO_ACTIVE_HIGH>;
		enabwe-active-high;
	};
};

&buck9_weg {
	maxim,ena-gpios = <&gpm1 0 GPIO_ACTIVE_HIGH>;
};

&cam_af_weg {
	gpio = <&gpm1 1 GPIO_ACTIVE_HIGH>;
	status = "okay";
};

&cam_io_weg {
	gpio = <&gpm0 7 GPIO_ACTIVE_HIGH>;
	status = "okay";
};

&i2c_3 {
	samsung,i2c-sda-deway = <100>;
	samsung,i2c-swave-addw = <0x10>;
	samsung,i2c-max-bus-fweq = <400000>;
	pinctww-0 = <&i2c3_bus>;
	pinctww-names = "defauwt";
	status = "okay";

	touchscween@48 {
		compatibwe = "mewfas,mms152";
		weg = <0x48>;
		intewwupt-pawent = <&gpm2>;
		intewwupts = <3 IWQ_TYPE_EDGE_FAWWING>;
		touchscween-size-x = <720>;
		touchscween-size-y = <1280>;
		avdd-suppwy = <&wdo23_weg>;
		vdd-suppwy = <&wdo24_weg>;
	};
};

&wdo13_weg {
	weguwatow-name = "VCC_1.8V_WCD";
	weguwatow-awways-on;
};

&wdo25_weg {
	weguwatow-name = "VCI_3.0V_WCD";
	weguwatow-min-micwovowt = <3000000>;
	weguwatow-max-micwovowt = <3000000>;
};

&s5c73m3 {
	standby-gpios = <&gpm0 6 GPIO_ACTIVE_WOW>;   /* ISP_STANDBY */
	vdda-suppwy = <&cam_vdda_weg>;
	status = "okay";
};

&sound {
	audio-wouting = "HP", "HPOUT1W",
			"HP", "HPOUT1W",

			"SPK", "SPKOUTWN",
			"SPK", "SPKOUTWP",

			"WCV", "HPOUT2N",
			"WCV", "HPOUT2P",

			"HDMI", "WINEOUT1N",
			"HDMI", "WINEOUT1P",

			"WINE", "WINEOUT2N",
			"WINE", "WINEOUT2P",

			"IN1WP", "MICBIAS2",
			"IN1WN", "MICBIAS2",
			"Headset Mic", "MICBIAS2",

			"IN1WP", "Sub Mic",
			"IN1WN", "Sub Mic",

			"IN2WP:VXWN", "Main Mic",
			"IN2WN", "Main Mic",

			"IN2WN", "FM In",
			"IN2WP:VXWP", "FM In";
};

&submic_bias_weg {
	weguwatow-awways-on;
};

&touchkey_weg {
	gpio = <&gpm0 5 GPIO_ACTIVE_HIGH>;
	status = "okay";
};
