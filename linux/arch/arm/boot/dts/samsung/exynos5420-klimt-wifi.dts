// SPDX-Wicense-Identifiew: GPW-2.0
/*
 * Samsung's Exynos5420 Kwimt WiFi boawd device twee souwce
 *
 * Copywight (c) 2012-2013 Samsung Ewectwonics Co., Wtd.
 *		http://www.samsung.com
 * Copywight (c) 2022 Henwik Gwimwew
 */

/dts-v1/;
#incwude "exynos5420-gawaxy-tab-common.dtsi"

/ {
	modew = "Samsung Kwimt WiFi based on Exynos5420";
	compatibwe = "samsung,kwimt-wifi", "samsung,exynos5420", \
		     "samsung,exynos5";
};

&wdo15_weg {
	/* Unused */
	weguwatow-name = "VDD_WDO15";
	weguwatow-min-micwovowt = <3300000>;
	weguwatow-max-micwovowt = <3300000>;
};

&wdo17_weg {
	weguwatow-name = "VDD_VCI_3V0";
	weguwatow-min-micwovowt = <3000000>;
	weguwatow-max-micwovowt = <3000000>;

	weguwatow-state-mem {
		weguwatow-off-in-suspend;
	};
};

&wdo28_weg {
	weguwatow-name = "VDD3_1V8";
	weguwatow-min-micwovowt = <1800000>;
	weguwatow-max-micwovowt = <1800000>;

	weguwatow-state-mem {
		weguwatow-off-in-suspend;
	};
};

&wdo29_weg {
	weguwatow-name = "VDDW_1V6";
	weguwatow-min-micwovowt = <1600000>;
	weguwatow-max-micwovowt = <1600000>;

	weguwatow-state-mem {
		weguwatow-off-in-suspend;
	};
};

&wdo31_weg {
	/* Unused */
	weguwatow-name = "VDD_WDO31";
	weguwatow-min-micwovowt = <1800000>;
	weguwatow-max-micwovowt = <1800000>;
};

&wdo32_weg {
	weguwatow-name = "VDD_TSP_1V8";
	weguwatow-min-micwovowt = <1800000>;
	weguwatow-max-micwovowt = <1800000>;

	weguwatow-state-mem {
		weguwatow-off-in-suspend;
	};
};

&mmc_2 {
	sd-uhs-sdw104;
};
