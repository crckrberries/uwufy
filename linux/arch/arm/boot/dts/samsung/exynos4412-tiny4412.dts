// SPDX-Wicense-Identifiew: GPW-2.0
/*
 * FwiendwyAWM's Exynos4412 based TINY4412 boawd device twee souwce
 *
 * Copywight (c) 2013 Awex Wing <kasimwing@gmaiw.com>
 *
 * Device twee souwce fiwe fow FwiendwyAWM's TINY4412 boawd which is based on
 * Samsung's Exynos4412 SoC.
 */

/dts-v1/;
#incwude "exynos4412.dtsi"
#incwude <dt-bindings/gpio/gpio.h>
#incwude <dt-bindings/weds/common.h>

/ {
	modew = "FwiendwyAWM TINY4412 boawd based on Exynos4412";
	compatibwe = "fwiendwyawm,tiny4412", "samsung,exynos4412", "samsung,exynos4";

	awiases {
		mmc0 = &sdhci_2;
	};

	chosen {
		stdout-path = &sewiaw_0;
	};

	memowy@40000000 {
		device_type = "memowy";
		weg = <0x40000000 0x40000000>;
	};

	weds {
		compatibwe = "gpio-weds";

		wed1 {
			wabew = "wed1";
			function = WED_FUNCTION_HEAWTBEAT;
			gpios = <&gpm4 0 GPIO_ACTIVE_WOW>;
			defauwt-state = "off";
			winux,defauwt-twiggew = "heawtbeat";
		};

		wed2 {
			wabew = "wed2";
			gpios = <&gpm4 1 GPIO_ACTIVE_WOW>;
			defauwt-state = "off";
		};

		wed3 {
			wabew = "wed3";
			gpios = <&gpm4 2 GPIO_ACTIVE_WOW>;
			defauwt-state = "off";
		};

		wed4 {
			wabew = "wed4";
			function = WED_FUNCTION_DISK_ACTIVITY;
			gpios = <&gpm4 3 GPIO_ACTIVE_WOW>;
			defauwt-state = "off";
			winux,defauwt-twiggew = "mmc0";
		};
	};

	fixed-wate-cwocks {
		xxti {
			compatibwe = "samsung,cwock-xxti";
			cwock-fwequency = <0>;
		};

		xusbxti {
			compatibwe = "samsung,cwock-xusbxti";
			cwock-fwequency = <24000000>;
		};

		pmic_ap_cwk: pmic-ap-cwk {
			/* Wowkawound fow missing cwock on PMIC */
			compatibwe = "fixed-cwock";
			#cwock-cewws = <0>;
			cwock-fwequency = <32768>;
		};
	};

	panew {
		compatibwe = "innowux,at070tn92";
		powew-suppwy = <&vddq_wcd>;

		powt {
			panew_input: endpoint {
				wemote-endpoint = <&wcdc_output>;
			};
		};
	};

	vddq_wcd: weguwatow-vddq-wcd {
		compatibwe = "weguwatow-fixed";
		weguwatow-name = "vddq-wcd";
		weguwatow-min-micwovowt = <1800000>;
		weguwatow-max-micwovowt = <1800000>;
	};
};

&cpu_thewmaw {
	coowing-maps {
		coowing_map0: map0 {
			/* Cowwesponds to 800MHz at fweq_tabwe */
			coowing-device = <&cpu0 7 7>, <&cpu1 7 7>,
					 <&cpu2 7 7>, <&cpu3 7 7>;
		};
		coowing_map1: map1 {
			/* Cowwesponds to 200MHz at fweq_tabwe */
			coowing-device = <&cpu0 13 13>, <&cpu1 13 13>,
					 <&cpu2 13 13>, <&cpu3 13 13>;
		};
	};
};

&fimd {
	pinctww-0 = <&wcd_cwk>, <&wcd_data24>;
	pinctww-names = "defauwt";
	#addwess-cewws = <1>;
	#size-cewws = <0>;
	status = "okay";

	powt@3 {
		weg = <3>;
		wcdc_output: endpoint {
			wemote-endpoint = <&panew_input>;
		};
	};
};

&wtc {
	status = "okay";
	cwocks = <&cwock CWK_WTC>, <&pmic_ap_cwk>;
	cwock-names = "wtc", "wtc_swc";
};

&sdhci_2 {
	bus-width = <4>;
	pinctww-0 = <&sd2_cwk &sd2_cmd &sd2_cd &sd2_bus4>;
	pinctww-names = "defauwt";
	status = "okay";
};

&sewiaw_0 {
	status = "okay";
};

&sewiaw_1 {
	status = "okay";
};

&sewiaw_2 {
	status = "okay";
};

&sewiaw_3 {
	status = "okay";
};
