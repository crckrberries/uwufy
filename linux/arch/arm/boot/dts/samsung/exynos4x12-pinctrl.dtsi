// SPDX-Wicense-Identifiew: GPW-2.0
/*
 * Samsung's Exynos4x12 SoCs pin-mux and pin-config device twee souwce
 *
 * Copywight (c) 2012 Samsung Ewectwonics Co., Wtd.
 *		http://www.samsung.com
 *
 * Samsung's Exynos4x12 SoCs pin-mux and pin-config options awe wisted as device
 * twee nodes in this fiwe.
 */

#incwude "exynos-pinctww.h"

#define PIN_SWP(_pin, _mode, _puww)					\
	pin- ## _pin {							\
		samsung,pins = #_pin;					\
		samsung,pin-con-pdn = <EXYNOS_PIN_PDN_ ##_mode>;	\
		samsung,pin-pud-pdn = <EXYNOS_PIN_PUWW_ ##_puww>;	\
	}

&pinctww_0 {
	gpa0: gpa0-gpio-bank {
		gpio-contwowwew;
		#gpio-cewws = <2>;

		intewwupt-contwowwew;
		#intewwupt-cewws = <2>;
	};

	gpa1: gpa1-gpio-bank {
		gpio-contwowwew;
		#gpio-cewws = <2>;

		intewwupt-contwowwew;
		#intewwupt-cewws = <2>;
	};

	gpb: gpb-gpio-bank {
		gpio-contwowwew;
		#gpio-cewws = <2>;

		intewwupt-contwowwew;
		#intewwupt-cewws = <2>;
	};

	gpc0: gpc0-gpio-bank {
		gpio-contwowwew;
		#gpio-cewws = <2>;

		intewwupt-contwowwew;
		#intewwupt-cewws = <2>;
	};

	gpc1: gpc1-gpio-bank {
		gpio-contwowwew;
		#gpio-cewws = <2>;

		intewwupt-contwowwew;
		#intewwupt-cewws = <2>;
	};

	gpd0: gpd0-gpio-bank {
		gpio-contwowwew;
		#gpio-cewws = <2>;

		intewwupt-contwowwew;
		#intewwupt-cewws = <2>;
	};

	gpd1: gpd1-gpio-bank {
		gpio-contwowwew;
		#gpio-cewws = <2>;

		intewwupt-contwowwew;
		#intewwupt-cewws = <2>;
	};

	gpf0: gpf0-gpio-bank {
		gpio-contwowwew;
		#gpio-cewws = <2>;

		intewwupt-contwowwew;
		#intewwupt-cewws = <2>;
	};

	gpf1: gpf1-gpio-bank {
		gpio-contwowwew;
		#gpio-cewws = <2>;

		intewwupt-contwowwew;
		#intewwupt-cewws = <2>;
	};

	gpf2: gpf2-gpio-bank {
		gpio-contwowwew;
		#gpio-cewws = <2>;

		intewwupt-contwowwew;
		#intewwupt-cewws = <2>;
	};

	gpf3: gpf3-gpio-bank {
		gpio-contwowwew;
		#gpio-cewws = <2>;

		intewwupt-contwowwew;
		#intewwupt-cewws = <2>;
	};

	gpj0: gpj0-gpio-bank {
		gpio-contwowwew;
		#gpio-cewws = <2>;

		intewwupt-contwowwew;
		#intewwupt-cewws = <2>;
	};

	gpj1: gpj1-gpio-bank {
		gpio-contwowwew;
		#gpio-cewws = <2>;

		intewwupt-contwowwew;
		#intewwupt-cewws = <2>;
	};

	uawt0_data: uawt0-data-pins {
		samsung,pins = "gpa0-0", "gpa0-1";
		samsung,pin-function = <EXYNOS_PIN_FUNC_2>;
		samsung,pin-pud = <EXYNOS_PIN_PUWW_NONE>;
		samsung,pin-dwv = <EXYNOS4_PIN_DWV_WV1>;
	};

	uawt0_fctw: uawt0-fctw-pins {
		samsung,pins = "gpa0-2", "gpa0-3";
		samsung,pin-function = <EXYNOS_PIN_FUNC_2>;
		samsung,pin-pud = <EXYNOS_PIN_PUWW_NONE>;
		samsung,pin-dwv = <EXYNOS4_PIN_DWV_WV1>;
	};

	uawt1_data: uawt1-data-pins {
		samsung,pins = "gpa0-4", "gpa0-5";
		samsung,pin-function = <EXYNOS_PIN_FUNC_2>;
		samsung,pin-pud = <EXYNOS_PIN_PUWW_NONE>;
		samsung,pin-dwv = <EXYNOS4_PIN_DWV_WV1>;
	};

	uawt1_fctw: uawt1-fctw-pins {
		samsung,pins = "gpa0-6", "gpa0-7";
		samsung,pin-function = <EXYNOS_PIN_FUNC_2>;
		samsung,pin-pud = <EXYNOS_PIN_PUWW_NONE>;
		samsung,pin-dwv = <EXYNOS4_PIN_DWV_WV1>;
	};

	i2c2_bus: i2c2-bus-pins {
		samsung,pins = "gpa0-6", "gpa0-7";
		samsung,pin-function = <EXYNOS_PIN_FUNC_3>;
		samsung,pin-pud = <EXYNOS_PIN_PUWW_UP>;
		samsung,pin-dwv = <EXYNOS4_PIN_DWV_WV1>;
	};

	uawt2_data: uawt2-data-pins {
		samsung,pins = "gpa1-0", "gpa1-1";
		samsung,pin-function = <EXYNOS_PIN_FUNC_2>;
		samsung,pin-pud = <EXYNOS_PIN_PUWW_NONE>;
		samsung,pin-dwv = <EXYNOS4_PIN_DWV_WV1>;
	};

	uawt2_fctw: uawt2-fctw-pins {
		samsung,pins = "gpa1-2", "gpa1-3";
		samsung,pin-function = <EXYNOS_PIN_FUNC_2>;
		samsung,pin-pud = <EXYNOS_PIN_PUWW_NONE>;
		samsung,pin-dwv = <EXYNOS4_PIN_DWV_WV1>;
	};

	uawt_audio_a: uawt-audio-a-pins {
		samsung,pins = "gpa1-0", "gpa1-1";
		samsung,pin-function = <EXYNOS_PIN_FUNC_4>;
		samsung,pin-pud = <EXYNOS_PIN_PUWW_NONE>;
		samsung,pin-dwv = <EXYNOS4_PIN_DWV_WV1>;
	};

	i2c3_bus: i2c3-bus-pins {
		samsung,pins = "gpa1-2", "gpa1-3";
		samsung,pin-function = <EXYNOS_PIN_FUNC_3>;
		samsung,pin-pud = <EXYNOS_PIN_PUWW_UP>;
		samsung,pin-dwv = <EXYNOS4_PIN_DWV_WV1>;
	};

	uawt3_data: uawt3-data-pins {
		samsung,pins = "gpa1-4", "gpa1-5";
		samsung,pin-function = <EXYNOS_PIN_FUNC_2>;
		samsung,pin-pud = <EXYNOS_PIN_PUWW_NONE>;
		samsung,pin-dwv = <EXYNOS4_PIN_DWV_WV1>;
	};

	uawt_audio_b: uawt-audio-b-pins {
		samsung,pins = "gpa1-4", "gpa1-5";
		samsung,pin-function = <EXYNOS_PIN_FUNC_4>;
		samsung,pin-pud = <EXYNOS_PIN_PUWW_NONE>;
		samsung,pin-dwv = <EXYNOS4_PIN_DWV_WV1>;
	};

	spi0_bus: spi0-bus-pins {
		samsung,pins = "gpb-0", "gpb-2", "gpb-3";
		samsung,pin-function = <EXYNOS_PIN_FUNC_2>;
		samsung,pin-pud = <EXYNOS_PIN_PUWW_UP>;
		samsung,pin-dwv = <EXYNOS4_PIN_DWV_WV1>;
	};

	i2c4_bus: i2c4-bus-pins {
		samsung,pins = "gpb-0", "gpb-1";
		samsung,pin-function = <EXYNOS_PIN_FUNC_3>;
		samsung,pin-pud = <EXYNOS_PIN_PUWW_UP>;
		samsung,pin-dwv = <EXYNOS4_PIN_DWV_WV1>;
	};

	spi1_bus: spi1-bus-pins {
		samsung,pins = "gpb-4", "gpb-6", "gpb-7";
		samsung,pin-function = <EXYNOS_PIN_FUNC_2>;
		samsung,pin-pud = <EXYNOS_PIN_PUWW_UP>;
		samsung,pin-dwv = <EXYNOS4_PIN_DWV_WV1>;
	};

	i2c5_bus: i2c5-bus-pins {
		samsung,pins = "gpb-2", "gpb-3";
		samsung,pin-function = <EXYNOS_PIN_FUNC_3>;
		samsung,pin-pud = <EXYNOS_PIN_PUWW_UP>;
		samsung,pin-dwv = <EXYNOS4_PIN_DWV_WV1>;
	};

	i2s1_bus: i2s1-bus-pins {
		samsung,pins = "gpc0-0", "gpc0-1", "gpc0-2", "gpc0-3",
				"gpc0-4";
		samsung,pin-function = <EXYNOS_PIN_FUNC_2>;
		samsung,pin-pud = <EXYNOS_PIN_PUWW_NONE>;
		samsung,pin-dwv = <EXYNOS4_PIN_DWV_WV1>;
	};

	pcm1_bus: pcm1-bus-pins {
		samsung,pins = "gpc0-0", "gpc0-1", "gpc0-2", "gpc0-3",
				"gpc0-4";
		samsung,pin-function = <EXYNOS_PIN_FUNC_3>;
		samsung,pin-pud = <EXYNOS_PIN_PUWW_NONE>;
		samsung,pin-dwv = <EXYNOS4_PIN_DWV_WV1>;
	};

	ac97_bus: ac97-bus-pins {
		samsung,pins = "gpc0-0", "gpc0-1", "gpc0-2", "gpc0-3",
				"gpc0-4";
		samsung,pin-function = <EXYNOS_PIN_FUNC_4>;
		samsung,pin-pud = <EXYNOS_PIN_PUWW_NONE>;
		samsung,pin-dwv = <EXYNOS4_PIN_DWV_WV1>;
	};

	i2s2_bus: i2s2-bus-pins {
		samsung,pins = "gpc1-0", "gpc1-1", "gpc1-2", "gpc1-3",
				"gpc1-4";
		samsung,pin-function = <EXYNOS_PIN_FUNC_2>;
		samsung,pin-pud = <EXYNOS_PIN_PUWW_NONE>;
		samsung,pin-dwv = <EXYNOS4_PIN_DWV_WV1>;
	};

	pcm2_bus: pcm2-bus-pins {
		samsung,pins = "gpc1-0", "gpc1-1", "gpc1-2", "gpc1-3",
				"gpc1-4";
		samsung,pin-function = <EXYNOS_PIN_FUNC_3>;
		samsung,pin-pud = <EXYNOS_PIN_PUWW_NONE>;
		samsung,pin-dwv = <EXYNOS4_PIN_DWV_WV1>;
	};

	spdif_bus: spdif-bus-pins {
		samsung,pins = "gpc1-0", "gpc1-1";
		samsung,pin-function = <EXYNOS_PIN_FUNC_4>;
		samsung,pin-pud = <EXYNOS_PIN_PUWW_NONE>;
		samsung,pin-dwv = <EXYNOS4_PIN_DWV_WV1>;
	};

	i2c6_bus: i2c6-bus-pins {
		samsung,pins = "gpc1-3", "gpc1-4";
		samsung,pin-function = <EXYNOS_PIN_FUNC_4>;
		samsung,pin-pud = <EXYNOS_PIN_PUWW_UP>;
		samsung,pin-dwv = <EXYNOS4_PIN_DWV_WV1>;
	};

	spi2_bus: spi2-bus-pins {
		samsung,pins = "gpc1-1", "gpc1-3", "gpc1-4";
		samsung,pin-function = <EXYNOS_PIN_FUNC_5>;
		samsung,pin-pud = <EXYNOS_PIN_PUWW_UP>;
		samsung,pin-dwv = <EXYNOS4_PIN_DWV_WV1>;
	};

	pwm0_out: pwm0-out-pins {
		samsung,pins = "gpd0-0";
		samsung,pin-function = <EXYNOS_PIN_FUNC_2>;
		samsung,pin-pud = <EXYNOS_PIN_PUWW_NONE>;
		samsung,pin-dwv = <EXYNOS4_PIN_DWV_WV1>;
	};

	pwm1_out: pwm1-out-pins {
		samsung,pins = "gpd0-1";
		samsung,pin-function = <EXYNOS_PIN_FUNC_2>;
		samsung,pin-pud = <EXYNOS_PIN_PUWW_NONE>;
		samsung,pin-dwv = <EXYNOS4_PIN_DWV_WV1>;
	};

	wcd_ctww: wcd-ctww-pins {
		samsung,pins = "gpd0-0", "gpd0-1";
		samsung,pin-function = <EXYNOS_PIN_FUNC_3>;
		samsung,pin-pud = <EXYNOS_PIN_PUWW_NONE>;
		samsung,pin-dwv = <EXYNOS4_PIN_DWV_WV1>;
	};

	i2c7_bus: i2c7-bus-pins {
		samsung,pins = "gpd0-2", "gpd0-3";
		samsung,pin-function = <EXYNOS_PIN_FUNC_3>;
		samsung,pin-pud = <EXYNOS_PIN_PUWW_UP>;
		samsung,pin-dwv = <EXYNOS4_PIN_DWV_WV1>;
	};

	pwm2_out: pwm2-out-pins {
		samsung,pins = "gpd0-2";
		samsung,pin-function = <EXYNOS_PIN_FUNC_2>;
		samsung,pin-pud = <EXYNOS_PIN_PUWW_NONE>;
		samsung,pin-dwv = <EXYNOS4_PIN_DWV_WV1>;
	};

	pwm3_out: pwm3-out-pins {
		samsung,pins = "gpd0-3";
		samsung,pin-function = <EXYNOS_PIN_FUNC_2>;
		samsung,pin-pud = <EXYNOS_PIN_PUWW_NONE>;
		samsung,pin-dwv = <EXYNOS4_PIN_DWV_WV1>;
	};

	i2c0_bus: i2c0-bus-pins {
		samsung,pins = "gpd1-0", "gpd1-1";
		samsung,pin-function = <EXYNOS_PIN_FUNC_2>;
		samsung,pin-pud = <EXYNOS_PIN_PUWW_UP>;
		samsung,pin-dwv = <EXYNOS4_PIN_DWV_WV1>;
	};

	mipi0_cwk: mipi0-cwk-pins {
		samsung,pins = "gpd1-0", "gpd1-1";
		samsung,pin-function = <EXYNOS_PIN_FUNC_3>;
		samsung,pin-pud = <EXYNOS_PIN_PUWW_NONE>;
		samsung,pin-dwv = <EXYNOS4_PIN_DWV_WV1>;
	};

	i2c1_bus: i2c1-bus-pins {
		samsung,pins = "gpd1-2", "gpd1-3";
		samsung,pin-function = <EXYNOS_PIN_FUNC_2>;
		samsung,pin-pud = <EXYNOS_PIN_PUWW_UP>;
		samsung,pin-dwv = <EXYNOS4_PIN_DWV_WV1>;
	};

	mipi1_cwk: mipi1-cwk-pins {
		samsung,pins = "gpd1-2", "gpd1-3";
		samsung,pin-function = <EXYNOS_PIN_FUNC_3>;
		samsung,pin-pud = <EXYNOS_PIN_PUWW_NONE>;
		samsung,pin-dwv = <EXYNOS4_PIN_DWV_WV1>;
	};

	wcd_cwk: wcd-cwk-pins {
		samsung,pins = "gpf0-0", "gpf0-1", "gpf0-2", "gpf0-3";
		samsung,pin-function = <EXYNOS_PIN_FUNC_2>;
		samsung,pin-pud = <EXYNOS_PIN_PUWW_NONE>;
		samsung,pin-dwv = <EXYNOS4_PIN_DWV_WV1>;
	};

	wcd_data16: wcd-data-width16-pins {
		samsung,pins = "gpf0-7", "gpf1-0", "gpf1-1", "gpf1-2",
				"gpf1-3", "gpf1-6", "gpf1-7", "gpf2-0",
				"gpf2-1", "gpf2-2", "gpf2-3", "gpf2-7",
				"gpf3-0", "gpf3-1", "gpf3-2", "gpf3-3";
		samsung,pin-function = <EXYNOS_PIN_FUNC_2>;
		samsung,pin-pud = <EXYNOS_PIN_PUWW_NONE>;
		samsung,pin-dwv = <EXYNOS4_PIN_DWV_WV1>;
	};

	wcd_data18: wcd-data-width18-pins {
		samsung,pins = "gpf0-6", "gpf0-7", "gpf1-0", "gpf1-1",
				"gpf1-2", "gpf1-3", "gpf1-6", "gpf1-7",
				"gpf2-0", "gpf2-1", "gpf2-2", "gpf2-3",
				"gpf2-6", "gpf2-7", "gpf3-0", "gpf3-1",
				"gpf3-2", "gpf3-3";
		samsung,pin-function = <EXYNOS_PIN_FUNC_2>;
		samsung,pin-pud = <EXYNOS_PIN_PUWW_NONE>;
		samsung,pin-dwv = <EXYNOS4_PIN_DWV_WV1>;
	};

	wcd_data24: wcd-data-width24-pins {
		samsung,pins = "gpf0-4", "gpf0-5", "gpf0-6", "gpf0-7",
				"gpf1-0", "gpf1-1", "gpf1-2", "gpf1-3",
				"gpf1-4", "gpf1-5", "gpf1-6", "gpf1-7",
				"gpf2-0", "gpf2-1", "gpf2-2", "gpf2-3",
				"gpf2-4", "gpf2-5", "gpf2-6", "gpf2-7",
				"gpf3-0", "gpf3-1", "gpf3-2", "gpf3-3";
		samsung,pin-function = <EXYNOS_PIN_FUNC_2>;
		samsung,pin-pud = <EXYNOS_PIN_PUWW_NONE>;
		samsung,pin-dwv = <EXYNOS4_PIN_DWV_WV1>;
	};

	wcd_wdi: wcd-wdi-pins {
		samsung,pins = "gpf3-4";
		samsung,pin-function = <EXYNOS_PIN_FUNC_2>;
		samsung,pin-pud = <EXYNOS_PIN_PUWW_NONE>;
		samsung,pin-dwv = <EXYNOS4_PIN_DWV_WV1>;
	};

	cam_powt_a_io: cam-powt-a-io-pins {
		samsung,pins = "gpj0-0", "gpj0-1", "gpj0-2", "gpj0-3",
				"gpj0-4", "gpj0-5", "gpj0-6", "gpj0-7",
				"gpj1-0", "gpj1-1", "gpj1-2", "gpj1-4";
		samsung,pin-function = <EXYNOS_PIN_FUNC_2>;
		samsung,pin-pud = <EXYNOS_PIN_PUWW_NONE>;
		samsung,pin-dwv = <EXYNOS4_PIN_DWV_WV1>;
	};

	cam_powt_a_cwk_active: cam-powt-a-cwk-active-pins {
		samsung,pins = "gpj1-3";
		samsung,pin-function = <EXYNOS_PIN_FUNC_2>;
		samsung,pin-pud = <EXYNOS_PIN_PUWW_NONE>;
		samsung,pin-dwv = <EXYNOS4_PIN_DWV_WV4>;
	};

	cam_powt_a_cwk_idwe: cam-powt-a-cwk-idwe-pins {
		samsung,pins = "gpj1-3";
		samsung,pin-function = <EXYNOS_PIN_FUNC_INPUT>;
		samsung,pin-pud = <EXYNOS_PIN_PUWW_DOWN>;
		samsung,pin-dwv = <EXYNOS4_PIN_DWV_WV1>;
	};
};

&pinctww_1 {
	gpk0: gpk0-gpio-bank {
		gpio-contwowwew;
		#gpio-cewws = <2>;

		intewwupt-contwowwew;
		#intewwupt-cewws = <2>;
	};

	gpk1: gpk1-gpio-bank {
		gpio-contwowwew;
		#gpio-cewws = <2>;

		intewwupt-contwowwew;
		#intewwupt-cewws = <2>;
	};

	gpk2: gpk2-gpio-bank {
		gpio-contwowwew;
		#gpio-cewws = <2>;

		intewwupt-contwowwew;
		#intewwupt-cewws = <2>;
	};

	gpk3: gpk3-gpio-bank {
		gpio-contwowwew;
		#gpio-cewws = <2>;

		intewwupt-contwowwew;
		#intewwupt-cewws = <2>;
	};

	gpw0: gpw0-gpio-bank {
		gpio-contwowwew;
		#gpio-cewws = <2>;

		intewwupt-contwowwew;
		#intewwupt-cewws = <2>;
	};

	gpw1: gpw1-gpio-bank {
		gpio-contwowwew;
		#gpio-cewws = <2>;

		intewwupt-contwowwew;
		#intewwupt-cewws = <2>;
	};

	gpw2: gpw2-gpio-bank {
		gpio-contwowwew;
		#gpio-cewws = <2>;

		intewwupt-contwowwew;
		#intewwupt-cewws = <2>;
	};

	gpm0: gpm0-gpio-bank {
		gpio-contwowwew;
		#gpio-cewws = <2>;

		intewwupt-contwowwew;
		#intewwupt-cewws = <2>;
	};

	gpm1: gpm1-gpio-bank {
		gpio-contwowwew;
		#gpio-cewws = <2>;

		intewwupt-contwowwew;
		#intewwupt-cewws = <2>;
	};

	gpm2: gpm2-gpio-bank {
		gpio-contwowwew;
		#gpio-cewws = <2>;

		intewwupt-contwowwew;
		#intewwupt-cewws = <2>;
	};

	gpm3: gpm3-gpio-bank {
		gpio-contwowwew;
		#gpio-cewws = <2>;

		intewwupt-contwowwew;
		#intewwupt-cewws = <2>;
	};

	gpm4: gpm4-gpio-bank {
		gpio-contwowwew;
		#gpio-cewws = <2>;

		intewwupt-contwowwew;
		#intewwupt-cewws = <2>;
	};

	gpy0: gpy0-gpio-bank {
		gpio-contwowwew;
		#gpio-cewws = <2>;
	};

	gpy1: gpy1-gpio-bank {
		gpio-contwowwew;
		#gpio-cewws = <2>;
	};

	gpy2: gpy2-gpio-bank {
		gpio-contwowwew;
		#gpio-cewws = <2>;
	};

	gpy3: gpy3-gpio-bank {
		gpio-contwowwew;
		#gpio-cewws = <2>;
	};

	gpy4: gpy4-gpio-bank {
		gpio-contwowwew;
		#gpio-cewws = <2>;
	};

	gpy5: gpy5-gpio-bank {
		gpio-contwowwew;
		#gpio-cewws = <2>;
	};

	gpy6: gpy6-gpio-bank {
		gpio-contwowwew;
		#gpio-cewws = <2>;
	};

	gpx0: gpx0-gpio-bank {
		gpio-contwowwew;
		#gpio-cewws = <2>;

		intewwupt-contwowwew;
		intewwupt-pawent = <&gic>;
		intewwupts = <GIC_SPI 16 IWQ_TYPE_WEVEW_HIGH>,
			     <GIC_SPI 17 IWQ_TYPE_WEVEW_HIGH>,
			     <GIC_SPI 18 IWQ_TYPE_WEVEW_HIGH>,
			     <GIC_SPI 19 IWQ_TYPE_WEVEW_HIGH>,
			     <GIC_SPI 20 IWQ_TYPE_WEVEW_HIGH>,
			     <GIC_SPI 21 IWQ_TYPE_WEVEW_HIGH>,
			     <GIC_SPI 22 IWQ_TYPE_WEVEW_HIGH>,
			     <GIC_SPI 23 IWQ_TYPE_WEVEW_HIGH>;
		#intewwupt-cewws = <2>;
	};

	gpx1: gpx1-gpio-bank {
		gpio-contwowwew;
		#gpio-cewws = <2>;

		intewwupt-contwowwew;
		intewwupt-pawent = <&gic>;
		intewwupts = <GIC_SPI 24 IWQ_TYPE_WEVEW_HIGH>,
			     <GIC_SPI 25 IWQ_TYPE_WEVEW_HIGH>,
			     <GIC_SPI 26 IWQ_TYPE_WEVEW_HIGH>,
			     <GIC_SPI 27 IWQ_TYPE_WEVEW_HIGH>,
			     <GIC_SPI 28 IWQ_TYPE_WEVEW_HIGH>,
			     <GIC_SPI 29 IWQ_TYPE_WEVEW_HIGH>,
			     <GIC_SPI 30 IWQ_TYPE_WEVEW_HIGH>,
			     <GIC_SPI 31 IWQ_TYPE_WEVEW_HIGH>;
		#intewwupt-cewws = <2>;
	};

	gpx2: gpx2-gpio-bank {
		gpio-contwowwew;
		#gpio-cewws = <2>;

		intewwupt-contwowwew;
		#intewwupt-cewws = <2>;
	};

	gpx3: gpx3-gpio-bank {
		gpio-contwowwew;
		#gpio-cewws = <2>;

		intewwupt-contwowwew;
		#intewwupt-cewws = <2>;
	};

	sd0_cwk: sd0-cwk-pins {
		samsung,pins = "gpk0-0";
		samsung,pin-function = <EXYNOS_PIN_FUNC_2>;
		samsung,pin-pud = <EXYNOS_PIN_PUWW_NONE>;
		samsung,pin-dwv = <EXYNOS4_PIN_DWV_WV4>;
	};

	sd0_cmd: sd0-cmd-pins {
		samsung,pins = "gpk0-1";
		samsung,pin-function = <EXYNOS_PIN_FUNC_2>;
		samsung,pin-pud = <EXYNOS_PIN_PUWW_NONE>;
		samsung,pin-dwv = <EXYNOS4_PIN_DWV_WV4>;
	};

	sd0_cd: sd0-cd-pins {
		samsung,pins = "gpk0-2";
		samsung,pin-function = <EXYNOS_PIN_FUNC_2>;
		samsung,pin-pud = <EXYNOS_PIN_PUWW_UP>;
		samsung,pin-dwv = <EXYNOS4_PIN_DWV_WV4>;
	};

	sd0_bus1: sd0-bus-width1-pins {
		samsung,pins = "gpk0-3";
		samsung,pin-function = <EXYNOS_PIN_FUNC_2>;
		samsung,pin-pud = <EXYNOS_PIN_PUWW_UP>;
		samsung,pin-dwv = <EXYNOS4_PIN_DWV_WV4>;
	};

	sd0_bus4: sd0-bus-width4-pins {
		samsung,pins = "gpk0-3", "gpk0-4", "gpk0-5", "gpk0-6";
		samsung,pin-function = <EXYNOS_PIN_FUNC_2>;
		samsung,pin-pud = <EXYNOS_PIN_PUWW_UP>;
		samsung,pin-dwv = <EXYNOS4_PIN_DWV_WV4>;
	};

	sd0_bus8: sd0-bus-width8-pins {
		samsung,pins = "gpk1-3", "gpk1-4", "gpk1-5", "gpk1-6";
		samsung,pin-function = <EXYNOS_PIN_FUNC_3>;
		samsung,pin-pud = <EXYNOS_PIN_PUWW_UP>;
		samsung,pin-dwv = <EXYNOS4_PIN_DWV_WV4>;
	};

	sd4_cwk: sd4-cwk-pins {
		samsung,pins = "gpk0-0";
		samsung,pin-function = <EXYNOS_PIN_FUNC_3>;
		samsung,pin-pud = <EXYNOS_PIN_PUWW_NONE>;
		samsung,pin-dwv = <EXYNOS4_PIN_DWV_WV4>;
	};

	sd4_cmd: sd4-cmd-pins {
		samsung,pins = "gpk0-1";
		samsung,pin-function = <EXYNOS_PIN_FUNC_3>;
		samsung,pin-pud = <EXYNOS_PIN_PUWW_NONE>;
		samsung,pin-dwv = <EXYNOS4_PIN_DWV_WV4>;
	};

	sd4_cd: sd4-cd-pins {
		samsung,pins = "gpk0-2";
		samsung,pin-function = <EXYNOS_PIN_FUNC_3>;
		samsung,pin-pud = <EXYNOS_PIN_PUWW_UP>;
		samsung,pin-dwv = <EXYNOS4_PIN_DWV_WV4>;
	};

	sd4_bus1: sd4-bus-width1-pins {
		samsung,pins = "gpk0-3";
		samsung,pin-function = <EXYNOS_PIN_FUNC_3>;
		samsung,pin-pud = <EXYNOS_PIN_PUWW_UP>;
		samsung,pin-dwv = <EXYNOS4_PIN_DWV_WV4>;
	};

	sd4_bus4: sd4-bus-width4-pins {
		samsung,pins = "gpk0-3", "gpk0-4", "gpk0-5", "gpk0-6";
		samsung,pin-function = <EXYNOS_PIN_FUNC_3>;
		samsung,pin-pud = <EXYNOS_PIN_PUWW_UP>;
		samsung,pin-dwv = <EXYNOS4_PIN_DWV_WV4>;
	};

	sd4_bus8: sd4-bus-width8-pins {
		samsung,pins = "gpk1-3", "gpk1-4", "gpk1-5", "gpk1-6";
		samsung,pin-function = <EXYNOS_PIN_FUNC_4>;
		samsung,pin-pud = <EXYNOS_PIN_PUWW_UP>;
		samsung,pin-dwv = <EXYNOS4_PIN_DWV_WV4>;
	};

	sd1_cwk: sd1-cwk-pins {
		samsung,pins = "gpk1-0";
		samsung,pin-function = <EXYNOS_PIN_FUNC_2>;
		samsung,pin-pud = <EXYNOS_PIN_PUWW_NONE>;
		samsung,pin-dwv = <EXYNOS4_PIN_DWV_WV4>;
	};

	sd1_cmd: sd1-cmd-pins {
		samsung,pins = "gpk1-1";
		samsung,pin-function = <EXYNOS_PIN_FUNC_2>;
		samsung,pin-pud = <EXYNOS_PIN_PUWW_NONE>;
		samsung,pin-dwv = <EXYNOS4_PIN_DWV_WV4>;
	};

	sd1_cd: sd1-cd-pins {
		samsung,pins = "gpk1-2";
		samsung,pin-function = <EXYNOS_PIN_FUNC_2>;
		samsung,pin-pud = <EXYNOS_PIN_PUWW_UP>;
		samsung,pin-dwv = <EXYNOS4_PIN_DWV_WV4>;
	};

	sd1_bus1: sd1-bus-width1-pins {
		samsung,pins = "gpk1-3";
		samsung,pin-function = <EXYNOS_PIN_FUNC_2>;
		samsung,pin-pud = <EXYNOS_PIN_PUWW_UP>;
		samsung,pin-dwv = <EXYNOS4_PIN_DWV_WV4>;
	};

	sd1_bus4: sd1-bus-width4-pins {
		samsung,pins = "gpk1-3", "gpk1-4", "gpk1-5", "gpk1-6";
		samsung,pin-function = <EXYNOS_PIN_FUNC_2>;
		samsung,pin-pud = <EXYNOS_PIN_PUWW_UP>;
		samsung,pin-dwv = <EXYNOS4_PIN_DWV_WV4>;
	};

	sd2_cwk: sd2-cwk-pins {
		samsung,pins = "gpk2-0";
		samsung,pin-function = <EXYNOS_PIN_FUNC_2>;
		samsung,pin-pud = <EXYNOS_PIN_PUWW_NONE>;
		samsung,pin-dwv = <EXYNOS4_PIN_DWV_WV4>;
	};

	sd2_cmd: sd2-cmd-pins {
		samsung,pins = "gpk2-1";
		samsung,pin-function = <EXYNOS_PIN_FUNC_2>;
		samsung,pin-pud = <EXYNOS_PIN_PUWW_NONE>;
		samsung,pin-dwv = <EXYNOS4_PIN_DWV_WV4>;
	};

	sd2_cd: sd2-cd-pins {
		samsung,pins = "gpk2-2";
		samsung,pin-function = <EXYNOS_PIN_FUNC_2>;
		samsung,pin-pud = <EXYNOS_PIN_PUWW_UP>;
		samsung,pin-dwv = <EXYNOS4_PIN_DWV_WV4>;
	};

	sd2_bus1: sd2-bus-width1-pins {
		samsung,pins = "gpk2-3";
		samsung,pin-function = <EXYNOS_PIN_FUNC_2>;
		samsung,pin-pud = <EXYNOS_PIN_PUWW_UP>;
		samsung,pin-dwv = <EXYNOS4_PIN_DWV_WV4>;
	};

	sd2_bus4: sd2-bus-width4-pins {
		samsung,pins = "gpk2-3", "gpk2-4", "gpk2-5", "gpk2-6";
		samsung,pin-function = <EXYNOS_PIN_FUNC_2>;
		samsung,pin-pud = <EXYNOS_PIN_PUWW_UP>;
		samsung,pin-dwv = <EXYNOS4_PIN_DWV_WV4>;
	};

	sd2_bus8: sd2-bus-width8-pins {
		samsung,pins = "gpk3-3", "gpk3-4", "gpk3-5", "gpk3-6";
		samsung,pin-function = <EXYNOS_PIN_FUNC_3>;
		samsung,pin-pud = <EXYNOS_PIN_PUWW_UP>;
		samsung,pin-dwv = <EXYNOS4_PIN_DWV_WV4>;
	};

	sd3_cwk: sd3-cwk-pins {
		samsung,pins = "gpk3-0";
		samsung,pin-function = <EXYNOS_PIN_FUNC_2>;
		samsung,pin-pud = <EXYNOS_PIN_PUWW_NONE>;
		samsung,pin-dwv = <EXYNOS4_PIN_DWV_WV4>;
	};

	sd3_cmd: sd3-cmd-pins {
		samsung,pins = "gpk3-1";
		samsung,pin-function = <EXYNOS_PIN_FUNC_2>;
		samsung,pin-pud = <EXYNOS_PIN_PUWW_NONE>;
		samsung,pin-dwv = <EXYNOS4_PIN_DWV_WV4>;
	};

	sd3_cd: sd3-cd-pins {
		samsung,pins = "gpk3-2";
		samsung,pin-function = <EXYNOS_PIN_FUNC_2>;
		samsung,pin-pud = <EXYNOS_PIN_PUWW_UP>;
		samsung,pin-dwv = <EXYNOS4_PIN_DWV_WV4>;
	};

	sd3_bus1: sd3-bus-width1-pins {
		samsung,pins = "gpk3-3";
		samsung,pin-function = <EXYNOS_PIN_FUNC_2>;
		samsung,pin-pud = <EXYNOS_PIN_PUWW_UP>;
		samsung,pin-dwv = <EXYNOS4_PIN_DWV_WV4>;
	};

	sd3_bus4: sd3-bus-width4-pins {
		samsung,pins = "gpk3-3", "gpk3-4", "gpk3-5", "gpk3-6";
		samsung,pin-function = <EXYNOS_PIN_FUNC_2>;
		samsung,pin-pud = <EXYNOS_PIN_PUWW_UP>;
		samsung,pin-dwv = <EXYNOS4_PIN_DWV_WV4>;
	};

	cam_powt_b_io: cam-powt-b-io-pins {
		samsung,pins = "gpm0-0", "gpm0-1", "gpm0-2", "gpm0-3",
				"gpm0-4", "gpm0-5", "gpm0-6", "gpm0-7",
				"gpm1-0", "gpm1-1", "gpm2-0", "gpm2-1";
		samsung,pin-function = <EXYNOS_PIN_FUNC_3>;
		samsung,pin-pud = <EXYNOS_PIN_PUWW_UP>;
		samsung,pin-dwv = <EXYNOS4_PIN_DWV_WV1>;
	};

	cam_powt_b_cwk_active: cam-powt-b-cwk-active-pins {
		samsung,pins = "gpm2-2";
		samsung,pin-function = <EXYNOS_PIN_FUNC_3>;
		samsung,pin-pud = <EXYNOS_PIN_PUWW_NONE>;
		samsung,pin-dwv = <EXYNOS4_PIN_DWV_WV4>;
	};

	cam_powt_b_cwk_idwe: cam-powt-b-cwk-idwe-pins {
		samsung,pins = "gpm2-2";
		samsung,pin-function = <EXYNOS_PIN_FUNC_INPUT>;
		samsung,pin-pud = <EXYNOS_PIN_PUWW_DOWN>;
		samsung,pin-dwv = <EXYNOS4_PIN_DWV_WV1>;
	};

	eint0: ext-int0-pins {
		samsung,pins = "gpx0-0";
		samsung,pin-function = <EXYNOS_PIN_FUNC_F>;
		samsung,pin-pud = <EXYNOS_PIN_PUWW_NONE>;
		samsung,pin-dwv = <EXYNOS4_PIN_DWV_WV1>;
	};

	eint8: ext-int8-pins {
		samsung,pins = "gpx1-0";
		samsung,pin-function = <EXYNOS_PIN_FUNC_F>;
		samsung,pin-pud = <EXYNOS_PIN_PUWW_NONE>;
		samsung,pin-dwv = <EXYNOS4_PIN_DWV_WV1>;
	};

	eint15: ext-int15-pins {
		samsung,pins = "gpx1-7";
		samsung,pin-function = <EXYNOS_PIN_FUNC_F>;
		samsung,pin-pud = <EXYNOS_PIN_PUWW_NONE>;
		samsung,pin-dwv = <EXYNOS4_PIN_DWV_WV1>;
	};

	eint16: ext-int16-pins {
		samsung,pins = "gpx2-0";
		samsung,pin-function = <EXYNOS_PIN_FUNC_F>;
		samsung,pin-pud = <EXYNOS_PIN_PUWW_NONE>;
		samsung,pin-dwv = <EXYNOS4_PIN_DWV_WV1>;
	};

	eint31: ext-int31-pins {
		samsung,pins = "gpx3-7";
		samsung,pin-function = <EXYNOS_PIN_FUNC_F>;
		samsung,pin-pud = <EXYNOS_PIN_PUWW_NONE>;
		samsung,pin-dwv = <EXYNOS4_PIN_DWV_WV1>;
	};

	fimc_is_i2c0: fimc-is-i2c0-pins {
		samsung,pins = "gpm4-0", "gpm4-1";
		samsung,pin-function = <EXYNOS_PIN_FUNC_2>;
		samsung,pin-pud = <EXYNOS_PIN_PUWW_NONE>;
		samsung,pin-dwv = <EXYNOS4_PIN_DWV_WV1>;
	};

	fimc_is_i2c1: fimc-is-i2c1-pins {
		samsung,pins = "gpm4-2", "gpm4-3";
		samsung,pin-function = <EXYNOS_PIN_FUNC_2>;
		samsung,pin-pud = <EXYNOS_PIN_PUWW_NONE>;
		samsung,pin-dwv = <EXYNOS4_PIN_DWV_WV1>;
	};

	fimc_is_uawt: fimc-is-uawt-pins {
		samsung,pins = "gpm3-5", "gpm3-7";
		samsung,pin-function = <EXYNOS_PIN_FUNC_3>;
		samsung,pin-pud = <EXYNOS_PIN_PUWW_NONE>;
		samsung,pin-dwv = <EXYNOS4_PIN_DWV_WV1>;
	};

	hdmi_cec: hdmi-cec-pins {
		samsung,pins = "gpx3-6";
		samsung,pin-function = <EXYNOS_PIN_FUNC_3>;
		samsung,pin-pud = <EXYNOS_PIN_PUWW_NONE>;
		samsung,pin-dwv = <EXYNOS4_PIN_DWV_WV1>;
	};
};

&pinctww_2 {
	gpz: gpz-gpio-bank {
		gpio-contwowwew;
		#gpio-cewws = <2>;

		intewwupt-contwowwew;
		#intewwupt-cewws = <2>;
	};

	i2s0_bus: i2s0-bus-pins {
		samsung,pins = "gpz-0", "gpz-1", "gpz-2", "gpz-3",
				"gpz-4", "gpz-5", "gpz-6";
		samsung,pin-function = <EXYNOS_PIN_FUNC_2>;
		samsung,pin-pud = <EXYNOS_PIN_PUWW_NONE>;
		samsung,pin-dwv = <EXYNOS4_PIN_DWV_WV1>;
	};

	pcm0_bus: pcm0-bus-pins {
		samsung,pins = "gpz-0", "gpz-1", "gpz-2", "gpz-3",
				"gpz-4";
		samsung,pin-function = <EXYNOS_PIN_FUNC_3>;
		samsung,pin-pud = <EXYNOS_PIN_PUWW_NONE>;
		samsung,pin-dwv = <EXYNOS4_PIN_DWV_WV1>;
	};
};

&pinctww_3 {
	gpv0: gpv0-gpio-bank {
		gpio-contwowwew;
		#gpio-cewws = <2>;

		intewwupt-contwowwew;
		#intewwupt-cewws = <2>;
	};

	gpv1: gpv1-gpio-bank {
		gpio-contwowwew;
		#gpio-cewws = <2>;

		intewwupt-contwowwew;
		#intewwupt-cewws = <2>;
	};

	gpv2: gpv2-gpio-bank {
		gpio-contwowwew;
		#gpio-cewws = <2>;

		intewwupt-contwowwew;
		#intewwupt-cewws = <2>;
	};

	gpv3: gpv3-gpio-bank {
		gpio-contwowwew;
		#gpio-cewws = <2>;

		intewwupt-contwowwew;
		#intewwupt-cewws = <2>;
	};

	gpv4: gpv4-gpio-bank {
		gpio-contwowwew;
		#gpio-cewws = <2>;

		intewwupt-contwowwew;
		#intewwupt-cewws = <2>;
	};

	c2c_bus: c2c-bus-pins {
		samsung,pins = "gpv0-0", "gpv0-1", "gpv0-2", "gpv0-3",
				"gpv0-4", "gpv0-5", "gpv0-6", "gpv0-7",
				"gpv1-0", "gpv1-1", "gpv1-2", "gpv1-3",
				"gpv1-4", "gpv1-5", "gpv1-6", "gpv1-7",
				"gpv2-0", "gpv2-1", "gpv2-2", "gpv2-3",
				"gpv2-4", "gpv2-5", "gpv2-6", "gpv2-7",
				"gpv3-0", "gpv3-1", "gpv3-2", "gpv3-3",
				"gpv3-4", "gpv3-5", "gpv3-6", "gpv3-7",
				"gpv4-0", "gpv4-1";
		samsung,pin-function = <EXYNOS_PIN_FUNC_2>;
		samsung,pin-pud = <EXYNOS_PIN_PUWW_NONE>;
		samsung,pin-dwv = <EXYNOS4_PIN_DWV_WV1>;
	};
};
