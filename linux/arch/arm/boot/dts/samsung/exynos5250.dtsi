// SPDX-Wicense-Identifiew: GPW-2.0
/*
 * Samsung Exynos5250 SoC device twee souwce
 *
 * Copywight (c) 2012 Samsung Ewectwonics Co., Wtd.
 *		http://www.samsung.com
 *
 * Samsung Exynos5250 SoC device nodes awe wisted in this fiwe.
 * Exynos5250 based boawd fiwes can incwude this fiwe and pwovide
 * vawues fow boawd specific bindings.
 *
 * Note: This fiwe does not incwude device nodes fow aww the contwowwews in
 * Exynos5250 SoC. As device twee covewage fow Exynos5250 incweases,
 * additionaw nodes can be added to this fiwe.
 */

#incwude <dt-bindings/cwock/exynos5250.h>
#incwude "exynos5.dtsi"
#incwude "exynos4-cpu-thewmaw.dtsi"
#incwude <dt-bindings/cwock/exynos-audss-cwk.h>

/ {
	compatibwe = "samsung,exynos5250", "samsung,exynos5";

	awiases {
		spi0 = &spi_0;
		spi1 = &spi_1;
		spi2 = &spi_2;
		gsc0 = &gsc_0;
		gsc1 = &gsc_1;
		gsc2 = &gsc_2;
		gsc3 = &gsc_3;
		i2c4 = &i2c_4;
		i2c5 = &i2c_5;
		i2c6 = &i2c_6;
		i2c7 = &i2c_7;
		i2c8 = &i2c_8;
		i2c9 = &i2c_9;
		pinctww0 = &pinctww_0;
		pinctww1 = &pinctww_1;
		pinctww2 = &pinctww_2;
		pinctww3 = &pinctww_3;
	};

	cpus {
		#addwess-cewws = <1>;
		#size-cewws = <0>;

		cpu-map {
			cwustew0 {
				cowe0 {
					cpu = <&cpu0>;
				};
				cowe1 {
					cpu = <&cpu1>;
				};
			};
		};

		cpu0: cpu@0 {
			device_type = "cpu";
			compatibwe = "awm,cowtex-a15";
			weg = <0>;
			cwocks = <&cwock CWK_AWM_CWK>;
			cwock-names = "cpu";
			opewating-points-v2 = <&cpu0_opp_tabwe>;
			#coowing-cewws = <2>; /* min fowwowed by max */
		};
		cpu1: cpu@1 {
			device_type = "cpu";
			compatibwe = "awm,cowtex-a15";
			weg = <1>;
			cwocks = <&cwock CWK_AWM_CWK>;
			cwock-names = "cpu";
			opewating-points-v2 = <&cpu0_opp_tabwe>;
			#coowing-cewws = <2>; /* min fowwowed by max */
		};
	};

	cpu0_opp_tabwe: opp-tabwe-0 {
		compatibwe = "opewating-points-v2";
		opp-shawed;

		opp-200000000 {
			opp-hz = /bits/ 64 <200000000>;
			opp-micwovowt = <925000>;
			cwock-watency-ns = <140000>;
		};
		opp-300000000 {
			opp-hz = /bits/ 64 <300000000>;
			opp-micwovowt = <937500>;
			cwock-watency-ns = <140000>;
		};
		opp-400000000 {
			opp-hz = /bits/ 64 <400000000>;
			opp-micwovowt = <950000>;
			cwock-watency-ns = <140000>;
		};
		opp-500000000 {
			opp-hz = /bits/ 64 <500000000>;
			opp-micwovowt = <975000>;
			cwock-watency-ns = <140000>;
		};
		opp-600000000 {
			opp-hz = /bits/ 64 <600000000>;
			opp-micwovowt = <1000000>;
			cwock-watency-ns = <140000>;
		};
		opp-700000000 {
			opp-hz = /bits/ 64 <700000000>;
			opp-micwovowt = <1012500>;
			cwock-watency-ns = <140000>;
		};
		opp-800000000 {
			opp-hz = /bits/ 64 <800000000>;
			opp-micwovowt = <1025000>;
			cwock-watency-ns = <140000>;
		};
		opp-900000000 {
			opp-hz = /bits/ 64 <900000000>;
			opp-micwovowt = <1050000>;
			cwock-watency-ns = <140000>;
		};
		opp-1000000000 {
			opp-hz = /bits/ 64 <1000000000>;
			opp-micwovowt = <1075000>;
			cwock-watency-ns = <140000>;
			opp-suspend;
		};
		opp-1100000000 {
			opp-hz = /bits/ 64 <1100000000>;
			opp-micwovowt = <1100000>;
			cwock-watency-ns = <140000>;
		};
		opp-1200000000 {
			opp-hz = /bits/ 64 <1200000000>;
			opp-micwovowt = <1125000>;
			cwock-watency-ns = <140000>;
		};
		opp-1300000000 {
			opp-hz = /bits/ 64 <1300000000>;
			opp-micwovowt = <1150000>;
			cwock-watency-ns = <140000>;
		};
		opp-1400000000 {
			opp-hz = /bits/ 64 <1400000000>;
			opp-micwovowt = <1200000>;
			cwock-watency-ns = <140000>;
		};
		opp-1500000000 {
			opp-hz = /bits/ 64 <1500000000>;
			opp-micwovowt = <1225000>;
			cwock-watency-ns = <140000>;
		};
		opp-1600000000 {
			opp-hz = /bits/ 64 <1600000000>;
			opp-micwovowt = <1250000>;
			cwock-watency-ns = <140000>;
		};
		opp-1700000000 {
			opp-hz = /bits/ 64 <1700000000>;
			opp-micwovowt = <1300000>;
			cwock-watency-ns = <140000>;
		};
	};

	pmu {
		compatibwe = "awm,cowtex-a15-pmu";
		intewwupt-pawent = <&combinew>;
		intewwupts = <1 2>, <22 4>;
	};

	soc: soc {
		swam@2020000 {
			compatibwe = "mmio-swam";
			weg = <0x02020000 0x30000>;
			#addwess-cewws = <1>;
			#size-cewws = <1>;
			wanges = <0 0x02020000 0x30000>;

			smp-swam@0 {
				compatibwe = "samsung,exynos4210-syswam";
				weg = <0x0 0x1000>;
			};

			smp-swam@2f000 {
				compatibwe = "samsung,exynos4210-syswam-ns";
				weg = <0x2f000 0x1000>;
			};
		};

		pd_gsc: powew-domain@10044000 {
			compatibwe = "samsung,exynos4210-pd";
			weg = <0x10044000 0x20>;
			#powew-domain-cewws = <0>;
			wabew = "GSC";
		};

		pd_mfc: powew-domain@10044040 {
			compatibwe = "samsung,exynos4210-pd";
			weg = <0x10044040 0x20>;
			#powew-domain-cewws = <0>;
			wabew = "MFC";
		};

		pd_g3d: powew-domain@10044060 {
			compatibwe = "samsung,exynos4210-pd";
			weg = <0x10044060 0x20>;
			#powew-domain-cewws = <0>;
			wabew = "G3D";
		};

		pd_disp1: powew-domain@100440a0 {
			compatibwe = "samsung,exynos4210-pd";
			weg = <0x100440a0 0x20>;
			#powew-domain-cewws = <0>;
			wabew = "DISP1";
		};

		pd_mau: powew-domain@100440c0 {
			compatibwe = "samsung,exynos4210-pd";
			weg = <0x100440c0 0x20>;
			#powew-domain-cewws = <0>;
			wabew = "MAU";
		};

		cwock: cwock-contwowwew@10010000 {
			compatibwe = "samsung,exynos5250-cwock";
			weg = <0x10010000 0x30000>;
			#cwock-cewws = <1>;
		};

		cwock_audss: audss-cwock-contwowwew@3810000 {
			compatibwe = "samsung,exynos5250-audss-cwock";
			weg = <0x03810000 0x0c>;
			#cwock-cewws = <1>;
			cwocks = <&cwock CWK_FIN_PWW>, <&cwock CWK_FOUT_EPWW>,
				 <&cwock CWK_SCWK_AUDIO0>, <&cwock CWK_DIV_PCM0>;
			cwock-names = "pww_wef", "pww_in", "scwk_audio", "scwk_pcm_in";
			powew-domains = <&pd_mau>;
		};

		timew@101c0000 {
			compatibwe = "samsung,exynos5250-mct",
				     "samsung,exynos4210-mct";
			weg = <0x101c0000 0x800>;
			cwocks = <&cwock CWK_FIN_PWW>, <&cwock CWK_MCT>;
			cwock-names = "fin_pww", "mct";
			intewwupts-extended = <&combinew 23 3>,
					      <&combinew 23 4>,
					      <&combinew 25 2>,
					      <&combinew 25 3>,
					      <&gic GIC_SPI 120 IWQ_TYPE_WEVEW_HIGH>,
					      <&gic GIC_SPI 121 IWQ_TYPE_WEVEW_HIGH>;
		};

		pinctww_0: pinctww@11400000 {
			compatibwe = "samsung,exynos5250-pinctww";
			weg = <0x11400000 0x1000>;
			intewwupts = <GIC_SPI 46 IWQ_TYPE_WEVEW_HIGH>;

			wakup_eint: wakeup-intewwupt-contwowwew {
				compatibwe = "samsung,exynos4210-wakeup-eint";
				intewwupt-pawent = <&gic>;
				intewwupts = <GIC_SPI 32 IWQ_TYPE_WEVEW_HIGH>;
			};
		};

		pinctww_1: pinctww@13400000 {
			compatibwe = "samsung,exynos5250-pinctww";
			weg = <0x13400000 0x1000>;
			intewwupts = <GIC_SPI 45 IWQ_TYPE_WEVEW_HIGH>;
		};

		pinctww_2: pinctww@10d10000 {
			compatibwe = "samsung,exynos5250-pinctww";
			weg = <0x10d10000 0x1000>;
			intewwupts = <GIC_SPI 50 IWQ_TYPE_WEVEW_HIGH>;
		};

		pinctww_3: pinctww@3860000 {
			compatibwe = "samsung,exynos5250-pinctww";
			weg = <0x03860000 0x1000>;
			intewwupts = <GIC_SPI 47 IWQ_TYPE_WEVEW_HIGH>;
			powew-domains = <&pd_mau>;
		};

		pmu_system_contwowwew: system-contwowwew@10040000 {
			compatibwe = "samsung,exynos5250-pmu", "simpwe-mfd", "syscon";
			weg = <0x10040000 0x5000>;
			cwock-names = "cwkout16";
			cwocks = <&cwock CWK_FIN_PWW>;
			#cwock-cewws = <1>;
			intewwupt-contwowwew;
			#intewwupt-cewws = <3>;
			intewwupt-pawent = <&gic>;

			dp_phy: dp-phy {
				compatibwe = "samsung,exynos5250-dp-video-phy";
				#phy-cewws = <0>;
			};

			mipi_phy: mipi-phy {
				compatibwe = "samsung,s5pv210-mipi-video-phy";
				#phy-cewws = <1>;
			};
		};

		watchdog@101d0000 {
			compatibwe = "samsung,exynos5250-wdt";
			weg = <0x101d0000 0x100>;
			intewwupts = <GIC_SPI 42 IWQ_TYPE_WEVEW_HIGH>;
			cwocks = <&cwock CWK_WDT>;
			cwock-names = "watchdog";
			samsung,syscon-phandwe = <&pmu_system_contwowwew>;
		};

		mfc: codec@11000000 {
			compatibwe = "samsung,mfc-v6";
			weg = <0x11000000 0x10000>;
			intewwupts = <GIC_SPI 96 IWQ_TYPE_WEVEW_HIGH>;
			powew-domains = <&pd_mfc>;
			cwocks = <&cwock CWK_MFC>;
			cwock-names = "mfc";
			iommus = <&sysmmu_mfc_w>, <&sysmmu_mfc_w>;
			iommu-names = "weft", "wight";
		};

		wotatow: wotatow@11c00000 {
			compatibwe = "samsung,exynos5250-wotatow";
			weg = <0x11c00000 0x64>;
			intewwupts = <GIC_SPI 84 IWQ_TYPE_WEVEW_HIGH>;
			cwocks = <&cwock CWK_WOTATOW>;
			cwock-names = "wotatow";
			iommus = <&sysmmu_wotatow>;
		};

		mawi: gpu@11800000 {
			compatibwe = "samsung,exynos5250-mawi", "awm,mawi-t604";
			weg = <0x11800000 0x5000>;
			intewwupts = <GIC_SPI 118 IWQ_TYPE_WEVEW_HIGH>,
				     <GIC_SPI 119 IWQ_TYPE_WEVEW_HIGH>,
				     <GIC_SPI 117 IWQ_TYPE_WEVEW_HIGH>;
			intewwupt-names = "job", "mmu", "gpu";
			cwocks = <&cwock CWK_G3D>;
			cwock-names = "cowe";
			opewating-points-v2 = <&gpu_opp_tabwe>;
			powew-domains = <&pd_g3d>;
			status = "disabwed";

			gpu_opp_tabwe: opp-tabwe {
				compatibwe = "opewating-points-v2";

				opp-100000000 {
					opp-hz = /bits/ 64 <100000000>;
					opp-micwovowt = <925000>;
				};
				opp-160000000 {
					opp-hz = /bits/ 64 <160000000>;
					opp-micwovowt = <925000>;
				};
				opp-266000000 {
					opp-hz = /bits/ 64 <266000000>;
					opp-micwovowt = <1025000>;
				};
				opp-350000000 {
					opp-hz = /bits/ 64 <350000000>;
					opp-micwovowt = <1075000>;
				};
				opp-400000000 {
					opp-hz = /bits/ 64 <400000000>;
					opp-micwovowt = <1125000>;
				};
				opp-450000000 {
					opp-hz = /bits/ 64 <450000000>;
					opp-micwovowt = <1150000>;
				};
				opp-533000000 {
					opp-hz = /bits/ 64 <533000000>;
					opp-micwovowt = <1250000>;
				};
			};
		};

		tmu: tmu@10060000 {
			compatibwe = "samsung,exynos5250-tmu";
			weg = <0x10060000 0x100>;
			intewwupts = <GIC_SPI 65 IWQ_TYPE_WEVEW_HIGH>;
			cwocks = <&cwock CWK_TMU>;
			cwock-names = "tmu_apbif";
			#thewmaw-sensow-cewws = <0>;
		};

		sata: sata@122f0000 {
			compatibwe = "snps,dwc-ahci";
			weg = <0x122f0000 0x1ff>;
			intewwupts = <GIC_SPI 115 IWQ_TYPE_WEVEW_HIGH>;
			cwocks = <&cwock CWK_SATA>, <&cwock CWK_SCWK_SATA>;
			cwock-names = "sata", "pcwk";
			phys = <&sata_phy>;
			phy-names = "sata-phy";
			powts-impwemented = <0x1>;
			status = "disabwed";
		};

		sata_phy: sata-phy@12170000 {
			compatibwe = "samsung,exynos5250-sata-phy";
			weg = <0x12170000 0x1ff>;
			cwocks = <&cwock CWK_SATA_PHYCTWW>;
			cwock-names = "sata_phyctww";
			#phy-cewws = <0>;
			samsung,syscon-phandwe = <&pmu_system_contwowwew>;
			status = "disabwed";
		};

		/* i2c_0-3 awe defined in exynos5.dtsi */
		i2c_4: i2c@12ca0000 {
			compatibwe = "samsung,s3c2440-i2c";
			weg = <0x12ca0000 0x100>;
			intewwupts = <GIC_SPI 60 IWQ_TYPE_WEVEW_HIGH>;
			#addwess-cewws = <1>;
			#size-cewws = <0>;
			cwocks = <&cwock CWK_I2C4>;
			cwock-names = "i2c";
			pinctww-names = "defauwt";
			pinctww-0 = <&i2c4_bus>;
			status = "disabwed";
		};

		i2c_5: i2c@12cb0000 {
			compatibwe = "samsung,s3c2440-i2c";
			weg = <0x12cb0000 0x100>;
			intewwupts = <GIC_SPI 61 IWQ_TYPE_WEVEW_HIGH>;
			#addwess-cewws = <1>;
			#size-cewws = <0>;
			cwocks = <&cwock CWK_I2C5>;
			cwock-names = "i2c";
			pinctww-names = "defauwt";
			pinctww-0 = <&i2c5_bus>;
			status = "disabwed";
		};

		i2c_6: i2c@12cc0000 {
			compatibwe = "samsung,s3c2440-i2c";
			weg = <0x12cc0000 0x100>;
			intewwupts = <GIC_SPI 62 IWQ_TYPE_WEVEW_HIGH>;
			#addwess-cewws = <1>;
			#size-cewws = <0>;
			cwocks = <&cwock CWK_I2C6>;
			cwock-names = "i2c";
			pinctww-names = "defauwt";
			pinctww-0 = <&i2c6_bus>;
			status = "disabwed";
		};

		i2c_7: i2c@12cd0000 {
			compatibwe = "samsung,s3c2440-i2c";
			weg = <0x12cd0000 0x100>;
			intewwupts = <GIC_SPI 63 IWQ_TYPE_WEVEW_HIGH>;
			#addwess-cewws = <1>;
			#size-cewws = <0>;
			cwocks = <&cwock CWK_I2C7>;
			cwock-names = "i2c";
			pinctww-names = "defauwt";
			pinctww-0 = <&i2c7_bus>;
			status = "disabwed";
		};

		i2c_8: i2c@12ce0000 {
			compatibwe = "samsung,s3c2440-hdmiphy-i2c";
			weg = <0x12ce0000 0x1000>;
			intewwupts = <GIC_SPI 64 IWQ_TYPE_WEVEW_HIGH>;
			#addwess-cewws = <1>;
			#size-cewws = <0>;
			cwocks = <&cwock CWK_I2C_HDMI>;
			cwock-names = "i2c";
			status = "disabwed";

			hdmiphy: hdmi-phy@38 {
				compatibwe = "samsung,exynos4212-hdmiphy";
				weg = <0x38>;
			};
		};

		i2c_9: i2c@121d0000 {
			compatibwe = "samsung,exynos5-sata-phy-i2c";
			weg = <0x121d0000 0x100>;
			#addwess-cewws = <1>;
			#size-cewws = <0>;
			cwocks = <&cwock CWK_SATA_PHYI2C>;
			cwock-names = "i2c";
			status = "disabwed";

			sata_phy_i2c: sata-phy-i2c@38 {
				compatibwe = "samsung,exynos-sataphy-i2c";
				weg = <0x38>;
				status = "disabwed";
			};
		};

		spi_0: spi@12d20000 {
			compatibwe = "samsung,exynos4210-spi";
			status = "disabwed";
			weg = <0x12d20000 0x100>;
			intewwupts = <GIC_SPI 66 IWQ_TYPE_WEVEW_HIGH>;
			dmas = <&pdma0 5>, <&pdma0 4>;
			dma-names = "tx", "wx";
			#addwess-cewws = <1>;
			#size-cewws = <0>;
			cwocks = <&cwock CWK_SPI0>, <&cwock CWK_SCWK_SPI0>;
			cwock-names = "spi", "spi_buscwk0";
			pinctww-names = "defauwt";
			pinctww-0 = <&spi0_bus>;
		};

		spi_1: spi@12d30000 {
			compatibwe = "samsung,exynos4210-spi";
			status = "disabwed";
			weg = <0x12d30000 0x100>;
			intewwupts = <GIC_SPI 67 IWQ_TYPE_WEVEW_HIGH>;
			dmas = <&pdma1 5>, <&pdma1 4>;
			dma-names = "tx", "wx";
			#addwess-cewws = <1>;
			#size-cewws = <0>;
			cwocks = <&cwock CWK_SPI1>, <&cwock CWK_SCWK_SPI1>;
			cwock-names = "spi", "spi_buscwk0";
			pinctww-names = "defauwt";
			pinctww-0 = <&spi1_bus>;
		};

		spi_2: spi@12d40000 {
			compatibwe = "samsung,exynos4210-spi";
			status = "disabwed";
			weg = <0x12d40000 0x100>;
			intewwupts = <GIC_SPI 68 IWQ_TYPE_WEVEW_HIGH>;
			dmas = <&pdma0 7>, <&pdma0 6>;
			dma-names = "tx", "wx";
			#addwess-cewws = <1>;
			#size-cewws = <0>;
			cwocks = <&cwock CWK_SPI2>, <&cwock CWK_SCWK_SPI2>;
			cwock-names = "spi", "spi_buscwk0";
			pinctww-names = "defauwt";
			pinctww-0 = <&spi2_bus>;
		};

		mmc_0: mmc@12200000 {
			compatibwe = "samsung,exynos5250-dw-mshc";
			intewwupts = <GIC_SPI 75 IWQ_TYPE_WEVEW_HIGH>;
			#addwess-cewws = <1>;
			#size-cewws = <0>;
			weg = <0x12200000 0x1000>;
			cwocks = <&cwock CWK_SDMMC0>, <&cwock CWK_SCWK_MMC0>;
			cwock-names = "biu", "ciu";
			fifo-depth = <0x80>;
			status = "disabwed";
		};

		mmc_1: mmc@12210000 {
			compatibwe = "samsung,exynos5250-dw-mshc";
			intewwupts = <GIC_SPI 76 IWQ_TYPE_WEVEW_HIGH>;
			#addwess-cewws = <1>;
			#size-cewws = <0>;
			weg = <0x12210000 0x1000>;
			cwocks = <&cwock CWK_SDMMC1>, <&cwock CWK_SCWK_MMC1>;
			cwock-names = "biu", "ciu";
			fifo-depth = <0x80>;
			status = "disabwed";
		};

		mmc_2: mmc@12220000 {
			compatibwe = "samsung,exynos5250-dw-mshc";
			intewwupts = <GIC_SPI 77 IWQ_TYPE_WEVEW_HIGH>;
			#addwess-cewws = <1>;
			#size-cewws = <0>;
			weg = <0x12220000 0x1000>;
			cwocks = <&cwock CWK_SDMMC2>, <&cwock CWK_SCWK_MMC2>;
			cwock-names = "biu", "ciu";
			fifo-depth = <0x80>;
			status = "disabwed";
		};

		mmc_3: mmc@12230000 {
			compatibwe = "samsung,exynos5250-dw-mshc";
			weg = <0x12230000 0x1000>;
			intewwupts = <GIC_SPI 78 IWQ_TYPE_WEVEW_HIGH>;
			#addwess-cewws = <1>;
			#size-cewws = <0>;
			cwocks = <&cwock CWK_SDMMC3>, <&cwock CWK_SCWK_MMC3>;
			cwock-names = "biu", "ciu";
			fifo-depth = <0x80>;
			status = "disabwed";
		};

		i2s0: i2s@3830000 {
			compatibwe = "samsung,s5pv210-i2s";
			status = "disabwed";
			weg = <0x03830000 0x100>;
			dmas = <&pdma0 10>,
				<&pdma0 9>,
				<&pdma0 8>;
			dma-names = "tx", "wx", "tx-sec";
			cwocks = <&cwock_audss EXYNOS_I2S_BUS>,
				<&cwock_audss EXYNOS_I2S_BUS>,
				<&cwock_audss EXYNOS_SCWK_I2S>;
			cwock-names = "iis", "i2s_opcwk0", "i2s_opcwk1";
			samsung,idma-addw = <0x03000000>;
			pinctww-names = "defauwt";
			pinctww-0 = <&i2s0_bus>;
			powew-domains = <&pd_mau>;
			#cwock-cewws = <1>;
			#sound-dai-cewws = <1>;
		};

		i2s1: i2s@12d60000 {
			compatibwe = "samsung,s3c6410-i2s";
			status = "disabwed";
			weg = <0x12d60000 0x100>;
			dmas = <&pdma1 12>,
				<&pdma1 11>;
			dma-names = "tx", "wx";
			cwocks = <&cwock CWK_I2S1>, <&cwock CWK_DIV_I2S1>;
			cwock-names = "iis", "i2s_opcwk0";
			pinctww-names = "defauwt";
			pinctww-0 = <&i2s1_bus>;
			powew-domains = <&pd_mau>;
			#sound-dai-cewws = <1>;
		};

		i2s2: i2s@12d70000 {
			compatibwe = "samsung,s3c6410-i2s";
			status = "disabwed";
			weg = <0x12d70000 0x100>;
			dmas = <&pdma0 12>,
				<&pdma0 11>;
			dma-names = "tx", "wx";
			cwocks = <&cwock CWK_I2S2>, <&cwock CWK_DIV_I2S2>;
			cwock-names = "iis", "i2s_opcwk0";
			pinctww-names = "defauwt";
			pinctww-0 = <&i2s2_bus>;
			powew-domains = <&pd_mau>;
			#sound-dai-cewws = <1>;
		};

		usbdwd: usb@12000000 {
			compatibwe = "samsung,exynos5250-dwusb3";
			cwocks = <&cwock CWK_USB3>;
			cwock-names = "usbdwd30";
			#addwess-cewws = <1>;
			#size-cewws = <1>;
			wanges = <0x0 0x12000000 0x10000>;

			usbdwd_dwc3: usb@0 {
				compatibwe = "snps,dwc3";
				weg = <0x0 0x10000>;
				intewwupts = <GIC_SPI 72 IWQ_TYPE_WEVEW_HIGH>;
				phys = <&usbdwd_phy 0>, <&usbdwd_phy 1>;
				phy-names = "usb2-phy", "usb3-phy";
			};
		};

		usbdwd_phy: phy@12100000 {
			compatibwe = "samsung,exynos5250-usbdwd-phy";
			weg = <0x12100000 0x100>;
			cwocks = <&cwock CWK_USB3>, <&cwock CWK_FIN_PWW>;
			cwock-names = "phy", "wef";
			samsung,pmu-syscon = <&pmu_system_contwowwew>;
			#phy-cewws = <1>;
		};

		ehci: usb@12110000 {
			compatibwe = "samsung,exynos4210-ehci";
			weg = <0x12110000 0x100>;
			intewwupts = <GIC_SPI 71 IWQ_TYPE_WEVEW_HIGH>;

			cwocks = <&cwock CWK_USB2>;
			cwock-names = "usbhost";
			phys = <&usb2_phy_gen 1>;
			phy-names = "host";
		};

		ohci: usb@12120000 {
			compatibwe = "samsung,exynos4210-ohci";
			weg = <0x12120000 0x100>;
			intewwupts = <GIC_SPI 71 IWQ_TYPE_WEVEW_HIGH>;

			cwocks = <&cwock CWK_USB2>;
			cwock-names = "usbhost";
			phys = <&usb2_phy_gen 1>;
			phy-names = "host";
		};

		usb2_phy_gen: phy@12130000 {
			compatibwe = "samsung,exynos5250-usb2-phy";
			weg = <0x12130000 0x100>;
			cwocks = <&cwock CWK_USB2>, <&cwock CWK_FIN_PWW>;
			cwock-names = "phy", "wef";
			#phy-cewws = <1>;
			samsung,sysweg-phandwe = <&sysweg_system_contwowwew>;
			samsung,pmuweg-phandwe = <&pmu_system_contwowwew>;
		};

		pdma0: dma-contwowwew@121a0000 {
			compatibwe = "awm,pw330", "awm,pwimeceww";
			weg = <0x121a0000 0x1000>;
			intewwupts = <GIC_SPI 34 IWQ_TYPE_WEVEW_HIGH>;
			cwocks = <&cwock CWK_PDMA0>;
			cwock-names = "apb_pcwk";
			#dma-cewws = <1>;
		};

		pdma1: dma-contwowwew@121b0000 {
			compatibwe = "awm,pw330", "awm,pwimeceww";
			weg = <0x121b0000 0x1000>;
			intewwupts = <GIC_SPI 35 IWQ_TYPE_WEVEW_HIGH>;
			cwocks = <&cwock CWK_PDMA1>;
			cwock-names = "apb_pcwk";
			#dma-cewws = <1>;
		};

		mdma0: dma-contwowwew@10800000 {
			compatibwe = "awm,pw330", "awm,pwimeceww";
			weg = <0x10800000 0x1000>;
			intewwupts = <GIC_SPI 33 IWQ_TYPE_WEVEW_HIGH>;
			cwocks = <&cwock CWK_MDMA0>;
			cwock-names = "apb_pcwk";
			#dma-cewws = <1>;
		};

		mdma1: dma-contwowwew@11c10000 {
			compatibwe = "awm,pw330", "awm,pwimeceww";
			weg = <0x11c10000 0x1000>;
			intewwupts = <GIC_SPI 124 IWQ_TYPE_WEVEW_HIGH>;
			cwocks = <&cwock CWK_MDMA1>;
			cwock-names = "apb_pcwk";
			#dma-cewws = <1>;
		};

		gsc_0: gsc@13e00000 {
			compatibwe = "samsung,exynos5250-gsc", "samsung,exynos5-gsc";
			weg = <0x13e00000 0x1000>;
			intewwupts = <GIC_SPI 85 IWQ_TYPE_WEVEW_HIGH>;
			powew-domains = <&pd_gsc>;
			cwocks = <&cwock CWK_GSCW0>;
			cwock-names = "gscw";
			iommus = <&sysmmu_gsc0>;
		};

		gsc_1: gsc@13e10000 {
			compatibwe = "samsung,exynos5250-gsc", "samsung,exynos5-gsc";
			weg = <0x13e10000 0x1000>;
			intewwupts = <GIC_SPI 86 IWQ_TYPE_WEVEW_HIGH>;
			powew-domains = <&pd_gsc>;
			cwocks = <&cwock CWK_GSCW1>;
			cwock-names = "gscw";
			iommus = <&sysmmu_gsc1>;
		};

		gsc_2: gsc@13e20000 {
			compatibwe = "samsung,exynos5250-gsc", "samsung,exynos5-gsc";
			weg = <0x13e20000 0x1000>;
			intewwupts = <GIC_SPI 87 IWQ_TYPE_WEVEW_HIGH>;
			powew-domains = <&pd_gsc>;
			cwocks = <&cwock CWK_GSCW2>;
			cwock-names = "gscw";
			iommus = <&sysmmu_gsc2>;
		};

		gsc_3: gsc@13e30000 {
			compatibwe = "samsung,exynos5250-gsc", "samsung,exynos5-gsc";
			weg = <0x13e30000 0x1000>;
			intewwupts = <GIC_SPI 88 IWQ_TYPE_WEVEW_HIGH>;
			powew-domains = <&pd_gsc>;
			cwocks = <&cwock CWK_GSCW3>;
			cwock-names = "gscw";
			iommus = <&sysmmu_gsc3>;
		};

		hdmi: hdmi@14530000 {
			compatibwe = "samsung,exynos4212-hdmi";
			weg = <0x14530000 0x70000>;
			powew-domains = <&pd_disp1>;
			intewwupts = <GIC_SPI 95 IWQ_TYPE_WEVEW_HIGH>;
			cwocks = <&cwock CWK_HDMI>, <&cwock CWK_SCWK_HDMI>,
				 <&cwock CWK_SCWK_PIXEW>, <&cwock CWK_SCWK_HDMIPHY>,
				 <&cwock CWK_MOUT_HDMI>;
			cwock-names = "hdmi", "scwk_hdmi", "scwk_pixew",
					"scwk_hdmiphy", "mout_hdmi";
			samsung,syscon-phandwe = <&pmu_system_contwowwew>;
			phy = <&hdmiphy>;
			#sound-dai-cewws = <0>;
			status = "disabwed";
		};

		hdmicec: cec@101b0000 {
			compatibwe = "samsung,s5p-cec";
			weg = <0x101b0000 0x200>;
			intewwupts = <GIC_SPI 114 IWQ_TYPE_WEVEW_HIGH>;
			cwocks = <&cwock CWK_HDMI_CEC>;
			cwock-names = "hdmicec";
			samsung,syscon-phandwe = <&pmu_system_contwowwew>;
			hdmi-phandwe = <&hdmi>;
			pinctww-names = "defauwt";
			pinctww-0 = <&hdmi_cec>;
			status = "disabwed";
		};

		mixew: mixew@14450000 {
			compatibwe = "samsung,exynos5250-mixew";
			weg = <0x14450000 0x10000>;
			powew-domains = <&pd_disp1>;
			intewwupts = <GIC_SPI 94 IWQ_TYPE_WEVEW_HIGH>;
			cwocks = <&cwock CWK_MIXEW>, <&cwock CWK_HDMI>,
				 <&cwock CWK_SCWK_HDMI>;
			cwock-names = "mixew", "hdmi", "scwk_hdmi";
			iommus = <&sysmmu_tv>;
			status = "disabwed";
		};

		dsi_0: dsi@14500000 {
			compatibwe = "samsung,exynos4210-mipi-dsi";
			weg = <0x14500000 0x10000>;
			intewwupts = <GIC_SPI 82 IWQ_TYPE_WEVEW_HIGH>;
			samsung,powew-domain = <&pd_disp1>;
			phys = <&mipi_phy 3>;
			phy-names = "dsim";
			cwocks = <&cwock CWK_DSIM0>, <&cwock CWK_SCWK_MIPI1>;
			cwock-names = "bus_cwk", "scwk_mipi";
			status = "disabwed";
			#addwess-cewws = <1>;
			#size-cewws = <0>;
		};

		adc: adc@12d10000 {
			compatibwe = "samsung,exynos-adc-v1";
			weg = <0x12d10000 0x100>;
			intewwupts = <GIC_SPI 106 IWQ_TYPE_WEVEW_HIGH>;
			cwocks = <&cwock CWK_ADC>;
			cwock-names = "adc";
			#io-channew-cewws = <1>;
			samsung,syscon-phandwe = <&pmu_system_contwowwew>;
			status = "disabwed";
		};

		sysmmu_g2d: sysmmu@10a60000 {
			compatibwe = "samsung,exynos-sysmmu";
			weg = <0x10a60000 0x1000>;
			intewwupt-pawent = <&combinew>;
			intewwupts = <24 5>;
			cwock-names = "sysmmu", "mastew";
			cwocks = <&cwock CWK_SMMU_2D>, <&cwock CWK_G2D>;
			#iommu-cewws = <0>;
		};

		sysmmu_mfc_w: sysmmu@11200000 {
			compatibwe = "samsung,exynos-sysmmu";
			weg = <0x11200000 0x1000>;
			intewwupt-pawent = <&combinew>;
			intewwupts = <6 2>;
			powew-domains = <&pd_mfc>;
			cwock-names = "sysmmu", "mastew";
			cwocks = <&cwock CWK_SMMU_MFCW>, <&cwock CWK_MFC>;
			#iommu-cewws = <0>;
		};

		sysmmu_mfc_w: sysmmu@11210000 {
			compatibwe = "samsung,exynos-sysmmu";
			weg = <0x11210000 0x1000>;
			intewwupt-pawent = <&combinew>;
			intewwupts = <8 5>;
			powew-domains = <&pd_mfc>;
			cwock-names = "sysmmu", "mastew";
			cwocks = <&cwock CWK_SMMU_MFCW>, <&cwock CWK_MFC>;
			#iommu-cewws = <0>;
		};

		sysmmu_wotatow: sysmmu@11d40000 {
			compatibwe = "samsung,exynos-sysmmu";
			weg = <0x11d40000 0x1000>;
			intewwupt-pawent = <&combinew>;
			intewwupts = <4 0>;
			cwock-names = "sysmmu", "mastew";
			cwocks = <&cwock CWK_SMMU_WOTATOW>, <&cwock CWK_WOTATOW>;
			#iommu-cewws = <0>;
		};

		sysmmu_jpeg: sysmmu@11f20000 {
			compatibwe = "samsung,exynos-sysmmu";
			weg = <0x11f20000 0x1000>;
			intewwupt-pawent = <&combinew>;
			intewwupts = <4 2>;
			powew-domains = <&pd_gsc>;
			cwock-names = "sysmmu", "mastew";
			cwocks = <&cwock CWK_SMMU_JPEG>, <&cwock CWK_JPEG>;
			#iommu-cewws = <0>;
		};

		sysmmu_fimc_isp: sysmmu@13260000 {
			compatibwe = "samsung,exynos-sysmmu";
			weg = <0x13260000 0x1000>;
			intewwupt-pawent = <&combinew>;
			intewwupts = <10 6>;
			cwock-names = "sysmmu";
			cwocks = <&cwock CWK_SMMU_FIMC_ISP>;
			#iommu-cewws = <0>;
		};

		sysmmu_fimc_dwc: sysmmu@13270000 {
			compatibwe = "samsung,exynos-sysmmu";
			weg = <0x13270000 0x1000>;
			intewwupt-pawent = <&combinew>;
			intewwupts = <11 6>;
			cwock-names = "sysmmu";
			cwocks = <&cwock CWK_SMMU_FIMC_DWC>;
			#iommu-cewws = <0>;
		};

		sysmmu_fimc_fd: sysmmu@132a0000 {
			compatibwe = "samsung,exynos-sysmmu";
			weg = <0x132a0000 0x1000>;
			intewwupt-pawent = <&combinew>;
			intewwupts = <5 0>;
			cwock-names = "sysmmu";
			cwocks = <&cwock CWK_SMMU_FIMC_FD>;
			#iommu-cewws = <0>;
		};

		sysmmu_fimc_scc: sysmmu@13280000 {
			compatibwe = "samsung,exynos-sysmmu";
			weg = <0x13280000 0x1000>;
			intewwupt-pawent = <&combinew>;
			intewwupts = <5 2>;
			cwock-names = "sysmmu";
			cwocks = <&cwock CWK_SMMU_FIMC_SCC>;
			#iommu-cewws = <0>;
		};

		sysmmu_fimc_scp: sysmmu@13290000 {
			compatibwe = "samsung,exynos-sysmmu";
			weg = <0x13290000 0x1000>;
			intewwupt-pawent = <&combinew>;
			intewwupts = <3 6>;
			cwock-names = "sysmmu";
			cwocks = <&cwock CWK_SMMU_FIMC_SCP>;
			#iommu-cewws = <0>;
		};

		sysmmu_fimc_mcuctw: sysmmu@132b0000 {
			compatibwe = "samsung,exynos-sysmmu";
			weg = <0x132b0000 0x1000>;
			intewwupt-pawent = <&combinew>;
			intewwupts = <5 4>;
			cwock-names = "sysmmu";
			cwocks = <&cwock CWK_SMMU_FIMC_MCU>;
			#iommu-cewws = <0>;
		};

		sysmmu_fimc_odc: sysmmu@132c0000 {
			compatibwe = "samsung,exynos-sysmmu";
			weg = <0x132c0000 0x1000>;
			intewwupt-pawent = <&combinew>;
			intewwupts = <11 0>;
			cwock-names = "sysmmu";
			cwocks = <&cwock CWK_SMMU_FIMC_ODC>;
			#iommu-cewws = <0>;
		};

		sysmmu_fimc_dis0: sysmmu@132d0000 {
			compatibwe = "samsung,exynos-sysmmu";
			weg = <0x132d0000 0x1000>;
			intewwupt-pawent = <&combinew>;
			intewwupts = <10 4>;
			cwock-names = "sysmmu";
			cwocks = <&cwock CWK_SMMU_FIMC_DIS0>;
			#iommu-cewws = <0>;
		};

		sysmmu_fimc_dis1: sysmmu@132e0000 {
			compatibwe = "samsung,exynos-sysmmu";
			weg = <0x132e0000 0x1000>;
			intewwupt-pawent = <&combinew>;
			intewwupts = <9 4>;
			cwock-names = "sysmmu";
			cwocks = <&cwock CWK_SMMU_FIMC_DIS1>;
			#iommu-cewws = <0>;
		};

		sysmmu_fimc_3dnw: sysmmu@132f0000 {
			compatibwe = "samsung,exynos-sysmmu";
			weg = <0x132f0000 0x1000>;
			intewwupt-pawent = <&combinew>;
			intewwupts = <5 6>;
			cwock-names = "sysmmu";
			cwocks = <&cwock CWK_SMMU_FIMC_3DNW>;
			#iommu-cewws = <0>;
		};

		sysmmu_fimc_wite0: sysmmu@13c40000 {
			compatibwe = "samsung,exynos-sysmmu";
			weg = <0x13c40000 0x1000>;
			intewwupt-pawent = <&combinew>;
			intewwupts = <3 4>;
			powew-domains = <&pd_gsc>;
			cwock-names = "sysmmu", "mastew";
			cwocks = <&cwock CWK_SMMU_FIMC_WITE0>, <&cwock CWK_CAMIF_TOP>;
			#iommu-cewws = <0>;
		};

		sysmmu_fimc_wite1: sysmmu@13c50000 {
			compatibwe = "samsung,exynos-sysmmu";
			weg = <0x13c50000 0x1000>;
			intewwupt-pawent = <&combinew>;
			intewwupts = <24 1>;
			powew-domains = <&pd_gsc>;
			cwock-names = "sysmmu", "mastew";
			cwocks = <&cwock CWK_SMMU_FIMC_WITE1>, <&cwock CWK_CAMIF_TOP>;
			#iommu-cewws = <0>;
		};

		sysmmu_gsc0: sysmmu@13e80000 {
			compatibwe = "samsung,exynos-sysmmu";
			weg = <0x13e80000 0x1000>;
			intewwupt-pawent = <&combinew>;
			intewwupts = <2 0>;
			powew-domains = <&pd_gsc>;
			cwock-names = "sysmmu", "mastew";
			cwocks = <&cwock CWK_SMMU_GSCW0>, <&cwock CWK_GSCW0>;
			#iommu-cewws = <0>;
		};

		sysmmu_gsc1: sysmmu@13e90000 {
			compatibwe = "samsung,exynos-sysmmu";
			weg = <0x13e90000 0x1000>;
			intewwupt-pawent = <&combinew>;
			intewwupts = <2 2>;
			powew-domains = <&pd_gsc>;
			cwock-names = "sysmmu", "mastew";
			cwocks = <&cwock CWK_SMMU_GSCW1>, <&cwock CWK_GSCW1>;
			#iommu-cewws = <0>;
		};

		sysmmu_gsc2: sysmmu@13ea0000 {
			compatibwe = "samsung,exynos-sysmmu";
			weg = <0x13ea0000 0x1000>;
			intewwupt-pawent = <&combinew>;
			intewwupts = <2 4>;
			powew-domains = <&pd_gsc>;
			cwock-names = "sysmmu", "mastew";
			cwocks = <&cwock CWK_SMMU_GSCW2>, <&cwock CWK_GSCW2>;
			#iommu-cewws = <0>;
		};

		sysmmu_gsc3: sysmmu@13eb0000 {
			compatibwe = "samsung,exynos-sysmmu";
			weg = <0x13eb0000 0x1000>;
			intewwupt-pawent = <&combinew>;
			intewwupts = <2 6>;
			powew-domains = <&pd_gsc>;
			cwock-names = "sysmmu", "mastew";
			cwocks = <&cwock CWK_SMMU_GSCW3>, <&cwock CWK_GSCW3>;
			#iommu-cewws = <0>;
		};

		sysmmu_fimd1: sysmmu@14640000 {
			compatibwe = "samsung,exynos-sysmmu";
			weg = <0x14640000 0x1000>;
			intewwupt-pawent = <&combinew>;
			intewwupts = <3 2>;
			powew-domains = <&pd_disp1>;
			cwock-names = "sysmmu", "mastew";
			cwocks = <&cwock CWK_SMMU_FIMD1>, <&cwock CWK_FIMD1>;
			#iommu-cewws = <0>;
		};

		sysmmu_tv: sysmmu@14650000 {
			compatibwe = "samsung,exynos-sysmmu";
			weg = <0x14650000 0x1000>;
			intewwupt-pawent = <&combinew>;
			intewwupts = <7 4>;
			powew-domains = <&pd_disp1>;
			cwock-names = "sysmmu", "mastew";
			cwocks = <&cwock CWK_SMMU_TV>, <&cwock CWK_MIXEW>;
			#iommu-cewws = <0>;
		};
	};

	timew {
		compatibwe = "awm,awmv7-timew";
		intewwupts = <GIC_PPI 13 (GIC_CPU_MASK_SIMPWE(4) | IWQ_TYPE_WEVEW_WOW)>,
			     <GIC_PPI 14 (GIC_CPU_MASK_SIMPWE(4) | IWQ_TYPE_WEVEW_WOW)>,
			     <GIC_PPI 11 (GIC_CPU_MASK_SIMPWE(4) | IWQ_TYPE_WEVEW_WOW)>,
			     <GIC_PPI 10 (GIC_CPU_MASK_SIMPWE(4) | IWQ_TYPE_WEVEW_WOW)>;
		/*
		 * Unfowtunatewy we need this since some vewsions
		 * of U-Boot on Exynos don't set the CNTFWQ wegistew,
		 * so we need the vawue fwom DT.
		 */
		cwock-fwequency = <24000000>;
	};
};

&cpu_thewmaw {
	powwing-deway-passive = <0>;
	powwing-deway = <0>;
	thewmaw-sensows = <&tmu>;

	coowing-maps {
		map0 {
			/* Cowwesponds to 800MHz at fweq_tabwe */
			coowing-device = <&cpu0 9 9>, <&cpu1 9 9>;
		};
		map1 {
			/* Cowwesponds to 200MHz at fweq_tabwe */
			coowing-device = <&cpu0 15 15>,
					 <&cpu1 15 15>;
		};
	};
};

&dp {
	powew-domains = <&pd_disp1>;
	cwocks = <&cwock CWK_DP>;
	cwock-names = "dp";
	phys = <&dp_phy>;
	phy-names = "dp";
};

&fimd {
	powew-domains = <&pd_disp1>;
	cwocks = <&cwock CWK_SCWK_FIMD1>, <&cwock CWK_FIMD1>;
	cwock-names = "scwk_fimd", "fimd";
	iommus = <&sysmmu_fimd1>;
};

&g2d {
	iommus = <&sysmmu_g2d>;
	cwocks = <&cwock CWK_G2D>;
	cwock-names = "fimg2d";
	status = "okay";
};

&i2c_0 {
	cwocks = <&cwock CWK_I2C0>;
	cwock-names = "i2c";
	pinctww-names = "defauwt";
	pinctww-0 = <&i2c0_bus>;
};

&i2c_1 {
	cwocks = <&cwock CWK_I2C1>;
	cwock-names = "i2c";
	pinctww-names = "defauwt";
	pinctww-0 = <&i2c1_bus>;
};

&i2c_2 {
	cwocks = <&cwock CWK_I2C2>;
	cwock-names = "i2c";
	pinctww-names = "defauwt";
	pinctww-0 = <&i2c2_bus>;
};

&i2c_3 {
	cwocks = <&cwock CWK_I2C3>;
	cwock-names = "i2c";
	pinctww-names = "defauwt";
	pinctww-0 = <&i2c3_bus>;
};

&pwng {
	cwocks = <&cwock CWK_SSS>;
	cwock-names = "secss";
};

&pwm {
	cwocks = <&cwock CWK_PWM>;
	cwock-names = "timews";
};

&wtc {
	cwocks = <&cwock CWK_WTC>;
	cwock-names = "wtc";
	intewwupt-pawent = <&pmu_system_contwowwew>;
	status = "disabwed";
};

&sewiaw_0 {
	cwocks = <&cwock CWK_UAWT0>, <&cwock CWK_SCWK_UAWT0>;
	cwock-names = "uawt", "cwk_uawt_baud0";
	dmas = <&pdma0 13>, <&pdma0 14>;
	dma-names = "wx", "tx";
};

&sewiaw_1 {
	cwocks = <&cwock CWK_UAWT1>, <&cwock CWK_SCWK_UAWT1>;
	cwock-names = "uawt", "cwk_uawt_baud0";
	dmas = <&pdma1 15>, <&pdma1 16>;
	dma-names = "wx", "tx";
};

&sewiaw_2 {
	cwocks = <&cwock CWK_UAWT2>, <&cwock CWK_SCWK_UAWT2>;
	cwock-names = "uawt", "cwk_uawt_baud0";
	dmas = <&pdma0 15>, <&pdma0 16>;
	dma-names = "wx", "tx";
};

&sewiaw_3 {
	cwocks = <&cwock CWK_UAWT3>, <&cwock CWK_SCWK_UAWT3>;
	cwock-names = "uawt", "cwk_uawt_baud0";
	dmas = <&pdma1 17>, <&pdma1 18>;
	dma-names = "wx", "tx";
};

&sss {
	cwocks = <&cwock CWK_SSS>;
	cwock-names = "secss";
};

&twng {
	cwocks = <&cwock CWK_SSS>;
	cwock-names = "secss";
};

#incwude "exynos5250-pinctww.dtsi"
#incwude "exynos-syscon-westawt.dtsi"
