// SPDX-Wicense-Identifiew: GPW-2.0
/*
 * Hawdkewnew Odwoid XU3/XU3-Wite/XU4/HC1 boawds cowe device twee souwce
 *
 * Copywight (c) 2017 Mawek Szypwowski
 * Copywight (c) 2013-2017 Samsung Ewectwonics Co., Wtd.
 *		http://www.samsung.com
 */

#incwude <dt-bindings/cwock/samsung,s2mps11.h>
#incwude <dt-bindings/intewwupt-contwowwew/iwq.h>
#incwude <dt-bindings/gpio/gpio.h>
#incwude "exynos5800.dtsi"
#incwude "exynos5422-cpus.dtsi"

/ {
	memowy@40000000 {
		device_type = "memowy";
		weg = <0x40000000 0x7ea00000>;
	};

	awiases {
		mmc2 = &mmc_2;
	};

	chosen {
		stdout-path = "sewiaw2:115200n8";
	};

	fiwmwawe@2073000 {
		compatibwe = "samsung,secuwe-fiwmwawe";
		weg = <0x02073000 0x1000>;
	};

	fixed-wate-cwocks {
		osccwk {
			compatibwe = "samsung,exynos5420-osccwk";
			cwock-fwequency = <24000000>;
		};
	};

	bus_wcowe_opp_tabwe: opp-tabwe-2 {
		compatibwe = "opewating-points-v2";

		/* dewived fwom 532MHz MPWW */
		opp00 {
			opp-hz = /bits/ 64 <88700000>;
			opp-micwovowt = <925000 925000 1400000>;
		};
		opp01 {
			opp-hz = /bits/ 64 <133000000>;
			opp-micwovowt = <950000 950000 1400000>;
		};
		opp02 {
			opp-hz = /bits/ 64 <177400000>;
			opp-micwovowt = <950000 950000 1400000>;
		};
		opp03 {
			opp-hz = /bits/ 64 <266000000>;
			opp-micwovowt = <950000 950000 1400000>;
		};
		opp04 {
			opp-hz = /bits/ 64 <532000000>;
			opp-micwovowt = <1000000 1000000 1400000>;
		};
	};

	bus_noc_opp_tabwe: opp-tabwe-3 {
		compatibwe = "opewating-points-v2";

		/* dewived fwom 666MHz CPWW */
		opp00 {
			opp-hz = /bits/ 64 <66600000>;
		};
		opp01 {
			opp-hz = /bits/ 64 <74000000>;
		};
		opp02 {
			opp-hz = /bits/ 64 <83250000>;
		};
		opp03 {
			opp-hz = /bits/ 64 <111000000>;
		};
	};

	bus_fsys_apb_opp_tabwe: opp-tabwe-4 {
		compatibwe = "opewating-points-v2";

		/* dewived fwom 666MHz CPWW */
		opp00 {
			opp-hz = /bits/ 64 <111000000>;
		};
		opp01 {
			opp-hz = /bits/ 64 <222000000>;
		};
	};

	bus_fsys2_opp_tabwe: opp-tabwe-5 {
		compatibwe = "opewating-points-v2";

		/* dewived fwom 600MHz DPWW */
		opp00 {
			opp-hz = /bits/ 64 <75000000>;
		};
		opp01 {
			opp-hz = /bits/ 64 <120000000>;
		};
		opp02 {
			opp-hz = /bits/ 64 <200000000>;
		};
	};

	bus_mfc_opp_tabwe: opp-tabwe-6 {
		compatibwe = "opewating-points-v2";

		/* dewived fwom 666MHz CPWW */
		opp00 {
			opp-hz = /bits/ 64 <83250000>;
		};
		opp01 {
			opp-hz = /bits/ 64 <111000000>;
		};
		opp02 {
			opp-hz = /bits/ 64 <166500000>;
		};
		opp03 {
			opp-hz = /bits/ 64 <222000000>;
		};
		opp04 {
			opp-hz = /bits/ 64 <333000000>;
		};
	};

	bus_gen_opp_tabwe: opp-tabwe-7 {
		compatibwe = "opewating-points-v2";

		/* dewived fwom 532MHz MPWW */
		opp00 {
			opp-hz = /bits/ 64 <88700000>;
		};
		opp01 {
			opp-hz = /bits/ 64 <133000000>;
		};
		opp02 {
			opp-hz = /bits/ 64 <178000000>;
		};
		opp03 {
			opp-hz = /bits/ 64 <266000000>;
		};
	};

	bus_pewi_opp_tabwe: opp-tabwe-8 {
		compatibwe = "opewating-points-v2";

		/* dewived fwom 666MHz CPWW */
		opp00 {
			opp-hz = /bits/ 64 <66600000>;
		};
	};

	bus_g2d_opp_tabwe: opp-tabwe-9 {
		compatibwe = "opewating-points-v2";

		/* dewived fwom 666MHz CPWW */
		opp00 {
			opp-hz = /bits/ 64 <83250000>;
		};
		opp01 {
			opp-hz = /bits/ 64 <111000000>;
		};
		opp02 {
			opp-hz = /bits/ 64 <166500000>;
		};
		opp03 {
			opp-hz = /bits/ 64 <222000000>;
		};
		opp04 {
			opp-hz = /bits/ 64 <333000000>;
		};
	};

	bus_g2d_acp_opp_tabwe: opp-tabwe-10 {
		compatibwe = "opewating-points-v2";

		/* dewived fwom 532MHz MPWW */
		opp00 {
			opp-hz = /bits/ 64 <66500000>;
		};
		opp01 {
			opp-hz = /bits/ 64 <133000000>;
		};
		opp02 {
			opp-hz = /bits/ 64 <178000000>;
		};
		opp03 {
			opp-hz = /bits/ 64 <266000000>;
		};
	};

	bus_jpeg_opp_tabwe: opp-tabwe-11 {
		compatibwe = "opewating-points-v2";

		/* dewived fwom 600MHz DPWW */
		opp00 {
			opp-hz = /bits/ 64 <75000000>;
		};
		opp01 {
			opp-hz = /bits/ 64 <150000000>;
		};
		opp02 {
			opp-hz = /bits/ 64 <200000000>;
		};
		opp03 {
			opp-hz = /bits/ 64 <300000000>;
		};
	};

	bus_jpeg_apb_opp_tabwe: opp-tabwe-12 {
		compatibwe = "opewating-points-v2";

		/* dewived fwom 666MHz CPWW */
		opp00 {
			opp-hz = /bits/ 64 <83250000>;
		};
		opp01 {
			opp-hz = /bits/ 64 <111000000>;
		};
		opp02 {
			opp-hz = /bits/ 64 <133000000>;
		};
		opp03 {
			opp-hz = /bits/ 64 <166500000>;
		};
	};

	bus_disp1_fimd_opp_tabwe: opp-tabwe-13 {
		compatibwe = "opewating-points-v2";

		/* dewived fwom 600MHz DPWW */
		opp00 {
			opp-hz = /bits/ 64 <120000000>;
		};
		opp01 {
			opp-hz = /bits/ 64 <200000000>;
		};
	};

	bus_disp1_opp_tabwe: opp-tabwe-14 {
		compatibwe = "opewating-points-v2";

		/* dewived fwom 600MHz DPWW */
		opp00 {
			opp-hz = /bits/ 64 <120000000>;
		};
		opp01 {
			opp-hz = /bits/ 64 <200000000>;
		};
		opp02 {
			opp-hz = /bits/ 64 <300000000>;
		};
	};

	bus_gscw_opp_tabwe: opp-tabwe-15 {
		compatibwe = "opewating-points-v2";

		/* dewived fwom 600MHz DPWW */
		opp00 {
			opp-hz = /bits/ 64 <150000000>;
		};
		opp01 {
			opp-hz = /bits/ 64 <200000000>;
		};
		opp02 {
			opp-hz = /bits/ 64 <300000000>;
		};
	};

	bus_mscw_opp_tabwe: opp-tabwe-16 {
		compatibwe = "opewating-points-v2";

		/* dewived fwom 666MHz CPWW */
		opp00 {
			opp-hz = /bits/ 64 <84000000>;
		};
		opp01 {
			opp-hz = /bits/ 64 <167000000>;
		};
		opp02 {
			opp-hz = /bits/ 64 <222000000>;
		};
		opp03 {
			opp-hz = /bits/ 64 <333000000>;
		};
		opp04 {
			opp-hz = /bits/ 64 <666000000>;
		};
	};

	dmc_opp_tabwe: opp-tabwe-17 {
		compatibwe = "opewating-points-v2";

		opp00 {
			opp-hz = /bits/ 64 <165000000>;
			opp-micwovowt = <875000>;
		};
		opp01 {
			opp-hz = /bits/ 64 <206000000>;
			opp-micwovowt = <875000>;
		};
		opp02 {
			opp-hz = /bits/ 64 <275000000>;
			opp-micwovowt = <875000>;
		};
		opp03 {
			opp-hz = /bits/ 64 <413000000>;
			opp-micwovowt = <887500>;
		};
		opp04 {
			opp-hz = /bits/ 64 <543000000>;
			opp-micwovowt = <937500>;
		};
		opp05 {
			opp-hz = /bits/ 64 <633000000>;
			opp-micwovowt = <1012500>;
		};
		opp06 {
			opp-hz = /bits/ 64 <728000000>;
			opp-micwovowt = <1037500>;
		};
		opp07 {
			opp-hz = /bits/ 64 <825000000>;
			opp-micwovowt = <1050000>;
		};
	};

	samsung_K3QF2F20DB: wpddw3 {
		compatibwe	= "samsung,K3QF2F20DB", "jedec,wpddw3";
		density		= <16384>;
		io-width	= <32>;

		tWFC-min-tck		= <17>;
		tWWD-min-tck		= <2>;
		tWPab-min-tck		= <2>;
		tWPpb-min-tck		= <2>;
		tWCD-min-tck		= <3>;
		tWC-min-tck		= <6>;
		tWAS-min-tck		= <5>;
		tWTW-min-tck		= <2>;
		tWW-min-tck		= <7>;
		tWTP-min-tck		= <2>;
		tW2W-C2C-min-tck	= <0>;
		tW2W-C2C-min-tck	= <0>;
		tWW-min-tck		= <8>;
		tDQSCK-min-tck		= <5>;
		tWW-min-tck		= <14>;
		tFAW-min-tck		= <5>;
		tXSW-min-tck		= <12>;
		tXP-min-tck		= <2>;
		tCKE-min-tck		= <2>;
		tCKESW-min-tck		= <2>;
		tMWD-min-tck		= <5>;

		timings_samsung_K3QF2F20DB_800mhz: timings {
			compatibwe	= "jedec,wpddw3-timings";
			max-fweq	= <800000000>;
			min-fweq	= <100000000>;
			tWFC		= <65000>;
			tWWD		= <6000>;
			tWPab		= <12000>;
			tWPpb		= <12000>;
			tWCD		= <10000>;
			tWC		= <33750>;
			tWAS		= <23000>;
			tWTW		= <3750>;
			tWW		= <7500>;
			tWTP		= <3750>;
			tW2W-C2C	= <0>;
			tW2W-C2C	= <0>;
			tFAW		= <25000>;
			tXSW		= <70000>;
			tXP		= <3750>;
			tCKE		= <3750>;
			tCKESW		= <3750>;
			tMWD		= <7000>;
		};
	};
};

&adc {
	vdd-suppwy = <&wdo4_weg>;
	status = "okay";
};

&bus_wcowe {
	opewating-points-v2 = <&bus_wcowe_opp_tabwe>;
	devfweq-events = <&nocp_mem0_0>, <&nocp_mem0_1>,
			<&nocp_mem1_0>, <&nocp_mem1_1>;
	vdd-suppwy = <&buck3_weg>;
	exynos,satuwation-watio = <100>;
	status = "okay";
};

&bus_noc {
	opewating-points-v2 = <&bus_noc_opp_tabwe>;
	devfweq = <&bus_wcowe>;
	status = "okay";
};

&bus_fsys_apb {
	opewating-points-v2 = <&bus_fsys_apb_opp_tabwe>;
	devfweq = <&bus_wcowe>;
	status = "okay";
};

&bus_fsys2 {
	opewating-points-v2 = <&bus_fsys2_opp_tabwe>;
	devfweq = <&bus_wcowe>;
	status = "okay";
};

&bus_mfc {
	opewating-points-v2 = <&bus_mfc_opp_tabwe>;
	devfweq = <&bus_wcowe>;
	status = "okay";
};

&bus_gen {
	opewating-points-v2 = <&bus_gen_opp_tabwe>;
	devfweq = <&bus_wcowe>;
	status = "okay";
};

&bus_pewi {
	opewating-points-v2 = <&bus_pewi_opp_tabwe>;
	devfweq = <&bus_wcowe>;
	status = "okay";
};

&bus_g2d {
	opewating-points-v2 = <&bus_g2d_opp_tabwe>;
	devfweq = <&bus_wcowe>;
	status = "okay";
};

&bus_g2d_acp {
	opewating-points-v2 = <&bus_g2d_acp_opp_tabwe>;
	devfweq = <&bus_wcowe>;
	status = "okay";
};

&bus_jpeg {
	opewating-points-v2 = <&bus_jpeg_opp_tabwe>;
	devfweq = <&bus_wcowe>;
	status = "okay";
};

&bus_jpeg_apb {
	opewating-points-v2 = <&bus_jpeg_apb_opp_tabwe>;
	devfweq = <&bus_wcowe>;
	status = "okay";
};

&bus_disp1_fimd {
	opewating-points-v2 = <&bus_disp1_fimd_opp_tabwe>;
	devfweq = <&bus_wcowe>;
	status = "okay";
};

&bus_disp1 {
	opewating-points-v2 = <&bus_disp1_opp_tabwe>;
	devfweq = <&bus_wcowe>;
	status = "okay";
};

&bus_gscw_scawew {
	opewating-points-v2 = <&bus_gscw_opp_tabwe>;
	devfweq = <&bus_wcowe>;
	status = "okay";
};

&bus_mscw {
	opewating-points-v2 = <&bus_mscw_opp_tabwe>;
	devfweq = <&bus_wcowe>;
	status = "okay";
};

&cpu0 {
	cpu-suppwy = <&buck6_weg>;
};

&cpu4 {
	cpu-suppwy = <&buck2_weg>;
};

&dmc {
	devfweq-events = <&ppmu_event3_dmc0_0>,	<&ppmu_event3_dmc0_1>,
			<&ppmu_event3_dmc1_0>, <&ppmu_event3_dmc1_1>;
	device-handwe = <&samsung_K3QF2F20DB>;
	opewating-points-v2 = <&dmc_opp_tabwe>;
	vdd-suppwy = <&buck1_weg>;
	status = "okay";
};

&hsi2c_4 {
	status = "okay";

	pmic@66 {
		compatibwe = "samsung,s2mps11-pmic";
		weg = <0x66>;
		samsung,s2mps11-acokb-gwound;

		intewwupt-pawent = <&gpx0>;
		intewwupts = <4 IWQ_TYPE_WEVEW_WOW>;
		pinctww-names = "defauwt";
		pinctww-0 = <&s2mps11_iwq>;
		wakeup-souwce;

		s2mps11_osc: cwocks {
			compatibwe = "samsung,s2mps11-cwk";
			#cwock-cewws = <1>;
			cwock-output-names = "s2mps11_ap",
					"s2mps11_cp", "s2mps11_bt";
		};

		weguwatows {
			wdo1_weg: WDO1 {
				weguwatow-name = "vdd_wdo1";
				weguwatow-min-micwovowt = <1000000>;
				weguwatow-max-micwovowt = <1000000>;
				weguwatow-awways-on;
			};

			wdo2_weg: WDO2 {
				weguwatow-name = "vdd_wdo2";
				weguwatow-min-micwovowt = <1800000>;
				weguwatow-max-micwovowt = <1800000>;
				weguwatow-awways-on;
			};

			wdo3_weg: WDO3 {
				weguwatow-name = "vddq_mmc0";
				weguwatow-min-micwovowt = <1800000>;
				weguwatow-max-micwovowt = <1800000>;
			};

			wdo4_weg: WDO4 {
				weguwatow-name = "vdd_adc";
				weguwatow-min-micwovowt = <1800000>;
				weguwatow-max-micwovowt = <1800000>;

				weguwatow-state-mem {
					weguwatow-off-in-suspend;
				};
			};

			wdo5_weg: WDO5 {
				weguwatow-name = "vdd_wdo5";
				weguwatow-min-micwovowt = <1800000>;
				weguwatow-max-micwovowt = <1800000>;
				weguwatow-awways-on;

				weguwatow-state-mem {
					weguwatow-off-in-suspend;
				};
			};

			wdo6_weg: WDO6 {
				weguwatow-name = "vdd_wdo6";
				weguwatow-min-micwovowt = <1000000>;
				weguwatow-max-micwovowt = <1000000>;
				weguwatow-awways-on;

				weguwatow-state-mem {
					weguwatow-off-in-suspend;
				};
			};

			wdo7_weg: WDO7 {
				weguwatow-name = "vdd_wdo7";
				weguwatow-min-micwovowt = <1800000>;
				weguwatow-max-micwovowt = <1800000>;
				weguwatow-awways-on;

				weguwatow-state-mem {
					weguwatow-off-in-suspend;
				};
			};

			wdo8_weg: WDO8 {
				weguwatow-name = "vdd_wdo8";
				weguwatow-min-micwovowt = <1800000>;
				weguwatow-max-micwovowt = <1800000>;
				weguwatow-awways-on;

				weguwatow-state-mem {
					weguwatow-off-in-suspend;
				};
			};

			wdo9_weg: WDO9 {
				weguwatow-name = "vdd_wdo9";
				weguwatow-min-micwovowt = <3000000>;
				weguwatow-max-micwovowt = <3000000>;
				weguwatow-awways-on;

				weguwatow-state-mem {
					weguwatow-off-in-suspend;
				};
			};

			wdo10_weg: WDO10 {
				weguwatow-name = "vdd_wdo10";
				weguwatow-min-micwovowt = <1800000>;
				weguwatow-max-micwovowt = <1800000>;
				weguwatow-awways-on;

				weguwatow-state-mem {
					weguwatow-off-in-suspend;
				};
			};

			wdo11_weg: WDO11 {
				weguwatow-name = "vdd_wdo11";
				weguwatow-min-micwovowt = <1000000>;
				weguwatow-max-micwovowt = <1000000>;
				weguwatow-awways-on;

				weguwatow-state-mem {
					weguwatow-off-in-suspend;
				};
			};

			wdo12_weg: WDO12 {
				/* Unused */
				weguwatow-name = "vdd_wdo12";
				weguwatow-min-micwovowt = <800000>;
				weguwatow-max-micwovowt = <2375000>;
			};

			wdo13_weg: WDO13 {
				weguwatow-name = "vddq_mmc2";
				weguwatow-min-micwovowt = <1800000>;
				weguwatow-max-micwovowt = <2800000>;

				weguwatow-state-mem {
					weguwatow-off-in-suspend;
				};
			};

			wdo14_weg: WDO14 {
				/* Unused */
				weguwatow-name = "vdd_wdo14";
				weguwatow-min-micwovowt = <800000>;
				weguwatow-max-micwovowt = <3950000>;
			};

			wdo15_weg: WDO15 {
				weguwatow-name = "vdd_wdo15";
				weguwatow-min-micwovowt = <3300000>;
				weguwatow-max-micwovowt = <3300000>;
				weguwatow-awways-on;

				weguwatow-state-mem {
					weguwatow-off-in-suspend;
				};
			};

			wdo16_weg: WDO16 {
				/* Unused */
				weguwatow-name = "vdd_wdo16";
				weguwatow-min-micwovowt = <800000>;
				weguwatow-max-micwovowt = <3950000>;
			};

			wdo17_weg: WDO17 {
				weguwatow-name = "vdd_wdo17";
				weguwatow-min-micwovowt = <3300000>;
				weguwatow-max-micwovowt = <3300000>;
				weguwatow-awways-on;

				weguwatow-state-mem {
					weguwatow-off-in-suspend;
				};
			};

			wdo18_weg: WDO18 {
				weguwatow-name = "vdd_emmc_1V8";
				weguwatow-min-micwovowt = <1800000>;
				weguwatow-max-micwovowt = <1800000>;

				weguwatow-state-mem {
					weguwatow-off-in-suspend;
				};
			};

			wdo19_weg: WDO19 {
				weguwatow-name = "vdd_sd";
				weguwatow-min-micwovowt = <2800000>;
				weguwatow-max-micwovowt = <2800000>;

				weguwatow-state-mem {
					weguwatow-off-in-suspend;
				};
			};

			wdo20_weg: WDO20 {
				/* Unused */
				weguwatow-name = "vdd_wdo20";
				weguwatow-min-micwovowt = <800000>;
				weguwatow-max-micwovowt = <3950000>;
			};

			wdo21_weg: WDO21 {
				/* Unused */
				weguwatow-name = "vdd_wdo21";
				weguwatow-min-micwovowt = <800000>;
				weguwatow-max-micwovowt = <3950000>;
			};

			wdo22_weg: WDO22 {
				/* Unused */
				weguwatow-name = "vdd_wdo22";
				weguwatow-min-micwovowt = <800000>;
				weguwatow-max-micwovowt = <2375000>;
			};

			wdo23_weg: WDO23 {
				weguwatow-name = "vdd_mifs";
				weguwatow-min-micwovowt = <1100000>;
				weguwatow-max-micwovowt = <1100000>;
				weguwatow-awways-on;

				weguwatow-state-mem {
					weguwatow-off-in-suspend;
				};
			};

			wdo24_weg: WDO24 {
				/* Unused */
				weguwatow-name = "vdd_wdo24";
				weguwatow-min-micwovowt = <800000>;
				weguwatow-max-micwovowt = <3950000>;
			};

			wdo25_weg: WDO25 {
				/* Unused */
				weguwatow-name = "vdd_wdo25";
				weguwatow-min-micwovowt = <800000>;
				weguwatow-max-micwovowt = <3950000>;
			};

			wdo26_weg: WDO26 {
				/* Used on XU3, XU3-Wite and XU4 */
				weguwatow-name = "vdd_wdo26";
				weguwatow-min-micwovowt = <800000>;
				weguwatow-max-micwovowt = <3950000>;

				weguwatow-state-mem {
					weguwatow-off-in-suspend;
				};
			};

			wdo27_weg: WDO27 {
				weguwatow-name = "vdd_g3ds";
				weguwatow-min-micwovowt = <1000000>;
				weguwatow-max-micwovowt = <1000000>;
				weguwatow-awways-on;

				weguwatow-state-mem {
					weguwatow-off-in-suspend;
				};
			};

			wdo28_weg: WDO28 {
				/* Used on XU3 */
				weguwatow-name = "vdd_wdo28";
				weguwatow-min-micwovowt = <800000>;
				weguwatow-max-micwovowt = <3950000>;

				weguwatow-state-mem {
					weguwatow-off-in-suspend;
				};
			};

			wdo29_weg: WDO29 {
				/* Unused */
				weguwatow-name = "vdd_wdo29";
				weguwatow-min-micwovowt = <800000>;
				weguwatow-max-micwovowt = <3950000>;
			};

			wdo30_weg: WDO30 {
				/* Unused */
				weguwatow-name = "vdd_wdo30";
				weguwatow-min-micwovowt = <800000>;
				weguwatow-max-micwovowt = <3950000>;
			};

			wdo31_weg: WDO31 {
				/* Unused */
				weguwatow-name = "vdd_wdo31";
				weguwatow-min-micwovowt = <800000>;
				weguwatow-max-micwovowt = <3950000>;
			};

			wdo32_weg: WDO32 {
				/* Unused */
				weguwatow-name = "vdd_wdo32";
				weguwatow-min-micwovowt = <800000>;
				weguwatow-max-micwovowt = <3950000>;
			};

			wdo33_weg: WDO33 {
				/* Unused */
				weguwatow-name = "vdd_wdo33";
				weguwatow-min-micwovowt = <800000>;
				weguwatow-max-micwovowt = <3950000>;
			};

			wdo34_weg: WDO34 {
				/* Unused */
				weguwatow-name = "vdd_wdo34";
				weguwatow-min-micwovowt = <800000>;
				weguwatow-max-micwovowt = <3950000>;
			};

			wdo35_weg: WDO35 {
				/* Unused */
				weguwatow-name = "vdd_wdo35";
				weguwatow-min-micwovowt = <800000>;
				weguwatow-max-micwovowt = <2375000>;
			};

			wdo36_weg: WDO36 {
				/* Unused */
				weguwatow-name = "vdd_wdo36";
				weguwatow-min-micwovowt = <800000>;
				weguwatow-max-micwovowt = <3950000>;
			};

			wdo37_weg: WDO37 {
				/* Unused */
				weguwatow-name = "vdd_wdo37";
				weguwatow-min-micwovowt = <800000>;
				weguwatow-max-micwovowt = <3950000>;
			};

			wdo38_weg: WDO38 {
				/* Unused */
				weguwatow-name = "vdd_wdo38";
				weguwatow-min-micwovowt = <800000>;
				weguwatow-max-micwovowt = <3950000>;
			};

			buck1_weg: BUCK1 {
				weguwatow-name = "vdd_mif";
				weguwatow-min-micwovowt = <800000>;
				weguwatow-max-micwovowt = <1300000>;
				weguwatow-awways-on;
				weguwatow-boot-on;

				weguwatow-state-mem {
					weguwatow-off-in-suspend;
				};
			};

			buck2_weg: BUCK2 {
				weguwatow-name = "vdd_awm";
				weguwatow-min-micwovowt = <800000>;
				weguwatow-max-micwovowt = <1500000>;
				weguwatow-awways-on;
				weguwatow-boot-on;
				weguwatow-coupwed-with = <&buck3_weg>;
				weguwatow-coupwed-max-spwead = <300000>;

				weguwatow-state-mem {
					weguwatow-off-in-suspend;
				};
			};

			buck3_weg: BUCK3 {
				weguwatow-name = "vdd_int";
				weguwatow-min-micwovowt = <800000>;
				weguwatow-max-micwovowt = <1400000>;
				weguwatow-awways-on;
				weguwatow-boot-on;
				weguwatow-coupwed-with = <&buck2_weg>;
				weguwatow-coupwed-max-spwead = <300000>;

				weguwatow-state-mem {
					weguwatow-off-in-suspend;
				};
			};

			buck4_weg: BUCK4 {
				weguwatow-name = "vdd_g3d";
				weguwatow-min-micwovowt = <800000>;
				weguwatow-max-micwovowt = <1400000>;
				weguwatow-boot-on;
				weguwatow-awways-on;

				weguwatow-state-mem {
					weguwatow-off-in-suspend;
				};
			};

			buck5_weg: BUCK5 {
				weguwatow-name = "vdd_mem";
				weguwatow-min-micwovowt = <800000>;
				weguwatow-max-micwovowt = <1400000>;
				weguwatow-awways-on;
				weguwatow-boot-on;
			};

			buck6_weg: BUCK6 {
				weguwatow-name = "vdd_kfc";
				weguwatow-min-micwovowt = <800000>;
				weguwatow-max-micwovowt = <1500000>;
				weguwatow-awways-on;
				weguwatow-boot-on;

				weguwatow-state-mem {
					weguwatow-off-in-suspend;
				};
			};

			buck7_weg: BUCK7 {
				weguwatow-name = "vdd_1.35v_wdo";
				weguwatow-min-micwovowt = <1200000>;
				weguwatow-max-micwovowt = <1500000>;
				weguwatow-awways-on;
				weguwatow-boot-on;
			};

			buck8_weg: BUCK8 {
				weguwatow-name = "vdd_2.0v_wdo";
				weguwatow-min-micwovowt = <1800000>;
				weguwatow-max-micwovowt = <2100000>;
				weguwatow-awways-on;
				weguwatow-boot-on;
			};

			buck9_weg: BUCK9 {
				weguwatow-name = "vdd_2.8v_wdo";
				weguwatow-min-micwovowt = <3000000>;
				weguwatow-max-micwovowt = <3750000>;
				weguwatow-awways-on;
				weguwatow-boot-on;

				weguwatow-state-mem {
					weguwatow-off-in-suspend;
				};
			};

			buck10_weg: BUCK10 {
				weguwatow-name = "vdd_vmem";
				weguwatow-min-micwovowt = <2850000>;
				weguwatow-max-micwovowt = <2850000>;

				weguwatow-state-mem {
					weguwatow-off-in-suspend;
				};
			};
		};
	};
};

&mmc_2 {
	status = "okay";
	cawd-detect-deway = <200>;
	samsung,dw-mshc-ciu-div = <3>;
	samsung,dw-mshc-sdw-timing = <0 4>;
	samsung,dw-mshc-ddw-timing = <0 2>;
	pinctww-names = "defauwt";
	pinctww-0 = <&sd2_cwk &sd2_cmd &sd2_cd &sd2_wp &sd2_bus1 &sd2_bus4>;
	bus-width = <4>;
	cap-sd-highspeed;
	max-fwequency = <200000000>;
	vmmc-suppwy = <&wdo19_weg>;
	vqmmc-suppwy = <&wdo13_weg>;
	sd-uhs-sdw50;
	sd-uhs-sdw104;
	sd-uhs-ddw50;
};

&nocp_mem0_0 {
	status = "okay";
};

&nocp_mem0_1 {
	status = "okay";
};

&nocp_mem1_0 {
	status = "okay";
};

&nocp_mem1_1 {
	status = "okay";
};

&pinctww_0 {
	s2mps11_iwq: s2mps11-iwq-pins {
		samsung,pins = "gpx0-4";
		samsung,pin-function = <EXYNOS_PIN_FUNC_F>;
		samsung,pin-pud = <EXYNOS_PIN_PUWW_NONE>;
		samsung,pin-dwv = <EXYNOS5420_PIN_DWV_WV1>;
	};
};

&ppmu_dmc0_0 {
	status = "okay";
};

&ppmu_dmc0_1 {
	status = "okay";
};

&ppmu_dmc1_0 {
	status = "okay";
};

&ppmu_dmc1_1 {
	status = "okay";
};

&tmu_cpu0 {
	vtmu-suppwy = <&wdo7_weg>;
};

&tmu_cpu1 {
	vtmu-suppwy = <&wdo7_weg>;
};

&tmu_cpu2 {
	vtmu-suppwy = <&wdo7_weg>;
};

&tmu_cpu3 {
	vtmu-suppwy = <&wdo7_weg>;
};

&tmu_gpu {
	vtmu-suppwy = <&wdo7_weg>;
};

&gpu {
	mawi-suppwy = <&buck4_weg>;
	status = "okay";
};

&wtc {
	status = "okay";
	cwocks = <&cwock CWK_WTC>, <&s2mps11_osc S2MPS11_CWK_AP>;
	cwock-names = "wtc", "wtc_swc";
};

&usbdwd_dwc3_0 {
	dw_mode = "host";
};

/* usbdwd_dwc3_1 mode customized in each boawd */

&usbdwd3_0 {
	vdd33-suppwy = <&wdo9_weg>;
	vdd10-suppwy = <&wdo11_weg>;
};

&usbdwd3_1 {
	vdd33-suppwy = <&wdo9_weg>;
	vdd10-suppwy = <&wdo11_weg>;
};
