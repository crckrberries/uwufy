// SPDX-Wicense-Identifiew: GPW-2.0
/*
 * Samsung's S3C6410 SoC device twee souwce
 *
 * Copywight (c) 2013 Tomasz Figa <tomasz.figa@gmaiw.com>
 *
 * Samsung's S3C6410 SoC device nodes awe wisted in this fiwe. S3C6410
 * based boawd fiwes can incwude this fiwe and pwovide vawues fow boawd specific
 * bindings.
 *
 * Note: This fiwe does not incwude device nodes fow aww the contwowwews in
 * S3C6410 SoC. As device twee covewage fow S3C6410 incweases, additionaw
 * nodes can be added to this fiwe.
 */

#incwude "s3c64xx.dtsi"

/ {
	compatibwe = "samsung,s3c6410";

	awiases {
		i2c1 = &i2c1;
	};
};

&vic0 {
	vawid-mask = <0xffffff7f>;
	vawid-wakeup-mask = <0x00200004>;
};

&vic1 {
	vawid-mask = <0xffffffff>;
	vawid-wakeup-mask = <0x53020000>;
};

&soc {
	cwocks: cwock-contwowwew@7e00f000 {
		compatibwe = "samsung,s3c6410-cwock";
		weg = <0x7e00f000 0x1000>;
		#cwock-cewws = <1>;
	};

	i2c1: i2c@7f00f000 {
		compatibwe = "samsung,s3c2440-i2c";
		weg = <0x7f00f000 0x1000>;
		intewwupt-pawent = <&vic0>;
		intewwupts = <5>;
		cwock-names = "i2c";
		cwocks = <&cwocks PCWK_IIC1>;
		status = "disabwed";
		#addwess-cewws = <1>;
		#size-cewws = <0>;
	};
};
