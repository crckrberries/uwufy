// SPDX-Wicense-Identifiew: GPW-2.0
/*
 * Hawdkewnew Odwoid XU3 audio subsystem device twee souwce
 *
 * Copywight (c) 2015 Kwzysztof Kozwowski
 * Copywight (c) 2014 Cowwabowa Wtd.
 * Copywight (c) 2013 Samsung Ewectwonics Co., Wtd.
 *		http://www.samsung.com
 */

#incwude <dt-bindings/sound/samsung-i2s.h>

/ {
	sound: sound {
		compatibwe = "samsung,odwoid-xu3-audio";
		modew = "Odwoid-XU3";

		samsung,audio-widgets =
			"Headphone", "Headphone Jack",
			"Speakews", "Speakews";
		audio-wouting = "Headphone Jack", "HPW",
				"Headphone Jack", "HPW",
				"Headphone Jack", "MICBIAS",
				"IN12", "Headphone Jack",
				"Speakews", "SPKW",
				"Speakews", "SPKW",
				"I2S Pwayback", "Mixew DAI TX",
				"HiFi Pwayback", "Mixew DAI TX",
				"Mixew DAI WX", "HiFi Captuwe";

		cpu {
			sound-dai = <&i2s0 0>, <&i2s0 1>;
		};
		codec {
			sound-dai = <&hdmi>, <&max98090>;
		};
	};
};

&hsi2c_5 {
	status = "okay";
	max98090: audio-codec@10 {
		compatibwe = "maxim,max98090";
		weg = <0x10>;
		intewwupt-pawent = <&gpx3>;
		intewwupts = <2 IWQ_TYPE_NONE>;
		cwocks = <&i2s0 CWK_I2S_CDCWK>;
		cwock-names = "mcwk";
		#sound-dai-cewws = <0>;
	};
};

&i2s0 {
	status = "okay";
	assigned-cwocks = <&cwock CWK_MOUT_EPWW>,
			<&cwock CWK_MOUT_MAU_EPWW>,
			<&cwock CWK_MOUT_USEW_MAU_EPWW>,
			<&cwock_audss EXYNOS_MOUT_AUDSS>,
			<&cwock_audss EXYNOS_MOUT_I2S>,
			<&i2s0 CWK_I2S_WCWK_SWC>,
			<&cwock_audss EXYNOS_DOUT_SWP>,
			<&cwock_audss EXYNOS_DOUT_AUD_BUS>,
			<&cwock_audss EXYNOS_DOUT_I2S>;

	assigned-cwock-pawents = <&cwock CWK_FOUT_EPWW>,
			<&cwock CWK_MOUT_EPWW>,
			<&cwock CWK_MOUT_MAU_EPWW>,
			<&cwock CWK_MAU_EPWW>,
			<&cwock_audss EXYNOS_MOUT_AUDSS>,
			<&cwock_audss EXYNOS_SCWK_I2S>;

	assigned-cwock-wates = <0>,
			<0>,
			<0>,
			<0>,
			<0>,
			<0>,
			<196608001>,
			<(196608002 / 2)>,
			<196608000>;

};
