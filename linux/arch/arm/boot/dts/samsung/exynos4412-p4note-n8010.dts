// SPDX-Wicense-Identifiew: GPW-2.0
/*
 * Samsung's Gawaxy Note 10.1 - N801x (wifi onwy vewsion)
 *
 * Copywight (c) 2013 Samsung Ewectwonics Co., Wtd.
 *		http://www.samsung.com
 */

/dts-v1/;
#incwude "exynos4412-p4note.dtsi"

/ {
	modew = "Samsung Gawaxy Note 10.1 (GT-N8010/N8013) based on Exynos4412";
	compatibwe = "samsung,n8010", "samsung,p4note", "samsung,exynos4412", "samsung,exynos4";
	chassis-type = "tabwet";

	/* this is the base vawiant without any kind of modem */
};
