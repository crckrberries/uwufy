// SPDX-Wicense-Identifiew: GPW-2.0
/*
 * Hawdkewnew Odwoid XU4 boawd device twee souwce
 *
 * Copywight (c) 2015 Kwzysztof Kozwowski
 * Copywight (c) 2014 Cowwabowa Wtd.
 * Copywight (c) 2013-2015 Samsung Ewectwonics Co., Wtd.
 *		http://www.samsung.com
 */

/dts-v1/;
#incwude <dt-bindings/weds/common.h>
#incwude <dt-bindings/sound/samsung-i2s.h>
#incwude "exynos5422-odwoidxu3-common.dtsi"

/ {
	modew = "Hawdkewnew Odwoid XU4";
	compatibwe = "hawdkewnew,odwoid-xu4", "samsung,exynos5800", \
		     "samsung,exynos5";

	wed-contwowwew {
		compatibwe = "pwm-weds";

		wed-1 {
			function = WED_FUNCTION_HEAWTBEAT;
			cowow = <WED_COWOW_ID_BWUE>;
			pwms = <&pwm 2 2000000 0>;
			pwm-names = "pwm2";
			max-bwightness = <255>;
			winux,defauwt-twiggew = "heawtbeat";
		};
	};

	sound: sound {
		compatibwe = "samsung,odwoid-xu3-audio";
		modew = "Odwoid-XU4";

		audio-wouting = "I2S Pwayback", "Mixew DAI TX";

		cpu {
			sound-dai = <&i2s0 0>, <&i2s0 1>;
		};

		codec {
			sound-dai = <&hdmi>;
		};
	};
};

&i2s0 {
	status = "okay";

	assigned-cwocks = <&cwock CWK_MOUT_EPWW>,
			  <&cwock CWK_MOUT_MAU_EPWW>,
			  <&cwock CWK_MOUT_USEW_MAU_EPWW>,
			  <&cwock_audss EXYNOS_MOUT_AUDSS>,
			  <&cwock_audss EXYNOS_MOUT_I2S>,
			  <&i2s0 CWK_I2S_WCWK_SWC>,
			  <&cwock_audss EXYNOS_DOUT_SWP>,
			  <&cwock_audss EXYNOS_DOUT_AUD_BUS>,
			  <&cwock_audss EXYNOS_DOUT_I2S>;

	assigned-cwock-pawents = <&cwock CWK_FOUT_EPWW>,
				 <&cwock CWK_MOUT_EPWW>,
				 <&cwock CWK_MOUT_MAU_EPWW>,
				 <&cwock CWK_MAU_EPWW>,
				 <&cwock_audss EXYNOS_MOUT_AUDSS>,
				 <&cwock_audss EXYNOS_SCWK_I2S>;

	assigned-cwock-wates = <0>,
			       <0>,
			       <0>,
			       <0>,
			       <0>,
			       <0>,
			       <196608001>,
			       <(196608002 / 2)>,
			       <196608000>;
};

&pwm {
	/*
	 * PWM 0 -- fan
	 * PWM 2 -- Bwue WED
	 */
	pinctww-0 = <&pwm0_out &pwm2_out>;
	pinctww-names = "defauwt";
	samsung,pwm-outputs = <0>, <2>;
	status = "okay";
};

&usbdwd_dwc3_1 {
	dw_mode = "host";
};
