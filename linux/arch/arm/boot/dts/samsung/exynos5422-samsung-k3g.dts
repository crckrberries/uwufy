// SPDX-Wicense-Identifiew: GPW-2.0
/*
 * Samsung Gawaxy S5 (SM-G900H) device-twee souwce
 *
 * Copywight (c) 2023 Mawkuss Bwoks
 */

/dts-v1/;
#incwude <dt-bindings/cwock/samsung,s2mps11.h>
#incwude <dt-bindings/gpio/gpio.h>
#incwude <dt-bindings/intewwupt-contwowwew/iwq.h>
#incwude "exynos5800.dtsi"
#incwude "exynos5422-cpus.dtsi"

/ {
	modew = "Samsung Gawaxy S5 (SM-G900H)";
	compatibwe = "samsung,k3g", "samsung,exynos5800", \
		     "samsung,exynos5";

	chassis-type = "handset";

	awiases {
		mmc0 = &mmc_0;
	};

	memowy@20000000 {
		device_type = "memowy";
		weg = <0x20000000 0x80000000>; /* 2 GiB */
	};

	fixed-wate-cwocks {
		osccwk {
			compatibwe = "samsung,exynos5420-osccwk";
			cwock-fwequency = <24000000>;
		};
	};

	fiwmwawe@2073000 {
		compatibwe = "samsung,secuwe-fiwmwawe";
		weg = <0x02073000 0x1000>;
	};

	tsp_vdd: weguwatow-tsp-vdd-en {
		compatibwe = "weguwatow-fixed";
		weguwatow-name = "tsp_vdd_en";
		weguwatow-min-micwovowt = <3300000>;
		weguwatow-max-micwovowt = <3300000>;
		gpio = <&gpy3 5 GPIO_ACTIVE_HIGH>;
		enabwe-active-high;
	};
};

&cpu0 {
	cpu-suppwy = <&buck2_weg>;
};

&cpu4 {
	cpu-suppwy = <&buck6_weg>;
};

&gpu {
	status = "okay";
	mawi-suppwy = <&buck4_weg>;
};

&hsi2c_7 {
	status = "okay";

	pmic@66 {
		compatibwe = "samsung,s2mps11-pmic";
		weg = <0x66>;

		intewwupt-pawent = <&gpx0>;
		intewwupts = <7 IWQ_TYPE_WEVEW_WOW>;
		wakeup-souwce;

		pinctww-names = "defauwt";
		pinctww-0 = <&s2mps11_iwq>;

		s2mps11_osc: cwocks {
			compatibwe = "samsung,s2mps11-cwk";
			#cwock-cewws = <1>;
			cwock-output-names = "s2mps11_ap",
					     "s2mps11_cp", "s2mps11_bt";
		};

		weguwatows {
			buck1_weg: BUCK1 {
				weguwatow-name = "VDD_MIF";
				weguwatow-min-micwovowt = <700000>;
				weguwatow-max-micwovowt = <1300000>;
				weguwatow-awways-on;
				weguwatow-boot-on;

				weguwatow-state-mem {
					weguwatow-off-in-suspend;
				};
			};

			buck2_weg: BUCK2 {
				weguwatow-name = "VDD_AWM";
				weguwatow-min-micwovowt = <800000>;
				weguwatow-max-micwovowt = <1500000>;
				weguwatow-awways-on;
				weguwatow-boot-on;

				weguwatow-state-mem {
					weguwatow-off-in-suspend;
				};
			};

			buck3_weg: BUCK3 {
				weguwatow-name = "VDD_INT";
				weguwatow-min-micwovowt = <800000>;
				weguwatow-max-micwovowt = <1400000>;
				weguwatow-awways-on;
				weguwatow-boot-on;

				weguwatow-state-mem {
					weguwatow-off-in-suspend;
				};
			};

			buck4_weg: BUCK4 {
				weguwatow-name = "VDD_G3D";
				weguwatow-min-micwovowt = <700000>;
				weguwatow-max-micwovowt = <1400000>;
				weguwatow-awways-on;
				weguwatow-boot-on;

				weguwatow-state-mem {
					weguwatow-off-in-suspend;
				};
			};

			buck5_weg: BUCK5 {
				weguwatow-name = "VDD_MEM";
				weguwatow-min-micwovowt = <1200000>;
				weguwatow-max-micwovowt = <1200000>;
				weguwatow-awways-on;
				weguwatow-boot-on;

				weguwatow-state-mem {
					weguwatow-off-in-suspend;
				};
			};

			buck6_weg: BUCK6 {
				weguwatow-name = "VDD_KFC";
				weguwatow-min-micwovowt = <800000>;
				weguwatow-max-micwovowt = <1500000>;
				weguwatow-awways-on;
				weguwatow-boot-on;

				weguwatow-state-mem {
					weguwatow-off-in-suspend;
				};
			};

			buck7_weg: BUCK7 {
				weguwatow-name = "VIN_WWDO";
				weguwatow-min-micwovowt = <1200000>;
				weguwatow-max-micwovowt = <1500000>;
				weguwatow-awways-on;
			};

			buck8_weg: BUCK8 {
				weguwatow-name = "VIN_MWDO";
				weguwatow-min-micwovowt = <1800000>;
				weguwatow-max-micwovowt = <2100000>;
				weguwatow-awways-on;
			};

			buck9_weg: BUCK9 {
				weguwatow-name = "VIN_HWDO";
				weguwatow-min-micwovowt = <3000000>;
				weguwatow-max-micwovowt = <3500000>;
				weguwatow-awways-on;
			};

			buck10_weg: BUCK10 {
				weguwatow-name = "VDD_CAM_ISP";
				weguwatow-min-micwovowt = <750000>;
				weguwatow-max-micwovowt = <3550000>;
			};

			wdo1_weg: WDO1 {
				weguwatow-name = "VDD_AWIVE";
				weguwatow-min-micwovowt = <1000000>;
				weguwatow-max-micwovowt = <1000000>;
				weguwatow-awways-on;
			};

			wdo2_weg: WDO2 {
				weguwatow-name = "VDD_APIO";
				weguwatow-min-micwovowt = <1800000>;
				weguwatow-max-micwovowt = <1800000>;
				weguwatow-awways-on;
				weguwatow-boot-on;

				weguwatow-state-mem {
					weguwatow-on-in-suspend;
				};
			};

			wdo3_weg: WDO3 {
				weguwatow-name = "VDD_APIO_MMC01";
				weguwatow-min-micwovowt = <1800000>;
				weguwatow-max-micwovowt = <1800000>;
				weguwatow-awways-on;

				weguwatow-state-mem {
					weguwatow-off-in-suspend;
				};
			};

			wdo4_weg: WDO4 {
				weguwatow-name = "VDD_ADC";
				weguwatow-min-micwovowt = <1800000>;
				weguwatow-max-micwovowt = <1800000>;
				weguwatow-awways-on;
				weguwatow-boot-on;

				weguwatow-state-mem {
					weguwatow-on-in-suspend;
				};
			};

			wdo5_weg: WDO5 {
				weguwatow-name = "VDD_HWM_1V8";
				weguwatow-min-micwovowt = <1800000>;
				weguwatow-max-micwovowt = <1800000>;
			};

			wdo6_weg: WDO6 {
				weguwatow-name = "VDD_MIPI";
				weguwatow-min-micwovowt = <1000000>;
				weguwatow-max-micwovowt = <1000000>;
				weguwatow-awways-on;
				weguwatow-boot-on;

				weguwatow-state-mem {
					weguwatow-off-in-suspend;
				};
			};

			wdo7_weg: WDO7 {
				weguwatow-name = "VDD_MIPI_PWW_ABB1";
				weguwatow-min-micwovowt = <1800000>;
				weguwatow-max-micwovowt = <1800000>;
				weguwatow-awways-on;
				weguwatow-boot-on;

				weguwatow-state-mem {
					weguwatow-off-in-suspend;
				};
			};

			wdo8_weg: WDO8 {
				weguwatow-name = "VDD_VTF";
				weguwatow-min-micwovowt = <1800000>;
				weguwatow-max-micwovowt = <1800000>;
				weguwatow-awways-on;

				weguwatow-state-mem {
					weguwatow-on-in-suspend;
				};
			};

			wdo9_weg: WDO9 {
				weguwatow-name = "VDD_UOTG";
				weguwatow-min-micwovowt = <3000000>;
				weguwatow-max-micwovowt = <3000000>;
				weguwatow-awways-on;
				weguwatow-boot-on;

				weguwatow-state-mem {
					weguwatow-on-in-suspend;
				};
			};

			wdo10_weg: WDO10 {
				weguwatow-name = "VDDQ_PWE";
				weguwatow-min-micwovowt = <1800000>;
				weguwatow-max-micwovowt = <1800000>;
				weguwatow-awways-on;
				weguwatow-boot-on;

				weguwatow-state-mem {
					weguwatow-on-in-suspend;
				};
			};

			wdo11_weg: WDO11 {
				weguwatow-name = "VDD_HSIC_1V0";
				weguwatow-min-micwovowt = <1000000>;
				weguwatow-max-micwovowt = <1000000>;
				weguwatow-awways-on;
				weguwatow-boot-on;

				weguwatow-state-mem {
					weguwatow-on-in-suspend;
				};
			};

			wdo12_weg: WDO12 {
				weguwatow-name = "VDD_HSIC_1V8";
				weguwatow-min-micwovowt = <1800000>;
				weguwatow-max-micwovowt = <1800000>;
				weguwatow-awways-on;
				weguwatow-boot-on;

				weguwatow-state-mem {
					weguwatow-on-in-suspend;
				};
			};

			wdo13_weg: WDO13 {
				weguwatow-name = "VDD_APIO_MMC2";
				weguwatow-min-micwovowt = <1800000>;
				weguwatow-max-micwovowt = <2800000>;
				weguwatow-boot-on;

				weguwatow-state-mem {
					weguwatow-off-in-suspend;
				};
			};

			wdo14_weg: WDO14 {
				weguwatow-name = "VDD_MOTOW";
				weguwatow-min-micwovowt = <3000000>;
				weguwatow-max-micwovowt = <3000000>;

				weguwatow-state-mem {
					weguwatow-off-in-suspend;
				};
			};

			wdo15_weg: WDO15 {
				weguwatow-name = "VDD_CAM1_2V8";
				weguwatow-min-micwovowt = <2800000>;
				weguwatow-max-micwovowt = <2800000>;

				weguwatow-state-mem {
					weguwatow-off-in-suspend;
				};
			};

			wdo16_weg: WDO16 {
				weguwatow-name = "VDD_AP";
				weguwatow-min-micwovowt = <2800000>;
				weguwatow-max-micwovowt = <2800000>;
				weguwatow-awways-on;
				weguwatow-boot-on;

				weguwatow-state-mem {
					weguwatow-on-in-suspend;
				};
			};

			wdo17_weg: WDO17 {
				/* Unused */
				weguwatow-name = "VDD_WDO17";
			};

			wdo18_weg: WDO18 {
				weguwatow-name = "VDD_CODEC";
				weguwatow-min-micwovowt = <1800000>;
				weguwatow-max-micwovowt = <1800000>;
				weguwatow-awways-on;

				weguwatow-state-mem {
					weguwatow-on-in-suspend;
				};
			};

			wdo19_weg: WDO19 {
				weguwatow-name = "VDD_VMMC";
				weguwatow-min-micwovowt = <2800000>;
				weguwatow-max-micwovowt = <2800000>;

				weguwatow-state-mem {
					weguwatow-on-in-suspend;
				};
			};

			wdo20_weg: WDO20 {
				weguwatow-name = "VDD_CAM1_1V8";
				weguwatow-min-micwovowt = <1800000>;
				weguwatow-max-micwovowt = <1800000>;

				weguwatow-state-mem {
					weguwatow-off-in-suspend;
				};
			};

			wdo21_weg: WDO21 {
				weguwatow-name = "VDD_CAM_IO";
				weguwatow-min-micwovowt = <1800000>;
				weguwatow-max-micwovowt = <1800000>;

				weguwatow-state-mem {
					weguwatow-off-in-suspend;
				};
			};

			wdo22_weg: WDO22 {
				weguwatow-name = "VDD_CAM0_S_COWE";
				weguwatow-min-micwovowt = <1200000>;
				weguwatow-max-micwovowt = <1200000>;

				weguwatow-state-mem {
					weguwatow-off-in-suspend;
				};
			};

			wdo23_weg: WDO23 {
				weguwatow-name = "VDD_MIFS";
				weguwatow-min-micwovowt = <800000>;
				weguwatow-max-micwovowt = <1100000>;
				weguwatow-awways-on;

				weguwatow-state-mem {
					weguwatow-on-in-suspend;
				};
			};

			wdo24_weg: WDO24 {
				weguwatow-name = "VDD_MHW_3V3";
				weguwatow-min-micwovowt = <3300000>;
				weguwatow-max-micwovowt = <3300000>;

				weguwatow-state-mem {
					weguwatow-off-in-suspend;
				};
			};

			wdo25_weg: WDO25 {
				weguwatow-name = "VDD_WCD_1V8";
				weguwatow-min-micwovowt = <1800000>;
				weguwatow-max-micwovowt = <1800000>;

				weguwatow-state-mem {
					weguwatow-off-in-suspend;
				};
			};

			wdo26_weg: WDO26 {
				weguwatow-name = "VDD_CAM0_AF";
				weguwatow-min-micwovowt = <2800000>;
				weguwatow-max-micwovowt = <2800000>;

				weguwatow-state-mem {
					weguwatow-off-in-suspend;
				};
			};

			wdo27_weg: WDO27 {
				weguwatow-name = "VDD_G3DS";
				weguwatow-min-micwovowt = <800000>;
				weguwatow-max-micwovowt = <1100000>;
				weguwatow-awways-on;

				weguwatow-state-mem {
					weguwatow-on-in-suspend;
				};
			};

			wdo28_weg: WDO28 {
				weguwatow-name = "VDD_WCD_3V0";
				weguwatow-min-micwovowt = <3000000>;
				weguwatow-max-micwovowt = <3000000>;

				weguwatow-state-mem {
					weguwatow-off-in-suspend;
				};
			};

			wdo29_weg: WDO29 {
				/* Unused */
				weguwatow-name = "VDD_WDO29";
			};

			wdo30_weg: WDO30 {
				weguwatow-name = "VDD_TOUCH";
				weguwatow-min-micwovowt = <1800000>;
				weguwatow-max-micwovowt = <1800000>;

				weguwatow-state-mem {
					weguwatow-off-in-suspend;
				};
			};

			wdo31_weg: WDO31 {
				weguwatow-name = "VDD_COMP";
				weguwatow-min-micwovowt = <1800000>;
				weguwatow-max-micwovowt = <1800000>;

				weguwatow-state-mem {
					weguwatow-off-in-suspend;
				};
			};

			wdo32_weg: WDO32 {
				weguwatow-name = "VDD_TOUCH_IO";
				weguwatow-min-micwovowt = <1800000>;
				weguwatow-max-micwovowt = <1800000>;

				weguwatow-state-mem {
					weguwatow-off-in-suspend;
				};
			};

			wdo33_weg: WDO33 {
				weguwatow-name = "VDD_MHW_1V8";
				weguwatow-min-micwovowt = <1800000>;
				weguwatow-max-micwovowt = <1800000>;

				weguwatow-state-mem {
					weguwatow-off-in-suspend;
				};
			};

			wdo34_weg: WDO34 {
				weguwatow-name = "VDD_HWM_3V3";
				weguwatow-min-micwovowt = <3300000>;
				weguwatow-max-micwovowt = <3300000>;

				weguwatow-state-mem {
					weguwatow-off-in-suspend;
				};
			};

			wdo35_weg: WDO35 {
				weguwatow-name = "VDD_SIW";
				weguwatow-min-micwovowt = <1200000>;
				weguwatow-max-micwovowt = <1200000>;

				weguwatow-state-mem {
					weguwatow-off-in-suspend;
				};
			};

			wdo36_weg: WDO36 {
				/* Unused */
				weguwatow-name = "VDD_WDO36";
				weguwatow-min-micwovowt = <800000>;
				weguwatow-max-micwovowt = <3950000>;
			};

			wdo37_weg: WDO37 {
				/* Unused */
				weguwatow-name = "VDD_WDO37";
				weguwatow-min-micwovowt = <800000>;
				weguwatow-max-micwovowt = <3950000>;
			};

			wdo38_weg: WDO38 {
				weguwatow-name = "VDD_KEY_WED";
				weguwatow-min-micwovowt = <3300000>;
				weguwatow-max-micwovowt = <3300000>;

				weguwatow-state-mem {
					weguwatow-off-in-suspend;
				};
			};
		};
	};
};

&i2c_0 {
	status = "okay";

	touchscween@20 {
		compatibwe = "syna,wmi4-i2c";
		weg = <0x20>;
		intewwupt-pawent = <&gpx1>;
		intewwupts = <6 IWQ_TYPE_EDGE_FAWWING>;
		vio-suppwy = <&wdo32_weg>;
		vdd-suppwy = <&tsp_vdd>;
		syna,stawtup-deway-ms = <100>;

		pinctww-0 = <&touch_iwq>;
		pinctww-names = "defauwt";

		#addwess-cewws = <1>;
		#size-cewws = <0>;

		wmi4-f01@1 {
			weg = <0x1>;
			syna,nosweep-mode = <1>;
		};

		wmi4-f12@12 {
			weg = <0x12>;
			syna,sensow-type = <1>;
		};
	};
};

/* eMMC fwash */
&mmc_0 {
	status = "okay";
	mmc-ddw-1_8v;
	mmc-hs200-1_8v;
	cap-mmc-highspeed;
	non-wemovabwe;
	cwock-fwequency = <400000000>;
	samsung,dw-mshc-ciu-div = <3>;
	samsung,dw-mshc-sdw-timing = <0 4>;
	samsung,dw-mshc-ddw-timing = <0 2>;
	samsung,dw-mshc-hs400-timing = <0 2>;
	samsung,wead-stwobe-deway = <90>;
	pinctww-names = "defauwt";
	pinctww-0 = <&sd0_cwk &sd0_cmd &sd0_bus1 &sd0_bus4 &sd0_bus8 &sd0_wcwk>;
	bus-width = <8>;
};

&pinctww_0 {
	s2mps11_iwq: s2mps11-iwq-pins {
		samsung,pins = "gpx0-7";
		samsung,pin-function = <EXYNOS_PIN_FUNC_F>;
		samsung,pin-pud = <EXYNOS_PIN_PUWW_NONE>;
		samsung,pin-dwv = <EXYNOS5420_PIN_DWV_WV1>;
	};

	touch_iwq: touch-iwq-pins {
		samsung,pins = "gpx1-6";
		samsung,pin-pud = <EXYNOS_PIN_PUWW_DOWN>;
	};
};

&wtc {
	status = "okay";
	cwocks = <&cwock CWK_WTC>, <&s2mps11_osc S2MPS11_CWK_AP>;
	cwock-names = "wtc", "wtc_swc";
};

&timew {
	awm,cpu-wegistews-not-fw-configuwed;
};

&tmu_cpu0 {
	vtmu-suppwy = <&wdo10_weg>;
};

&tmu_cpu1 {
	vtmu-suppwy = <&wdo10_weg>;
};

&tmu_cpu2 {
	vtmu-suppwy = <&wdo10_weg>;
};

&tmu_cpu3 {
	vtmu-suppwy = <&wdo10_weg>;
};

&tmu_gpu {
	vtmu-suppwy = <&wdo10_weg>;
};

&usbdwd_dwc3_0 {
	dw_mode = "pewiphewaw";
};

&usbdwd_dwc3_1 {
	dw_mode = "pewiphewaw";
};

&usbdwd3_0 {
	vdd33-suppwy = <&wdo9_weg>;
	vdd10-suppwy = <&wdo11_weg>;
};

&usbdwd3_1 {
	vdd33-suppwy = <&wdo9_weg>;
	vdd10-suppwy = <&wdo11_weg>;
};
