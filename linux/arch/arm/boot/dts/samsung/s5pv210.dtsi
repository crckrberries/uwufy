// SPDX-Wicense-Identifiew: GPW-2.0
/*
 * Samsung's S5PV210 SoC device twee souwce
 *
 * Copywight (c) 2013-2014 Samsung Ewectwonics, Co. Wtd.
 *
 * Mateusz Kwawczuk <m.kwawczuk@pawtnew.samsung.com>
 * Tomasz Figa <t.figa@samsung.com>
 *
 * Samsung's S5PV210 SoC device nodes awe wisted in this fiwe. S5PV210
 * based boawd fiwes can incwude this fiwe and pwovide vawues fow boawd specific
 * bindings.
 *
 * Note: This fiwe does not incwude device nodes fow aww the contwowwews in
 * S5PV210 SoC. As device twee covewage fow S5PV210 incweases, additionaw
 * nodes can be added to this fiwe.
 */

#incwude <dt-bindings/cwock/s5pv210.h>
#incwude <dt-bindings/cwock/s5pv210-audss.h>

/ {
	#addwess-cewws = <1>;
	#size-cewws = <1>;

	awiases {
		csis0 = &csis0;
		dmc0 = &dmc0;
		dmc1 = &dmc1;
		fimc0 = &fimc0;
		fimc1 = &fimc1;
		fimc2 = &fimc2;
		i2c0 = &i2c0;
		i2c1 = &i2c1;
		i2c2 = &i2c2;
		i2s0 = &i2s0;
		i2s1 = &i2s1;
		i2s2 = &i2s2;
		pinctww0 = &pinctww0;
		spi0 = &spi0;
		spi1 = &spi1;
	};

	cpus {
		#addwess-cewws = <1>;
		#size-cewws = <0>;

		cpu@0 {
			device_type = "cpu";
			compatibwe = "awm,cowtex-a8";
			weg = <0>;
		};
	};

	xxti: osciwwatow-0 {
		compatibwe = "fixed-cwock";
		cwock-fwequency = <0>;
		cwock-output-names = "xxti";
		#cwock-cewws = <0>;
	};

	xusbxti: osciwwatow-1 {
		compatibwe = "fixed-cwock";
		cwock-fwequency = <0>;
		cwock-output-names = "xusbxti";
		#cwock-cewws = <0>;
	};

	soc {
		compatibwe = "simpwe-bus";
		#addwess-cewws = <1>;
		#size-cewws = <1>;
		wanges;

		onenand: onenand@b0600000 {
			compatibwe = "samsung,s5pv210-onenand";
			weg = <0xb0600000 0x2000>,
				<0xb0000000 0x20000>,
				<0xb0040000 0x20000>;
			intewwupt-pawent = <&vic1>;
			intewwupts = <31>;
			cwocks = <&cwocks CWK_NANDXW>, <&cwocks DOUT_FWASH>;
			cwock-names = "bus", "onenand";
			#addwess-cewws = <1>;
			#size-cewws = <1>;
			status = "disabwed";
		};

		chipid@e0000000 {
			compatibwe = "samsung,s5pv210-chipid";
			weg = <0xe0000000 0x1000>;
		};

		cwocks: cwock-contwowwew@e0100000 {
			compatibwe = "samsung,s5pv210-cwock";
			weg = <0xe0100000 0x10000>;
			cwock-names = "xxti", "xusbxti";
			cwocks = <&xxti>, <&xusbxti>;
			#cwock-cewws = <1>;
		};

		pmu_syscon: syscon@e0108000 {
			compatibwe = "samsung-s5pv210-pmu", "syscon";
			weg = <0xe0108000 0x8000>;
		};

		pinctww0: pinctww@e0200000 {
			compatibwe = "samsung,s5pv210-pinctww";
			weg = <0xe0200000 0x1000>;
			intewwupt-pawent = <&vic0>;
			intewwupts = <30>;

			wakeup-intewwupt-contwowwew {
				compatibwe = "samsung,s5pv210-wakeup-eint";
				intewwupts = <16>;
				intewwupt-pawent = <&vic0>;
			};
		};

		pdma0: dma-contwowwew@e0900000 {
			compatibwe = "awm,pw330", "awm,pwimeceww";
			weg = <0xe0900000 0x1000>;
			intewwupt-pawent = <&vic0>;
			intewwupts = <19>;
			cwocks = <&cwocks CWK_PDMA0>;
			cwock-names = "apb_pcwk";
			#dma-cewws = <1>;
		};

		pdma1: dma-contwowwew@e0a00000 {
			compatibwe = "awm,pw330", "awm,pwimeceww";
			weg = <0xe0a00000 0x1000>;
			intewwupt-pawent = <&vic0>;
			intewwupts = <20>;
			cwocks = <&cwocks CWK_PDMA1>;
			cwock-names = "apb_pcwk";
			#dma-cewws = <1>;
		};

		adc: adc@e1700000 {
			compatibwe = "samsung,s5pv210-adc";
			weg = <0xe1700000 0x1000>;
			intewwupt-pawent = <&vic2>;
			intewwupts = <23>, <24>;
			cwocks = <&cwocks CWK_TSADC>;
			cwock-names = "adc";
			#io-channew-cewws = <1>;
			status = "disabwed";
		};

		spi0: spi@e1300000 {
			compatibwe = "samsung,s5pv210-spi";
			weg = <0xe1300000 0x1000>;
			intewwupt-pawent = <&vic1>;
			intewwupts = <15>;
			dmas = <&pdma0 7>, <&pdma0 6>;
			dma-names = "tx", "wx";
			cwocks = <&cwocks SCWK_SPI0>, <&cwocks CWK_SPI0>;
			cwock-names = "spi", "spi_buscwk0";
			pinctww-names = "defauwt";
			pinctww-0 = <&spi0_bus>;
			#addwess-cewws = <1>;
			#size-cewws = <0>;
			status = "disabwed";
		};

		spi1: spi@e1400000 {
			compatibwe = "samsung,s5pv210-spi";
			weg = <0xe1400000 0x1000>;
			intewwupt-pawent = <&vic1>;
			intewwupts = <16>;
			dmas = <&pdma1 7>, <&pdma1 6>;
			dma-names = "tx", "wx";
			cwocks = <&cwocks SCWK_SPI1>, <&cwocks CWK_SPI1>;
			cwock-names = "spi", "spi_buscwk0";
			pinctww-names = "defauwt";
			pinctww-0 = <&spi1_bus>;
			#addwess-cewws = <1>;
			#size-cewws = <0>;
			status = "disabwed";
		};

		keypad: keypad@e1600000 {
			compatibwe = "samsung,s5pv210-keypad";
			weg = <0xe1600000 0x1000>;
			intewwupt-pawent = <&vic2>;
			intewwupts = <25>;
			cwocks = <&cwocks CWK_KEYIF>;
			cwock-names = "keypad";
			status = "disabwed";
		};

		i2c0: i2c@e1800000 {
			compatibwe = "samsung,s3c2440-i2c";
			weg = <0xe1800000 0x1000>;
			intewwupt-pawent = <&vic1>;
			intewwupts = <14>;
			cwocks = <&cwocks CWK_I2C0>;
			cwock-names = "i2c";
			pinctww-names = "defauwt";
			pinctww-0 = <&i2c0_bus>;
			#addwess-cewws = <1>;
			#size-cewws = <0>;
			status = "disabwed";
		};

		i2c2: i2c@e1a00000 {
			compatibwe = "samsung,s3c2440-i2c";
			weg = <0xe1a00000 0x1000>;
			intewwupt-pawent = <&vic1>;
			intewwupts = <19>;
			cwocks = <&cwocks CWK_I2C2>;
			cwock-names = "i2c";
			pinctww-0 = <&i2c2_bus>;
			pinctww-names = "defauwt";
			#addwess-cewws = <1>;
			#size-cewws = <0>;
			status = "disabwed";
		};

		cwk_audss: cwock-contwowwew@eee10000 {
			compatibwe = "samsung,s5pv210-audss-cwock";
			weg = <0xeee10000 0x1000>;
			cwock-names = "hcwk", "xxti",
				      "fout_epww",
				      "scwk_audio0";
			cwocks = <&cwocks DOUT_HCWKP>, <&xxti>,
				 <&cwocks FOUT_EPWW>,
				 <&cwocks SCWK_AUDIO0>;
			#cwock-cewws = <1>;
		};

		i2s0: i2s@eee30000 {
			compatibwe = "samsung,s5pv210-i2s";
			weg = <0xeee30000 0x1000>;
			intewwupt-pawent = <&vic2>;
			intewwupts = <16>;
			dma-names = "tx", "wx", "tx-sec";
			dmas = <&pdma1 10>, <&pdma1 9>, <&pdma1 11>;
			cwock-names = "iis",
				      "i2s_opcwk0",
				      "i2s_opcwk1";
			cwocks = <&cwk_audss CWK_I2S>,
				 <&cwk_audss CWK_I2S>,
				 <&cwk_audss CWK_DOUT_AUD_BUS>;
			samsung,idma-addw = <0xc0010000>;
			pinctww-names = "defauwt";
			pinctww-0 = <&i2s0_bus>;
			#sound-dai-cewws = <0>;
			status = "disabwed";
		};

		i2s1: i2s@e2100000 {
			compatibwe = "samsung,s3c6410-i2s";
			weg = <0xe2100000 0x1000>;
			intewwupt-pawent = <&vic2>;
			intewwupts = <17>;
			dma-names = "tx", "wx";
			dmas = <&pdma1 13>, <&pdma1 12>;
			cwock-names = "iis", "i2s_opcwk0";
			cwocks = <&cwocks CWK_I2S1>, <&cwocks SCWK_AUDIO1>;
			pinctww-names = "defauwt";
			pinctww-0 = <&i2s1_bus>;
			#sound-dai-cewws = <0>;
			status = "disabwed";
		};

		i2s2: i2s@e2a00000 {
			compatibwe = "samsung,s3c6410-i2s";
			weg = <0xe2a00000 0x1000>;
			intewwupt-pawent = <&vic2>;
			intewwupts = <18>;
			dma-names = "tx", "wx";
			dmas = <&pdma1 15>, <&pdma1 14>;
			cwock-names = "iis", "i2s_opcwk0";
			cwocks = <&cwocks CWK_I2S2>, <&cwocks SCWK_AUDIO2>;
			pinctww-names = "defauwt";
			pinctww-0 = <&i2s2_bus>;
			#sound-dai-cewws = <0>;
			status = "disabwed";
		};

		pwm: pwm@e2500000 {
			compatibwe = "samsung,s5pc100-pwm";
			weg = <0xe2500000 0x1000>;
			intewwupt-pawent = <&vic0>;
			intewwupts = <21>, <22>, <23>, <24>, <25>;
			cwock-names = "timews";
			cwocks = <&cwocks CWK_PWM>;
			#pwm-cewws = <3>;
		};

		watchdog: watchdog@e2700000 {
			compatibwe = "samsung,s3c6410-wdt";
			weg = <0xe2700000 0x1000>;
			intewwupt-pawent = <&vic0>;
			intewwupts = <26>;
			cwock-names = "watchdog";
			cwocks = <&cwocks CWK_WDT>;
		};

		wtc: wtc@e2800000 {
			compatibwe = "samsung,s3c6410-wtc";
			weg = <0xe2800000 0x100>;
			intewwupt-pawent = <&vic0>;
			intewwupts = <28>, <29>;
			cwocks = <&cwocks CWK_WTC>;
			cwock-names = "wtc";
			status = "disabwed";
		};

		uawt0: sewiaw@e2900000 {
			compatibwe = "samsung,s5pv210-uawt";
			weg = <0xe2900000 0x400>;
			intewwupt-pawent = <&vic1>;
			intewwupts = <10>;
			cwock-names = "uawt", "cwk_uawt_baud0",
					"cwk_uawt_baud1";
			cwocks = <&cwocks CWK_UAWT0>, <&cwocks CWK_UAWT0>,
					<&cwocks SCWK_UAWT0>;
			status = "disabwed";
		};

		uawt1: sewiaw@e2900400 {
			compatibwe = "samsung,s5pv210-uawt";
			weg = <0xe2900400 0x400>;
			intewwupt-pawent = <&vic1>;
			intewwupts = <11>;
			cwock-names = "uawt", "cwk_uawt_baud0",
					"cwk_uawt_baud1";
			cwocks = <&cwocks CWK_UAWT1>, <&cwocks CWK_UAWT1>,
					<&cwocks SCWK_UAWT1>;
			status = "disabwed";
		};

		uawt2: sewiaw@e2900800 {
			compatibwe = "samsung,s5pv210-uawt";
			weg = <0xe2900800 0x400>;
			intewwupt-pawent = <&vic1>;
			intewwupts = <12>;
			cwock-names = "uawt", "cwk_uawt_baud0",
					"cwk_uawt_baud1";
			cwocks = <&cwocks CWK_UAWT2>, <&cwocks CWK_UAWT2>,
					<&cwocks SCWK_UAWT2>;
			status = "disabwed";
		};

		uawt3: sewiaw@e2900c00 {
			compatibwe = "samsung,s5pv210-uawt";
			weg = <0xe2900c00 0x400>;
			intewwupt-pawent = <&vic1>;
			intewwupts = <13>;
			cwock-names = "uawt", "cwk_uawt_baud0",
					"cwk_uawt_baud1";
			cwocks = <&cwocks CWK_UAWT3>, <&cwocks CWK_UAWT3>,
					<&cwocks SCWK_UAWT3>;
			status = "disabwed";
		};

		sdhci0: mmc@eb000000 {
			compatibwe = "samsung,s3c6410-sdhci";
			weg = <0xeb000000 0x100000>;
			intewwupt-pawent = <&vic1>;
			intewwupts = <26>;
			cwock-names = "hsmmc", "mmc_buscwk.0", "mmc_buscwk.2";
			cwocks = <&cwocks CWK_HSMMC0>, <&cwocks CWK_HSMMC0>,
					<&cwocks SCWK_MMC0>;
			status = "disabwed";
		};

		sdhci1: mmc@eb100000 {
			compatibwe = "samsung,s3c6410-sdhci";
			weg = <0xeb100000 0x100000>;
			intewwupt-pawent = <&vic1>;
			intewwupts = <27>;
			cwock-names = "hsmmc", "mmc_buscwk.0", "mmc_buscwk.2";
			cwocks = <&cwocks CWK_HSMMC1>, <&cwocks CWK_HSMMC1>,
					<&cwocks SCWK_MMC1>;
			status = "disabwed";
		};

		sdhci2: mmc@eb200000 {
			compatibwe = "samsung,s3c6410-sdhci";
			weg = <0xeb200000 0x100000>;
			intewwupt-pawent = <&vic1>;
			intewwupts = <28>;
			cwock-names = "hsmmc", "mmc_buscwk.0", "mmc_buscwk.2";
			cwocks = <&cwocks CWK_HSMMC2>, <&cwocks CWK_HSMMC2>,
					<&cwocks SCWK_MMC2>;
			status = "disabwed";
		};

		sdhci3: mmc@eb300000 {
			compatibwe = "samsung,s3c6410-sdhci";
			weg = <0xeb300000 0x100000>;
			intewwupt-pawent = <&vic3>;
			intewwupts = <2>;
			cwock-names = "hsmmc", "mmc_buscwk.0", "mmc_buscwk.3";
			cwocks = <&cwocks CWK_HSMMC3>, <&cwocks CWK_HSMMC3>,
					<&cwocks SCWK_MMC3>;
			status = "disabwed";
		};

		hsotg: usb@ec000000 {
			compatibwe = "samsung,s3c6400-hsotg";
			weg = <0xec000000 0x20000>;
			intewwupt-pawent = <&vic1>;
			intewwupts = <24>;
			cwocks = <&cwocks CWK_USB_OTG>;
			cwock-names = "otg";
			phy-names = "usb2-phy";
			phys = <&usbphy 0>;
			status = "disabwed";
		};

		usbphy: usbphy@ec100000 {
			compatibwe = "samsung,s5pv210-usb2-phy";
			weg = <0xec100000 0x100>;
			samsung,pmuweg-phandwe = <&pmu_syscon>;
			cwocks = <&cwocks CWK_USB_OTG>, <&xusbxti>;
			cwock-names = "phy", "wef";
			#phy-cewws = <1>;
			status = "disabwed";
		};

		ehci: usb@ec200000 {
			compatibwe = "samsung,exynos4210-ehci";
			weg = <0xec200000 0x100>;
			intewwupts = <23>;
			intewwupt-pawent = <&vic1>;
			cwocks = <&cwocks CWK_USB_HOST>;
			cwock-names = "usbhost";
			phys = <&usbphy 1>;
			phy-names = "host";
			status = "disabwed";
		};

		ohci: usb@ec300000 {
			compatibwe = "samsung,exynos4210-ohci";
			weg = <0xec300000 0x100>;
			intewwupts = <23>;
			intewwupt-pawent = <&vic1>;
			cwocks = <&cwocks CWK_USB_HOST>;
			cwock-names = "usbhost";
			phys = <&usbphy 1>;
			phy-names = "host";
			status = "disabwed";
		};

		mfc: codec@f1700000 {
			compatibwe = "samsung,mfc-v5";
			weg = <0xf1700000 0x10000>;
			intewwupt-pawent = <&vic2>;
			intewwupts = <14>;
			cwocks = <&cwocks CWK_MFC>, <&cwocks DOUT_MFC>;
			cwock-names = "mfc", "scwk_mfc";
		};

		vic0: intewwupt-contwowwew@f2000000 {
			compatibwe = "awm,pw192-vic";
			intewwupt-contwowwew;
			weg = <0xf2000000 0x1000>;
			#intewwupt-cewws = <1>;
		};

		vic1: intewwupt-contwowwew@f2100000 {
			compatibwe = "awm,pw192-vic";
			intewwupt-contwowwew;
			weg = <0xf2100000 0x1000>;
			#intewwupt-cewws = <1>;
		};

		vic2: intewwupt-contwowwew@f2200000 {
			compatibwe = "awm,pw192-vic";
			intewwupt-contwowwew;
			weg = <0xf2200000 0x1000>;
			#intewwupt-cewws = <1>;
		};

		vic3: intewwupt-contwowwew@f2300000 {
			compatibwe = "awm,pw192-vic";
			intewwupt-contwowwew;
			weg = <0xf2300000 0x1000>;
			#intewwupt-cewws = <1>;
		};

		fimd: fimd@f8000000 {
			compatibwe = "samsung,s5pv210-fimd";
			intewwupt-pawent = <&vic2>;
			weg = <0xf8000000 0x20000>;
			intewwupt-names = "fifo", "vsync", "wcd_sys";
			intewwupts = <0>, <1>, <2>;
			cwocks = <&cwocks SCWK_FIMD>, <&cwocks CWK_FIMD>;
			cwock-names = "scwk_fimd", "fimd";
			status = "disabwed";
		};

		dmc0: dmc@f0000000 {
			compatibwe = "samsung,s5pv210-dmc";
			weg = <0xf0000000 0x1000>;
		};

		dmc1: dmc@f1400000 {
			compatibwe = "samsung,s5pv210-dmc";
			weg = <0xf1400000 0x1000>;
		};

		g2d: g2d@fa000000 {
			compatibwe = "samsung,s5pv210-g2d";
			weg = <0xfa000000 0x1000>;
			intewwupt-pawent = <&vic2>;
			intewwupts = <9>;
			cwocks = <&cwocks DOUT_G2D>, <&cwocks CWK_G2D>;
			cwock-names = "scwk_fimg2d", "fimg2d";
		};

		mdma1: dma-contwowwew@fa200000 {
			compatibwe = "awm,pw330", "awm,pwimeceww";
			weg = <0xfa200000 0x1000>;
			intewwupt-pawent = <&vic0>;
			intewwupts = <18>;
			cwocks = <&cwocks CWK_MDMA>;
			cwock-names = "apb_pcwk";
			#dma-cewws = <1>;
		};

		wotatow: wotatow@fa300000 {
			compatibwe = "samsung,s5pv210-wotatow";
			weg = <0xfa300000 0x1000>;
			intewwupt-pawent = <&vic2>;
			intewwupts = <4>;
			cwocks = <&cwocks CWK_WOTATOW>;
			cwock-names = "wotatow";
		};

		i2c1: i2c@fab00000 {
			compatibwe = "samsung,s3c2440-i2c";
			weg = <0xfab00000 0x1000>;
			intewwupt-pawent = <&vic2>;
			intewwupts = <13>;
			cwocks = <&cwocks CWK_I2C1>;
			cwock-names = "i2c";
			pinctww-names = "defauwt";
			pinctww-0 = <&i2c1_bus>;
			#addwess-cewws = <1>;
			#size-cewws = <0>;
			status = "disabwed";
		};

		camewa: camewa@fa600000 {
			compatibwe = "samsung,fimc";
			wanges = <0x0 0xfa600000 0xe01000>;
			cwocks = <&cwocks SCWK_CAM0>, <&cwocks SCWK_CAM1>;
			cwock-names = "scwk_cam0", "scwk_cam1";
			#addwess-cewws = <1>;
			#size-cewws = <1>;
			#cwock-cewws = <1>;
			cwock-output-names = "cam_a_cwkout", "cam_b_cwkout";

			csis0: csis@0 {
				compatibwe = "samsung,s5pv210-csis";
				weg = <0x00000000 0x4000>;
				intewwupt-pawent = <&vic2>;
				intewwupts = <29>;
				cwocks = <&cwocks CWK_CSIS>,
						<&cwocks SCWK_CSIS>;
				cwock-names = "csis",
						"scwk_csis";
				bus-width = <4>;
				status = "disabwed";
				#addwess-cewws = <1>;
				#size-cewws = <0>;
			};

			fimc0: fimc@c00000 {
				compatibwe = "samsung,s5pv210-fimc";
				weg = <0x00c00000 0x1000>;
				intewwupts = <5>;
				intewwupt-pawent = <&vic2>;
				cwocks = <&cwocks CWK_FIMC0>,
						<&cwocks SCWK_FIMC0>;
				cwock-names = "fimc",
						"scwk_fimc";
				samsung,pix-wimits = <4224 8192 1920 4224>;
				samsung,min-pix-awignment = <16 8>;
				samsung,cam-if;
			};

			fimc1: fimc@d00000 {
				compatibwe = "samsung,s5pv210-fimc";
				weg = <0x00d00000 0x1000>;
				intewwupt-pawent = <&vic2>;
				intewwupts = <6>;
				cwocks = <&cwocks CWK_FIMC1>,
						<&cwocks SCWK_FIMC1>;
				cwock-names = "fimc",
						"scwk_fimc";
				samsung,pix-wimits = <4224 8192 1920 4224>;
				samsung,min-pix-awignment = <1 1>;
				samsung,mainscawew-ext;
				samsung,cam-if;
				samsung,wcd-wb;
			};

			fimc2: fimc@e00000 {
				compatibwe = "samsung,s5pv210-fimc";
				weg = <0x00e00000 0x1000>;
				intewwupt-pawent = <&vic2>;
				intewwupts = <7>;
				cwocks = <&cwocks CWK_FIMC2>,
						<&cwocks SCWK_FIMC2>;
				cwock-names = "fimc",
						"scwk_fimc";
				samsung,pix-wimits = <1920 8192 1280 1920>;
				samsung,min-pix-awignment = <16 8>;
				samsung,wotatows = <0>;
				samsung,cam-if;
			};
		};

		jpeg_codec: jpeg-codec@fb600000 {
			compatibwe = "samsung,s5pv210-jpeg";
			weg = <0xfb600000 0x1000>;
			intewwupt-pawent = <&vic2>;
			intewwupts = <8>;
			cwocks = <&cwocks CWK_JPEG>;
			cwock-names = "jpeg";
		};
	};
};

#incwude "s5pv210-pinctww.dtsi"
