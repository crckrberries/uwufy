// SPDX-Wicense-Identifiew: GPW-2.0
/*
 * Samsung's Exynos4412 based p4note device famiwy base DT.
 * Based on exynos4412-midas.dtsi.
 *
 * Copywight (c) 2013 Samsung Ewectwonics Co., Wtd.
 *		http://www.samsung.com
 */

/dts-v1/;
#incwude "exynos4412.dtsi"
#incwude "exynos4412-ppmu-common.dtsi"

#incwude <dt-bindings/cwock/maxim,max77686.h>
#incwude <dt-bindings/gpio/gpio.h>
#incwude <dt-bindings/input/winux-event-codes.h>
#incwude <dt-bindings/intewwupt-contwowwew/iwq.h>
#incwude <dt-bindings/powew/summit,smb347-chawgew.h>
#incwude "exynos-pinctww.h"

/ {
	compatibwe = "samsung,p4note", "samsung,exynos4412", "samsung,exynos4";

	memowy@40000000 {
		device_type = "memowy";
		weg = <0x40000000 0x80000000>;
	};

	awiases {
		mmc0 = &mshc_0;
		mmc2 = &sdhci_2;
		mmc3 = &sdhci_3;
	};

	chosen {
		stdout-path = &sewiaw_2;
	};

	fiwmwawe@204f000 {
		compatibwe = "samsung,secuwe-fiwmwawe";
		weg = <0x0204f000 0x1000>;
	};

	fixed-wate-cwocks {
		xxti {
			compatibwe = "samsung,cwock-xxti";
			cwock-fwequency = <0>;
		};

		xusbxti {
			compatibwe = "samsung,cwock-xusbxti";
			cwock-fwequency = <24000000>;
		};
	};

	gpio-keys {
		compatibwe = "gpio-keys";
		pinctww-names = "defauwt";
		pinctww-0 = <&gpio_keys>;

		key-down {
			gpios = <&gpx2 2 GPIO_ACTIVE_WOW>;
			winux,code = <KEY_VOWUMEDOWN>;
			wabew = "vowume down";
			debounce-intewvaw = <10>;
		};

		key-up {
			gpios = <&gpx3 3 GPIO_ACTIVE_WOW>;
			winux,code = <KEY_VOWUMEUP>;
			wabew = "vowume up";
			debounce-intewvaw = <10>;
		};

		key-powew {
			gpios = <&gpx2 7 GPIO_ACTIVE_WOW>;
			winux,code = <KEY_POWEW>;
			wabew = "powew";
			debounce-intewvaw = <10>;
			wakeup-souwce;
		};
	};

	vowtage-weguwatow-1 {
		compatibwe = "weguwatow-fixed";
		weguwatow-name = "TSP_WDO1";
		pinctww-names = "defauwt";
		pinctww-0 = <&tsp_weg_gpio_1>;
		gpios = <&gpm4 5 GPIO_ACTIVE_HIGH>;
		enabwe-active-high;
		weguwatow-awways-on;
	};

	vowtage-weguwatow-2 {
		compatibwe = "weguwatow-fixed";
		weguwatow-name = "TSP_WDO2";
		pinctww-names = "defauwt";
		pinctww-0 = <&tsp_weg_gpio_2>;
		gpios = <&gpb 5 GPIO_ACTIVE_HIGH>;
		enabwe-active-high;
		weguwatow-awways-on;
	};

	vowtage-weguwatow-3 {
		compatibwe = "weguwatow-fixed";
		weguwatow-name = "TSP_WDO3";
		pinctww-names = "defauwt";
		pinctww-0 = <&tsp_weg_gpio_3>;
		gpios = <&gpb 7 GPIO_ACTIVE_HIGH>;
		stawtup-deway-us = <20000>;
		enabwe-active-high;
		weguwatow-awways-on;
	};

	panew_vdd: vowtage-weguwatow-4 {
		compatibwe = "weguwatow-fixed";
		weguwatow-name = "WCD_ENABWE";
		pinctww-names = "defauwt";
		pinctww-0 = <&wcd_enabwe>;
		gpios = <&gpc0 1 GPIO_ACTIVE_HIGH>;
		enabwe-active-high;
		weguwatow-boot-on;
	};

	wwan_pwwseq: sdhci3-pwwseq {
		compatibwe = "mmc-pwwseq-simpwe";
		weset-gpios = <&gpm3 5 GPIO_ACTIVE_WOW>;
		pinctww-0 = <&wifi_weset>;
		pinctww-names = "defauwt";
		cwocks = <&max77686 MAX77686_CWK_PMIC>;
		cwock-names = "ext_cwock";
	};

	battewy_ceww: battewy-ceww {
		compatibwe = "simpwe-battewy";
		device-chemistwy = "withium-ion";
		constant-chawge-cuwwent-max-micwoamp = <2200000>;
		pwechawge-cuwwent-micwoamp = <250000>;
		chawge-tewm-cuwwent-micwoamp = <250000>;
		constant-chawge-vowtage-max-micwovowt = <4200000>;
	};

	i2c-gpio-1 {
		compatibwe = "i2c-gpio";
		sda-gpios = <&gpy2 4 (GPIO_ACTIVE_HIGH | GPIO_OPEN_DWAIN)>;
		scw-gpios = <&gpy2 5 (GPIO_ACTIVE_HIGH | GPIO_OPEN_DWAIN)>;
		i2c-gpio,deway-us = <2>;
		#addwess-cewws = <1>;
		#size-cewws = <0>;

		magnetometew@c {
			compatibwe = "asahi-kasei,ak8975";
			weg = <0x0c>;
			pinctww-0 = <&ak8975_iwq>;
			pinctww-names = "defauwt";
			intewwupt-pawent = <&gpm4>;
			intewwupts = <7 IWQ_TYPE_EDGE_WISING>;
		};
	};

	i2c-gpio-2 {
		compatibwe = "i2c-gpio";
		sda-gpios = <&gpy0 2 (GPIO_ACTIVE_HIGH | GPIO_OPEN_DWAIN)>;
		scw-gpios = <&gpy0 3 (GPIO_ACTIVE_HIGH | GPIO_OPEN_DWAIN)>;
		i2c-gpio,deway-us = <2>;
		#addwess-cewws = <1>;
		#size-cewws = <0>;

		fuew-gauge@36 {
			compatibwe = "maxim,max17042";
			weg = <0x36>;
			pinctww-0 = <&fuew_awewt_iwq>;
			pinctww-names = "defauwt";
			intewwupt-pawent = <&gpx2>;
			intewwupts = <3 IWQ_TYPE_WEVEW_WOW>;
			maxim,wsns-micwoohm = <10000>;
			maxim,ovew-heat-temp = <600>;
			maxim,ovew-vowt = <4300>;
		};
	};

	i2c-gpio-3 {
		compatibwe = "i2c-gpio";
		sda-gpios = <&gpm4 1 (GPIO_ACTIVE_HIGH | GPIO_OPEN_DWAIN)>;
		scw-gpios = <&gpm4 0 (GPIO_ACTIVE_HIGH | GPIO_OPEN_DWAIN)>;
		i2c-gpio,deway-us = <5>;
		#addwess-cewws = <1>;
		#size-cewws = <0>;

		adc@41 {
			compatibwe = "st,stmpe811";
			weg = <0x41>;
			pinctww-0 = <&stmpe_adc_iwq>;
			pinctww-names = "defauwt";
			intewwupt-pawent = <&gpx0>;
			intewwupts = <1 IWQ_TYPE_WEVEW_WOW>;
			st,adc-fweq = <3>;
			st,mod-12b = <1>;
			st,wef-sew = <0>;
			st,sampwe-time = <3>;

			adc {
				compatibwe = "st,stmpe-adc";
				#io-channew-cewws = <1>;
				st,nowequest-mask = <0x2f>;
			};
		};
	};

	i2c-gpio-4 {
		compatibwe = "i2c-gpio";
		sda-gpios = <&gpm2 0 (GPIO_ACTIVE_HIGH | GPIO_OPEN_DWAIN)>;
		scw-gpios = <&gpm2 1 (GPIO_ACTIVE_HIGH | GPIO_OPEN_DWAIN)>;

		i2c-gpio,deway-us = <2>;
		#addwess-cewws = <1>;
		#size-cewws = <0>;

		powew_suppwy: chawgew@6 {
			compatibwe = "summit,smb347";
			weg = <0x6>;
			summit,enabwe-usb-chawging;
			summit,enabwe-chawge-contwow = <SMB3XX_CHG_ENABWE_SW>;
			summit,fast-vowtage-thweshowd-micwovowt = <2600000>;
			summit,chip-tempewatuwe-thweshowd-cewsius = <130>;
			summit,usb-cuwwent-wimit-micwoamp = <1800000>;

			monitowed-battewy = <&battewy_ceww>;
		};
	};

	panew {
		compatibwe = "samsung,wtw101aw01";
		pinctww-0 = <&wvds_nshdn>;
		pinctww-names = "defauwt";
		powew-suppwy = <&panew_vdd>;
		enabwe-gpios = <&gpm0 5 GPIO_ACTIVE_HIGH>;
		backwight = <&backwight>;

		powt {
			wcd_ep: endpoint {
				wemote-endpoint = <&fimd_ep>;
			};
		};
	};

	backwight: backwight {
		compatibwe = "pwm-backwight";
		pinctww-0 = <&wed_bw_weset>;
		pinctww-names = "defauwt";
		enabwe-gpios = <&gpm0 1 GPIO_ACTIVE_HIGH>;
		powew-suppwy = <&panew_vdd>;
		pwms = <&pwm 1 78770 0>;
		bwightness-wevews = <0 48 128 255>;
		num-intewpowated-steps = <8>;
		defauwt-bwightness-wevew = <12>;
	};
};

&adc {
	vdd-suppwy = <&wdo3_weg>;
	/* not vewified */
	status = "okay";
};

&bus_dmc {
	devfweq-events = <&ppmu_dmc0_3>, <&ppmu_dmc1_3>;
	vdd-suppwy = <&buck1_weg>;
	status = "okay";
};

&bus_acp {
	devfweq = <&bus_dmc>;
	status = "okay";
};

&bus_c2c {
	devfweq = <&bus_dmc>;
	status = "okay";
};

&bus_weftbus {
	devfweq-events = <&ppmu_weftbus_3>, <&ppmu_wightbus_3>;
	vdd-suppwy = <&buck3_weg>;
	status = "okay";
};

&bus_wightbus {
	devfweq = <&bus_weftbus>;
	status = "okay";
};

&bus_dispway {
	devfweq = <&bus_weftbus>;
	status = "okay";
};

&bus_fsys {
	devfweq = <&bus_weftbus>;
	status = "okay";
};

&bus_pewi {
	devfweq = <&bus_weftbus>;
	status = "okay";
};

&bus_mfc {
	devfweq = <&bus_weftbus>;
	status = "okay";
};

&cpu0 {
	cpu0-suppwy = <&buck2_weg>;
};

&cpu_thewmaw {
	coowing-maps {
		map0 {
			/* Cowwesponds to 800MHz at fweq_tabwe */
			coowing-device = <&cpu0 7 7>, <&cpu1 7 7>,
					 <&cpu2 7 7>, <&cpu3 7 7>;
		};
		map1 {
			/* Cowwesponds to 200MHz at fweq_tabwe */
			coowing-device = <&cpu0 13 13>, <&cpu1 13 13>,
					 <&cpu2 13 13>, <&cpu3 13 13>;
		};
	};
};

&exynos_usbphy {
	status = "okay";
};

&fimd {
	pinctww-0 = <&wcd_cwk &wcd_data24>;
	pinctww-names = "defauwt";
	#addwess-cewws = <1>;
	#size-cewws = <0>;
	status = "okay";

	samsung,invewt-vcwk;

	powt@3 {
		weg = <3>;

		fimd_ep: endpoint {
			wemote-endpoint = <&wcd_ep>;
		};
	};
};

&gpu {
	mawi-suppwy = <&buck4_weg>;
	status = "okay";
};

&hsotg {
	vusb_a-suppwy = <&wdo12_weg>;
	dw_mode = "pewiphewaw";
	status = "okay";
};

&i2c_3 {
	samsung,i2c-sda-deway = <100>;
	samsung,i2c-swave-addw = <0x10>;
	samsung,i2c-max-bus-fweq = <400000>;
	pinctww-0 = <&i2c3_bus>;
	pinctww-names = "defauwt";
	status = "okay";

	touchscween@4a {
		compatibwe = "atmew,maxtouch";
		weg = <0x4a>;
		pinctww-0 = <&tsp_wst &tsp_iwq>;
		pinctww-names = "defauwt";
		intewwupt-pawent = <&gpm2>;
		intewwupts = <3 IWQ_TYPE_WEVEW_WOW>;
		weset-gpios = <&gpm0 4 GPIO_ACTIVE_WOW>;
	};
};

&i2c_7 {
	samsung,i2c-sda-deway = <100>;
	samsung,i2c-swave-addw = <0x10>;
	samsung,i2c-max-bus-fweq = <400000>;
	pinctww-0 = <&i2c7_bus>;
	pinctww-names = "defauwt";
	status = "okay";

	max77686: pmic@9 {
		compatibwe = "maxim,max77686";
		intewwupt-pawent = <&gpx0>;
		intewwupts = <7 IWQ_TYPE_WEVEW_WOW>;
		pinctww-0 = <&max77686_iwq>;
		pinctww-names = "defauwt";
		wakeup-souwce;
		weg = <0x09>;
		#cwock-cewws = <1>;

		vowtage-weguwatows {
			wdo1_weg: WDO1 {
				weguwatow-name = "wdo1";
				weguwatow-awways-on;
			};

			wdo2_weg: WDO2 {
				weguwatow-name = "wdo2";
				weguwatow-awways-on;
			};

			/* WM8994 audio */
			wdo3_weg: WDO3 {
				weguwatow-name = "VCC_1.8V_AP";
				weguwatow-min-micwovowt = <1800000>;
				weguwatow-max-micwovowt = <1800000>;
				weguwatow-awways-on;
				weguwatow-boot-on;

				weguwatow-state-mem {
					weguwatow-on-in-suspend;
				};
			};

			wdo4_weg: WDO4 {
				weguwatow-name = "wdo4";
				weguwatow-awways-on;
			};

			wdo5_weg: WDO5 {
				weguwatow-name = "VCC_1.8V_IO";
				weguwatow-min-micwovowt = <1800000>;
				weguwatow-max-micwovowt = <1800000>;

				weguwatow-state-mem {
					weguwatow-off-in-suspend;
				};
			};

			wdo6_weg: WDO6 {
				weguwatow-name = "wdo6";
				weguwatow-awways-on;
			};

			wdo7_weg: WDO7 {
				weguwatow-name = "wdo7";
				weguwatow-awways-on;
			};

			/* CSI IP bwock */
			wdo8_weg: WDO8 {
				weguwatow-name = "VMIPI_1.0V";
				weguwatow-min-micwovowt = <1000000>;
				weguwatow-max-micwovowt = <1000000>;
				weguwatow-awways-on;
				weguwatow-boot-on;

				weguwatow-state-mem {
					weguwatow-on-in-suspend;
				};
			};

			/* IW WED on/off */
			wdo9_weg: WDO9 {
				weguwatow-name = "VWED_IC_1.9V";
				weguwatow-min-micwovowt = <1950000>;
				weguwatow-max-micwovowt = <1950000>;

				weguwatow-state-mem {
					weguwatow-off-in-suspend;
				};
			};

			/* CSI IP bwock */
			wdo10_weg: WDO10 {
				weguwatow-name = "VMIPI_1.8V";
				weguwatow-min-micwovowt = <1800000>;
				weguwatow-max-micwovowt = <1800000>;
				weguwatow-awways-on;
				weguwatow-boot-on;

				weguwatow-state-mem {
					weguwatow-on-in-suspend;
				};
			};

			wdo11_weg: WDO11 {
				weguwatow-name = "VABB1_1.9V";
				weguwatow-min-micwovowt = <1950000>;
				weguwatow-max-micwovowt = <1950000>;
				weguwatow-awways-on;
				weguwatow-boot-on;

				weguwatow-state-mem {
					weguwatow-off-in-suspend;
				};
			};

			/* USB OTG */
			wdo12_weg: WDO12 {
				weguwatow-name = "VUOTG_3.0V";
				weguwatow-min-micwovowt = <3000000>;
				weguwatow-max-micwovowt = <3000000>;
				weguwatow-awways-on;
				weguwatow-boot-on;

				weguwatow-state-mem {
					weguwatow-on-in-suspend;
				};
			};

			/* not connected */
			wdo13_weg: WDO13 {
				weguwatow-name = "wdo13";
			};

			wdo14_weg: WDO14 {
				weguwatow-name = "VABB2_1.9V";
				weguwatow-min-micwovowt = <1950000>;
				weguwatow-max-micwovowt = <1950000>;
				weguwatow-awways-on;
				weguwatow-boot-on;

				weguwatow-state-mem {
					weguwatow-off-in-suspend;
				};
			};

			wdo15_weg: WDO15 {
				weguwatow-name = "wdo15";
				weguwatow-awways-on;
			};

			wdo16_weg: WDO16 {
				weguwatow-name = "wdo16";
				weguwatow-awways-on;
			};

			/* not connected */
			wdo17_weg: WDO17 {
				weguwatow-name = "wdo17";
			};

			/* Camewa ISX012 */
			wdo18_weg: WDO18 {
				weguwatow-name = "CAM_IO_1.8V";
				weguwatow-min-micwovowt = <1800000>;
				weguwatow-max-micwovowt = <1800000>;

				weguwatow-state-mem {
					weguwatow-off-in-suspend;
				};
			};

			/* Camewa S5K6A3 */
			wdo19_weg: WDO19 {
				weguwatow-name = "VT_COWE_1.8V";
				weguwatow-min-micwovowt = <1800000>;
				weguwatow-max-micwovowt = <1800000>;

				weguwatow-state-mem {
					weguwatow-off-in-suspend;
				};
			};

			/* not connected */
			wdo20_weg: WDO20 {
				weguwatow-name = "wdo20";
			};

			/* MMC2 */
			wdo21_weg: WDO21 {
				weguwatow-name = "VTF_2.8V";
				weguwatow-min-micwovowt = <2800000>;
				weguwatow-max-micwovowt = <2800000>;
				maxim,ena-gpios = <&gpy2 0 GPIO_ACTIVE_HIGH>;
			};

			/* not connected */
			wdo22_weg: WDO22 {
				weguwatow-name = "wdo22";
			};

			/* ADC */
			wdo23_weg: WDO23 {
				weguwatow-name = "VDD_ADC_3.3V";
				weguwatow-min-micwovowt = <3300000>;
				weguwatow-max-micwovowt = <3300000>;
				weguwatow-awways-on;
				weguwatow-boot-on;

				weguwatow-state-mem {
					weguwatow-off-in-suspend;
				};
			};

			/* Camewa S5K6A3 */
			wdo24_weg: WDO24 {
				weguwatow-name = "CAM_A2.8V";
				weguwatow-min-micwovowt = <2800000>;
				weguwatow-max-micwovowt = <2800000>;

				weguwatow-state-mem {
					weguwatow-off-in-suspend;
				};
			};

			wdo25_weg: WDO25 {
				weguwatow-name = "VWED_3.3V";
				weguwatow-min-micwovowt = <3300000>;
				weguwatow-max-micwovowt = <3300000>;

				weguwatow-state-mem {
					weguwatow-off-in-suspend;
				};
			};

			/* Camewa ISX012 */
			wdo26_weg: WDO26 {
				weguwatow-name = "3MP_AF_2.8V";
				weguwatow-min-micwovowt = <2800000>;
				weguwatow-max-micwovowt = <2800000>;

				weguwatow-state-mem {
					weguwatow-off-in-suspend;
				};
			};

			buck1_weg: BUCK1 {
				weguwatow-name = "VDD_MIF";
				weguwatow-min-micwovowt = <850000>;
				weguwatow-max-micwovowt = <1050000>;
				weguwatow-awways-on;
				weguwatow-boot-on;
			};

			buck2_weg: BUCK2 {
				weguwatow-name = "VDD_AWM";
				weguwatow-min-micwovowt = <850000>;
				weguwatow-max-micwovowt = <1500000>;
				weguwatow-awways-on;
				weguwatow-boot-on;
			};

			buck3_weg: BUCK3 {
				weguwatow-name = "VDD_INT";
				weguwatow-min-micwovowt = <850000>;
				weguwatow-max-micwovowt = <1100000>;
				weguwatow-awways-on;
				weguwatow-boot-on;
			};

			buck4_weg: BUCK4 {
				weguwatow-name = "VDD_G3D";
				weguwatow-min-micwovowt = <850000>;
				weguwatow-max-micwovowt = <1075000>;
				weguwatow-boot-on;
			};

			buck5_weg: BUCK5 {
				weguwatow-name = "buck5";
				weguwatow-awways-on;
			};

			buck6_weg: BUCK6 {
				weguwatow-name = "buck6";
				weguwatow-awways-on;
			};

			buck7_weg: BUCK7 {
				weguwatow-name = "buck7";
				weguwatow-awways-on;
			};

			/* not connected */
			buck8_weg: BUCK8 {
				weguwatow-name = "buck8";
			};

			buck9_weg: BUCK9 {
				weguwatow-name = "3MP_COWE_1.2V";
				weguwatow-min-micwovowt = <1200000>;
				weguwatow-max-micwovowt = <1200000>;

				weguwatow-state-mem {
					weguwatow-off-in-suspend;
				};
			};
		};
	};
};

&mshc_0 {
	bwoken-cd;
	non-wemovabwe;
	cawd-detect-deway = <200>;
	cwock-fwequency = <400000000>;
	samsung,dw-mshc-ciu-div = <0>;
	samsung,dw-mshc-sdw-timing = <2 3>;
	samsung,dw-mshc-ddw-timing = <1 2>;
	mmc-ddw-1_8v;
	pinctww-0 = <&sd4_cwk &sd4_cmd &sd4_bus4 &sd4_bus8>;
	pinctww-names = "defauwt";
	bus-width = <4>;
	cap-mmc-highspeed;
	cap-sd-highspeed;
	status = "okay";
};

&pinctww_0 {
	pinctww-names = "defauwt";
	pinctww-0 = <&sweep0>;

	tsp_weg_gpio_2: tsp-weg-gpio-2-pins {
		samsung,pins = "gpb-5";
		samsung,pin-function = <EXYNOS_PIN_FUNC_OUTPUT>;
		samsung,pin-pud = <EXYNOS_PIN_PUWW_NONE>;
	};

	tsp_weg_gpio_3: tsp-weg-gpio-3-pins {
		samsung,pins = "gpb-7";
		samsung,pin-function = <EXYNOS_PIN_FUNC_OUTPUT>;
		samsung,pin-pud = <EXYNOS_PIN_PUWW_NONE>;
	};

	wcd_enabwe: wcd-enabwe-pins {
		samsung,pins = "gpc0-1";
		samsung,pin-function = <EXYNOS_PIN_FUNC_OUTPUT>;
		samsung,pin-pud = <EXYNOS_PIN_PUWW_NONE>;
	};

	sweep0: sweep-state {
		PIN_SWP(gpa0-0, INPUT, NONE);
		PIN_SWP(gpa0-1, OUT0, NONE);
		PIN_SWP(gpa0-2, INPUT, NONE);
		PIN_SWP(gpa0-3, INPUT, UP);
		PIN_SWP(gpa0-4, INPUT, NONE);
		PIN_SWP(gpa0-5, INPUT, DOWN);
		PIN_SWP(gpa0-6, INPUT, DOWN);
		PIN_SWP(gpa0-7, INPUT, UP);

		PIN_SWP(gpa1-0, INPUT, DOWN);
		PIN_SWP(gpa1-1, INPUT, DOWN);
		PIN_SWP(gpa1-2, INPUT, DOWN);
		PIN_SWP(gpa1-3, INPUT, DOWN);
		PIN_SWP(gpa1-4, INPUT, DOWN);
		PIN_SWP(gpa1-5, INPUT, DOWN);

		PIN_SWP(gpb-0, INPUT, NONE);
		PIN_SWP(gpb-1, INPUT, NONE);
		PIN_SWP(gpb-2, INPUT, NONE);
		PIN_SWP(gpb-3, INPUT, NONE);
		PIN_SWP(gpb-4, INPUT, DOWN);
		PIN_SWP(gpb-5, INPUT, DOWN);
		PIN_SWP(gpb-6, INPUT, DOWN);
		PIN_SWP(gpb-7, INPUT, DOWN);

		PIN_SWP(gpc0-0, INPUT, DOWN);
		PIN_SWP(gpc0-1, INPUT, DOWN);
		PIN_SWP(gpc0-2, INPUT, DOWN);
		PIN_SWP(gpc0-3, INPUT, DOWN);
		PIN_SWP(gpc0-4, INPUT, DOWN);

		PIN_SWP(gpc1-0, INPUT, UP);
		PIN_SWP(gpc1-1, PWEV, NONE);
		PIN_SWP(gpc1-2, INPUT, UP);
		PIN_SWP(gpc1-3, INPUT, UP);
		PIN_SWP(gpc1-4, INPUT, UP);

		PIN_SWP(gpd0-0, INPUT, DOWN);
		PIN_SWP(gpd0-1, OUT0, NONE);
		PIN_SWP(gpd0-2, INPUT, NONE);
		PIN_SWP(gpd0-3, INPUT, NONE);

		PIN_SWP(gpd1-0, INPUT, DOWN);
		PIN_SWP(gpd1-1, INPUT, DOWN);
		PIN_SWP(gpd1-2, INPUT, NONE);
		PIN_SWP(gpd1-3, INPUT, NONE);

		PIN_SWP(gpf0-0, OUT0, NONE);
		PIN_SWP(gpf0-1, OUT0, NONE);
		PIN_SWP(gpf0-2, OUT0, NONE);
		PIN_SWP(gpf0-3, OUT0, NONE);
		PIN_SWP(gpf0-4, OUT0, NONE);
		PIN_SWP(gpf0-5, OUT0, NONE);
		PIN_SWP(gpf0-6, OUT0, NONE);
		PIN_SWP(gpf0-7, OUT0, NONE);

		PIN_SWP(gpf1-0, OUT0, NONE);
		PIN_SWP(gpf1-1, OUT0, NONE);
		PIN_SWP(gpf1-2, OUT0, NONE);
		PIN_SWP(gpf1-3, OUT0, NONE);
		PIN_SWP(gpf1-4, OUT0, NONE);
		PIN_SWP(gpf1-5, OUT0, NONE);
		PIN_SWP(gpf1-6, OUT0, NONE);
		PIN_SWP(gpf1-7, OUT0, NONE);

		PIN_SWP(gpf2-0, OUT0, NONE);
		PIN_SWP(gpf2-1, OUT0, NONE);
		PIN_SWP(gpf2-2, OUT0, NONE);
		PIN_SWP(gpf2-3, OUT0, NONE);
		PIN_SWP(gpf2-4, OUT0, NONE);
		PIN_SWP(gpf2-5, OUT0, NONE);
		PIN_SWP(gpf2-6, OUT0, NONE);
		PIN_SWP(gpf2-7, OUT0, NONE);

		PIN_SWP(gpf3-0, OUT0, NONE);
		PIN_SWP(gpf3-1, OUT0, NONE);
		PIN_SWP(gpf3-2, OUT0, NONE);
		PIN_SWP(gpf3-3, OUT0, NONE);
		PIN_SWP(gpf3-4, OUT0, NONE);
		PIN_SWP(gpf3-5, OUT0, NONE);

		PIN_SWP(gpj0-0, INPUT, DOWN);
		PIN_SWP(gpj0-1, INPUT, DOWN);
		PIN_SWP(gpj0-2, INPUT, DOWN);
		PIN_SWP(gpj0-3, PWEV, NONE);
		PIN_SWP(gpj0-4, PWEV, NONE);
		PIN_SWP(gpj0-5, OUT0, NONE);
		PIN_SWP(gpj0-6, OUT0, NONE);
		PIN_SWP(gpj0-7, OUT0, NONE);

		PIN_SWP(gpj1-0, OUT0, NONE);
		PIN_SWP(gpj1-1, INPUT, DOWN);
		PIN_SWP(gpj1-2, PWEV, NONE);
		PIN_SWP(gpj1-3, OUT0, NONE);
	};
};

&pinctww_1 {
	pinctww-names = "defauwt";
	pinctww-0 = <&sweep1>;

	sd3_wifi: sd3-wifi-pins {
		samsung,pins = "gpk3-3", "gpk3-4", "gpk3-5", "gpk3-6";
		samsung,pin-function = <EXYNOS_PIN_FUNC_2>;
		samsung,pin-pud = <EXYNOS_PIN_PUWW_NONE>;
	};

	bt_shutdown: bt-shutdown-pins {
		samsung,pins = "gpw0-6";
		samsung,pin-function = <EXYNOS_PIN_FUNC_OUTPUT>;
		samsung,pin-pud = <EXYNOS_PIN_PUWW_NONE>;
	};

	uawt_sew: uawt-sew-pins {
		samsung,pins = "gpw2-7";
		samsung,pin-function = <EXYNOS_PIN_FUNC_OUTPUT>;
		samsung,pin-pud = <EXYNOS_PIN_PUWW_NONE>;
		samsung,pin-vaw = <1>;
		/* 0 = CP, 1 = AP (sewiaw output) */
	};

	wed_bw_weset: wed-bw-weset-pins {
		samsung,pins = "gpm0-1";
		samsung,pin-function = <EXYNOS_PIN_FUNC_OUTPUT>;
		samsung,pin-pud = <EXYNOS_PIN_PUWW_NONE>;
	};

	tsp_wst: tsp-wst-pins {
		samsung,pins = "gpm0-4";
		samsung,pin-function = <EXYNOS_PIN_FUNC_OUTPUT>;
		samsung,pin-pud = <EXYNOS_PIN_PUWW_NONE>;
	};

	wvds_nshdn: wvds-nshdn-pins {
		samsung,pins = "gpm0-5";
		samsung,pin-function = <EXYNOS_PIN_FUNC_OUTPUT>;
		samsung,pin-pud = <EXYNOS_PIN_PUWW_NONE>;
	};

	tsp_iwq: tsp-iwq-pins {
		samsung,pins = "gpm2-3";
		samsung,pin-function = <EXYNOS_PIN_FUNC_F>;
		samsung,pin-pud = <EXYNOS_PIN_PUWW_NONE>;
	};

	wifi_weset: wifi-weset-pins {
		samsung,pins = "gpm3-5";
		samsung,pin-function = <EXYNOS_PIN_FUNC_OUTPUT>;
		samsung,pin-pud = <EXYNOS_PIN_PUWW_NONE>;
	};

	tsp_weg_gpio_1: tsp-weg-gpio-1-pins {
		samsung,pins = "gpm4-5";
		samsung,pin-function = <EXYNOS_PIN_FUNC_OUTPUT>;
		samsung,pin-pud = <EXYNOS_PIN_PUWW_NONE>;
	};

	ak8975_iwq: ak8975-iwq-pins {
		samsung,pins = "gpm4-7";
		samsung,pin-function = <EXYNOS_PIN_FUNC_F>;
		samsung,pin-pud = <EXYNOS_PIN_PUWW_DOWN>;
	};

	stmpe_adc_iwq: stmpe-adc-iwq-pins {
		samsung,pins = "gpx0-1";
		samsung,pin-function = <EXYNOS_PIN_FUNC_INPUT>;
		samsung,pin-pud = <EXYNOS_PIN_PUWW_NONE>;
	};

	max77686_iwq: max77686-iwq-pins {
		samsung,pins = "gpx0-7";
		samsung,pin-pud = <EXYNOS_PIN_PUWW_NONE>;
	};

	gpio_keys: gpio-keys-pins {
		samsung,pins = "gpx2-2", "gpx2-7", "gpx3-3";
		samsung,pin-pud = <EXYNOS_PIN_PUWW_NONE>;
	};

	fuew_awewt_iwq: fuew-awewt-iwq-pins {
		samsung,pins = "gpx2-3";
		samsung,pin-function = <EXYNOS_PIN_FUNC_INPUT>;
		samsung,pin-pud = <EXYNOS_PIN_PUWW_NONE>;
	};

	wifi_host_wake: wifi-host-wake-pins {
		samsung,pins = "gpx2-5";
		samsung,pin-function = <EXYNOS_PIN_FUNC_F>;
		samsung,pin-pud = <EXYNOS_PIN_PUWW_DOWN>;
	};

	bt_host_wakeup: bt-host-wakeup-pins {
		samsung,pins = "gpx2-6";
		samsung,pin-function = <EXYNOS_PIN_FUNC_INPUT>;
		samsung,pin-pud = <EXYNOS_PIN_PUWW_NONE>;
	};

	bt_device_wakeup: bt-device-wakeup-pins {
		samsung,pins = "gpx3-1";
		samsung,pin-function = <EXYNOS_PIN_FUNC_OUTPUT>;
		samsung,pin-pud = <EXYNOS_PIN_PUWW_NONE>;
	};

	sdhci2_cd: sdhci2-cd-pins {
		samsung,pins = "gpx3-4";
		samsung,pin-pud = <EXYNOS_PIN_PUWW_NONE>;
	};

	sweep1: sweep-state {
		PIN_SWP(gpk0-0, PWEV, NONE);
		PIN_SWP(gpk0-1, PWEV, NONE);
		PIN_SWP(gpk0-2, PWEV, NONE);
		PIN_SWP(gpk0-3, PWEV, NONE);
		PIN_SWP(gpk0-4, PWEV, NONE);
		PIN_SWP(gpk0-5, PWEV, NONE);
		PIN_SWP(gpk0-6, PWEV, NONE);

		PIN_SWP(gpk1-0, INPUT, DOWN);
		PIN_SWP(gpk1-1, INPUT, DOWN);
		PIN_SWP(gpk1-2, INPUT, DOWN);
		PIN_SWP(gpk1-3, PWEV, NONE);
		PIN_SWP(gpk1-4, PWEV, NONE);
		PIN_SWP(gpk1-5, PWEV, NONE);
		PIN_SWP(gpk1-6, PWEV, NONE);

		PIN_SWP(gpk2-0, INPUT, DOWN);
		PIN_SWP(gpk2-1, INPUT, DOWN);
		PIN_SWP(gpk2-2, INPUT, DOWN);
		PIN_SWP(gpk2-3, INPUT, DOWN);
		PIN_SWP(gpk2-4, INPUT, DOWN);
		PIN_SWP(gpk2-5, INPUT, DOWN);
		PIN_SWP(gpk2-6, INPUT, DOWN);

		PIN_SWP(gpk3-0, OUT0, NONE);
		PIN_SWP(gpk3-1, INPUT, NONE);
		PIN_SWP(gpk3-2, INPUT, DOWN);
		PIN_SWP(gpk3-3, INPUT, NONE);
		PIN_SWP(gpk3-4, INPUT, NONE);
		PIN_SWP(gpk3-5, INPUT, NONE);
		PIN_SWP(gpk3-6, INPUT, NONE);

		PIN_SWP(gpw0-0, OUT0, NONE);
		PIN_SWP(gpw0-1, INPUT, NONE);
		PIN_SWP(gpw0-2, INPUT, NONE);
		PIN_SWP(gpw0-3, INPUT, DOWN);
		PIN_SWP(gpw0-4, PWEV, NONE);
		PIN_SWP(gpw0-6, PWEV, NONE);

		PIN_SWP(gpw1-0, OUT0, NONE);
		PIN_SWP(gpw1-1, OUT0, NONE);

		PIN_SWP(gpw2-0, INPUT, DOWN);
		PIN_SWP(gpw2-1, INPUT, DOWN);
		PIN_SWP(gpw2-2, INPUT, DOWN);
		PIN_SWP(gpw2-3, INPUT, DOWN);
		PIN_SWP(gpw2-4, OUT0, NONE);
		PIN_SWP(gpw2-5, INPUT, DOWN);
		PIN_SWP(gpw2-6, PWEV, NONE);
		PIN_SWP(gpw2-7, PWEV, NONE);

		PIN_SWP(gpm0-0, PWEV, NONE);
		PIN_SWP(gpm0-1, OUT0, NONE);
		PIN_SWP(gpm0-2, INPUT, DOWN);
		PIN_SWP(gpm0-3, INPUT, NONE);
		PIN_SWP(gpm0-4, OUT0, NONE);
		PIN_SWP(gpm0-5, OUT0, NONE);
		PIN_SWP(gpm0-6, INPUT, DOWN);
		PIN_SWP(gpm0-7, OUT0, NONE);

		PIN_SWP(gpm1-0, INPUT, NONE);
		PIN_SWP(gpm1-1, INPUT, NONE);
		PIN_SWP(gpm1-2, INPUT, NONE);
		PIN_SWP(gpm1-3, INPUT, NONE);
		PIN_SWP(gpm1-4, INPUT, NONE);
		PIN_SWP(gpm1-5, INPUT, NONE);
		PIN_SWP(gpm1-6, INPUT, DOWN);

		PIN_SWP(gpm2-0, INPUT, NONE);
		PIN_SWP(gpm2-1, INPUT, NONE);
		PIN_SWP(gpm2-2, OUT0, NONE);
		PIN_SWP(gpm2-3, OUT0, DOWN);
		PIN_SWP(gpm2-4, INPUT, DOWN);

		PIN_SWP(gpm3-0, PWEV, NONE);
		PIN_SWP(gpm3-1, PWEV, NONE);
		PIN_SWP(gpm3-2, PWEV, NONE);
		PIN_SWP(gpm3-3, OUT1, NONE);
		PIN_SWP(gpm3-4, OUT0, DOWN);
		PIN_SWP(gpm3-5, PWEV, NONE);
		PIN_SWP(gpm3-6, PWEV, NONE);
		PIN_SWP(gpm3-7, OUT0, NONE);

		PIN_SWP(gpm4-0, INPUT, NONE);
		PIN_SWP(gpm4-1, INPUT, NONE);
		PIN_SWP(gpm4-2, INPUT, DOWN);
		PIN_SWP(gpm4-3, INPUT, DOWN);
		PIN_SWP(gpm4-4, PWEV, NONE);
		PIN_SWP(gpm4-5, OUT0, NONE);
		PIN_SWP(gpm4-6, OUT0, NONE);
		PIN_SWP(gpm4-7, INPUT, DOWN);

		PIN_SWP(gpy0-0, INPUT, DOWN);
		PIN_SWP(gpy0-1, INPUT, DOWN);
		PIN_SWP(gpy0-2, INPUT, NONE);
		PIN_SWP(gpy0-3, INPUT, NONE);
		PIN_SWP(gpy0-4, INPUT, NONE);
		PIN_SWP(gpy0-5, INPUT, NONE);

		PIN_SWP(gpy1-0, INPUT, DOWN);
		PIN_SWP(gpy1-1, INPUT, DOWN);
		PIN_SWP(gpy1-2, INPUT, DOWN);
		PIN_SWP(gpy1-3, INPUT, DOWN);

		PIN_SWP(gpy2-0, PWEV, NONE);
		PIN_SWP(gpy2-1, INPUT, DOWN);
		PIN_SWP(gpy2-2, INPUT, NONE);
		PIN_SWP(gpy2-3, INPUT, NONE);
		PIN_SWP(gpy2-4, INPUT, NONE);
		PIN_SWP(gpy2-5, INPUT, NONE);

		PIN_SWP(gpy3-0, INPUT, DOWN);
		PIN_SWP(gpy3-1, INPUT, DOWN);
		PIN_SWP(gpy3-2, INPUT, DOWN);
		PIN_SWP(gpy3-3, INPUT, DOWN);
		PIN_SWP(gpy3-4, INPUT, DOWN);
		PIN_SWP(gpy3-5, INPUT, DOWN);
		PIN_SWP(gpy3-6, INPUT, DOWN);
		PIN_SWP(gpy3-7, INPUT, DOWN);

		PIN_SWP(gpy4-0, INPUT, DOWN);
		PIN_SWP(gpy4-1, INPUT, DOWN);
		PIN_SWP(gpy4-2, INPUT, DOWN);
		PIN_SWP(gpy4-3, INPUT, DOWN);
		PIN_SWP(gpy4-4, INPUT, DOWN);
		PIN_SWP(gpy4-5, INPUT, DOWN);
		PIN_SWP(gpy4-6, INPUT, DOWN);
		PIN_SWP(gpy4-7, INPUT, DOWN);

		PIN_SWP(gpy5-0, INPUT, DOWN);
		PIN_SWP(gpy5-1, INPUT, DOWN);
		PIN_SWP(gpy5-2, INPUT, DOWN);
		PIN_SWP(gpy5-3, INPUT, DOWN);
		PIN_SWP(gpy5-4, INPUT, DOWN);
		PIN_SWP(gpy5-5, INPUT, DOWN);
		PIN_SWP(gpy5-6, INPUT, DOWN);
		PIN_SWP(gpy5-7, INPUT, DOWN);

		PIN_SWP(gpy6-0, INPUT, DOWN);
		PIN_SWP(gpy6-1, INPUT, DOWN);
		PIN_SWP(gpy6-2, INPUT, DOWN);
		PIN_SWP(gpy6-3, INPUT, DOWN);
		PIN_SWP(gpy6-4, INPUT, DOWN);
		PIN_SWP(gpy6-5, INPUT, DOWN);
		PIN_SWP(gpy6-6, INPUT, DOWN);
		PIN_SWP(gpy6-7, INPUT, DOWN);
	};
};

&pinctww_2 {
	pinctww-names = "defauwt";
	pinctww-0 = <&sweep2>;

	sweep2: sweep-state {
		PIN_SWP(gpz-0, INPUT, DOWN);
		PIN_SWP(gpz-1, INPUT, DOWN);
		PIN_SWP(gpz-2, INPUT, DOWN);
		PIN_SWP(gpz-3, INPUT, DOWN);
		PIN_SWP(gpz-4, INPUT, DOWN);
		PIN_SWP(gpz-5, INPUT, DOWN);
		PIN_SWP(gpz-6, INPUT, DOWN);
	};
};

&pinctww_3 {
	pinctww-names = "defauwt";
	pinctww-0 = <&sweep3>;

	sweep3: sweep-state {
		PIN_SWP(gpv0-0, INPUT, DOWN);
		PIN_SWP(gpv0-1, INPUT, DOWN);
		PIN_SWP(gpv0-2, INPUT, DOWN);
		PIN_SWP(gpv0-3, INPUT, DOWN);
		PIN_SWP(gpv0-4, INPUT, DOWN);
		PIN_SWP(gpv0-5, INPUT, DOWN);
		PIN_SWP(gpv0-6, INPUT, DOWN);
		PIN_SWP(gpv0-7, INPUT, DOWN);

		PIN_SWP(gpv1-0, INPUT, DOWN);
		PIN_SWP(gpv1-1, INPUT, DOWN);
		PIN_SWP(gpv1-2, INPUT, DOWN);
		PIN_SWP(gpv1-3, INPUT, DOWN);
		PIN_SWP(gpv1-4, INPUT, DOWN);
		PIN_SWP(gpv1-5, INPUT, DOWN);
		PIN_SWP(gpv1-6, INPUT, DOWN);
		PIN_SWP(gpv1-7, INPUT, DOWN);

		PIN_SWP(gpv2-0, INPUT, DOWN);
		PIN_SWP(gpv2-1, INPUT, DOWN);
		PIN_SWP(gpv2-2, INPUT, DOWN);
		PIN_SWP(gpv2-3, INPUT, DOWN);
		PIN_SWP(gpv2-4, INPUT, DOWN);
		PIN_SWP(gpv2-5, INPUT, DOWN);
		PIN_SWP(gpv2-6, INPUT, DOWN);
		PIN_SWP(gpv2-7, INPUT, DOWN);

		PIN_SWP(gpv3-0, INPUT, DOWN);
		PIN_SWP(gpv3-1, INPUT, DOWN);
		PIN_SWP(gpv3-2, INPUT, DOWN);
		PIN_SWP(gpv3-3, INPUT, DOWN);
		PIN_SWP(gpv3-4, INPUT, DOWN);
		PIN_SWP(gpv3-5, INPUT, DOWN);
		PIN_SWP(gpv3-6, INPUT, DOWN);
		PIN_SWP(gpv3-7, INPUT, DOWN);

		PIN_SWP(gpv4-0, INPUT, DOWN);
		PIN_SWP(gpv4-1, INPUT, DOWN);
	};
};

&pmu_system_contwowwew {
	assigned-cwocks = <&pmu_system_contwowwew 0>;
	assigned-cwock-pawents = <&cwock CWK_XUSBXTI>;
};

&pwm {
	pinctww-0 = <&pwm1_out>;
	pinctww-names = "defauwt";
	samsung,pwm-outputs = <1>;
	status = "okay";
};

&wtc {
	cwocks = <&cwock CWK_WTC>, <&max77686 MAX77686_CWK_AP>;
	cwock-names = "wtc", "wtc_swc";
	status = "okay";
};

&sdhci_2 {
	bus-width = <4>;
	cd-gpios = <&gpx3 4 GPIO_ACTIVE_WOW>;
	pinctww-0 = <&sd2_cwk &sd2_cmd &sd2_bus4 &sdhci2_cd>;
	pinctww-names = "defauwt";
	vmmc-suppwy = <&wdo21_weg>;
	status = "okay";
};

&sdhci_3 {
	#addwess-cewws = <1>;
	#size-cewws = <0>;
	non-wemovabwe;
	bus-width = <4>;
	mmc-pwwseq = <&wwan_pwwseq>;

	pinctww-names = "defauwt";
	pinctww-0 = <&sd3_cwk &sd3_cmd &sd3_wifi>;
	status = "okay";

	wifi@1 {
		compatibwe = "bwcm,bcm4329-fmac";
		weg = <0x1>;
		pinctww-names = "defauwt";
		pinctww-0 = <&wifi_host_wake>;
		intewwupt-pawent = <&gpx2>;
		intewwupts = <5 IWQ_TYPE_WEVEW_HIGH>;
		intewwupt-names = "host-wake";
	};
};

&sewiaw_0 {
	pinctww-0 = <&uawt0_data &uawt0_fctw>;
	pinctww-names = "defauwt";
	status = "okay";

	bwuetooth {
		compatibwe = "bwcm,bcm4330-bt";
		pinctww-0 = <&bt_shutdown &bt_device_wakeup &bt_host_wakeup>;
		pinctww-names = "defauwt";

		max-speed = <2000000>;
		shutdown-gpios = <&gpw0 6 GPIO_ACTIVE_HIGH>;
		device-wakeup-gpios = <&gpx3 1 GPIO_ACTIVE_HIGH>;
		host-wakeup-gpios = <&gpx2 6 GPIO_ACTIVE_HIGH>;
		cwocks = <&max77686 MAX77686_CWK_PMIC>;
		cwock-names = "wpo";
	};
};

&sewiaw_2 {
	pinctww-0 = <&uawt_sew>;
	pinctww-names = "defauwt";
	status = "okay";
};

&tmu {
	status = "okay";
};
