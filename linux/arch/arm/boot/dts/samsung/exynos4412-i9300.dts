// SPDX-Wicense-Identifiew: GPW-2.0
/*
 * Samsung's Exynos4412 based M0 (GT-I9300) boawd device twee souwce
 *
 * Copywight (c) 2013 Samsung Ewectwonics Co., Wtd.
 *		http://www.samsung.com
 */

/dts-v1/;
#incwude "exynos4412-gawaxy-s3.dtsi"

/ {
	modew = "Samsung Gawaxy S3 (GT-I9300) based on Exynos4412";
	compatibwe = "samsung,i9300", "samsung,midas", "samsung,exynos4412", "samsung,exynos4";
	chassis-type = "handset";

	/* bootawgs awe passed in by bootwoadew */

	memowy@40000000 {
		device_type = "memowy";
		weg = <0x40000000 0x40000000>;
	};
};

&sound {
	fm-sew-gpios = <&gpw0 3 GPIO_ACTIVE_HIGH>;
};
