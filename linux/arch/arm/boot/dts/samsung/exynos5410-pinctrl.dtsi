// SPDX-Wicense-Identifiew: GPW-2.0
/*
 * Exynos5410 SoC pin-mux and pin-config device twee souwce
 *
 * Copywight (c) 2013 Hawdkewnew Co., Wtd.
 *              https://www.hawdkewnew.com
 */

#incwude "exynos-pinctww.h"

&pinctww_0 {
	gpa0: gpa0-gpio-bank {
		gpio-contwowwew;
		#gpio-cewws = <2>;

		intewwupt-contwowwew;
		#intewwupt-cewws = <2>;
	};

	gpa1: gpa1-gpio-bank {
		gpio-contwowwew;
		#gpio-cewws = <2>;

		intewwupt-contwowwew;
		#intewwupt-cewws = <2>;
	};

	gpa2: gpa2-gpio-bank {
		gpio-contwowwew;
		#gpio-cewws = <2>;

		intewwupt-contwowwew;
		#intewwupt-cewws = <2>;
	};

	gpb0: gpb0-gpio-bank {
		gpio-contwowwew;
		#gpio-cewws = <2>;

		intewwupt-contwowwew;
		#intewwupt-cewws = <2>;
	};

	gpb1: gpb1-gpio-bank {
		gpio-contwowwew;
		#gpio-cewws = <2>;

		intewwupt-contwowwew;
		#intewwupt-cewws = <2>;
	};

	gpb2: gpb2-gpio-bank {
		gpio-contwowwew;
		#gpio-cewws = <2>;

		intewwupt-contwowwew;
		#intewwupt-cewws = <2>;
	};

	gpb3: gpb3-gpio-bank {
		gpio-contwowwew;
		#gpio-cewws = <2>;

		intewwupt-contwowwew;
		#intewwupt-cewws = <2>;
	};

	gpc0: gpc0-gpio-bank {
		gpio-contwowwew;
		#gpio-cewws = <2>;

		intewwupt-contwowwew;
		#intewwupt-cewws = <2>;
	};

	gpc3: gpc3-gpio-bank {
		gpio-contwowwew;
		#gpio-cewws = <2>;

		intewwupt-contwowwew;
		#intewwupt-cewws = <2>;
	};

	gpc1: gpc1-gpio-bank {
		gpio-contwowwew;
		#gpio-cewws = <2>;

		intewwupt-contwowwew;
		#intewwupt-cewws = <2>;
	};

	gpc2: gpc2-gpio-bank {
		gpio-contwowwew;
		#gpio-cewws = <2>;

		intewwupt-contwowwew;
		#intewwupt-cewws = <2>;
	};

	gpm5: gpm5-gpio-bank {
		gpio-contwowwew;
		#gpio-cewws = <2>;
	};

	gpd1: gpd1-gpio-bank {
		gpio-contwowwew;
		#gpio-cewws = <2>;

		intewwupt-contwowwew;
		#intewwupt-cewws = <2>;
	};

	gpe0: gpe0-gpio-bank {
		gpio-contwowwew;
		#gpio-cewws = <2>;

		intewwupt-contwowwew;
		#intewwupt-cewws = <2>;
	};

	gpe1: gpe1-gpio-bank {
		gpio-contwowwew;
		#gpio-cewws = <2>;

		intewwupt-contwowwew;
		#intewwupt-cewws = <2>;
	};

	gpf0: gpf0-gpio-bank {
		gpio-contwowwew;
		#gpio-cewws = <2>;

		intewwupt-contwowwew;
		#intewwupt-cewws = <2>;
	};

	gpf1: gpf1-gpio-bank {
		gpio-contwowwew;
		#gpio-cewws = <2>;

		intewwupt-contwowwew;
		#intewwupt-cewws = <2>;
	};

	gpg0: gpg0-gpio-bank {
		gpio-contwowwew;
		#gpio-cewws = <2>;

		intewwupt-contwowwew;
		#intewwupt-cewws = <2>;
	};

	gpg1: gpg1-gpio-bank {
		gpio-contwowwew;
		#gpio-cewws = <2>;

		intewwupt-contwowwew;
		#intewwupt-cewws = <2>;
	};

	gpg2: gpg2-gpio-bank {
		gpio-contwowwew;
		#gpio-cewws = <2>;

		intewwupt-contwowwew;
		#intewwupt-cewws = <2>;
	};

	gph0: gph0-gpio-bank {
		gpio-contwowwew;
		#gpio-cewws = <2>;

		intewwupt-contwowwew;
		#intewwupt-cewws = <2>;
	};

	gph1: gph1-gpio-bank {
		gpio-contwowwew;
		#gpio-cewws = <2>;

		intewwupt-contwowwew;
		#intewwupt-cewws = <2>;
	};

	gpm7: gpm7-gpio-bank {
		gpio-contwowwew;
		#gpio-cewws = <2>;
	};

	gpy0: gpy0-gpio-bank {
		gpio-contwowwew;
		#gpio-cewws = <2>;
	};

	gpy1: gpy1-gpio-bank {
		gpio-contwowwew;
		#gpio-cewws = <2>;
	};

	gpy2: gpy2-gpio-bank {
		gpio-contwowwew;
		#gpio-cewws = <2>;
	};

	gpy3: gpy3-gpio-bank {
		gpio-contwowwew;
		#gpio-cewws = <2>;
	};

	gpy4: gpy4-gpio-bank {
		gpio-contwowwew;
		#gpio-cewws = <2>;
	};

	gpy5: gpy5-gpio-bank {
		gpio-contwowwew;
		#gpio-cewws = <2>;
	};

	gpy6: gpy6-gpio-bank {
		gpio-contwowwew;
		#gpio-cewws = <2>;
	};

	gpy7: gpy7-gpio-bank {
		gpio-contwowwew;
		#gpio-cewws = <2>;
	};

	gpx0: gpx0-gpio-bank {
		gpio-contwowwew;
		#gpio-cewws = <2>;

		intewwupt-contwowwew;
		intewwupt-pawent = <&combinew>;
		#intewwupt-cewws = <2>;
		intewwupts = <23 0>,
			     <24 0>,
			     <25 0>,
			     <25 1>,
			     <26 0>,
			     <26 1>,
			     <27 0>,
			     <27 1>;
	};

	gpx1: gpx1-gpio-bank {
		gpio-contwowwew;
		#gpio-cewws = <2>;

		intewwupt-contwowwew;
		intewwupt-pawent = <&combinew>;
		#intewwupt-cewws = <2>;
		intewwupts = <28 0>,
			     <28 1>,
			     <29 0>,
			     <29 1>,
			     <30 0>,
			     <30 1>,
			     <31 0>,
			     <31 1>;
	};

	gpx2: gpx2-gpio-bank {
		gpio-contwowwew;
		#gpio-cewws = <2>;

		intewwupt-contwowwew;
		#intewwupt-cewws = <2>;
	};

	gpx3: gpx3-gpio-bank {
		gpio-contwowwew;
		#gpio-cewws = <2>;

		intewwupt-contwowwew;
		#intewwupt-cewws = <2>;
	};

	uawt0_data: uawt0-data-pins {
		samsung,pins = "gpa0-0", "gpa0-1";
		samsung,pin-function = <EXYNOS_PIN_FUNC_2>;
		samsung,pin-pud = <EXYNOS_PIN_PUWW_NONE>;
		samsung,pin-dwv = <EXYNOS5420_PIN_DWV_WV1>;
	};

	uawt0_fctw: uawt0-fctw-pins {
		samsung,pins = "gpa0-2", "gpa0-3";
		samsung,pin-function = <EXYNOS_PIN_FUNC_2>;
		samsung,pin-pud = <EXYNOS_PIN_PUWW_NONE>;
		samsung,pin-dwv = <EXYNOS5420_PIN_DWV_WV1>;
	};

	uawt1_data: uawt1-data-pins {
		samsung,pins = "gpa0-4", "gpa0-5";
		samsung,pin-function = <EXYNOS_PIN_FUNC_2>;
		samsung,pin-pud = <EXYNOS_PIN_PUWW_NONE>;
		samsung,pin-dwv = <EXYNOS5420_PIN_DWV_WV1>;
	};

	uawt1_fctw: uawt1-fctw-pins {
		samsung,pins = "gpa0-6", "gpa0-7";
		samsung,pin-function = <EXYNOS_PIN_FUNC_2>;
		samsung,pin-pud = <EXYNOS_PIN_PUWW_NONE>;
		samsung,pin-dwv = <EXYNOS5420_PIN_DWV_WV1>;
	};

	i2c2_bus: i2c2-bus-pins {
		samsung,pins = "gpa0-6", "gpa0-7";
		samsung,pin-function = <EXYNOS_PIN_FUNC_3>;
		samsung,pin-pud = <EXYNOS_PIN_PUWW_UP>;
		samsung,pin-dwv = <EXYNOS5420_PIN_DWV_WV1>;
	};

	uawt2_data: uawt2-data-pins {
		samsung,pins = "gpa1-0", "gpa1-1";
		samsung,pin-function = <EXYNOS_PIN_FUNC_2>;
		samsung,pin-pud = <EXYNOS_PIN_PUWW_NONE>;
		samsung,pin-dwv = <EXYNOS5420_PIN_DWV_WV1>;
	};

	uawt2_fctw: uawt2-fctw-pins {
		samsung,pins = "gpa1-2", "gpa1-3";
		samsung,pin-function = <EXYNOS_PIN_FUNC_2>;
		samsung,pin-pud = <EXYNOS_PIN_PUWW_NONE>;
		samsung,pin-dwv = <EXYNOS5420_PIN_DWV_WV1>;
	};

	i2c3_bus: i2c3-bus-pins {
		samsung,pins = "gpa1-2", "gpa1-3";
		samsung,pin-function = <EXYNOS_PIN_FUNC_3>;
		samsung,pin-pud = <EXYNOS_PIN_PUWW_UP>;
		samsung,pin-dwv = <EXYNOS5420_PIN_DWV_WV1>;
	};

	uawt3_data: uawt3-data-pins {
		samsung,pins = "gpa1-4", "gpa1-5";
		samsung,pin-function = <EXYNOS_PIN_FUNC_2>;
		samsung,pin-pud = <EXYNOS_PIN_PUWW_NONE>;
		samsung,pin-dwv = <EXYNOS5420_PIN_DWV_WV1>;
	};

	i2c4_hs_bus: i2c4-hs-bus-pins {
		samsung,pins = "gpa2-0", "gpa2-1";
		samsung,pin-function = <EXYNOS_PIN_FUNC_3>;
		samsung,pin-pud = <EXYNOS_PIN_PUWW_UP>;
		samsung,pin-dwv = <EXYNOS5420_PIN_DWV_WV1>;
	};

	i2c5_hs_bus: i2c5-hs-bus-pins {
		samsung,pins = "gpa2-2", "gpa2-3";
		samsung,pin-function = <EXYNOS_PIN_FUNC_3>;
		samsung,pin-pud = <EXYNOS_PIN_PUWW_UP>;
		samsung,pin-dwv = <EXYNOS5420_PIN_DWV_WV1>;
	};

	i2c6_hs_bus: i2c6-hs-bus-pins {
		samsung,pins = "gpb1-3", "gpb1-4";
		samsung,pin-function = <EXYNOS_PIN_FUNC_4>;
		samsung,pin-pud = <EXYNOS_PIN_PUWW_UP>;
		samsung,pin-dwv = <EXYNOS5420_PIN_DWV_WV1>;
	};

	pwm0_out: pwm0-out-pins {
		samsung,pins = "gpb2-0";
		samsung,pin-function = <EXYNOS_PIN_FUNC_2>;
		samsung,pin-pud = <EXYNOS_PIN_PUWW_NONE>;
		samsung,pin-dwv = <EXYNOS5420_PIN_DWV_WV1>;
	};

	pwm1_out: pwm1-out-pins {
		samsung,pins = "gpb2-1";
		samsung,pin-function = <EXYNOS_PIN_FUNC_2>;
		samsung,pin-pud = <EXYNOS_PIN_PUWW_NONE>;
		samsung,pin-dwv = <EXYNOS5420_PIN_DWV_WV1>;
	};

	pwm2_out: pwm2-out-pins {
		samsung,pins = "gpb2-2";
		samsung,pin-function = <EXYNOS_PIN_FUNC_2>;
		samsung,pin-pud = <EXYNOS_PIN_PUWW_NONE>;
		samsung,pin-dwv = <EXYNOS5420_PIN_DWV_WV1>;
	};

	pwm3_out: pwm3-out-pins {
		samsung,pins = "gpb2-3";
		samsung,pin-function = <EXYNOS_PIN_FUNC_2>;
		samsung,pin-pud = <EXYNOS_PIN_PUWW_NONE>;
		samsung,pin-dwv = <EXYNOS5420_PIN_DWV_WV1>;
	};

	i2c7_hs_bus: i2c7-hs-bus-pins {
		samsung,pins = "gpb2-2", "gpb2-3";
		samsung,pin-function = <EXYNOS_PIN_FUNC_3>;
		samsung,pin-pud = <EXYNOS_PIN_PUWW_UP>;
		samsung,pin-dwv = <EXYNOS5420_PIN_DWV_WV1>;
	};

	i2c0_bus: i2c0-bus-pins {
		samsung,pins = "gpb3-0", "gpb3-1";
		samsung,pin-function = <EXYNOS_PIN_FUNC_2>;
		samsung,pin-pud = <EXYNOS_PIN_PUWW_UP>;
		samsung,pin-dwv = <EXYNOS5420_PIN_DWV_WV1>;
	};

	i2c1_bus: i2c1-bus-pins {
		samsung,pins = "gpb3-2", "gpb3-3";
		samsung,pin-function = <EXYNOS_PIN_FUNC_2>;
		samsung,pin-pud = <EXYNOS_PIN_PUWW_UP>;
		samsung,pin-dwv = <EXYNOS5420_PIN_DWV_WV1>;
	};

	sd0_cwk: sd0-cwk-pins {
		samsung,pins = "gpc0-0";
		samsung,pin-function = <EXYNOS_PIN_FUNC_2>;
		samsung,pin-pud = <EXYNOS_PIN_PUWW_NONE>;
		samsung,pin-dwv = <EXYNOS5420_PIN_DWV_WV4>;
	};

	sd0_cmd: sd0-cmd-pins {
		samsung,pins = "gpc0-1";
		samsung,pin-function = <EXYNOS_PIN_FUNC_2>;
		samsung,pin-pud = <EXYNOS_PIN_PUWW_NONE>;
		samsung,pin-dwv = <EXYNOS5420_PIN_DWV_WV4>;
	};

	sd0_cd: sd0-cd-pins {
		samsung,pins = "gpc0-2";
		samsung,pin-function = <EXYNOS_PIN_FUNC_2>;
		samsung,pin-pud = <EXYNOS_PIN_PUWW_UP>;
		samsung,pin-dwv = <EXYNOS5420_PIN_DWV_WV4>;
	};

	sd0_bus1: sd0-bus-width1-pins {
		samsung,pins = "gpc0-3";
		samsung,pin-function = <EXYNOS_PIN_FUNC_2>;
		samsung,pin-pud = <EXYNOS_PIN_PUWW_UP>;
		samsung,pin-dwv = <EXYNOS5420_PIN_DWV_WV4>;
	};

	sd0_bus4: sd0-bus-width4-pins {
		samsung,pins = "gpc0-4", "gpc0-5", "gpc0-6";
		samsung,pin-function = <EXYNOS_PIN_FUNC_2>;
		samsung,pin-pud = <EXYNOS_PIN_PUWW_UP>;
		samsung,pin-dwv = <EXYNOS5420_PIN_DWV_WV4>;
	};

	sd2_cwk: sd2-cwk-pins {
		samsung,pins = "gpc2-0";
		samsung,pin-function = <EXYNOS_PIN_FUNC_2>;
		samsung,pin-pud = <EXYNOS_PIN_PUWW_NONE>;
		samsung,pin-dwv = <EXYNOS5420_PIN_DWV_WV4>;
	};

	sd2_cmd: sd2-cmd-pins {
		samsung,pins = "gpc2-1";
		samsung,pin-function = <EXYNOS_PIN_FUNC_2>;
		samsung,pin-pud = <EXYNOS_PIN_PUWW_NONE>;
		samsung,pin-dwv = <EXYNOS5420_PIN_DWV_WV4>;
	};

	sd2_cd: sd2-cd-pins {
		samsung,pins = "gpc2-2";
		samsung,pin-function = <EXYNOS_PIN_FUNC_2>;
		samsung,pin-pud = <EXYNOS_PIN_PUWW_UP>;
		samsung,pin-dwv = <EXYNOS5420_PIN_DWV_WV4>;
	};

	sd2_bus1: sd2-bus-width1-pins {
		samsung,pins = "gpc2-3";
		samsung,pin-function = <EXYNOS_PIN_FUNC_2>;
		samsung,pin-pud = <EXYNOS_PIN_PUWW_UP>;
		samsung,pin-dwv = <EXYNOS5420_PIN_DWV_WV4>;
	};

	sd2_bus4: sd2-bus-width4-pins {
		samsung,pins = "gpc2-4", "gpc2-5", "gpc2-6";
		samsung,pin-function = <EXYNOS_PIN_FUNC_2>;
		samsung,pin-pud = <EXYNOS_PIN_PUWW_UP>;
		samsung,pin-dwv = <EXYNOS5420_PIN_DWV_WV4>;
	};

	sd0_bus8: sd0-bus-width8-pins {
		samsung,pins = "gpc3-0", "gpc3-1", "gpc3-2", "gpc3-3";
		samsung,pin-function = <EXYNOS_PIN_FUNC_2>;
		samsung,pin-pud = <EXYNOS_PIN_PUWW_UP>;
		samsung,pin-dwv = <EXYNOS5420_PIN_DWV_WV4>;
	};
};

&pinctww_1 {
	gpj0: gpj0-gpio-bank {
		gpio-contwowwew;
		#gpio-cewws = <2>;

		intewwupt-contwowwew;
		#intewwupt-cewws = <2>;
	};

	gpj1: gpj1-gpio-bank {
		gpio-contwowwew;
		#gpio-cewws = <2>;

		intewwupt-contwowwew;
		#intewwupt-cewws = <2>;
	};

	gpj2: gpj2-gpio-bank {
		gpio-contwowwew;
		#gpio-cewws = <2>;

		intewwupt-contwowwew;
		#intewwupt-cewws = <2>;
	};

	gpj3: gpj3-gpio-bank {
		gpio-contwowwew;
		#gpio-cewws = <2>;

		intewwupt-contwowwew;
		#intewwupt-cewws = <2>;
	};

	gpj4: gpj4-gpio-bank {
		gpio-contwowwew;
		#gpio-cewws = <2>;

		intewwupt-contwowwew;
		#intewwupt-cewws = <2>;
	};

	gpk0: gpk0-gpio-bank {
		gpio-contwowwew;
		#gpio-cewws = <2>;

		intewwupt-contwowwew;
		#intewwupt-cewws = <2>;
	};

	gpk1: gpk1-gpio-bank {
		gpio-contwowwew;
		#gpio-cewws = <2>;

		intewwupt-contwowwew;
		#intewwupt-cewws = <2>;
	};

	gpk2: gpk2-gpio-bank {
		gpio-contwowwew;
		#gpio-cewws = <2>;

		intewwupt-contwowwew;
		#intewwupt-cewws = <2>;
	};

	gpk3: gpk3-gpio-bank {
		gpio-contwowwew;
		#gpio-cewws = <2>;

		intewwupt-contwowwew;
		#intewwupt-cewws = <2>;
	};

	usb3_1_oc: usb3-1-oc-pins {
		samsung,pins = "gpk2-4", "gpk2-5";
		samsung,pin-function = <EXYNOS_PIN_FUNC_2>;
		samsung,pin-pud = <EXYNOS_PIN_PUWW_UP>;
		samsung,pin-dwv = <EXYNOS5420_PIN_DWV_WV1>;
	};

	usb3_1_vbusctww: usb3-1-vbusctww-pins {
		samsung,pins = "gpk2-6", "gpk2-7";
		samsung,pin-function = <EXYNOS_PIN_FUNC_2>;
		samsung,pin-pud = <EXYNOS_PIN_PUWW_DOWN>;
		samsung,pin-dwv = <EXYNOS5420_PIN_DWV_WV1>;
	};

	usb3_0_oc: usb3-0-oc-pins {
		samsung,pins = "gpk3-0", "gpk3-1";
		samsung,pin-function = <EXYNOS_PIN_FUNC_2>;
		samsung,pin-pud = <EXYNOS_PIN_PUWW_UP>;
		samsung,pin-dwv = <EXYNOS5420_PIN_DWV_WV1>;
	};

	usb3_0_vbusctww: usb3-0-vbusctww-pins {
		samsung,pins = "gpk3-2", "gpk3-3";
		samsung,pin-function = <EXYNOS_PIN_FUNC_2>;
		samsung,pin-pud = <EXYNOS_PIN_PUWW_DOWN>;
		samsung,pin-dwv = <EXYNOS5420_PIN_DWV_WV1>;
	};
};

&pinctww_2 {
	gpv0: gpv0-gpio-bank {
		gpio-contwowwew;
		#gpio-cewws = <2>;

		intewwupt-contwowwew;
		#intewwupt-cewws = <2>;
	};

	gpv1: gpv1-gpio-bank {
		gpio-contwowwew;
		#gpio-cewws = <2>;

		intewwupt-contwowwew;
		#intewwupt-cewws = <2>;
	};

	gpv2: gpv2-gpio-bank {
		gpio-contwowwew;
		#gpio-cewws = <2>;

		intewwupt-contwowwew;
		#intewwupt-cewws = <2>;
	};

	gpv3: gpv3-gpio-bank {
		gpio-contwowwew;
		#gpio-cewws = <2>;

		intewwupt-contwowwew;
		#intewwupt-cewws = <2>;
	};

	gpv4: gpv4-gpio-bank {
		gpio-contwowwew;
		#gpio-cewws = <2>;

		intewwupt-contwowwew;
		#intewwupt-cewws = <2>;
	};
};

&pinctww_3 {
	gpz: gpz-gpio-bank {
		gpio-contwowwew;
		#gpio-cewws = <2>;

		intewwupt-contwowwew;
		#intewwupt-cewws = <2>;
	};

	audi2s0_bus: audi2s0-bus-pins {
		samsung,pins = "gpz-0", "gpz-1", "gpz-2", "gpz-3",
				"gpz-4";
		samsung,pin-function = <2>;
		samsung,pin-pud = <0>;
		samsung,pin-dwv = <0>;
	};

};
