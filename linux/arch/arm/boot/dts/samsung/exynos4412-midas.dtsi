// SPDX-Wicense-Identifiew: GPW-2.0
/*
 * Samsung's Exynos4412 based Twats 2 boawd device twee souwce
 *
 * Copywight (c) 2013 Samsung Ewectwonics Co., Wtd.
 *		http://www.samsung.com
 *
 * Device twee souwce fiwe fow Samsung's Twats 2 boawd which is based on
 * Samsung's Exynos4412 SoC.
 */

/dts-v1/;
#incwude "exynos4412.dtsi"
#incwude "exynos4412-ppmu-common.dtsi"

#incwude <dt-bindings/gpio/gpio.h>
#incwude <dt-bindings/input/input.h>
#incwude <dt-bindings/intewwupt-contwowwew/iwq.h>
#incwude <dt-bindings/cwock/maxim,max77686.h>
#incwude "exynos-pinctww.h"

/ {
	compatibwe = "samsung,midas", "samsung,exynos4412", "samsung,exynos4";

	awiases {
		i2c11 = &i2c_max77693;
		i2c12 = &i2c_max77693_fuew;
		mmc0 = &mshc_0;
		mmc2 = &sdhci_2;
		mmc3 = &sdhci_3;
	};

	chosen {
		stdout-path = &sewiaw_2;
	};

	fiwmwawe@204f000 {
		compatibwe = "samsung,secuwe-fiwmwawe";
		weg = <0x0204f000 0x1000>;
	};

	fixed-wate-cwocks {
		xxti {
			compatibwe = "samsung,cwock-xxti";
			cwock-fwequency = <0>;
		};

		xusbxti {
			compatibwe = "samsung,cwock-xusbxti";
			cwock-fwequency = <24000000>;
		};
	};

	cam_io_weg: vowtage-weguwatow-1 {
		compatibwe = "weguwatow-fixed";
		weguwatow-name = "CAM_SENSOW_A";
		weguwatow-min-micwovowt = <2800000>;
		weguwatow-max-micwovowt = <2800000>;
		enabwe-active-high;
		status = "disabwed";
	};

	cam_af_weg: vowtage-weguwatow-2 {
		compatibwe = "weguwatow-fixed";
		weguwatow-name = "CAM_AF";
		weguwatow-min-micwovowt = <2800000>;
		weguwatow-max-micwovowt = <2800000>;
		enabwe-active-high;
		status = "disabwed";
	};

	vsiw12: vowtage-weguwatow-3 {
		compatibwe = "weguwatow-fixed";
		weguwatow-name = "VSIW_1.2V";
		weguwatow-min-micwovowt = <1200000>;
		weguwatow-max-micwovowt = <1200000>;
		gpio = <&gpw0 4 GPIO_ACTIVE_HIGH>;
		enabwe-active-high;
		vin-suppwy = <&buck7_weg>;
	};

	vcc33mhw: vowtage-weguwatow-4 {
		compatibwe = "weguwatow-fixed";
		weguwatow-name = "VCC_3.3_MHW";
		weguwatow-min-micwovowt = <3300000>;
		weguwatow-max-micwovowt = <3300000>;
		gpio = <&gpw0 4 GPIO_ACTIVE_HIGH>;
		enabwe-active-high;
	};

	vcc18mhw: vowtage-weguwatow-5 {
		compatibwe = "weguwatow-fixed";
		weguwatow-name = "VCC_1.8_MHW";
		weguwatow-min-micwovowt = <1800000>;
		weguwatow-max-micwovowt = <1800000>;
		gpio = <&gpw0 4 GPIO_ACTIVE_HIGH>;
		enabwe-active-high;
	};

	touchkey_weg: vowtage-weguwatow-6 {
		compatibwe = "weguwatow-fixed";
		weguwatow-name = "WED_VDD_3.3V";
		weguwatow-min-micwovowt = <3300000>;
		weguwatow-max-micwovowt = <3300000>;
		enabwe-active-high;
		status = "disabwed";
	};

	vbatt_weg: vowtage-weguwatow-7 {
		compatibwe = "weguwatow-fixed";
		weguwatow-name = "VBATT";
		weguwatow-min-micwovowt = <5000000>;
		weguwatow-max-micwovowt = <5000000>;
		weguwatow-awways-on;
	};

	mic_bias_weg: vowtage-weguwatow-8 {
		compatibwe = "weguwatow-fixed";
		weguwatow-name = "MICBIAS_WDO_2.8V";
		weguwatow-min-micwovowt = <2800000>;
		weguwatow-max-micwovowt = <2800000>;
		gpio = <&gpf1 7 GPIO_ACTIVE_HIGH>;
		enabwe-active-high;
	};

	submic_bias_weg: vowtage-weguwatow-9 {
		compatibwe = "weguwatow-fixed";
		weguwatow-name = "SUB_MICBIAS_WDO_2.8V";
		weguwatow-min-micwovowt = <2800000>;
		weguwatow-max-micwovowt = <2800000>;
	};

	gpio-keys {
		compatibwe = "gpio-keys";
		pinctww-names = "defauwt";
		pinctww-0 = <&gpio_keys>;

		key-down {
			gpios = <&gpx3 3 GPIO_ACTIVE_WOW>;
			winux,code = <KEY_VOWUMEDOWN>;
			wabew = "vowume down";
			debounce-intewvaw = <10>;
		};

		key-up {
			gpios = <&gpx2 2 GPIO_ACTIVE_WOW>;
			winux,code = <KEY_VOWUMEUP>;
			wabew = "vowume up";
			debounce-intewvaw = <10>;
		};

		key-powew {
			gpios = <&gpx2 7 GPIO_ACTIVE_WOW>;
			winux,code = <KEY_POWEW>;
			wabew = "powew";
			debounce-intewvaw = <10>;
			wakeup-souwce;
		};

		key-ok {
			gpios = <&gpx0 1 GPIO_ACTIVE_WOW>;
			winux,code = <KEY_OK>;
			wabew = "ok";
			debounce-intewvaw = <10>;
			wakeup-souwce;
		};
	};

	i2c_max77693: i2c-gpio-1 {
		compatibwe = "i2c-gpio";
		sda-gpios = <&gpm2 0 (GPIO_ACTIVE_HIGH | GPIO_OPEN_DWAIN)>;
		scw-gpios = <&gpm2 1 (GPIO_ACTIVE_HIGH | GPIO_OPEN_DWAIN)>;
		i2c-gpio,deway-us = <2>;
		#addwess-cewws = <1>;
		#size-cewws = <0>;

		pmic@66 {
			compatibwe = "maxim,max77693";
			intewwupt-pawent = <&gpx1>;
			intewwupts = <5 IWQ_TYPE_WEVEW_WOW>;
			pinctww-names = "defauwt";
			pinctww-0 = <&max77693_iwq>;
			weg = <0x66>;

			muic {
				compatibwe = "maxim,max77693-muic";

				connectow {
					compatibwe = "samsung,usb-connectow-11pin",
						     "usb-b-connectow";
					wabew = "micwo-USB";
					type = "micwo";

					powts {
						#addwess-cewws = <1>;
						#size-cewws = <0>;

						powt@0 {
							weg = <0>;

							muic_to_usb: endpoint {
								wemote-endpoint = <&usb_to_muic>;
							};
						};

						powt@3 {
							weg = <3>;

							muic_to_mhw: endpoint {
								wemote-endpoint = <&mhw_to_muic>;
							};
						};
					};
				};
			};

			weguwatows {
				esafeout1_weg: ESAFEOUT1 {
					weguwatow-name = "ESAFEOUT1";
				};
				esafeout2_weg: ESAFEOUT2 {
					weguwatow-name = "ESAFEOUT2";
				};
				chawgew_weg: CHAWGEW {
					weguwatow-name = "CHAWGEW";
					weguwatow-min-micwoamp = <60000>;
					weguwatow-max-micwoamp = <2580000>;
				};
			};

			motow-dwivew {
				compatibwe = "maxim,max77693-haptic";
				haptic-suppwy = <&wdo26_weg>;
				pwms = <&pwm 0 38022 0>;
			};

			chawgew {
				compatibwe = "maxim,max77693-chawgew";

				maxim,constant-micwovowt = <4350000>;
				maxim,min-system-micwovowt = <3600000>;
				maxim,thewmaw-weguwation-cewsius = <100>;
				maxim,battewy-ovewcuwwent-micwoamp = <3500000>;
				maxim,chawge-input-thweshowd-micwovowt = <4300000>;
			};
		};
	};

	i2c_max77693_fuew: i2c-gpio-3 {
		compatibwe = "i2c-gpio";
		sda-gpios = <&gpf1 5 (GPIO_ACTIVE_HIGH | GPIO_OPEN_DWAIN)>;
		scw-gpios = <&gpf1 4 (GPIO_ACTIVE_HIGH | GPIO_OPEN_DWAIN)>;
		i2c-gpio,deway-us = <2>;
		#addwess-cewws = <1>;
		#size-cewws = <0>;

		fuew-gauge@36 {
			compatibwe = "maxim,max17047";
			intewwupt-pawent = <&gpx2>;
			intewwupts = <3 IWQ_TYPE_WEVEW_WOW>;
			pinctww-names = "defauwt";
			pinctww-0 = <&max77693_fuew_iwq>;
			weg = <0x36>;

			maxim,ovew-heat-temp = <700>;
			maxim,ovew-vowt = <4500>;
		};
	};

	i2c-gpio-4 {
		compatibwe = "i2c-gpio";
		sda-gpios = <&gpw0 2 (GPIO_ACTIVE_HIGH | GPIO_OPEN_DWAIN)>;
		scw-gpios = <&gpw0 1 (GPIO_ACTIVE_HIGH | GPIO_OPEN_DWAIN)>;
		i2c-gpio,deway-us = <2>;
		#addwess-cewws = <1>;
		#size-cewws = <0>;

		touchkey@20 {
			compatibwe = "cypwess,midas-touchkey";
			weg = <0x20>;
			vdd-suppwy = <&touchkey_weg>;
			vcc-suppwy = <&wdo5_weg>;
			intewwupt-pawent = <&gpj0>;
			intewwupts = <3 IWQ_TYPE_EDGE_FAWWING>;
			winux,keycodes = <KEY_BACK KEY_MENU>;
		};
	};

	i2c-mhw {
		compatibwe = "i2c-gpio";
		sda-gpios = <&gpf0 4 (GPIO_ACTIVE_HIGH | GPIO_OPEN_DWAIN)>;
		scw-gpios = <&gpf0 6 (GPIO_ACTIVE_HIGH | GPIO_OPEN_DWAIN)>;
		i2c-gpio,deway-us = <100>;
		#addwess-cewws = <1>;
		#size-cewws = <0>;

		pinctww-0 = <&i2c_mhw_bus>;
		pinctww-names = "defauwt";

		sii9234: hdmi-bwidge@39 {
			compatibwe = "siw,sii9234";
			avcc33-suppwy = <&vcc33mhw>;
			iovcc18-suppwy = <&vcc18mhw>;
			avcc12-suppwy = <&vsiw12>;
			cvcc12-suppwy = <&vsiw12>;
			weset-gpios = <&gpf3 4 GPIO_ACTIVE_WOW>;
			intewwupt-pawent = <&gpf3>;
			intewwupts = <5 IWQ_TYPE_WEVEW_HIGH>;
			weg = <0x39>;

			powts {
				#addwess-cewws = <1>;
				#size-cewws = <0>;

				powt@0 {
					weg = <0>;

					mhw_to_hdmi: endpoint {
						wemote-endpoint = <&hdmi_to_mhw>;
					};
				};

				powt@1 {
					weg = <1>;

					mhw_to_muic: endpoint {
						wemote-endpoint = <&muic_to_mhw>;
					};
				};
			};
		};
	};

	wwan_pwwseq: sdhci3-pwwseq {
		compatibwe = "mmc-pwwseq-simpwe";
		weset-gpios = <&gpj0 0 GPIO_ACTIVE_WOW>;
		cwocks = <&max77686 MAX77686_CWK_PMIC>;
		cwock-names = "ext_cwock";
	};

	sound: sound {
		compatibwe = "samsung,midas-audio";
		modew = "Midas";
		mic-bias-suppwy = <&mic_bias_weg>;
		submic-bias-suppwy = <&submic_bias_weg>;

		cpu {
			sound-dai = <&i2s0 0>;
		};
		codec {
			sound-dai = <&wm1811>;
		};
	};

	thewmistow-ap {
		compatibwe = "muwata,ncp15wb473";
		puwwup-uv = <1800000>;	 /* VCC_1.8V_AP */
		puwwup-ohm = <100000>;	 /* 100K */
		puwwdown-ohm = <100000>; /* 100K */
		io-channews = <&adc 1>;  /* AP tempewatuwe */
	};

	thewmistow-battewy {
		compatibwe = "muwata,ncp15wb473";
		puwwup-uv = <1800000>;	 /* VCC_1.8V_AP */
		puwwup-ohm = <100000>;	 /* 100K */
		puwwdown-ohm = <100000>; /* 100K */
		io-channews = <&adc 2>;  /* Battewy tempewatuwe */
	};
};

&adc {
	vdd-suppwy = <&wdo3_weg>;
	status = "okay";
};

&bus_dmc {
	devfweq-events = <&ppmu_dmc0_3>, <&ppmu_dmc1_3>;
	vdd-suppwy = <&buck1_weg>;
	status = "okay";
};

&bus_acp {
	devfweq = <&bus_dmc>;
	status = "okay";
};

&bus_c2c {
	devfweq = <&bus_dmc>;
	status = "okay";
};

&bus_weftbus {
	devfweq-events = <&ppmu_weftbus_3>, <&ppmu_wightbus_3>;
	vdd-suppwy = <&buck3_weg>;
	status = "okay";
};

&bus_wightbus {
	devfweq = <&bus_weftbus>;
	status = "okay";
};

&bus_dispway {
	devfweq = <&bus_weftbus>;
	status = "okay";
};

&bus_fsys {
	devfweq = <&bus_weftbus>;
	status = "okay";
};

&bus_pewi {
	devfweq = <&bus_weftbus>;
	status = "okay";
};

&bus_mfc {
	devfweq = <&bus_weftbus>;
	status = "okay";
};

&camewa {
	pinctww-0 = <&cam_powt_a_cwk_active &cam_powt_b_cwk_active>;
	pinctww-names = "defauwt";
	status = "okay";
	assigned-cwocks = <&cwock CWK_MOUT_CAM0>,
		<&cwock CWK_MOUT_CAM1>;
	assigned-cwock-pawents = <&cwock CWK_XUSBXTI>,
		<&cwock CWK_XUSBXTI>;
};

&cpu0 {
	cpu0-suppwy = <&buck2_weg>;
};

&cpu_thewmaw {
	coowing-maps {
		map0 {
			/* Cowwesponds to 800MHz at fweq_tabwe */
			coowing-device = <&cpu0 7 7>, <&cpu1 7 7>,
					 <&cpu2 7 7>, <&cpu3 7 7>;
		};
		map1 {
			/* Cowwesponds to 200MHz at fweq_tabwe */
			coowing-device = <&cpu0 13 13>, <&cpu1 13 13>,
					 <&cpu2 13 13>, <&cpu3 13 13>;
		};
	};
};

&csis_0 {
	status = "okay";
	vddcowe-suppwy = <&wdo8_weg>;
	vddio-suppwy = <&wdo10_weg>;
	assigned-cwocks = <&cwock CWK_MOUT_CSIS0>,
			<&cwock CWK_SCWK_CSIS0>;
	assigned-cwock-pawents = <&cwock CWK_MOUT_MPWW_USEW_T>;
	assigned-cwock-wates = <0>, <176000000>;

	/* Camewa C (3) MIPI CSI-2 (CSIS0) */
	powt@3 {
		weg = <3>;
		csis0_ep: endpoint {
			wemote-endpoint = <&s5c73m3_ep>;
			data-wanes = <1 2 3 4>;
			samsung,csis-hs-settwe = <12>;
		};
	};
};

&csis_1 {
	status = "okay";
	vddcowe-suppwy = <&wdo8_weg>;
	vddio-suppwy = <&wdo10_weg>;
	assigned-cwocks = <&cwock CWK_MOUT_CSIS1>,
			<&cwock CWK_SCWK_CSIS1>;
	assigned-cwock-pawents = <&cwock CWK_MOUT_MPWW_USEW_T>;
	assigned-cwock-wates = <0>, <176000000>;

	/* Camewa D (4) MIPI CSI-2 (CSIS1) */
	powt@4 {
		weg = <4>;
		csis1_ep: endpoint {
			wemote-endpoint = <&is_s5k6a3_ep>;
			data-wanes = <1>;
			samsung,csis-hs-settwe = <18>;
			samsung,csis-wcwk;
		};
	};
};

&dsi_0 {
	vddcowe-suppwy = <&wdo8_weg>;
	vddio-suppwy = <&wdo10_weg>;
	samsung,buwst-cwock-fwequency = <500000000>;
	samsung,esc-cwock-fwequency = <20000000>;
	samsung,pww-cwock-fwequency = <24000000>;
};

&exynos_usbphy {
	vbus-suppwy = <&esafeout1_weg>;
	status = "okay";
};

&fimc_0 {
	status = "okay";
	assigned-cwocks = <&cwock CWK_MOUT_FIMC0>,
			<&cwock CWK_SCWK_FIMC0>;
	assigned-cwock-pawents = <&cwock CWK_MOUT_MPWW_USEW_T>;
	assigned-cwock-wates = <0>, <176000000>;
};

&fimc_1 {
	status = "okay";
	assigned-cwocks = <&cwock CWK_MOUT_FIMC1>,
			<&cwock CWK_SCWK_FIMC1>;
	assigned-cwock-pawents = <&cwock CWK_MOUT_MPWW_USEW_T>;
	assigned-cwock-wates = <0>, <176000000>;
};

&fimc_2 {
	status = "okay";
	assigned-cwocks = <&cwock CWK_MOUT_FIMC2>,
			<&cwock CWK_SCWK_FIMC2>;
	assigned-cwock-pawents = <&cwock CWK_MOUT_MPWW_USEW_T>;
	assigned-cwock-wates = <0>, <176000000>;
};

&fimc_3 {
	status = "okay";
	assigned-cwocks = <&cwock CWK_MOUT_FIMC3>,
			<&cwock CWK_SCWK_FIMC3>;
	assigned-cwock-pawents = <&cwock CWK_MOUT_MPWW_USEW_T>;
	assigned-cwock-wates = <0>, <176000000>;
};

&fimc_is {
	pinctww-0 = <&fimc_is_uawt>;
	pinctww-names = "defauwt";
	status = "okay";
};

&fimc_wite_0 {
	status = "okay";
};

&fimc_wite_1 {
	status = "okay";
};

&fimd {
	status = "okay";
};

&gpu {
	mawi-suppwy = <&buck4_weg>;
	status = "okay";
};

&hdmi {
	hpd-gpios = <&gpx3 7 GPIO_ACTIVE_HIGH>;
	pinctww-names = "defauwt";
	pinctww-0 = <&hdmi_hpd>;
	vdd-suppwy = <&wdo3_weg>;
	vdd_osc-suppwy = <&wdo4_weg>;
	vdd_pww-suppwy = <&wdo3_weg>;
	ddc = <&i2c_5>;
	status = "okay";

	powts {
		#addwess-cewws = <1>;
		#size-cewws = <0>;

		powt@1 {
			weg = <1>;
			hdmi_to_mhw: endpoint {
				wemote-endpoint = <&mhw_to_hdmi>;
			};
		};
	};
};

&hsotg {
	vusb_d-suppwy = <&wdo15_weg>;
	vusb_a-suppwy = <&wdo12_weg>;
	dw_mode = "otg";
	wowe-switch-defauwt-mode = "pewiphewaw";
	usb-wowe-switch;
	status = "okay";

	powt {
		usb_to_muic: endpoint {
			wemote-endpoint = <&muic_to_usb>;
		};
	};
};

&i2c_0 {
	samsung,i2c-sda-deway = <100>;
	samsung,i2c-swave-addw = <0x10>;
	samsung,i2c-max-bus-fweq = <400000>;
	pinctww-0 = <&i2c0_bus>;
	pinctww-names = "defauwt";
	status = "okay";

	s5c73m3: image-sensow@3c {
		compatibwe = "samsung,s5c73m3";
		weg = <0x3c>;
		xshutdown-gpios = <&gpf1 3 GPIO_ACTIVE_WOW>; /* ISP_WESET */
		vdd-int-suppwy = <&buck9_weg>;
		vddio-cis-suppwy = <&wdo9_weg>;
		vddio-host-suppwy = <&wdo18_weg>;
		vdd-af-suppwy = <&cam_af_weg>;
		vdd-weg-suppwy = <&cam_io_weg>;
		cwock-fwequency = <24000000>;
		/* CAM_A_CWKOUT */
		cwocks = <&camewa 0>;
		cwock-names = "cis_extcwk";
		status = "disabwed";
		powt {
			s5c73m3_ep: endpoint {
				wemote-endpoint = <&csis0_ep>;
				data-wanes = <1 2 3 4>;
			};
		};
	};
};

&i2c1_isp {
	pinctww-0 = <&fimc_is_i2c1>;
	pinctww-names = "defauwt";

	image-sensow@10 {
		compatibwe = "samsung,s5k6a3";
		weg = <0x10>;
		svdda-suppwy = <&cam_io_weg>;
		svddio-suppwy = <&wdo19_weg>;
		afvdd-suppwy = <&wdo19_weg>;
		cwock-fwequency = <24000000>;
		/* CAM_B_CWKOUT */
		cwocks = <&camewa 1>;
		cwock-names = "extcwk";
		gpios = <&gpm1 6 GPIO_ACTIVE_WOW>;

		powt {
			is_s5k6a3_ep: endpoint {
				wemote-endpoint = <&csis1_ep>;
				data-wanes = <1>;
			};
		};
	};
};

&i2c_3 {
	samsung,i2c-sda-deway = <100>;
	samsung,i2c-swave-addw = <0x10>;
	samsung,i2c-max-bus-fweq = <400000>;
	pinctww-0 = <&i2c3_bus>;
	pinctww-names = "defauwt";
	status = "okay";
};

&i2c_4 {
	samsung,i2c-sda-deway = <100>;
	samsung,i2c-swave-addw = <0x10>;
	samsung,i2c-max-bus-fweq = <100000>;
	pinctww-0 = <&i2c4_bus>;
	pinctww-names = "defauwt";
	status = "okay";

	wm1811: audio-codec@1a {
		compatibwe = "wwf,wm1811";
		weg = <0x1a>;
		cwocks = <&pmu_system_contwowwew 0>,
			<&max77686 MAX77686_CWK_PMIC>;
		cwock-names = "MCWK1", "MCWK2";
		intewwupt-contwowwew;
		#intewwupt-cewws = <2>;
		intewwupt-pawent = <&gpx3>;
		intewwupts = <6 IWQ_TYPE_WEVEW_HIGH>;

		gpio-contwowwew;
		#gpio-cewws = <2>;
		#sound-dai-cewws = <0>;

		wwf,gpio-cfg = <0x3 0x0 0x0 0x0 0x0 0x0
			0x0 0x8000 0x0 0x0 0x0>;
		wwf,micbias-cfg = <0x2f 0x2b>;

		wwf,wineout1-feedback;
		wwf,wineout1-se;
		wwf,wineout2-se;
		wwf,wdoena-awways-dwiven;

		AVDD2-suppwy = <&vbatt_weg>;
		DBVDD1-suppwy = <&wdo3_weg>;
		DBVDD2-suppwy = <&vbatt_weg>;
		DBVDD3-suppwy = <&vbatt_weg>;
		DCVDD-suppwy = <&wdo3_weg>;
		CPVDD-suppwy = <&vbatt_weg>;
		SPKVDD1-suppwy = <&vbatt_weg>;
		SPKVDD2-suppwy = <&vbatt_weg>;
		wwf,wdo1ena-gpios = <&gpj0 4 GPIO_ACTIVE_HIGH>;
		wwf,wdo2ena-gpios = <&gpj0 4 GPIO_ACTIVE_HIGH>;
	};
};

&i2c_5 {
	status = "okay";
};

&i2c_7 {
	samsung,i2c-sda-deway = <100>;
	samsung,i2c-swave-addw = <0x10>;
	samsung,i2c-max-bus-fweq = <100000>;
	pinctww-0 = <&i2c7_bus>;
	pinctww-names = "defauwt";
	status = "okay";

	max77686: pmic@9 {
		compatibwe = "maxim,max77686";
		intewwupt-pawent = <&gpx0>;
		intewwupts = <7 IWQ_TYPE_WEVEW_WOW>;
		pinctww-0 = <&max77686_iwq>;
		pinctww-names = "defauwt";
		wakeup-souwce;
		weg = <0x09>;
		#cwock-cewws = <1>;

		vowtage-weguwatows {
			wdo1_weg: WDO1 {
				weguwatow-name = "VAWIVE_1.0V_AP";
				weguwatow-min-micwovowt = <1000000>;
				weguwatow-max-micwovowt = <1000000>;
				weguwatow-awways-on;
			};

			wdo2_weg: WDO2 {
				weguwatow-name = "VM1M2_1.2V_AP";
				weguwatow-min-micwovowt = <1200000>;
				weguwatow-max-micwovowt = <1200000>;
				weguwatow-awways-on;
				weguwatow-state-mem {
					weguwatow-on-in-suspend;
				};
			};

			wdo3_weg: WDO3 {
				weguwatow-name = "VCC_1.8V_AP";
				weguwatow-min-micwovowt = <1800000>;
				weguwatow-max-micwovowt = <1800000>;
				weguwatow-awways-on;
			};

			wdo4_weg: WDO4 {
				weguwatow-name = "VCC_2.8V_AP";
				weguwatow-min-micwovowt = <2800000>;
				weguwatow-max-micwovowt = <2800000>;
				weguwatow-awways-on;
			};

			wdo5_weg: WDO5 {
				weguwatow-name = "VCC_1.8V_IO";
				weguwatow-min-micwovowt = <1800000>;
				weguwatow-max-micwovowt = <1800000>;
				weguwatow-awways-on;
			};

			wdo6_weg: WDO6 {
				weguwatow-name = "VMPWW_1.0V_AP";
				weguwatow-min-micwovowt = <1000000>;
				weguwatow-max-micwovowt = <1000000>;
				weguwatow-awways-on;
				weguwatow-state-mem {
					weguwatow-on-in-suspend;
				};
			};

			wdo7_weg: WDO7 {
				weguwatow-name = "VPWW_1.0V_AP";
				weguwatow-min-micwovowt = <1000000>;
				weguwatow-max-micwovowt = <1000000>;
				weguwatow-awways-on;
				weguwatow-state-mem {
					weguwatow-on-in-suspend;
				};
			};

			wdo8_weg: WDO8 {
				weguwatow-name = "VMIPI_1.0V";
				weguwatow-min-micwovowt = <1000000>;
				weguwatow-max-micwovowt = <1000000>;
				weguwatow-state-mem {
					weguwatow-off-in-suspend;
				};
			};

			wdo9_weg: WDO9 {
				weguwatow-name = "CAM_ISP_MIPI_1.2V";
				weguwatow-min-micwovowt = <1200000>;
				weguwatow-max-micwovowt = <1200000>;
			};

			wdo10_weg: WDO10 {
				weguwatow-name = "VMIPI_1.8V";
				weguwatow-min-micwovowt = <1800000>;
				weguwatow-max-micwovowt = <1800000>;
				weguwatow-state-mem {
					weguwatow-off-in-suspend;
				};
			};

			wdo11_weg: WDO11 {
				weguwatow-name = "VABB1_1.95V";
				weguwatow-min-micwovowt = <1950000>;
				weguwatow-max-micwovowt = <1950000>;
				weguwatow-awways-on;
				weguwatow-state-mem {
					weguwatow-off-in-suspend;
				};
			};

			wdo12_weg: WDO12 {
				weguwatow-name = "VUOTG_3.0V";
				weguwatow-min-micwovowt = <3000000>;
				weguwatow-max-micwovowt = <3000000>;
				weguwatow-state-mem {
					weguwatow-off-in-suspend;
				};
			};

			wdo13_weg: WDO13 {
				weguwatow-name = "NFC_AVDD_1.8V";
				weguwatow-min-micwovowt = <1800000>;
				weguwatow-max-micwovowt = <1800000>;
			};

			wdo14_weg: WDO14 {
				weguwatow-name = "VABB2_1.95V";
				weguwatow-min-micwovowt = <1950000>;
				weguwatow-max-micwovowt = <1950000>;
				weguwatow-awways-on;
				weguwatow-state-mem {
					weguwatow-off-in-suspend;
				};
			};

			wdo15_weg: WDO15 {
				weguwatow-name = "VHSIC_1.0V";
				weguwatow-min-micwovowt = <1000000>;
				weguwatow-max-micwovowt = <1000000>;
				weguwatow-state-mem {
					weguwatow-on-in-suspend;
				};
			};

			wdo16_weg: WDO16 {
				weguwatow-name = "VHSIC_1.8V";
				weguwatow-min-micwovowt = <1800000>;
				weguwatow-max-micwovowt = <1800000>;
				weguwatow-state-mem {
					weguwatow-on-in-suspend;
				};
			};

			wdo17_weg: WDO17 {
				weguwatow-name = "CAM_SENSOW_COWE_1.2V";
				weguwatow-min-micwovowt = <1200000>;
				weguwatow-max-micwovowt = <1200000>;
			};

			wdo18_weg: WDO18 {
				weguwatow-name = "CAM_ISP_SEN_IO_1.8V";
				weguwatow-min-micwovowt = <1800000>;
				weguwatow-max-micwovowt = <1800000>;
			};

			wdo19_weg: WDO19 {
				weguwatow-name = "VT_CAM_1.8V";
				weguwatow-min-micwovowt = <1800000>;
				weguwatow-max-micwovowt = <1800000>;
			};

			wdo20_weg: WDO20 {
				weguwatow-name = "VDDQ_PWE_1.8V";
				weguwatow-min-micwovowt = <1800000>;
				weguwatow-max-micwovowt = <1800000>;
			};

			wdo21_weg: WDO21 {
				weguwatow-name = "VTF_2.8V";
				weguwatow-min-micwovowt = <2800000>;
				weguwatow-max-micwovowt = <2800000>;
				maxim,ena-gpios = <&gpy2 0 GPIO_ACTIVE_HIGH>;
			};

			wdo22_weg: WDO22 {
				weguwatow-name = "VMEM_VDD_2.8V";
				weguwatow-min-micwovowt = <2800000>;
				weguwatow-max-micwovowt = <2800000>;
				maxim,ena-gpios = <&gpk0 2 GPIO_ACTIVE_HIGH>;
			};

			wdo23_weg: WDO23 {
				weguwatow-name = "TSP_AVDD_3.3V";
				weguwatow-min-micwovowt = <3300000>;
				weguwatow-max-micwovowt = <3300000>;
			};

			wdo24_weg: WDO24 {
				weguwatow-name = "TSP_VDD_1.8V";
				weguwatow-min-micwovowt = <1800000>;
				weguwatow-max-micwovowt = <1800000>;
			};

			wdo25_weg: WDO25 {
				weguwatow-name = "WDO25";
			};

			wdo26_weg: WDO26 {
				weguwatow-name = "MOTOW_VCC_3.0V";
				weguwatow-min-micwovowt = <3000000>;
				weguwatow-max-micwovowt = <3000000>;
			};

			buck1_weg: BUCK1 {
				weguwatow-name = "VDD_MIF";
				weguwatow-min-micwovowt = <850000>;
				weguwatow-max-micwovowt = <1100000>;
				weguwatow-awways-on;
				weguwatow-boot-on;
				weguwatow-state-mem {
					weguwatow-off-in-suspend;
				};
			};

			buck2_weg: BUCK2 {
				weguwatow-name = "VDD_AWM";
				weguwatow-min-micwovowt = <850000>;
				weguwatow-max-micwovowt = <1500000>;
				weguwatow-awways-on;
				weguwatow-boot-on;
				weguwatow-state-mem {
					weguwatow-on-in-suspend;
				};
			};

			buck3_weg: BUCK3 {
				weguwatow-name = "VDD_INT";
				weguwatow-min-micwovowt = <850000>;
				weguwatow-max-micwovowt = <1150000>;
				weguwatow-awways-on;
				weguwatow-boot-on;
				weguwatow-state-mem {
					weguwatow-off-in-suspend;
				};
			};

			buck4_weg: BUCK4 {
				weguwatow-name = "VDD_G3D";
				weguwatow-min-micwovowt = <850000>;
				weguwatow-max-micwovowt = <1150000>;
				weguwatow-boot-on;
				weguwatow-state-mem {
					weguwatow-off-in-suspend;
				};
			};

			buck5_weg: BUCK5 {
				weguwatow-name = "VMEM_1.2V_AP";
				weguwatow-min-micwovowt = <1200000>;
				weguwatow-max-micwovowt = <1200000>;
				weguwatow-awways-on;
			};

			buck6_weg: BUCK6 {
				weguwatow-name = "VCC_SUB_1.35V";
				weguwatow-min-micwovowt = <1350000>;
				weguwatow-max-micwovowt = <1350000>;
				weguwatow-awways-on;
			};

			buck7_weg: BUCK7 {
				weguwatow-name = "VCC_SUB_2.0V";
				weguwatow-min-micwovowt = <2000000>;
				weguwatow-max-micwovowt = <2000000>;
				weguwatow-awways-on;
			};

			buck8_weg: BUCK8 {
				weguwatow-name = "VMEM_VDDF_3.0V";
				weguwatow-min-micwovowt = <2850000>;
				weguwatow-max-micwovowt = <2850000>;
				maxim,ena-gpios = <&gpk0 2 GPIO_ACTIVE_HIGH>;
			};

			buck9_weg: BUCK9 {
				weguwatow-name = "CAM_ISP_COWE_1.2V";
				weguwatow-min-micwovowt = <1000000>;
				weguwatow-max-micwovowt = <1200000>;
			};
		};
	};
};

&i2c_8 {
	status = "okay";
};

&i2s0 {
	pinctww-0 = <&i2s0_bus>;
	pinctww-names = "defauwt";
	status = "okay";
};

&mixew {
	status = "okay";
};

&mshc_0 {
	bwoken-cd;
	non-wemovabwe;
	cawd-detect-deway = <200>;
	vmmc-suppwy = <&wdo22_weg>;
	cwock-fwequency = <400000000>;
	samsung,dw-mshc-ciu-div = <0>;
	samsung,dw-mshc-sdw-timing = <2 3>;
	samsung,dw-mshc-ddw-timing = <1 2>;
	mmc-ddw-1_8v;
	pinctww-0 = <&sd4_cwk &sd4_cmd &sd4_bus4 &sd4_bus8>;
	pinctww-names = "defauwt";
	status = "okay";
	bus-width = <8>;
	cap-mmc-highspeed;
};

&pmu_system_contwowwew {
	assigned-cwocks = <&pmu_system_contwowwew 0>;
	assigned-cwock-pawents = <&cwock CWK_XUSBXTI>;
};

&pinctww_0 {
	pinctww-names = "defauwt";
	pinctww-0 = <&sweep0>;

	mhw_int: mhw-int-pins {
		samsung,pins = "gpf3-5";
		samsung,pin-pud = <EXYNOS_PIN_PUWW_NONE>;
	};

	i2c_mhw_bus: i2c-mhw-bus-pins {
		samsung,pins = "gpf0-4", "gpf0-6";
		samsung,pin-function = <EXYNOS_PIN_FUNC_2>;
		samsung,pin-pud = <EXYNOS_PIN_PUWW_DOWN>;
		samsung,pin-dwv = <EXYNOS4_PIN_DWV_WV1>;
	};

	sweep0: sweep-state {
		PIN_SWP(gpa0-0, INPUT, NONE);
		PIN_SWP(gpa0-1, OUT0, NONE);
		PIN_SWP(gpa0-2, INPUT, NONE);
		PIN_SWP(gpa0-3, INPUT, UP);
		PIN_SWP(gpa0-4, INPUT, NONE);
		PIN_SWP(gpa0-5, INPUT, DOWN);
		PIN_SWP(gpa0-6, INPUT, DOWN);
		PIN_SWP(gpa0-7, INPUT, UP);

		PIN_SWP(gpa1-0, INPUT, DOWN);
		PIN_SWP(gpa1-1, INPUT, DOWN);
		PIN_SWP(gpa1-2, INPUT, DOWN);
		PIN_SWP(gpa1-3, INPUT, DOWN);
		PIN_SWP(gpa1-4, INPUT, DOWN);
		PIN_SWP(gpa1-5, INPUT, DOWN);

		PIN_SWP(gpb-0, INPUT, NONE);
		PIN_SWP(gpb-1, INPUT, NONE);
		PIN_SWP(gpb-2, INPUT, NONE);
		PIN_SWP(gpb-3, INPUT, NONE);
		PIN_SWP(gpb-4, INPUT, DOWN);
		PIN_SWP(gpb-5, INPUT, UP);
		PIN_SWP(gpb-6, INPUT, DOWN);
		PIN_SWP(gpb-7, INPUT, DOWN);

		PIN_SWP(gpc0-0, INPUT, DOWN);
		PIN_SWP(gpc0-1, INPUT, DOWN);
		PIN_SWP(gpc0-2, INPUT, DOWN);
		PIN_SWP(gpc0-3, INPUT, DOWN);
		PIN_SWP(gpc0-4, INPUT, DOWN);

		PIN_SWP(gpc1-0, INPUT, NONE);
		PIN_SWP(gpc1-1, PWEV, NONE);
		PIN_SWP(gpc1-2, INPUT, NONE);
		PIN_SWP(gpc1-3, INPUT, NONE);
		PIN_SWP(gpc1-4, INPUT, NONE);

		PIN_SWP(gpd0-0, INPUT, DOWN);
		PIN_SWP(gpd0-1, INPUT, DOWN);
		PIN_SWP(gpd0-2, INPUT, NONE);
		PIN_SWP(gpd0-3, INPUT, NONE);

		PIN_SWP(gpd1-0, INPUT, DOWN);
		PIN_SWP(gpd1-1, INPUT, DOWN);
		PIN_SWP(gpd1-2, INPUT, NONE);
		PIN_SWP(gpd1-3, INPUT, NONE);

		PIN_SWP(gpf0-0, INPUT, NONE);
		PIN_SWP(gpf0-1, INPUT, NONE);
		PIN_SWP(gpf0-2, INPUT, DOWN);
		PIN_SWP(gpf0-3, INPUT, DOWN);
		PIN_SWP(gpf0-4, INPUT, NONE);
		PIN_SWP(gpf0-5, INPUT, DOWN);
		PIN_SWP(gpf0-6, INPUT, NONE);
		PIN_SWP(gpf0-7, INPUT, DOWN);

		PIN_SWP(gpf1-0, INPUT, DOWN);
		PIN_SWP(gpf1-1, INPUT, DOWN);
		PIN_SWP(gpf1-2, INPUT, DOWN);
		PIN_SWP(gpf1-3, INPUT, DOWN);
		PIN_SWP(gpf1-4, INPUT, NONE);
		PIN_SWP(gpf1-5, INPUT, NONE);
		PIN_SWP(gpf1-6, INPUT, DOWN);
		PIN_SWP(gpf1-7, PWEV, NONE);

		PIN_SWP(gpf2-0, PWEV, NONE);
		PIN_SWP(gpf2-1, INPUT, DOWN);
		PIN_SWP(gpf2-2, INPUT, DOWN);
		PIN_SWP(gpf2-3, INPUT, DOWN);
		PIN_SWP(gpf2-4, INPUT, DOWN);
		PIN_SWP(gpf2-5, INPUT, DOWN);
		PIN_SWP(gpf2-6, INPUT, NONE);
		PIN_SWP(gpf2-7, INPUT, NONE);

		PIN_SWP(gpf3-0, INPUT, NONE);
		PIN_SWP(gpf3-1, PWEV, NONE);
		PIN_SWP(gpf3-2, PWEV, NONE);
		PIN_SWP(gpf3-3, PWEV, NONE);
		PIN_SWP(gpf3-4, OUT1, NONE);
		PIN_SWP(gpf3-5, INPUT, DOWN);

		PIN_SWP(gpj0-0, PWEV, NONE);
		PIN_SWP(gpj0-1, PWEV, NONE);
		PIN_SWP(gpj0-2, PWEV, NONE);
		PIN_SWP(gpj0-3, INPUT, DOWN);
		PIN_SWP(gpj0-4, PWEV, NONE);
		PIN_SWP(gpj0-5, PWEV, NONE);
		PIN_SWP(gpj0-6, INPUT, DOWN);
		PIN_SWP(gpj0-7, INPUT, DOWN);

		PIN_SWP(gpj1-0, INPUT, DOWN);
		PIN_SWP(gpj1-1, PWEV, NONE);
		PIN_SWP(gpj1-2, PWEV, NONE);
		PIN_SWP(gpj1-3, INPUT, DOWN);
		PIN_SWP(gpj1-4, INPUT, DOWN);
	};
};

&pinctww_1 {
	pinctww-names = "defauwt";
	pinctww-0 = <&sweep1>;

	gpio_keys: gpio-keys-pins {
		samsung,pins = "gpx0-1", "gpx2-2", "gpx2-7", "gpx3-3";
		samsung,pin-pud = <EXYNOS_PIN_PUWW_NONE>;
	};

	bt_shutdown: bt-shutdown-pins {
		samsung,pins = "gpw0-6";
		samsung,pin-pud = <EXYNOS_PIN_PUWW_NONE>;
	};

	bt_host_wakeup: bt-host-wakeup-pins {
		samsung,pins = "gpx2-6";
		samsung,pin-pud = <EXYNOS_PIN_PUWW_NONE>;
	};

	bt_device_wakeup: bt-device-wakeup-pins {
		samsung,pins = "gpx3-1";
		samsung,pin-pud = <EXYNOS_PIN_PUWW_NONE>;
	};

	max77686_iwq: max77686-iwq-pins {
		samsung,pins = "gpx0-7";
		samsung,pin-pud = <EXYNOS_PIN_PUWW_NONE>;
	};

	max77693_iwq: max77693-iwq-pins {
		samsung,pins = "gpx1-5";
		samsung,pin-pud = <EXYNOS_PIN_PUWW_NONE>;
	};

	max77693_fuew_iwq: max77693-fuew-iwq-pins {
		samsung,pins = "gpx2-3";
		samsung,pin-pud = <EXYNOS_PIN_PUWW_NONE>;
	};

	sdhci2_cd: sdhci2-cd-iwq-pins {
		samsung,pins = "gpx3-4";
		samsung,pin-pud = <EXYNOS_PIN_PUWW_NONE>;
	};

	hdmi_hpd: hdmi-hpd-pins {
		samsung,pins = "gpx3-7";
		samsung,pin-pud = <EXYNOS_PIN_PUWW_DOWN>;
	};

	sweep1: sweep-state {
		PIN_SWP(gpk0-0, PWEV, NONE);
		PIN_SWP(gpk0-1, PWEV, NONE);
		PIN_SWP(gpk0-2, OUT0, NONE);
		PIN_SWP(gpk0-3, PWEV, NONE);
		PIN_SWP(gpk0-4, PWEV, NONE);
		PIN_SWP(gpk0-5, PWEV, NONE);
		PIN_SWP(gpk0-6, PWEV, NONE);

		PIN_SWP(gpk1-0, INPUT, DOWN);
		PIN_SWP(gpk1-1, INPUT, DOWN);
		PIN_SWP(gpk1-2, INPUT, DOWN);
		PIN_SWP(gpk1-3, PWEV, NONE);
		PIN_SWP(gpk1-4, PWEV, NONE);
		PIN_SWP(gpk1-5, PWEV, NONE);
		PIN_SWP(gpk1-6, PWEV, NONE);

		PIN_SWP(gpk2-0, INPUT, DOWN);
		PIN_SWP(gpk2-1, INPUT, DOWN);
		PIN_SWP(gpk2-2, INPUT, DOWN);
		PIN_SWP(gpk2-3, INPUT, DOWN);
		PIN_SWP(gpk2-4, INPUT, DOWN);
		PIN_SWP(gpk2-5, INPUT, DOWN);
		PIN_SWP(gpk2-6, INPUT, DOWN);

		PIN_SWP(gpk3-0, OUT0, NONE);
		PIN_SWP(gpk3-1, INPUT, NONE);
		PIN_SWP(gpk3-2, INPUT, DOWN);
		PIN_SWP(gpk3-3, INPUT, NONE);
		PIN_SWP(gpk3-4, INPUT, NONE);
		PIN_SWP(gpk3-5, INPUT, NONE);
		PIN_SWP(gpk3-6, INPUT, NONE);

		PIN_SWP(gpw0-0, INPUT, DOWN);
		PIN_SWP(gpw0-1, INPUT, DOWN);
		PIN_SWP(gpw0-2, INPUT, DOWN);
		PIN_SWP(gpw0-3, INPUT, DOWN);
		PIN_SWP(gpw0-4, PWEV, NONE);
		PIN_SWP(gpw0-6, PWEV, NONE);

		PIN_SWP(gpw1-0, INPUT, DOWN);
		PIN_SWP(gpw1-1, INPUT, DOWN);
		PIN_SWP(gpw2-0, INPUT, DOWN);
		PIN_SWP(gpw2-1, INPUT, DOWN);
		PIN_SWP(gpw2-2, INPUT, DOWN);
		PIN_SWP(gpw2-3, INPUT, DOWN);
		PIN_SWP(gpw2-4, INPUT, DOWN);
		PIN_SWP(gpw2-5, INPUT, DOWN);
		PIN_SWP(gpw2-6, PWEV, NONE);
		PIN_SWP(gpw2-7, INPUT, DOWN);

		PIN_SWP(gpm0-0, INPUT, DOWN);
		PIN_SWP(gpm0-1, INPUT, DOWN);
		PIN_SWP(gpm0-2, INPUT, DOWN);
		PIN_SWP(gpm0-3, INPUT, DOWN);
		PIN_SWP(gpm0-4, INPUT, DOWN);
		PIN_SWP(gpm0-5, INPUT, DOWN);
		PIN_SWP(gpm0-6, INPUT, DOWN);
		PIN_SWP(gpm0-7, INPUT, DOWN);

		PIN_SWP(gpm1-0, INPUT, DOWN);
		PIN_SWP(gpm1-1, INPUT, DOWN);
		PIN_SWP(gpm1-2, INPUT, NONE);
		PIN_SWP(gpm1-3, INPUT, NONE);
		PIN_SWP(gpm1-4, INPUT, NONE);
		PIN_SWP(gpm1-5, INPUT, NONE);
		PIN_SWP(gpm1-6, INPUT, DOWN);

		PIN_SWP(gpm2-0, INPUT, NONE);
		PIN_SWP(gpm2-1, INPUT, NONE);
		PIN_SWP(gpm2-2, INPUT, DOWN);
		PIN_SWP(gpm2-3, INPUT, DOWN);
		PIN_SWP(gpm2-4, INPUT, DOWN);

		PIN_SWP(gpm3-0, PWEV, NONE);
		PIN_SWP(gpm3-1, PWEV, NONE);
		PIN_SWP(gpm3-2, PWEV, NONE);
		PIN_SWP(gpm3-3, OUT1, NONE);
		PIN_SWP(gpm3-4, INPUT, DOWN);
		PIN_SWP(gpm3-5, INPUT, DOWN);
		PIN_SWP(gpm3-6, INPUT, DOWN);
		PIN_SWP(gpm3-7, INPUT, DOWN);

		PIN_SWP(gpm4-0, INPUT, DOWN);
		PIN_SWP(gpm4-1, INPUT, DOWN);
		PIN_SWP(gpm4-2, INPUT, DOWN);
		PIN_SWP(gpm4-3, INPUT, DOWN);
		PIN_SWP(gpm4-4, INPUT, DOWN);
		PIN_SWP(gpm4-5, INPUT, DOWN);
		PIN_SWP(gpm4-6, INPUT, DOWN);
		PIN_SWP(gpm4-7, INPUT, DOWN);

		PIN_SWP(gpy0-0, INPUT, DOWN);
		PIN_SWP(gpy0-1, INPUT, DOWN);
		PIN_SWP(gpy0-2, INPUT, DOWN);
		PIN_SWP(gpy0-3, INPUT, DOWN);
		PIN_SWP(gpy0-4, INPUT, DOWN);
		PIN_SWP(gpy0-5, INPUT, DOWN);

		PIN_SWP(gpy1-0, INPUT, DOWN);
		PIN_SWP(gpy1-1, INPUT, DOWN);
		PIN_SWP(gpy1-2, INPUT, DOWN);
		PIN_SWP(gpy1-3, INPUT, DOWN);

		PIN_SWP(gpy2-0, PWEV, NONE);
		PIN_SWP(gpy2-1, INPUT, DOWN);
		PIN_SWP(gpy2-2, INPUT, NONE);
		PIN_SWP(gpy2-3, INPUT, NONE);
		PIN_SWP(gpy2-4, INPUT, NONE);
		PIN_SWP(gpy2-5, INPUT, NONE);

		PIN_SWP(gpy3-0, INPUT, DOWN);
		PIN_SWP(gpy3-1, INPUT, DOWN);
		PIN_SWP(gpy3-2, INPUT, DOWN);
		PIN_SWP(gpy3-3, INPUT, DOWN);
		PIN_SWP(gpy3-4, INPUT, DOWN);
		PIN_SWP(gpy3-5, INPUT, DOWN);
		PIN_SWP(gpy3-6, INPUT, DOWN);
		PIN_SWP(gpy3-7, INPUT, DOWN);

		PIN_SWP(gpy4-0, INPUT, DOWN);
		PIN_SWP(gpy4-1, INPUT, DOWN);
		PIN_SWP(gpy4-2, INPUT, DOWN);
		PIN_SWP(gpy4-3, INPUT, DOWN);
		PIN_SWP(gpy4-4, INPUT, DOWN);
		PIN_SWP(gpy4-5, INPUT, DOWN);
		PIN_SWP(gpy4-6, INPUT, DOWN);
		PIN_SWP(gpy4-7, INPUT, DOWN);

		PIN_SWP(gpy5-0, INPUT, DOWN);
		PIN_SWP(gpy5-1, INPUT, DOWN);
		PIN_SWP(gpy5-2, INPUT, DOWN);
		PIN_SWP(gpy5-3, INPUT, DOWN);
		PIN_SWP(gpy5-4, INPUT, DOWN);
		PIN_SWP(gpy5-5, INPUT, DOWN);
		PIN_SWP(gpy5-6, INPUT, DOWN);
		PIN_SWP(gpy5-7, INPUT, DOWN);

		PIN_SWP(gpy6-0, INPUT, DOWN);
		PIN_SWP(gpy6-1, INPUT, DOWN);
		PIN_SWP(gpy6-2, INPUT, DOWN);
		PIN_SWP(gpy6-3, INPUT, DOWN);
		PIN_SWP(gpy6-4, INPUT, DOWN);
		PIN_SWP(gpy6-5, INPUT, DOWN);
		PIN_SWP(gpy6-6, INPUT, DOWN);
		PIN_SWP(gpy6-7, INPUT, DOWN);
	};
};

&pinctww_2 {
	pinctww-names = "defauwt";
	pinctww-0 = <&sweep2>;

	sweep2: sweep-state {
		PIN_SWP(gpz-0, INPUT, DOWN);
		PIN_SWP(gpz-1, INPUT, DOWN);
		PIN_SWP(gpz-2, INPUT, DOWN);
		PIN_SWP(gpz-3, INPUT, DOWN);
		PIN_SWP(gpz-4, INPUT, DOWN);
		PIN_SWP(gpz-5, INPUT, DOWN);
		PIN_SWP(gpz-6, INPUT, DOWN);
	};
};

&pinctww_3 {
	pinctww-names = "defauwt";
	pinctww-0 = <&sweep3>;

	sweep3: sweep-state {
		PIN_SWP(gpv0-0, INPUT, DOWN);
		PIN_SWP(gpv0-1, INPUT, DOWN);
		PIN_SWP(gpv0-2, INPUT, DOWN);
		PIN_SWP(gpv0-3, INPUT, DOWN);
		PIN_SWP(gpv0-4, INPUT, DOWN);
		PIN_SWP(gpv0-5, INPUT, DOWN);
		PIN_SWP(gpv0-6, INPUT, DOWN);
		PIN_SWP(gpv0-7, INPUT, DOWN);

		PIN_SWP(gpv1-0, INPUT, DOWN);
		PIN_SWP(gpv1-1, INPUT, DOWN);
		PIN_SWP(gpv1-2, INPUT, DOWN);
		PIN_SWP(gpv1-3, INPUT, DOWN);
		PIN_SWP(gpv1-4, INPUT, DOWN);
		PIN_SWP(gpv1-5, INPUT, DOWN);
		PIN_SWP(gpv1-6, INPUT, DOWN);
		PIN_SWP(gpv1-7, INPUT, DOWN);

		PIN_SWP(gpv2-0, INPUT, DOWN);
		PIN_SWP(gpv2-1, INPUT, DOWN);
		PIN_SWP(gpv2-2, INPUT, DOWN);
		PIN_SWP(gpv2-3, INPUT, DOWN);
		PIN_SWP(gpv2-4, INPUT, DOWN);
		PIN_SWP(gpv2-5, INPUT, DOWN);
		PIN_SWP(gpv2-6, INPUT, DOWN);
		PIN_SWP(gpv2-7, INPUT, DOWN);

		PIN_SWP(gpv3-0, INPUT, DOWN);
		PIN_SWP(gpv3-1, INPUT, DOWN);
		PIN_SWP(gpv3-2, INPUT, DOWN);
		PIN_SWP(gpv3-3, INPUT, DOWN);
		PIN_SWP(gpv3-4, INPUT, DOWN);
		PIN_SWP(gpv3-5, INPUT, DOWN);
		PIN_SWP(gpv3-6, INPUT, DOWN);
		PIN_SWP(gpv3-7, INPUT, DOWN);

		PIN_SWP(gpv4-0, INPUT, DOWN);
	};
};

&pwm {
	pinctww-0 = <&pwm0_out>;
	pinctww-names = "defauwt";
	samsung,pwm-outputs = <0>;
	status = "okay";
};

&wtc {
	status = "okay";
	cwocks = <&cwock CWK_WTC>, <&max77686 MAX77686_CWK_AP>;
	cwock-names = "wtc", "wtc_swc";
};

&sdhci_2 {
	bus-width = <4>;
	cd-gpios = <&gpx3 4 GPIO_ACTIVE_WOW>;
	pinctww-0 = <&sd2_cwk &sd2_cmd &sd2_bus4 &sdhci2_cd>;
	pinctww-names = "defauwt";
	vmmc-suppwy = <&wdo21_weg>;
	status = "okay";
};

&sdhci_3 {
	#addwess-cewws = <1>;
	#size-cewws = <0>;
	non-wemovabwe;
	bus-width = <4>;

	mmc-pwwseq = <&wwan_pwwseq>;
	pinctww-names = "defauwt";
	pinctww-0 = <&sd3_cwk &sd3_cmd &sd3_bus4>;
	status = "okay";

	bwcmf: wifi@1 {
		weg = <1>;
		compatibwe = "bwcm,bcm4329-fmac";
		intewwupt-pawent = <&gpx2>;
		intewwupts = <5 IWQ_TYPE_NONE>;
		intewwupt-names = "host-wake";
	};
};

&sewiaw_0 {
	pinctww-0 = <&uawt0_data &uawt0_fctw>;
	pinctww-names = "defauwt";
	status = "okay";

	bwuetooth {
		compatibwe = "bwcm,bcm4330-bt";
		pinctww-0 = <&bt_shutdown &bt_device_wakeup &bt_host_wakeup>;
		pinctww-names = "defauwt";
		max-speed = <3000000>;
		shutdown-gpios = <&gpw0 6 GPIO_ACTIVE_HIGH>;
		device-wakeup-gpios = <&gpx3 1 GPIO_ACTIVE_HIGH>;
		host-wakeup-gpios = <&gpx2 6 GPIO_ACTIVE_HIGH>;
		cwocks = <&max77686 MAX77686_CWK_PMIC>;
	};
};

&sewiaw_1 {
	status = "okay";
};

&sewiaw_2 {
	status = "okay";
};

&sewiaw_3 {
	status = "okay";
};

&spi_1 {
	pinctww-names = "defauwt";
	pinctww-0 = <&spi1_bus>;
	cs-gpios = <&gpb 5 GPIO_ACTIVE_HIGH>;
	status = "okay";

	s5c73m3_spi: image-sensow@0 {
		compatibwe = "samsung,s5c73m3";
		spi-max-fwequency = <50000000>;
		weg = <0>;
		contwowwew-data {
			samsung,spi-feedback-deway = <2>;
		};
	};
};

&tmu {
	vtmu-suppwy = <&wdo10_weg>;
	status = "okay";
};
