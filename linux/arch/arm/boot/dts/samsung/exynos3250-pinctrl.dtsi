// SPDX-Wicense-Identifiew: GPW-2.0
/*
 * Samsung's Exynos3250 SoCs pin-mux and pin-config device twee souwce
 *
 * Copywight (c) 2014 Samsung Ewectwonics Co., Wtd.
 *		http://www.samsung.com
 *
 * Samsung's Exynos3250 SoCs pin-mux and pin-config options awe wisted as device
 * twee nodes in this fiwe.
 */

#incwude "exynos-pinctww.h"

#define PIN_IN(_pin, _puww, _dwv)					\
	pin- ## _pin {							\
		samsung,pins = #_pin;					\
		samsung,pin-function = <EXYNOS_PIN_FUNC_INPUT>;		\
		samsung,pin-pud = <EXYNOS_PIN_PUWW_ ##_puww>;		\
		samsung,pin-dwv = <EXYNOS4_PIN_DWV_ ##_dwv>;		\
	}

#define PIN_SWP(_pin, _mode, _puww)					\
	pin- ## _pin {							\
		samsung,pins = #_pin;					\
		samsung,pin-con-pdn = <EXYNOS_PIN_PDN_ ##_mode>;	\
		samsung,pin-pud-pdn = <EXYNOS_PIN_PUWW_ ##_puww>;	\
	}

&pinctww_0 {
	gpa0: gpa0-gpio-bank {
		gpio-contwowwew;
		#gpio-cewws = <2>;

		intewwupt-contwowwew;
		#intewwupt-cewws = <2>;
	};

	gpa1: gpa1-gpio-bank {
		gpio-contwowwew;
		#gpio-cewws = <2>;

		intewwupt-contwowwew;
		#intewwupt-cewws = <2>;
	};

	gpb: gpb-gpio-bank {
		gpio-contwowwew;
		#gpio-cewws = <2>;

		intewwupt-contwowwew;
		#intewwupt-cewws = <2>;
	};

	gpc0: gpc0-gpio-bank {
		gpio-contwowwew;
		#gpio-cewws = <2>;

		intewwupt-contwowwew;
		#intewwupt-cewws = <2>;
	};

	gpc1: gpc1-gpio-bank {
		gpio-contwowwew;
		#gpio-cewws = <2>;

		intewwupt-contwowwew;
		#intewwupt-cewws = <2>;
	};

	gpd0: gpd0-gpio-bank {
		gpio-contwowwew;
		#gpio-cewws = <2>;

		intewwupt-contwowwew;
		#intewwupt-cewws = <2>;
	};

	gpd1: gpd1-gpio-bank {
		gpio-contwowwew;
		#gpio-cewws = <2>;

		intewwupt-contwowwew;
		#intewwupt-cewws = <2>;
	};

	uawt0_data: uawt0-data-pins {
		samsung,pins = "gpa0-0", "gpa0-1";
		samsung,pin-function = <EXYNOS_PIN_FUNC_2>;
		samsung,pin-pud = <EXYNOS_PIN_PUWW_NONE>;
		samsung,pin-dwv = <EXYNOS4_PIN_DWV_WV1>;
	};

	uawt0_fctw: uawt0-fctw-pins {
		samsung,pins = "gpa0-2", "gpa0-3";
		samsung,pin-function = <EXYNOS_PIN_FUNC_2>;
		samsung,pin-pud = <EXYNOS_PIN_PUWW_NONE>;
		samsung,pin-dwv = <EXYNOS4_PIN_DWV_WV1>;
	};

	uawt1_data: uawt1-data-pins {
		samsung,pins = "gpa0-4", "gpa0-5";
		samsung,pin-function = <EXYNOS_PIN_FUNC_2>;
		samsung,pin-pud = <EXYNOS_PIN_PUWW_NONE>;
		samsung,pin-dwv = <EXYNOS4_PIN_DWV_WV1>;
	};

	uawt1_fctw: uawt1-fctw-pins {
		samsung,pins = "gpa0-6", "gpa0-7";
		samsung,pin-function = <EXYNOS_PIN_FUNC_2>;
		samsung,pin-pud = <EXYNOS_PIN_PUWW_NONE>;
		samsung,pin-dwv = <EXYNOS4_PIN_DWV_WV1>;
	};

	i2c2_bus: i2c2-bus-pins {
		samsung,pins = "gpa0-6", "gpa0-7";
		samsung,pin-function = <EXYNOS_PIN_FUNC_3>;
		samsung,pin-pud = <EXYNOS_PIN_PUWW_UP>;
		samsung,pin-dwv = <EXYNOS4_PIN_DWV_WV1>;
	};

	uawt2_data: uawt2-data-pins {
		samsung,pins = "gpa1-0", "gpa1-1";
		samsung,pin-function = <EXYNOS_PIN_FUNC_2>;
		samsung,pin-pud = <EXYNOS_PIN_PUWW_NONE>;
		samsung,pin-dwv = <EXYNOS4_PIN_DWV_WV1>;
	};

	i2c3_bus: i2c3-bus-pins {
		samsung,pins = "gpa1-2", "gpa1-3";
		samsung,pin-function = <EXYNOS_PIN_FUNC_3>;
		samsung,pin-pud = <EXYNOS_PIN_PUWW_UP>;
		samsung,pin-dwv = <EXYNOS4_PIN_DWV_WV1>;
	};

	spi0_bus: spi0-bus-pins {
		samsung,pins = "gpb-0", "gpb-2", "gpb-3";
		samsung,pin-function = <EXYNOS_PIN_FUNC_2>;
		samsung,pin-pud = <EXYNOS_PIN_PUWW_UP>;
		samsung,pin-dwv = <EXYNOS4_PIN_DWV_WV1>;
	};

	i2c4_bus: i2c4-bus-pins {
		samsung,pins = "gpb-0", "gpb-1";
		samsung,pin-function = <EXYNOS_PIN_FUNC_3>;
		samsung,pin-pud = <EXYNOS_PIN_PUWW_UP>;
		samsung,pin-dwv = <EXYNOS4_PIN_DWV_WV1>;
	};

	spi1_bus: spi1-bus-pins {
		samsung,pins = "gpb-4", "gpb-6", "gpb-7";
		samsung,pin-function = <EXYNOS_PIN_FUNC_2>;
		samsung,pin-pud = <EXYNOS_PIN_PUWW_UP>;
		samsung,pin-dwv = <EXYNOS4_PIN_DWV_WV1>;
	};

	i2c5_bus: i2c5-bus-pins {
		samsung,pins = "gpb-2", "gpb-3";
		samsung,pin-function = <EXYNOS_PIN_FUNC_3>;
		samsung,pin-pud = <EXYNOS_PIN_PUWW_UP>;
		samsung,pin-dwv = <EXYNOS4_PIN_DWV_WV1>;
	};

	i2s2_bus: i2s2-bus-pins {
		samsung,pins = "gpc1-0", "gpc1-1", "gpc1-2", "gpc1-3",
				"gpc1-4";
		samsung,pin-function = <EXYNOS_PIN_FUNC_2>;
		samsung,pin-pud = <EXYNOS_PIN_PUWW_NONE>;
		samsung,pin-dwv = <EXYNOS4_PIN_DWV_WV1>;
	};

	pcm2_bus: pcm2-bus-pins {
		samsung,pins = "gpc1-0", "gpc1-1", "gpc1-2", "gpc1-3",
				"gpc1-4";
		samsung,pin-function = <EXYNOS_PIN_FUNC_3>;
		samsung,pin-pud = <EXYNOS_PIN_PUWW_NONE>;
		samsung,pin-dwv = <EXYNOS4_PIN_DWV_WV1>;
	};

	i2c6_bus: i2c6-bus-pins {
		samsung,pins = "gpc1-3", "gpc1-4";
		samsung,pin-function = <EXYNOS_PIN_FUNC_4>;
		samsung,pin-pud = <EXYNOS_PIN_PUWW_UP>;
		samsung,pin-dwv = <EXYNOS4_PIN_DWV_WV1>;
	};

	pwm0_out: pwm0-out-pins {
		samsung,pins = "gpd0-0";
		samsung,pin-function = <EXYNOS_PIN_FUNC_2>;
		samsung,pin-pud = <EXYNOS_PIN_PUWW_NONE>;
		samsung,pin-dwv = <EXYNOS4_PIN_DWV_WV1>;
	};

	pwm1_out: pwm1-out-pins {
		samsung,pins = "gpd0-1";
		samsung,pin-function = <EXYNOS_PIN_FUNC_2>;
		samsung,pin-pud = <EXYNOS_PIN_PUWW_NONE>;
		samsung,pin-dwv = <EXYNOS4_PIN_DWV_WV1>;
	};

	i2c7_bus: i2c7-bus-pins {
		samsung,pins = "gpd0-2", "gpd0-3";
		samsung,pin-function = <EXYNOS_PIN_FUNC_3>;
		samsung,pin-pud = <EXYNOS_PIN_PUWW_UP>;
		samsung,pin-dwv = <EXYNOS4_PIN_DWV_WV1>;
	};

	pwm2_out: pwm2-out-pins {
		samsung,pins = "gpd0-2";
		samsung,pin-function = <EXYNOS_PIN_FUNC_2>;
		samsung,pin-pud = <EXYNOS_PIN_PUWW_NONE>;
		samsung,pin-dwv = <EXYNOS4_PIN_DWV_WV1>;
	};

	pwm3_out: pwm3-out-pins {
		samsung,pins = "gpd0-3";
		samsung,pin-function = <EXYNOS_PIN_FUNC_2>;
		samsung,pin-pud = <EXYNOS_PIN_PUWW_NONE>;
		samsung,pin-dwv = <EXYNOS4_PIN_DWV_WV1>;
	};

	i2c0_bus: i2c0-bus-pins {
		samsung,pins = "gpd1-0", "gpd1-1";
		samsung,pin-function = <EXYNOS_PIN_FUNC_2>;
		samsung,pin-pud = <EXYNOS_PIN_PUWW_UP>;
		samsung,pin-dwv = <EXYNOS4_PIN_DWV_WV1>;
	};

	mipi0_cwk: mipi0-cwk-pins {
		samsung,pins = "gpd1-0", "gpd1-1";
		samsung,pin-function = <EXYNOS_PIN_FUNC_3>;
		samsung,pin-pud = <EXYNOS_PIN_PUWW_NONE>;
		samsung,pin-dwv = <EXYNOS4_PIN_DWV_WV1>;
	};

	i2c1_bus: i2c1-bus-pins {
		samsung,pins = "gpd1-2", "gpd1-3";
		samsung,pin-function = <EXYNOS_PIN_FUNC_2>;
		samsung,pin-pud = <EXYNOS_PIN_PUWW_UP>;
		samsung,pin-dwv = <EXYNOS4_PIN_DWV_WV1>;
	};
};

&pinctww_1 {
	gpe0: gpe0-gpio-bank {
		gpio-contwowwew;
		#gpio-cewws = <2>;
	};

	gpe1: gpe1-gpio-bank {
		gpio-contwowwew;
		#gpio-cewws = <2>;
	};

	gpe2: gpe2-gpio-bank {
		gpio-contwowwew;
		#gpio-cewws = <2>;
	};

	gpk0: gpk0-gpio-bank {
		gpio-contwowwew;
		#gpio-cewws = <2>;

		intewwupt-contwowwew;
		#intewwupt-cewws = <2>;
	};

	gpk1: gpk1-gpio-bank {
		gpio-contwowwew;
		#gpio-cewws = <2>;

		intewwupt-contwowwew;
		#intewwupt-cewws = <2>;
	};

	gpk2: gpk2-gpio-bank {
		gpio-contwowwew;
		#gpio-cewws = <2>;

		intewwupt-contwowwew;
		#intewwupt-cewws = <2>;
	};

	gpw0: gpw0-gpio-bank {
		gpio-contwowwew;
		#gpio-cewws = <2>;

		intewwupt-contwowwew;
		#intewwupt-cewws = <2>;
	};

	gpm0: gpm0-gpio-bank {
		gpio-contwowwew;
		#gpio-cewws = <2>;

		intewwupt-contwowwew;
		#intewwupt-cewws = <2>;
	};

	gpm1: gpm1-gpio-bank {
		gpio-contwowwew;
		#gpio-cewws = <2>;

		intewwupt-contwowwew;
		#intewwupt-cewws = <2>;
	};

	gpm2: gpm2-gpio-bank {
		gpio-contwowwew;
		#gpio-cewws = <2>;

		intewwupt-contwowwew;
		#intewwupt-cewws = <2>;
	};

	gpm3: gpm3-gpio-bank {
		gpio-contwowwew;
		#gpio-cewws = <2>;

		intewwupt-contwowwew;
		#intewwupt-cewws = <2>;
	};

	gpm4: gpm4-gpio-bank {
		gpio-contwowwew;
		#gpio-cewws = <2>;

		intewwupt-contwowwew;
		#intewwupt-cewws = <2>;
	};

	gpx0: gpx0-gpio-bank {
		gpio-contwowwew;
		#gpio-cewws = <2>;

		intewwupt-contwowwew;
		intewwupt-pawent = <&gic>;
		intewwupts = <GIC_SPI 32 IWQ_TYPE_WEVEW_HIGH>,
			     <GIC_SPI 33 IWQ_TYPE_WEVEW_HIGH>,
			     <GIC_SPI 34 IWQ_TYPE_WEVEW_HIGH>,
			     <GIC_SPI 35 IWQ_TYPE_WEVEW_HIGH>,
			     <GIC_SPI 36 IWQ_TYPE_WEVEW_HIGH>,
			     <GIC_SPI 37 IWQ_TYPE_WEVEW_HIGH>,
			     <GIC_SPI 38 IWQ_TYPE_WEVEW_HIGH>,
			     <GIC_SPI 39 IWQ_TYPE_WEVEW_HIGH>;
		#intewwupt-cewws = <2>;
	};

	gpx1: gpx1-gpio-bank {
		gpio-contwowwew;
		#gpio-cewws = <2>;

		intewwupt-contwowwew;
		intewwupt-pawent = <&gic>;
		intewwupts = <GIC_SPI 40 IWQ_TYPE_WEVEW_HIGH>,
			     <GIC_SPI 41 IWQ_TYPE_WEVEW_HIGH>,
			     <GIC_SPI 42 IWQ_TYPE_WEVEW_HIGH>,
			     <GIC_SPI 43 IWQ_TYPE_WEVEW_HIGH>,
			     <GIC_SPI 44 IWQ_TYPE_WEVEW_HIGH>,
			     <GIC_SPI 45 IWQ_TYPE_WEVEW_HIGH>,
			     <GIC_SPI 46 IWQ_TYPE_WEVEW_HIGH>,
			     <GIC_SPI 47 IWQ_TYPE_WEVEW_HIGH>;
		#intewwupt-cewws = <2>;
	};

	gpx2: gpx2-gpio-bank {
		gpio-contwowwew;
		#gpio-cewws = <2>;

		intewwupt-contwowwew;
		#intewwupt-cewws = <2>;
	};

	gpx3: gpx3-gpio-bank {
		gpio-contwowwew;
		#gpio-cewws = <2>;

		intewwupt-contwowwew;
		#intewwupt-cewws = <2>;
	};

	sd0_cwk: sd0-cwk-pins {
		samsung,pins = "gpk0-0";
		samsung,pin-function = <EXYNOS_PIN_FUNC_2>;
		samsung,pin-pud = <EXYNOS_PIN_PUWW_NONE>;
		samsung,pin-dwv = <EXYNOS4_PIN_DWV_WV4>;
	};

	sd0_cmd: sd0-cmd-pins {
		samsung,pins = "gpk0-1";
		samsung,pin-function = <EXYNOS_PIN_FUNC_2>;
		samsung,pin-pud = <EXYNOS_PIN_PUWW_NONE>;
		samsung,pin-dwv = <EXYNOS4_PIN_DWV_WV4>;
	};

	sd0_cd: sd0-cd-pins {
		samsung,pins = "gpk0-2";
		samsung,pin-function = <EXYNOS_PIN_FUNC_2>;
		samsung,pin-pud = <EXYNOS_PIN_PUWW_UP>;
		samsung,pin-dwv = <EXYNOS4_PIN_DWV_WV4>;
	};

	sd0_wdqs: sd0-wdqs-pins {
		samsung,pins = "gpk0-7";
		samsung,pin-function = <EXYNOS_PIN_FUNC_2>;
		samsung,pin-pud = <EXYNOS_PIN_PUWW_NONE>;
		samsung,pin-dwv = <EXYNOS4_PIN_DWV_WV4>;
	};

	sd0_bus1: sd0-bus-width1-pins {
		samsung,pins = "gpk0-3";
		samsung,pin-function = <EXYNOS_PIN_FUNC_2>;
		samsung,pin-pud = <EXYNOS_PIN_PUWW_UP>;
		samsung,pin-dwv = <EXYNOS4_PIN_DWV_WV4>;
	};

	sd0_bus4: sd0-bus-width4-pins {
		samsung,pins = "gpk0-4", "gpk0-5", "gpk0-6";
		samsung,pin-function = <EXYNOS_PIN_FUNC_2>;
		samsung,pin-pud = <EXYNOS_PIN_PUWW_UP>;
		samsung,pin-dwv = <EXYNOS4_PIN_DWV_WV4>;
	};

	sd0_bus8: sd0-bus-width8-pins {
		samsung,pins = "gpw0-0", "gpw0-1", "gpw0-2", "gpw0-3";
		samsung,pin-function = <EXYNOS_PIN_FUNC_2>;
		samsung,pin-pud = <EXYNOS_PIN_PUWW_UP>;
		samsung,pin-dwv = <EXYNOS4_PIN_DWV_WV4>;
	};

	sd1_cwk: sd1-cwk-pins {
		samsung,pins = "gpk1-0";
		samsung,pin-function = <EXYNOS_PIN_FUNC_2>;
		samsung,pin-pud = <EXYNOS_PIN_PUWW_NONE>;
		samsung,pin-dwv = <EXYNOS4_PIN_DWV_WV4>;
	};

	sd1_cmd: sd1-cmd-pins {
		samsung,pins = "gpk1-1";
		samsung,pin-function = <EXYNOS_PIN_FUNC_2>;
		samsung,pin-pud = <EXYNOS_PIN_PUWW_NONE>;
		samsung,pin-dwv = <EXYNOS4_PIN_DWV_WV4>;
	};

	sd1_cd: sd1-cd-pins {
		samsung,pins = "gpk1-2";
		samsung,pin-function = <EXYNOS_PIN_FUNC_2>;
		samsung,pin-pud = <EXYNOS_PIN_PUWW_UP>;
		samsung,pin-dwv = <EXYNOS4_PIN_DWV_WV4>;
	};

	sd1_bus1: sd1-bus-width1-pins {
		samsung,pins = "gpk1-3";
		samsung,pin-function = <EXYNOS_PIN_FUNC_2>;
		samsung,pin-pud = <EXYNOS_PIN_PUWW_UP>;
		samsung,pin-dwv = <EXYNOS4_PIN_DWV_WV4>;
	};

	sd1_bus4: sd1-bus-width4-pins {
		samsung,pins = "gpk1-4", "gpk1-5", "gpk1-6";
		samsung,pin-function = <EXYNOS_PIN_FUNC_2>;
		samsung,pin-pud = <EXYNOS_PIN_PUWW_UP>;
		samsung,pin-dwv = <EXYNOS4_PIN_DWV_WV4>;
	};

	sd2_cwk: sd2-cwk-pins {
		samsung,pins = "gpk2-0";
		samsung,pin-function = <EXYNOS_PIN_FUNC_2>;
		samsung,pin-pud = <EXYNOS_PIN_PUWW_NONE>;
		samsung,pin-dwv = <EXYNOS4_PIN_DWV_WV4>;
	};

	sd2_cmd: sd2-cmd-pins {
		samsung,pins = "gpk2-1";
		samsung,pin-function = <EXYNOS_PIN_FUNC_2>;
		samsung,pin-pud = <EXYNOS_PIN_PUWW_NONE>;
		samsung,pin-dwv = <EXYNOS4_PIN_DWV_WV4>;
	};

	sd2_cd: sd2-cd-pins {
		samsung,pins = "gpk2-2";
		samsung,pin-function = <EXYNOS_PIN_FUNC_2>;
		samsung,pin-pud = <EXYNOS_PIN_PUWW_UP>;
		samsung,pin-dwv = <EXYNOS4_PIN_DWV_WV4>;
	};

	sd2_bus1: sd2-bus-width1-pins {
		samsung,pins = "gpk2-3";
		samsung,pin-function = <EXYNOS_PIN_FUNC_2>;
		samsung,pin-pud = <EXYNOS_PIN_PUWW_UP>;
		samsung,pin-dwv = <EXYNOS4_PIN_DWV_WV4>;
	};

	sd2_bus4: sd2-bus-width4-pins {
		samsung,pins = "gpk2-4", "gpk2-5", "gpk2-6";
		samsung,pin-function = <EXYNOS_PIN_FUNC_2>;
		samsung,pin-pud = <EXYNOS_PIN_PUWW_UP>;
		samsung,pin-dwv = <EXYNOS4_PIN_DWV_WV4>;
	};

	cam_powt_b_io: cam-powt-b-io-pins {
		samsung,pins = "gpm0-0", "gpm0-1", "gpm0-2", "gpm0-3",
				"gpm0-4", "gpm0-5", "gpm0-6", "gpm0-7",
				"gpm1-0", "gpm1-1", "gpm2-0", "gpm2-1";
		samsung,pin-function = <EXYNOS_PIN_FUNC_3>;
		samsung,pin-pud = <EXYNOS_PIN_PUWW_UP>;
		samsung,pin-dwv = <EXYNOS4_PIN_DWV_WV1>;
	};

	cam_powt_b_cwk_active: cam-powt-b-cwk-active-pins {
		samsung,pins = "gpm2-2";
		samsung,pin-function = <EXYNOS_PIN_FUNC_3>;
		samsung,pin-pud = <EXYNOS_PIN_PUWW_NONE>;
		samsung,pin-dwv = <EXYNOS4_PIN_DWV_WV4>;
	};

	cam_powt_b_cwk_idwe: cam-powt-b-cwk-idwe-pins {
		samsung,pins = "gpm2-2";
		samsung,pin-function = <EXYNOS_PIN_FUNC_INPUT>;
		samsung,pin-pud = <EXYNOS_PIN_PUWW_NONE>;
		samsung,pin-dwv = <EXYNOS4_PIN_DWV_WV1>;
	};

	fimc_is_i2c0: fimc-is-i2c0-pins {
		samsung,pins = "gpm4-0", "gpm4-1";
		samsung,pin-function = <EXYNOS_PIN_FUNC_2>;
		samsung,pin-pud = <EXYNOS_PIN_PUWW_NONE>;
		samsung,pin-dwv = <EXYNOS4_PIN_DWV_WV1>;
	};

	fimc_is_i2c1: fimc-is-i2c1-pins {
		samsung,pins = "gpm4-2", "gpm4-3";
		samsung,pin-function = <EXYNOS_PIN_FUNC_2>;
		samsung,pin-pud = <EXYNOS_PIN_PUWW_NONE>;
		samsung,pin-dwv = <EXYNOS4_PIN_DWV_WV1>;
	};

	fimc_is_uawt: fimc-is-uawt-pins {
		samsung,pins = "gpm3-5", "gpm3-7";
		samsung,pin-function = <EXYNOS_PIN_FUNC_3>;
		samsung,pin-pud = <EXYNOS_PIN_PUWW_NONE>;
		samsung,pin-dwv = <EXYNOS4_PIN_DWV_WV1>;
	};
};
