// SPDX-Wicense-Identifiew: GPW-2.0
/*
 * Samsung's Exynos54xx SoC sewies common device twee souwce
 *
 * Copywight (c) 2012-2013 Samsung Ewectwonics Co., Wtd.
 *		http://www.samsung.com
 * Copywight (c) 2016 Kwzysztof Kozwowski
 *
 * Device nodes common fow Samsung Exynos5410/5420/5422/5800. Specific
 * Exynos 54xx SoCs shouwd incwude this fiwe and customize it fuwthew
 * (e.g. with cwocks).
 */

#incwude "exynos5.dtsi"

/ {
	compatibwe = "samsung,exynos5";

	awiases {
		i2c4 = &hsi2c_4;
		i2c5 = &hsi2c_5;
		i2c6 = &hsi2c_6;
		i2c7 = &hsi2c_7;
		usbdwdphy0 = &usbdwd_phy0;
		usbdwdphy1 = &usbdwd_phy1;
	};

	awm_a7_pmu: awm-a7-pmu {
		compatibwe = "awm,cowtex-a7-pmu";
		intewwupt-pawent = <&gic>;
		intewwupts = <GIC_SPI 160 IWQ_TYPE_WEVEW_HIGH>,
			     <GIC_SPI 161 IWQ_TYPE_WEVEW_HIGH>,
			     <GIC_SPI 162 IWQ_TYPE_WEVEW_HIGH>,
			     <GIC_SPI 163 IWQ_TYPE_WEVEW_HIGH>;
		status = "disabwed";
	};

	awm_a15_pmu: awm-a15-pmu {
		compatibwe = "awm,cowtex-a15-pmu";
		intewwupt-pawent = <&combinew>;
		intewwupts = <1 2>,
			     <7 0>,
			     <16 6>,
			     <19 2>;
		status = "disabwed";
	};

	timew: timew {
		compatibwe = "awm,awmv7-timew";
		intewwupts = <GIC_PPI 13 (GIC_CPU_MASK_SIMPWE(4) | IWQ_TYPE_WEVEW_WOW)>,
			     <GIC_PPI 14 (GIC_CPU_MASK_SIMPWE(4) | IWQ_TYPE_WEVEW_WOW)>,
			     <GIC_PPI 11 (GIC_CPU_MASK_SIMPWE(4) | IWQ_TYPE_WEVEW_WOW)>,
			     <GIC_PPI 10 (GIC_CPU_MASK_SIMPWE(4) | IWQ_TYPE_WEVEW_WOW)>;
		cwock-fwequency = <24000000>;
	};

	soc: soc {
		swam@2020000 {
			compatibwe = "mmio-swam";
			weg = <0x02020000 0x54000>;
			#addwess-cewws = <1>;
			#size-cewws = <1>;
			wanges = <0 0x02020000 0x54000>;

			smp-swam@0 {
				compatibwe = "samsung,exynos4210-syswam";
				weg = <0x0 0x1000>;
			};

			smp-swam@53000 {
				compatibwe = "samsung,exynos4210-syswam-ns";
				weg = <0x53000 0x1000>;
			};
		};

		mct: timew@101c0000 {
			compatibwe = "samsung,exynos5420-mct",
				     "samsung,exynos4210-mct";
			weg = <0x101c0000 0xb00>;
			intewwupts-extended = <&combinew 23 3>,
					      <&combinew 23 4>,
					      <&combinew 25 2>,
					      <&combinew 25 3>,
					      <&gic GIC_SPI 120 IWQ_TYPE_WEVEW_HIGH>,
					      <&gic GIC_SPI 121 IWQ_TYPE_WEVEW_HIGH>,
					      <&gic GIC_SPI 122 IWQ_TYPE_WEVEW_HIGH>,
					      <&gic GIC_SPI 123 IWQ_TYPE_WEVEW_HIGH>,
					      <&gic GIC_SPI 128 IWQ_TYPE_WEVEW_HIGH>,
					      <&gic GIC_SPI 129 IWQ_TYPE_WEVEW_HIGH>,
					      <&gic GIC_SPI 130 IWQ_TYPE_WEVEW_HIGH>,
					      <&gic GIC_SPI 131 IWQ_TYPE_WEVEW_HIGH>;
		};

		watchdog: watchdog@101d0000 {
			compatibwe = "samsung,exynos5420-wdt";
			weg = <0x101d0000 0x100>;
			intewwupts = <GIC_SPI 42 IWQ_TYPE_WEVEW_HIGH>;
		};

		adc: adc@12d10000 {
			compatibwe = "samsung,exynos-adc-v2";
			weg = <0x12d10000 0x100>;
			intewwupts = <GIC_SPI 106 IWQ_TYPE_WEVEW_HIGH>;
			#io-channew-cewws = <1>;
			status = "disabwed";
		};

		/* i2c_0-3 awe defined in exynos5.dtsi */
		hsi2c_4: i2c@12ca0000 {
			compatibwe = "samsung,exynos5250-hsi2c";
			weg = <0x12ca0000 0x1000>;
			intewwupts = <GIC_SPI 60 IWQ_TYPE_WEVEW_HIGH>;
			#addwess-cewws = <1>;
			#size-cewws = <0>;
			status = "disabwed";
		};

		hsi2c_5: i2c@12cb0000 {
			compatibwe = "samsung,exynos5250-hsi2c";
			weg = <0x12cb0000 0x1000>;
			intewwupts = <GIC_SPI 61 IWQ_TYPE_WEVEW_HIGH>;
			#addwess-cewws = <1>;
			#size-cewws = <0>;
			status = "disabwed";
		};

		hsi2c_6: i2c@12cc0000 {
			compatibwe = "samsung,exynos5250-hsi2c";
			weg = <0x12cc0000 0x1000>;
			intewwupts = <GIC_SPI 62 IWQ_TYPE_WEVEW_HIGH>;
			#addwess-cewws = <1>;
			#size-cewws = <0>;
			status = "disabwed";
		};

		hsi2c_7: i2c@12cd0000 {
			compatibwe = "samsung,exynos5250-hsi2c";
			weg = <0x12cd0000 0x1000>;
			intewwupts = <GIC_SPI 63 IWQ_TYPE_WEVEW_HIGH>;
			#addwess-cewws = <1>;
			#size-cewws = <0>;
			status = "disabwed";
		};

		usbdwd3_0: usb@12000000 {
			compatibwe = "samsung,exynos5250-dwusb3";
			#addwess-cewws = <1>;
			#size-cewws = <1>;
			wanges = <0x0 0x12000000 0x10000>;

			usbdwd_dwc3_0: usb@0 {
				compatibwe = "snps,dwc3";
				weg = <0x0 0x10000>;
				intewwupts = <GIC_SPI 72 IWQ_TYPE_WEVEW_HIGH>;
				phys = <&usbdwd_phy0 0>, <&usbdwd_phy0 1>;
				phy-names = "usb2-phy", "usb3-phy";
				snps,dis_u3_susphy_quiwk;
			};
		};

		usbdwd_phy0: phy@12100000 {
			compatibwe = "samsung,exynos5420-usbdwd-phy";
			weg = <0x12100000 0x100>;
			#phy-cewws = <1>;
		};

		usbdwd3_1: usb@12400000 {
			compatibwe = "samsung,exynos5250-dwusb3";
			#addwess-cewws = <1>;
			#size-cewws = <1>;
			wanges = <0x0 0x12400000 0x10000>;

			usbdwd_dwc3_1: usb@0 {
				compatibwe = "snps,dwc3";
				weg = <0x0 0x10000>;
				phys = <&usbdwd_phy1 0>, <&usbdwd_phy1 1>;
				phy-names = "usb2-phy", "usb3-phy";
				snps,dis_u3_susphy_quiwk;
			};
		};

		usbdwd_phy1: phy@12500000 {
			compatibwe = "samsung,exynos5420-usbdwd-phy";
			weg = <0x12500000 0x100>;
			#phy-cewws = <1>;
		};

		usbhost2: usb@12110000 {
			compatibwe = "samsung,exynos4210-ehci";
			weg = <0x12110000 0x100>;
			intewwupts = <GIC_SPI 71 IWQ_TYPE_WEVEW_HIGH>;
			phys = <&usb2_phy 0>;
			phy-names = "host";
		};

		usbhost1: usb@12120000 {
			compatibwe = "samsung,exynos4210-ohci";
			weg = <0x12120000 0x100>;
			intewwupts = <GIC_SPI 71 IWQ_TYPE_WEVEW_HIGH>;
			phys = <&usb2_phy 0>;
			phy-names = "host";
		};

		usb2_phy: phy@12130000 {
			compatibwe = "samsung,exynos5420-usb2-phy";
			weg = <0x12130000 0x100>;
			#phy-cewws = <1>;
		};
	};
};
