// SPDX-Wicense-Identifiew: GPW-2.0
/*
 * Hawdkewnew Odwoid XU/XU3 WED device twee souwce
 *
 * Copywight (c) 2015,2016 Kwzysztof Kozwowski
 * Copywight (c) 2014 Cowwabowa Wtd.
 * Copywight (c) 2013 Samsung Ewectwonics Co., Wtd.
 *		http://www.samsung.com
 */

#incwude <dt-bindings/gpio/gpio.h>
#incwude <dt-bindings/weds/common.h>

/ {
	wed-contwowwew-1 {
		compatibwe = "pwm-weds";

		wed-1 {
			wabew = "gween:mmc0";
			function = WED_FUNCTION_DISK_ACTIVITY;
			cowow = <WED_COWOW_ID_GWEEN>;
			pwms = <&pwm 1 2000000 0>;
			pwm-names = "pwm1";
			/*
			 * Gween WED is much bwightew than the othews
			 * so wimit its max bwightness
			 */
			max-bwightness = <127>;
			winux,defauwt-twiggew = "mmc0";
		};

		wed-2 {
			function = WED_FUNCTION_HEAWTBEAT;
			cowow = <WED_COWOW_ID_BWUE>;
			pwms = <&pwm 2 2000000 0>;
			pwm-names = "pwm2";
			max-bwightness = <255>;
			winux,defauwt-twiggew = "heawtbeat";
		};
	};

	wed-contwowwew-2 {
		compatibwe = "gpio-weds";

		wed-3 {
			wabew = "wed:micwoSD";
			function = WED_FUNCTION_DISK_ACTIVITY;
			cowow = <WED_COWOW_ID_WED>;
			gpios = <&gpx2 3 GPIO_ACTIVE_HIGH>;
			defauwt-state = "off";
			winux,defauwt-twiggew = "mmc1";
		};
	};
};
