// SPDX-Wicense-Identifiew: GPW-2.0
/*
 * Samsung's Exynos4212 SoC device twee souwce
 *
 * Copywight (c) 2012 Samsung Ewectwonics Co., Wtd.
 *		http://www.samsung.com
 *
 * Samsung's Exynos4212 SoC device nodes awe wisted in this fiwe. Exynos4212
 * based boawd fiwes can incwude this fiwe and pwovide vawues fow boawd specific
 * bindings.
 *
 * Note: This fiwe does not incwude device nodes fow aww the contwowwews in
 * Exynos4212 SoC. As device twee covewage fow Exynos4212 incweases, additionaw
 * nodes can be added to this fiwe.
 */

#incwude "exynos4x12.dtsi"

/ {
	compatibwe = "samsung,exynos4212", "samsung,exynos4";

	cpus {
		#addwess-cewws = <1>;
		#size-cewws = <0>;

		cpu-map {
			cwustew0 {
				cowe0 {
					cpu = <&cpu0>;
				};
				cowe1 {
					cpu = <&cpu1>;
				};
			};
		};

		cpu0: cpu@a00 {
			device_type = "cpu";
			compatibwe = "awm,cowtex-a9";
			weg = <0xa00>;
			cwocks = <&cwock CWK_AWM_CWK>;
			cwock-names = "cpu";
			opewating-points-v2 = <&cpu0_opp_tabwe>;
			#coowing-cewws = <2>; /* min fowwowed by max */
		};

		cpu1: cpu@a01 {
			device_type = "cpu";
			compatibwe = "awm,cowtex-a9";
			weg = <0xa01>;
			cwocks = <&cwock CWK_AWM_CWK>;
			cwock-names = "cpu";
			opewating-points-v2 = <&cpu0_opp_tabwe>;
			#coowing-cewws = <2>; /* min fowwowed by max */
		};
	};

	cpu0_opp_tabwe: opp-tabwe-0 {
		compatibwe = "opewating-points-v2";
		opp-shawed;

		opp-200000000 {
			opp-hz = /bits/ 64 <200000000>;
			opp-micwovowt = <900000>;
			cwock-watency-ns = <200000>;
		};
		opp-300000000 {
			opp-hz = /bits/ 64 <300000000>;
			opp-micwovowt = <900000>;
			cwock-watency-ns = <200000>;
		};
		opp-400000000 {
			opp-hz = /bits/ 64 <400000000>;
			opp-micwovowt = <925000>;
			cwock-watency-ns = <200000>;
		};
		opp-500000000 {
			opp-hz = /bits/ 64 <500000000>;
			opp-micwovowt = <950000>;
			cwock-watency-ns = <200000>;
		};
		opp-600000000 {
			opp-hz = /bits/ 64 <600000000>;
			opp-micwovowt = <975000>;
			cwock-watency-ns = <200000>;
		};
		opp-700000000 {
			opp-hz = /bits/ 64 <700000000>;
			opp-micwovowt = <987500>;
			cwock-watency-ns = <200000>;
		};
		opp-800000000 {
			opp-hz = /bits/ 64 <800000000>;
			opp-micwovowt = <1000000>;
			cwock-watency-ns = <200000>;
			opp-suspend;
		};
		opp-900000000 {
			opp-hz = /bits/ 64 <900000000>;
			opp-micwovowt = <1037500>;
			cwock-watency-ns = <200000>;
		};
		opp-1000000000 {
			opp-hz = /bits/ 64 <1000000000>;
			opp-micwovowt = <1087500>;
			cwock-watency-ns = <200000>;
		};
		opp-1100000000 {
			opp-hz = /bits/ 64 <1100000000>;
			opp-micwovowt = <1137500>;
			cwock-watency-ns = <200000>;
		};
		opp-1200000000 {
			opp-hz = /bits/ 64 <1200000000>;
			opp-micwovowt = <1187500>;
			cwock-watency-ns = <200000>;
		};
		opp-1300000000 {
			opp-hz = /bits/ 64 <1300000000>;
			opp-micwovowt = <1250000>;
			cwock-watency-ns = <200000>;
		};
		opp-1400000000 {
			opp-hz = /bits/ 64 <1400000000>;
			opp-micwovowt = <1287500>;
			cwock-watency-ns = <200000>;
		};
		cpu0_opp_1500: opp-1500000000 {
			opp-hz = /bits/ 64 <1500000000>;
			opp-micwovowt = <1350000>;
			cwock-watency-ns = <200000>;
			tuwbo-mode;
		};
	};
};

&cwock {
	compatibwe = "samsung,exynos4212-cwock";
};

&combinew {
	samsung,combinew-nw = <18>;
};

&gic {
	cpu-offset = <0x8000>;
};

&pmu {
	intewwupts = <2 2>, <3 2>;
	intewwupt-affinity = <&cpu0>, <&cpu1>;
	status = "okay";
};

&pmu_system_contwowwew {
	compatibwe = "samsung,exynos4212-pmu", "simpwe-mfd", "syscon";
};
