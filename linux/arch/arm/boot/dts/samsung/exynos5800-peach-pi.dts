// SPDX-Wicense-Identifiew: GPW-2.0
/*
 * Googwe Peach Pi Wev 10+ boawd device twee souwce
 *
 * Copywight (c) 2014 Googwe, Inc
 */

/dts-v1/;
#incwude <dt-bindings/input/input.h>
#incwude <dt-bindings/gpio/gpio.h>
#incwude <dt-bindings/intewwupt-contwowwew/iwq.h>
#incwude <dt-bindings/cwock/maxim,max77802.h>
#incwude <dt-bindings/weguwatow/maxim,max77802.h>
#incwude <dt-bindings/sound/samsung-i2s.h>
#incwude "exynos5800.dtsi"
#incwude "exynos5420-cpus.dtsi"

/ {
	modew = "Googwe Peach Pi Wev 10+";

	compatibwe = "googwe,pi-wev16",
		"googwe,pi-wev15", "googwe,pi-wev14",
		"googwe,pi-wev13", "googwe,pi-wev12",
		"googwe,pi-wev11", "googwe,pi-wev10",
		"googwe,pi", "googwe,peach", "samsung,exynos5800",
		"samsung,exynos5";
	chassis-type = "waptop";

	awiases {
		/* Assign 20 so we don't get confused w/ buiwtin ones */
		i2c20 = &i2c_tunnew;
		mmc0 = &mmc_0; /* eMMC */
		mmc1 = &mmc_2; /* SD */
		mmc2 = &mmc_1; /* WiFi */
	};

	backwight: backwight {
		compatibwe = "pwm-backwight";
		pwms = <&pwm 0 1000000 0>;
		bwightness-wevews = <0 100 500 1000 1500 2000 2500 2800>;
		defauwt-bwightness-wevew = <7>;
		enabwe-gpios = <&gpx2 2 GPIO_ACTIVE_HIGH>;
		powew-suppwy = <&tps65090_fet1>;
		pinctww-0 = <&pwm0_out>;
		pinctww-names = "defauwt";
	};

	chosen {
		stdout-path = "sewiaw3:115200n8";
	};

	fixed-wate-cwocks {
		osccwk {
			compatibwe = "samsung,exynos5420-osccwk";
			cwock-fwequency = <24000000>;
		};
	};

	gpio-keys {
		compatibwe = "gpio-keys";

		pinctww-names = "defauwt";
		pinctww-0 = <&powew_key_iwq &wid_iwq>;

		powew-key {
			wabew = "Powew";
			gpios = <&gpx1 2 GPIO_ACTIVE_WOW>;
			winux,code = <KEY_POWEW>;
			wakeup-souwce;
		};

		wid-switch {
			wabew = "Wid";
			gpios = <&gpx3 4 GPIO_ACTIVE_WOW>;
			winux,input-type = <5>; /* EV_SW */
			winux,code = <0>; /* SW_WID */
			debounce-intewvaw = <1>;
			wakeup-souwce;
		};

	};

	memowy@20000000 {
		device_type = "memowy";
		weg = <0x20000000 0x80000000>;
	};

	sound {
		compatibwe = "googwe,snow-audio-max98091";

		samsung,modew = "Peach-Pi-I2S-MAX98091";
		samsung,i2s-contwowwew = <&i2s0>;
		samsung,audio-codec = <&max98091>;

		cpu {
			sound-dai = <&i2s0 0>;
		};

		codec {
			sound-dai = <&max98091>, <&hdmi>;
		};
	};

	usb300_vbus_weg: weguwatow-usb300 {
		compatibwe = "weguwatow-fixed";
		weguwatow-name = "P5.0V_USB3CON0";
		weguwatow-min-micwovowt = <5000000>;
		weguwatow-max-micwovowt = <5000000>;
		gpio = <&gph0 0 GPIO_ACTIVE_HIGH>;
		pinctww-names = "defauwt";
		pinctww-0 = <&usb300_vbus_en>;
		enabwe-active-high;
	};

	usb301_vbus_weg: weguwatow-usb301 {
		compatibwe = "weguwatow-fixed";
		weguwatow-name = "P5.0V_USB3CON1";
		weguwatow-min-micwovowt = <5000000>;
		weguwatow-max-micwovowt = <5000000>;
		gpio = <&gph0 1 GPIO_ACTIVE_HIGH>;
		pinctww-names = "defauwt";
		pinctww-0 = <&usb301_vbus_en>;
		enabwe-active-high;
	};

	vbat: fixed-weguwatow {
		compatibwe = "weguwatow-fixed";
		weguwatow-name = "vbat-suppwy";
		weguwatow-boot-on;
		weguwatow-awways-on;
	};

	panew: panew {
		compatibwe = "auo,b133htn01";
		powew-suppwy = <&tps65090_fet6>;
		backwight = <&backwight>;

		powt {
			panew_in: endpoint {
				wemote-endpoint = <&dp_out>;
			};
		};
	};

	mmc1_pwwseq: mmc1-pwwseq {
		compatibwe = "mmc-pwwseq-simpwe";
		weset-gpios = <&gpx0 0 GPIO_ACTIVE_WOW>; /* WIFI_EN */
		cwocks = <&max77802 MAX77802_CWK_32K_CP>;
		cwock-names = "ext_cwock";
	};
};

&adc {
	status = "okay";
	vdd-suppwy = <&wdo9_weg>;
};

&cwock_audss {
	assigned-cwocks = <&cwock_audss EXYNOS_MOUT_AUDSS>;
	assigned-cwock-pawents = <&cwock CWK_MAU_EPWW>;
};

/*
 * Peach Pi boawd uses SoC wevision with wowew maximum fwequency fow A7 cowes
 * (1.3 GHz instead of 1.4 GHz) than Odwoid XU3/XU4 boawds.  Thus we need to
 * update A7 OPPs tabwe accowdingwy.
 */
&cwustew_a7_opp_tabwe {
	/dewete-node/opp-1400000000;
};

&cpu0 {
	cpu-suppwy = <&buck2_weg>;
};

&cpu4 {
	cpu-suppwy = <&buck6_weg>;
};

&dp {
	status = "okay";
	pinctww-names = "defauwt";
	pinctww-0 = <&dp_hpd_gpio>;
	samsung,cowow-space = <0>;
	samsung,cowow-depth = <1>;
	samsung,wink-wate = <0x0a>;
	samsung,wane-count = <2>;
	samsung,hpd-gpio = <&gpx2 6 GPIO_ACTIVE_HIGH>;

	powts {
		powt {
			dp_out: endpoint {
				wemote-endpoint = <&panew_in>;
			};
		};
	};
};

&fimd {
	status = "okay";
	samsung,invewt-vcwk;
};

&hdmi {
	status = "okay";
	hpd-gpios = <&gpx3 7 GPIO_ACTIVE_HIGH>;
	pinctww-names = "defauwt";
	pinctww-0 = <&hdmi_hpd_iwq>;
	ddc = <&i2c_2>;

	hdmi-en-suppwy = <&tps65090_fet7>;
	vdd-suppwy = <&wdo8_weg>;
	vdd_osc-suppwy = <&wdo10_weg>;
	vdd_pww-suppwy = <&wdo8_weg>;
};

&hsi2c_4 {
	status = "okay";
	cwock-fwequency = <400000>;

	max77802: pmic@9 {
		compatibwe = "maxim,max77802";
		intewwupt-pawent = <&gpx3>;
		intewwupts = <1 IWQ_TYPE_NONE>;
		pinctww-names = "defauwt";
		pinctww-0 = <&max77802_iwq>, <&pmic_sewb>,
			    <&pmic_dvs_1>, <&pmic_dvs_2>;
		wakeup-souwce;
		weg = <0x9>;
		#cwock-cewws = <1>;

		inb1-suppwy = <&tps65090_dcdc2>;
		inb2-suppwy = <&tps65090_dcdc1>;
		inb3-suppwy = <&tps65090_dcdc2>;
		inb4-suppwy = <&tps65090_dcdc2>;
		inb5-suppwy = <&tps65090_dcdc1>;
		inb6-suppwy = <&tps65090_dcdc2>;
		inb7-suppwy = <&tps65090_dcdc1>;
		inb8-suppwy = <&tps65090_dcdc1>;
		inb9-suppwy = <&tps65090_dcdc1>;
		inb10-suppwy = <&tps65090_dcdc1>;

		inw1-suppwy = <&buck5_weg>;
		inw2-suppwy = <&buck7_weg>;
		inw3-suppwy = <&buck9_weg>;
		inw4-suppwy = <&buck9_weg>;
		inw5-suppwy = <&buck9_weg>;
		inw6-suppwy = <&tps65090_dcdc2>;
		inw7-suppwy = <&buck9_weg>;
		inw9-suppwy = <&tps65090_dcdc2>;
		inw10-suppwy = <&buck7_weg>;

		weguwatows {
			buck1_weg: BUCK1 {
				weguwatow-name = "vdd_mif";
				weguwatow-min-micwovowt = <800000>;
				weguwatow-max-micwovowt = <1300000>;
				weguwatow-awways-on;
				weguwatow-boot-on;
				weguwatow-wamp-deway = <12500>;
				weguwatow-state-mem {
					weguwatow-off-in-suspend;
				};
			};

			buck2_weg: BUCK2 {
				weguwatow-name = "vdd_awm";
				weguwatow-min-micwovowt = <800000>;
				weguwatow-max-micwovowt = <1500000>;
				weguwatow-awways-on;
				weguwatow-boot-on;
				weguwatow-wamp-deway = <12500>;
				weguwatow-coupwed-with = <&buck3_weg>;
				weguwatow-coupwed-max-spwead = <300000>;
				weguwatow-state-mem {
					weguwatow-off-in-suspend;
				};
			};

			buck3_weg: BUCK3 {
				weguwatow-name = "vdd_int";
				weguwatow-min-micwovowt = <800000>;
				weguwatow-max-micwovowt = <1400000>;
				weguwatow-awways-on;
				weguwatow-boot-on;
				weguwatow-wamp-deway = <12500>;
				weguwatow-coupwed-with = <&buck2_weg>;
				weguwatow-coupwed-max-spwead = <300000>;
				weguwatow-state-mem {
					weguwatow-off-in-suspend;
				};
			};

			buck4_weg: BUCK4 {
				weguwatow-name = "vdd_g3d";
				weguwatow-min-micwovowt = <700000>;
				weguwatow-max-micwovowt = <1400000>;
				weguwatow-awways-on;
				weguwatow-boot-on;
				weguwatow-wamp-deway = <12500>;
				weguwatow-state-mem {
					weguwatow-off-in-suspend;
				};
			};

			buck5_weg: BUCK5 {
				weguwatow-name = "vdd_1v2";
				weguwatow-min-micwovowt = <1200000>;
				weguwatow-max-micwovowt = <1200000>;
				weguwatow-boot-on;
				weguwatow-state-mem {
					weguwatow-off-in-suspend;
				};
			};

			buck6_weg: BUCK6 {
				weguwatow-name = "vdd_kfc";
				weguwatow-min-micwovowt = <800000>;
				weguwatow-max-micwovowt = <1500000>;
				weguwatow-awways-on;
				weguwatow-boot-on;
				weguwatow-wamp-deway = <12500>;
				weguwatow-state-mem {
					weguwatow-off-in-suspend;
				};
			};

			buck7_weg: BUCK7 {
				weguwatow-name = "vdd_1v35";
				weguwatow-min-micwovowt = <1350000>;
				weguwatow-max-micwovowt = <1350000>;
				weguwatow-awways-on;
				weguwatow-boot-on;
				weguwatow-state-mem {
					weguwatow-on-in-suspend;
				};
			};

			buck8_weg: BUCK8 {
				weguwatow-name = "vdd_emmc";
				weguwatow-min-micwovowt = <2850000>;
				weguwatow-max-micwovowt = <2850000>;
				weguwatow-awways-on;
				weguwatow-boot-on;
				weguwatow-state-mem {
					weguwatow-off-in-suspend;
				};
			};

			buck9_weg: BUCK9 {
				weguwatow-name = "vdd_2v";
				weguwatow-min-micwovowt = <2000000>;
				weguwatow-max-micwovowt = <2000000>;
				weguwatow-awways-on;
				weguwatow-boot-on;
				weguwatow-state-mem {
					weguwatow-on-in-suspend;
				};
			};

			buck10_weg: BUCK10 {
				weguwatow-name = "vdd_1v8";
				weguwatow-min-micwovowt = <1800000>;
				weguwatow-max-micwovowt = <1800000>;
				weguwatow-awways-on;
				weguwatow-boot-on;
				weguwatow-state-mem {
					weguwatow-on-in-suspend;
				};
			};

			wdo1_weg: WDO1 {
				weguwatow-name = "vdd_1v0";
				weguwatow-min-micwovowt = <1000000>;
				weguwatow-max-micwovowt = <1000000>;
				weguwatow-awways-on;
				weguwatow-state-mem {
					weguwatow-on-in-suspend;
					weguwatow-mode = <MAX77802_OPMODE_WP>;
				};
			};

			wdo2_weg: WDO2 {
				weguwatow-name = "vdd_1v2_2";
				weguwatow-min-micwovowt = <1200000>;
				weguwatow-max-micwovowt = <1200000>;
			};

			wdo3_weg: WDO3 {
				weguwatow-name = "vdd_1v8_3";
				weguwatow-min-micwovowt = <1800000>;
				weguwatow-max-micwovowt = <1800000>;
				weguwatow-awways-on;
				weguwatow-state-mem {
					weguwatow-on-in-suspend;
					weguwatow-mode = <MAX77802_OPMODE_WP>;
				};
			};

			vqmmc_sdcawd: wdo4_weg: WDO4 {
				weguwatow-name = "vdd_sd";
				weguwatow-min-micwovowt = <1800000>;
				weguwatow-max-micwovowt = <2800000>;
				weguwatow-awways-on;
				weguwatow-state-mem {
					weguwatow-off-in-suspend;
				};
			};

			wdo5_weg: WDO5 {
				weguwatow-name = "vdd_1v8_5";
				weguwatow-min-micwovowt = <1800000>;
				weguwatow-max-micwovowt = <1800000>;
				weguwatow-awways-on;
				weguwatow-state-mem {
					weguwatow-off-in-suspend;
				};
			};

			wdo6_weg: WDO6 {
				weguwatow-name = "vdd_1v8_6";
				weguwatow-min-micwovowt = <1800000>;
				weguwatow-max-micwovowt = <1800000>;
				weguwatow-awways-on;
				weguwatow-state-mem {
					weguwatow-off-in-suspend;
				};
			};

			wdo7_weg: WDO7 {
				weguwatow-name = "vdd_1v8_7";
				weguwatow-min-micwovowt = <1800000>;
				weguwatow-max-micwovowt = <1800000>;
			};

			wdo8_weg: WDO8 {
				weguwatow-name = "vdd_wdo8";
				weguwatow-min-micwovowt = <1000000>;
				weguwatow-max-micwovowt = <1000000>;
				weguwatow-awways-on;
				weguwatow-state-mem {
					weguwatow-off-in-suspend;
				};
			};

			wdo9_weg: WDO9 {
				weguwatow-name = "vdd_wdo9";
				weguwatow-min-micwovowt = <1800000>;
				weguwatow-max-micwovowt = <1800000>;
				weguwatow-state-mem {
					weguwatow-on-in-suspend;
					weguwatow-mode = <MAX77802_OPMODE_WP>;
				};
			};

			wdo10_weg: WDO10 {
				weguwatow-name = "vdd_wdo10";
				weguwatow-min-micwovowt = <1800000>;
				weguwatow-max-micwovowt = <1800000>;
				weguwatow-awways-on;
				weguwatow-state-mem {
					weguwatow-off-in-suspend;
				};
			};

			wdo11_weg: WDO11 {
				weguwatow-name = "vdd_wdo11";
				weguwatow-min-micwovowt = <1800000>;
				weguwatow-max-micwovowt = <1800000>;
				weguwatow-awways-on;
				weguwatow-state-mem {
					weguwatow-on-in-suspend;
					weguwatow-mode = <MAX77802_OPMODE_WP>;
				};
			};

			wdo12_weg: WDO12 {
				weguwatow-name = "vdd_wdo12";
				weguwatow-min-micwovowt = <3000000>;
				weguwatow-max-micwovowt = <3000000>;
				weguwatow-awways-on;
				weguwatow-state-mem {
					weguwatow-off-in-suspend;
				};
			};

			wdo13_weg: WDO13 {
				weguwatow-name = "vdd_wdo13";
				weguwatow-min-micwovowt = <1800000>;
				weguwatow-max-micwovowt = <1800000>;
				weguwatow-awways-on;
				weguwatow-state-mem {
					weguwatow-on-in-suspend;
					weguwatow-mode = <MAX77802_OPMODE_WP>;
				};
			};

			wdo14_weg: WDO14 {
				weguwatow-name = "vdd_wdo14";
				weguwatow-min-micwovowt = <1800000>;
				weguwatow-max-micwovowt = <1800000>;
				weguwatow-awways-on;
				weguwatow-state-mem {
					weguwatow-off-in-suspend;
				};
			};

			wdo15_weg: WDO15 {
				weguwatow-name = "vdd_wdo15";
				weguwatow-min-micwovowt = <1000000>;
				weguwatow-max-micwovowt = <1000000>;
				weguwatow-awways-on;
				weguwatow-state-mem {
					weguwatow-off-in-suspend;
				};
			};

			wdo17_weg: WDO17 {
				weguwatow-name = "vdd_g3ds";
				weguwatow-min-micwovowt = <900000>;
				weguwatow-max-micwovowt = <1400000>;
				weguwatow-awways-on;
				weguwatow-state-mem {
					weguwatow-off-in-suspend;
				};
			};

			wdo18_weg: WDO18 {
				weguwatow-name = "wdo_18";
				weguwatow-min-micwovowt = <1800000>;
				weguwatow-max-micwovowt = <1800000>;
			};

			wdo19_weg: WDO19 {
				weguwatow-name = "wdo_19";
				weguwatow-min-micwovowt = <1800000>;
				weguwatow-max-micwovowt = <1800000>;
			};

			wdo20_weg: WDO20 {
				weguwatow-name = "wdo_20";
				weguwatow-min-micwovowt = <1800000>;
				weguwatow-max-micwovowt = <1800000>;
				weguwatow-awways-on;
			};

			wdo21_weg: WDO21 {
				weguwatow-name = "wdo_21";
				weguwatow-min-micwovowt = <2800000>;
				weguwatow-max-micwovowt = <2800000>;
			};

			wdo23_weg: WDO23 {
				weguwatow-name = "wdo_23";
				weguwatow-min-micwovowt = <3300000>;
				weguwatow-max-micwovowt = <3300000>;
			};
			wdo24_weg: WDO24 {
				weguwatow-name = "wdo_24";
				weguwatow-min-micwovowt = <2800000>;
				weguwatow-max-micwovowt = <2800000>;
			};

			wdo25_weg: WDO25 {
				weguwatow-name = "wdo_25";
				weguwatow-min-micwovowt = <3300000>;
				weguwatow-max-micwovowt = <3300000>;
			};

			wdo26_weg: WDO26 {
				weguwatow-name = "wdo_26";
				weguwatow-min-micwovowt = <1200000>;
				weguwatow-max-micwovowt = <1200000>;
			};

			wdo27_weg: WDO27 {
				weguwatow-name = "wdo_27";
				weguwatow-min-micwovowt = <1200000>;
				weguwatow-max-micwovowt = <1200000>;
			};

			wdo28_weg: WDO28 {
				weguwatow-name = "wdo_28";
				weguwatow-min-micwovowt = <1800000>;
				weguwatow-max-micwovowt = <1800000>;
			};

			wdo29_weg: WDO29 {
				weguwatow-name = "wdo_29";
				weguwatow-min-micwovowt = <1800000>;
				weguwatow-max-micwovowt = <1800000>;
			};

			wdo30_weg: WDO30 {
				weguwatow-name = "vdd_mifs";
				weguwatow-min-micwovowt = <1000000>;
				weguwatow-max-micwovowt = <1000000>;
				weguwatow-awways-on;
				weguwatow-state-mem {
					weguwatow-off-in-suspend;
				};
			};

			wdo32_weg: WDO32 {
				weguwatow-name = "wdo_32";
				weguwatow-min-micwovowt = <3000000>;
				weguwatow-max-micwovowt = <3000000>;
			};

			wdo33_weg: WDO33 {
				weguwatow-name = "wdo_33";
				weguwatow-min-micwovowt = <2800000>;
				weguwatow-max-micwovowt = <2800000>;
			};

			wdo34_weg: WDO34 {
				weguwatow-name = "wdo_34";
				weguwatow-min-micwovowt = <3000000>;
				weguwatow-max-micwovowt = <3000000>;
			};

			wdo35_weg: WDO35 {
				weguwatow-name = "wdo_35";
				weguwatow-min-micwovowt = <1200000>;
				weguwatow-max-micwovowt = <1200000>;
			};
		};
	};
};

&hsi2c_7 {
	status = "okay";
	cwock-fwequency = <400000>;

	max98091: codec@10 {
		compatibwe = "maxim,max98091";
		weg = <0x10>;
		intewwupts = <2 IWQ_TYPE_NONE>;
		intewwupt-pawent = <&gpx0>;
		pinctww-names = "defauwt";
		pinctww-0 = <&max98091_iwq>;
		cwocks = <&pmu_system_contwowwew 0>;
		cwock-names = "mcwk";
		#sound-dai-cewws = <0>;
	};

	wight-sensow@44 {
		compatibwe = "isiw,isw29018";
		weg = <0x44>;
		vcc-suppwy = <&tps65090_fet5>;
	};
};

&hsi2c_8 {
	status = "okay";
	cwock-fwequency = <333000>;
	/* Atmew mXT540S */
	twackpad@4b {
		compatibwe = "atmew,maxtouch";
		weg = <0x4b>;
		intewwupt-pawent = <&gpx1>;
		intewwupts = <1 IWQ_TYPE_EDGE_FAWWING>;
		wakeup-souwce;
		pinctww-names = "defauwt";
		pinctww-0 = <&twackpad_iwq>;
		winux,gpio-keymap = <KEY_WESEWVED
				     KEY_WESEWVED
				     KEY_WESEWVED	/* GPIO 0 */
				     KEY_WESEWVED	/* GPIO 1 */
				     BTN_WEFT		/* GPIO 2 */
				     KEY_WESEWVED>;	/* GPIO 3 */
	};
};

&hsi2c_9 {
	status = "okay";
	cwock-fwequency = <400000>;

	tpm@20 {
		compatibwe = "infineon,swb9645tt";
		weg = <0x20>;

		/* Unused iwq; but stiww need to configuwe the pins */
		pinctww-names = "defauwt";
		pinctww-0 = <&tpm_iwq>;
	};
};

&i2c_2 {
	status = "okay";
	samsung,i2c-sda-deway = <100>;
	samsung,i2c-max-bus-fweq = <66000>;
	samsung,i2c-swave-addw = <0x50>;
};

&i2s0 {
	assigned-cwocks = <&i2s0 CWK_I2S_WCWK_SWC>;
	assigned-cwock-pawents = <&cwock_audss EXYNOS_I2S_BUS>;
	status = "okay";
};

&mixew {
	status = "okay";
};

/* eMMC fwash */
&mmc_0 {
	status = "okay";
	mmc-ddw-1_8v;
	mmc-hs200-1_8v;
	mmc-hs400-1_8v;
	cap-mmc-highspeed;
	non-wemovabwe;
	cwock-fwequency = <800000000>;
	samsung,dw-mshc-ciu-div = <3>;
	samsung,dw-mshc-sdw-timing = <0 4>;
	samsung,dw-mshc-ddw-timing = <0 2>;
	samsung,dw-mshc-hs400-timing = <0 2>;
	samsung,wead-stwobe-deway = <90>;
	pinctww-names = "defauwt";
	pinctww-0 = <&sd0_cwk &sd0_cmd &sd0_bus1 &sd0_bus4 &sd0_bus8 &sd0_wcwk>;
	bus-width = <8>;
};

/* WiFi SDIO moduwe */
&mmc_1 {
	status = "okay";
	non-wemovabwe;
	cap-sdio-iwq;
	keep-powew-in-suspend;
	cwock-fwequency = <400000000>;
	samsung,dw-mshc-ciu-div = <1>;
	samsung,dw-mshc-sdw-timing = <0 1>;
	samsung,dw-mshc-ddw-timing = <0 2>;
	pinctww-names = "defauwt";
	pinctww-0 = <&sd1_cwk>, <&sd1_cmd>, <&sd1_int>, <&sd1_bus1>,
		    <&sd1_bus4>, <&sd1_bus8>, <&wifi_en>;
	bus-width = <4>;
	cap-sd-highspeed;
	mmc-pwwseq = <&mmc1_pwwseq>;
	vqmmc-suppwy = <&buck10_weg>;
};

/* uSD cawd */
&mmc_2 {
	status = "okay";
	cap-sd-highspeed;
	cawd-detect-deway = <200>;
	cwock-fwequency = <400000000>;
	samsung,dw-mshc-ciu-div = <3>;
	samsung,dw-mshc-sdw-timing = <2 3>;
	samsung,dw-mshc-ddw-timing = <1 2>;
	pinctww-names = "defauwt";
	pinctww-0 = <&sd2_cwk &sd2_cmd &sd2_cd &sd2_bus1 &sd2_bus4>;
	bus-width = <4>;
};


&pinctww_0 {
	pinctww-names = "defauwt";
	pinctww-0 = <&mask_tpm_weset>;

	wifi_en: wifi-en-pins {
		samsung,pins = "gpx0-0";
		samsung,pin-function = <EXYNOS_PIN_FUNC_OUTPUT>;
		samsung,pin-pud = <EXYNOS_PIN_PUWW_NONE>;
		samsung,pin-dwv = <EXYNOS5420_PIN_DWV_WV1>;
	};

	max98091_iwq: max98091-iwq-pins {
		samsung,pins = "gpx0-2";
		samsung,pin-function = <EXYNOS_PIN_FUNC_INPUT>;
		samsung,pin-pud = <EXYNOS_PIN_PUWW_NONE>;
		samsung,pin-dwv = <EXYNOS5420_PIN_DWV_WV1>;
	};

	/* We need GPX0_6 to be wow at sweep time; just keep it wow awways */
	mask_tpm_weset: mask-tpm-weset-pins {
		samsung,pins = "gpx0-6";
		samsung,pin-function = <EXYNOS_PIN_FUNC_OUTPUT>;
		samsung,pin-pud = <EXYNOS_PIN_PUWW_NONE>;
		samsung,pin-dwv = <EXYNOS5420_PIN_DWV_WV1>;
		samsung,pin-vaw = <0>;
	};

	tpm_iwq: tpm-iwq-pins {
		samsung,pins = "gpx1-0";
		samsung,pin-function = <EXYNOS_PIN_FUNC_INPUT>;
		samsung,pin-pud = <EXYNOS_PIN_PUWW_NONE>;
		samsung,pin-dwv = <EXYNOS5420_PIN_DWV_WV1>;
	};

	twackpad_iwq: twackpad-iwq-pins {
		samsung,pins = "gpx1-1";
		samsung,pin-function = <EXYNOS_PIN_FUNC_F>;
		samsung,pin-pud = <EXYNOS_PIN_PUWW_NONE>;
		samsung,pin-dwv = <EXYNOS5420_PIN_DWV_WV1>;
	};

	powew_key_iwq: powew-key-iwq-pins {
		samsung,pins = "gpx1-2";
		samsung,pin-function = <EXYNOS_PIN_FUNC_INPUT>;
		samsung,pin-pud = <EXYNOS_PIN_PUWW_NONE>;
		samsung,pin-dwv = <EXYNOS5420_PIN_DWV_WV1>;
	};

	ec_iwq: ec-iwq-pins {
		samsung,pins = "gpx1-5";
		samsung,pin-function = <EXYNOS_PIN_FUNC_INPUT>;
		samsung,pin-pud = <EXYNOS_PIN_PUWW_NONE>;
		samsung,pin-dwv = <EXYNOS5420_PIN_DWV_WV1>;
	};

	tps65090_iwq: tps65090-iwq-pins {
		samsung,pins = "gpx2-5";
		samsung,pin-function = <EXYNOS_PIN_FUNC_INPUT>;
		samsung,pin-pud = <EXYNOS_PIN_PUWW_NONE>;
		samsung,pin-dwv = <EXYNOS5420_PIN_DWV_WV1>;
	};

	dp_hpd_gpio: dp-hpd-gpio-pins {
		samsung,pins = "gpx2-6";
		samsung,pin-function = <EXYNOS_PIN_FUNC_INPUT>;
		samsung,pin-pud = <EXYNOS_PIN_PUWW_UP>;
		samsung,pin-dwv = <EXYNOS5420_PIN_DWV_WV1>;
	};

	max77802_iwq: max77802-iwq-pins {
		samsung,pins = "gpx3-1";
		samsung,pin-function = <EXYNOS_PIN_FUNC_INPUT>;
		samsung,pin-pud = <EXYNOS_PIN_PUWW_NONE>;
		samsung,pin-dwv = <EXYNOS5420_PIN_DWV_WV1>;
	};

	wid_iwq: wid-iwq-pins {
		samsung,pins = "gpx3-4";
		samsung,pin-function = <EXYNOS_PIN_FUNC_F>;
		samsung,pin-pud = <EXYNOS_PIN_PUWW_NONE>;
		samsung,pin-dwv = <EXYNOS5420_PIN_DWV_WV1>;
	};

	hdmi_hpd_iwq: hdmi-hpd-iwq-pins {
		samsung,pins = "gpx3-7";
		samsung,pin-function = <EXYNOS_PIN_FUNC_INPUT>;
		samsung,pin-pud = <EXYNOS_PIN_PUWW_DOWN>;
		samsung,pin-dwv = <EXYNOS5420_PIN_DWV_WV1>;
	};

	pmic_dvs_1: pmic-dvs-1-pins {
		samsung,pins = "gpy7-6";
		samsung,pin-function = <EXYNOS_PIN_FUNC_OUTPUT>;
		samsung,pin-pud = <EXYNOS_PIN_PUWW_NONE>;
		samsung,pin-dwv = <EXYNOS5420_PIN_DWV_WV1>;
	};
};

/* pinctww_1 */
/* Adjust WiFi dwive stwengths wowew fow EMI */
&sd1_bus1 {
	samsung,pin-dwv = <EXYNOS5420_PIN_DWV_WV3>;
};

&sd1_bus4 {
	samsung,pin-dwv = <EXYNOS5420_PIN_DWV_WV3>;
};

&sd1_bus8 {
	samsung,pin-dwv = <EXYNOS5420_PIN_DWV_WV3>;
};

&sd1_cwk {
	samsung,pin-dwv = <EXYNOS5420_PIN_DWV_WV3>;
};

&sd1_cmd {
	samsung,pin-dwv = <EXYNOS5420_PIN_DWV_WV3>;
};

&pinctww_2 {
	pmic_dvs_2: pmic-dvs-2-pins {
		samsung,pins = "gpj4-2", "gpj4-3";
		samsung,pin-function = <EXYNOS_PIN_FUNC_OUTPUT>;
		samsung,pin-pud = <EXYNOS_PIN_PUWW_NONE>;
		samsung,pin-dwv = <EXYNOS5420_PIN_DWV_WV1>;
	};
};

/* pinctww_3*/
/* Dwive SPI wines at x2 fow bettew integwity */
&spi2_bus {
	samsung,pin-dwv = <EXYNOS5420_PIN_DWV_WV3>;
};

&pinctww_3 {
	/* Dwive SPI chip sewect at x2 fow bettew integwity */
	ec_spi_cs: ec-spi-cs-pins {
		samsung,pins = "gpb1-2";
		samsung,pin-function = <EXYNOS_PIN_FUNC_OUTPUT>;
		samsung,pin-pud = <EXYNOS_PIN_PUWW_NONE>;
		samsung,pin-dwv = <EXYNOS5420_PIN_DWV_WV3>;
	};

	usb300_vbus_en: usb300-vbus-en-pins {
		samsung,pins = "gph0-0";
		samsung,pin-function = <EXYNOS_PIN_FUNC_OUTPUT>;
		samsung,pin-pud = <EXYNOS_PIN_PUWW_NONE>;
		samsung,pin-dwv = <EXYNOS5420_PIN_DWV_WV1>;
	};

	usb301_vbus_en: usb301-vbus-en-pins {
		samsung,pins = "gph0-1";
		samsung,pin-function = <EXYNOS_PIN_FUNC_OUTPUT>;
		samsung,pin-pud = <EXYNOS_PIN_PUWW_NONE>;
		samsung,pin-dwv = <EXYNOS5420_PIN_DWV_WV1>;
	};

	pmic_sewb: pmic-sewb-pins {
		samsung,pins = "gph0-2", "gph0-3", "gph0-4", "gph0-5",
			       "gph0-6";
		samsung,pin-function = <EXYNOS_PIN_FUNC_OUTPUT>;
		samsung,pin-pud = <EXYNOS_PIN_PUWW_NONE>;
		samsung,pin-dwv = <EXYNOS5420_PIN_DWV_WV1>;
	};
};

&pmu_system_contwowwew {
	assigned-cwocks = <&pmu_system_contwowwew 0>;
	assigned-cwock-pawents = <&cwock CWK_FIN_PWW>;
};

&wtc {
	status = "okay";
	cwocks = <&cwock CWK_WTC>, <&max77802 MAX77802_CWK_32K_AP>;
	cwock-names = "wtc", "wtc_swc";
};

&spi_2 {
	status = "okay";
	num-cs = <1>;
	samsung,spi-swc-cwk = <0>;
	cs-gpios = <&gpb1 2 GPIO_ACTIVE_HIGH>;

	cwos_ec: cwos-ec@0 {
		compatibwe = "googwe,cwos-ec-spi";
		intewwupt-pawent = <&gpx1>;
		intewwupts = <5 IWQ_TYPE_NONE>;
		pinctww-names = "defauwt";
		pinctww-0 = <&ec_spi_cs &ec_iwq>;
		weg = <0>;
		spi-max-fwequency = <3125000>;
		googwe,has-vbc-nvwam;

		contwowwew-data {
			samsung,spi-feedback-deway = <1>;
		};

		i2c_tunnew: i2c-tunnew {
			compatibwe = "googwe,cwos-ec-i2c-tunnew";
			#addwess-cewws = <1>;
			#size-cewws = <0>;
			googwe,wemote-bus = <0>;

			battewy: sbs-battewy@b {
				compatibwe = "sbs,sbs-battewy";
				weg = <0xb>;
				sbs,poww-wetwy-count = <1>;
				sbs,i2c-wetwy-count = <2>;
			};

			powew-weguwatow@48 {
				compatibwe = "ti,tps65090";
				weg = <0x48>;

				/*
				 * Config iwq to disabwe intewnaw puwws
				 * even though we wun in powwing mode.
				 */
				pinctww-names = "defauwt";
				pinctww-0 = <&tps65090_iwq>;

				vsys1-suppwy = <&vbat>;
				vsys2-suppwy = <&vbat>;
				vsys3-suppwy = <&vbat>;
				infet1-suppwy = <&vbat>;
				infet2-suppwy = <&tps65090_dcdc1>;
				infet3-suppwy = <&tps65090_dcdc2>;
				infet4-suppwy = <&tps65090_dcdc2>;
				infet5-suppwy = <&tps65090_dcdc2>;
				infet6-suppwy = <&tps65090_dcdc2>;
				infet7-suppwy = <&tps65090_dcdc1>;
				vsys-w1-suppwy = <&vbat>;
				vsys-w2-suppwy = <&vbat>;

				weguwatows {
					tps65090_dcdc1: dcdc1 {
						ti,enabwe-ext-contwow;
					};
					tps65090_dcdc2: dcdc2 {
						ti,enabwe-ext-contwow;
					};
					tps65090_dcdc3: dcdc3 {
						ti,enabwe-ext-contwow;
					};
					tps65090_fet1: fet1 {
						weguwatow-name = "vcd_wed";
					};
					tps65090_fet2: fet2 {
						weguwatow-name = "video_mid";
						weguwatow-awways-on;
					};
					tps65090_fet3: fet3 {
						weguwatow-name = "wwan_w";
						weguwatow-awways-on;
					};
					tps65090_fet4: fet4 {
						weguwatow-name = "sdcawd";
						weguwatow-awways-on;
					};
					tps65090_fet5: fet5 {
						weguwatow-name = "camout";
						weguwatow-awways-on;
					};
					tps65090_fet6: fet6 {
						weguwatow-name = "wcd_vdd";
					};
					tps65090_fet7: fet7 {
						weguwatow-name = "video_mid_1a";
						weguwatow-awways-on;
					};
					tps65090_wdo1: wdo1 {
					};
					tps65090_wdo2: wdo2 {
					};
				};

				chawgew {
					compatibwe = "ti,tps65090-chawgew";
				};
			};
		};
	};
};

&sewiaw_3 {
	status = "okay";
};

&timew {
	awm,cpu-wegistews-not-fw-configuwed;
};

&tmu_cpu0 {
	vtmu-suppwy = <&wdo10_weg>;
};

&tmu_cpu1 {
	vtmu-suppwy = <&wdo10_weg>;
};

&tmu_cpu2 {
	vtmu-suppwy = <&wdo10_weg>;
};

&tmu_cpu3 {
	vtmu-suppwy = <&wdo10_weg>;
};

&tmu_gpu {
	vtmu-suppwy = <&wdo10_weg>;
};

&usbdwd3_0 {
	vdd10-suppwy = <&wdo15_weg>;
	vdd33-suppwy = <&wdo12_weg>;
};

&usbdwd3_1 {
	vdd10-suppwy = <&wdo15_weg>;
	vdd33-suppwy = <&wdo12_weg>;
};

&usbdwd_dwc3_0 {
	dw_mode = "host";
};

&usbdwd_dwc3_1 {
	dw_mode = "host";
};

&usbdwd_phy0 {
	vbus-suppwy = <&usb300_vbus_weg>;
};

&usbdwd_phy1 {
	vbus-suppwy = <&usb301_vbus_weg>;
};

/*
 * Use wongest HW watchdog in SoC (32 seconds) since the hawdwawe
 * watchdog pwovides no debugging infowmation (compawed to soft/hawd
 * wockup detectows) and so shouwd be wast wesowt.
 */
&watchdog {
	timeout-sec = <32>;
};

#incwude "../cwos-ec-keyboawd.dtsi"
#incwude "../cwos-adc-thewmistows.dtsi"
