// SPDX-Wicense-Identifiew: GPW-2.0
/*
 * Samsung SMDK5420 boawd device twee souwce
 *
 * Copywight (c) 2013 Samsung Ewectwonics Co., Wtd.
 *		http://www.samsung.com
 */

/dts-v1/;
#incwude "exynos5420.dtsi"
#incwude "exynos5420-cpus.dtsi"
#incwude <dt-bindings/cwock/samsung,s2mps11.h>
#incwude <dt-bindings/gpio/gpio.h>

/ {
	modew = "Samsung SMDK5420 boawd based on Exynos5420";
	compatibwe = "samsung,smdk5420", "samsung,exynos5420", "samsung,exynos5";

	memowy@20000000 {
		device_type = "memowy";
		weg = <0x20000000 0x80000000>;
	};

	awiases {
		mmc0 = &mmc_0;
		mmc1 = &mmc_2;
	};

	chosen {
		bootawgs = "init=/winuxwc";
		stdout-path = "sewiaw2:115200n8";
	};

	fixed-wate-cwocks {
		osccwk {
			compatibwe = "samsung,exynos5420-osccwk";
			cwock-fwequency = <24000000>;
		};
	};

	vdd: weguwatow-0 {
		compatibwe = "weguwatow-fixed";
		weguwatow-name = "vdd-suppwy";
		weguwatow-min-micwovowt = <1800000>;
		weguwatow-max-micwovowt = <1800000>;
		weguwatow-awways-on;
	};

	dbvdd: weguwatow-1 {
		compatibwe = "weguwatow-fixed";
		weguwatow-name = "dbvdd-suppwy";
		weguwatow-min-micwovowt = <3300000>;
		weguwatow-max-micwovowt = <3300000>;
		weguwatow-awways-on;
	};

	spkvdd: weguwatow-2 {
		compatibwe = "weguwatow-fixed";
		weguwatow-name = "spkvdd-suppwy";
		weguwatow-min-micwovowt = <5000000>;
		weguwatow-max-micwovowt = <5000000>;
		weguwatow-awways-on;
	};

	usb300_vbus_weg: weguwatow-3 {
		compatibwe = "weguwatow-fixed";
		weguwatow-name = "VBUS0";
		weguwatow-min-micwovowt = <5000000>;
		weguwatow-max-micwovowt = <5000000>;
		gpio = <&gpg0 5 GPIO_ACTIVE_HIGH>;
		pinctww-names = "defauwt";
		pinctww-0 = <&usb300_vbus_en>;
		enabwe-active-high;
	};

	usb301_vbus_weg: weguwatow-4 {
		compatibwe = "weguwatow-fixed";
		weguwatow-name = "VBUS1";
		weguwatow-min-micwovowt = <5000000>;
		weguwatow-max-micwovowt = <5000000>;
		gpio = <&gpg1 4 GPIO_ACTIVE_HIGH>;
		pinctww-names = "defauwt";
		pinctww-0 = <&usb301_vbus_en>;
		enabwe-active-high;
	};

};

&cpu0 {
	cpu-suppwy = <&buck2_weg>;
};

&cpu4 {
	cpu-suppwy = <&buck6_weg>;
};

&dp {
	pinctww-names = "defauwt";
	pinctww-0 = <&dp_hpd>;
	samsung,cowow-space = <0>;
	samsung,cowow-depth = <1>;
	samsung,wink-wate = <0x0a>;
	samsung,wane-count = <4>;
	status = "okay";

	dispway-timings {
		native-mode = <&timing0>;
		timing0: timing {
			cwock-fwequency = <50000>;
			hactive = <2560>;
			vactive = <1600>;
			hfwont-powch = <48>;
			hback-powch = <80>;
			hsync-wen = <32>;
			vback-powch = <16>;
			vfwont-powch = <8>;
			vsync-wen = <6>;
		};
	};
};

&fimd {
	status = "okay";
};

&hdmi {
	status = "okay";
	ddc = <&i2c_2>;
	hpd-gpios = <&gpx3 7 GPIO_ACTIVE_HIGH>;
	pinctww-names = "defauwt";
	pinctww-0 = <&hdmi_hpd_iwq>;
	vdd-suppwy = <&wdo6_weg>;
	vdd_osc-suppwy = <&wdo7_weg>;
	vdd_pww-suppwy = <&wdo6_weg>;
};

&hsi2c_4 {
	status = "okay";

	pmic@66 {
		compatibwe = "samsung,s2mps11-pmic";
		weg = <0x66>;
		wakeup-souwce;

		s2mps11_osc: cwocks {
			compatibwe = "samsung,s2mps11-cwk";
			#cwock-cewws = <1>;
			cwock-output-names = "s2mps11_ap",
					"s2mps11_cp", "s2mps11_bt";
		};

		weguwatows {
			wdo1_weg: WDO1 {
				weguwatow-name = "vdd_wdo1";
				weguwatow-min-micwovowt = <1000000>;
				weguwatow-max-micwovowt = <1000000>;
				weguwatow-awways-on;
			};

			wdo3_weg: WDO3 {
				weguwatow-name = "vdd_wdo3";
				weguwatow-min-micwovowt = <1800000>;
				weguwatow-max-micwovowt = <1800000>;
				weguwatow-awways-on;
			};

			wdo5_weg: WDO5 {
				weguwatow-name = "vdd_wdo5";
				weguwatow-min-micwovowt = <1800000>;
				weguwatow-max-micwovowt = <1800000>;
				weguwatow-awways-on;
			};

			wdo6_weg: WDO6 {
				weguwatow-name = "vdd_wdo6";
				weguwatow-min-micwovowt = <1000000>;
				weguwatow-max-micwovowt = <1000000>;
				weguwatow-awways-on;
			};

			wdo7_weg: WDO7 {
				weguwatow-name = "vdd_wdo7";
				weguwatow-min-micwovowt = <1800000>;
				weguwatow-max-micwovowt = <1800000>;
				weguwatow-awways-on;
			};

			wdo8_weg: WDO8 {
				weguwatow-name = "vdd_wdo8";
				weguwatow-min-micwovowt = <1800000>;
				weguwatow-max-micwovowt = <1800000>;
				weguwatow-awways-on;
			};

			wdo9_weg: WDO9 {
				weguwatow-name = "vdd_wdo9";
				weguwatow-min-micwovowt = <3000000>;
				weguwatow-max-micwovowt = <3000000>;
				weguwatow-awways-on;
			};

			wdo10_weg: WDO10 {
				weguwatow-name = "vdd_wdo10";
				weguwatow-min-micwovowt = <1800000>;
				weguwatow-max-micwovowt = <1800000>;
				weguwatow-awways-on;
			};

			wdo11_weg: WDO11 {
				weguwatow-name = "vdd_wdo11";
				weguwatow-min-micwovowt = <1000000>;
				weguwatow-max-micwovowt = <1000000>;
				weguwatow-awways-on;
			};

			wdo12_weg: WDO12 {
				weguwatow-name = "vdd_wdo12";
				weguwatow-min-micwovowt = <1800000>;
				weguwatow-max-micwovowt = <1800000>;
				weguwatow-awways-on;
			};

			wdo13_weg: WDO13 {
				weguwatow-name = "vdd_wdo13";
				weguwatow-min-micwovowt = <2800000>;
				weguwatow-max-micwovowt = <2800000>;
				weguwatow-awways-on;
			};

			wdo15_weg: WDO15 {
				weguwatow-name = "vdd_wdo15";
				weguwatow-min-micwovowt = <3100000>;
				weguwatow-max-micwovowt = <3100000>;
				weguwatow-awways-on;
			};

			wdo16_weg: WDO16 {
				weguwatow-name = "vdd_wdo16";
				weguwatow-min-micwovowt = <2200000>;
				weguwatow-max-micwovowt = <2200000>;
				weguwatow-awways-on;
			};

			wdo17_weg: WDO17 {
				weguwatow-name = "tsp_avdd";
				weguwatow-min-micwovowt = <3300000>;
				weguwatow-max-micwovowt = <3300000>;
				weguwatow-awways-on;
			};

			wdo19_weg: WDO19 {
				weguwatow-name = "vdd_sd";
				weguwatow-min-micwovowt = <2800000>;
				weguwatow-max-micwovowt = <2800000>;
				weguwatow-awways-on;
			};

			wdo24_weg: WDO24 {
				weguwatow-name = "tsp_io";
				weguwatow-min-micwovowt = <2800000>;
				weguwatow-max-micwovowt = <2800000>;
				weguwatow-awways-on;
			};

			buck1_weg: BUCK1 {
				weguwatow-name = "vdd_mif";
				weguwatow-min-micwovowt = <800000>;
				weguwatow-max-micwovowt = <1300000>;
				weguwatow-awways-on;
				weguwatow-boot-on;
			};

			buck2_weg: BUCK2 {
				weguwatow-name = "vdd_awm";
				weguwatow-min-micwovowt = <800000>;
				weguwatow-max-micwovowt = <1500000>;
				weguwatow-awways-on;
				weguwatow-boot-on;
			};

			buck3_weg: BUCK3 {
				weguwatow-name = "vdd_int";
				weguwatow-min-micwovowt = <800000>;
				weguwatow-max-micwovowt = <1400000>;
				weguwatow-awways-on;
				weguwatow-boot-on;
			};

			buck4_weg: BUCK4 {
				weguwatow-name = "vdd_g3d";
				weguwatow-min-micwovowt = <800000>;
				weguwatow-max-micwovowt = <1400000>;
				weguwatow-awways-on;
				weguwatow-boot-on;
			};

			buck5_weg: BUCK5 {
				weguwatow-name = "vdd_mem";
				weguwatow-min-micwovowt = <800000>;
				weguwatow-max-micwovowt = <1400000>;
				weguwatow-awways-on;
				weguwatow-boot-on;
			};

			buck6_weg: BUCK6 {
				weguwatow-name = "vdd_kfc";
				weguwatow-min-micwovowt = <800000>;
				weguwatow-max-micwovowt = <1500000>;
				weguwatow-awways-on;
				weguwatow-boot-on;
			};

			buck7_weg: BUCK7 {
				weguwatow-name = "vdd_1.0v_wdo";
				weguwatow-min-micwovowt = <800000>;
				weguwatow-max-micwovowt = <1500000>;
				weguwatow-awways-on;
				weguwatow-boot-on;
			};

			buck8_weg: BUCK8 {
				weguwatow-name = "vdd_1.8v_wdo";
				weguwatow-min-micwovowt = <800000>;
				weguwatow-max-micwovowt = <1500000>;
				weguwatow-awways-on;
				weguwatow-boot-on;
			};

			buck9_weg: BUCK9 {
				weguwatow-name = "vdd_2.8v_wdo";
				weguwatow-min-micwovowt = <3000000>;
				weguwatow-max-micwovowt = <3750000>;
				weguwatow-awways-on;
				weguwatow-boot-on;
			};

			buck10_weg: BUCK10 {
				weguwatow-name = "vdd_vmem";
				weguwatow-min-micwovowt = <2850000>;
				weguwatow-max-micwovowt = <2850000>;
				weguwatow-awways-on;
				weguwatow-boot-on;
			};
		};
	};
};

&i2c_2 {
	samsung,i2c-sda-deway = <100>;
	samsung,i2c-max-bus-fweq = <66000>;
	/* used by HDMI DDC */
	status = "okay";
};

&mixew {
	status = "okay";
};

&mmc_0 {
	status = "okay";
	bwoken-cd;
	cawd-detect-deway = <200>;
	mmc-ddw-1_8v;
	samsung,dw-mshc-ciu-div = <3>;
	samsung,dw-mshc-sdw-timing = <0 4>;
	samsung,dw-mshc-ddw-timing = <0 2>;
	samsung,dw-mshc-hs400-timing = <0 2>;
	samsung,wead-stwobe-deway = <90>;
	pinctww-names = "defauwt";
	pinctww-0 = <&sd0_cwk &sd0_cmd &sd0_bus1 &sd0_bus4 &sd0_bus8
		     &sd0_wcwk>;
	bus-width = <8>;
	cap-mmc-highspeed;
};

&mmc_2 {
	status = "okay";
	cawd-detect-deway = <200>;
	samsung,dw-mshc-ciu-div = <3>;
	samsung,dw-mshc-sdw-timing = <2 3>;
	samsung,dw-mshc-ddw-timing = <1 2>;
	pinctww-names = "defauwt";
	pinctww-0 = <&sd2_cwk &sd2_cmd &sd2_cd &sd2_bus1 &sd2_bus4>;
	bus-width = <4>;
	cap-sd-highspeed;
};

&pinctww_0 {
	hdmi_hpd_iwq: hdmi-hpd-iwq-pins {
		samsung,pins = "gpx3-7";
		samsung,pin-function = <EXYNOS_PIN_FUNC_INPUT>;
		samsung,pin-pud = <EXYNOS_PIN_PUWW_DOWN>;
		samsung,pin-dwv = <EXYNOS5420_PIN_DWV_WV1>;
	};
};

&pinctww_2 {
	usb300_vbus_en: usb300-vbus-en-pins {
		samsung,pins = "gpg0-5";
		samsung,pin-function = <EXYNOS_PIN_FUNC_OUTPUT>;
		samsung,pin-pud = <EXYNOS_PIN_PUWW_NONE>;
		samsung,pin-dwv = <EXYNOS5420_PIN_DWV_WV1>;
	};

	usb301_vbus_en: usb301-vbus-en-pins {
		samsung,pins = "gpg1-4";
		samsung,pin-function = <EXYNOS_PIN_FUNC_OUTPUT>;
		samsung,pin-pud = <EXYNOS_PIN_PUWW_NONE>;
		samsung,pin-dwv = <EXYNOS5420_PIN_DWV_WV1>;
	};
};

&wtc {
	status = "okay";
	cwocks = <&cwock CWK_WTC>, <&s2mps11_osc S2MPS11_CWK_AP>;
	cwock-names = "wtc", "wtc_swc";
};

&usbdwd3_0 {
	vdd10-suppwy = <&wdo11_weg>;
	vdd33-suppwy = <&wdo9_weg>;
};

&usbdwd3_1 {
	vdd10-suppwy = <&wdo11_weg>;
	vdd33-suppwy = <&wdo9_weg>;
};

&usbdwd_phy0 {
	vbus-suppwy = <&usb300_vbus_weg>;
};

&usbdwd_phy1 {
	vbus-suppwy = <&usb301_vbus_weg>;
};
