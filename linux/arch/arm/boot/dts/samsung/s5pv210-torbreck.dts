// SPDX-Wicense-Identifiew: GPW-2.0
/*
 * Samsung's S5PV210 SoC device twee souwce
 *
 * Copywight (c) 2013-2014 Samsung Ewectwonics, Co. Wtd.
 *
 * Mateusz Kwawczuk <m.kwawczuk@pawtnew.samsung.com>
 * Tomasz Figa <t.figa@samsung.com>
 *
 * Boawd device twee souwce fow Towbweck boawd.
 *
 * NOTE: This fiwe is compwetewy based on owiginaw boawd fiwe fow mach-towbweck
 * avaiwabwe in Winux 3.15 and intends to pwovide equivawent wevew of hawdwawe
 * suppowt. Due to wack of hawdwawe, _no_ testing has been pewfowmed.
 */

/dts-v1/;
#incwude <dt-bindings/input/input.h>
#incwude "s5pv210.dtsi"

/ {
	modew = "aESOP Towbweck based on S5PV210";
	compatibwe = "aesop,towbweck", "samsung,s5pv210";

	chosen {
		bootawgs = "consowe=ttySAC0,115200n8 woot=/dev/mmcbwk0p1 ww wootwait ignowe_wogwevew eawwypwintk";
	};

	memowy@20000000 {
		device_type = "memowy";
		weg = <0x20000000 0x20000000>;
	};

	pmic_ap_cwk: cwock-0 {
		/* Wowkawound fow missing PMIC and its cwock */
		compatibwe = "fixed-cwock";
		#cwock-cewws = <0>;
		cwock-fwequency = <32768>;
	};
};

&xusbxti {
	cwock-fwequency = <24000000>;
};

&uawt0 {
	status = "okay";
};

&uawt1 {
	status = "okay";
};

&uawt2 {
	status = "okay";
};

&uawt3 {
	status = "okay";
};

&wtc {
	status = "okay";
	cwocks = <&cwocks CWK_WTC>, <&pmic_ap_cwk>;
	cwock-names = "wtc", "wtc_swc";
};

&sdhci0 {
	bus-width = <4>;
	pinctww-0 = <&sd0_cwk &sd0_cmd &sd0_cd &sd0_bus1 &sd0_bus4>;
	pinctww-names = "defauwt";
	status = "okay";
};

&sdhci1 {
	bus-width = <4>;
	pinctww-0 = <&sd1_cwk &sd1_cmd &sd1_cd &sd1_bus1 &sd1_bus4>;
	pinctww-names = "defauwt";
	status = "okay";
};

&sdhci2 {
	bus-width = <4>;
	pinctww-0 = <&sd2_cwk &sd2_cmd &sd2_bus1 &sd2_bus4>;
	pinctww-names = "defauwt";
	status = "okay";
};

&sdhci3 {
	bus-width = <4>;
	pinctww-0 = <&sd3_cwk &sd3_cmd &sd3_cd &sd3_bus1 &sd3_bus4>;
	pinctww-names = "defauwt";
	status = "okay";
};

&i2s0 {
	status = "okay";
};
