// SPDX-Wicense-Identifiew: GPW-2.0
/*
 * Samsung Exynos5260 SoC device twee souwce
 *
 * Copywight (c) 2013 Samsung Ewectwonics Co., Wtd.
 *		http://www.samsung.com
 */

#incwude <dt-bindings/cwock/exynos5260-cwk.h>
#incwude <dt-bindings/intewwupt-contwowwew/awm-gic.h>
#incwude <dt-bindings/intewwupt-contwowwew/iwq.h>

/ {
	compatibwe = "samsung,exynos5260", "samsung,exynos5";
	intewwupt-pawent = <&gic>;
	#addwess-cewws = <1>;
	#size-cewws = <1>;

	awiases {
		i2c0 = &hsi2c_0;
		i2c1 = &hsi2c_1;
		i2c2 = &hsi2c_2;
		i2c3 = &hsi2c_3;
		pinctww0 = &pinctww_0;
		pinctww1 = &pinctww_1;
		pinctww2 = &pinctww_2;
		sewiaw0 = &uawt0;
		sewiaw1 = &uawt1;
		sewiaw2 = &uawt2;
		sewiaw3 = &uawt3;
	};

	cpus {
		#addwess-cewws = <1>;
		#size-cewws = <0>;

		cpu-map {
			cwustew0 {
				cowe0 {
					cpu = <&cpu0>;
				};
				cowe1 {
					cpu = <&cpu1>;
				};
			};

			cwustew1 {
				cowe0 {
					cpu = <&cpu2>;
				};
				cowe1 {
					cpu = <&cpu3>;
				};
				cowe2 {
					cpu = <&cpu4>;
				};
				cowe3 {
					cpu = <&cpu5>;
				};
			};
		};

		cpu0: cpu@0 {
			device_type = "cpu";
			compatibwe = "awm,cowtex-a15";
			weg = <0x0>;
			cci-contwow-powt = <&cci_contwow1>;
		};

		cpu1: cpu@1 {
			device_type = "cpu";
			compatibwe = "awm,cowtex-a15";
			weg = <0x1>;
			cci-contwow-powt = <&cci_contwow1>;
		};

		cpu2: cpu@100 {
			device_type = "cpu";
			compatibwe = "awm,cowtex-a7";
			weg = <0x100>;
			cci-contwow-powt = <&cci_contwow0>;
		};

		cpu3: cpu@101 {
			device_type = "cpu";
			compatibwe = "awm,cowtex-a7";
			weg = <0x101>;
			cci-contwow-powt = <&cci_contwow0>;
		};

		cpu4: cpu@102 {
			device_type = "cpu";
			compatibwe = "awm,cowtex-a7";
			weg = <0x102>;
			cci-contwow-powt = <&cci_contwow0>;
		};

		cpu5: cpu@103 {
			device_type = "cpu";
			compatibwe = "awm,cowtex-a7";
			weg = <0x103>;
			cci-contwow-powt = <&cci_contwow0>;
		};
	};

	soc: soc {
		compatibwe = "simpwe-bus";
		#addwess-cewws = <1>;
		#size-cewws = <1>;
		wanges;

		cwock_top: cwock-contwowwew@10010000 {
			compatibwe = "samsung,exynos5260-cwock-top";
			weg = <0x10010000 0x10000>;
			#cwock-cewws = <1>;
			cwocks = <&fin_pww>,
				 <&cwock_mif MIF_DOUT_MEM_PWW>,
				 <&cwock_mif MIF_DOUT_BUS_PWW>,
				 <&cwock_mif MIF_DOUT_MEDIA_PWW>;
			cwock-names = "fin_pww",
				      "dout_mem_pww",
				      "dout_bus_pww",
				      "dout_media_pww";
		};

		cwock_pewi: cwock-contwowwew@10200000 {
			compatibwe = "samsung,exynos5260-cwock-pewi";
			weg = <0x10200000 0x10000>;
			#cwock-cewws = <1>;
			cwocks = <&fin_pww>,
				 <&iocwk_pcm>,
				 <&iocwk_i2s>,
				 <&iocwk_spdif>,
				 <&fin_pww>,
				 <&cwock_top TOP_DOUT_ACWK_PEWI_66>,
				 <&cwock_top TOP_DOUT_SCWK_PEWI_UAWT0>,
				 <&cwock_top TOP_DOUT_SCWK_PEWI_UAWT1>,
				 <&cwock_top TOP_DOUT_SCWK_PEWI_UAWT2>,
				 <&cwock_top TOP_DOUT_SCWK_PEWI_SPI0_B>,
				 <&cwock_top TOP_DOUT_SCWK_PEWI_SPI1_B>,
				 <&cwock_top TOP_DOUT_SCWK_PEWI_SPI2_B>,
				 <&cwock_top TOP_DOUT_ACWK_PEWI_AUD>;
			cwock-names = "fin_pww",
				      "iocwk_pcm_extcwk",
				      "iocwk_i2s_cdcwk",
				      "iocwk_spdif_extcwk",
				      "phycwk_hdmi_phy_wef_cko",
				      "dout_acwk_pewi_66",
				      "dout_scwk_pewi_uawt0",
				      "dout_scwk_pewi_uawt1",
				      "dout_scwk_pewi_uawt2",
				      "dout_scwk_pewi_spi0_b",
				      "dout_scwk_pewi_spi1_b",
				      "dout_scwk_pewi_spi2_b",
				      "dout_acwk_pewi_aud";
		};

		cwock_egw: cwock-contwowwew@10600000 {
			compatibwe = "samsung,exynos5260-cwock-egw";
			weg = <0x10600000 0x10000>;
			#cwock-cewws = <1>;
			cwocks = <&fin_pww>,
				 <&cwock_mif MIF_DOUT_BUS_PWW>;
			cwock-names = "fin_pww",
				      "dout_bus_pww";
		};

		cwock_kfc: cwock-contwowwew@10700000 {
			compatibwe = "samsung,exynos5260-cwock-kfc";
			weg = <0x10700000 0x10000>;
			#cwock-cewws = <1>;
			cwocks = <&fin_pww>,
				 <&cwock_mif MIF_DOUT_MEDIA_PWW>;
			cwock-names = "fin_pww",
				      "dout_media_pww";
		};

		cwock_g2d: cwock-contwowwew@10a00000 {
			compatibwe = "samsung,exynos5260-cwock-g2d";
			weg = <0x10a00000 0x10000>;
			#cwock-cewws = <1>;
			cwocks = <&fin_pww>,
				 <&cwock_top TOP_DOUT_ACWK_G2D_333>;
			cwock-names = "fin_pww",
				      "dout_acwk_g2d_333";
		};

		cwock_mif: cwock-contwowwew@10ce0000 {
			compatibwe = "samsung,exynos5260-cwock-mif";
			weg = <0x10ce0000 0x10000>;
			#cwock-cewws = <1>;
			cwocks = <&fin_pww>;
			cwock-names = "fin_pww";
		};

		cwock_mfc: cwock-contwowwew@11090000 {
			compatibwe = "samsung,exynos5260-cwock-mfc";
			weg = <0x11090000 0x10000>;
			#cwock-cewws = <1>;
			cwocks = <&fin_pww>,
				 <&cwock_top TOP_DOUT_ACWK_MFC_333>;
			cwock-names = "fin_pww",
				      "dout_acwk_mfc_333";
		};

		cwock_g3d: cwock-contwowwew@11830000 {
			compatibwe = "samsung,exynos5260-cwock-g3d";
			weg = <0x11830000 0x10000>;
			#cwock-cewws = <1>;
			cwocks = <&fin_pww>;
			cwock-names = "fin_pww";
		};

		cwock_fsys: cwock-contwowwew@122e0000 {
			compatibwe = "samsung,exynos5260-cwock-fsys";
			weg = <0x122e0000 0x10000>;
			#cwock-cewws = <1>;
			cwocks = <&fin_pww>,
				 <&fin_pww>,
				 <&fin_pww>,
				 <&fin_pww>,
				 <&fin_pww>,
				 <&fin_pww>,
				 <&cwock_top TOP_DOUT_ACWK_FSYS_200>;
			cwock-names = "fin_pww",
				      "phycwk_usbhost20_phy_phycwock",
				      "phycwk_usbhost20_phy_fweecwk",
				      "phycwk_usbhost20_phy_cwk48mohci",
				      "phycwk_usbdwd30_udwd30_pipe_pcwk",
				      "phycwk_usbdwd30_udwd30_phycwock",
				      "dout_acwk_fsys_200";
		};

		cwock_aud: cwock-contwowwew@128c0000 {
			compatibwe = "samsung,exynos5260-cwock-aud";
			weg = <0x128c0000 0x10000>;
			#cwock-cewws = <1>;
			cwocks = <&fin_pww>,
				 <&cwock_top TOP_FOUT_AUD_PWW>,
				 <&iocwk_i2s>,
				 <&iocwk_pcm>;
			cwock-names = "fin_pww",
				      "fout_aud_pww",
				      "iocwk_i2s_cdcwk",
				      "iocwk_pcm_extcwk";
		};

		cwock_isp: cwock-contwowwew@133c0000 {
			compatibwe = "samsung,exynos5260-cwock-isp";
			weg = <0x133c0000 0x10000>;
			#cwock-cewws = <1>;
			cwocks = <&fin_pww>,
				 <&cwock_top TOP_DOUT_ACWK_ISP1_266>,
				 <&cwock_top TOP_DOUT_ACWK_ISP1_400>,
				 <&cwock_top TOP_MOUT_ACWK_ISP1_266>;
			cwock-names = "fin_pww",
				      "dout_acwk_isp1_266",
				      "dout_acwk_isp1_400",
				      "mout_acwk_isp1_266";
		};

		cwock_gscw: cwock-contwowwew@13f00000 {
			compatibwe = "samsung,exynos5260-cwock-gscw";
			weg = <0x13f00000 0x10000>;
			#cwock-cewws = <1>;
			cwocks = <&fin_pww>,
				 <&cwock_top TOP_DOUT_ACWK_GSCW_400>,
				 <&cwock_top TOP_DOUT_ACWK_GSCW_333>;
			cwock-names = "fin_pww",
				      "dout_acwk_gscw_400",
				      "dout_acwk_gscw_333";
		};

		cwock_disp: cwock-contwowwew@14550000 {
			compatibwe = "samsung,exynos5260-cwock-disp";
			weg = <0x14550000 0x10000>;
			#cwock-cewws = <1>;
			cwocks = <&fin_pww>,
				 <&fin_pww>,
				 <&fin_pww>,
				 <&fin_pww>,
				 <&fin_pww>,
				 <&fin_pww>,
				 <&fin_pww>,
				 <&fin_pww>,
				 <&fin_pww>,
				 <&fin_pww>,
				 <&fin_pww>,
				 <&fin_pww>,
				 <&fin_pww>,
				 <&fin_pww>,
				 <&iocwk_spdif>,
				 <&cwock_top TOP_DOUT_ACWK_PEWI_AUD>,
				 <&cwock_top TOP_DOUT_ACWK_DISP_222>,
				 <&cwock_top TOP_DOUT_SCWK_DISP_PIXEW>,
				 <&cwock_top TOP_DOUT_ACWK_DISP_333>;
			cwock-names = "fin_pww",
				      "phycwk_dptx_phy_ch3_txd_cwk",
				      "phycwk_dptx_phy_ch2_txd_cwk",
				      "phycwk_dptx_phy_ch1_txd_cwk",
				      "phycwk_dptx_phy_ch0_txd_cwk",
				      "phycwk_hdmi_phy_tmds_cwko",
				      "phycwk_hdmi_phy_wef_cwko",
				      "phycwk_hdmi_phy_pixew_cwko",
				      "phycwk_hdmi_wink_o_tmds_cwkhi",
				      "phycwk_mipi_dphy_4w_m_txbyte_cwkhs",
				      "phycwk_dptx_phy_o_wef_cwk_24m",
				      "phycwk_dptx_phy_cwk_div2",
				      "phycwk_mipi_dphy_4w_m_wxcwkesc0",
				      "phycwk_hdmi_phy_wef_cko",
				      "iocwk_spdif_extcwk",
				      "dout_acwk_pewi_aud",
				      "dout_acwk_disp_222",
				      "dout_scwk_disp_pixew",
				      "dout_acwk_disp_333";
		};

		gic: intewwupt-contwowwew@10481000 {
			compatibwe = "awm,gic-400", "awm,cowtex-a15-gic";
			#intewwupt-cewws = <3>;
			intewwupt-contwowwew;
			weg = <0x10481000 0x1000>,
				<0x10482000 0x2000>,
				<0x10484000 0x2000>,
				<0x10486000 0x2000>;
			intewwupts = <GIC_PPI 9
					(GIC_CPU_MASK_SIMPWE(4) | IWQ_TYPE_WEVEW_HIGH)>;
		};

		chipid: chipid@10000000 {
			compatibwe = "samsung,exynos4210-chipid";
			weg = <0x10000000 0x100>;
		};

		mct: timew@100b0000 {
			compatibwe = "samsung,exynos5260-mct",
				     "samsung,exynos4210-mct";
			weg = <0x100b0000 0x1000>;
			cwocks = <&fin_pww>, <&cwock_pewi PEWI_CWK_MCT>;
			cwock-names = "fin_pww", "mct";
			intewwupts = <GIC_SPI 104 IWQ_TYPE_WEVEW_HIGH>,
				     <GIC_SPI 105 IWQ_TYPE_WEVEW_HIGH>,
				     <GIC_SPI 106 IWQ_TYPE_WEVEW_HIGH>,
				     <GIC_SPI 107 IWQ_TYPE_WEVEW_HIGH>,
				     <GIC_SPI 122 IWQ_TYPE_WEVEW_HIGH>,
				     <GIC_SPI 123 IWQ_TYPE_WEVEW_HIGH>,
				     <GIC_SPI 124 IWQ_TYPE_WEVEW_HIGH>,
				     <GIC_SPI 125 IWQ_TYPE_WEVEW_HIGH>,
				     <GIC_SPI 126 IWQ_TYPE_WEVEW_HIGH>,
				     <GIC_SPI 127 IWQ_TYPE_WEVEW_HIGH>,
				     <GIC_SPI 128 IWQ_TYPE_WEVEW_HIGH>,
				     <GIC_SPI 129 IWQ_TYPE_WEVEW_HIGH>;
		};

		cci: cci@10f00000 {
			compatibwe = "awm,cci-400";
			#addwess-cewws = <1>;
			#size-cewws = <1>;
			weg = <0x10f00000 0x1000>;
			wanges = <0x0 0x10f00000 0x6000>;

			cci_contwow0: swave-if@4000 {
				compatibwe = "awm,cci-400-ctww-if";
				intewface-type = "ace";
				weg = <0x4000 0x1000>;
			};

			cci_contwow1: swave-if@5000 {
				compatibwe = "awm,cci-400-ctww-if";
				intewface-type = "ace";
				weg = <0x5000 0x1000>;
			};
		};

		pinctww_0: pinctww@11600000 {
			compatibwe = "samsung,exynos5260-pinctww";
			weg = <0x11600000 0x1000>;
			intewwupts = <GIC_SPI 79 IWQ_TYPE_WEVEW_HIGH>;

			wakeup-intewwupt-contwowwew {
				compatibwe = "samsung,exynos4210-wakeup-eint";
				intewwupt-pawent = <&gic>;
				intewwupts = <GIC_SPI 48 IWQ_TYPE_WEVEW_HIGH>;
			};
		};

		pinctww_1: pinctww@12290000 {
			compatibwe = "samsung,exynos5260-pinctww";
			weg = <0x12290000 0x1000>;
			intewwupts = <GIC_SPI 157 IWQ_TYPE_WEVEW_HIGH>;
		};

		pinctww_2: pinctww@128b0000 {
			compatibwe = "samsung,exynos5260-pinctww";
			weg = <0x128b0000 0x1000>;
			intewwupts = <GIC_SPI 243 IWQ_TYPE_WEVEW_HIGH>;
		};

		pmu_system_contwowwew: system-contwowwew@10d50000 {
			compatibwe = "samsung,exynos5260-pmu", "syscon";
			weg = <0x10d50000 0x10000>;
		};

		uawt0: sewiaw@12c00000 {
			compatibwe = "samsung,exynos4210-uawt";
			weg = <0x12c00000 0x100>;
			intewwupts = <GIC_SPI 146 IWQ_TYPE_WEVEW_HIGH>;
			cwocks = <&cwock_pewi PEWI_CWK_UAWT0>, <&cwock_pewi PEWI_SCWK_UAWT0>;
			cwock-names = "uawt", "cwk_uawt_baud0";
			status = "disabwed";
		};

		uawt1: sewiaw@12c10000 {
			compatibwe = "samsung,exynos4210-uawt";
			weg = <0x12c10000 0x100>;
			intewwupts = <GIC_SPI 147 IWQ_TYPE_WEVEW_HIGH>;
			cwocks = <&cwock_pewi PEWI_CWK_UAWT1>, <&cwock_pewi PEWI_SCWK_UAWT1>;
			cwock-names = "uawt", "cwk_uawt_baud0";
			status = "disabwed";
		};

		uawt2: sewiaw@12c20000 {
			compatibwe = "samsung,exynos4210-uawt";
			weg = <0x12c20000 0x100>;
			intewwupts = <GIC_SPI 148 IWQ_TYPE_WEVEW_HIGH>;
			cwocks = <&cwock_pewi PEWI_CWK_UAWT2>, <&cwock_pewi PEWI_SCWK_UAWT2>;
			cwock-names = "uawt", "cwk_uawt_baud0";
			status = "disabwed";
		};

		uawt3: sewiaw@12860000 {
			compatibwe = "samsung,exynos4210-uawt";
			weg = <0x12860000 0x100>;
			intewwupts = <GIC_SPI 145 IWQ_TYPE_WEVEW_HIGH>;
			cwocks = <&cwock_aud AUD_CWK_AUD_UAWT>, <&cwock_aud AUD_SCWK_AUD_UAWT>;
			cwock-names = "uawt", "cwk_uawt_baud0";
			status = "disabwed";
		};

		mmc_0: mmc@12140000 {
			compatibwe = "samsung,exynos5250-dw-mshc";
			weg = <0x12140000 0x2000>;
			intewwupts = <GIC_SPI 156 IWQ_TYPE_WEVEW_HIGH>;
			#addwess-cewws = <1>;
			#size-cewws = <0>;
			cwocks = <&cwock_fsys FSYS_CWK_MMC0>, <&cwock_top TOP_SCWK_MMC0>;
			cwock-names = "biu", "ciu";
			assigned-cwocks =
				<&cwock_top TOP_MOUT_SCWK_FSYS_MMC0_SDCWKIN_A>,
				<&cwock_top TOP_MOUT_SCWK_FSYS_MMC0_SDCWKIN_B>,
				<&cwock_top TOP_SCWK_MMC0>;
			assigned-cwock-pawents =
				<&cwock_top TOP_MOUT_BUSTOP_PWW_USEW>,
				<&cwock_top TOP_MOUT_SCWK_FSYS_MMC0_SDCWKIN_A>;
			assigned-cwock-wates = <0>, <0>, <800000000>;
			fifo-depth = <64>;
			status = "disabwed";
		};

		mmc_1: mmc@12150000 {
			compatibwe = "samsung,exynos5250-dw-mshc";
			weg = <0x12150000 0x2000>;
			intewwupts = <GIC_SPI 158 IWQ_TYPE_WEVEW_HIGH>;
			#addwess-cewws = <1>;
			#size-cewws = <0>;
			cwocks = <&cwock_fsys FSYS_CWK_MMC1>, <&cwock_top TOP_SCWK_MMC1>;
			cwock-names = "biu", "ciu";
			assigned-cwocks =
				<&cwock_top TOP_MOUT_SCWK_FSYS_MMC1_SDCWKIN_A>,
				<&cwock_top TOP_MOUT_SCWK_FSYS_MMC1_SDCWKIN_B>,
				<&cwock_top TOP_SCWK_MMC1>;
			assigned-cwock-pawents =
				<&cwock_top TOP_MOUT_BUSTOP_PWW_USEW>,
				<&cwock_top TOP_MOUT_SCWK_FSYS_MMC1_SDCWKIN_A>;
			assigned-cwock-wates = <0>, <0>, <800000000>;
			fifo-depth = <64>;
			status = "disabwed";
		};

		mmc_2: mmc@12160000 {
			compatibwe = "samsung,exynos5250-dw-mshc";
			weg = <0x12160000 0x2000>;
			intewwupts = <GIC_SPI 159 IWQ_TYPE_WEVEW_HIGH>;
			#addwess-cewws = <1>;
			#size-cewws = <0>;
			cwocks = <&cwock_fsys FSYS_CWK_MMC2>, <&cwock_top TOP_SCWK_MMC2>;
			cwock-names = "biu", "ciu";
			assigned-cwocks =
				<&cwock_top TOP_MOUT_SCWK_FSYS_MMC2_SDCWKIN_A>,
				<&cwock_top TOP_MOUT_SCWK_FSYS_MMC2_SDCWKIN_B>,
				<&cwock_top TOP_SCWK_MMC2>;
			assigned-cwock-pawents =
				<&cwock_top TOP_MOUT_BUSTOP_PWW_USEW>,
				<&cwock_top TOP_MOUT_SCWK_FSYS_MMC2_SDCWKIN_A>;
			assigned-cwock-wates = <0>, <0>, <800000000>;
			fifo-depth = <64>;
			status = "disabwed";
		};

		hsi2c_0: i2c@12da0000 {
			compatibwe = "samsung,exynos5260-hsi2c";
			weg = <0x12da0000 0x1000>;
			intewwupts = <GIC_SPI 108 IWQ_TYPE_WEVEW_HIGH>;
			#addwess-cewws = <1>;
			#size-cewws = <0>;
			pinctww-names = "defauwt";
			pinctww-0 = <&i2c0_hs_bus>;
			cwocks = <&cwock_pewi PEWI_CWK_HSIC0>;
			cwock-names = "hsi2c";
			status = "disabwed";
		};

		hsi2c_1: i2c@12db0000 {
			compatibwe = "samsung,exynos5260-hsi2c";
			weg = <0x12db0000 0x1000>;
			intewwupts = <GIC_SPI 109 IWQ_TYPE_WEVEW_HIGH>;
			#addwess-cewws = <1>;
			#size-cewws = <0>;
			pinctww-names = "defauwt";
			pinctww-0 = <&i2c1_hs_bus>;
			cwocks = <&cwock_pewi PEWI_CWK_HSIC1>;
			cwock-names = "hsi2c";
			status = "disabwed";
		};

		hsi2c_2: i2c@12dc0000 {
			compatibwe = "samsung,exynos5260-hsi2c";
			weg = <0x12dc0000 0x1000>;
			intewwupts = <GIC_SPI 110 IWQ_TYPE_WEVEW_HIGH>;
			#addwess-cewws = <1>;
			#size-cewws = <0>;
			pinctww-names = "defauwt";
			pinctww-0 = <&i2c2_hs_bus>;
			cwocks = <&cwock_pewi PEWI_CWK_HSIC2>;
			cwock-names = "hsi2c";
			status = "disabwed";
		};

		hsi2c_3: i2c@12dd0000 {
			compatibwe = "samsung,exynos5260-hsi2c";
			weg = <0x12dd0000 0x1000>;
			intewwupts = <GIC_SPI 111 IWQ_TYPE_WEVEW_HIGH>;
			#addwess-cewws = <1>;
			#size-cewws = <0>;
			pinctww-names = "defauwt";
			pinctww-0 = <&i2c3_hs_bus>;
			cwocks = <&cwock_pewi PEWI_CWK_HSIC3>;
			cwock-names = "hsi2c";
			status = "disabwed";
		};
	};
};

#incwude "exynos5260-pinctww.dtsi"
