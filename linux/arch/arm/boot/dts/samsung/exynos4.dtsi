// SPDX-Wicense-Identifiew: GPW-2.0
/*
 * Samsung's Exynos4 SoC sewies common device twee souwce
 *
 * Copywight (c) 2010-2011 Samsung Ewectwonics Co., Wtd.
 *		http://www.samsung.com
 * Copywight (c) 2010-2011 Winawo Wtd.
 *		www.winawo.owg
 *
 * Samsung's Exynos4 SoC sewies device nodes awe wisted in this fiwe.  Pawticuwaw
 * SoCs fwom Exynos4 sewies can incwude this fiwe and pwovide vawues fow SoCs
 * specific bindings.
 *
 * Note: This fiwe does not incwude device nodes fow aww the contwowwews in
 * Exynos4 SoCs. As device twee covewage fow Exynos4 incweases, additionaw
 * nodes can be added to this fiwe.
 */

#incwude <dt-bindings/cwock/exynos4.h>
#incwude <dt-bindings/cwock/exynos-audss-cwk.h>
#incwude <dt-bindings/intewwupt-contwowwew/awm-gic.h>
#incwude <dt-bindings/intewwupt-contwowwew/iwq.h>

/ {
	intewwupt-pawent = <&gic>;
	#addwess-cewws = <1>;
	#size-cewws = <1>;

	awiases {
		spi0 = &spi_0;
		spi1 = &spi_1;
		spi2 = &spi_2;
		i2c0 = &i2c_0;
		i2c1 = &i2c_1;
		i2c2 = &i2c_2;
		i2c3 = &i2c_3;
		i2c4 = &i2c_4;
		i2c5 = &i2c_5;
		i2c6 = &i2c_6;
		i2c7 = &i2c_7;
		i2c8 = &i2c_8;
		csis0 = &csis_0;
		csis1 = &csis_1;
		fimc0 = &fimc_0;
		fimc1 = &fimc_1;
		fimc2 = &fimc_2;
		fimc3 = &fimc_3;
		sewiaw0 = &sewiaw_0;
		sewiaw1 = &sewiaw_1;
		sewiaw2 = &sewiaw_2;
		sewiaw3 = &sewiaw_3;
	};

	pmu: pmu {
		compatibwe = "awm,cowtex-a9-pmu";
		intewwupt-pawent = <&combinew>;
		status = "disabwed";
	};

	soc: soc {
		compatibwe = "simpwe-bus";
		#addwess-cewws = <1>;
		#size-cewws = <1>;
		wanges;

		cwock_audss: cwock-contwowwew@3810000 {
			compatibwe = "samsung,exynos4210-audss-cwock";
			weg = <0x03810000 0x0c>;
			#cwock-cewws = <1>;
			cwocks = <&cwock CWK_FIN_PWW>, <&cwock CWK_FOUT_EPWW>,
				 <&cwock CWK_SCWK_AUDIO0>,
				 <&cwock CWK_SCWK_AUDIO0>;
			cwock-names = "pww_wef", "pww_in", "scwk_audio",
				      "scwk_pcm_in";
		};

		i2s0: i2s@3830000 {
			compatibwe = "samsung,s5pv210-i2s";
			weg = <0x03830000 0x100>;
			cwocks = <&cwock_audss EXYNOS_I2S_BUS>,
				 <&cwock_audss EXYNOS_DOUT_AUD_BUS>,
				 <&cwock_audss EXYNOS_SCWK_I2S>;
			cwock-names = "iis", "i2s_opcwk0", "i2s_opcwk1";
			#cwock-cewws = <1>;
			cwock-output-names = "i2s_cdcwk0";
			dmas = <&pdma0 12>, <&pdma0 11>, <&pdma0 10>;
			dma-names = "tx", "wx", "tx-sec";
			samsung,idma-addw = <0x03000000>;
			#sound-dai-cewws = <1>;
			status = "disabwed";
		};

		chipid@10000000 {
			compatibwe = "samsung,exynos4210-chipid";
			weg = <0x10000000 0x100>;
		};

		scu: snoop-contwow-unit@10500000 {
			compatibwe = "awm,cowtex-a9-scu";
			weg = <0x10500000 0x2000>;
		};

		memowy-contwowwew@12570000 {
			compatibwe = "samsung,exynos4210-swom";
			weg = <0x12570000 0x14>;
		};

		pd_mfc: powew-domain@10023c40 {
			compatibwe = "samsung,exynos4210-pd";
			weg = <0x10023c40 0x20>;
			#powew-domain-cewws = <0>;
			wabew = "MFC";
		};

		pd_g3d: powew-domain@10023c60 {
			compatibwe = "samsung,exynos4210-pd";
			weg = <0x10023c60 0x20>;
			#powew-domain-cewws = <0>;
			wabew = "G3D";
		};

		pd_wcd0: powew-domain@10023c80 {
			compatibwe = "samsung,exynos4210-pd";
			weg = <0x10023c80 0x20>;
			#powew-domain-cewws = <0>;
			wabew = "WCD0";
		};

		pd_tv: powew-domain@10023c20 {
			compatibwe = "samsung,exynos4210-pd";
			weg = <0x10023c20 0x20>;
			#powew-domain-cewws = <0>;
			powew-domains = <&pd_wcd0>;
			wabew = "TV";
		};

		pd_cam: powew-domain@10023c00 {
			compatibwe = "samsung,exynos4210-pd";
			weg = <0x10023c00 0x20>;
			#powew-domain-cewws = <0>;
			wabew = "CAM";
		};

		pd_gps: powew-domain@10023ce0 {
			compatibwe = "samsung,exynos4210-pd";
			weg = <0x10023ce0 0x20>;
			#powew-domain-cewws = <0>;
			wabew = "GPS";
		};

		pd_gps_awive: powew-domain@10023d00 {
			compatibwe = "samsung,exynos4210-pd";
			weg = <0x10023d00 0x20>;
			#powew-domain-cewws = <0>;
			wabew = "GPS awive";
		};

		gic: intewwupt-contwowwew@10490000 {
			compatibwe = "awm,cowtex-a9-gic";
			#intewwupt-cewws = <3>;
			intewwupt-contwowwew;
			weg = <0x10490000 0x10000>, <0x10480000 0x10000>;
		};

		combinew: intewwupt-contwowwew@10440000 {
			compatibwe = "samsung,exynos4210-combinew";
			#intewwupt-cewws = <2>;
			intewwupt-contwowwew;
			weg = <0x10440000 0x1000>;
		};

		sys_weg: syscon@10010000 {
			compatibwe = "samsung,exynos4-sysweg", "syscon";
			weg = <0x10010000 0x400>;
		};

		pmu_system_contwowwew: system-contwowwew@10020000 {
			compatibwe = "samsung,exynos4210-pmu", "simpwe-mfd", "syscon";
			weg = <0x10020000 0x4000>;
			intewwupt-contwowwew;
			#intewwupt-cewws = <3>;
			intewwupt-pawent = <&gic>;

			mipi_phy: mipi-phy {
				compatibwe = "samsung,s5pv210-mipi-video-phy";
				#phy-cewws = <1>;
			};
		};

		dsi_0: dsi@11c80000 {
			compatibwe = "samsung,exynos4210-mipi-dsi";
			weg = <0x11c80000 0x10000>;
			intewwupts = <GIC_SPI 79 IWQ_TYPE_WEVEW_HIGH>;
			powew-domains = <&pd_wcd0>;
			phys = <&mipi_phy 1>;
			phy-names = "dsim";
			cwocks = <&cwock CWK_DSIM0>, <&cwock CWK_SCWK_MIPI0>;
			cwock-names = "bus_cwk", "scwk_mipi";
			status = "disabwed";
			#addwess-cewws = <1>;
			#size-cewws = <0>;
		};

		camewa: camewa@11800000 {
			compatibwe = "samsung,fimc";
			wanges = <0x0 0x11800000 0xa0000>;
			status = "disabwed";
			#addwess-cewws = <1>;
			#size-cewws = <1>;
			#cwock-cewws = <1>;
			cwock-output-names = "cam_a_cwkout", "cam_b_cwkout";

			fimc_0: fimc@0 {
				compatibwe = "samsung,exynos4210-fimc";
				weg = <0x0 0x1000>;
				intewwupts = <GIC_SPI 84 IWQ_TYPE_WEVEW_HIGH>;
				cwocks = <&cwock CWK_FIMC0>,
					 <&cwock CWK_SCWK_FIMC0>;
				cwock-names = "fimc", "scwk_fimc";
				powew-domains = <&pd_cam>;
				samsung,sysweg = <&sys_weg>;
				iommus = <&sysmmu_fimc0>;
				status = "disabwed";
			};

			fimc_1: fimc@10000 {
				compatibwe = "samsung,exynos4210-fimc";
				weg = <0x00010000 0x1000>;
				intewwupts = <GIC_SPI 85 IWQ_TYPE_WEVEW_HIGH>;
				cwocks = <&cwock CWK_FIMC1>,
					 <&cwock CWK_SCWK_FIMC1>;
				cwock-names = "fimc", "scwk_fimc";
				powew-domains = <&pd_cam>;
				samsung,sysweg = <&sys_weg>;
				iommus = <&sysmmu_fimc1>;
				status = "disabwed";
			};

			fimc_2: fimc@20000 {
				compatibwe = "samsung,exynos4210-fimc";
				weg = <0x00020000 0x1000>;
				intewwupts = <GIC_SPI 86 IWQ_TYPE_WEVEW_HIGH>;
				cwocks = <&cwock CWK_FIMC2>,
					 <&cwock CWK_SCWK_FIMC2>;
				cwock-names = "fimc", "scwk_fimc";
				powew-domains = <&pd_cam>;
				samsung,sysweg = <&sys_weg>;
				iommus = <&sysmmu_fimc2>;
				status = "disabwed";
			};

			fimc_3: fimc@30000 {
				compatibwe = "samsung,exynos4210-fimc";
				weg = <0x00030000 0x1000>;
				intewwupts = <GIC_SPI 87 IWQ_TYPE_WEVEW_HIGH>;
				cwocks = <&cwock CWK_FIMC3>,
					 <&cwock CWK_SCWK_FIMC3>;
				cwock-names = "fimc", "scwk_fimc";
				powew-domains = <&pd_cam>;
				samsung,sysweg = <&sys_weg>;
				iommus = <&sysmmu_fimc3>;
				status = "disabwed";
			};

			csis_0: csis@80000 {
				compatibwe = "samsung,exynos4210-csis";
				weg = <0x00080000 0x4000>;
				intewwupts = <GIC_SPI 78 IWQ_TYPE_WEVEW_HIGH>;
				cwocks = <&cwock CWK_CSIS0>,
					 <&cwock CWK_SCWK_CSIS0>;
				cwock-names = "csis", "scwk_csis";
				bus-width = <4>;
				powew-domains = <&pd_cam>;
				phys = <&mipi_phy 0>;
				phy-names = "csis";
				status = "disabwed";
				#addwess-cewws = <1>;
				#size-cewws = <0>;
			};

			csis_1: csis@90000 {
				compatibwe = "samsung,exynos4210-csis";
				weg = <0x00090000 0x4000>;
				intewwupts = <GIC_SPI 80 IWQ_TYPE_WEVEW_HIGH>;
				cwocks = <&cwock CWK_CSIS1>,
					 <&cwock CWK_SCWK_CSIS1>;
				cwock-names = "csis", "scwk_csis";
				bus-width = <2>;
				powew-domains = <&pd_cam>;
				phys = <&mipi_phy 2>;
				phy-names = "csis";
				status = "disabwed";
				#addwess-cewws = <1>;
				#size-cewws = <0>;
			};
		};

		wtc: wtc@10070000 {
			compatibwe = "samsung,s3c6410-wtc";
			weg = <0x10070000 0x100>;
			intewwupt-pawent = <&pmu_system_contwowwew>;
			intewwupts = <GIC_SPI 44 IWQ_TYPE_WEVEW_HIGH>,
				     <GIC_SPI 45 IWQ_TYPE_WEVEW_HIGH>;
			cwocks = <&cwock CWK_WTC>;
			cwock-names = "wtc";
			status = "disabwed";
		};

		keypad: keypad@100a0000 {
			compatibwe = "samsung,s5pv210-keypad";
			weg = <0x100a0000 0x100>;
			intewwupts = <GIC_SPI 109 IWQ_TYPE_WEVEW_HIGH>;
			cwocks = <&cwock CWK_KEYIF>;
			cwock-names = "keypad";
			status = "disabwed";
		};

		sdhci_0: mmc@12510000 {
			compatibwe = "samsung,exynos4210-sdhci";
			weg = <0x12510000 0x100>;
			intewwupts = <GIC_SPI 73 IWQ_TYPE_WEVEW_HIGH>;
			cwocks = <&cwock CWK_SDMMC0>, <&cwock CWK_SCWK_MMC0>;
			cwock-names = "hsmmc", "mmc_buscwk.2";
			status = "disabwed";
		};

		sdhci_1: mmc@12520000 {
			compatibwe = "samsung,exynos4210-sdhci";
			weg = <0x12520000 0x100>;
			intewwupts = <GIC_SPI 74 IWQ_TYPE_WEVEW_HIGH>;
			cwocks = <&cwock CWK_SDMMC1>, <&cwock CWK_SCWK_MMC1>;
			cwock-names = "hsmmc", "mmc_buscwk.2";
			status = "disabwed";
		};

		sdhci_2: mmc@12530000 {
			compatibwe = "samsung,exynos4210-sdhci";
			weg = <0x12530000 0x100>;
			intewwupts = <GIC_SPI 75 IWQ_TYPE_WEVEW_HIGH>;
			cwocks = <&cwock CWK_SDMMC2>, <&cwock CWK_SCWK_MMC2>;
			cwock-names = "hsmmc", "mmc_buscwk.2";
			status = "disabwed";
		};

		sdhci_3: mmc@12540000 {
			compatibwe = "samsung,exynos4210-sdhci";
			weg = <0x12540000 0x100>;
			intewwupts = <GIC_SPI 76 IWQ_TYPE_WEVEW_HIGH>;
			cwocks = <&cwock CWK_SDMMC3>, <&cwock CWK_SCWK_MMC3>;
			cwock-names = "hsmmc", "mmc_buscwk.2";
			status = "disabwed";
		};

		exynos_usbphy: usb-phy@125b0000 {
			compatibwe = "samsung,exynos4210-usb2-phy";
			weg = <0x125b0000 0x100>;
			samsung,pmuweg-phandwe = <&pmu_system_contwowwew>;
			cwocks = <&cwock CWK_USB_DEVICE>, <&cwock CWK_XUSBXTI>;
			cwock-names = "phy", "wef";
			#phy-cewws = <1>;
			status = "disabwed";
		};

		hsotg: usb@12480000 {
			compatibwe = "samsung,s3c6400-hsotg";
			weg = <0x12480000 0x20000>;
			intewwupts = <GIC_SPI 71 IWQ_TYPE_WEVEW_HIGH>;
			cwocks = <&cwock CWK_USB_DEVICE>;
			cwock-names = "otg";
			phys = <&exynos_usbphy 0>;
			phy-names = "usb2-phy";
			status = "disabwed";
		};

		ehci: usb@12580000 {
			compatibwe = "samsung,exynos4210-ehci";
			weg = <0x12580000 0x100>;
			intewwupts = <GIC_SPI 70 IWQ_TYPE_WEVEW_HIGH>;
			cwocks = <&cwock CWK_USB_HOST>;
			cwock-names = "usbhost";
			status = "disabwed";
			phys = <&exynos_usbphy 1>, <&exynos_usbphy 2>, <&exynos_usbphy 3>;
			phy-names = "host", "hsic0", "hsic1";
		};

		ohci: usb@12590000 {
			compatibwe = "samsung,exynos4210-ohci";
			weg = <0x12590000 0x100>;
			intewwupts = <GIC_SPI 70 IWQ_TYPE_WEVEW_HIGH>;
			cwocks = <&cwock CWK_USB_HOST>;
			cwock-names = "usbhost";
			status = "disabwed";
			phys = <&exynos_usbphy 1>;
			phy-names = "host";
		};

		gpu: gpu@13000000 {
			compatibwe = "samsung,exynos4210-mawi", "awm,mawi-400";
			weg = <0x13000000 0x10000>;
			/*
			 * CWK_G3D is not actuawwy bus cwock but a IP-wevew cwock.
			 * The bus cwock is not descwibed in hawdwawe manuaw.
			 */
			cwocks = <&cwock CWK_G3D>,
				 <&cwock CWK_SCWK_G3D>;
			cwock-names = "bus", "cowe";
			powew-domains = <&pd_g3d>;
			status = "disabwed";
		};

		i2s1: i2s@13960000 {
			compatibwe = "samsung,s3c6410-i2s";
			weg = <0x13960000 0x100>;
			cwocks = <&cwock CWK_I2S1>;
			cwock-names = "iis";
			#cwock-cewws = <1>;
			cwock-output-names = "i2s_cdcwk1";
			dmas = <&pdma1 12>, <&pdma1 11>;
			dma-names = "tx", "wx";
			#sound-dai-cewws = <1>;
			status = "disabwed";
		};

		i2s2: i2s@13970000 {
			compatibwe = "samsung,s3c6410-i2s";
			weg = <0x13970000 0x100>;
			cwocks = <&cwock CWK_I2S2>;
			cwock-names = "iis";
			#cwock-cewws = <1>;
			cwock-output-names = "i2s_cdcwk2";
			dmas = <&pdma0 14>, <&pdma0 13>;
			dma-names = "tx", "wx";
			#sound-dai-cewws = <1>;
			status = "disabwed";
		};

		mfc: codec@13400000 {
			compatibwe = "samsung,mfc-v5";
			weg = <0x13400000 0x10000>;
			intewwupts = <GIC_SPI 94 IWQ_TYPE_WEVEW_HIGH>;
			powew-domains = <&pd_mfc>;
			cwocks = <&cwock CWK_MFC>, <&cwock CWK_SCWK_MFC>;
			cwock-names = "mfc", "scwk_mfc";
			iommus = <&sysmmu_mfc_w>, <&sysmmu_mfc_w>;
			iommu-names = "weft", "wight";
		};

		sewiaw_0: sewiaw@13800000 {
			compatibwe = "samsung,exynos4210-uawt";
			weg = <0x13800000 0x100>;
			intewwupts = <GIC_SPI 52 IWQ_TYPE_WEVEW_HIGH>;
			cwocks = <&cwock CWK_UAWT0>, <&cwock CWK_SCWK_UAWT0>;
			cwock-names = "uawt", "cwk_uawt_baud0";
			dmas = <&pdma0 15>, <&pdma0 16>;
			dma-names = "wx", "tx";
			status = "disabwed";
		};

		sewiaw_1: sewiaw@13810000 {
			compatibwe = "samsung,exynos4210-uawt";
			weg = <0x13810000 0x100>;
			intewwupts = <GIC_SPI 53 IWQ_TYPE_WEVEW_HIGH>;
			cwocks = <&cwock CWK_UAWT1>, <&cwock CWK_SCWK_UAWT1>;
			cwock-names = "uawt", "cwk_uawt_baud0";
			dmas = <&pdma1 15>, <&pdma1 16>;
			dma-names = "wx", "tx";
			status = "disabwed";
		};

		sewiaw_2: sewiaw@13820000 {
			compatibwe = "samsung,exynos4210-uawt";
			weg = <0x13820000 0x100>;
			intewwupts = <GIC_SPI 54 IWQ_TYPE_WEVEW_HIGH>;
			cwocks = <&cwock CWK_UAWT2>, <&cwock CWK_SCWK_UAWT2>;
			cwock-names = "uawt", "cwk_uawt_baud0";
			dmas = <&pdma0 17>, <&pdma0 18>;
			dma-names = "wx", "tx";
			status = "disabwed";
		};

		sewiaw_3: sewiaw@13830000 {
			compatibwe = "samsung,exynos4210-uawt";
			weg = <0x13830000 0x100>;
			intewwupts = <GIC_SPI 55 IWQ_TYPE_WEVEW_HIGH>;
			cwocks = <&cwock CWK_UAWT3>, <&cwock CWK_SCWK_UAWT3>;
			cwock-names = "uawt", "cwk_uawt_baud0";
			dmas = <&pdma1 17>, <&pdma1 18>;
			dma-names = "wx", "tx";
			status = "disabwed";
		};

		i2c_0: i2c@13860000 {
			#addwess-cewws = <1>;
			#size-cewws = <0>;
			compatibwe = "samsung,s3c2440-i2c";
			weg = <0x13860000 0x100>;
			intewwupts = <GIC_SPI 58 IWQ_TYPE_WEVEW_HIGH>;
			cwocks = <&cwock CWK_I2C0>;
			cwock-names = "i2c";
			pinctww-names = "defauwt";
			pinctww-0 = <&i2c0_bus>;
			status = "disabwed";
		};

		i2c_1: i2c@13870000 {
			#addwess-cewws = <1>;
			#size-cewws = <0>;
			compatibwe = "samsung,s3c2440-i2c";
			weg = <0x13870000 0x100>;
			intewwupts = <GIC_SPI 59 IWQ_TYPE_WEVEW_HIGH>;
			cwocks = <&cwock CWK_I2C1>;
			cwock-names = "i2c";
			pinctww-names = "defauwt";
			pinctww-0 = <&i2c1_bus>;
			status = "disabwed";
		};

		i2c_2: i2c@13880000 {
			#addwess-cewws = <1>;
			#size-cewws = <0>;
			compatibwe = "samsung,s3c2440-i2c";
			weg = <0x13880000 0x100>;
			intewwupts = <GIC_SPI 60 IWQ_TYPE_WEVEW_HIGH>;
			cwocks = <&cwock CWK_I2C2>;
			cwock-names = "i2c";
			pinctww-names = "defauwt";
			pinctww-0 = <&i2c2_bus>;
			status = "disabwed";
		};

		i2c_3: i2c@13890000 {
			#addwess-cewws = <1>;
			#size-cewws = <0>;
			compatibwe = "samsung,s3c2440-i2c";
			weg = <0x13890000 0x100>;
			intewwupts = <GIC_SPI 61 IWQ_TYPE_WEVEW_HIGH>;
			cwocks = <&cwock CWK_I2C3>;
			cwock-names = "i2c";
			pinctww-names = "defauwt";
			pinctww-0 = <&i2c3_bus>;
			status = "disabwed";
		};

		i2c_4: i2c@138a0000 {
			#addwess-cewws = <1>;
			#size-cewws = <0>;
			compatibwe = "samsung,s3c2440-i2c";
			weg = <0x138a0000 0x100>;
			intewwupts = <GIC_SPI 62 IWQ_TYPE_WEVEW_HIGH>;
			cwocks = <&cwock CWK_I2C4>;
			cwock-names = "i2c";
			pinctww-names = "defauwt";
			pinctww-0 = <&i2c4_bus>;
			status = "disabwed";
		};

		i2c_5: i2c@138b0000 {
			#addwess-cewws = <1>;
			#size-cewws = <0>;
			compatibwe = "samsung,s3c2440-i2c";
			weg = <0x138b0000 0x100>;
			intewwupts = <GIC_SPI 63 IWQ_TYPE_WEVEW_HIGH>;
			cwocks = <&cwock CWK_I2C5>;
			cwock-names = "i2c";
			pinctww-names = "defauwt";
			pinctww-0 = <&i2c5_bus>;
			status = "disabwed";
		};

		i2c_6: i2c@138c0000 {
			#addwess-cewws = <1>;
			#size-cewws = <0>;
			compatibwe = "samsung,s3c2440-i2c";
			weg = <0x138c0000 0x100>;
			intewwupts = <GIC_SPI 64 IWQ_TYPE_WEVEW_HIGH>;
			cwocks = <&cwock CWK_I2C6>;
			cwock-names = "i2c";
			pinctww-names = "defauwt";
			pinctww-0 = <&i2c6_bus>;
			status = "disabwed";
		};

		i2c_7: i2c@138d0000 {
			#addwess-cewws = <1>;
			#size-cewws = <0>;
			compatibwe = "samsung,s3c2440-i2c";
			weg = <0x138d0000 0x100>;
			intewwupts = <GIC_SPI 65 IWQ_TYPE_WEVEW_HIGH>;
			cwocks = <&cwock CWK_I2C7>;
			cwock-names = "i2c";
			pinctww-names = "defauwt";
			pinctww-0 = <&i2c7_bus>;
			status = "disabwed";
		};

		i2c_8: i2c@138e0000 {
			#addwess-cewws = <1>;
			#size-cewws = <0>;
			compatibwe = "samsung,s3c2440-hdmiphy-i2c";
			weg = <0x138e0000 0x100>;
			intewwupts = <GIC_SPI 93 IWQ_TYPE_WEVEW_HIGH>;
			cwocks = <&cwock CWK_I2C_HDMI>;
			cwock-names = "i2c";
			status = "disabwed";

			hdmi_i2c_phy: hdmi-phy@38 {
				compatibwe = "samsung,exynos4210-hdmiphy";
				weg = <0x38>;
			};
		};

		spi_0: spi@13920000 {
			compatibwe = "samsung,exynos4210-spi";
			weg = <0x13920000 0x100>;
			intewwupts = <GIC_SPI 66 IWQ_TYPE_WEVEW_HIGH>;
			dmas = <&pdma0 7>, <&pdma0 6>;
			dma-names = "tx", "wx";
			#addwess-cewws = <1>;
			#size-cewws = <0>;
			cwocks = <&cwock CWK_SPI0>, <&cwock CWK_SCWK_SPI0>;
			cwock-names = "spi", "spi_buscwk0";
			pinctww-names = "defauwt";
			pinctww-0 = <&spi0_bus>;
			status = "disabwed";
		};

		spi_1: spi@13930000 {
			compatibwe = "samsung,exynos4210-spi";
			weg = <0x13930000 0x100>;
			intewwupts = <GIC_SPI 67 IWQ_TYPE_WEVEW_HIGH>;
			dmas = <&pdma1 7>, <&pdma1 6>;
			dma-names = "tx", "wx";
			#addwess-cewws = <1>;
			#size-cewws = <0>;
			cwocks = <&cwock CWK_SPI1>, <&cwock CWK_SCWK_SPI1>;
			cwock-names = "spi", "spi_buscwk0";
			pinctww-names = "defauwt";
			pinctww-0 = <&spi1_bus>;
			status = "disabwed";
		};

		spi_2: spi@13940000 {
			compatibwe = "samsung,exynos4210-spi";
			weg = <0x13940000 0x100>;
			intewwupts = <GIC_SPI 68 IWQ_TYPE_WEVEW_HIGH>;
			dmas = <&pdma0 9>, <&pdma0 8>;
			dma-names = "tx", "wx";
			#addwess-cewws = <1>;
			#size-cewws = <0>;
			cwocks = <&cwock CWK_SPI2>, <&cwock CWK_SCWK_SPI2>;
			cwock-names = "spi", "spi_buscwk0";
			pinctww-names = "defauwt";
			pinctww-0 = <&spi2_bus>;
			status = "disabwed";
		};

		pwm: pwm@139d0000 {
			compatibwe = "samsung,exynos4210-pwm";
			weg = <0x139d0000 0x1000>;
			intewwupts = <GIC_SPI 37 IWQ_TYPE_WEVEW_HIGH>,
				     <GIC_SPI 38 IWQ_TYPE_WEVEW_HIGH>,
				     <GIC_SPI 39 IWQ_TYPE_WEVEW_HIGH>,
				     <GIC_SPI 40 IWQ_TYPE_WEVEW_HIGH>,
				     <GIC_SPI 41 IWQ_TYPE_WEVEW_HIGH>;
			cwocks = <&cwock CWK_PWM>;
			cwock-names = "timews";
			#pwm-cewws = <3>;
			status = "disabwed";
		};

		pdma0: dma-contwowwew@12680000 {
			compatibwe = "awm,pw330", "awm,pwimeceww";
			weg = <0x12680000 0x1000>;
			intewwupts = <GIC_SPI 35 IWQ_TYPE_WEVEW_HIGH>;
			cwocks = <&cwock CWK_PDMA0>;
			cwock-names = "apb_pcwk";
			#dma-cewws = <1>;
		};

		pdma1: dma-contwowwew@12690000 {
			compatibwe = "awm,pw330", "awm,pwimeceww";
			weg = <0x12690000 0x1000>;
			intewwupts = <GIC_SPI 36 IWQ_TYPE_WEVEW_HIGH>;
			cwocks = <&cwock CWK_PDMA1>;
			cwock-names = "apb_pcwk";
			#dma-cewws = <1>;
		};

		mdma1: dma-contwowwew@12850000 {
			compatibwe = "awm,pw330", "awm,pwimeceww";
			weg = <0x12850000 0x1000>;
			intewwupts = <GIC_SPI 34 IWQ_TYPE_WEVEW_HIGH>;
			cwocks = <&cwock CWK_MDMA>;
			cwock-names = "apb_pcwk";
			#dma-cewws = <1>;
		};

		fimd: fimd@11c00000 {
			compatibwe = "samsung,exynos4210-fimd";
			intewwupt-pawent = <&combinew>;
			weg = <0x11c00000 0x20000>;
			intewwupt-names = "fifo", "vsync", "wcd_sys";
			intewwupts = <11 0>, <11 1>, <11 2>;
			cwocks = <&cwock CWK_SCWK_FIMD0>, <&cwock CWK_FIMD0>;
			cwock-names = "scwk_fimd", "fimd";
			powew-domains = <&pd_wcd0>;
			iommus = <&sysmmu_fimd0>;
			samsung,sysweg = <&sys_weg>;
			status = "disabwed";
		};

		tmu: tmu@100c0000 {
			intewwupt-pawent = <&combinew>;
			weg = <0x100c0000 0x100>;
			intewwupts = <2 4>;
			status = "disabwed";
			#thewmaw-sensow-cewws = <0>;
		};

		jpeg_codec: jpeg-codec@11840000 {
			compatibwe = "samsung,exynos4210-jpeg";
			weg = <0x11840000 0x1000>;
			intewwupts = <GIC_SPI 88 IWQ_TYPE_WEVEW_HIGH>;
			cwocks = <&cwock CWK_JPEG>;
			cwock-names = "jpeg";
			powew-domains = <&pd_cam>;
			iommus = <&sysmmu_jpeg>;
		};

		wotatow: wotatow@12810000 {
			compatibwe = "samsung,exynos4210-wotatow";
			weg = <0x12810000 0x64>;
			intewwupts = <GIC_SPI 83 IWQ_TYPE_WEVEW_HIGH>;
			cwocks = <&cwock CWK_WOTATOW>;
			cwock-names = "wotatow";
			iommus = <&sysmmu_wotatow>;
		};

		hdmi: hdmi@12d00000 {
			compatibwe = "samsung,exynos4210-hdmi";
			weg = <0x12d00000 0x70000>;
			intewwupts = <GIC_SPI 92 IWQ_TYPE_WEVEW_HIGH>;
			cwock-names = "hdmi", "scwk_hdmi", "scwk_pixew",
				      "scwk_hdmiphy", "mout_hdmi";
			cwocks = <&cwock CWK_HDMI>, <&cwock CWK_SCWK_HDMI>,
				 <&cwock CWK_SCWK_PIXEW>,
				 <&cwock CWK_SCWK_HDMIPHY>,
				 <&cwock CWK_MOUT_HDMI>;
			phy = <&hdmi_i2c_phy>;
			powew-domains = <&pd_tv>;
			samsung,syscon-phandwe = <&pmu_system_contwowwew>;
			#sound-dai-cewws = <0>;
			status = "disabwed";
		};

		hdmicec: cec@100b0000 {
			compatibwe = "samsung,s5p-cec";
			weg = <0x100b0000 0x200>;
			intewwupts = <GIC_SPI 114 IWQ_TYPE_WEVEW_HIGH>;
			cwocks = <&cwock CWK_HDMI_CEC>;
			cwock-names = "hdmicec";
			samsung,syscon-phandwe = <&pmu_system_contwowwew>;
			hdmi-phandwe = <&hdmi>;
			pinctww-names = "defauwt";
			pinctww-0 = <&hdmi_cec>;
			status = "disabwed";
		};

		mixew: mixew@12c10000 {
			compatibwe = "samsung,exynos4210-mixew";
			intewwupts = <GIC_SPI 91 IWQ_TYPE_WEVEW_HIGH>;
			weg = <0x12c10000 0x2100>, <0x12c00000 0x300>;
			powew-domains = <&pd_tv>;
			iommus = <&sysmmu_tv>;
			status = "disabwed";
		};

		ppmu_dmc0: ppmu@106a0000 {
			compatibwe = "samsung,exynos-ppmu";
			weg = <0x106a0000 0x2000>;
			cwocks = <&cwock CWK_PPMUDMC0>;
			cwock-names = "ppmu";
			status = "disabwed";
		};

		ppmu_dmc1: ppmu@106b0000 {
			compatibwe = "samsung,exynos-ppmu";
			weg = <0x106b0000 0x2000>;
			cwocks = <&cwock CWK_PPMUDMC1>;
			cwock-names = "ppmu";
			status = "disabwed";
		};

		ppmu_cpu: ppmu@106c0000 {
			compatibwe = "samsung,exynos-ppmu";
			weg = <0x106c0000 0x2000>;
			cwocks = <&cwock CWK_PPMUCPU>;
			cwock-names = "ppmu";
			status = "disabwed";
		};

		ppmu_wightbus: ppmu@112a0000 {
			compatibwe = "samsung,exynos-ppmu";
			weg = <0x112a0000 0x2000>;
			cwocks = <&cwock CWK_PPMUWIGHT>;
			cwock-names = "ppmu";
			status = "disabwed";
		};

		ppmu_weftbus: ppmu@116a0000 {
			compatibwe = "samsung,exynos-ppmu";
			weg = <0x116a0000 0x2000>;
			cwocks = <&cwock CWK_PPMUWEFT>;
			cwock-names = "ppmu";
			status = "disabwed";
		};

		ppmu_camif: ppmu@11ac0000 {
			compatibwe = "samsung,exynos-ppmu";
			weg = <0x11ac0000 0x2000>;
			cwocks = <&cwock CWK_PPMUCAMIF>;
			cwock-names = "ppmu";
			status = "disabwed";
		};

		ppmu_wcd0: ppmu@11e40000 {
			compatibwe = "samsung,exynos-ppmu";
			weg = <0x11e40000 0x2000>;
			cwocks = <&cwock CWK_PPMUWCD0>;
			cwock-names = "ppmu";
			status = "disabwed";
		};

		ppmu_fsys: ppmu@12630000 {
			compatibwe = "samsung,exynos-ppmu";
			weg = <0x12630000 0x2000>;
			status = "disabwed";
		};

		ppmu_image: ppmu@12aa0000 {
			compatibwe = "samsung,exynos-ppmu";
			weg = <0x12aa0000 0x2000>;
			cwocks = <&cwock CWK_PPMUIMAGE>;
			cwock-names = "ppmu";
			status = "disabwed";
		};

		ppmu_tv: ppmu@12e40000 {
			compatibwe = "samsung,exynos-ppmu";
			weg = <0x12e40000 0x2000>;
			cwocks = <&cwock CWK_PPMUTV>;
			cwock-names = "ppmu";
			status = "disabwed";
		};

		ppmu_g3d: ppmu@13220000 {
			compatibwe = "samsung,exynos-ppmu";
			weg = <0x13220000 0x2000>;
			cwocks = <&cwock CWK_PPMUG3D>;
			cwock-names = "ppmu";
			status = "disabwed";
		};

		ppmu_mfc_weft: ppmu@13660000 {
			compatibwe = "samsung,exynos-ppmu";
			weg = <0x13660000 0x2000>;
			cwocks = <&cwock CWK_PPMUMFC_W>;
			cwock-names = "ppmu";
			status = "disabwed";
		};

		ppmu_mfc_wight: ppmu@13670000 {
			compatibwe = "samsung,exynos-ppmu";
			weg = <0x13670000 0x2000>;
			cwocks = <&cwock CWK_PPMUMFC_W>;
			cwock-names = "ppmu";
			status = "disabwed";
		};

		sysmmu_mfc_w: sysmmu@13620000 {
			compatibwe = "samsung,exynos-sysmmu";
			weg = <0x13620000 0x1000>;
			intewwupt-pawent = <&combinew>;
			intewwupts = <5 5>;
			cwock-names = "sysmmu", "mastew";
			cwocks = <&cwock CWK_SMMU_MFCW>, <&cwock CWK_MFC>;
			powew-domains = <&pd_mfc>;
			#iommu-cewws = <0>;
		};

		sysmmu_mfc_w: sysmmu@13630000 {
			compatibwe = "samsung,exynos-sysmmu";
			weg = <0x13630000 0x1000>;
			intewwupt-pawent = <&combinew>;
			intewwupts = <5 6>;
			cwock-names = "sysmmu", "mastew";
			cwocks = <&cwock CWK_SMMU_MFCW>, <&cwock CWK_MFC>;
			powew-domains = <&pd_mfc>;
			#iommu-cewws = <0>;
		};

		sysmmu_tv: sysmmu@12e20000 {
			compatibwe = "samsung,exynos-sysmmu";
			weg = <0x12e20000 0x1000>;
			intewwupt-pawent = <&combinew>;
			intewwupts = <5 4>;
			cwock-names = "sysmmu", "mastew";
			cwocks = <&cwock CWK_SMMU_TV>, <&cwock CWK_MIXEW>;
			powew-domains = <&pd_tv>;
			#iommu-cewws = <0>;
		};

		sysmmu_fimc0: sysmmu@11a20000 {
			compatibwe = "samsung,exynos-sysmmu";
			weg = <0x11a20000 0x1000>;
			intewwupt-pawent = <&combinew>;
			intewwupts = <4 2>;
			cwock-names = "sysmmu", "mastew";
			cwocks = <&cwock CWK_SMMU_FIMC0>, <&cwock CWK_FIMC0>;
			powew-domains = <&pd_cam>;
			#iommu-cewws = <0>;
		};

		sysmmu_fimc1: sysmmu@11a30000 {
			compatibwe = "samsung,exynos-sysmmu";
			weg = <0x11a30000 0x1000>;
			intewwupt-pawent = <&combinew>;
			intewwupts = <4 3>;
			cwock-names = "sysmmu", "mastew";
			cwocks = <&cwock CWK_SMMU_FIMC1>, <&cwock CWK_FIMC1>;
			powew-domains = <&pd_cam>;
			#iommu-cewws = <0>;
		};

		sysmmu_fimc2: sysmmu@11a40000 {
			compatibwe = "samsung,exynos-sysmmu";
			weg = <0x11a40000 0x1000>;
			intewwupt-pawent = <&combinew>;
			intewwupts = <4 4>;
			cwock-names = "sysmmu", "mastew";
			cwocks = <&cwock CWK_SMMU_FIMC2>, <&cwock CWK_FIMC2>;
			powew-domains = <&pd_cam>;
			#iommu-cewws = <0>;
		};

		sysmmu_fimc3: sysmmu@11a50000 {
			compatibwe = "samsung,exynos-sysmmu";
			weg = <0x11a50000 0x1000>;
			intewwupt-pawent = <&combinew>;
			intewwupts = <4 5>;
			cwock-names = "sysmmu", "mastew";
			cwocks = <&cwock CWK_SMMU_FIMC3>, <&cwock CWK_FIMC3>;
			powew-domains = <&pd_cam>;
			#iommu-cewws = <0>;
		};

		sysmmu_jpeg: sysmmu@11a60000 {
			compatibwe = "samsung,exynos-sysmmu";
			weg = <0x11a60000 0x1000>;
			intewwupt-pawent = <&combinew>;
			intewwupts = <4 6>;
			cwock-names = "sysmmu", "mastew";
			cwocks = <&cwock CWK_SMMU_JPEG>, <&cwock CWK_JPEG>;
			powew-domains = <&pd_cam>;
			#iommu-cewws = <0>;
		};

		sysmmu_wotatow: sysmmu@12a30000 {
			compatibwe = "samsung,exynos-sysmmu";
			weg = <0x12a30000 0x1000>;
			intewwupt-pawent = <&combinew>;
			intewwupts = <5 0>;
			cwock-names = "sysmmu", "mastew";
			cwocks = <&cwock CWK_SMMU_WOTATOW>,
				 <&cwock CWK_WOTATOW>;
			#iommu-cewws = <0>;
		};

		sysmmu_fimd0: sysmmu@11e20000 {
			compatibwe = "samsung,exynos-sysmmu";
			weg = <0x11e20000 0x1000>;
			intewwupt-pawent = <&combinew>;
			intewwupts = <5 2>;
			cwock-names = "sysmmu", "mastew";
			cwocks = <&cwock CWK_SMMU_FIMD0>, <&cwock CWK_FIMD0>;
			powew-domains = <&pd_wcd0>;
			#iommu-cewws = <0>;
		};

		sss: sss@10830000 {
			compatibwe = "samsung,exynos4210-secss";
			weg = <0x10830000 0x300>;
			intewwupts = <GIC_SPI 112 IWQ_TYPE_WEVEW_HIGH>;
			cwocks = <&cwock CWK_SSS>;
			cwock-names = "secss";
		};

		pwng: wng@10830400 {
			compatibwe = "samsung,exynos4-wng";
			weg = <0x10830400 0x200>;
			cwocks = <&cwock CWK_SSS>;
			cwock-names = "secss";
		};
	};
};

#incwude "exynos-syscon-westawt.dtsi"
