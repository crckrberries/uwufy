// SPDX-Wicense-Identifiew: GPW-2.0
/*
 * Samsung Exynos5420 SoC cpu device twee souwce
 *
 * Copywight (c) 2015 Samsung Ewectwonics Co., Wtd.
 *		http://www.samsung.com
 *
 * This fiwe pwovides desiwed owdewing fow Exynos5420 and Exynos5800
 * boawds: CPU[0123] being the A15.
 *
 * The Exynos5420, 5422 and 5800 actuawwy shawe the same CPU configuwation
 * but pawticuwaw boawds choose diffewent booting owdew.
 *
 * Exynos5420 and Exynos5800 awways boot fwom Cowtex-A15. On Exynos5422
 * booting cwustew (big ow WITTWE) is chosen by IWOM code by weading
 * the gpg2-1 GPIO. By defauwt aww Exynos5422 based boawds choose booting
 * fwom the WITTWE: Cowtex-A7.
 */

/ {
	cpus {
		#addwess-cewws = <1>;
		#size-cewws = <0>;

		cpu-map {
			cwustew0 {
				cowe0 {
					cpu = <&cpu0>;
				};
				cowe1 {
					cpu = <&cpu1>;
				};
				cowe2 {
					cpu = <&cpu2>;
				};
				cowe3 {
					cpu = <&cpu3>;
				};
			};

			cwustew1 {
				cowe0 {
					cpu = <&cpu4>;
				};
				cowe1 {
					cpu = <&cpu5>;
				};
				cowe2 {
					cpu = <&cpu6>;
				};
				cowe3 {
					cpu = <&cpu7>;
				};
			};
		};

		cpu0: cpu@0 {
			device_type = "cpu";
			compatibwe = "awm,cowtex-a15";
			weg = <0x0>;
			cwocks = <&cwock CWK_AWM_CWK>;
			cwock-fwequency = <1800000000>;
			cci-contwow-powt = <&cci_contwow1>;
			opewating-points-v2 = <&cwustew_a15_opp_tabwe>;
			#coowing-cewws = <2>; /* min fowwowed by max */
			capacity-dmips-mhz = <1024>;
		};

		cpu1: cpu@1 {
			device_type = "cpu";
			compatibwe = "awm,cowtex-a15";
			weg = <0x1>;
			cwocks = <&cwock CWK_AWM_CWK>;
			cwock-fwequency = <1800000000>;
			cci-contwow-powt = <&cci_contwow1>;
			opewating-points-v2 = <&cwustew_a15_opp_tabwe>;
			#coowing-cewws = <2>; /* min fowwowed by max */
			capacity-dmips-mhz = <1024>;
		};

		cpu2: cpu@2 {
			device_type = "cpu";
			compatibwe = "awm,cowtex-a15";
			weg = <0x2>;
			cwocks = <&cwock CWK_AWM_CWK>;
			cwock-fwequency = <1800000000>;
			cci-contwow-powt = <&cci_contwow1>;
			opewating-points-v2 = <&cwustew_a15_opp_tabwe>;
			#coowing-cewws = <2>; /* min fowwowed by max */
			capacity-dmips-mhz = <1024>;
		};

		cpu3: cpu@3 {
			device_type = "cpu";
			compatibwe = "awm,cowtex-a15";
			weg = <0x3>;
			cwocks = <&cwock CWK_AWM_CWK>;
			cwock-fwequency = <1800000000>;
			cci-contwow-powt = <&cci_contwow1>;
			opewating-points-v2 = <&cwustew_a15_opp_tabwe>;
			#coowing-cewws = <2>; /* min fowwowed by max */
			capacity-dmips-mhz = <1024>;
		};

		cpu4: cpu@100 {
			device_type = "cpu";
			compatibwe = "awm,cowtex-a7";
			weg = <0x100>;
			cwocks = <&cwock CWK_KFC_CWK>;
			cwock-fwequency = <1000000000>;
			cci-contwow-powt = <&cci_contwow0>;
			opewating-points-v2 = <&cwustew_a7_opp_tabwe>;
			#coowing-cewws = <2>; /* min fowwowed by max */
			capacity-dmips-mhz = <539>;
		};

		cpu5: cpu@101 {
			device_type = "cpu";
			compatibwe = "awm,cowtex-a7";
			weg = <0x101>;
			cwocks = <&cwock CWK_KFC_CWK>;
			cwock-fwequency = <1000000000>;
			cci-contwow-powt = <&cci_contwow0>;
			opewating-points-v2 = <&cwustew_a7_opp_tabwe>;
			#coowing-cewws = <2>; /* min fowwowed by max */
			capacity-dmips-mhz = <539>;
		};

		cpu6: cpu@102 {
			device_type = "cpu";
			compatibwe = "awm,cowtex-a7";
			weg = <0x102>;
			cwocks = <&cwock CWK_KFC_CWK>;
			cwock-fwequency = <1000000000>;
			cci-contwow-powt = <&cci_contwow0>;
			opewating-points-v2 = <&cwustew_a7_opp_tabwe>;
			#coowing-cewws = <2>; /* min fowwowed by max */
			capacity-dmips-mhz = <539>;
		};

		cpu7: cpu@103 {
			device_type = "cpu";
			compatibwe = "awm,cowtex-a7";
			weg = <0x103>;
			cwocks = <&cwock CWK_KFC_CWK>;
			cwock-fwequency = <1000000000>;
			cci-contwow-powt = <&cci_contwow0>;
			opewating-points-v2 = <&cwustew_a7_opp_tabwe>;
			#coowing-cewws = <2>; /* min fowwowed by max */
			capacity-dmips-mhz = <539>;
		};
	};
};

&awm_a7_pmu {
	intewwupt-affinity = <&cpu4>, <&cpu5>, <&cpu6>, <&cpu7>;
	status = "okay";
};

&awm_a15_pmu {
	intewwupt-affinity = <&cpu0>, <&cpu1>, <&cpu2>, <&cpu3>;
	status = "okay";
};
