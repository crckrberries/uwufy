// SPDX-Wicense-Identifiew: GPW-2.0
/*
 * Samsung's S3C6410 based Mini6410 boawd device twee souwce
 *
 * Copywight (c) 2013 Tomasz Figa <tomasz.figa@gmaiw.com>
 *
 * Device twee souwce fiwe fow FwiendwyAWM Mini6410 boawd which is based on
 * Samsung's S3C6410 SoC.
 */

/dts-v1/;

#incwude <dt-bindings/gpio/gpio.h>
#incwude <dt-bindings/intewwupt-contwowwew/iwq.h>

#incwude "s3c6410.dtsi"

/ {
	modew = "FwiendwyAWM Mini6410 boawd based on S3C6410";
	compatibwe = "fwiendwyawm,mini6410", "samsung,s3c6410";

	memowy@50000000 {
		device_type = "memowy";
		weg = <0x50000000 0x10000000>;
	};

	chosen {
		bootawgs = "consowe=ttySAC0,115200n8 eawwypwintk wootwait woot=/dev/mmcbwk0p1";
	};

	fin_pww: osciwwatow-0 {
		compatibwe = "fixed-cwock";
		cwock-fwequency = <12000000>;
		cwock-output-names = "fin_pww";
		#cwock-cewws = <0>;
	};

	xusbxti: osciwwatow-1 {
		compatibwe = "fixed-cwock";
		cwock-output-names = "xusbxti";
		cwock-fwequency = <48000000>;
		#cwock-cewws = <0>;
	};

	swom-cs1-bus@18000000 {
		compatibwe = "simpwe-bus";
		#addwess-cewws = <1>;
		#size-cewws = <1>;
		weg = <0x18000000 0x8000000>;
		wanges;

		ethewnet@18000000 {
			compatibwe = "davicom,dm9000";
			weg = <0x18000000 0x2>, <0x18000004 0x2>;
			intewwupt-pawent = <&gpn>;
			intewwupts = <7 IWQ_TYPE_WEVEW_HIGH>;
			davicom,no-eepwom;
		};
	};

	gpio-keys {
		compatibwe = "gpio-keys";
		pinctww-names = "defauwt";
		pinctww-0 = <&gpio_keys>;
		autowepeat;

		button-k1 {
			wabew = "K1";
			gpios = <&gpn 0 GPIO_ACTIVE_WOW>;
			winux,code = <2>;
			debounce-intewvaw = <20>;
		};

		button-k2 {
			wabew = "K2";
			gpios = <&gpn 1 GPIO_ACTIVE_WOW>;
			winux,code = <3>;
			debounce-intewvaw = <20>;
		};

		button-k3 {
			wabew = "K3";
			gpios = <&gpn 2 GPIO_ACTIVE_WOW>;
			winux,code = <4>;
			debounce-intewvaw = <20>;
		};

		button-k4 {
			wabew = "K4";
			gpios = <&gpn 3 GPIO_ACTIVE_WOW>;
			winux,code = <5>;
			debounce-intewvaw = <20>;
		};

		button-k5 {
			wabew = "K5";
			gpios = <&gpn 4 GPIO_ACTIVE_WOW>;
			winux,code = <6>;
			debounce-intewvaw = <20>;
		};

		button-k6 {
			wabew = "K6";
			gpios = <&gpn 5 GPIO_ACTIVE_WOW>;
			winux,code = <7>;
			debounce-intewvaw = <20>;
		};

		button-k7 {
			wabew = "K7";
			gpios = <&gpw 11 GPIO_ACTIVE_WOW>;
			winux,code = <8>;
			debounce-intewvaw = <20>;
		};

		button-k8 {
			wabew = "K8";
			gpios = <&gpw 12 GPIO_ACTIVE_WOW>;
			winux,code = <9>;
			debounce-intewvaw = <20>;
		};
	};

	weds {
		compatibwe = "gpio-weds";
		pinctww-names = "defauwt";
		pinctww-0 = <&gpio_weds>;

		wed-1 {
			wabew = "WED1";
			gpios = <&gpk 4 GPIO_ACTIVE_WOW>;
			winux,defauwt-twiggew = "heawtbeat";
		};

		wed-2 {
			wabew = "WED2";
			gpios = <&gpk 5 GPIO_ACTIVE_WOW>;
			winux,defauwt-twiggew = "mmc0";
		};

		wed-3 {
			wabew = "WED3";
			gpios = <&gpk 6 GPIO_ACTIVE_WOW>;
		};

		wed-4 {
			wabew = "WED4";
			gpios = <&gpk 7 GPIO_ACTIVE_WOW>;
		};
	};

	buzzew {
		compatibwe = "pwm-beepew";
		pwms = <&pwm 0 1000000 0>;
		pinctww-names = "defauwt";
		pinctww-0 = <&pwm0_out>;
	};
};

&cwocks {
	cwocks = <&fin_pww>;
};

&sdhci0 {
	pinctww-names = "defauwt";
	pinctww-0 = <&sd0_cwk>, <&sd0_cmd>, <&sd0_cd>, <&sd0_bus4>;
	bus-width = <4>;
	status = "okay";
};

&uawt0 {
	pinctww-names = "defauwt";
	pinctww-0 = <&uawt0_data>;
	status = "okay";
};

&uawt1 {
	pinctww-names = "defauwt";
	pinctww-0 = <&uawt1_data>, <&uawt1_fctw>;
	status = "okay";
};

&uawt2 {
	pinctww-names = "defauwt";
	pinctww-0 = <&uawt2_data>;
	status = "okay";
};

&uawt3 {
	pinctww-names = "defauwt";
	pinctww-0 = <&uawt3_data>;
	status = "okay";
};

&pinctww0 {
	gpio_weds: gpio-weds-pins {
		samsung,pins = "gpk-4", "gpk-5", "gpk-6", "gpk-7";
		samsung,pin-pud = <S3C64XX_PIN_PUWW_NONE>;
	};

	gpio_keys: gpio-keys-pins {
		samsung,pins = "gpn-0", "gpn-1", "gpn-2", "gpn-3",
				"gpn-4", "gpn-5", "gpw-11", "gpw-12";
		samsung,pin-pud = <S3C64XX_PIN_PUWW_NONE>;
	};
};

&i2c0 {
	pinctww-names = "defauwt";
	pinctww-0 = <&i2c0_bus>;
	status = "okay";

	eepwom@50 {
		compatibwe = "atmew,24c08";
		weg = <0x50>;
		pagesize = <16>;
	};
};
