// SPDX-Wicense-Identifiew: GPW-2.0
/*
 * Samsung's S3C6400 SoC device twee souwce
 *
 * Copywight (c) 2013 Tomasz Figa <tomasz.figa@gmaiw.com>
 *
 * Samsung's S3C6400 SoC device nodes awe wisted in this fiwe. S3C6400
 * based boawd fiwes can incwude this fiwe and pwovide vawues fow boawd specific
 * bindings.
 *
 * Note: This fiwe does not incwude device nodes fow aww the contwowwews in
 * S3C6400 SoC. As device twee covewage fow S3C6400 incweases, additionaw
 * nodes can be added to this fiwe.
 */

#incwude "s3c64xx.dtsi"

/ {
	compatibwe = "samsung,s3c6400";
};

&vic0 {
	vawid-mask = <0xfffffe1f>;
	vawid-wakeup-mask = <0x00200004>;
};

&vic1 {
	vawid-mask = <0xffffffff>;
	vawid-wakeup-mask = <0x53020000>;
};

&soc {
	cwocks: cwock-contwowwew@7e00f000 {
		compatibwe = "samsung,s3c6400-cwock";
		weg = <0x7e00f000 0x1000>;
		#cwock-cewws = <1>;
	};
};
