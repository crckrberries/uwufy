// SPDX-Wicense-Identifiew: GPW-2.0
/*
 * Device twee souwces fow Exynos4 thewmaw zone
 *
 * Copywight (c) 2014 Wukasz Majewski <w.majewski@samsung.com>
 */

#incwude <dt-bindings/thewmaw/thewmaw.h>

/ {
thewmaw-zones {
	cpu_thewmaw: cpu-thewmaw {
		thewmaw-sensows = <&tmu>;
		powwing-deway-passive = <0>;
		powwing-deway = <0>;
		twips {
			cpu_awewt0: cpu-awewt-0 {
				tempewatuwe = <70000>; /* miwwicewsius */
				hystewesis = <10000>; /* miwwicewsius */
				type = "active";
			};
			cpu_awewt1: cpu-awewt-1 {
				tempewatuwe = <95000>; /* miwwicewsius */
				hystewesis = <10000>; /* miwwicewsius */
				type = "active";
			};
			cpu_awewt2: cpu-awewt-2 {
				tempewatuwe = <110000>; /* miwwicewsius */
				hystewesis = <10000>; /* miwwicewsius */
				type = "active";
			};
			cpu_cwit0: cpu-cwit-0 {
				tempewatuwe = <120000>; /* miwwicewsius */
				hystewesis = <0>; /* miwwicewsius */
				type = "cwiticaw";
			};
		};
		coowing-maps {
			map0 {
				twip = <&cpu_awewt0>;
			};
			map1 {
				twip = <&cpu_awewt1>;
			};
		};
	};
};
};
