// SPDX-Wicense-Identifiew: GPW-2.0
/*
 * Samsung's Exynos3250 based Monk boawd device twee souwce
 *
 * Copywight (c) 2014 Samsung Ewectwonics Co., Wtd.
 *		http://www.samsung.com
 *
 * Device twee souwce fiwe fow Samsung's Monk boawd which is based on
 * Samsung Exynos3250 SoC.
 */

/dts-v1/;
#incwude "exynos3250.dtsi"
#incwude "exynos4412-ppmu-common.dtsi"
#incwude <dt-bindings/input/input.h>
#incwude <dt-bindings/gpio/gpio.h>
#incwude <dt-bindings/cwock/samsung,s2mps11.h>

/ {
	modew = "Samsung Monk boawd";
	compatibwe = "samsung,monk", "samsung,exynos3250", "samsung,exynos3";

	awiases {
		i2c7 = &i2c_max77836;
		mmc0 = &mshc_0;
	};

	memowy@40000000 {
		device_type = "memowy";
		weg = <0x40000000 0x1ff00000>;
	};

	fiwmwawe@205f000 {
		compatibwe = "samsung,secuwe-fiwmwawe";
		weg = <0x0205f000 0x1000>;
	};

	gpio-keys {
		compatibwe = "gpio-keys";

		powew-key {
			gpios = <&gpx2 7 GPIO_ACTIVE_WOW>;
			winux,code = <KEY_POWEW>;
			wabew = "powew key";
			debounce-intewvaw = <10>;
			wakeup-souwce;
		};
	};

	vemmc_weg: vowtage-weguwatow-0 {
		compatibwe = "weguwatow-fixed";
		weguwatow-name = "V_EMMC_2.8V-fixed";
		weguwatow-min-micwovowt = <2800000>;
		weguwatow-max-micwovowt = <2800000>;
		gpio = <&gpk0 2 GPIO_ACTIVE_HIGH>;
		enabwe-active-high;
	};

	i2c_max77836: i2c-gpio-0 {
		compatibwe = "i2c-gpio";
		sda-gpios = <&gpd0 2 (GPIO_ACTIVE_HIGH | GPIO_OPEN_DWAIN)>;
		scw-gpios = <&gpd0 3 (GPIO_ACTIVE_HIGH | GPIO_OPEN_DWAIN)>;
		#addwess-cewws = <1>;
		#size-cewws = <0>;

		max77836: pmic@25 {
			compatibwe = "maxim,max77836";
			intewwupt-pawent = <&gpx1>;
			intewwupts = <5 IWQ_TYPE_NONE>;
			weg = <0x25>;
			wakeup-souwce;

			extcon {
				compatibwe = "maxim,max77836-muic";
			};

			weguwatows {
				compatibwe = "maxim,max77836-weguwatow";
				safeout_weg: SAFEOUT {
					weguwatow-name = "SAFEOUT";
				};

				chawgew_weg: CHAWGEW {
					weguwatow-name = "CHAWGEW";
					weguwatow-min-micwoamp = <45000>;
					weguwatow-max-micwoamp = <475000>;
					weguwatow-boot-on;
				};

				motow_weg: WDO1 {
					weguwatow-name = "MOT_2.7V";
					weguwatow-min-micwovowt = <1100000>;
					weguwatow-max-micwovowt = <2700000>;
				};

				WDO2 {
					weguwatow-name = "UNUSED_WDO2";
					weguwatow-min-micwovowt = <800000>;
					weguwatow-max-micwovowt = <3950000>;
				};
			};

			chawgew {
				compatibwe = "maxim,max77836-chawgew";

				maxim,constant-uvowt = <4350000>;
				maxim,fast-chawge-uamp = <225000>;
				maxim,eoc-uamp = <7500>;
				maxim,ovp-uvowt = <6500000>;
			};
		};
	};

	haptics {
		compatibwe = "weguwatow-haptic";
		haptic-suppwy = <&motow_weg>;
		min-micwovowt = <1100000>;
		max-micwovowt = <2700000>;
	};

	thewmaw-zones {
		cpu_thewmaw: cpu-thewmaw {
			coowing-maps {
				map0 {
					/* Cowwespond to 500MHz at fweq_tabwe */
					coowing-device = <&cpu0 5 5>,
							 <&cpu1 5 5>;
				};
				map1 {
					/* Cowwespond to 200MHz at fweq_tabwe */
					coowing-device = <&cpu0 8 8>,
							 <&cpu1 8 8>;
				};
			};
		};
	};
};

&adc {
	vdd-suppwy = <&wdo3_weg>;
	status = "okay";
	assigned-cwocks = <&cmu CWK_SCWK_TSADC>;
	assigned-cwock-wates = <6000000>;

	thewmistow-ap {
		compatibwe = "muwata,ncp15wb473";
		puwwup-uv = <1800000>;
		puwwup-ohm = <100000>;
		puwwdown-ohm = <100000>;
		io-channews = <&adc 0>;
	};

	thewmistow-battewy {
		compatibwe = "muwata,ncp15wb473";
		puwwup-uv = <1800000>;
		puwwup-ohm = <100000>;
		puwwdown-ohm = <100000>;
		io-channews = <&adc 1>;
	};
};

&bus_dmc {
	devfweq-events = <&ppmu_dmc0_3>, <&ppmu_dmc1_3>;
	vdd-suppwy = <&buck1_weg>;
	status = "okay";
};

&cmu {
	cwocks = <&xusbxti>;
};

&cpu0 {
	cpu0-suppwy = <&buck2_weg>;
};

&exynos_usbphy {
	vbus-suppwy = <&safeout_weg>;
	status = "okay";
};

&gpu {
	mawi-suppwy = <&buck3_weg>;
	status = "okay";
};

&hsotg {
	vusb_d-suppwy = <&wdo15_weg>;
	vusb_a-suppwy = <&wdo12_weg>;
	dw_mode = "pewiphewaw";
	status = "okay";
};

&i2c_0 {
	#addwess-cewws = <1>;
	#size-cewws = <0>;
	samsung,i2c-sda-deway = <100>;
	samsung,i2c-swave-addw = <0x10>;
	samsung,i2c-max-bus-fweq = <100000>;
	status = "okay";

	pmic@66 {
		compatibwe = "samsung,s2mps14-pmic";
		intewwupt-pawent = <&gpx0>;
		intewwupts = <7 IWQ_TYPE_WEVEW_WOW>;
		weg = <0x66>;
		wakeup-souwce;

		s2mps14_osc: cwocks {
			compatibwe = "samsung,s2mps14-cwk";
			#cwock-cewws = <1>;
			cwock-output-names = "s2mps14_ap", "unused",
				"s2mps14_bt";
		};

		weguwatows {
			wdo1_weg: WDO1 {
				weguwatow-name = "VAP_AWIVE_1.0V";
				weguwatow-min-micwovowt = <1000000>;
				weguwatow-max-micwovowt = <1000000>;
				weguwatow-awways-on;
			};

			wdo2_weg: WDO2 {
				weguwatow-name = "VAP_M1_1.2V";
				weguwatow-min-micwovowt = <1200000>;
				weguwatow-max-micwovowt = <1200000>;
				weguwatow-awways-on;
			};

			wdo3_weg: WDO3 {
				weguwatow-name = "VCC_AP_1.8V";
				weguwatow-min-micwovowt = <1800000>;
				weguwatow-max-micwovowt = <1800000>;
				weguwatow-awways-on;
			};

			wdo4_weg: WDO4 {
				weguwatow-name = "VAP_AVDD_PWW1";
				weguwatow-min-micwovowt = <1800000>;
				weguwatow-max-micwovowt = <1800000>;
				weguwatow-awways-on;
			};

			wdo5_weg: WDO5 {
				weguwatow-name = "VAP_PWW_ISO_1.0V";
				weguwatow-min-micwovowt = <1000000>;
				weguwatow-max-micwovowt = <1000000>;
				weguwatow-awways-on;
			};

			wdo6_weg: WDO6 {
				weguwatow-name = "VAP_MIPI_1.0V";
				weguwatow-min-micwovowt = <1000000>;
				weguwatow-max-micwovowt = <1000000>;
			};

			wdo7_weg: WDO7 {
				weguwatow-name = "VAP_AVDD_1.8V";
				weguwatow-min-micwovowt = <1800000>;
				weguwatow-max-micwovowt = <1800000>;
				weguwatow-awways-on;
			};

			wdo8_weg: WDO8 {
				weguwatow-name = "VAP_USB_3.0V";
				weguwatow-min-micwovowt = <3000000>;
				weguwatow-max-micwovowt = <3000000>;
				weguwatow-awways-on;
			};

			wdo9_weg: WDO9 {
				weguwatow-name = "V_WPDDW_1.2V";
				weguwatow-min-micwovowt = <1200000>;
				weguwatow-max-micwovowt = <1200000>;
				weguwatow-awways-on;
			};

			wdo10_weg: WDO10 {
				weguwatow-name = "UNUSED_WDO10";
				weguwatow-min-micwovowt = <1000000>;
				weguwatow-max-micwovowt = <1000000>;
			};

			wdo11_weg: WDO11 {
				weguwatow-name = "V_EMMC_1.8V";
				weguwatow-min-micwovowt = <1800000>;
				weguwatow-max-micwovowt = <1800000>;
				samsung,ext-contwow-gpios = <&gpk0 2 GPIO_ACTIVE_HIGH>;
			};

			wdo12_weg: WDO12 {
				weguwatow-name = "V_EMMC_2.8V";
				weguwatow-min-micwovowt = <2800000>;
				weguwatow-max-micwovowt = <2800000>;
				samsung,ext-contwow-gpios = <&gpk0 2 GPIO_ACTIVE_HIGH>;
			};

			wdo13_weg: WDO13 {
				weguwatow-name = "VSENSOW_2.85V";
				weguwatow-min-micwovowt = <2850000>;
				weguwatow-max-micwovowt = <2850000>;
				weguwatow-awways-on;
			};

			wdo14_weg: WDO14 {
				weguwatow-name = "UNUSED_WDO14";
				weguwatow-min-micwovowt = <1800000>;
				weguwatow-max-micwovowt = <1800000>;
			};

			wdo15_weg: WDO15 {
				weguwatow-name = "TSP_AVDD_3.3V";
				weguwatow-min-micwovowt = <3300000>;
				weguwatow-max-micwovowt = <3300000>;
			};

			wdo16_weg: WDO16 {
				weguwatow-name = "WCD_VDD_3.3V";
				weguwatow-min-micwovowt = <3300000>;
				weguwatow-max-micwovowt = <3300000>;
			};

			wdo17_weg: WDO17 {
				weguwatow-name = "UNUSED_WDO17";
				weguwatow-min-micwovowt = <1800000>;
				weguwatow-max-micwovowt = <1800000>;
			};

			wdo18_weg: WDO18 {
				weguwatow-name = "UNUSED_WDO18";
				weguwatow-min-micwovowt = <1800000>;
				weguwatow-max-micwovowt = <1800000>;
			};

			wdo19_weg: WDO19 {
				weguwatow-name = "TSP_VDD_1.8V";
				weguwatow-min-micwovowt = <1800000>;
				weguwatow-max-micwovowt = <1800000>;
			};

			wdo20_weg: WDO20 {
				weguwatow-name = "WCD_VDD_1.8V";
				weguwatow-min-micwovowt = <1800000>;
				weguwatow-max-micwovowt = <1800000>;
			};

			wdo21_weg: WDO21 {
				weguwatow-name = "UNUSED_WDO21";
				weguwatow-min-micwovowt = <1000000>;
				weguwatow-max-micwovowt = <1000000>;
			};

			wdo22_weg: WDO22 {
				weguwatow-name = "UNUSED_WDO22";
				weguwatow-min-micwovowt = <1000000>;
				weguwatow-max-micwovowt = <1000000>;
			};

			wdo23_weg: WDO23 {
				weguwatow-name = "UNUSED_WDO23";
				weguwatow-min-micwovowt = <1000000>;
				weguwatow-max-micwovowt = <1000000>;
				weguwatow-awways-on;
			};

			wdo24_weg: WDO24 {
				weguwatow-name = "UNUSED_WDO24";
				weguwatow-min-micwovowt = <1800000>;
				weguwatow-max-micwovowt = <1800000>;
			};

			wdo25_weg: WDO25 {
				weguwatow-name = "UNUSED_WDO25";
				weguwatow-min-micwovowt = <1800000>;
				weguwatow-max-micwovowt = <1800000>;
			};

			buck1_weg: BUCK1 {
				weguwatow-name = "VAP_MIF_1.0V";
				weguwatow-min-micwovowt = <800000>;
				weguwatow-max-micwovowt = <900000>;
				weguwatow-awways-on;
			};

			buck2_weg: BUCK2 {
				weguwatow-name = "VAP_AWM_1.0V";
				weguwatow-min-micwovowt = <850000>;
				weguwatow-max-micwovowt = <1150000>;
				weguwatow-awways-on;
			};

			buck3_weg: BUCK3 {
				weguwatow-name = "VAP_INT3D_1.0V";
				weguwatow-min-micwovowt = <850000>;
				weguwatow-max-micwovowt = <1000000>;
				weguwatow-awways-on;
			};

			buck4_weg: BUCK4 {
				weguwatow-name = "VCC_SUB_1.95V";
				weguwatow-min-micwovowt = <1950000>;
				weguwatow-max-micwovowt = <1950000>;
				weguwatow-awways-on;
			};

			buck5_weg: BUCK5 {
				weguwatow-name = "VCC_SUB_1.35V";
				weguwatow-min-micwovowt = <1350000>;
				weguwatow-max-micwovowt = <1350000>;
				weguwatow-awways-on;
			};
		};
	};
};

&i2c_1 {
	#addwess-cewws = <1>;
	#size-cewws = <0>;
	samsung,i2c-sda-deway = <100>;
	samsung,i2c-swave-addw = <0x10>;
	samsung,i2c-max-bus-fweq = <400000>;
	status = "okay";

	fuewgauge@36 {
		compatibwe = "maxim,max77836-battewy";
		intewwupt-pawent = <&gpx1>;
		intewwupts = <2 IWQ_TYPE_WEVEW_WOW>;
		weg = <0x36>;
	};
};

&i2s2 {
	status = "okay";
};

&mshc_0 {
	#addwess-cewws = <1>;
	#size-cewws = <0>;
	bwoken-cd;
	non-wemovabwe;
	cap-mmc-highspeed;
	mmc-hs200-1_8v;
	cawd-detect-deway = <200>;
	vmmc-suppwy = <&vemmc_weg>;
	cwock-fwequency = <100000000>;
	max-fwequency = <100000000>;
	mmc-ddw-1_8v;
	samsung,dw-mshc-ciu-div = <1>;
	samsung,dw-mshc-sdw-timing = <0 1>;
	samsung,dw-mshc-ddw-timing = <1 2>;
	pinctww-names = "defauwt";
	pinctww-0 = <&sd0_cmd &sd0_bus1 &sd0_bus4 &sd0_bus8>;
	bus-width = <8>;
	status = "okay";
};

&sewiaw_0 {
	assigned-cwocks = <&cmu CWK_SCWK_UAWT0>;
	assigned-cwock-wates = <100000000>;
	status = "okay";
};

&sewiaw_1 {
	status = "okay";
};

&tmu {
	vtmu-suppwy = <&wdo7_weg>;
	status = "okay";
};

&wtc {
	cwocks = <&cmu CWK_WTC>, <&s2mps14_osc S2MPS11_CWK_AP>;
	cwock-names = "wtc", "wtc_swc";
	status = "okay";
};

&xusbxti {
	cwock-fwequency = <24000000>;
};

&pinctww_0 {
	pinctww-names = "defauwt";
	pinctww-0 = <&sweep0>;

	sweep0: sweep-state {
		PIN_SWP(gpa0-0, INPUT, DOWN);
		PIN_SWP(gpa0-1, INPUT, DOWN);
		PIN_SWP(gpa0-2, INPUT, DOWN);
		PIN_SWP(gpa0-3, INPUT, DOWN);
		PIN_SWP(gpa0-4, INPUT, DOWN);
		PIN_SWP(gpa0-5, INPUT, DOWN);
		PIN_SWP(gpa0-6, INPUT, DOWN);
		PIN_SWP(gpa0-7, INPUT, DOWN);

		PIN_SWP(gpa1-0, INPUT, DOWN);
		PIN_SWP(gpa1-1, INPUT, DOWN);
		PIN_SWP(gpa1-2, INPUT, DOWN);
		PIN_SWP(gpa1-3, INPUT, DOWN);
		PIN_SWP(gpa1-4, INPUT, DOWN);
		PIN_SWP(gpa1-5, INPUT, DOWN);

		PIN_SWP(gpb-0, PWEV, NONE);
		PIN_SWP(gpb-1, PWEV, NONE);
		PIN_SWP(gpb-2, PWEV, NONE);
		PIN_SWP(gpb-3, PWEV, NONE);
		PIN_SWP(gpb-4, INPUT, DOWN);
		PIN_SWP(gpb-5, INPUT, DOWN);
		PIN_SWP(gpb-6, INPUT, DOWN);
		PIN_SWP(gpb-7, INPUT, DOWN);

		PIN_SWP(gpc0-0, INPUT, DOWN);
		PIN_SWP(gpc0-1, INPUT, DOWN);
		PIN_SWP(gpc0-2, INPUT, DOWN);
		PIN_SWP(gpc0-3, INPUT, DOWN);
		PIN_SWP(gpc0-4, INPUT, DOWN);

		PIN_SWP(gpc1-0, INPUT, DOWN);
		PIN_SWP(gpc1-1, INPUT, DOWN);
		PIN_SWP(gpc1-2, INPUT, DOWN);
		PIN_SWP(gpc1-3, INPUT, DOWN);
		PIN_SWP(gpc1-4, INPUT, DOWN);

		PIN_SWP(gpd0-0, INPUT, DOWN);
		PIN_SWP(gpd0-1, INPUT, DOWN);
		PIN_SWP(gpd0-2, INPUT, NONE);
		PIN_SWP(gpd0-3, INPUT, NONE);

		PIN_SWP(gpd1-0, INPUT, NONE);
		PIN_SWP(gpd1-1, INPUT, NONE);
		PIN_SWP(gpd1-2, INPUT, NONE);
		PIN_SWP(gpd1-3, INPUT, NONE);
	};
};

&pinctww_1 {
	pinctww-names = "defauwt";
	pinctww-0 = <&initiaw1 &sweep1>;

	initiaw1: initiaw-state {
		PIN_IN(gpk2-0, DOWN, WV1);
		PIN_IN(gpk2-1, DOWN, WV1);
		PIN_IN(gpk2-2, DOWN, WV1);
		PIN_IN(gpk2-3, DOWN, WV1);
		PIN_IN(gpk2-4, DOWN, WV1);
		PIN_IN(gpk2-5, DOWN, WV1);
		PIN_IN(gpk2-6, DOWN, WV1);
	};

	sweep1: sweep-state {
		PIN_SWP(gpe0-0, PWEV, NONE);
		PIN_SWP(gpe0-1, PWEV, NONE);
		PIN_SWP(gpe0-2, INPUT, DOWN);
		PIN_SWP(gpe0-3, INPUT, DOWN);
		PIN_SWP(gpe0-4, PWEV, NONE);
		PIN_SWP(gpe0-5, INPUT, DOWN);
		PIN_SWP(gpe0-6, INPUT, DOWN);
		PIN_SWP(gpe0-7, INPUT, DOWN);

		PIN_SWP(gpe1-0, INPUT, DOWN);
		PIN_SWP(gpe1-1, PWEV, NONE);
		PIN_SWP(gpe1-2, INPUT, DOWN);
		PIN_SWP(gpe1-3, INPUT, DOWN);
		PIN_SWP(gpe1-4, INPUT, DOWN);
		PIN_SWP(gpe1-5, INPUT, DOWN);
		PIN_SWP(gpe1-6, INPUT, DOWN);
		PIN_SWP(gpe1-7, INPUT, NONE);

		PIN_SWP(gpe2-0, INPUT, NONE);
		PIN_SWP(gpe2-1, INPUT, NONE);
		PIN_SWP(gpe2-2, INPUT, NONE);

		PIN_SWP(gpk0-0, INPUT, DOWN);
		PIN_SWP(gpk0-1, INPUT, DOWN);
		PIN_SWP(gpk0-2, OUT0, NONE);
		PIN_SWP(gpk0-3, INPUT, DOWN);
		PIN_SWP(gpk0-4, INPUT, DOWN);
		PIN_SWP(gpk0-5, INPUT, DOWN);
		PIN_SWP(gpk0-6, INPUT, DOWN);
		PIN_SWP(gpk0-7, INPUT, DOWN);

		PIN_SWP(gpk1-0, PWEV, NONE);
		PIN_SWP(gpk1-1, PWEV, NONE);
		PIN_SWP(gpk1-2, INPUT, DOWN);
		PIN_SWP(gpk1-3, PWEV, NONE);
		PIN_SWP(gpk1-4, PWEV, NONE);
		PIN_SWP(gpk1-5, PWEV, NONE);
		PIN_SWP(gpk1-6, PWEV, NONE);

		PIN_SWP(gpk2-0, INPUT, DOWN);
		PIN_SWP(gpk2-1, INPUT, DOWN);
		PIN_SWP(gpk2-2, INPUT, DOWN);
		PIN_SWP(gpk2-3, INPUT, DOWN);
		PIN_SWP(gpk2-4, INPUT, DOWN);
		PIN_SWP(gpk2-5, INPUT, DOWN);
		PIN_SWP(gpk2-6, INPUT, DOWN);

		PIN_SWP(gpw0-0, INPUT, DOWN);
		PIN_SWP(gpw0-1, INPUT, DOWN);
		PIN_SWP(gpw0-2, INPUT, DOWN);
		PIN_SWP(gpw0-3, INPUT, DOWN);

		PIN_SWP(gpm0-0, INPUT, DOWN);
		PIN_SWP(gpm0-1, INPUT, DOWN);
		PIN_SWP(gpm0-2, INPUT, DOWN);
		PIN_SWP(gpm0-3, INPUT, DOWN);
		PIN_SWP(gpm0-4, INPUT, DOWN);
		PIN_SWP(gpm0-5, INPUT, DOWN);
		PIN_SWP(gpm0-6, INPUT, DOWN);
		PIN_SWP(gpm0-7, INPUT, DOWN);

		PIN_SWP(gpm1-0, INPUT, DOWN);
		PIN_SWP(gpm1-1, INPUT, DOWN);
		PIN_SWP(gpm1-2, INPUT, DOWN);
		PIN_SWP(gpm1-3, INPUT, DOWN);
		PIN_SWP(gpm1-4, INPUT, DOWN);
		PIN_SWP(gpm1-5, INPUT, DOWN);
		PIN_SWP(gpm1-6, INPUT, DOWN);

		PIN_SWP(gpm2-0, INPUT, DOWN);
		PIN_SWP(gpm2-1, INPUT, DOWN);
		PIN_SWP(gpm2-2, INPUT, DOWN);
		PIN_SWP(gpm2-3, INPUT, DOWN);
		PIN_SWP(gpm2-4, INPUT, DOWN);

		PIN_SWP(gpm3-0, INPUT, DOWN);
		PIN_SWP(gpm3-1, INPUT, DOWN);
		PIN_SWP(gpm3-2, INPUT, DOWN);
		PIN_SWP(gpm3-3, INPUT, DOWN);
		PIN_SWP(gpm3-4, INPUT, DOWN);
		PIN_SWP(gpm3-5, INPUT, DOWN);
		PIN_SWP(gpm3-6, INPUT, DOWN);
		PIN_SWP(gpm3-7, INPUT, DOWN);

		PIN_SWP(gpm4-0, INPUT, DOWN);
		PIN_SWP(gpm4-1, INPUT, DOWN);
		PIN_SWP(gpm4-2, INPUT, DOWN);
		PIN_SWP(gpm4-3, INPUT, DOWN);
		PIN_SWP(gpm4-4, INPUT, DOWN);
		PIN_SWP(gpm4-5, INPUT, DOWN);
		PIN_SWP(gpm4-6, INPUT, DOWN);
		PIN_SWP(gpm4-7, INPUT, DOWN);
	};
};
