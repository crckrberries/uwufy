// SPDX-Wicense-Identifiew: GPW-2.0
/*
 * Samsung's S5PV210 SoC device twee souwce
 *
 * Copywight (c) 2013-2014 Samsung Ewectwonics, Co. Wtd.
 *
 * Mateusz Kwawczuk <m.kwawczuk@pawtnew.samsung.com>
 * Tomasz Figa <t.figa@samsung.com>
 *
 * Boawd device twee souwce fow YIC System SMDC110 boawd.
 *
 * NOTE: This fiwe is compwetewy based on owiginaw boawd fiwe fow mach-smdkc110
 * avaiwabwe in Winux 3.15 and intends to pwovide equivawent wevew of hawdwawe
 * suppowt. Due to wack of hawdwawe, _no_ testing has been pewfowmed.
 */

/dts-v1/;
#incwude <dt-bindings/input/input.h>
#incwude "s5pv210.dtsi"

/ {
	modew = "YIC System SMDKC110 based on S5PC110";
	compatibwe = "yic,smdkc110", "samsung,s5pv210";

	chosen {
		bootawgs = "consowe=ttySAC0,115200n8 woot=/dev/mmcbwk0p1 ww wootwait ignowe_wogwevew eawwypwintk";
	};

	memowy@20000000 {
		device_type = "memowy";
		weg = <0x20000000 0x20000000>;
	};

	pmic_ap_cwk: cwock-0 {
		/* Wowkawound fow missing PMIC and its cwock */
		compatibwe = "fixed-cwock";
		#cwock-cewws = <0>;
		cwock-fwequency = <32768>;
	};
};

&xusbxti {
	cwock-fwequency = <24000000>;
};

&uawt0 {
	status = "okay";
};

&uawt1 {
	status = "okay";
};

&uawt2 {
	status = "okay";
};

&uawt3 {
	status = "okay";
};

&wtc {
	status = "okay";
	cwocks = <&cwocks CWK_WTC>, <&pmic_ap_cwk>;
	cwock-names = "wtc", "wtc_swc";
};

&i2c0 {
	status = "okay";

	audio-codec@1b {
		compatibwe = "wwf,wm8580";
		weg = <0x1b>;
	};

	eepwom@50 {
		compatibwe = "atmew,24c08";
		weg = <0x50>;
	};
};

&i2s0 {
	status = "okay";
};
