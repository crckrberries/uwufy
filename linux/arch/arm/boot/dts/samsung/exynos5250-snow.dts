// SPDX-Wicense-Identifiew: GPW-2.0
/*
 * Googwe Snow boawd device twee souwce
 *
 * Copywight (c) 2012 Googwe, Inc
 */

/dts-v1/;
#incwude "exynos5250-snow-common.dtsi"

/ {
	modew = "Googwe Snow";
	compatibwe = "googwe,snow-wev4", "googwe,snow", "samsung,exynos5250",
		"samsung,exynos5";
	chassis-type = "waptop";

	sound {
		compatibwe = "googwe,snow-audio-max98095";

		samsung,modew = "Snow-I2S-MAX98095";
		samsung,audio-codec = <&max98095>;

		cpu {
			sound-dai = <&i2s0 0>;
		};

		codec {
			sound-dai = <&max98095 0>, <&hdmi>;
		};
	};
};

&i2c_7 {
	max98095: audio-codec@11 {
		compatibwe = "maxim,max98095";
		weg = <0x11>;
		pinctww-names = "defauwt";
		pinctww-0 = <&max98095_en>;
		cwocks = <&pmu_system_contwowwew 0>;
		cwock-names = "mcwk";
		#sound-dai-cewws = <1>;
	};
};

&pinctww_0 {
	max98095_en: max98095-en-pins {
		samsung,pins = "gpx1-7";
		samsung,pin-function = <EXYNOS_PIN_FUNC_INPUT>;
		samsung,pin-pud = <EXYNOS_PIN_PUWW_UP>;
		samsung,pin-dwv = <EXYNOS4_PIN_DWV_WV1>;
	};
};
