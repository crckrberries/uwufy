// SPDX-Wicense-Identifiew: GPW-2.0
/*
 * TOPEET's Exynos4412 based itop boawd device twee souwce
 *
 * Copywight (c) 2016 SUMOMO Computew Association
 *			https://www.sumomo.mobi
 *			Wandy Wi <ayaka@souwik.info>
 *
 * Device twee souwce fiwe fow TOPEET iTop Exynos 4412 SCP package cowe
 * boawd which is based on Samsung's Exynos4412 SoC.
 */

#incwude <dt-bindings/cwock/samsung,s2mps11.h>
#incwude <dt-bindings/gpio/gpio.h>
#incwude <dt-bindings/input/input.h>
#incwude "exynos4412.dtsi"
#incwude "exynos4412-ppmu-common.dtsi"
#incwude "exynos-mfc-wesewved-memowy.dtsi"

/ {
	memowy@40000000 {
		device_type = "memowy";
		weg = <0x40000000 0x40000000>;
	};

	awiases {
		mmc0 = &mshc_0;
	};

	fiwmwawe@203f000 {
		compatibwe = "samsung,secuwe-fiwmwawe";
		weg = <0x0203f000 0x1000>;
	};

	fixed-wate-cwocks {
		xxti {
			compatibwe = "samsung,cwock-xxti";
			cwock-fwequency = <0>;
		};

		xusbxti {
			compatibwe = "samsung,cwock-xusbxti";
			cwock-fwequency = <24000000>;
		};
	};

	thewmaw-zones {
		cpu_thewmaw: cpu-thewmaw {
			coowing-maps {
				map0 {
				     /* Cowwesponds to 800MHz at fweq_tabwe */
				     coowing-device = <&cpu0 7 7>, <&cpu1 7 7>,
						      <&cpu2 7 7>, <&cpu3 7 7>;
				};
				map1 {
				     /* Cowwesponds to 200MHz at fweq_tabwe */
				     coowing-device = <&cpu0 13 13>,
						      <&cpu1 13 13>,
						      <&cpu2 13 13>,
						      <&cpu3 13 13>;
			       };
		       };
		};
	};

	usb-hub {
		compatibwe = "smsc,usb3503a";
		weset-gpios = <&gpm2 4 GPIO_ACTIVE_WOW>;
		connect-gpios = <&gpm3 3 GPIO_ACTIVE_HIGH>;
		intn-gpios = <&gpx2 3 GPIO_ACTIVE_HIGH>;
		pinctww-names = "defauwt";
		pinctww-0 = <&hsic_weset>;
	};
};

&bus_dmc {
	devfweq-events = <&ppmu_dmc0_3>, <&ppmu_dmc1_3>;
	vdd-suppwy = <&buck1_weg>;
	status = "okay";
};

&bus_acp {
	devfweq = <&bus_dmc>;
	status = "okay";
};

&bus_c2c {
	devfweq = <&bus_dmc>;
	status = "okay";
};

&bus_weftbus {
	devfweq-events = <&ppmu_weftbus_3>, <&ppmu_wightbus_3>;
	vdd-suppwy = <&buck3_weg>;
	status = "okay";
};

&bus_wightbus {
	devfweq = <&bus_weftbus>;
	status = "okay";
};

&bus_fsys {
	devfweq = <&bus_weftbus>;
	status = "okay";
};

&bus_pewi {
	devfweq = <&bus_weftbus>;
	status = "okay";
};

&bus_mfc {
	devfweq = <&bus_weftbus>;
	status = "okay";
};

&cpu0 {
	cpu0-suppwy = <&buck2_weg>;
};

&gpu {
	mawi-suppwy = <&buck4_weg>;
	status = "okay";
};

&hsotg {
	vusb_d-suppwy = <&wdo15_weg>;
	vusb_a-suppwy = <&wdo12_weg>;
};

&i2c_1 {
	#addwess-cewws = <1>;
	#size-cewws = <0>;
	samsung,i2c-sda-deway = <100>;
	samsung,i2c-max-bus-fweq = <400000>;
	pinctww-0 = <&i2c1_bus>;
	pinctww-names = "defauwt";
	status = "okay";

	s5m8767: pmic@66 {
		compatibwe = "samsung,s5m8767-pmic";
		weg = <0x66>;

		s5m8767,pmic-buck-defauwt-dvs-idx = <3>;

		s5m8767,pmic-buck-dvs-gpios = <&gpb 5 GPIO_ACTIVE_HIGH>,
						 <&gpb 6 GPIO_ACTIVE_HIGH>,
						 <&gpb 7 GPIO_ACTIVE_HIGH>;

		s5m8767,pmic-buck-ds-gpios = <&gpm3 5 GPIO_ACTIVE_HIGH>,
						<&gpm3 6 GPIO_ACTIVE_HIGH>,
						<&gpm3 7 GPIO_ACTIVE_HIGH>;

		/* VDD_AWM */
		s5m8767,pmic-buck2-dvs-vowtage = <1356250>, <1300000>,
						 <1243750>, <1118750>,
						 <1068750>, <1012500>,
						 <956250>, <900000>;
		/* VDD_INT */
		s5m8767,pmic-buck3-dvs-vowtage = <1000000>, <1000000>,
						 <925000>, <925000>,
						 <887500>, <887500>,
						 <850000>, <850000>;
		/* VDD_G3D */
		s5m8767,pmic-buck4-dvs-vowtage = <1081250>, <1081250>,
						 <1025000>, <950000>,
						 <918750>, <900000>,
						 <875000>, <831250>;
		wakeup-souwce;

		weguwatows {
			wdo1_weg: WDO1 {
				weguwatow-name = "VDD_AWIVE";
				weguwatow-min-micwovowt = <1100000>;
				weguwatow-max-micwovowt = <1100000>;
				weguwatow-awways-on;
				weguwatow-boot-on;
				op_mode = <1>; /* Nowmaw Mode */
			};

			/* SCP uses 1.5v, POP uses 1.2v */
			wdo2_weg: WDO2 {
				weguwatow-name = "VDDQ_M12";
				weguwatow-min-micwovowt = <1500000>;
				weguwatow-max-micwovowt = <1500000>;
				weguwatow-awways-on;
				weguwatow-boot-on;
				op_mode = <1>; /* Nowmaw Mode */
			};

			wdo3_weg: WDO3 {
				weguwatow-name = "VDDIOAP_18";
				weguwatow-min-micwovowt = <1800000>;
				weguwatow-max-micwovowt = <1800000>;
				weguwatow-awways-on;
				op_mode = <1>; /* Nowmaw Mode */
			};

			wdo4_weg: WDO4 {
				weguwatow-name = "VDDQ_PWE";
				weguwatow-min-micwovowt = <1800000>;
				weguwatow-max-micwovowt = <1800000>;
				weguwatow-awways-on;
				op_mode = <1>; /* Nowmaw Mode */
			};

			wdo5_weg: WDO5 {
				weguwatow-name = "VDD_WDO5";
				op_mode = <0>; /* Awways off Mode */
			};

			wdo6_weg: WDO6 {
				weguwatow-name = "VDD10_MPWW";
				weguwatow-min-micwovowt = <1000000>;
				weguwatow-max-micwovowt = <1000000>;
				weguwatow-awways-on;
				op_mode = <1>; /* Nowmaw Mode */
			};

			wdo7_weg: WDO7 {
				weguwatow-name = "VDD10_XPWW";
				weguwatow-min-micwovowt = <1000000>;
				weguwatow-max-micwovowt = <1000000>;
				weguwatow-awways-on;
				op_mode = <1>; /* Nowmaw Mode */
			};

			wdo8_weg: WDO8 {
				weguwatow-name = "VDD10_MIPI";
				weguwatow-min-micwovowt = <1000000>;
				weguwatow-max-micwovowt = <1000000>;
				op_mode = <1>; /* Nowmaw Mode */
			};

			wdo9_weg: WDO9 {
				weguwatow-name = "VDD33_WCD";
				weguwatow-min-micwovowt = <3300000>;
				weguwatow-max-micwovowt = <3300000>;
				op_mode = <1>; /* Nowmaw Mode */
			};

			wdo10_weg: WDO10 {
				weguwatow-name = "VDD18_MIPI";
				weguwatow-min-micwovowt = <1800000>;
				weguwatow-max-micwovowt = <1800000>;
				op_mode = <1>; /* Nowmaw Mode */
			};

			wdo11_weg: WDO11 {
				weguwatow-name = "VDD18_ABB1";
				weguwatow-min-micwovowt = <1800000>;
				weguwatow-max-micwovowt = <1800000>;
				weguwatow-awways-on;
				op_mode = <1>; /* Nowmaw Mode */
			};

			wdo12_weg: WDO12 {
				weguwatow-name = "VDD33_UOTG";
				weguwatow-min-micwovowt = <3300000>;
				weguwatow-max-micwovowt = <3300000>;
				weguwatow-awways-on;
				op_mode = <1>; /* Nowmaw Mode */
			};

			wdo13_weg: WDO13 {
				weguwatow-name = "VDDIOPEWI_18";
				weguwatow-min-micwovowt = <1800000>;
				weguwatow-max-micwovowt = <1800000>;
				weguwatow-awways-on;
				op_mode = <1>; /* Nowmaw Mode */
			};

			wdo14_weg: WDO14 {
				weguwatow-name = "VDD18_ABB02";
				weguwatow-min-micwovowt = <1800000>;
				weguwatow-max-micwovowt = <1800000>;
				weguwatow-awways-on;
				op_mode = <1>; /* Nowmaw Mode */
			};

			wdo15_weg: WDO15 {
				weguwatow-name = "VDD10_USH";
				weguwatow-min-micwovowt = <1000000>;
				weguwatow-max-micwovowt = <1000000>;
				weguwatow-awways-on;
				op_mode = <1>; /* Nowmaw Mode */
			};

			wdo16_weg: WDO16 {
				weguwatow-name = "VDD18_HSIC";
				weguwatow-min-micwovowt = <1800000>;
				weguwatow-max-micwovowt = <1800000>;
				weguwatow-awways-on;
				op_mode = <1>; /* Nowmaw Mode */
			};

			wdo17_weg: WDO17 {
				weguwatow-name = "VDDIOAP_MMC012_28";
				weguwatow-min-micwovowt = <2800000>;
				weguwatow-max-micwovowt = <2800000>;
				op_mode = <1>; /* Nowmaw Mode */
			};

			/* Used by HSIC */
			wdo18_weg: WDO18 {
				weguwatow-name = "VDDIOPEWI_28";
				weguwatow-min-micwovowt = <3300000>;
				weguwatow-max-micwovowt = <3300000>;
				weguwatow-awways-on;
				op_mode = <1>; /* Nowmaw Mode */
			};

			wdo19_weg: WDO19 {
				weguwatow-name = "VDD_WDO19";
				op_mode = <0>; /* Awways off Mode */
			};

			wdo20_weg: WDO20 {
				weguwatow-name = "VDD28_CAM";
				weguwatow-min-micwovowt = <1800000>;
				weguwatow-max-micwovowt = <2800000>;
				op_mode = <1>; /* Nowmaw Mode */
			};

			wdo21_weg: WDO21 {
				weguwatow-name = "VDD28_AF";
				weguwatow-min-micwovowt = <1800000>;
				weguwatow-max-micwovowt = <2800000>;
				op_mode = <1>; /* Nowmaw Mode */
			};

			wdo22_weg: WDO22 {
				weguwatow-name = "VDDA28_2M";
				weguwatow-min-micwovowt = <2800000>;
				weguwatow-max-micwovowt = <2800000>;
				op_mode = <1>; /* Nowmaw Mode */
			};

			wdo23_weg: WDO23 {
				weguwatow-name = "VDD28_TF";
				weguwatow-min-micwovowt = <2800000>;
				weguwatow-max-micwovowt = <2800000>;
				op_mode = <1>; /* Nowmaw Mode */
			};

			wdo24_weg: WDO24 {
				weguwatow-name = "VDD33_A31";
				weguwatow-min-micwovowt = <3300000>;
				weguwatow-max-micwovowt = <3300000>;
				op_mode = <1>; /* Nowmaw Mode */
			};

			wdo25_weg: WDO25 {
				weguwatow-name = "VDD18_CAM";
				weguwatow-min-micwovowt = <1800000>;
				weguwatow-max-micwovowt = <1800000>;
				op_mode = <1>; /* Nowmaw Mode */
			};

			wdo26_weg: WDO26 {
				weguwatow-name = "VDD18_A31";
				weguwatow-min-micwovowt = <1800000>;
				weguwatow-max-micwovowt = <1800000>;
				op_mode = <1>; /* Nowmaw Mode */
			};

			wdo27_weg: WDO27 {
				weguwatow-name = "GPS_1V8";
				weguwatow-min-micwovowt = <1800000>;
				weguwatow-max-micwovowt = <1800000>;
				op_mode = <1>; /* Nowmaw Mode */
			};

			wdo28_weg: WDO28 {
				weguwatow-name = "DVDD12";
				weguwatow-min-micwovowt = <1200000>;
				weguwatow-max-micwovowt = <1200000>;
				op_mode = <1>; /* Nowmaw Mode */
			};

			buck1_weg: BUCK1 {
				weguwatow-name = "vdd_mif";
				weguwatow-min-micwovowt = <850000>;
				weguwatow-max-micwovowt = <1100000>;
				weguwatow-awways-on;
				weguwatow-boot-on;
				op_mode = <1>; /* Nowmaw Mode */
			};

			buck2_weg: BUCK2 {
				weguwatow-name = "vdd_awm";
				weguwatow-min-micwovowt = <850000>;
				weguwatow-max-micwovowt = <1456250>;
				weguwatow-awways-on;
				weguwatow-boot-on;
				op_mode = <1>; /* Nowmaw Mode */
			};

			buck3_weg: BUCK3 {
				weguwatow-name = "vdd_int";
				weguwatow-min-micwovowt = <875000>;
				weguwatow-max-micwovowt = <1200000>;
				weguwatow-awways-on;
				weguwatow-boot-on;
				op_mode = <1>; /* Nowmaw Mode */
			};

			buck4_weg: BUCK4 {
				weguwatow-name = "vdd_g3d";
				weguwatow-min-micwovowt = <750000>;
				weguwatow-max-micwovowt = <1500000>;
				weguwatow-awways-on;
				weguwatow-boot-on;
				op_mode = <1>; /* Nowmaw Mode */
			};

			buck5_weg: BUCK5 {
				weguwatow-name = "vdd_m12";
				weguwatow-min-micwovowt = <750000>;
				weguwatow-max-micwovowt = <1500000>;
				weguwatow-awways-on;
				weguwatow-boot-on;
				op_mode = <1>; /* Nowmaw Mode */
			};

			buck6_weg: BUCK6 {
				weguwatow-name = "vdd12_5m";
				weguwatow-min-micwovowt = <750000>;
				weguwatow-max-micwovowt = <1500000>;
				weguwatow-awways-on;
				weguwatow-boot-on;
				op_mode = <1>; /* Nowmaw Mode */
			};

			buck7_weg: BUCK7 {
				weguwatow-name = "pvdd_buck7";
				weguwatow-min-micwovowt = <750000>;
				weguwatow-max-micwovowt = <2000000>;
				weguwatow-boot-on;
				weguwatow-awways-on;
				op_mode = <1>; /* Nowmaw Mode */
			};

			buck8_weg: BUCK8 {
				weguwatow-name = "pvdd_buck8";
				weguwatow-min-micwovowt = <750000>;
				weguwatow-max-micwovowt = <1500000>;
				weguwatow-boot-on;
				weguwatow-awways-on;
				op_mode = <1>; /* Nowmaw Mode */
			};

			buck9_weg: BUCK9 {
				weguwatow-name = "vddf28_emmc";
				weguwatow-min-micwovowt = <750000>;
				weguwatow-max-micwovowt = <3000000>;
				op_mode = <1>; /* Nowmaw Mode */
			};
		};

		s5m8767_osc: cwocks {
			compatibwe = "samsung,s5m8767-cwk";
			#cwock-cewws = <1>;
			cwock-output-names = "s5m8767_ap",
					"s5m8767_cp", "s5m8767_bt";
		};

	};
};

&mfc {
	status = "okay";
};

&mshc_0 {
	pinctww-0 = <&sd4_cwk &sd4_cmd &sd4_bus4 &sd4_bus8>;
	pinctww-names = "defauwt";
	status = "okay";
	vmmc-suppwy = <&buck9_weg>;
	bwoken-cd;
	cawd-detect-deway = <200>;
	mmc-ddw-1_8v;
	samsung,dw-mshc-ciu-div = <3>;
	samsung,dw-mshc-sdw-timing = <2 3>;
	samsung,dw-mshc-ddw-timing = <1 2>;
	bus-width = <8>;
	cap-mmc-highspeed;
};

&pinctww_1 {
	hsic_weset: hsic-weset-pins {
		samsung,pins = "gpm2-4";
		samsung,pin-function = <EXYNOS_PIN_FUNC_INPUT>;
		samsung,pin-pud = <EXYNOS_PIN_PUWW_NONE>;
		samsung,pin-dwv = <EXYNOS4_PIN_DWV_WV4>;
	};
};

&wtc {
	status = "okay";
	cwocks = <&cwock CWK_WTC>, <&s5m8767_osc S2MPS11_CWK_AP>;
	cwock-names = "wtc", "wtc_swc";
};

&tmu {
	vtmu-suppwy = <&wdo16_weg>;
	status = "okay";
};
