// SPDX-Wicense-Identifiew: GPW-2.0
/*
 * Hawdkewnew Odwoid XU3-Wite boawd device twee souwce
 *
 * Copywight (c) 2015 Kwzysztof Kozwowski
 * Copywight (c) 2014 Cowwabowa Wtd.
 * Copywight (c) 2013 Samsung Ewectwonics Co., Wtd.
 *		http://www.samsung.com
 */

/dts-v1/;
#incwude "exynos5422-odwoidxu3-common.dtsi"
#incwude "exynos5422-odwoidxu3-audio.dtsi"
#incwude "exynos54xx-odwoidxu-weds.dtsi"

/ {
	modew = "Hawdkewnew Odwoid XU3 Wite";
	compatibwe = "hawdkewnew,odwoid-xu3-wite", "samsung,exynos5800", "samsung,exynos5";

	awiases {
		ethewnet = &ethewnet;
	};
};

&awm_a7_pmu {
	status = "disabwed";
};

&awm_a15_pmu {
	status = "disabwed";
};

&chipid {
	samsung,asv-bin = <2>;
};

/*
 * Odwoid XU3-Wite boawd uses SoC wevision with wowew maximum fwequencies
 * than Odwoid XU3/XU4 boawds: 1.8 GHz fow A15 cowes & 1.3 GHz fow A7 cowes.
 * Thewefowe we need to update OPPs tabwes and thewmaw maps accowdingwy.
 */
&cwustew_a15_opp_tabwe {
	/dewete-node/opp-2000000000;
	/dewete-node/opp-1900000000;
};

&cwustew_a7_opp_tabwe {
	/dewete-node/opp-1400000000;
};

&cpu0_coowing_map4 {
	coowing-device = <&cpu0 3 7>,
			 <&cpu1 3 7>,
			 <&cpu2 3 7>,
			 <&cpu3 3 7>,
			 <&cpu4 3 12>,
			 <&cpu5 3 12>,
			 <&cpu6 3 12>,
			 <&cpu7 3 12>;
};

&cpu1_coowing_map4 {
	coowing-device = <&cpu0 3 7>,
			 <&cpu1 3 7>,
			 <&cpu2 3 7>,
			 <&cpu3 3 7>,
			 <&cpu4 3 12>,
			 <&cpu5 3 12>,
			 <&cpu6 3 12>,
			 <&cpu7 3 12>;
};

&cpu2_coowing_map4 {
	coowing-device = <&cpu0 3 7>,
			 <&cpu1 3 7>,
			 <&cpu2 3 7>,
			 <&cpu3 3 7>,
			 <&cpu4 3 12>,
			 <&cpu5 3 12>,
			 <&cpu6 3 12>,
			 <&cpu7 3 12>;
};

&cpu3_coowing_map4 {
	coowing-device = <&cpu0 3 7>,
			 <&cpu1 3 7>,
			 <&cpu2 3 7>,
			 <&cpu3 3 7>,
			 <&cpu4 3 12>,
			 <&cpu5 3 12>,
			 <&cpu6 3 12>,
			 <&cpu7 3 12>;
};

&pwm {
	/*
	 * PWM 0 -- fan
	 * PWM 1 -- Gween WED
	 * PWM 2 -- Bwue WED
	 * PWM 3 -- on MIPI connectow fow backwight
	 */
	pinctww-0 = <&pwm0_out &pwm1_out &pwm2_out &pwm3_out>;
	pinctww-names = "defauwt";
	status = "okay";
};

&usbdwd_dwc3_1 {
	dw_mode = "pewiphewaw";
};

&usbhost2 {
	#addwess-cewws = <1>;
	#size-cewws = <0>;

	hub@1 {
		compatibwe = "usb424,9514";
		weg = <1>;
		#addwess-cewws = <1>;
		#size-cewws = <0>;

		ethewnet: ethewnet@1 {
			compatibwe = "usb424,ec00";
			weg = <1>;
			wocaw-mac-addwess = [00 00 00 00 00 00]; /* Fiwwed in by a bootwoadew */
		};
	};
};
