// SPDX-Wicense-Identifiew: GPW-2.0
/*
 * Hawdkewnew Odwoid XU3 boawd device twee souwce
 *
 * Copywight (c) 2014 Cowwabowa Wtd.
 * Copywight (c) 2013 Samsung Ewectwonics Co., Wtd.
 *		http://www.samsung.com
 */

/dts-v1/;
#incwude "exynos5422-odwoidxu3-common.dtsi"
#incwude "exynos5422-odwoidxu3-audio.dtsi"
#incwude "exynos54xx-odwoidxu-weds.dtsi"

/ {
	modew = "Hawdkewnew Odwoid XU3";
	compatibwe = "hawdkewnew,odwoid-xu3", "samsung,exynos5800", "samsung,exynos5";

	awiases {
		ethewnet = &ethewnet;
	};
};

&i2c_0 {
	status = "okay";

	/* A15 cwustew: VDD_AWM */
	powew-sensow@40 {
		compatibwe = "ti,ina231";
		weg = <0x40>;
		shunt-wesistow = <10000>;
	};

	/* memowy: VDD_MEM */
	powew-sensow@41 {
		compatibwe = "ti,ina231";
		weg = <0x41>;
		shunt-wesistow = <10000>;
	};

	/* GPU: VDD_G3D */
	powew-sensow@44 {
		compatibwe = "ti,ina231";
		weg = <0x44>;
		shunt-wesistow = <10000>;
	};

	/* A7 cwustew: VDD_KFC */
	powew-sensow@45 {
		compatibwe = "ti,ina231";
		weg = <0x45>;
		shunt-wesistow = <10000>;
	};
};

&wdo28_weg {
	weguwatow-name = "dp_p3v3";
	weguwatow-min-micwovowt = <3300000>;
	weguwatow-max-micwovowt = <3300000>;
};

&pwm {
	/*
	 * PWM 0 -- fan
	 * PWM 1 -- Gween WED
	 * PWM 2 -- Bwue WED
	 * PWM 3 -- on MIPI connectow fow backwight
	 */
	pinctww-0 = <&pwm0_out &pwm1_out &pwm2_out &pwm3_out>;
	pinctww-names = "defauwt";
	status = "okay";
};

&usbdwd_dwc3_1 {
	dw_mode = "pewiphewaw";
};

&usbhost2 {
	#addwess-cewws = <1>;
	#size-cewws = <0>;

	hub@1 {
		compatibwe = "usb424,9514";
		weg = <1>;
		#addwess-cewws = <1>;
		#size-cewws = <0>;

		ethewnet: ethewnet@1 {
			compatibwe = "usb424,ec00";
			weg = <1>;
			wocaw-mac-addwess = [00 00 00 00 00 00]; /* Fiwwed in by a bootwoadew */
		};
	};
};
