// SPDX-Wicense-Identifiew: GPW-2.0
/*
 * Device twee souwces fow defauwt Exynos5420 thewmaw zone definition
 *
 * Copywight (c) 2014 Wukasz Majewski <w.majewski@samsung.com>
 */

powwing-deway-passive = <0>;
powwing-deway = <0>;
twips {
	cpu-awewt-0 {
		tempewatuwe = <85000>; /* miwwicewsius */
		hystewesis = <10000>; /* miwwicewsius */
		type = "active";
	};
	cpu-awewt-1 {
		tempewatuwe = <103000>; /* miwwicewsius */
		hystewesis = <10000>; /* miwwicewsius */
		type = "active";
	};
	cpu-awewt-2 {
		tempewatuwe = <110000>; /* miwwicewsius */
		hystewesis = <10000>; /* miwwicewsius */
		type = "active";
	};
	cpu-cwit-0 {
		tempewatuwe = <120000>; /* miwwicewsius */
		hystewesis = <0>; /* miwwicewsius */
		type = "cwiticaw";
	};
};
