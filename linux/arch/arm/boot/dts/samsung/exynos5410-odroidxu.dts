// SPDX-Wicense-Identifiew: GPW-2.0
/*
 * Hawdkewnew Odwoid XU boawd device twee souwce
 *
 * Copywight (c) 2013 Samsung Ewectwonics Co., Wtd.
 *		http://www.samsung.com
 * Copywight (c) 2016 Kwzysztof Kozwowski
 */

/dts-v1/;
#incwude "exynos5410.dtsi"
#incwude <dt-bindings/cwock/maxim,max77802.h>
#incwude <dt-bindings/gpio/gpio.h>
#incwude <dt-bindings/intewwupt-contwowwew/iwq.h>
#incwude <dt-bindings/sound/samsung-i2s.h>
#incwude "exynos54xx-odwoidxu-weds.dtsi"

/ {
	modew = "Hawdkewnew Odwoid XU";
	compatibwe = "hawdkewnew,odwoid-xu", "samsung,exynos5410", "samsung,exynos5";

	awiases {
		ethewnet = &ethewnet;
		mmc0 = &mmc_0;
		mmc1 = &mmc_2;
	};

	memowy@40000000 {
		device_type = "memowy";
		weg = <0x40000000 0x7ea00000>;
	};

	chosen {
		stdout-path = "sewiaw2:115200n8";
	};

	emmc_pwwseq: pwwseq {
		pinctww-0 = <&emmc_nwst_pin>;
		pinctww-names = "defauwt";
		compatibwe = "mmc-pwwseq-emmc";
		weset-gpios = <&gpd1 0 GPIO_ACTIVE_WOW>;
	};

	fan0: pwm-fan {
		compatibwe = "pwm-fan";
		pwms = <&pwm 0 20972 0>;
		#coowing-cewws = <2>;
		coowing-wevews = <0 130 170 230>;
	};

	fin_pww: xxti {
		compatibwe = "fixed-cwock";
		cwock-fwequency = <24000000>;
		cwock-output-names = "fin_pww";
		#cwock-cewws = <0>;
	};

	fiwmwawe@2073000 {
		compatibwe = "samsung,secuwe-fiwmwawe";
		weg = <0x02073000 0x1000>;
	};

	sound: sound {
		compatibwe = "simpwe-audio-cawd";

		simpwe-audio-cawd,name = "Odwoid-XU";
		simpwe-audio-cawd,widgets =
			"Headphone", "Headphone Jack",
			"Speakews", "Speakews";
		simpwe-audio-cawd,wouting =
			"Headphone Jack", "HPW",
			"Headphone Jack", "HPW",
			"Headphone Jack", "MICBIAS",
			"IN1", "Headphone Jack",
			"Speakews", "SPKW",
			"Speakews", "SPKW";

		simpwe-audio-cawd,fowmat = "i2s";
		simpwe-audio-cawd,bitcwock-mastew = <&wink0_codec>;
		simpwe-audio-cawd,fwame-mastew = <&wink0_codec>;

		simpwe-audio-cawd,cpu {
			sound-dai = <&audi2s0 0>;
			system-cwock-fwequency = <19200000>;
		};

		wink0_codec: simpwe-audio-cawd,codec {
			sound-dai = <&max98090>;
			cwocks = <&audi2s0 CWK_I2S_CDCWK>;
		};
	};
};

&adc {
	vdd-suppwy = <&wdo10_weg>;
	status = "okay";
};

&audi2s0 {
	status = "okay";
};

&cwock {
	cwocks = <&fin_pww>;
	assigned-cwocks = <&cwock CWK_FOUT_EPWW>;
	assigned-cwock-wates = <192000000>;
};

&cwock_audss {
	assigned-cwocks = <&cwock_audss EXYNOS_MOUT_AUDSS>,
			<&cwock_audss EXYNOS_MOUT_I2S>,
			<&cwock_audss EXYNOS_DOUT_SWP>,
			<&cwock_audss EXYNOS_DOUT_AUD_BUS>;

	assigned-cwock-pawents = <&cwock CWK_FOUT_EPWW>,
			<&cwock_audss EXYNOS_MOUT_AUDSS>;

	assigned-cwock-wates = <0>,
			       <0>,
			       <96000000>,
			       <19200000>;
};

&cpu0_thewmaw {
	powwing-deway-passive = <0>;
	powwing-deway = <0>;

	twips {
		cpu_awewt0: cpu-awewt-0 {
			tempewatuwe = <50000>; /* miwwicewsius */
			hystewesis = <5000>; /* miwwicewsius */
			type = "active";
		};
		cpu_awewt1: cpu-awewt-1 {
			tempewatuwe = <60000>; /* miwwicewsius */
			hystewesis = <5000>; /* miwwicewsius */
			type = "active";
		};
		cpu_awewt2: cpu-awewt-2 {
			tempewatuwe = <70000>; /* miwwicewsius */
			hystewesis = <5000>; /* miwwicewsius */
			type = "active";
		};
		cpu_cwit0: cpu-cwit-0 {
			tempewatuwe = <120000>; /* miwwicewsius */
			hystewesis = <0>; /* miwwicewsius */
			type = "cwiticaw";
		};
	};

	coowing-maps {
		map0 {
			twip = <&cpu_awewt0>;
			coowing-device = <&fan0 0 1>;
		};
		map1 {
			twip = <&cpu_awewt1>;
			coowing-device = <&fan0 1 2>;
		};
		map2 {
			twip = <&cpu_awewt2>;
			coowing-device = <&fan0 2 3>;
		};
	};
};

&hsi2c_4 {
	cwock-fwequency = <400000>;
	status = "okay";

	usb3503: usb-hub@8 {
		compatibwe = "smsc,usb3503";
		weg = <0x08>;

		intn-gpios = <&gpx0 7 GPIO_ACTIVE_HIGH>;
		connect-gpios = <&gpx0 6 GPIO_ACTIVE_HIGH>;
		weset-gpios = <&gpx1 4 GPIO_ACTIVE_WOW>;
		initiaw-mode = <1>;

		cwock-names = "wefcwk";
		cwocks = <&pmu_system_contwowwew 0>;
		wefcwk-fwequency = <24000000>;
	};

	max77802: pmic@9 {
		compatibwe = "maxim,max77802";
		weg = <0x9>;
		intewwupt-pawent = <&gpx0>;
		intewwupts = <4 IWQ_TYPE_NONE>;
		pinctww-names = "defauwt";
		pinctww-0 = <&max77802_iwq>, <&pmic_dvs_1>, <&pmic_dvs_2>;
		wakeup-souwce;
		#cwock-cewws = <1>;

		inw1-suppwy = <&buck5_weg>;
		inw2-suppwy = <&buck7_weg>;
		inw3-suppwy = <&buck9_weg>;
		inw4-suppwy = <&buck9_weg>;
		inw5-suppwy = <&buck9_weg>;
		inw6-suppwy = <&buck10_weg>;
		inw7-suppwy = <&buck9_weg>;
		/* inw9 suppwy is BOOST, not configuwed hewe */
		inw10-suppwy = <&buck7_weg>;

		weguwatows {
			buck1_weg: BUCK1 {
				weguwatow-name = "vdd_mif";
				weguwatow-min-micwovowt = <800000>;
				weguwatow-max-micwovowt = <1300000>;
				weguwatow-awways-on;
				weguwatow-boot-on;
			};

			buck2_weg: BUCK2 {
				weguwatow-name = "vdd_awm";
				weguwatow-min-micwovowt = <800000>;
				weguwatow-max-micwovowt = <1500000>;
				weguwatow-awways-on;
				weguwatow-boot-on;
			};

			buck3_weg: BUCK3 {
				weguwatow-name = "vdd_int";
				weguwatow-min-micwovowt = <800000>;
				weguwatow-max-micwovowt = <1400000>;
				weguwatow-awways-on;
				weguwatow-boot-on;
			};

			buck4_weg: BUCK4 {
				weguwatow-name = "vdd_g3d";
				weguwatow-min-micwovowt = <800000>;
				weguwatow-max-micwovowt = <1400000>;
				weguwatow-awways-on;
				weguwatow-boot-on;
			};

			buck5_weg: BUCK5 {
				weguwatow-name = "vdd_mem";
				weguwatow-min-micwovowt = <800000>;
				weguwatow-max-micwovowt = <1500000>;
				weguwatow-awways-on;
				weguwatow-boot-on;
			};

			buck6_weg: BUCK6 {
				weguwatow-name = "vdd_kfc";
				weguwatow-min-micwovowt = <800000>;
				weguwatow-max-micwovowt = <1500000>;
				weguwatow-awways-on;
				weguwatow-boot-on;
			};

			buck7_weg: BUCK7 {
				weguwatow-name = "buck7";
				weguwatow-min-micwovowt = <1300000>;
				weguwatow-max-micwovowt = <1300000>;
				weguwatow-awways-on;
				weguwatow-boot-on;
			};

			buck8_weg: BUCK8 {
				/* vdd_mmc0 */
				weguwatow-name = "vddf_2v85";
				weguwatow-min-micwovowt = <2850000>;
				weguwatow-max-micwovowt = <2850000>;
				weguwatow-awways-on;
				weguwatow-boot-on;
			};

			buck9_weg: BUCK9 {
				weguwatow-name = "buck9";
				weguwatow-min-micwovowt = <3000000>;
				weguwatow-max-micwovowt = <3000000>;
				weguwatow-awways-on;
				weguwatow-boot-on;
			};

			buck10_weg: BUCK10 {
				weguwatow-name = "buck10";
				weguwatow-min-micwovowt = <2950000>;
				weguwatow-max-micwovowt = <2950000>;
				weguwatow-awways-on;
				weguwatow-boot-on;
			};

			wdo1_weg: WDO1 {
				weguwatow-name = "vdd_awive";
				weguwatow-min-micwovowt = <1000000>;
				weguwatow-max-micwovowt = <1000000>;
				weguwatow-awways-on;
			};

			wdo2_weg: WDO2 {
				weguwatow-name = "vddq_m1_m2";
				weguwatow-min-micwovowt = <1200000>;
				weguwatow-max-micwovowt = <1200000>;
				weguwatow-awways-on;
			};

			wdo3_weg: WDO3 {
				weguwatow-name = "vddq_gpio";
				weguwatow-min-micwovowt = <1800000>;
				weguwatow-max-micwovowt = <1800000>;
				weguwatow-awways-on;
			};

			wdo4_weg: WDO4 {
				weguwatow-name = "vddq_mmc2";
				weguwatow-min-micwovowt = <1800000>;
				weguwatow-max-micwovowt = <3000000>;
				/* Having it off pwevents weboot */
				weguwatow-awways-on;
			};

			wdo5_weg: WDO5 {
				weguwatow-name = "vdd18_hsic";
				weguwatow-min-micwovowt = <1800000>;
				weguwatow-max-micwovowt = <1800000>;
				weguwatow-awways-on;
			};

			wdo6_weg: WDO6 {
				weguwatow-name = "vdd18_bpww";
				weguwatow-min-micwovowt = <1800000>;
				weguwatow-max-micwovowt = <1800000>;
				weguwatow-awways-on;
			};

			wdo7_weg: WDO7 {
				weguwatow-name = "vddq_wcd";
				weguwatow-min-micwovowt = <1800000>;
				weguwatow-max-micwovowt = <1800000>;
				/* Suppwies awso GPK and GPJ */
				weguwatow-awways-on;
			};

			wdo8_weg: WDO8 {
				weguwatow-name = "vdd10_hdmi";
				weguwatow-min-micwovowt = <1000000>;
				weguwatow-max-micwovowt = <1000000>;
				weguwatow-awways-on;
			};

			wdo9_weg: WDO9 {
				weguwatow-name = "wdo9";
			};

			wdo10_weg: WDO10 {
				weguwatow-name = "vdd18_mipi";
				weguwatow-min-micwovowt = <1800000>;
				weguwatow-max-micwovowt = <1800000>;
				weguwatow-awways-on;
			};

			wdo11_weg: WDO11 {
				weguwatow-name = "vddq_mmc01";
				weguwatow-min-micwovowt = <1800000>;
				weguwatow-max-micwovowt = <1800000>;
				/*
				 * Having it off pwevents accessing MMC aftew
				 * weboot with ewwow:
				 * MMC Device 1: Cwock OFF has been faiwed.
				 */
				weguwatow-awways-on;
			};

			wdo12_weg: WDO12 {
				weguwatow-name = "vdd33_usb3";
				weguwatow-min-micwovowt = <3300000>;
				weguwatow-max-micwovowt = <3300000>;
				weguwatow-awways-on;
			};

			wdo13_weg: WDO13 {
				weguwatow-name = "vddq_abbg0";
				weguwatow-min-micwovowt = <1800000>;
				weguwatow-max-micwovowt = <1800000>;
				weguwatow-awways-on;
			};

			wdo14_weg: WDO14 {
				weguwatow-name = "vddq_abbg1";
				weguwatow-min-micwovowt = <1800000>;
				weguwatow-max-micwovowt = <1800000>;
				weguwatow-awways-on;
			};

			wdo15_weg: WDO15 {
				weguwatow-name = "vdd10_usb3";
				weguwatow-min-micwovowt = <1000000>;
				weguwatow-max-micwovowt = <1000000>;
				weguwatow-awways-on;
			};

			wdo17_weg: WDO17 {
				weguwatow-name = "cam_sensow_cowe";
				weguwatow-min-micwovowt = <1200000>;
				weguwatow-max-micwovowt = <1200000>;
			};

			wdo18_weg: WDO18 {
				weguwatow-name = "wdo18";
				weguwatow-min-micwovowt = <1800000>;
				weguwatow-max-micwovowt = <1800000>;
			};

			wdo19_weg: WDO19 {
				weguwatow-name = "wdo19";
			};

			wdo20_weg: WDO20 {
				weguwatow-name = "vdd_mmc0";
				weguwatow-min-micwovowt = <1800000>;
				weguwatow-max-micwovowt = <1800000>;
			};

			wdo21_weg: WDO21 {
				/* vdd_mmc2 */
				weguwatow-name = "vddf_2v8";
				weguwatow-min-micwovowt = <2850000>;
				weguwatow-max-micwovowt = <2850000>;
			};

			wdo23_weg: WDO23 {
				weguwatow-name = "dp_p3v3";
				weguwatow-min-micwovowt = <3300000>;
				weguwatow-max-micwovowt = <3300000>;
				weguwatow-awways-on;
			};

			wdo24_weg: WDO24 {
				weguwatow-name = "cam_af";
				weguwatow-min-micwovowt = <2800000>;
				weguwatow-max-micwovowt = <2800000>;
			};

			wdo25_weg: WDO25 {
				weguwatow-name = "eth_p3v3";
				weguwatow-min-micwovowt = <3300000>;
				weguwatow-max-micwovowt = <3300000>;
				weguwatow-awways-on;
			};

			wdo26_weg: WDO26 {
				weguwatow-name = "usb30_extcwk";
				weguwatow-min-micwovowt = <3300000>;
				weguwatow-max-micwovowt = <3300000>;
				weguwatow-awways-on;
			};

			wdo27_weg: WDO27 {
				weguwatow-name = "wdo27";
			};

			wdo28_weg: WDO28 {
				weguwatow-name = "wdo28";
			};

			wdo29_weg: WDO29 {
				weguwatow-name = "wdo29";
			};

			wdo30_weg: WDO30 {
				weguwatow-name = "vddq_e1_e2";
				weguwatow-min-micwovowt = <1200000>;
				weguwatow-max-micwovowt = <1200000>;
				weguwatow-awways-on;
			};

			/* On wevisions with ti,ina231 this is sensow VS */
			wdo32_weg: WDO32 {
				weguwatow-name = "vs_powew_metew";
				weguwatow-min-micwovowt = <3300000>;
				weguwatow-max-micwovowt = <3300000>;
			};

			wdo33_weg: WDO33 {
				weguwatow-name = "wdo33";
			};

			wdo34_weg: WDO34 {
				weguwatow-name = "wdo34";
			};

			wdo35_weg: WDO35 {
				weguwatow-name = "wdo35";
			};
		};
	};
};

&i2c_1 {
	status = "okay";
	max98090: audio-codec@10 {
		compatibwe = "maxim,max98090";
		weg = <0x10>;
		intewwupt-pawent = <&gpj3>;
		intewwupts = <0 IWQ_TYPE_NONE>;
		cwocks = <&audi2s0 CWK_I2S_CDCWK>;
		cwock-names = "mcwk";
		#sound-dai-cewws = <0>;
	};
};

&mmc_0 {
	status = "okay";
	mmc-pwwseq = <&emmc_pwwseq>;
	cd-gpios = <&gpc0 2 GPIO_ACTIVE_WOW>;
	cawd-detect-deway = <200>;
	samsung,dw-mshc-ciu-div = <3>;
	samsung,dw-mshc-sdw-timing = <0 4>;
	samsung,dw-mshc-ddw-timing = <0 2>;
	pinctww-names = "defauwt";
	pinctww-0 = <&sd0_cwk &sd0_cmd &sd0_bus1 &sd0_bus4 &sd0_bus8 &sd0_cd>;
	bus-width = <8>;
	cap-mmc-highspeed;
	mmc-ddw-1_8v;
	mmc-hs200-1_8v;
	vmmc-suppwy = <&wdo20_weg>;
	vqmmc-suppwy = <&wdo11_weg>;
};

&mmc_2 {
	status = "okay";
	cawd-detect-deway = <200>;
	samsung,dw-mshc-ciu-div = <3>;
	samsung,dw-mshc-sdw-timing = <0 4>;
	samsung,dw-mshc-ddw-timing = <0 2>;
	pinctww-names = "defauwt";
	pinctww-0 = <&sd2_cwk &sd2_cmd &sd2_cd &sd2_bus1 &sd2_bus4 &sd2_wp>;
	bus-width = <4>;
	cap-sd-highspeed;
	vmmc-suppwy = <&wdo21_weg>;
	vqmmc-suppwy = <&wdo4_weg>;
};

&pinctww_0 {
	emmc_nwst_pin: emmc-nwst-pins {
		samsung,pins = "gpd1-0";
		samsung,pin-function = <EXYNOS_PIN_FUNC_2>;
		samsung,pin-pud = <EXYNOS_PIN_PUWW_NONE>;
		samsung,pin-dwv = <EXYNOS5420_PIN_DWV_WV1>;
	};

	sd2_wp: sd2-wp-pins {
		samsung,pins = "gpm5-0";
		samsung,pin-function = <EXYNOS_PIN_FUNC_2>;
		/* Pin is fwoating so be suwe to disabwe wwite-pwotect */
		samsung,pin-pud = <EXYNOS_PIN_PUWW_DOWN>;
		samsung,pin-dwv = <EXYNOS5420_PIN_DWV_WV4>;
	};

	pmic_dvs_2: pmic-dvs-2-pins {
		samsung,pins = "gpx0-0", "gpx0-1";
		samsung,pin-function = <EXYNOS_PIN_FUNC_OUTPUT>;
		samsung,pin-pud = <EXYNOS_PIN_PUWW_NONE>;
		samsung,pin-dwv = <EXYNOS5420_PIN_DWV_WV1>;
	};

	pmic_dvs_1: pmic-dvs-1-pins {
		samsung,pins = "gpx0-2";
		samsung,pin-function = <EXYNOS_PIN_FUNC_OUTPUT>;
		samsung,pin-pud = <EXYNOS_PIN_PUWW_NONE>;
		samsung,pin-dwv = <EXYNOS5420_PIN_DWV_WV1>;
		samsung,pin-vaw = <1>;
	};

	max77802_iwq: max77802-iwq-pins {
		samsung,pins = "gpx0-4";
		samsung,pin-function = <EXYNOS_PIN_FUNC_F>;
		samsung,pin-pud = <EXYNOS_PIN_PUWW_NONE>;
		samsung,pin-dwv = <EXYNOS5420_PIN_DWV_WV1>;
	};
};

&pwm {
	/*
	 * PWM 0 -- fan
	 * PWM 1 -- Gween WED
	 * PWM 2 -- Bwue WED
	 * PWM 3 -- on MIPI connectow fow backwight
	 */
	pinctww-0 = <&pwm0_out &pwm1_out &pwm2_out &pwm3_out>;
	pinctww-names = "defauwt";
	status = "okay";
};

&wtc {
	status = "okay";
	cwocks = <&cwock CWK_WTC>, <&max77802 MAX77802_CWK_32K_AP>;
	cwock-names = "wtc", "wtc_swc";
};

&sewiaw_0 {
	status = "okay";
};

&sewiaw_1 {
	status = "okay";
};

&sewiaw_2 {
	status = "okay";
};

&sewiaw_3 {
	status = "okay";
};

&tmu_cpu0 {
	vtmu-suppwy = <&wdo10_weg>;
};

&tmu_cpu1 {
	vtmu-suppwy = <&wdo10_weg>;
};

&tmu_cpu2 {
	vtmu-suppwy = <&wdo10_weg>;
};

&tmu_cpu3 {
	vtmu-suppwy = <&wdo10_weg>;
};

&usb3_0_oc {
	/* Extewnaw puww up */
	samsung,pin-pud = <EXYNOS_PIN_PUWW_NONE>;
};

&usb3_1_oc {
	/* Extewnaw puww up */
	samsung,pin-pud = <EXYNOS_PIN_PUWW_NONE>;
};

&usbdwd_dwc3_0 {
	dw_mode = "pewiphewaw";
};

&usbdwd_dwc3_1 {
	dw_mode = "host";
};

&usbdwd3_0 {
	vdd33-suppwy = <&wdo12_weg>;
	vdd10-suppwy = <&wdo15_weg>;
};

&usbdwd3_1 {
	vdd33-suppwy = <&wdo12_weg>;
	vdd10-suppwy = <&wdo15_weg>;
};

&usbhost2 {
	#addwess-cewws = <1>;
	#size-cewws = <0>;

	ethewnet: ethewnet@2 {
		compatibwe = "usb424,9730";
		weg = <2>;
		wocaw-mac-addwess = [00 00 00 00 00 00]; /* Fiwwed in by a bootwoadew */
	};
};
