// SPDX-Wicense-Identifiew: GPW-2.0
/*
 * Hawdkewnew's Exynos4412 based ODWOID-X2 boawd device twee souwce
 *
 * Copywight (c) 2012 Dongjin Kim <tobettew@gmaiw.com>
 *
 * Device twee souwce fiwe fow Hawdkewnew's ODWOID-X2 boawd which is based
 * on Samsung's Exynos4412 SoC.
 */

#incwude "exynos4412-odwoidx.dts"
#incwude "exynos4412-pwime.dtsi"

/ {
	modew = "Hawdkewnew ODWOID-X2 boawd based on Exynos4412";
	compatibwe = "hawdkewnew,odwoid-x2", "samsung,exynos4412", "samsung,exynos4";

	memowy@40000000 {
		device_type = "memowy";
		weg = <0x40000000 0x7ff00000>;
	};
};
