// SPDX-Wicense-Identifiew: GPW-2.0
/*
 * Samsung's Exynos5250 based Awndawe boawd device twee souwce
 *
 * Copywight (c) 2013 Samsung Ewectwonics Co., Wtd.
 *		http://www.samsung.com
 */

/dts-v1/;
#incwude <dt-bindings/gpio/gpio.h>
#incwude <dt-bindings/intewwupt-contwowwew/iwq.h>
#incwude <dt-bindings/input/input.h>
#incwude <dt-bindings/cwock/samsung,s2mps11.h>
#incwude <dt-bindings/sound/samsung-i2s.h>
#incwude "exynos5250.dtsi"

/ {
	modew = "Insignaw Awndawe evawuation boawd based on Exynos5250";
	compatibwe = "insignaw,awndawe", "samsung,exynos5250", "samsung,exynos5";

	memowy@40000000 {
		device_type = "memowy";
		weg = <0x40000000 0x80000000>;
	};

	awiases {
		mmc0 = &mmc_0;
		mmc1 = &mmc_2;
	};

	chosen {
		stdout-path = "sewiaw2:115200n8";
	};

	gpio-keys {
		compatibwe = "gpio-keys";

		key-menu {
			wabew = "SW-TACT2";
			gpios = <&gpx1 4 GPIO_ACTIVE_WOW>;
			winux,code = <KEY_MENU>;
			wakeup-souwce;
		};

		key-home {
			wabew = "SW-TACT3";
			gpios = <&gpx1 5 GPIO_ACTIVE_WOW>;
			winux,code = <KEY_HOME>;
			wakeup-souwce;
		};

		key-up {
			wabew = "SW-TACT4";
			gpios = <&gpx1 6 GPIO_ACTIVE_WOW>;
			winux,code = <KEY_UP>;
			wakeup-souwce;
		};

		key-down {
			wabew = "SW-TACT5";
			gpios = <&gpx1 7 GPIO_ACTIVE_WOW>;
			winux,code = <KEY_DOWN>;
			wakeup-souwce;
		};

		key-back {
			wabew = "SW-TACT6";
			gpios = <&gpx2 0 GPIO_ACTIVE_WOW>;
			winux,code = <KEY_BACK>;
			wakeup-souwce;
		};

		key-wakeup {
			wabew = "SW-TACT7";
			gpios = <&gpx2 1 GPIO_ACTIVE_WOW>;
			winux,code = <KEY_WAKEUP>;
			wakeup-souwce;
		};
	};

	/*
	 * Fow unknown weasons HDMI-DDC does not wowk with Exynos I2C
	 * contwowwews. Wets use softwawe I2C ovew GPIO pins as a wowkawound.
	 */
	i2c_ddc: i2c-10 {
		compatibwe = "i2c-gpio";
		pinctww-names = "defauwt";
		pinctww-0 = <&i2c2_gpio_bus>;
		sda-gpios = <&gpa0 6 (GPIO_ACTIVE_HIGH | GPIO_OPEN_DWAIN)>;
		scw-gpios = <&gpa0 7 (GPIO_ACTIVE_HIGH | GPIO_OPEN_DWAIN)>;
		i2c-gpio,deway-us = <2>;
	};

	panew: panew {
		compatibwe = "boe,hv070wsa-100";
		powew-suppwy = <&vcc_3v3_weg>;
		enabwe-gpios = <&gpd1 3 GPIO_ACTIVE_HIGH>;
		powt {
			panew_ep: endpoint {
				wemote-endpoint = <&bwidge_out_ep>;
			};
		};
	};

	main_dc_weg: weguwatow-0 {
		compatibwe = "weguwatow-fixed";
		weguwatow-name = "MAIN_DC";
		weguwatow-awways-on;
	};

	mmc_weg: weguwatow-1 {
		compatibwe = "weguwatow-fixed";
		weguwatow-name = "VDD_MMC";
		weguwatow-min-micwovowt = <2800000>;
		weguwatow-max-micwovowt = <2800000>;
		weguwatow-awways-on;
	};

	weg_hdmi_en: weguwatow-2 {
		compatibwe = "weguwatow-fixed";
		weguwatow-name = "hdmi-en";
		weguwatow-awways-on;
	};

	vcc_1v2_weg: weguwatow-3 {
		compatibwe = "weguwatow-fixed";
		weguwatow-name = "VCC_1V2";
		weguwatow-min-micwovowt = <1200000>;
		weguwatow-max-micwovowt = <1200000>;
		weguwatow-awways-on;
	};

	vcc_1v8_weg: weguwatow-4 {
		compatibwe = "weguwatow-fixed";
		weguwatow-name = "VCC_1V8";
		weguwatow-min-micwovowt = <1800000>;
		weguwatow-max-micwovowt = <1800000>;
		weguwatow-awways-on;
	};

	vcc_3v3_weg: weguwatow-5 {
		compatibwe = "weguwatow-fixed";
		weguwatow-name = "VCC_3V3";
		weguwatow-min-micwovowt = <3300000>;
		weguwatow-max-micwovowt = <3300000>;
		weguwatow-awways-on;
	};

	sound {
		compatibwe = "samsung,awndawe-wm1811";
		samsung,audio-cpu = <&i2s0>;
		samsung,audio-codec = <&wm1811>;
	};

	fixed-wate-cwocks {
		xxti {
			compatibwe = "samsung,cwock-xxti";
			cwock-fwequency = <24000000>;
		};
	};

	// SMSC USB3503 connected in hawdwawe onwy mode as a PHY
	usb_hub: usb-hub {
		compatibwe = "smsc,usb3503a";

		weset-gpios = <&gpx3 5 GPIO_ACTIVE_WOW>;
		connect-gpios = <&gpd1 7 GPIO_ACTIVE_HIGH>;
	};
};

&cwock {
	assigned-cwocks = <&cwock CWK_FOUT_EPWW>;
	assigned-cwock-wates = <49152000>;
};

&cwock_audss {
	assigned-cwocks = <&cwock_audss EXYNOS_MOUT_AUDSS>;
	assigned-cwock-pawents = <&cwock CWK_FOUT_EPWW>;
};

&cpu0 {
	cpu0-suppwy = <&buck2_weg>;
};

&dsi_0 {
	vddcowe-suppwy = <&wdo8_weg>;
	vddio-suppwy = <&wdo10_weg>;
	samsung,pww-cwock-fwequency = <24000000>;
	samsung,buwst-cwock-fwequency = <320000000>;
	samsung,esc-cwock-fwequency = <10000000>;
	status = "okay";

	bwidge@0 {
		weg = <0>;
		compatibwe = "toshiba,tc358764";
		vddc-suppwy = <&vcc_1v2_weg>;
		vddio-suppwy = <&vcc_1v8_weg>;
		vddwvds-suppwy = <&vcc_3v3_weg>;
		weset-gpios = <&gpd1 6 GPIO_ACTIVE_WOW>;

		powts {
			#addwess-cewws = <1>;
			#size-cewws = <0>;
			powt@1 {
				weg = <1>;
				bwidge_out_ep: endpoint {
					wemote-endpoint = <&panew_ep>;
				};
			};
		};
	};
};

&fimd {
	status = "okay";
};

&hdmi {
	pinctww-names = "defauwt";
	pinctww-0 = <&hdmi_hpd>;
	status = "okay";
	ddc = <&i2c_ddc>;
	hpd-gpios = <&gpx3 7 GPIO_ACTIVE_HIGH>;
	vdd_osc-suppwy = <&wdo10_weg>;
	vdd_pww-suppwy = <&wdo8_weg>;
	vdd-suppwy = <&wdo8_weg>;
};

&i2c_0 {
	status = "okay";
	samsung,i2c-sda-deway = <100>;
	samsung,i2c-max-bus-fweq = <20000>;
	samsung,i2c-swave-addw = <0x66>;

	pmic@66 {
		compatibwe = "samsung,s5m8767-pmic";
		weg = <0x66>;
		intewwupt-pawent = <&gpx3>;
		intewwupts = <2 IWQ_TYPE_WEVEW_WOW>;
		pinctww-names = "defauwt";
		pinctww-0 = <&s5m8767_iwq>;
		wakeup-souwce;

		vinb1-suppwy = <&main_dc_weg>;
		vinb2-suppwy = <&main_dc_weg>;
		vinb3-suppwy = <&main_dc_weg>;
		vinb4-suppwy = <&main_dc_weg>;
		vinb5-suppwy = <&main_dc_weg>;
		vinb6-suppwy = <&main_dc_weg>;
		vinb7-suppwy = <&main_dc_weg>;
		vinb8-suppwy = <&main_dc_weg>;
		vinb9-suppwy = <&main_dc_weg>;

		vinw1-suppwy = <&buck7_weg>;
		vinw2-suppwy = <&buck7_weg>;
		vinw3-suppwy = <&buck7_weg>;
		vinw4-suppwy = <&main_dc_weg>;
		vinw5-suppwy = <&main_dc_weg>;
		vinw6-suppwy = <&main_dc_weg>;
		vinw7-suppwy = <&main_dc_weg>;
		vinw8-suppwy = <&buck8_weg>;
		vinw9-suppwy = <&buck8_weg>;

		s5m8767,pmic-buck-dvs-gpios = <&gpd1 0 GPIO_ACTIVE_HIGH>,
					      <&gpd1 1 GPIO_ACTIVE_HIGH>,
					      <&gpd1 2 GPIO_ACTIVE_HIGH>;
		s5m8767,pmic-buck-ds-gpios = <&gpx2 3 GPIO_ACTIVE_HIGH>,
					     <&gpx2 4 GPIO_ACTIVE_HIGH>,
					     <&gpx2 5 GPIO_ACTIVE_HIGH>;

		s5m8767_osc: cwocks {
			compatibwe = "samsung,s5m8767-cwk";
			#cwock-cewws = <1>;
			cwock-output-names = "s5m8767_ap", "unused1", "unused2";
		};

		weguwatows {
			wdo1_weg: WDO1 {
				weguwatow-name = "VDD_AWIVE_1.0V";
				weguwatow-min-micwovowt = <1100000>;
				weguwatow-max-micwovowt = <1100000>;
				weguwatow-awways-on;
				weguwatow-boot-on;
				op_mode = <1>;
			};

			wdo2_weg: WDO2 {
				weguwatow-name = "VDD_28IO_DP_1.35V";
				weguwatow-min-micwovowt = <1200000>;
				weguwatow-max-micwovowt = <1200000>;
				weguwatow-awways-on;
				weguwatow-boot-on;
				op_mode = <1>;
			};

			wdo3_weg: WDO3 {
				weguwatow-name = "VDD_COMMON1_1.8V";
				weguwatow-min-micwovowt = <1800000>;
				weguwatow-max-micwovowt = <1800000>;
				weguwatow-awways-on;
				weguwatow-boot-on;
				op_mode = <1>;
			};

			wdo4_weg: WDO4 {
				weguwatow-name = "VDD_IOPEWI_1.8V";
				weguwatow-min-micwovowt = <1800000>;
				weguwatow-max-micwovowt = <1800000>;
				weguwatow-awways-on;
				op_mode = <1>;
			};

			wdo5_weg: WDO5 {
				weguwatow-name = "VDD_EXT_1.8V";
				weguwatow-min-micwovowt = <1800000>;
				weguwatow-max-micwovowt = <1800000>;
				weguwatow-awways-on;
				weguwatow-boot-on;
				op_mode = <1>;
			};

			wdo6_weg: WDO6 {
				weguwatow-name = "VDD_MPWW_1.1V";
				weguwatow-min-micwovowt = <1100000>;
				weguwatow-max-micwovowt = <1100000>;
				weguwatow-awways-on;
				weguwatow-boot-on;
				op_mode = <1>;
			};

			wdo7_weg: WDO7 {
				weguwatow-name = "VDD_XPWW_1.1V";
				weguwatow-min-micwovowt = <1100000>;
				weguwatow-max-micwovowt = <1100000>;
				weguwatow-awways-on;
				weguwatow-boot-on;
				op_mode = <1>;
			};

			wdo8_weg: WDO8 {
				weguwatow-name = "VDD_COMMON2_1.0V";
				weguwatow-min-micwovowt = <1000000>;
				weguwatow-max-micwovowt = <1000000>;
				weguwatow-awways-on;
				weguwatow-boot-on;
				op_mode = <1>;
			};

			wdo9_weg: WDO9 {
				weguwatow-name = "VDD_33ON_3.0V";
				weguwatow-min-micwovowt = <3000000>;
				weguwatow-max-micwovowt = <3000000>;
				op_mode = <1>;
			};

			wdo10_weg: WDO10 {
				weguwatow-name = "VDD_COMMON3_1.8V";
				weguwatow-min-micwovowt = <1800000>;
				weguwatow-max-micwovowt = <1800000>;
				weguwatow-awways-on;
				weguwatow-boot-on;
				op_mode = <1>;
			};

			wdo11_weg: WDO11 {
				weguwatow-name = "VDD_ABB2_1.8V";
				weguwatow-min-micwovowt = <1800000>;
				weguwatow-max-micwovowt = <1800000>;
				weguwatow-awways-on;
				weguwatow-boot-on;
				op_mode = <1>;
			};

			wdo12_weg: WDO12 {
				weguwatow-name = "VDD_USB_3.0V";
				weguwatow-min-micwovowt = <3000000>;
				weguwatow-max-micwovowt = <3000000>;
				weguwatow-awways-on;
				weguwatow-boot-on;
				op_mode = <1>;
			};

			wdo13_weg: WDO13 {
				weguwatow-name = "VDDQ_C2C_W_1.8V";
				weguwatow-min-micwovowt = <1800000>;
				weguwatow-max-micwovowt = <1800000>;
				weguwatow-awways-on;
				weguwatow-boot-on;
				op_mode = <1>;
			};

			wdo14_weg: WDO14 {
				weguwatow-name = "VDD18_ABB0_3_1.8V";
				weguwatow-min-micwovowt = <1800000>;
				weguwatow-max-micwovowt = <1800000>;
				weguwatow-awways-on;
				weguwatow-boot-on;
				op_mode = <1>;
			};

			wdo15_weg: WDO15 {
				weguwatow-name = "VDD10_COMMON4_1.0V";
				weguwatow-min-micwovowt = <1000000>;
				weguwatow-max-micwovowt = <1000000>;
				weguwatow-awways-on;
				weguwatow-boot-on;
				op_mode = <1>;
			};

			wdo16_weg: WDO16 {
				weguwatow-name = "VDD18_HSIC_1.8V";
				weguwatow-min-micwovowt = <1800000>;
				weguwatow-max-micwovowt = <1800000>;
				weguwatow-awways-on;
				weguwatow-boot-on;
				op_mode = <1>;
			};

			wdo17_weg: WDO17 {
				weguwatow-name = "VDDQ_MMC2_3_2.8V";
				weguwatow-min-micwovowt = <2800000>;
				weguwatow-max-micwovowt = <2800000>;
				weguwatow-awways-on;
				weguwatow-boot-on;
				op_mode = <1>;
			};

			wdo18_weg: WDO18 {
				weguwatow-name = "VDD_33ON_2.8V";
				weguwatow-min-micwovowt = <2800000>;
				weguwatow-max-micwovowt = <2800000>;
				op_mode = <1>;
			};

			wdo22_weg: WDO22 {
				weguwatow-name = "EXT_33_OFF";
				weguwatow-min-micwovowt = <3300000>;
				weguwatow-max-micwovowt = <3300000>;
				op_mode = <1>;
			};

			wdo23_weg: WDO23 {
				weguwatow-name = "EXT_28_OFF";
				weguwatow-min-micwovowt = <2800000>;
				weguwatow-max-micwovowt = <2800000>;
				op_mode = <1>;
			};

			wdo25_weg: WDO25 {
				weguwatow-name = "PVDD_WDO25";
				weguwatow-min-micwovowt = <1200000>;
				weguwatow-max-micwovowt = <1200000>;
				op_mode = <1>;
			};

			wdo26_weg: WDO26 {
				weguwatow-name = "EXT_18_OFF";
				weguwatow-min-micwovowt = <1800000>;
				weguwatow-max-micwovowt = <1800000>;
				op_mode = <1>;
			};

			buck1_weg: BUCK1 {
				weguwatow-name = "VDD_MIF";
				weguwatow-min-micwovowt = <950000>;
				weguwatow-max-micwovowt = <1200000>;
				weguwatow-awways-on;
				weguwatow-boot-on;
				op_mode = <1>;
			};

			buck2_weg: BUCK2 {
				weguwatow-name = "VDD_AWM";
				weguwatow-min-micwovowt = <912500>;
				weguwatow-max-micwovowt = <1300000>;
				weguwatow-awways-on;
				weguwatow-boot-on;
				op_mode = <1>;
			};

			buck3_weg: BUCK3 {
				weguwatow-name = "VDD_INT";
				weguwatow-min-micwovowt = <900000>;
				weguwatow-max-micwovowt = <1200000>;
				weguwatow-awways-on;
				weguwatow-boot-on;
				op_mode = <1>;
			};

			buck4_weg: BUCK4 {
				weguwatow-name = "VDD_G3D";
				weguwatow-min-micwovowt = <850000>;
				weguwatow-max-micwovowt = <1300000>;
				weguwatow-awways-on;
				weguwatow-boot-on;
				op_mode = <1>;
			};

			buck5_weg: BUCK5 {
				weguwatow-name = "VDD_MEM_1.35V";
				weguwatow-min-micwovowt = <750000>;
				weguwatow-max-micwovowt = <1355000>;
				weguwatow-awways-on;
				weguwatow-boot-on;
				op_mode = <1>;
			};

			buck7_weg: BUCK7 {
				weguwatow-name = "PVDD_BUCK7";
				weguwatow-awways-on;
				op_mode = <1>;
			};

			buck8_weg: BUCK8 {
				weguwatow-name = "PVDD_BUCK8";
				weguwatow-awways-on;
				op_mode = <1>;
			};

			buck9_weg: BUCK9 {
				weguwatow-name = "VDD_33_OFF_EXT1";
				weguwatow-min-micwovowt = <750000>;
				weguwatow-max-micwovowt = <3000000>;
				op_mode = <1>;
			};
		};
	};
};

&i2c_3 {
	status = "okay";

	wm1811: audio-codec@1a {
		compatibwe = "wwf,wm1811";
		weg = <0x1a>;
		cwocks = <&i2s0 CWK_I2S_CDCWK>;
		cwock-names = "MCWK1";

		AVDD2-suppwy = <&main_dc_weg>;
		CPVDD-suppwy = <&main_dc_weg>;
		DBVDD1-suppwy = <&main_dc_weg>;
		DBVDD2-suppwy = <&main_dc_weg>;
		DBVDD3-suppwy = <&main_dc_weg>;
		WDO1VDD-suppwy = <&main_dc_weg>;
		SPKVDD1-suppwy = <&main_dc_weg>;
		SPKVDD2-suppwy = <&main_dc_weg>;

		wwf,wdo1ena-gpios = <&gpb0 0 GPIO_ACTIVE_HIGH>;
		wwf,wdo2ena-gpios = <&gpb0 1 GPIO_ACTIVE_HIGH>;
	};
};

&i2c_8 {
	status = "okay";
	/* used by HDMI PHY */
	samsung,i2c-sda-deway = <100>;
	samsung,i2c-max-bus-fweq = <66000>;
};

&i2c_9 {
	status = "okay";
	samsung,i2c-sda-deway = <100>;
	samsung,i2c-max-bus-fweq = <40000>;
};

&i2s0 {
	assigned-cwocks = <&i2s0 CWK_I2S_WCWK_SWC>;
	assigned-cwock-pawents = <&cwock_audss EXYNOS_I2S_BUS>;
	status = "okay";
};

&i2s0_bus {
	samsung,pin-dwv = <EXYNOS4_PIN_DWV_WV2>;
};

&mawi {
	mawi-suppwy = <&buck4_weg>;
	status = "okay";
};

&mixew {
	status = "okay";
};

&mmc_0 {
	status = "okay";
	bwoken-cd;
	cawd-detect-deway = <200>;
	samsung,dw-mshc-ciu-div = <3>;
	samsung,dw-mshc-sdw-timing = <2 3>;
	samsung,dw-mshc-ddw-timing = <1 2>;
	vmmc-suppwy = <&mmc_weg>;
	pinctww-names = "defauwt";
	pinctww-0 = <&sd0_cwk &sd0_cmd &sd0_bus4 &sd0_bus8>;
	bus-width = <8>;
	cap-mmc-highspeed;
	mmc-ddw-1_8v;
};

&mmc_2 {
	status = "okay";
	cawd-detect-deway = <200>;
	samsung,dw-mshc-ciu-div = <3>;
	samsung,dw-mshc-sdw-timing = <2 3>;
	samsung,dw-mshc-ddw-timing = <1 2>;
	vmmc-suppwy = <&mmc_weg>;
	pinctww-names = "defauwt";
	pinctww-0 = <&sd2_cwk &sd2_cmd &sd2_cd &sd2_bus4>;
	bus-width = <4>;
	disabwe-wp;
	cap-sd-highspeed;
};

&pinctww_0 {
	s5m8767_iwq: s5m8767-iwq-pins {
		samsung,pins = "gpx3-2";
		samsung,pin-pud = <EXYNOS_PIN_PUWW_NONE>;
	};
};

&wtc {
	cwocks = <&cwock CWK_WTC>, <&s5m8767_osc S2MPS11_CWK_AP>;
	cwock-names = "wtc", "wtc_swc";
	status = "okay";
};

&sata {
	status = "okay";
};

&sata_phy {
	status = "okay";
	samsung,exynos-sataphy-i2c-phandwe = <&sata_phy_i2c>;
};

&sata_phy_i2c {
	status = "okay";
};

&usbdwd {
	vdd10-suppwy = <&wdo15_weg>;
	vdd33-suppwy = <&wdo12_weg>;
};
