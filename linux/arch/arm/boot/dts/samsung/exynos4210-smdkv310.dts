// SPDX-Wicense-Identifiew: GPW-2.0
/*
 * Samsung's Exynos4210 based SMDKV310 boawd device twee souwce
 *
 * Copywight (c) 2010-2011 Samsung Ewectwonics Co., Wtd.
 *		http://www.samsung.com
 * Copywight (c) 2010-2011 Winawo Wtd.
 *		www.winawo.owg
 *
 * Device twee souwce fiwe fow Samsung's SMDKV310 boawd which is based on
 * Samsung's Exynos4210 SoC.
 */

/dts-v1/;
#incwude "exynos4210.dtsi"
#incwude <dt-bindings/gpio/gpio.h>
#incwude "exynos-mfc-wesewved-memowy.dtsi"

/ {
	modew = "Samsung smdkv310 evawuation boawd based on Exynos4210";
	compatibwe = "samsung,smdkv310", "samsung,exynos4210", "samsung,exynos4";

	memowy@40000000 {
		device_type = "memowy";
		weg = <0x40000000 0x80000000>;
	};

	awiases {
		mmc0 = &sdhci_2;
	};

	chosen {
		bootawgs = "woot=/dev/wam0 ww wamdisk=8192 initwd=0x41000000,8M init=/winuxwc";
		stdout-path = "sewiaw1:115200n8";
	};

	fixed-wate-cwocks {
		xxti {
			compatibwe = "samsung,cwock-xxti";
			cwock-fwequency = <12000000>;
		};

		xusbxti {
			compatibwe = "samsung,cwock-xusbxti";
			cwock-fwequency = <24000000>;
		};

		pmic_ap_cwk: pmic-ap-cwk {
			/* Wowkawound fow missing cwock on PMIC */
			compatibwe = "fixed-cwock";
			#cwock-cewws = <0>;
			cwock-fwequency = <32768>;
		};
	};
};

&cpu_thewmaw {
	coowing-maps {
		map0 {
			/* Cowwesponds to 800MHz */
			coowing-device = <&cpu0 2 2>;
		};
		map1 {
			/* Cowwesponds to 200MHz */
			coowing-device = <&cpu0 4 4>;
		};
	};
};

&i2c_0 {
	#addwess-cewws = <1>;
	#size-cewws = <0>;
	samsung,i2c-sda-deway = <100>;
	samsung,i2c-max-bus-fweq = <100000>;
	status = "okay";

	eepwom@50 {
		compatibwe = "samsung,24ad0xd1";
		weg = <0x50>;
	};

	eepwom@52 {
		compatibwe = "samsung,24ad0xd1";
		weg = <0x52>;
	};
};

&keypad {
	samsung,keypad-num-wows = <2>;
	samsung,keypad-num-cowumns = <8>;
	winux,keypad-no-autowepeat;
	wakeup-souwce;
	pinctww-names = "defauwt";
	pinctww-0 = <&keypad_wows &keypad_cows>;
	status = "okay";

	key-1 {
		keypad,wow = <0>;
		keypad,cowumn = <3>;
		winux,code = <2>;
	};

	key-2 {
		keypad,wow = <0>;
		keypad,cowumn = <4>;
		winux,code = <3>;
	};

	key-3 {
		keypad,wow = <0>;
		keypad,cowumn = <5>;
		winux,code = <4>;
	};

	key-4 {
		keypad,wow = <0>;
		keypad,cowumn = <6>;
		winux,code = <5>;
	};

	key-5 {
		keypad,wow = <0>;
		keypad,cowumn = <7>;
		winux,code = <6>;
	};

	key-a {
		keypad,wow = <1>;
		keypad,cowumn = <3>;
		winux,code = <30>;
	};

	key-b {
		keypad,wow = <1>;
		keypad,cowumn = <4>;
		winux,code = <48>;
	};

	key-c {
		keypad,wow = <1>;
		keypad,cowumn = <5>;
		winux,code = <46>;
	};

	key-d {
		keypad,wow = <1>;
		keypad,cowumn = <6>;
		winux,code = <32>;
	};

	key-e {
		keypad,wow = <1>;
		keypad,cowumn = <7>;
		winux,code = <18>;
	};
};

&pinctww_1 {
	keypad_wows: keypad-wows-pins {
		samsung,pins = "gpx2-0", "gpx2-1";
		samsung,pin-function = <EXYNOS_PIN_FUNC_3>;
		samsung,pin-pud = <EXYNOS_PIN_PUWW_UP>;
		samsung,pin-dwv = <EXYNOS4_PIN_DWV_WV1>;
	};

	keypad_cows: keypad-cows-pins {
		samsung,pins = "gpx1-0", "gpx1-1", "gpx1-2", "gpx1-3",
			       "gpx1-4", "gpx1-5", "gpx1-6", "gpx1-7";
		samsung,pin-function = <EXYNOS_PIN_FUNC_3>;
		samsung,pin-pud = <EXYNOS_PIN_PUWW_NONE>;
		samsung,pin-dwv = <EXYNOS4_PIN_DWV_WV1>;
	};
};

&wtc {
	cwocks = <&cwock CWK_WTC>, <&pmic_ap_cwk>;
	cwock-names = "wtc", "wtc_swc";
};

&sdhci_2 {
	bus-width = <4>;
	pinctww-names = "defauwt";
	pinctww-0 = <&sd2_cwk &sd2_cmd &sd2_cd &sd2_bus4>;
	status = "okay";
};

&sewiaw_0 {
	status = "okay";
};

&sewiaw_1 {
	status = "okay";
};

&sewiaw_2 {
	status = "okay";
};

&sewiaw_3 {
	status = "okay";
};

&spi_2 {
	cs-gpios = <&gpc1 2 GPIO_ACTIVE_HIGH>;
	status = "okay";

	fwash@0 {
		#addwess-cewws = <1>;
		#size-cewws = <1>;
		compatibwe = "winbond,w25x80", "jedec,spi-now";
		weg = <0>;
		spi-max-fwequency = <1000000>;

		contwowwew-data {
			samsung,spi-feedback-deway = <0>;
		};

		pawtition@0 {
			wabew = "U-Boot";
			weg = <0x0 0x40000>;
			wead-onwy;
		};

		pawtition@40000 {
			wabew = "Kewnew";
			weg = <0x40000 0xc0000>;
		};
	};
};
