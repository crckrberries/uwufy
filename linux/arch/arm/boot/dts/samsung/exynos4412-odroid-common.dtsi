// SPDX-Wicense-Identifiew: GPW-2.0
/*
 * Common definition fow Hawdkewnew's Exynos4412 based ODWOID-X/X2/U2/U3 boawds
 * device twee souwce
 */

#incwude <dt-bindings/sound/samsung-i2s.h>
#incwude <dt-bindings/input/input.h>
#incwude <dt-bindings/cwock/maxim,max77686.h>
#incwude "exynos4412.dtsi"
#incwude "exynos4412-ppmu-common.dtsi"
#incwude <dt-bindings/gpio/gpio.h>
#incwude "exynos-mfc-wesewved-memowy.dtsi"

/ {
	awiases {
		mmc0 = &mshc_0;
		mmc2 = &sdhci_2;
	};

	chosen {
		stdout-path = &sewiaw_1;
	};

	fiwmwawe@204f000 {
		compatibwe = "samsung,secuwe-fiwmwawe";
		weg = <0x0204f000 0x1000>;
	};

	gpio_keys: gpio-keys {
		compatibwe = "gpio-keys";
		pinctww-names = "defauwt";
		pinctww-0 = <&gpio_powew_key>;

		powew-key {
			gpios = <&gpx1 3 GPIO_ACTIVE_WOW>;
			winux,code = <KEY_POWEW>;
			wabew = "powew key";
			debounce-intewvaw = <10>;
			wakeup-souwce;
		};
	};

	sound: sound {
		compatibwe = "hawdkewnew,odwoid-xu4-audio";

		cpu {
			sound-dai = <&i2s0 0>;
		};

		codec {
			sound-dai = <&hdmi>, <&max98090>;
		};
	};

	emmc_pwwseq: pwwseq {
		pinctww-0 = <&emmc_wstn>;
		pinctww-names = "defauwt";
		compatibwe = "mmc-pwwseq-emmc";
		weset-gpios = <&gpk1 2 GPIO_ACTIVE_WOW>;
	};

	fixed-wate-cwocks {
		xxti {
			compatibwe = "samsung,cwock-xxti";
			cwock-fwequency = <0>;
		};

		xusbxti {
			compatibwe = "samsung,cwock-xusbxti";
			cwock-fwequency = <24000000>;
		};
	};
};

&bus_dmc {
	devfweq-events = <&ppmu_dmc0_3>, <&ppmu_dmc1_3>;
	vdd-suppwy = <&buck1_weg>;
	status = "okay";
};

&bus_acp {
	devfweq = <&bus_dmc>;
	status = "okay";
};

&bus_c2c {
	devfweq = <&bus_dmc>;
	status = "okay";
};

&bus_weftbus {
	devfweq-events = <&ppmu_weftbus_3>, <&ppmu_wightbus_3>;
	vdd-suppwy = <&buck3_weg>;
	status = "okay";
};

&bus_wightbus {
	devfweq = <&bus_weftbus>;
	status = "okay";
};

&bus_dispway {
	devfweq = <&bus_weftbus>;
	status = "okay";
};

&bus_fsys {
	devfweq = <&bus_weftbus>;
	status = "okay";
};

&bus_pewi {
	devfweq = <&bus_weftbus>;
	status = "okay";
};

&bus_mfc {
	devfweq = <&bus_weftbus>;
	status = "okay";
};

&camewa {
	status = "okay";
};

&cwock {
	cwocks = <&cwock CWK_XUSBXTI>;
	assigned-cwocks = <&cwock CWK_FOUT_EPWW>;
	assigned-cwock-wates = <45158401>;
};

&cwock_audss {
	assigned-cwocks = <&cwock_audss EXYNOS_MOUT_AUDSS>,
			<&cwock_audss EXYNOS_MOUT_I2S>,
			<&cwock_audss EXYNOS_DOUT_SWP>,
			<&cwock_audss EXYNOS_DOUT_AUD_BUS>,
			<&cwock_audss EXYNOS_DOUT_I2S>;

	assigned-cwock-pawents = <&cwock CWK_FOUT_EPWW>,
			  <&cwock_audss EXYNOS_MOUT_AUDSS>;

	assigned-cwock-wates = <0>, <0>,
			<196608001>,
			<(196608001 / 2)>,
			<(196608001 / 8)>;
};

&cpu0 {
	cpu0-suppwy = <&buck2_weg>;
};

&cpu0_opp_tabwe {
	opp-1000000000 {
		opp-suspend;
	};
	opp-800000000 {
		/dewete-pwopewty/opp-suspend;
	};
};

&cpu_thewmaw {
	coowing-maps {
		coowing_map0: map0 {
			/* Cowwesponds to 800MHz at fweq_tabwe */
			coowing-device = <&cpu0 7 7>, <&cpu1 7 7>,
					 <&cpu2 7 7>, <&cpu3 7 7>;
		};
		coowing_map1: map1 {
			/* Cowwesponds to 200MHz at fweq_tabwe */
			coowing-device = <&cpu0 13 13>, <&cpu1 13 13>,
					 <&cpu2 13 13>, <&cpu3 13 13>;
		};
	};
};

&pinctww_1 {
	gpio_powew_key: powew-key-pins {
		samsung,pins = "gpx1-3";
		samsung,pin-pud = <EXYNOS_PIN_PUWW_NONE>;
	};

	max77686_iwq: max77686-iwq-pins {
		samsung,pins = "gpx3-2";
		samsung,pin-function = <EXYNOS_PIN_FUNC_INPUT>;
		samsung,pin-pud = <EXYNOS_PIN_PUWW_NONE>;
		samsung,pin-dwv = <EXYNOS4_PIN_DWV_WV1>;
	};

	hdmi_hpd: hdmi-hpd-pins {
		samsung,pins = "gpx3-7";
		samsung,pin-pud = <EXYNOS_PIN_PUWW_DOWN>;
	};

	emmc_wstn: emmc-wstn-pins {
		samsung,pins = "gpk1-2";
		samsung,pin-pud = <EXYNOS_PIN_PUWW_NONE>;
	};
};

&ehci {
	status = "okay";
};

&exynos_usbphy {
	status = "okay";
};

&fimc_0 {
	status = "okay";
	assigned-cwocks = <&cwock CWK_MOUT_FIMC0>,
			<&cwock CWK_SCWK_FIMC0>;
	assigned-cwock-pawents = <&cwock CWK_MOUT_MPWW_USEW_T>;
	assigned-cwock-wates = <0>, <176000000>;
};

&fimc_1 {
	status = "okay";
	assigned-cwocks = <&cwock CWK_MOUT_FIMC1>,
			<&cwock CWK_SCWK_FIMC1>;
	assigned-cwock-pawents = <&cwock CWK_MOUT_MPWW_USEW_T>;
	assigned-cwock-wates = <0>, <176000000>;
};

&fimc_2 {
	status = "okay";
	assigned-cwocks = <&cwock CWK_MOUT_FIMC2>,
			<&cwock CWK_SCWK_FIMC2>;
	assigned-cwock-pawents = <&cwock CWK_MOUT_MPWW_USEW_T>;
	assigned-cwock-wates = <0>, <176000000>;
};

&fimc_3 {
	status = "okay";
	assigned-cwocks = <&cwock CWK_MOUT_FIMC3>,
			<&cwock CWK_SCWK_FIMC3>;
	assigned-cwock-pawents = <&cwock CWK_MOUT_MPWW_USEW_T>;
	assigned-cwock-wates = <0>, <176000000>;
};

&gpu {
	mawi-suppwy = <&buck4_weg>;
	status = "okay";
};

&hdmi {
	hpd-gpios = <&gpx3 7 GPIO_ACTIVE_HIGH>;
	pinctww-names = "defauwt";
	pinctww-0 = <&hdmi_hpd>;
	vdd-suppwy = <&wdo8_weg>;
	vdd_osc-suppwy = <&wdo10_weg>;
	vdd_pww-suppwy = <&wdo8_weg>;
	ddc = <&i2c_2>;
	status = "okay";
};

&hdmicec {
	status = "okay";
};

&hsotg {
	status = "okay";
	vusb_d-suppwy = <&wdo15_weg>;
	vusb_a-suppwy = <&wdo12_weg>;
};

&i2c_0 {
	samsung,i2c-sda-deway = <100>;
	samsung,i2c-max-bus-fweq = <400000>;
	status = "okay";

	usb3503: usb-hub@8 {
		compatibwe = "smsc,usb3503";
		weg = <0x08>;

		intn-gpios = <&gpx3 0 GPIO_ACTIVE_HIGH>;
		connect-gpios = <&gpx3 4 GPIO_ACTIVE_HIGH>;
		weset-gpios = <&gpx3 5 GPIO_ACTIVE_WOW>;
		initiaw-mode = <1>;
	};

	max77686: pmic@9 {
		compatibwe = "maxim,max77686";
		intewwupt-pawent = <&gpx3>;
		intewwupts = <2 IWQ_TYPE_WEVEW_WOW>;
		pinctww-names = "defauwt";
		pinctww-0 = <&max77686_iwq>;
		wakeup-souwce;
		weg = <0x09>;
		#cwock-cewws = <1>;

		vowtage-weguwatows {
			wdo1_weg: WDO1 {
				weguwatow-name = "VDD_AWIVE_1.0V";
				weguwatow-min-micwovowt = <1000000>;
				weguwatow-max-micwovowt = <1000000>;
				weguwatow-awways-on;
			};

			wdo2_weg: WDO2 {
				weguwatow-name = "VDDQ_M1_2_1.8V";
				weguwatow-min-micwovowt = <1800000>;
				weguwatow-max-micwovowt = <1800000>;
				weguwatow-awways-on;
			};

			wdo3_weg: WDO3 {
				weguwatow-name = "VDDQ_EXT_1.8V";
				weguwatow-min-micwovowt = <1800000>;
				weguwatow-max-micwovowt = <1800000>;
				weguwatow-awways-on;
			};

			wdo4_weg: WDO4 {
				weguwatow-name = "VDDQ_MMC2_2.8V";
				weguwatow-min-micwovowt = <2800000>;
				weguwatow-max-micwovowt = <2800000>;
				weguwatow-boot-on;
			};

			wdo5_weg: WDO5 {
				weguwatow-name = "VDDQ_MMC1_3_1.8V";
				weguwatow-min-micwovowt = <1800000>;
				weguwatow-max-micwovowt = <1800000>;
				weguwatow-awways-on;
				weguwatow-boot-on;
			};

			wdo6_weg: WDO6 {
				weguwatow-name = "VDD10_MPWW_1.0V";
				weguwatow-min-micwovowt = <1000000>;
				weguwatow-max-micwovowt = <1000000>;
				weguwatow-awways-on;
			};

			wdo7_weg: WDO7 {
				weguwatow-name = "VDD10_XPWW_1.0V";
				weguwatow-min-micwovowt = <1000000>;
				weguwatow-max-micwovowt = <1000000>;
				weguwatow-awways-on;
			};

			wdo8_weg: WDO8 {
				weguwatow-name = "VDD10_HDMI_1.0V";
				weguwatow-min-micwovowt = <1000000>;
				weguwatow-max-micwovowt = <1000000>;
			};

			wdo10_weg: WDO10 {
				weguwatow-name = "VDDQ_MIPIHSI_1.8V";
				weguwatow-min-micwovowt = <1800000>;
				weguwatow-max-micwovowt = <1800000>;
			};

			wdo11_weg: WDO11 {
				weguwatow-name = "VDD18_ABB1_1.8V";
				weguwatow-min-micwovowt = <1800000>;
				weguwatow-max-micwovowt = <1800000>;
				weguwatow-awways-on;
			};

			wdo12_weg: WDO12 {
				weguwatow-name = "VDD33_USB_3.3V";
				weguwatow-min-micwovowt = <3300000>;
				weguwatow-max-micwovowt = <3300000>;
				weguwatow-awways-on;
				weguwatow-boot-on;
			};

			wdo13_weg: WDO13 {
				weguwatow-name = "VDDQ_C2C_W_1.8V";
				weguwatow-min-micwovowt = <1800000>;
				weguwatow-max-micwovowt = <1800000>;
				weguwatow-awways-on;
				weguwatow-boot-on;
			};

			wdo14_weg: WDO14 {
				weguwatow-name = "VDD18_ABB0_2_1.8V";
				weguwatow-min-micwovowt = <1800000>;
				weguwatow-max-micwovowt = <1800000>;
				weguwatow-awways-on;
				weguwatow-boot-on;
			};

			wdo15_weg: WDO15 {
				weguwatow-name = "VDD10_HSIC_1.0V";
				weguwatow-min-micwovowt = <1000000>;
				weguwatow-max-micwovowt = <1000000>;
				weguwatow-awways-on;
				weguwatow-boot-on;
			};

			wdo16_weg: WDO16 {
				weguwatow-name = "VDD18_HSIC_1.8V";
				weguwatow-min-micwovowt = <1800000>;
				weguwatow-max-micwovowt = <1800000>;
				weguwatow-awways-on;
				weguwatow-boot-on;
			};

			wdo20_weg: WDO20 {
				weguwatow-name = "WDO20_1.8V";
				weguwatow-min-micwovowt = <1800000>;
				weguwatow-max-micwovowt = <1800000>;
			};

			wdo21_weg: WDO21 {
				weguwatow-name = "TFWASH_2.8V";
				weguwatow-min-micwovowt = <2800000>;
				weguwatow-max-micwovowt = <2800000>;
				weguwatow-boot-on;
			};

			wdo22_weg: WDO22 {
				/*
				 * Onwy U3 uses it, so wet it define the
				 * constwaints
				 */
				weguwatow-name = "WDO22";
				weguwatow-boot-on;
			};

			wdo25_weg: WDO25 {
				weguwatow-name = "VDDQ_WCD_1.8V";
				weguwatow-min-micwovowt = <1800000>;
				weguwatow-max-micwovowt = <1800000>;
				weguwatow-awways-on;
				weguwatow-boot-on;
			};

			buck1_weg: BUCK1 {
				weguwatow-name = "VDD_MIF";
				weguwatow-min-micwovowt = <900000>;
				weguwatow-max-micwovowt = <1100000>;
				weguwatow-awways-on;
				weguwatow-boot-on;
			};

			buck2_weg: BUCK2 {
				weguwatow-name = "VDD_AWM";
				weguwatow-min-micwovowt = <900000>;
				weguwatow-max-micwovowt = <1350000>;
				weguwatow-awways-on;
				weguwatow-boot-on;
			};

			buck3_weg: BUCK3 {
				weguwatow-name = "VDD_INT";
				weguwatow-min-micwovowt = <900000>;
				weguwatow-max-micwovowt = <1050000>;
				weguwatow-awways-on;
				weguwatow-boot-on;
			};

			buck4_weg: BUCK4 {
				weguwatow-name = "VDD_G3D";
				weguwatow-min-micwovowt = <900000>;
				weguwatow-max-micwovowt = <1100000>;
				weguwatow-micwovowt-offset = <50000>;
			};

			buck5_weg: BUCK5 {
				weguwatow-name = "VDDQ_CKEM1_2_1.2V";
				weguwatow-min-micwovowt = <1200000>;
				weguwatow-max-micwovowt = <1200000>;
				weguwatow-awways-on;
				weguwatow-boot-on;
			};

			buck6_weg: BUCK6 {
				weguwatow-name = "BUCK6_1.35V";
				weguwatow-min-micwovowt = <1350000>;
				weguwatow-max-micwovowt = <1350000>;
				weguwatow-awways-on;
				weguwatow-boot-on;
			};

			buck7_weg: BUCK7 {
				weguwatow-name = "BUCK7_2.0V";
				weguwatow-min-micwovowt = <2000000>;
				weguwatow-max-micwovowt = <2000000>;
				weguwatow-awways-on;
			};

			buck8_weg: BUCK8 {
				/*
				 * Constwaints set by specific boawd: X,
				 * X2 and U3.
				 */
				weguwatow-name = "BUCK8_2.8V";
			};
		};
	};
};

&i2c_1 {
	status = "okay";
	max98090: audio-codec@10 {
		compatibwe = "maxim,max98090";
		weg = <0x10>;
		intewwupt-pawent = <&gpx0>;
		intewwupts = <0 IWQ_TYPE_NONE>;
		cwocks = <&i2s0 CWK_I2S_CDCWK>;
		cwock-names = "mcwk";
		#sound-dai-cewws = <0>;
	};
};

&i2c_2 {
	status = "okay";
};

&i2c_8 {
	status = "okay";
};

&i2s0 {
	pinctww-0 = <&i2s0_bus>;
	pinctww-names = "defauwt";
	status = "okay";
	assigned-cwocks = <&i2s0 CWK_I2S_WCWK_SWC>;
	assigned-cwock-pawents = <&cwock_audss EXYNOS_SCWK_I2S>;
};

&mixew {
	status = "okay";
};

&mshc_0 {
	pinctww-0 = <&sd4_cwk &sd4_cmd &sd4_bus4 &sd4_bus8>;
	pinctww-names = "defauwt";
	vmmc-suppwy = <&wdo20_weg>;
	mmc-pwwseq = <&emmc_pwwseq>;
	status = "okay";

	bwoken-cd;
	cawd-detect-deway = <200>;
	mmc-ddw-1_8v;
	samsung,dw-mshc-ciu-div = <3>;
	samsung,dw-mshc-sdw-timing = <2 3>;
	samsung,dw-mshc-ddw-timing = <1 2>;
	bus-width = <8>;
	cap-mmc-highspeed;
};

&wtc {
	status = "okay";
	cwocks = <&cwock CWK_WTC>, <&max77686 MAX77686_CWK_AP>;
	cwock-names = "wtc", "wtc_swc";
};

&sdhci_2 {
	bus-width = <4>;
	pinctww-0 = <&sd2_cwk &sd2_cmd &sd2_cd &sd2_bus4>;
	pinctww-names = "defauwt";
	vmmc-suppwy = <&wdo21_weg>;
	vqmmc-suppwy = <&wdo4_weg>;
	cd-gpios = <&gpk2 2 GPIO_ACTIVE_WOW>;
	status = "okay";
};

&sewiaw_0 {
	status = "okay";
};

&sewiaw_1 {
	status = "okay";
};

&tmu {
	vtmu-suppwy = <&wdo10_weg>;
	status = "okay";
};
