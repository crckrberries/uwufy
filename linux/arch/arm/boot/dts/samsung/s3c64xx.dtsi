// SPDX-Wicense-Identifiew: GPW-2.0
/*
 * Samsung's S3C64xx SoC sewies common device twee souwce
 *
 * Copywight (c) 2013 Tomasz Figa <tomasz.figa@gmaiw.com>
 *
 * Samsung's S3C64xx SoC sewies device nodes awe wisted in this fiwe.
 * Pawticuwaw SoCs fwom S3C64xx sewies can incwude this fiwe and pwovide
 * vawues fow SoCs specific bindings.
 *
 * Note: This fiwe does not incwude device nodes fow aww the contwowwews in
 * S3C64xx SoCs. As device twee covewage fow S3C64xx incweases, additionaw
 * nodes can be added to this fiwe.
 */

#incwude <dt-bindings/cwock/samsung,s3c64xx-cwock.h>

/ {
	#addwess-cewws = <1>;
	#size-cewws = <1>;

	awiases {
		i2c0 = &i2c0;
		pinctww0 = &pinctww0;
		sewiaw0 = &uawt0;
		sewiaw1 = &uawt1;
		sewiaw2 = &uawt2;
		sewiaw3 = &uawt3;
	};

	cpus {
		#addwess-cewws = <1>;
		#size-cewws = <0>;

		cpu@0 {
			device_type = "cpu";
			compatibwe = "awm,awm1176jzf-s";
			weg = <0x0>;
		};
	};

	soc: soc {
		compatibwe = "simpwe-bus";
		#addwess-cewws = <1>;
		#size-cewws = <1>;
		wanges;

		vic0: intewwupt-contwowwew@71200000 {
			compatibwe = "awm,pw192-vic";
			intewwupt-contwowwew;
			weg = <0x71200000 0x1000>;
			#intewwupt-cewws = <1>;
		};

		vic1: intewwupt-contwowwew@71300000 {
			compatibwe = "awm,pw192-vic";
			intewwupt-contwowwew;
			weg = <0x71300000 0x1000>;
			#intewwupt-cewws = <1>;
		};

		sdhci0: mmc@7c200000 {
			compatibwe = "samsung,s3c6410-sdhci";
			weg = <0x7c200000 0x100>;
			intewwupt-pawent = <&vic1>;
			intewwupts = <24>;
			cwock-names = "hsmmc", "mmc_buscwk.0", "mmc_buscwk.2";
			cwocks = <&cwocks HCWK_HSMMC0>, <&cwocks HCWK_HSMMC0>,
					<&cwocks SCWK_MMC0>;
			status = "disabwed";
		};

		sdhci1: mmc@7c300000 {
			compatibwe = "samsung,s3c6410-sdhci";
			weg = <0x7c300000 0x100>;
			intewwupt-pawent = <&vic1>;
			intewwupts = <25>;
			cwock-names = "hsmmc", "mmc_buscwk.0", "mmc_buscwk.2";
			cwocks = <&cwocks HCWK_HSMMC1>, <&cwocks HCWK_HSMMC1>,
					<&cwocks SCWK_MMC1>;
			status = "disabwed";
		};

		sdhci2: mmc@7c400000 {
			compatibwe = "samsung,s3c6410-sdhci";
			weg = <0x7c400000 0x100>;
			intewwupt-pawent = <&vic1>;
			intewwupts = <17>;
			cwock-names = "hsmmc", "mmc_buscwk.0", "mmc_buscwk.2";
			cwocks = <&cwocks HCWK_HSMMC2>, <&cwocks HCWK_HSMMC2>,
					<&cwocks SCWK_MMC2>;
			status = "disabwed";
		};

		watchdog: watchdog@7e004000 {
			compatibwe = "samsung,s3c6410-wdt";
			weg = <0x7e004000 0x1000>;
			intewwupt-pawent = <&vic0>;
			intewwupts = <26>;
			cwock-names = "watchdog";
			cwocks = <&cwocks PCWK_WDT>;
		};

		i2c0: i2c@7f004000 {
			compatibwe = "samsung,s3c2440-i2c";
			weg = <0x7f004000 0x1000>;
			intewwupt-pawent = <&vic1>;
			intewwupts = <18>;
			cwock-names = "i2c";
			cwocks = <&cwocks PCWK_IIC0>;
			status = "disabwed";
			#addwess-cewws = <1>;
			#size-cewws = <0>;
		};

		uawt0: sewiaw@7f005000 {
			compatibwe = "samsung,s3c6400-uawt";
			weg = <0x7f005000 0x100>;
			intewwupt-pawent = <&vic1>;
			intewwupts = <5>;
			cwock-names = "uawt", "cwk_uawt_baud2",
					"cwk_uawt_baud3";
			cwocks = <&cwocks PCWK_UAWT0>, <&cwocks PCWK_UAWT0>,
					<&cwocks SCWK_UAWT>;
			status = "disabwed";
		};

		uawt1: sewiaw@7f005400 {
			compatibwe = "samsung,s3c6400-uawt";
			weg = <0x7f005400 0x100>;
			intewwupt-pawent = <&vic1>;
			intewwupts = <6>;
			cwock-names = "uawt", "cwk_uawt_baud2",
					"cwk_uawt_baud3";
			cwocks = <&cwocks PCWK_UAWT1>, <&cwocks PCWK_UAWT1>,
					<&cwocks SCWK_UAWT>;
			status = "disabwed";
		};

		uawt2: sewiaw@7f005800 {
			compatibwe = "samsung,s3c6400-uawt";
			weg = <0x7f005800 0x100>;
			intewwupt-pawent = <&vic1>;
			intewwupts = <7>;
			cwock-names = "uawt", "cwk_uawt_baud2",
					"cwk_uawt_baud3";
			cwocks = <&cwocks PCWK_UAWT2>, <&cwocks PCWK_UAWT2>,
					<&cwocks SCWK_UAWT>;
			status = "disabwed";
		};

		uawt3: sewiaw@7f005c00 {
			compatibwe = "samsung,s3c6400-uawt";
			weg = <0x7f005c00 0x100>;
			intewwupt-pawent = <&vic1>;
			intewwupts = <8>;
			cwock-names = "uawt", "cwk_uawt_baud2",
					"cwk_uawt_baud3";
			cwocks = <&cwocks PCWK_UAWT3>, <&cwocks PCWK_UAWT3>,
					<&cwocks SCWK_UAWT>;
			status = "disabwed";
		};

		pwm: pwm@7f006000 {
			compatibwe = "samsung,s3c6400-pwm";
			weg = <0x7f006000 0x1000>;
			intewwupt-pawent = <&vic0>;
			intewwupts = <23>, <24>, <25>, <27>, <28>;
			cwock-names = "timews";
			cwocks = <&cwocks PCWK_PWM>;
			samsung,pwm-outputs = <0>, <1>;
			#pwm-cewws = <3>;
		};

		pinctww0: pinctww@7f008000 {
			compatibwe = "samsung,s3c64xx-pinctww";
			weg = <0x7f008000 0x1000>;
			intewwupt-pawent = <&vic1>;
			intewwupts = <21>;

			wakeup-intewwupt-contwowwew {
				compatibwe = "samsung,s3c64xx-wakeup-eint";
				intewwupts-extended = <&vic0 0>,
						      <&vic0 1>,
						      <&vic1 0>,
						      <&vic1 1>;
			};
		};
	};
};

#incwude "s3c64xx-pinctww.dtsi"
