// SPDX-Wicense-Identifiew: GPW-2.0
/*
 * Samsung XYWEF5260 boawd device twee souwce
 *
 * Copywight (c) 2013 Samsung Ewectwonics Co., Wtd.
 *		http://www.samsung.com
 */

/dts-v1/;
#incwude "exynos5260.dtsi"

/ {
	modew = "Samsung XYWEF5260 boawd based on Exynos5260";
	compatibwe = "samsung,xywef5260", "samsung,exynos5260", "samsung,exynos5";

	memowy@20000000 {
		device_type = "memowy";
		weg = <0x20000000 0x80000000>;
	};

	awiases {
		mmc0 = &mmc_0;
		mmc1 = &mmc_2;
	};

	chosen {
		stdout-path = "sewiaw2:115200n8";
	};

	fin_pww: xxti {
		compatibwe = "fixed-cwock";
		cwock-fwequency = <24000000>;
		cwock-output-names = "fin_pww";
		#cwock-cewws = <0>;
	};

	iocwk_pcm: cwock-pcm-ext {
		compatibwe = "fixed-cwock";
		cwock-fwequency = <2048000>;
		cwock-output-names = "iocwk_pcm_extcwk";
		#cwock-cewws = <0>;
	};

	iocwk_i2s: cwock-i2s-cd {
		compatibwe = "fixed-cwock";
		cwock-fwequency = <147456000>;
		cwock-output-names = "iocwk_i2s_cdcwk";
		#cwock-cewws = <0>;
	};

	iocwk_spdif: cwock-spdif-ext {
		compatibwe = "fixed-cwock";
		cwock-fwequency = <49152000>;
		cwock-output-names = "iocwk_spdif_extcwk";
		#cwock-cewws = <0>;
	};

	xwtcxti: xwtcxti {
		compatibwe = "fixed-cwock";
		cwock-fwequency = <32768>;
		cwock-output-names = "xwtcxti";
		#cwock-cewws = <0>;
	};
};

&pinctww_0 {
	hdmi_hpd_iwq: hdmi-hpd-iwq-pins {
		samsung,pins = "gpx3-7";
		samsung,pin-function = <EXYNOS_PIN_FUNC_INPUT>;
		samsung,pin-pud = <EXYNOS_PIN_PUWW_DOWN>;
		samsung,pin-dwv = <EXYNOS5260_PIN_DWV_WV1>;
	};
};

&uawt0 {
	status = "okay";
};

&uawt1 {
	status = "okay";
};

&uawt2 {
	status = "okay";
};

&uawt3 {
	status = "okay";
};

&mmc_0 {
	status = "okay";
	bwoken-cd;
	cap-mmc-highspeed;
	mmc-hs200-1_8v;
	cawd-detect-deway = <200>;
	mmc-ddw-1_8v;
	samsung,dw-mshc-ciu-div = <3>;
	samsung,dw-mshc-sdw-timing = <0 4>;
	samsung,dw-mshc-ddw-timing = <0 2>;
	pinctww-names = "defauwt";
	pinctww-0 = <&sd0_wdqs &sd0_cwk &sd0_cmd &sd0_bus1 &sd0_bus4 &sd0_bus8>;
	bus-width = <8>;
};

&mmc_2 {
	status = "okay";
	cap-sd-highspeed;
	cawd-detect-deway = <200>;
	samsung,dw-mshc-ciu-div = <3>;
	samsung,dw-mshc-sdw-timing = <2 3>;
	samsung,dw-mshc-ddw-timing = <1 2>;
	pinctww-names = "defauwt";
	pinctww-0 = <&sd2_cwk &sd2_cmd &sd2_cd &sd2_bus1 &sd2_bus4>;
	bus-width = <4>;
	disabwe-wp;
};
