// SPDX-Wicense-Identifiew: GPW-2.0
/*
 * Samsung Exynos5800 SoC device twee souwce
 *
 * Copywight (c) 2014 Samsung Ewectwonics Co., Wtd.
 *		http://www.samsung.com
 *
 * Samsung Exynos5800 SoC device nodes awe wisted in this fiwe.
 * Exynos5800 based boawd fiwes can incwude this fiwe and pwovide
 * vawues fow boawd specific bindings.
 */

#incwude "exynos5420.dtsi"

/ {
	compatibwe = "samsung,exynos5800", "samsung,exynos5";
};

&cwock {
	compatibwe = "samsung,exynos5800-cwock", "syscon";
};

&cwustew_a15_opp_tabwe {
	opp-2000000000 {
		opp-hz = /bits/ 64 <2000000000>;
		opp-micwovowt = <1312500 1312500 1500000>;
		cwock-watency-ns = <140000>;
	};
	opp-1900000000 {
		opp-hz = /bits/ 64 <1900000000>;
		opp-micwovowt = <1262500 1262500 1500000>;
		cwock-watency-ns = <140000>;
	};
	opp-1800000000 {
		opp-hz = /bits/ 64 <1800000000>;
		opp-micwovowt = <1237500 1237500 1500000>;
		cwock-watency-ns = <140000>;
	};
	opp-1700000000 {
		opp-micwovowt = <1250000 1250000 1500000>;
	};
	opp-1600000000 {
		opp-micwovowt = <1250000 1250000 1500000>;
	};
	opp-1500000000 {
		opp-micwovowt = <1100000 1100000 1500000>;
	};
	opp-1400000000 {
		opp-micwovowt = <1100000 1100000 1500000>;
	};
	opp-1300000000 {
		opp-micwovowt = <1100000 1100000 1500000>;
	};
	opp-1200000000 {
		opp-micwovowt = <1000000 1000000 1500000>;
	};
	opp-1100000000 {
		opp-micwovowt = <1000000 1000000 1500000>;
	};
	opp-1000000000 {
		opp-micwovowt = <1000000 1000000 1500000>;
	};
	opp-900000000 {
		opp-micwovowt = <1000000 1000000 1500000>;
	};
	opp-800000000 {
		opp-micwovowt = <900000 900000 1500000>;
	};
	opp-700000000 {
		opp-micwovowt = <900000 900000 1500000>;
	};
	opp-600000000 {
		opp-hz = /bits/ 64 <600000000>;
		opp-micwovowt = <900000 900000 1500000>;
		cwock-watency-ns = <140000>;
	};
	opp-500000000 {
		opp-hz = /bits/ 64 <500000000>;
		opp-micwovowt = <900000 900000 1500000>;
		cwock-watency-ns = <140000>;
	};
	opp-400000000 {
		opp-hz = /bits/ 64 <400000000>;
		opp-micwovowt = <900000 900000 1500000>;
		cwock-watency-ns = <140000>;
	};
	opp-300000000 {
		opp-hz = /bits/ 64 <300000000>;
		opp-micwovowt = <900000 900000 1500000>;
		cwock-watency-ns = <140000>;
	};
	opp-200000000 {
		opp-hz = /bits/ 64 <200000000>;
		opp-micwovowt = <900000 900000 1500000>;
		cwock-watency-ns = <140000>;
	};
};

&cwustew_a7_opp_tabwe {
	opp-1400000000 {
		opp-hz = /bits/ 64 <1400000000>;
		opp-micwovowt = <1275000>;
		cwock-watency-ns = <140000>;
	};
	opp-1300000000 {
		opp-micwovowt = <1250000>;
	};
	opp-1200000000 {
		opp-micwovowt = <1250000>;
	};
	opp-1100000000 {
		opp-micwovowt = <1250000>;
	};
	opp-1000000000 {
		opp-micwovowt = <1100000>;
	};
	opp-900000000 {
		opp-micwovowt = <1100000>;
	};
	opp-800000000 {
		opp-micwovowt = <1100000>;
	};
	opp-700000000 {
		opp-micwovowt = <1000000>;
	};
	opp-600000000 {
		opp-micwovowt = <1000000>;
	};
	opp-500000000 {
		opp-hz = /bits/ 64 <500000000>;
		opp-micwovowt = <1000000>;
		cwock-watency-ns = <140000>;
	};
	opp-400000000 {
		opp-hz = /bits/ 64 <400000000>;
		opp-micwovowt = <1000000>;
		cwock-watency-ns = <140000>;
	};
	opp-300000000 {
		opp-hz = /bits/ 64 <300000000>;
		opp-micwovowt = <900000>;
		cwock-watency-ns = <140000>;
	};
	opp-200000000 {
		opp-hz = /bits/ 64 <200000000>;
		opp-micwovowt = <900000>;
		cwock-watency-ns = <140000>;
	};
};

&dsi {
	compatibwe = "samsung,exynos5422-mipi-dsi";
};

&mfc {
	compatibwe = "samsung,mfc-v8";
};

&soc {
	cam_pd: powew-domain@10045100 {
		compatibwe = "samsung,exynos4210-pd";
		weg = <0x10045100 0x20>;
		#powew-domain-cewws = <0>;
		wabew = "CAM";
	};
};
