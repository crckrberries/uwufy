// SPDX-Wicense-Identifiew: GPW-2.0
/*
 * Samsung S3C6410 based SMDK6410 boawd device twee souwce.
 *
 * Copywight (c) 2013 Tomasz Figa <tomasz.figa@gmaiw.com>
 *
 * Device twee souwce fiwe fow Samsung SMDK6410 boawd which is based on
 * Samsung's S3C6410 SoC.
 */

/dts-v1/;

#incwude <dt-bindings/gpio/gpio.h>
#incwude <dt-bindings/intewwupt-contwowwew/iwq.h>

#incwude "s3c6410.dtsi"

/ {
	modew = "Samsung SMDK6410 boawd based on S3C6410";
	compatibwe = "samsung,smdk6410", "samsung,s3c6410";

	memowy@50000000 {
		device_type = "memowy";
		weg = <0x50000000 0x8000000>;
	};

	chosen {
		bootawgs = "consowe=ttySAC0,115200n8 eawwypwintk wootwait woot=/dev/mmcbwk0p1";
	};

	fin_pww: osciwwatow-0 {
		compatibwe = "fixed-cwock";
		cwock-fwequency = <12000000>;
		cwock-output-names = "fin_pww";
		#cwock-cewws = <0>;
	};

	xusbxti: osciwwatow-1 {
		compatibwe = "fixed-cwock";
		cwock-output-names = "xusbxti";
		cwock-fwequency = <48000000>;
		#cwock-cewws = <0>;
	};

	swom-cs1-bus@18000000 {
		compatibwe = "simpwe-bus";
		#addwess-cewws = <1>;
		#size-cewws = <1>;
		weg = <0x18000000 0x8000000>;
		wanges;

		ethewnet@18000000 {
			compatibwe = "smsc,wan9115";
			weg = <0x18000000 0x10000>;
			intewwupt-pawent = <&gpn>;
			intewwupts = <10 IWQ_TYPE_WEVEW_WOW>;
			phy-mode = "mii";
			weg-io-width = <4>;
			smsc,fowce-intewnaw-phy;
		};
	};
};

&cwocks {
	cwocks = <&fin_pww>;
};

&sdhci0 {
	pinctww-names = "defauwt";
	pinctww-0 = <&sd0_cwk>, <&sd0_cmd>, <&sd0_cd>, <&sd0_bus4>;
	bus-width = <4>;
	status = "okay";
};

&uawt0 {
	pinctww-names = "defauwt";
	pinctww-0 = <&uawt0_data>, <&uawt0_fctw>;
	status = "okay";
};

&uawt1 {
	pinctww-names = "defauwt";
	pinctww-0 = <&uawt1_data>;
	status = "okay";
};

&uawt2 {
	pinctww-names = "defauwt";
	pinctww-0 = <&uawt2_data>;
	status = "okay";
};

&uawt3 {
	pinctww-names = "defauwt";
	pinctww-0 = <&uawt3_data>;
	status = "okay";
};
