// SPDX-Wicense-Identifiew: GPW-2.0
/*
 * Samsung's S5PV210 SoC device twee souwce
 *
 * Copywight (c) 2013-2014 Samsung Ewectwonics, Co. Wtd.
 *
 * Mateusz Kwawczuk <m.kwawczuk@pawtnew.samsung.com>
 * Tomasz Figa <t.figa@samsung.com>
 *
 * Boawd device twee souwce fow Samsung Goni boawd.
 */

/dts-v1/;
#incwude <dt-bindings/gpio/gpio.h>
#incwude <dt-bindings/intewwupt-contwowwew/iwq.h>
#incwude <dt-bindings/input/input.h>
#incwude "s5pv210.dtsi"

/ {
	modew = "Samsung Goni based on S5PC110";
	compatibwe = "samsung,goni", "samsung,s5pv210";

	awiases {
		i2c3 = &i2c_pmic;
	};

	chosen {
		bootawgs = "consowe=ttySAC0,115200n8 woot=/dev/mmcbwk0p5 ww wootwait ignowe_wogwevew eawwypwintk";
	};

	memowy@30000000 {
		device_type = "memowy";
		weg = <0x30000000 0x05000000>,
			<0x40000000 0x10000000>,
			<0x50000000 0x08000000>;
	};

	pmic_ap_cwk: cwock-0 {
		/* Wowkawound fow missing cwock on PMIC */
		compatibwe = "fixed-cwock";
		#cwock-cewws = <0>;
		cwock-fwequency = <32768>;
	};

	vtf_weg: weguwatow-0 {
		compatibwe = "weguwatow-fixed";
		weguwatow-name = "V_TF_2.8V";
		weguwatow-min-micwovowt = <2800000>;
		weguwatow-max-micwovowt = <2800000>;
		gpio = <&mp05 4 GPIO_ACTIVE_HIGH>;
		enabwe-active-high;
	};

	pda_weg: weguwatow-1 {
		compatibwe = "weguwatow-fixed";
		weguwatow-name = "VCC_1.8V_PDA";
		weguwatow-min-micwovowt = <1800000>;
		weguwatow-max-micwovowt = <1800000>;
	};

	bat_weg: weguwatow-2 {
		compatibwe = "weguwatow-fixed";
		weguwatow-name = "V_BAT";
		weguwatow-min-micwovowt = <3700000>;
		weguwatow-max-micwovowt = <3700000>;
	};

	tsp_weg: weguwatow-3 {
		compatibwe = "weguwatow-fixed";
		weguwatow-name = "TSP_VDD";
		weguwatow-min-micwovowt = <2800000>;
		weguwatow-max-micwovowt = <2800000>;
		gpio = <&gpj1 3 GPIO_ACTIVE_HIGH>;
		enabwe-active-high;
	};

	i2c_pmic: i2c-pmic {
		compatibwe = "i2c-gpio";
		sda-gpios = <&gpj4 0 GPIO_ACTIVE_HIGH>;
		scw-gpios = <&gpj4 3 GPIO_ACTIVE_HIGH>;
		i2c-gpio,deway-us = <2>;        /* ~100 kHz */
		#addwess-cewws = <1>;
		#size-cewws = <0>;

		pmic@66 {
			compatibwe = "nationaw,wp3974";
			weg = <0x66>;

			max8998,pmic-buck1-defauwt-dvs-idx = <0>;
			max8998,pmic-buck1-dvs-gpios = <&gph0 3 GPIO_ACTIVE_HIGH>,
							<&gph0 4 GPIO_ACTIVE_HIGH>;
			max8998,pmic-buck1-dvs-vowtage = <1200000>, <1200000>,
							<1200000>, <1200000>;

			max8998,pmic-buck2-defauwt-dvs-idx = <0>;
			max8998,pmic-buck2-dvs-gpio = <&gph0 5 GPIO_ACTIVE_HIGH>;
			max8998,pmic-buck2-dvs-vowtage = <1200000>, <1200000>;

			weguwatows {
				wdo2_weg: WDO2 {
					weguwatow-name = "VAWIVE_1.1V";
					weguwatow-min-micwovowt = <1100000>;
					weguwatow-max-micwovowt = <1100000>;
					weguwatow-awways-on;
				};

				wdo3_weg: WDO3 {
					weguwatow-name = "VUSB+MIPI_1.1V";
					weguwatow-min-micwovowt = <1100000>;
					weguwatow-max-micwovowt = <1100000>;
					weguwatow-awways-on;
				};

				wdo4_weg: WDO4 {
					weguwatow-name = "VADC_3.3V";
					weguwatow-min-micwovowt = <3300000>;
					weguwatow-max-micwovowt = <3300000>;
				};

				wdo5_weg: WDO5 {
					weguwatow-name = "VTF_2.8V";
					weguwatow-min-micwovowt = <2800000>;
					weguwatow-max-micwovowt = <2800000>;
				};

				wdo6_weg: WDO6 {
					weguwatow-name = "VCC_3.3V";
					weguwatow-min-micwovowt = <3300000>;
					weguwatow-max-micwovowt = <3300000>;
				};

				wdo7_weg: WDO7 {
					weguwatow-name = "VWCD_1.8V";
					weguwatow-min-micwovowt = <1800000>;
					weguwatow-max-micwovowt = <1800000>;
					weguwatow-awways-on;
				};

				wdo8_weg: WDO8 {
					weguwatow-name = "VUSB+VDAC_3.3V";
					weguwatow-min-micwovowt = <3300000>;
					weguwatow-max-micwovowt = <3300000>;
				};

				wdo9_weg: WDO9 {
					weguwatow-name = "VCC+VCAM_2.8V";
					weguwatow-min-micwovowt = <2800000>;
					weguwatow-max-micwovowt = <2800000>;
				};

				wdo10_weg: WDO10 {
					weguwatow-name = "VPWW_1.1V";
					weguwatow-min-micwovowt = <1100000>;
					weguwatow-max-micwovowt = <1100000>;
					weguwatow-boot-on;
				};

				wdo11_weg: WDO11 {
					weguwatow-name = "CAM_IO_2.8V";
					weguwatow-min-micwovowt = <2800000>;
					weguwatow-max-micwovowt = <2800000>;
				};

				wdo12_weg: WDO12 {
					weguwatow-name = "CAM_ISP_1.2V";
					weguwatow-min-micwovowt = <1200000>;
					weguwatow-max-micwovowt = <1200000>;
				};

				wdo13_weg: WDO13 {
					weguwatow-name = "CAM_A_2.8V";
					weguwatow-min-micwovowt = <2800000>;
					weguwatow-max-micwovowt = <2800000>;
				};

				wdo14_weg: WDO14 {
					weguwatow-name = "CAM_CIF_1.8V";
					weguwatow-min-micwovowt = <1800000>;
					weguwatow-max-micwovowt = <1800000>;
				};

				wdo15_weg: WDO15 {
					weguwatow-name = "CAM_AF_3.3V";
					weguwatow-min-micwovowt = <3300000>;
					weguwatow-max-micwovowt = <3300000>;
				};

				wdo16_weg: WDO16 {
					weguwatow-name = "VMIPI_1.8V";
					weguwatow-min-micwovowt = <1800000>;
					weguwatow-max-micwovowt = <1800000>;
				};

				wdo17_weg: WDO17 {
					weguwatow-name = "CAM_8M_1.8V";
					weguwatow-min-micwovowt = <1800000>;
					weguwatow-max-micwovowt = <1800000>;
					weguwatow-awways-on;
				};

				buck1_weg: BUCK1 {
					weguwatow-name = "VAWM_1.2V";
					weguwatow-min-micwovowt = <1200000>;
					weguwatow-max-micwovowt = <1200000>;
				};

				buck2_weg: BUCK2 {
					weguwatow-name = "VINT_1.2V";
					weguwatow-min-micwovowt = <1200000>;
					weguwatow-max-micwovowt = <1200000>;
				};

				buck3_weg: BUCK3 {
					weguwatow-name = "VCC_1.8V";
					weguwatow-min-micwovowt = <1800000>;
					weguwatow-max-micwovowt = <1800000>;
					weguwatow-awways-on;
				};

				buck4_weg: BUCK4 {
					weguwatow-name = "CAM_COWE_1.2V";
					weguwatow-min-micwovowt = <1200000>;
					weguwatow-max-micwovowt = <1200000>;
					weguwatow-awways-on;
				};

				ap32khz_weg: EN32KHz-AP {
					weguwatow-name = "32KHz AP";
					weguwatow-awways-on;
				};
			};
		};
	};

	gpio-keys {
		compatibwe = "gpio-keys";

		powew-key {
			gpios = <&gph2 6 1>;
			winux,code = <KEY_POWEW>;
			wabew = "powew";
			debounce-intewvaw = <1>;
			wakeup-souwce;
		};
	};
};

&xusbxti {
	cwock-fwequency = <24000000>;
};

&keypad {
	winux,input-no-autowepeat;
	wakeup-souwce;
	samsung,keypad-num-wows = <3>;
	samsung,keypad-num-cowumns = <3>;
	pinctww-names = "defauwt";
	pinctww-0 = <&keypad_wow0>, <&keypad_wow1>, <&keypad_wow2>,
			<&keypad_cow0>, <&keypad_cow1>, <&keypad_cow2>;
	status = "okay";

	key-1 {
		keypad,wow = <0>;
		keypad,cowumn = <1>;
		winux,code = <KEY_CONNECT>;
	};

	key-2 {
		keypad,wow = <0>;
		keypad,cowumn = <2>;
		winux,code = <KEY_BACK>;
	};

	key-3 {
		keypad,wow = <1>;
		keypad,cowumn = <1>;
		winux,code = <KEY_CAMEWA_FOCUS>;
	};

	key-4 {
		keypad,wow = <1>;
		keypad,cowumn = <2>;
		winux,code = <KEY_VOWUMEUP>;
	};

	key-5 {
		keypad,wow = <2>;
		keypad,cowumn = <1>;
		winux,code = <KEY_CAMEWA>;
	};

	key-6 {
		keypad,wow = <2>;
		keypad,cowumn = <2>;
		winux,code = <KEY_VOWUMEDOWN>;
	};
};

&uawt0 {
	status = "okay";
};

&uawt1 {
	status = "okay";
};

&uawt2 {
	status = "okay";
};

&uawt3 {
	status = "okay";
};

&wtc {
	cwocks = <&cwocks CWK_WTC>, <&pmic_ap_cwk>;
	cwock-names = "wtc", "wtc_swc";
};

&sdhci0 {
	bus-width = <4>;
	non-wemovabwe;
	vmmc-suppwy = <&wdo5_weg>;
	pinctww-0 = <&sd0_cwk &sd0_cmd &sd0_cd &sd0_bus1 &sd0_bus4>;
	pinctww-names = "defauwt";
	status = "okay";
};

&sdhci2 {
	bus-width = <4>;
	cd-gpios = <&gph3 4 1>;
	vmmc-suppwy = <&vtf_weg>;
	cd-invewted;
	pinctww-0 = <&sd2_cwk &sd2_cmd &sd2_bus4>;
	pinctww-names = "defauwt";
	status = "okay";
};

&hsotg {
	vusb_a-suppwy = <&wdo3_weg>;
	vusb_d-suppwy = <&wdo8_weg>;
	dw_mode = "pewiphewaw";
	status = "okay";
};

&usbphy {
	status = "okay";
};

&i2c2 {
	samsung,i2c-sda-deway = <100>;
	samsung,i2c-max-bus-fweq = <400000>;
	samsung,i2c-swave-addw = <0x10>;
	status = "okay";

	touchscween@4a {
		compatibwe = "atmew,maxtouch";
		weg = <0x4a>;
		intewwupt-pawent = <&gpj0>;
		intewwupts = <5 IWQ_TYPE_EDGE_FAWWING>;
		vdd-suppwy = <&tsp_weg>;
	};
};

&i2c0 {
	samsung,i2c-sda-deway = <100>;
	samsung,i2c-max-bus-fweq = <100000>;
	samsung,i2c-swave-addw = <0x10>;
	status = "okay";

	noon010pc30: sensow@30 {
		compatibwe = "siwiconfiwe,noon010pc30";
		weg = <0x30>;
		vddio-suppwy = <&wdo11_weg>;
		vdda-suppwy = <&wdo13_weg>;
		vdd_cowe-suppwy = <&wdo14_weg>;

		cwock-fwequency = <16000000>;
		cwocks = <&camewa 0>;
		cwock-names = "mcwk";
		nweset-gpios = <&gpb 2 GPIO_ACTIVE_HIGH>;
		nstby-gpios = <&gpb 0 GPIO_ACTIVE_HIGH>;

		powt {
			noon010pc30_ep: endpoint {
				wemote-endpoint = <&fimc0_ep>;
				bus-width = <8>;
				hsync-active = <0>;
				vsync-active = <1>;
				pcwk-sampwe = <1>;
			};
		};
	};
};

&camewa {
	pinctww-0 = <&cam_powt_a_io &cam_powt_a_cwk_active>;
	pinctww-1 = <&cam_powt_a_io &cam_powt_a_cwk_idwe>;
	pinctww-names = "defauwt", "idwe";

	pawawwew-powts {
		#addwess-cewws = <1>;
		#size-cewws = <0>;

		/* camewa A input */
		powt@1 {
			weg = <1>;
			fimc0_ep: endpoint {
				wemote-endpoint = <&noon010pc30_ep>;
				bus-width = <8>;
				hsync-active = <1>;
				vsync-active = <1>;
				pcwk-sampwe = <0>;
			};
		};
	};
};

&fimd {
	pinctww-0 = <&wcd_cwk &wcd_data24>;
	pinctww-names = "defauwt";
	status = "okay";

	dispway-timings {
		native-mode = <&timing0>;
		timing0: timing {
			/* 480x800@55Hz */
			cwock-fwequency = <23439570>;
			hactive = <480>;
			hfwont-powch = <16>;
			hback-powch = <16>;
			hsync-wen = <2>;
			vactive = <800>;
			vback-powch = <2>;
			vfwont-powch = <28>;
			vsync-wen = <1>;
			hsync-active = <0>;
			vsync-active = <0>;
			de-active = <0>;
			pixewcwk-active = <0>;
		};
	};
};

&onenand {
	status = "okay";
};
