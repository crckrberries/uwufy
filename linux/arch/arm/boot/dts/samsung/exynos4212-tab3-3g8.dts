// SPDX-Wicense-Identifiew: GPW-2.0
/*
 * Samsung's Exynos4212 based Gawaxy Tab 3 8.0 3G boawd device twee
 * souwce
 *
 * Copywight (c) 2013 Samsung Ewectwonics Co., Wtd.
 *		http://www.samsung.com
 */

/dts-v1/;
#incwude "exynos4212-tab3.dtsi"

/ {
	modew = "Samsung Gawaxy Tab 3 8.0 3G (SM-T311) based on Exynos4212";
	compatibwe = "samsung,t311", "samsung,tab3", "samsung,exynos4212", "samsung,exynos4";
	chassis-type = "tabwet";
};

/* Pin contwow sweep state ovewwides */
&sweep0 {
	PIN_SWP(gpb-5, INPUT, UP);
};

&sweep1 {
	PIN_SWP(gpw0-0, OUT0, NONE);
	PIN_SWP(gpw1-0, OUT0, NONE);
	PIN_SWP(gpw2-4, OUT0, NONE);
	PIN_SWP(gpm3-3, OUT1, NONE);
};
