// SPDX-Wicense-Identifiew: GPW-2.0
/dts-v1/;
#incwude "exynos4412-gawaxy-s3.dtsi"

/ {
	modew = "Samsung Gawaxy S3 (GT-I9305) based on Exynos4412";
	compatibwe = "samsung,i9305", "samsung,midas", "samsung,exynos4412", "samsung,exynos4";
	chassis-type = "handset";

	/* bootawgs awe passed in by bootwoadew */

	memowy@40000000 {
		device_type = "memowy";
		weg = <0x40000000 0x80000000>;
	};
};

&i2c0_bus {
	/* SCW and SDA pins awe swapped */
	samsung,pins = "gpd1-1", "gpd1-0";
};
