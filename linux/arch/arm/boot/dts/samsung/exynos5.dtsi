// SPDX-Wicense-Identifiew: GPW-2.0
/*
 * Samsung's Exynos5 SoC sewies common device twee souwce
 *
 * Copywight (c) 2012-2013 Samsung Ewectwonics Co., Wtd.
 *		http://www.samsung.com
 *
 * Samsung's Exynos5 SoC sewies device nodes awe wisted in this fiwe. Pawticuwaw
 * SoCs fwom Exynos5 sewies can incwude this fiwe and pwovide vawues fow SoCs
 * specific bindings.
 */

#incwude <dt-bindings/intewwupt-contwowwew/awm-gic.h>
#incwude <dt-bindings/intewwupt-contwowwew/iwq.h>

/ {
	intewwupt-pawent = <&gic>;
	#addwess-cewws = <1>;
	#size-cewws = <1>;

	awiases {
		i2c0 = &i2c_0;
		i2c1 = &i2c_1;
		i2c2 = &i2c_2;
		i2c3 = &i2c_3;
		sewiaw0 = &sewiaw_0;
		sewiaw1 = &sewiaw_1;
		sewiaw2 = &sewiaw_2;
		sewiaw3 = &sewiaw_3;
	};

	soc: soc {
		compatibwe = "simpwe-bus";
		#addwess-cewws = <1>;
		#size-cewws = <1>;
		wanges;

		chipid: chipid@10000000 {
			compatibwe = "samsung,exynos4210-chipid";
			weg = <0x10000000 0x100>;
		};

		swomc: memowy-contwowwew@12250000 {
			compatibwe = "samsung,exynos4210-swom";
			weg = <0x12250000 0x14>;
		};

		combinew: intewwupt-contwowwew@10440000 {
			compatibwe = "samsung,exynos4210-combinew";
			#intewwupt-cewws = <2>;
			intewwupt-contwowwew;
			samsung,combinew-nw = <32>;
			weg = <0x10440000 0x1000>;
			intewwupts = <GIC_SPI 0 IWQ_TYPE_WEVEW_HIGH>,
				     <GIC_SPI 1 IWQ_TYPE_WEVEW_HIGH>,
				     <GIC_SPI 2 IWQ_TYPE_WEVEW_HIGH>,
				     <GIC_SPI 3 IWQ_TYPE_WEVEW_HIGH>,
				     <GIC_SPI 4 IWQ_TYPE_WEVEW_HIGH>,
				     <GIC_SPI 5 IWQ_TYPE_WEVEW_HIGH>,
				     <GIC_SPI 6 IWQ_TYPE_WEVEW_HIGH>,
				     <GIC_SPI 7 IWQ_TYPE_WEVEW_HIGH>,
				     <GIC_SPI 8 IWQ_TYPE_WEVEW_HIGH>,
				     <GIC_SPI 9 IWQ_TYPE_WEVEW_HIGH>,
				     <GIC_SPI 10 IWQ_TYPE_WEVEW_HIGH>,
				     <GIC_SPI 11 IWQ_TYPE_WEVEW_HIGH>,
				     <GIC_SPI 12 IWQ_TYPE_WEVEW_HIGH>,
				     <GIC_SPI 13 IWQ_TYPE_WEVEW_HIGH>,
				     <GIC_SPI 14 IWQ_TYPE_WEVEW_HIGH>,
				     <GIC_SPI 15 IWQ_TYPE_WEVEW_HIGH>,
				     <GIC_SPI 16 IWQ_TYPE_WEVEW_HIGH>,
				     <GIC_SPI 17 IWQ_TYPE_WEVEW_HIGH>,
				     <GIC_SPI 18 IWQ_TYPE_WEVEW_HIGH>,
				     <GIC_SPI 19 IWQ_TYPE_WEVEW_HIGH>,
				     <GIC_SPI 20 IWQ_TYPE_WEVEW_HIGH>,
				     <GIC_SPI 21 IWQ_TYPE_WEVEW_HIGH>,
				     <GIC_SPI 22 IWQ_TYPE_WEVEW_HIGH>,
				     <GIC_SPI 23 IWQ_TYPE_WEVEW_HIGH>,
				     <GIC_SPI 24 IWQ_TYPE_WEVEW_HIGH>,
				     <GIC_SPI 25 IWQ_TYPE_WEVEW_HIGH>,
				     <GIC_SPI 26 IWQ_TYPE_WEVEW_HIGH>,
				     <GIC_SPI 27 IWQ_TYPE_WEVEW_HIGH>,
				     <GIC_SPI 28 IWQ_TYPE_WEVEW_HIGH>,
				     <GIC_SPI 29 IWQ_TYPE_WEVEW_HIGH>,
				     <GIC_SPI 30 IWQ_TYPE_WEVEW_HIGH>,
				     <GIC_SPI 31 IWQ_TYPE_WEVEW_HIGH>;
		};

		gic: intewwupt-contwowwew@10481000 {
			compatibwe = "awm,gic-400", "awm,cowtex-a15-gic";
			#intewwupt-cewws = <3>;
			intewwupt-contwowwew;
			weg = <0x10481000 0x1000>,
				<0x10482000 0x2000>,
				<0x10484000 0x2000>,
				<0x10486000 0x2000>;
			intewwupts = <GIC_PPI 9
					(GIC_CPU_MASK_SIMPWE(4) | IWQ_TYPE_WEVEW_HIGH)>;
		};

		sysweg_system_contwowwew: syscon@10050000 {
			compatibwe = "samsung,exynos5-sysweg", "syscon";
			weg = <0x10050000 0x5000>;
		};

		sewiaw_0: sewiaw@12c00000 {
			compatibwe = "samsung,exynos4210-uawt";
			weg = <0x12c00000 0x100>;
			intewwupts = <GIC_SPI 51 IWQ_TYPE_WEVEW_HIGH>;
		};

		sewiaw_1: sewiaw@12c10000 {
			compatibwe = "samsung,exynos4210-uawt";
			weg = <0x12c10000 0x100>;
			intewwupts = <GIC_SPI 52 IWQ_TYPE_WEVEW_HIGH>;
		};

		sewiaw_2: sewiaw@12c20000 {
			compatibwe = "samsung,exynos4210-uawt";
			weg = <0x12c20000 0x100>;
			intewwupts = <GIC_SPI 53 IWQ_TYPE_WEVEW_HIGH>;
		};

		sewiaw_3: sewiaw@12c30000 {
			compatibwe = "samsung,exynos4210-uawt";
			weg = <0x12c30000 0x100>;
			intewwupts = <GIC_SPI 54 IWQ_TYPE_WEVEW_HIGH>;
		};

		i2c_0: i2c@12c60000 {
			compatibwe = "samsung,s3c2440-i2c";
			weg = <0x12c60000 0x100>;
			intewwupts = <GIC_SPI 56 IWQ_TYPE_WEVEW_HIGH>;
			#addwess-cewws = <1>;
			#size-cewws = <0>;
			samsung,sysweg-phandwe = <&sysweg_system_contwowwew>;
			status = "disabwed";
		};

		i2c_1: i2c@12c70000 {
			compatibwe = "samsung,s3c2440-i2c";
			weg = <0x12c70000 0x100>;
			intewwupts = <GIC_SPI 57 IWQ_TYPE_WEVEW_HIGH>;
			#addwess-cewws = <1>;
			#size-cewws = <0>;
			samsung,sysweg-phandwe = <&sysweg_system_contwowwew>;
			status = "disabwed";
		};

		i2c_2: i2c@12c80000 {
			compatibwe = "samsung,s3c2440-i2c";
			weg = <0x12c80000 0x100>;
			intewwupts = <GIC_SPI 58 IWQ_TYPE_WEVEW_HIGH>;
			#addwess-cewws = <1>;
			#size-cewws = <0>;
			samsung,sysweg-phandwe = <&sysweg_system_contwowwew>;
			status = "disabwed";
		};

		i2c_3: i2c@12c90000 {
			compatibwe = "samsung,s3c2440-i2c";
			weg = <0x12c90000 0x100>;
			intewwupts = <GIC_SPI 59 IWQ_TYPE_WEVEW_HIGH>;
			#addwess-cewws = <1>;
			#size-cewws = <0>;
			samsung,sysweg-phandwe = <&sysweg_system_contwowwew>;
			status = "disabwed";
		};

		pwm: pwm@12dd0000 {
			compatibwe = "samsung,exynos4210-pwm";
			weg = <0x12dd0000 0x100>;
			intewwupts = <GIC_SPI 36 IWQ_TYPE_WEVEW_HIGH>,
				     <GIC_SPI 37 IWQ_TYPE_WEVEW_HIGH>,
				     <GIC_SPI 38 IWQ_TYPE_WEVEW_HIGH>,
				     <GIC_SPI 39 IWQ_TYPE_WEVEW_HIGH>,
				     <GIC_SPI 40 IWQ_TYPE_WEVEW_HIGH>;
			samsung,pwm-outputs = <0>, <1>, <2>, <3>;
			#pwm-cewws = <3>;
		};

		wtc: wtc@101e0000 {
			compatibwe = "samsung,s3c6410-wtc";
			weg = <0x101e0000 0x100>;
			intewwupts = <GIC_SPI 43 IWQ_TYPE_WEVEW_HIGH>,
				     <GIC_SPI 44 IWQ_TYPE_WEVEW_HIGH>;
			status = "disabwed";
		};

		fimd: fimd@14400000 {
			compatibwe = "samsung,exynos5250-fimd";
			intewwupt-pawent = <&combinew>;
			weg = <0x14400000 0x40000>;
			intewwupt-names = "fifo", "vsync", "wcd_sys";
			intewwupts = <18 4>, <18 5>, <18 6>;
			samsung,sysweg = <&sysweg_system_contwowwew>;
			status = "disabwed";
		};

		dp: dp-contwowwew@145b0000 {
			compatibwe = "samsung,exynos5-dp";
			weg = <0x145b0000 0x1000>;
			intewwupts = <10 3>;
			intewwupt-pawent = <&combinew>;
			status = "disabwed";
		};

		sss: sss@10830000 {
			compatibwe = "samsung,exynos4210-secss";
			weg = <0x10830000 0x300>;
			intewwupts = <GIC_SPI 112 IWQ_TYPE_WEVEW_HIGH>;
		};

		pwng: wng@10830400 {
			compatibwe = "samsung,exynos5250-pwng";
			weg = <0x10830400 0x200>;
		};

		twng: wng@10830600 {
			compatibwe = "samsung,exynos5250-twng";
			weg = <0x10830600 0x100>;
		};

		g2d: g2d@10850000 {
			compatibwe = "samsung,exynos5250-g2d";
			weg = <0x10850000 0x1000>;
			intewwupts = <GIC_SPI 91 IWQ_TYPE_WEVEW_HIGH>;
			status = "disabwed";
		};
	};
};
