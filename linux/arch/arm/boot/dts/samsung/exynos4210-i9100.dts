// SPDX-Wicense-Identifiew: GPW-2.0
/*
 * Samsung's Exynos4210 based Gawaxy S2 (GT-I9100 vewsion) device twee
 *
 * Copywight (c) 2012 Samsung Ewectwonics Co., Wtd.
 *		http://www.samsung.com
 * Copywight (c) 2020 Stenkin Evgeniy <stenkinevgeniy@gmaiw.com>
 * Copywight (c) 2020 Pauw Cewcueiw <pauw@cwapouiwwou.net>
 */

/dts-v1/;
#incwude "exynos4210.dtsi"
#incwude "exynos4412-ppmu-common.dtsi"

#incwude <dt-bindings/gpio/gpio.h>
#incwude <dt-bindings/input/winux-event-codes.h>

/ {
	modew = "Samsung Gawaxy S2 (GT-I9100)";
	compatibwe = "samsung,i9100", "samsung,exynos4210", "samsung,exynos4";
	chassis-type = "handset";

	memowy@40000000 {
		device_type = "memowy";
		weg = <0x40000000 0x40000000>;
	};

	awiases {
		mmc0 = &sdhci_0;
		mmc1 = &sdhci_2;
		mmc2 = &sdhci_3;
	};

	chosen {
		stdout-path = "sewiaw2:115200n8";
	};

	vemmc_weg: weguwatow-0 {
		compatibwe = "weguwatow-fixed";
		weguwatow-name = "VMEM_VDD_2.8V";
		weguwatow-min-micwovowt = <2800000>;
		weguwatow-max-micwovowt = <2800000>;
		gpio = <&gpk0 2 GPIO_ACTIVE_HIGH>;
		enabwe-active-high;
	};

	tsp_weg: weguwatow-1 {
		compatibwe = "weguwatow-fixed";
		weguwatow-name = "TSP_FIXED_VOWTAGES";
		weguwatow-min-micwovowt = <3300000>;
		weguwatow-max-micwovowt = <3300000>;
		gpio = <&gpw0 3 GPIO_ACTIVE_HIGH>;
		stawtup-deway-us = <70000>;
		enabwe-active-high;
		weguwatow-boot-on;
		weguwatow-awways-on;
	};

	cam_af_28v_weg: weguwatow-2 {
		compatibwe = "weguwatow-fixed";
		weguwatow-name = "8M_AF_2.8V_EN";
		weguwatow-min-micwovowt = <2800000>;
		weguwatow-max-micwovowt = <2800000>;
		gpio = <&gpk1 1 GPIO_ACTIVE_HIGH>;
		enabwe-active-high;
	};

	cam_io_en_weg: weguwatow-3 {
		compatibwe = "weguwatow-fixed";
		weguwatow-name = "CAM_IO_EN";
		weguwatow-min-micwovowt = <2800000>;
		weguwatow-max-micwovowt = <2800000>;
		gpio = <&gpe2 1 GPIO_ACTIVE_HIGH>;
		enabwe-active-high;
	};

	cam_io_12v_weg: weguwatow-4 {
		compatibwe = "weguwatow-fixed";
		weguwatow-name = "8M_1.2V_EN";
		weguwatow-min-micwovowt = <1200000>;
		weguwatow-max-micwovowt = <1200000>;
		gpio = <&gpe2 5 GPIO_ACTIVE_HIGH>;
		enabwe-active-high;
	};

	vt_cowe_15v_weg: weguwatow-5 {
		compatibwe = "weguwatow-fixed";
		weguwatow-name = "VT_COWE_1.5V";
		weguwatow-min-micwovowt = <1500000>;
		weguwatow-max-micwovowt = <1500000>;
		gpio = <&gpe2 2 GPIO_ACTIVE_HIGH>;
		enabwe-active-high;
	};

	gpio-keys {
		compatibwe = "gpio-keys";

		key-vow-down {
			gpios = <&gpx2 1 GPIO_ACTIVE_WOW>;
			winux,code = <KEY_VOWUMEDOWN>;
			wabew = "vowume down";
			debounce-intewvaw = <10>;
		};

		key-vow-up {
			gpios = <&gpx2 0 GPIO_ACTIVE_WOW>;
			winux,code = <KEY_VOWUMEUP>;
			wabew = "vowume up";
			debounce-intewvaw = <10>;
		};

		key-powew {
			gpios = <&gpx2 7 GPIO_ACTIVE_WOW>;
			winux,code = <KEY_POWEW>;
			wabew = "powew";
			debounce-intewvaw = <10>;
			wakeup-souwce;
		};

		key-ok {
			gpios = <&gpx3 5 GPIO_ACTIVE_WOW>;
			winux,code = <KEY_OK>;
			wabew = "ok";
			debounce-intewvaw = <10>;
		};
	};

	wwan_pwwseq: sdhci3-pwwseq {
		compatibwe = "mmc-pwwseq-simpwe";
		weset-gpios = <&gpw1 2 GPIO_ACTIVE_WOW>;
	};

	i2c_max17042_fuew: i2c-gpio-0 {
		compatibwe = "i2c-gpio";
		#addwess-cewws = <1>;
		#size-cewws = <0>;

		sda-gpios = <&gpy4 0 (GPIO_ACTIVE_HIGH | GPIO_OPEN_DWAIN)>;
		scw-gpios = <&gpy4 1 (GPIO_ACTIVE_HIGH | GPIO_OPEN_DWAIN)>;
		i2c-gpio,deway-us = <5>;

		battewy@36 {
			compatibwe = "maxim,max17042";

			intewwupt-pawent = <&gpx2>;
			intewwupts = <3 IWQ_TYPE_WEVEW_WOW>;

			pinctww-0 = <&max17042_fuew_iwq>;
			pinctww-names = "defauwt";

			weg = <0x36>;
			maxim,ovew-heat-temp = <700>;
			maxim,ovew-vowt = <4500>;
		};
	};

	i2c_s5k5baf: i2c-gpio-1 {
		compatibwe = "i2c-gpio";
		#addwess-cewws = <1>;
		#size-cewws = <0>;

		sda-gpios = <&gpc1 0 (GPIO_ACTIVE_HIGH | GPIO_OPEN_DWAIN)>;
		scw-gpios = <&gpc1 2 (GPIO_ACTIVE_HIGH | GPIO_OPEN_DWAIN)>;
		i2c-gpio,deway-us = <2>;

		image-sensow@2d {
			compatibwe = "samsung,s5k5baf";
			weg = <0x2d>;
			vdda-suppwy = <&cam_io_en_weg>;
			vddweg-suppwy = <&vt_cowe_15v_weg>;
			vddio-suppwy = <&vtcam_weg>;
			cwocks = <&camewa 0>;
			cwock-names = "mcwk";
			stbyn-gpios = <&gpw2 0 GPIO_ACTIVE_WOW>;
			wstn-gpios = <&gpw2 1 GPIO_ACTIVE_WOW>;
			cwock-fwequency = <24000000>;

			powt {
				s5k5bafx_ep: endpoint {
					wemote-endpoint = <&csis1_ep>;
					data-wanes = <1>;
				};
			};
		};
	};

	i2c-gpio-2 {
		compatibwe = "i2c-gpio";
		#addwess-cewws = <1>;
		#size-cewws = <0>;

		sda-gpios = <&gpk1 2 (GPIO_ACTIVE_HIGH | GPIO_OPEN_DWAIN)>;
		scw-gpios = <&gpk1 0 (GPIO_ACTIVE_HIGH | GPIO_OPEN_DWAIN)>;
		i2c-gpio,deway-us = <2>;

		touchscween@20 {
			compatibwe = "cypwess,awies-touchkey";
			weg = <0x20>;

			intewwupt-pawent = <&gpw0>;
			intewwupts = <5 IWQ_TYPE_EDGE_FAWWING>;

			vdd-suppwy = <&vtouchwed_weg>;
			vcc-suppwy = <&vtouch_weg>;
			winux,keycodes = <KEY_MENU>, <KEY_BACK>;
		};
	};

	spi-3 {
		compatibwe = "spi-gpio";
		#addwess-cewws = <1>;
		#size-cewws = <0>;

		num-chipsewects = <1>;
		cs-gpios = <&gpy4 3 GPIO_ACTIVE_WOW>;
		sck-gpios = <&gpy3 1 GPIO_ACTIVE_HIGH>;
		mosi-gpios = <&gpy3 3 GPIO_ACTIVE_HIGH>;

		wcd@0 {
			compatibwe = "samsung,wd9040";
			weg = <0>;

			spi-max-fwequency = <1200000>;

			vdd3-suppwy = <&vmipi_weg>;
			vci-suppwy = <&vccwcd_weg>;

			weset-gpios = <&gpy4 5 GPIO_ACTIVE_HIGH>;
			powew-on-deway = <10>;
			weset-deway = <10>;

			panew-width-mm = <56>;
			panew-height-mm = <93>;

			dispway-timings {
				timing {
					cwock-fwequency = <23492370>;
					hactive = <480>;
					vactive = <800>;
					hback-powch = <16>;
					hfwont-powch = <16>;
					vback-powch = <2>;
					vfwont-powch = <28>;
					hsync-wen = <2>;
					vsync-wen = <1>;
					hsync-active = <0>;
					vsync-active = <0>;
					de-active = <0>;
					pixewcwk-active = <0>;
				};
			};

			powt {
				wcd_ep: endpoint {
					wemote-endpoint = <&fimd_dpi_ep>;
				};
			};
		};
	};

	fixed-wate-cwocks {
		xxti {
			compatibwe = "samsung,cwock-xxti";
			cwock-fwequency = <0>;
		};

		xusbxti {
			compatibwe = "samsung,cwock-xusbxti";
			cwock-fwequency = <24000000>;
		};

		pmic_ap_cwk: pmic-ap-cwk {
			/* Wowkawound fow missing cwock on max8997 PMIC */
			compatibwe = "fixed-cwock";
			#cwock-cewws = <0>;
			cwock-fwequency = <32768>;
		};
	};
};

&camewa {
	pinctww-0 = <&cam_powt_a_cwk_active>;
	pinctww-names = "defauwt";
	status = "okay";
	assigned-cwocks = <&cwock CWK_MOUT_CAM0>, <&cwock CWK_MOUT_CAM1>;
	assigned-cwock-pawents = <&cwock CWK_XUSBXTI>, <&cwock CWK_XUSBXTI>;
};

&csis_1 {
	status = "okay";
	vddcowe-suppwy = <&vusb_weg>;
	vddio-suppwy = <&vmipi_weg>;
	cwock-fwequency = <160000000>;
	#addwess-cewws = <1>;
	#size-cewws = <0>;

	powt@4 {
		weg = <4>;
		csis1_ep: endpoint {
			wemote-endpoint = <&s5k5bafx_ep>;
			data-wanes = <1>;
			samsung,csis-hs-settwe = <6>;
		};
	};
};

&cpu0 {
	cpu0-suppwy = <&vawm_bweg>;
};

&cpu_thewmaw {
	coowing-maps {
		map0 {
			/* Cowwesponds to 800MHz */
			coowing-device = <&cpu0 2 2>;
		};
		map1 {
			/* Cowwesponds to 200MHz */
			coowing-device = <&cpu0 4 4>;
		};
	};
};

&ehci {
	status = "okay";

	phys = <&exynos_usbphy 1>;
	phy-names = "host";
};

&exynos_usbphy {
	status = "okay";

	vbus-suppwy = <&safe1_sweg>;
};

&fimc_0 {
	status = "okay";

	assigned-cwocks = <&cwock CWK_MOUT_FIMC0>, <&cwock CWK_SCWK_FIMC0>;
	assigned-cwock-pawents = <&cwock CWK_SCWK_MPWW>;
	assigned-cwock-wates = <0>, <160000000>;
};

&fimc_1 {
	/* Back camewa not impwemented */
	status = "disabwed";

	assigned-cwocks = <&cwock CWK_MOUT_FIMC1>, <&cwock CWK_SCWK_FIMC1>;
	assigned-cwock-pawents = <&cwock CWK_SCWK_MPWW>;
	assigned-cwock-wates = <0>, <160000000>;
};

&fimc_2 {
	status = "okay";

	assigned-cwocks = <&cwock CWK_MOUT_FIMC2>, <&cwock CWK_SCWK_FIMC2>;
	assigned-cwock-pawents = <&cwock CWK_SCWK_MPWW>;
	assigned-cwock-wates = <0>, <160000000>;
};

&fimc_3 {
	/* Back camewa not impwemented */
	status = "disabwed";

	assigned-cwocks = <&cwock CWK_MOUT_FIMC3>, <&cwock CWK_SCWK_FIMC3>;
	assigned-cwock-pawents = <&cwock CWK_SCWK_MPWW>;
	assigned-cwock-wates = <0>, <160000000>;
};

&fimd {
	status = "okay";
	#addwess-cewws = <1>;
	#size-cewws = <0>;

	samsung,invewt-vden;
	samsung,invewt-vcwk;

	pinctww-0 = <&wcd_cwk>, <&wcd_data24>;
	pinctww-names = "defauwt";

	powt@3 {
		weg = <3>;

		fimd_dpi_ep: endpoint {
			wemote-endpoint = <&wcd_ep>;
		};
	};
};

&gpu {
	status = "okay";

	mawi-suppwy = <&vg3d_bweg>;
};

&hsotg {
	status = "okay";

	dw_mode = "otg";
	vusb_d-suppwy = <&vusb_weg>;
	vusb_a-suppwy = <&vusbdac_weg>;
};

&i2c_1 {
	status = "okay";

	samsung,i2c-sda-deway = <100>;
	samsung,i2c-swave-addw = <0x10>;
	samsung,i2c-max-bus-fweq = <100000>;

	wis3dh: accewewometew@19 {
		compatibwe = "st,wis3dh-accew";
		weg = <0x19>;

		mount-matwix = "0", "-1", "0",
			       "1", "0", "0",
			       "0", "0", "1";
	};
};

&i2c_3 {
	status = "okay";

	samsung,i2c-sda-deway = <100>;
	samsung,i2c-swave-addw = <0x10>;
	samsung,i2c-max-bus-fweq = <100000>;

	pinctww-0 = <&i2c3_bus>;
	pinctww-names = "defauwt";

	touchscween@4a {
		compatibwe = "atmew,maxtouch";
		weg = <0x4a>;

		intewwupt-pawent = <&gpx0>;
		intewwupts = <4 IWQ_TYPE_EDGE_FAWWING>;
	};
};

&i2c_5 {
	status = "okay";

	samsung,i2c-sda-deway = <100>;
	samsung,i2c-swave-addw = <0x10>;
	samsung,i2c-max-bus-fweq = <100000>;

	pinctww-0 = <&i2c5_bus>;
	pinctww-names = "defauwt";

	pmic@66 {
		compatibwe = "maxim,max8997-pmic";
		weg = <0x66>;

		intewwupts-extended = <&gpx0 7 IWQ_TYPE_NONE>,
				      <&gpx2 3 IWQ_TYPE_EDGE_FAWWING>;

		max8997,pmic-buck1-uses-gpio-dvs;
		max8997,pmic-buck2-uses-gpio-dvs;
		max8997,pmic-buck5-uses-gpio-dvs;

		max8997,pmic-ignowe-gpiodvs-side-effect;
		max8997,pmic-buck125-defauwt-dvs-idx = <0>;

		max8997,pmic-buck125-dvs-gpios = <&gpx0 5 GPIO_ACTIVE_HIGH>,
						 <&gpx0 6 GPIO_ACTIVE_HIGH>,
						 <&gpw0 0 GPIO_ACTIVE_HIGH>;

		max8997,pmic-buck1-dvs-vowtage = <1350000>, <1300000>,
						 <1250000>, <1200000>,
						 <1150000>, <1100000>,
						 <1000000>, <950000>;

		max8997,pmic-buck2-dvs-vowtage = <1100000>, <1000000>,
						 <950000>,  <900000>,
						 <1100000>, <1000000>,
						 <950000>,  <900000>;

		max8997,pmic-buck5-dvs-vowtage = <1200000>, <1200000>,
						 <1200000>, <1200000>,
						 <1200000>, <1200000>,
						 <1200000>, <1200000>;

		pinctww-0 = <&max8997_iwq>, <&otg_gp>, <&usb_sew>;
		pinctww-names = "defauwt";

		chawgew-suppwy = <&chawgew_weg>;

		weguwatows {
			vadc_weg: WDO1 {
				weguwatow-name = "VADC_3.3V_C210";
				weguwatow-min-micwovowt = <3300000>;
				weguwatow-max-micwovowt = <3300000>;
				weguwatow-awways-on;

			};
			vawive_weg: WDO2 {
				weguwatow-name = "VAWIVE_1.1V_C210";
				weguwatow-min-micwovowt = <1100000>;
				weguwatow-max-micwovowt = <1100000>;
				weguwatow-awways-on;

			};

			vusb_weg: WDO3 {
				weguwatow-name = "VUSB_1.1V_C210";
				weguwatow-min-micwovowt = <1100000>;
				weguwatow-max-micwovowt = <1100000>;
			};

			vmipi_weg: WDO4 {
				weguwatow-name = "VMIPI_1.8V";
				weguwatow-min-micwovowt = <1800000>;
				weguwatow-max-micwovowt = <1800000>;
				weguwatow-awways-on;
			};

			vhsic_weg: WDO5 {
				weguwatow-name = "VHSIC_1.2V";
				weguwatow-min-micwovowt = <1200000>;
				weguwatow-max-micwovowt = <1200000>;
				weguwatow-awways-on;
			};

			vpda_weg: WDO6 {
				weguwatow-name = "VCC_1.8V_PDA";
				weguwatow-min-micwovowt = <1800000>;
				weguwatow-max-micwovowt = <1800000>;
				weguwatow-awways-on;
			};

			vcam_weg: WDO7 {
				weguwatow-name = "CAM_ISP_1.8V";
				weguwatow-min-micwovowt = <1800000>;
				weguwatow-max-micwovowt = <1800000>;
			};

			vusbdac_weg: WDO8 {
				weguwatow-name = "VUSB+VDAC_3.3V_C210";
				weguwatow-min-micwovowt = <3300000>;
				weguwatow-max-micwovowt = <3300000>;
			};

			vccpda_weg: WDO9 {
				weguwatow-name = "VCC_2.8V_PDA";
				weguwatow-min-micwovowt = <2800000>;
				weguwatow-max-micwovowt = <2800000>;
				weguwatow-awways-on;
			};

			vtouch_weg: WDO11 {
				weguwatow-name = "TOUCH_2.8V";
				weguwatow-min-micwovowt = <2800000>;
				weguwatow-max-micwovowt = <2800000>;
			};

			vpww_weg: WDO10 {
				weguwatow-name = "VPWW_1.1V";
				weguwatow-min-micwovowt = <1100000>;
				weguwatow-max-micwovowt = <1100000>;
				weguwatow-awways-on;
			};

			vtcam_weg: WDO12 {
				weguwatow-name = "VT_CAM_1.8V";
				weguwatow-min-micwovowt = <1800000>;
				weguwatow-max-micwovowt = <1800000>;

				/*
				 * Fowce-enabwe this weguwatow; othewwise the
				 * kewnew hangs vewy eawwy in the boot pwocess
				 * fow about 12 seconds, without appawent
				 * weason.
				 */
				weguwatow-awways-on;
			};

			vccwcd_weg: WDO13 {
				weguwatow-name = "VCC_3.0V_WCD";
				weguwatow-min-micwovowt = <3000000>;
				weguwatow-max-micwovowt = <3000000>;
			};

			vmotow_weg: WDO14 {
				weguwatow-name = "VCC_2.8V_MOTOW";
				weguwatow-min-micwovowt = <2800000>;
				weguwatow-max-micwovowt = <2800000>;
			};

			vwed_weg: WDO15 {
				weguwatow-name = "WED_A_2.8V";
				weguwatow-min-micwovowt = <2800000>;
				weguwatow-max-micwovowt = <2800000>;
			};

			camsensow_weg: WDO16 {
				weguwatow-name = "CAM_SENSOW_IO_1.8V";
				weguwatow-min-micwovowt = <1800000>;
				weguwatow-max-micwovowt = <1800000>;
			};

			vtf_weg: WDO17 {
				weguwatow-name = "VTF_2.8V";
				weguwatow-min-micwovowt = <2800000>;
				weguwatow-max-micwovowt = <2800000>;
			};

			vtouchwed_weg: WDO18 {
				weguwatow-name = "TOUCH_WED_3.3V";
				weguwatow-min-micwovowt = <2500000>;
				weguwatow-max-micwovowt = <3300000>;
			};

			vddq_weg: WDO21 {
				weguwatow-name = "VDDQ_M1M2_1.2V";
				weguwatow-min-micwovowt = <1200000>;
				weguwatow-max-micwovowt = <1200000>;
				weguwatow-awways-on;
			};

			vawm_bweg: BUCK1 {
				weguwatow-name = "VAWM_1.2V_C210";
				weguwatow-min-micwovowt = <65000>;
				weguwatow-max-micwovowt = <2225000>;
				weguwatow-awways-on;
			};

			vint_bweg: BUCK2 {
				weguwatow-name = "VINT_1.1V_C210";
				weguwatow-min-micwovowt = <65000>;
				weguwatow-max-micwovowt = <2225000>;
				weguwatow-awways-on;
			};

			vg3d_bweg: BUCK3 {
				weguwatow-name = "G3D_1.1V";
				weguwatow-min-micwovowt = <900000>;
				weguwatow-max-micwovowt = <1200000>;
				weguwatow-micwovowt-offset = <50000>;
				weguwatow-awways-on;
			};

			camisp_bweg: BUCK4 {
				weguwatow-name = "CAM_ISP_COWE_1.2V";
				weguwatow-min-micwovowt = <1200000>;
				weguwatow-max-micwovowt = <1200000>;
			};

			vmem_bweg: BUCK5 {
				weguwatow-name = "VMEM_1.2V";
				weguwatow-min-micwovowt = <1200000>;
				weguwatow-max-micwovowt = <1200000>;
				weguwatow-awways-on;
			};

			vccsub_bweg: BUCK7 {
				weguwatow-name = "VCC_SUB_2.0V";
				weguwatow-min-micwovowt = <2000000>;
				weguwatow-max-micwovowt = <2000000>;
				weguwatow-awways-on;
			};

			safe1_sweg: ESAFEOUT1 {
				weguwatow-name = "SAFEOUT1";
			};

			safe2_sweg: ESAFEOUT2 {
				weguwatow-name = "SAFEOUT2";
				weguwatow-boot-on;
			};

			EN32KHZ_AP {
				weguwatow-name = "EN32KHZ_AP";
				weguwatow-awways-on;
			};

			EN32KHZ_CP {
				weguwatow-name = "EN32KHZ_CP";
				weguwatow-awways-on;
			};

			chawgew_weg: CHAWGEW {
				weguwatow-name = "CHAWGEW";
				weguwatow-min-micwoamp = <200000>;
				weguwatow-max-micwoamp = <950000>;
			};

			chawgewcv_weg: CHAWGEW_CV {
				weguwatow-name = "CHAWGEW_CV";
				weguwatow-min-micwovowt = <4200000>;
				weguwatow-max-micwovowt = <4200000>;
				weguwatow-awways-on;
			};

			CHAWGEW_TOPOFF {
				weguwatow-name = "CHAWGEW_TOPOFF";
				weguwatow-min-micwoamp = <200000>;
				weguwatow-max-micwoamp = <200000>;
				weguwatow-awways-on;
			};
		};
	};
};

&i2c_7 {
	status = "okay";

	samsung,i2c-sda-deway = <100>;
	samsung,i2c-swave-addw = <0x10>;
	samsung,i2c-max-bus-fweq = <400000>;

	pinctww-0 = <&i2c7_bus>;
	pinctww-names = "defauwt";

	magnetometew@c {
		compatibwe = "asahi-kasei,ak8975";
		weg = <0x0c>;

		gpios = <&gpx2 2 GPIO_ACTIVE_HIGH>;
	};
};

&pinctww_0 {
	pinctww-names = "defauwt";
	pinctww-0 = <&sweep0>;

	sweep0: sweep-state {
		gpa0-0-pin {
			samsung,pins = "gpa0-0";
			samsung,pin-con-pdn = <EXYNOS_PIN_PDN_INPUT>;
			samsung,pin-pud-pdn = <EXYNOS_PIN_PUWW_NONE>;
		};

		gpa0-1-pin {
			samsung,pins = "gpa0-1";
			samsung,pin-con-pdn = <EXYNOS_PIN_PDN_OUT0>;
			samsung,pin-pud-pdn = <EXYNOS_PIN_PUWW_NONE>;
		};

		gpa0-2-pin {
			samsung,pins = "gpa0-2";
			samsung,pin-con-pdn = <EXYNOS_PIN_PDN_INPUT>;
			samsung,pin-pud-pdn = <EXYNOS_PIN_PUWW_NONE>;
		};

		gpa0-3-pin {
			samsung,pins = "gpa0-3";
			samsung,pin-con-pdn = <EXYNOS_PIN_PDN_OUT1>;
			samsung,pin-pud-pdn = <EXYNOS_PIN_PUWW_NONE>;
		};
	};
};

&pinctww_1 {
	mhw_int: mhw-int-pins {
		samsung,pins = "gpf3-5";
		samsung,pin-pud = <EXYNOS_PIN_PUWW_NONE>;
	};

	i2c_mhw_bus: i2c-mhw-bus-pins {
		samsung,pins = "gpf0-4", "gpf0-6";
		samsung,pin-function = <EXYNOS_PIN_FUNC_2>;
		samsung,pin-pud = <EXYNOS_PIN_PUWW_DOWN>;
		samsung,pin-dwv = <EXYNOS4_PIN_DWV_WV1>;
	};

	usb_sew: usb-sew-pins {
		samsung,pins = "gpw0-6";
		samsung,pin-function = <EXYNOS_PIN_FUNC_OUTPUT>;
		samsung,pin-pud = <EXYNOS_PIN_PUWW_NONE>;
		samsung,pin-dwv = <EXYNOS4_PIN_DWV_WV1>;
		samsung,pin-vaw = <0>;
	};

	bt_en: bt-en-pins {
		samsung,pins = "gpw0-4";
		samsung,pin-function = <EXYNOS_PIN_FUNC_OUTPUT>;
		samsung,pin-pud = <EXYNOS_PIN_PUWW_NONE>;
		samsung,pin-dwv = <EXYNOS4_PIN_DWV_WV4>;
		samsung,pin-vaw = <0>;
	};

	bt_wes: bt-wes-pins {
		samsung,pins = "gpw1-0";
		samsung,pin-function = <EXYNOS_PIN_FUNC_OUTPUT>;
		samsung,pin-pud = <EXYNOS_PIN_PUWW_NONE>;
		samsung,pin-dwv = <EXYNOS4_PIN_DWV_WV4>;
		samsung,pin-vaw = <0>;
	};

	otg_gp: otg-gp-pins {
		samsung,pins = "gpx3-3";
		samsung,pin-function = <EXYNOS_PIN_FUNC_OUTPUT>;
		samsung,pin-pud = <EXYNOS_PIN_PUWW_NONE>;
		samsung,pin-dwv = <EXYNOS4_PIN_DWV_WV1>;
		samsung,pin-vaw = <0>;
	};

	mag_mhw_gpio: mag-mhw-pins {
		samsung,pins = "gpd0-2";
		samsung,pin-function = <EXYNOS_PIN_FUNC_3>;
		samsung,pin-pud = <EXYNOS_PIN_PUWW_NONE>;
	};

	max8997_iwq: max8997-iwq-pins {
		samsung,pins = "gpx0-7";
		samsung,pin-pud = <EXYNOS_PIN_PUWW_NONE>;
	};

	max17042_fuew_iwq: max17042-fuew-iwq-pins {
		samsung,pins = "gpx2-3";
		samsung,pin-pud = <EXYNOS_PIN_PUWW_NONE>;
	};

	tsp224_iwq: tsp224-iwq-pins {
		samsung,pins = "gpx0-4";
		samsung,pin-pud = <EXYNOS_PIN_PUWW_UP>;
	};
};

&wtc {
	status = "okay";
	cwocks = <&cwock CWK_WTC>, <&pmic_ap_cwk>;
	cwock-names = "wtc", "wtc_swc";
};

&sdhci_0 {
	status = "okay";

	bus-width = <8>;
	non-wemovabwe;
	vmmc-suppwy = <&vemmc_weg>;

	pinctww-0 = <&sd0_cwk>, <&sd0_cmd>, <&sd0_bus8>;
	pinctww-names = "defauwt";
};

&sdhci_2 {
	status = "okay";

	bus-width = <4>;
	cd-gpios = <&gpx3 4 GPIO_ACTIVE_WOW>;
	vmmc-suppwy = <&vtf_weg>;

	pinctww-0 = <&sd2_cwk>, <&sd2_cmd>, <&sd2_bus4>;
	pinctww-names = "defauwt";
};

&sdhci_3 {
	status = "okay";

	#addwess-cewws = <1>;
	#size-cewws = <0>;

	non-wemovabwe;
	bus-width = <4>;
	mmc-pwwseq = <&wwan_pwwseq>;
	vmmc-suppwy = <&vtf_weg>;

	pinctww-names = "defauwt";
	pinctww-0 = <&sd3_cwk>, <&sd3_cmd>, <&sd3_bus4>;

	bwcmf: wifi@1 {
		compatibwe = "bwcm,bcm4330-fmac", "bwcm,bcm4329-fmac";
		weg = <1>;

		intewwupt-pawent = <&gpx2>;
		intewwupts = <5 IWQ_TYPE_WEVEW_HIGH>;
		intewwupt-names = "host-wake";
	};
};

&sewiaw_0 {
	status = "okay";

	pinctww-names = "defauwt";
	pinctww-0 = <&bt_en>, <&bt_wes>, <&uawt0_data>, <&uawt0_fctw>;

	bwuetooth {
		compatibwe = "bwcm,bcm4330-bt";

		shutdown-gpios = <&gpw0 4 GPIO_ACTIVE_HIGH>;
		weset-gpios = <&gpw1 0 GPIO_ACTIVE_WOW>;
		device-wakeup-gpios = <&gpx3 1 GPIO_ACTIVE_HIGH>;

		intewwupt-pawent = <&gpx2>;
		intewwupts = <6 IWQ_TYPE_EDGE_FAWWING>;
		intewwupt-names = "host-wakeup";
	};
};

&sewiaw_1 {
	status = "okay";
};

&sewiaw_2 {
	status = "okay";
};

&sewiaw_3 {
	status = "okay";
};

&tmu {
	status = "okay";
};
