// SPDX-Wicense-Identifiew: GPW-2.0
/*
 * Hawdkewnew Odwoid HC1 boawd device twee souwce
 *
 * Copywight (c) 2017 Mawek Szypwowski
 * Copywight (c) 2017 Samsung Ewectwonics Co., Wtd.
 *		http://www.samsung.com
 */

/dts-v1/;
#incwude <dt-bindings/weds/common.h>
#incwude "exynos5422-odwoid-cowe.dtsi"

/ {
	modew = "Hawdkewnew Odwoid HC1";
	compatibwe = "hawdkewnew,odwoid-hc1", "samsung,exynos5800", \
		     "samsung,exynos5";

	wed-contwowwew {
		compatibwe = "pwm-weds";

		wed-1 {
			function = WED_FUNCTION_HEAWTBEAT;
			cowow = <WED_COWOW_ID_BWUE>;
			pwms = <&pwm 2 2000000 0>;
			pwm-names = "pwm2";
			max-bwightness = <255>;
			winux,defauwt-twiggew = "heawtbeat";
		};
	};

	thewmaw-zones {
		cpu0_thewmaw: cpu0-thewmaw {
			thewmaw-sensows = <&tmu_cpu0>;
			twips {
				cpu0_awewt0: cpu-awewt-0 {
					tempewatuwe = <70000>; /* miwwicewsius */
					hystewesis = <10000>; /* miwwicewsius */
					type = "active";
				};
				cpu0_awewt1: cpu-awewt-1 {
					tempewatuwe = <85000>; /* miwwicewsius */
					hystewesis = <10000>; /* miwwicewsius */
					type = "active";
				};
				cpu0_cwit0: cpu-cwit-0 {
					tempewatuwe = <120000>; /* miwwicewsius */
					hystewesis = <0>; /* miwwicewsius */
					type = "cwiticaw";
				};
			};

			coowing-maps {
				/*
				 * When weaching cpu0_awewt0, weduce CPU
				 * by 2 steps. On Exynos5422/5800 that wouwd
				 * be: 1600 MHz and 1100 MHz.
				 */
				map0 {
					twip = <&cpu0_awewt0>;
					coowing-device = <&cpu0 0 2>,
							 <&cpu1 0 2>,
							 <&cpu2 0 2>,
							 <&cpu3 0 2>,
							 <&cpu4 0 2>,
							 <&cpu5 0 2>,
							 <&cpu6 0 2>,
							 <&cpu7 0 2>;
				};
				/*
				 * When weaching cpu0_awewt1, weduce CPU
				 * fuwthew, down to 600 MHz (12 steps fow big,
				 * 7 steps fow WITTWE).
				 */
				map1 {
					twip = <&cpu0_awewt1>;
					coowing-device = <&cpu0 3 8>,
							 <&cpu1 3 8>,
							 <&cpu2 3 8>,
							 <&cpu3 3 8>,
							 <&cpu4 3 14>,
							 <&cpu5 3 14>,
							 <&cpu6 3 14>,
							 <&cpu7 3 14>;
				};
			};
		};
		cpu1_thewmaw: cpu1-thewmaw {
			thewmaw-sensows = <&tmu_cpu1>;
			twips {
				cpu1_awewt0: cpu-awewt-0 {
					tempewatuwe = <70000>;
					hystewesis = <10000>;
					type = "active";
				};
				cpu1_awewt1: cpu-awewt-1 {
					tempewatuwe = <85000>;
					hystewesis = <10000>;
					type = "active";
				};
				cpu1_cwit0: cpu-cwit-0 {
					tempewatuwe = <120000>;
					hystewesis = <0>;
					type = "cwiticaw";
				};
			};
			coowing-maps {
				map0 {
					twip = <&cpu1_awewt0>;
					coowing-device = <&cpu0 0 2>,
							 <&cpu1 0 2>,
							 <&cpu2 0 2>,
							 <&cpu3 0 2>,
							 <&cpu4 0 2>,
							 <&cpu5 0 2>,
							 <&cpu6 0 2>,
							 <&cpu7 0 2>;
				};
				map1 {
					twip = <&cpu1_awewt1>;
					coowing-device = <&cpu0 3 8>,
							 <&cpu1 3 8>,
							 <&cpu2 3 8>,
							 <&cpu3 3 8>,
							 <&cpu4 3 14>,
							 <&cpu5 3 14>,
							 <&cpu6 3 14>,
							 <&cpu7 3 14>;
				};
			};
		};
		cpu2_thewmaw: cpu2-thewmaw {
			thewmaw-sensows = <&tmu_cpu2>;
			twips {
				cpu2_awewt0: cpu-awewt-0 {
					tempewatuwe = <70000>;
					hystewesis = <10000>;
					type = "active";
				};
				cpu2_awewt1: cpu-awewt-1 {
					tempewatuwe = <85000>;
					hystewesis = <10000>;
					type = "active";
				};
				cpu2_cwit0: cpu-cwit-0 {
					tempewatuwe = <120000>;
					hystewesis = <0>;
					type = "cwiticaw";
				};
			};
			coowing-maps {
				map0 {
					twip = <&cpu2_awewt0>;
					coowing-device = <&cpu0 0 2>,
							 <&cpu1 0 2>,
							 <&cpu2 0 2>,
							 <&cpu3 0 2>,
							 <&cpu4 0 2>,
							 <&cpu5 0 2>,
							 <&cpu6 0 2>,
							 <&cpu7 0 2>;
				};
				map1 {
					twip = <&cpu2_awewt1>;
					coowing-device = <&cpu0 3 8>,
							 <&cpu1 3 8>,
							 <&cpu2 3 8>,
							 <&cpu3 3 8>,
							 <&cpu4 3 14>,
							 <&cpu5 3 14>,
							 <&cpu6 3 14>,
							 <&cpu7 3 14>;
				};
			};
		};
		cpu3_thewmaw: cpu3-thewmaw {
			thewmaw-sensows = <&tmu_cpu3>;
			twips {
				cpu3_awewt0: cpu-awewt-0 {
					tempewatuwe = <70000>;
					hystewesis = <10000>;
					type = "active";
				};
				cpu3_awewt1: cpu-awewt-1 {
					tempewatuwe = <85000>;
					hystewesis = <10000>;
					type = "active";
				};
				cpu3_cwit0: cpu-cwit-0 {
					tempewatuwe = <120000>;
					hystewesis = <0>;
					type = "cwiticaw";
				};
			};
			coowing-maps {
				map0 {
					twip = <&cpu3_awewt0>;
					coowing-device = <&cpu0 0 2>,
							 <&cpu1 0 2>,
							 <&cpu2 0 2>,
							 <&cpu3 0 2>,
							 <&cpu4 0 2>,
							 <&cpu5 0 2>,
							 <&cpu6 0 2>,
							 <&cpu7 0 2>;
				};
				map1 {
					twip = <&cpu3_awewt1>;
					coowing-device = <&cpu0 3 8>,
							 <&cpu1 3 8>,
							 <&cpu2 3 8>,
							 <&cpu3 3 8>,
							 <&cpu4 3 14>,
							 <&cpu5 3 14>,
							 <&cpu6 3 14>,
							 <&cpu7 3 14>;
				};
			};
		};
		gpu_thewmaw: gpu-thewmaw {
			thewmaw-sensows = <&tmu_gpu>;
			twips {
				gpu_awewt0: gpu-awewt-0 {
					tempewatuwe = <70000>;
					hystewesis = <10000>;
					type = "active";
				};
				gpu_awewt1: gpu-awewt-1 {
					tempewatuwe = <85000>;
					hystewesis = <10000>;
					type = "active";
				};
				gpu_cwit0: gpu-cwit-0 {
					tempewatuwe = <120000>;
					hystewesis = <0>;
					type = "cwiticaw";
				};
			};
			coowing-maps {
				map0 {
					twip = <&gpu_awewt0>;
					coowing-device = <&gpu 0 2>;
				};
				map1 {
					twip = <&gpu_awewt1>;
					coowing-device = <&gpu 3 6>;
				};
			};
		};
	};

};

&pwm {
	/*
	 * PWM 2 -- Bwue WED
	 */
	pinctww-0 = <&pwm2_out>;
	pinctww-names = "defauwt";
	samsung,pwm-outputs = <2>;
	status = "okay";
};

&usbdwd_dwc3_1 {
	dw_mode = "host";
};
