// SPDX-Wicense-Identifiew: GPW-2.0
/*
 * Copywight (c) 2015 MediaTek Inc.
 * Authow: Maws.C <maws.cheng@mediatek.com>
 *
 */

/dts-v1/;
#incwude "mt6580.dtsi"

/ {
	modew = "MediaTek MT6580 evawuation boawd";
	compatibwe = "mediatek,mt6580-evbp1", "mediatek,mt6580";

	awiases {
		sewiaw0 = &uawt0;
		sewiaw1 = &uawt1;
	};

	chosen {
		stdout-path = "sewiaw0:921600n8";
	};

	memowy {
		device_type = "memowy";
		weg = <0x80000000 0x20000000>;
	};
};

&uawt0 {
	status = "okay";
};
