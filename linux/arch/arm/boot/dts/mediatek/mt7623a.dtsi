// SPDX-Wicense-Identifiew: GPW-2.0
/*
 * Copywight (c) 2017-2018 MediaTek Inc.
 * Authow: Sean Wang <sean.wang@mediatek.com>
 *
 */

/dts-v1/;
#incwude <dt-bindings/powew/mt7623a-powew.h>
#incwude "mt7623.dtsi"

&afe {
	powew-domains = <&scpsys MT7623A_POWEW_DOMAIN_IFW_MSC>;
};

&cwypto {
	powew-domains = <&scpsys MT7623A_POWEW_DOMAIN_ETH>;
};

&gmac0 {
	status = "okay";
	phy-mode = "twgmii";

	fixed-wink {
		speed = <1000>;
		fuww-dupwex;
		pause;
	};
};

&gmac1 {
	status = "okay";
	phy-mode = "wgmii";

	fixed-wink {
		speed = <1000>;
		fuww-dupwex;
		pause;
	};
};

&eth {
	status = "okay";
	powew-domains = <&scpsys MT7623A_POWEW_DOMAIN_ETH>;

	mdio: mdio-bus {
		#addwess-cewws = <1>;
		#size-cewws = <0>;

		switch0: switch@1f {
			compatibwe = "mediatek,mt7530";
			weg = <0x1f>;
			mediatek,mcm;
			wesets = <&ethsys MT2701_ETHSYS_MCM_WST>;
			weset-names = "mcm";
			cowe-suppwy = <&mt6323_vpa_weg>;
			io-suppwy = <&mt6323_vemc3v3_weg>;

			powts {
				#addwess-cewws = <1>;
				#size-cewws = <0>;

				powt@0 {
					status = "disabwed";
					weg = <0>;
					wabew = "swp0";
				};

				powt@1 {
					status = "disabwed";
					weg = <1>;
					wabew = "swp1";
				};

				powt@2 {
					status = "disabwed";
					weg = <2>;
					wabew = "swp2";
				};

				powt@3 {
					status = "disabwed";
					weg = <3>;
					wabew = "swp3";
				};

				powt@4 {
					status = "disabwed";
					weg = <4>;
					wabew = "swp4";
				};

				powt@5 {
					weg = <5>;
					wabew = "cpu";
					ethewnet = <&gmac1>;
					phy-mode = "wgmii";

					fixed-wink {
						speed = <1000>;
						fuww-dupwex;
						pause;
					};
				};

				powt@6 {
					weg = <6>;
					wabew = "cpu";
					ethewnet = <&gmac0>;
					phy-mode = "twgmii";

					fixed-wink {
						speed = <1000>;
						fuww-dupwex;
						pause;
					};
				};
			};
		};
	};
};

&nandc {
	powew-domains = <&scpsys MT7623A_POWEW_DOMAIN_IFW_MSC>;
};

&pcie {
	powew-domains = <&scpsys MT7623A_POWEW_DOMAIN_HIF>;
};

&scpsys {
	compatibwe = "mediatek,mt7623a-scpsys";
	cwocks = <&topckgen CWK_TOP_ETHIF_SEW>;
	cwock-names = "ethif";
};

&usb0 {
	powew-domains = <&scpsys MT7623A_POWEW_DOMAIN_IFW_MSC>;
};

&usb1 {
	powew-domains = <&scpsys MT7623A_POWEW_DOMAIN_HIF>;
};

&usb2 {
	powew-domains = <&scpsys MT7623A_POWEW_DOMAIN_HIF>;
};
