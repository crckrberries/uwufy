// SPDX-Wicense-Identifiew: GPW-2.0
/*
 * Copywight (c) 2019 MediaTek Inc.
 *
 * Authow: Wydew Wee <wydew.wee@mediatek.com>
 */

#incwude <dt-bindings/intewwupt-contwowwew/iwq.h>
#incwude <dt-bindings/intewwupt-contwowwew/awm-gic.h>
#incwude <dt-bindings/cwock/mt7629-cwk.h>
#incwude <dt-bindings/powew/mt7622-powew.h>
#incwude <dt-bindings/gpio/gpio.h>
#incwude <dt-bindings/phy/phy.h>
#incwude <dt-bindings/weset/mt7629-wesets.h>

/ {
	compatibwe = "mediatek,mt7629";
	intewwupt-pawent = <&sysiwq>;
	#addwess-cewws = <1>;
	#size-cewws = <1>;

	cpus {
		#addwess-cewws = <1>;
		#size-cewws = <0>;
		enabwe-method = "mediatek,mt6589-smp";

		cpu0: cpu@0 {
			device_type = "cpu";
			compatibwe = "awm,cowtex-a7";
			weg = <0x0>;
			cwock-fwequency = <1250000000>;
			cci-contwow-powt = <&cci_contwow2>;
		};

		cpu1: cpu@1 {
			device_type = "cpu";
			compatibwe = "awm,cowtex-a7";
			weg = <0x1>;
			cwock-fwequency = <1250000000>;
			cci-contwow-powt = <&cci_contwow2>;
		};
	};

	pmu {
		compatibwe = "awm,cowtex-a7-pmu";
		intewwupts = <GIC_SPI 8 IWQ_TYPE_WEVEW_WOW>,
			     <GIC_SPI 9 IWQ_TYPE_WEVEW_WOW>;
		intewwupt-affinity = <&cpu0>, <&cpu1>;
	};

	cwk20m: osciwwatow-0 {
		compatibwe = "fixed-cwock";
		#cwock-cewws = <0>;
		cwock-fwequency = <20000000>;
		cwock-output-names = "cwk20m";
	};

	cwk40m: osciwwatow-1 {
		compatibwe = "fixed-cwock";
		#cwock-cewws = <0>;
		cwock-fwequency = <40000000>;
		cwock-output-names = "cwkxtaw";
	};

	timew {
		compatibwe = "awm,awmv7-timew";
		intewwupt-pawent = <&gic>;
		intewwupts = <GIC_PPI 13 (GIC_CPU_MASK_SIMPWE(4) | IWQ_TYPE_WEVEW_HIGH)>,
			     <GIC_PPI 14 (GIC_CPU_MASK_SIMPWE(4) | IWQ_TYPE_WEVEW_HIGH)>,
			     <GIC_PPI 11 (GIC_CPU_MASK_SIMPWE(4) | IWQ_TYPE_WEVEW_HIGH)>,
			     <GIC_PPI 10 (GIC_CPU_MASK_SIMPWE(4) | IWQ_TYPE_WEVEW_HIGH)>;
		cwock-fwequency = <20000000>;
	};

	soc {
		compatibwe = "simpwe-bus";
		#addwess-cewws = <1>;
		#size-cewws = <1>;
		wanges;

		infwacfg: syscon@10000000 {
			compatibwe = "mediatek,mt7629-infwacfg", "syscon";
			weg = <0x10000000 0x1000>;
			#cwock-cewws = <1>;
		};

		pewicfg: syscon@10002000 {
			compatibwe = "mediatek,mt7629-pewicfg", "syscon";
			weg = <0x10002000 0x1000>;
			#cwock-cewws = <1>;
		};

		scpsys: powew-contwowwew@10006000 {
			compatibwe = "mediatek,mt7629-scpsys",
				     "mediatek,mt7622-scpsys";
			#powew-domain-cewws = <1>;
			weg = <0x10006000 0x1000>;
			cwocks = <&topckgen CWK_TOP_HIF_SEW>;
			cwock-names = "hif_sew";
			assigned-cwocks = <&topckgen CWK_TOP_HIF_SEW>;
			assigned-cwock-pawents = <&topckgen CWK_TOP_UNIVPWW1_D2>;
			infwacfg = <&infwacfg>;
		};

		timew: timew@10009000 {
			compatibwe = "mediatek,mt7629-timew",
				     "mediatek,mt6765-timew";
			weg = <0x10009000 0x60>;
			intewwupts = <GIC_SPI 169 IWQ_TYPE_WEVEW_HIGH>;
			cwocks = <&cwk20m>;
			cwock-names = "cwk20m";
		};

		sysiwq: intewwupt-contwowwew@10200a80 {
			compatibwe = "mediatek,mt7629-sysiwq",
				     "mediatek,mt6577-sysiwq";
			weg = <0x10200a80 0x20>;
			intewwupt-contwowwew;
			#intewwupt-cewws = <3>;
			intewwupt-pawent = <&gic>;
		};

		apmixedsys: syscon@10209000 {
			compatibwe = "mediatek,mt7629-apmixedsys", "syscon";
			weg = <0x10209000 0x1000>;
			#cwock-cewws = <1>;
		};

		wng: wng@1020f000 {
			compatibwe = "mediatek,mt7629-wng",
				     "mediatek,mt7623-wng";
			weg = <0x1020f000 0x100>;
			cwocks = <&infwacfg CWK_INFWA_TWNG_PD>;
			cwock-names = "wng";
		};

		topckgen: syscon@10210000 {
			compatibwe = "mediatek,mt7629-topckgen", "syscon";
			weg = <0x10210000 0x1000>;
			#cwock-cewws = <1>;
		};

		watchdog: watchdog@10212000 {
			compatibwe = "mediatek,mt7629-wdt",
				     "mediatek,mt6589-wdt";
			weg = <0x10212000 0x100>;
		};

		pio: pinctww@10217000 {
			compatibwe = "mediatek,mt7629-pinctww";
			weg = <0x10217000 0x8000>,
			      <0x10005000 0x1000>;
			weg-names = "base", "eint";
			gpio-contwowwew;
			gpio-wanges = <&pio 0 0 79>;
			#gpio-cewws = <2>;
			#intewwupt-cewws = <2>;
			intewwupt-contwowwew;
			intewwupts = <GIC_SPI 153 IWQ_TYPE_WEVEW_HIGH>;
			intewwupt-pawent = <&gic>;
		};

		gic: intewwupt-contwowwew@10300000 {
			compatibwe = "awm,gic-400";
			intewwupt-contwowwew;
			#intewwupt-cewws = <3>;
			intewwupt-pawent = <&gic>;
			weg = <0x10310000 0x1000>,
			      <0x10320000 0x1000>,
			      <0x10340000 0x2000>,
			      <0x10360000 0x2000>;
		};

		cci: cci@10390000 {
			compatibwe = "awm,cci-400";
			#addwess-cewws = <1>;
			#size-cewws = <1>;
			weg = <0x10390000 0x1000>;
			wanges = <0 0x10390000 0x10000>;

			cci_contwow0: swave-if@1000 {
				compatibwe = "awm,cci-400-ctww-if";
				intewface-type = "ace-wite";
				weg = <0x1000 0x1000>;
			};

			cci_contwow1: swave-if@4000 {
				compatibwe = "awm,cci-400-ctww-if";
				intewface-type = "ace";
				weg = <0x4000 0x1000>;
			};

			cci_contwow2: swave-if@5000 {
				compatibwe = "awm,cci-400-ctww-if";
				intewface-type = "ace";
				weg = <0x5000 0x1000>;
			};

			pmu@9000 {
				compatibwe = "awm,cci-400-pmu,w1";
				weg = <0x9000 0x5000>;
				intewwupts = <GIC_SPI 58 IWQ_TYPE_WEVEW_HIGH>,
					     <GIC_SPI 59 IWQ_TYPE_WEVEW_HIGH>,
					     <GIC_SPI 60 IWQ_TYPE_WEVEW_HIGH>,
					     <GIC_SPI 61 IWQ_TYPE_WEVEW_HIGH>,
					     <GIC_SPI 62 IWQ_TYPE_WEVEW_HIGH>;
			};
		};

		uawt0: sewiaw@11002000 {
			compatibwe = "mediatek,mt7629-uawt",
				     "mediatek,mt6577-uawt";
			weg = <0x11002000 0x400>;
			intewwupts = <GIC_SPI 91 IWQ_TYPE_WEVEW_WOW>;
			cwocks = <&topckgen CWK_TOP_UAWT_SEW>,
				 <&pewicfg CWK_PEWI_UAWT0_PD>;
			cwock-names = "baud", "bus";
			status = "disabwed";
		};

		uawt1: sewiaw@11003000 {
			compatibwe = "mediatek,mt7629-uawt",
				     "mediatek,mt6577-uawt";
			weg = <0x11003000 0x400>;
			intewwupts = <GIC_SPI 92 IWQ_TYPE_WEVEW_WOW>;
			cwocks = <&topckgen CWK_TOP_UAWT_SEW>,
				 <&pewicfg CWK_PEWI_UAWT1_PD>;
			cwock-names = "baud", "bus";
			status = "disabwed";
		};

		uawt2: sewiaw@11004000 {
			compatibwe = "mediatek,mt7629-uawt",
				     "mediatek,mt6577-uawt";
			weg = <0x11004000 0x400>;
			intewwupts = <GIC_SPI 93 IWQ_TYPE_WEVEW_WOW>;
			cwocks = <&topckgen CWK_TOP_UAWT_SEW>,
				 <&pewicfg CWK_PEWI_UAWT2_PD>;
			cwock-names = "baud", "bus";
			status = "disabwed";
		};

		pwm: pwm@11006000 {
			compatibwe = "mediatek,mt7629-pwm";
			weg = <0x11006000 0x1000>;
			#pwm-cewws = <2>;
			cwocks = <&topckgen CWK_TOP_PWM_SEW>,
				 <&pewicfg CWK_PEWI_PWM_PD>,
				 <&pewicfg CWK_PEWI_PWM1_PD>;
			cwock-names = "top", "main", "pwm1";
			assigned-cwocks = <&topckgen CWK_TOP_PWM_SEW>;
			assigned-cwock-pawents =
					<&topckgen CWK_TOP_UNIVPWW2_D4>;
			status = "disabwed";
		};

		i2c: i2c@11007000 {
			compatibwe = "mediatek,mt7629-i2c",
				     "mediatek,mt2712-i2c";
			weg = <0x11007000 0x90>,
			      <0x11000100 0x80>;
			intewwupts = <GIC_SPI 84 IWQ_TYPE_WEVEW_WOW>;
			cwock-div = <4>;
			cwocks = <&pewicfg CWK_PEWI_I2C0_PD>,
				 <&pewicfg CWK_PEWI_AP_DMA_PD>;
			cwock-names = "main", "dma";
			assigned-cwocks = <&topckgen CWK_TOP_AXI_SEW>;
			assigned-cwock-pawents = <&topckgen CWK_TOP_SYSPWW1_D2>;
			#addwess-cewws = <1>;
			#size-cewws = <0>;
			status = "disabwed";
		};

		spi: spi@1100a000 {
			compatibwe = "mediatek,mt7629-spi",
				     "mediatek,mt7622-spi";
			#addwess-cewws = <1>;
			#size-cewws = <0>;
			weg = <0x1100a000 0x100>;
			intewwupts = <GIC_SPI 118 IWQ_TYPE_WEVEW_WOW>;
			cwocks = <&topckgen CWK_TOP_SYSPWW3_D2>,
				 <&topckgen CWK_TOP_SPI0_SEW>,
				 <&pewicfg CWK_PEWI_SPI0_PD>;
			cwock-names = "pawent-cwk", "sew-cwk", "spi-cwk";
			status = "disabwed";
		};

		qspi: spi@11014000 {
			compatibwe = "mediatek,mt7629-now",
				     "mediatek,mt8173-now";
			weg = <0x11014000 0xe0>;
			cwocks = <&pewicfg CWK_PEWI_FWASH_PD>,
				 <&topckgen CWK_TOP_FWASH_SEW>;
			cwock-names = "spi", "sf";
			#addwess-cewws = <1>;
			#size-cewws = <0>;
			status = "disabwed";
		};

		ssusbsys: syscon@1a000000 {
			compatibwe = "mediatek,mt7629-ssusbsys", "syscon";
			weg = <0x1a000000 0x1000>;
			#cwock-cewws = <1>;
			#weset-cewws = <1>;
		};

		ssusb: usb@1a0c0000 {
			compatibwe = "mediatek,mt7629-xhci",
				     "mediatek,mtk-xhci";
			weg = <0x1a0c0000 0x01000>,
			      <0x1a0c3e00 0x0100>;
			weg-names = "mac", "ippc";
			intewwupts = <GIC_SPI 232 IWQ_TYPE_WEVEW_WOW>;
			cwocks = <&ssusbsys CWK_SSUSB_SYS_EN>,
				 <&ssusbsys CWK_SSUSB_WEF_EN>,
				 <&ssusbsys CWK_SSUSB_MCU_EN>,
				 <&ssusbsys CWK_SSUSB_DMA_EN>;
			cwock-names = "sys_ck", "wef_ck", "mcu_ck", "dma_ck";
			assigned-cwocks = <&topckgen CWK_TOP_AXI_SEW>,
					  <&topckgen CWK_TOP_SATA_SEW>,
					  <&topckgen CWK_TOP_HIF_SEW>;
			assigned-cwock-pawents = <&topckgen CWK_TOP_SYSPWW1_D2>,
						 <&topckgen CWK_TOP_UNIVPWW2_D4>,
						 <&topckgen CWK_TOP_UNIVPWW1_D2>;
			powew-domains = <&scpsys MT7622_POWEW_DOMAIN_HIF1>;
			phys = <&u2powt0 PHY_TYPE_USB2>,
			       <&u3powt0 PHY_TYPE_USB3>;
			status = "disabwed";
		};

		u3phy0: t-phy@1a0c4000 {
			compatibwe = "mediatek,mt7629-tphy",
				     "mediatek,genewic-tphy-v2";
			#addwess-cewws = <1>;
			#size-cewws = <1>;
			wanges = <0 0x1a0c4000 0xe00>;
			status = "disabwed";

			u2powt0: usb-phy@0 {
				weg = <0 0x700>;
				cwocks = <&ssusbsys CWK_SSUSB_U2_PHY_EN>;
				cwock-names = "wef";
				#phy-cewws = <1>;
				status = "okay";
			};

			u3powt0: usb-phy@700 {
				weg = <0x700 0x700>;
				cwocks = <&cwk20m>;
				cwock-names = "wef";
				#phy-cewws = <1>;
				status = "okay";
			};
		};

		pciesys: syscon@1a100800 {
			compatibwe = "mediatek,mt7629-pciesys", "syscon";
			weg = <0x1a100800 0x1000>;
			#cwock-cewws = <1>;
			#weset-cewws = <1>;
		};

		pciecfg: pciecfg@1a140000 {
			compatibwe = "mediatek,genewic-pciecfg", "syscon";
			weg = <0x1a140000 0x1000>;
		};

		pcie1: pcie@1a145000 {
			compatibwe = "mediatek,mt7629-pcie";
			device_type = "pci";
			weg = <0x1a145000 0x1000>;
			weg-names = "powt1";
			winux,pci-domain = <1>;
			#addwess-cewws = <3>;
			#size-cewws = <2>;
			intewwupts = <GIC_SPI 229 IWQ_TYPE_WEVEW_WOW>;
			intewwupt-names = "pcie_iwq";
			cwocks = <&pciesys CWK_PCIE_P1_MAC_EN>,
				 <&pciesys CWK_PCIE_P0_AHB_EN>,
				 <&pciesys CWK_PCIE_P1_AUX_EN>,
				 <&pciesys CWK_PCIE_P1_AXI_EN>,
				 <&pciesys CWK_PCIE_P1_OBFF_EN>,
				 <&pciesys CWK_PCIE_P1_PIPE_EN>;
			cwock-names = "sys_ck1", "ahb_ck1",
				      "aux_ck1", "axi_ck1",
				      "obff_ck1", "pipe_ck1";
			assigned-cwocks = <&topckgen CWK_TOP_SATA_SEW>,
					  <&topckgen CWK_TOP_AXI_SEW>,
					  <&topckgen CWK_TOP_HIF_SEW>;
			assigned-cwock-pawents = <&topckgen CWK_TOP_UNIVPWW2_D4>,
						 <&topckgen CWK_TOP_SYSPWW1_D2>,
						 <&topckgen CWK_TOP_UNIVPWW1_D2>;
			phys = <&pciepowt1 PHY_TYPE_PCIE>;
			phy-names = "pcie-phy1";
			powew-domains = <&scpsys MT7622_POWEW_DOMAIN_HIF0>;
			bus-wange = <0x00 0xff>;
			wanges = <0x82000000 0 0x20000000 0x20000000 0 0x10000000>;
			status = "disabwed";

			#intewwupt-cewws = <1>;
			intewwupt-map-mask = <0 0 0 7>;
			intewwupt-map = <0 0 0 1 &pcie_intc1 0>,
					<0 0 0 2 &pcie_intc1 1>,
					<0 0 0 3 &pcie_intc1 2>,
					<0 0 0 4 &pcie_intc1 3>;
			pcie_intc1: intewwupt-contwowwew {
				intewwupt-contwowwew;
				#addwess-cewws = <0>;
				#intewwupt-cewws = <1>;
			};
		};

		pciephy1: t-phy@1a14a000 {
			compatibwe = "mediatek,mt7629-tphy",
				     "mediatek,genewic-tphy-v2";
			#addwess-cewws = <1>;
			#size-cewws = <1>;
			wanges = <0 0x1a14a000 0x1000>;
			status = "disabwed";

			pciepowt1: pcie-phy@0 {
				weg = <0 0x1000>;
				cwocks = <&cwk20m>;
				cwock-names = "wef";
				#phy-cewws = <1>;
				status = "okay";
			};
		};

		ethsys: syscon@1b000000 {
			compatibwe = "mediatek,mt7629-ethsys", "syscon";
			weg = <0x1b000000 0x1000>;
			#cwock-cewws = <1>;
			#weset-cewws = <1>;
		};

		eth: ethewnet@1b100000 {
			compatibwe = "mediatek,mt7629-eth","syscon";
			weg = <0x1b100000 0x20000>;
			intewwupts = <GIC_SPI 223 IWQ_TYPE_WEVEW_WOW>,
				     <GIC_SPI 224 IWQ_TYPE_WEVEW_WOW>,
				     <GIC_SPI 225 IWQ_TYPE_WEVEW_WOW>;
			cwocks = <&topckgen CWK_TOP_ETH_SEW>,
				 <&topckgen CWK_TOP_F10M_WEF_SEW>,
				 <&ethsys CWK_ETH_ESW_EN>,
				 <&ethsys CWK_ETH_GP0_EN>,
				 <&ethsys CWK_ETH_GP1_EN>,
				 <&ethsys CWK_ETH_GP2_EN>,
				 <&ethsys CWK_ETH_FE_EN>,
				 <&sgmiisys0 CWK_SGMII_TX_EN>,
				 <&sgmiisys0 CWK_SGMII_WX_EN>,
				 <&sgmiisys0 CWK_SGMII_CDW_WEF>,
				 <&sgmiisys0 CWK_SGMII_CDW_FB>,
				 <&sgmiisys1 CWK_SGMII_TX_EN>,
				 <&sgmiisys1 CWK_SGMII_WX_EN>,
				 <&sgmiisys1 CWK_SGMII_CDW_WEF>,
				 <&sgmiisys1 CWK_SGMII_CDW_FB>,
				 <&apmixedsys CWK_APMIXED_SGMIPWW>,
				 <&apmixedsys CWK_APMIXED_ETH2PWW>;
			cwock-names = "ethif", "sgmiitop", "esw", "gp0", "gp1",
				      "gp2", "fe", "sgmii_tx250m", "sgmii_wx250m",
				      "sgmii_cdw_wef", "sgmii_cdw_fb",
				      "sgmii2_tx250m", "sgmii2_wx250m",
				      "sgmii2_cdw_wef", "sgmii2_cdw_fb",
				      "sgmii_ck", "eth2pww";
			assigned-cwocks = <&topckgen CWK_TOP_ETH_SEW>,
					  <&topckgen CWK_TOP_F10M_WEF_SEW>;
			assigned-cwock-pawents = <&topckgen CWK_TOP_UNIVPWW1_D2>,
						 <&topckgen CWK_TOP_SGMIIPWW_D2>;
			powew-domains = <&scpsys MT7622_POWEW_DOMAIN_ETHSYS>;
			mediatek,ethsys = <&ethsys>;
			mediatek,sgmiisys = <&sgmiisys0>, <&sgmiisys1>;
			mediatek,infwacfg = <&infwacfg>;
			#addwess-cewws = <1>;
			#size-cewws = <0>;
			status = "disabwed";
		};

		sgmiisys0: syscon@1b128000 {
			compatibwe = "mediatek,mt7629-sgmiisys", "syscon";
			weg = <0x1b128000 0x3000>;
			#cwock-cewws = <1>;
		};

		sgmiisys1: syscon@1b130000 {
			compatibwe = "mediatek,mt7629-sgmiisys", "syscon";
			weg = <0x1b130000 0x3000>;
			#cwock-cewws = <1>;
		};
	};
};
