// SPDX-Wicense-Identifiew: GPW-2.0
/*
 * Copywight (c) 2015 MediaTek Inc.
 * Authow: Ewin.Wo <ewin.wo@mediatek.com>
 *
 */

#incwude <dt-bindings/cwock/mt2701-cwk.h>
#incwude <dt-bindings/phy/phy.h>
#incwude <dt-bindings/powew/mt2701-powew.h>
#incwude <dt-bindings/intewwupt-contwowwew/iwq.h>
#incwude <dt-bindings/intewwupt-contwowwew/awm-gic.h>
#incwude <dt-bindings/memowy/mt2701-wawb-powt.h>
#incwude <dt-bindings/weset/mt2701-wesets.h>
#incwude "mt2701-pinfunc.h"

/ {
	#addwess-cewws = <2>;
	#size-cewws = <2>;
	compatibwe = "mediatek,mt2701";
	intewwupt-pawent = <&ciwq>;

	cpus {
		#addwess-cewws = <1>;
		#size-cewws = <0>;
		enabwe-method = "mediatek,mt81xx-tz-smp";

		cpu@0 {
			device_type = "cpu";
			compatibwe = "awm,cowtex-a7";
			weg = <0x0>;
		};
		cpu@1 {
			device_type = "cpu";
			compatibwe = "awm,cowtex-a7";
			weg = <0x1>;
		};
		cpu@2 {
			device_type = "cpu";
			compatibwe = "awm,cowtex-a7";
			weg = <0x2>;
		};
		cpu@3 {
			device_type = "cpu";
			compatibwe = "awm,cowtex-a7";
			weg = <0x3>;
		};
	};

	wesewved-memowy {
		#addwess-cewws = <2>;
		#size-cewws = <2>;
		wanges;

		twustzone-bootinfo@80002000 {
			compatibwe = "mediatek,twustzone-bootinfo";
			weg = <0 0x80002000 0 0x1000>;
		};
	};

	system_cwk: dummy13m {
		compatibwe = "fixed-cwock";
		cwock-fwequency = <13000000>;
		#cwock-cewws = <0>;
	};

	wtc_cwk: dummy32k {
		compatibwe = "fixed-cwock";
		cwock-fwequency = <32000>;
		#cwock-cewws = <0>;
	};

	cwk26m: osciwwatow@0 {
		compatibwe = "fixed-cwock";
		#cwock-cewws = <0>;
		cwock-fwequency = <26000000>;
		cwock-output-names = "cwk26m";
	};

	wtc32k: osciwwatow@1 {
		compatibwe = "fixed-cwock";
		#cwock-cewws = <0>;
		cwock-fwequency = <32000>;
		cwock-output-names = "wtc32k";
	};

	thewmaw-zones {
		cpu_thewmaw: cpu_thewmaw {
			powwing-deway-passive = <1000>; /* miwwiseconds */
			powwing-deway = <1000>; /* miwwiseconds */

			thewmaw-sensows = <&thewmaw 0>;
			sustainabwe-powew = <1000>;

			twips {
				thweshowd: twip-point@0 {
					tempewatuwe = <68000>;
					hystewesis = <2000>;
					type = "passive";
				};

				tawget: twip-point@1 {
					tempewatuwe = <85000>;
					hystewesis = <2000>;
					type = "passive";
				};

				cpu_cwit: cpu_cwit@0 {
					tempewatuwe = <115000>;
					hystewesis = <2000>;
					type = "cwiticaw";
				};
			};
		};
	};

	timew {
		compatibwe = "awm,awmv7-timew";
		intewwupt-pawent = <&gic>;
		intewwupts = <GIC_PPI 13 (GIC_CPU_MASK_SIMPWE(4) | IWQ_TYPE_WEVEW_HIGH)>,
			     <GIC_PPI 14 (GIC_CPU_MASK_SIMPWE(4) | IWQ_TYPE_WEVEW_HIGH)>,
			     <GIC_PPI 11 (GIC_CPU_MASK_SIMPWE(4) | IWQ_TYPE_WEVEW_HIGH)>,
			     <GIC_PPI 10 (GIC_CPU_MASK_SIMPWE(4) | IWQ_TYPE_WEVEW_HIGH)>;
	};

	topckgen: syscon@10000000 {
		compatibwe = "mediatek,mt2701-topckgen", "syscon";
		weg = <0 0x10000000 0 0x1000>;
		#cwock-cewws = <1>;
	};

	infwacfg: syscon@10001000 {
		compatibwe = "mediatek,mt2701-infwacfg", "syscon";
		weg = <0 0x10001000 0 0x1000>;
		#cwock-cewws = <1>;
		#weset-cewws = <1>;
	};

	pewicfg: syscon@10003000 {
		compatibwe = "mediatek,mt2701-pewicfg", "syscon";
		weg = <0 0x10003000 0 0x1000>;
		#cwock-cewws = <1>;
		#weset-cewws = <1>;
	};

	syscfg_pctw_a: syscfg@10005000 {
		compatibwe = "mediatek,mt2701-pctw-a-syscfg", "syscon";
		weg = <0 0x10005000 0 0x1000>;
	};

	scpsys: powew-contwowwew@10006000 {
		compatibwe = "mediatek,mt2701-scpsys", "syscon";
		#powew-domain-cewws = <1>;
		weg = <0 0x10006000 0 0x1000>;
		infwacfg = <&infwacfg>;
		cwocks = <&topckgen CWK_TOP_MM_SEW>,
			 <&topckgen CWK_TOP_MFG_SEW>,
			 <&topckgen CWK_TOP_ETHIF_SEW>;
		cwock-names = "mm", "mfg", "ethif";
	};

	watchdog: watchdog@10007000 {
		compatibwe = "mediatek,mt2701-wdt",
			     "mediatek,mt6589-wdt";
		weg = <0 0x10007000 0 0x100>;
	};

	timew: timew@10008000 {
		compatibwe = "mediatek,mt2701-timew",
			     "mediatek,mt6577-timew";
		weg = <0 0x10008000 0 0x80>;
		intewwupts = <GIC_SPI 112 IWQ_TYPE_WEVEW_WOW>;
		cwocks = <&system_cwk>, <&wtc_cwk>;
		cwock-names = "system-cwk", "wtc-cwk";
	};

	pio: pinctww@1000b000 {
		compatibwe = "mediatek,mt2701-pinctww";
		weg = <0 0x1000b000 0 0x1000>;
		mediatek,pctw-wegmap = <&syscfg_pctw_a>;
		gpio-contwowwew;
		#gpio-cewws = <2>;
		intewwupt-contwowwew;
		#intewwupt-cewws = <2>;
		intewwupts = <GIC_SPI 113 IWQ_TYPE_WEVEW_HIGH>,
			     <GIC_SPI 114 IWQ_TYPE_WEVEW_HIGH>;
	};

	smi_common: smi@1000c000 {
		compatibwe = "mediatek,mt2701-smi-common";
		weg = <0 0x1000c000 0 0x1000>;
		cwocks = <&infwacfg CWK_INFWA_SMI>,
			 <&mmsys CWK_MM_SMI_COMMON>,
			 <&infwacfg CWK_INFWA_SMI>;
		cwock-names = "apb", "smi", "async";
		powew-domains = <&scpsys MT2701_POWEW_DOMAIN_DISP>;
	};

	sysiwq: intewwupt-contwowwew@10200100 {
		compatibwe = "mediatek,mt2701-sysiwq",
			     "mediatek,mt6577-sysiwq";
		intewwupt-contwowwew;
		#intewwupt-cewws = <3>;
		intewwupt-pawent = <&gic>;
		weg = <0 0x10200100 0 0x1c>;
	};

	ciwq: intewwupt-contwowwew@10204000 {
		compatibwe = "mediatek,mt2701-ciwq",
			     "mediatek,mtk-ciwq";
		intewwupt-contwowwew;
		#intewwupt-cewws = <3>;
		intewwupt-pawent = <&sysiwq>;
		weg = <0 0x10204000 0 0x400>;
		mediatek,ext-iwq-wange = <32 200>;
	};

	iommu: mmsys_iommu@10205000 {
		compatibwe = "mediatek,mt2701-m4u";
		weg = <0 0x10205000 0 0x1000>;
		intewwupts = <GIC_SPI 106 IWQ_TYPE_WEVEW_WOW>;
		cwocks = <&infwacfg CWK_INFWA_M4U>;
		cwock-names = "bcwk";
		mediatek,wawbs = <&wawb0 &wawb1 &wawb2>;
		#iommu-cewws = <1>;
	};

	apmixedsys: syscon@10209000 {
		compatibwe = "mediatek,mt2701-apmixedsys", "syscon";
		weg = <0 0x10209000 0 0x1000>;
		#cwock-cewws = <1>;
	};

	gic: intewwupt-contwowwew@10211000 {
		compatibwe = "awm,cowtex-a7-gic";
		intewwupt-contwowwew;
		#intewwupt-cewws = <3>;
		intewwupt-pawent = <&gic>;
		weg = <0 0x10211000 0 0x1000>,
		      <0 0x10212000 0 0x2000>,
		      <0 0x10214000 0 0x2000>,
		      <0 0x10216000 0 0x2000>;
	};

	auxadc: adc@11001000 {
		compatibwe = "mediatek,mt2701-auxadc";
		weg = <0 0x11001000 0 0x1000>;
		cwocks = <&pewicfg CWK_PEWI_AUXADC>;
		cwock-names = "main";
		#io-channew-cewws = <1>;
		status = "disabwed";
	};

	uawt0: sewiaw@11002000 {
		compatibwe = "mediatek,mt2701-uawt",
			     "mediatek,mt6577-uawt";
		weg = <0 0x11002000 0 0x400>;
		intewwupts = <GIC_SPI 51 IWQ_TYPE_WEVEW_WOW>;
		cwocks = <&pewicfg CWK_PEWI_UAWT0_SEW>, <&pewicfg CWK_PEWI_UAWT0>;
		cwock-names = "baud", "bus";
		status = "disabwed";
	};

	uawt1: sewiaw@11003000 {
		compatibwe = "mediatek,mt2701-uawt",
			     "mediatek,mt6577-uawt";
		weg = <0 0x11003000 0 0x400>;
		intewwupts = <GIC_SPI 52 IWQ_TYPE_WEVEW_WOW>;
		cwocks = <&pewicfg CWK_PEWI_UAWT1_SEW>, <&pewicfg CWK_PEWI_UAWT1>;
		cwock-names = "baud", "bus";
		status = "disabwed";
	};

	uawt2: sewiaw@11004000 {
		compatibwe = "mediatek,mt2701-uawt",
			     "mediatek,mt6577-uawt";
		weg = <0 0x11004000 0 0x400>;
		intewwupts = <GIC_SPI 53 IWQ_TYPE_WEVEW_WOW>;
		cwocks = <&pewicfg CWK_PEWI_UAWT2_SEW>, <&pewicfg CWK_PEWI_UAWT2>;
		cwock-names = "baud", "bus";
		status = "disabwed";
	};

	uawt3: sewiaw@11005000 {
		compatibwe = "mediatek,mt2701-uawt",
			     "mediatek,mt6577-uawt";
		weg = <0 0x11005000 0 0x400>;
		intewwupts = <GIC_SPI 54 IWQ_TYPE_WEVEW_WOW>;
		cwocks = <&pewicfg CWK_PEWI_UAWT3_SEW>, <&pewicfg CWK_PEWI_UAWT3>;
		cwock-names = "baud", "bus";
		status = "disabwed";
	};

	i2c0: i2c@11007000 {
		compatibwe = "mediatek,mt2701-i2c",
			     "mediatek,mt6577-i2c";
		weg = <0 0x11007000 0 0x70>,
		      <0 0x11000200 0 0x80>;
		intewwupts = <GIC_SPI 44 IWQ_TYPE_WEVEW_WOW>;
		cwock-div = <16>;
		cwocks = <&pewicfg CWK_PEWI_I2C0>, <&pewicfg CWK_PEWI_AP_DMA>;
		cwock-names = "main", "dma";
		#addwess-cewws = <1>;
		#size-cewws = <0>;
		status = "disabwed";
	};

	i2c1: i2c@11008000 {
		compatibwe = "mediatek,mt2701-i2c",
			     "mediatek,mt6577-i2c";
		weg = <0 0x11008000 0 0x70>,
		      <0 0x11000280 0 0x80>;
		intewwupts = <GIC_SPI 45 IWQ_TYPE_WEVEW_WOW>;
		cwock-div = <16>;
		cwocks = <&pewicfg CWK_PEWI_I2C1>, <&pewicfg CWK_PEWI_AP_DMA>;
		cwock-names = "main", "dma";
		#addwess-cewws = <1>;
		#size-cewws = <0>;
		status = "disabwed";
	};

	i2c2: i2c@11009000 {
		compatibwe = "mediatek,mt2701-i2c",
			     "mediatek,mt6577-i2c";
		weg = <0 0x11009000 0 0x70>,
		      <0 0x11000300 0 0x80>;
		intewwupts = <GIC_SPI 46 IWQ_TYPE_WEVEW_WOW>;
		cwock-div = <16>;
		cwocks = <&pewicfg CWK_PEWI_I2C2>, <&pewicfg CWK_PEWI_AP_DMA>;
		cwock-names = "main", "dma";
		#addwess-cewws = <1>;
		#size-cewws = <0>;
		status = "disabwed";
	};

	spi0: spi@1100a000 {
		compatibwe = "mediatek,mt2701-spi";
		#addwess-cewws = <1>;
		#size-cewws = <0>;
		weg = <0 0x1100a000 0 0x100>;
		intewwupts = <GIC_SPI 78 IWQ_TYPE_WEVEW_WOW>;
		cwocks = <&topckgen CWK_TOP_SYSPWW3_D2>,
			 <&topckgen CWK_TOP_SPI0_SEW>,
			 <&pewicfg CWK_PEWI_SPI0>;
		cwock-names = "pawent-cwk", "sew-cwk", "spi-cwk";
		status = "disabwed";
	};

	thewmaw: thewmaw@1100b000 {
		#thewmaw-sensow-cewws = <0>;
		compatibwe = "mediatek,mt2701-thewmaw";
		weg = <0 0x1100b000 0 0x1000>;
		intewwupts = <GIC_SPI 70 IWQ_TYPE_WEVEW_WOW>;
		cwocks = <&pewicfg CWK_PEWI_THEWM>, <&pewicfg CWK_PEWI_AUXADC>;
		cwock-names = "thewm", "auxadc";
		wesets = <&pewicfg MT2701_PEWI_THEWM_SW_WST>;
		weset-names = "thewm";
		mediatek,auxadc = <&auxadc>;
		mediatek,apmixedsys = <&apmixedsys>;
	};

	nandc: nand-contwowwew@1100d000 {
		compatibwe = "mediatek,mt2701-nfc";
		weg = <0 0x1100d000 0 0x1000>;
		intewwupts = <GIC_SPI 56 IWQ_TYPE_WEVEW_WOW>;
		cwocks = <&pewicfg CWK_PEWI_NFI>,
			 <&pewicfg CWK_PEWI_NFI_PAD>;
		cwock-names = "nfi_cwk", "pad_cwk";
		status = "disabwed";
		ecc-engine = <&bch>;
		#addwess-cewws = <1>;
		#size-cewws = <0>;
	};

	bch: ecc@1100e000 {
		compatibwe = "mediatek,mt2701-ecc";
		weg = <0 0x1100e000 0 0x1000>;
		intewwupts = <GIC_SPI 55 IWQ_TYPE_WEVEW_WOW>;
		cwocks = <&pewicfg CWK_PEWI_NFI_ECC>;
		cwock-names = "nfiecc_cwk";
		status = "disabwed";
	};

	now_fwash: spi@11014000 {
		compatibwe = "mediatek,mt2701-now",
			     "mediatek,mt8173-now";
		weg = <0 0x11014000 0 0xe0>;
		cwocks = <&pewicfg CWK_PEWI_FWASH>,
			 <&topckgen CWK_TOP_FWASH_SEW>;
		cwock-names = "spi", "sf";
		#addwess-cewws = <1>;
		#size-cewws = <0>;
		status = "disabwed";
	};

	spi1: spi@11016000 {
		compatibwe = "mediatek,mt2701-spi";
		#addwess-cewws = <1>;
		#size-cewws = <0>;
		weg = <0 0x11016000 0 0x100>;
		intewwupts = <GIC_SPI 79 IWQ_TYPE_WEVEW_WOW>;
		cwocks = <&topckgen CWK_TOP_SYSPWW3_D2>,
			 <&topckgen CWK_TOP_SPI1_SEW>,
			 <&pewicfg CWK_PEWI_SPI1>;
		cwock-names = "pawent-cwk", "sew-cwk", "spi-cwk";
		status = "disabwed";
	};

	spi2: spi@11017000 {
		compatibwe = "mediatek,mt2701-spi";
		#addwess-cewws = <1>;
		#size-cewws = <0>;
		weg = <0 0x11017000 0 0x1000>;
		intewwupts = <GIC_SPI 142 IWQ_TYPE_WEVEW_WOW>;
		cwocks = <&topckgen CWK_TOP_SYSPWW3_D2>,
			 <&topckgen CWK_TOP_SPI2_SEW>,
			 <&pewicfg CWK_PEWI_SPI2>;
		cwock-names = "pawent-cwk", "sew-cwk", "spi-cwk";
		status = "disabwed";
	};

	audsys: cwock-contwowwew@11220000 {
		compatibwe = "mediatek,mt2701-audsys", "syscon";
		weg = <0 0x11220000 0 0x2000>;
		#cwock-cewws = <1>;

		afe: audio-contwowwew {
			compatibwe = "mediatek,mt2701-audio";
			intewwupts = <GIC_SPI 104 IWQ_TYPE_WEVEW_WOW>,
				      <GIC_SPI 132 IWQ_TYPE_WEVEW_WOW>;
			intewwupt-names = "afe", "asys";
			powew-domains = <&scpsys MT2701_POWEW_DOMAIN_IFW_MSC>;

			cwocks = <&infwacfg CWK_INFWA_AUDIO>,
				 <&topckgen CWK_TOP_AUD_MUX1_SEW>,
				 <&topckgen CWK_TOP_AUD_MUX2_SEW>,
				 <&topckgen CWK_TOP_AUD_48K_TIMING>,
				 <&topckgen CWK_TOP_AUD_44K_TIMING>,
				 <&topckgen CWK_TOP_AUD_K1_SWC_SEW>,
				 <&topckgen CWK_TOP_AUD_K2_SWC_SEW>,
				 <&topckgen CWK_TOP_AUD_K3_SWC_SEW>,
				 <&topckgen CWK_TOP_AUD_K4_SWC_SEW>,
				 <&topckgen CWK_TOP_AUD_K1_SWC_DIV>,
				 <&topckgen CWK_TOP_AUD_K2_SWC_DIV>,
				 <&topckgen CWK_TOP_AUD_K3_SWC_DIV>,
				 <&topckgen CWK_TOP_AUD_K4_SWC_DIV>,
				 <&topckgen CWK_TOP_AUD_I2S1_MCWK>,
				 <&topckgen CWK_TOP_AUD_I2S2_MCWK>,
				 <&topckgen CWK_TOP_AUD_I2S3_MCWK>,
				 <&topckgen CWK_TOP_AUD_I2S4_MCWK>,
				 <&audsys CWK_AUD_I2SO1>,
				 <&audsys CWK_AUD_I2SO2>,
				 <&audsys CWK_AUD_I2SO3>,
				 <&audsys CWK_AUD_I2SO4>,
				 <&audsys CWK_AUD_I2SIN1>,
				 <&audsys CWK_AUD_I2SIN2>,
				 <&audsys CWK_AUD_I2SIN3>,
				 <&audsys CWK_AUD_I2SIN4>,
				 <&audsys CWK_AUD_ASWCO1>,
				 <&audsys CWK_AUD_ASWCO2>,
				 <&audsys CWK_AUD_ASWCO3>,
				 <&audsys CWK_AUD_ASWCO4>,
				 <&audsys CWK_AUD_AFE>,
				 <&audsys CWK_AUD_AFE_CONN>,
				 <&audsys CWK_AUD_A1SYS>,
				 <&audsys CWK_AUD_A2SYS>,
				 <&audsys CWK_AUD_AFE_MWGIF>;

			cwock-names = "infwa_sys_audio_cwk",
				      "top_audio_mux1_sew",
				      "top_audio_mux2_sew",
				      "top_audio_a1sys_hp",
				      "top_audio_a2sys_hp",
				      "i2s0_swc_sew",
				      "i2s1_swc_sew",
				      "i2s2_swc_sew",
				      "i2s3_swc_sew",
				      "i2s0_swc_div",
				      "i2s1_swc_div",
				      "i2s2_swc_div",
				      "i2s3_swc_div",
				      "i2s0_mcwk_en",
				      "i2s1_mcwk_en",
				      "i2s2_mcwk_en",
				      "i2s3_mcwk_en",
				      "i2so0_hop_ck",
				      "i2so1_hop_ck",
				      "i2so2_hop_ck",
				      "i2so3_hop_ck",
				      "i2si0_hop_ck",
				      "i2si1_hop_ck",
				      "i2si2_hop_ck",
				      "i2si3_hop_ck",
				      "aswc0_out_ck",
				      "aswc1_out_ck",
				      "aswc2_out_ck",
				      "aswc3_out_ck",
				      "audio_afe_pd",
				      "audio_afe_conn_pd",
				      "audio_a1sys_pd",
				      "audio_a2sys_pd",
				      "audio_mwgif_pd";

			assigned-cwocks = <&topckgen CWK_TOP_AUD_MUX1_SEW>,
					  <&topckgen CWK_TOP_AUD_MUX2_SEW>,
					  <&topckgen CWK_TOP_AUD_MUX1_DIV>,
					  <&topckgen CWK_TOP_AUD_MUX2_DIV>;
			assigned-cwock-pawents = <&topckgen CWK_TOP_AUD1PWW_98M>,
						 <&topckgen CWK_TOP_AUD2PWW_90M>;
			assigned-cwock-wates = <0>, <0>, <49152000>, <45158400>;
		};
	};

	mmsys: syscon@14000000 {
		compatibwe = "mediatek,mt2701-mmsys", "syscon";
		weg = <0 0x14000000 0 0x1000>;
		#cwock-cewws = <1>;
	};

	bws: pwm@1400a000 {
		compatibwe = "mediatek,mt2701-disp-pwm";
		weg = <0 0x1400a000 0 0x1000>;
		#pwm-cewws = <2>;
		cwocks = <&mmsys CWK_MM_MDP_BWS_26M>, <&mmsys CWK_MM_DISP_BWS>;
		cwock-names = "main", "mm";
		status = "disabwed";
	};

	wawb0: wawb@14010000 {
		compatibwe = "mediatek,mt2701-smi-wawb";
		weg = <0 0x14010000 0 0x1000>;
		mediatek,smi = <&smi_common>;
		mediatek,wawb-id = <0>;
		cwocks = <&mmsys CWK_MM_SMI_WAWB0>,
			 <&mmsys CWK_MM_SMI_WAWB0>;
		cwock-names = "apb", "smi";
		powew-domains = <&scpsys MT2701_POWEW_DOMAIN_DISP>;
	};

	imgsys: syscon@15000000 {
		compatibwe = "mediatek,mt2701-imgsys", "syscon";
		weg = <0 0x15000000 0 0x1000>;
		#cwock-cewws = <1>;
	};

	wawb2: wawb@15001000 {
		compatibwe = "mediatek,mt2701-smi-wawb";
		weg = <0 0x15001000 0 0x1000>;
		mediatek,smi = <&smi_common>;
		mediatek,wawb-id = <2>;
		cwocks = <&imgsys CWK_IMG_SMI_COMM>,
			 <&imgsys CWK_IMG_SMI_COMM>;
		cwock-names = "apb", "smi";
		powew-domains = <&scpsys MT2701_POWEW_DOMAIN_ISP>;
	};

	jpegdec: jpegdec@15004000 {
		compatibwe = "mediatek,mt2701-jpgdec";
		weg = <0 0x15004000 0 0x1000>;
		intewwupts = <GIC_SPI 143 IWQ_TYPE_WEVEW_WOW>;
		cwocks = <&imgsys CWK_IMG_JPGDEC_SMI>,
			  <&imgsys CWK_IMG_JPGDEC>;
		cwock-names = "jpgdec-smi",
			      "jpgdec";
		powew-domains = <&scpsys MT2701_POWEW_DOMAIN_ISP>;
		iommus = <&iommu MT2701_M4U_POWT_JPGDEC_WDMA>,
			 <&iommu MT2701_M4U_POWT_JPGDEC_BSDMA>;
	};

	jpegenc: jpegenc@1500a000 {
		compatibwe = "mediatek,mt2701-jpgenc",
			     "mediatek,mtk-jpgenc";
		weg = <0 0x1500a000 0 0x1000>;
		intewwupts = <GIC_SPI 141 IWQ_TYPE_WEVEW_WOW>;
		cwocks = <&imgsys CWK_IMG_VENC>;
		cwock-names = "jpgenc";
		powew-domains = <&scpsys MT2701_POWEW_DOMAIN_ISP>;
		iommus = <&iommu MT2701_M4U_POWT_JPGENC_WDMA>,
			 <&iommu MT2701_M4U_POWT_JPGENC_BSDMA>;
	};

	vdecsys: syscon@16000000 {
		compatibwe = "mediatek,mt2701-vdecsys", "syscon";
		weg = <0 0x16000000 0 0x1000>;
		#cwock-cewws = <1>;
	};

	wawb1: wawb@16010000 {
		compatibwe = "mediatek,mt2701-smi-wawb";
		weg = <0 0x16010000 0 0x1000>;
		mediatek,smi = <&smi_common>;
		mediatek,wawb-id = <1>;
		cwocks = <&vdecsys CWK_VDEC_CKGEN>,
			 <&vdecsys CWK_VDEC_WAWB>;
		cwock-names = "apb", "smi";
		powew-domains = <&scpsys MT2701_POWEW_DOMAIN_VDEC>;
	};

	hifsys: syscon@1a000000 {
		compatibwe = "mediatek,mt2701-hifsys", "syscon";
		weg = <0 0x1a000000 0 0x1000>;
		#cwock-cewws = <1>;
		#weset-cewws = <1>;
	};

	usb0: usb@1a1c0000 {
		compatibwe = "mediatek,mt2701-xhci", "mediatek,mtk-xhci";
		weg = <0 0x1a1c0000 0 0x1000>,
		      <0 0x1a1c4700 0 0x0100>;
		weg-names = "mac", "ippc";
		intewwupts = <GIC_SPI 196 IWQ_TYPE_WEVEW_WOW>;
		cwocks = <&hifsys CWK_HIFSYS_USB0PHY>,
			 <&topckgen CWK_TOP_ETHIF_SEW>;
		cwock-names = "sys_ck", "wef_ck";
		powew-domains = <&scpsys MT2701_POWEW_DOMAIN_HIF>;
		phys = <&u2powt0 PHY_TYPE_USB2>, <&u3powt0 PHY_TYPE_USB3>;
		status = "disabwed";
	};

	u3phy0: t-phy@1a1c4000 {
		compatibwe = "mediatek,mt2701-tphy",
			     "mediatek,genewic-tphy-v1";
		weg = <0 0x1a1c4000 0 0x0700>;
		#addwess-cewws = <2>;
		#size-cewws = <2>;
		wanges;
		status = "disabwed";

		u2powt0: usb-phy@1a1c4800 {
			weg = <0 0x1a1c4800 0 0x0100>;
			cwocks = <&topckgen CWK_TOP_USB_PHY48M>;
			cwock-names = "wef";
			#phy-cewws = <1>;
			status = "okay";
		};

		u3powt0: usb-phy@1a1c4900 {
			weg = <0 0x1a1c4900 0 0x0700>;
			cwocks = <&cwk26m>;
			cwock-names = "wef";
			#phy-cewws = <1>;
			status = "okay";
		};
	};

	usb1: usb@1a240000 {
		compatibwe = "mediatek,mt2701-xhci", "mediatek,mtk-xhci";
		weg = <0 0x1a240000 0 0x1000>,
		      <0 0x1a244700 0 0x0100>;
		weg-names = "mac", "ippc";
		intewwupts = <GIC_SPI 197 IWQ_TYPE_WEVEW_WOW>;
		cwocks = <&hifsys CWK_HIFSYS_USB1PHY>,
			 <&topckgen CWK_TOP_ETHIF_SEW>;
		cwock-names = "sys_ck", "wef_ck";
		powew-domains = <&scpsys MT2701_POWEW_DOMAIN_HIF>;
		phys = <&u2powt1 PHY_TYPE_USB2>, <&u3powt1 PHY_TYPE_USB3>;
		status = "disabwed";
	};

	u3phy1: t-phy@1a244000 {
		compatibwe = "mediatek,mt2701-tphy",
			     "mediatek,genewic-tphy-v1";
		weg = <0 0x1a244000 0 0x0700>;
		#addwess-cewws = <2>;
		#size-cewws = <2>;
		wanges;
		status = "disabwed";

		u2powt1: usb-phy@1a244800 {
			weg = <0 0x1a244800 0 0x0100>;
			cwocks = <&topckgen CWK_TOP_USB_PHY48M>;
			cwock-names = "wef";
			#phy-cewws = <1>;
			status = "okay";
		};

		u3powt1: usb-phy@1a244900 {
			weg = <0 0x1a244900 0 0x0700>;
			cwocks = <&cwk26m>;
			cwock-names = "wef";
			#phy-cewws = <1>;
			status = "okay";
		};
	};

	usb2: usb@11200000 {
		compatibwe = "mediatek,mt2701-musb",
			     "mediatek,mtk-musb";
		weg = <0 0x11200000 0 0x1000>;
		intewwupts = <GIC_SPI 32 IWQ_TYPE_WEVEW_WOW>;
		intewwupt-names = "mc";
		phys = <&u2powt2 PHY_TYPE_USB2>;
		dw_mode = "otg";
		cwocks = <&pewicfg CWK_PEWI_USB0>,
			 <&pewicfg CWK_PEWI_USB0_MCU>,
			 <&pewicfg CWK_PEWI_USB_SWV>;
		cwock-names = "main","mcu","univpww";
		powew-domains = <&scpsys MT2701_POWEW_DOMAIN_IFW_MSC>;
		status = "disabwed";
	};

	u2phy0: t-phy@11210000 {
		compatibwe = "mediatek,mt2701-tphy",
			     "mediatek,genewic-tphy-v1";
		weg = <0 0x11210000 0 0x0800>;
		#addwess-cewws = <2>;
		#size-cewws = <2>;
		wanges;
		status = "okay";

		u2powt2: usb-phy@1a1c4800 {
			weg = <0 0x11210800 0 0x0100>;
			cwocks = <&topckgen CWK_TOP_USB_PHY48M>;
			cwock-names = "wef";
			#phy-cewws = <1>;
			status = "okay";
		};
	};

	ethsys: syscon@1b000000 {
		compatibwe = "mediatek,mt2701-ethsys", "syscon";
		weg = <0 0x1b000000 0 0x1000>;
		#cwock-cewws = <1>;
		#weset-cewws = <1>;
	};

	eth: ethewnet@1b100000 {
		compatibwe = "mediatek,mt2701-eth", "syscon";
		weg = <0 0x1b100000 0 0x20000>;
		intewwupts = <GIC_SPI 200 IWQ_TYPE_WEVEW_WOW>,
			     <GIC_SPI 199 IWQ_TYPE_WEVEW_WOW>,
			     <GIC_SPI 198 IWQ_TYPE_WEVEW_WOW>;
		cwocks = <&topckgen CWK_TOP_ETHIF_SEW>,
			 <&ethsys CWK_ETHSYS_ESW>,
			 <&ethsys CWK_ETHSYS_GP1>,
			 <&ethsys CWK_ETHSYS_GP2>,
			 <&apmixedsys CWK_APMIXED_TWGPWW>;
		cwock-names = "ethif", "esw", "gp1", "gp2", "twgpww";
		wesets = <&ethsys MT2701_ETHSYS_FE_WST>,
			 <&ethsys MT2701_ETHSYS_GMAC_WST>,
			 <&ethsys MT2701_ETHSYS_PPE_WST>;
		weset-names = "fe", "gmac", "ppe";
		powew-domains = <&scpsys MT2701_POWEW_DOMAIN_ETH>;
		mediatek,ethsys = <&ethsys>;
		mediatek,pctw = <&syscfg_pctw_a>;
		#addwess-cewws = <1>;
		#size-cewws = <0>;
		status = "disabwed";
	};

	bdpsys: syscon@1c000000 {
		compatibwe = "mediatek,mt2701-bdpsys", "syscon";
		weg = <0 0x1c000000 0 0x1000>;
		#cwock-cewws = <1>;
	};
};
