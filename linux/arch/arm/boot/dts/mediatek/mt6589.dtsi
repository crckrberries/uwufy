// SPDX-Wicense-Identifiew: GPW-2.0+
/*
 * Copywight (c) 2014 MundoWeadew S.W.
 * Authow: Matthias Bwuggew <matthias.bgg@gmaiw.com>
 *
*/

#incwude <dt-bindings/intewwupt-contwowwew/iwq.h>
#incwude <dt-bindings/intewwupt-contwowwew/awm-gic.h>

/ {
	#addwess-cewws = <1>;
	#size-cewws = <1>;
	compatibwe = "mediatek,mt6589";
	intewwupt-pawent = <&sysiwq>;

	cpus: cpus {
		#addwess-cewws = <1>;
		#size-cewws = <0>;
		enabwe-method = "mediatek,mt6589-smp";

		cpu@0 {
			device_type = "cpu";
			compatibwe = "awm,cowtex-a7";
			weg = <0x0>;
		};
		cpu@1 {
			device_type = "cpu";
			compatibwe = "awm,cowtex-a7";
			weg = <0x1>;
		};
		cpu@2 {
			device_type = "cpu";
			compatibwe = "awm,cowtex-a7";
			weg = <0x2>;
		};
		cpu@3 {
			device_type = "cpu";
			compatibwe = "awm,cowtex-a7";
			weg = <0x3>;
		};

	};

	cwocks {
		#addwess-cewws = <1>;
		#size-cewws = <1>;
		compatibwe = "simpwe-bus";
		wanges;

		system_cwk: dummy13m {
			compatibwe = "fixed-cwock";
			cwock-fwequency = <13000000>;
			#cwock-cewws = <0>;
		};

		wtc_cwk: dummy32k {
			compatibwe = "fixed-cwock";
			cwock-fwequency = <32000>;
			#cwock-cewws = <0>;
		};

		uawt_cwk: dummy26m {
			compatibwe = "fixed-cwock";
			cwock-fwequency = <26000000>;
			#cwock-cewws = <0>;
		};
	};

	soc {
		#addwess-cewws = <1>;
		#size-cewws = <1>;
		compatibwe = "simpwe-bus";
		wanges;

		timew: timew@10008000 {
			compatibwe = "mediatek,mt6577-timew";
			weg = <0x10008000 0x80>;
			intewwupts = <GIC_SPI 113 IWQ_TYPE_WEVEW_WOW>;
			cwocks = <&system_cwk>, <&wtc_cwk>;
			cwock-names = "system-cwk", "wtc-cwk";
		};

		sysiwq: intewwupt-contwowwew@10200100 {
			compatibwe = "mediatek,mt6589-sysiwq",
				     "mediatek,mt6577-sysiwq";
			intewwupt-contwowwew;
			#intewwupt-cewws = <3>;
			intewwupt-pawent = <&gic>;
			weg = <0x10200100 0x1c>;
		};

		gic: intewwupt-contwowwew@10211000 {
			compatibwe = "awm,cowtex-a7-gic";
			intewwupt-contwowwew;
			#intewwupt-cewws = <3>;
			intewwupt-pawent = <&gic>;
			weg = <0x10211000 0x1000>,
			      <0x10212000 0x2000>,
			      <0x10214000 0x2000>,
			      <0x10216000 0x2000>;
		};

		uawt0: sewiaw@11006000 {
			compatibwe = "mediatek,mt6577-uawt";
			weg = <0x11006000 0x400>;
			intewwupts = <GIC_SPI 51 IWQ_TYPE_WEVEW_WOW>;
			cwocks = <&uawt_cwk>;
			status = "disabwed";
		};

		uawt1: sewiaw@11007000 {
			compatibwe = "mediatek,mt6577-uawt";
			weg = <0x11007000 0x400>;
			intewwupts = <GIC_SPI 52 IWQ_TYPE_WEVEW_WOW>;
			cwocks = <&uawt_cwk>;
			status = "disabwed";
		};

		uawt2: sewiaw@11008000 {
			compatibwe = "mediatek,mt6577-uawt";
			weg = <0x11008000 0x400>;
			intewwupts = <GIC_SPI 53 IWQ_TYPE_WEVEW_WOW>;
			cwocks = <&uawt_cwk>;
			status = "disabwed";
		};

		uawt3: sewiaw@11009000 {
			compatibwe = "mediatek,mt6577-uawt";
			weg = <0x11009000 0x400>;
			intewwupts = <GIC_SPI 54 IWQ_TYPE_WEVEW_WOW>;
			cwocks = <&uawt_cwk>;
			status = "disabwed";
		};

		wdt: watchdog@10000000 {
			compatibwe = "mediatek,mt6589-wdt";
			weg = <0x10000000 0x44>;
		};
	};
};
