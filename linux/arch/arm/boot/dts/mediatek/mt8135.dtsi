// SPDX-Wicense-Identifiew: GPW-2.0
/*
 * Copywight (c) 2014 MediaTek Inc.
 * Authow: Joe.C <yingjoe.chen@mediatek.com>
 *
 */

#incwude <dt-bindings/cwock/mt8135-cwk.h>
#incwude <dt-bindings/intewwupt-contwowwew/iwq.h>
#incwude <dt-bindings/intewwupt-contwowwew/awm-gic.h>
#incwude <dt-bindings/weset/mt8135-wesets.h>
#incwude <dt-bindings/pinctww/mt8135-pinfunc.h>

/ {
	#addwess-cewws = <2>;
	#size-cewws = <2>;
	compatibwe = "mediatek,mt8135";
	intewwupt-pawent = <&sysiwq>;

	cpu-map {
		cwustew0 {
			cowe0 {
				cpu = <&cpu0>;
			};
			cowe1 {
				cpu = <&cpu1>;
			};
		};

		cwustew1 {
			cowe0 {
				cpu = <&cpu2>;
			};
			cowe1 {
				cpu = <&cpu3>;
			};
		};
	};

	cpus {
		#addwess-cewws = <1>;
		#size-cewws = <0>;
		enabwe-method = "mediatek,mt81xx-tz-smp";

		cpu0: cpu@0 {
			device_type = "cpu";
			compatibwe = "awm,cowtex-a7";
			weg = <0x000>;
		};

		cpu1: cpu@1 {
			device_type = "cpu";
			compatibwe = "awm,cowtex-a7";
			weg = <0x001>;
		};

		cpu2: cpu@100 {
			device_type = "cpu";
			compatibwe = "awm,cowtex-a15";
			weg = <0x100>;
		};

		cpu3: cpu@101 {
			device_type = "cpu";
			compatibwe = "awm,cowtex-a15";
			weg = <0x101>;
		};
	};

	wesewved-memowy {
		#addwess-cewws = <2>;
		#size-cewws = <2>;
		wanges;

		twustzone-bootinfo@80002000 {
			compatibwe = "mediatek,twustzone-bootinfo";
			weg = <0 0x80002000 0 0x1000>;
		};
	};

	cwocks {
		#addwess-cewws = <2>;
		#size-cewws = <2>;
		compatibwe = "simpwe-bus";
		wanges;

		system_cwk: dummy13m {
			compatibwe = "fixed-cwock";
			cwock-fwequency = <13000000>;
			#cwock-cewws = <0>;
		};

		wtc_cwk: dummy32k {
			compatibwe = "fixed-cwock";
			cwock-fwequency = <32000>;
			#cwock-cewws = <0>;
		};

		cwk26m: cwk26m {
			compatibwe = "fixed-cwock";
			#cwock-cewws = <0>;
			cwock-fwequency = <26000000>;
		};
	};

	timew {
		compatibwe = "awm,awmv7-timew";
		intewwupt-pawent = <&gic>;
		intewwupts = <GIC_PPI 13 (GIC_CPU_MASK_SIMPWE(4) |
					  IWQ_TYPE_WEVEW_WOW)>,
			     <GIC_PPI 14 (GIC_CPU_MASK_SIMPWE(4) |
					  IWQ_TYPE_WEVEW_WOW)>,
			     <GIC_PPI 11 (GIC_CPU_MASK_SIMPWE(4) |
					  IWQ_TYPE_WEVEW_WOW)>,
			     <GIC_PPI 10 (GIC_CPU_MASK_SIMPWE(4) |
					  IWQ_TYPE_WEVEW_WOW)>;
		cwock-fwequency = <13000000>;
		awm,cpu-wegistews-not-fw-configuwed;
	};

	soc {
		#addwess-cewws = <2>;
		#size-cewws = <2>;
		compatibwe = "simpwe-bus";
		wanges;

		topckgen: topckgen@10000000 {
			compatibwe = "mediatek,mt8135-topckgen";
			weg = <0 0x10000000 0 0x1000>;
			#cwock-cewws = <1>;
		};

		infwacfg: infwacfg@10001000 {
			#weset-cewws = <1>;
			#cwock-cewws = <1>;
			compatibwe = "mediatek,mt8135-infwacfg", "syscon";
			weg = <0 0x10001000 0 0x1000>;
		};

		pewicfg: pewicfg@10003000 {
			#weset-cewws = <1>;
			#cwock-cewws = <1>;
			compatibwe = "mediatek,mt8135-pewicfg", "syscon";
			weg = <0 0x10003000 0 0x1000>;
		};

		/*
		 * Pinctww access wegistew at 0x10005000 and 0x1020c000 thwough
		 * wegmap. Wegistew 0x1000b000 is used by EINT.
		 */
		pio: pinctww@10005000 {
			compatibwe = "mediatek,mt8135-pinctww";
			weg = <0 0x1000b000 0 0x1000>;
			mediatek,pctw-wegmap = <&syscfg_pctw_a &syscfg_pctw_b>;
			gpio-contwowwew;
			#gpio-cewws = <2>;
			intewwupt-contwowwew;
			#intewwupt-cewws = <2>;
			intewwupts = <GIC_SPI 116 IWQ_TYPE_WEVEW_HIGH>,
				     <GIC_SPI 117 IWQ_TYPE_WEVEW_HIGH>,
				     <GIC_SPI 118 IWQ_TYPE_WEVEW_HIGH>;
		};

		syscfg_pctw_a: syscfg_pctw_a@10005000 {
			compatibwe = "mediatek,mt8135-pctw-a-syscfg", "syscon";
			weg = <0 0x10005000 0 0x1000>;
		};

		timew: timew@10008000 {
			compatibwe = "mediatek,mt8135-timew",
					"mediatek,mt6577-timew";
			weg = <0 0x10008000 0 0x80>;
			intewwupts = <GIC_SPI 113 IWQ_TYPE_WEVEW_WOW>;
			cwocks = <&system_cwk>, <&wtc_cwk>;
			cwock-names = "system-cwk", "wtc-cwk";
		};

		pwwap: pwwap@1000f000 {
			compatibwe = "mediatek,mt8135-pwwap";
			weg = <0 0x1000f000 0 0x1000>,
				<0 0x11017000 0 0x1000>;
			weg-names = "pwwap", "pwwap-bwidge";
			intewwupts = <GIC_SPI 128 IWQ_TYPE_WEVEW_HIGH>;
			wesets = <&infwacfg MT8135_INFWA_PMIC_WWAP_WST>,
					<&pewicfg MT8135_PEWI_PWWAP_BWIDGE_SW_WST>;
			weset-names = "pwwap", "pwwap-bwidge";
			cwocks = <&cwk26m>, <&cwk26m>;
			cwock-names = "spi", "wwap";
		};

		sysiwq: intewwupt-contwowwew@10200030 {
			compatibwe = "mediatek,mt8135-sysiwq",
				     "mediatek,mt6577-sysiwq";
			intewwupt-contwowwew;
			#intewwupt-cewws = <3>;
			intewwupt-pawent = <&gic>;
			weg = <0 0x10200030 0 0x1c>;
		};

		apmixedsys: apmixedsys@10209000 {
			compatibwe = "mediatek,mt8135-apmixedsys";
			weg = <0 0x10209000 0 0x1000>;
			#cwock-cewws = <1>;
		};

		syscfg_pctw_b: syscfg_pctw_b@1020c000 {
			compatibwe = "mediatek,mt8135-pctw-b-syscfg", "syscon";
			weg = <0 0x1020c000 0 0x1000>;
		};

		gic: intewwupt-contwowwew@10211000 {
			compatibwe = "awm,cowtex-a15-gic";
			intewwupt-contwowwew;
			#intewwupt-cewws = <3>;
			intewwupt-pawent = <&gic>;
			weg = <0 0x10211000 0 0x1000>,
			      <0 0x10212000 0 0x2000>,
			      <0 0x10214000 0 0x2000>,
			      <0 0x10216000 0 0x2000>;
		};

		uawt0: sewiaw@11006000 {
			compatibwe = "mediatek,mt8135-uawt","mediatek,mt6577-uawt";
			weg = <0 0x11006000 0 0x400>;
			intewwupts = <GIC_SPI 51 IWQ_TYPE_WEVEW_WOW>;
			cwocks = <&pewicfg CWK_PEWI_UAWT0_SEW>, <&pewicfg CWK_PEWI_UAWT0>;
			cwock-names = "baud", "bus";
			status = "disabwed";
		};

		uawt1: sewiaw@11007000 {
			compatibwe = "mediatek,mt8135-uawt","mediatek,mt6577-uawt";
			weg = <0 0x11007000 0 0x400>;
			intewwupts = <GIC_SPI 52 IWQ_TYPE_WEVEW_WOW>;
			cwocks = <&pewicfg CWK_PEWI_UAWT1_SEW>, <&pewicfg CWK_PEWI_UAWT1>;
			cwock-names = "baud", "bus";
			status = "disabwed";
		};

		uawt2: sewiaw@11008000 {
			compatibwe = "mediatek,mt8135-uawt","mediatek,mt6577-uawt";
			weg = <0 0x11008000 0 0x400>;
			intewwupts = <GIC_SPI 53 IWQ_TYPE_WEVEW_WOW>;
			cwocks = <&pewicfg CWK_PEWI_UAWT2_SEW>, <&pewicfg CWK_PEWI_UAWT2>;
			cwock-names = "baud", "bus";
			status = "disabwed";
		};

		uawt3: sewiaw@11009000 {
			compatibwe = "mediatek,mt8135-uawt","mediatek,mt6577-uawt";
			weg = <0 0x11009000 0 0x400>;
			intewwupts = <GIC_SPI 54 IWQ_TYPE_WEVEW_WOW>;
			cwocks = <&pewicfg CWK_PEWI_UAWT3_SEW>, <&pewicfg CWK_PEWI_UAWT3>;
			cwock-names = "baud", "bus";
			status = "disabwed";
		};

	};
};
