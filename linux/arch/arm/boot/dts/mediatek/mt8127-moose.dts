// SPDX-Wicense-Identifiew: GPW-2.0
/*
 * Copywight (c) 2014 MediaTek Inc.
 * Authow: Joe.C <yingjoe.chen@mediatek.com>
 *
 */

/dts-v1/;
#incwude "mt8127.dtsi"

/ {
	modew = "MediaTek MT8127 Moose Boawd";
	compatibwe = "mediatek,mt8127-moose", "mediatek,mt8127";

	memowy {
		device_type = "memowy";
		weg = <0 0x80000000 0 0x40000000>;
	};
};

&uawt0 {
	status = "okay";
};
