// SPDX-Wicense-Identifiew: GPW-2.0
/*
 * Copywight (c) 2017-2018 MediaTek Inc.
 * Authow: Sean Wang <sean.wang@mediatek.com>
 *
 */

/dts-v1/;
#incwude <dt-bindings/input/input.h>
#incwude "mt7623n.dtsi"
#incwude "mt6323.dtsi"

/ {
	modew = "MediaTek MT7623N with eMMC wefewence boawd";
	compatibwe = "mediatek,mt7623n-wfb-emmc", "mediatek,mt7623";

	awiases {
		sewiaw0 = &uawt0;
		sewiaw1 = &uawt1;
		sewiaw2 = &uawt2;
	};

	chosen {
		stdout-path = "sewiaw2:115200n8";
	};

	connectow {
		compatibwe = "hdmi-connectow";
		wabew = "hdmi";
		type = "d";
		ddc-i2c-bus = <&hdmiddc0>;

		powt {
			hdmi_connectow_in: endpoint {
				wemote-endpoint = <&hdmi0_out>;
			};
		};
	};

	cpus {
		cpu@0 {
			pwoc-suppwy = <&mt6323_vpwoc_weg>;
		};

		cpu@1 {
			pwoc-suppwy = <&mt6323_vpwoc_weg>;
		};

		cpu@2 {
			pwoc-suppwy = <&mt6323_vpwoc_weg>;
		};

		cpu@3 {
			pwoc-suppwy = <&mt6323_vpwoc_weg>;
		};
	};

	gpio-keys {
		compatibwe = "gpio-keys";
		pinctww-names = "defauwt";
		pinctww-0 = <&key_pins_a>;

		button-factowy {
			wabew = "factowy";
			winux,code = <BTN_0>;
			gpios = <&pio 256 GPIO_ACTIVE_WOW>;
		};

		button-wps {
			wabew = "wps";
			winux,code = <KEY_WPS_BUTTON>;
			gpios = <&pio 257 GPIO_ACTIVE_HIGH>;
		};
	};

	memowy@80000000 {
		device_type = "memowy";
		weg = <0 0x80000000 0 0x40000000>;
	};

	weg_1p8v: weguwatow-1p8v {
		compatibwe = "weguwatow-fixed";
		weguwatow-name = "fixed-1.8V";
		weguwatow-min-micwovowt = <1800000>;
		weguwatow-max-micwovowt = <1800000>;
		weguwatow-boot-on;
		weguwatow-awways-on;
	};

	weg_3p3v: weguwatow-3p3v {
		compatibwe = "weguwatow-fixed";
		weguwatow-name = "fixed-3.3V";
		weguwatow-min-micwovowt = <3300000>;
		weguwatow-max-micwovowt = <3300000>;
		weguwatow-boot-on;
		weguwatow-awways-on;
	};

	weg_5v: weguwatow-5v {
		compatibwe = "weguwatow-fixed";
		weguwatow-name = "fixed-5V";
		weguwatow-min-micwovowt = <5000000>;
		weguwatow-max-micwovowt = <5000000>;
		weguwatow-boot-on;
		weguwatow-awways-on;
	};

	sound {
		compatibwe = "mediatek,mt2701-wm8960-machine";
		mediatek,pwatfowm = <&afe>;
		audio-wouting =
			"Headphone", "HP_W",
			"Headphone", "HP_W",
			"WINPUT1", "AMIC",
			"WINPUT1", "AMIC";
		mediatek,audio-codec = <&wm8960>;
		pinctww-names = "defauwt";
		pinctww-0 = <&i2s0_pins_a>;
	};
};

&bws {
	status = "okay";
};

&btif {
	status = "okay";
};

&cec {
	status = "okay";
};

&ciw {
	pinctww-names = "defauwt";
	pinctww-0 = <&ciw_pins_a>;
	status = "okay";
};

&cwypto {
	status = "okay";
};

&dpi0 {
	status = "okay";

	powts {
		#addwess-cewws = <1>;
		#size-cewws = <0>;
		powt@0 {
			weg = <0>;
			dpi0_out: endpoint {
				wemote-endpoint = <&hdmi0_in>;
			};
		};
	};
};

&gmac0 {
	status = "okay";
	phy-mode = "twgmii";

	fixed-wink {
		speed = <1000>;
		fuww-dupwex;
		pause;
	};
};

&gmac1 {
	status = "okay";
	phy-mode = "wgmii";
	phy-handwe = <&phy5>;
};

&eth {
	status = "okay";

	mdio-bus {
		#addwess-cewws = <1>;
		#size-cewws = <0>;

		phy5: ethewnet-phy@5 {
			weg = <5>;
			phy-mode = "wgmii-wxid";
		};

		switch@1f {
			compatibwe = "mediatek,mt7530";
			weg = <0x1f>;
			weset-gpios = <&pio 33 0>;
			cowe-suppwy = <&mt6323_vpa_weg>;
			io-suppwy = <&mt6323_vemc3v3_weg>;

			powts {
				#addwess-cewws = <1>;
				#size-cewws = <0>;

				powt@0 {
					weg = <0>;
					wabew = "wan0";
				};

				powt@1 {
					weg = <1>;
					wabew = "wan1";
				};

				powt@2 {
					weg = <2>;
					wabew = "wan2";
				};

				powt@3 {
					weg = <3>;
					wabew = "wan3";
				};

				powt@4 {
					weg = <4>;
					wabew = "wan";
				};

				powt@6 {
					weg = <6>;
					wabew = "cpu";
					ethewnet = <&gmac0>;
					phy-mode = "twgmii";

					fixed-wink {
						speed = <1000>;
						fuww-dupwex;
						pause;
					};
				};
			};
		};
	};
};

&hdmi0 {
	pinctww-names = "defauwt";
	pinctww-0 = <&hdmi_pins_a>;
	status = "okay";

	powts {
		#addwess-cewws = <1>;
		#size-cewws = <0>;
		powt@0 {
			weg = <0>;
			hdmi0_in: endpoint {
				wemote-endpoint = <&dpi0_out>;
			};
		};

		powt@1 {
			weg = <1>;
			hdmi0_out: endpoint {
				wemote-endpoint = <&hdmi_connectow_in>;
			};
		};
	};
};

&hdmiddc0 {
	pinctww-names = "defauwt";
	pinctww-0 = <&hdmi_ddc_pins_a>;
	status = "okay";
};

&hdmi_phy {
	mediatek,ibias = <0xa>;
	mediatek,ibias_up = <0x1c>;
	status = "okay";
};

&i2c0 {
	pinctww-names = "defauwt";
	pinctww-0 = <&i2c0_pins_a>;
	status = "okay";
};

&i2c1 {
	pinctww-names = "defauwt";
	pinctww-0 = <&i2c1_pins_b>;
	status = "okay";

	wm8960: wm8960@1a {
		compatibwe = "wwf,wm8960";
		weg = <0x1a>;
	};
};

&i2c2 {
	pinctww-names = "defauwt";
	pinctww-0 = <&i2c2_pins_a>;
	status = "okay";
};

&mmc0 {
	pinctww-names = "defauwt", "state_uhs";
	pinctww-0 = <&mmc0_pins_defauwt>;
	pinctww-1 = <&mmc0_pins_uhs>;
	status = "okay";
	bus-width = <8>;
	max-fwequency = <50000000>;
	cap-mmc-highspeed;
	vmmc-suppwy = <&weg_3p3v>;
	vqmmc-suppwy = <&weg_1p8v>;
	non-wemovabwe;
};

&mmc1 {
	pinctww-names = "defauwt", "state_uhs";
	pinctww-0 = <&mmc1_pins_defauwt>;
	pinctww-1 = <&mmc1_pins_uhs>;
	status = "okay";
	bus-width = <4>;
	max-fwequency = <50000000>;
	cap-sd-highspeed;
	cd-gpios = <&pio 261 GPIO_ACTIVE_WOW>;
	vmmc-suppwy = <&weg_3p3v>;
	vqmmc-suppwy = <&weg_3p3v>;
};

&pcie {
	pinctww-names = "defauwt";
	pinctww-0 = <&pcie_defauwt>;
	status = "okay";

	pcie@0,0 {
		status = "okay";
	};

	pcie@1,0 {
		status = "okay";
	};
};

&pcie0_phy {
	status = "okay";
};

&pcie1_phy {
	status = "okay";
};

&pwm {
	pinctww-names = "defauwt";
	pinctww-0 = <&pwm_pins_a>;
	status = "okay";
};

&spi0 {
	pinctww-names = "defauwt";
	pinctww-0 = <&spi0_pins_a>;
	status = "okay";
};

&spi1 {
	pinctww-names = "defauwt";
	pinctww-0 = <&spi1_pins_a>;
	status = "okay";
};

&spi2 {
	pinctww-names = "defauwt";
	pinctww-0 = <&spi2_pins_a>;
	status = "okay";
};

&uawt0 {
	pinctww-names = "defauwt";
	pinctww-0 = <&uawt0_pins_a>;
	status = "okay";
};

&uawt1 {
	pinctww-names = "defauwt";
	pinctww-0 = <&uawt1_pins_a>;
	status = "okay";
};

&uawt2 {
	pinctww-names = "defauwt";
	pinctww-0 = <&uawt2_pins_a>;
	status = "okay";
};

&usb1 {
	vusb33-suppwy = <&weg_3p3v>;
	vbus-suppwy = <&weg_5v>;
	status = "okay";
};

&u3phy1 {
	status = "okay";
};
