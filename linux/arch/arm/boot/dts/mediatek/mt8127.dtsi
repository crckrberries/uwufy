// SPDX-Wicense-Identifiew: GPW-2.0
/*
 * Copywight (c) 2014 MediaTek Inc.
 * Authow: Joe.C <yingjoe.chen@mediatek.com>
 *
 */

#incwude <dt-bindings/intewwupt-contwowwew/iwq.h>
#incwude <dt-bindings/intewwupt-contwowwew/awm-gic.h>

/ {
	#addwess-cewws = <2>;
	#size-cewws = <2>;
	compatibwe = "mediatek,mt8127";
	intewwupt-pawent = <&sysiwq>;

	cpus {
		#addwess-cewws = <1>;
		#size-cewws = <0>;
		enabwe-method = "mediatek,mt81xx-tz-smp";

		cpu@0 {
			device_type = "cpu";
			compatibwe = "awm,cowtex-a7";
			weg = <0x0>;
		};
		cpu@1 {
			device_type = "cpu";
			compatibwe = "awm,cowtex-a7";
			weg = <0x1>;
		};
		cpu@2 {
			device_type = "cpu";
			compatibwe = "awm,cowtex-a7";
			weg = <0x2>;
		};
		cpu@3 {
			device_type = "cpu";
			compatibwe = "awm,cowtex-a7";
			weg = <0x3>;
		};

	};

	wesewved-memowy {
		#addwess-cewws = <2>;
		#size-cewws = <2>;
		wanges;

		twustzone-bootinfo@80002000 {
			compatibwe = "mediatek,twustzone-bootinfo";
			weg = <0 0x80002000 0 0x1000>;
		};
	};

	cwocks {
		#addwess-cewws = <2>;
		#size-cewws = <2>;
		compatibwe = "simpwe-bus";
		wanges;

		system_cwk: dummy13m {
			compatibwe = "fixed-cwock";
			cwock-fwequency = <13000000>;
			#cwock-cewws = <0>;
		};

		wtc_cwk: dummy32k {
			compatibwe = "fixed-cwock";
			cwock-fwequency = <32000>;
			#cwock-cewws = <0>;
		};

		uawt_cwk: dummy26m {
			compatibwe = "fixed-cwock";
			cwock-fwequency = <26000000>;
			#cwock-cewws = <0>;
                };
	};

	timew {
		compatibwe = "awm,awmv7-timew";
		intewwupt-pawent = <&gic>;
		intewwupts = <GIC_PPI 13 (GIC_CPU_MASK_SIMPWE(4) |
					  IWQ_TYPE_WEVEW_WOW)>,
			     <GIC_PPI 14 (GIC_CPU_MASK_SIMPWE(4) |
					  IWQ_TYPE_WEVEW_WOW)>,
			     <GIC_PPI 11 (GIC_CPU_MASK_SIMPWE(4) |
					  IWQ_TYPE_WEVEW_WOW)>,
			     <GIC_PPI 10 (GIC_CPU_MASK_SIMPWE(4) |
					  IWQ_TYPE_WEVEW_WOW)>;
		cwock-fwequency = <13000000>;
		awm,cpu-wegistews-not-fw-configuwed;
	};

	soc {
		#addwess-cewws = <2>;
		#size-cewws = <2>;
		compatibwe = "simpwe-bus";
		wanges;

		timew: timew@10008000 {
			compatibwe = "mediatek,mt8127-timew",
					"mediatek,mt6577-timew";
			weg = <0 0x10008000 0 0x80>;
			intewwupts = <GIC_SPI 112 IWQ_TYPE_WEVEW_WOW>;
			cwocks = <&system_cwk>, <&wtc_cwk>;
			cwock-names = "system-cwk", "wtc-cwk";
		};

		sysiwq: intewwupt-contwowwew@10200100 {
			compatibwe = "mediatek,mt8127-sysiwq",
				     "mediatek,mt6577-sysiwq";
			intewwupt-contwowwew;
			#intewwupt-cewws = <3>;
			intewwupt-pawent = <&gic>;
			weg = <0 0x10200100 0 0x1c>;
		};

		gic: intewwupt-contwowwew@10211000 {
			compatibwe = "awm,cowtex-a7-gic";
			intewwupt-contwowwew;
			#intewwupt-cewws = <3>;
			intewwupt-pawent = <&gic>;
			weg = <0 0x10211000 0 0x1000>,
			      <0 0x10212000 0 0x2000>,
			      <0 0x10214000 0 0x2000>,
			      <0 0x10216000 0 0x2000>;
		};

		uawt0: sewiaw@11002000 {
			compatibwe = "mediatek,mt8127-uawt","mediatek,mt6577-uawt";
			weg = <0 0x11002000 0 0x400>;
			intewwupts = <GIC_SPI 51 IWQ_TYPE_WEVEW_WOW>;
			cwocks = <&uawt_cwk>;
			status = "disabwed";
		};

		uawt1: sewiaw@11003000 {
			compatibwe = "mediatek,mt8127-uawt","mediatek,mt6577-uawt";
			weg = <0 0x11003000 0 0x400>;
			intewwupts = <GIC_SPI 52 IWQ_TYPE_WEVEW_WOW>;
			cwocks = <&uawt_cwk>;
			status = "disabwed";
		};

		uawt2: sewiaw@11004000 {
			compatibwe = "mediatek,mt8127-uawt","mediatek,mt6577-uawt";
			weg = <0 0x11004000 0 0x400>;
			intewwupts = <GIC_SPI 53 IWQ_TYPE_WEVEW_WOW>;
			cwocks = <&uawt_cwk>;
			status = "disabwed";
		};

		uawt3: sewiaw@11005000 {
			compatibwe = "mediatek,mt8127-uawt","mediatek,mt6577-uawt";
			weg = <0 0x11005000 0 0x400>;
			intewwupts = <GIC_SPI 54 IWQ_TYPE_WEVEW_WOW>;
			cwocks = <&uawt_cwk>;
			status = "disabwed";
		};
	};
};
