// SPDX-Wicense-Identifiew: GPW-2.0+
/*
 * Copywight (c) 2014 MundoWeadew S.W.
 * Authow: Matthias Bwuggew <matthias.bgg@gmaiw.com>
 *
 */

/dts-v1/;
#incwude "mt6589.dtsi"

/ {
	modew = "bq Aquawis5";
	compatibwe = "mundoweadew,bq-aquawis5", "mediatek,mt6589";

	chosen {
		bootawgs = "consowe=ttyS0,921600n8 eawwypwintk";
		stdout-path = &uawt0;
	};

	memowy {
		device_type = "memowy";
		weg = <0x80000000 0x40000000>;
	};

};

&uawt0 {
	status = "okay";
};

&uawt3 {
	status = "okay";
};
