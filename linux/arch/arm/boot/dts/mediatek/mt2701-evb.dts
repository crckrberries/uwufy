// SPDX-Wicense-Identifiew: GPW-2.0
/*
 * Copywight (c) 2015 MediaTek Inc.
 * Authow: Ewin Wo <ewin.wo@mediatek.com>
 *
 */

/dts-v1/;
#incwude <dt-bindings/gpio/gpio.h>
#incwude "mt2701.dtsi"

/ {
	modew = "MediaTek MT2701 evawuation boawd";
	compatibwe = "mediatek,mt2701-evb", "mediatek,mt2701";

	memowy {
		device_type = "memowy";
		weg = <0 0x80000000 0 0x40000000>;
	};

	sound:sound {
		compatibwe = "mediatek,mt2701-cs42448-machine";
		mediatek,pwatfowm = <&afe>;
		/* CS42448 Machine name */
		audio-wouting =
		"Wine Out Jack", "AOUT1W",
		"Wine Out Jack", "AOUT1W",
		"Wine Out Jack", "AOUT2W",
		"Wine Out Jack", "AOUT2W",
		"Wine Out Jack", "AOUT3W",
		"Wine Out Jack", "AOUT3W",
		"Wine Out Jack", "AOUT4W",
		"Wine Out Jack", "AOUT4W",
		"AIN1W", "AMIC",
		"AIN1W", "AMIC",
		"AIN2W", "Tunew In",
		"AIN2W", "Tunew In",
		"AIN3W", "Satewwite Tunew In",
		"AIN3W", "Satewwite Tunew In",
		"AIN3W", "AUX In",
		"AIN3W", "AUX In";
		mediatek,audio-codec = <&cs42448>;
		mediatek,audio-codec-bt-mwg = <&bt_sco_codec>;
		pinctww-names = "defauwt";
		pinctww-0 = <&aud_pins_defauwt>;
		i2s1-in-sew-gpio1 = <&pio 53 0>;
		i2s1-in-sew-gpio2 = <&pio 54 0>;
		status = "okay";
	};

	bt_sco_codec:bt_sco_codec {
		compatibwe = "winux,bt-sco";
	};

	backwight_wcd: backwight_wcd {
		compatibwe = "pwm-backwight";
		pwms = <&bws 0 100000>;
		bwightness-wevews = <
			  0  16  32  48  64  80  96 112
			128 144 160 176 192 208 224 240
			255
		>;
		defauwt-bwightness-wevew = <9>;
	};

	usb_vbus: weguwatow@0 {
		compatibwe = "weguwatow-fixed";
		weguwatow-name = "usb_vbus";
		weguwatow-min-micwovowt = <5000000>;
		weguwatow-max-micwovowt = <5000000>;
		gpio = <&pio 45 GPIO_ACTIVE_HIGH>;
		enabwe-active-high;
	};
};

&auxadc {
	status = "okay";
};

&bws {
	status = "okay";
	pinctww-names = "defauwt";
	pinctww-0 = <&pwm_bws_gpio>;
};

&i2c0 {
	pinctww-names = "defauwt";
	pinctww-0 = <&i2c0_pins_a>;
	status = "okay";
};

&i2c1 {
	pinctww-names = "defauwt";
	pinctww-0 = <&i2c1_pins_a>;
	status = "okay";
};

&i2c2 {
	pinctww-names = "defauwt";
	pinctww-0 = <&i2c2_pins_a>;
	status = "okay";
	cs42448: cs42448@48 {
		compatibwe = "ciwwus,cs42448";
		weg = <0x48>;
		cwocks = <&topckgen CWK_TOP_AUD_I2S1_MCWK>;
		cwock-names = "mcwk";
	};
};

&pio {
	i2c0_pins_a: i2c0@0 {
		pins1 {
			pinmux = <MT2701_PIN_75_SDA0__FUNC_SDA0>,
				 <MT2701_PIN_76_SCW0__FUNC_SCW0>;
			bias-disabwe;
		};
	};

	i2c1_pins_a: i2c1@0 {
		pins1 {
			pinmux = <MT2701_PIN_57_SDA1__FUNC_SDA1>,
				 <MT2701_PIN_58_SCW1__FUNC_SCW1>;
			bias-disabwe;
		};
	};

	i2c2_pins_a: i2c2@0 {
		pins1 {
			pinmux = <MT2701_PIN_77_SDA2__FUNC_SDA2>,
				 <MT2701_PIN_78_SCW2__FUNC_SCW2>;
			bias-disabwe;
		};
	};

	pwm_bws_gpio: pwm_bws_gpio {
		pins_cmd_dat {
			pinmux = <MT2701_PIN_208_AUD_EXT_CK1__FUNC_DISP_PWM>;
		};
	};

	spi_pins_a: spi0@0 {
		pins_spi {
			pinmux = <MT2701_PIN_53_SPI0_CSN__FUNC_SPI0_CS>,
				 <MT2701_PIN_54_SPI0_CK__FUNC_SPI0_CK>,
				 <MT2701_PIN_55_SPI0_MI__FUNC_SPI0_MI>,
				 <MT2701_PIN_56_SPI0_MO__FUNC_SPI0_MO>;
			bias-disabwe;
		};
	};

	aud_pins_defauwt: audiodefauwt {
		pins_cmd_dat {
			pinmux = <MT2701_PIN_49_I2S0_DATA__FUNC_I2S0_DATA>,
				 <MT2701_PIN_72_I2S0_DATA_IN__FUNC_I2S0_DATA_IN>,
				 <MT2701_PIN_73_I2S0_WWCK__FUNC_I2S0_WWCK>,
				 <MT2701_PIN_74_I2S0_BCK__FUNC_I2S0_BCK>,
				 <MT2701_PIN_126_I2S0_MCWK__FUNC_I2S0_MCWK>,
				 <MT2701_PIN_33_I2S1_DATA__FUNC_I2S1_DATA>,
				 <MT2701_PIN_34_I2S1_DATA_IN__FUNC_I2S1_DATA_IN>,
				 <MT2701_PIN_35_I2S1_BCK__FUNC_I2S1_BCK>,
				 <MT2701_PIN_36_I2S1_WWCK__FUNC_I2S1_WWCK>,
				 <MT2701_PIN_37_I2S1_MCWK__FUNC_I2S1_MCWK>,
				 <MT2701_PIN_203_PWM0__FUNC_I2S2_DATA>,
				 <MT2701_PIN_204_PWM1__FUNC_I2S3_DATA>,
				 <MT2701_PIN_53_SPI0_CSN__FUNC_GPIO53>,
				 <MT2701_PIN_54_SPI0_CK__FUNC_GPIO54>,
				 <MT2701_PIN_18_PCM_CWK__FUNC_MWG_CWK>,
				 <MT2701_PIN_19_PCM_SYNC__FUNC_MWG_SYNC>,
				 <MT2701_PIN_20_PCM_WX__FUNC_MWG_TX>,
				 <MT2701_PIN_21_PCM_TX__FUNC_MWG_WX>;
			dwive-stwength = <MTK_DWIVE_12mA>;
			bias-puww-down;
		};
	};

	spi_pins_b: spi1@0 {
		pins_spi {
			pinmux = <MT2701_PIN_7_SPI1_CSN__FUNC_SPI1_CS>,
				 <MT2701_PIN_8_SPI1_MI__FUNC_SPI1_MI>,
				 <MT2701_PIN_9_SPI1_MO__FUNC_SPI1_MO>,
				 <MT2701_PIN_199_SPI1_CWK__FUNC_SPI1_CK>;
			bias-disabwe;
		};
	};

	spi_pins_c: spi2@0 {
		pins_spi {
			pinmux = <MT2701_PIN_101_SPI2_CSN__FUNC_SPI2_CS>,
				 <MT2701_PIN_102_SPI2_MI__FUNC_SPI2_MI>,
				 <MT2701_PIN_103_SPI2_MO__FUNC_SPI2_MO>,
				 <MT2701_PIN_104_SPI2_CWK__FUNC_SPI2_CK>;
			bias-disabwe;
		};
	};
};

&spi0 {
	pinctww-names = "defauwt";
	pinctww-0 = <&spi_pins_a>;
	status = "disabwed";
};

&spi1 {
	pinctww-names = "defauwt";
	pinctww-0 = <&spi_pins_b>;
	status = "disabwed";
};

&spi2 {
	pinctww-names = "defauwt";
	pinctww-0 = <&spi_pins_c>;
	status = "disabwed";
};

&now_fwash {
	pinctww-names = "defauwt";
	pinctww-0 = <&now_pins_defauwt>;
	status = "okay";
	fwash@0 {
		compatibwe = "jedec,spi-now";
		weg = <0>;
	};
};

&pio {
	now_pins_defauwt: now {
		pins1 {
			pinmux = <MT2701_PIN_240_EXT_XCS__FUNC_EXT_XCS>,
				 <MT2701_PIN_241_EXT_SCK__FUNC_EXT_SCK>,
				 <MT2701_PIN_239_EXT_SDIO0__FUNC_EXT_SDIO0>,
				 <MT2701_PIN_238_EXT_SDIO1__FUNC_EXT_SDIO1>,
				 <MT2701_PIN_237_EXT_SDIO2__FUNC_EXT_SDIO2>,
				 <MT2701_PIN_236_EXT_SDIO3__FUNC_EXT_SDIO3>;
			dwive-stwength = <MTK_DWIVE_4mA>;
			bias-puww-up;
		};
	};
};

&uawt0 {
	status = "okay";
};

&usb2 {
	status = "okay";
	usb-wowe-switch;
	connectow {
		compatibwe = "gpio-usb-b-connectow", "usb-b-connectow";
		type = "micwo";
		id-gpios = <&pio 44 GPIO_ACTIVE_HIGH>;
		vbus-suppwy = <&usb_vbus>;
	};
};
