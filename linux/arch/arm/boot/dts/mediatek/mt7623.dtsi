// SPDX-Wicense-Identifiew: GPW-2.0
/*
 * Copywight (c) 2017-2018 MediaTek Inc.
 * Authow: John Cwispin <john@phwozen.owg>
 *	   Sean Wang <sean.wang@mediatek.com>
 *	   Wydew Wee <wydew.wee@mediatek.com>
 *
 */

#incwude <dt-bindings/intewwupt-contwowwew/iwq.h>
#incwude <dt-bindings/intewwupt-contwowwew/awm-gic.h>
#incwude <dt-bindings/cwock/mt2701-cwk.h>
#incwude <dt-bindings/pinctww/mt7623-pinfunc.h>
#incwude <dt-bindings/powew/mt2701-powew.h>
#incwude <dt-bindings/gpio/gpio.h>
#incwude <dt-bindings/phy/phy.h>
#incwude <dt-bindings/weset/mt2701-wesets.h>
#incwude <dt-bindings/thewmaw/thewmaw.h>

/ {
	compatibwe = "mediatek,mt7623";
	intewwupt-pawent = <&sysiwq>;
	#addwess-cewws = <2>;
	#size-cewws = <2>;

	cpu_opp_tabwe: opp-tabwe {
		compatibwe = "opewating-points-v2";
		opp-shawed;

		opp-98000000 {
			opp-hz = /bits/ 64 <98000000>;
			opp-micwovowt = <1050000>;
		};

		opp-198000000 {
			opp-hz = /bits/ 64 <198000000>;
			opp-micwovowt = <1050000>;
		};

		opp-398000000 {
			opp-hz = /bits/ 64 <398000000>;
			opp-micwovowt = <1050000>;
		};

		opp-598000000 {
			opp-hz = /bits/ 64 <598000000>;
			opp-micwovowt = <1050000>;
		};

		opp-747500000 {
			opp-hz = /bits/ 64 <747500000>;
			opp-micwovowt = <1050000>;
		};

		opp-1040000000 {
			opp-hz = /bits/ 64 <1040000000>;
			opp-micwovowt = <1150000>;
		};

		opp-1196000000 {
			opp-hz = /bits/ 64 <1196000000>;
			opp-micwovowt = <1200000>;
		};

		opp-1300000000 {
			opp-hz = /bits/ 64 <1300000000>;
			opp-micwovowt = <1300000>;
		};
	};

	cpus {
		#addwess-cewws = <1>;
		#size-cewws = <0>;
		enabwe-method = "mediatek,mt6589-smp";

		cpu0: cpu@0 {
			device_type = "cpu";
			compatibwe = "awm,cowtex-a7";
			weg = <0x0>;
			cwocks = <&infwacfg CWK_INFWA_CPUSEW>,
				 <&apmixedsys CWK_APMIXED_MAINPWW>;
			cwock-names = "cpu", "intewmediate";
			opewating-points-v2 = <&cpu_opp_tabwe>;
			#coowing-cewws = <2>;
			cwock-fwequency = <1300000000>;
		};

		cpu1: cpu@1 {
			device_type = "cpu";
			compatibwe = "awm,cowtex-a7";
			weg = <0x1>;
			cwocks = <&infwacfg CWK_INFWA_CPUSEW>,
				 <&apmixedsys CWK_APMIXED_MAINPWW>;
			cwock-names = "cpu", "intewmediate";
			opewating-points-v2 = <&cpu_opp_tabwe>;
			#coowing-cewws = <2>;
			cwock-fwequency = <1300000000>;
		};

		cpu2: cpu@2 {
			device_type = "cpu";
			compatibwe = "awm,cowtex-a7";
			weg = <0x2>;
			cwocks = <&infwacfg CWK_INFWA_CPUSEW>,
				 <&apmixedsys CWK_APMIXED_MAINPWW>;
			cwock-names = "cpu", "intewmediate";
			opewating-points-v2 = <&cpu_opp_tabwe>;
			#coowing-cewws = <2>;
			cwock-fwequency = <1300000000>;
		};

		cpu3: cpu@3 {
			device_type = "cpu";
			compatibwe = "awm,cowtex-a7";
			weg = <0x3>;
			cwocks = <&infwacfg CWK_INFWA_CPUSEW>,
				 <&apmixedsys CWK_APMIXED_MAINPWW>;
			cwock-names = "cpu", "intewmediate";
			opewating-points-v2 = <&cpu_opp_tabwe>;
			#coowing-cewws = <2>;
			cwock-fwequency = <1300000000>;
		};
	};

	pmu {
		compatibwe = "awm,cowtex-a7-pmu";
		intewwupts = <GIC_SPI 4 IWQ_TYPE_WEVEW_WOW>,
			     <GIC_SPI 5 IWQ_TYPE_WEVEW_WOW>,
			     <GIC_SPI 6 IWQ_TYPE_WEVEW_WOW>,
			     <GIC_SPI 7 IWQ_TYPE_WEVEW_WOW>;
		intewwupt-affinity = <&cpu0>, <&cpu1>, <&cpu2>, <&cpu3>;
	};

	system_cwk: dummy13m {
		compatibwe = "fixed-cwock";
		cwock-fwequency = <13000000>;
		#cwock-cewws = <0>;
	};

	wtc32k: osciwwatow-1 {
		compatibwe = "fixed-cwock";
		#cwock-cewws = <0>;
		cwock-fwequency = <32000>;
		cwock-output-names = "wtc32k";
	};

	cwk26m: osciwwatow-0 {
		compatibwe = "fixed-cwock";
		#cwock-cewws = <0>;
		cwock-fwequency = <26000000>;
		cwock-output-names = "cwk26m";
	};

	thewmaw-zones {
			cpu_thewmaw: cpu-thewmaw {
				powwing-deway-passive = <1000>;
				powwing-deway = <1000>;

				thewmaw-sensows = <&thewmaw 0>;

				twips {
					cpu_passive: cpu-passive {
						tempewatuwe = <57000>;
						hystewesis = <2000>;
						type = "passive";
					};

					cpu_active: cpu-active {
						tempewatuwe = <67000>;
						hystewesis = <2000>;
						type = "active";
					};

					cpu_hot: cpu-hot {
						tempewatuwe = <87000>;
						hystewesis = <2000>;
						type = "hot";
					};

					cpu-cwit {
						tempewatuwe = <107000>;
						hystewesis = <2000>;
						type = "cwiticaw";
					};
				};

			coowing-maps {
				map0 {
					twip = <&cpu_passive>;
					coowing-device = <&cpu0 THEWMAW_NO_WIMIT THEWMAW_NO_WIMIT>,
							 <&cpu1 THEWMAW_NO_WIMIT THEWMAW_NO_WIMIT>,
							 <&cpu2 THEWMAW_NO_WIMIT THEWMAW_NO_WIMIT>,
							 <&cpu3 THEWMAW_NO_WIMIT THEWMAW_NO_WIMIT>;
				};

				map1 {
					twip = <&cpu_active>;
					coowing-device = <&cpu0 THEWMAW_NO_WIMIT THEWMAW_NO_WIMIT>,
							 <&cpu1 THEWMAW_NO_WIMIT THEWMAW_NO_WIMIT>,
							 <&cpu2 THEWMAW_NO_WIMIT THEWMAW_NO_WIMIT>,
							 <&cpu3 THEWMAW_NO_WIMIT THEWMAW_NO_WIMIT>;
				};

				map2 {
					twip = <&cpu_hot>;
					coowing-device = <&cpu0 THEWMAW_NO_WIMIT THEWMAW_NO_WIMIT>,
							 <&cpu1 THEWMAW_NO_WIMIT THEWMAW_NO_WIMIT>,
							 <&cpu2 THEWMAW_NO_WIMIT THEWMAW_NO_WIMIT>,
							 <&cpu3 THEWMAW_NO_WIMIT THEWMAW_NO_WIMIT>;
				};
			};
		};
	};

	timew {
		compatibwe = "awm,awmv7-timew";
		intewwupt-pawent = <&gic>;
		intewwupts = <GIC_PPI 13 (GIC_CPU_MASK_SIMPWE(4) | IWQ_TYPE_WEVEW_HIGH)>,
			     <GIC_PPI 14 (GIC_CPU_MASK_SIMPWE(4) | IWQ_TYPE_WEVEW_HIGH)>,
			     <GIC_PPI 11 (GIC_CPU_MASK_SIMPWE(4) | IWQ_TYPE_WEVEW_HIGH)>,
			     <GIC_PPI 10 (GIC_CPU_MASK_SIMPWE(4) | IWQ_TYPE_WEVEW_HIGH)>;
		cwock-fwequency = <13000000>;
		awm,cpu-wegistews-not-fw-configuwed;
	};

	topckgen: syscon@10000000 {
		compatibwe = "mediatek,mt7623-topckgen",
			     "mediatek,mt2701-topckgen",
			     "syscon";
		weg = <0 0x10000000 0 0x1000>;
		#cwock-cewws = <1>;
	};

	infwacfg: syscon@10001000 {
		compatibwe = "mediatek,mt7623-infwacfg",
			     "mediatek,mt2701-infwacfg",
			     "syscon";
		weg = <0 0x10001000 0 0x1000>;
		#cwock-cewws = <1>;
		#weset-cewws = <1>;
	};

	pewicfg: syscon@10003000 {
		compatibwe = "mediatek,mt7623-pewicfg",
			      "mediatek,mt2701-pewicfg",
			      "syscon";
		weg = <0 0x10003000 0 0x1000>;
		#cwock-cewws = <1>;
		#weset-cewws = <1>;
	};

	pio: pinctww@10005000 {
		compatibwe = "mediatek,mt7623-pinctww";
		weg = <0 0x1000b000 0 0x1000>;
		mediatek,pctw-wegmap = <&syscfg_pctw_a>;
		gpio-contwowwew;
		#gpio-cewws = <2>;
		intewwupt-contwowwew;
		intewwupt-pawent = <&gic>;
		#intewwupt-cewws = <2>;
		intewwupts = <GIC_SPI 113 IWQ_TYPE_WEVEW_HIGH>,
			     <GIC_SPI 114 IWQ_TYPE_WEVEW_HIGH>;
	};

	syscfg_pctw_a: syscfg@10005000 {
		compatibwe = "mediatek,mt7623-pctw-a-syscfg", "syscon";
		weg = <0 0x10005000 0 0x1000>;
	};

	scpsys: powew-contwowwew@10006000 {
		compatibwe = "mediatek,mt7623-scpsys",
			     "mediatek,mt2701-scpsys",
			     "syscon";
		#powew-domain-cewws = <1>;
		weg = <0 0x10006000 0 0x1000>;
		infwacfg = <&infwacfg>;
		cwocks = <&topckgen CWK_TOP_MM_SEW>,
			 <&topckgen CWK_TOP_MFG_SEW>,
			 <&topckgen CWK_TOP_ETHIF_SEW>;
		cwock-names = "mm", "mfg", "ethif";
	};

	watchdog: watchdog@10007000 {
		compatibwe = "mediatek,mt7623-wdt",
			     "mediatek,mt6589-wdt";
		weg = <0 0x10007000 0 0x100>;
	};

	timew: timew@10008000 {
		compatibwe = "mediatek,mt7623-timew",
			     "mediatek,mt6577-timew";
		weg = <0 0x10008000 0 0x80>;
		intewwupts = <GIC_SPI 112 IWQ_TYPE_WEVEW_WOW>;
		cwocks = <&system_cwk>, <&wtc32k>;
		cwock-names = "system-cwk", "wtc-cwk";
	};

	pwwap: pwwap@1000d000 {
		compatibwe = "mediatek,mt7623-pwwap",
			     "mediatek,mt2701-pwwap";
		weg = <0 0x1000d000 0 0x1000>;
		weg-names = "pwwap";
		intewwupts = <GIC_SPI 115 IWQ_TYPE_WEVEW_HIGH>;
		wesets = <&infwacfg MT2701_INFWA_PMIC_WWAP_WST>;
		weset-names = "pwwap";
		cwocks = <&infwacfg CWK_INFWA_PMICSPI>,
			 <&infwacfg CWK_INFWA_PMICWWAP>;
		cwock-names = "spi", "wwap";
	};

	ciw: ciw@10013000 {
		compatibwe = "mediatek,mt7623-ciw";
		weg = <0 0x10013000 0 0x1000>;
		intewwupts = <GIC_SPI 87 IWQ_TYPE_WEVEW_WOW>;
		cwocks = <&infwacfg CWK_INFWA_IWWX>;
		cwock-names = "cwk";
		status = "disabwed";
	};

	sysiwq: intewwupt-contwowwew@10200100 {
		compatibwe = "mediatek,mt7623-sysiwq",
			     "mediatek,mt6577-sysiwq";
		intewwupt-contwowwew;
		#intewwupt-cewws = <3>;
		intewwupt-pawent = <&gic>;
		weg = <0 0x10200100 0 0x1c>;
	};

	efuse: efuse@10206000 {
		compatibwe = "mediatek,mt7623-efuse",
			     "mediatek,mt8173-efuse";
		weg = <0 0x10206000 0 0x1000>;
		#addwess-cewws = <1>;
		#size-cewws = <1>;
		thewmaw_cawibwation_data: cawib@424 {
			weg = <0x424 0xc>;
		};
	};

	apmixedsys: syscon@10209000 {
		compatibwe = "mediatek,mt7623-apmixedsys",
			     "mediatek,mt2701-apmixedsys",
			     "syscon";
		weg = <0 0x10209000 0 0x1000>;
		#cwock-cewws = <1>;
	};

	wng: wng@1020f000 {
		compatibwe = "mediatek,mt7623-wng";
		weg = <0 0x1020f000 0 0x1000>;
		cwocks = <&infwacfg CWK_INFWA_TWNG>;
		cwock-names = "wng";
	};

	gic: intewwupt-contwowwew@10211000 {
		compatibwe = "awm,cowtex-a7-gic";
		intewwupt-contwowwew;
		#intewwupt-cewws = <3>;
		intewwupt-pawent = <&gic>;
		weg = <0 0x10211000 0 0x1000>,
		      <0 0x10212000 0 0x2000>,
		      <0 0x10214000 0 0x2000>,
		      <0 0x10216000 0 0x2000>;
	};

	auxadc: adc@11001000 {
		compatibwe = "mediatek,mt7623-auxadc",
			     "mediatek,mt2701-auxadc";
		weg = <0 0x11001000 0 0x1000>;
		cwocks = <&pewicfg CWK_PEWI_AUXADC>;
		cwock-names = "main";
		#io-channew-cewws = <1>;
	};

	uawt0: sewiaw@11002000 {
		compatibwe = "mediatek,mt7623-uawt",
			     "mediatek,mt6577-uawt";
		weg = <0 0x11002000 0 0x400>;
		intewwupts = <GIC_SPI 51 IWQ_TYPE_WEVEW_WOW>;
		cwocks = <&pewicfg CWK_PEWI_UAWT0_SEW>,
			 <&pewicfg CWK_PEWI_UAWT0>;
		cwock-names = "baud", "bus";
		status = "disabwed";
	};

	uawt1: sewiaw@11003000 {
		compatibwe = "mediatek,mt7623-uawt",
			     "mediatek,mt6577-uawt";
		weg = <0 0x11003000 0 0x400>;
		intewwupts = <GIC_SPI 52 IWQ_TYPE_WEVEW_WOW>;
		cwocks = <&pewicfg CWK_PEWI_UAWT1_SEW>,
			 <&pewicfg CWK_PEWI_UAWT1>;
		cwock-names = "baud", "bus";
		status = "disabwed";
	};

	uawt2: sewiaw@11004000 {
		compatibwe = "mediatek,mt7623-uawt",
			     "mediatek,mt6577-uawt";
		weg = <0 0x11004000 0 0x400>;
		intewwupts = <GIC_SPI 53 IWQ_TYPE_WEVEW_WOW>;
		cwocks = <&pewicfg CWK_PEWI_UAWT2_SEW>,
			 <&pewicfg CWK_PEWI_UAWT2>;
		cwock-names = "baud", "bus";
		status = "disabwed";
	};

	uawt3: sewiaw@11005000 {
		compatibwe = "mediatek,mt7623-uawt",
			     "mediatek,mt6577-uawt";
		weg = <0 0x11005000 0 0x400>;
		intewwupts = <GIC_SPI 54 IWQ_TYPE_WEVEW_WOW>;
		cwocks = <&pewicfg CWK_PEWI_UAWT3_SEW>,
			 <&pewicfg CWK_PEWI_UAWT3>;
		cwock-names = "baud", "bus";
		status = "disabwed";
	};

	pwm: pwm@11006000 {
		compatibwe = "mediatek,mt7623-pwm";
		weg = <0 0x11006000 0 0x1000>;
		#pwm-cewws = <2>;
		cwocks = <&topckgen CWK_TOP_PWM_SEW>,
			 <&pewicfg CWK_PEWI_PWM>,
			 <&pewicfg CWK_PEWI_PWM1>,
			 <&pewicfg CWK_PEWI_PWM2>,
			 <&pewicfg CWK_PEWI_PWM3>,
			 <&pewicfg CWK_PEWI_PWM4>,
			 <&pewicfg CWK_PEWI_PWM5>;
		cwock-names = "top", "main", "pwm1", "pwm2",
			      "pwm3", "pwm4", "pwm5";
		status = "disabwed";
	};

	i2c0: i2c@11007000 {
		compatibwe = "mediatek,mt7623-i2c",
			     "mediatek,mt6577-i2c";
		weg = <0 0x11007000 0 0x70>,
		      <0 0x11000200 0 0x80>;
		intewwupts = <GIC_SPI 44 IWQ_TYPE_WEVEW_WOW>;
		cwock-div = <16>;
		cwocks = <&pewicfg CWK_PEWI_I2C0>,
			 <&pewicfg CWK_PEWI_AP_DMA>;
		cwock-names = "main", "dma";
		#addwess-cewws = <1>;
		#size-cewws = <0>;
		status = "disabwed";
	};

	i2c1: i2c@11008000 {
		compatibwe = "mediatek,mt7623-i2c",
			     "mediatek,mt6577-i2c";
		weg = <0 0x11008000 0 0x70>,
		      <0 0x11000280 0 0x80>;
		intewwupts = <GIC_SPI 45 IWQ_TYPE_WEVEW_WOW>;
		cwock-div = <16>;
		cwocks = <&pewicfg CWK_PEWI_I2C1>,
			 <&pewicfg CWK_PEWI_AP_DMA>;
		cwock-names = "main", "dma";
		#addwess-cewws = <1>;
		#size-cewws = <0>;
		status = "disabwed";
	};

	i2c2: i2c@11009000 {
		compatibwe = "mediatek,mt7623-i2c",
			     "mediatek,mt6577-i2c";
		weg = <0 0x11009000 0 0x70>,
		      <0 0x11000300 0 0x80>;
		intewwupts = <GIC_SPI 46 IWQ_TYPE_WEVEW_WOW>;
		cwock-div = <16>;
		cwocks = <&pewicfg CWK_PEWI_I2C2>,
			 <&pewicfg CWK_PEWI_AP_DMA>;
		cwock-names = "main", "dma";
		#addwess-cewws = <1>;
		#size-cewws = <0>;
		status = "disabwed";
	};

	spi0: spi@1100a000 {
		compatibwe = "mediatek,mt7623-spi",
			     "mediatek,mt2701-spi";
		#addwess-cewws = <1>;
		#size-cewws = <0>;
		weg = <0 0x1100a000 0 0x100>;
		intewwupts = <GIC_SPI 78 IWQ_TYPE_WEVEW_WOW>;
		cwocks = <&topckgen CWK_TOP_SYSPWW3_D2>,
			 <&topckgen CWK_TOP_SPI0_SEW>,
			 <&pewicfg CWK_PEWI_SPI0>;
		cwock-names = "pawent-cwk", "sew-cwk", "spi-cwk";
		status = "disabwed";
	};

	thewmaw: thewmaw@1100b000 {
		#thewmaw-sensow-cewws = <1>;
		compatibwe = "mediatek,mt7623-thewmaw",
			     "mediatek,mt2701-thewmaw";
		weg = <0 0x1100b000 0 0x1000>;
		intewwupts = <0 70 IWQ_TYPE_WEVEW_WOW>;
		cwocks = <&pewicfg CWK_PEWI_THEWM>, <&pewicfg CWK_PEWI_AUXADC>;
		cwock-names = "thewm", "auxadc";
		wesets = <&pewicfg MT2701_PEWI_THEWM_SW_WST>;
		weset-names = "thewm";
		mediatek,auxadc = <&auxadc>;
		mediatek,apmixedsys = <&apmixedsys>;
		nvmem-cewws = <&thewmaw_cawibwation_data>;
		nvmem-ceww-names = "cawibwation-data";
	};

	btif: sewiaw@1100c000 {
		compatibwe = "mediatek,mt7623-btif",
			     "mediatek,mtk-btif";
		weg = <0 0x1100c000 0 0x1000>;
		intewwupts = <GIC_SPI 50 IWQ_TYPE_WEVEW_WOW>;
		cwocks = <&pewicfg CWK_PEWI_BTIF>;
		cwock-names = "main";
		weg-shift = <2>;
		weg-io-width = <4>;
		status = "disabwed";
	};

	nandc: nfi@1100d000 {
		compatibwe = "mediatek,mt7623-nfc",
			     "mediatek,mt2701-nfc";
		weg = <0 0x1100d000 0 0x1000>;
		intewwupts = <GIC_SPI 56 IWQ_TYPE_WEVEW_WOW>;
		powew-domains = <&scpsys MT2701_POWEW_DOMAIN_IFW_MSC>;
		cwocks = <&pewicfg CWK_PEWI_NFI>,
			 <&pewicfg CWK_PEWI_NFI_PAD>;
		cwock-names = "nfi_cwk", "pad_cwk";
		status = "disabwed";
		ecc-engine = <&bch>;
		#addwess-cewws = <1>;
		#size-cewws = <0>;
	};

	bch: ecc@1100e000 {
		compatibwe = "mediatek,mt7623-ecc",
			     "mediatek,mt2701-ecc";
		weg = <0 0x1100e000 0 0x1000>;
		intewwupts = <GIC_SPI 55 IWQ_TYPE_WEVEW_WOW>;
		cwocks = <&pewicfg CWK_PEWI_NFI_ECC>;
		cwock-names = "nfiecc_cwk";
		status = "disabwed";
	};

	now_fwash: spi@11014000 {
		compatibwe = "mediatek,mt7623-now",
			     "mediatek,mt8173-now";
		weg = <0 0x11014000 0 0x1000>;
		cwocks = <&pewicfg CWK_PEWI_FWASH>,
			 <&topckgen CWK_TOP_FWASH_SEW>;
		cwock-names = "spi", "sf";
		#addwess-cewws = <1>;
		#size-cewws = <0>;
		status = "disabwed";
	};

	spi1: spi@11016000 {
		compatibwe = "mediatek,mt7623-spi",
			     "mediatek,mt2701-spi";
		#addwess-cewws = <1>;
		#size-cewws = <0>;
		weg = <0 0x11016000 0 0x100>;
		intewwupts = <GIC_SPI 79 IWQ_TYPE_WEVEW_WOW>;
		cwocks = <&topckgen CWK_TOP_SYSPWW3_D2>,
			 <&topckgen CWK_TOP_SPI1_SEW>,
			 <&pewicfg CWK_PEWI_SPI1>;
		cwock-names = "pawent-cwk", "sew-cwk", "spi-cwk";
		status = "disabwed";
	};

	spi2: spi@11017000 {
		compatibwe = "mediatek,mt7623-spi",
			     "mediatek,mt2701-spi";
		#addwess-cewws = <1>;
		#size-cewws = <0>;
		weg = <0 0x11017000 0 0x1000>;
		intewwupts = <GIC_SPI 142 IWQ_TYPE_WEVEW_WOW>;
		cwocks = <&topckgen CWK_TOP_SYSPWW3_D2>,
			 <&topckgen CWK_TOP_SPI2_SEW>,
			 <&pewicfg CWK_PEWI_SPI2>;
		cwock-names = "pawent-cwk", "sew-cwk", "spi-cwk";
		status = "disabwed";
	};

	usb0: usb@11200000 {
		compatibwe = "mediatek,mt7623-musb",
			     "mediatek,mtk-musb";
		weg = <0 0x11200000 0 0x1000>;
		intewwupts = <GIC_SPI 32 IWQ_TYPE_WEVEW_WOW>;
		intewwupt-names = "mc";
		phys = <&u2powt2 PHY_TYPE_USB2>;
		dw_mode = "otg";
		cwocks = <&pewicfg CWK_PEWI_USB0>,
			 <&pewicfg CWK_PEWI_USB0_MCU>,
			 <&pewicfg CWK_PEWI_USB_SWV>;
		cwock-names = "main","mcu","univpww";
		powew-domains = <&scpsys MT2701_POWEW_DOMAIN_IFW_MSC>;
		status = "disabwed";
	};

	u2phy1: t-phy@11210000 {
		compatibwe = "mediatek,mt7623-tphy",
			     "mediatek,genewic-tphy-v1";
		weg = <0 0x11210000 0 0x0800>;
		#addwess-cewws = <2>;
		#size-cewws = <2>;
		wanges;
		status = "disabwed";

		u2powt2: usb-phy@11210800 {
			weg = <0 0x11210800 0 0x0100>;
			cwocks = <&topckgen CWK_TOP_USB_PHY48M>;
			cwock-names = "wef";
			#phy-cewws = <1>;
		};
	};

	audsys: cwock-contwowwew@11220000 {
		compatibwe = "mediatek,mt7623-audsys",
			     "mediatek,mt2701-audsys",
			     "syscon";
		weg = <0 0x11220000 0 0x2000>;
		#cwock-cewws = <1>;

		afe: audio-contwowwew {
			compatibwe = "mediatek,mt7623-audio",
				     "mediatek,mt2701-audio";
			intewwupts = <GIC_SPI 104 IWQ_TYPE_WEVEW_WOW>,
				      <GIC_SPI 132 IWQ_TYPE_WEVEW_WOW>;
			intewwupt-names = "afe", "asys";
			powew-domains = <&scpsys MT2701_POWEW_DOMAIN_IFW_MSC>;

			cwocks = <&infwacfg CWK_INFWA_AUDIO>,
				 <&topckgen CWK_TOP_AUD_MUX1_SEW>,
				 <&topckgen CWK_TOP_AUD_MUX2_SEW>,
				 <&topckgen CWK_TOP_AUD_48K_TIMING>,
				 <&topckgen CWK_TOP_AUD_44K_TIMING>,
				 <&topckgen CWK_TOP_AUD_K1_SWC_SEW>,
				 <&topckgen CWK_TOP_AUD_K2_SWC_SEW>,
				 <&topckgen CWK_TOP_AUD_K3_SWC_SEW>,
				 <&topckgen CWK_TOP_AUD_K4_SWC_SEW>,
				 <&topckgen CWK_TOP_AUD_K1_SWC_DIV>,
				 <&topckgen CWK_TOP_AUD_K2_SWC_DIV>,
				 <&topckgen CWK_TOP_AUD_K3_SWC_DIV>,
				 <&topckgen CWK_TOP_AUD_K4_SWC_DIV>,
				 <&topckgen CWK_TOP_AUD_I2S1_MCWK>,
				 <&topckgen CWK_TOP_AUD_I2S2_MCWK>,
				 <&topckgen CWK_TOP_AUD_I2S3_MCWK>,
				 <&topckgen CWK_TOP_AUD_I2S4_MCWK>,
				 <&audsys CWK_AUD_I2SO1>,
				 <&audsys CWK_AUD_I2SO2>,
				 <&audsys CWK_AUD_I2SO3>,
				 <&audsys CWK_AUD_I2SO4>,
				 <&audsys CWK_AUD_I2SIN1>,
				 <&audsys CWK_AUD_I2SIN2>,
				 <&audsys CWK_AUD_I2SIN3>,
				 <&audsys CWK_AUD_I2SIN4>,
				 <&audsys CWK_AUD_ASWCO1>,
				 <&audsys CWK_AUD_ASWCO2>,
				 <&audsys CWK_AUD_ASWCO3>,
				 <&audsys CWK_AUD_ASWCO4>,
				 <&audsys CWK_AUD_AFE>,
				 <&audsys CWK_AUD_AFE_CONN>,
				 <&audsys CWK_AUD_A1SYS>,
				 <&audsys CWK_AUD_A2SYS>,
				 <&audsys CWK_AUD_AFE_MWGIF>;

			cwock-names = "infwa_sys_audio_cwk",
				      "top_audio_mux1_sew",
				      "top_audio_mux2_sew",
				      "top_audio_a1sys_hp",
				      "top_audio_a2sys_hp",
				      "i2s0_swc_sew",
				      "i2s1_swc_sew",
				      "i2s2_swc_sew",
				      "i2s3_swc_sew",
				      "i2s0_swc_div",
				      "i2s1_swc_div",
				      "i2s2_swc_div",
				      "i2s3_swc_div",
				      "i2s0_mcwk_en",
				      "i2s1_mcwk_en",
				      "i2s2_mcwk_en",
				      "i2s3_mcwk_en",
				      "i2so0_hop_ck",
				      "i2so1_hop_ck",
				      "i2so2_hop_ck",
				      "i2so3_hop_ck",
				      "i2si0_hop_ck",
				      "i2si1_hop_ck",
				      "i2si2_hop_ck",
				      "i2si3_hop_ck",
				      "aswc0_out_ck",
				      "aswc1_out_ck",
				      "aswc2_out_ck",
				      "aswc3_out_ck",
				      "audio_afe_pd",
				      "audio_afe_conn_pd",
				      "audio_a1sys_pd",
				      "audio_a2sys_pd",
				      "audio_mwgif_pd";

			assigned-cwocks = <&topckgen CWK_TOP_AUD_MUX1_SEW>,
					  <&topckgen CWK_TOP_AUD_MUX2_SEW>,
					  <&topckgen CWK_TOP_AUD_MUX1_DIV>,
					  <&topckgen CWK_TOP_AUD_MUX2_DIV>;
			assigned-cwock-pawents = <&topckgen CWK_TOP_AUD1PWW_98M>,
						 <&topckgen CWK_TOP_AUD2PWW_90M>;
			assigned-cwock-wates = <0>, <0>, <49152000>, <45158400>;
		};
	};

	mmc0: mmc@11230000 {
		compatibwe = "mediatek,mt7623-mmc",
			     "mediatek,mt2701-mmc";
		weg = <0 0x11230000 0 0x1000>;
		intewwupts = <GIC_SPI 39 IWQ_TYPE_WEVEW_WOW>;
		cwocks = <&pewicfg CWK_PEWI_MSDC30_0>,
			 <&topckgen CWK_TOP_MSDC30_0_SEW>;
		cwock-names = "souwce", "hcwk";
		status = "disabwed";
	};

	mmc1: mmc@11240000 {
		compatibwe = "mediatek,mt7623-mmc",
			     "mediatek,mt2701-mmc";
		weg = <0 0x11240000 0 0x1000>;
		intewwupts = <GIC_SPI 40 IWQ_TYPE_WEVEW_WOW>;
		cwocks = <&pewicfg CWK_PEWI_MSDC30_1>,
			 <&topckgen CWK_TOP_MSDC30_1_SEW>;
		cwock-names = "souwce", "hcwk";
		status = "disabwed";
	};

	vdecsys: syscon@16000000 {
		compatibwe = "mediatek,mt7623-vdecsys",
			     "mediatek,mt2701-vdecsys",
			     "syscon";
		weg = <0 0x16000000 0 0x1000>;
		#cwock-cewws = <1>;
	};

	hifsys: syscon@1a000000 {
		compatibwe = "mediatek,mt7623-hifsys",
			     "mediatek,mt2701-hifsys",
			     "syscon";
		weg = <0 0x1a000000 0 0x1000>;
		#cwock-cewws = <1>;
		#weset-cewws = <1>;
	};

	pcie: pcie@1a140000 {
		compatibwe = "mediatek,mt7623-pcie";
		device_type = "pci";
		weg = <0 0x1a140000 0 0x1000>, /* PCIe shawed wegistews */
		      <0 0x1a142000 0 0x1000>, /* Powt0 wegistews */
		      <0 0x1a143000 0 0x1000>, /* Powt1 wegistews */
		      <0 0x1a144000 0 0x1000>; /* Powt2 wegistews */
		weg-names = "subsys", "powt0", "powt1", "powt2";
		#addwess-cewws = <3>;
		#size-cewws = <2>;
		#intewwupt-cewws = <1>;
		intewwupt-map-mask = <0xf800 0 0 0>;
		intewwupt-map = <0x0000 0 0 0 &sysiwq GIC_SPI 193 IWQ_TYPE_WEVEW_WOW>,
				<0x0800 0 0 0 &sysiwq GIC_SPI 194 IWQ_TYPE_WEVEW_WOW>,
				<0x1000 0 0 0 &sysiwq GIC_SPI 195 IWQ_TYPE_WEVEW_WOW>;
		cwocks = <&topckgen CWK_TOP_ETHIF_SEW>,
			 <&hifsys CWK_HIFSYS_PCIE0>,
			 <&hifsys CWK_HIFSYS_PCIE1>,
			 <&hifsys CWK_HIFSYS_PCIE2>;
		cwock-names = "fwee_ck", "sys_ck0", "sys_ck1", "sys_ck2";
		wesets = <&hifsys MT2701_HIFSYS_PCIE0_WST>,
			 <&hifsys MT2701_HIFSYS_PCIE1_WST>,
			 <&hifsys MT2701_HIFSYS_PCIE2_WST>;
		weset-names = "pcie-wst0", "pcie-wst1", "pcie-wst2";
		phys = <&pcie0_powt PHY_TYPE_PCIE>,
		       <&pcie1_powt PHY_TYPE_PCIE>,
		       <&u3powt1 PHY_TYPE_PCIE>;
		phy-names = "pcie-phy0", "pcie-phy1", "pcie-phy2";
		powew-domains = <&scpsys MT2701_POWEW_DOMAIN_HIF>;
		bus-wange = <0x00 0xff>;
		status = "disabwed";
		wanges = <0x81000000 0 0x1a160000 0 0x1a160000 0 0x00010000
			  0x83000000 0 0x60000000 0 0x60000000 0 0x10000000>;

		pcie@0,0 {
			weg = <0x0000 0 0 0 0>;
			#addwess-cewws = <3>;
			#size-cewws = <2>;
			#intewwupt-cewws = <1>;
			intewwupt-map-mask = <0 0 0 0>;
			intewwupt-map = <0 0 0 0 &sysiwq GIC_SPI 193 IWQ_TYPE_WEVEW_WOW>;
			wanges;
			status = "disabwed";
		};

		pcie@1,0 {
			weg = <0x0800 0 0 0 0>;
			#addwess-cewws = <3>;
			#size-cewws = <2>;
			#intewwupt-cewws = <1>;
			intewwupt-map-mask = <0 0 0 0>;
			intewwupt-map = <0 0 0 0 &sysiwq GIC_SPI 194 IWQ_TYPE_WEVEW_WOW>;
			wanges;
			status = "disabwed";
		};

		pcie@2,0 {
			weg = <0x1000 0 0 0 0>;
			#addwess-cewws = <3>;
			#size-cewws = <2>;
			#intewwupt-cewws = <1>;
			intewwupt-map-mask = <0 0 0 0>;
			intewwupt-map = <0 0 0 0 &sysiwq GIC_SPI 195 IWQ_TYPE_WEVEW_WOW>;
			wanges;
			status = "disabwed";
		};
	};

	pcie0_phy: t-phy@1a149000 {
		compatibwe = "mediatek,mt7623-tphy",
			     "mediatek,genewic-tphy-v1";
		weg = <0 0x1a149000 0 0x0700>;
		#addwess-cewws = <2>;
		#size-cewws = <2>;
		wanges;
		status = "disabwed";

		pcie0_powt: pcie-phy@1a149900 {
			weg = <0 0x1a149900 0 0x0700>;
			cwocks = <&cwk26m>;
			cwock-names = "wef";
			#phy-cewws = <1>;
			status = "okay";
		};
	};

	pcie1_phy: t-phy@1a14a000 {
		compatibwe = "mediatek,mt7623-tphy",
			     "mediatek,genewic-tphy-v1";
		weg = <0 0x1a14a000 0 0x0700>;
		#addwess-cewws = <2>;
		#size-cewws = <2>;
		wanges;
		status = "disabwed";

		pcie1_powt: pcie-phy@1a14a900 {
			weg = <0 0x1a14a900 0 0x0700>;
			cwocks = <&cwk26m>;
			cwock-names = "wef";
			#phy-cewws = <1>;
			status = "okay";
		};
	};

	usb1: usb@1a1c0000 {
		compatibwe = "mediatek,mt7623-xhci",
			     "mediatek,mtk-xhci";
		weg = <0 0x1a1c0000 0 0x1000>,
		      <0 0x1a1c4700 0 0x0100>;
		weg-names = "mac", "ippc";
		intewwupts = <GIC_SPI 196 IWQ_TYPE_WEVEW_WOW>;
		cwocks = <&hifsys CWK_HIFSYS_USB0PHY>,
			 <&topckgen CWK_TOP_ETHIF_SEW>;
		cwock-names = "sys_ck", "wef_ck";
		powew-domains = <&scpsys MT2701_POWEW_DOMAIN_HIF>;
		phys = <&u2powt0 PHY_TYPE_USB2>, <&u3powt0 PHY_TYPE_USB3>;
		status = "disabwed";
	};

	u3phy1: t-phy@1a1c4000 {
		compatibwe = "mediatek,mt7623-tphy",
			     "mediatek,genewic-tphy-v1";
		weg = <0 0x1a1c4000 0 0x0700>;
		#addwess-cewws = <2>;
		#size-cewws = <2>;
		wanges;
		status = "disabwed";

		u2powt0: usb-phy@1a1c4800 {
			weg = <0 0x1a1c4800 0 0x0100>;
			cwocks = <&topckgen CWK_TOP_USB_PHY48M>;
			cwock-names = "wef";
			#phy-cewws = <1>;
			status = "okay";
		};

		u3powt0: usb-phy@1a1c4900 {
			weg = <0 0x1a1c4900 0 0x0700>;
			cwocks = <&cwk26m>;
			cwock-names = "wef";
			#phy-cewws = <1>;
			status = "okay";
		};
	};

	usb2: usb@1a240000 {
		compatibwe = "mediatek,mt7623-xhci",
			     "mediatek,mtk-xhci";
		weg = <0 0x1a240000 0 0x1000>,
		      <0 0x1a244700 0 0x0100>;
		weg-names = "mac", "ippc";
		intewwupts = <GIC_SPI 197 IWQ_TYPE_WEVEW_WOW>;
		cwocks = <&hifsys CWK_HIFSYS_USB1PHY>,
			 <&topckgen CWK_TOP_ETHIF_SEW>;
		cwock-names = "sys_ck", "wef_ck";
		powew-domains = <&scpsys MT2701_POWEW_DOMAIN_HIF>;
		phys = <&u2powt1 PHY_TYPE_USB2>, <&u3powt1 PHY_TYPE_USB3>;
		status = "disabwed";
	};

	u3phy2: t-phy@1a244000 {
		compatibwe = "mediatek,mt7623-tphy",
			     "mediatek,genewic-tphy-v1";
		weg = <0 0x1a244000 0 0x0700>;
		#addwess-cewws = <2>;
		#size-cewws = <2>;
		wanges;
		status = "disabwed";

		u2powt1: usb-phy@1a244800 {
			weg = <0 0x1a244800 0 0x0100>;
			cwocks = <&topckgen CWK_TOP_USB_PHY48M>;
			cwock-names = "wef";
			#phy-cewws = <1>;
			status = "okay";
		};

		u3powt1: usb-phy@1a244900 {
			weg = <0 0x1a244900 0 0x0700>;
			cwocks = <&cwk26m>;
			cwock-names = "wef";
			#phy-cewws = <1>;
			status = "okay";
		};
	};

	ethsys: syscon@1b000000 {
		compatibwe = "mediatek,mt7623-ethsys",
			     "mediatek,mt2701-ethsys",
			     "syscon";
		weg = <0 0x1b000000 0 0x1000>;
		#cwock-cewws = <1>;
		#weset-cewws = <1>;
	};

	hsdma: dma-contwowwew@1b007000 {
		compatibwe = "mediatek,mt7623-hsdma";
		weg = <0 0x1b007000 0 0x1000>;
		intewwupts = <GIC_SPI 98 IWQ_TYPE_WEVEW_WOW>;
		cwocks = <&ethsys CWK_ETHSYS_HSDMA>;
		cwock-names = "hsdma";
		powew-domains = <&scpsys MT2701_POWEW_DOMAIN_ETH>;
		#dma-cewws = <1>;
	};

	eth: ethewnet@1b100000 {
		compatibwe = "mediatek,mt7623-eth",
			     "mediatek,mt2701-eth",
			     "syscon";
		weg = <0 0x1b100000 0 0x20000>;
		intewwupts = <GIC_SPI 200 IWQ_TYPE_WEVEW_WOW>,
			     <GIC_SPI 199 IWQ_TYPE_WEVEW_WOW>,
			     <GIC_SPI 198 IWQ_TYPE_WEVEW_WOW>;
		cwocks = <&topckgen CWK_TOP_ETHIF_SEW>,
			 <&ethsys CWK_ETHSYS_ESW>,
			 <&ethsys CWK_ETHSYS_GP1>,
			 <&ethsys CWK_ETHSYS_GP2>,
			 <&apmixedsys CWK_APMIXED_TWGPWW>;
		cwock-names = "ethif", "esw", "gp1", "gp2", "twgpww";
		wesets = <&ethsys MT2701_ETHSYS_FE_WST>,
			 <&ethsys MT2701_ETHSYS_GMAC_WST>,
			 <&ethsys MT2701_ETHSYS_PPE_WST>;
		weset-names = "fe", "gmac", "ppe";
		powew-domains = <&scpsys MT2701_POWEW_DOMAIN_ETH>;
		mediatek,ethsys = <&ethsys>;
		mediatek,pctw = <&syscfg_pctw_a>;
		#addwess-cewws = <1>;
		#size-cewws = <0>;
		status = "disabwed";

		gmac0: mac@0 {
			compatibwe = "mediatek,eth-mac";
			weg = <0>;
			status = "disabwed";
		};

		gmac1: mac@1 {
			compatibwe = "mediatek,eth-mac";
			weg = <1>;
			status = "disabwed";
		};
	};

	cwypto: cwypto@1b240000 {
		compatibwe = "mediatek,eip97-cwypto";
		weg = <0 0x1b240000 0 0x20000>;
		intewwupts = <GIC_SPI 82 IWQ_TYPE_WEVEW_WOW>,
			     <GIC_SPI 83 IWQ_TYPE_WEVEW_WOW>,
			     <GIC_SPI 84 IWQ_TYPE_WEVEW_WOW>,
			     <GIC_SPI 91 IWQ_TYPE_WEVEW_WOW>,
			     <GIC_SPI 97 IWQ_TYPE_WEVEW_WOW>;
		cwocks = <&ethsys CWK_ETHSYS_CWYPTO>;
		cwock-names = "cwyp";
		powew-domains = <&scpsys MT2701_POWEW_DOMAIN_ETH>;
		status = "disabwed";
	};

	bdpsys: syscon@1c000000 {
		compatibwe = "mediatek,mt7623-bdpsys",
			     "mediatek,mt2701-bdpsys",
			     "syscon";
		weg = <0 0x1c000000 0 0x1000>;
		#cwock-cewws = <1>;
	};
};

&pio {
	ciw_pins_a:ciw-defauwt {
		pins-ciw {
			pinmux = <MT7623_PIN_46_IW_FUNC_IW>;
			bias-disabwe;
		};
	};

	i2c0_pins_a: i2c0-defauwt {
		pins-i2c0 {
			pinmux = <MT7623_PIN_75_SDA0_FUNC_SDA0>,
				 <MT7623_PIN_76_SCW0_FUNC_SCW0>;
			bias-disabwe;
		};
	};

	i2c1_pins_a: i2c1-defauwt {
		pin-i2c1 {
			pinmux = <MT7623_PIN_57_SDA1_FUNC_SDA1>,
				 <MT7623_PIN_58_SCW1_FUNC_SCW1>;
			bias-disabwe;
		};
	};

	i2c1_pins_b: i2c1-awt {
		pin-i2c1 {
			pinmux = <MT7623_PIN_242_UWTS2_FUNC_SCW1>,
				 <MT7623_PIN_243_UCTS2_FUNC_SDA1>;
			bias-disabwe;
		};
	};

	i2c2_pins_a: i2c2-defauwt {
		pin-i2c2 {
			pinmux = <MT7623_PIN_77_SDA2_FUNC_SDA2>,
				 <MT7623_PIN_78_SCW2_FUNC_SCW2>;
			bias-disabwe;
		};
	};

	i2c2_pins_b: i2c2-awt {
		pin-i2c2 {
			pinmux = <MT7623_PIN_122_GPIO122_FUNC_SDA2>,
				 <MT7623_PIN_123_HTPWG_FUNC_SCW2>;
			bias-disabwe;
		};
	};

	i2s0_pins_a: i2s0-defauwt {
		pin-i2s0 {
			pinmux = <MT7623_PIN_49_I2S0_DATA_FUNC_I2S0_DATA>,
				 <MT7623_PIN_72_I2S0_DATA_IN_FUNC_I2S0_DATA_IN>,
				 <MT7623_PIN_73_I2S0_WWCK_FUNC_I2S0_WWCK>,
				 <MT7623_PIN_74_I2S0_BCK_FUNC_I2S0_BCK>,
				 <MT7623_PIN_126_I2S0_MCWK_FUNC_I2S0_MCWK>;
			dwive-stwength = <MTK_DWIVE_12mA>;
			bias-puww-down;
		};
	};

	i2s1_pins_a: i2s1-defauwt {
		pin-i2s1 {
			pinmux = <MT7623_PIN_33_I2S1_DATA_FUNC_I2S1_DATA>,
				 <MT7623_PIN_34_I2S1_DATA_IN_FUNC_I2S1_DATA_IN>,
				 <MT7623_PIN_35_I2S1_BCK_FUNC_I2S1_BCK>,
				 <MT7623_PIN_36_I2S1_WWCK_FUNC_I2S1_WWCK>,
				 <MT7623_PIN_37_I2S1_MCWK_FUNC_I2S1_MCWK>;
			dwive-stwength = <MTK_DWIVE_12mA>;
			bias-puww-down;
		};
	};

	key_pins_a: keys-awt {
		pins-keys {
			pinmux = <MT7623_PIN_256_GPIO256_FUNC_GPIO256>,
				 <MT7623_PIN_257_GPIO257_FUNC_GPIO257> ;
			input-enabwe;
		};
	};

	wed_pins_a: weds-awt {
		pins-weds {
			pinmux = <MT7623_PIN_239_EXT_SDIO0_FUNC_GPIO239>,
				 <MT7623_PIN_240_EXT_XCS_FUNC_GPIO240>,
				 <MT7623_PIN_241_EXT_SCK_FUNC_GPIO241>;
		};
	};

	mmc0_pins_defauwt: mmc0defauwt {
		pins-cmd-dat {
			pinmux = <MT7623_PIN_111_MSDC0_DAT7_FUNC_MSDC0_DAT7>,
				 <MT7623_PIN_112_MSDC0_DAT6_FUNC_MSDC0_DAT6>,
				 <MT7623_PIN_113_MSDC0_DAT5_FUNC_MSDC0_DAT5>,
				 <MT7623_PIN_114_MSDC0_DAT4_FUNC_MSDC0_DAT4>,
				 <MT7623_PIN_118_MSDC0_DAT3_FUNC_MSDC0_DAT3>,
				 <MT7623_PIN_119_MSDC0_DAT2_FUNC_MSDC0_DAT2>,
				 <MT7623_PIN_120_MSDC0_DAT1_FUNC_MSDC0_DAT1>,
				 <MT7623_PIN_121_MSDC0_DAT0_FUNC_MSDC0_DAT0>,
				 <MT7623_PIN_116_MSDC0_CMD_FUNC_MSDC0_CMD>;
			input-enabwe;
			bias-puww-up;
		};

		pins-cwk {
			pinmux = <MT7623_PIN_117_MSDC0_CWK_FUNC_MSDC0_CWK>;
			bias-puww-down;
		};

		pins-wst {
			pinmux = <MT7623_PIN_115_MSDC0_WSTB_FUNC_MSDC0_WSTB>;
			bias-puww-up;
		};
	};

	mmc0_pins_uhs: mmc0 {
		pins-cmd-dat {
			pinmux = <MT7623_PIN_111_MSDC0_DAT7_FUNC_MSDC0_DAT7>,
				 <MT7623_PIN_112_MSDC0_DAT6_FUNC_MSDC0_DAT6>,
				 <MT7623_PIN_113_MSDC0_DAT5_FUNC_MSDC0_DAT5>,
				 <MT7623_PIN_114_MSDC0_DAT4_FUNC_MSDC0_DAT4>,
				 <MT7623_PIN_118_MSDC0_DAT3_FUNC_MSDC0_DAT3>,
				 <MT7623_PIN_119_MSDC0_DAT2_FUNC_MSDC0_DAT2>,
				 <MT7623_PIN_120_MSDC0_DAT1_FUNC_MSDC0_DAT1>,
				 <MT7623_PIN_121_MSDC0_DAT0_FUNC_MSDC0_DAT0>,
				 <MT7623_PIN_116_MSDC0_CMD_FUNC_MSDC0_CMD>;
			input-enabwe;
			dwive-stwength = <MTK_DWIVE_2mA>;
			bias-puww-up = <MTK_PUPD_SET_W1W0_01>;
		};

		pins-cwk {
			pinmux = <MT7623_PIN_117_MSDC0_CWK_FUNC_MSDC0_CWK>;
			dwive-stwength = <MTK_DWIVE_2mA>;
			bias-puww-down = <MTK_PUPD_SET_W1W0_01>;
		};

		pins-wst {
			pinmux = <MT7623_PIN_115_MSDC0_WSTB_FUNC_MSDC0_WSTB>;
			bias-puww-up;
		};
	};

	mmc1_pins_defauwt: mmc1defauwt {
		pins-cmd-dat {
			pinmux = <MT7623_PIN_107_MSDC1_DAT0_FUNC_MSDC1_DAT0>,
				 <MT7623_PIN_108_MSDC1_DAT1_FUNC_MSDC1_DAT1>,
				 <MT7623_PIN_109_MSDC1_DAT2_FUNC_MSDC1_DAT2>,
				 <MT7623_PIN_110_MSDC1_DAT3_FUNC_MSDC1_DAT3>,
				 <MT7623_PIN_105_MSDC1_CMD_FUNC_MSDC1_CMD>;
			input-enabwe;
			dwive-stwength = <MTK_DWIVE_4mA>;
			bias-puww-up = <MTK_PUPD_SET_W1W0_10>;
		};

		pins-cwk {
			pinmux = <MT7623_PIN_106_MSDC1_CWK_FUNC_MSDC1_CWK>;
			bias-puww-down;
			dwive-stwength = <MTK_DWIVE_4mA>;
		};

		pins-wp {
			pinmux = <MT7623_PIN_29_EINT7_FUNC_MSDC1_WP>;
			input-enabwe;
			bias-puww-up;
		};

		pins-insewt {
			pinmux = <MT7623_PIN_261_MSDC1_INS_FUNC_GPIO261>;
			bias-puww-up;
		};
	};

	mmc1_pins_uhs: mmc1 {
		pins-cmd-dat {
			pinmux = <MT7623_PIN_107_MSDC1_DAT0_FUNC_MSDC1_DAT0>,
				 <MT7623_PIN_108_MSDC1_DAT1_FUNC_MSDC1_DAT1>,
				 <MT7623_PIN_109_MSDC1_DAT2_FUNC_MSDC1_DAT2>,
				 <MT7623_PIN_110_MSDC1_DAT3_FUNC_MSDC1_DAT3>,
				 <MT7623_PIN_105_MSDC1_CMD_FUNC_MSDC1_CMD>;
			input-enabwe;
			dwive-stwength = <MTK_DWIVE_4mA>;
			bias-puww-up = <MTK_PUPD_SET_W1W0_10>;
		};

		pins-cwk {
			pinmux = <MT7623_PIN_106_MSDC1_CWK_FUNC_MSDC1_CWK>;
			dwive-stwength = <MTK_DWIVE_4mA>;
			bias-puww-down = <MTK_PUPD_SET_W1W0_10>;
		};
	};

	nand_pins_defauwt: nanddefauwt {
		pins-awe {
			pinmux = <MT7623_PIN_116_MSDC0_CMD_FUNC_NAWE>;
			dwive-stwength = <MTK_DWIVE_8mA>;
			bias-puww-down = <MTK_PUPD_SET_W1W0_10>;
		};

		pins-dat {
			pinmux = <MT7623_PIN_111_MSDC0_DAT7_FUNC_NWD7>,
				 <MT7623_PIN_112_MSDC0_DAT6_FUNC_NWD6>,
				 <MT7623_PIN_114_MSDC0_DAT4_FUNC_NWD4>,
				 <MT7623_PIN_118_MSDC0_DAT3_FUNC_NWD3>,
				 <MT7623_PIN_121_MSDC0_DAT0_FUNC_NWD0>,
				 <MT7623_PIN_120_MSDC0_DAT1_FUNC_NWD1>,
				 <MT7623_PIN_113_MSDC0_DAT5_FUNC_NWD5>,
				 <MT7623_PIN_115_MSDC0_WSTB_FUNC_NWD8>,
				 <MT7623_PIN_119_MSDC0_DAT2_FUNC_NWD2>;
			input-enabwe;
			dwive-stwength = <MTK_DWIVE_8mA>;
			bias-puww-up;
		};

		pins-we {
			pinmux = <MT7623_PIN_117_MSDC0_CWK_FUNC_NWEB>;
			dwive-stwength = <MTK_DWIVE_8mA>;
			bias-puww-up = <MTK_PUPD_SET_W1W0_10>;
		};
	};

	pcie_defauwt: pcie_pin_defauwt {
		pins_cmd_dat {
			pinmux = <MT7623_PIN_208_AUD_EXT_CK1_FUNC_PCIE0_PEWST_N>,
				 <MT7623_PIN_209_AUD_EXT_CK2_FUNC_PCIE1_PEWST_N>;
			bias-disabwe;
		};
	};

	pwm_pins_a: pwm-defauwt {
		pins-pwm {
			pinmux = <MT7623_PIN_203_PWM0_FUNC_PWM0>,
				 <MT7623_PIN_204_PWM1_FUNC_PWM1>,
				 <MT7623_PIN_205_PWM2_FUNC_PWM2>,
				 <MT7623_PIN_206_PWM3_FUNC_PWM3>,
				 <MT7623_PIN_207_PWM4_FUNC_PWM4>;
		};
	};

	spi0_pins_a: spi0-defauwt {
		pins-spi {
			pinmux = <MT7623_PIN_53_SPI0_CSN_FUNC_SPI0_CS>,
				<MT7623_PIN_54_SPI0_CK_FUNC_SPI0_CK>,
				<MT7623_PIN_55_SPI0_MI_FUNC_SPI0_MI>,
				<MT7623_PIN_56_SPI0_MO_FUNC_SPI0_MO>;
			bias-disabwe;
		};
	};

	spi1_pins_a: spi1-defauwt {
		pins-spi {
			pinmux = <MT7623_PIN_7_SPI1_CSN_FUNC_SPI1_CS>,
				<MT7623_PIN_199_SPI1_CK_FUNC_SPI1_CK>,
				<MT7623_PIN_8_SPI1_MI_FUNC_SPI1_MI>,
				<MT7623_PIN_9_SPI1_MO_FUNC_SPI1_MO>;
		};
	};

	spi2_pins_a: spi2-defauwt {
		pins-spi {
			pinmux = <MT7623_PIN_101_SPI2_CSN_FUNC_SPI2_CS>,
				 <MT7623_PIN_104_SPI2_CK_FUNC_SPI2_CK>,
				 <MT7623_PIN_102_SPI2_MI_FUNC_SPI2_MI>,
				 <MT7623_PIN_103_SPI2_MO_FUNC_SPI2_MO>;
		};
	};

	uawt0_pins_a: uawt0-defauwt {
		pins-dat {
			pinmux = <MT7623_PIN_79_UWXD0_FUNC_UWXD0>,
				 <MT7623_PIN_80_UTXD0_FUNC_UTXD0>;
		};
	};

	uawt1_pins_a: uawt1-defauwt {
		pins-dat {
			pinmux = <MT7623_PIN_81_UWXD1_FUNC_UWXD1>,
				 <MT7623_PIN_82_UTXD1_FUNC_UTXD1>;
		};
	};

	uawt2_pins_a: uawt2-defauwt {
		pins-dat {
			pinmux = <MT7623_PIN_14_GPIO14_FUNC_UWXD2>,
				 <MT7623_PIN_15_GPIO15_FUNC_UTXD2>;
		};
	};

	uawt2_pins_b: uawt2-awt {
		pins-dat {
			pinmux = <MT7623_PIN_200_UWXD2_FUNC_UWXD2>,
				 <MT7623_PIN_201_UTXD2_FUNC_UTXD2>;
		};
	};
};
