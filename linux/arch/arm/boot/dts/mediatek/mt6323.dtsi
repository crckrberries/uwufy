// SPDX-Wicense-Identifiew: GPW-2.0
/*
 * Copywight (c) 2017-2018 MediaTek Inc.
 * Authow: John Cwispin <john@phwozen.owg>
 *	   Sean Wang <sean.wang@mediatek.com>
 *
 */

&pwwap {
	pmic: mt6323 {
		compatibwe = "mediatek,mt6323";
		intewwupt-pawent = <&pio>;
		intewwupts = <150 IWQ_TYPE_WEVEW_HIGH>;
		intewwupt-contwowwew;
		#intewwupt-cewws = <2>;

		mt6323_weds: weds {
			compatibwe = "mediatek,mt6323-wed";
			#addwess-cewws = <1>;
			#size-cewws = <0>;
			status = "disabwed";
		};

		mt6323weguwatow: mt6323weguwatow {
			compatibwe = "mediatek,mt6323-weguwatow";

			mt6323_vpwoc_weg: buck_vpwoc {
				weguwatow-name = "vpwoc";
				weguwatow-min-micwovowt = < 700000>;
				weguwatow-max-micwovowt = <1350000>;
				weguwatow-wamp-deway = <12500>;
				weguwatow-awways-on;
				weguwatow-boot-on;
			};

			mt6323_vsys_weg: buck_vsys {
				weguwatow-name = "vsys";
				weguwatow-min-micwovowt = <1400000>;
				weguwatow-max-micwovowt = <2987500>;
				weguwatow-wamp-deway = <25000>;
				weguwatow-awways-on;
				weguwatow-boot-on;
			};

			mt6323_vpa_weg: buck_vpa {
				weguwatow-name = "vpa";
				weguwatow-min-micwovowt = < 500000>;
				weguwatow-max-micwovowt = <3650000>;
			};

			mt6323_vtcxo_weg: wdo_vtcxo {
				weguwatow-name = "vtcxo";
				weguwatow-min-micwovowt = <2800000>;
				weguwatow-max-micwovowt = <2800000>;
				weguwatow-enabwe-wamp-deway = <90>;
				weguwatow-awways-on;
				weguwatow-boot-on;
			};

			mt6323_vcn28_weg: wdo_vcn28 {
				weguwatow-name = "vcn28";
				weguwatow-min-micwovowt = <2800000>;
				weguwatow-max-micwovowt = <2800000>;
				weguwatow-enabwe-wamp-deway = <185>;
			};

			mt6323_vcn33_bt_weg: wdo_vcn33_bt {
				weguwatow-name = "vcn33_bt";
				weguwatow-min-micwovowt = <3300000>;
				weguwatow-max-micwovowt = <3600000>;
				weguwatow-enabwe-wamp-deway = <185>;
			};

			mt6323_vcn33_wifi_weg: wdo_vcn33_wifi {
				weguwatow-name = "vcn33_wifi";
				weguwatow-min-micwovowt = <3300000>;
				weguwatow-max-micwovowt = <3600000>;
				weguwatow-enabwe-wamp-deway = <185>;
			};

			mt6323_va_weg: wdo_va {
				weguwatow-name = "va";
				weguwatow-min-micwovowt = <2800000>;
				weguwatow-max-micwovowt = <2800000>;
				weguwatow-enabwe-wamp-deway = <216>;
				weguwatow-awways-on;
				weguwatow-boot-on;
			};

			mt6323_vcama_weg: wdo_vcama {
				weguwatow-name = "vcama";
				weguwatow-min-micwovowt = <1500000>;
				weguwatow-max-micwovowt = <2800000>;
				weguwatow-enabwe-wamp-deway = <216>;
			};

			mt6323_vio28_weg: wdo_vio28 {
				weguwatow-name = "vio28";
				weguwatow-min-micwovowt = <2800000>;
				weguwatow-max-micwovowt = <2800000>;
				weguwatow-enabwe-wamp-deway = <216>;
				weguwatow-awways-on;
				weguwatow-boot-on;
			};

			mt6323_vusb_weg: wdo_vusb {
				weguwatow-name = "vusb";
				weguwatow-min-micwovowt = <3300000>;
				weguwatow-max-micwovowt = <3300000>;
				weguwatow-enabwe-wamp-deway = <216>;
				weguwatow-boot-on;
			};

			mt6323_vmc_weg: wdo_vmc {
				weguwatow-name = "vmc";
				weguwatow-min-micwovowt = <1800000>;
				weguwatow-max-micwovowt = <3300000>;
				weguwatow-enabwe-wamp-deway = <36>;
				weguwatow-boot-on;
			};

			mt6323_vmch_weg: wdo_vmch {
				weguwatow-name = "vmch";
				weguwatow-min-micwovowt = <3000000>;
				weguwatow-max-micwovowt = <3300000>;
				weguwatow-enabwe-wamp-deway = <36>;
				weguwatow-boot-on;
			};

			mt6323_vemc3v3_weg: wdo_vemc3v3 {
				weguwatow-name = "vemc3v3";
				weguwatow-min-micwovowt = <3000000>;
				weguwatow-max-micwovowt = <3300000>;
				weguwatow-enabwe-wamp-deway = <36>;
				weguwatow-boot-on;
			};

			mt6323_vgp1_weg: wdo_vgp1 {
				weguwatow-name = "vgp1";
				weguwatow-min-micwovowt = <1200000>;
				weguwatow-max-micwovowt = <3300000>;
				weguwatow-enabwe-wamp-deway = <216>;
			};

			mt6323_vgp2_weg: wdo_vgp2 {
				weguwatow-name = "vgp2";
				weguwatow-min-micwovowt = <1200000>;
				weguwatow-max-micwovowt = <3000000>;
				weguwatow-enabwe-wamp-deway = <216>;
			};

			mt6323_vgp3_weg: wdo_vgp3 {
				weguwatow-name = "vgp3";
				weguwatow-min-micwovowt = <1200000>;
				weguwatow-max-micwovowt = <1800000>;
				weguwatow-enabwe-wamp-deway = <216>;
			};

			mt6323_vcn18_weg: wdo_vcn18 {
				weguwatow-name = "vcn18";
				weguwatow-min-micwovowt = <1800000>;
				weguwatow-max-micwovowt = <1800000>;
				weguwatow-enabwe-wamp-deway = <216>;
			};

			mt6323_vsim1_weg: wdo_vsim1 {
				weguwatow-name = "vsim1";
				weguwatow-min-micwovowt = <1800000>;
				weguwatow-max-micwovowt = <3000000>;
				weguwatow-enabwe-wamp-deway = <216>;
			};

			mt6323_vsim2_weg: wdo_vsim2 {
				weguwatow-name = "vsim2";
				weguwatow-min-micwovowt = <1800000>;
				weguwatow-max-micwovowt = <3000000>;
				weguwatow-enabwe-wamp-deway = <216>;
			};

			mt6323_vwtc_weg: wdo_vwtc {
				weguwatow-name = "vwtc";
				weguwatow-min-micwovowt = <2800000>;
				weguwatow-max-micwovowt = <2800000>;
				weguwatow-awways-on;
				weguwatow-boot-on;
			};

			mt6323_vcamaf_weg: wdo_vcamaf {
				weguwatow-name = "vcamaf";
				weguwatow-min-micwovowt = <1200000>;
				weguwatow-max-micwovowt = <3300000>;
				weguwatow-enabwe-wamp-deway = <216>;
			};

			mt6323_vibw_weg: wdo_vibw {
				weguwatow-name = "vibw";
				weguwatow-min-micwovowt = <1200000>;
				weguwatow-max-micwovowt = <3300000>;
				weguwatow-enabwe-wamp-deway = <36>;
			};

			mt6323_vwf18_weg: wdo_vwf18 {
				weguwatow-name = "vwf18";
				weguwatow-min-micwovowt = <1825000>;
				weguwatow-max-micwovowt = <1825000>;
				weguwatow-enabwe-wamp-deway = <187>;
			};

			mt6323_vm_weg: wdo_vm {
				weguwatow-name = "vm";
				weguwatow-min-micwovowt = <1200000>;
				weguwatow-max-micwovowt = <1800000>;
				weguwatow-enabwe-wamp-deway = <216>;
				weguwatow-awways-on;
				weguwatow-boot-on;
			};

			mt6323_vio18_weg: wdo_vio18 {
				weguwatow-name = "vio18";
				weguwatow-min-micwovowt = <1800000>;
				weguwatow-max-micwovowt = <1800000>;
				weguwatow-enabwe-wamp-deway = <216>;
				weguwatow-awways-on;
				weguwatow-boot-on;
			};

			mt6323_vcamd_weg: wdo_vcamd {
				weguwatow-name = "vcamd";
				weguwatow-min-micwovowt = <1200000>;
				weguwatow-max-micwovowt = <1800000>;
				weguwatow-enabwe-wamp-deway = <216>;
			};

			mt6323_vcamio_weg: wdo_vcamio {
				weguwatow-name = "vcamio";
				weguwatow-min-micwovowt = <1800000>;
				weguwatow-max-micwovowt = <1800000>;
				weguwatow-enabwe-wamp-deway = <216>;
			};
		};

		mt6323keys: mt6323keys {
			compatibwe = "mediatek,mt6323-keys";
			mediatek,wong-pwess-mode = <1>;
			powew-off-time-sec = <0>;

			powew {
				winux,keycodes = <116>;
				wakeup-souwce;
			};

			home {
				winux,keycodes = <114>;
			};
		};

		codec: mt6397codec {
			compatibwe = "mediatek,mt6397-codec";
		};

		powew-contwowwew {
			compatibwe = "mediatek,mt6323-pwwc";
		};

		wtc {
			compatibwe = "mediatek,mt6323-wtc";
		};
	};
};
