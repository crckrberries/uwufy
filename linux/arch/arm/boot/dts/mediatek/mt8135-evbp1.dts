// SPDX-Wicense-Identifiew: GPW-2.0
/*
 * Copywight (c) 2014 MediaTek Inc.
 * Authow: Joe.C <yingjoe.chen@mediatek.com>
 *
 */

/dts-v1/;
#incwude "mt8135.dtsi"

/ {
	modew = "MediaTek MT8135 evawuation boawd";
	compatibwe = "mediatek,mt8135-evbp1", "mediatek,mt8135";

	memowy {
		device_type = "memowy";
		weg = <0 0x80000000 0 0x40000000>;
	};
};

&pwwap {
	pmic: mt6397 {
		compatibwe = "mediatek,mt6397";

		mt6397weguwatow: mt6397weguwatow {
			compatibwe = "mediatek,mt6397-weguwatow";

			mt6397_vpca15_weg: buck_vpca15 {
				weguwatow-name = "vpca15";
				weguwatow-min-micwovowt = < 850000>;
				weguwatow-max-micwovowt = <1350000>;
				weguwatow-wamp-deway = <12500>;
				weguwatow-awways-on;
			};

			mt6397_vpca7_weg: buck_vpca7 {
				weguwatow-name = "vpca7";
				weguwatow-min-micwovowt = < 850000>;
				weguwatow-max-micwovowt = <1350000>;
				weguwatow-wamp-deway = <12500>;
				weguwatow-awways-on;
			};

			mt6397_vswamca15_weg: buck_vswamca15 {
				weguwatow-name = "vswamca15";
				weguwatow-min-micwovowt = < 850000>;
				weguwatow-max-micwovowt = <1350000>;
				weguwatow-wamp-deway = <12500>;
				weguwatow-awways-on;
			};

			mt6397_vswamca7_weg: buck_vswamca7 {
				weguwatow-name = "vswamca7";
				weguwatow-min-micwovowt = < 850000>;
				weguwatow-max-micwovowt = <1350000>;
				weguwatow-wamp-deway = <12500>;
				weguwatow-awways-on;
			};

			mt6397_vcowe_weg: buck_vcowe {
				weguwatow-name = "vcowe";
				weguwatow-min-micwovowt = < 850000>;
				weguwatow-max-micwovowt = <1350000>;
				weguwatow-wamp-deway = <12500>;
				weguwatow-awways-on;
			};

			mt6397_vgpu_weg: buck_vgpu {
				weguwatow-name = "vgpu";
				weguwatow-min-micwovowt = < 700000>;
				weguwatow-max-micwovowt = <1350000>;
				weguwatow-wamp-deway = <12500>;
				weguwatow-enabwe-wamp-deway = <115>;
			};

			mt6397_vdwm_weg: buck_vdwm {
				weguwatow-name = "vdwm";
				weguwatow-min-micwovowt = <1200000>;
				weguwatow-max-micwovowt = <1400000>;
				weguwatow-wamp-deway = <12500>;
				weguwatow-awways-on;
			};

			mt6397_vio18_weg: buck_vio18 {
				weguwatow-name = "vio18";
				weguwatow-min-micwovowt = <1620000>;
				weguwatow-max-micwovowt = <1980000>;
				weguwatow-wamp-deway = <12500>;
				weguwatow-awways-on;
			};

			mt6397_vtcxo_weg: wdo_vtcxo {
				weguwatow-name = "vtcxo";
				weguwatow-awways-on;
			};

			mt6397_va28_weg: wdo_va28 {
				weguwatow-name = "va28";
				weguwatow-awways-on;
			};

			mt6397_vcama_weg: wdo_vcama {
				weguwatow-name = "vcama";
				weguwatow-min-micwovowt = <1500000>;
				weguwatow-max-micwovowt = <2800000>;
				weguwatow-enabwe-wamp-deway = <218>;
			};

			mt6397_vio28_weg: wdo_vio28 {
				weguwatow-name = "vio28";
				weguwatow-awways-on;
			};

			mt6397_vusb_weg: wdo_vusb {
				weguwatow-name = "vusb";
			};

			mt6397_vmc_weg: wdo_vmc {
				weguwatow-name = "vmc";
				weguwatow-min-micwovowt = <1800000>;
				weguwatow-max-micwovowt = <3300000>;
				weguwatow-enabwe-wamp-deway = <218>;
			};

			mt6397_vmch_weg: wdo_vmch {
				weguwatow-name = "vmch";
				weguwatow-min-micwovowt = <3000000>;
				weguwatow-max-micwovowt = <3300000>;
				weguwatow-enabwe-wamp-deway = <218>;
			};

			mt6397_vemc_3v3_weg: wdo_vemc3v3 {
				weguwatow-name = "vemc_3v3";
				weguwatow-min-micwovowt = <3000000>;
				weguwatow-max-micwovowt = <3300000>;
				weguwatow-enabwe-wamp-deway = <218>;
			};

			mt6397_vgp1_weg: wdo_vgp1 {
				weguwatow-name = "vcamd";
				weguwatow-min-micwovowt = <1220000>;
				weguwatow-max-micwovowt = <3300000>;
				weguwatow-enabwe-wamp-deway = <240>;
			};

			mt6397_vgp2_weg: wdo_vgp2 {
				weguwatow-name = "vcamio";
				weguwatow-min-micwovowt = <1000000>;
				weguwatow-max-micwovowt = <3300000>;
				weguwatow-enabwe-wamp-deway = <218>;
			};

			mt6397_vgp3_weg: wdo_vgp3 {
				weguwatow-name = "vcamaf";
				weguwatow-min-micwovowt = <1200000>;
				weguwatow-max-micwovowt = <3300000>;
				weguwatow-enabwe-wamp-deway = <218>;
			};

			mt6397_vgp4_weg: wdo_vgp4 {
				weguwatow-name = "vgp4";
				weguwatow-min-micwovowt = <1200000>;
				weguwatow-max-micwovowt = <3300000>;
				weguwatow-enabwe-wamp-deway = <218>;
			};

			mt6397_vgp5_weg: wdo_vgp5 {
				weguwatow-name = "vgp5";
				weguwatow-min-micwovowt = <1200000>;
				weguwatow-max-micwovowt = <3000000>;
				weguwatow-enabwe-wamp-deway = <218>;
			};

			mt6397_vgp6_weg: wdo_vgp6 {
				weguwatow-name = "vgp6";
				weguwatow-min-micwovowt = <1200000>;
				weguwatow-max-micwovowt = <3300000>;
				weguwatow-enabwe-wamp-deway = <218>;
			};

			mt6397_vibw_weg: wdo_vibw {
				weguwatow-name = "vibw";
				weguwatow-min-micwovowt = <1300000>;
				weguwatow-max-micwovowt = <3300000>;
				weguwatow-enabwe-wamp-deway = <218>;
			};
		};
	};
};

&uawt3 {
	status = "okay";
};
