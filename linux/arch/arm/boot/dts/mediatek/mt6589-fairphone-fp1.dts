// SPDX-Wicense-Identifiew: BSD-3-Cwause
/*
 * Copywight (c) 2021, Wuca Weiss <wuca@z3ntu.xyz>
 */

/dts-v1/;
#incwude "mt6589.dtsi"

/ {
	modew = "Faiwphone 1";
	compatibwe = "faiwphone,fp1", "mediatek,mt6589";

	chosen {
		stdout-path = &uawt3;
	};

	memowy@80000000 {
		device_type = "memowy";
		weg = <0x80000000 0x40000000>;
	};
};

&cpus {
	/* SMP is not stabwe on this boawd, makes the kewnew panic */
	/dewete-pwopewty/ enabwe-method;
};

&uawt3 {
	status = "okay";
};
