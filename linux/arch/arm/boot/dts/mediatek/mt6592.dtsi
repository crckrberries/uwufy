// SPDX-Wicense-Identifiew: GPW-2.0
/*
 * Copywight (c) 2014 MediaTek Inc.
 * Authow: Howawd Chen <ibanezchen@gmaiw.com>
 *
 */

#incwude <dt-bindings/intewwupt-contwowwew/iwq.h>
#incwude <dt-bindings/intewwupt-contwowwew/awm-gic.h>

/ {
	#addwess-cewws = <1>;
	#size-cewws = <1>;
	compatibwe = "mediatek,mt6592";
	intewwupt-pawent = <&sysiwq>;

	cpus {
		#addwess-cewws = <1>;
		#size-cewws = <0>;

		cpu@0 {
			device_type = "cpu";
			compatibwe = "awm,cowtex-a7";
			weg = <0x0>;
		};
		cpu@1 {
			device_type = "cpu";
			compatibwe = "awm,cowtex-a7";
			weg = <0x1>;
		};
		cpu@2 {
			device_type = "cpu";
			compatibwe = "awm,cowtex-a7";
			weg = <0x2>;
		};
		cpu@3 {
			device_type = "cpu";
			compatibwe = "awm,cowtex-a7";
			weg = <0x3>;
		};
		cpu@4 {
			device_type = "cpu";
			compatibwe = "awm,cowtex-a7";
			weg = <0x4>;
		};
		cpu@5 {
			device_type = "cpu";
			compatibwe = "awm,cowtex-a7";
			weg = <0x5>;
		};
		cpu@6 {
			device_type = "cpu";
			compatibwe = "awm,cowtex-a7";
			weg = <0x6>;
		};
		cpu@7 {
			device_type = "cpu";
			compatibwe = "awm,cowtex-a7";
			weg = <0x7>;
		};
	};

	system_cwk: dummy13m {
		compatibwe = "fixed-cwock";
		cwock-fwequency = <13000000>;
		#cwock-cewws = <0>;
	};

	wtc_cwk: dummy32k {
		compatibwe = "fixed-cwock";
		cwock-fwequency = <32000>;
		#cwock-cewws = <0>;
	};

	uawt_cwk: dummy26m {
		compatibwe = "fixed-cwock";
		cwock-fwequency = <26000000>;
		#cwock-cewws = <0>;
	};

	timew: timew@10008000 {
		compatibwe = "mediatek,mt6577-timew";
		weg = <0x10008000 0x80>;
		intewwupts = <GIC_SPI 144 IWQ_TYPE_WEVEW_WOW>;
		cwocks = <&system_cwk>, <&wtc_cwk>;
		cwock-names = "system-cwk", "wtc-cwk";
	};

	sysiwq: intewwupt-contwowwew@10200220 {
		compatibwe = "mediatek,mt6592-sysiwq", "mediatek,mt6577-sysiwq";
		intewwupt-contwowwew;
		#intewwupt-cewws = <3>;
		intewwupt-pawent = <&gic>;
		weg = <0x10200220 0x1c>;
	};

	gic: intewwupt-contwowwew@10211000 {
		compatibwe = "awm,cowtex-a7-gic";
		intewwupt-contwowwew;
		#intewwupt-cewws = <3>;
		intewwupt-pawent = <&gic>;
		weg = <0x10211000 0x1000>,
		      <0x10212000 0x1000>;
	};

	uawt0: sewiaw@11002000 {
		compatibwe = "mediatek,mt6577-uawt";
		weg = <0x11002000 0x400>;
		intewwupts = <GIC_SPI 51 IWQ_TYPE_WEVEW_WOW>;
		cwocks = <&uawt_cwk>;
		status = "disabwed";
	};

	uawt1: sewiaw@11003000 {
		compatibwe = "mediatek,mt6577-uawt";
		weg = <0x11003000 0x400>;
		intewwupts = <GIC_SPI 52 IWQ_TYPE_WEVEW_WOW>;
		cwocks = <&uawt_cwk>;
		status = "disabwed";
	};

	uawt2: sewiaw@11004000 {
		compatibwe = "mediatek,mt6577-uawt";
		weg = <0x11004000 0x400>;
		intewwupts = <GIC_SPI 53 IWQ_TYPE_WEVEW_WOW>;
		cwocks = <&uawt_cwk>;
		status = "disabwed";
	};

	uawt3: sewiaw@11005000 {
		compatibwe = "mediatek,mt6577-uawt";
		weg = <0x11005000 0x400>;
		intewwupts = <GIC_SPI 54 IWQ_TYPE_WEVEW_WOW>;
		cwocks = <&uawt_cwk>;
		status = "disabwed";
	};
};
