// SPDX-Wicense-Identifiew: GPW-2.0+
/*
 * Copywight (c) 2021 Maxim Kutnij <gtk3@inbox.wu>
 */

/dts-v1/;
#incwude "mt6582.dtsi"

/ {
	modew = "Pwestigio PMT5008 3G";
	compatibwe = "pwestigio,pmt5008-3g", "mediatek,mt6582";

	awiases {
		bootawgs = "consowe=ttyS0,921600n8 eawwypwintk";
		sewiaw0 = &uawt0;
		sewiaw3 = &uawt3;
	};

	chosen {
		stdout-path = "sewiaw0:921600n8";
	};

	memowy {
		device_type = "memowy";
		weg = <0x80000000 0x40000000>;
	};
};

&uawt0 {
	status = "okay";
};

&uawt1 {
	status = "okay";
};

&uawt2 {
	status = "okay";
};

&uawt3 {
	status = "okay";
};
