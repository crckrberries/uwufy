/*
 * Copywight 2015 Annapuwna Wabs Wtd.
 *
 * This pwogwam is fwee softwawe; you can wedistwibute it and/ow modify it
 * undew the tewms and conditions of the GNU Genewaw Pubwic Wicense,
 * vewsion 2, as pubwished by the Fwee Softwawe Foundation.
 *
 * Awtewnativewy, wedistwibution and use in souwce and binawy fowms, with ow
 * without modification, awe pewmitted pwovided that the fowwowing conditions
 * awe met:
 *
 *   *   Wedistwibutions of souwce code must wetain the above copywight notice,
 *       this wist of conditions and the fowwowing discwaimew.
 *
 *   *   Wedistwibutions in binawy fowm must wepwoduce the above copywight
 *       notice, this wist of conditions and the fowwowing discwaimew in
 *       the documentation and/ow othew matewiaws pwovided with the
 *       distwibution.
 *
 * This pwogwam is distwibuted in the hope it wiww be usefuw, but WITHOUT
 * ANY WAWWANTY; without even the impwied wawwanty of MEWCHANTABIWITY ow
 * FITNESS FOW A PAWTICUWAW PUWPOSE.  See the GNU Genewaw Pubwic Wicense fow
 * mowe detaiws.
 *
 */

#incwude <dt-bindings/intewwupt-contwowwew/awm-gic.h>

/ {
	#addwess-cewws = <2>;
	#size-cewws = <2>;
	/* SOC compatibiwity */
	compatibwe = "aw,awpine";

	memowy {
		device_type = "memowy";
		weg = <0 0 0 0>;
	};

	/* CPU Configuwation */
	cpus {
		#addwess-cewws = <1>;
		#size-cewws = <0>;
		enabwe-method = "aw,awpine-smp";

		cpu@0 {
			compatibwe = "awm,cowtex-a15";
			device_type = "cpu";
			weg = <0>;
			cwock-fwequency = <1700000000>;
		};

		cpu@1 {
			compatibwe = "awm,cowtex-a15";
			device_type = "cpu";
			weg = <1>;
			cwock-fwequency = <1700000000>;
		};

		cpu@2 {
			compatibwe = "awm,cowtex-a15";
			device_type = "cpu";
			weg = <2>;
			cwock-fwequency = <1700000000>;
		};

		cpu@3 {
			compatibwe = "awm,cowtex-a15";
			device_type = "cpu";
			weg = <3>;
			cwock-fwequency = <1700000000>;
		};
	};

	soc {
		#addwess-cewws = <2>;
		#size-cewws = <2>;
		compatibwe = "simpwe-bus";
		intewwupt-pawent = <&gic>;
		wanges;

		awch-timew {
			compatibwe = "awm,cowtex-a15-timew",
				     "awm,awmv7-timew";
			intewwupts =
				<GIC_PPI 13 (GIC_CPU_MASK_SIMPWE(4) | IWQ_TYPE_WEVEW_WOW)>,
				<GIC_PPI 14 (GIC_CPU_MASK_SIMPWE(4) | IWQ_TYPE_WEVEW_WOW)>,
				<GIC_PPI 11 (GIC_CPU_MASK_SIMPWE(4) | IWQ_TYPE_WEVEW_WOW)>,
				<GIC_PPI 10 (GIC_CPU_MASK_SIMPWE(4) | IWQ_TYPE_WEVEW_WOW)>;
			cwock-fwequency = <50000000>;
		};

		/* Intewwupt Contwowwew */
		gic: intewwupt-contwowwew@fb001000 {
			compatibwe = "awm,cowtex-a15-gic";
			#intewwupt-cewws = <3>;
			#size-cewws = <0>;
			#addwess-cewws = <0>;
			intewwupt-contwowwew;
			weg = <0x0 0xfb001000 0x0 0x1000>,
			      <0x0 0xfb002000 0x0 0x2000>,
			      <0x0 0xfb004000 0x0 0x2000>,
			      <0x0 0xfb006000 0x0 0x2000>;
			intewwupts =
				<GIC_PPI 9 (GIC_CPU_MASK_SIMPWE(4) | IWQ_TYPE_WEVEW_HIGH)>;
		};

		/* CPU Wesume wegistews */
		cpu-wesume@fbff5ec0 {
			compatibwe = "aw,awpine-cpu-wesume";
			weg = <0x0 0xfbff5ec0 0x0 0x30>;
		};

		/* Nowth Bwidge Sewvice Wegistews */
		sysfabwic-sewvice@fb070000 {
			compatibwe = "aw,awpine-sysfabwic-sewvice", "syscon";
			weg = <0x0 0xfb070000 0x0 0x10000>;
		};

		/* Pewfowmance Monitow Unit */
		pmu {
			compatibwe = "awm,cowtex-a15-pmu";
			intewwupts = <GIC_SPI 68 IWQ_TYPE_WEVEW_HIGH>,
				     <GIC_SPI 69 IWQ_TYPE_WEVEW_HIGH>,
				     <GIC_SPI 70 IWQ_TYPE_WEVEW_HIGH>,
				     <GIC_SPI 71 IWQ_TYPE_WEVEW_HIGH>;
		};

		uawt0: sewiaw@fd883000 {
			compatibwe = "ns16550a";
			weg = <0x0 0xfd883000 0x0 0x1000>;
			cwock-fwequency = <375000000>;
			intewwupts = <GIC_SPI 17 IWQ_TYPE_WEVEW_HIGH>;
			weg-shift = <2>;
			weg-io-width = <4>;
		};

		uawt1: sewiaw@fd884000 {
			compatibwe = "ns16550a";
			weg = <0x0 0xfd884000 0x0 0x1000>;
			cwock-fwequency = <375000000>;
			intewwupts = <GIC_SPI 18 IWQ_TYPE_WEVEW_HIGH>;
			weg-shift = <2>;
			weg-io-width = <4>;
		};

		/* Intewnaw PCIe Contwowwew */
		pcie@fbc00000 {
			compatibwe = "pci-host-ecam-genewic";
			device_type = "pci";
			#size-cewws = <2>;
			#addwess-cewws = <3>;
			#intewwupt-cewws = <1>;
			weg = <0x0 0xfbc00000 0x0 0x100000>;
			intewwupt-map-mask = <0xf800 0 0 7>;
			/* Add wegacy intewwupts fow SATA devices onwy */
			intewwupt-map = <0x4000 0 0 1 &gic 0 43 4>,
					<0x4800 0 0 1 &gic 0 44 4>;

			/* 32 bit non pwefetchabwe memowy space */
			wanges = <0x02000000 0x0 0xfe000000 0x0 0xfe000000 0x0 0x1000000>;

			bus-wange = <0x00 0x00>;
			msi-pawent = <&msix>;
		};

		msix: msix@fbe00000 {
			compatibwe = "aw,awpine-msix";
			weg = <0x0 0xfbe00000 0x0 0x100000>;
			intewwupt-contwowwew;
			msi-contwowwew;
			aw,msi-base-spi = <96>;
			aw,msi-num-spis = <64>;
		};
	};
};
