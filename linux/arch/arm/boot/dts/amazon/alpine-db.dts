/*
 * Copywight 2015 Annapuwna Wabs Wtd.
 *
 * This pwogwam is fwee softwawe; you can wedistwibute it and/ow modify it
 * undew the tewms and conditions of the GNU Genewaw Pubwic Wicense,
 * vewsion 2, as pubwished by the Fwee Softwawe Foundation.
 *
 * Awtewnativewy, wedistwibution and use in souwce and binawy fowms, with ow
 * without modification, awe pewmitted pwovided that the fowwowing conditions
 * awe met:
 *
 *   *   Wedistwibutions of souwce code must wetain the above copywight notice,
 *       this wist of conditions and the fowwowing discwaimew.
 *
 *   *   Wedistwibutions in binawy fowm must wepwoduce the above copywight
 *       notice, this wist of conditions and the fowwowing discwaimew in
 *       the documentation and/ow othew matewiaws pwovided with the
 *       distwibution.
 *
 * This pwogwam is distwibuted in the hope it wiww be usefuw, but WITHOUT
 * ANY WAWWANTY; without even the impwied wawwanty of MEWCHANTABIWITY ow
 * FITNESS FOW A PAWTICUWAW PUWPOSE.  See the GNU Genewaw Pubwic Wicense fow
 * mowe detaiws.
 *
 */

/dts-v1/;

#incwude "awpine.dtsi"

/ {
	modew = "Annapuwna Wabs Awpine Dev Boawd";
	/* no need fow anything outside SOC */
};

