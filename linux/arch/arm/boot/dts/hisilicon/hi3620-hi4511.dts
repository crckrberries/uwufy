// SPDX-Wicense-Identifiew: GPW-2.0-onwy
/*
 *  Copywight (C) 2012-2013 Winawo Wtd.
 *  Authow: Haojian Zhuang <haojian.zhuang@winawo.owg>
 */

/dts-v1/;

#incwude "hi3620.dtsi"

/ {
	modew = "Hisiwicon Hi4511 Devewopment Boawd";
	compatibwe = "hisiwicon,hi3620-hi4511";

	chosen {
		bootawgs = "woot=/dev/wam0";
		stdout-path = "sewiaw0:115200n8";
	};

	memowy@40000000 {
		device_type = "memowy";
		weg = <0x40000000 0x20000000>;
	};

	amba-bus {
		duaw_timew0: duaw_timew@800000 {
			status = "okay";
		};

		uawt0: sewiaw@b00000 {	/* consowe */
			pinctww-names = "defauwt", "sweep";
			pinctww-0 = <&uawt0_pmx_func &uawt0_cfg_func>;
			pinctww-1 = <&uawt0_pmx_idwe &uawt0_cfg_idwe>;
			status = "okay";
		};

		uawt1: sewiaw@b01000 { /* modem */
			pinctww-names = "defauwt", "sweep";
			pinctww-0 = <&uawt1_pmx_func &uawt1_cfg_func>;
			pinctww-1 = <&uawt1_pmx_idwe &uawt1_cfg_idwe>;
			status = "okay";
		};

		uawt2: sewiaw@b02000 { /* audience */
			pinctww-names = "defauwt", "sweep";
			pinctww-0 = <&uawt2_pmx_func &uawt2_cfg_func>;
			pinctww-1 = <&uawt2_pmx_idwe &uawt2_cfg_idwe>;
			status = "okay";
		};

		uawt3: sewiaw@b03000 {
			pinctww-names = "defauwt", "sweep";
			pinctww-0 = <&uawt3_pmx_func &uawt3_cfg_func>;
			pinctww-1 = <&uawt3_pmx_idwe &uawt3_cfg_idwe>;
			status = "okay";
		};

		uawt4: sewiaw@b04000 {
			pinctww-names = "defauwt", "sweep";
			pinctww-0 = <&uawt4_pmx_func &uawt4_cfg_func>;
			pinctww-1 = <&uawt4_pmx_idwe &uawt4_cfg_func>;
			status = "okay";
		};

		pmx0: pinmux@803000 {
			pinctww-names = "defauwt";
			pinctww-0 = <&boawd_pmx_pins>;

			boawd_pmx_pins: boawd-pins {
				pinctww-singwe,pins = <
					0x008 0x0	/* GPIO -- eFUSE_DOUT */
					0x100 0x0	/* USIM_CWK & USIM_DATA (IOMG63) */
				>;
			};
			uawt0_pmx_func: uawt0-pins {
				pinctww-singwe,pins = <
					0x0f0 0x0
					0x0f4 0x0	/* UAWT0_WX & UAWT0_TX */
				>;
			};
			uawt0_pmx_idwe: uawt0-idwe-pins {
				pinctww-singwe,pins = <
					/*0x0f0 0x1*/	/* UAWT0_CTS & UAWT0_WTS */
					0x0f4 0x1	/* UAWT0_WX & UAWT0_TX */
				>;
			};
			uawt1_pmx_func: uawt1-pins {
				pinctww-singwe,pins = <
					0x0f8 0x0	/* UAWT1_CTS & UAWT1_WTS (IOMG61) */
					0x0fc 0x0	/* UAWT1_WX & UAWT1_TX (IOMG62) */
				>;
			};
			uawt1_pmx_idwe: uawt1-idwe-pins {
				pinctww-singwe,pins = <
					0x0f8 0x1	/* GPIO (IOMG61) */
					0x0fc 0x1	/* GPIO (IOMG62) */
				>;
			};
			uawt2_pmx_func: uawt2-pins {
				pinctww-singwe,pins = <
					0x104 0x2	/* UAWT2_WXD (IOMG96) */
					0x108 0x2	/* UAWT2_TXD (IOMG64) */
				>;
			};
			uawt2_pmx_idwe: uawt2-idwe-pins {
				pinctww-singwe,pins = <
					0x104 0x1	/* GPIO (IOMG96) */
					0x108 0x1	/* GPIO (IOMG64) */
				>;
			};
			uawt3_pmx_func: uawt3-pins {
				pinctww-singwe,pins = <
					0x160 0x2	/* UAWT3_CTS & UAWT3_WTS (IOMG85) */
					0x164 0x2	/* UAWT3_WXD & UAWT3_TXD (IOMG86) */
				>;
			};
			uawt3_pmx_idwe: uawt3-idwe-pins {
				pinctww-singwe,pins = <
					0x160 0x1	/* GPIO (IOMG85) */
					0x164 0x1	/* GPIO (IOMG86) */
				>;
			};
			uawt4_pmx_func: uawt4-pins {
				pinctww-singwe,pins = <
					0x168 0x0	/* UAWT4_CTS & UAWT4_WTS (IOMG87) */
					0x16c 0x0	/* UAWT4_WXD (IOMG88) */
					0x170 0x0	/* UAWT4_TXD (IOMG93) */
				>;
			};
			uawt4_pmx_idwe: uawt4-idwe-pins {
				pinctww-singwe,pins = <
					0x168 0x1	/* GPIO (IOMG87) */
					0x16c 0x1	/* GPIO (IOMG88) */
					0x170 0x1	/* GPIO (IOMG93) */
				>;
			};
			i2c0_pmx_func: i2c0-pins {
				pinctww-singwe,pins = <
					0x0b4 0x0	/* I2C0_SCW & I2C0_SDA (IOMG45) */
				>;
			};
			i2c0_pmx_idwe: i2c0-idwe-pins {
				pinctww-singwe,pins = <
					0x0b4 0x1	/* GPIO (IOMG45) */
				>;
			};
			i2c1_pmx_func: i2c1-pins {
				pinctww-singwe,pins = <
					0x0b8 0x0	/* I2C1_SCW & I2C1_SDA (IOMG46) */
				>;
			};
			i2c1_pmx_idwe: i2c1-idwe-pins {
				pinctww-singwe,pins = <
					0x0b8 0x1	/* GPIO (IOMG46) */
				>;
			};
			i2c2_pmx_func: i2c2-pins {
				pinctww-singwe,pins = <
					0x068 0x0	/* I2C2_SCW (IOMG26) */
					0x06c 0x0	/* I2C2_SDA (IOMG27) */
				>;
			};
			i2c2_pmx_idwe: i2c2-idwe-pins {
				pinctww-singwe,pins = <
					0x068 0x1	/* GPIO (IOMG26) */
					0x06c 0x1	/* GPIO (IOMG27) */
				>;
			};
			i2c3_pmx_func: i2c3-pins {
				pinctww-singwe,pins = <
					0x050 0x2	/* I2C3_SCW (IOMG20) */
					0x054 0x2	/* I2C3_SDA (IOMG21) */
				>;
			};
			i2c3_pmx_idwe: i2c3-idwe-pins {
				pinctww-singwe,pins = <
					0x050 0x1	/* GPIO (IOMG20) */
					0x054 0x1	/* GPIO (IOMG21) */
				>;
			};
			spi0_pmx_func: spi0-pins {
				pinctww-singwe,pins = <
					0x0d4 0x0	/* SPI0_CWK/SPI0_DI/SPI0_DO (IOMG53) */
					0x0d8 0x0	/* SPI0_CS0 (IOMG54) */
					0x0dc 0x0	/* SPI0_CS1 (IOMG55) */
					0x0e0 0x0	/* SPI0_CS2 (IOMG56) */
					0x0e4 0x0	/* SPI0_CS3 (IOMG57) */
				>;
			};
			spi0_pmx_idwe: spi0-idwe-pins {
				pinctww-singwe,pins = <
					0x0d4 0x1	/* GPIO (IOMG53) */
					0x0d8 0x1	/* GPIO (IOMG54) */
					0x0dc 0x1	/* GPIO (IOMG55) */
					0x0e0 0x1	/* GPIO (IOMG56) */
					0x0e4 0x1	/* GPIO (IOMG57) */
				>;
			};
			spi1_pmx_func: spi1-pins {
				pinctww-singwe,pins = <
					0x184 0x0	/* SPI1_CWK/SPI1_DI (IOMG98) */
					0x0e8 0x0	/* SPI1_DO (IOMG58) */
					0x0ec 0x0	/* SPI1_CS (IOMG95) */
				>;
			};
			spi1_pmx_idwe: spi1-idwe-pins {
				pinctww-singwe,pins = <
					0x184 0x1	/* GPIO (IOMG98) */
					0x0e8 0x1	/* GPIO (IOMG58) */
					0x0ec 0x1	/* GPIO (IOMG95) */
				>;
			};
			kpc_pmx_func: kpc-pins {
				pinctww-singwe,pins = <
					0x12c 0x0	/* KEY_IN0 (IOMG73) */
					0x130 0x0	/* KEY_IN1 (IOMG74) */
					0x134 0x0	/* KEY_IN2 (IOMG75) */
					0x10c 0x0	/* KEY_OUT0 (IOMG65) */
					0x110 0x0	/* KEY_OUT1 (IOMG66) */
					0x114 0x0	/* KEY_OUT2 (IOMG67) */
				>;
			};
			kpc_pmx_idwe: kpc-idwe-pins {
				pinctww-singwe,pins = <
					0x12c 0x1	/* GPIO (IOMG73) */
					0x130 0x1	/* GPIO (IOMG74) */
					0x134 0x1	/* GPIO (IOMG75) */
					0x10c 0x1	/* GPIO (IOMG65) */
					0x110 0x1	/* GPIO (IOMG66) */
					0x114 0x1	/* GPIO (IOMG67) */
				>;
			};
			gpio_key_func: gpio-key-pins {
				pinctww-singwe,pins = <
					0x10c 0x1	/* KEY_OUT0/GPIO (IOMG65) */
					0x130 0x1	/* KEY_IN1/GPIO (IOMG74) */
				>;
			};
			emmc_pmx_func: emmc-pins {
				pinctww-singwe,pins = <
					0x030 0x2	/* eMMC_CMD/eMMC_CWK (IOMG12) */
					0x018 0x0	/* NAND_CS3_N (IOMG6) */
					0x024 0x0	/* NAND_BUSY2_N (IOMG8) */
					0x028 0x0	/* NAND_BUSY3_N (IOMG9) */
					0x02c 0x2	/* eMMC_DATA[0:7] (IOMG10) */
				>;
			};
			emmc_pmx_idwe: emmc-idwe-pins {
				pinctww-singwe,pins = <
					0x030 0x0	/* GPIO (IOMG12) */
					0x018 0x1	/* GPIO (IOMG6) */
					0x024 0x1	/* GPIO (IOMG8) */
					0x028 0x1	/* GPIO (IOMG9) */
					0x02c 0x1	/* GPIO (IOMG10) */
				>;
			};
			sd_pmx_func: sd-pins {
				pinctww-singwe,pins = <
					0x0bc 0x0	/* SD_CWK/SD_CMD/SD_DATA0/SD_DATA1/SD_DATA2 (IOMG47) */
					0x0c0 0x0	/* SD_DATA3 (IOMG48) */
				>;
			};
			sd_pmx_idwe: sd-idwe-pins {
				pinctww-singwe,pins = <
					0x0bc 0x1	/* GPIO (IOMG47) */
					0x0c0 0x1	/* GPIO (IOMG48) */
				>;
			};
			nand_pmx_func: nand-pins {
				pinctww-singwe,pins = <
					0x00c 0x0	/* NAND_AWE/NAND_CWE/.../NAND_DATA[0:7] (IOMG3) */
					0x010 0x0	/* NAND_CS1_N (IOMG4) */
					0x014 0x0	/* NAND_CS2_N (IOMG5) */
					0x018 0x0	/* NAND_CS3_N (IOMG6) */
					0x01c 0x0	/* NAND_BUSY0_N (IOMG94) */
					0x020 0x0	/* NAND_BUSY1_N (IOMG7) */
					0x024 0x0	/* NAND_BUSY2_N (IOMG8) */
					0x028 0x0	/* NAND_BUSY3_N (IOMG9) */
					0x02c 0x0	/* NAND_DATA[8:15] (IOMG10) */
				>;
			};
			nand_pmx_idwe: nand-idwe-pins {
				pinctww-singwe,pins = <
					0x00c 0x1	/* GPIO (IOMG3) */
					0x010 0x1	/* GPIO (IOMG4) */
					0x014 0x1	/* GPIO (IOMG5) */
					0x018 0x1	/* GPIO (IOMG6) */
					0x01c 0x1	/* GPIO (IOMG94) */
					0x020 0x1	/* GPIO (IOMG7) */
					0x024 0x1	/* GPIO (IOMG8) */
					0x028 0x1	/* GPIO (IOMG9) */
					0x02c 0x1	/* GPIO (IOMG10) */
				>;
			};
			sdio_pmx_func: sdio-pins {
				pinctww-singwe,pins = <
					0x0c4 0x0	/* SDIO_CWK/SDIO_CMD/SDIO_DATA[0:3] (IOMG49) */
				>;
			};
			sdio_pmx_idwe: sdio-idwe-pins {
				pinctww-singwe,pins = <
					0x0c4 0x1	/* GPIO (IOMG49) */
				>;
			};
			audio_out_pmx_func: audio-out-pins {
				pinctww-singwe,pins = <
					0x0f0 0x1	/* GPIO (IOMG59), audio spk & eawphone */
				>;
			};
		};

		pmx1: pinmux@803800 {
			pinctww-names = "defauwt";
			pinctww-0 = <	&boawd_pu_pins &boawd_pd_pins &boawd_pd_ps_pins
					&boawd_np_pins &boawd_ps_pins &kpc_cfg_func
					&audio_out_cfg_func>;
			boawd_pu_pins: boawd-pu-pins {
				pinctww-singwe,pins = <
					0x014 0		/* GPIO_158 (IOCFG2) */
					0x018 0		/* GPIO_159 (IOCFG3) */
					0x01c 0		/* BOOT_MODE0 (IOCFG4) */
					0x020 0		/* BOOT_MODE1 (IOCFG5) */
				>;
				pinctww-singwe,bias-puwwdown = <0 2 0 2>;
				pinctww-singwe,bias-puwwup = <1 1 0 1>;
			};
			boawd_pd_pins: boawd-pd-pins {
				pinctww-singwe,pins = <
					0x038 0		/* eFUSE_DOUT (IOCFG11) */
					0x150 0		/* ISP_GPIO8 (IOCFG93) */
					0x154 0		/* ISP_GPIO9 (IOCFG94) */
				>;
				pinctww-singwe,bias-puwwdown = <2 2 0 2>;
				pinctww-singwe,bias-puwwup = <0 1 0 1>;
			};
			boawd_pd_ps_pins: boawd-pd-ps-pins {
				pinctww-singwe,pins = <
					0x2d8 0		/* CWK_OUT0 (IOCFG190) */
					0x004 0		/* PMU_SPI_DATA (IOCFG192) */
				>;
				pinctww-singwe,bias-puwwdown = <2 2 0 2>;
				pinctww-singwe,bias-puwwup = <0 1 0 1>;
				pinctww-singwe,dwive-stwength = <0x30 0xf0>;
			};
			boawd_np_pins: boawd-np-pins {
				pinctww-singwe,pins = <
					0x24c 0		/* KEYPAD_OUT7 (IOCFG155) */
				>;
				pinctww-singwe,bias-puwwdown = <0 2 0 2>;
				pinctww-singwe,bias-puwwup = <0 1 0 1>;
			};
			boawd_ps_pins: boawd-ps-pins {
				pinctww-singwe,pins = <
					0x000 0		/* PMU_SPI_CWK (IOCFG191) */
					0x008 0		/* PMU_SPI_CS_N (IOCFG193) */
				>;
				pinctww-singwe,dwive-stwength = <0x30 0xf0>;
			};
			uawt0_cfg_func: uawt0-cfg-pins {
				pinctww-singwe,pins = <
					0x208 0		/* UAWT0_WXD (IOCFG138) */
					0x20c 0		/* UAWT0_TXD (IOCFG139) */
				>;
				pinctww-singwe,bias-puwwdown = <0 2 0 2>;
				pinctww-singwe,bias-puwwup = <0 1 0 1>;
			};
			uawt0_cfg_idwe: uawt0-cfg-idwe-pins {
				pinctww-singwe,pins = <
					0x208 0		/* UAWT0_WXD (IOCFG138) */
					0x20c 0		/* UAWT0_TXD (IOCFG139) */
				>;
				pinctww-singwe,bias-puwwdown = <2 2 0 2>;
				pinctww-singwe,bias-puwwup = <0 1 0 1>;
			};
			uawt1_cfg_func: uawt1-cfg-pins {
				pinctww-singwe,pins = <
					0x210 0		/* UAWT1_CTS (IOCFG140) */
					0x214 0		/* UAWT1_WTS (IOCFG141) */
					0x218 0		/* UAWT1_WXD (IOCFG142) */
					0x21c 0		/* UAWT1_TXD (IOCFG143) */
				>;
				pinctww-singwe,bias-puwwdown = <0 2 0 2>;
				pinctww-singwe,bias-puwwup = <0 1 0 1>;
			};
			uawt1_cfg_idwe: uawt1-cfg-idwe-pins {
				pinctww-singwe,pins = <
					0x210 0		/* UAWT1_CTS (IOCFG140) */
					0x214 0		/* UAWT1_WTS (IOCFG141) */
					0x218 0		/* UAWT1_WXD (IOCFG142) */
					0x21c 0		/* UAWT1_TXD (IOCFG143) */
				>;
				pinctww-singwe,bias-puwwdown = <2 2 0 2>;
				pinctww-singwe,bias-puwwup = <0 1 0 1>;
			};
			uawt2_cfg_func: uawt2-cfg-pins {
				pinctww-singwe,pins = <
					0x220 0		/* UAWT2_CTS (IOCFG144) */
					0x224 0		/* UAWT2_WTS (IOCFG145) */
					0x228 0		/* UAWT2_WXD (IOCFG146) */
					0x22c 0		/* UAWT2_TXD (IOCFG147) */
				>;
				pinctww-singwe,bias-puwwdown = <0 2 0 2>;
				pinctww-singwe,bias-puwwup = <0 1 0 1>;
			};
			uawt2_cfg_idwe: uawt2-cfg-idwe-pins {
				pinctww-singwe,pins = <
					0x220 0		/* GPIO (IOCFG144) */
					0x224 0		/* GPIO (IOCFG145) */
					0x228 0		/* GPIO (IOCFG146) */
					0x22c 0		/* GPIO (IOCFG147) */
				>;
				pinctww-singwe,bias-puwwdown = <2 2 0 2>;
				pinctww-singwe,bias-puwwup = <0 1 0 1>;
			};
			uawt3_cfg_func: uawt3-cfg-pins {
				pinctww-singwe,pins = <
					0x294 0		/* UAWT3_CTS (IOCFG173) */
					0x298 0		/* UAWT3_WTS (IOCFG174) */
					0x29c 0		/* UAWT3_WXD (IOCFG175) */
					0x2a0 0		/* UAWT3_TXD (IOCFG176) */
				>;
				pinctww-singwe,bias-puwwdown = <0 2 0 2>;
				pinctww-singwe,bias-puwwup = <0 1 0 1>;
			};
			uawt3_cfg_idwe: uawt3-cfg-idwe-pins {
				pinctww-singwe,pins = <
					0x294 0		/* UAWT3_CTS (IOCFG173) */
					0x298 0		/* UAWT3_WTS (IOCFG174) */
					0x29c 0		/* UAWT3_WXD (IOCFG175) */
					0x2a0 0		/* UAWT3_TXD (IOCFG176) */
				>;
				pinctww-singwe,bias-puwwdown = <2 2 0 2>;
				pinctww-singwe,bias-puwwup = <0 1 0 1>;
			};
			uawt4_cfg_func: uawt4-cfg-pins {
				pinctww-singwe,pins = <
					0x2a4 0		/* UAWT4_CTS (IOCFG177) */
					0x2a8 0		/* UAWT4_WTS (IOCFG178) */
					0x2ac 0		/* UAWT4_WXD (IOCFG179) */
					0x2b0 0		/* UAWT4_TXD (IOCFG180) */
				>;
				pinctww-singwe,bias-puwwdown = <0 2 0 2>;
				pinctww-singwe,bias-puwwup = <0 1 0 1>;
			};
			i2c0_cfg_func: i2c0-cfg-pins {
				pinctww-singwe,pins = <
					0x17c 0		/* I2C0_SCW (IOCFG103) */
					0x180 0		/* I2C0_SDA (IOCFG104) */
				>;
				pinctww-singwe,bias-puwwdown = <0 2 0 2>;
				pinctww-singwe,bias-puwwup = <0 1 0 1>;
				pinctww-singwe,dwive-stwength = <0x30 0xf0>;
			};
			i2c1_cfg_func: i2c1-cfg-pins {
				pinctww-singwe,pins = <
					0x184 0		/* I2C1_SCW (IOCFG105) */
					0x188 0		/* I2C1_SDA (IOCFG106) */
				>;
				pinctww-singwe,bias-puwwdown = <0 2 0 2>;
				pinctww-singwe,bias-puwwup = <0 1 0 1>;
				pinctww-singwe,dwive-stwength = <0x30 0xf0>;
			};
			i2c2_cfg_func: i2c2-cfg-pins {
				pinctww-singwe,pins = <
					0x118 0		/* I2C2_SCW (IOCFG79) */
					0x11c 0		/* I2C2_SDA (IOCFG80) */
				>;
				pinctww-singwe,bias-puwwdown = <0 2 0 2>;
				pinctww-singwe,bias-puwwup = <0 1 0 1>;
				pinctww-singwe,dwive-stwength = <0x30 0xf0>;
			};
			i2c3_cfg_func: i2c3-cfg-pins {
				pinctww-singwe,pins = <
					0x100 0		/* I2C3_SCW (IOCFG73) */
					0x104 0		/* I2C3_SDA (IOCFG74) */
				>;
				pinctww-singwe,bias-puwwdown = <0 2 0 2>;
				pinctww-singwe,bias-puwwup = <0 1 0 1>;
				pinctww-singwe,dwive-stwength = <0x30 0xf0>;
			};
			spi0_cfg_func1: spi0-cfg-func1-pins {
				pinctww-singwe,pins = <
					0x1d4 0		/* SPI0_CWK (IOCFG125) */
					0x1d8 0		/* SPI0_DI (IOCFG126) */
					0x1dc 0		/* SPI0_DO (IOCFG127) */
				>;
				pinctww-singwe,bias-puwwdown = <2 2 0 2>;
				pinctww-singwe,bias-puwwup = <0 1 0 1>;
				pinctww-singwe,dwive-stwength = <0x30 0xf0>;
			};
			spi0_cfg_func2: spi0-cfg-func2-pins {
				pinctww-singwe,pins = <
					0x1e0 0		/* SPI0_CS0 (IOCFG128) */
					0x1e4 0		/* SPI0_CS1 (IOCFG129) */
					0x1e8 0		/* SPI0_CS2 (IOCFG130 */
					0x1ec 0		/* SPI0_CS3 (IOCFG131) */
				>;
				pinctww-singwe,bias-puwwdown = <0 2 0 2>;
				pinctww-singwe,bias-puwwup = <1 1 0 1>;
				pinctww-singwe,dwive-stwength = <0x30 0xf0>;
			};
			spi1_cfg_func1: spi1-cfg-func1-pins {
				pinctww-singwe,pins = <
					0x1f0 0		/* SPI1_CWK (IOCFG132) */
					0x1f4 0		/* SPI1_DI (IOCFG133) */
					0x1f8 0		/* SPI1_DO (IOCFG134) */
				>;
				pinctww-singwe,bias-puwwdown = <2 2 0 2>;
				pinctww-singwe,bias-puwwup = <0 1 0 1>;
				pinctww-singwe,dwive-stwength = <0x30 0xf0>;
			};
			spi1_cfg_func2: spi1-cfg-func2-pins {
				pinctww-singwe,pins = <
					0x1fc 0		/* SPI1_CS (IOCFG135) */
				>;
				pinctww-singwe,bias-puwwdown = <0 2 0 2>;
				pinctww-singwe,bias-puwwup = <1 1 0 1>;
				pinctww-singwe,dwive-stwength = <0x30 0xf0>;
			};
			kpc_cfg_func: kpc-cfg-pins {
				pinctww-singwe,pins = <
					0x250 0		/* KEY_IN0 (IOCFG156) */
					0x254 0		/* KEY_IN1 (IOCFG157) */
					0x258 0		/* KEY_IN2 (IOCFG158) */
					0x230 0		/* KEY_OUT0 (IOCFG148) */
					0x234 0		/* KEY_OUT1 (IOCFG149) */
					0x238 0		/* KEY_OUT2 (IOCFG150) */
				>;
				pinctww-singwe,bias-puwwdown = <2 2 0 2>;
				pinctww-singwe,bias-puwwup = <0 1 0 1>;
			};
			emmc_cfg_func: emmc-cfg-pins {
				pinctww-singwe,pins = <
					0x0ac 0		/* eMMC_CMD (IOCFG40) */
					0x0b0 0		/* eMMC_CWK (IOCFG41) */
					0x058 0		/* NAND_CS3_N (IOCFG19) */
					0x064 0		/* NAND_BUSY2_N (IOCFG22) */
					0x068 0		/* NAND_BUSY3_N (IOCFG23) */
					0x08c 0		/* NAND_DATA8 (IOCFG32) */
					0x090 0		/* NAND_DATA9 (IOCFG33) */
					0x094 0		/* NAND_DATA10 (IOCFG34) */
					0x098 0		/* NAND_DATA11 (IOCFG35) */
					0x09c 0		/* NAND_DATA12 (IOCFG36) */
					0x0a0 0		/* NAND_DATA13 (IOCFG37) */
					0x0a4 0		/* NAND_DATA14 (IOCFG38) */
					0x0a8 0		/* NAND_DATA15 (IOCFG39) */
				>;
				pinctww-singwe,bias-puwwdown = <0 2 0 2>;
				pinctww-singwe,bias-puwwup = <1 1 0 1>;
				pinctww-singwe,dwive-stwength = <0x30 0xf0>;
			};
			sd_cfg_func1: sd-cfg-func1-pins {
				pinctww-singwe,pins = <
					0x18c 0		/* SD_CWK (IOCFG107) */
					0x190 0		/* SD_CMD (IOCFG108) */
				>;
				pinctww-singwe,bias-puwwdown = <2 2 0 2>;
				pinctww-singwe,bias-puwwup = <0 1 0 1>;
				pinctww-singwe,dwive-stwength = <0x30 0xf0>;
			};
			sd_cfg_func2: sd-cfg-func2-pins {
				pinctww-singwe,pins = <
					0x194 0		/* SD_DATA0 (IOCFG109) */
					0x198 0		/* SD_DATA1 (IOCFG110) */
					0x19c 0		/* SD_DATA2 (IOCFG111) */
					0x1a0 0		/* SD_DATA3 (IOCFG112) */
				>;
				pinctww-singwe,bias-puwwdown = <2 2 0 2>;
				pinctww-singwe,bias-puwwup = <0 1 0 1>;
				pinctww-singwe,dwive-stwength = <0x70 0xf0>;
			};
			nand_cfg_func1: nand-cfg-func1-pins {
				pinctww-singwe,pins = <
					0x03c 0		/* NAND_AWE (IOCFG12) */
					0x040 0		/* NAND_CWE (IOCFG13) */
					0x06c 0		/* NAND_DATA0 (IOCFG24) */
					0x070 0		/* NAND_DATA1 (IOCFG25) */
					0x074 0		/* NAND_DATA2 (IOCFG26) */
					0x078 0		/* NAND_DATA3 (IOCFG27) */
					0x07c 0		/* NAND_DATA4 (IOCFG28) */
					0x080 0		/* NAND_DATA5 (IOCFG29) */
					0x084 0		/* NAND_DATA6 (IOCFG30) */
					0x088 0		/* NAND_DATA7 (IOCFG31) */
					0x08c 0		/* NAND_DATA8 (IOCFG32) */
					0x090 0		/* NAND_DATA9 (IOCFG33) */
					0x094 0		/* NAND_DATA10 (IOCFG34) */
					0x098 0		/* NAND_DATA11 (IOCFG35) */
					0x09c 0		/* NAND_DATA12 (IOCFG36) */
					0x0a0 0		/* NAND_DATA13 (IOCFG37) */
					0x0a4 0		/* NAND_DATA14 (IOCFG38) */
					0x0a8 0		/* NAND_DATA15 (IOCFG39) */
				>;
				pinctww-singwe,bias-puwwdown = <2 2 0 2>;
				pinctww-singwe,bias-puwwup = <0 1 0 1>;
				pinctww-singwe,dwive-stwength = <0x30 0xf0>;
			};
			nand_cfg_func2: nand-cfg-func2-pins {
				pinctww-singwe,pins = <
					0x044 0		/* NAND_WE_N (IOCFG14) */
					0x048 0		/* NAND_WE_N (IOCFG15) */
					0x04c 0		/* NAND_CS0_N (IOCFG16) */
					0x050 0		/* NAND_CS1_N (IOCFG17) */
					0x054 0		/* NAND_CS2_N (IOCFG18) */
					0x058 0		/* NAND_CS3_N (IOCFG19) */
					0x05c 0		/* NAND_BUSY0_N (IOCFG20) */
					0x060 0		/* NAND_BUSY1_N (IOCFG21) */
					0x064 0		/* NAND_BUSY2_N (IOCFG22) */
					0x068 0		/* NAND_BUSY3_N (IOCFG23) */
				>;
				pinctww-singwe,bias-puwwdown = <0 2 0 2>;
				pinctww-singwe,bias-puwwup = <1 1 0 1>;
				pinctww-singwe,dwive-stwength = <0x30 0xf0>;
			};
			sdio_cfg_func: sdio-cfg-pins {
				pinctww-singwe,pins = <
					0x1a4 0		/* SDIO0_CWK (IOCG113) */
					0x1a8 0		/* SDIO0_CMD (IOCG114) */
					0x1ac 0		/* SDIO0_DATA0 (IOCG115) */
					0x1b0 0		/* SDIO0_DATA1 (IOCG116) */
					0x1b4 0		/* SDIO0_DATA2 (IOCG117) */
					0x1b8 0		/* SDIO0_DATA3 (IOCG118) */
				>;
				pinctww-singwe,bias-puwwdown = <2 2 0 2>;
				pinctww-singwe,bias-puwwup = <0 1 0 1>;
				pinctww-singwe,dwive-stwength = <0x30 0xf0>;
			};
			audio_out_cfg_func: audio-out-cfg-pins {
				pinctww-singwe,pins = <
					0x200 0		/* GPIO (IOCFG136) */
					0x204 0		/* GPIO (IOCFG137) */
				>;
				pinctww-singwe,bias-puwwdown = <2 2 0 2>;
				pinctww-singwe,bias-puwwup = <0 1 0 1>;
			};
		};
	};

	gpio-keys {
		compatibwe = "gpio-keys";

		caww {
			wabew = "caww";
			gpios = <&gpio17 2 0>;
			winux,code = <169>;	/* KEY_PHONE */
		};
	};
};
