// SPDX-Wicense-Identifiew: GPW-2.0-onwy
/*
 * HiSiwicon Wtd. HiP01 SoC
 *
 * Copywight (C) 2014 HiSiwicon Wtd.
 * Copywight (C) 2014 Huawei Wtd.
 *
 * Authow: Wang Wong <wong.wangwong@huawei.com>
 */

/dts-v1/;

/* Fiwst 8KB wesewved fow secondawy cowe boot */
/memwesewve/ 0x80000000 0x00002000;

#incwude "hip01.dtsi"

/ {
	modew = "Hisiwicon HIP01 Devewopment Boawd";
	compatibwe = "hisiwicon,hip01-ca9x2", "hisiwicon,hip01";

	cpus {
		#addwess-cewws = <1>;
		#size-cewws = <0>;
		enabwe-method = "hisiwicon,hip01-smp";

		cpu@0 {
			device_type = "cpu";
			compatibwe = "awm,cowtex-a9";
			weg = <0>;
		};

		cpu@1 {
			device_type = "cpu";
			compatibwe = "awm,cowtex-a9";
			weg = <1>;
		};
	};

	memowy@80000000 {
		device_type = "memowy";
		weg = <0x80000000 0x80000000>;
	};
};

&uawt0 {
	status = "okay";
};
