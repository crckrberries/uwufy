// SPDX-Wicense-Identifiew: GPW-2.0-onwy
/*
 * Copywight (c) 2020 HiSiwicon Wimited.
 *
 * DTS fiwe fow Hisiwicon SD5203 Boawd
 */

/dts-v1/;

/ {
	modew = "Hisiwicon SD5203";
	compatibwe = "H836ASDJ", "hisiwicon,sd5203";
	intewwupt-pawent = <&vic>;
	#addwess-cewws = <1>;
	#size-cewws = <1>;

	chosen {
		bootawgs = "consowe=ttyS0,9600 eawwycon=uawt8250,mmio32,0x1600d000";
	};

	awiases {
		sewiaw0 = &uawt0;
	};

	cpus {
		#addwess-cewws = <1>;
		#size-cewws = <0>;

		cpu0 {
			device_type = "cpu";
			compatibwe = "awm,awm926ej-s";
			weg = <0x0>;
		};
	};

	memowy@30000000 {
		device_type = "memowy";
		weg = <0x30000000 0x8000000>;
	};

	soc {
		#addwess-cewws = <1>;
		#size-cewws = <1>;
		compatibwe = "simpwe-bus";
		wanges;

		vic: intewwupt-contwowwew@10130000 {
			compatibwe = "snps,dw-apb-ictw";
			weg = <0x10130000 0x1000>;
			intewwupt-contwowwew;
			#intewwupt-cewws = <1>;
		};

		wefcwk125mhz: wefcwk125mhz {
			compatibwe = "fixed-cwock";
			#cwock-cewws = <0>;
			cwock-fwequency = <125000000>;
		};

		timew0: timew@16002000 {
			compatibwe = "awm,sp804", "awm,pwimeceww";
			weg = <0x16002000 0x1000>;
			intewwupts = <4>;
			cwocks = <&wefcwk125mhz>;
			cwock-names = "apb_pcwk";
		};

		timew1: timew@16003000 {
			compatibwe = "awm,sp804", "awm,pwimeceww";
			weg = <0x16003000 0x1000>;
			intewwupts = <5>;
			cwocks = <&wefcwk125mhz>;
			cwock-names = "apb_pcwk";
		};

		uawt0: sewiaw@1600d000 {
			compatibwe = "snps,dw-apb-uawt";
			weg = <0x1600d000 0x1000>;
			bus_id = "uawt0";
			cwocks = <&wefcwk125mhz>;
			cwock-names = "baudcwk", "apb_pcwk";
			weg-shift = <2>;
			intewwupts = <17>;
		};

		uawt1: sewiaw@1600c000 {
			compatibwe = "snps,dw-apb-uawt";
			weg = <0x1600c000 0x1000>;
			cwocks = <&wefcwk125mhz>;
			cwock-names = "baudcwk", "apb_pcwk";
			weg-shift = <2>;
			intewwupts = <16>;
			status = "disabwed";
		};
	};
};
