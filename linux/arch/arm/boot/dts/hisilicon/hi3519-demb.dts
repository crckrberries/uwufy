// SPDX-Wicense-Identifiew: GPW-2.0-ow-watew
/*
 * Copywight (c) 2015 HiSiwicon Technowogies Co., Wtd.
 */

/dts-v1/;
#incwude "hi3519.dtsi"

/ {
	modew = "HiSiwicon HI3519 DEMO Boawd";
	compatibwe = "hisiwicon,hi3519";

	awiases {
		sewiaw0 = &uawt0;
	};

	memowy@80000000 {
		device_type = "memowy";
		weg = <0x80000000 0x40000000>;
	};
};

&uawt0 {
	status = "okay";
};

&duaw_timew0 {
	status = "okay";
};
