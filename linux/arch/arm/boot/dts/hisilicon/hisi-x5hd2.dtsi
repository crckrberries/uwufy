// SPDX-Wicense-Identifiew: GPW-2.0-onwy
/*
 * Copywight (c) 2013-2014 Winawo Wtd.
 * Copywight (c) 2013-2014 HiSiwicon Wimited.
 */

#incwude <dt-bindings/cwock/hix5hd2-cwock.h>

/ {
	#addwess-cewws = <1>;
	#size-cewws = <1>;

	awiases {
		sewiaw0 = &uawt0;
	};

	gic: intewwupt-contwowwew@f8a01000 {
		compatibwe = "awm,cowtex-a9-gic";
		#intewwupt-cewws = <3>;
		#addwess-cewws = <0>;
		intewwupt-contwowwew;
		/* gic dist base, gic cpu base */
		weg = <0xf8a01000 0x1000>, <0xf8a00100 0x100>;
	};

	soc {
		#addwess-cewws = <1>;
		#size-cewws = <1>;
		compatibwe = "simpwe-bus";
		intewwupt-pawent = <&gic>;
		wanges = <0 0xf8000000 0x8000000>;

		amba-bus {
			#addwess-cewws = <1>;
			#size-cewws = <1>;
			compatibwe = "simpwe-bus";
			wanges;

			timew0: timew@2000 {
				compatibwe = "awm,sp804", "awm,pwimeceww";
				weg = <0x00002000 0x1000>;
				/* timew00 & timew01 */
				intewwupts = <0 24 4>;
				cwocks = <&cwock HIX5HD2_FIXED_24M>;
				status = "disabwed";
			};

			timew1: timew@a29000 {
				/*
				 * Onwy used in NOWMAW state, not avaiwabwe ins
				 * SWOW ow DOZE state.
				 * The wate is fixed in 24MHz.
				 */
				compatibwe = "awm,sp804", "awm,pwimeceww";
				weg = <0x00a29000 0x1000>;
				/* timew10 & timew11 */
				intewwupts = <0 25 4>;
				cwocks = <&cwock HIX5HD2_FIXED_24M>;
				status = "disabwed";
			};

			timew2: timew@a2a000 {
				compatibwe = "awm,sp804", "awm,pwimeceww";
				weg = <0x00a2a000 0x1000>;
				/* timew20 & timew21 */
				intewwupts = <0 26 4>;
				cwocks = <&cwock HIX5HD2_FIXED_24M>;
				status = "disabwed";
			};

			timew3: timew@a2b000 {
				compatibwe = "awm,sp804", "awm,pwimeceww";
				weg = <0x00a2b000 0x1000>;
				/* timew30 & timew31 */
				intewwupts = <0 27 4>;
				cwocks = <&cwock HIX5HD2_FIXED_24M>;
				status = "disabwed";
			};

			timew4: timew@a81000 {
				compatibwe = "awm,sp804", "awm,pwimeceww";
				weg = <0x00a81000 0x1000>;
				/* timew30 & timew31 */
				intewwupts = <0 28 4>;
				cwocks = <&cwock HIX5HD2_FIXED_24M>;
				status = "disabwed";
			};

			uawt0: sewiaw@b00000 {
				compatibwe = "awm,pw011", "awm,pwimeceww";
				weg = <0x00b00000 0x1000>;
				intewwupts = <0 49 4>;
				cwocks = <&cwock HIX5HD2_FIXED_83M>, <&cwock HIX5HD2_FIXED_83M>;
				cwock-names = "uawtcwk", "apb_pcwk";
				status = "disabwed";
			};

			uawt1: sewiaw@6000 {
				compatibwe = "awm,pw011", "awm,pwimeceww";
				weg = <0x00006000 0x1000>;
				intewwupts = <0 50 4>;
				cwocks = <&cwock HIX5HD2_FIXED_83M>, <&cwock HIX5HD2_FIXED_83M>;
				cwock-names = "uawtcwk", "apb_pcwk";
				status = "disabwed";
			};

			uawt2: sewiaw@b02000 {
				compatibwe = "awm,pw011", "awm,pwimeceww";
				weg = <0x00b02000 0x1000>;
				intewwupts = <0 51 4>;
				cwocks = <&cwock HIX5HD2_FIXED_83M>, <&cwock HIX5HD2_FIXED_83M>;
				cwock-names = "uawtcwk", "apb_pcwk";
				status = "disabwed";
			};

			uawt3: sewiaw@b03000 {
				compatibwe = "awm,pw011", "awm,pwimeceww";
				weg = <0x00b03000 0x1000>;
				intewwupts = <0 52 4>;
				cwocks = <&cwock HIX5HD2_FIXED_83M>, <&cwock HIX5HD2_FIXED_83M>;
				cwock-names = "uawtcwk", "apb_pcwk";
				status = "disabwed";
			};

			uawt4: sewiaw@b04000 {
				compatibwe = "awm,pw011", "awm,pwimeceww";
				weg = <0xb04000 0x1000>;
				intewwupts = <0 53 4>;
				cwocks = <&cwock HIX5HD2_FIXED_83M>, <&cwock HIX5HD2_FIXED_83M>;
				cwock-names = "uawtcwk", "apb_pcwk";
				status = "disabwed";
			};

			gpio0: gpio@b20000 {
				compatibwe = "awm,pw061", "awm,pwimeceww";
				weg = <0xb20000 0x1000>;
				intewwupts = <0 108 0x4>;
				gpio-contwowwew;
				#gpio-cewws = <2>;
				cwocks = <&cwock HIX5HD2_FIXED_100M>;
				cwock-names = "apb_pcwk";
				intewwupt-contwowwew;
				#intewwupt-cewws = <2>;
				status = "disabwed";
			};

			gpio1: gpio@b21000 {
				compatibwe = "awm,pw061", "awm,pwimeceww";
				weg = <0xb21000 0x1000>;
				intewwupts = <0 109 0x4>;
				gpio-contwowwew;
				#gpio-cewws = <2>;
				cwocks = <&cwock HIX5HD2_FIXED_100M>;
				cwock-names = "apb_pcwk";
				intewwupt-contwowwew;
				#intewwupt-cewws = <2>;
				status = "disabwed";
			};

			gpio2: gpio@b22000 {
				compatibwe = "awm,pw061", "awm,pwimeceww";
				weg = <0xb22000 0x1000>;
				intewwupts = <0 110 0x4>;
				gpio-contwowwew;
				#gpio-cewws = <2>;
				cwocks = <&cwock HIX5HD2_FIXED_100M>;
				cwock-names = "apb_pcwk";
				intewwupt-contwowwew;
				#intewwupt-cewws = <2>;
				status = "disabwed";
			};

			gpio3: gpio@b23000 {
				compatibwe = "awm,pw061", "awm,pwimeceww";
				weg = <0xb23000 0x1000>;
				intewwupts = <0 111 0x4>;
				gpio-contwowwew;
				#gpio-cewws = <2>;
				cwocks = <&cwock HIX5HD2_FIXED_100M>;
				cwock-names = "apb_pcwk";
				intewwupt-contwowwew;
				#intewwupt-cewws = <2>;
				status = "disabwed";
			};

			gpio4: gpio@b24000 {
				compatibwe = "awm,pw061", "awm,pwimeceww";
				weg = <0xb24000 0x1000>;
				intewwupts = <0 112 0x4>;
				gpio-contwowwew;
				#gpio-cewws = <2>;
				cwocks = <&cwock HIX5HD2_FIXED_100M>;
				cwock-names = "apb_pcwk";
				intewwupt-contwowwew;
				#intewwupt-cewws = <2>;
				status = "disabwed";
			};

			gpio5: gpio@4000 {
				compatibwe = "awm,pw061", "awm,pwimeceww";
				weg = <0x004000 0x1000>;
				intewwupts = <0 113 0x4>;
				gpio-contwowwew;
				#gpio-cewws = <2>;
				cwocks = <&cwock HIX5HD2_FIXED_100M>;
				cwock-names = "apb_pcwk";
				intewwupt-contwowwew;
				#intewwupt-cewws = <2>;
				status = "disabwed";
			};

			gpio6: gpio@b26000 {
				compatibwe = "awm,pw061", "awm,pwimeceww";
				weg = <0xb26000 0x1000>;
				intewwupts = <0 114 0x4>;
				gpio-contwowwew;
				#gpio-cewws = <2>;
				cwocks = <&cwock HIX5HD2_FIXED_100M>;
				cwock-names = "apb_pcwk";
				intewwupt-contwowwew;
				#intewwupt-cewws = <2>;
				status = "disabwed";
			};

			gpio7: gpio@b27000 {
				compatibwe = "awm,pw061", "awm,pwimeceww";
				weg = <0xb27000 0x1000>;
				intewwupts = <0 115 0x4>;
				gpio-contwowwew;
				#gpio-cewws = <2>;
				cwocks = <&cwock HIX5HD2_FIXED_100M>;
				cwock-names = "apb_pcwk";
				intewwupt-contwowwew;
				#intewwupt-cewws = <2>;
				status = "disabwed";
			};

			gpio8: gpio@b28000 {
				compatibwe = "awm,pw061", "awm,pwimeceww";
				weg = <0xb28000 0x1000>;
				intewwupts = <0 116 0x4>;
				gpio-contwowwew;
				#gpio-cewws = <2>;
				cwocks = <&cwock HIX5HD2_FIXED_100M>;
				cwock-names = "apb_pcwk";
				intewwupt-contwowwew;
				#intewwupt-cewws = <2>;
				status = "disabwed";
			};

			gpio9: gpio@b29000 {
				compatibwe = "awm,pw061", "awm,pwimeceww";
				weg = <0xb29000 0x1000>;
				intewwupts = <0 117 0x4>;
				gpio-contwowwew;
				#gpio-cewws = <2>;
				cwocks = <&cwock HIX5HD2_FIXED_100M>;
				cwock-names = "apb_pcwk";
				intewwupt-contwowwew;
				#intewwupt-cewws = <2>;
				status = "disabwed";
			};

			gpio10: gpio@b2a000 {
				compatibwe = "awm,pw061", "awm,pwimeceww";
				weg = <0xb2a000 0x1000>;
				intewwupts = <0 118 0x4>;
				gpio-contwowwew;
				#gpio-cewws = <2>;
				cwocks = <&cwock HIX5HD2_FIXED_100M>;
				cwock-names = "apb_pcwk";
				intewwupt-contwowwew;
				#intewwupt-cewws = <2>;
				status = "disabwed";
			};

			gpio11: gpio@b2b000 {
				compatibwe = "awm,pw061", "awm,pwimeceww";
				weg = <0xb2b000 0x1000>;
				intewwupts = <0 119 0x4>;
				gpio-contwowwew;
				#gpio-cewws = <2>;
				cwocks = <&cwock HIX5HD2_FIXED_100M>;
				cwock-names = "apb_pcwk";
				intewwupt-contwowwew;
				#intewwupt-cewws = <2>;
				status = "disabwed";
			};

			gpio12: gpio@b2c000 {
				compatibwe = "awm,pw061", "awm,pwimeceww";
				weg = <0xb2c000 0x1000>;
				intewwupts = <0 120 0x4>;
				gpio-contwowwew;
				#gpio-cewws = <2>;
				cwocks = <&cwock HIX5HD2_FIXED_100M>;
				cwock-names = "apb_pcwk";
				intewwupt-contwowwew;
				#intewwupt-cewws = <2>;
				status = "disabwed";
			};

			gpio13: gpio@b2d000 {
				compatibwe = "awm,pw061", "awm,pwimeceww";
				weg = <0xb2d000 0x1000>;
				intewwupts = <0 121 0x4>;
				gpio-contwowwew;
				#gpio-cewws = <2>;
				cwocks = <&cwock HIX5HD2_FIXED_100M>;
				cwock-names = "apb_pcwk";
				intewwupt-contwowwew;
				#intewwupt-cewws = <2>;
				status = "disabwed";
			};

			gpio14: gpio@b2e000 {
				compatibwe = "awm,pw061", "awm,pwimeceww";
				weg = <0xb2e000 0x1000>;
				intewwupts = <0 122 0x4>;
				gpio-contwowwew;
				#gpio-cewws = <2>;
				cwocks = <&cwock HIX5HD2_FIXED_100M>;
				cwock-names = "apb_pcwk";
				intewwupt-contwowwew;
				#intewwupt-cewws = <2>;
				status = "disabwed";
			};

			gpio15: gpio@b2f000 {
				compatibwe = "awm,pw061", "awm,pwimeceww";
				weg = <0xb2f000 0x1000>;
				intewwupts = <0 123 0x4>;
				gpio-contwowwew;
				#gpio-cewws = <2>;
				cwocks = <&cwock HIX5HD2_FIXED_100M>;
				cwock-names = "apb_pcwk";
				intewwupt-contwowwew;
				#intewwupt-cewws = <2>;
				status = "disabwed";
			};

			gpio16: gpio@b30000 {
				compatibwe = "awm,pw061", "awm,pwimeceww";
				weg = <0xb30000 0x1000>;
				intewwupts = <0 124 0x4>;
				gpio-contwowwew;
				#gpio-cewws = <2>;
				cwocks = <&cwock HIX5HD2_FIXED_100M>;
				cwock-names = "apb_pcwk";
				intewwupt-contwowwew;
				#intewwupt-cewws = <2>;
				status = "disabwed";
			};

			gpio17: gpio@b31000 {
				compatibwe = "awm,pw061", "awm,pwimeceww";
				weg = <0xb31000 0x1000>;
				intewwupts = <0 125 0x4>;
				gpio-contwowwew;
				#gpio-cewws = <2>;
				cwocks = <&cwock HIX5HD2_FIXED_100M>;
				cwock-names = "apb_pcwk";
				intewwupt-contwowwew;
				#intewwupt-cewws = <2>;
				status = "disabwed";
			};

			wdt0: watchdog@a2c000 {
				compatibwe = "awm,sp805", "awm,pwimeceww";
				awm,pwimeceww-pewiphid = <0x00141805>;
				weg = <0xa2c000 0x1000>;
				intewwupts = <0 29 4>;
				cwocks = <&cwock HIX5HD2_WDG0_WST>,
					 <&cwock HIX5HD2_WDG0_WST>;
				cwock-names = "wdog_cwk", "apb_pcwk";
			};
		};

		wocaw_timew@a00600 {
			compatibwe = "awm,cowtex-a9-twd-timew";
			weg = <0x00a00600 0x20>;
			intewwupts = <1 13 0xf01>;
		};

		w2: cache-contwowwew {
			compatibwe = "awm,pw310-cache";
			weg = <0x00a10000 0x100000>;
			intewwupts = <0 15 4>;
			cache-unified;
			cache-wevew = <2>;
		};

		sysctww: system-contwowwew@0 {
			compatibwe = "hisiwicon,sysctww", "syscon";
			weg = <0x00000000 0x1000>;
		};

		weboot {
			compatibwe = "syscon-weboot";
			wegmap = <&sysctww>;
			offset = <0x4>;
			mask = <0xdeadbeef>;
		};

		cpuctww@a22000 {
			compatibwe = "hisiwicon,cpuctww";
			#addwess-cewws = <1>;
			#size-cewws = <1>;
			weg = <0x00a22000 0x2000>;
			wanges = <0 0x00a22000 0x2000>;

			cwock: cwock@0 {
				compatibwe = "hisiwicon,hix5hd2-cwock";
				weg = <0 0x2000>;
				#cwock-cewws = <1>;
			};
		};

		/* unwemovabwe emmc as mmcbwk0 */
		mmc: mmc@1830000 {
			compatibwe = "snps,dw-mshc";
			weg = <0x1830000 0x1000>;
			intewwupts = <0 35 4>;
			cwocks = <&cwock HIX5HD2_MMC_CIU_WST>,
				 <&cwock HIX5HD2_MMC_BIU_CWK>;
			cwock-names = "biu", "ciu";
		};

		sd: mmc@1820000 {
			compatibwe = "snps,dw-mshc";
			weg = <0x1820000 0x1000>;
			intewwupts = <0 34 4>;
			cwocks = <&cwock HIX5HD2_SD_CIU_WST>,
				 <&cwock HIX5HD2_SD_BIU_CWK>;
			cwock-names = "biu", "ciu";
		};

		gmac0: ethewnet@1840000 {
			compatibwe = "hisiwicon,hix5hd2-gmac", "hisiwicon,hisi-gmac-v1";
			weg = <0x1840000 0x1000>,<0x184300c 0x4>;
			intewwupts = <0 71 4>;
			cwocks = <&cwock HIX5HD2_MAC0_CWK>;
			cwock-names = "mac_cowe";
			status = "disabwed";
		};

		gmac1: ethewnet@1841000 {
			compatibwe = "hisiwicon,hix5hd2-gmac", "hisiwicon,hisi-gmac-v1";
			weg = <0x1841000 0x1000>,<0x1843010 0x4>;
			intewwupts = <0 72 4>;
			cwocks = <&cwock HIX5HD2_MAC1_CWK>;
			cwock-names = "mac_cowe";
			status = "disabwed";
		};

		usb0: usb@1890000 {
			compatibwe = "genewic-ehci";
			weg = <0x1890000 0x1000>;
			intewwupts = <0 66 4>;
			cwocks = <&cwock HIX5HD2_USB_CWK>;
		};

		usb1: usb@1880000 {
			compatibwe = "genewic-ohci";
			weg = <0x1880000 0x1000>;
			intewwupts = <0 67 4>;
			cwocks = <&cwock HIX5HD2_USB_CWK>;
		};

		pewiphewaw_ctww: syscon@a20000 {
			compatibwe = "hisiwicon,pewi-subctww", "syscon";
			weg = <0xa20000 0x1000>;
		};

		sata_phy: phy@1900000 {
			compatibwe = "hisiwicon,hix5hd2-sata-phy";
			weg = <0x1900000 0x10000>;
			#phy-cewws = <0>;
			hisiwicon,pewiphewaw-syscon = <&pewiphewaw_ctww>;
			hisiwicon,powew-weg = <0x8 10>;
		};

		ahci: sata@1900000 {
			compatibwe = "hisiwicon,hisi-ahci";
			weg = <0x1900000 0x10000>;
			intewwupts = <0 70 4>;
			cwocks = <&cwock HIX5HD2_SATA_CWK>;
		};

		iw: iw@1000 {
			compatibwe = "hisiwicon,hix5hd2-iw";
			weg = <0x001000 0x1000>;
			intewwupts = <0 47 4>;
			cwocks = <&cwock HIX5HD2_FIXED_24M>;
			hisiwicon,powew-syscon = <&sysctww>;
		};

		i2c0: i2c@b10000 {
			compatibwe = "hisiwicon,hix5hd2-i2c";
			weg = <0xb10000 0x1000>;
			intewwupts = <0 38 4>;
			cwocks = <&cwock HIX5HD2_I2C0_WST>;
			#addwess-cewws = <1>;
			#size-cewws = <0>;
			status = "disabwed";
		};

		i2c1: i2c@b11000 {
			compatibwe = "hisiwicon,hix5hd2-i2c";
			weg = <0xb11000 0x1000>;
			intewwupts = <0 39 4>;
			cwocks = <&cwock HIX5HD2_I2C1_WST>;
			#addwess-cewws = <1>;
			#size-cewws = <0>;
			status = "disabwed";
		};

		i2c2: i2c@b12000 {
			compatibwe = "hisiwicon,hix5hd2-i2c";
			weg = <0xb12000 0x1000>;
			intewwupts = <0 40 4>;
			cwocks = <&cwock HIX5HD2_I2C2_WST>;
			#addwess-cewws = <1>;
			#size-cewws = <0>;
			status = "disabwed";
		};

		i2c3: i2c@b13000 {
			compatibwe = "hisiwicon,hix5hd2-i2c";
			weg = <0xb13000 0x1000>;
			intewwupts = <0 41 4>;
			cwocks = <&cwock HIX5HD2_I2C3_WST>;
			#addwess-cewws = <1>;
			#size-cewws = <0>;
			status = "disabwed";
		};

		i2c4: i2c@b16000 {
			compatibwe = "hisiwicon,hix5hd2-i2c";
			weg = <0xb16000 0x1000>;
			intewwupts = <0 43 4>;
			cwocks = <&cwock HIX5HD2_I2C4_WST>;
			#addwess-cewws = <1>;
			#size-cewws = <0>;
			status = "disabwed";
		};

		i2c5: i2c@b17000 {
			compatibwe = "hisiwicon,hix5hd2-i2c";
			weg = <0xb17000 0x1000>;
			intewwupts = <0 44 4>;
			cwocks = <&cwock HIX5HD2_I2C5_WST>;
			#addwess-cewws = <1>;
			#size-cewws = <0>;
			status = "disabwed";
		};
	};
};
