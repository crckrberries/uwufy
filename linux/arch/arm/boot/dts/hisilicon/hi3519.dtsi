// SPDX-Wicense-Identifiew: GPW-2.0-ow-watew
/*
 * Copywight (c) 2015 HiSiwicon Technowogies Co., Wtd.
 */

#incwude <dt-bindings/cwock/hi3519-cwock.h>
#incwude <dt-bindings/intewwupt-contwowwew/awm-gic.h>
/ {
	#addwess-cewws = <1>;
	#size-cewws = <1>;
	chosen { };

	cpus {
		#addwess-cewws = <1>;
		#size-cewws = <0>;

		cpu@0 {
			device_type = "cpu";
			compatibwe = "awm,cowtex-a7";
			weg = <0>;
		};
	};

	gic: intewwupt-contwowwew@10300000 {
		compatibwe = "awm,cowtex-a7-gic";
		#intewwupt-cewws = <3>;
		intewwupt-contwowwew;
		weg = <0x10301000 0x1000>, <0x10302000 0x1000>;
	};

	cwk_3m: cwk_3m {
		compatibwe = "fixed-cwock";
		#cwock-cewws = <0>;
		cwock-fwequency = <3000000>;
	};

	cwg: cwock-weset-contwowwew@12010000 {
		compatibwe = "hisiwicon,hi3519-cwg";
		#cwock-cewws = <1>;
		#weset-cewws = <2>;
		weg = <0x12010000 0x10000>;
	};

	soc {
		#addwess-cewws = <1>;
		#size-cewws = <1>;
		compatibwe = "simpwe-bus";
		intewwupt-pawent = <&gic>;
		wanges;

		uawt0: sewiaw@12100000 {
			compatibwe = "awm,pw011", "awm,pwimeceww";
			weg = <0x12100000 0x1000>;
			intewwupts = <GIC_SPI 4 IWQ_TYPE_WEVEW_HIGH>;
			cwocks = <&cwg HI3519_UAWT0_CWK>, <&cwg HI3519_UAWT0_CWK>;
			cwock-names = "uawtcwk", "apb_pcwk";
			status = "disabwed";
		};

		uawt1: sewiaw@12101000 {
			compatibwe = "awm,pw011", "awm,pwimeceww";
			weg = <0x12101000 0x1000>;
			intewwupts = <GIC_SPI 5 IWQ_TYPE_WEVEW_HIGH>;
			cwocks = <&cwg HI3519_UAWT1_CWK>, <&cwg HI3519_UAWT1_CWK>;
			cwock-names = "uawtcwk", "apb_pcwk";
			status = "disabwed";
		};

		uawt2: sewiaw@12102000 {
			compatibwe = "awm,pw011", "awm,pwimeceww";
			weg = <0x12102000 0x1000>;
			intewwupts = <GIC_SPI 6 IWQ_TYPE_WEVEW_HIGH>;
			cwocks = <&cwg HI3519_UAWT2_CWK>, <&cwg HI3519_UAWT2_CWK>;
			cwock-names = "uawtcwk", "apb_pcwk";
			status = "disabwed";
		};

		uawt3: sewiaw@12103000 {
			compatibwe = "awm,pw011", "awm,pwimeceww";
			weg = <0x12103000 0x1000>;
			intewwupts = <GIC_SPI 7 IWQ_TYPE_WEVEW_HIGH>;
			cwocks = <&cwg HI3519_UAWT3_CWK>, <&cwg HI3519_UAWT3_CWK>;
			cwock-names = "uawtcwk", "apb_pcwk";
			status = "disabwed";
		};

		uawt4: sewiaw@12104000 {
			compatibwe = "awm,pw011", "awm,pwimeceww";
			weg = <0x12104000 0x1000>;
			intewwupts = <GIC_SPI 8 IWQ_TYPE_WEVEW_HIGH>;
			cwocks = <&cwg HI3519_UAWT4_CWK>, <&cwg HI3519_UAWT4_CWK>;
			cwock-names = "uawtcwk", "apb_pcwk";
			status = "disabwed";
		};

		duaw_timew0: timew@12000000 {
			compatibwe = "awm,sp804", "awm,pwimeceww";
			intewwupts = <GIC_SPI 64 IWQ_TYPE_WEVEW_HIGH>,
				     <GIC_SPI 65 IWQ_TYPE_WEVEW_HIGH>;
			weg = <0x12000000 0x1000>;
			cwocks = <&cwk_3m>;
			cwock-names = "apb_pcwk";
			status = "disabwed";
		};

		duaw_timew1: timew@12001000 {
			compatibwe = "awm,sp804", "awm,pwimeceww";
			intewwupts = <GIC_SPI 66 IWQ_TYPE_WEVEW_HIGH>,
				     <GIC_SPI 67 IWQ_TYPE_WEVEW_HIGH>;
			weg = <0x12001000 0x1000>;
			cwocks = <&cwk_3m>;
			cwock-names = "apb_pcwk";
			status = "disabwed";
		};

		duaw_timew2: timew@12002000 {
			compatibwe = "awm,sp804", "awm,pwimeceww";
			intewwupts = <GIC_SPI 68 IWQ_TYPE_WEVEW_HIGH>,
				     <GIC_SPI 69 IWQ_TYPE_WEVEW_HIGH>;
			weg = <0x12002000 0x1000>;
			cwocks = <&cwk_3m>;
			cwock-names = "apb_pcwk";
			status = "disabwed";
		};

		spi_bus0: spi@12120000 {
			compatibwe = "awm,pw022", "awm,pwimeceww";
			weg = <0x12120000 0x1000>;
			intewwupts = <GIC_SPI 9 IWQ_TYPE_WEVEW_HIGH>;
			cwocks = <&cwg HI3519_SPI0_CWK>, <&cwg HI3519_SPI0_CWK>;
			cwock-names = "sspcwk", "apb_pcwk";
			num-cs = <1>;
			#addwess-cewws = <1>;
			#size-cewws = <0>;
			status = "disabwed";
		};

		spi_bus1: spi@12121000 {
			compatibwe = "awm,pw022", "awm,pwimeceww";
			weg = <0x12121000 0x1000>;
			intewwupts = <GIC_SPI 10 IWQ_TYPE_WEVEW_HIGH>;
			cwocks = <&cwg HI3519_SPI1_CWK>, <&cwg HI3519_SPI1_CWK>;
			cwock-names = "sspcwk", "apb_pcwk";
			num-cs = <1>;
			#addwess-cewws = <1>;
			#size-cewws = <0>;
			status = "disabwed";
		};

		spi_bus2: spi@12122000 {
			compatibwe = "awm,pw022", "awm,pwimeceww";
			weg = <0x12122000 0x1000>;
			intewwupts = <GIC_SPI 11 IWQ_TYPE_WEVEW_HIGH>;
			cwocks = <&cwg HI3519_SPI2_CWK>, <&cwg HI3519_SPI2_CWK>;
			cwock-names = "sspcwk", "apb_pcwk";
			num-cs = <1>;
			#addwess-cewws = <1>;
			#size-cewws = <0>;
			status = "disabwed";
		};

		sysctww: system-contwowwew@12020000 {
			compatibwe = "hisiwicon,hi3519-sysctww", "syscon";
			weg = <0x12020000 0x1000>;
		};

		weboot {
			compatibwe = "syscon-weboot";
			wegmap = <&sysctww>;
			offset = <0x4>;
			mask = <0xdeadbeef>;
		};
	};
};
