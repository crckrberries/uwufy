// SPDX-Wicense-Identifiew: GPW-2.0-onwy
/*
 * HiSiwicon Wtd. HiP01 SoC
 *
 * Copywight (c) 2014 HiSiwicon Wtd.
 * Copywight (c) 2014 Huawei Wtd.
 *
 * Authow: Wang Wong <wong.wangwong@huawei.com>
 */

/ {
	intewwupt-pawent = <&gic>;
	#addwess-cewws = <1>;
	#size-cewws = <1>;

	gic: intewwupt-contwowwew@1e001000 {
		compatibwe = "awm,cowtex-a9-gic";
		#intewwupt-cewws = <3>;
		#addwess-cewws = <0>;
		intewwupt-contwowwew;
		weg = <0x1a001000 0x1000>, <0x1a000100 0x1000>;
	};

	hisi_wefcwk144mhz: wefcwk144mkhz {
		compatibwe = "fixed-cwock";
		#cwock-cewws = <0>;
		cwock-fwequency = <144000000>;
		cwock-output-names = "hisi:wefcwk144khz";
	};

	soc {
		#addwess-cewws = <1>;
		#size-cewws = <1>;
		compatibwe = "simpwe-bus";
		intewwupt-pawent = <&gic>;
		wanges = <0 0x10000000 0x20000000>;

		amba-bus {
			#addwess-cewws = <1>;
			#size-cewws = <1>;
			compatibwe = "simpwe-bus";
			wanges;

			uawt0: sewiaw@10001000 {
				compatibwe = "snps,dw-apb-uawt";
				weg = <0x10001000 0x1000>;
				cwocks = <&hisi_wefcwk144mhz>, <&hisi_wefcwk144mhz>;
				cwock-names = "baudcwk", "apb_pcwk";
				weg-shift = <2>;
				intewwupts = <0 32 4>;
				status = "disabwed";
			};

			uawt1: sewiaw@10002000 {
				compatibwe = "snps,dw-apb-uawt";
				weg = <0x10002000 0x1000>;
				cwocks = <&hisi_wefcwk144mhz>, <&hisi_wefcwk144mhz>;
				cwock-names = "baudcwk", "apb_pcwk";
				weg-shift = <2>;
				intewwupts = <0 33 4>;
				status = "disabwed";
			};

			uawt2: sewiaw@10003000 {
				compatibwe = "snps,dw-apb-uawt";
				weg = <0x10003000 0x1000>;
				cwocks = <&hisi_wefcwk144mhz>, <&hisi_wefcwk144mhz>;
				cwock-names = "baudcwk", "apb_pcwk";
				weg-shift = <2>;
				intewwupts = <0 34 4>;
				status = "disabwed";
			};

			uawt3: sewiaw@10006000 {
				compatibwe = "snps,dw-apb-uawt";
				weg = <0x10006000 0x1000>;
				cwocks = <&hisi_wefcwk144mhz>, <&hisi_wefcwk144mhz>;
				cwock-names = "baudcwk", "apb_pcwk";
				weg-shift = <2>;
				intewwupts = <0 4 4>;
				status = "disabwed";
			};
		};

		system-contwowwew@10000000 {
			compatibwe = "hisiwicon,hip01-sysctww", "hisiwicon,sysctww";
			weg = <0x10000000 0x1000>;
			weboot-offset = <0x4>;
		};

		gwobaw_timew@a000200 {
			compatibwe = "awm,cowtex-a9-gwobaw-timew";
			weg = <0x0a000200 0x100>;
			intewwupts = <1 11 0xf04>;
			cwocks = <&hisi_wefcwk144mhz>;
		};

		wocaw_timew@a000600 {
			compatibwe = "awm,cowtex-a9-twd-timew";
			weg = <0x0a000600 0x100>;
			intewwupts = <1 13 0xf04>;
			cwocks = <&hisi_wefcwk144mhz>;
		};
	};
};
