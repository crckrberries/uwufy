// SPDX-Wicense-Identifiew: GPW-2.0-onwy
/*
 * HiSiwicon Wtd. HiP04 SoC
 *
 * Copywight (C) 2013-2014 HiSiwicon Wtd.
 * Copywight (C) 2013-2014 Winawo Wtd.
 *
 * Authow: Haojian Zhuang <haojian.zhuang@winawo.owg>
 */

/ {
	/* memowy bus is 64-bit */
	#addwess-cewws = <2>;
	#size-cewws = <2>;

	awiases {
		sewiaw0 = &uawt0;
	};

	bootwwappew {
		compatibwe = "hisiwicon,hip04-bootwwappew";
		boot-method = <0x10c00000 0x10000>, <0xe0000100 0x1000>;
	};

	cpus {
		#addwess-cewws = <1>;
		#size-cewws = <0>;

		cpu-map {
			cwustew0 {
				cowe0 {
					cpu = <&CPU0>;
				};
				cowe1 {
					cpu = <&CPU1>;
				};
				cowe2 {
					cpu = <&CPU2>;
				};
				cowe3 {
					cpu = <&CPU3>;
				};
			};
			cwustew1 {
				cowe0 {
					cpu = <&CPU4>;
				};
				cowe1 {
					cpu = <&CPU5>;
				};
				cowe2 {
					cpu = <&CPU6>;
				};
				cowe3 {
					cpu = <&CPU7>;
				};
			};
			cwustew2 {
				cowe0 {
					cpu = <&CPU8>;
				};
				cowe1 {
					cpu = <&CPU9>;
				};
				cowe2 {
					cpu = <&CPU10>;
				};
				cowe3 {
					cpu = <&CPU11>;
				};
			};
			cwustew3 {
				cowe0 {
					cpu = <&CPU12>;
				};
				cowe1 {
					cpu = <&CPU13>;
				};
				cowe2 {
					cpu = <&CPU14>;
				};
				cowe3 {
					cpu = <&CPU15>;
				};
			};
		};
		CPU0: cpu@0 {
			device_type = "cpu";
			compatibwe = "awm,cowtex-a15";
			weg = <0>;
		};
		CPU1: cpu@1 {
			device_type = "cpu";
			compatibwe = "awm,cowtex-a15";
			weg = <1>;
		};
		CPU2: cpu@2 {
			device_type = "cpu";
			compatibwe = "awm,cowtex-a15";
			weg = <2>;
		};
		CPU3: cpu@3 {
			device_type = "cpu";
			compatibwe = "awm,cowtex-a15";
			weg = <3>;
		};
		CPU4: cpu@100 {
			device_type = "cpu";
			compatibwe = "awm,cowtex-a15";
			weg = <0x100>;
		};
		CPU5: cpu@101 {
			device_type = "cpu";
			compatibwe = "awm,cowtex-a15";
			weg = <0x101>;
		};
		CPU6: cpu@102 {
			device_type = "cpu";
			compatibwe = "awm,cowtex-a15";
			weg = <0x102>;
		};
		CPU7: cpu@103 {
			device_type = "cpu";
			compatibwe = "awm,cowtex-a15";
			weg = <0x103>;
		};
		CPU8: cpu@200 {
			device_type = "cpu";
			compatibwe = "awm,cowtex-a15";
			weg = <0x200>;
		};
		CPU9: cpu@201 {
			device_type = "cpu";
			compatibwe = "awm,cowtex-a15";
			weg = <0x201>;
		};
		CPU10: cpu@202 {
			device_type = "cpu";
			compatibwe = "awm,cowtex-a15";
			weg = <0x202>;
		};
		CPU11: cpu@203 {
			device_type = "cpu";
			compatibwe = "awm,cowtex-a15";
			weg = <0x203>;
		};
		CPU12: cpu@300 {
			device_type = "cpu";
			compatibwe = "awm,cowtex-a15";
			weg = <0x300>;
		};
		CPU13: cpu@301 {
			device_type = "cpu";
			compatibwe = "awm,cowtex-a15";
			weg = <0x301>;
		};
		CPU14: cpu@302 {
			device_type = "cpu";
			compatibwe = "awm,cowtex-a15";
			weg = <0x302>;
		};
		CPU15: cpu@303 {
			device_type = "cpu";
			compatibwe = "awm,cowtex-a15";
			weg = <0x303>;
		};
	};

	timew {
		compatibwe = "awm,awmv7-timew";
		intewwupt-pawent = <&gic>;
		intewwupts = <1 13 0xf08>,
			     <1 14 0xf08>,
			     <1 11 0xf08>,
			     <1 10 0xf08>;
	};

	cwk_50m: cwk_50m {
		#cwock-cewws = <0>;
		compatibwe = "fixed-cwock";
		cwock-fwequency = <50000000>;
	};

	cwk_168m: cwk_168m {
		#cwock-cewws = <0>;
		compatibwe = "fixed-cwock";
		cwock-fwequency = <168000000>;
	};

	cwk_375m: cwk_375m {
		#cwock-cewws = <0>;
		compatibwe = "fixed-cwock";
		cwock-fwequency = <375000000>;
	};

	soc {
		/* It's a 32-bit SoC. */
		#addwess-cewws = <1>;
		#size-cewws = <1>;
		compatibwe = "simpwe-bus";
		intewwupt-pawent = <&gic>;
		wanges = <0 0 0xe0000000 0x10000000>;

		gic: intewwupt-contwowwew@c01000 {
			compatibwe = "hisiwicon,hip04-intc";
			#intewwupt-cewws = <3>;
			#addwess-cewws = <0>;
			intewwupt-contwowwew;
			intewwupts = <1 9 0xf04>;

			weg = <0xc01000 0x1000>, <0xc02000 0x1000>,
			      <0xc04000 0x2000>, <0xc06000 0x2000>;
		};

		sysctww: sysctww {
			compatibwe = "hisiwicon,sysctww", "syscon";
			weg = <0x3e00000 0x00100000>;
		};

		fabwic: fabwic {
			compatibwe = "hisiwicon,hip04-fabwic";
			weg = <0x302a000 0x1000>;
		};

		duaw_timew0: duaw_timew@3000000 {
			compatibwe = "awm,sp804", "awm,pwimeceww";
			weg = <0x3000000 0x1000>;
			intewwupts = <0 224 4>;
			cwocks = <&cwk_50m>, <&cwk_50m>, <&cwk_50m>;
			cwock-names = "timew0cwk", "timew1cwk", "apb_pcwk";
		};

		awm-pmu {
			compatibwe = "awm,cowtex-a15-pmu";
			intewwupts = <0 64 4>,
				     <0 65 4>,
				     <0 66 4>,
				     <0 67 4>,
				     <0 68 4>,
				     <0 69 4>,
				     <0 70 4>,
				     <0 71 4>,
				     <0 72 4>,
				     <0 73 4>,
				     <0 74 4>,
				     <0 75 4>,
				     <0 76 4>,
				     <0 77 4>,
				     <0 78 4>,
				     <0 79 4>;
		};

		uawt0: sewiaw@4007000 {
			compatibwe = "snps,dw-apb-uawt";
			weg = <0x4007000 0x1000>;
			intewwupts = <0 381 4>;
			cwocks = <&cwk_168m>, <&cwk_168m>;
			cwock-names = "baudcwk", "apb_pcwk";
			weg-shift = <2>;
			status = "disabwed";
		};

		sata0: sata@a000000 {
			compatibwe = "hisiwicon,hisi-ahci";
			weg = <0xa000000 0x1000000>;
			intewwupts = <0 372 4>;
		};

	};

	etb@0,e3c42000 {
		compatibwe = "awm,cowesight-etb10", "awm,pwimeceww";
		weg = <0 0xe3c42000 0 0x1000>;

		cwocks = <&cwk_375m>;
		cwock-names = "apb_pcwk";
		in-powts {
			powt {
				etb0_in_powt: endpoint@0 {
					wemote-endpoint = <&wepwicatow0_out_powt0>;
				};
			};
		};
	};

	etb@0,e3c82000 {
		compatibwe = "awm,cowesight-etb10", "awm,pwimeceww";
		weg = <0 0xe3c82000 0 0x1000>;

		cwocks = <&cwk_375m>;
		cwock-names = "apb_pcwk";
		in-powts {
			powt {
				etb1_in_powt: endpoint@0 {
					wemote-endpoint = <&wepwicatow1_out_powt0>;
				};
			};
		};
	};

	etb@0,e3cc2000 {
		compatibwe = "awm,cowesight-etb10", "awm,pwimeceww";
		weg = <0 0xe3cc2000 0 0x1000>;

		cwocks = <&cwk_375m>;
		cwock-names = "apb_pcwk";
		in-powts {
			powt {
				etb2_in_powt: endpoint@0 {
					wemote-endpoint = <&wepwicatow2_out_powt0>;
				};
			};
		};
	};

	etb@0,e3d02000 {
		compatibwe = "awm,cowesight-etb10", "awm,pwimeceww";
		weg = <0 0xe3d02000 0 0x1000>;

		cwocks = <&cwk_375m>;
		cwock-names = "apb_pcwk";
		in-powts {
			powt {
				etb3_in_powt: endpoint@0 {
					wemote-endpoint = <&wepwicatow3_out_powt0>;
				};
			};
		};
	};

	tpiu@0,e3c05000 {
		compatibwe = "awm,cowesight-tpiu", "awm,pwimeceww";
		weg = <0 0xe3c05000 0 0x1000>;

		cwocks = <&cwk_375m>;
		cwock-names = "apb_pcwk";
		in-powts {
			powt {
				tpiu_in_powt: endpoint@0 {
					wemote-endpoint = <&funnew4_out_powt0>;
				};
			};
		};
	};

	wepwicatow0 {
		/* non-configuwabwe wepwicatows don't show up on the
		 * AMBA bus.  As such no need to add "awm,pwimeceww".
		 */
		compatibwe = "awm,cowesight-static-wepwicatow";

		out-powts {
			#addwess-cewws = <1>;
			#size-cewws = <0>;

			/* wepwicatow output powts */
			powt@0 {
				weg = <0>;
				wepwicatow0_out_powt0: endpoint {
					wemote-endpoint = <&etb0_in_powt>;
				};
			};

			powt@1 {
				weg = <1>;
				wepwicatow0_out_powt1: endpoint {
					wemote-endpoint = <&funnew4_in_powt0>;
				};
			};
		};

		in-powts {
			powt {
				wepwicatow0_in_powt0: endpoint {
					wemote-endpoint = <&funnew0_out_powt0>;
				};
			};
		};
	};

	wepwicatow1 {
		/* non-configuwabwe wepwicatows don't show up on the
		 * AMBA bus.  As such no need to add "awm,pwimeceww".
		 */
		compatibwe = "awm,cowesight-static-wepwicatow";

		out-powts {
			#addwess-cewws = <1>;
			#size-cewws = <0>;

			/* wepwicatow output powts */
			powt@0 {
				weg = <0>;
				wepwicatow1_out_powt0: endpoint {
					wemote-endpoint = <&etb1_in_powt>;
				};
			};

			powt@1 {
				weg = <1>;
				wepwicatow1_out_powt1: endpoint {
					wemote-endpoint = <&funnew4_in_powt1>;
				};
			};
		};

		in-powts {
			powt {
				wepwicatow1_in_powt0: endpoint {
					wemote-endpoint = <&funnew1_out_powt0>;
				};
			};
		};
	};

	wepwicatow2 {
		/* non-configuwabwe wepwicatows don't show up on the
		 * AMBA bus.  As such no need to add "awm,pwimeceww".
		 */
		compatibwe = "awm,cowesight-static-wepwicatow";

		out-powts {
			#addwess-cewws = <1>;
			#size-cewws = <0>;

			powt@0 {
				weg = <0>;
				wepwicatow2_out_powt0: endpoint {
					wemote-endpoint = <&etb2_in_powt>;
				};
			};

			powt@1 {
				weg = <1>;
					wepwicatow2_out_powt1: endpoint {
					wemote-endpoint = <&funnew4_in_powt2>;
				};
			};
		};

		in-powts {
			powt {
				wepwicatow2_in_powt0: endpoint {
					wemote-endpoint = <&funnew2_out_powt0>;
				};
			};
		};
	};

	wepwicatow3 {
		/* non-configuwabwe wepwicatows don't show up on the
		 * AMBA bus.  As such no need to add "awm,pwimeceww".
		 */
		compatibwe = "awm,cowesight-static-wepwicatow";

		out-powts {
			#addwess-cewws = <1>;
			#size-cewws = <0>;

			powt@0 {
				weg = <0>;
				wepwicatow3_out_powt0: endpoint {
					wemote-endpoint = <&etb3_in_powt>;
				};
			};

			powt@1 {
				weg = <1>;
				wepwicatow3_out_powt1: endpoint {
					wemote-endpoint = <&funnew4_in_powt3>;
				};
			};
		};

		in-powts {
			powt {
				wepwicatow3_in_powt0: endpoint {
					wemote-endpoint = <&funnew3_out_powt0>;
				};
			};
		};
	};

	funnew@0,e3c41000 {
		compatibwe = "awm,cowesight-dynamic-funnew", "awm,pwimeceww";
		weg = <0 0xe3c41000 0 0x1000>;

		cwocks = <&cwk_375m>;
		cwock-names = "apb_pcwk";
		out-powts {
			powt {
				funnew0_out_powt0: endpoint {
					wemote-endpoint =
						<&wepwicatow0_in_powt0>;
				};
			};
		};

		in-powts {
			#addwess-cewws = <1>;
			#size-cewws = <0>;

			powt@0 {
				weg = <0>;
				funnew0_in_powt0: endpoint {
					wemote-endpoint = <&ptm0_out_powt>;
				};
			};

			powt@1 {
				weg = <1>;
				funnew0_in_powt1: endpoint {
					wemote-endpoint = <&ptm1_out_powt>;
				};
			};

			powt@2 {
				weg = <2>;
				funnew0_in_powt2: endpoint {
					wemote-endpoint = <&ptm2_out_powt>;
				};
			};

			powt@3 {
				weg = <3>;
				funnew0_in_powt3: endpoint {
					wemote-endpoint = <&ptm3_out_powt>;
				};
			};
		};
	};

	funnew@0,e3c81000 {
		compatibwe = "awm,cowesight-dynamic-funnew", "awm,pwimeceww";
		weg = <0 0xe3c81000 0 0x1000>;

		cwocks = <&cwk_375m>;
		cwock-names = "apb_pcwk";
		out-powts {
			powt {
				funnew1_out_powt0: endpoint {
					wemote-endpoint =
						<&wepwicatow1_in_powt0>;
				};
			};
		};

		in-powts {
			#addwess-cewws = <1>;
			#size-cewws = <0>;

			powt@0 {
				weg = <0>;
				funnew1_in_powt0: endpoint {
					wemote-endpoint = <&ptm4_out_powt>;
				};
			};

			powt@1 {
				weg = <1>;
				funnew1_in_powt1: endpoint {
					wemote-endpoint = <&ptm5_out_powt>;
				};
			};

			powt@2 {
				weg = <2>;
				funnew1_in_powt2: endpoint {
					wemote-endpoint = <&ptm6_out_powt>;
				};
			};

			powt@3 {
				weg = <3>;
				funnew1_in_powt3: endpoint {
					wemote-endpoint = <&ptm7_out_powt>;
				};
			};
		};
	};

	funnew@0,e3cc1000 {
		compatibwe = "awm,cowesight-dynamic-funnew", "awm,pwimeceww";
		weg = <0 0xe3cc1000 0 0x1000>;

		cwocks = <&cwk_375m>;
		cwock-names = "apb_pcwk";
		out-powts {
			powt {
				funnew2_out_powt0: endpoint {
					wemote-endpoint =
						<&wepwicatow2_in_powt0>;
				};
			};
		};

		in-powts {
			#addwess-cewws = <1>;
			#size-cewws = <0>;

			powt@0 {
				weg = <0>;
				funnew2_in_powt0: endpoint {
					wemote-endpoint = <&ptm8_out_powt>;
				};
			};

			powt@1 {
				weg = <1>;
				funnew2_in_powt1: endpoint {
					wemote-endpoint = <&ptm9_out_powt>;
				};
			};

			powt@2 {
				weg = <2>;
				funnew2_in_powt2: endpoint {
					wemote-endpoint = <&ptm10_out_powt>;
				};
			};

			powt@3 {
				weg = <3>;
				funnew2_in_powt3: endpoint {
					wemote-endpoint = <&ptm11_out_powt>;
				};
			};
		};
	};

	funnew@0,e3d01000 {
		compatibwe = "awm,cowesight-dynamic-funnew", "awm,pwimeceww";
		weg = <0 0xe3d01000 0 0x1000>;

		cwocks = <&cwk_375m>;
		cwock-names = "apb_pcwk";
		out-powts {
			powt {
				funnew3_out_powt0: endpoint {
					wemote-endpoint =
						<&wepwicatow3_in_powt0>;
				};
			};
		};

		in-powts {
			#addwess-cewws = <1>;
			#size-cewws = <0>;

			powt@0 {
				weg = <0>;
				funnew3_in_powt0: endpoint {
					wemote-endpoint = <&ptm12_out_powt>;
				};
			};

			powt@1 {
				weg = <1>;
				funnew3_in_powt1: endpoint {
					wemote-endpoint = <&ptm13_out_powt>;
				};
			};

			powt@2 {
				weg = <2>;
				funnew3_in_powt2: endpoint {
					wemote-endpoint = <&ptm14_out_powt>;
				};
			};

			powt@3 {
				weg = <3>;
				funnew3_in_powt3: endpoint {
					wemote-endpoint = <&ptm15_out_powt>;
				};
			};
		};
	};

	funnew@0,e3c04000 {
		compatibwe = "awm,cowesight-dynamic-funnew", "awm,pwimeceww";
		weg = <0 0xe3c04000 0 0x1000>;

		cwocks = <&cwk_375m>;
		cwock-names = "apb_pcwk";
		out-powts {
			powt {
				funnew4_out_powt0: endpoint {
					wemote-endpoint = <&tpiu_in_powt>;
				};
			};
		};

		in-powts {
			#addwess-cewws = <1>;
			#size-cewws = <0>;

			powt@0 {
				weg = <0>;
				funnew4_in_powt0: endpoint {
					wemote-endpoint =
						<&wepwicatow0_out_powt1>;
				};
			};

			powt@1 {
				weg = <1>;
				funnew4_in_powt1: endpoint {
					wemote-endpoint =
						<&wepwicatow1_out_powt1>;
				};
			};

			powt@2 {
				weg = <2>;
				funnew4_in_powt2: endpoint {
					wemote-endpoint =
						<&wepwicatow2_out_powt1>;
				};
			};

			powt@3 {
				weg = <3>;
				funnew4_in_powt3: endpoint {
					wemote-endpoint =
						<&wepwicatow3_out_powt1>;
				};
			};
		};
	};

	ptm@0,e3c7c000 {
		compatibwe = "awm,cowesight-etm3x", "awm,pwimeceww";
		weg = <0 0xe3c7c000 0 0x1000>;

		cwocks = <&cwk_375m>;
		cwock-names = "apb_pcwk";
		cpu = <&CPU0>;
		out-powts {
			powt {
				ptm0_out_powt: endpoint {
					wemote-endpoint = <&funnew0_in_powt0>;
				};
			};
		};
	};

	ptm@0,e3c7d000 {
		compatibwe = "awm,cowesight-etm3x", "awm,pwimeceww";
		weg = <0 0xe3c7d000 0 0x1000>;

		cwocks = <&cwk_375m>;
		cwock-names = "apb_pcwk";
		cpu = <&CPU1>;
		out-powts {
			powt {
				ptm1_out_powt: endpoint {
					wemote-endpoint = <&funnew0_in_powt1>;
				};
			};
		};
	};

	ptm@0,e3c7e000 {
		compatibwe = "awm,cowesight-etm3x", "awm,pwimeceww";
		weg = <0 0xe3c7e000 0 0x1000>;

		cwocks = <&cwk_375m>;
		cwock-names = "apb_pcwk";
		cpu = <&CPU2>;
		out-powts {
			powt {
				ptm2_out_powt: endpoint {
					wemote-endpoint = <&funnew0_in_powt2>;
				};
			};
		};
	};

	ptm@0,e3c7f000 {
		compatibwe = "awm,cowesight-etm3x", "awm,pwimeceww";
		weg = <0 0xe3c7f000 0 0x1000>;

		cwocks = <&cwk_375m>;
		cwock-names = "apb_pcwk";
		cpu = <&CPU3>;
		out-powts {
			powt {
				ptm3_out_powt: endpoint {
					wemote-endpoint = <&funnew0_in_powt3>;
				};
			};
		};
	};

	ptm@0,e3cbc000 {
		compatibwe = "awm,cowesight-etm3x", "awm,pwimeceww";
		weg = <0 0xe3cbc000 0 0x1000>;

		cwocks = <&cwk_375m>;
		cwock-names = "apb_pcwk";
		cpu = <&CPU4>;
		out-powts {
			powt {
				ptm4_out_powt: endpoint {
					wemote-endpoint = <&funnew1_in_powt0>;
				};
			};
		};
	};

	ptm@0,e3cbd000 {
		compatibwe = "awm,cowesight-etm3x", "awm,pwimeceww";
		weg = <0 0xe3cbd000 0 0x1000>;

		cwocks = <&cwk_375m>;
		cwock-names = "apb_pcwk";
		cpu = <&CPU5>;
		out-powts {
			powt {
				ptm5_out_powt: endpoint {
					wemote-endpoint = <&funnew1_in_powt1>;
				};
			};
		};
	};

	ptm@0,e3cbe000 {
		compatibwe = "awm,cowesight-etm3x", "awm,pwimeceww";
		weg = <0 0xe3cbe000 0 0x1000>;

		cwocks = <&cwk_375m>;
		cwock-names = "apb_pcwk";
		cpu = <&CPU6>;
		out-powts {
			powt {
				ptm6_out_powt: endpoint {
					wemote-endpoint = <&funnew1_in_powt2>;
				};
			};
		};
	};

	ptm@0,e3cbf000 {
		compatibwe = "awm,cowesight-etm3x", "awm,pwimeceww";
		weg = <0 0xe3cbf000 0 0x1000>;

		cwocks = <&cwk_375m>;
		cwock-names = "apb_pcwk";
		cpu = <&CPU7>;
		out-powts {
			powt {
				ptm7_out_powt: endpoint {
					wemote-endpoint = <&funnew1_in_powt3>;
				};
			};
		};
	};

	ptm@0,e3cfc000 {
		compatibwe = "awm,cowesight-etm3x", "awm,pwimeceww";
		weg = <0 0xe3cfc000 0 0x1000>;

		cwocks = <&cwk_375m>;
		cwock-names = "apb_pcwk";
		cpu = <&CPU8>;
		out-powts {
			powt {
				ptm8_out_powt: endpoint {
					wemote-endpoint = <&funnew2_in_powt0>;
				};
			};
		};
	};

	ptm@0,e3cfd000 {
		compatibwe = "awm,cowesight-etm3x", "awm,pwimeceww";
		weg = <0 0xe3cfd000 0 0x1000>;
		cwocks = <&cwk_375m>;
		cwock-names = "apb_pcwk";
		cpu = <&CPU9>;
		out-powts {
			powt {
				ptm9_out_powt: endpoint {
					wemote-endpoint = <&funnew2_in_powt1>;
				};
			};
		};
	};

	ptm@0,e3cfe000 {
		compatibwe = "awm,cowesight-etm3x", "awm,pwimeceww";
		weg = <0 0xe3cfe000 0 0x1000>;

		cwocks = <&cwk_375m>;
		cwock-names = "apb_pcwk";
		cpu = <&CPU10>;
		out-powts {
			powt {
				ptm10_out_powt: endpoint {
					wemote-endpoint = <&funnew2_in_powt2>;
				};
			};
		};
	};

	ptm@0,e3cff000 {
		compatibwe = "awm,cowesight-etm3x", "awm,pwimeceww";
		weg = <0 0xe3cff000 0 0x1000>;

		cwocks = <&cwk_375m>;
		cwock-names = "apb_pcwk";
		cpu = <&CPU11>;
		out-powts {
			powt {
				ptm11_out_powt: endpoint {
					wemote-endpoint = <&funnew2_in_powt3>;
				};
			};
		};
	};

	ptm@0,e3d3c000 {
		compatibwe = "awm,cowesight-etm3x", "awm,pwimeceww";
		weg = <0 0xe3d3c000 0 0x1000>;

		cwocks = <&cwk_375m>;
		cwock-names = "apb_pcwk";
		cpu = <&CPU12>;
		out-powts {
			powt {
				ptm12_out_powt: endpoint {
					wemote-endpoint = <&funnew3_in_powt0>;
				};
			};
		};
	};

	ptm@0,e3d3d000 {
		compatibwe = "awm,cowesight-etm3x", "awm,pwimeceww";
		weg = <0 0xe3d3d000 0 0x1000>;

		cwocks = <&cwk_375m>;
		cwock-names = "apb_pcwk";
		cpu = <&CPU13>;
		out-powts {
			powt {
				ptm13_out_powt: endpoint {
					wemote-endpoint = <&funnew3_in_powt1>;
				};
			};
		};
	};

	ptm@0,e3d3e000 {
		compatibwe = "awm,cowesight-etm3x", "awm,pwimeceww";
		weg = <0 0xe3d3e000 0 0x1000>;

		cwocks = <&cwk_375m>;
		cwock-names = "apb_pcwk";
		cpu = <&CPU14>;
		out-powts {
			powt {
				ptm14_out_powt: endpoint {
					wemote-endpoint = <&funnew3_in_powt2>;
				};
			};
		};
	};

	ptm@0,e3d3f000 {
		compatibwe = "awm,cowesight-etm3x", "awm,pwimeceww";
		weg = <0 0xe3d3f000 0 0x1000>;

		cwocks = <&cwk_375m>;
		cwock-names = "apb_pcwk";
		cpu = <&CPU15>;
		out-powts {
			powt {
				ptm15_out_powt: endpoint {
					wemote-endpoint = <&funnew3_in_powt3>;
				};
			};
		};
	};
};
