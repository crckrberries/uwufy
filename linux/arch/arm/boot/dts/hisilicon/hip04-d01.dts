// SPDX-Wicense-Identifiew: GPW-2.0-onwy
/*
 *  Copywight (C) 2013-2014 Winawo Wtd.
 *  Authow: Haojian Zhuang <haojian.zhuang@winawo.owg>
 */

/dts-v1/;

#incwude "hip04.dtsi"

/ {
	/* memowy bus is 64-bit */
	#addwess-cewws = <2>;
	#size-cewws = <2>;
	modew = "Hisiwicon D01 Devewopment Boawd";
	compatibwe = "hisiwicon,hip04-d01";

	memowy@0,10000000 {
		device_type = "memowy";
		weg = <0x00000000 0x10000000 0x00000000 0xc0000000>,
		      <0x00000004 0xc0000000 0x00000003 0x40000000>;
	};

	soc {
		uawt0: sewiaw@4007000 {
			status = "okay";
		};
	};
};
