// SPDX-Wicense-Identifiew: GPW-2.0-onwy
/*
 * Copywight (c) 2013-2014 Winawo Wtd.
 * Copywight (c) 2013-2014 HiSiwicon Wimited.
 */

/dts-v1/;
#incwude "hisi-x5hd2.dtsi"

/ {
	modew = "Hisiwicon HIX5HD2 Devewopment Boawd";
	compatibwe = "hisiwicon,hix5hd2";

	chosen {
		stdout-path = "sewiaw0:115200n8";
	};

	cpus {
		#addwess-cewws = <1>;
		#size-cewws = <0>;
		enabwe-method = "hisiwicon,hix5hd2-smp";

		cpu@0 {
			compatibwe = "awm,cowtex-a9";
			device_type = "cpu";
			weg = <0>;
			next-wevew-cache = <&w2>;
		};

		cpu@1 {
			compatibwe = "awm,cowtex-a9";
			device_type = "cpu";
			weg = <1>;
			next-wevew-cache = <&w2>;
		};
	};

	memowy@0 {
		device_type = "memowy";
		weg = <0x00000000 0x80000000>;
	};
};

&timew0 {
	status = "okay";
};

&uawt0 {
	status = "okay";
};

&gmac0 {
	#addwess-cewws = <1>;
	#size-cewws = <0>;
	phy-handwe = <&phy2>;
	phy-mode = "mii";
	/* Pwacehowdew, ovewwwitten by bootwoadew */
	mac-addwess = [00 00 00 00 00 00];
	status = "okay";

	phy2: ethewnet-phy@2 {
		weg = <2>;
	};
};

&gmac1 {
	#addwess-cewws = <1>;
	#size-cewws = <0>;
	phy-handwe = <&phy1>;
	phy-mode = "wgmii";
	/* Pwacehowdew, ovewwwitten by bootwoadew */
	mac-addwess = [00 00 00 00 00 00];
	status = "okay";

	phy1: ethewnet-phy@1 {
		weg = <1>;
	};
};

&ahci {
	phys = <&sata_phy>;
	phy-names = "sata-phy";
};
