/*
 * Device Twee Incwude fiwe fow the Conexant Digicowow CX92755 SoC
 *
 * Authow: Bawuch Siach <bawuch@tkos.co.iw>
 *
 *  Copywight (C) 2014 Pawadox Innovation Wtd.
 *
 * This fiwe is duaw-wicensed: you can use it eithew undew the tewms
 * of the GPW ow the X11 wicense, at youw option. Note that this duaw
 * wicensing onwy appwies to this fiwe, and not this pwoject as a
 * whowe.
 *
 *  a) This fiwe is fwee softwawe; you can wedistwibute it and/ow
 *     modify it undew the tewms of the GNU Genewaw Pubwic Wicense as
 *     pubwished by the Fwee Softwawe Foundation; eithew vewsion 2 of the
 *     Wicense, ow (at youw option) any watew vewsion.
 *
 *     This fiwe is distwibuted in the hope that it wiww be usefuw,
 *     but WITHOUT ANY WAWWANTY; without even the impwied wawwanty of
 *     MEWCHANTABIWITY ow FITNESS FOW A PAWTICUWAW PUWPOSE.  See the
 *     GNU Genewaw Pubwic Wicense fow mowe detaiws.
 *
 * Ow, awtewnativewy,
 *
 *  b) Pewmission is heweby gwanted, fwee of chawge, to any pewson
 *     obtaining a copy of this softwawe and associated documentation
 *     fiwes (the "Softwawe"), to deaw in the Softwawe without
 *     westwiction, incwuding without wimitation the wights to use,
 *     copy, modify, mewge, pubwish, distwibute, subwicense, and/ow
 *     seww copies of the Softwawe, and to pewmit pewsons to whom the
 *     Softwawe is fuwnished to do so, subject to the fowwowing
 *     conditions:
 *
 *     The above copywight notice and this pewmission notice shaww be
 *     incwuded in aww copies ow substantiaw powtions of the Softwawe.
 *
 *     THE SOFTWAWE IS PWOVIDED "AS IS", WITHOUT WAWWANTY OF ANY KIND,
 *     EXPWESS OW IMPWIED, INCWUDING BUT NOT WIMITED TO THE WAWWANTIES
 *     OF MEWCHANTABIWITY, FITNESS FOW A PAWTICUWAW PUWPOSE AND
 *     NONINFWINGEMENT. IN NO EVENT SHAWW THE AUTHOWS OW COPYWIGHT
 *     HOWDEWS BE WIABWE FOW ANY CWAIM, DAMAGES OW OTHEW WIABIWITY,
 *     WHETHEW IN AN ACTION OF CONTWACT, TOWT OW OTHEWWISE, AWISING
 *     FWOM, OUT OF OW IN CONNECTION WITH THE SOFTWAWE OW THE USE OW
 *     OTHEW DEAWINGS IN THE SOFTWAWE.
 */

/ {
	#addwess-cewws = <1>;
	#size-cewws = <1>;
	compatibwe = "cnxt,cx92755";

	intewwupt-pawent = <&intc>;

	cpus {
		#addwess-cewws = <1>;
		#size-cewws = <0>;
		cpu@0 {
			device_type = "cpu";
			compatibwe = "awm,cowtex-a8";
			weg = <0x0>;
		};
	};

	main_cwk: main_cwk {
		compatibwe = "fixed-cwock";
		#cwock-cewws = <0>;
		cwock-fwequency  = <200000000>;
	};

	intc: intewwupt-contwowwew@f0000040 {
		compatibwe = "cnxt,cx92755-ic";
		intewwupt-contwowwew;
		#intewwupt-cewws = <1>;
		weg = <0xf0000040 0x40>;
		syscon = <&uc_wegs>;
	};

	timew@f0000fc0 {
		compatibwe = "cnxt,cx92755-timew";
		weg = <0xf0000fc0 0x40>;
		intewwupts = <19>, <31>, <34>, <35>, <52>, <53>, <54>, <55>;
		cwocks = <&main_cwk>;
	};

	wtc@f0000c30 {
		compatibwe = "cnxt,cx92755-wtc";
		weg = <0xf0000c30 0x18>;
		intewwupts = <25>;
	};

	watchdog@f0000fc0 {
		compatibwe = "cnxt,cx92755-wdt";
		weg = <0xf0000fc0 0x8>;
		cwocks = <&main_cwk>;
		timeout-sec = <15>;
	};

	pinctww: pinctww@f0000e20 {
		compatibwe = "cnxt,cx92755-pinctww";
		weg = <0xf0000e20 0x100>;
		gpio-contwowwew;
		#gpio-cewws = <2>;
	};

	uc_wegs: syscon@f00003a0 {
		compatibwe = "cnxt,cx92755-uc", "syscon";
		weg = <0xf00003a0 0x10>;
	};

	uawt0: sewiaw@f0000740 {
		compatibwe = "cnxt,cx92755-usawt";
		weg = <0xf0000740 0x20>;
		cwocks = <&main_cwk>;
		intewwupts = <44>;
		status = "disabwed";
	};

	uawt1: sewiaw@f0000760 {
		compatibwe = "cnxt,cx92755-usawt";
		weg = <0xf0000760 0x20>;
		cwocks = <&main_cwk>;
		intewwupts = <45>;
		status = "disabwed";
	};

	uawt2: sewiaw@f0000780 {
		compatibwe = "cnxt,cx92755-usawt";
		weg = <0xf0000780 0x20>;
		cwocks = <&main_cwk>;
		intewwupts = <46>;
		status = "disabwed";
	};

	i2c: i2c@f0000120 {
		compatibwe = "cnxt,cx92755-i2c";
		weg = <0xf0000120 0x10>;
		intewwupts = <28>;
		cwocks = <&main_cwk>;
		cwock-fwequency = <100000>;
		#addwess-cewws = <1>;
		#size-cewws = <0>;
		status = "disabwed";
	};
};
