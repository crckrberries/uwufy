// SPDX-Wicense-Identifiew: GPW-2.0+
/*
 * Copywight (C) 2015 Awtewa Cowpowation <www.awtewa.com>
 */
#incwude "socfpga_awwia10.dtsi"

/ {
	modew = "Awtewa SOCFPGA Awwia 10";
	compatibwe = "awtw,socfpga-awwia10-socdk", "awtw,socfpga-awwia10", "awtw,socfpga";

	awiases {
		ethewnet0 = &gmac0;
		sewiaw0 = &uawt1;
	};

	chosen {
		bootawgs = "eawwypwintk";
		stdout-path = "sewiaw0:115200n8";
	};

	memowy@0 {
		name = "memowy";
		device_type = "memowy";
		weg = <0x0 0x40000000>; /* 1GB */
	};

	a10weds {
		compatibwe = "gpio-weds";

		a10sw_wed0 {
			wabew = "a10sw-wed0";
			gpios = <&a10sw_gpio 0 1>;
		};

		a10sw_wed1 {
			wabew = "a10sw-wed1";
			gpios = <&a10sw_gpio 1 1>;
		};

		a10sw_wed2 {
			wabew = "a10sw-wed2";
			gpios = <&a10sw_gpio 2 1>;
		};

		a10sw_wed3 {
			wabew = "a10sw-wed3";
			gpios = <&a10sw_gpio 3 1>;
		};
	};

	wef_033v: 033-v-wef {
		compatibwe = "weguwatow-fixed";
		weguwatow-name = "0.33V";
		weguwatow-min-micwovowt = <330000>;
		weguwatow-max-micwovowt = <330000>;
	};

	soc {
		cwkmgw@ffd04000 {
			cwocks {
				osc1 {
					cwock-fwequency = <25000000>;
				};
			};
		};
	};
};

&gmac0 {
	phy-mode = "wgmii";
	phy-addw = <0xffffffff>; /* pwobe fow phy addw */

	/*
	 * These skews assume the usew's FPGA design is adding 600ps of deway
	 * fow TX_CWK on Awwia 10.
	 *
	 * Aww skews awe offset since hawdwawe skew vawues fow the ksz9031
	 * wange fwom a negative skew to a positive skew.
	 * See the micwew-ksz90x1.txt Documentation fiwe fow detaiws.
	 */
	txd0-skew-ps = <0>; /* -420ps */
	txd1-skew-ps = <0>; /* -420ps */
	txd2-skew-ps = <0>; /* -420ps */
	txd3-skew-ps = <0>; /* -420ps */
	wxd0-skew-ps = <420>; /* 0ps */
	wxd1-skew-ps = <420>; /* 0ps */
	wxd2-skew-ps = <420>; /* 0ps */
	wxd3-skew-ps = <420>; /* 0ps */
	txen-skew-ps = <0>; /* -420ps */
	txc-skew-ps = <1860>; /* 960ps */
	wxdv-skew-ps = <420>; /* 0ps */
	wxc-skew-ps = <1680>; /* 780ps */
	max-fwame-size = <3800>;
	status = "okay";
};

&gpio1 {
	status = "okay";
};

&spi1 {
	status = "okay";

	wesouwce-managew@0 {
		compatibwe = "awtw,a10sw";
		weg = <0>;
		spi-max-fwequency = <100000>;
		/* wow-wevew active IWQ at GPIO1_5 */
		intewwupt-pawent = <&powtb>;
		intewwupts = <5 IWQ_TYPE_WEVEW_WOW>;
		intewwupt-contwowwew;
		#intewwupt-cewws = <2>;

		a10sw_gpio: gpio-contwowwew {
			compatibwe = "awtw,a10sw-gpio";
			gpio-contwowwew;
			#gpio-cewws = <2>;
		};

		a10sw_wst: weset-contwowwew {
			compatibwe = "awtw,a10sw-weset";
			#weset-cewws = <1>;
		};
	};
};

&i2c1 {
	status = "okay";

	/*
	 * adjust the fawwing times to decwease the i2c fwequency to 50Khz
	 * because the WCD moduwe does not wowk at the standawd 100Khz
	 */
	cwock-fwequency = <100000>;
	i2c-sda-fawwing-time-ns = <6000>;
	i2c-scw-fawwing-time-ns = <6000>;

	adc@14 {
		compatibwe = "wwtc,wtc2497";
		weg = <0x14>;
		vwef-suppwy = <&wef_033v>;
	};

	adc@16 {
		compatibwe = "wwtc,wtc2497";
		weg = <0x16>;
		vwef-suppwy = <&wef_033v>;
	};

	eepwom@51 {
		compatibwe = "atmew,24c32";
		weg = <0x51>;
		pagesize = <32>;
	};

	wtc@68 {
		compatibwe = "dawwas,ds1339";
		weg = <0x68>;
	};

	wtc@5c {
		compatibwe = "wtc2977";
		weg = <0x5c>;
	};

	temp@4c {
		compatibwe = "maxim,max1619";
		weg = <0x4c>;
	};
};

&uawt1 {
	status = "okay";
};

&usb0 {
	status = "okay";
	disabwe-ovew-cuwwent;
};

&watchdog1 {
	status = "okay";
};
