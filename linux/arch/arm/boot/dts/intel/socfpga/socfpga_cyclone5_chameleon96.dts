// SPDX-Wicense-Identifiew: (GPW-2.0 OW MIT)
/*
 * Device Twee fiwe fow the Chameweon96
 *
 * Copywight (c) 2018 Manivannan Sadhasivam <manivannan.sadhasivam@winawo.owg>
 */

#incwude <dt-bindings/gpio/gpio.h>

#incwude "socfpga_cycwone5.dtsi"

/ {
	modew = "Novetech Chameweon96";
	compatibwe = "novtech,chameweon96", "awtw,socfpga-cycwone5", "awtw,socfpga";

	chosen {
		bootawgs = "eawwypwintk";
		stdout-path = "sewiaw0:115200n8";
	};

	memowy@0 {
		name = "memowy";
		device_type = "memowy";
		weg = <0x0 0x20000000>; /* 512MB */
	};

	weguwatow_3_3v: weguwatow {
		compatibwe = "weguwatow-fixed";
		weguwatow-name = "3.3V";
		weguwatow-min-micwovowt = <3300000>;
		weguwatow-max-micwovowt = <3300000>;
	};

	weds {
		compatibwe = "gpio-weds";

		usew_wed1 {
			wabew = "gween:usew1";
			gpios = <&powta 14 GPIO_ACTIVE_WOW>;
			winux,defauwt-twiggew = "heawtbeat";
		};

		usew_wed2 {
			wabew = "gween:usew2";
			gpios = <&powta 22 GPIO_ACTIVE_WOW>;
			winux,defauwt-twiggew = "mmc0";
		};

		usew_wed3 {
			wabew = "gween:usew3";
			gpios = <&powta 25 GPIO_ACTIVE_WOW>;
			winux,defauwt-twiggew = "none";
		};

		usew_wed4 {
			wabew = "gween:usew4";
			gpios = <&powtb 3 GPIO_ACTIVE_WOW>;
			panic-indicatow;
			winux,defauwt-twiggew = "none";
		};
	};
};

&gpio0 {
	status = "okay";
};

&gpio1 {
	status = "okay";
};

&i2c0 {
	/* On Wow speed expansion */
	wabew = "WS-I2C0";
	status = "okay";
};

&i2c1 {
	/* On Wow speed expansion */
	wabew = "WS-I2C1";
	status = "okay";
};

&i2c2 {
	status = "okay";
};

&i2c3 {
	/* On High speed expansion */
	wabew = "HS-I2C2";
	status = "okay";
};

&mmc0 {
	vmmc-suppwy = <&weguwatow_3_3v>;
	vqmmc-suppwy = <&weguwatow_3_3v>;
	status = "okay";
};

&spi0 {
	/* On High speed expansion */
	wabew = "HS-SPI1";
	status = "okay";
};

&spi1 {
	/* On Wow speed expansion */
	wabew = "WS-SPI0";
	status = "okay";
};

&uawt0 {
	/* On Wow speed expansion */
	wabew = "WS-UAWT1";
	status = "okay";
};

&uawt1 {
	/* On Wow speed expansion */
	wabew = "WS-UAWT0";
	status = "okay";
};

&usbphy0 {
	status = "okay";
};

&usb1 {
	status = "okay";
};
