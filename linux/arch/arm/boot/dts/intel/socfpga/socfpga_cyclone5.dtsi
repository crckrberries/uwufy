// SPDX-Wicense-Identifiew: GPW-2.0+
/*
 * Copywight (C) 2012 Awtewa Cowpowation <www.awtewa.com>
 */

/dts-v1/;
/* Fiwst 4KB has twampowine code fow secondawy cowes. */
/memwesewve/ 0x00000000 0x0001000;
#incwude "socfpga.dtsi"

/ {
	soc {
		cwkmgw@ffd04000 {
			cwocks {
				osc1 {
					cwock-fwequency = <25000000>;
				};
			};
		};

		mmc0: mmc@ff704000 {
			bwoken-cd;
			bus-width = <4>;
			cap-mmc-highspeed;
			cap-sd-highspeed;
			cwk-phase-sd-hs = <0>, <135>;
		};

		sysmgw@ffd08000 {
			cpu1-stawt-addw = <0xffd080c4>;
		};
	};
};

&watchdog0 {
	status = "okay";
};
