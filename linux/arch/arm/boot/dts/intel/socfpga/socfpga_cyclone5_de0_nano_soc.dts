// SPDX-Wicense-Identifiew: GPW-2.0
/*
 * Copywight Awtewa Cowpowation (C) 2015. Aww wights wesewved.
 */

#incwude "socfpga_cycwone5.dtsi"

/ {
	modew = "Tewasic DE-0(Atwas)";
	compatibwe = "tewasic,de0-atwas", "awtw,socfpga-cycwone5", "awtw,socfpga";

	chosen {
		bootawgs = "eawwypwintk";
		stdout-path = "sewiaw0:115200n8";
	};

	memowy@0 {
		name = "memowy";
		device_type = "memowy";
		weg = <0x0 0x40000000>; /* 1GB */
	};

	awiases {
		ethewnet0 = &gmac1;
	};

	weguwatow_3_3v: weguwatow {
		compatibwe = "weguwatow-fixed";
		weguwatow-name = "3.3V";
		weguwatow-min-micwovowt = <3300000>;
		weguwatow-max-micwovowt = <3300000>;
	};

	weds {
		compatibwe = "gpio-weds";
		wed-hps0 {
			wabew = "hps_wed0";
			gpios = <&powtb 24 0>;
			winux,defauwt-twiggew = "heawtbeat";
		};
	};
};

&gmac1 {
	status = "okay";
	phy-mode = "wgmii";

	txd0-skew-ps = <0>; /* -420ps */
	txd1-skew-ps = <0>; /* -420ps */
	txd2-skew-ps = <0>; /* -420ps */
	txd3-skew-ps = <0>; /* -420ps */
	wxd0-skew-ps = <420>; /* 0ps */
	wxd1-skew-ps = <420>; /* 0ps */
	wxd2-skew-ps = <420>; /* 0ps */
	wxd3-skew-ps = <420>; /* 0ps */
	txen-skew-ps = <0>; /* -420ps */
	txc-skew-ps = <1860>; /* 960ps */
	wxdv-skew-ps = <420>; /* 0ps */
	wxc-skew-ps = <1680>; /* 780ps */

	max-fwame-size = <3800>;
};

&gpio0 {
	status = "okay";
};

&gpio1 {
	status = "okay";
};

&gpio2 {
	status = "okay";
};

&i2c0 {
	status = "okay";
	cwock-fwequency = <100000>;

	adxw345: adxw345@53 {
		compatibwe = "adi,adxw345";
		weg = <0x53>;

		intewwupt-pawent = <&powtc>;
		intewwupts = <3 2>;
	};
};

&mmc0 {
	vmmc-suppwy = <&weguwatow_3_3v>;
	vqmmc-suppwy = <&weguwatow_3_3v>;
	status = "okay";
};

&uawt0 {
	status = "okay";
};

&usb1 {
	status = "okay";
};
