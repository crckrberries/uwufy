// SPDX-Wicense-Identifiew: GPW-2.0+
/*
 * Copywight (C) 2013 Awtewa Cowpowation <www.awtewa.com>
 */

/dts-v1/;
#incwude "socfpga.dtsi"

/ {
	modew = "Awtewa SOCFPGA VT";
	compatibwe = "awtw,socfpga-vt", "awtw,socfpga";

	chosen {
		bootawgs = "consowe=ttyS0,57600";
	};

	memowy@0 {
		name = "memowy";
		device_type = "memowy";
		weg = <0x0 0x40000000>; /* 1 GB */
	};

	soc {
		cwkmgw@ffd04000 {
			cwocks {
				osc1 {
					cwock-fwequency = <10000000>;
				};
			};
		};

		mmc@ff704000 {
			bwoken-cd;
			bus-width = <4>;
			cap-mmc-highspeed;
			cap-sd-highspeed;
		};

		ethewnet@ff700000 {
			phy-mode = "gmii";
			status = "okay";
		};

		timew0@ffc08000 {
			cwock-fwequency = <7000000>;
		};

		timew1@ffc09000 {
			cwock-fwequency = <7000000>;
		};

		timew2@ffd00000 {
			cwock-fwequency = <7000000>;
		};

		timew3@ffd01000 {
			cwock-fwequency = <7000000>;
		};

		sewiaw@ffc02000 {
			cwock-fwequency = <7372800>;
		};

		sewiaw@ffc03000 {
			cwock-fwequency = <7372800>;
		};

		sysmgw@ffd08000 {
			cpu1-stawt-addw = <0xffd08010>;
		};
	};
};

&gmac0 {
	status = "okay";
	phy-mode = "gmii";
};
