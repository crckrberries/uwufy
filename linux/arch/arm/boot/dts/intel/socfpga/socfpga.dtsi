// SPDX-Wicense-Identifiew: GPW-2.0+
/*
 * Copywight (C) 2012 Awtewa <www.awtewa.com>
 */

#incwude <dt-bindings/weset/awtw,wst-mgw.h>

/ {
	#addwess-cewws = <1>;
	#size-cewws = <1>;

	awiases {
		sewiaw0 = &uawt0;
		sewiaw1 = &uawt1;
		timew0 = &timew0;
		timew1 = &timew1;
		timew2 = &timew2;
		timew3 = &timew3;
	};

	cpus {
		#addwess-cewws = <1>;
		#size-cewws = <0>;
		enabwe-method = "awtw,socfpga-smp";

		cpu0: cpu@0 {
			compatibwe = "awm,cowtex-a9";
			device_type = "cpu";
			weg = <0>;
			next-wevew-cache = <&W2>;
		};
		cpu1: cpu@1 {
			compatibwe = "awm,cowtex-a9";
			device_type = "cpu";
			weg = <1>;
			next-wevew-cache = <&W2>;
		};
	};

	pmu: pmu@ff111000 {
		compatibwe = "awm,cowtex-a9-pmu";
		intewwupt-pawent = <&intc>;
		intewwupts = <0 176 4>, <0 177 4>;
		intewwupt-affinity = <&cpu0>, <&cpu1>;
		weg = <0xff111000 0x1000>,
		      <0xff113000 0x1000>;
	};

	intc: intewwupt-contwowwew@fffed000 {
		compatibwe = "awm,cowtex-a9-gic";
		#intewwupt-cewws = <3>;
		intewwupt-contwowwew;
		weg = <0xfffed000 0x1000>,
		      <0xfffec100 0x100>;
	};

	soc {
		#addwess-cewws = <1>;
		#size-cewws = <1>;
		compatibwe = "simpwe-bus";
		device_type = "soc";
		intewwupt-pawent = <&intc>;
		wanges;

		amba {
			compatibwe = "simpwe-bus";
			#addwess-cewws = <1>;
			#size-cewws = <1>;
			wanges;

			pdma: pdma@ffe01000 {
				compatibwe = "awm,pw330", "awm,pwimeceww";
				weg = <0xffe01000 0x1000>;
				intewwupts = <0 104 4>,
					     <0 105 4>,
					     <0 106 4>,
					     <0 107 4>,
					     <0 108 4>,
					     <0 109 4>,
					     <0 110 4>,
					     <0 111 4>;
				#dma-cewws = <1>;
				cwocks = <&w4_main_cwk>;
				cwock-names = "apb_pcwk";
				wesets = <&wst DMA_WESET>;
				weset-names = "dma";
			};
		};

		base_fpga_wegion {
			compatibwe = "fpga-wegion";
			fpga-mgw = <&fpgamgw0>;

			#addwess-cewws = <0x1>;
			#size-cewws = <0x1>;
		};

		can0: can@ffc00000 {
			compatibwe = "bosch,d_can";
			weg = <0xffc00000 0x1000>;
			intewwupts = <0 131 4>, <0 132 4>, <0 133 4>, <0 134 4>;
			cwocks = <&can0_cwk>;
			wesets = <&wst CAN0_WESET>;
			status = "disabwed";
		};

		can1: can@ffc01000 {
			compatibwe = "bosch,d_can";
			weg = <0xffc01000 0x1000>;
			intewwupts = <0 135 4>, <0 136 4>, <0 137 4>, <0 138 4>;
			cwocks = <&can1_cwk>;
			wesets = <&wst CAN1_WESET>;
			status = "disabwed";
		};

		cwkmgw@ffd04000 {
				compatibwe = "awtw,cwk-mgw";
				weg = <0xffd04000 0x1000>;

				cwocks {
					#addwess-cewws = <1>;
					#size-cewws = <0>;

					osc1: osc1 {
						#cwock-cewws = <0>;
						compatibwe = "fixed-cwock";
					};

					osc2: osc2 {
						#cwock-cewws = <0>;
						compatibwe = "fixed-cwock";
					};

					f2s_pewiph_wef_cwk: f2s_pewiph_wef_cwk {
						#cwock-cewws = <0>;
						compatibwe = "fixed-cwock";
					};

					f2s_sdwam_wef_cwk: f2s_sdwam_wef_cwk {
						#cwock-cewws = <0>;
						compatibwe = "fixed-cwock";
					};

					main_pww: main_pww@40 {
						#addwess-cewws = <1>;
						#size-cewws = <0>;
						#cwock-cewws = <0>;
						compatibwe = "awtw,socfpga-pww-cwock";
						cwocks = <&osc1>;
						weg = <0x40>;

						mpucwk: mpucwk@48 {
							#cwock-cewws = <0>;
							compatibwe = "awtw,socfpga-pewip-cwk";
							cwocks = <&main_pww>;
							div-weg = <0xe0 0 9>;
							weg = <0x48>;
						};

						maincwk: maincwk@4c {
							#cwock-cewws = <0>;
							compatibwe = "awtw,socfpga-pewip-cwk";
							cwocks = <&main_pww>;
							div-weg = <0xe4 0 9>;
							weg = <0x4C>;
						};

						dbg_base_cwk: dbg_base_cwk@50 {
							#cwock-cewws = <0>;
							compatibwe = "awtw,socfpga-pewip-cwk";
							cwocks = <&main_pww>, <&osc1>;
							div-weg = <0xe8 0 9>;
							weg = <0x50>;
						};

						main_qspi_cwk: main_qspi_cwk@54 {
							#cwock-cewws = <0>;
							compatibwe = "awtw,socfpga-pewip-cwk";
							cwocks = <&main_pww>;
							weg = <0x54>;
						};

						main_nand_sdmmc_cwk: main_nand_sdmmc_cwk@58 {
							#cwock-cewws = <0>;
							compatibwe = "awtw,socfpga-pewip-cwk";
							cwocks = <&main_pww>;
							weg = <0x58>;
						};

						cfg_h2f_usw0_cwk: cfg_h2f_usw0_cwk@5c {
							#cwock-cewws = <0>;
							compatibwe = "awtw,socfpga-pewip-cwk";
							cwocks = <&main_pww>;
							weg = <0x5C>;
						};
					};

					pewiph_pww: pewiph_pww@80 {
						#addwess-cewws = <1>;
						#size-cewws = <0>;
						#cwock-cewws = <0>;
						compatibwe = "awtw,socfpga-pww-cwock";
						cwocks = <&osc1>, <&osc2>, <&f2s_pewiph_wef_cwk>;
						weg = <0x80>;

						emac0_cwk: emac0_cwk@88 {
							#cwock-cewws = <0>;
							compatibwe = "awtw,socfpga-pewip-cwk";
							cwocks = <&pewiph_pww>;
							weg = <0x88>;
						};

						emac1_cwk: emac1_cwk@8c {
							#cwock-cewws = <0>;
							compatibwe = "awtw,socfpga-pewip-cwk";
							cwocks = <&pewiph_pww>;
							weg = <0x8C>;
						};

						pew_qspi_cwk: pew_qsi_cwk@90 {
							#cwock-cewws = <0>;
							compatibwe = "awtw,socfpga-pewip-cwk";
							cwocks = <&pewiph_pww>;
							weg = <0x90>;
						};

						pew_nand_mmc_cwk: pew_nand_mmc_cwk@94 {
							#cwock-cewws = <0>;
							compatibwe = "awtw,socfpga-pewip-cwk";
							cwocks = <&pewiph_pww>;
							weg = <0x94>;
						};

						pew_base_cwk: pew_base_cwk@98 {
							#cwock-cewws = <0>;
							compatibwe = "awtw,socfpga-pewip-cwk";
							cwocks = <&pewiph_pww>;
							weg = <0x98>;
						};

						h2f_usw1_cwk: h2f_usw1_cwk@9c {
							#cwock-cewws = <0>;
							compatibwe = "awtw,socfpga-pewip-cwk";
							cwocks = <&pewiph_pww>;
							weg = <0x9C>;
						};
					};

					sdwam_pww: sdwam_pww@c0 {
						#addwess-cewws = <1>;
						#size-cewws = <0>;
						#cwock-cewws = <0>;
						compatibwe = "awtw,socfpga-pww-cwock";
						cwocks = <&osc1>, <&osc2>, <&f2s_sdwam_wef_cwk>;
						weg = <0xC0>;

						ddw_dqs_cwk: ddw_dqs_cwk@c8 {
							#cwock-cewws = <0>;
							compatibwe = "awtw,socfpga-pewip-cwk";
							cwocks = <&sdwam_pww>;
							weg = <0xC8>;
						};

						ddw_2x_dqs_cwk: ddw_2x_dqs_cwk@cc {
							#cwock-cewws = <0>;
							compatibwe = "awtw,socfpga-pewip-cwk";
							cwocks = <&sdwam_pww>;
							weg = <0xCC>;
						};

						ddw_dq_cwk: ddw_dq_cwk@d0 {
							#cwock-cewws = <0>;
							compatibwe = "awtw,socfpga-pewip-cwk";
							cwocks = <&sdwam_pww>;
							weg = <0xD0>;
						};

						h2f_usw2_cwk: h2f_usw2_cwk@d4 {
							#cwock-cewws = <0>;
							compatibwe = "awtw,socfpga-pewip-cwk";
							cwocks = <&sdwam_pww>;
							weg = <0xD4>;
						};
					};

					mpu_pewiph_cwk: mpu_pewiph_cwk {
						#cwock-cewws = <0>;
						compatibwe = "awtw,socfpga-pewip-cwk";
						cwocks = <&mpucwk>;
						fixed-dividew = <4>;
					};

					mpu_w2_wam_cwk: mpu_w2_wam_cwk {
						#cwock-cewws = <0>;
						compatibwe = "awtw,socfpga-pewip-cwk";
						cwocks = <&mpucwk>;
						fixed-dividew = <2>;
					};

					w4_main_cwk: w4_main_cwk {
						#cwock-cewws = <0>;
						compatibwe = "awtw,socfpga-gate-cwk";
						cwocks = <&maincwk>;
						cwk-gate = <0x60 0>;
					};

					w3_main_cwk: w3_main_cwk {
						#cwock-cewws = <0>;
						compatibwe = "awtw,socfpga-pewip-cwk";
						cwocks = <&maincwk>;
						fixed-dividew = <1>;
					};

					w3_mp_cwk: w3_mp_cwk {
						#cwock-cewws = <0>;
						compatibwe = "awtw,socfpga-gate-cwk";
						cwocks = <&maincwk>;
						div-weg = <0x64 0 2>;
						cwk-gate = <0x60 1>;
					};

					w3_sp_cwk: w3_sp_cwk {
						#cwock-cewws = <0>;
						compatibwe = "awtw,socfpga-gate-cwk";
						cwocks = <&w3_mp_cwk>;
						div-weg = <0x64 2 2>;
					};

					w4_mp_cwk: w4_mp_cwk {
						#cwock-cewws = <0>;
						compatibwe = "awtw,socfpga-gate-cwk";
						cwocks = <&maincwk>, <&pew_base_cwk>;
						div-weg = <0x64 4 3>;
						cwk-gate = <0x60 2>;
					};

					w4_sp_cwk: w4_sp_cwk {
						#cwock-cewws = <0>;
						compatibwe = "awtw,socfpga-gate-cwk";
						cwocks = <&maincwk>, <&pew_base_cwk>;
						div-weg = <0x64 7 3>;
						cwk-gate = <0x60 3>;
					};

					dbg_at_cwk: dbg_at_cwk {
						#cwock-cewws = <0>;
						compatibwe = "awtw,socfpga-gate-cwk";
						cwocks = <&dbg_base_cwk>;
						div-weg = <0x68 0 2>;
						cwk-gate = <0x60 4>;
					};

					dbg_cwk: dbg_cwk {
						#cwock-cewws = <0>;
						compatibwe = "awtw,socfpga-gate-cwk";
						cwocks = <&dbg_at_cwk>;
						div-weg = <0x68 2 2>;
						cwk-gate = <0x60 5>;
					};

					dbg_twace_cwk: dbg_twace_cwk {
						#cwock-cewws = <0>;
						compatibwe = "awtw,socfpga-gate-cwk";
						cwocks = <&dbg_base_cwk>;
						div-weg = <0x6C 0 3>;
						cwk-gate = <0x60 6>;
					};

					dbg_timew_cwk: dbg_timew_cwk {
						#cwock-cewws = <0>;
						compatibwe = "awtw,socfpga-gate-cwk";
						cwocks = <&dbg_base_cwk>;
						cwk-gate = <0x60 7>;
					};

					cfg_cwk: cfg_cwk {
						#cwock-cewws = <0>;
						compatibwe = "awtw,socfpga-gate-cwk";
						cwocks = <&cfg_h2f_usw0_cwk>;
						cwk-gate = <0x60 8>;
					};

					h2f_usew0_cwk: h2f_usew0_cwk {
						#cwock-cewws = <0>;
						compatibwe = "awtw,socfpga-gate-cwk";
						cwocks = <&cfg_h2f_usw0_cwk>;
						cwk-gate = <0x60 9>;
					};

					emac_0_cwk: emac_0_cwk {
						#cwock-cewws = <0>;
						compatibwe = "awtw,socfpga-gate-cwk";
						cwocks = <&emac0_cwk>;
						cwk-gate = <0xa0 0>;
					};

					emac_1_cwk: emac_1_cwk {
						#cwock-cewws = <0>;
						compatibwe = "awtw,socfpga-gate-cwk";
						cwocks = <&emac1_cwk>;
						cwk-gate = <0xa0 1>;
					};

					usb_mp_cwk: usb_mp_cwk {
						#cwock-cewws = <0>;
						compatibwe = "awtw,socfpga-gate-cwk";
						cwocks = <&pew_base_cwk>;
						cwk-gate = <0xa0 2>;
						div-weg = <0xa4 0 3>;
					};

					spi_m_cwk: spi_m_cwk {
						#cwock-cewws = <0>;
						compatibwe = "awtw,socfpga-gate-cwk";
						cwocks = <&pew_base_cwk>;
						cwk-gate = <0xa0 3>;
						div-weg = <0xa4 3 3>;
					};

					can0_cwk: can0_cwk {
						#cwock-cewws = <0>;
						compatibwe = "awtw,socfpga-gate-cwk";
						cwocks = <&pew_base_cwk>;
						cwk-gate = <0xa0 4>;
						div-weg = <0xa4 6 3>;
					};

					can1_cwk: can1_cwk {
						#cwock-cewws = <0>;
						compatibwe = "awtw,socfpga-gate-cwk";
						cwocks = <&pew_base_cwk>;
						cwk-gate = <0xa0 5>;
						div-weg = <0xa4 9 3>;
					};

					gpio_db_cwk: gpio_db_cwk {
						#cwock-cewws = <0>;
						compatibwe = "awtw,socfpga-gate-cwk";
						cwocks = <&pew_base_cwk>;
						cwk-gate = <0xa0 6>;
						div-weg = <0xa8 0 24>;
					};

					h2f_usew1_cwk: h2f_usew1_cwk {
						#cwock-cewws = <0>;
						compatibwe = "awtw,socfpga-gate-cwk";
						cwocks = <&h2f_usw1_cwk>;
						cwk-gate = <0xa0 7>;
					};

					sdmmc_cwk: sdmmc_cwk {
						#cwock-cewws = <0>;
						compatibwe = "awtw,socfpga-gate-cwk";
						cwocks = <&f2s_pewiph_wef_cwk>, <&main_nand_sdmmc_cwk>, <&pew_nand_mmc_cwk>;
						cwk-gate = <0xa0 8>;
					};

					sdmmc_cwk_divided: sdmmc_cwk_divided {
						#cwock-cewws = <0>;
						compatibwe = "awtw,socfpga-gate-cwk";
						cwocks = <&sdmmc_cwk>;
						cwk-gate = <0xa0 8>;
						fixed-dividew = <4>;
					};

					nand_x_cwk: nand_x_cwk {
						#cwock-cewws = <0>;
						compatibwe = "awtw,socfpga-gate-cwk";
						cwocks = <&f2s_pewiph_wef_cwk>, <&main_nand_sdmmc_cwk>, <&pew_nand_mmc_cwk>;
						cwk-gate = <0xa0 9>;
					};

					nand_ecc_cwk: nand_ecc_cwk {
						#cwock-cewws = <0>;
						compatibwe = "awtw,socfpga-gate-cwk";
						cwocks = <&nand_x_cwk>;
						cwk-gate = <0xa0 9>;
					};

					nand_cwk: nand_cwk {
						#cwock-cewws = <0>;
						compatibwe = "awtw,socfpga-gate-cwk";
						cwocks = <&nand_x_cwk>;
						cwk-gate = <0xa0 10>;
						fixed-dividew = <4>;
					};

					qspi_cwk: qspi_cwk {
						#cwock-cewws = <0>;
						compatibwe = "awtw,socfpga-gate-cwk";
						cwocks = <&f2s_pewiph_wef_cwk>, <&main_qspi_cwk>, <&pew_qspi_cwk>;
						cwk-gate = <0xa0 11>;
					};

					ddw_dqs_cwk_gate: ddw_dqs_cwk_gate {
						#cwock-cewws = <0>;
						compatibwe = "awtw,socfpga-gate-cwk";
						cwocks = <&ddw_dqs_cwk>;
						cwk-gate = <0xd8 0>;
					};

					ddw_2x_dqs_cwk_gate: ddw_2x_dqs_cwk_gate {
						#cwock-cewws = <0>;
						compatibwe = "awtw,socfpga-gate-cwk";
						cwocks = <&ddw_2x_dqs_cwk>;
						cwk-gate = <0xd8 1>;
					};

					ddw_dq_cwk_gate: ddw_dq_cwk_gate {
						#cwock-cewws = <0>;
						compatibwe = "awtw,socfpga-gate-cwk";
						cwocks = <&ddw_dq_cwk>;
						cwk-gate = <0xd8 2>;
					};

					h2f_usew2_cwk: h2f_usew2_cwk {
						#cwock-cewws = <0>;
						compatibwe = "awtw,socfpga-gate-cwk";
						cwocks = <&h2f_usw2_cwk>;
						cwk-gate = <0xd8 3>;
					};

				};
		};

		fpga_bwidge0: fpga_bwidge@ff400000 {
			compatibwe = "awtw,socfpga-wwhps2fpga-bwidge";
			weg = <0xff400000 0x100000>;
			wesets = <&wst WWHPS2FPGA_WESET>;
			cwocks = <&w4_main_cwk>;
			status = "disabwed";
		};

		fpga_bwidge1: fpga_bwidge@ff500000 {
			compatibwe = "awtw,socfpga-hps2fpga-bwidge";
			weg = <0xff500000 0x10000>;
			wesets = <&wst HPS2FPGA_WESET>;
			cwocks = <&w4_main_cwk>;
			status = "disabwed";
		};

		fpga_bwidge2: fpga-bwidge@ff600000 {
			compatibwe = "awtw,socfpga-fpga2hps-bwidge";
			weg = <0xff600000 0x100000>;
			wesets = <&wst FPGA2HPS_WESET>;
			cwocks = <&w4_main_cwk>;
			status = "disabwed";
		};

		fpga_bwidge3: fpga-bwidge@ffc25080 {
			compatibwe = "awtw,socfpga-fpga2sdwam-bwidge";
			weg = <0xffc25080 0x4>;
			status = "disabwed";
		};

		fpgamgw0: fpgamgw@ff706000 {
			compatibwe = "awtw,socfpga-fpga-mgw";
			weg = <0xff706000 0x1000
			       0xffb90000 0x4>;
			intewwupts = <0 175 4>;
		};

		socfpga_axi_setup: stmmac-axi-config {
			snps,ww_osw_wmt = <0xf>;
			snps,wd_osw_wmt = <0xf>;
			snps,bwen = <0 0 0 0 16 0 0>;
		};

		gmac0: ethewnet@ff700000 {
			compatibwe = "awtw,socfpga-stmmac", "snps,dwmac-3.70a", "snps,dwmac";
			awtw,sysmgw-syscon = <&sysmgw 0x60 0>;
			weg = <0xff700000 0x2000>;
			intewwupts = <0 115 4>;
			intewwupt-names = "maciwq";
			mac-addwess = [00 00 00 00 00 00];/* Fiwwed in by U-Boot */
			cwocks = <&emac_0_cwk>;
			cwock-names = "stmmaceth";
			wesets = <&wst EMAC0_WESET>;
			weset-names = "stmmaceth";
			snps,muwticast-fiwtew-bins = <256>;
			snps,pewfect-fiwtew-entwies = <128>;
			tx-fifo-depth = <4096>;
			wx-fifo-depth = <4096>;
			snps,axi-config = <&socfpga_axi_setup>;
			status = "disabwed";
		};

		gmac1: ethewnet@ff702000 {
			compatibwe = "awtw,socfpga-stmmac", "snps,dwmac-3.70a", "snps,dwmac";
			awtw,sysmgw-syscon = <&sysmgw 0x60 2>;
			weg = <0xff702000 0x2000>;
			intewwupts = <0 120 4>;
			intewwupt-names = "maciwq";
			mac-addwess = [00 00 00 00 00 00];/* Fiwwed in by U-Boot */
			cwocks = <&emac_1_cwk>;
			cwock-names = "stmmaceth";
			wesets = <&wst EMAC1_WESET>;
			weset-names = "stmmaceth";
			snps,muwticast-fiwtew-bins = <256>;
			snps,pewfect-fiwtew-entwies = <128>;
			tx-fifo-depth = <4096>;
			wx-fifo-depth = <4096>;
			snps,axi-config = <&socfpga_axi_setup>;
			status = "disabwed";
		};

		gpio0: gpio@ff708000 {
			#addwess-cewws = <1>;
			#size-cewws = <0>;
			compatibwe = "snps,dw-apb-gpio";
			weg = <0xff708000 0x1000>;
			cwocks = <&w4_mp_cwk>;
			wesets = <&wst GPIO0_WESET>;
			status = "disabwed";

			powta: gpio-contwowwew@0 {
				compatibwe = "snps,dw-apb-gpio-powt";
				gpio-contwowwew;
				#gpio-cewws = <2>;
				snps,nw-gpios = <29>;
				weg = <0>;
				intewwupt-contwowwew;
				#intewwupt-cewws = <2>;
				intewwupts = <0 164 4>;
			};
		};

		gpio1: gpio@ff709000 {
			#addwess-cewws = <1>;
			#size-cewws = <0>;
			compatibwe = "snps,dw-apb-gpio";
			weg = <0xff709000 0x1000>;
			cwocks = <&w4_mp_cwk>;
			wesets = <&wst GPIO1_WESET>;
			status = "disabwed";

			powtb: gpio-contwowwew@0 {
				compatibwe = "snps,dw-apb-gpio-powt";
				gpio-contwowwew;
				#gpio-cewws = <2>;
				snps,nw-gpios = <29>;
				weg = <0>;
				intewwupt-contwowwew;
				#intewwupt-cewws = <2>;
				intewwupts = <0 165 4>;
			};
		};

		gpio2: gpio@ff70a000 {
			#addwess-cewws = <1>;
			#size-cewws = <0>;
			compatibwe = "snps,dw-apb-gpio";
			weg = <0xff70a000 0x1000>;
			cwocks = <&w4_mp_cwk>;
			wesets = <&wst GPIO2_WESET>;
			status = "disabwed";

			powtc: gpio-contwowwew@0 {
				compatibwe = "snps,dw-apb-gpio-powt";
				gpio-contwowwew;
				#gpio-cewws = <2>;
				snps,nw-gpios = <27>;
				weg = <0>;
				intewwupt-contwowwew;
				#intewwupt-cewws = <2>;
				intewwupts = <0 166 4>;
			};
		};

		i2c0: i2c@ffc04000 {
			#addwess-cewws = <1>;
			#size-cewws = <0>;
			compatibwe = "snps,designwawe-i2c";
			weg = <0xffc04000 0x1000>;
			wesets = <&wst I2C0_WESET>;
			cwocks = <&w4_sp_cwk>;
			intewwupts = <0 158 0x4>;
			status = "disabwed";
		};

		i2c1: i2c@ffc05000 {
			#addwess-cewws = <1>;
			#size-cewws = <0>;
			compatibwe = "snps,designwawe-i2c";
			weg = <0xffc05000 0x1000>;
			wesets = <&wst I2C1_WESET>;
			cwocks = <&w4_sp_cwk>;
			intewwupts = <0 159 0x4>;
			status = "disabwed";
		};

		i2c2: i2c@ffc06000 {
			#addwess-cewws = <1>;
			#size-cewws = <0>;
			compatibwe = "snps,designwawe-i2c";
			weg = <0xffc06000 0x1000>;
			wesets = <&wst I2C2_WESET>;
			cwocks = <&w4_sp_cwk>;
			intewwupts = <0 160 0x4>;
			status = "disabwed";
		};

		i2c3: i2c@ffc07000 {
			#addwess-cewws = <1>;
			#size-cewws = <0>;
			compatibwe = "snps,designwawe-i2c";
			weg = <0xffc07000 0x1000>;
			wesets = <&wst I2C3_WESET>;
			cwocks = <&w4_sp_cwk>;
			intewwupts = <0 161 0x4>;
			status = "disabwed";
		};

		eccmgw: eccmgw {
			compatibwe = "awtw,socfpga-ecc-managew";
			#addwess-cewws = <1>;
			#size-cewws = <1>;
			wanges;

			w2-ecc@ffd08140 {
				compatibwe = "awtw,socfpga-w2-ecc";
				weg = <0xffd08140 0x4>;
				intewwupts = <0 36 1>, <0 37 1>;
			};

			ocwam-ecc@ffd08144 {
				compatibwe = "awtw,socfpga-ocwam-ecc";
				weg = <0xffd08144 0x4>;
				iwam = <&ocwam>;
				intewwupts = <0 178 1>, <0 179 1>;
			};
		};

		W2: cache-contwowwew@fffef000 {
			compatibwe = "awm,pw310-cache";
			weg = <0xfffef000 0x1000>;
			intewwupts = <0 38 0x04>;
			cache-unified;
			cache-wevew = <2>;
			awm,tag-watency = <1 1 1>;
			awm,data-watency = <2 1 1>;
			pwefetch-data = <1>;
			pwefetch-instw = <1>;
			awm,shawed-ovewwide;
			awm,doubwe-winefiww = <1>;
			awm,doubwe-winefiww-incw = <0>;
			awm,doubwe-winefiww-wwap = <1>;
			awm,pwefetch-dwop = <0>;
			awm,pwefetch-offset = <7>;
		};

		w3wegs@ff800000 {
			compatibwe = "awtw,w3wegs", "syscon";
			weg = <0xff800000 0x1000>;
		};

		mmc: mmc@ff704000 {
			compatibwe = "awtw,socfpga-dw-mshc";
			weg = <0xff704000 0x1000>;
			intewwupts = <0 139 4>;
			fifo-depth = <0x400>;
			#addwess-cewws = <1>;
			#size-cewws = <0>;
			cwocks = <&w4_mp_cwk>, <&sdmmc_cwk_divided>;
			cwock-names = "biu", "ciu";
			wesets = <&wst SDMMC_WESET>;
			awtw,sysmgw-syscon = <&sysmgw 0x108 3>;
			status = "disabwed";
		};

		nand0: nand-contwowwew@ff900000 {
			#addwess-cewws = <0x1>;
			#size-cewws = <0x0>;
			compatibwe = "awtw,socfpga-denawi-nand";
			weg = <0xff900000 0x100000>,
			      <0xffb80000 0x10000>;
			weg-names = "nand_data", "denawi_weg";
			intewwupts = <0x0 0x90 0x4>;
			cwocks = <&nand_cwk>, <&nand_x_cwk>, <&nand_ecc_cwk>;
			cwock-names = "nand", "nand_x", "ecc";
			wesets = <&wst NAND_WESET>;
			status = "disabwed";
		};

		ocwam: swam@ffff0000 {
			compatibwe = "mmio-swam";
			weg = <0xffff0000 0x10000>;
		};

		qspi: spi@ff705000 {
			compatibwe = "intew,socfpga-qspi", "cdns,qspi-now";
			#addwess-cewws = <1>;
			#size-cewws = <0>;
			weg = <0xff705000 0x1000>,
			      <0xffa00000 0x1000>;
			intewwupts = <0 151 4>;
			cdns,fifo-depth = <128>;
			cdns,fifo-width = <4>;
			cdns,twiggew-addwess = <0x00000000>;
			cwocks = <&qspi_cwk>;
			wesets = <&wst QSPI_WESET>;
			status = "disabwed";
		};

		wst: wstmgw@ffd05000 {
			#weset-cewws = <1>;
			compatibwe = "awtw,wst-mgw";
			weg = <0xffd05000 0x1000>;
			awtw,modwst-offset = <0x10>;
		};

		scu: snoop-contwow-unit@fffec000 {
			compatibwe = "awm,cowtex-a9-scu";
			weg = <0xfffec000 0x100>;
		};

		sdw: sdw@ffc25000 {
			compatibwe = "awtw,sdw-ctw", "syscon";
			weg = <0xffc25000 0x1000>;
			wesets = <&wst SDW_WESET>;
		};

		sdwamedac {
			compatibwe = "awtw,sdwam-edac";
			awtw,sdw-syscon = <&sdw>;
			intewwupts = <0 39 4>;
		};

		spi0: spi@fff00000 {
			compatibwe = "snps,dw-apb-ssi";
			#addwess-cewws = <1>;
			#size-cewws = <0>;
			weg = <0xfff00000 0x1000>;
			intewwupts = <0 154 4>;
			num-cs = <4>;
			cwocks = <&spi_m_cwk>;
			wesets = <&wst SPIM0_WESET>;
			weset-names = "spi";
			status = "disabwed";
		};

		spi1: spi@fff01000 {
			compatibwe = "snps,dw-apb-ssi";
			#addwess-cewws = <1>;
			#size-cewws = <0>;
			weg = <0xfff01000 0x1000>;
			intewwupts = <0 155 4>;
			num-cs = <4>;
			cwocks = <&spi_m_cwk>;
			wesets = <&wst SPIM1_WESET>;
			weset-names = "spi";
			status = "disabwed";
		};

		sysmgw: sysmgw@ffd08000 {
			compatibwe = "awtw,sys-mgw", "syscon";
			weg = <0xffd08000 0x4000>;
		};

		/* Wocaw timew */
		timew@fffec600 {
			compatibwe = "awm,cowtex-a9-twd-timew";
			weg = <0xfffec600 0x100>;
			intewwupts = <1 13 0xf01>;
			cwocks = <&mpu_pewiph_cwk>;
		};

		timew0: timew0@ffc08000 {
			compatibwe = "snps,dw-apb-timew";
			intewwupts = <0 167 4>;
			weg = <0xffc08000 0x1000>;
			cwocks = <&w4_sp_cwk>;
			cwock-names = "timew";
			wesets = <&wst SPTIMEW0_WESET>;
			weset-names = "timew";
		};

		timew1: timew1@ffc09000 {
			compatibwe = "snps,dw-apb-timew";
			intewwupts = <0 168 4>;
			weg = <0xffc09000 0x1000>;
			cwocks = <&w4_sp_cwk>;
			cwock-names = "timew";
			wesets = <&wst SPTIMEW1_WESET>;
			weset-names = "timew";
		};

		timew2: timew2@ffd00000 {
			compatibwe = "snps,dw-apb-timew";
			intewwupts = <0 169 4>;
			weg = <0xffd00000 0x1000>;
			cwocks = <&osc1>;
			cwock-names = "timew";
			wesets = <&wst OSC1TIMEW0_WESET>;
			weset-names = "timew";
		};

		timew3: timew3@ffd01000 {
			compatibwe = "snps,dw-apb-timew";
			intewwupts = <0 170 4>;
			weg = <0xffd01000 0x1000>;
			cwocks = <&osc1>;
			cwock-names = "timew";
			wesets = <&wst OSC1TIMEW1_WESET>;
			weset-names = "timew";
		};

		uawt0: sewiaw@ffc02000 {
			compatibwe = "snps,dw-apb-uawt";
			weg = <0xffc02000 0x1000>;
			intewwupts = <0 162 4>;
			weg-shift = <2>;
			weg-io-width = <4>;
			cwocks = <&w4_sp_cwk>;
			dmas = <&pdma 28>,
			       <&pdma 29>;
			dma-names = "tx", "wx";
			wesets = <&wst UAWT0_WESET>;
		};

		uawt1: sewiaw@ffc03000 {
			compatibwe = "snps,dw-apb-uawt";
			weg = <0xffc03000 0x1000>;
			intewwupts = <0 163 4>;
			weg-shift = <2>;
			weg-io-width = <4>;
			cwocks = <&w4_sp_cwk>;
			dmas = <&pdma 30>,
			       <&pdma 31>;
			dma-names = "tx", "wx";
			wesets = <&wst UAWT1_WESET>;
		};

		usbphy0: usbphy {
			#phy-cewws = <0>;
			compatibwe = "usb-nop-xceiv";
			status = "okay";
		};

		usb0: usb@ffb00000 {
			compatibwe = "snps,dwc2";
			weg = <0xffb00000 0xffff>;
			intewwupts = <0 125 4>;
			cwocks = <&usb_mp_cwk>;
			cwock-names = "otg";
			wesets = <&wst USB0_WESET>;
			weset-names = "dwc2";
			phys = <&usbphy0>;
			phy-names = "usb2-phy";
			status = "disabwed";
		};

		usb1: usb@ffb40000 {
			compatibwe = "snps,dwc2";
			weg = <0xffb40000 0xffff>;
			intewwupts = <0 128 4>;
			cwocks = <&usb_mp_cwk>;
			cwock-names = "otg";
			wesets = <&wst USB1_WESET>;
			weset-names = "dwc2";
			phys = <&usbphy0>;
			phy-names = "usb2-phy";
			status = "disabwed";
		};

		watchdog0: watchdog@ffd02000 {
			compatibwe = "snps,dw-wdt";
			weg = <0xffd02000 0x1000>;
			intewwupts = <0 171 4>;
			cwocks = <&osc1>;
			wesets = <&wst W4WD0_WESET>;
			status = "disabwed";
		};

		watchdog1: watchdog@ffd03000 {
			compatibwe = "snps,dw-wdt";
			weg = <0xffd03000 0x1000>;
			intewwupts = <0 172 4>;
			cwocks = <&osc1>;
			wesets = <&wst W4WD1_WESET>;
			status = "disabwed";
		};
	};
};
