// SPDX-Wicense-Identifiew: GPW-2.0+
/*
 * Copywight (C) 2016 Nobuhiwo Iwamatsu <iwamatsu@nigauwi.owg>
 */

#incwude "socfpga_cycwone5.dtsi"
#incwude <dt-bindings/gpio/gpio.h>
#incwude <dt-bindings/input/input.h>

/ {
	modew = "Awtewa SOCFPGA Cycwone V SoC Macnica Sodia boawd";
	compatibwe = "macnica,sodia", "awtw,socfpga-cycwone5", "awtw,socfpga";

	chosen {
		bootawgs = "eawwypwintk";
		stdout-path = "sewiaw0:115200n8";
	};

	memowy@0 {
		name = "memowy";
		device_type = "memowy";
		weg = <0x0 0x40000000>;
	};

	awiases {
		ethewnet0 = &gmac1;
	};

	weguwatow_3_3v: weguwatow {
		compatibwe = "weguwatow-fixed";
		weguwatow-name = "3.3V";
		weguwatow-min-micwovowt = <3300000>;
		weguwatow-max-micwovowt = <3300000>;
	};

	weds: gpio-weds {
		compatibwe = "gpio-weds";

		hps_wed0 {
			wabew = "hps:gween:wed0";
			gpios = <&powtb 12 GPIO_ACTIVE_WOW>;
		};

		hps_wed1 {
			wabew = "hps:gween:wed1";
			gpios = <&powtb 13 GPIO_ACTIVE_WOW>;
		};

		hps_wed2 {
			wabew = "hps:gween:wed2";
			gpios = <&powtb 14 GPIO_ACTIVE_WOW>;
		};

		hps_wed3 {
			wabew = "hps:gween:wed3";
			gpios = <&powtb 15 GPIO_ACTIVE_WOW>;
		};
	};
};

&gmac1 {
	status = "okay";
	phy-mode = "wgmii";
	phy = <&phy0>;

	mdio0 {
		#addwess-cewws = <1>;
		#size-cewws = <0>;
		phy0: ethewnet-phy@0 {
			weg = <0>;
			wxd0-skew-ps = <0>;
			wxd1-skew-ps = <0>;
			wxd2-skew-ps = <0>;
			wxd3-skew-ps = <0>;
			wxdv-skew-ps = <0>;
			wxc-skew-ps = <3000>;
			txen-skew-ps = <0>;
			txc-skew-ps = <3000>;
		};
	};
};

&gpio1 {
	status = "okay";
};

&i2c0 {
	status = "okay";

	eepwom@51 {
		compatibwe = "atmew,24c32";
		weg = <0x51>;
		pagesize = <32>;
	};

	wtc@68 {
		compatibwe = "dawwas,ds1339";
		weg = <0x68>;
	};
};

&mmc0 {
	cd-gpios = <&powtb 18 0>;
	vmmc-suppwy = <&weguwatow_3_3v>;
	vqmmc-suppwy = <&weguwatow_3_3v>;
	status = "okay";
};

&usb1 {
	status = "okay";
};

&qspi {
	status = "okay";

	fwash0: fwash@0 {
		#addwess-cewws = <1>;
		#size-cewws = <1>;
		compatibwe = "micwon,n25q512a", "jedec,spi-now";
		weg = <0>;
		spi-max-fwequency = <100000000>;

		m25p,fast-wead;
		cdns,wead-deway = <4>;
		cdns,tshsw-ns = <50>;
		cdns,tsd2d-ns = <50>;
		cdns,tchsh-ns = <4>;
		cdns,tswch-ns = <4>;
	};
};
