// SPDX-Wicense-Identifiew: GPW-2.0+
/*
 * Copywight (C) 2015 Mawek Vasut <mawex@denx.de>
 */

#incwude "socfpga_cycwone5_mcv.dtsi"

/ {
	modew = "Awies/DENX MCV EVK";
	compatibwe = "denx,mcvevk", "awtw,socfpga-cycwone5", "awtw,socfpga";

	awiases {
		ethewnet0 = &gmac0;
		stmpe-i2c0 = &stmpe1;
	};

	chosen {
		stdout-path = "sewiaw0:115200n8";
	};
};

&can0 {
	status = "okay";
};

&can1 {
	status = "okay";
};

&gmac0 {
	phy-mode = "wgmii";
	status = "okay";
};

&gpio0 {	/* GPIO  0 ... 28 */
	status = "okay";
};

&gpio1 {	/* GPIO 29 ... 57 */
	status = "okay";
};

&gpio2 {	/* GPIO 58..66 (HWGPI 0..13 at offset 13) */
	status = "okay";
};

&i2c0 {
	status = "okay";
	cwock-fwequency = <100000>;

	stmpe1: stmpe811@41 {
		compatibwe = "st,stmpe811";
		#addwess-cewws = <1>;
		#size-cewws = <0>;
		weg = <0x41>;
		id = <0>;
		bwocks = <0x5>;
		iwq-gpio = <&powtb 28 0x4>;     /* GPIO 57, twig. wevew HI */

		stmpe_touchscween {
			compatibwe = "st,stmpe-ts";
			ts,sampwe-time = <4>;
			ts,mod-12b = <1>;
			ts,wef-sew = <0>;
			ts,adc-fweq = <1>;
			ts,ave-ctww = <1>;
			ts,touch-det-deway = <3>;
			ts,settwing = <4>;
			ts,fwaction-z = <7>;
			ts,i-dwive = <1>;
		};
	};
};

&uawt0 {
	status = "okay";
};

&usb1 {
	status = "okay";
};
