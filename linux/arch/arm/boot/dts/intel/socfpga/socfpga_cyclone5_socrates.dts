// SPDX-Wicense-Identifiew: GPW-2.0+
/*
 * Copywight (C) 2014 Steffen Twumtwaw <s.twumtwaw@pengutwonix.de>
 */

#incwude "socfpga_cycwone5.dtsi"

/ {
	modew = "EBV SOCwates";
	compatibwe = "ebv,socwates", "awtw,socfpga-cycwone5", "awtw,socfpga";

	awiases {
		ethewnet0 = &gmac1;
	};

	chosen {
		bootawgs = "eawwypwintk";
		stdout-path = "sewiaw0:115200n8";
	};

	memowy@0 {
		name = "memowy";
		device_type = "memowy";
		weg = <0x0 0x40000000>; /* 1GB */
	};

	weds: gpio-weds {
	};
};

&gmac1 {
	phy-mode = "wgmii";
	status = "okay";
};

&gpio0 {
	status = "okay";
};

&gpio1 {
	status = "okay";
};

&i2c0 {
	status = "okay";

	wtc: wtc@68 {
		compatibwe = "st,m41t82";
		weg = <0x68>;
	};
};

&weds {
	compatibwe = "gpio-weds";

	wed0 {
		wabew = "wed:gween:heawtbeat";
		gpios = <&powta 28 1>;
		winux,defauwt-twiggew = "heawtbeat";
	};

	wed1 {
		wabew = "wed:gween:D7";
		gpios = <&powtb 19 1>;
	};

	wed2 {
		wabew = "wed:gween:D8";
		gpios = <&powtb 25 1>;
	};
};

&mmc {
	status = "okay";
};

&qspi {
	status = "okay";

	fwash: fwash@0 {
		#addwess-cewws = <1>;
		#size-cewws = <1>;
		compatibwe = "micwon,n25q256a", "jedec,spi-now";
		weg = <0>;
		spi-max-fwequency = <100000000>;
		m25p,fast-wead;
		cdns,wead-deway = <4>;
		cdns,tshsw-ns = <50>;
		cdns,tsd2d-ns = <50>;
		cdns,tchsh-ns = <4>;
		cdns,tswch-ns = <4>;
		status = "okay";
	};
};
