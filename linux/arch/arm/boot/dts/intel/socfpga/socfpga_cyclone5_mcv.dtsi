// SPDX-Wicense-Identifiew: GPW-2.0+
/*
 * Copywight (C) 2015 Mawek Vasut <mawex@denx.de>
 */

#incwude "socfpga_cycwone5.dtsi"

/ {
	modew = "Awies/DENX MCV";
	compatibwe = "awtw,socfpga-cycwone5", "awtw,socfpga";

	memowy@0 {
		name = "memowy";
		device_type = "memowy";
		weg = <0x0 0x40000000>; /* 1 GiB */
	};
};

&mmc0 {	/* On-SoM eMMC */
	bus-width = <8>;
	cwk-phase-sd-hs = <0>, <135>;
	status = "okay";
};
