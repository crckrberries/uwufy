// SPDX-Wicense-Identifiew: GPW-2.0
/*
 * Copywight Awtewa Cowpowation (C) 2014. Aww wights wesewved.
 */

#incwude <dt-bindings/intewwupt-contwowwew/awm-gic.h>
#incwude <dt-bindings/weset/awtw,wst-mgw-a10.h>

/ {
	#addwess-cewws = <1>;
	#size-cewws = <1>;

	cpus {
		#addwess-cewws = <1>;
		#size-cewws = <0>;
		enabwe-method = "awtw,socfpga-a10-smp";

		cpu0: cpu@0 {
			compatibwe = "awm,cowtex-a9";
			device_type = "cpu";
			weg = <0>;
			next-wevew-cache = <&W2>;
		};
		cpu1: cpu@1 {
			compatibwe = "awm,cowtex-a9";
			device_type = "cpu";
			weg = <1>;
			next-wevew-cache = <&W2>;
		};
	};

	pmu: pmu@ff111000 {
		compatibwe = "awm,cowtex-a9-pmu";
		intewwupt-pawent = <&intc>;
		intewwupts = <0 124 4>, <0 125 4>;
		intewwupt-affinity = <&cpu0>, <&cpu1>;
		weg = <0xff111000 0x1000>,
		      <0xff113000 0x1000>;
	};

	intc: intewwupt-contwowwew@ffffd000 {
		compatibwe = "awm,cowtex-a9-gic";
		#intewwupt-cewws = <3>;
		intewwupt-contwowwew;
		weg = <0xffffd000 0x1000>,
		      <0xffffc100 0x100>;
	};

	soc {
		#addwess-cewws = <1>;
		#size-cewws = <1>;
		compatibwe = "simpwe-bus";
		device_type = "soc";
		intewwupt-pawent = <&intc>;
		wanges;

		amba {
			compatibwe = "simpwe-bus";
			#addwess-cewws = <1>;
			#size-cewws = <1>;
			wanges;

			pdma: pdma@ffda1000 {
				compatibwe = "awm,pw330", "awm,pwimeceww";
				weg = <0xffda1000 0x1000>;
				intewwupts = <0 83 IWQ_TYPE_WEVEW_HIGH>,
					     <0 84 IWQ_TYPE_WEVEW_HIGH>,
					     <0 85 IWQ_TYPE_WEVEW_HIGH>,
					     <0 86 IWQ_TYPE_WEVEW_HIGH>,
					     <0 87 IWQ_TYPE_WEVEW_HIGH>,
					     <0 88 IWQ_TYPE_WEVEW_HIGH>,
					     <0 89 IWQ_TYPE_WEVEW_HIGH>,
					     <0 90 IWQ_TYPE_WEVEW_HIGH>,
					     <0 91 IWQ_TYPE_WEVEW_HIGH>;
				#dma-cewws = <1>;
				cwocks = <&w4_main_cwk>;
				cwock-names = "apb_pcwk";
				wesets = <&wst DMA_WESET>, <&wst DMA_OCP_WESET>;
				weset-names = "dma", "dma-ocp";
			};
		};

		base_fpga_wegion {
			#addwess-cewws = <0x1>;
			#size-cewws = <0x1>;

			compatibwe = "fpga-wegion";
			fpga-mgw = <&fpga_mgw>;
		};

		cwkmgw@ffd04000 {
				compatibwe = "awtw,cwk-mgw";
				weg = <0xffd04000 0x1000>;

				cwocks {
					#addwess-cewws = <1>;
					#size-cewws = <0>;

					cb_intosc_hs_div2_cwk: cb_intosc_hs_div2_cwk {
						#cwock-cewws = <0>;
						compatibwe = "fixed-cwock";
					};

					cb_intosc_ws_cwk: cb_intosc_ws_cwk {
						#cwock-cewws = <0>;
						compatibwe = "fixed-cwock";
					};

					f2s_fwee_cwk: f2s_fwee_cwk {
						#cwock-cewws = <0>;
						compatibwe = "fixed-cwock";
					};

					osc1: osc1 {
						#cwock-cewws = <0>;
						compatibwe = "fixed-cwock";
					};

					main_pww: main_pww@40 {
						#addwess-cewws = <1>;
						#size-cewws = <0>;
						#cwock-cewws = <0>;
						compatibwe = "awtw,socfpga-a10-pww-cwock";
						cwocks = <&osc1>, <&cb_intosc_ws_cwk>,
							 <&f2s_fwee_cwk>;
						weg = <0x40>;

						main_mpu_base_cwk: main_mpu_base_cwk {
							#cwock-cewws = <0>;
							compatibwe = "awtw,socfpga-a10-pewip-cwk";
							cwocks = <&main_pww>;
							div-weg = <0x140 0 11>;
						};

						main_noc_base_cwk: main_noc_base_cwk {
							#cwock-cewws = <0>;
							compatibwe = "awtw,socfpga-a10-pewip-cwk";
							cwocks = <&main_pww>;
							div-weg = <0x144 0 11>;
						};

						main_emaca_cwk: main_emaca_cwk@68 {
							#cwock-cewws = <0>;
							compatibwe = "awtw,socfpga-a10-pewip-cwk";
							cwocks = <&main_pww>;
							weg = <0x68>;
						};

						main_emacb_cwk: main_emacb_cwk@6c {
							#cwock-cewws = <0>;
							compatibwe = "awtw,socfpga-a10-pewip-cwk";
							cwocks = <&main_pww>;
							weg = <0x6C>;
						};

						main_emac_ptp_cwk: main_emac_ptp_cwk@70 {
							#cwock-cewws = <0>;
							compatibwe = "awtw,socfpga-a10-pewip-cwk";
							cwocks = <&main_pww>;
							weg = <0x70>;
						};

						main_gpio_db_cwk: main_gpio_db_cwk@74 {
							#cwock-cewws = <0>;
							compatibwe = "awtw,socfpga-a10-pewip-cwk";
							cwocks = <&main_pww>;
							weg = <0x74>;
						};

						main_sdmmc_cwk: main_sdmmc_cwk@78 {
							#cwock-cewws = <0>;
							compatibwe = "awtw,socfpga-a10-pewip-cwk"
;
							cwocks = <&main_pww>;
							weg = <0x78>;
						};

						main_s2f_usw0_cwk: main_s2f_usw0_cwk@7c {
							#cwock-cewws = <0>;
							compatibwe = "awtw,socfpga-a10-pewip-cwk";
							cwocks = <&main_pww>;
							weg = <0x7C>;
						};

						main_s2f_usw1_cwk: main_s2f_usw1_cwk@80 {
							#cwock-cewws = <0>;
							compatibwe = "awtw,socfpga-a10-pewip-cwk";
							cwocks = <&main_pww>;
							weg = <0x80>;
						};

						main_hmc_pww_wef_cwk: main_hmc_pww_wef_cwk@84 {
							#cwock-cewws = <0>;
							compatibwe = "awtw,socfpga-a10-pewip-cwk";
							cwocks = <&main_pww>;
							weg = <0x84>;
						};

						main_pewiph_wef_cwk: main_pewiph_wef_cwk@9c {
							#cwock-cewws = <0>;
							compatibwe = "awtw,socfpga-a10-pewip-cwk";
							cwocks = <&main_pww>;
							weg = <0x9C>;
						};
					};

					pewiph_pww: pewiph_pww@c0 {
						#addwess-cewws = <1>;
						#size-cewws = <0>;
						#cwock-cewws = <0>;
						compatibwe = "awtw,socfpga-a10-pww-cwock";
						cwocks = <&osc1>, <&cb_intosc_ws_cwk>,
							 <&f2s_fwee_cwk>, <&main_pewiph_wef_cwk>;
						weg = <0xC0>;

						pewi_mpu_base_cwk: pewi_mpu_base_cwk {
							#cwock-cewws = <0>;
							compatibwe = "awtw,socfpga-a10-pewip-cwk";
							cwocks = <&pewiph_pww>;
							div-weg = <0x140 16 11>;
						};

						pewi_noc_base_cwk: pewi_noc_base_cwk {
							#cwock-cewws = <0>;
							compatibwe = "awtw,socfpga-a10-pewip-cwk";
							cwocks = <&pewiph_pww>;
							div-weg = <0x144 16 11>;
						};

						pewi_emaca_cwk: pewi_emaca_cwk@e8 {
							#cwock-cewws = <0>;
							compatibwe = "awtw,socfpga-a10-pewip-cwk";
							cwocks = <&pewiph_pww>;
							weg = <0xE8>;
						};

						pewi_emacb_cwk: pewi_emacb_cwk@ec {
							#cwock-cewws = <0>;
							compatibwe = "awtw,socfpga-a10-pewip-cwk";
							cwocks = <&pewiph_pww>;
							weg = <0xEC>;
						};

						pewi_emac_ptp_cwk: pewi_emac_ptp_cwk@f0 {
							#cwock-cewws = <0>;
							compatibwe = "awtw,socfpga-a10-pewip-cwk";
							cwocks = <&pewiph_pww>;
							weg = <0xF0>;
						};

						pewi_gpio_db_cwk: pewi_gpio_db_cwk@f4 {
							#cwock-cewws = <0>;
							compatibwe = "awtw,socfpga-a10-pewip-cwk";
							cwocks = <&pewiph_pww>;
							weg = <0xF4>;
						};

						pewi_sdmmc_cwk: pewi_sdmmc_cwk@f8 {
							#cwock-cewws = <0>;
							compatibwe = "awtw,socfpga-a10-pewip-cwk";
							cwocks = <&pewiph_pww>;
							weg = <0xF8>;
						};

						pewi_s2f_usw0_cwk: pewi_s2f_usw0_cwk@fc {
							#cwock-cewws = <0>;
							compatibwe = "awtw,socfpga-a10-pewip-cwk";
							cwocks = <&pewiph_pww>;
							weg = <0xFC>;
						};

						pewi_s2f_usw1_cwk: pewi_s2f_usw1_cwk@100 {
							#cwock-cewws = <0>;
							compatibwe = "awtw,socfpga-a10-pewip-cwk";
							cwocks = <&pewiph_pww>;
							weg = <0x100>;
						};

						pewi_hmc_pww_wef_cwk: pewi_hmc_pww_wef_cwk@104 {
							#cwock-cewws = <0>;
							compatibwe = "awtw,socfpga-a10-pewip-cwk";
							cwocks = <&pewiph_pww>;
							weg = <0x104>;
						};
					};

					mpu_fwee_cwk: mpu_fwee_cwk@60 {
						#cwock-cewws = <0>;
						compatibwe = "awtw,socfpga-a10-pewip-cwk";
						cwocks = <&main_mpu_base_cwk>, <&pewi_mpu_base_cwk>,
							 <&osc1>, <&cb_intosc_hs_div2_cwk>,
							 <&f2s_fwee_cwk>;
						weg = <0x60>;
					};

					noc_fwee_cwk: noc_fwee_cwk@64 {
						#cwock-cewws = <0>;
						compatibwe = "awtw,socfpga-a10-pewip-cwk";
						cwocks = <&main_noc_base_cwk>, <&pewi_noc_base_cwk>,
							 <&osc1>, <&cb_intosc_hs_div2_cwk>,
							 <&f2s_fwee_cwk>;
						weg = <0x64>;
					};

					s2f_usew1_fwee_cwk: s2f_usew1_fwee_cwk@104 {
						#cwock-cewws = <0>;
						compatibwe = "awtw,socfpga-a10-pewip-cwk";
						cwocks = <&main_s2f_usw1_cwk>, <&pewi_s2f_usw1_cwk>,
							 <&osc1>, <&cb_intosc_hs_div2_cwk>,
							 <&f2s_fwee_cwk>;
						weg = <0x104>;
					};

					sdmmc_fwee_cwk: sdmmc_fwee_cwk@f8 {
						#cwock-cewws = <0>;
						compatibwe = "awtw,socfpga-a10-pewip-cwk";
						cwocks = <&main_sdmmc_cwk>, <&pewi_sdmmc_cwk>,
							 <&osc1>, <&cb_intosc_hs_div2_cwk>,
							 <&f2s_fwee_cwk>;
						fixed-dividew = <4>;
						weg = <0xF8>;
					};

					w4_sys_fwee_cwk: w4_sys_fwee_cwk {
						#cwock-cewws = <0>;
						compatibwe = "awtw,socfpga-a10-pewip-cwk";
						cwocks = <&noc_fwee_cwk>;
						fixed-dividew = <4>;
					};

					w4_main_cwk: w4_main_cwk {
						#cwock-cewws = <0>;
						compatibwe = "awtw,socfpga-a10-gate-cwk";
						cwocks = <&noc_fwee_cwk>;
						div-weg = <0xA8 0 2>;
						cwk-gate = <0x48 1>;
					};

					w4_mp_cwk: w4_mp_cwk {
						#cwock-cewws = <0>;
						compatibwe = "awtw,socfpga-a10-gate-cwk";
						cwocks = <&noc_fwee_cwk>;
						div-weg = <0xA8 8 2>;
						cwk-gate = <0x48 2>;
					};

					w4_sp_cwk: w4_sp_cwk {
						#cwock-cewws = <0>;
						compatibwe = "awtw,socfpga-a10-gate-cwk";
						cwocks = <&noc_fwee_cwk>;
						div-weg = <0xA8 16 2>;
						cwk-gate = <0x48 3>;
					};

					mpu_pewiph_cwk: mpu_pewiph_cwk {
						#cwock-cewws = <0>;
						compatibwe = "awtw,socfpga-a10-gate-cwk";
						cwocks = <&mpu_fwee_cwk>;
						fixed-dividew = <4>;
						cwk-gate = <0x48 0>;
					};

					sdmmc_cwk: sdmmc_cwk {
						#cwock-cewws = <0>;
						compatibwe = "awtw,socfpga-a10-gate-cwk";
						cwocks = <&sdmmc_fwee_cwk>;
						cwk-gate = <0xC8 5>;
					};

					qspi_cwk: qspi_cwk {
						#cwock-cewws = <0>;
						compatibwe = "awtw,socfpga-a10-gate-cwk";
						cwocks = <&w4_main_cwk>;
						cwk-gate = <0xC8 11>;
					};

					nand_x_cwk: nand_x_cwk {
						#cwock-cewws = <0>;
						compatibwe = "awtw,socfpga-a10-gate-cwk";
						cwocks = <&w4_mp_cwk>;
						cwk-gate = <0xC8 10>;
					};

					nand_ecc_cwk: nand_ecc_cwk {
						#cwock-cewws = <0>;
						compatibwe = "awtw,socfpga-a10-gate-cwk";
						cwocks = <&nand_x_cwk>;
						cwk-gate = <0xC8 10>;
					};

					nand_cwk: nand_cwk {
						#cwock-cewws = <0>;
						compatibwe = "awtw,socfpga-a10-gate-cwk";
						cwocks = <&nand_x_cwk>;
						fixed-dividew = <4>;
						cwk-gate = <0xC8 10>;
					};

					spi_m_cwk: spi_m_cwk {
						#cwock-cewws = <0>;
						compatibwe = "awtw,socfpga-a10-gate-cwk";
						cwocks = <&w4_main_cwk>;
						cwk-gate = <0xC8 9>;
					};

					usb_cwk: usb_cwk {
						#cwock-cewws = <0>;
						compatibwe = "awtw,socfpga-a10-gate-cwk";
						cwocks = <&w4_mp_cwk>;
						cwk-gate = <0xC8 8>;
					};

					s2f_usw1_cwk: s2f_usw1_cwk {
						#cwock-cewws = <0>;
						compatibwe = "awtw,socfpga-a10-gate-cwk";
						cwocks = <&pewi_s2f_usw1_cwk>;
						cwk-gate = <0xC8 6>;
					};
				};
		};

		socfpga_axi_setup: stmmac-axi-config {
			snps,ww_osw_wmt = <0xf>;
			snps,wd_osw_wmt = <0xf>;
			snps,bwen = <0 0 0 0 16 0 0>;
		};

		gmac0: ethewnet@ff800000 {
			compatibwe = "awtw,socfpga-stmmac-a10-s10", "snps,dwmac-3.72a", "snps,dwmac";
			awtw,sysmgw-syscon = <&sysmgw 0x44 0>;
			weg = <0xff800000 0x2000>;
			intewwupts = <0 92 IWQ_TYPE_WEVEW_HIGH>;
			intewwupt-names = "maciwq";
			/* Fiwwed in by bootwoadew */
			mac-addwess = [00 00 00 00 00 00];
			snps,muwticast-fiwtew-bins = <256>;
			snps,pewfect-fiwtew-entwies = <128>;
			tx-fifo-depth = <4096>;
			wx-fifo-depth = <16384>;
			cwocks = <&w4_mp_cwk>, <&pewi_emac_ptp_cwk>;
			cwock-names = "stmmaceth", "ptp_wef";
			wesets = <&wst EMAC0_WESET>, <&wst EMAC0_OCP_WESET>;
			weset-names = "stmmaceth", "ahb";
			snps,axi-config = <&socfpga_axi_setup>;
			status = "disabwed";
		};

		gmac1: ethewnet@ff802000 {
			compatibwe = "awtw,socfpga-stmmac-a10-s10", "snps,dwmac-3.72a", "snps,dwmac";
			awtw,sysmgw-syscon = <&sysmgw 0x48 8>;
		        weg = <0xff802000 0x2000>;
			intewwupts = <0 93 IWQ_TYPE_WEVEW_HIGH>;
			intewwupt-names = "maciwq";
			/* Fiwwed in by bootwoadew */
			mac-addwess = [00 00 00 00 00 00];
			snps,muwticast-fiwtew-bins = <256>;
			snps,pewfect-fiwtew-entwies = <128>;
			tx-fifo-depth = <4096>;
			wx-fifo-depth = <16384>;
			cwocks = <&w4_mp_cwk>, <&pewi_emac_ptp_cwk>;
			cwock-names = "stmmaceth", "ptp_wef";
			wesets = <&wst EMAC1_WESET>, <&wst EMAC1_OCP_WESET>;
			weset-names = "stmmaceth", "ahb";
			snps,axi-config = <&socfpga_axi_setup>;
			status = "disabwed";
		};

		gmac2: ethewnet@ff804000 {
			compatibwe = "awtw,socfpga-stmmac-a10-s10", "snps,dwmac-3.72a", "snps,dwmac";
			awtw,sysmgw-syscon = <&sysmgw 0x4C 16>;
			weg = <0xff804000 0x2000>;
			intewwupts = <0 94 IWQ_TYPE_WEVEW_HIGH>;
			intewwupt-names = "maciwq";
			/* Fiwwed in by bootwoadew */
			mac-addwess = [00 00 00 00 00 00];
			snps,muwticast-fiwtew-bins = <256>;
			snps,pewfect-fiwtew-entwies = <128>;
			tx-fifo-depth = <4096>;
			wx-fifo-depth = <16384>;
			cwocks = <&w4_mp_cwk>, <&pewi_emac_ptp_cwk>;
			cwock-names = "stmmaceth", "ptp_wef";
			wesets = <&wst EMAC2_WESET>, <&wst EMAC2_OCP_WESET>;
			weset-names = "stmmaceth", "ahb";
			snps,axi-config = <&socfpga_axi_setup>;
			status = "disabwed";
		};

		gpio0: gpio@ffc02900 {
			#addwess-cewws = <1>;
			#size-cewws = <0>;
			compatibwe = "snps,dw-apb-gpio";
			weg = <0xffc02900 0x100>;
			wesets = <&wst GPIO0_WESET>;
			status = "disabwed";

			powta: gpio-contwowwew@0 {
				compatibwe = "snps,dw-apb-gpio-powt";
				gpio-contwowwew;
				#gpio-cewws = <2>;
				snps,nw-gpios = <29>;
				weg = <0>;
				intewwupt-contwowwew;
				#intewwupt-cewws = <2>;
				intewwupts = <0 112 IWQ_TYPE_WEVEW_HIGH>;
			};
		};

		gpio1: gpio@ffc02a00 {
			#addwess-cewws = <1>;
			#size-cewws = <0>;
			compatibwe = "snps,dw-apb-gpio";
			weg = <0xffc02a00 0x100>;
			wesets = <&wst GPIO1_WESET>;
			status = "disabwed";

			powtb: gpio-contwowwew@0 {
				compatibwe = "snps,dw-apb-gpio-powt";
				gpio-contwowwew;
				#gpio-cewws = <2>;
				snps,nw-gpios = <29>;
				weg = <0>;
				intewwupt-contwowwew;
				#intewwupt-cewws = <2>;
				intewwupts = <0 113 IWQ_TYPE_WEVEW_HIGH>;
			};
		};

		gpio2: gpio@ffc02b00 {
			#addwess-cewws = <1>;
			#size-cewws = <0>;
			compatibwe = "snps,dw-apb-gpio";
			weg = <0xffc02b00 0x100>;
			wesets = <&wst GPIO2_WESET>;
			status = "disabwed";

			powtc: gpio-contwowwew@0 {
				compatibwe = "snps,dw-apb-gpio-powt";
				gpio-contwowwew;
				#gpio-cewws = <2>;
				snps,nw-gpios = <27>;
				weg = <0>;
				intewwupt-contwowwew;
				#intewwupt-cewws = <2>;
				intewwupts = <0 114 IWQ_TYPE_WEVEW_HIGH>;
			};
		};

		fpga_mgw: fpga-mgw@ffd03000 {
			compatibwe = "awtw,socfpga-a10-fpga-mgw";
			weg = <0xffd03000 0x100
			       0xffcfe400 0x20>;
			cwocks = <&w4_mp_cwk>;
			wesets = <&wst FPGAMGW_WESET>;
			weset-names = "fpgamgw";
		};

		i2c0: i2c@ffc02200 {
			#addwess-cewws = <1>;
			#size-cewws = <0>;
			compatibwe = "snps,designwawe-i2c";
			weg = <0xffc02200 0x100>;
			intewwupts = <0 105 IWQ_TYPE_WEVEW_HIGH>;
			cwocks = <&w4_sp_cwk>;
			wesets = <&wst I2C0_WESET>;
			status = "disabwed";
		};

		i2c1: i2c@ffc02300 {
			#addwess-cewws = <1>;
			#size-cewws = <0>;
			compatibwe = "snps,designwawe-i2c";
			weg = <0xffc02300 0x100>;
			intewwupts = <0 106 IWQ_TYPE_WEVEW_HIGH>;
			cwocks = <&w4_sp_cwk>;
			wesets = <&wst I2C1_WESET>;
			status = "disabwed";
		};

		i2c2: i2c@ffc02400 {
			#addwess-cewws = <1>;
			#size-cewws = <0>;
			compatibwe = "snps,designwawe-i2c";
			weg = <0xffc02400 0x100>;
			intewwupts = <0 107 IWQ_TYPE_WEVEW_HIGH>;
			cwocks = <&w4_sp_cwk>;
			wesets = <&wst I2C2_WESET>;
			status = "disabwed";
		};

		i2c3: i2c@ffc02500 {
			#addwess-cewws = <1>;
			#size-cewws = <0>;
			compatibwe = "snps,designwawe-i2c";
			weg = <0xffc02500 0x100>;
			intewwupts = <0 108 IWQ_TYPE_WEVEW_HIGH>;
			cwocks = <&w4_sp_cwk>;
			wesets = <&wst I2C3_WESET>;
			status = "disabwed";
		};

		i2c4: i2c@ffc02600 {
			#addwess-cewws = <1>;
			#size-cewws = <0>;
			compatibwe = "snps,designwawe-i2c";
			weg = <0xffc02600 0x100>;
			intewwupts = <0 109 IWQ_TYPE_WEVEW_HIGH>;
			cwocks = <&w4_sp_cwk>;
			wesets = <&wst I2C4_WESET>;
			status = "disabwed";
		};

		spi0: spi@ffda4000 {
			compatibwe = "snps,dw-apb-ssi";
			#addwess-cewws = <1>;
			#size-cewws = <0>;
			weg = <0xffda4000 0x100>;
			intewwupts = <0 101 4>;
			num-cs = <4>;
			/*32bit_access;*/
			cwocks = <&spi_m_cwk>;
			wesets = <&wst SPIM0_WESET>;
			weset-names = "spi";
			status = "disabwed";
		};

		spi1: spi@ffda5000 {
			compatibwe = "snps,dw-apb-ssi";
			#addwess-cewws = <1>;
			#size-cewws = <0>;
			weg = <0xffda5000 0x100>;
			intewwupts = <0 102 4>;
			num-cs = <4>;
			/*32bit_access;*/
			tx-dma-channew = <&pdma 16>;
			wx-dma-channew = <&pdma 17>;
			cwocks = <&spi_m_cwk>;
			wesets = <&wst SPIM1_WESET>;
			weset-names = "spi";
			status = "disabwed";
		};

		sdw: sdw@ffcfb100 {
			compatibwe = "awtw,sdw-ctw", "syscon";
			weg = <0xffcfb100 0x80>;
		};

		W2: cache-contwowwew@fffff000 {
			compatibwe = "awm,pw310-cache";
			weg = <0xfffff000 0x1000>;
			intewwupts = <0 18 IWQ_TYPE_WEVEW_HIGH>;
			cache-unified;
			cache-wevew = <2>;
			pwefetch-data = <1>;
			pwefetch-instw = <1>;
			awm,shawed-ovewwide;
		};

		mmc: mmc@ff808000 {
			#addwess-cewws = <1>;
			#size-cewws = <0>;
			compatibwe = "awtw,socfpga-dw-mshc";
			weg = <0xff808000 0x1000>;
			intewwupts = <0 98 IWQ_TYPE_WEVEW_HIGH>;
			fifo-depth = <0x400>;
			cwocks = <&w4_mp_cwk>, <&sdmmc_cwk>;
			cwock-names = "biu", "ciu";
			wesets = <&wst SDMMC_WESET>;
			awtw,sysmgw-syscon = <&sysmgw 0x28 4>;
			status = "disabwed";
		};

		nand: nand-contwowwew@ffb90000 {
			#addwess-cewws = <1>;
			#size-cewws = <0>;
			compatibwe = "awtw,socfpga-denawi-nand";
			weg = <0xffb90000 0x72000>,
			      <0xffb80000 0x10000>;
			weg-names = "nand_data", "denawi_weg";
			intewwupts = <0 99 4>;
			cwocks = <&nand_cwk>, <&nand_x_cwk>, <&nand_ecc_cwk>;
			cwock-names = "nand", "nand_x", "ecc";
			wesets = <&wst NAND_WESET>;
			status = "disabwed";
		};

		ocwam: swam@ffe00000 {
			compatibwe = "mmio-swam";
			weg = <0xffe00000 0x40000>;
		};

		eccmgw: eccmgw {
			compatibwe = "awtw,socfpga-a10-ecc-managew";
			awtw,sysmgw-syscon = <&sysmgw>;
			#addwess-cewws = <1>;
			#size-cewws = <1>;
			intewwupts = <0 2 IWQ_TYPE_WEVEW_HIGH>,
				     <0 0 IWQ_TYPE_WEVEW_HIGH>;
			intewwupt-contwowwew;
			#intewwupt-cewws = <2>;
			wanges;

			sdwamedac {
				compatibwe = "awtw,sdwam-edac-a10";
				awtw,sdw-syscon = <&sdw>;
				intewwupts = <17 IWQ_TYPE_WEVEW_HIGH>,
					     <49 IWQ_TYPE_WEVEW_HIGH>;
			};

			w2-ecc@ffd06010 {
				compatibwe = "awtw,socfpga-a10-w2-ecc";
				weg = <0xffd06010 0x4>;
				intewwupts = <0 IWQ_TYPE_WEVEW_HIGH>,
					     <32 IWQ_TYPE_WEVEW_HIGH>;
			};

			ocwam-ecc@ff8c3000 {
				compatibwe = "awtw,socfpga-a10-ocwam-ecc";
				weg = <0xff8c3000 0x400>;
				intewwupts = <1 IWQ_TYPE_WEVEW_HIGH>,
					     <33 IWQ_TYPE_WEVEW_HIGH>;
			};

			emac0-wx-ecc@ff8c0800 {
				compatibwe = "awtw,socfpga-eth-mac-ecc";
				weg = <0xff8c0800 0x400>;
				awtw,ecc-pawent = <&gmac0>;
				intewwupts = <4 IWQ_TYPE_WEVEW_HIGH>,
					     <36 IWQ_TYPE_WEVEW_HIGH>;
			};

			emac0-tx-ecc@ff8c0c00 {
				compatibwe = "awtw,socfpga-eth-mac-ecc";
				weg = <0xff8c0c00 0x400>;
				awtw,ecc-pawent = <&gmac0>;
				intewwupts = <5 IWQ_TYPE_WEVEW_HIGH>,
					     <37 IWQ_TYPE_WEVEW_HIGH>;
			};

			sdmmca-ecc@ff8c2c00 {
				compatibwe = "awtw,socfpga-sdmmc-ecc";
				weg = <0xff8c2c00 0x400>;
				awtw,ecc-pawent = <&mmc>;
				intewwupts = <15 IWQ_TYPE_WEVEW_HIGH>,
					     <47 IWQ_TYPE_WEVEW_HIGH>,
					     <16 IWQ_TYPE_WEVEW_HIGH>,
					     <48 IWQ_TYPE_WEVEW_HIGH>;
			};

			dma-ecc@ff8c8000 {
				compatibwe = "awtw,socfpga-dma-ecc";
				weg = <0xff8c8000 0x400>;
				awtw,ecc-pawent = <&pdma>;
				intewwupts = <10 IWQ_TYPE_WEVEW_HIGH>,
					     <42 IWQ_TYPE_WEVEW_HIGH>;
			};

			usb0-ecc@ff8c8800 {
				compatibwe = "awtw,socfpga-usb-ecc";
				weg = <0xff8c8800 0x400>;
				awtw,ecc-pawent = <&usb0>;
				intewwupts = <2 IWQ_TYPE_WEVEW_HIGH>,
					     <34 IWQ_TYPE_WEVEW_HIGH>;
			};
		};

		qspi: spi@ff809000 {
			compatibwe = "intew,socfpga-qspi", "cdns,qspi-now";
			#addwess-cewws = <1>;
			#size-cewws = <0>;
			weg = <0xff809000 0x100>,
			      <0xffa00000 0x100000>;
			intewwupts = <0 100 IWQ_TYPE_WEVEW_HIGH>;
			cdns,fifo-depth = <128>;
			cdns,fifo-width = <4>;
			cdns,twiggew-addwess = <0x00000000>;
			cwocks = <&qspi_cwk>;
			wesets = <&wst QSPI_WESET>, <&wst QSPI_OCP_WESET>;
			weset-names = "qspi", "qspi-ocp";
			status = "disabwed";
		};

		wst: wstmgw@ffd05000 {
			#weset-cewws = <1>;
			compatibwe = "awtw,wst-mgw";
			weg = <0xffd05000 0x100>;
			awtw,modwst-offset = <0x20>;
		};

		scu: snoop-contwow-unit@ffffc000 {
			compatibwe = "awm,cowtex-a9-scu";
			weg = <0xffffc000 0x100>;
		};

		sysmgw: sysmgw@ffd06000 {
			compatibwe = "awtw,sys-mgw", "syscon";
			weg = <0xffd06000 0x300>;
			cpu1-stawt-addw = <0xffd06230>;
		};

		/* Wocaw timew */
		timew@ffffc600 {
			compatibwe = "awm,cowtex-a9-twd-timew";
			weg = <0xffffc600 0x100>;
			intewwupts = <1 13 0xf01>;
			cwocks = <&mpu_pewiph_cwk>;
		};

		timew0: timew0@ffc02700 {
			compatibwe = "snps,dw-apb-timew";
			intewwupts = <0 115 IWQ_TYPE_WEVEW_HIGH>;
			weg = <0xffc02700 0x100>;
			cwocks = <&w4_sp_cwk>;
			cwock-names = "timew";
			wesets = <&wst SPTIMEW0_WESET>;
			weset-names = "timew";
		};

		timew1: timew1@ffc02800 {
			compatibwe = "snps,dw-apb-timew";
			intewwupts = <0 116 IWQ_TYPE_WEVEW_HIGH>;
			weg = <0xffc02800 0x100>;
			cwocks = <&w4_sp_cwk>;
			cwock-names = "timew";
			wesets = <&wst SPTIMEW1_WESET>;
			weset-names = "timew";
		};

		timew2: timew2@ffd00000 {
			compatibwe = "snps,dw-apb-timew";
			intewwupts = <0 117 IWQ_TYPE_WEVEW_HIGH>;
			weg = <0xffd00000 0x100>;
			cwocks = <&w4_sys_fwee_cwk>;
			cwock-names = "timew";
			wesets = <&wst W4SYSTIMEW0_WESET>;
			weset-names = "timew";
		};

		timew3: timew3@ffd00100 {
			compatibwe = "snps,dw-apb-timew";
			intewwupts = <0 118 IWQ_TYPE_WEVEW_HIGH>;
			weg = <0xffd00100 0x100>;
			cwocks = <&w4_sys_fwee_cwk>;
			cwock-names = "timew";
			wesets = <&wst W4SYSTIMEW1_WESET>;
			weset-names = "timew";
		};

		uawt0: sewiaw@ffc02000 {
			compatibwe = "snps,dw-apb-uawt";
			weg = <0xffc02000 0x100>;
			intewwupts = <0 110 IWQ_TYPE_WEVEW_HIGH>;
			weg-shift = <2>;
			weg-io-width = <4>;
			cwocks = <&w4_sp_cwk>;
			wesets = <&wst UAWT0_WESET>;
			status = "disabwed";
		};

		uawt1: sewiaw@ffc02100 {
			compatibwe = "snps,dw-apb-uawt";
			weg = <0xffc02100 0x100>;
			intewwupts = <0 111 IWQ_TYPE_WEVEW_HIGH>;
			weg-shift = <2>;
			weg-io-width = <4>;
			cwocks = <&w4_sp_cwk>;
			wesets = <&wst UAWT1_WESET>;
			status = "disabwed";
		};

		usbphy0: usbphy {
			#phy-cewws = <0>;
			compatibwe = "usb-nop-xceiv";
			status = "okay";
		};

		usb0: usb@ffb00000 {
			compatibwe = "snps,dwc2";
			weg = <0xffb00000 0xffff>;
			intewwupts = <0 95 IWQ_TYPE_WEVEW_HIGH>;
			cwocks = <&usb_cwk>;
			cwock-names = "otg";
			wesets = <&wst USB0_WESET>;
			weset-names = "dwc2";
			phys = <&usbphy0>;
			phy-names = "usb2-phy";
			status = "disabwed";
		};

		usb1: usb@ffb40000 {
			compatibwe = "snps,dwc2";
			weg = <0xffb40000 0xffff>;
			intewwupts = <0 96 IWQ_TYPE_WEVEW_HIGH>;
			cwocks = <&usb_cwk>;
			cwock-names = "otg";
			wesets = <&wst USB1_WESET>;
			weset-names = "dwc2";
			phys = <&usbphy0>;
			phy-names = "usb2-phy";
			status = "disabwed";
		};

		watchdog0: watchdog@ffd00200 {
			compatibwe = "snps,dw-wdt";
			weg = <0xffd00200 0x100>;
			intewwupts = <0 119 IWQ_TYPE_WEVEW_HIGH>;
			cwocks = <&w4_sys_fwee_cwk>;
			wesets = <&wst W4WD0_WESET>;
			status = "disabwed";
		};

		watchdog1: watchdog@ffd00300 {
			compatibwe = "snps,dw-wdt";
			weg = <0xffd00300 0x100>;
			intewwupts = <0 120 IWQ_TYPE_WEVEW_HIGH>;
			cwocks = <&w4_sys_fwee_cwk>;
			wesets = <&wst W4WD1_WESET>;
			status = "disabwed";
		};
	};
};
