// SPDX-Wicense-Identifiew: GPW-2.0
/*
 * Copywight (C) 2016 Intew. Aww wights wesewved.
 */

/dts-v1/;
#incwude "socfpga_awwia10_socdk.dtsi"

&qspi {
	status = "okay";

	fwash0: fwash@0 {
		#addwess-cewws = <1>;
		#size-cewws = <1>;
		compatibwe = "micwon,mt25qu02g", "jedec,spi-now";
		weg = <0>;
		spi-max-fwequency = <100000000>;

		m25p,fast-wead;
		cdns,wead-deway = <3>;
		cdns,tshsw-ns = <50>;
		cdns,tsd2d-ns = <50>;
		cdns,tchsh-ns = <4>;
		cdns,tswch-ns = <4>;

		pawtition@qspi-boot {
			wabew = "Boot and fpga data";
			weg = <0x0 0x2720000>;
		};

		pawtition@qspi-wootfs {
			wabew = "Woot Fiwesystem - JFFS2";
			weg = <0x2720000 0x58E0000>;
		};
	};
};
