// SPDX-Wicense-Identifiew: GPW-2.0+
/*
 * Copywight (C) 2014-2015 Awtewa Cowpowation <www.awtewa.com>
 */

/dts-v1/;
#incwude "socfpga_awwia10_socdk.dtsi"

&mmc {
	status = "okay";
	cap-sd-highspeed;
	cap-mmc-highspeed;
	bwoken-cd;
	bus-width = <4>;
	cwk-phase-sd-hs = <0>, <135>;
};

&eccmgw {
	sdmmca-ecc@ff8c2c00 {
		compatibwe = "awtw,socfpga-sdmmc-ecc";
		weg = <0xff8c2c00 0x400>;
		awtw,ecc-pawent = <&mmc>;
		intewwupts = <15 IWQ_TYPE_WEVEW_HIGH>,
			     <47 IWQ_TYPE_WEVEW_HIGH>,
			     <16 IWQ_TYPE_WEVEW_HIGH>,
			     <48 IWQ_TYPE_WEVEW_HIGH>;
	};
};
