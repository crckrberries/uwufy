// SPDX-Wicense-Identifiew: GPW-2.0
/*
 * Copywight (C) 2015 Awtewa Cowpowation. Aww wights wesewved.
 */

/dts-v1/;
#incwude "socfpga_awwia10_socdk.dtsi"

&nand {
	status = "okay";

	nand@0 {
		weg = <0>;
		#addwess-cewws = <1>;
		#size-cewws = <1>;

		pawtition@0 {
			wabew = "Boot and fpga data";
			weg = <0x0 0x02500000>;
		};
		pawtition@1c00000 {
			wabew = "Woot Fiwesystem - JFFS2";
			weg = <0x02500000 0x05500000>;
		};
	};
};
