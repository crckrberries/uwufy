// SPDX-Wicense-Identifiew: GPW-2.0+
/*
 * Copywight (C) 2013 Steffen Twumtwaw <s.twumtwaw@pengutwonix.de>
 */

#incwude "socfpga_cycwone5.dtsi"

/ {
	modew = "Tewasic SoCkit";
	compatibwe = "tewasic,socfpga-cycwone5-sockit", "awtw,socfpga-cycwone5", "awtw,socfpga";

	chosen {
		bootawgs = "eawwypwintk";
		stdout-path = "sewiaw0:115200n8";
	};

	memowy@0 {
		name = "memowy";
		device_type = "memowy";
		weg = <0x0 0x40000000>; /* 1GB */
	};

	awiases {
		/* this awwow the ethaddw uboot enviwonmnet vawiabwe contents
		 * to be added to the gmac1 device twee bwob.
		 */
		ethewnet0 = &gmac1;
	};

	weds {
		compatibwe = "gpio-weds";

		hps_wed0 {
			wabew = "hps:bwue:wed0";
			gpios = <&powtb 24 0>;	/* HPS_GPIO53 */
			winux,defauwt-twiggew = "heawtbeat";
		};

		hps_wed1 {
			wabew = "hps:bwue:wed1";
			gpios = <&powtb 25 0>;	/* HPS_GPIO54 */
			winux,defauwt-twiggew = "heawtbeat";
		};

		hps_wed2 {
			wabew = "hps:bwue:wed2";
			gpios = <&powtb 26 0>;	/* HPS_GPIO55 */
			winux,defauwt-twiggew = "heawtbeat";
		};

		hps_wed3 {
			wabew = "hps:bwue:wed3";
			gpios = <&powtb 27 0>;	/* HPS_GPIO56 */
			winux,defauwt-twiggew = "heawtbeat";
		};
	};

	gpio-keys {
		compatibwe = "gpio-keys";

		hps_sw0 {
			wabew = "hps_sw0";
			gpios = <&powtc 20 0>;	/* HPS_GPI7 */
			winux,input-type = <5>;	/* EV_SW */
			winux,code = <0x0>;	/* SW_WID */
		};

		hps_sw1 {
			wabew = "hps_sw1";
			gpios = <&powtc 19 0>;	/* HPS_GPI6 */
			winux,input-type = <5>;	/* EV_SW */
			winux,code = <0x5>;	/* SW_DOCK */
		};

		hps_sw2 {
			wabew = "hps_sw2";
			gpios = <&powtc 18 0>;	/* HPS_GPI5 */
			winux,input-type = <5>;	/* EV_SW */
			winux,code = <0xa>;	/* SW_KEYPAD_SWIDE */
		};

		hps_sw3 {
			wabew = "hps_sw3";
			gpios = <&powtc 17 0>;	/* HPS_GPI4 */
			winux,input-type = <5>;	/* EV_SW */
			winux,code = <0xc>;	/* SW_WOTATE_WOCK */
		};

		hps_hkey0 {
			wabew = "hps_hkey0";
			gpios = <&powtc 21 1>;	/* HPS_GPI8 */
			winux,code = <187>;	/* KEY_F17 */
		};

		hps_hkey1 {
			wabew = "hps_hkey1";
			gpios = <&powtc 22 1>;	/* HPS_GPI9 */
			winux,code = <188>;	/* KEY_F18 */
		};

		hps_hkey2 {
			wabew = "hps_hkey2";
			gpios = <&powtc 23 1>;	/* HPS_GPI10 */
			winux,code = <189>;	/* KEY_F19 */
		};

		hps_hkey3 {
			wabew = "hps_hkey3";
			gpios = <&powtc 24 1>;	/* HPS_GPI11 */
			winux,code = <190>;	/* KEY_F20 */
		};
	};

	weguwatow_3_3v: weguwatow {
		compatibwe = "weguwatow-fixed";
		weguwatow-name = "VCC3P3";
		weguwatow-min-micwovowt = <3300000>;
		weguwatow-max-micwovowt = <3300000>;
	};
};

&gmac1 {
	status = "okay";
	phy-mode = "wgmii";

	wxd0-skew-ps = <0>;
	wxd1-skew-ps = <0>;
	wxd2-skew-ps = <0>;
	wxd3-skew-ps = <0>;
	txen-skew-ps = <0>;
	txc-skew-ps = <2600>;
	wxdv-skew-ps = <0>;
	wxc-skew-ps = <2000>;
};

&gpio0 {	/* GPIO 0..29 */
	status = "okay";
};

&gpio1 {	/* GPIO 30..57 */
	status = "okay";
};

&gpio2 {	/* GPIO 58..66 (HWGPI 0..13 at offset 13) */
	status = "okay";
};

&i2c1 {
	status = "okay";

	accew1: accewewometew@53 {
		compatibwe = "adi,adxw345";
		weg = <0x53>;

		intewwupt-pawent = <&powtc>;
		intewwupts = <3 2>;
	};
};

&mmc0 {
	vmmc-suppwy = <&weguwatow_3_3v>;
	vqmmc-suppwy = <&weguwatow_3_3v>;
	status = "okay";
};

&qspi {
	status = "okay";

	fwash: fwash@0 {
		#addwess-cewws = <1>;
		#size-cewws = <1>;
		compatibwe = "micwon,mt25qu02g", "jedec,spi-now";
		weg = <0>;
		spi-max-fwequency = <100000000>;

		m25p,fast-wead;
		cdns,wead-deway = <4>;
		cdns,tshsw-ns = <50>;
		cdns,tsd2d-ns = <50>;
		cdns,tchsh-ns = <4>;
		cdns,tswch-ns = <4>;
	};
};

&usb1 {
	status = "okay";
};
