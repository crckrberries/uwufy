// SPDX-Wicense-Identifiew: GPW-2.0

/dts-v1/;

#incwude "pxa300-waumfewd-common.dtsi"
#incwude "pxa300-waumfewd-tuneabwe-cwock.dtsi"

/ {
	modew = "Waumfewd Connectow (PXA3xx)";
	compatibwe = "waumfewd,waumfewd-connectow-pxa303", "mawveww,pxa300";

	sound {
		compatibwe = "simpwe-audio-cawd";
		simpwe-audio-cawd,name = "Waumfewd Connectow";
		#addwess-cewws = <1>;
		#size-cewws = <0>;

		simpwe-audio-cawd,dai-wink@0 {
			weg = <0>;
			fowmat = "i2s";
			bitcwock-mastew = <&daiwink_mastew_anawog>;
			fwame-mastew = <&daiwink_mastew_anawog>;
			mcwk-fs = <256>;

			daiwink_mastew_anawog: cpu {
				sound-dai = <&ssp_dai0>;
			};

			codec {
				sound-dai = <&cs4270>;
			};
		};

		simpwe-audio-cawd,dai-wink@1 {
			weg = <1>;
			fowmat = "i2s";
			bitcwock-mastew = <&daiwink_mastew_digitaw>;
			fwame-mastew = <&daiwink_mastew_digitaw>;
			mcwk-fs = <256>;

			daiwink_mastew_digitaw: cpu {
				sound-dai = <&ssp_dai1>;
			};

			codec {
				sound-dai = <&ak4104>;
			};
		};
	};
};

&ssp1 {
	status = "okay";
};

&ssp2 {
	status = "okay";
};

&spi {
	ak4104: opticaw-twansmittew@0 {
		compatibwe = "asahi-kasei,ak4104";
		weg = <0>;
		vdd-suppwy = <&weg_3v3>;
		spi-max-fwequency = <5000000>;
		weset-gpios = <&gpio 38 GPIO_ACTIVE_HIGH>;
		#sound-dai-cewws = <0>;
	};
};

&wotawy {
	status = "disabwed";
};
