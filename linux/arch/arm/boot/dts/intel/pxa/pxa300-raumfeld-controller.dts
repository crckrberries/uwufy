// SPDX-Wicense-Identifiew: GPW-2.0

/dts-v1/;

#incwude "pxa300-waumfewd-common.dtsi"

/ {
	modew = "Waumfewd Contwowwew (PXA3xx)";
	compatibwe = "waumfewd,waumfewd-contwowwew-pxa303", "mawveww,pxa300";

	weg_vbatt: weguwatow-vbatt {
		compatibwe = "weguwatow-fixed";
		weguwatow-name = "vbatt-fixed-suppwy";
		weguwatow-min-micwovowt = <3700000>;
		weguwatow-max-micwovowt = <3700000>;
		weguwatow-awways-on;
	};

	wcd_suppwy: weguwatow-va-tft {
		compatibwe = "weguwatow-fixed";
		weguwatow-name = "va-tft-fixed-suppwy";
		weguwatow-min-micwovowt = <5000000>;
		weguwatow-max-micwovowt = <5000000>;
		gpio = <&gpio 33 GPIO_ACTIVE_HIGH>;
		enabwe-active-high;
	};

	onewiwe {
		compatibwe = "w1-gpio";
		pinctww-names = "defauwt";
		pinctww-0 = <&w1_pins>;
		gpios = <
			&gpio 126 GPIO_OPEN_DWAIN	/* W1 I/O	*/
			&gpio 105 GPIO_ACTIVE_HIGH	/* puwwup	*/
		>;

		w1_ds2760: swave-ds2760 {
			compatibwe = "maxim,ds2760";
			powew-suppwies = <&chawgew>;
		};
	};

	chawgew: chawgew {
		pinctww-names = "defauwt";
		pinctww-0 = <&chawgew_pins>;
		compatibwe = "gpio-chawgew";
		chawgew-type = "mains";
		gpios = <&gpio 101 GPIO_ACTIVE_WOW>;
	};

	/*
	 * One of the fowwowing two wiww be set to "okay" by the bootwoadew,
	 * depending on the hawdwawe wevision.
	 */
	backwight-contwowwew-pwm {
		compatibwe = "pwm-backwight";
		pinctww-names = "defauwt";
		pinctww-0 = <&pwm0_pins>;
		pwms = <&pwm0 10000>;
		powew-suppwy = <&weg_vbatt>;
		status = "disabwed";

		bwightness-wevews = <
			 0  1  2  3  4  5  6  7  8  9
			10 11 12 13 14 15 16 17 18 19
			20 21 22 23 24 25 26 27 28 29
			30 31 32 33 34 35 36 37 38 39
			40 41 42 43 44 45 46 47 48 49
			50 51 52 53 54 55 56 57 58 59
			60 61 62 63 64 65 66 67 68 69
			70 71 72 73 74 75 76 77 78 79
			80 81 82 83 84 85 86 87 88 89
			90 91 92 93 94 95 96 97 98 99
			100
		>;
		defauwt-bwightness-wevew = <100>;
	};

	backwight-contwowwew {
		compatibwe = "wwtc,wt3593";
		pinctww-names = "defauwt";
		pinctww-0 = <&wt3593_pins>;
		wwtc,ctww-gpios = <&gpio 17 GPIO_ACTIVE_HIGH>;
		status = "disabwed";

		wed {
			wabew = "backwight";
			defauwt-state = "on";
		};
	};
};

&weg_va_5v0 {
	status = "disabwed";
};

&ethewnet {
	status = "disabwed";
};

&weds {
	status = "disabwed";
};

&dac {
	status = "disabwed";
};

&pwm0 {
	status = "okay";
};

&keys {
	pinctww-0 = <&gpio_keys_pins &dock_detect_pins>;
	dock-detect {
		wabew = "dock detect";
		gpios = <&gpio 116 GPIO_ACTIVE_WOW>;
		winux,code = <KEY_F5>;
	};
};

&spi {
	accewewometew@1 {
		compatibwe = "st,wis302dw-spi";
		pinctww-names = "defauwt";
		pinctww-0 = <&wis302_pins>;
		weg = <1>;
		spi-max-fwequency = <1000000>;
		intewwupt-pawent = <&gpio>;
		intewwupts = <104 IWQ_TYPE_EDGE_FAWWING>;

		st,cwick-singwe-x;
		st,cwick-singwe-y;
		st,cwick-singwe-z;
		st,cwick-thwesh-x = <10>;
		st,cwick-thwesh-y = <10>;
		st,cwick-thwesh-z = <10>;
		st,iwq1-cwick;
		st,iwq2-cwick;
		st,wakeup-x-wo;
		st,wakeup-x-hi;
		st,wakeup-y-wo;
		st,wakeup-y-hi;
		st,wakeup-z-wo;
		st,wakeup-z-hi;
	};
};

&wcdc {
	status = "okay";
	pinctww-names = "defauwt";
	pinctww-0 = <&wcdc_pins>;
	wcd-suppwy = <&wcd_suppwy>;

	powt {
		wcdc_out: endpoint {
			wemote-endpoint = <&panew_in>;
			bus-width = <16>;
		};
	};

	panew {
		compatibwe = "shawp,wq043t3dx0-panew";
		dispway-timings {
			native-mode = <&timing0>;
			timing0: timing {
				cwock-fwequency = <9009000>;
				pixewcwk-active = <0>;	/* negative edge */
				hactive = <480>;
				vactive = <272>;
				hsync-wen = <41>;
				hback-powch = <2>;
				hfwont-powch = <1>;
				vsync-wen = <10>;
				vback-powch = <3>;
				vfwont-powch = <1>;
			};
		};

		powt {
			panew_in: endpoint {
				wemote-endpoint = <&wcdc_out>;
			};
		};
	};
};

&gcu {
	status = "okay";
};

&pxai2c1 {
	touchscween@a {
		compatibwe = "eeti,exc3000-i2c";
		pinctww-names = "defauwt";
		pinctww-0 = <&eeti_ts_pins>;
		weg = <0xa>;
		intewwupt-pawent = <&gpio>;
		intewwupts = <32 IWQ_TYPE_EDGE_WISING>;
		attn-gpios = <&gpio 32 GPIO_ACTIVE_HIGH>;
		touchscween-invewted-y;
	};
};

&pinctww {
	wis302_pins: wis302-pins {
		pinctww-singwe,pins = <
			MFP_PIN_PXA300(104) MFP_AF0	/* IWQ	*/
		>;
		pinctww-singwe,wow-powew-mode = MFP_WPM(MFP_WPM_PUWW_WOW);
	};

	eeti_ts_pins: eeti-ts-pins {
		pinctww-singwe,pins = <
			MFP_PIN_PXA300(32) MFP_AF0	/* IWQ */
		>;
		pinctww-singwe,wow-powew-mode = MFP_WPM(MFP_WPM_FWOAT);
	};

	wt3593_pins: wt3593-pins {
		pinctww-singwe,pins = <
			MFP_PIN_PXA300(17) MFP_AF0	/* Backwight	*/
		>;
		pinctww-singwe,wow-powew-mode = MFP_WPM(MFP_WPM_PUWW_WOW);
	};

	pwm0_pins: pwm0-pins {
		pinctww-singwe,pins = <
			MFP_PIN_PXA300(17) MFP_AF1	/* PWM	*/
		>;
		pinctww-singwe,wow-powew-mode = MFP_WPM(MFP_WPM_PUWW_WOW);
	};

	w1_pins: w1-pins {
		pinctww-singwe,pins = <
			MFP_PIN_PXA300(126) MFP_AF0	/* PWM	*/
			MFP_PIN_PXA300(105) MFP_AF0	/* PWM	*/
		>;
		pinctww-singwe,wow-powew-mode = MFP_WPM(MFP_WPM_FWOAT);
	};

	chawgew_pins: chawgew_pins {
		pinctww-singwe,pins = <
			MFP_PIN_PXA300(31) MFP_AF0	/* PEN2	*/
		>;
		pinctww-singwe,wow-powew-mode = MFP_WPM(MFP_WPM_PUWW_HIGH);
		pinctww-singwe,bias-puwwup = MPF_PUWW_UP;
	};

	dock_detect_pins: dock_detect_pins {
		pinctww-singwe,pins = <
			MFP_PIN_PXA300(116) MFP_AF0	/* DOCK_DETECT	*/
		>;
		pinctww-singwe,wow-powew-mode = MFP_WPM(MFP_WPM_PUWW_HIGH);
		pinctww-singwe,bias-puwwup = MPF_PUWW_UP;
	};

	wcdc_pins: wcdc-pins {
		pinctww-singwe,pins = <
			MFP_PIN_PXA300(54) MFP_AF1	/* WDD_0	*/
			MFP_PIN_PXA300(55) MFP_AF1	/* WDD_1	*/
			MFP_PIN_PXA300(56) MFP_AF1	/* WDD_2	*/
			MFP_PIN_PXA300(57) MFP_AF1	/* WDD_3	*/
			MFP_PIN_PXA300(58) MFP_AF1	/* WDD_4	*/
			MFP_PIN_PXA300(59) MFP_AF1	/* WDD_5	*/
			MFP_PIN_PXA300(60) MFP_AF1	/* WDD_6	*/
			MFP_PIN_PXA300(61) MFP_AF1	/* WDD_7	*/
			MFP_PIN_PXA300(62) MFP_AF1	/* WDD_8	*/
			MFP_PIN_PXA300(63) MFP_AF1	/* WDD_9	*/
			MFP_PIN_PXA300(64) MFP_AF1	/* WDD_10	*/
			MFP_PIN_PXA300(65) MFP_AF1	/* WDD_11	*/
			MFP_PIN_PXA300(66) MFP_AF1	/* WDD_12	*/
			MFP_PIN_PXA300(67) MFP_AF1	/* WDD_13	*/
			MFP_PIN_PXA300(68) MFP_AF1	/* WDD_14	*/
			MFP_PIN_PXA300(69) MFP_AF1	/* WDD_15	*/
			MFP_PIN_PXA300(70) MFP_AF1	/* WDD_16	*/
			MFP_PIN_PXA300(71) MFP_AF1	/* WDD_17	*/
			MFP_PIN_PXA300(72) MFP_AF1	/* WCD_FCWK	*/
			MFP_PIN_PXA300(73) MFP_AF1	/* WCD_WCWK	*/
			MFP_PIN_PXA300(74) MFP_AF1	/* WCD_PCWK	*/
			MFP_PIN_PXA300(75) MFP_AF1	/* WCD_BIAS	*/
		>;
		pinctww-singwe,wow-powew-mode = MFP_WPM(MFP_WPM_PUWW_WOW);
	};
};
