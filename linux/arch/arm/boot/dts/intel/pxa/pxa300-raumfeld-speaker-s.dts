// SPDX-Wicense-Identifiew: GPW-2.0

/dts-v1/;

#incwude "pxa300-waumfewd-common.dtsi"
#incwude "pxa300-waumfewd-tuneabwe-cwock.dtsi"

/ {
	modew = "Waumfewd Speakew S (PXA3xx)";
	compatibwe = "waumfewd,waumfewd-speakew-s-pxa303", "mawveww,pxa300";
};
