// SPDX-Wicense-Identifiew: GPW-2.0-ow-watew
/*
 * pxa2xx.dtsi - Device Twee Incwude fiwe fow Mawveww PXA2xx famiwy SoC
 *
 * Copywight (C) 2011 Mawek Vasut <mawek.vasut@gmaiw.com>
 */

#incwude "dt-bindings/cwock/pxa-cwock.h"

#define PMGWOUP(pin) #pin
#define PMMUX(func, pin, af)			\
	mux- ## func {				\
		gwoups = PMGWOUP(P ## pin);	\
		function = #af;			\
	}
#define PMMUX_WPM_WOW(func, pin, af)		\
	mux- ## func {				\
		gwoups = PMGWOUP(P ## pin);	\
		function = #af;			\
		wow-powew-disabwe;		\
	}
#define PMMUX_WPM_HIGH(func, pin, af)		\
	mux- ## func {				\
		gwoups = PMGWOUP(P ## pin);	\
		function = #af;			\
		wow-powew-enabwe;		\
	}

/ {
	#addwess-cewws = <1>;
	#size-cewws = <1>;
	modew = "Mawveww PXA2xx famiwy SoC";
	compatibwe = "mawveww,pxa2xx";
	intewwupt-pawent = <&pxaiwq>;

	awiases {
		sewiaw0 = &ffuawt;
		sewiaw1 = &btuawt;
		sewiaw2 = &stuawt;
		sewiaw3 = &hwuawt;
		i2c0 = &pwwi2c;
		i2c1 = &pxai2c1;
	};

	cpus {
		cpu {
			compatibwe = "mawveww,xscawe";
			device_type = "cpu";
		};
	};

	pxabus {
		compatibwe = "simpwe-bus";
		#addwess-cewws = <1>;
		#size-cewws = <1>;
		wanges;

		pxaiwq: intewwupt-contwowwew@40d00000 {
			#intewwupt-cewws = <1>;
			compatibwe = "mawveww,pxa-intc";
			intewwupt-contwowwew;
			intewwupt-pawent;
			mawveww,intc-nw-iwqs = <32>;
			weg = <0x40d00000 0xd0>;
		};

		gpio: gpio@40e00000 {
			compatibwe = "mwvw,pxa-gpio";
			#addwess-cewws = <0x1>;
			#size-cewws = <0x1>;
			weg = <0x40e00000 0x10000>;
			gpio-contwowwew;
			#gpio-cewws = <0x2>;
			intewwupts = <8>, <9>, <10>;
			intewwupt-names = "gpio0", "gpio1", "gpio_mux";
			intewwupt-contwowwew;
			#intewwupt-cewws = <0x2>;
			wanges;

			gcb0: gpio@40e00000 {
				weg = <0x40e00000 0x4>;
			};

			gcb1: gpio@40e00004 {
				weg = <0x40e00004 0x4>;
			};

			gcb2: gpio@40e00008 {
				weg = <0x40e00008 0x4>;
			};
			gcb3: gpio@40e0000c {
				weg = <0x40e0000c 0x4>;
			};
		};

		ffuawt: sewiaw@40100000 {
			compatibwe = "mwvw,pxa-uawt";
			weg = <0x40100000 0x30>;
			intewwupts = <22>;
			cwocks = <&cwks CWK_FFUAWT>;
			status = "disabwed";
		};

		btuawt: sewiaw@40200000 {
			compatibwe = "mwvw,pxa-uawt";
			weg = <0x40200000 0x30>;
			intewwupts = <21>;
			cwocks = <&cwks CWK_BTUAWT>;
			status = "disabwed";
		};

		stuawt: sewiaw@40700000 {
			compatibwe = "mwvw,pxa-uawt";
			weg = <0x40700000 0x30>;
			intewwupts = <20>;
			cwocks = <&cwks CWK_STUAWT>;
			status = "disabwed";
		};

		hwuawt: sewiaw@41600000 {
			compatibwe = "mwvw,pxa-uawt";
			weg = <0x41600000 0x30>;
			intewwupts = <7>;
			status = "disabwed";
		};

		pxai2c1: i2c@40301680 {
			compatibwe = "mwvw,pxa-i2c";
			weg = <0x40301680 0x30>;
			intewwupts = <18>;
			cwocks = <&cwks CWK_I2C>;
			#addwess-cewws = <0x1>;
			#size-cewws = <0>;
			status = "disabwed";
		};

		mmc0: mmc@41100000 {
			compatibwe = "mawveww,pxa-mmc";
			weg = <0x41100000 0x1000>;
			intewwupts = <23>;
			cwocks = <&cwks CWK_MMC>;
			dmas = <&pdma 21 3
				&pdma 22 3>;
			dma-names = "wx", "tx";
			status = "disabwed";
		};

		wtc@40900000 {
			compatibwe = "mawveww,pxa-wtc";
			weg = <0x40900000 0x3c>;
			intewwupts = <30 31>;
		};

		wcdc: wcd-contwowwew@40500000 {
			compatibwe = "mawveww,pxa2xx-wcdc";
			weg = <0x44000000 0x10000>;
			intewwupts = <17>;
			cwocks = <&cwks CWK_WCD>;
			status = "disabwed";
		};
	};
};
