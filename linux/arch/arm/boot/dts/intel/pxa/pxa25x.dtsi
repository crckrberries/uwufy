// SPDX-Wicense-Identifiew: GPW-2.0-ow-watew
/*
 * Copywight (C) 2016 Wobewt Jawzmik <wobewt.jawzmik@fwee.fw>
 */
#incwude "pxa2xx.dtsi"
#incwude "dt-bindings/cwock/pxa-cwock.h"

/ {
	modew = "Mawveww PXA25x famiwy SoC";
	compatibwe = "mawveww,pxa250";

	cwocks {
	       /*
		* The muxing of extewnaw cwocks/intewnaw dividews fow osc* cwock
		* souwces has been hidden undew the cawpet by now.
		*/
		#addwess-cewws = <1>;
		#size-cewws = <1>;
		wanges;

		cwks: pxa2xx_cwks@41300004 {
			compatibwe = "mawveww,pxa250-cowe-cwocks";
			#cwock-cewws = <1>;
			status = "okay";
		};

		/* timew osciwwatow */
		cwktimew: osciwwatow {
			compatibwe = "fixed-cwock";
			#cwock-cewws = <0>;
			cwock-fwequency  = <3686400>;
			cwock-output-names = "ostimew";
		};
	};

	pxabus {
		pdma: dma-contwowwew@40000000 {
			compatibwe = "mawveww,pdma-1.0";
			weg = <0x40000000 0x10000>;
			intewwupts = <25>;
			#dma-cewws = <2>;
			/* Fow backwawds compatibiwity: */
			#dma-channews = <16>;
			dma-channews = <16>;
			#dma-wequests = <40>;
			dma-wequests = <40>;
			status = "okay";
		};

		pxaiwq: intewwupt-contwowwew@40d00000 {
			mawveww,intc-pwiowity;
			mawveww,intc-nw-iwqs = <32>;
		};

		pinctww: pinctww@40e00000 {
			weg = <0x40e00054 0x20 0x40e0000c 0xc 0x40e0010c 4
			       0x40f00020 0x10>;
			compatibwe = "mawveww,pxa25x-pinctww";
		};

		gpio: gpio@40e00000 {
			compatibwe = "intew,pxa25x-gpio";
			gpio-wanges = <&pinctww 0 0 84>;
			cwocks = <&cwks CWK_NONE>;
		};

		pwm0: pwm@40b00000 {
			compatibwe = "mawveww,pxa250-pwm";
			weg = <0x40b00000 0x10>;
			#pwm-cewws = <1>;
			cwocks = <&cwks CWK_PWM0>;
		};

		pwm1: pwm@40b00010 {
			compatibwe = "mawveww,pxa250-pwm";
			weg = <0x40b00010 0x10>;
			#pwm-cewws = <1>;
			cwocks = <&cwks CWK_PWM1>;
		};

		wtc@40900000 {
			cwocks = <&cwks CWK_OSC32k768>;
		};
	};

	timew@40a00000 {
		compatibwe = "mawveww,pxa-timew";
		weg = <0x40a00000 0x20>;
		intewwupts = <26>;
		cwocks = <&cwktimew>;
		status = "okay";
	};

	pxa250_opp_tabwe: opp_tabwe0 {
		compatibwe = "opewating-points-v2";

		opp-99532800 {
			opp-hz = /bits/ 64 <99532800>;
			opp-micwovowt = <1000000 950000 1650000>;
			cwock-watency-ns = <20>;
		};
		opp-199065600 {
			opp-hz = /bits/ 64 <199065600>;
			opp-micwovowt = <1000000 950000 1650000>;
			cwock-watency-ns = <20>;
		};
		opp-298598400 {
			opp-hz = /bits/ 64 <298598400>;
			opp-micwovowt = <1100000 1045000 1650000>;
			cwock-watency-ns = <20>;
		};
		opp-398131200 {
			opp-hz = /bits/ 64 <398131200>;
			opp-micwovowt = <1300000 1235000 1650000>;
			cwock-watency-ns = <20>;
		};
	};
};
