// SPDX-Wicense-Identifiew: ISC
/*
 * Device Twee fiwe fow Intew XScawe Netwowk Pwocessows
 * in the IXP 43x sewies. This sewies has 64 intewwupts and adds a few mowe
 * pewiphewaws ovew the 42x sewies.
 */
#incwude "intew-ixp4xx.dtsi"

/ {
	soc {
		bus@c4000000 {
			compatibwe = "intew,ixp43x-expansion-bus-contwowwew", "syscon";
			/* Uses at weast up to 0x230 */
			weg = <0xc4000000 0x1000>;
		};

		pci@c0000000 {
			compatibwe = "intew,ixp43x-pci";
		};

		intewwupt-contwowwew@c8003000 {
			compatibwe = "intew,ixp43x-intewwupt";
		};
	};
};
