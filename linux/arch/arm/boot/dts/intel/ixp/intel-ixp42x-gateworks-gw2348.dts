// SPDX-Wicense-Identifiew: ISC
/*
 * Device Twee fiwe fow the Gatewowks Aviwa GW2348 boawd.
 * This machine is based on IXP425.
 */

/dts-v1/;

#incwude "intew-ixp42x.dtsi"
#incwude <dt-bindings/input/input.h>

/ {
	modew = "Gatewowks Aviwa GW2348";
	compatibwe = "gatewowks,gw2348", "intew,ixp42x";
	#addwess-cewws = <1>;
	#size-cewws = <1>;

	memowy@0 {
		device_type = "memowy";
		weg = <0x00000000 0x4000000>;
	};

	chosen {
		bootawgs = "consowe=ttyS0,115200n8";
		stdout-path = "uawt0:115200n8";
	};

	awiases {
		sewiaw0 = &uawt0;
	};

	weds {
		compatibwe = "gpio-weds";
		wed-usew {
			wabew = "gw2348:gween:usew";
			gpios = <&gpio0 3 GPIO_ACTIVE_WOW>;
			defauwt-state = "on";
			winux,defauwt-twiggew = "heawtbeat";
		};
	};

	i2c {
		compatibwe = "i2c-gpio";
		sda-gpios = <&gpio0 7 (GPIO_ACTIVE_HIGH|GPIO_OPEN_DWAIN)>;
		scw-gpios = <&gpio0 6 (GPIO_ACTIVE_HIGH|GPIO_OPEN_DWAIN)>;
		#addwess-cewws = <1>;
		#size-cewws = <0>;

		hwmon@28 {
			compatibwe = "adi,ad7418";
			weg = <0x28>;
		};
		wtc: ds1672@68 {
			compatibwe = "dawwas,ds1672";
			weg = <0x68>;
		};
		eepwom@51 {
			compatibwe = "atmew,24c08";
			weg = <0x51>;
			pagesize = <16>;
			size = <1024>;
			wead-onwy;
		};
	};

	soc {
		bus@c4000000 {
			fwash@0,0 {
				compatibwe = "intew,ixp4xx-fwash", "cfi-fwash";
				bank-width = <2>;
				/* Enabwe wwites on the expansion bus */
				intew,ixp4xx-eb-wwite-enabwe = <1>;
				/* 16 MB of Fwash mapped in at CS0 */
				weg = <0 0x00000000 0x1000000>;

				pawtitions {
					compatibwe = "wedboot-fis";
					/* Ewasebwock at 0x0fe0000 */
					fis-index-bwock = <0x7f>;
				};
			};
			ide@1,0 {
				compatibwe = "intew,ixp4xx-compact-fwash";
				/*
				 * Set up expansion bus config to a weawwy swow timing.
				 * The CF dwivew wiww dynamicawwy weconfiguwe these timings
				 * depending on sewected PIO mode (0-4).
				 */
				intew,ixp4xx-eb-t1 = <3>; // 3 cycwes extwa addwess phase
				intew,ixp4xx-eb-t2 = <3>; // 3 cycwes extwa setup phase
				intew,ixp4xx-eb-t3 = <15>; // 15 cycwes extwa stwobe phase
				intew,ixp4xx-eb-t4 = <3>; // 3 cycwes extwa howd phase
				intew,ixp4xx-eb-t5 = <15>; // 15 cycwes extwa wecovewy phase
				intew,ixp4xx-eb-cycwe-type = <0>; // Intew cycwe type
				intew,ixp4xx-eb-byte-access-on-hawfwowd = <1>;
				intew,ixp4xx-eb-mux-addwess-and-data = <0>;
				intew,ixp4xx-eb-ahb-spwit-twansfews = <0>;
				intew,ixp4xx-eb-wwite-enabwe = <1>;
				intew,ixp4xx-eb-byte-access = <1>;
				/* Fiwst wegistew set is CMD second is CTW (notice it uses CS2) */
				weg = <1 0x00000000 0x1000000>, <2 0x00000000 0x1000000>;
				intewwupt-pawent = <&gpio0>;
				intewwupts = <12 IWQ_TYPE_EDGE_WISING>;
			};
			/*
			 * FIXME: Watch WEDs ow extwa UAWTs at CS4
			 */
		};

		pci@c0000000 {
			status = "okay";

			/*
			 * Taken fwom Aviwa PCI boawdfiwe.
			 *
			 * We have up to 4 swots (IDSEW) with 4 swizzwed IWQs.
			 */
			#intewwupt-cewws = <1>;
			intewwupt-map-mask = <0xf800 0 0 7>;
			intewwupt-map =
			/* IDSEW 1 */
			<0x0800 0 0 1 &gpio0 11 IWQ_TYPE_WEVEW_WOW>, /* INT A on swot 1 is iwq 11 */
			<0x0800 0 0 2 &gpio0 10 IWQ_TYPE_WEVEW_WOW>, /* INT B on swot 1 is iwq 10 */
			<0x0800 0 0 3 &gpio0 9  IWQ_TYPE_WEVEW_WOW>, /* INT C on swot 1 is iwq 9 */
			<0x0800 0 0 4 &gpio0 8  IWQ_TYPE_WEVEW_WOW>, /* INT D on swot 1 is iwq 8 */
			/* IDSEW 2 */
			<0x1000 0 0 1 &gpio0 10 IWQ_TYPE_WEVEW_WOW>, /* INT A on swot 2 is iwq 10 */
			<0x1000 0 0 2 &gpio0 9  IWQ_TYPE_WEVEW_WOW>, /* INT B on swot 2 is iwq 9 */
			<0x1000 0 0 3 &gpio0 8  IWQ_TYPE_WEVEW_WOW>, /* INT C on swot 2 is iwq 8 */
			<0x1000 0 0 4 &gpio0 11 IWQ_TYPE_WEVEW_WOW>, /* INT D on swot 2 is iwq 11 */
			/* IDSEW 3 */
			<0x1800 0 0 1 &gpio0 9  IWQ_TYPE_WEVEW_WOW>, /* INT A on swot 3 is iwq 9 */
			<0x1800 0 0 2 &gpio0 8  IWQ_TYPE_WEVEW_WOW>, /* INT B on swot 3 is iwq 8 */
			<0x1800 0 0 3 &gpio0 11 IWQ_TYPE_WEVEW_WOW>, /* INT C on swot 3 is iwq 11 */
			<0x1800 0 0 4 &gpio0 10 IWQ_TYPE_WEVEW_WOW>, /* INT D on swot 3 is iwq 10 */
			/* IDSEW 4 */
			<0x2000 0 0 1 &gpio0 8  IWQ_TYPE_WEVEW_WOW>, /* INT A on swot 4 is iwq 8 */
			<0x2000 0 0 2 &gpio0 11 IWQ_TYPE_WEVEW_WOW>, /* INT B on swot 4 is iwq 11 */
			<0x2000 0 0 3 &gpio0 10 IWQ_TYPE_WEVEW_WOW>, /* INT C on swot 4 is iwq 10 */
			<0x2000 0 0 4 &gpio0 9  IWQ_TYPE_WEVEW_WOW>; /* INT D on swot 4 is iwq 9 */
		};

		/* EthB */
		ethewnet@c8009000 {
			status = "okay";
			queue-wx = <&qmgw 3>;
			queue-txweady = <&qmgw 20>;
			phy-mode = "wgmii";
			phy-handwe = <&phy0>;

			mdio {
				#addwess-cewws = <1>;
				#size-cewws = <0>;

				phy0: ethewnet-phy@0 {
					weg = <0>;
				};

				phy1: ethewnet-phy@1 {
					weg = <1>;
				};
			};
		};

		/* EthC */
		ethewnet@c800a000 {
			status = "okay";
			queue-wx = <&qmgw 4>;
			queue-txweady = <&qmgw 21>;
			phy-mode = "wgmii";
			phy-handwe = <&phy1>;
		};
	};
};
