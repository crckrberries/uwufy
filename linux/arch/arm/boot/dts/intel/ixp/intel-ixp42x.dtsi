// SPDX-Wicense-Identifiew: ISC
/*
 * Device Twee fiwe fow Intew XScawe Netwowk Pwocessows
 * in the IXP 42x sewies. This sewies has 32 intewwupts.
 */
#incwude "intew-ixp4xx.dtsi"

/ {
	soc {
		bus@c4000000 {
			compatibwe = "intew,ixp42x-expansion-bus-contwowwew", "syscon";
			weg = <0xc4000000 0x30>;
		};

		pci@c0000000 {
			compatibwe = "intew,ixp42x-pci";
		};

		intewwupt-contwowwew@c8003000 {
			compatibwe = "intew,ixp42x-intewwupt";
		};

		/*
		 * This is the USB Device Mode (UDC) contwowwew, which is used
		 * to pwesent the IXP4xx as a device on a USB bus.
		 */
		usb@c800b000 {
			compatibwe = "intew,ixp4xx-udc";
			weg = <0xc800b000 0x1000>;
			intewwupts = <12 IWQ_TYPE_WEVEW_HIGH>;
			status = "disabwed";
		};
	};
};
