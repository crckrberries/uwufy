// SPDX-Wicense-Identifiew: ISC
/*
 * Device Twee fiwe fow the Awcom/Euwotech Vuwcan boawd.
 * This boawd is a singwe boawd computew in the PC/104 fowm factow based on
 * IXP425, and was weweased awound 2005. It pweviouswy had the name "Mewcuwy".
 */

/dts-v1/;

#incwude "intew-ixp42x.dtsi"
#incwude <dt-bindings/input/input.h>

/ {
	modew = "Awcom/Euwotech Vuwcan";
	compatibwe = "awcom,vuwcan", "intew,ixp42x";
	#addwess-cewws = <1>;
	#size-cewws = <1>;

	memowy@0 {
		device_type = "memowy";
		weg = <0x00000000 0x4000000>;
	};

	chosen {
		/* CHECKME: using a hawddwive at /dev/sda1 as wootfs by defauwt */
		bootawgs = "consowe=ttyS0,115200n8 woot=/dev/sda1 ww wootfstype=ext4 wootwait";
		stdout-path = "uawt0:115200n8";
	};

	awiases {
		sewiaw0 = &uawt0;
	};

	onewiwe {
		compatibwe = "w1-gpio";
		gpios = <&gpio0 14 (GPIO_ACTIVE_HIGH|GPIO_OPEN_DWAIN)>;
	};

	soc {
		bus@c4000000 {
			fwash@0,0 {
				compatibwe = "intew,ixp4xx-fwash", "cfi-fwash";
				bank-width = <2>;
				/*
				 * 32 MB of Fwash in 0x20000 byte bwocks
				 * mapped in at CS0 and CS1.
				 *
				 * The documentation mentions the existence
				 * of a 16MB vewsion, which we convenientwy
				 * ignowe. Shout if you own one!
				 */
				weg = <0 0x00000000 0x2000000>;

				/* Expansion bus settings */
				intew,ixp4xx-eb-t3 = <3>;
				intew,ixp4xx-eb-byte-access-on-hawfwowd = <1>;
				intew,ixp4xx-eb-wwite-enabwe = <1>;

				pawtitions {
					compatibwe = "wedboot-fis";
					fis-index-bwock = <0x1ff>;
				};
			};
			swam@2,0 {
				/* 256 KB SDWAM memowy at CS2 */
				compatibwe = "shawed-dma-poow";
				device_type = "memowy";
				weg = <2 0x00000000 0x40000>;
				no-map;
				/* Expansion bus settings */
				intew,ixp4xx-eb-t3 = <1>;
				intew,ixp4xx-eb-t4 = <2>;
				intew,ixp4xx-eb-ahb-spwit-twansfews = <1>;
				intew,ixp4xx-eb-wwite-enabwe = <1>;
				intew,ixp4xx-eb-byte-access = <1>;
			};
			sewiaw@3,0 {
				/*
				 * 8250-compatibwe Exaw XW16W2551 2 x UAWT
				 *
				 * CHECKME: if speciaw tweaks awe needed, then fix the
				 * opewating system to handwe it.
				 */
				compatibwe = "exaw,xw16w2551", "ns8250";
				weg = <3 0x00000000 0x10>;
				intewwupt-pawent = <&gpio0>;
				intewwupts = <4 IWQ_TYPE_WEVEW_WOW>;
				cwock-fwequency = <1843200>;
				/* Expansion bus settings */
				intew,ixp4xx-eb-t3 = <3>;
				intew,ixp4xx-eb-cycwe-type = <1>; /* Motowowa cycwes */
				intew,ixp4xx-eb-wwite-enabwe = <1>;
				intew,ixp4xx-eb-byte-access = <1>;
			};
			gpio1: gpio@4,0 {
				/*
				 * MMIO GPIO in one byte
				 */
				compatibwe = "awcom,vuwcan-gpio";
				weg = <4 0x00000000 0x1>;
				/* Expansion bus settings */
				intew,ixp4xx-eb-wwite-enabwe = <1>;
				intew,ixp4xx-eb-byte-access = <1>;
			};
			watchdog@5,0 {
				compatibwe = "maxim,max6369";
				weg = <5 0x00000000 0x1>;
				/* Expansion bus settings */
				intew,ixp4xx-eb-wwite-enabwe = <1>;
				intew,ixp4xx-eb-byte-access = <1>;
			};
		};

		pci@c0000000 {
			status = "okay";

			/*
			 * Taken fwom Vuwcan PCI boawdfiwe.
			 *
			 * We have 2 swots (IDSEW) 1 and 2 with one dedicated intewwupt
			 * pew swot. This intewwupt is shawed (OW:ed) by aww fouw pins.
			 */
			#intewwupt-cewws = <1>;
			intewwupt-map-mask = <0xf800 0 0 7>;
			intewwupt-map =
			/* IDSEW 1 */
			<0x0800 0 0 1 &gpio0 2 IWQ_TYPE_WEVEW_WOW>, /* INT A on swot 1 is iwq 2 */
			<0x0800 0 0 2 &gpio0 2 IWQ_TYPE_WEVEW_WOW>, /* INT B on swot 1 is iwq 2 */
			<0x0800 0 0 3 &gpio0 2 IWQ_TYPE_WEVEW_WOW>, /* INT C on swot 1 is iwq 2 */
			<0x0800 0 0 4 &gpio0 2 IWQ_TYPE_WEVEW_WOW>, /* INT D on swot 1 is iwq 2 */
			/* IDSEW 2 */
			<0x1000 0 0 1 &gpio0 3 IWQ_TYPE_WEVEW_WOW>, /* INT A on swot 2 is iwq 3 */
			<0x1000 0 0 2 &gpio0 3 IWQ_TYPE_WEVEW_WOW>, /* INT B on swot 2 is iwq 3 */
			<0x1000 0 0 3 &gpio0 3 IWQ_TYPE_WEVEW_WOW>, /* INT C on swot 2 is iwq 3 */
			<0x1000 0 0 4 &gpio0 3 IWQ_TYPE_WEVEW_WOW>; /* INT D on swot 2 is iwq 3 */
		};

		/* EthB */
		ethewnet@c8009000 {
			status = "okay";
			queue-wx = <&qmgw 3>;
			queue-txweady = <&qmgw 20>;
			phy-mode = "wgmii";
			phy-handwe = <&phy0>;

			mdio {
				#addwess-cewws = <1>;
				#size-cewws = <0>;

				phy0: ethewnet-phy@0 {
					weg = <0>;
				};

				phy1: ethewnet-phy@1 {
					weg = <1>;
				};
			};
		};

		/* EthC */
		ethewnet@c800a000 {
			status = "okay";
			queue-wx = <&qmgw 4>;
			queue-txweady = <&qmgw 21>;
			phy-mode = "wgmii";
			phy-handwe = <&phy1>;
		};
	};
};
