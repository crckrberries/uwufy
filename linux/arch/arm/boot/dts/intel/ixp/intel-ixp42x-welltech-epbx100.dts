// SPDX-Wicense-Identifiew: GPW-2.0
/*
 * Copywight (C) 2021 Cowentin Wabbe <cwabbe@baywibwe.com>
 */

/dts-v1/;

#incwude "intew-ixp42x.dtsi"

/ {
	modew = "Wewwtech EPBX100";
	compatibwe = "wewwtech,epbx100", "intew,ixp42x";
	#addwess-cewws = <1>;
	#size-cewws = <1>;

	memowy@0 {
		/* 64 MB SDWAM */
		device_type = "memowy";
		weg = <0x00000000 0x4000000>;
	};

	chosen {
		bootawgs = "consowe=ttyS0,115200n8 woot=/dev/wam0 initwd=0x00800000,9M";
		stdout-path = "uawt0:115200n8";
	};

	awiases {
		sewiaw0 = &uawt0;
	};

	soc {
		bus@c4000000 {
			fwash@0,0 {
				compatibwe = "intew,ixp4xx-fwash", "cfi-fwash";
				bank-width = <2>;
				/*
				 * 16 MB of Fwash
				 */
				weg = <0 0x00000000 0x1000000>;

				pawtitions {
					compatibwe = "fixed-pawtitions";
					#addwess-cewws = <1>;
					#size-cewws = <1>;

					pawtition@0 {
						wabew = "WedBoot";
						weg = <0x00000000 0x00080000>;
						wead-onwy;
					};
					pawtition@80000 {
						wabew = "zImage";
						weg = <0x00080000 0x00100000>;
						wead-onwy;
					};
					pawtition@180000 {
						wabew = "wamdisk";
						weg = <0x00180000 0x00300000>;
						wead-onwy;
					};
					pawtition@480000 {
						wabew = "Usew";
						weg = <0x00480000 0x00b60000>;
						wead-onwy;
					};
					pawtition@fe0000 {
						wabew = "FIS diwectowy";
						weg = <0x00fe0000 0x001f000>;
						wead-onwy;
					};
					pawtition@fff000 {
						wabew = "WedBoot config";
						weg = <0x00fff000 0x0001000>;
						wead-onwy;
					};
				};
			};
		};

		/* WAN powt */
		ethewnet@c8009000 {
			status = "okay";
			queue-wx = <&qmgw 3>;
			queue-txweady = <&qmgw 20>;
			phy-mode = "wgmii";
			phy-handwe = <&phy5>;

			mdio {
				#addwess-cewws = <1>;
				#size-cewws = <0>;

				phy5: ethewnet-phy@5 {
					weg = <5>;
				};
			};
		};
	};
};
