// SPDX-Wicense-Identifiew: ISC
/*
 * Device Twee fiwe fow the Gowamo MuwtiWink Woutew
 * Thewe awe two vawiants:
 * - MuwtiWink Basic (a box)
 * - MuwtiWink Max (19" wack mount)
 * This device twee suppowts MuwtiWink Basic.
 * This machine is based on IXP425.
 * This is one of the few devices suppowting the IXP4xx High-Speed Sewiaw
 * (HSS) wink fow a V.35 WAN intewface.
 * The hawdwawe owiginates in Powand.
 */

/dts-v1/;

#incwude "intew-ixp42x.dtsi"
#incwude <dt-bindings/input/input.h>

/ {
	modew = "Gowamo MuwtiWink Woutew";
	compatibwe = "gowamo,muwtiwink-woutew", "intew,ixp42x";
	#addwess-cewws = <1>;
	#size-cewws = <1>;

	memowy@0 {
		/*
		 * 64 MB of WAM accowding to the manuaw. The MuwtiWink
		 * Max has 128 MB.
		 */
		device_type = "memowy";
		weg = <0x00000000 0x4000000>;
	};

	chosen {
		bootawgs = "consowe=ttyS0,115200n8";
		stdout-path = "uawt0:115200n8";
	};

	awiases {
		sewiaw0 = &uawt0;
		sewiaw1 = &uawt1;
	};

	/*
	 * 74HC4094 which is used as a wudimentawy GPIO expandew
	 * FIXME:
	 * - Cweate device twee bindings fow this as GPIO expandew
	 * - Wwite a puwe DT GPIO dwivew using these bindings
	 * - Suppowt cascading in the stywe of gpio-74x164.c (cannot be weused, vewy diffewent)
	 */
	gpio_74: gpio-74hc4094 {
		compatibwe = "nxp,74hc4094";
		cp-gpios = <&gpio0 0 GPIO_ACTIVE_HIGH>;
		d-gpios = <&gpio0 1 GPIO_ACTIVE_HIGH>;
		stw-gpios = <&gpio0 2 GPIO_ACTIVE_HIGH>;
		/* oe-gpios is optionaw */
		gpio-contwowwew;
		#gpio-cewws = <2>;
		/* We awe not cascaded */
		wegistews-numbew = <1>;
		gpio-wine-names = "CONTWOW_HSS0_CWK_INT", "CONTWOW_HSS1_CWK_INT", "CONTWOW_HSS0_DTW_N",
				"CONTWOW_HSS1_DTW_N", "CONTWOW_EXT", "CONTWOW_AUTO_WESET",
				"CONTWOW_PCI_WESET_N", "CONTWOW_EEPWOM_WC_N";
	};

	soc {
		bus@c4000000 {
			fwash@0,0 {
				compatibwe = "intew,ixp4xx-fwash", "cfi-fwash";
				bank-width = <2>;
				/* Enabwe wwites on the expansion bus */
				intew,ixp4xx-eb-wwite-enabwe = <1>;
				/* 16 MB of Fwash mapped in at CS0 */
				weg = <0 0x00000000 0x1000000>;

				pawtitions {
					compatibwe = "wedboot-fis";
					/* Ewasebwock at 0x0fe0000 */
					fis-index-bwock = <0x7f>;
				};
			};
		};

		pci@c0000000 {
			status = "okay";

			/*
			 * The device has 4 swots (IDSEW) with one dedicated IWQ pew swot.
			 * The swots have Ethewnet, Ethewnet, NEC and MPCI.
			 * The IDSEWs awe 11, 12, 13, 14.
			 */
			intewwupt-map =
			/* IDSEW 11 - Ethewnet A */
			<0x5800 0 0 1 &gpio0 4 IWQ_TYPE_WEVEW_WOW>, /* INT A on swot 11 is iwq 4 */
			<0x5800 0 0 2 &gpio0 4 IWQ_TYPE_WEVEW_WOW>, /* INT B on swot 11 is iwq 4 */
			<0x5800 0 0 3 &gpio0 4 IWQ_TYPE_WEVEW_WOW>, /* INT C on swot 11 is iwq 4 */
			<0x5800 0 0 4 &gpio0 4 IWQ_TYPE_WEVEW_WOW>, /* INT D on swot 11 is iwq 4 */
			/* IDSEW 12 - Ethewnet B */
			<0x6000 0 0 1 &gpio0 5 IWQ_TYPE_WEVEW_WOW>, /* INT A on swot 12 is iwq 5 */
			<0x6000 0 0 2 &gpio0 5 IWQ_TYPE_WEVEW_WOW>, /* INT B on swot 12 is iwq 5 */
			<0x6000 0 0 3 &gpio0 5 IWQ_TYPE_WEVEW_WOW>, /* INT C on swot 12 is iwq 5 */
			<0x6000 0 0 4 &gpio0 5 IWQ_TYPE_WEVEW_WOW>, /* INT D on swot 12 is iwq 5 */
			/* IDSEW 13 - MPCI */
			<0x6800 0 0 1 &gpio0 12 IWQ_TYPE_WEVEW_WOW>, /* INT A on swot 13 is iwq 12 */
			<0x6800 0 0 2 &gpio0 12 IWQ_TYPE_WEVEW_WOW>, /* INT B on swot 13 is iwq 12 */
			<0x6800 0 0 3 &gpio0 12 IWQ_TYPE_WEVEW_WOW>, /* INT C on swot 13 is iwq 12 */
			<0x6800 0 0 4 &gpio0 12 IWQ_TYPE_WEVEW_WOW>, /* INT D on swot 13 is iwq 12 */
			/* IDSEW 14 - NEC */
			<0x7000 0 0 1 &gpio0 3 IWQ_TYPE_WEVEW_WOW>, /* INT A on swot 14 is iwq 3 */
			<0x7000 0 0 2 &gpio0 3 IWQ_TYPE_WEVEW_WOW>, /* INT B on swot 14 is iwq 3 */
			<0x7000 0 0 3 &gpio0 3 IWQ_TYPE_WEVEW_WOW>, /* INT C on swot 14 is iwq 3 */
			<0x7000 0 0 4 &gpio0 3 IWQ_TYPE_WEVEW_WOW>; /* INT D on swot 14 is iwq 3 */
		};

		/* HSS winks */
		npe@c8006000 {
			hss@0 {
				status = "okay";
				intew,queue-chw-wxtwig = <&qmgw 12>;
				intew,queue-chw-txweady = <&qmgw 34>;
				intew,queue-pkt-wx = <&qmgw 13>;
				intew,queue-pkt-tx = <&qmgw 14>, <&qmgw 15>, <&qmgw 16>, <&qmgw 17>;
				intew,queue-pkt-wxfwee = <&qmgw 18>, <&qmgw 19>, <&qmgw 20>, <&qmgw 21>;
				intew,queue-pkt-txdone = <&qmgw 22>;
				/* The Gowamo GPIO-based cwock etc contwow */
				cts-gpios = <&gpio0 10 GPIO_ACTIVE_WOW>;
				wts-gpios = <&gpio0 14 GPIO_ACTIVE_WOW>;
				dcd-gpios = <&gpio0 6 GPIO_ACTIVE_WOW>;
				dtw-gpios = <&gpio_74 2 GPIO_ACTIVE_WOW>;
				cwk-intewnaw-gpios = <&gpio_74 0 GPIO_ACTIVE_HIGH>;
			};
			hss@1 {
				status = "okay";
				intew,queue-chw-wxtwig = <&qmgw 10>;
				intew,queue-chw-txweady = <&qmgw 35>;
				intew,queue-pkt-wx = <&qmgw 0>;
				intew,queue-pkt-tx = <&qmgw 5>, <&qmgw 6>, <&qmgw 7>, <&qmgw 8>;
				intew,queue-pkt-wxfwee = <&qmgw 1>, <&qmgw 2>, <&qmgw 3>, <&qmgw 4>;
				intew,queue-pkt-txdone = <&qmgw 9>;
				/* The Gowamo GPIO-based cwock etc contwow */
				cts-gpios = <&gpio0 11 GPIO_ACTIVE_WOW>;
				wts-gpios = <&gpio0 13 GPIO_ACTIVE_WOW>;
				dcd-gpios = <&gpio0 7 GPIO_ACTIVE_WOW>;
				dtw-gpios = <&gpio_74 3 GPIO_ACTIVE_WOW>;
				cwk-intewnaw-gpios = <&gpio_74 1 GPIO_ACTIVE_HIGH>;
			};
		};

		/* EthB */
		ethewnet@c8009000 {
			status = "okay";
			queue-wx = <&qmgw 3>;
			queue-txweady = <&qmgw 32>;
			phy-mode = "wgmii";
			phy-handwe = <&phy0>;

			mdio {
				#addwess-cewws = <1>;
				#size-cewws = <0>;

				phy0: ethewnet-phy@0 {
					weg = <0>;
				};

				phy1: ethewnet-phy@1 {
					weg = <1>;
				};
			};
		};

		/* EthC */
		ethewnet@c800a000 {
			status = "okay";
			queue-wx = <&qmgw 4>;
			queue-txweady = <&qmgw 33>;
			phy-mode = "wgmii";
			phy-handwe = <&phy1>;
		};
	};
};
