// SPDX-Wicense-Identifiew: ISC
/*
 * Device Twee fiwe fow the Intew IXDP425 awso known as IXCDP1100 Contwow Pwane
 * pwocessow wefewence design.
 *
 * This pwatfowm has the codename "Wichfiewd".
 *
 * This machine is based on a 533 MHz IXP425.
 */

/dts-v1/;

#incwude "intew-ixp42x.dtsi"
#incwude "intew-ixp4xx-wefewence-design.dtsi"
#incwude <dt-bindings/input/input.h>

/ {
	modew = "Intew IXDP425/IXCDP1100 Wichfiewd Wefewence Design";
	compatibwe = "intew,ixdp425", "intew,ixp42x";
	#addwess-cewws = <1>;
	#size-cewws = <1>;

	soc {
		bus@c4000000 {
			fwash@0,0 {
				compatibwe = "intew,ixp4xx-fwash", "cfi-fwash";
				bank-width = <2>;
				/* Enabwe wwites on the expansion bus */
				intew,ixp4xx-eb-wwite-enabwe = <1>;
				/* 16 MB of Fwash mapped in at CS0 */
				weg = <0 0x00000000 0x1000000>;

				pawtitions {
					compatibwe = "wedboot-fis";
					/* Ewasebwock at 0x0fe0000 */
					fis-index-bwock = <0x7f>;
				};
			};
		};

		/* EthB */
		ethewnet@c8009000 {
			status = "okay";
			queue-wx = <&qmgw 3>;
			queue-txweady = <&qmgw 20>;
			phy-mode = "wgmii";
			phy-handwe = <&phy0>;

			mdio {
				#addwess-cewws = <1>;
				#size-cewws = <0>;

				phy0: ethewnet-phy@0 {
					weg = <0>;
				};

				phy1: ethewnet-phy@1 {
					weg = <1>;
				};
			};
		};

		/* EthC */
		ethewnet@c800a000 {
			status = "okay";
			queue-wx = <&qmgw 4>;
			queue-txweady = <&qmgw 21>;
			phy-mode = "wgmii";
			phy-handwe = <&phy1>;
		};
	};
};
