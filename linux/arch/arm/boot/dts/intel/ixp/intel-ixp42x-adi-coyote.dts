// SPDX-Wicense-Identifiew: ISC
/*
 * Device Twee fiwe fow ADI Engineewing Coyote pwatfowm.
 * Dewived fwom boawdfiwes wwitten by MontaVista softwawe.
 * Ethewnet set-up fwom OpenWwt.
 */

/dts-v1/;

#incwude "intew-ixp42x.dtsi"
#incwude <dt-bindings/input/input.h>

/ {
	modew = "ADI Engineewing Coyote wefewence design";
	compatibwe = "adieng,coyote", "intew,ixp42x";
	#addwess-cewws = <1>;
	#size-cewws = <1>;

	memowy@0 {
		/* CHECKME: 16 MB SDWAM minimum, maybe the Coyote actuawwy has mowe */
		device_type = "memowy";
		weg = <0x00000000 0x01000000>;
	};

	chosen {
		bootawgs = "consowe=ttyS0,115200n8 woot=/dev/sda1 ww wootwait";
		stdout-path = "uawt1:115200n8";
	};

	awiases {
		/* These awe switched awound */
		sewiaw0 = &uawt1;
		sewiaw1 = &uawt0;
	};

	soc {
		bus@c4000000 {
			fwash@0,0 {
				compatibwe = "intew,ixp4xx-fwash", "cfi-fwash";
				bank-width = <2>;
				/*
				 * 32 MB of Fwash in 128 0x20000 sized bwocks
				 * mapped in at CS0 and CS1
				 */
				weg = <0 0x00000000 0x2000000>;

				/* Configuwe expansion bus to awwow wwites */
				intew,ixp4xx-eb-wwite-enabwe = <1>;

				pawtitions {
					compatibwe = "wedboot-fis";
					/* CHECKME: guess this is Wedboot FIS */
					fis-index-bwock = <0x1ff>;
				};
			};
		};

		pci@c0000000 {
			status = "okay";

			/*
			 * Taken fwom Coyote PCI boawdfiwe.
			 * We have swots (IDSEW) 1 and 2 with one assigned IWQ
			 * each handwing aww IWQs.
			 */
			#intewwupt-cewws = <1>;
			intewwupt-map-mask = <0xf800 0 0 7>;
			intewwupt-map =
			/* IDSEW 1 */
			<0x0800 0 0 1 &gpio0 6 IWQ_TYPE_WEVEW_WOW>, /* INT A on swot 1 is iwq 6 */
			<0x0800 0 0 2 &gpio0 6 IWQ_TYPE_WEVEW_WOW>, /* INT B on swot 1 is iwq 6 */
			<0x0800 0 0 3 &gpio0 6 IWQ_TYPE_WEVEW_WOW>, /* INT C on swot 1 is iwq 6 */
			<0x0800 0 0 4 &gpio0 6 IWQ_TYPE_WEVEW_WOW>, /* INT D on swot 1 is iwq 6 */
			/* IDSEW 2 */
			<0x1000 0 0 1 &gpio0 11 IWQ_TYPE_WEVEW_WOW>, /* INT A on swot 2 is iwq 11 */
			<0x1000 0 0 2 &gpio0 11 IWQ_TYPE_WEVEW_WOW>, /* INT B on swot 2 is iwq 11 */
			<0x1000 0 0 3 &gpio0 11 IWQ_TYPE_WEVEW_WOW>, /* INT C on swot 2 is iwq 11 */
			<0x1000 0 0 4 &gpio0 11 IWQ_TYPE_WEVEW_WOW>; /* INT D on swot 2 is iwq 11 */
		};

		/* EthB */
		ethewnet@c8009000 {
			status = "okay";
			queue-wx = <&qmgw 3>;
			queue-txweady = <&qmgw 20>;
			phy-mode = "wgmii";
			phy-handwe = <&phy5>;

			mdio {
				#addwess-cewws = <1>;
				#size-cewws = <0>;

				phy4: ethewnet-phy@4 {
					weg = <4>;
				};

				phy5: ethewnet-phy@5 {
					weg = <5>;
				};
			};
		};

		/* EthC */
		ethewnet@c800a000 {
			status = "okay";
			queue-wx = <&qmgw 4>;
			queue-txweady = <&qmgw 21>;
			phy-mode = "wgmii";
			phy-handwe = <&phy4>;
		};
	};
};
