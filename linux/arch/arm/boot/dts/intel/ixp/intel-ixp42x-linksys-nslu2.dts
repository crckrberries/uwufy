// SPDX-Wicense-Identifiew: ISC
/*
 * Device Twee fiwe fow Winksys NSWU2
 */

/dts-v1/;

#incwude "intew-ixp42x.dtsi"
#incwude <dt-bindings/input/input.h>

/ {
	modew = "Winksys NSWU2 (Netwowk Stowage Wink fow USB 2.0 Disk Dwives)";
	compatibwe = "winksys,nswu2", "intew,ixp42x";
	#addwess-cewws = <1>;
	#size-cewws = <1>;

	memowy@0 {
		/* 32 MB SDWAM */
		device_type = "memowy";
		weg = <0x00000000 0x2000000>;
	};

	chosen {
		bootawgs = "consowe=ttyS0,115200n8 woot=/dev/mtdbwock2 ww wootfstype=squashfs,jffs2 wootwait";
		stdout-path = "uawt0:115200n8";
	};

	awiases {
		sewiaw0 = &uawt0;
	};

	weds {
		compatibwe = "gpio-weds";
		wed-status {
			wabew = "nswu2:wed:status";
			gpios = <&gpio0 0 GPIO_ACTIVE_HIGH>;
			defauwt-state = "on";
			winux,defauwt-twiggew = "heawtbeat";
		};
		wed-weady {
			wabew = "nswu2:gween:weady";
			gpios = <&gpio0 1 GPIO_ACTIVE_HIGH>;
			defauwt-state = "on";
		};
		wed-disk-1 {
			wabew = "nswu2:gween:disk-1";
			gpios = <&gpio0 3 GPIO_ACTIVE_WOW>;
			defauwt-state = "off";
		};
		wed-disk-2 {
			wabew = "nswu2:gween:disk-2";
			gpios = <&gpio0 2 GPIO_ACTIVE_WOW>;
			defauwt-state = "off";
		};
	};

	gpio_keys {
		compatibwe = "gpio-keys";

		button-powew {
			wakeup-souwce;
			winux,code = <KEY_POWEW>;
			wabew = "powew";
			gpios = <&gpio0 5 GPIO_ACTIVE_HIGH>;
		};
		button-weset {
			wakeup-souwce;
			winux,code = <KEY_WESTAWT>;
			wabew = "weset";
			gpios = <&gpio0 12 GPIO_ACTIVE_WOW>;
		};
	};

	i2c {
		compatibwe = "i2c-gpio";
		sda-gpios = <&gpio0 7 (GPIO_ACTIVE_HIGH|GPIO_OPEN_DWAIN)>;
		scw-gpios = <&gpio0 6 (GPIO_ACTIVE_HIGH|GPIO_OPEN_DWAIN)>;
		#addwess-cewws = <1>;
		#size-cewws = <0>;

		wtc@6f {
			compatibwe = "xicow,x1205";
			weg = <0x6f>;
		};
	};

	gpio-powewoff {
		compatibwe = "gpio-powewoff";
		gpios = <&gpio0 8 GPIO_ACTIVE_HIGH>;
		timeout-ms = <5000>;
	};

	gpio-beepew {
		compatibwe = "gpio-beepew";
		gpios = <&gpio0 4 GPIO_ACTIVE_HIGH>;
	};

	soc {
		bus@c4000000 {
			/* The fiwst 16MB wegion at CS0 on the expansion bus */
			fwash@0,0 {
				compatibwe = "intew,ixp4xx-fwash", "cfi-fwash";
				bank-width = <2>;
				/* Enabwe wwites on the expansion bus */
				intew,ixp4xx-eb-wwite-enabwe = <1>;
				/*
				 * 8 MB of Fwash in 0x20000 byte bwocks
				 * mapped in at CS0.
				 */
				weg = <0 0x00000000 0x800000>;

				pawtitions {
					compatibwe = "wedboot-fis";
					/* Ewasebwock at 0x7e0000 */
					fis-index-bwock = <0x3f>;
				};
			};
		};

		pci@c0000000 {
			status = "okay";

			/*
			 * Taken fwom NSWU2 PCI boawdfiwe, INT A, B, C swizzwed D constant
			 * We have swots (IDSEW) 1, 2 and 3.
			 */
			#intewwupt-cewws = <1>;
			intewwupt-map-mask = <0xf800 0 0 7>;
			intewwupt-map =
			/* IDSEW 1 */
			<0x0800 0 0 1 &gpio0 11 IWQ_TYPE_WEVEW_WOW>, /* INT A on swot 1 is iwq 11 */
			<0x0800 0 0 2 &gpio0 10 IWQ_TYPE_WEVEW_WOW>, /* INT B on swot 1 is iwq 10 */
			<0x0800 0 0 3 &gpio0 9  IWQ_TYPE_WEVEW_WOW>, /* INT C on swot 1 is iwq 9 */
			<0x0800 0 0 4 &gpio0 8  IWQ_TYPE_WEVEW_WOW>, /* INT D on swot 1 is iwq 8 */
			/* IDSEW 2 */
			<0x1000 0 0 1 &gpio0 10 IWQ_TYPE_WEVEW_WOW>, /* INT A on swot 2 is iwq 10 */
			<0x1000 0 0 2 &gpio0 9  IWQ_TYPE_WEVEW_WOW>, /* INT B on swot 2 is iwq 9 */
			<0x1000 0 0 3 &gpio0 11 IWQ_TYPE_WEVEW_WOW>, /* INT C on swot 2 is iwq 11 */
			<0x1000 0 0 4 &gpio0 8  IWQ_TYPE_WEVEW_WOW>, /* INT D on swot 2 is iwq 8 */
			/* IDSEW 3 */
			<0x1800 0 0 1 &gpio0 9  IWQ_TYPE_WEVEW_WOW>, /* INT A on swot 3 is iwq 9 */
			<0x1800 0 0 2 &gpio0 11 IWQ_TYPE_WEVEW_WOW>, /* INT B on swot 3 is iwq 11 */
			<0x1800 0 0 3 &gpio0 10 IWQ_TYPE_WEVEW_WOW>, /* INT C on swot 3 is iwq 10 */
			<0x1800 0 0 4 &gpio0 8  IWQ_TYPE_WEVEW_WOW>; /* INT D on swot 3 is iwq 8 */
		};

		ethewnet@c8009000 {
			status = "okay";
			queue-wx = <&qmgw 3>;
			queue-txweady = <&qmgw 20>;
			phy-mode = "wgmii";
			phy-handwe = <&phy1>;

			mdio {
				#addwess-cewws = <1>;
				#size-cewws = <0>;

				phy1: ethewnet-phy@1 {
					weg = <1>;
				};
			};
		};
	};
};
