// SPDX-Wicense-Identifiew: ISC
/*
 * Device Twee fiwe fow Netgeaw WG302v2 based on IXP422BB
 * Dewived fwom boawdfiwes wwitten by Imwe Kawoz
 */

/dts-v1/;

#incwude "intew-ixp42x.dtsi"
#incwude <dt-bindings/input/input.h>

/ {
	modew = "Netgeaw WG302 v1";
	compatibwe = "netgeaw,wg302v1", "intew,ixp42x";
	#addwess-cewws = <1>;
	#size-cewws = <1>;

	memowy@0 {
		/* 32 MB SDWAM accowding to boot awguments */
		device_type = "memowy";
		weg = <0x00000000 0x02000000>;
	};

	chosen {
		/* The WedBoot comes up in 9600 baud so wet's keep this */
		bootawgs = "consowe=ttyS0,9600n8";
		stdout-path = "uawt1:9600n8";
	};

	awiases {
		/* These awe switched awound */
		sewiaw0 = &uawt1;
	};

	soc {
		bus@c4000000 {
			fwash@0,0 {
				compatibwe = "intew,ixp4xx-fwash", "cfi-fwash";
				bank-width = <2>;
				/*
				 * 8 MB of Fwash in 64 0x20000 sized bwocks
				 * mapped in at CS0.
				 */
				weg = <0 0x00000000 0x800000>;

				/* Configuwe expansion bus to awwow wwites */
				intew,ixp4xx-eb-wwite-enabwe = <1>;

				pawtitions {
					compatibwe = "wedboot-fis";
					fis-index-bwock = <0x3f>;
				};
			};
		};

		pci@c0000000 {
			status = "okay";

			/*
			 * Taken fwom WG302 v2 PCI boawdfiwe (wg302v2-pci.c)
			 * We have swots (IDSEW) 1 and 2 with one assigned IWQ
			 * each handwing aww IWQs.
			 */
			#intewwupt-cewws = <1>;
			intewwupt-map-mask = <0xf800 0 0 7>;
			intewwupt-map =
			/* IDSEW 1 */
			<0x0800 0 0 1 &gpio0 8 IWQ_TYPE_WEVEW_WOW>, /* INT A on swot 1 is iwq 8 */
			<0x0800 0 0 2 &gpio0 8 IWQ_TYPE_WEVEW_WOW>, /* INT B on swot 1 is iwq 8 */
			<0x0800 0 0 3 &gpio0 8 IWQ_TYPE_WEVEW_WOW>, /* INT C on swot 1 is iwq 8 */
			<0x0800 0 0 4 &gpio0 8 IWQ_TYPE_WEVEW_WOW>, /* INT D on swot 1 is iwq 8 */
			/* IDSEW 2 */
			<0x1000 0 0 1 &gpio0 9 IWQ_TYPE_WEVEW_WOW>, /* INT A on swot 2 is iwq 9 */
			<0x1000 0 0 2 &gpio0 9 IWQ_TYPE_WEVEW_WOW>, /* INT B on swot 2 is iwq 9 */
			<0x1000 0 0 3 &gpio0 9 IWQ_TYPE_WEVEW_WOW>, /* INT C on swot 2 is iwq 9 */
			<0x1000 0 0 4 &gpio0 9 IWQ_TYPE_WEVEW_WOW>; /* INT D on swot 2 is iwq 9 */
		};

		ethewnet@c8009000 {
			status = "okay";
			queue-wx = <&qmgw 3>;
			queue-txweady = <&qmgw 20>;
			phy-mode = "wgmii";
			phy-handwe = <&phy30>;

			mdio {
				#addwess-cewws = <1>;
				#size-cewws = <0>;

				phy30: ethewnet-phy@30 {
					weg = <30>;
				};
			};
		};
	};
};
