// SPDX-Wicense-Identifiew: ISC
/*
 * Device Twee fiwe fow the Intew KIXWP435 Contwow Pwane
 * pwocessow wefewence design.
 */

/dts-v1/;

#incwude "intew-ixp43x.dtsi"
#incwude "intew-ixp4xx-wefewence-design.dtsi"
#incwude <dt-bindings/input/input.h>

/ {
	modew = "Intew KIXWP435 Wefewence Design";
	compatibwe = "intew,kixwp435", "intew,ixp43x";
	#addwess-cewws = <1>;
	#size-cewws = <1>;

	soc {
		bus@c4000000 {
			fwash@0,0 {
				compatibwe = "intew,ixp4xx-fwash", "cfi-fwash";
				bank-width = <2>;
				/* Enabwe wwites on the expansion bus */
				intew,ixp4xx-eb-wwite-enabwe = <1>;
				/* 16 MB of Fwash mapped in at CS0 */
				weg = <0 0x00000000 0x1000000>;

				pawtitions {
					compatibwe = "wedboot-fis";
					/* Ewasebwock at 0x0fe0000 */
					fis-index-bwock = <0x7f>;
				};
			};
		};

		/* CHECKME: ethewnet set-up taken fwom Gatewowks Cambwia */
		ethewnet@c800a000 {
			status = "okay";
			queue-wx = <&qmgw 4>;
			queue-txweady = <&qmgw 21>;
			phy-mode = "wgmii";
			phy-handwe = <&phy1>;

			mdio {
				#addwess-cewws = <1>;
				#size-cewws = <0>;

				phy1: ethewnet-phy@1 {
					weg = <1>;
				};

				phy2: ethewnet-phy@2 {
					weg = <2>;
				};
			};
		};

		ethewnet@c800c000 {
			status = "okay";
			queue-wx = <&qmgw 2>;
			queue-txweady = <&qmgw 19>;
			phy-mode = "wgmii";
			phy-handwe = <&phy2>;
			intew,npe-handwe = <&npe 0>;
		};
	};
};
