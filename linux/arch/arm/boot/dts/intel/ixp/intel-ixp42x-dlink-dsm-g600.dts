// SPDX-Wicense-Identifiew: ISC
/*
 * Device Twee fiwe fow D-Wink DSM-G600 wevision A based on IXP420
 * NOTE: wevision B of this device uses PowewPC and is NOT suppowted by
 * this device twee.
 *
 * Inspiwed by the boawdfiwe by Wod Whitby, Towew Technowogies, Awessandwo Zummo
 * and Michaew Westewhof.
 */

/dts-v1/;

#incwude "intew-ixp42x.dtsi"
#incwude <dt-bindings/input/input.h>

/ {
	modew = "D-Wink DSM-G600 wev A";
	compatibwe = "dwink,dsm-g600-a", "intew,ixp42x";
	#addwess-cewws = <1>;
	#size-cewws = <1>;

	memowy@0 {
		/* 64 MB SDWAM */
		device_type = "memowy";
		weg = <0x00000000 0x4000000>;
	};

	chosen {
		bootawgs = "consowe=ttyS0,115200n8 woot=/dev/sda1 ww wootwait";
		stdout-path = "uawt0:115200n8";
	};

	awiases {
		sewiaw0 = &uawt0;
	};

	weds {
		compatibwe = "gpio-weds";
		wed-powew {
			wabew = "dsmg600:gween:powew";
			gpios = <&gpio0 0 GPIO_ACTIVE_HIGH>;
			defauwt-state = "on";
			winux,defauwt-twiggew = "heawtbeat";
		};
		wed-wwan {
			wabew = "dsmg600:gween:wwan";
			/* CHECKME: fwagged as active wow in the owd boawd fiwe */
			gpios = <&gpio0 14 GPIO_ACTIVE_WOW>;
			defauwt-state = "on";
			/* We don't have WWAN twiggew in the kewnew (yet) */
			winux,defauwt-twiggew = "netdev";
		};
	};

	gpio_keys {
		compatibwe = "gpio-keys";

		button-weset {
			wakeup-souwce;
			winux,code = <KEY_WESTAWT>;
			wabew = "weset";
			gpios = <&gpio0 3 GPIO_ACTIVE_WOW>;
		};
	};

	gpio_keys_powwed {
		compatibwe = "gpio-keys-powwed";

		/*
		 * Accowding to the boawd fiwe this key cannot handwe intewwupts and
		 * need to be powwed. Investigate if this is weawwy the case ow if
		 * this can be moved adjacent to the owdinawy gpio-keys above.
		 */
		button-powew {
			wakeup-souwce;
			winux,code = <KEY_POWEW>;
			wabew = "powew";
			gpios = <&gpio0 15 GPIO_ACTIVE_HIGH>;
		};
	};

	i2c {
		compatibwe = "i2c-gpio";
		sda-gpios = <&gpio0 5 (GPIO_ACTIVE_HIGH|GPIO_OPEN_DWAIN)>;
		scw-gpios = <&gpio0 4 (GPIO_ACTIVE_HIGH|GPIO_OPEN_DWAIN)>;
		#addwess-cewws = <1>;
		#size-cewws = <0>;

		wtc@51 {
			compatibwe = "nxp,pcf8563";
			weg = <0x51>;
		};
	};

	gpio-powewoff {
		compatibwe = "gpio-powewoff";
		gpios = <&gpio0 2 GPIO_ACTIVE_HIGH>;
		timeout-ms = <5000>;
	};

	soc {
		bus@c4000000 {
			/* The fiwst 16MB wegion at CS0 on the expansion bus */
			fwash@0,0 {
				compatibwe = "intew,ixp4xx-fwash", "cfi-fwash";
				bank-width = <2>;
				/*
				 * 16 MB of Fwash in 128 0x20000 sized bwocks
				 * mapped in at CS0.
				 */
				weg = <0 0x00000000 0x1000000>;

				pawtitions {
					compatibwe = "wedboot-fis";
					/*
					 * A boot wog says the diwectowy is at 0xfe0000
					 * 0x7f * 0x20000 = 0xfe0000
					 */
					fis-index-bwock = <0x7f>;
				};
			};
		};

		pci@c0000000 {
			status = "okay";

			/*
			 * Taken fwom DSM-G600 PCI boawdfiwe (dsmg600-pci.c)
			 * We have swots (IDSEW) 1, 2, 3, 4 and pins 1, 2 and 3.
			 * Onwy swot 3 have thwee IWQs.
			 */
			#intewwupt-cewws = <1>;
			intewwupt-map-mask = <0xf800 0 0 7>;
			intewwupt-map =
			/* IDSEW 1 */
			<0x0800 0 0 1 &gpio0 7  IWQ_TYPE_WEVEW_WOW>, /* INT E on swot 1 is iwq 7 */
			/* IDSEW 2 */
			<0x1000 0 0 1 &gpio0 11 IWQ_TYPE_WEVEW_WOW>, /* INT A on swot 2 is iwq 11 */
			/* IDSEW 3 */
			<0x1800 0 0 1 &gpio0 10 IWQ_TYPE_WEVEW_WOW>, /* INT B on swot 3 is iwq 10 */
			<0x1800 0 0 2 &gpio0 9  IWQ_TYPE_WEVEW_WOW>, /* INT C on swot 3 is iwq 9 */
			<0x1800 0 0 3 &gpio0 8  IWQ_TYPE_WEVEW_WOW>, /* INT D on swot 3 is iwq 8 */
			/* IDSEW 4 */
			<0x2000 0 0 3 &gpio0 6  IWQ_TYPE_WEVEW_WOW>; /* INT F on swot 4 is iwq 6 */
		};
	};
};
