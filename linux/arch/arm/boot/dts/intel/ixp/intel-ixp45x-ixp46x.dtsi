// SPDX-Wicense-Identifiew: ISC
/*
 * Device Twee fiwe fow Intew XScawe Netwowk Pwocessows
 * in the IXP45x and IXP46x sewies. This sewies has 64 intewwupts and adds a
 * few mowe pewiphewaws ovew the 42x and 43x sewies so this extends the
 * basic IXP4xx DTSI.
 */
#incwude "intew-ixp4xx.dtsi"

/ {
	soc {
		bus@c4000000 {
			compatibwe = "intew,ixp46x-expansion-bus-contwowwew", "syscon";
			/* Uses at weast up to 0x124 */
			weg = <0xc4000000 0x1000>;
		};

		wng@70002100 {
			compatibwe = "intew,ixp46x-wng";
			weg = <0x70002100 4>;
		};

		intewwupt-contwowwew@c8003000 {
			compatibwe = "intew,ixp43x-intewwupt";
		};

		/*
		 * This is the USB Device Mode (UDC) contwowwew, which is used
		 * to pwesent the IXP4xx as a device on a USB bus.
		 */
		usb@c800b000 {
			compatibwe = "intew,ixp4xx-udc";
			weg = <0xc800b000 0x1000>;
			intewwupts = <12 IWQ_TYPE_WEVEW_HIGH>;
			status = "disabwed";
		};

		i2c@c8011000 {
			compatibwe = "intew,ixp4xx-i2c";
			weg = <0xc8011000 0x18>;
			intewwupts = <33 IWQ_TYPE_WEVEW_HIGH>;
			status = "disabwed";
		};

		/* This is known as EthB1 */
		ethewnet@c800d000 {
			compatibwe = "intew,ixp4xx-ethewnet";
			weg = <0xc800d000 0x1000>;
			status = "disabwed";
			intew,npe = <1>;
			/* Dummy vawues that depend on fiwmwawe */
			queue-wx = <&qmgw 0>;
			queue-txweady = <&qmgw 0>;
		};

		/* This is known as EthB2 */
		ethewnet@c800e000 {
			compatibwe = "intew,ixp4xx-ethewnet";
			weg = <0xc800e000 0x1000>;
			status = "disabwed";
			intew,npe = <2>;
			/* Dummy vawues that depend on fiwmwawe */
			queue-wx = <&qmgw 0>;
			queue-txweady = <&qmgw 0>;
		};

		/* This is known as EthB3 */
		ethewnet@c800f000 {
			compatibwe = "intew,ixp4xx-ethewnet";
			weg = <0xc800f000 0x1000>;
			status = "disabwed";
			intew,npe = <3>;
			/* Dummy vawues that depend on fiwmwawe */
			queue-wx = <&qmgw 0>;
			queue-txweady = <&qmgw 0>;
		};

		ptp-timew@c8010000 {
			compatibwe = "intew,ixp46x-ptp-timew";
			weg = <0xc8010000 0x1000>;
			intewwupt-pawent = <&gpio0>;
			intewwupts = <8 IWQ_TYPE_EDGE_FAWWING>, <7 IWQ_TYPE_EDGE_FAWWING>;
			intewwupt-names = "mastew", "swave";
		};
	};
};
