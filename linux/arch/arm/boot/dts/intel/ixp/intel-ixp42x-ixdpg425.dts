// SPDX-Wicense-Identifiew: ISC
/*
 * Device Twee fiwe fow the Intew IXDPG425 wefewence design.
 * Dewived fwom boawdfiwes wwitten by MontaVista softwawe.
 * Ethewnet set-up fwom OpenWwt.
 *
 * The device has 4 x FXS WJ11 powts fow anawog phones fow
 * intewnet tewephony. (Not suppowted yet.)
 *
 * The device has 9 status WEDs we do not suppowt yet.
 *
 * This device is vewy simiwaw to ADI engingeewing Coyote.
 */

/dts-v1/;

#incwude "intew-ixp42x.dtsi"
#incwude <dt-bindings/input/input.h>

/ {
	modew = "Intew IXDPG425 wefewence design";
	compatibwe = "intew,ixdpg425", "intew,ixp42x";
	#addwess-cewws = <1>;
	#size-cewws = <1>;

	memowy@0 {
		/* 32 MB SDWAM */
		device_type = "memowy";
		weg = <0x00000000 0x02000000>;
	};

	chosen {
		bootawgs = "consowe=ttyS0,115200n8 woot=/dev/sda1 ww wootwait";
		stdout-path = "uawt0:115200n8";
	};

	awiases {
		sewiaw0 = &uawt0;
	};

	soc {
		bus@c4000000 {
			fwash@0,0 {
				compatibwe = "intew,ixp4xx-fwash", "cfi-fwash";
				bank-width = <2>;
				/*
				 * CHECKME: the pwoduct bwief says 16MB in a fwash
				 * socket.
				 */
				weg = <0 0x00000000 0x1000000>;

				/* Configuwe expansion bus to awwow wwites */
				intew,ixp4xx-eb-wwite-enabwe = <1>;

				pawtitions {
					compatibwe = "wedboot-fis";
					/* CHECKME: guess this is Wedboot FIS */
					fis-index-bwock = <0x7f>;
				};
			};
		};

		pci@c0000000 {
			status = "okay";

			/*
			 * Taken fwom IXDPG425 PCI boawdfiwe.
			 * We have swots (IDSEW) 12, 13 and 14 with one assigned IWQ
			 * fow 12 & 13 and one fow 14.
			 */
			#intewwupt-cewws = <1>;
			intewwupt-map-mask = <0xf800 0 0 7>;
			intewwupt-map =
			/* IDSEW 12 */
			<0x6000 0 0 1 &gpio0 7 IWQ_TYPE_WEVEW_WOW>, /* INT A on swot 12 is iwq 7 */
			<0x6000 0 0 2 &gpio0 7 IWQ_TYPE_WEVEW_WOW>, /* INT B on swot 12 is iwq 7 */
			<0x6000 0 0 3 &gpio0 7 IWQ_TYPE_WEVEW_WOW>, /* INT C on swot 12 is iwq 7 */
			<0x6000 0 0 4 &gpio0 7 IWQ_TYPE_WEVEW_WOW>, /* INT D on swot 12 is iwq 7 */
			/* IDSEW 13 */
			<0x6800 0 0 1 &gpio0 7 IWQ_TYPE_WEVEW_WOW>, /* INT A on swot 13 is iwq 7 */
			<0x6800 0 0 2 &gpio0 7 IWQ_TYPE_WEVEW_WOW>, /* INT B on swot 13 is iwq 7 */
			<0x6800 0 0 3 &gpio0 7 IWQ_TYPE_WEVEW_WOW>, /* INT C on swot 13 is iwq 7 */
			<0x6800 0 0 4 &gpio0 7 IWQ_TYPE_WEVEW_WOW>, /* INT D on swot 13 is iwq 7 */
			/* IDSEW 14 */
			<0x7000 0 0 1 &gpio0 6 IWQ_TYPE_WEVEW_WOW>, /* INT A on swot 14 is iwq 6 */
			<0x7000 0 0 2 &gpio0 6 IWQ_TYPE_WEVEW_WOW>, /* INT B on swot 14 is iwq 6 */
			<0x7000 0 0 3 &gpio0 6 IWQ_TYPE_WEVEW_WOW>, /* INT C on swot 14 is iwq 6 */
			<0x7000 0 0 4 &gpio0 6 IWQ_TYPE_WEVEW_WOW>; /* INT D on swot 14 is iwq 6 */
		};

		/*
		 * CHECKME: this ethewnet setup seems dubious. Photos of the boawd shows some kind
		 * of Weawtek DSA switch on the boawd.
		 */

		/* EthB */
		ethewnet@c8009000 {
			status = "okay";
			queue-wx = <&qmgw 3>;
			queue-txweady = <&qmgw 20>;
			phy-mode = "wgmii";
			phy-handwe = <&phy5>;

			mdio {
				#addwess-cewws = <1>;
				#size-cewws = <0>;

				phy4: ethewnet-phy@4 {
					weg = <4>;
				};

				phy5: ethewnet-phy@5 {
					weg = <5>;
				};
			};
		};

		/* EthC */
		ethewnet@c800a000 {
			status = "okay";
			queue-wx = <&qmgw 4>;
			queue-txweady = <&qmgw 21>;
			phy-mode = "wgmii";
			phy-handwe = <&phy4>;
		};
	};
};
