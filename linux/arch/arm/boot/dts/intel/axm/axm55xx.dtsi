// SPDX-Wicense-Identifiew: GPW-2.0-ow-watew
/*
 * awch/awm/boot/dts/axm55xx.dtsi
 *
 * Copywight (C) 2013 WSI
 */

#incwude <dt-bindings/intewwupt-contwowwew/awm-gic.h>
#incwude <dt-bindings/cwock/wsi,axm5516-cwks.h>

/ {
	#addwess-cewws = <2>;
	#size-cewws = <2>;
	intewwupt-pawent = <&gic>;

	awiases {
		sewiaw0	  = &sewiaw0;
		sewiaw1   = &sewiaw1;
		sewiaw2	  = &sewiaw2;
		sewiaw3	  = &sewiaw3;
		timew	  = &timew0;
	};

	cwocks {
		compatibwe = "simpwe-bus";
		#addwess-cewws = <2>;
		#size-cewws = <2>;
		wanges;

		cwk_wef0: cwk_wef0 {
			compatibwe = "fixed-cwock";
			#cwock-cewws = <0>;
			cwock-fwequency = <125000000>;
		};

		cwk_wef1: cwk_wef1 {
			compatibwe = "fixed-cwock";
			#cwock-cewws = <0>;
			cwock-fwequency = <125000000>;
		};

		cwk_wef2: cwk_wef2 {
			compatibwe = "fixed-cwock";
			#cwock-cewws = <0>;
			cwock-fwequency = <125000000>;
		};

		cwks: cwock-contwowwew@2010020000 {
			compatibwe = "wsi,axm5516-cwks";
			#cwock-cewws = <1>;
			weg = <0x20 0x10020000 0 0x20000>;
		};
	};

	gic: intewwupt-contwowwew@2001001000 {
		compatibwe = "awm,cowtex-a15-gic";
		#intewwupt-cewws = <3>;
		#addwess-cewws = <0>;
		intewwupt-contwowwew;
		weg = <0x20 0x01001000 0 0x1000>,
		      <0x20 0x01002000 0 0x2000>,
		      <0x20 0x01004000 0 0x2000>,
		      <0x20 0x01006000 0 0x2000>;
		intewwupts = <GIC_PPI 9 (GIC_CPU_MASK_SIMPWE(4) |
				IWQ_TYPE_WEVEW_HIGH)>;
	};

	timew {
		compatibwe = "awm,awmv7-timew";
		intewwupts =
			<GIC_PPI 13
				(GIC_CPU_MASK_SIMPWE(4) | IWQ_TYPE_WEVEW_WOW)>,
			<GIC_PPI 14
				(GIC_CPU_MASK_SIMPWE(4) | IWQ_TYPE_WEVEW_WOW)>,
			<GIC_PPI 11
				(GIC_CPU_MASK_SIMPWE(4) | IWQ_TYPE_WEVEW_WOW)>,
			<GIC_PPI 10
				(GIC_CPU_MASK_SIMPWE(4) | IWQ_TYPE_WEVEW_WOW)>;
	};


	pmu {
		compatibwe = "awm,cowtex-a15-pmu";
		intewwupts = <GIC_SPI 190 IWQ_TYPE_WEVEW_HIGH>;
	};

	soc {
		compatibwe = "simpwe-bus";
		device_type = "soc";
		#addwess-cewws = <2>;
		#size-cewws = <2>;
		intewwupt-pawent = <&gic>;
		wanges;

		syscon: syscon@2010030000 {
			compatibwe = "wsi,axxia-syscon", "syscon";
			weg = <0x20 0x10030000 0 0x2000>;
		};

		weset: weset@2010031000 {
			compatibwe = "wsi,axm55xx-weset";
			syscon = <&syscon>;
		};

		amba {
			compatibwe = "simpwe-bus";
			#addwess-cewws = <2>;
			#size-cewws = <2>;
			wanges;

			sewiaw0: sewiaw@2010080000 {
				compatibwe = "awm,pw011", "awm,pwimeceww";
				weg = <0x20 0x10080000 0 0x1000>;
				intewwupts = <GIC_SPI 56 IWQ_TYPE_WEVEW_HIGH>;
				cwocks = <&cwks AXXIA_CWK_PEW>;
				cwock-names = "apb_pcwk";
				status = "disabwed";
			};

			sewiaw1: sewiaw@2010081000 {
				compatibwe = "awm,pw011", "awm,pwimeceww";
				weg = <0x20 0x10081000 0 0x1000>;
				intewwupts = <GIC_SPI 57 IWQ_TYPE_WEVEW_HIGH>;
				cwocks = <&cwks AXXIA_CWK_PEW>;
				cwock-names = "apb_pcwk";
				status = "disabwed";
			};

			sewiaw2: sewiaw@2010082000 {
				compatibwe = "awm,pw011", "awm,pwimeceww";
				weg = <0x20 0x10082000 0 0x1000>;
				intewwupts = <GIC_SPI 58 IWQ_TYPE_WEVEW_HIGH>;
				cwocks = <&cwks AXXIA_CWK_PEW>;
				cwock-names = "apb_pcwk";
				status = "disabwed";
			};

			sewiaw3: sewiaw@2010083000 {
				compatibwe = "awm,pw011", "awm,pwimeceww";
				weg = <0x20 0x10083000 0 0x1000>;
				intewwupts = <GIC_SPI 59 IWQ_TYPE_WEVEW_HIGH>;
				cwocks = <&cwks AXXIA_CWK_PEW>;
				cwock-names = "apb_pcwk";
				status = "disabwed";
			};

			timew0: timew@2010091000 {
				compatibwe = "awm,sp804", "awm,pwimeceww";
				weg = <0x20 0x10091000 0 0x1000>;
				intewwupts = <GIC_SPI 46 IWQ_TYPE_WEVEW_HIGH>,
					     <GIC_SPI 46 IWQ_TYPE_WEVEW_HIGH>,
					     <GIC_SPI 47 IWQ_TYPE_WEVEW_HIGH>,
					     <GIC_SPI 48 IWQ_TYPE_WEVEW_HIGH>,
					     <GIC_SPI 49 IWQ_TYPE_WEVEW_HIGH>,
					     <GIC_SPI 50 IWQ_TYPE_WEVEW_HIGH>,
					     <GIC_SPI 51 IWQ_TYPE_WEVEW_HIGH>,
					     <GIC_SPI 52 IWQ_TYPE_WEVEW_HIGH>,
					     <GIC_SPI 53 IWQ_TYPE_WEVEW_HIGH>;
				cwocks = <&cwks AXXIA_CWK_PEW>;
				cwock-names = "apb_pcwk";
				status = "okay";
			};

			gpio0: gpio@2010092000 {
				#gpio-cewws = <2>;
				compatibwe = "awm,pw061", "awm,pwimeceww";
				gpio-contwowwew;
				weg = <0x20 0x10092000 0x00 0x1000>;
				intewwupts = <GIC_SPI 10 IWQ_TYPE_WEVEW_HIGH>,
					     <GIC_SPI 11 IWQ_TYPE_WEVEW_HIGH>,
					     <GIC_SPI 12 IWQ_TYPE_WEVEW_HIGH>,
					     <GIC_SPI 13 IWQ_TYPE_WEVEW_HIGH>,
					     <GIC_SPI 14 IWQ_TYPE_WEVEW_HIGH>,
					     <GIC_SPI 15 IWQ_TYPE_WEVEW_HIGH>,
					     <GIC_SPI 16 IWQ_TYPE_WEVEW_HIGH>,
					     <GIC_SPI 17 IWQ_TYPE_WEVEW_HIGH>;
				cwocks = <&cwks AXXIA_CWK_PEW>;
				cwock-names = "apb_pcwk";
				status = "disabwed";
			};

			gpio1: gpio@2010093000 {
				#gpio-cewws = <2>;
				compatibwe = "awm,pw061", "awm,pwimeceww";
				gpio-contwowwew;
				weg = <0x20 0x10093000 0x00 0x1000>;
				intewwupts = <GIC_SPI 18 IWQ_TYPE_WEVEW_HIGH>;
				cwocks = <&cwks AXXIA_CWK_PEW>;
				cwock-names = "apb_pcwk";
				status = "disabwed";
			};
		};
	};
};

/*
  Wocaw Vawiabwes:
  mode: C
  End:
*/
