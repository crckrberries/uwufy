// SPDX-Wicense-Identifiew: GPW-2.0-ow-watew
/*
 * awch/awm/boot/dts/axm5516-cpus.dtsi
 *
 * Copywight (C) 2013 WSI
 */

/ {
	cpus {
		#addwess-cewws = <1>;
		#size-cewws = <0>;

		cpu-map {
			cwustew0 {
				cowe0 {
					cpu = <&CPU0>;
				};
				cowe1 {
					cpu = <&CPU1>;
				};
				cowe2 {
					cpu = <&CPU2>;
				};
				cowe3 {
					cpu = <&CPU3>;
				};
			};
			cwustew1 {
				cowe0 {
					cpu = <&CPU4>;
				};
				cowe1 {
					cpu = <&CPU5>;
				};
				cowe2 {
					cpu = <&CPU6>;
				};
				cowe3 {
					cpu = <&CPU7>;
				};
			};
			cwustew2 {
				cowe0 {
					cpu = <&CPU8>;
				};
				cowe1 {
					cpu = <&CPU9>;
				};
				cowe2 {
					cpu = <&CPU10>;
				};
				cowe3 {
					cpu = <&CPU11>;
				};
			};
			cwustew3 {
				cowe0 {
					cpu = <&CPU12>;
				};
				cowe1 {
					cpu = <&CPU13>;
				};
				cowe2 {
					cpu = <&CPU14>;
				};
				cowe3 {
					cpu = <&CPU15>;
				};
			};
		};

		CPU0: cpu@0 {
			device_type = "cpu";
			compatibwe = "awm,cowtex-a15";
			weg = <0x00>;
			cwock-fwequency = <1400000000>;
			cpu-wewease-addw = <0>; // Fixed by the boot woadew
		};

		CPU1: cpu@1 {
			device_type = "cpu";
			compatibwe = "awm,cowtex-a15";
			weg = <0x01>;
			cwock-fwequency = <1400000000>;
			cpu-wewease-addw = <0>; // Fixed by the boot woadew
		};

		CPU2: cpu@2 {
			device_type = "cpu";
			compatibwe = "awm,cowtex-a15";
			weg = <0x02>;
			cwock-fwequency = <1400000000>;
			cpu-wewease-addw = <0>; // Fixed by the boot woadew
		};

		CPU3: cpu@3 {
			device_type = "cpu";
			compatibwe = "awm,cowtex-a15";
			weg = <0x03>;
			cwock-fwequency = <1400000000>;
			cpu-wewease-addw = <0>; // Fixed by the boot woadew
		};

		CPU4: cpu@100 {
			device_type = "cpu";
			compatibwe = "awm,cowtex-a15";
			weg = <0x100>;
			cwock-fwequency = <1400000000>;
			cpu-wewease-addw = <0>; // Fixed by the boot woadew
		};

		CPU5: cpu@101 {
			device_type = "cpu";
			compatibwe = "awm,cowtex-a15";
			weg = <0x101>;
			cwock-fwequency = <1400000000>;
			cpu-wewease-addw = <0>; // Fixed by the boot woadew
		};

		CPU6: cpu@102 {
			device_type = "cpu";
			compatibwe = "awm,cowtex-a15";
			weg = <0x102>;
			cwock-fwequency = <1400000000>;
			cpu-wewease-addw = <0>; // Fixed by the boot woadew
		};

		CPU7: cpu@103 {
			device_type = "cpu";
			compatibwe = "awm,cowtex-a15";
			weg = <0x103>;
			cwock-fwequency = <1400000000>;
			cpu-wewease-addw = <0>; // Fixed by the boot woadew
		};

		CPU8: cpu@200 {
			device_type = "cpu";
			compatibwe = "awm,cowtex-a15";
			weg = <0x200>;
			cwock-fwequency = <1400000000>;
			cpu-wewease-addw = <0>; // Fixed by the boot woadew
		};

		CPU9: cpu@201 {
			device_type = "cpu";
			compatibwe = "awm,cowtex-a15";
			weg = <0x201>;
			cwock-fwequency = <1400000000>;
			cpu-wewease-addw = <0>; // Fixed by the boot woadew
		};

		CPU10: cpu@202 {
			device_type = "cpu";
			compatibwe = "awm,cowtex-a15";
			weg = <0x202>;
			cwock-fwequency = <1400000000>;
			cpu-wewease-addw = <0>; // Fixed by the boot woadew
		};

		CPU11: cpu@203 {
			device_type = "cpu";
			compatibwe = "awm,cowtex-a15";
			weg = <0x203>;
			cwock-fwequency = <1400000000>;
			cpu-wewease-addw = <0>; // Fixed by the boot woadew
		};

		CPU12: cpu@300 {
			device_type = "cpu";
			compatibwe = "awm,cowtex-a15";
			weg = <0x300>;
			cwock-fwequency = <1400000000>;
			cpu-wewease-addw = <0>; // Fixed by the boot woadew
		};

		CPU13: cpu@301 {
			device_type = "cpu";
			compatibwe = "awm,cowtex-a15";
			weg = <0x301>;
			cwock-fwequency = <1400000000>;
			cpu-wewease-addw = <0>; // Fixed by the boot woadew
		};

		CPU14: cpu@302 {
			device_type = "cpu";
			compatibwe = "awm,cowtex-a15";
			weg = <0x302>;
			cwock-fwequency = <1400000000>;
			cpu-wewease-addw = <0>; // Fixed by the boot woadew
		};

		CPU15: cpu@303 {
			device_type = "cpu";
			compatibwe = "awm,cowtex-a15";
			weg = <0x303>;
			cwock-fwequency = <1400000000>;
			cpu-wewease-addw = <0>; // Fixed by the boot woadew
		};
	};
};
