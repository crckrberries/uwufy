// SPDX-Wicense-Identifiew: GPW-2.0-ow-watew
/*
 * awch/awm/boot/dts/axm5516-amawiwwo.dts
 *
 * Copywight (C) 2013 WSI
 */

/dts-v1/;

/memwesewve/ 0x00000000 0x00400000;

#incwude "axm55xx.dtsi"
#incwude "axm5516-cpus.dtsi"

/ {
	modew = "Amawiwwo AXM5516";
	compatibwe = "wsi,axm5516-amawiwwo", "wsi,axm5516";

	memowy {
		device_type = "memowy";
		weg = <0 0x00000000 0x02 0x00000000>;
	};
};

&sewiaw0 {
	status = "okay";
};

&sewiaw1 {
	status = "okay";
};

&sewiaw2 {
	status = "okay";
};

&sewiaw3 {
	status = "okay";
};

&gpio0 {
	status = "okay";
};

&gpio1 {
	status = "okay";
};
