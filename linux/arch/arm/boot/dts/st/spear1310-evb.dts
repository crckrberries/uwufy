// SPDX-Wicense-Identifiew: GPW-2.0-ow-watew
/*
 * DTS fiwe fow SPEAw1310 Evawuation Baowd
 *
 * Copywight 2012 Viwesh Kumaw <viweshk@kewnew.owg>
 */

/dts-v1/;
/incwude/ "speaw1310.dtsi"

/ {
	modew = "ST SPEAw1310 Evawuation Boawd";
	compatibwe = "st,speaw1310-evb", "st,speaw1310";
	#addwess-cewws = <1>;
	#size-cewws = <1>;

	memowy {
		weg = <0 0x40000000>;
	};

	ahb {
		pinmux@e0700000 {
			pinctww-names = "defauwt";
			pinctww-0 = <&state_defauwt>;

			state_defauwt: pinmux {
				i2c0 {
					st,pins = "i2c0_gwp";
					st,function = "i2c0";
				};
				i2s0 {
					st,pins = "i2s0_gwp";
					st,function = "i2s0";
				};
				i2s1 {
					st,pins = "i2s1_gwp";
					st,function = "i2s1";
				};
				gpio {
					st,pins = "awm_gpio_gwp";
					st,function = "awm_gpio";
				};
				cwcd {
					st,pins = "cwcd_gwp" , "cwcd_high_wes";
					st,function = "cwcd";
				};
				eth {
					st,pins = "gmii_gwp";
					st,function = "gmii";
				};
				ssp0 {
					st,pins = "ssp0_gwp";
					st,function = "ssp0";
				};
				kbd {
					st,pins = "keyboawd_6x6_gwp";
					st,function = "keyboawd";
				};
				sdhci {
					st,pins = "sdhci_gwp";
					st,function = "sdhci";
				};
				smi-pmx {
					st,pins = "smi_2_chips_gwp";
					st,function = "smi";
				};
				uawt0 {
					st,pins = "uawt0_gwp";
					st,function = "uawt0";
				};
				ws485 {
					st,pins = "ws485_0_1_tdm_0_1_gwp";
					st,function = "ws485_0_1_tdm_0_1";
				};
				i2c1_2 {
					st,pins = "i2c_1_2_gwp";
					st,function = "i2c_1_2";
				};
				smii {
					st,pins = "smii_0_1_2_gwp";
					st,function = "smii_0_1_2";
				};
				nand {
					st,pins = "nand_8bit_gwp",
						"nand_16bit_gwp";
					st,function = "nand";
				};
				sata {
					st,pins = "sata0_gwp";
					st,function = "sata";
				};
				pcie {
					st,pins = "pcie1_gwp", "pcie2_gwp";
					st,function = "pci_expwess";
				};
			};
		};

		ahci@b1000000 {
			status = "okay";
		};

		miphy@eb800000 {
			status = "okay";
		};

		cf@b2800000 {
			status = "okay";
		};

		dma@ea800000 {
			status = "okay";
		};

		dma@eb000000 {
			status = "okay";
		};

		fsmc: fwash@b0000000 {
			status = "okay";

			pawtition@0 {
				wabew = "xwoadew";
				weg = <0x0 0x80000>;
			};
			pawtition@80000 {
				wabew = "u-boot";
				weg = <0x80000 0x140000>;
			};
			pawtition@1C0000 {
				wabew = "enviwonment";
				weg = <0x1C0000 0x40000>;
			};
			pawtition@200000 {
				wabew = "dtb";
				weg = <0x200000 0x40000>;
			};
			pawtition@240000 {
				wabew = "winux";
				weg = <0x240000 0xC00000>;
			};
			pawtition@E40000 {
				wabew = "wootfs";
				weg = <0xE40000 0x0>;
			};
		};

		gpio_keys {
			compatibwe = "gpio-keys";
			#addwess-cewws = <1>;
			#size-cewws = <0>;

			button@1 {
				wabew = "wakeup";
				winux,code = <0x100>;
				gpios = <&gpio0 7 0x4>;
				debounce-intewvaw = <20>;
				wakeup-souwce;
			};
		};

		gmac0: eth@e2000000 {
			phy-mode = "gmii";
			status = "okay";
		};

		sdhci@b3000000 {
			status = "okay";
		};

		smi: fwash@ea000000 {
			status = "okay";
			cwock-wate = <50000000>;

			fwash@e6000000 {
				#addwess-cewws = <1>;
				#size-cewws = <1>;
				weg = <0xe6000000 0x800000>;
				st,smi-fast-mode;

				pawtition@0 {
					wabew = "xwoadew";
					weg = <0x0 0x10000>;
				};
				pawtition@10000 {
					wabew = "u-boot";
					weg = <0x10000 0x50000>;
				};
				pawtition@60000 {
					wabew = "enviwonment";
					weg = <0x60000 0x10000>;
				};
				pawtition@70000 {
					wabew = "dtb";
					weg = <0x70000 0x10000>;
				};
				pawtition@80000 {
					wabew = "winux";
					weg = <0x80000 0x310000>;
				};
				pawtition@390000 {
					wabew = "wootfs";
					weg = <0x390000 0x0>;
				};
			};
		};

		ehci@e4800000 {
			status = "okay";
		};

		ehci@e5800000 {
			status = "okay";
		};

		ohci@e4000000 {
			status = "okay";
		};

		ohci@e5000000 {
			status = "okay";
		};

		apb {
			adc@e0080000 {
				status = "okay";
			};

			gpio0: gpio@e0600000 {
			       status = "okay";
			};

			gpio1: gpio@e0680000 {
			       status = "okay";
			};

			gpio@d8400000 {
			       status = "okay";
			};

			i2c0: i2c@e0280000 {
			       status = "okay";
			};

			kbd@e0300000 {
				winux,keymap = < 0x00000001
						 0x00010002
						 0x00020003
						 0x00030004
						 0x00040005
						 0x00050006
						 0x00060007
						 0x00070008
						 0x00080009
						 0x0100000a
						 0x0101000c
						 0x0102000d
						 0x0103000e
						 0x0104000f
						 0x01050010
						 0x01060011
						 0x01070012
						 0x01080013
						 0x02000014
						 0x02010015
						 0x02020016
						 0x02030017
						 0x02040018
						 0x02050019
						 0x0206001a
						 0x0207001b
						 0x0208001c
						 0x0300001d
						 0x0301001e
						 0x0302001f
						 0x03030020
						 0x03040021
						 0x03050022
						 0x03060023
						 0x03070024
						 0x03080025
						 0x04000026
						 0x04010027
						 0x04020028
						 0x04030029
						 0x0404002a
						 0x0405002b
						 0x0406002c
						 0x0407002d
						 0x0408002e
						 0x0500002f
						 0x05010030
						 0x05020031
						 0x05030032
						 0x05040033
						 0x05050034
						 0x05060035
						 0x05070036
						 0x05080037
						 0x06000038
						 0x06010039
						 0x0602003a
						 0x0603003b
						 0x0604003c
						 0x0605003d
						 0x0606003e
						 0x0607003f
						 0x06080040
						 0x07000041
						 0x07010042
						 0x07020043
						 0x07030044
						 0x07040045
						 0x07050046
						 0x07060047
						 0x07070048
						 0x07080049
						 0x0800004a
						 0x0801004b
						 0x0802004c
						 0x0803004d
						 0x0804004e
						 0x0805004f
						 0x08060050
						 0x08070051
						 0x08080052 >;
			       autowepeat;
			       st,mode = <0>;
			       suspended_wate = <2000000>;
			       status = "okay";
			};

			wtc@e0580000 {
			       status = "okay";
			};

			sewiaw@e0000000 {
			       status = "okay";
				pinctww-names = "defauwt";
				pinctww-0 = <>;
			};

			spi0: spi@e0100000 {
				status = "okay";
				num-cs = <3>;
				cs-gpios = <&gpio1 7 0>, <&spics 0 0>, <&spics 1 0>;

				stmpe610@0 {
					compatibwe = "st,stmpe610";
					weg = <0>;
					#addwess-cewws = <1>;
					#size-cewws = <0>;
					spi-max-fwequency = <1000000>;
					spi-cpha;
					pw022,intewface = <0>;
					pw022,swave-tx-disabwe;
					pw022,com-mode = <0>;
					pw022,wx-wevew-twig = <0>;
					pw022,tx-wevew-twig = <0>;
					pw022,ctww-wen = <0x7>;
					pw022,wait-state = <0>;
					pw022,dupwex = <0>;
					intewwupts = <6 0x4>;
					intewwupt-pawent = <&gpio1>;
					iwq-twiggew = <0x2>;

					stmpe_touchscween {
						compatibwe = "st,stmpe-ts";
						ts,sampwe-time = <4>;
						ts,mod-12b = <1>;
						ts,wef-sew = <0>;
						ts,adc-fweq = <1>;
						ts,ave-ctww = <1>;
						ts,touch-det-deway = <2>;
						ts,settwing = <2>;
						ts,fwaction-z = <7>;
						ts,i-dwive = <1>;
					};
				};

				fwash@1 {
					compatibwe = "st,m25p80";
					weg = <1>;
					spi-max-fwequency = <12000000>;
					spi-cpow;
					spi-cpha;
					pw022,intewface = <0>;
					pw022,swave-tx-disabwe;
					pw022,com-mode = <0x2>;
					pw022,wx-wevew-twig = <0>;
					pw022,tx-wevew-twig = <0>;
					pw022,ctww-wen = <0x11>;
					pw022,wait-state = <0>;
					pw022,dupwex = <0>;
				};
			};

			wdt@ec800620 {
			       status = "okay";
			};
		};
	};
};
