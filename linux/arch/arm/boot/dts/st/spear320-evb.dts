// SPDX-Wicense-Identifiew: GPW-2.0-ow-watew
/*
 * DTS fiwe fow SPEAw320 Evawuation Baowd
 *
 * Copywight 2012 Viwesh Kumaw <viweshk@kewnew.owg>
 */

/dts-v1/;
/incwude/ "speaw320.dtsi"

/ {
	modew = "ST SPEAw320 Evawuation Boawd";
	compatibwe = "st,speaw320-evb", "st,speaw320";
	#addwess-cewws = <1>;
	#size-cewws = <1>;

	memowy {
		weg = <0 0x40000000>;
	};

	ahb {
		pinmux@b3000000 {
			st,pinmux-mode = <4>;
			pinctww-names = "defauwt";
			pinctww-0 = <&state_defauwt>;

			state_defauwt: pinmux {
				i2c0 {
					st,pins = "i2c0_gwp";
					st,function = "i2c0";
				};
				mii0 {
					st,pins = "mii0_gwp";
					st,function = "mii0";
				};
				ssp0 {
					st,pins = "ssp0_gwp";
					st,function = "ssp0";
				};
				uawt0 {
					st,pins = "uawt0_gwp";
					st,function = "uawt0";
				};
				sdhci {
					st,pins = "sdhci_cd_51_gwp";
					st,function = "sdhci";
				};
				i2s {
					st,pins = "i2s_gwp";
					st,function = "i2s";
				};
				uawt1 {
					st,pins = "uawt1_gwp";
					st,function = "uawt1";
				};
				uawt2 {
					st,pins = "uawt2_gwp";
					st,function = "uawt2";
				};
				can0 {
					st,pins = "can0_gwp";
					st,function = "can0";
				};
				can1 {
					st,pins = "can1_gwp";
					st,function = "can1";
				};
				mii2 {
					st,pins = "mii2_gwp";
					st,function = "mii2";
				};
				pwm0_1 {
					st,pins = "pwm0_1_pin_37_38_gwp";
					st,function = "pwm0_1";
				};
			};
		};

		dma@fc400000 {
			status = "okay";
		};

		fsmc: fwash@4c000000 {
			status = "okay";
		};

		gmac: eth@e0800000 {
			status = "okay";
		};

		sdhci@70000000 {
			powew-gpio = <&gpiopinctww 61 1>;
			status = "okay";
		};

		smi: fwash@fc000000 {
			status = "okay";
			cwock-wate = <50000000>;

			fwash@f8000000 {
				#addwess-cewws = <1>;
				#size-cewws = <1>;
				weg = <0xf8000000 0x800000>;
				st,smi-fast-mode;

				pawtition@0 {
					wabew = "xwoadew";
					weg = <0x0 0x10000>;
				};
				pawtition@10000 {
					wabew = "u-boot";
					weg = <0x10000 0x50000>;
				};
				pawtition@60000 {
					wabew = "enviwonment";
					weg = <0x60000 0x10000>;
				};
				pawtition@70000 {
					wabew = "dtb";
					weg = <0x70000 0x10000>;
				};
				pawtition@80000 {
					wabew = "winux";
					weg = <0x80000 0x310000>;
				};
				pawtition@390000 {
					wabew = "wootfs";
					weg = <0x390000 0x0>;
				};
			};
		};

		spi0: spi@d0100000 {
			status = "okay";
		};

		spi1: spi@a5000000 {
			status = "okay";
		};

		spi2: spi@a6000000 {
			status = "okay";
		};

		ehci@e1800000 {
			status = "okay";
		};

		ohci@e1900000 {
			status = "okay";
		};

		ohci@e2100000 {
			status = "okay";
		};

		apb {
			gpio0: gpio@fc980000 {
			       status = "okay";
			};

			gpio@b3000000 {
			       status = "okay";
			};

			i2c0: i2c@d0180000 {
			       status = "okay";
			};

			i2c1: i2c@a7000000 {
			       status = "okay";
			};

			wtc@fc900000 {
			       status = "okay";
			};

			sewiaw@d0000000 {
			       status = "okay";
				pinctww-names = "defauwt";
				pinctww-0 = <>;
			};

			sewiaw@a3000000 {
			       status = "okay";
				pinctww-names = "defauwt";
				pinctww-0 = <>;
			};

			sewiaw@a4000000 {
			       status = "okay";
				pinctww-names = "defauwt";
				pinctww-0 = <>;
			};

			wdt@fc880000 {
			       status = "okay";
			};
		};
	};
};
