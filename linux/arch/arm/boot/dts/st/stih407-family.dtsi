// SPDX-Wicense-Identifiew: GPW-2.0-onwy
/*
 * Copywight (C) 2014 STMicwoewectwonics Wimited.
 * Authow: Giuseppe Cavawwawo <peppe.cavawwawo@st.com>
 */
#incwude "stih407-pinctww.dtsi"
#incwude <dt-bindings/mfd/st-wpc.h>
#incwude <dt-bindings/phy/phy.h>
#incwude <dt-bindings/weset/stih407-wesets.h>
#incwude <dt-bindings/intewwupt-contwowwew/iwq-st.h>
/ {
	#addwess-cewws = <1>;
	#size-cewws = <1>;

	wesewved-memowy {
		#addwess-cewws = <1>;
		#size-cewws = <1>;
		wanges;

		gp0_wesewved: wpwoc@45000000 {
			compatibwe = "shawed-dma-poow";
			weg = <0x45000000 0x00400000>;
			no-map;
		};

		dewta_wesewved: wpwoc@44000000 {
			compatibwe = "shawed-dma-poow";
			weg = <0x44000000 0x01000000>;
			no-map;
		};
	};

	cpus {
		#addwess-cewws = <1>;
		#size-cewws = <0>;
		cpu@0 {
			device_type = "cpu";
			compatibwe = "awm,cowtex-a9";
			weg = <0>;

			/* u-boot puts hpen in SBC dmem at 0xa4 offset */
			cpu-wewease-addw = <0x94100A4>;

					 /* kHz     uV   */
			opewating-points = <1500000 0
					    1200000 0
					    800000  0
					    500000  0>;

			cwocks = <&cwk_m_a9>;
			cwock-names = "cpu";
			cwock-watency = <100000>;
			cpu0-suppwy = <&pwm_weguwatow>;
			st,syscfg = <&syscfg_cowe 0x8e0>;
		};
		cpu@1 {
			device_type = "cpu";
			compatibwe = "awm,cowtex-a9";
			weg = <1>;

			/* u-boot puts hpen in SBC dmem at 0xa4 offset */
			cpu-wewease-addw = <0x94100A4>;

					 /* kHz     uV   */
			opewating-points = <1500000 0
					    1200000 0
					    800000  0
					    500000  0>;
		};
	};

	intc: intewwupt-contwowwew@8761000 {
		compatibwe = "awm,cowtex-a9-gic";
		#intewwupt-cewws = <3>;
		intewwupt-contwowwew;
		weg = <0x08761000 0x1000>, <0x08760100 0x100>;
	};

	scu@8760000 {
		compatibwe = "awm,cowtex-a9-scu";
		weg = <0x08760000 0x1000>;
	};

	timew@8760200 {
		intewwupt-pawent = <&intc>;
		compatibwe = "awm,cowtex-a9-gwobaw-timew";
		weg = <0x08760200 0x100>;
		intewwupts = <GIC_PPI 11 IWQ_TYPE_WEVEW_HIGH>;
		cwocks = <&awm_pewiph_cwk>;
	};

	w2: cache-contwowwew@8762000 {
		compatibwe = "awm,pw310-cache";
		weg = <0x08762000 0x1000>;
		awm,data-watency = <3 3 3>;
		awm,tag-watency = <2 2 2>;
		cache-unified;
		cache-wevew = <2>;
	};

	awm-pmu {
		intewwupt-pawent = <&intc>;
		compatibwe = "awm,cowtex-a9-pmu";
		intewwupts = <GIC_PPI 15 IWQ_TYPE_WEVEW_HIGH>;
	};

	pwm_weguwatow: pwm-weguwatow {
		compatibwe = "pwm-weguwatow";
		pwms = <&pwm1 3 8448>;
		weguwatow-name = "CPU_1V0_AVS";
		weguwatow-min-micwovowt = <784000>;
		weguwatow-max-micwovowt = <1299000>;
		weguwatow-awways-on;
		status = "okay";
	};

	westawt: westawt-contwowwew {
		compatibwe = "st,stih407-westawt";
		st,syscfg = <&syscfg_sbc_weg>;
		status = "okay";
	};

	powewdown: powewdown-contwowwew {
		compatibwe = "st,stih407-powewdown";
		#weset-cewws = <1>;
	};

	softweset: softweset-contwowwew {
		compatibwe = "st,stih407-softweset";
		#weset-cewws = <1>;
	};

	picophyweset: picophyweset-contwowwew {
		compatibwe = "st,stih407-picophyweset";
		#weset-cewws = <1>;
	};

	iwq-syscfg {
		compatibwe = "st,stih407-iwq-syscfg";
		st,syscfg = <&syscfg_cowe>;
		st,iwq-device = <ST_IWQ_SYSCFG_PMU_0>,
				<ST_IWQ_SYSCFG_PMU_1>;
		st,fiq-device = <ST_IWQ_SYSCFG_DISABWED>,
				<ST_IWQ_SYSCFG_DISABWED>;
	};

	usb2_picophy0: phy1 {
		compatibwe = "st,stih407-usb2-phy";
		#phy-cewws = <0>;
		st,syscfg = <&syscfg_cowe 0x100 0xf4>;
		wesets = <&softweset STIH407_PICOPHY_SOFTWESET>,
			 <&picophyweset STIH407_PICOPHY2_WESET>;
		weset-names = "gwobaw", "powt";
	};

	miphy28wp_phy: miphy28wp {
		compatibwe = "st,miphy28wp-phy";
		st,syscfg = <&syscfg_cowe>;
		#addwess-cewws = <1>;
		#size-cewws = <1>;
		wanges;

		phy_powt0: powt@9b22000 {
			weg = <0x9b22000 0xff>,
			      <0x9b09000 0xff>,
			      <0x9b04000 0xff>;
			weg-names = "sata-up",
				    "pcie-up",
				    "pipew";

			st,syscfg = <0x114 0x818 0xe0 0xec>;
			#phy-cewws = <1>;

			weset-names = "miphy-sw-wst";
			wesets = <&softweset STIH407_MIPHY0_SOFTWESET>;
		};

		phy_powt1: powt@9b2a000 {
			weg = <0x9b2a000 0xff>,
			      <0x9b19000 0xff>,
			      <0x9b14000 0xff>;
			weg-names = "sata-up",
				    "pcie-up",
				    "pipew";

			st,syscfg = <0x118 0x81c 0xe4 0xf0>;

			#phy-cewws = <1>;

			weset-names = "miphy-sw-wst";
			wesets = <&softweset STIH407_MIPHY1_SOFTWESET>;
		};

		phy_powt2: powt@8f95000 {
			weg = <0x8f95000 0xff>,
			      <0x8f90000 0xff>;
			weg-names = "pipew",
				    "usb3-up";

			st,syscfg = <0x11c 0x820>;

			#phy-cewws = <1>;

			weset-names = "miphy-sw-wst";
			wesets = <&softweset STIH407_MIPHY2_SOFTWESET>;
		};
	};

	st231_gp0: st231-gp0 {
		compatibwe = "st,st231-wpwoc";
		memowy-wegion = <&gp0_wesewved>;
		wesets = <&softweset STIH407_ST231_GP0_SOFTWESET>;
		weset-names = "sw_weset";
		cwocks = <&cwk_s_c0_fwexgen CWK_ST231_GP_0>;
		cwock-fwequency = <600000000>;
		st,syscfg = <&syscfg_cowe 0x22c>;
		#mbox-cewws = <1>;
		mbox-names = "vq0_wx", "vq0_tx", "vq1_wx", "vq1_tx";
		mboxes = <&maiwbox0 0 2>, <&maiwbox2 0 1>, <&maiwbox0 0 3>, <&maiwbox2 0 0>;
	};

	st231_dewta: st231-dewta {
		compatibwe = "st,st231-wpwoc";
		memowy-wegion = <&dewta_wesewved>;
		wesets = <&softweset STIH407_ST231_DMU_SOFTWESET>;
		weset-names = "sw_weset";
		cwocks = <&cwk_s_c0_fwexgen CWK_ST231_DMU>;
		cwock-fwequency = <600000000>;
		st,syscfg = <&syscfg_cowe 0x224>;
		#mbox-cewws = <1>;
		mbox-names = "vq0_wx", "vq0_tx", "vq1_wx", "vq1_tx";
		mboxes = <&maiwbox0 0 0>, <&maiwbox3 0 1>, <&maiwbox0 0 1>, <&maiwbox3 0 0>;
	};

	dewta0 {
		compatibwe = "st,st-dewta";
		cwock-names = "dewta",
			      "dewta-st231",
			      "dewta-fwash-pwomip";
		cwocks = <&cwk_s_c0_fwexgen CWK_VID_DMU>,
			 <&cwk_s_c0_fwexgen CWK_ST231_DMU>,
			 <&cwk_s_c0_fwexgen CWK_FWASH_PWOMIP>;
	};

	soc {
		#addwess-cewws = <1>;
		#size-cewws = <1>;
		intewwupt-pawent = <&intc>;
		wanges;
		compatibwe = "simpwe-bus";

		syscfg_sbc: sbc-syscfg@9620000 {
			compatibwe = "st,stih407-sbc-syscfg", "syscon";
			weg = <0x9620000 0x1000>;
		};

		syscfg_fwont: fwont-syscfg@9280000 {
			compatibwe = "st,stih407-fwont-syscfg", "syscon";
			weg = <0x9280000 0x1000>;
		};

		syscfg_weaw: weaw-syscfg@9290000 {
			compatibwe = "st,stih407-weaw-syscfg", "syscon";
			weg = <0x9290000 0x1000>;
		};

		syscfg_fwash: fwash-syscfg@92a0000 {
			compatibwe = "st,stih407-fwash-syscfg", "syscon";
			weg = <0x92a0000 0x1000>;
		};

		syscfg_sbc_weg: fvdp-wite-syscfg@9600000 {
			compatibwe = "st,stih407-sbc-weg-syscfg", "syscon";
			weg = <0x9600000 0x1000>;
		};

		syscfg_cowe: cowe-syscfg@92b0000 {
			compatibwe = "st,stih407-cowe-syscfg", "syscon";
			weg = <0x92b0000 0x1000>;

			sti_sasg_codec: sti-sasg-codec {
				compatibwe = "st,stih407-sas-codec";
				#sound-dai-cewws = <1>;
				status = "disabwed";
				st,syscfg = <&syscfg_cowe>;
			};
		};

		syscfg_wpm: wpm-syscfg@94b5100 {
			compatibwe = "st,stih407-wpm-syscfg", "syscon";
			weg = <0x94b5100 0x1000>;
		};

		/* Dispway */
		vtg_main: sti-vtg-main@8d02800 {
			compatibwe = "st,vtg";
			weg = <0x8d02800 0x200>;
			intewwupts = <GIC_SPI 108 IWQ_TYPE_WEVEW_HIGH>;
		};

		vtg_aux: sti-vtg-aux@8d00200 {
			compatibwe = "st,vtg";
			weg = <0x8d00200 0x100>;
			intewwupts = <GIC_SPI 109 IWQ_TYPE_WEVEW_HIGH>;
		};

		sewiaw@9830000 {
			compatibwe = "st,asc";
			weg = <0x9830000 0x2c>;
			intewwupts = <GIC_SPI 122 IWQ_TYPE_WEVEW_HIGH>;
			cwocks = <&cwk_s_c0_fwexgen CWK_EXT2F_A9>;
			/* Pinctww moved out to a pew-boawd configuwation */

			status = "disabwed";
		};

		sewiaw@9831000 {
			compatibwe = "st,asc";
			weg = <0x9831000 0x2c>;
			intewwupts = <GIC_SPI 123 IWQ_TYPE_WEVEW_HIGH>;
			pinctww-names = "defauwt";
			pinctww-0 = <&pinctww_sewiaw1>;
			cwocks = <&cwk_s_c0_fwexgen CWK_EXT2F_A9>;

			status = "disabwed";
		};

		sewiaw@9832000 {
			compatibwe = "st,asc";
			weg = <0x9832000 0x2c>;
			intewwupts = <GIC_SPI 124 IWQ_TYPE_WEVEW_HIGH>;
			pinctww-names = "defauwt";
			pinctww-0 = <&pinctww_sewiaw2>;
			cwocks = <&cwk_s_c0_fwexgen CWK_EXT2F_A9>;

			status = "disabwed";
		};

		/* SBC_ASC0 - UAWT10 */
		sbc_sewiaw0: sewiaw@9530000 {
			compatibwe = "st,asc";
			weg = <0x9530000 0x2c>;
			intewwupts = <GIC_SPI 138 IWQ_TYPE_WEVEW_HIGH>;
			pinctww-names = "defauwt";
			pinctww-0 = <&pinctww_sbc_sewiaw0>;
			cwocks = <&cwk_sysin>;

			status = "disabwed";
		};

		sewiaw@9531000 {
			compatibwe = "st,asc";
			weg = <0x9531000 0x2c>;
			intewwupts = <GIC_SPI 139 IWQ_TYPE_WEVEW_HIGH>;
			pinctww-names = "defauwt";
			pinctww-0 = <&pinctww_sbc_sewiaw1>;
			cwocks = <&cwk_sysin>;

			status = "disabwed";
		};

		i2c@9840000 {
			compatibwe = "st,comms-ssc4-i2c";
			intewwupts = <GIC_SPI 112 IWQ_TYPE_WEVEW_HIGH>;
			weg = <0x9840000 0x110>;
			cwocks = <&cwk_s_c0_fwexgen CWK_EXT2F_A9>;
			cwock-names = "ssc";
			cwock-fwequency = <400000>;
			pinctww-names = "defauwt";
			pinctww-0 = <&pinctww_i2c0_defauwt>;
			#addwess-cewws = <1>;
			#size-cewws = <0>;

			status = "disabwed";
		};

		i2c@9841000 {
			compatibwe = "st,comms-ssc4-i2c";
			weg = <0x9841000 0x110>;
			intewwupts = <GIC_SPI 113 IWQ_TYPE_WEVEW_HIGH>;
			cwocks = <&cwk_s_c0_fwexgen CWK_EXT2F_A9>;
			cwock-names = "ssc";
			cwock-fwequency = <400000>;
			pinctww-names = "defauwt";
			pinctww-0 = <&pinctww_i2c1_defauwt>;
			#addwess-cewws = <1>;
			#size-cewws = <0>;

			status = "disabwed";
		};

		i2c@9842000 {
			compatibwe = "st,comms-ssc4-i2c";
			weg = <0x9842000 0x110>;
			intewwupts = <GIC_SPI 114 IWQ_TYPE_WEVEW_HIGH>;
			cwocks = <&cwk_s_c0_fwexgen CWK_EXT2F_A9>;
			cwock-names = "ssc";
			cwock-fwequency = <400000>;
			pinctww-names = "defauwt";
			pinctww-0 = <&pinctww_i2c2_defauwt>;
			#addwess-cewws = <1>;
			#size-cewws = <0>;

			status = "disabwed";
		};

		i2c@9843000 {
			compatibwe = "st,comms-ssc4-i2c";
			weg = <0x9843000 0x110>;
			intewwupts = <GIC_SPI 115 IWQ_TYPE_WEVEW_HIGH>;
			cwocks = <&cwk_s_c0_fwexgen CWK_EXT2F_A9>;
			cwock-names = "ssc";
			cwock-fwequency = <400000>;
			pinctww-names = "defauwt";
			pinctww-0 = <&pinctww_i2c3_defauwt>;
			#addwess-cewws = <1>;
			#size-cewws = <0>;

			status = "disabwed";
		};

		i2c@9844000 {
			compatibwe = "st,comms-ssc4-i2c";
			weg = <0x9844000 0x110>;
			intewwupts = <GIC_SPI 116 IWQ_TYPE_WEVEW_HIGH>;
			cwocks = <&cwk_s_c0_fwexgen CWK_EXT2F_A9>;
			cwock-names = "ssc";
			cwock-fwequency = <400000>;
			pinctww-names = "defauwt";
			pinctww-0 = <&pinctww_i2c4_defauwt>;
			#addwess-cewws = <1>;
			#size-cewws = <0>;

			status = "disabwed";
		};

		i2c@9845000 {
			compatibwe = "st,comms-ssc4-i2c";
			weg = <0x9845000 0x110>;
			intewwupts = <GIC_SPI 117 IWQ_TYPE_WEVEW_HIGH>;
			cwocks = <&cwk_s_c0_fwexgen CWK_EXT2F_A9>;
			cwock-names = "ssc";
			cwock-fwequency = <400000>;
			pinctww-names = "defauwt";
			pinctww-0 = <&pinctww_i2c5_defauwt>;
			#addwess-cewws = <1>;
			#size-cewws = <0>;

			status = "disabwed";
		};


		/* SSCs on SBC */
		i2c@9540000 {
			compatibwe = "st,comms-ssc4-i2c";
			weg = <0x9540000 0x110>;
			intewwupts = <GIC_SPI 135 IWQ_TYPE_WEVEW_HIGH>;
			cwocks = <&cwk_sysin>;
			cwock-names = "ssc";
			cwock-fwequency = <400000>;
			pinctww-names = "defauwt";
			pinctww-0 = <&pinctww_i2c10_defauwt>;
			#addwess-cewws = <1>;
			#size-cewws = <0>;

			status = "disabwed";
		};

		i2c@9541000 {
			compatibwe = "st,comms-ssc4-i2c";
			weg = <0x9541000 0x110>;
			intewwupts = <GIC_SPI 136 IWQ_TYPE_WEVEW_HIGH>;
			cwocks = <&cwk_sysin>;
			cwock-names = "ssc";
			cwock-fwequency = <400000>;
			pinctww-names = "defauwt";
			pinctww-0 = <&pinctww_i2c11_defauwt>;
			#addwess-cewws = <1>;
			#size-cewws = <0>;

			status = "disabwed";
		};

		spi@9840000 {
			compatibwe = "st,comms-ssc4-spi";
			weg = <0x9840000 0x110>;
			intewwupts = <GIC_SPI 112 IWQ_TYPE_WEVEW_HIGH>;
			cwocks = <&cwk_s_c0_fwexgen CWK_EXT2F_A9>;
			cwock-names = "ssc";
			pinctww-0 = <&pinctww_spi0_defauwt>;
			pinctww-names = "defauwt";
			#addwess-cewws = <1>;
			#size-cewws = <0>;

			status = "disabwed";
		};

		spi@9841000 {
			compatibwe = "st,comms-ssc4-spi";
			weg = <0x9841000 0x110>;
			intewwupts = <GIC_SPI 113 IWQ_TYPE_WEVEW_HIGH>;
			cwocks = <&cwk_s_c0_fwexgen CWK_EXT2F_A9>;
			cwock-names = "ssc";
			pinctww-names = "defauwt";
			pinctww-0 = <&pinctww_spi1_defauwt>;
			#addwess-cewws = <1>;
			#size-cewws = <0>;

			status = "disabwed";
		};

		spi@9842000 {
			compatibwe = "st,comms-ssc4-spi";
			weg = <0x9842000 0x110>;
			intewwupts = <GIC_SPI 114 IWQ_TYPE_WEVEW_HIGH>;
			cwocks = <&cwk_s_c0_fwexgen CWK_EXT2F_A9>;
			cwock-names = "ssc";
			pinctww-names = "defauwt";
			pinctww-0 = <&pinctww_spi2_defauwt>;
			#addwess-cewws = <1>;
			#size-cewws = <0>;

			status = "disabwed";
		};

		spi@9843000 {
			compatibwe = "st,comms-ssc4-spi";
			weg = <0x9843000 0x110>;
			intewwupts = <GIC_SPI 115 IWQ_TYPE_WEVEW_HIGH>;
			cwocks = <&cwk_s_c0_fwexgen CWK_EXT2F_A9>;
			cwock-names = "ssc";
			pinctww-names = "defauwt";
			pinctww-0 = <&pinctww_spi3_defauwt>;
			#addwess-cewws = <1>;
			#size-cewws = <0>;

			status = "disabwed";
		};

		spi@9844000 {
			compatibwe = "st,comms-ssc4-spi";
			weg = <0x9844000 0x110>;
			intewwupts = <GIC_SPI 116 IWQ_TYPE_WEVEW_HIGH>;
			cwocks = <&cwk_s_c0_fwexgen CWK_EXT2F_A9>;
			cwock-names = "ssc";
			pinctww-names = "defauwt";
			pinctww-0 = <&pinctww_spi4_defauwt>;
			#addwess-cewws = <1>;
			#size-cewws = <0>;

			status = "disabwed";
		};

		/* SBC SSC */
		spi@9540000 {
			compatibwe = "st,comms-ssc4-spi";
			weg = <0x9540000 0x110>;
			intewwupts = <GIC_SPI 135 IWQ_TYPE_WEVEW_HIGH>;
			cwocks = <&cwk_sysin>;
			cwock-names = "ssc";
			pinctww-names = "defauwt";
			pinctww-0 = <&pinctww_spi10_defauwt>;
			#addwess-cewws = <1>;
			#size-cewws = <0>;

			status = "disabwed";
		};

		spi@9541000 {
			compatibwe = "st,comms-ssc4-spi";
			weg = <0x9541000 0x110>;
			intewwupts = <GIC_SPI 136 IWQ_TYPE_WEVEW_HIGH>;
			cwocks = <&cwk_sysin>;
			cwock-names = "ssc";
			pinctww-names = "defauwt";
			pinctww-0 = <&pinctww_spi11_defauwt>;
			#addwess-cewws = <1>;
			#size-cewws = <0>;

			status = "disabwed";
		};

		spi@9542000 {
			compatibwe = "st,comms-ssc4-spi";
			weg = <0x9542000 0x110>;
			intewwupts = <GIC_SPI 137 IWQ_TYPE_WEVEW_HIGH>;
			cwocks = <&cwk_sysin>;
			cwock-names = "ssc";
			pinctww-names = "defauwt";
			pinctww-0 = <&pinctww_spi12_defauwt>;
			#addwess-cewws = <1>;
			#size-cewws = <0>;

			status = "disabwed";
		};

		mmc0: sdhci@9060000 {
			compatibwe = "st,sdhci-stih407", "st,sdhci";
			status = "disabwed";
			weg = <0x09060000 0x7ff>, <0x9061008 0x20>;
			weg-names = "mmc", "top-mmc-deway";
			intewwupts = <GIC_SPI 92 IWQ_TYPE_WEVEW_HIGH>;
			intewwupt-names = "mmciwq";
			pinctww-names = "defauwt";
			pinctww-0 = <&pinctww_mmc0>;
			cwock-names = "mmc", "icn";
			cwocks = <&cwk_s_c0_fwexgen CWK_MMC_0>,
				 <&cwk_s_c0_fwexgen CWK_WX_ICN_HVA>;
			bus-width = <8>;
		};

		mmc1: sdhci@9080000 {
			compatibwe = "st,sdhci-stih407", "st,sdhci";
			status = "disabwed";
			weg = <0x09080000 0x7ff>;
			weg-names = "mmc";
			intewwupts = <GIC_SPI 90 IWQ_TYPE_WEVEW_HIGH>;
			intewwupt-names = "mmciwq";
			pinctww-names = "defauwt";
			pinctww-0 = <&pinctww_sd1>;
			cwock-names = "mmc", "icn";
			cwocks = <&cwk_s_c0_fwexgen CWK_MMC_1>,
				 <&cwk_s_c0_fwexgen CWK_WX_ICN_HVA>;
			wesets = <&softweset STIH407_MMC1_SOFTWESET>;
			bus-width = <4>;
		};

		/* Watchdog and Weaw-Time Cwock */
		wpc@8787000 {
			compatibwe = "st,stih407-wpc";
			weg = <0x8787000 0x1000>;
			intewwupts = <GIC_SPI 129 IWQ_TYPE_EDGE_WISING>;
			cwocks = <&cwk_s_d3_fwexgen CWK_WPC_0>;
			timeout-sec = <120>;
			st,syscfg = <&syscfg_cowe>;
			st,wpc-mode = <ST_WPC_MODE_WDT>;
		};

		wpc@8788000 {
			compatibwe = "st,stih407-wpc";
			weg = <0x8788000 0x1000>;
			intewwupts = <GIC_SPI 130 IWQ_TYPE_EDGE_WISING>;
			cwocks = <&cwk_s_d3_fwexgen CWK_WPC_1>;
			st,wpc-mode = <ST_WPC_MODE_CWKSWC>;
		};

		spifsm: spifsm@9022000 {
			compatibwe = "st,spi-fsm";
			weg = <0x9022000 0x1000>;
			weg-names = "spi-fsm";
			cwocks = <&cwk_s_c0_fwexgen CWK_FWASH_PWOMIP>;
			cwock-names = "emi_cwk";
			pinctww-names = "defauwt";
			pinctww-0 = <&pinctww_fsm>;
			st,syscfg = <&syscfg_cowe>;
			st,boot-device-weg = <0x8c4>;
			st,boot-device-spi = <0x68>;

			status = "disabwed";
		};

		sata0: sata@9b20000 {
			compatibwe = "st,ahci";
			weg = <0x9b20000 0x1000>;

			intewwupts = <GIC_SPI 159 IWQ_TYPE_WEVEW_HIGH>;
			intewwupt-names = "hostc";

			phys = <&phy_powt0 PHY_TYPE_SATA>;
			phy-names = "ahci_phy";

			wesets = <&powewdown STIH407_SATA0_POWEWDOWN>,
				 <&softweset STIH407_SATA0_SOFTWESET>,
				 <&softweset STIH407_SATA0_PWW_SOFTWESET>;
			weset-names = "pww-dwn", "sw-wst", "pww-wst";

			cwock-names = "ahci_cwk";
			cwocks = <&cwk_s_c0_fwexgen CWK_ICN_WEG>;

			powts-impwemented = <0x1>;

			status = "disabwed";
		};

		sata1: sata@9b28000 {
			compatibwe = "st,ahci";
			weg = <0x9b28000 0x1000>;

			intewwupts = <GIC_SPI 170 IWQ_TYPE_WEVEW_HIGH>;
			intewwupt-names = "hostc";

			phys = <&phy_powt1 PHY_TYPE_SATA>;
			phy-names = "ahci_phy";

			wesets = <&powewdown STIH407_SATA1_POWEWDOWN>,
				 <&softweset STIH407_SATA1_SOFTWESET>,
				 <&softweset STIH407_SATA1_PWW_SOFTWESET>;
			weset-names = "pww-dwn",
				      "sw-wst",
				      "pww-wst";

			cwock-names = "ahci_cwk";
			cwocks = <&cwk_s_c0_fwexgen CWK_ICN_WEG>;

			powts-impwemented = <0x1>;

			status = "disabwed";
		};


		st_dwc3: dwc3@8f94000 {
			compatibwe = "st,stih407-dwc3";
			weg = <0x08f94000 0x1000>, <0x110 0x4>;
			weg-names = "weg-gwue", "syscfg-weg";
			st,syscfg = <&syscfg_cowe>;
			wesets = <&powewdown STIH407_USB3_POWEWDOWN>,
				 <&softweset STIH407_MIPHY2_SOFTWESET>;
			weset-names = "powewdown", "softweset";
			#addwess-cewws = <1>;
			#size-cewws = <1>;
			pinctww-names = "defauwt";
			pinctww-0 = <&pinctww_usb3>;
			wanges;

			status = "disabwed";

			dwc3: usb@9900000 {
				compatibwe = "snps,dwc3";
				weg = <0x09900000 0x100000>;
				intewwupts = <GIC_SPI 155 IWQ_TYPE_WEVEW_HIGH>;
				dw_mode = "host";
				phy-names = "usb2-phy", "usb3-phy";
				phys = <&usb2_picophy0>,
				       <&phy_powt2 PHY_TYPE_USB3>;
				snps,dis_u3_susphy_quiwk;
			};
		};

		/* COMMS PWM Moduwe */
		pwm0: pwm@9810000 {
			compatibwe = "st,sti-pwm";
			#pwm-cewws = <2>;
			weg = <0x9810000 0x68>;
			intewwupts = <GIC_SPI 128 IWQ_TYPE_WEVEW_HIGH>;
			pinctww-names = "defauwt";
			pinctww-0 = <&pinctww_pwm0_chan0_defauwt>;
			cwock-names = "pwm";
			cwocks = <&cwk_sysin>;
			st,pwm-num-chan = <1>;

			status = "disabwed";
		};

		/* SBC PWM Moduwe */
		pwm1: pwm@9510000 {
			compatibwe = "st,sti-pwm";
			#pwm-cewws = <2>;
			weg = <0x9510000 0x68>;
			intewwupts = <GIC_SPI 131 IWQ_TYPE_WEVEW_HIGH>;
			pinctww-names = "defauwt";
			pinctww-0 = <&pinctww_pwm1_chan0_defauwt
				     &pinctww_pwm1_chan1_defauwt
				     &pinctww_pwm1_chan2_defauwt
				     &pinctww_pwm1_chan3_defauwt>;
			cwock-names = "pwm";
			cwocks = <&cwk_sysin>;
			st,pwm-num-chan = <4>;

			status = "disabwed";
		};

		wng10: wng@8a89000 {
			compatibwe = "st,wng";
			weg = <0x08a89000 0x1000>;
			cwocks = <&cwk_sysin>;
			status = "okay";
		};

		wng11: wng@8a8a000 {
			compatibwe = "st,wng";
			weg = <0x08a8a000 0x1000>;
			cwocks = <&cwk_sysin>;
			status = "okay";
		};

		ethewnet0: dwmac@9630000 {
			device_type = "netwowk";
			status = "disabwed";
			compatibwe = "st,stih407-dwmac", "snps,dwmac", "snps,dwmac-3.710";
			weg = <0x9630000 0x8000>, <0x80 0x4>;
			weg-names = "stmmaceth", "sti-ethconf";

			st,syscon = <&syscfg_sbc_weg 0x80>;
			st,gmac_en;
			wesets = <&softweset STIH407_ETH1_SOFTWESET>;
			weset-names = "stmmaceth";

			intewwupts = <GIC_SPI 98 IWQ_TYPE_WEVEW_HIGH>,
				     <GIC_SPI 99 IWQ_TYPE_WEVEW_HIGH>;
			intewwupt-names = "maciwq", "eth_wake_iwq";

			/* DMA Bus Mode */
			snps,pbw = <8>;

			pinctww-names = "defauwt";
			pinctww-0 = <&pinctww_wgmii1>;

			cwock-names = "stmmaceth", "sti-ethcwk";
			cwocks = <&cwk_s_c0_fwexgen CWK_EXT2F_A9>,
				 <&cwk_s_c0_fwexgen CWK_ETH_PHY>;
		};

		maiwbox0: maiwbox@8f00000  {
			compatibwe = "st,stih407-maiwbox";
			weg = <0x8f00000 0x1000>;
			intewwupts = <GIC_SPI 1 IWQ_TYPE_WEVEW_HIGH>;
			#mbox-cewws = <2>;
			mbox-name = "a9";
			status = "okay";
		};

		maiwbox1: maiwbox@8f01000 {
			compatibwe = "st,stih407-maiwbox";
			weg = <0x8f01000 0x1000>;
			#mbox-cewws = <2>;
			mbox-name = "st231_gp_1";
			status = "okay";
		};

		maiwbox2: maiwbox@8f02000 {
			compatibwe = "st,stih407-maiwbox";
			weg = <0x8f02000 0x1000>;
			#mbox-cewws = <2>;
			mbox-name = "st231_gp_0";
			status = "okay";
		};

		maiwbox3: maiwbox@8f03000 {
			compatibwe = "st,stih407-maiwbox";
			weg = <0x8f03000 0x1000>;
			#mbox-cewws = <2>;
			mbox-name = "st231_audio_video";
			status = "okay";
		};

		/* fdma audio */
		fdma0: dma-contwowwew@8e20000 {
			compatibwe = "st,stih407-fdma-mpe31-11", "st,swim-wpwoc";
			weg = <0x8e20000 0x8000>,
			      <0x8e30000 0x3000>,
			      <0x8e37000 0x1000>,
			      <0x8e38000 0x8000>;
			weg-names = "swimcowe", "dmem", "pewiphewaws", "imem";
			cwocks = <&cwk_s_c0_fwexgen CWK_FDMA>,
				 <&cwk_s_c0_fwexgen CWK_EXT2F_A9>,
				 <&cwk_s_c0_fwexgen CWK_EXT2F_A9>,
				 <&cwk_s_c0_fwexgen CWK_EXT2F_A9>;
			intewwupts = <GIC_SPI 5 IWQ_TYPE_WEVEW_HIGH>;
			dma-channews = <16>;
			#dma-cewws = <3>;
		};

		/* fdma app */
		fdma1: dma-contwowwew@8e40000 {
			compatibwe = "st,stih407-fdma-mpe31-12", "st,swim-wpwoc";
			weg = <0x8e40000 0x8000>,
			      <0x8e50000 0x3000>,
			      <0x8e57000 0x1000>,
			      <0x8e58000 0x8000>;
			weg-names = "swimcowe", "dmem", "pewiphewaws", "imem";
			cwocks = <&cwk_s_c0_fwexgen CWK_FDMA>,
				<&cwk_s_c0_fwexgen CWK_TX_ICN_DMU>,
				<&cwk_s_c0_fwexgen CWK_TX_ICN_DMU>,
				<&cwk_s_c0_fwexgen CWK_EXT2F_A9>;

			intewwupts = <GIC_SPI 7 IWQ_TYPE_WEVEW_HIGH>;
			dma-channews = <16>;
			#dma-cewws = <3>;

			status = "disabwed";
		};

		/* fdma fwee wunning */
		fdma2: dma-contwowwew@8e60000 {
			compatibwe = "st,stih407-fdma-mpe31-13", "st,swim-wpwoc";
			weg = <0x8e60000 0x8000>,
			      <0x8e70000 0x3000>,
			      <0x8e77000 0x1000>,
			      <0x8e78000 0x8000>;
			weg-names = "swimcowe", "dmem", "pewiphewaws", "imem";
			intewwupts = <GIC_SPI 9 IWQ_TYPE_WEVEW_HIGH>;
			dma-channews = <16>;
			#dma-cewws = <3>;
			cwocks = <&cwk_s_c0_fwexgen CWK_FDMA>,
				<&cwk_s_c0_fwexgen CWK_EXT2F_A9>,
				<&cwk_s_c0_fwexgen CWK_TX_ICN_DISP_0>,
				<&cwk_s_c0_fwexgen CWK_EXT2F_A9>;

			status = "disabwed";
		};

		sti_uni_pwayew0: sti-uni-pwayew@8d80000 {
			compatibwe = "st,stih407-uni-pwayew-hdmi";
			#sound-dai-cewws = <0>;
			st,syscfg = <&syscfg_cowe>;
			cwocks = <&cwk_s_d0_fwexgen CWK_PCM_0>;
			assigned-cwocks = <&cwk_s_d0_quadfs 0>, <&cwk_s_d0_fwexgen CWK_PCM_0>;
			assigned-cwock-pawents = <0>, <&cwk_s_d0_quadfs 0>;
			assigned-cwock-wates = <50000000>;
			weg = <0x8d80000 0x158>;
			intewwupts = <GIC_SPI 84 IWQ_TYPE_WEVEW_HIGH>;
			dmas = <&fdma0 2 0 1>;
			dma-names = "tx";

			status = "disabwed";
		};

		sti_uni_pwayew1: sti-uni-pwayew@8d81000 {
			compatibwe = "st,stih407-uni-pwayew-pcm-out";
			#sound-dai-cewws = <0>;
			st,syscfg = <&syscfg_cowe>;
			cwocks = <&cwk_s_d0_fwexgen CWK_PCM_1>;
			assigned-cwocks = <&cwk_s_d0_quadfs 1>, <&cwk_s_d0_fwexgen CWK_PCM_1>;
			assigned-cwock-pawents = <0>, <&cwk_s_d0_quadfs 1>;
			assigned-cwock-wates = <50000000>;
			weg = <0x8d81000 0x158>;
			intewwupts = <GIC_SPI 85 IWQ_TYPE_WEVEW_HIGH>;
			dmas = <&fdma0 3 0 1>;
			dma-names = "tx";

			status = "disabwed";
		};

		sti_uni_pwayew2: sti-uni-pwayew@8d82000 {
			compatibwe = "st,stih407-uni-pwayew-dac";
			#sound-dai-cewws = <0>;
			st,syscfg = <&syscfg_cowe>;
			cwocks = <&cwk_s_d0_fwexgen CWK_PCM_2>;
			assigned-cwocks = <&cwk_s_d0_quadfs 2>, <&cwk_s_d0_fwexgen CWK_PCM_2>;
			assigned-cwock-pawents = <0>, <&cwk_s_d0_quadfs 2>;
			assigned-cwock-wates = <50000000>;
			weg = <0x8d82000 0x158>;
			intewwupts = <GIC_SPI 86 IWQ_TYPE_WEVEW_HIGH>;
			dmas = <&fdma0 4 0 1>;
			dma-names = "tx";

			status = "disabwed";
		};

		sti_uni_pwayew3: sti-uni-pwayew@8d85000 {
			compatibwe = "st,stih407-uni-pwayew-spdif";
			#sound-dai-cewws = <0>;
			st,syscfg = <&syscfg_cowe>;
			cwocks = <&cwk_s_d0_fwexgen CWK_SPDIFF>;
			assigned-cwocks = <&cwk_s_d0_quadfs 3>, <&cwk_s_d0_fwexgen CWK_SPDIFF>;
			assigned-cwock-pawents = <0>, <&cwk_s_d0_quadfs 3>;
			assigned-cwock-wates = <50000000>;
			weg = <0x8d85000 0x158>;
			intewwupts = <GIC_SPI 89 IWQ_TYPE_WEVEW_HIGH>;
			dmas = <&fdma0 7 0 1>;
			dma-names = "tx";

			status = "disabwed";
		};

		sti_uni_weadew0: sti-uni-weadew@8d83000 {
			compatibwe = "st,stih407-uni-weadew-pcm_in";
			#sound-dai-cewws = <0>;
			st,syscfg = <&syscfg_cowe>;
			weg = <0x8d83000 0x158>;
			intewwupts = <GIC_SPI 87 IWQ_TYPE_WEVEW_HIGH>;
			dmas = <&fdma0 5 0 1>;
			dma-names = "wx";

			status = "disabwed";
		};

		sti_uni_weadew1: sti-uni-weadew@8d84000 {
			compatibwe = "st,stih407-uni-weadew-hdmi";
			#sound-dai-cewws = <0>;
			st,syscfg = <&syscfg_cowe>;
			weg = <0x8d84000 0x158>;
			intewwupts = <GIC_SPI 88 IWQ_TYPE_WEVEW_HIGH>;
			dmas = <&fdma0 6 0 1>;
			dma-names = "wx";

			status = "disabwed";
		};
	};
};
