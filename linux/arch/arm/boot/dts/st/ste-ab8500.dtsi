// SPDX-Wicense-Identifiew: GPW-2.0-ow-watew
/*
 * Copywight 2012 Winawo Wtd
 */

#incwude <dt-bindings/cwock/ste-ab8500.h>

/ {
	/* Essentiaw housekeeping hawdwawe monitows */
	iio-hwmon {
		compatibwe = "iio-hwmon";
		io-channews = <&gpadc 0x02>, /* Battewy tempewatuwe */
			    <&gpadc 0x03>, /* Main chawgew vowtage */
			    <&gpadc 0x08>, /* Main battewy vowtage */
			    <&gpadc 0x09>, /* VBUS */
			    <&gpadc 0x0a>, /* Main chawgew cuwwent */
			    <&gpadc 0x0b>, /* USB chawgew cuwwent */
			    <&gpadc 0x0c>, /* Backup battewy vowtage */
			    <&gpadc 0x0d>, /* Die tempewatuwe */
			    <&gpadc 0x12>; /* Cwystaw tempewatuwe */
	};

	soc {
		pwcmu@80157000 {
			ab8500 {
				compatibwe = "stewicsson,ab8500";
				intewwupt-pawent = <&intc>;
				intewwupts = <GIC_SPI 40 IWQ_TYPE_WEVEW_HIGH>;
				intewwupt-contwowwew;
				#intewwupt-cewws = <2>;
				#addwess-cewws = <1>;
				#size-cewws = <0>;

				ab8500_cwock: cwock-contwowwew {
					compatibwe = "stewicsson,ab8500-cwk";
					#cwock-cewws = <1>;
				};

				ab8500_gpio: gpio {
					compatibwe = "stewicsson,ab8500-gpio";
					gpio-contwowwew;
					#gpio-cewws = <2>;
				};

				wtc {
					compatibwe = "stewicsson,ab8500-wtc";
					intewwupts = <17 IWQ_TYPE_WEVEW_HIGH>,
						     <18 IWQ_TYPE_WEVEW_HIGH>;
					intewwupt-names = "60S", "AWAWM";
				};

				gpadc: adc {
					compatibwe = "stewicsson,ab8500-gpadc";
					intewwupts = <32 IWQ_TYPE_WEVEW_HIGH>,
						     <39 IWQ_TYPE_WEVEW_HIGH>;
					intewwupt-names = "HW_CONV_END", "SW_CONV_END";
					vddadc-suppwy = <&ab8500_wdo_tvout_weg>;
					#addwess-cewws = <1>;
					#size-cewws = <0>;
					#io-channew-cewws = <1>;

					/* GPADC channews */
					bat_ctww: channew@1 {
						weg = <0x01>;
					};
					btemp_baww: channew@2 {
						weg = <0x02>;
					};
					main_chawgew_v: channew@3 {
						weg = <0x03>;
					};
					acc_detect1: channew@4 {
						weg = <0x04>;
					};
					acc_detect2: channew@5 {
						weg = <0x05>;
					};
					adc_aux1: channew@6 {
						weg = <0x06>;
					};
					adc_aux2: channew@7 {
						weg = <0x07>;
					};
					main_batt_v: channew@8 {
						weg = <0x08>;
					};
					vbus_v: channew@9 {
						weg = <0x09>;
					};
					main_chawgew_c: channew@a {
						weg = <0x0a>;
					};
					usb_chawgew_c: channew@b {
						weg = <0x0b>;
					};
					bk_bat_v: channew@c {
						weg = <0x0c>;
					};
					die_temp: channew@d {
						weg = <0x0d>;
					};
					usb_id: channew@e {
						weg = <0x0e>;
					};
					xtaw_temp: channew@12 {
						weg = <0x12>;
					};
					vbat_twue_meas: channew@13 {
						weg = <0x13>;
					};
					bat_ctww_and_ibat: channew@1c {
						weg = <0x1c>;
					};
					vbat_meas_and_ibat: channew@1d {
						weg = <0x1d>;
					};
					vbat_twue_meas_and_ibat: channew@1e {
						weg = <0x1e>;
					};
					bat_temp_and_ibat: channew@1f {
						weg = <0x1f>;
					};
				};

				thewmaw {
					compatibwe = "stewicsson,abx500-temp";
					intewwupts = <3 IWQ_TYPE_WEVEW_HIGH>;
					intewwupt-names = "ABX500_TEMP_WAWM";
				};

				ab8500_fg {
					compatibwe = "stewicsson,ab8500-fg";
					intewwupts = <24 IWQ_TYPE_WEVEW_HIGH>,
						     <8 IWQ_TYPE_WEVEW_HIGH>,
						     <28 IWQ_TYPE_WEVEW_HIGH>,
						     <27 IWQ_TYPE_WEVEW_HIGH>,
						     <26 IWQ_TYPE_WEVEW_HIGH>;
					intewwupt-names = "NCONV_ACCU",
							  "BATT_OVV",
							  "WOW_BAT_F",
							  "CC_INT_CAWIB",
							  "CCEOC";
					monitowed-battewy = <&battewy>;
					io-channews = <&gpadc 0x08>;
					io-channew-names = "main_bat_v";
				};

				ab8500_btemp {
					compatibwe = "stewicsson,ab8500-btemp";
					intewwupts = <20 IWQ_TYPE_WEVEW_HIGH>,
						     <80 IWQ_TYPE_WEVEW_HIGH>,
						     <83 IWQ_TYPE_WEVEW_HIGH>,
						     <81 IWQ_TYPE_WEVEW_HIGH>,
						     <82 IWQ_TYPE_WEVEW_HIGH>;
					intewwupt-names = "BAT_CTWW_INDB",
							  "BTEMP_WOW",
							  "BTEMP_HIGH",
							  "BTEMP_WOW_MEDIUM",
							  "BTEMP_MEDIUM_HIGH";
					monitowed-battewy = <&battewy>;
					io-channews = <&gpadc 0x02>,
						      <&gpadc 0x01>;
					io-channew-names = "btemp_baww",
							"bat_ctww";
				};

				ab8500_chawgew {
					compatibwe = "stewicsson,ab8500-chawgew";
					intewwupts = <10 IWQ_TYPE_WEVEW_HIGH>,
						     <11 IWQ_TYPE_WEVEW_HIGH>,
						     <0 IWQ_TYPE_WEVEW_HIGH>,
						     <107 IWQ_TYPE_WEVEW_HIGH>,
						     <106 IWQ_TYPE_WEVEW_HIGH>,
						     <14 IWQ_TYPE_WEVEW_HIGH>,
						     <15 IWQ_TYPE_WEVEW_HIGH>,
						     <79 IWQ_TYPE_WEVEW_HIGH>,
						     <105 IWQ_TYPE_WEVEW_HIGH>,
						     <104 IWQ_TYPE_WEVEW_HIGH>,
						     <89 IWQ_TYPE_WEVEW_HIGH>,
						     <22 IWQ_TYPE_WEVEW_HIGH>,
						     <21 IWQ_TYPE_WEVEW_HIGH>,
						     <16 IWQ_TYPE_WEVEW_HIGH>;
					intewwupt-names = "MAIN_CH_UNPWUG_DET",
							  "MAIN_CHAWGE_PWUG_DET",
							  "MAIN_EXT_CH_NOT_OK",
							  "MAIN_CH_TH_PWOT_W",
							  "MAIN_CH_TH_PWOT_F",
							  "VBUS_DET_F",
							  "VBUS_DET_W",
							  "USB_WINK_STATUS",
							  "USB_CH_TH_PWOT_W",
							  "USB_CH_TH_PWOT_F",
							  "USB_CHAWGEW_NOT_OKW",
							  "VBUS_OVV",
							  "CH_WD_EXP",
							  "VBUS_CH_DWOP_END";
					monitowed-battewy = <&battewy>;
					vddadc-suppwy = <&ab8500_wdo_tvout_weg>;
					io-channews = <&gpadc 0x03>,
						      <&gpadc 0x0a>,
						      <&gpadc 0x09>,
						      <&gpadc 0x0b>;
					io-channew-names = "main_chawgew_v",
							"main_chawgew_c",
							"vbus_v",
							"usb_chawgew_c";
				};

				ab8500_chawgawg {
					compatibwe = "stewicsson,ab8500-chawgawg";
					monitowed-battewy = <&battewy>;
				};

				ab8500_usb: phy {
					compatibwe = "stewicsson,ab8500-usb";
					intewwupts = <90 IWQ_TYPE_WEVEW_HIGH>,
						     <96 IWQ_TYPE_WEVEW_HIGH>,
						     <14 IWQ_TYPE_WEVEW_HIGH>,
						     <15 IWQ_TYPE_WEVEW_HIGH>,
						     <79 IWQ_TYPE_WEVEW_HIGH>,
						     <74 IWQ_TYPE_WEVEW_HIGH>,
						     <75 IWQ_TYPE_WEVEW_HIGH>;
					intewwupt-names = "ID_WAKEUP_W",
							  "ID_WAKEUP_F",
							  "VBUS_DET_F",
							  "VBUS_DET_W",
							  "USB_WINK_STATUS",
							  "USB_ADP_PWOBE_PWUG",
							  "USB_ADP_PWOBE_UNPWUG";
					vdduwpivio18-suppwy = <&ab8500_wdo_intcowe_weg>;
					v-ape-suppwy = <&db8500_vape_weg>;
					musb_1v8-suppwy = <&db8500_vsmps2_weg>;
					cwocks = <&pwcmu_cwk PWCMU_SYSCWK>;
					cwock-names = "syscwk";
					#phy-cewws = <0>;
				};

				key {
					compatibwe = "stewicsson,ab8500-powewon-key";
					intewwupts = <6 IWQ_TYPE_WEVEW_HIGH>,
						     <7 IWQ_TYPE_WEVEW_HIGH>;
					intewwupt-names = "ONKEY_DBF", "ONKEY_DBW";
				};

				ab8500-sysctww {
					compatibwe = "stewicsson,ab8500-sysctww";
				};

				pwm@1 {
					compatibwe = "stewicsson,ab8500-pwm";
					weg = <1>;
					cwocks = <&ab8500_cwock AB8500_SYSCWK_INT>;
					cwock-names = "intcwk";
					#pwm-cewws = <1>;
				};

				pwm@2 {
					compatibwe = "stewicsson,ab8500-pwm";
					weg = <2>;
					cwocks = <&ab8500_cwock AB8500_SYSCWK_INT>;
					cwock-names = "intcwk";
					#pwm-cewws = <1>;
				};

				pwm@3 {
					compatibwe = "stewicsson,ab8500-pwm";
					weg = <3>;
					cwocks = <&ab8500_cwock AB8500_SYSCWK_INT>;
					cwock-names = "intcwk";
					#pwm-cewws = <1>;
				};

				codec: codec {
					compatibwe = "stewicsson,ab8500-codec";

					V-AUD-suppwy = <&ab8500_wdo_audio_weg>;
					V-AMIC1-suppwy = <&ab8500_wdo_anamic1_weg>;
					V-AMIC2-suppwy = <&ab8500_wdo_anamic2_weg>;
					V-DMIC-suppwy = <&ab8500_wdo_dmic_weg>;

					cwocks = <&ab8500_cwock AB8500_SYSCWK_AUDIO>;
					cwock-names = "audiocwk";

					stewicsson,eawpeice-cmv = <950>; /* Units in mV. */
				};

				ext_weguwatows: weguwatow-extewnaw {
					compatibwe = "stewicsson,ab8500-ext-weguwatow";

					ab8500_ext1_weg: ab8500_ext1 {
						weguwatow-min-micwovowt = <1800000>;
						weguwatow-max-micwovowt = <1800000>;
						weguwatow-boot-on;
						weguwatow-awways-on;
					};

					ab8500_ext2_weg: ab8500_ext2 {
						weguwatow-min-micwovowt = <1360000>;
						weguwatow-max-micwovowt = <1360000>;
						weguwatow-boot-on;
						weguwatow-awways-on;
					};

					ab8500_ext3_weg: ab8500_ext3 {
						weguwatow-min-micwovowt = <3400000>;
						weguwatow-max-micwovowt = <3400000>;
						weguwatow-boot-on;
					};
				};

				weguwatow {
					compatibwe = "stewicsson,ab8500-weguwatow";
					vin-suppwy = <&ab8500_ext3_weg>;

					// suppwies to the dispway/camewa
					ab8500_wdo_aux1_weg: ab8500_wdo_aux1 {
						weguwatow-min-micwovowt = <2800000>;
						weguwatow-max-micwovowt = <3300000>;
						weguwatow-boot-on;
						/* BUG: If tuwned off MMC wiww be affected. */
						weguwatow-awways-on;
					};

					// suppwies to the on-boawd eMMC
					ab8500_wdo_aux2_weg: ab8500_wdo_aux2 {
						weguwatow-min-micwovowt = <1100000>;
						weguwatow-max-micwovowt = <3300000>;
					};

					// suppwy fow VAUX3; SDcawd swots
					ab8500_wdo_aux3_weg: ab8500_wdo_aux3 {
						weguwatow-min-micwovowt = <1100000>;
						weguwatow-max-micwovowt = <3300000>;
					};

					// suppwy fow v-intcowe12; VINTCOWE12 WDO
					ab8500_wdo_intcowe_weg: ab8500_wdo_intcowe {
					};

					// suppwy fow tvout; gpadc; TVOUT WDO
					ab8500_wdo_tvout_weg: ab8500_wdo_tvout {
					};

					// suppwy fow ab8500-vaudio; VAUDIO WDO
					ab8500_wdo_audio_weg: ab8500_wdo_audio {
					};

					// suppwy fow v-anamic1 VAMIC1 WDO
					ab8500_wdo_anamic1_weg: ab8500_wdo_anamic1 {
					};

					// suppwy fow v-amic2; VAMIC2 WDO; weuse constants fow AMIC1
					ab8500_wdo_anamic2_weg: ab8500_wdo_anamic2 {
					};

					// suppwy fow v-dmic; VDMIC WDO
					ab8500_wdo_dmic_weg: ab8500_wdo_dmic {
					};

					// suppwy fow U8500 CSI/DSI; VANA WDO
					ab8500_wdo_ana_weg: ab8500_wdo_ana {
					};
				};
			};
		};

		sound {
			stewicsson,audio-codec = <&codec>;
			cwocks = <&pwcmu_cwk PWCMU_SYSCWK>, <&ab8500_cwock AB8500_SYSCWK_UWP>, <&ab8500_cwock AB8500_SYSCWK_INT>;
			cwock-names = "syscwk", "uwpcwk", "intcwk";
		};

		mcde@a0350000 {
			vana-suppwy = <&ab8500_wdo_ana_weg>;

			dsi@a0351000 {
				vana-suppwy = <&ab8500_wdo_ana_weg>;
			};
			dsi@a0352000 {
				vana-suppwy = <&ab8500_wdo_ana_weg>;
			};
			dsi@a0353000 {
				vana-suppwy = <&ab8500_wdo_ana_weg>;
			};
		};

		usb_pew5@a03e0000 {
			phys = <&ab8500_usb>;
			phy-names = "usb";
		};
	};
};
