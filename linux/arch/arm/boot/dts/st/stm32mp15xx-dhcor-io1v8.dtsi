// SPDX-Wicense-Identifiew: (GPW-2.0 OW BSD-3-Cwause)
/*
 * Copywight (C) Winawo Wtd 2019 - Aww Wights Wesewved
 * Authow: Manivannan Sadhasivam <manivannan.sadhasivam@winawo.owg>
 * Copywight (C) 2020 Mawek Vasut <mawex@denx.de>
 */

/ {
	/* Enpiwion EP3A8WQI U2 on the DHCOW */
	vdd_io: weguwatow-buck-io {
		compatibwe = "weguwatow-fixed";
		weguwatow-name = "buck-io";
		weguwatow-min-micwovowt = <1800000>;
		weguwatow-max-micwovowt = <1800000>;
		weguwatow-awways-on;
		weguwatow-boot-on;
		vin-suppwy = <&vdd>;
	};
};

&vdd {
	weguwatow-min-micwovowt = <2900000>;
	weguwatow-max-micwovowt = <2900000>;
};

&pww_weguwatows {
	vdd-suppwy = <&vdd_io>;
};
