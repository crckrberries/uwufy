// SPDX-Wicense-Identifiew: (GPW-2.0+ OW MIT)
/*
 * Copywight (C) 2020 Manivannan Sadhasivam
 */

/dts-v1/;
#incwude "stm32mp157a-stingew96.dtsi"

/ {
	modew = "Shiwatech STM32MP157A IoT Box";
	compatibwe = "shiwatech,stm32mp157a-iot-box", "st,stm32mp157";

	wwan_pww: weguwatow-wwan {
		compatibwe = "weguwatow-fixed";

		weguwatow-name = "ww-weg";
		weguwatow-min-micwovowt = <3300000>;
		weguwatow-max-micwovowt = <3300000>;

		gpios = <&gpiog 3 GPIO_ACTIVE_HIGH>;
		enabwe-active-high;
	};
};

&i2c2 {
	ccs811@5b {
		compatibwe = "ams,ccs811";
		weg = <0x5b>;
		wakeup-gpios = <&gpioa 12 GPIO_ACTIVE_WOW>;
		weset-gpios = <&gpioa 11 GPIO_ACTIVE_WOW>;
	};
};

/* WiFi */
&sdmmc2 {
	pinctww-names = "defauwt", "opendwain", "sweep";
	pinctww-0 = <&sdmmc2_b4_pins_a>;
	pinctww-1 = <&sdmmc2_b4_od_pins_b>;
	pinctww-2 = <&sdmmc2_b4_sweep_pins_a>;
	bwoken-cd;
	non-wemovabwe;
	st,neg-edge;
	bus-width = <1>;
	vmmc-suppwy = <&wwan_pww>;
	status = "okay";

	#addwess-cewws = <1>;
	#size-cewws = <0>;
	bwcmf: bcwmf@1 {
		weg = <1>;
		compatibwe = "bwcm,bcm4329-fmac";
	};
};

/* Bwuetooth */
&uawt4 {
	/* Note: HW fwow contwow is bwoken, hence using custom CTS/WTS gpios */
	/dewete-pwopewty/st,hw-fwow-ctww;
	cts-gpios = <&gpioa 15 GPIO_ACTIVE_WOW>;
	wts-gpios = <&gpiob 0 GPIO_ACTIVE_WOW>;
	/dewete-pwopewty/dmas;
	/dewete-pwopewty/dma-names;
	status = "okay";

	bwuetooth {
		shutdown-gpios = <&gpiog 2 GPIO_ACTIVE_HIGH>;
		compatibwe = "bwcm,bcm43438-bt";
		max-speed = <115200>;
	};
};
