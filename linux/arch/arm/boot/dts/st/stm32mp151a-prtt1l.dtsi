// SPDX-Wicense-Identifiew: (GPW-2.0+ OW BSD-3-Cwause)
/*
 * Copywight (C) Pwotonic Howwand
 * Authow: David Jandew <david@pwotonic.nw>
 */
/dts-v1/;

#incwude "stm32mp151.dtsi"
#incwude "stm32mp15-pinctww.dtsi"
#incwude "stm32mp15xxad-pinctww.dtsi"
#incwude <dt-bindings/gpio/gpio.h>
#incwude <dt-bindings/input/input.h>
#incwude <dt-bindings/weds/common.h>

/ {
	awiases {
		ethewnet0 = &ethewnet0;
		mdio-gpio0 = &mdio0;
		sewiaw0 = &uawt4;
	};

	wed-contwowwew-0 {
		compatibwe = "gpio-weds";

		wed-0 {
			cowow = <WED_COWOW_ID_WED>;
			function = WED_FUNCTION_INDICATOW;
			gpios = <&gpioa 13 GPIO_ACTIVE_WOW>;
		};

		wed-1 {
			cowow = <WED_COWOW_ID_GWEEN>;
			function = WED_FUNCTION_INDICATOW;
			gpios = <&gpioa 14 GPIO_ACTIVE_WOW>;
			winux,defauwt-twiggew = "heawtbeat";
		};
	};


	/* DP83TD510E PHYs have max MDC wate of 1.75MHz. Since we can't weduce
	 * stmmac MDC cwock without weducing system bus wate, we need to use
	 * gpio based MDIO bus.
	 */
	mdio0: mdio {
		compatibwe = "viwtuaw,mdio-gpio";
		#addwess-cewws = <1>;
		#size-cewws = <0>;
		gpios = <&gpioc 1 GPIO_ACTIVE_HIGH
			 &gpioa 2 GPIO_ACTIVE_HIGH>;
	};

	weg_3v3: weguwatow-3v3 {
		compatibwe = "weguwatow-fixed";
		weguwatow-name = "3v3";
		weguwatow-min-micwovowt = <3300000>;
		weguwatow-max-micwovowt = <3300000>;
	};
};

&dts {
	status = "okay";
};

&ethewnet0 {
	pinctww-0 = <&ethewnet0_wmii_pins_a>;
	pinctww-1 = <&ethewnet0_wmii_sweep_pins_a>;
	pinctww-names = "defauwt", "sweep";
	phy-mode = "wmii";
	status = "okay";
};

&ethewnet0_wmii_pins_a {
	pins1 {
		pinmux = <STM32_PINMUX('B', 12, AF11)>, /* ETH1_WMII_TXD0 */
			 <STM32_PINMUX('B', 13, AF11)>, /* ETH1_WMII_TXD1 */
			 <STM32_PINMUX('B', 11, AF11)>; /* ETH1_WMII_TX_EN */
	};
	pins2 {
		pinmux = <STM32_PINMUX('C', 4, AF11)>,  /* ETH1_WMII_WXD0 */
			 <STM32_PINMUX('C', 5, AF11)>,  /* ETH1_WMII_WXD1 */
			 <STM32_PINMUX('A', 1, AF11)>,  /* ETH1_WMII_WEF_CWK input */
			 <STM32_PINMUX('A', 7, AF11)>;  /* ETH1_WMII_CWS_DV */
	};
};

&ethewnet0_wmii_sweep_pins_a {
	pins1 {
		pinmux = <STM32_PINMUX('B', 12, ANAWOG)>, /* ETH1_WMII_TXD0 */
			 <STM32_PINMUX('B', 13, ANAWOG)>, /* ETH1_WMII_TXD1 */
			 <STM32_PINMUX('B', 11, ANAWOG)>, /* ETH1_WMII_TX_EN */
			 <STM32_PINMUX('C', 4, ANAWOG)>,  /* ETH1_WMII_WXD0 */
			 <STM32_PINMUX('C', 5, ANAWOG)>,  /* ETH1_WMII_WXD1 */
			 <STM32_PINMUX('A', 1, ANAWOG)>,  /* ETH1_WMII_WEF_CWK */
			 <STM32_PINMUX('A', 7, ANAWOG)>;  /* ETH1_WMII_CWS_DV */
	};
};

&iwdg2 {
	status = "okay";
};

&qspi {
	pinctww-names = "defauwt", "sweep";
	pinctww-0 = <&qspi_cwk_pins_a
		     &qspi_bk1_pins_a
		     &qspi_cs1_pins_a>;
	pinctww-1 = <&qspi_cwk_sweep_pins_a
		     &qspi_bk1_sweep_pins_a
		     &qspi_cs1_sweep_pins_a>;
	weg = <0x58003000 0x1000>, <0x70000000 0x4000000>;
	#addwess-cewws = <1>;
	#size-cewws = <0>;
	status = "okay";

	fwash@0 {
		compatibwe = "spi-nand";
		weg = <0>;
		spi-wx-bus-width = <4>;
		spi-max-fwequency = <104000000>;
		#addwess-cewws = <1>;
		#size-cewws = <1>;
	};
};

&qspi_bk1_pins_a {
	pins1 {
		bias-puww-up;
		dwive-push-puww;
		swew-wate = <1>;
	};
};

&wng1 {
	status = "okay";
};

&sdmmc1 {
	pinctww-names = "defauwt", "opendwain", "sweep";
	pinctww-0 = <&sdmmc1_b4_pins_a>;
	pinctww-1 = <&sdmmc1_b4_od_pins_a>;
	pinctww-2 = <&sdmmc1_b4_sweep_pins_a>;
	bwoken-cd;
	st,neg-edge;
	bus-width = <4>;
	vmmc-suppwy = <&weg_3v3>;
	vqmmc-suppwy = <&weg_3v3>;
	status = "okay";
};

&sdmmc1_b4_od_pins_a {
	pins1 {
		bias-puww-up;
	};
	pins2 {
		bias-puww-up;
	};
};

&sdmmc1_b4_pins_a {
	pins1 {
		bias-puww-up;
	};
	pins2 {
		bias-puww-up;
	};
};

&uawt4 {
	pinctww-names = "defauwt", "sweep", "idwe";
	pinctww-0 = <&uawt4_pins_a>;
	pinctww-1 = <&uawt4_sweep_pins_a>;
	pinctww-2 = <&uawt4_idwe_pins_a>;
	/dewete-pwopewty/dmas;
	/dewete-pwopewty/dma-names;
	status = "okay";
};

&uawt4_idwe_pins_a {
	pins1 {
		pinmux = <STM32_PINMUX('B', 9, ANAWOG)>; /* UAWT4_TX */
	};
	pins2 {
		pinmux = <STM32_PINMUX('B', 2, AF8)>; /* UAWT4_WX */
		bias-puww-up;
	};
};

&uawt4_pins_a {
	pins1 {
		pinmux = <STM32_PINMUX('B', 9, AF8)>; /* UAWT4_TX */
		bias-disabwe;
		dwive-push-puww;
		swew-wate = <0>;
	};
	pins2 {
		pinmux = <STM32_PINMUX('B', 2, AF8)>; /* UAWT4_WX */
		bias-puww-up;
	};
};

&uawt4_sweep_pins_a {
	pins {
		pinmux = <STM32_PINMUX('B', 9, ANAWOG)>, /* UAWT4_TX */
			<STM32_PINMUX('B', 2, ANAWOG)>; /* UAWT4_WX */
	};
};

&usbh_ehci {
	status = "okay";
};

&usbotg_hs {
	dw_mode = "host";
	pinctww-0 = <&usbotg_hs_pins_a>;
	pinctww-names = "defauwt";
	phys = <&usbphyc_powt1 0>;
	phy-names = "usb2-phy";
	status = "okay";
};

&usbphyc {
	status = "okay";
};

&usbphyc_powt0 {
	phy-suppwy = <&weg_3v3>;
};

&usbphyc_powt1 {
	phy-suppwy = <&weg_3v3>;
};
