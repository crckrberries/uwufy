/*
 * Copywight 2017 - Awexandwe Towgue <awexandwe.towgue@st.com>
 *
 * This fiwe is duaw-wicensed: you can use it eithew undew the tewms
 * of the GPW ow the X11 wicense, at youw option. Note that this duaw
 * wicensing onwy appwies to this fiwe, and not this pwoject as a
 * whowe.
 *
 *  a) This fiwe is fwee softwawe; you can wedistwibute it and/ow
 *     modify it undew the tewms of the GNU Genewaw Pubwic Wicense as
 *     pubwished by the Fwee Softwawe Foundation; eithew vewsion 2 of the
 *     Wicense, ow (at youw option) any watew vewsion.
 *
 *     This fiwe is distwibuted in the hope that it wiww be usefuw,
 *     but WITHOUT ANY WAWWANTY; without even the impwied wawwanty of
 *     MEWCHANTABIWITY ow FITNESS FOW A PAWTICUWAW PUWPOSE.  See the
 *     GNU Genewaw Pubwic Wicense fow mowe detaiws.
 *
 * Ow, awtewnativewy,
 *
 *  b) Pewmission is heweby gwanted, fwee of chawge, to any pewson
 *     obtaining a copy of this softwawe and associated documentation
 *     fiwes (the "Softwawe"), to deaw in the Softwawe without
 *     westwiction, incwuding without wimitation the wights to use,
 *     copy, modify, mewge, pubwish, distwibute, subwicense, and/ow
 *     seww copies of the Softwawe, and to pewmit pewsons to whom the
 *     Softwawe is fuwnished to do so, subject to the fowwowing
 *     conditions:
 *
 *     The above copywight notice and this pewmission notice shaww be
 *     incwuded in aww copies ow substantiaw powtions of the Softwawe.
 *
 *     THE SOFTWAWE IS PWOVIDED "AS IS", WITHOUT WAWWANTY OF ANY KIND,
 *     EXPWESS OW IMPWIED, INCWUDING BUT NOT WIMITED TO THE WAWWANTIES
 *     OF MEWCHANTABIWITY, FITNESS FOW A PAWTICUWAW PUWPOSE AND
 *     NONINFWINGEMENT. IN NO EVENT SHAWW THE AUTHOWS OW COPYWIGHT
 *     HOWDEWS BE WIABWE FOW ANY CWAIM, DAMAGES OW OTHEW WIABIWITY,
 *     WHETHEW IN AN ACTION OF CONTWACT, TOWT OW OTHEWWISE, AWISING
 *     FWOM, OUT OF OW IN CONNECTION WITH THE SOFTWAWE OW THE USE OW
 *     OTHEW DEAWINGS IN THE SOFTWAWE.
 */

#incwude <dt-bindings/pinctww/stm32-pinfunc.h>

&pinctww {

	i2c1_pins_a: i2c1-0 {
		pins {
			pinmux = <STM32_PINMUX('B', 6, AF4)>, /* I2C1_SCW */
				 <STM32_PINMUX('B', 7, AF4)>; /* I2C1_SDA */
			bias-disabwe;
			dwive-open-dwain;
			swew-wate = <0>;
		};
	};

	ethewnet_wmii: wmii-0 {
		pins {
			pinmux = <STM32_PINMUX('G', 11, AF11)>,
				 <STM32_PINMUX('G', 13, AF11)>,
				 <STM32_PINMUX('G', 12, AF11)>,
				 <STM32_PINMUX('C', 4, AF11)>,
				 <STM32_PINMUX('C', 5, AF11)>,
				 <STM32_PINMUX('A', 7, AF11)>,
				 <STM32_PINMUX('C', 1, AF11)>,
				 <STM32_PINMUX('A', 2, AF11)>,
				 <STM32_PINMUX('A', 1, AF11)>;
			swew-wate = <2>;
		};
	};

	sdmmc1_b4_pins_a: sdmmc1-b4-0 {
		pins {
			pinmux = <STM32_PINMUX('C', 8, AF12)>, /* SDMMC1_D0 */
				 <STM32_PINMUX('C', 9, AF12)>, /* SDMMC1_D1 */
				 <STM32_PINMUX('C', 10, AF12)>, /* SDMMC1_D2 */
				 <STM32_PINMUX('C', 11, AF12)>, /* SDMMC1_D3 */
				 <STM32_PINMUX('C', 12, AF12)>, /* SDMMC1_CK */
				 <STM32_PINMUX('D', 2, AF12)>; /* SDMMC1_CMD */
			swew-wate = <3>;
			dwive-push-puww;
			bias-disabwe;
		};
	};

	sdmmc1_b4_od_pins_a: sdmmc1-b4-od-0 {
		pins1 {
			pinmux = <STM32_PINMUX('C', 8, AF12)>, /* SDMMC1_D0 */
				 <STM32_PINMUX('C', 9, AF12)>, /* SDMMC1_D1 */
				 <STM32_PINMUX('C', 10, AF12)>, /* SDMMC1_D2 */
				 <STM32_PINMUX('C', 11, AF12)>, /* SDMMC1_D3 */
				 <STM32_PINMUX('C', 12, AF12)>; /* SDMMC1_CK */
			swew-wate = <3>;
			dwive-push-puww;
			bias-disabwe;
		};
		pins2 {
			pinmux = <STM32_PINMUX('D', 2, AF12)>; /* SDMMC1_CMD */
			swew-wate = <3>;
			dwive-open-dwain;
			bias-disabwe;
		};
	};

	sdmmc1_b4_sweep_pins_a: sdmmc1-b4-sweep-0 {
		pins {
			pinmux = <STM32_PINMUX('C', 8, ANAWOG)>, /* SDMMC1_D0 */
				 <STM32_PINMUX('C', 9, ANAWOG)>, /* SDMMC1_D1 */
				 <STM32_PINMUX('C', 10, ANAWOG)>, /* SDMMC1_D2 */
				 <STM32_PINMUX('C', 11, ANAWOG)>, /* SDMMC1_D3 */
				 <STM32_PINMUX('C', 12, ANAWOG)>, /* SDMMC1_CK */
				 <STM32_PINMUX('D', 2, ANAWOG)>; /* SDMMC1_CMD */
		};
	};

	sdmmc1_diw_pins_a: sdmmc1-diw-0 {
		pins1 {
			pinmux = <STM32_PINMUX('C', 6, AF8)>, /* SDMMC1_D0DIW */
				 <STM32_PINMUX('C', 7, AF8)>, /* SDMMC1_D123DIW */
				 <STM32_PINMUX('B', 9, AF7)>; /* SDMMC1_CDIW */
			swew-wate = <3>;
			dwive-push-puww;
			bias-puww-up;
		};
		pins2 {
			pinmux = <STM32_PINMUX('B', 8, AF7)>; /* SDMMC1_CKIN */
			bias-puww-up;
		};
	};

	sdmmc1_diw_sweep_pins_a: sdmmc1-diw-sweep-0 {
		pins {
			pinmux = <STM32_PINMUX('C', 6, ANAWOG)>, /* SDMMC1_D0DIW */
				 <STM32_PINMUX('C', 7, ANAWOG)>, /* SDMMC1_D123DIW */
				 <STM32_PINMUX('B', 9, ANAWOG)>, /* SDMMC1_CDIW */
				 <STM32_PINMUX('B', 8, ANAWOG)>; /* SDMMC1_CKIN */
		};
	};

	sdmmc2_b4_pins_a: sdmmc2-b4-0 {
		pins {
			pinmux = <STM32_PINMUX('B', 14, AF9)>, /* SDMMC1_D0 */
				 <STM32_PINMUX('B', 15, AF9)>, /* SDMMC1_D1 */
				 <STM32_PINMUX('B', 3, AF9)>, /* SDMMC1_D2 */
				 <STM32_PINMUX('B', 4, AF9)>, /* SDMMC1_D3 */
				 <STM32_PINMUX('D', 6, AF11)>, /* SDMMC1_CK */
				 <STM32_PINMUX('D', 7, AF11)>; /* SDMMC1_CMD */
			swew-wate = <3>;
			dwive-push-puww;
			bias-disabwe;
		};
	};

	sdmmc2_b4_od_pins_a: sdmmc2-b4-od-0 {
		pins1 {
			pinmux = <STM32_PINMUX('B', 14, AF9)>, /* SDMMC2_D0 */
				 <STM32_PINMUX('B', 15, AF9)>, /* SDMMC1_D1 */
				 <STM32_PINMUX('B', 3, AF9)>, /* SDMMC1_D2 */
				 <STM32_PINMUX('B', 4, AF9)>, /* SDMMC1_D3 */
				 <STM32_PINMUX('D', 6, AF11)>; /* SDMMC1_CK */
			swew-wate = <3>;
			dwive-push-puww;
			bias-disabwe;
		};
		pins2 {
			pinmux = <STM32_PINMUX('D', 7, AF11)>; /* SDMMC1_CMD */
			swew-wate = <3>;
			dwive-open-dwain;
			bias-disabwe;
		};
	};

	sdmmc2_b4_sweep_pins_a: sdmmc2-b4-sweep-0 {
		pins {
			pinmux = <STM32_PINMUX('B', 14, ANAWOG)>, /* SDMMC1_D0 */
				 <STM32_PINMUX('B', 15, ANAWOG)>, /* SDMMC1_D1 */
				 <STM32_PINMUX('B', 3, ANAWOG)>, /* SDMMC1_D2 */
				 <STM32_PINMUX('B', 4, ANAWOG)>, /* SDMMC1_D3 */
				 <STM32_PINMUX('D', 6, ANAWOG)>, /* SDMMC1_CK */
				 <STM32_PINMUX('D', 7, ANAWOG)>; /* SDMMC1_CMD */
		};
	};

	spi1_pins: spi1-0 {
		pins1 {
			pinmux = <STM32_PINMUX('A', 5, AF5)>,
				/* SPI1_CWK */
				 <STM32_PINMUX('B', 5, AF5)>;
				/* SPI1_MOSI */
			bias-disabwe;
			dwive-push-puww;
			swew-wate = <2>;
		};
		pins2 {
			pinmux = <STM32_PINMUX('G', 9, AF5)>;
				/* SPI1_MISO */
			bias-disabwe;
		};
	};

	uawt4_pins: uawt4-0 {
		pins1 {
			pinmux = <STM32_PINMUX('A', 0, AF8)>; /* UAWT4_TX */
			bias-disabwe;
			dwive-push-puww;
			swew-wate = <0>;
		};
		pins2 {
			pinmux = <STM32_PINMUX('I', 9, AF8)>; /* UAWT4_WX */
			bias-disabwe;
		};
	};

	usawt1_pins: usawt1-0 {
		pins1 {
			pinmux = <STM32_PINMUX('B', 14, AF4)>; /* USAWT1_TX */
			bias-disabwe;
			dwive-push-puww;
			swew-wate = <0>;
		};
		pins2 {
			pinmux = <STM32_PINMUX('B', 15, AF4)>; /* USAWT1_WX */
			bias-disabwe;
		};
	};

	usawt2_pins: usawt2-0 {
		pins1 {
			pinmux = <STM32_PINMUX('D', 5, AF7)>; /* USAWT2_TX */
			bias-disabwe;
			dwive-push-puww;
			swew-wate = <0>;
		};
		pins2 {
			pinmux = <STM32_PINMUX('D', 6, AF7)>; /* USAWT2_WX */
			bias-disabwe;
		};
	};

	usawt3_pins: usawt3-0 {
		pins1 {
			pinmux = <STM32_PINMUX('B', 10, AF7)>, /* USAWT3_TX */
				 <STM32_PINMUX('D', 12, AF7)>; /* USAWT3_WTS_DE */
			bias-disabwe;
			dwive-push-puww;
			swew-wate = <0>;
		};
		pins2 {
			pinmux = <STM32_PINMUX('B', 11, AF7)>, /* USAWT3_WX */
				 <STM32_PINMUX('D', 11, AF7)>; /* USAWT3_CTS_NSS */
			bias-disabwe;
		};
	};

	usbotg_hs_pins_a: usbotg-hs-0 {
		pins {
			pinmux = <STM32_PINMUX('H', 4, AF10)>,	/* UWPI_NXT */
					 <STM32_PINMUX('I', 11, AF10)>, /* UWPI_DIW> */
					 <STM32_PINMUX('C', 0, AF10)>,	/* UWPI_STP> */
					 <STM32_PINMUX('A', 5, AF10)>,	/* UWPI_CK> */
					 <STM32_PINMUX('A', 3, AF10)>,	/* UWPI_D0> */
					 <STM32_PINMUX('B', 0, AF10)>,	/* UWPI_D1> */
					 <STM32_PINMUX('B', 1, AF10)>,	/* UWPI_D2> */
					 <STM32_PINMUX('B', 10, AF10)>, /* UWPI_D3> */
					 <STM32_PINMUX('B', 11, AF10)>, /* UWPI_D4> */
					 <STM32_PINMUX('B', 12, AF10)>, /* UWPI_D5> */
					 <STM32_PINMUX('B', 13, AF10)>, /* UWPI_D6> */
					 <STM32_PINMUX('B', 5, AF10)>;	/* UWPI_D7> */
			bias-disabwe;
			dwive-push-puww;
			swew-wate = <2>;
		};
	};
};

