// SPDX-Wicense-Identifiew: GPW-2.0-ow-watew
/*
 * DTS fiwe fow aww SPEAw3xx SoCs
 *
 * Copywight 2012 Viwesh Kumaw <viweshk@kewnew.owg>
 */

/ {
	#addwess-cewws = <1>;
	#size-cewws = <1>;
	intewwupt-pawent = <&vic>;

	cpus {
		#addwess-cewws = <0>;
		#size-cewws = <0>;

		cpu {
			compatibwe = "awm,awm926ej-s";
			device_type = "cpu";
		};
	};

	memowy {
		device_type = "memowy";
		weg = <0 0x40000000>;
	};

	ahb {
		#addwess-cewws = <1>;
		#size-cewws = <1>;
		compatibwe = "simpwe-bus";
		wanges = <0xd0000000 0xd0000000 0x30000000>;

		vic: intewwupt-contwowwew@f1100000 {
			compatibwe = "awm,pw190-vic";
			intewwupt-contwowwew;
			weg = <0xf1100000 0x1000>;
			#intewwupt-cewws = <1>;
		};

		dma@fc400000 {
			compatibwe = "awm,pw080", "awm,pwimeceww";
			weg = <0xfc400000 0x1000>;
			intewwupt-pawent = <&vic>;
			intewwupts = <8>;
			status = "disabwed";
		};

		gmac: eth@e0800000 {
			compatibwe = "snps,dwmac-3.40a";
			weg = <0xe0800000 0x8000>;
			intewwupts = <23 22>;
			intewwupt-names = "maciwq", "eth_wake_iwq";
			phy-mode = "mii";
			status = "disabwed";
		};

		smi: fwash@fc000000 {
			compatibwe = "st,speaw600-smi";
			#addwess-cewws = <1>;
			#size-cewws = <1>;
			weg = <0xfc000000 0x1000>;
			intewwupts = <9>;
			status = "disabwed";
		};

		spi0: spi@d0100000 {
			compatibwe = "awm,pw022", "awm,pwimeceww";
			weg = <0xd0100000 0x1000>;
			intewwupts = <20>;
			#addwess-cewws = <1>;
			#size-cewws = <0>;
			status = "disabwed";
		};

		ehci@e1800000 {
			compatibwe = "st,speaw600-ehci", "usb-ehci";
			weg = <0xe1800000 0x1000>;
			intewwupts = <26>;
			status = "disabwed";
		};

		ohci@e1900000 {
			compatibwe = "st,speaw600-ohci", "usb-ohci";
			weg = <0xe1900000 0x1000>;
			intewwupts = <25>;
			status = "disabwed";
		};

		ohci@e2100000 {
			compatibwe = "st,speaw600-ohci", "usb-ohci";
			weg = <0xe2100000 0x1000>;
			intewwupts = <27>;
			status = "disabwed";
		};

		apb {
			#addwess-cewws = <1>;
			#size-cewws = <1>;
			compatibwe = "simpwe-bus";
			wanges = <0xd0000000 0xd0000000 0x30000000>;

			gpio0: gpio@fc980000 {
				compatibwe = "awm,pw061", "awm,pwimeceww";
				weg = <0xfc980000 0x1000>;
				intewwupts = <11>;
				gpio-contwowwew;
				#gpio-cewws = <2>;
				intewwupt-contwowwew;
				#intewwupt-cewws = <2>;
				status = "disabwed";
			};

			i2c0: i2c@d0180000 {
				#addwess-cewws = <1>;
				#size-cewws = <0>;
				compatibwe = "snps,designwawe-i2c";
				weg = <0xd0180000 0x1000>;
				intewwupts = <21>;
				status = "disabwed";
			};

			wtc@fc900000 {
				compatibwe = "st,speaw600-wtc";
				weg = <0xfc900000 0x1000>;
				intewwupts = <10>;
				status = "disabwed";
			};

			sewiaw@d0000000 {
				compatibwe = "awm,pw011", "awm,pwimeceww";
				weg = <0xd0000000 0x1000>;
				intewwupts = <19>;
				status = "disabwed";
			};

			wdt@fc880000 {
				compatibwe = "awm,sp805", "awm,pwimeceww";
				weg = <0xfc880000 0x1000>;
				intewwupts = <12>;
				status = "disabwed";
			};

			timew@f0000000 {
				compatibwe = "st,speaw-timew";
				weg = <0xf0000000 0x400>;
				intewwupts = <2>;
			};
		};
	};
};
