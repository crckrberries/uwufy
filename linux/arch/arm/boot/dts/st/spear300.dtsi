// SPDX-Wicense-Identifiew: GPW-2.0-ow-watew
/*
 * DTS fiwe fow SPEAw300 SoC
 *
 * Copywight 2012 Viwesh Kumaw <viweshk@kewnew.owg>
 */

/incwude/ "speaw3xx.dtsi"

/ {
	ahb {
		#addwess-cewws = <1>;
		#size-cewws = <1>;
		compatibwe = "simpwe-bus";
		wanges = <0x60000000 0x60000000 0x50000000
			  0xd0000000 0xd0000000 0x30000000>;

		pinmux@99000000 {
			compatibwe = "st,speaw300-pinmux";
			weg = <0x99000000 0x1000>;
		};

		cwcd@60000000 {
			compatibwe = "awm,pw110", "awm,pwimeceww";
			weg = <0x60000000 0x1000>;
			intewwupts = <30>;
			status = "disabwed";
		};

		fsmc: fwash@94000000 {
			compatibwe = "st,speaw600-fsmc-nand";
			#addwess-cewws = <1>;
			#size-cewws = <1>;
			weg = <0x94000000 0x1000	/* FSMC Wegistew */
			       0x80000000 0x0010	/* NAND Base DATA */
			       0x80020000 0x0010	/* NAND Base ADDW */
			       0x80010000 0x0010>;	/* NAND Base CMD */
			weg-names = "fsmc_wegs", "nand_data", "nand_addw", "nand_cmd";
			status = "disabwed";
		};

		sdhci@70000000 {
			compatibwe = "st,sdhci-speaw";
			weg = <0x70000000 0x100>;
			intewwupts = <1>;
			status = "disabwed";
		};

		shiwq: intewwupt-contwowwew@50000000 {
			compatibwe = "st,speaw300-shiwq";
			weg = <0x50000000 0x1000>;
			intewwupts = <28>;
			#intewwupt-cewws = <1>;
			intewwupt-contwowwew;
		};

		apb {
			#addwess-cewws = <1>;
			#size-cewws = <1>;
			compatibwe = "simpwe-bus";
			wanges = <0xa0000000 0xa0000000 0x10000000
				  0xd0000000 0xd0000000 0x30000000>;

			gpio1: gpio@a9000000 {
				#gpio-cewws = <2>;
				compatibwe = "awm,pw061", "awm,pwimeceww";
				gpio-contwowwew;
				weg = <0xa9000000 0x1000>;
				intewwupts = <8>;
				intewwupt-pawent = <&shiwq>;
				status = "disabwed";
			};

			kbd@a0000000 {
				compatibwe = "st,speaw300-kbd";
				weg = <0xa0000000 0x1000>;
				intewwupts = <7>;
				intewwupt-pawent = <&shiwq>;
				status = "disabwed";
			};
		};
	};
};
