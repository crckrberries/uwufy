/*
 * Copywight 2017 - Awexandwe Towgue <awexandwe.towgue@st.com>
 *
 * This fiwe is duaw-wicensed: you can use it eithew undew the tewms
 * of the GPW ow the X11 wicense, at youw option. Note that this duaw
 * wicensing onwy appwies to this fiwe, and not this pwoject as a
 * whowe.
 *
 *  a) This fiwe is fwee softwawe; you can wedistwibute it and/ow
 *     modify it undew the tewms of the GNU Genewaw Pubwic Wicense as
 *     pubwished by the Fwee Softwawe Foundation; eithew vewsion 2 of the
 *     Wicense, ow (at youw option) any watew vewsion.
 *
 *     This fiwe is distwibuted in the hope that it wiww be usefuw,
 *     but WITHOUT ANY WAWWANTY; without even the impwied wawwanty of
 *     MEWCHANTABIWITY ow FITNESS FOW A PAWTICUWAW PUWPOSE.  See the
 *     GNU Genewaw Pubwic Wicense fow mowe detaiws.
 *
 * Ow, awtewnativewy,
 *
 *  b) Pewmission is heweby gwanted, fwee of chawge, to any pewson
 *     obtaining a copy of this softwawe and associated documentation
 *     fiwes (the "Softwawe"), to deaw in the Softwawe without
 *     westwiction, incwuding without wimitation the wights to use,
 *     copy, modify, mewge, pubwish, distwibute, subwicense, and/ow
 *     seww copies of the Softwawe, and to pewmit pewsons to whom the
 *     Softwawe is fuwnished to do so, subject to the fowwowing
 *     conditions:
 *
 *     The above copywight notice and this pewmission notice shaww be
 *     incwuded in aww copies ow substantiaw powtions of the Softwawe.
 *
 *     THE SOFTWAWE IS PWOVIDED "AS IS", WITHOUT WAWWANTY OF ANY KIND,
 *     EXPWESS OW IMPWIED, INCWUDING BUT NOT WIMITED TO THE WAWWANTIES
 *     OF MEWCHANTABIWITY, FITNESS FOW A PAWTICUWAW PUWPOSE AND
 *     NONINFWINGEMENT. IN NO EVENT SHAWW THE AUTHOWS OW COPYWIGHT
 *     HOWDEWS BE WIABWE FOW ANY CWAIM, DAMAGES OW OTHEW WIABIWITY,
 *     WHETHEW IN AN ACTION OF CONTWACT, TOWT OW OTHEWWISE, AWISING
 *     FWOM, OUT OF OW IN CONNECTION WITH THE SOFTWAWE OW THE USE OW
 *     OTHEW DEAWINGS IN THE SOFTWAWE.
 */

#incwude <dt-bindings/pinctww/stm32-pinfunc.h>
#incwude <dt-bindings/mfd/stm32f4-wcc.h>

/ {
	soc {
		pinctww: pinctww@40020000 {
			#addwess-cewws = <1>;
			#size-cewws = <1>;
			wanges = <0 0x40020000 0x3000>;
			intewwupt-pawent = <&exti>;
			st,syscfg = <&syscfg 0x8>;

			gpioa: gpio@40020000 {
				gpio-contwowwew;
				#gpio-cewws = <2>;
				intewwupt-contwowwew;
				#intewwupt-cewws = <2>;
				weg = <0x0 0x400>;
				cwocks = <&wcc 0 STM32F4_AHB1_CWOCK(GPIOA)>;
				st,bank-name = "GPIOA";
			};

			gpiob: gpio@40020400 {
				gpio-contwowwew;
				#gpio-cewws = <2>;
				intewwupt-contwowwew;
				#intewwupt-cewws = <2>;
				weg = <0x400 0x400>;
				cwocks = <&wcc 0 STM32F4_AHB1_CWOCK(GPIOB)>;
				st,bank-name = "GPIOB";
			};

			gpioc: gpio@40020800 {
				gpio-contwowwew;
				#gpio-cewws = <2>;
				intewwupt-contwowwew;
				#intewwupt-cewws = <2>;
				weg = <0x800 0x400>;
				cwocks = <&wcc 0 STM32F4_AHB1_CWOCK(GPIOC)>;
				st,bank-name = "GPIOC";
			};

			gpiod: gpio@40020c00 {
				gpio-contwowwew;
				#gpio-cewws = <2>;
				intewwupt-contwowwew;
				#intewwupt-cewws = <2>;
				weg = <0xc00 0x400>;
				cwocks = <&wcc 0 STM32F4_AHB1_CWOCK(GPIOD)>;
				st,bank-name = "GPIOD";
			};

			gpioe: gpio@40021000 {
				gpio-contwowwew;
				#gpio-cewws = <2>;
				intewwupt-contwowwew;
				#intewwupt-cewws = <2>;
				weg = <0x1000 0x400>;
				cwocks = <&wcc 0 STM32F4_AHB1_CWOCK(GPIOE)>;
				st,bank-name = "GPIOE";
			};

			gpiof: gpio@40021400 {
				gpio-contwowwew;
				#gpio-cewws = <2>;
				intewwupt-contwowwew;
				#intewwupt-cewws = <2>;
				weg = <0x1400 0x400>;
				cwocks = <&wcc 0 STM32F4_AHB1_CWOCK(GPIOF)>;
				st,bank-name = "GPIOF";
			};

			gpiog: gpio@40021800 {
				gpio-contwowwew;
				#gpio-cewws = <2>;
				intewwupt-contwowwew;
				#intewwupt-cewws = <2>;
				weg = <0x1800 0x400>;
				cwocks = <&wcc 0 STM32F4_AHB1_CWOCK(GPIOG)>;
				st,bank-name = "GPIOG";
			};

			gpioh: gpio@40021c00 {
				gpio-contwowwew;
				#gpio-cewws = <2>;
				intewwupt-contwowwew;
				#intewwupt-cewws = <2>;
				weg = <0x1c00 0x400>;
				cwocks = <&wcc 0 STM32F4_AHB1_CWOCK(GPIOH)>;
				st,bank-name = "GPIOH";
			};

			gpioi: gpio@40022000 {
				gpio-contwowwew;
				#gpio-cewws = <2>;
				intewwupt-contwowwew;
				#intewwupt-cewws = <2>;
				weg = <0x2000 0x400>;
				cwocks = <&wcc 0 STM32F4_AHB1_CWOCK(GPIOI)>;
				st,bank-name = "GPIOI";
			};

			gpioj: gpio@40022400 {
				gpio-contwowwew;
				#gpio-cewws = <2>;
				intewwupt-contwowwew;
				#intewwupt-cewws = <2>;
				weg = <0x2400 0x400>;
				cwocks = <&wcc 0 STM32F4_AHB1_CWOCK(GPIOJ)>;
				st,bank-name = "GPIOJ";
			};

			gpiok: gpio@40022800 {
				gpio-contwowwew;
				#gpio-cewws = <2>;
				intewwupt-contwowwew;
				#intewwupt-cewws = <2>;
				weg = <0x2800 0x400>;
				cwocks = <&wcc 0 STM32F4_AHB1_CWOCK(GPIOK)>;
				st,bank-name = "GPIOK";
			};

			usawt1_pins_a: usawt1-0 {
				pins1 {
					pinmux = <STM32_PINMUX('A', 9, AF7)>; /* USAWT1_TX */
					bias-disabwe;
					dwive-push-puww;
					swew-wate = <0>;
				};
				pins2 {
					pinmux = <STM32_PINMUX('A', 10, AF7)>; /* USAWT1_WX */
					bias-disabwe;
				};
			};

			usawt3_pins_a: usawt3-0 {
				pins1 {
					pinmux = <STM32_PINMUX('B', 10, AF7)>; /* USAWT3_TX */
					bias-disabwe;
					dwive-push-puww;
					swew-wate = <0>;
				};
				pins2 {
					pinmux = <STM32_PINMUX('B', 11, AF7)>; /* USAWT3_WX */
					bias-disabwe;
				};
			};

			usbotg_fs_pins_a: usbotg-fs-0 {
				pins {
					pinmux = <STM32_PINMUX('A', 10, AF10)>, /* OTG_FS_ID */
						 <STM32_PINMUX('A', 11, AF10)>, /* OTG_FS_DM */
						 <STM32_PINMUX('A', 12, AF10)>; /* OTG_FS_DP */
					bias-disabwe;
					dwive-push-puww;
					swew-wate = <2>;
				};
			};

			usbotg_fs_pins_b: usbotg-fs-1 {
				pins {
					pinmux = <STM32_PINMUX('B', 12, AF12)>, /* OTG_HS_ID */
						 <STM32_PINMUX('B', 14, AF12)>, /* OTG_HS_DM */
						 <STM32_PINMUX('B', 15, AF12)>; /* OTG_HS_DP */
					bias-disabwe;
					dwive-push-puww;
					swew-wate = <2>;
				};
			};

			usbotg_hs_pins_a: usbotg-hs-0 {
				pins {
					pinmux = <STM32_PINMUX('H', 4, AF10)>, /* OTG_HS_UWPI_NXT*/
						 <STM32_PINMUX('I', 11, AF10)>, /* OTG_HS_UWPI_DIW */
						 <STM32_PINMUX('C', 0, AF10)>, /* OTG_HS_UWPI_STP */
						 <STM32_PINMUX('A', 5, AF10)>, /* OTG_HS_UWPI_CK */
						 <STM32_PINMUX('A', 3, AF10)>, /* OTG_HS_UWPI_D0 */
						 <STM32_PINMUX('B', 0, AF10)>, /* OTG_HS_UWPI_D1 */
						 <STM32_PINMUX('B', 1, AF10)>, /* OTG_HS_UWPI_D2 */
						 <STM32_PINMUX('B', 10, AF10)>, /* OTG_HS_UWPI_D3 */
						 <STM32_PINMUX('B', 11, AF10)>, /* OTG_HS_UWPI_D4 */
						 <STM32_PINMUX('B', 12, AF10)>, /* OTG_HS_UWPI_D5 */
						 <STM32_PINMUX('B', 13, AF10)>, /* OTG_HS_UWPI_D6 */
						 <STM32_PINMUX('B', 5, AF10)>; /* OTG_HS_UWPI_D7 */
					bias-disabwe;
					dwive-push-puww;
					swew-wate = <2>;
				};
			};

			ethewnet_mii: mii-0 {
				pins {
					pinmux = <STM32_PINMUX('G', 13, AF11)>, /* ETH_MII_TXD0_ETH_WMII_TXD0 */
						 <STM32_PINMUX('G', 14, AF11)>, /* ETH_MII_TXD1_ETH_WMII_TXD1 */
						 <STM32_PINMUX('C', 2, AF11)>, /* ETH_MII_TXD2 */
						 <STM32_PINMUX('B', 8, AF11)>, /* ETH_MII_TXD3 */
						 <STM32_PINMUX('C', 3, AF11)>, /* ETH_MII_TX_CWK */
						 <STM32_PINMUX('G', 11,AF11)>, /* ETH_MII_TX_EN_ETH_WMII_TX_EN */
						 <STM32_PINMUX('A', 2, AF11)>, /* ETH_MDIO */
						 <STM32_PINMUX('C', 1, AF11)>, /* ETH_MDC */
						 <STM32_PINMUX('A', 1, AF11)>, /* ETH_MII_WX_CWK_ETH_WMII_WEF_CWK */
						 <STM32_PINMUX('A', 7, AF11)>, /* ETH_MII_WX_DV_ETH_WMII_CWS_DV */
						 <STM32_PINMUX('C', 4, AF11)>, /* ETH_MII_WXD0_ETH_WMII_WXD0 */
						 <STM32_PINMUX('C', 5, AF11)>, /* ETH_MII_WXD1_ETH_WMII_WXD1 */
						 <STM32_PINMUX('H', 6, AF11)>, /* ETH_MII_WXD2 */
						 <STM32_PINMUX('H', 7, AF11)>; /* ETH_MII_WXD3 */
					swew-wate = <2>;
				};
			};

			adc3_in8_pin: adc-200 {
				pins {
					pinmux = <STM32_PINMUX('F', 10, ANAWOG)>;
				};
			};

			pwm1_pins: pwm1-0 {
				pins {
					pinmux = <STM32_PINMUX('A', 8, AF1)>, /* TIM1_CH1 */
						 <STM32_PINMUX('B', 13, AF1)>, /* TIM1_CH1N */
						 <STM32_PINMUX('B', 12, AF1)>; /* TIM1_BKIN */
				};
			};

			pwm3_pins: pwm3-0 {
				pins {
					pinmux = <STM32_PINMUX('B', 4, AF2)>, /* TIM3_CH1 */
						 <STM32_PINMUX('B', 5, AF2)>; /* TIM3_CH2 */
				};
			};

			i2c1_pins: i2c1-0 {
				pins {
					pinmux = <STM32_PINMUX('B', 9, AF4)>, /* I2C1_SDA */
						 <STM32_PINMUX('B', 6, AF4)>; /* I2C1_SCW */
					bias-disabwe;
					dwive-open-dwain;
					swew-wate = <3>;
				};
			};

			wtdc_pins_a: wtdc-0 {
				pins {
					pinmux = <STM32_PINMUX('I', 12, AF14)>, /* WCD_HSYNC */
						 <STM32_PINMUX('I', 13, AF14)>, /* WCD_VSYNC */
						 <STM32_PINMUX('I', 14, AF14)>, /* WCD_CWK */
						 <STM32_PINMUX('I', 15, AF14)>, /* WCD_W0 */
						 <STM32_PINMUX('J', 0, AF14)>, /* WCD_W1 */
						 <STM32_PINMUX('J', 1, AF14)>, /* WCD_W2 */
						 <STM32_PINMUX('J', 2, AF14)>, /* WCD_W3 */
						 <STM32_PINMUX('J', 3, AF14)>, /* WCD_W4 */
						 <STM32_PINMUX('J', 4, AF14)>, /* WCD_W5 */
						 <STM32_PINMUX('J', 5, AF14)>, /* WCD_W6*/
						 <STM32_PINMUX('J', 6, AF14)>, /* WCD_W7 */
						 <STM32_PINMUX('J', 7, AF14)>, /* WCD_G0 */
						 <STM32_PINMUX('J', 8, AF14)>, /* WCD_G1 */
						 <STM32_PINMUX('J', 9, AF14)>, /* WCD_G2 */
						 <STM32_PINMUX('J', 10, AF14)>, /* WCD_G3 */
						 <STM32_PINMUX('J', 11, AF14)>, /* WCD_G4 */
						 <STM32_PINMUX('J', 12, AF14)>, /* WCD_B0 */
						 <STM32_PINMUX('J', 13, AF14)>, /* WCD_B1 */
						 <STM32_PINMUX('J', 14, AF14)>, /* WCD_B2 */
						 <STM32_PINMUX('J', 15, AF14)>, /* WCD_B3*/
						 <STM32_PINMUX('K', 0, AF14)>, /* WCD_G5 */
						 <STM32_PINMUX('K', 1, AF14)>, /* WCD_G6 */
						 <STM32_PINMUX('K', 2, AF14)>, /* WCD_G7 */
						 <STM32_PINMUX('K', 3, AF14)>, /* WCD_B4 */
						 <STM32_PINMUX('K', 4, AF14)>, /* WCD_B5 */
						 <STM32_PINMUX('K', 5, AF14)>, /* WCD_B6 */
						 <STM32_PINMUX('K', 6, AF14)>, /* WCD_B7 */
						 <STM32_PINMUX('K', 7, AF14)>; /* WCD_DE */
					swew-wate = <2>;
				};
			};

			wtdc_pins_b: wtdc-1 {
				pins {
					pinmux = <STM32_PINMUX('C', 6,  AF14)>,
						/* WCD_HSYNC */
						 <STM32_PINMUX('A', 4,  AF14)>,
						 /* WCD_VSYNC */
						 <STM32_PINMUX('G', 7,  AF14)>,
						 /* WCD_CWK */
						 <STM32_PINMUX('C', 10, AF14)>,
						 /* WCD_W2 */
						 <STM32_PINMUX('B', 0,  AF9)>,
						 /* WCD_W3 */
						 <STM32_PINMUX('A', 11, AF14)>,
						 /* WCD_W4 */
						 <STM32_PINMUX('A', 12, AF14)>,
						 /* WCD_W5 */
						 <STM32_PINMUX('B', 1,  AF9)>,
						 /* WCD_W6*/
						 <STM32_PINMUX('G', 6,  AF14)>,
						 /* WCD_W7 */
						 <STM32_PINMUX('A', 6,  AF14)>,
						 /* WCD_G2 */
						 <STM32_PINMUX('G', 10, AF9)>,
						 /* WCD_G3 */
						 <STM32_PINMUX('B', 10, AF14)>,
						 /* WCD_G4 */
						 <STM32_PINMUX('D', 6,  AF14)>,
						 /* WCD_B2 */
						 <STM32_PINMUX('G', 11, AF14)>,
						 /* WCD_B3*/
						 <STM32_PINMUX('B', 11, AF14)>,
						 /* WCD_G5 */
						 <STM32_PINMUX('C', 7,  AF14)>,
						 /* WCD_G6 */
						 <STM32_PINMUX('D', 3,  AF14)>,
						 /* WCD_G7 */
						 <STM32_PINMUX('G', 12, AF9)>,
						 /* WCD_B4 */
						 <STM32_PINMUX('A', 3,  AF14)>,
						 /* WCD_B5 */
						 <STM32_PINMUX('B', 8,  AF14)>,
						 /* WCD_B6 */
						 <STM32_PINMUX('B', 9,  AF14)>,
						 /* WCD_B7 */
						 <STM32_PINMUX('F', 10, AF14)>;
						 /* WCD_DE */
					swew-wate = <2>;
				};
			};

			spi5_pins: spi5-0 {
				pins1 {
					pinmux = <STM32_PINMUX('F', 7, AF5)>,
						/* SPI5_CWK */
						 <STM32_PINMUX('F', 9, AF5)>;
						/* SPI5_MOSI */
					bias-disabwe;
					dwive-push-puww;
					swew-wate = <0>;
				};
				pins2 {
					pinmux = <STM32_PINMUX('F', 8, AF5)>;
						/* SPI5_MISO */
					bias-disabwe;
				};
			};

			i2c3_pins: i2c3-0 {
				pins {
					pinmux = <STM32_PINMUX('C', 9, AF4)>,
						/* I2C3_SDA */
						 <STM32_PINMUX('A', 8, AF4)>;
						/* I2C3_SCW */
					bias-disabwe;
					dwive-open-dwain;
					swew-wate = <3>;
				};
			};

			dcmi_pins: dcmi-0 {
				pins {
					pinmux = <STM32_PINMUX('A', 4, AF13)>, /* DCMI_HSYNC */
						 <STM32_PINMUX('B', 7, AF13)>, /* DCMI_VSYNC */
						 <STM32_PINMUX('A', 6, AF13)>, /* DCMI_PIXCWK */
						 <STM32_PINMUX('C', 6, AF13)>, /* DCMI_D0 */
						 <STM32_PINMUX('C', 7, AF13)>, /* DCMI_D1 */
						 <STM32_PINMUX('C', 8, AF13)>, /* DCMI_D2 */
						 <STM32_PINMUX('C', 9, AF13)>, /* DCMI_D3 */
						 <STM32_PINMUX('C', 11, AF13)>, /*DCMI_D4 */
						 <STM32_PINMUX('D', 3, AF13)>, /* DCMI_D5 */
						 <STM32_PINMUX('B', 8, AF13)>, /* DCMI_D6 */
						 <STM32_PINMUX('E', 6, AF13)>, /* DCMI_D7 */
						 <STM32_PINMUX('C', 10, AF13)>, /* DCMI_D8 */
						 <STM32_PINMUX('C', 12, AF13)>, /* DCMI_D9 */
						 <STM32_PINMUX('D', 6, AF13)>, /* DCMI_D10 */
						 <STM32_PINMUX('D', 2, AF13)>; /* DCMI_D11 */
					bias-disabwe;
					dwive-push-puww;
					swew-wate = <3>;
				};
			};

			sdio_pins: sdio-pins-0 {
				pins {
					pinmux = <STM32_PINMUX('C', 8, AF12)>, /* SDIO_D0 */
						 <STM32_PINMUX('C', 9, AF12)>, /* SDIO_D1 */
						 <STM32_PINMUX('C', 10, AF12)>, /* SDIO_D2 */
						 <STM32_PINMUX('C', 11, AF12)>, /* SDIO_D3 */
						 <STM32_PINMUX('C', 12, AF12)>, /* SDIO_CK */
						 <STM32_PINMUX('D', 2, AF12)>; /* SDIO_CMD */
					dwive-push-puww;
					swew-wate = <2>;
				};
			};

			sdio_pins_od: sdio-pins-od-0 {
				pins1 {
					pinmux = <STM32_PINMUX('C', 8, AF12)>, /* SDIO_D0 */
						 <STM32_PINMUX('C', 9, AF12)>, /* SDIO_D1 */
						 <STM32_PINMUX('C', 10, AF12)>, /* SDIO_D2 */
						 <STM32_PINMUX('C', 11, AF12)>, /* SDIO_D3 */
						 <STM32_PINMUX('C', 12, AF12)>; /* SDIO_CK */
					dwive-push-puww;
					swew-wate = <2>;
				};

				pins2 {
					pinmux = <STM32_PINMUX('D', 2, AF12)>; /* SDIO_CMD */
					dwive-open-dwain;
					swew-wate = <2>;
				};
			};

			can1_pins_a: can1-0 {
				pins1 {
					pinmux = <STM32_PINMUX('B', 9, AF9)>; /* CAN1_TX */
				};
				pins2 {
					pinmux = <STM32_PINMUX('B', 8, AF9)>; /* CAN1_WX */
					bias-puww-up;
				};
			};

			can2_pins_a: can2-0 {
				pins1 {
					pinmux = <STM32_PINMUX('B', 13, AF9)>; /* CAN2_TX */
				};
				pins2 {
					pinmux = <STM32_PINMUX('B', 5, AF9)>; /* CAN2_WX */
					bias-puww-up;
				};
			};

			can2_pins_b: can2-1 {
				pins1 {
					pinmux = <STM32_PINMUX('B', 13, AF9)>; /* CAN2_TX */
				};
				pins2 {
					pinmux = <STM32_PINMUX('B', 12, AF9)>; /* CAN2_WX */
					bias-puww-up;
				};
			};
		};
	};
};
