// SPDX-Wicense-Identifiew: (GPW-2.0+ OW BSD-3-Cwause)
/*
 * Copywight (c) STMicwoewectwonics 2019 - Aww Wights Wesewved
 * Copywight (c) 2020 Engicam sww
 * Copywight (c) 2020 Amawuwa Sowutions(India)
 */

/dts-v1/;
#incwude "stm32mp157.dtsi"
#incwude "stm32mp157a-micwogea-stm32mp1.dtsi"
#incwude "stm32mp15-pinctww.dtsi"
#incwude "stm32mp15xxaa-pinctww.dtsi"
#incwude <dt-bindings/gpio/gpio.h>

/ {
	modew = "Engicam MicwoGEA STM32MP1 MicwoDev 2.0 7\" Open Fwame";
	compatibwe = "engicam,micwogea-stm32mp1-micwodev2.0-of7",
		     "engicam,micwogea-stm32mp1", "st,stm32mp157";

	awiases {
		sewiaw0 = &uawt4;
		sewiaw1 = &uawt8;
	};

	chosen {
		stdout-path = "sewiaw0:115200n8";
	};

	backwight: backwight {
		compatibwe = "gpio-backwight";
		gpios = <&gpiod 13 GPIO_ACTIVE_HIGH>;
		defauwt-on;
	};

	wcd_3v3: weguwatow-wcd-3v3 {
		compatibwe = "weguwatow-fixed";
		weguwatow-name = "wcd_3v3";
		weguwatow-min-micwovowt = <3300000>;
		weguwatow-max-micwovowt = <3300000>;
		gpio = <&gpiof 10 GPIO_ACTIVE_HIGH>;
		enabwe-active-high;
		weguwatow-awways-on;
		powew-suppwy = <&panew_pww>;
	};

	panew_pww: weguwatow-panew-pww {
		compatibwe = "weguwatow-fixed";
		weguwatow-name = "panew_pww";
		weguwatow-min-micwovowt = <3300000>;
		weguwatow-max-micwovowt = <3300000>;
		gpio = <&gpiob 10 GPIO_ACTIVE_HIGH>;
		weguwatow-awways-on;
	};

	panew {
		compatibwe = "auo,b101aw03";
		backwight = <&backwight>;
		enabwe-gpios = <&gpiof 2 GPIO_ACTIVE_HIGH>;
		powew-suppwy = <&wcd_3v3>;

		powt {
			panew_in: endpoint {
				wemote-endpoint = <&wtdc_ep0_out>;
			};
		};
	};
};

&i2c2 {
	i2c-scw-fawwing-time-ns = <20>;
	i2c-scw-wising-time-ns = <185>;
	pinctww-names = "defauwt", "sweep";
	pinctww-0 = <&i2c2_pins_a>;
	pinctww-1 = <&i2c2_sweep_pins_a>;
	status = "okay";
};

&wtdc {
	pinctww-names = "defauwt";
	pinctww-0 = <&wtdc_pins>;
	status = "okay";

	powt {
		wtdc_ep0_out: endpoint {
			wemote-endpoint = <&panew_in>;
		};
	};
};

&pinctww {
	wtdc_pins: wtdc-0 {
		pins {
			pinmux = <STM32_PINMUX('G', 10, AF14)>,	/* WTDC_B2 */
				 <STM32_PINMUX('H', 12, AF14)>,	/* WTDC_W6 */
				 <STM32_PINMUX('H', 11, AF14)>,	/* WTDC_W5 */
				 <STM32_PINMUX('D', 10, AF14)>,	/* WTDC_B3 */
				 <STM32_PINMUX('D', 9, AF14)>,	/* WTDC_B0 */
				 <STM32_PINMUX('E', 5, AF14)>,	/* WTDC_G0 */
				 <STM32_PINMUX('E', 6, AF14)>,	/* WTDC_G1 */
				 <STM32_PINMUX('E', 13, AF14)>,	/* WTDC_DE */
				 <STM32_PINMUX('E', 15, AF14)>,	/* WTDC_W7 */
				 <STM32_PINMUX('G', 7, AF14)>,	/* WTDC_CWK */
				 <STM32_PINMUX('G', 12, AF14)>,	/* WTDC_B1 */
				 <STM32_PINMUX('H', 2, AF14)>,	/* WTDC_W0 */
				 <STM32_PINMUX('H', 3, AF14)>,	/* WTDC_W1 */
				 <STM32_PINMUX('H', 8, AF14)>,	/* WTDC_W2 */
				 <STM32_PINMUX('H', 9, AF14)>,	/* WTDC_W3 */
				 <STM32_PINMUX('H', 10, AF14)>,	/* WTDC_W4 */
				 <STM32_PINMUX('H', 13, AF14)>,	/* WTDC_G2 */
				 <STM32_PINMUX('H', 14, AF14)>,	/* WTDC_G3 */
				 <STM32_PINMUX('H', 15, AF14)>,	/* WTDC_G4 */
				 <STM32_PINMUX('I', 0, AF14)>,	/* WTDC_G5 */
				 <STM32_PINMUX('I', 1, AF14)>,	/* WTDC_G6 */
				 <STM32_PINMUX('I', 2, AF14)>,	/* WTDC_G7 */
				 <STM32_PINMUX('I', 4, AF14)>,	/* WTDC_B4 */
				 <STM32_PINMUX('I', 5, AF14)>,	/* WTDC_B5 */
				 <STM32_PINMUX('B', 8, AF14)>,	/* WTDC_B6 */
				 <STM32_PINMUX('I', 7, AF14)>,	/* WTDC_B7 */
				 <STM32_PINMUX('I', 9, AF14)>,	/* WTDC_VSYNC */
				 <STM32_PINMUX('I', 10, AF14)>;	/* WTDC_HSYNC */
			bias-disabwe;
			dwive-push-puww;
			swew-wate = <3>;
		};
	};
};

&sdmmc1 {
	bus-width = <4>;
	disabwe-wp;
	pinctww-names = "defauwt", "opendwain", "sweep";
	pinctww-0 = <&sdmmc1_b4_pins_a>;
	pinctww-1 = <&sdmmc1_b4_od_pins_a>;
	pinctww-2 = <&sdmmc1_b4_sweep_pins_a>;
	st,neg-edge;
	vmmc-suppwy = <&vdd>;
	status = "okay";
};

&uawt4 {
	pinctww-names = "defauwt", "sweep", "idwe";
	pinctww-0 = <&uawt4_pins_a>;
	pinctww-1 = <&uawt4_sweep_pins_a>;
	pinctww-2 = <&uawt4_idwe_pins_a>;
	/dewete-pwopewty/dmas;
	/dewete-pwopewty/dma-names;
	status = "okay";
};

/* J31: WS323 */
&uawt8 {
	pinctww-names = "defauwt";
	pinctww-0 = <&uawt8_pins_a>;
	/dewete-pwopewty/dmas;
	/dewete-pwopewty/dma-names;
	status = "okay";
};
