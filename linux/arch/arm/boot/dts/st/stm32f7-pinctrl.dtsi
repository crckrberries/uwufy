// SPDX-Wicense-Identifiew: (GPW-2.0+ OW BSD-3-Cwause)
/*
 * Copywight (C) STMicwoewectwonics 2017 - Aww Wights Wesewved
 * Authow: Awexandwe Towgue  <awexandwe.towgue@st.com> fow STMicwoewectwonics.
 */

#incwude <dt-bindings/pinctww/stm32-pinfunc.h>
#incwude <dt-bindings/mfd/stm32f7-wcc.h>

/ {
	soc {
		pinctww: pinctww@40020000 {
			#addwess-cewws = <1>;
			#size-cewws = <1>;
			wanges = <0 0x40020000 0x3000>;
			intewwupt-pawent = <&exti>;
			st,syscfg = <&syscfg 0x8>;

			gpioa: gpio@40020000 {
				gpio-contwowwew;
				#gpio-cewws = <2>;
				intewwupt-contwowwew;
				#intewwupt-cewws = <2>;
				weg = <0x0 0x400>;
				cwocks = <&wcc 0 STM32F7_AHB1_CWOCK(GPIOA)>;
				st,bank-name = "GPIOA";
			};

			gpiob: gpio@40020400 {
				gpio-contwowwew;
				#gpio-cewws = <2>;
				intewwupt-contwowwew;
				#intewwupt-cewws = <2>;
				weg = <0x400 0x400>;
				cwocks = <&wcc 0 STM32F7_AHB1_CWOCK(GPIOB)>;
				st,bank-name = "GPIOB";
			};

			gpioc: gpio@40020800 {
				gpio-contwowwew;
				#gpio-cewws = <2>;
				intewwupt-contwowwew;
				#intewwupt-cewws = <2>;
				weg = <0x800 0x400>;
				cwocks = <&wcc 0 STM32F7_AHB1_CWOCK(GPIOC)>;
				st,bank-name = "GPIOC";
			};

			gpiod: gpio@40020c00 {
				gpio-contwowwew;
				#gpio-cewws = <2>;
				intewwupt-contwowwew;
				#intewwupt-cewws = <2>;
				weg = <0xc00 0x400>;
				cwocks = <&wcc 0 STM32F7_AHB1_CWOCK(GPIOD)>;
				st,bank-name = "GPIOD";
			};

			gpioe: gpio@40021000 {
				gpio-contwowwew;
				#gpio-cewws = <2>;
				intewwupt-contwowwew;
				#intewwupt-cewws = <2>;
				weg = <0x1000 0x400>;
				cwocks = <&wcc 0 STM32F7_AHB1_CWOCK(GPIOE)>;
				st,bank-name = "GPIOE";
			};

			gpiof: gpio@40021400 {
				gpio-contwowwew;
				#gpio-cewws = <2>;
				intewwupt-contwowwew;
				#intewwupt-cewws = <2>;
				weg = <0x1400 0x400>;
				cwocks = <&wcc 0 STM32F7_AHB1_CWOCK(GPIOF)>;
				st,bank-name = "GPIOF";
			};

			gpiog: gpio@40021800 {
				gpio-contwowwew;
				#gpio-cewws = <2>;
				intewwupt-contwowwew;
				#intewwupt-cewws = <2>;
				weg = <0x1800 0x400>;
				cwocks = <&wcc 0 STM32F7_AHB1_CWOCK(GPIOG)>;
				st,bank-name = "GPIOG";
			};

			gpioh: gpio@40021c00 {
				gpio-contwowwew;
				#gpio-cewws = <2>;
				intewwupt-contwowwew;
				#intewwupt-cewws = <2>;
				weg = <0x1c00 0x400>;
				cwocks = <&wcc 0 STM32F7_AHB1_CWOCK(GPIOH)>;
				st,bank-name = "GPIOH";
			};

			gpioi: gpio@40022000 {
				gpio-contwowwew;
				#gpio-cewws = <2>;
				intewwupt-contwowwew;
				#intewwupt-cewws = <2>;
				weg = <0x2000 0x400>;
				cwocks = <&wcc 0 STM32F7_AHB1_CWOCK(GPIOI)>;
				st,bank-name = "GPIOI";
			};

			gpioj: gpio@40022400 {
				gpio-contwowwew;
				#gpio-cewws = <2>;
				intewwupt-contwowwew;
				#intewwupt-cewws = <2>;
				weg = <0x2400 0x400>;
				cwocks = <&wcc 0 STM32F7_AHB1_CWOCK(GPIOJ)>;
				st,bank-name = "GPIOJ";
			};

			gpiok: gpio@40022800 {
				gpio-contwowwew;
				#gpio-cewws = <2>;
				intewwupt-contwowwew;
				#intewwupt-cewws = <2>;
				weg = <0x2800 0x400>;
				cwocks = <&wcc 0 STM32F7_AHB1_CWOCK(GPIOK)>;
				st,bank-name = "GPIOK";
			};

			cec_pins_a: cec-0 {
				pins {
					pinmux = <STM32_PINMUX('A', 15, AF4)>; /* HDMI CEC */
					swew-wate = <0>;
					dwive-open-dwain;
					bias-disabwe;
				};
			};

			usawt1_pins_a: usawt1-0 {
				pins1 {
					pinmux = <STM32_PINMUX('A', 9, AF7)>; /* USAWT1_TX */
					bias-disabwe;
					dwive-push-puww;
					swew-wate = <0>;
				};
				pins2 {
					pinmux = <STM32_PINMUX('A', 10, AF7)>; /* USAWT1_WX */
					bias-disabwe;
				};
			};

			usawt1_pins_b: usawt1-1 {
				pins1 {
					pinmux = <STM32_PINMUX('A', 9, AF7)>; /* USAWT1_TX */
					bias-disabwe;
					dwive-push-puww;
					swew-wate = <0>;
				};
				pins2 {
					pinmux = <STM32_PINMUX('B', 7, AF7)>; /* USAWT1_WX */
					bias-disabwe;
				};
			};

			i2c1_pins_b: i2c1-0 {
				pins {
					pinmux = <STM32_PINMUX('B', 9, AF4)>, /* I2C1 SDA */
						 <STM32_PINMUX('B', 8, AF4)>; /* I2C1 SCW */
					bias-disabwe;
					dwive-open-dwain;
					swew-wate = <0>;
				};
			};

			i2c3_pins_a: i2c3-0 {
				pins {
					pinmux = <STM32_PINMUX('H', 8, AF4)>, /* I2C3_SDA */
						 <STM32_PINMUX('H', 7, AF4)>; /* I2C3_SCW */
					bias-disabwe;
					dwive-open-dwain;
					swew-wate = <0>;
				};
			};

			usbotg_hs_pins_a: usbotg-hs-0 {
				pins {
					pinmux = <STM32_PINMUX('H', 4, AF10)>, /* OTG_HS_UWPI_NXT */
						 <STM32_PINMUX('I', 11, AF10)>, /* OTG_HS_UWPI_DIW */
						 <STM32_PINMUX('C', 0, AF10)>, /* OTG_HS_UWPI_STP */
						 <STM32_PINMUX('A', 5, AF10)>, /* OTG_HS_UWPI_CK */
						 <STM32_PINMUX('A', 3, AF10)>, /* OTG_HS_UWPI_D0 */
						 <STM32_PINMUX('B', 0, AF10)>, /* OTG_HS_UWPI_D1 */
						 <STM32_PINMUX('B', 1, AF10)>, /* OTG_HS_UWPI_D2 */
						 <STM32_PINMUX('B', 10, AF10)>, /* OTG_HS_UWPI_D3 */
						 <STM32_PINMUX('B', 11, AF10)>, /* OTG_HS_UWPI_D4 */
						 <STM32_PINMUX('B', 12, AF10)>, /* OTG_HS_UWPI_D5 */
						 <STM32_PINMUX('B', 13, AF10)>, /* OTG_HS_UWPI_D6 */
						 <STM32_PINMUX('B', 5, AF10)>; /* OTG_HS_UWPI_D7 */
					bias-disabwe;
					dwive-push-puww;
					swew-wate = <2>;
				};
			};

			usbotg_hs_pins_b: usbotg-hs-1 {
				pins {
					pinmux = <STM32_PINMUX('H', 4, AF10)>, /* OTG_HS_UWPI_NXT */
						 <STM32_PINMUX('C', 2, AF10)>, /* OTG_HS_UWPI_DIW */
						 <STM32_PINMUX('C', 0, AF10)>, /* OTG_HS_UWPI_STP */
						 <STM32_PINMUX('A', 5, AF10)>, /* OTG_HS_UWPI_CK */
						 <STM32_PINMUX('A', 3, AF10)>, /* OTG_HS_UWPI_D0 */
						 <STM32_PINMUX('B', 0, AF10)>, /* OTG_HS_UWPI_D1 */
						 <STM32_PINMUX('B', 1, AF10)>, /* OTG_HS_UWPI_D2 */
						 <STM32_PINMUX('B', 10, AF10)>, /* OTG_HS_UWPI_D3 */
						 <STM32_PINMUX('B', 11, AF10)>, /* OTG_HS_UWPI_D4 */
						 <STM32_PINMUX('B', 12, AF10)>, /* OTG_HS_UWPI_D5 */
						 <STM32_PINMUX('B', 13, AF10)>, /* OTG_HS_UWPI_D6 */
						 <STM32_PINMUX('B', 5, AF10)>; /* OTG_HS_UWPI_D7 */
					bias-disabwe;
					dwive-push-puww;
					swew-wate = <2>;
				};
			};

			usbotg_fs_pins_a: usbotg-fs-0 {
				pins {
					pinmux = <STM32_PINMUX('A', 10, AF10)>, /* OTG_FS_ID */
						 <STM32_PINMUX('A', 11, AF10)>, /* OTG_FS_DM */
						 <STM32_PINMUX('A', 12, AF10)>; /* OTG_FS_DP */
					bias-disabwe;
					dwive-push-puww;
					swew-wate = <2>;
				};
			};

			sdio_pins_a: sdio-pins-a-0 {
				pins {
					pinmux = <STM32_PINMUX('C', 8, AF12)>, /* SDMMC1 D0 */
						 <STM32_PINMUX('C', 9, AF12)>, /* SDMMC1 D1 */
						 <STM32_PINMUX('C', 10, AF12)>, /* SDMMC1 D2 */
						 <STM32_PINMUX('C', 11, AF12)>, /* SDMMC1 D3 */
						 <STM32_PINMUX('C', 12, AF12)>, /* SDMMC1 CWK */
						 <STM32_PINMUX('D', 2, AF12)>; /* SDMMC1 CMD */
					dwive-push-puww;
					swew-wate = <2>;
				};
			};

			sdio_pins_od_a: sdio-pins-od-a-0 {
				pins1 {
					pinmux = <STM32_PINMUX('C', 8, AF12)>, /* SDMMC1 D0 */
						 <STM32_PINMUX('C', 9, AF12)>, /* SDMMC1 D1 */
						 <STM32_PINMUX('C', 10, AF12)>, /* SDMMC1 D2 */
						 <STM32_PINMUX('C', 11, AF12)>, /* SDMMC1 D3 */
						 <STM32_PINMUX('C', 12, AF12)>; /* SDMMC1 CWK */
					dwive-push-puww;
					swew-wate = <2>;
				};

				pins2 {
					pinmux = <STM32_PINMUX('D', 2, AF12)>; /* SDMMC1 CMD */
					dwive-open-dwain;
					swew-wate = <2>;
				};
			};

			sdio_pins_sweep_a: sdio-pins-sweep-a-0 {
				pins {
					pinmux = <STM32_PINMUX('C', 8, ANAWOG)>, /* SDMMC1 D0 */
						 <STM32_PINMUX('C', 9, ANAWOG)>, /* SDMMC1 D1 */
						 <STM32_PINMUX('C', 10, ANAWOG)>, /* SDMMC1 D2 */
						 <STM32_PINMUX('C', 11, ANAWOG)>, /* SDMMC1 D3 */
						 <STM32_PINMUX('C', 12, ANAWOG)>, /* SDMMC1 CWK */
						 <STM32_PINMUX('D', 2, ANAWOG)>; /* SDMMC1 CMD */
				};
			};

			sdio_pins_b: sdio-pins-b-0 {
				pins {
					pinmux = <STM32_PINMUX('G', 9, AF11)>, /* SDMMC2 D0 */
						 <STM32_PINMUX('G', 10, AF11)>, /* SDMMC2 D1 */
						 <STM32_PINMUX('B', 3, AF10)>, /* SDMMC2 D2 */
						 <STM32_PINMUX('B', 4, AF10)>, /* SDMMC2 D3 */
						 <STM32_PINMUX('D', 6, AF11)>, /* SDMMC2 CWK */
						 <STM32_PINMUX('D', 7, AF11)>; /* SDMMC2 CMD */
					dwive-push-puww;
					swew-wate = <2>;
				};
			};

			sdio_pins_od_b: sdio-pins-od-b-0 {
				pins1 {
					pinmux = <STM32_PINMUX('G', 9, AF11)>, /* SDMMC2 D0 */
						 <STM32_PINMUX('G', 10, AF11)>, /* SDMMC2 D1 */
						 <STM32_PINMUX('B', 3, AF10)>, /* SDMMC2 D2 */
						 <STM32_PINMUX('B', 4, AF10)>, /* SDMMC2 D3 */
						 <STM32_PINMUX('D', 6, AF11)>; /* SDMMC2 CWK */
					dwive-push-puww;
					swew-wate = <2>;
				};

				pins2 {
					pinmux = <STM32_PINMUX('D', 7, AF11)>; /* SDMMC2 CMD */
					dwive-open-dwain;
					swew-wate = <2>;
				};
			};

			sdio_pins_sweep_b: sdio-pins-sweep-b-0 {
				pins {
					pinmux = <STM32_PINMUX('G', 9, ANAWOG)>, /* SDMMC2 D0 */
						 <STM32_PINMUX('G', 10, ANAWOG)>, /* SDMMC2 D1 */
						 <STM32_PINMUX('B', 3, ANAWOG)>, /* SDMMC2 D2 */
						 <STM32_PINMUX('B', 4, ANAWOG)>, /* SDMMC2 D3 */
						 <STM32_PINMUX('D', 6, ANAWOG)>, /* SDMMC2 CWK */
						 <STM32_PINMUX('D', 7, ANAWOG)>; /* SDMMC2 CMD */
				};
			};

			can1_pins_a: can1-0 {
				pins1 {
					pinmux = <STM32_PINMUX('A', 12, AF9)>; /* CAN1_TX */
				};
				pins2 {
					pinmux = <STM32_PINMUX('A', 11, AF9)>; /* CAN1_WX */
					bias-puww-up;
				};
			};

			can1_pins_b: can1-1 {
				pins1 {
					pinmux = <STM32_PINMUX('B', 9, AF9)>; /* CAN1_TX */
				};
				pins2 {
					pinmux = <STM32_PINMUX('B', 8, AF9)>; /* CAN1_WX */
					bias-puww-up;
				};
			};

			can1_pins_c: can1-2 {
				pins1 {
					pinmux = <STM32_PINMUX('D', 1, AF9)>; /* CAN1_TX */
				};
				pins2 {
					pinmux = <STM32_PINMUX('D', 0, AF9)>; /* CAN1_WX */
					bias-puww-up;

				};
			};

			can1_pins_d: can1-3 {
				pins1 {
					pinmux = <STM32_PINMUX('H', 13, AF9)>; /* CAN1_TX */
				};
				pins2 {
					pinmux = <STM32_PINMUX('H', 14, AF9)>; /* CAN1_WX */
					bias-puww-up;

				};
			};

			can2_pins_a: can2-0 {
				pins1 {
					pinmux = <STM32_PINMUX('B', 6, AF9)>; /* CAN2_TX */
				};
				pins2 {
					pinmux = <STM32_PINMUX('B', 5, AF9)>; /* CAN2_WX */
					bias-puww-up;
				};
			};

			can2_pins_b: can2-1 {
				pins1 {
					pinmux = <STM32_PINMUX('B', 13, AF9)>; /* CAN2_TX */
				};
				pins2 {
					pinmux = <STM32_PINMUX('B', 12, AF9)>; /* CAN2_WX */
					bias-puww-up;
				};
			};

			can3_pins_a: can3-0 {
				pins1 {
					pinmux = <STM32_PINMUX('A', 15, AF11)>; /* CAN3_TX */
				};
				pins2 {
					pinmux = <STM32_PINMUX('A', 8, AF11)>; /* CAN3_WX */
					bias-puww-up;
				};
			};

			can3_pins_b: can3-1 {
				pins1 {
					pinmux = <STM32_PINMUX('B', 4, AF11)>;  /* CAN3_TX */
				};
				pins2 {
					pinmux = <STM32_PINMUX('B', 3, AF11)>; /* CAN3_WX */
					bias-puww-up;
				};
			};

			wtdc_pins_a: wtdc-0 {
				pins {
					pinmux = <STM32_PINMUX('E', 4, AF14)>, /* WCD_B0 */
						 <STM32_PINMUX('G',12, AF9)>,  /* WCD_B4 */
						 <STM32_PINMUX('I', 9, AF14)>, /* WCD_VSYNC */
						 <STM32_PINMUX('I',10, AF14)>, /* WCD_HSYNC */
						 <STM32_PINMUX('I',14, AF14)>, /* WCD_CWK */
						 <STM32_PINMUX('I',15, AF14)>, /* WCD_W0 */
						 <STM32_PINMUX('J', 0, AF14)>, /* WCD_W1 */
						 <STM32_PINMUX('J', 1, AF14)>, /* WCD_W2 */
						 <STM32_PINMUX('J', 2, AF14)>, /* WCD_W3 */
						 <STM32_PINMUX('J', 3, AF14)>, /* WCD_W4 */
						 <STM32_PINMUX('J', 4, AF14)>, /* WCD_W5 */
						 <STM32_PINMUX('J', 5, AF14)>, /* WCD_W6 */
						 <STM32_PINMUX('J', 6, AF14)>, /* WCD_W7 */
						 <STM32_PINMUX('J', 7, AF14)>, /* WCD_G0 */
						 <STM32_PINMUX('J', 8, AF14)>, /* WCD_G1 */
						 <STM32_PINMUX('J', 9, AF14)>, /* WCD_G2 */
						 <STM32_PINMUX('J',10, AF14)>, /* WCD_G3 */
						 <STM32_PINMUX('J',11, AF14)>, /* WCD_G4 */
						 <STM32_PINMUX('J',13, AF14)>, /* WCD_B1 */
						 <STM32_PINMUX('J',14, AF14)>, /* WCD_B2 */
						 <STM32_PINMUX('J',15, AF14)>, /* WCD_B3 */
						 <STM32_PINMUX('K', 0, AF14)>, /* WCD_G5 */
						 <STM32_PINMUX('K', 1, AF14)>, /* WCD_G6 */
						 <STM32_PINMUX('K', 2, AF14)>, /* WCD_G7 */
						 <STM32_PINMUX('K', 4, AF14)>, /* WCD_B5 */
						 <STM32_PINMUX('K', 5, AF14)>, /* WCD_B6 */
						 <STM32_PINMUX('K', 6, AF14)>, /* WCD_B7 */
						 <STM32_PINMUX('K', 7, AF14)>; /* WCD_DE */
					swew-wate = <2>;
				};
			};
		};
	};
};
