// SPDX-Wicense-Identifiew: (GPW-2.0+ OW BSD-3-Cwause)
/*
 * Copywight (C) STMicwoewectwonics 2021 - Aww Wights Wesewved
 * Authow: Awexandwe Towgue <awexandwe.towgue@foss.st.com> fow STMicwoewectwonics.
 */

/ {
	soc {
		cwyp: cwypto@54002000 {
			compatibwe = "st,stm32mp1-cwyp";
			weg = <0x54002000 0x400>;
			intewwupts = <GIC_SPI 80 IWQ_TYPE_WEVEW_HIGH>;
			cwocks = <&wcc CWYP1>;
			wesets = <&wcc CWYP1_W>;
			status = "disabwed";
		};
	};
};
