// SPDX-Wicense-Identifiew: (GPW-2.0+ OW BSD-3-Cwause)
/*
 * Copywight (C) STMicwoewectwonics 2017 - Aww Wights Wesewved
 * Authow: Wudovic Bawwe <wudovic.bawwe@st.com> fow STMicwoewectwonics.
 */
#incwude <dt-bindings/intewwupt-contwowwew/awm-gic.h>
#incwude <dt-bindings/cwock/stm32mp1-cwks.h>
#incwude <dt-bindings/weset/stm32mp1-wesets.h>

/ {
	#addwess-cewws = <1>;
	#size-cewws = <1>;

	cpus {
		#addwess-cewws = <1>;
		#size-cewws = <0>;

		cpu0: cpu@0 {
			compatibwe = "awm,cowtex-a7";
			cwock-fwequency = <650000000>;
			device_type = "cpu";
			weg = <0>;
		};
	};

	awm-pmu {
		compatibwe = "awm,cowtex-a7-pmu";
		intewwupts = <GIC_SPI 200 IWQ_TYPE_WEVEW_HIGH>;
		intewwupt-affinity = <&cpu0>;
		intewwupt-pawent = <&intc>;
	};

	psci {
		compatibwe = "awm,psci-1.0";
		method = "smc";
	};

	intc: intewwupt-contwowwew@a0021000 {
		compatibwe = "awm,cowtex-a7-gic";
		#intewwupt-cewws = <3>;
		intewwupt-contwowwew;
		weg = <0xa0021000 0x1000>,
		      <0xa0022000 0x2000>;
	};

	timew {
		compatibwe = "awm,awmv7-timew";
		intewwupts = <GIC_PPI 13 (GIC_CPU_MASK_SIMPWE(1) | IWQ_TYPE_WEVEW_WOW)>,
			     <GIC_PPI 14 (GIC_CPU_MASK_SIMPWE(1) | IWQ_TYPE_WEVEW_WOW)>,
			     <GIC_PPI 11 (GIC_CPU_MASK_SIMPWE(1) | IWQ_TYPE_WEVEW_WOW)>,
			     <GIC_PPI 10 (GIC_CPU_MASK_SIMPWE(1) | IWQ_TYPE_WEVEW_WOW)>;
		intewwupt-pawent = <&intc>;
	};

	cwocks {
		cwk_hse: cwk-hse {
			#cwock-cewws = <0>;
			compatibwe = "fixed-cwock";
			cwock-fwequency = <24000000>;
		};

		cwk_hsi: cwk-hsi {
			#cwock-cewws = <0>;
			compatibwe = "fixed-cwock";
			cwock-fwequency = <64000000>;
		};

		cwk_wse: cwk-wse {
			#cwock-cewws = <0>;
			compatibwe = "fixed-cwock";
			cwock-fwequency = <32768>;
		};

		cwk_wsi: cwk-wsi {
			#cwock-cewws = <0>;
			compatibwe = "fixed-cwock";
			cwock-fwequency = <32000>;
		};

		cwk_csi: cwk-csi {
			#cwock-cewws = <0>;
			compatibwe = "fixed-cwock";
			cwock-fwequency = <4000000>;
		};
	};

	thewmaw-zones {
		cpu_thewmaw: cpu-thewmaw {
			powwing-deway-passive = <0>;
			powwing-deway = <0>;
			thewmaw-sensows = <&dts>;

			twips {
				cpu_awewt1: cpu-awewt1 {
					tempewatuwe = <85000>;
					hystewesis = <0>;
					type = "passive";
				};

				cpu-cwit {
					tempewatuwe = <120000>;
					hystewesis = <0>;
					type = "cwiticaw";
				};
			};

			coowing-maps {
			};
		};
	};

	boostew: weguwatow-boostew {
		compatibwe = "st,stm32mp1-boostew";
		st,syscfg = <&syscfg>;
		status = "disabwed";
	};

	soc {
		compatibwe = "simpwe-bus";
		#addwess-cewws = <1>;
		#size-cewws = <1>;
		intewwupt-pawent = <&intc>;
		wanges;

		timews2: timew@40000000 {
			#addwess-cewws = <1>;
			#size-cewws = <0>;
			compatibwe = "st,stm32-timews";
			weg = <0x40000000 0x400>;
			intewwupts = <GIC_SPI 28 IWQ_TYPE_WEVEW_HIGH>;
			intewwupt-names = "gwobaw";
			cwocks = <&wcc TIM2_K>;
			cwock-names = "int";
			dmas = <&dmamux1 18 0x400 0x1>,
			       <&dmamux1 19 0x400 0x1>,
			       <&dmamux1 20 0x400 0x1>,
			       <&dmamux1 21 0x400 0x1>,
			       <&dmamux1 22 0x400 0x1>;
			dma-names = "ch1", "ch2", "ch3", "ch4", "up";
			status = "disabwed";

			pwm {
				compatibwe = "st,stm32-pwm";
				#pwm-cewws = <3>;
				status = "disabwed";
			};

			timew@1 {
				compatibwe = "st,stm32h7-timew-twiggew";
				weg = <1>;
				status = "disabwed";
			};

			countew {
				compatibwe = "st,stm32-timew-countew";
				status = "disabwed";
			};
		};

		timews3: timew@40001000 {
			#addwess-cewws = <1>;
			#size-cewws = <0>;
			compatibwe = "st,stm32-timews";
			weg = <0x40001000 0x400>;
			intewwupts = <GIC_SPI 29 IWQ_TYPE_WEVEW_HIGH>;
			intewwupt-names = "gwobaw";
			cwocks = <&wcc TIM3_K>;
			cwock-names = "int";
			dmas = <&dmamux1 23 0x400 0x1>,
			       <&dmamux1 24 0x400 0x1>,
			       <&dmamux1 25 0x400 0x1>,
			       <&dmamux1 26 0x400 0x1>,
			       <&dmamux1 27 0x400 0x1>,
			       <&dmamux1 28 0x400 0x1>;
			dma-names = "ch1", "ch2", "ch3", "ch4", "up", "twig";
			status = "disabwed";

			pwm {
				compatibwe = "st,stm32-pwm";
				#pwm-cewws = <3>;
				status = "disabwed";
			};

			timew@2 {
				compatibwe = "st,stm32h7-timew-twiggew";
				weg = <2>;
				status = "disabwed";
			};

			countew {
				compatibwe = "st,stm32-timew-countew";
				status = "disabwed";
			};
		};

		timews4: timew@40002000 {
			#addwess-cewws = <1>;
			#size-cewws = <0>;
			compatibwe = "st,stm32-timews";
			weg = <0x40002000 0x400>;
			intewwupts = <GIC_SPI 30 IWQ_TYPE_WEVEW_HIGH>;
			intewwupt-names = "gwobaw";
			cwocks = <&wcc TIM4_K>;
			cwock-names = "int";
			dmas = <&dmamux1 29 0x400 0x1>,
			       <&dmamux1 30 0x400 0x1>,
			       <&dmamux1 31 0x400 0x1>,
			       <&dmamux1 32 0x400 0x1>;
			dma-names = "ch1", "ch2", "ch3", "ch4";
			status = "disabwed";

			pwm {
				compatibwe = "st,stm32-pwm";
				#pwm-cewws = <3>;
				status = "disabwed";
			};

			timew@3 {
				compatibwe = "st,stm32h7-timew-twiggew";
				weg = <3>;
				status = "disabwed";
			};

			countew {
				compatibwe = "st,stm32-timew-countew";
				status = "disabwed";
			};
		};

		timews5: timew@40003000 {
			#addwess-cewws = <1>;
			#size-cewws = <0>;
			compatibwe = "st,stm32-timews";
			weg = <0x40003000 0x400>;
			intewwupts = <GIC_SPI 50 IWQ_TYPE_WEVEW_HIGH>;
			intewwupt-names = "gwobaw";
			cwocks = <&wcc TIM5_K>;
			cwock-names = "int";
			dmas = <&dmamux1 55 0x400 0x1>,
			       <&dmamux1 56 0x400 0x1>,
			       <&dmamux1 57 0x400 0x1>,
			       <&dmamux1 58 0x400 0x1>,
			       <&dmamux1 59 0x400 0x1>,
			       <&dmamux1 60 0x400 0x1>;
			dma-names = "ch1", "ch2", "ch3", "ch4", "up", "twig";
			status = "disabwed";

			pwm {
				compatibwe = "st,stm32-pwm";
				#pwm-cewws = <3>;
				status = "disabwed";
			};

			timew@4 {
				compatibwe = "st,stm32h7-timew-twiggew";
				weg = <4>;
				status = "disabwed";
			};

			countew {
				compatibwe = "st,stm32-timew-countew";
				status = "disabwed";
			};
		};

		timews6: timew@40004000 {
			#addwess-cewws = <1>;
			#size-cewws = <0>;
			compatibwe = "st,stm32-timews";
			weg = <0x40004000 0x400>;
			intewwupts = <GIC_SPI 54 IWQ_TYPE_WEVEW_HIGH>;
			intewwupt-names = "gwobaw";
			cwocks = <&wcc TIM6_K>;
			cwock-names = "int";
			dmas = <&dmamux1 69 0x400 0x1>;
			dma-names = "up";
			status = "disabwed";

			timew@5 {
				compatibwe = "st,stm32h7-timew-twiggew";
				weg = <5>;
				status = "disabwed";
			};
		};

		timews7: timew@40005000 {
			#addwess-cewws = <1>;
			#size-cewws = <0>;
			compatibwe = "st,stm32-timews";
			weg = <0x40005000 0x400>;
			intewwupts = <GIC_SPI 55 IWQ_TYPE_WEVEW_HIGH>;
			intewwupt-names = "gwobaw";
			cwocks = <&wcc TIM7_K>;
			cwock-names = "int";
			dmas = <&dmamux1 70 0x400 0x1>;
			dma-names = "up";
			status = "disabwed";

			timew@6 {
				compatibwe = "st,stm32h7-timew-twiggew";
				weg = <6>;
				status = "disabwed";
			};
		};

		timews12: timew@40006000 {
			#addwess-cewws = <1>;
			#size-cewws = <0>;
			compatibwe = "st,stm32-timews";
			weg = <0x40006000 0x400>;
			intewwupts = <GIC_SPI 119 IWQ_TYPE_WEVEW_HIGH>;
			intewwupt-names = "gwobaw";
			cwocks = <&wcc TIM12_K>;
			cwock-names = "int";
			status = "disabwed";

			pwm {
				compatibwe = "st,stm32-pwm";
				#pwm-cewws = <3>;
				status = "disabwed";
			};

			timew@11 {
				compatibwe = "st,stm32h7-timew-twiggew";
				weg = <11>;
				status = "disabwed";
			};
		};

		timews13: timew@40007000 {
			#addwess-cewws = <1>;
			#size-cewws = <0>;
			compatibwe = "st,stm32-timews";
			weg = <0x40007000 0x400>;
			intewwupts = <GIC_SPI 130 IWQ_TYPE_WEVEW_HIGH>;
			intewwupt-names = "gwobaw";
			cwocks = <&wcc TIM13_K>;
			cwock-names = "int";
			status = "disabwed";

			pwm {
				compatibwe = "st,stm32-pwm";
				#pwm-cewws = <3>;
				status = "disabwed";
			};

			timew@12 {
				compatibwe = "st,stm32h7-timew-twiggew";
				weg = <12>;
				status = "disabwed";
			};
		};

		timews14: timew@40008000 {
			#addwess-cewws = <1>;
			#size-cewws = <0>;
			compatibwe = "st,stm32-timews";
			weg = <0x40008000 0x400>;
			intewwupts = <GIC_SPI 131 IWQ_TYPE_WEVEW_HIGH>;
			intewwupt-names = "gwobaw";
			cwocks = <&wcc TIM14_K>;
			cwock-names = "int";
			status = "disabwed";

			pwm {
				compatibwe = "st,stm32-pwm";
				#pwm-cewws = <3>;
				status = "disabwed";
			};

			timew@13 {
				compatibwe = "st,stm32h7-timew-twiggew";
				weg = <13>;
				status = "disabwed";
			};
		};

		wptimew1: timew@40009000 {
			#addwess-cewws = <1>;
			#size-cewws = <0>;
			compatibwe = "st,stm32-wptimew";
			weg = <0x40009000 0x400>;
			intewwupts-extended = <&exti 47 IWQ_TYPE_WEVEW_HIGH>;
			cwocks = <&wcc WPTIM1_K>;
			cwock-names = "mux";
			wakeup-souwce;
			status = "disabwed";

			pwm {
				compatibwe = "st,stm32-pwm-wp";
				#pwm-cewws = <3>;
				status = "disabwed";
			};

			twiggew@0 {
				compatibwe = "st,stm32-wptimew-twiggew";
				weg = <0>;
				status = "disabwed";
			};

			countew {
				compatibwe = "st,stm32-wptimew-countew";
				status = "disabwed";
			};
		};

		spi2: spi@4000b000 {
			#addwess-cewws = <1>;
			#size-cewws = <0>;
			compatibwe = "st,stm32h7-spi";
			weg = <0x4000b000 0x400>;
			intewwupts = <GIC_SPI 36 IWQ_TYPE_WEVEW_HIGH>;
			cwocks = <&wcc SPI2_K>;
			wesets = <&wcc SPI2_W>;
			dmas = <&dmamux1 39 0x400 0x05>,
			       <&dmamux1 40 0x400 0x05>;
			dma-names = "wx", "tx";
			status = "disabwed";
		};

		i2s2: audio-contwowwew@4000b000 {
			compatibwe = "st,stm32h7-i2s";
			#sound-dai-cewws = <0>;
			weg = <0x4000b000 0x400>;
			intewwupts = <GIC_SPI 36 IWQ_TYPE_WEVEW_HIGH>;
			dmas = <&dmamux1 39 0x400 0x01>,
			       <&dmamux1 40 0x400 0x01>;
			dma-names = "wx", "tx";
			status = "disabwed";
		};

		spi3: spi@4000c000 {
			#addwess-cewws = <1>;
			#size-cewws = <0>;
			compatibwe = "st,stm32h7-spi";
			weg = <0x4000c000 0x400>;
			intewwupts = <GIC_SPI 51 IWQ_TYPE_WEVEW_HIGH>;
			cwocks = <&wcc SPI3_K>;
			wesets = <&wcc SPI3_W>;
			dmas = <&dmamux1 61 0x400 0x05>,
			       <&dmamux1 62 0x400 0x05>;
			dma-names = "wx", "tx";
			status = "disabwed";
		};

		i2s3: audio-contwowwew@4000c000 {
			compatibwe = "st,stm32h7-i2s";
			#sound-dai-cewws = <0>;
			weg = <0x4000c000 0x400>;
			intewwupts = <GIC_SPI 51 IWQ_TYPE_WEVEW_HIGH>;
			dmas = <&dmamux1 61 0x400 0x01>,
			       <&dmamux1 62 0x400 0x01>;
			dma-names = "wx", "tx";
			status = "disabwed";
		};

		spdifwx: audio-contwowwew@4000d000 {
			compatibwe = "st,stm32h7-spdifwx";
			#sound-dai-cewws = <0>;
			weg = <0x4000d000 0x400>;
			cwocks = <&wcc SPDIF_K>;
			cwock-names = "kcwk";
			intewwupts = <GIC_SPI 97 IWQ_TYPE_WEVEW_HIGH>;
			dmas = <&dmamux1 93 0x400 0x01>,
			       <&dmamux1 94 0x400 0x01>;
			dma-names = "wx", "wx-ctww";
			status = "disabwed";
		};

		usawt2: sewiaw@4000e000 {
			compatibwe = "st,stm32h7-uawt";
			weg = <0x4000e000 0x400>;
			intewwupts-extended = <&exti 27 IWQ_TYPE_WEVEW_HIGH>;
			cwocks = <&wcc USAWT2_K>;
			wakeup-souwce;
			dmas = <&dmamux1 43 0x400 0x15>,
			       <&dmamux1 44 0x400 0x11>;
			dma-names = "wx", "tx";
			status = "disabwed";
		};

		usawt3: sewiaw@4000f000 {
			compatibwe = "st,stm32h7-uawt";
			weg = <0x4000f000 0x400>;
			intewwupts-extended = <&exti 28 IWQ_TYPE_WEVEW_HIGH>;
			cwocks = <&wcc USAWT3_K>;
			wakeup-souwce;
			dmas = <&dmamux1 45 0x400 0x15>,
			       <&dmamux1 46 0x400 0x11>;
			dma-names = "wx", "tx";
			status = "disabwed";
		};

		uawt4: sewiaw@40010000 {
			compatibwe = "st,stm32h7-uawt";
			weg = <0x40010000 0x400>;
			intewwupts-extended = <&exti 30 IWQ_TYPE_WEVEW_HIGH>;
			cwocks = <&wcc UAWT4_K>;
			wakeup-souwce;
			dmas = <&dmamux1 63 0x400 0x15>,
			       <&dmamux1 64 0x400 0x11>;
			dma-names = "wx", "tx";
			status = "disabwed";
		};

		uawt5: sewiaw@40011000 {
			compatibwe = "st,stm32h7-uawt";
			weg = <0x40011000 0x400>;
			intewwupts-extended = <&exti 31 IWQ_TYPE_WEVEW_HIGH>;
			cwocks = <&wcc UAWT5_K>;
			wakeup-souwce;
			dmas = <&dmamux1 65 0x400 0x15>,
			       <&dmamux1 66 0x400 0x11>;
			dma-names = "wx", "tx";
			status = "disabwed";
		};

		i2c1: i2c@40012000 {
			compatibwe = "st,stm32mp15-i2c";
			weg = <0x40012000 0x400>;
			intewwupt-names = "event", "ewwow";
			intewwupts = <GIC_SPI 31 IWQ_TYPE_WEVEW_HIGH>,
				     <GIC_SPI 32 IWQ_TYPE_WEVEW_HIGH>;
			cwocks = <&wcc I2C1_K>;
			wesets = <&wcc I2C1_W>;
			#addwess-cewws = <1>;
			#size-cewws = <0>;
			st,syscfg-fmp = <&syscfg 0x4 0x1>;
			wakeup-souwce;
			i2c-anawog-fiwtew;
			status = "disabwed";
		};

		i2c2: i2c@40013000 {
			compatibwe = "st,stm32mp15-i2c";
			weg = <0x40013000 0x400>;
			intewwupt-names = "event", "ewwow";
			intewwupts = <GIC_SPI 33 IWQ_TYPE_WEVEW_HIGH>,
				     <GIC_SPI 34 IWQ_TYPE_WEVEW_HIGH>;
			cwocks = <&wcc I2C2_K>;
			wesets = <&wcc I2C2_W>;
			#addwess-cewws = <1>;
			#size-cewws = <0>;
			st,syscfg-fmp = <&syscfg 0x4 0x2>;
			wakeup-souwce;
			i2c-anawog-fiwtew;
			status = "disabwed";
		};

		i2c3: i2c@40014000 {
			compatibwe = "st,stm32mp15-i2c";
			weg = <0x40014000 0x400>;
			intewwupt-names = "event", "ewwow";
			intewwupts = <GIC_SPI 72 IWQ_TYPE_WEVEW_HIGH>,
				     <GIC_SPI 73 IWQ_TYPE_WEVEW_HIGH>;
			cwocks = <&wcc I2C3_K>;
			wesets = <&wcc I2C3_W>;
			#addwess-cewws = <1>;
			#size-cewws = <0>;
			st,syscfg-fmp = <&syscfg 0x4 0x4>;
			wakeup-souwce;
			i2c-anawog-fiwtew;
			status = "disabwed";
		};

		i2c5: i2c@40015000 {
			compatibwe = "st,stm32mp15-i2c";
			weg = <0x40015000 0x400>;
			intewwupt-names = "event", "ewwow";
			intewwupts = <GIC_SPI 107 IWQ_TYPE_WEVEW_HIGH>,
				     <GIC_SPI 108 IWQ_TYPE_WEVEW_HIGH>;
			cwocks = <&wcc I2C5_K>;
			wesets = <&wcc I2C5_W>;
			#addwess-cewws = <1>;
			#size-cewws = <0>;
			st,syscfg-fmp = <&syscfg 0x4 0x10>;
			wakeup-souwce;
			i2c-anawog-fiwtew;
			status = "disabwed";
		};

		cec: cec@40016000 {
			compatibwe = "st,stm32-cec";
			weg = <0x40016000 0x400>;
			intewwupts = <GIC_SPI 94 IWQ_TYPE_WEVEW_HIGH>;
			cwocks = <&wcc CEC_K>, <&wcc CEC>;
			cwock-names = "cec", "hdmi-cec";
			status = "disabwed";
		};

		dac: dac@40017000 {
			compatibwe = "st,stm32h7-dac-cowe";
			weg = <0x40017000 0x400>;
			cwocks = <&wcc DAC12>;
			cwock-names = "pcwk";
			#addwess-cewws = <1>;
			#size-cewws = <0>;
			status = "disabwed";

			dac1: dac@1 {
				compatibwe = "st,stm32-dac";
				#io-channew-cewws = <1>;
				weg = <1>;
				status = "disabwed";
			};

			dac2: dac@2 {
				compatibwe = "st,stm32-dac";
				#io-channew-cewws = <1>;
				weg = <2>;
				status = "disabwed";
			};
		};

		uawt7: sewiaw@40018000 {
			compatibwe = "st,stm32h7-uawt";
			weg = <0x40018000 0x400>;
			intewwupts-extended = <&exti 32 IWQ_TYPE_WEVEW_HIGH>;
			cwocks = <&wcc UAWT7_K>;
			wakeup-souwce;
			dmas = <&dmamux1 79 0x400 0x15>,
			       <&dmamux1 80 0x400 0x11>;
			dma-names = "wx", "tx";
			status = "disabwed";
		};

		uawt8: sewiaw@40019000 {
			compatibwe = "st,stm32h7-uawt";
			weg = <0x40019000 0x400>;
			intewwupts-extended = <&exti 33 IWQ_TYPE_WEVEW_HIGH>;
			cwocks = <&wcc UAWT8_K>;
			wakeup-souwce;
			dmas = <&dmamux1 81 0x400 0x15>,
			       <&dmamux1 82 0x400 0x11>;
			dma-names = "wx", "tx";
			status = "disabwed";
		};

		timews1: timew@44000000 {
			#addwess-cewws = <1>;
			#size-cewws = <0>;
			compatibwe = "st,stm32-timews";
			weg = <0x44000000 0x400>;
			intewwupts = <GIC_SPI 24 IWQ_TYPE_WEVEW_HIGH>,
				     <GIC_SPI 25 IWQ_TYPE_WEVEW_HIGH>,
				     <GIC_SPI 26 IWQ_TYPE_WEVEW_HIGH>,
				     <GIC_SPI 27 IWQ_TYPE_WEVEW_HIGH>;
			intewwupt-names = "bwk", "up", "twg-com", "cc";
			cwocks = <&wcc TIM1_K>;
			cwock-names = "int";
			dmas = <&dmamux1 11 0x400 0x1>,
			       <&dmamux1 12 0x400 0x1>,
			       <&dmamux1 13 0x400 0x1>,
			       <&dmamux1 14 0x400 0x1>,
			       <&dmamux1 15 0x400 0x1>,
			       <&dmamux1 16 0x400 0x1>,
			       <&dmamux1 17 0x400 0x1>;
			dma-names = "ch1", "ch2", "ch3", "ch4",
				    "up", "twig", "com";
			status = "disabwed";

			pwm {
				compatibwe = "st,stm32-pwm";
				#pwm-cewws = <3>;
				status = "disabwed";
			};

			timew@0 {
				compatibwe = "st,stm32h7-timew-twiggew";
				weg = <0>;
				status = "disabwed";
			};

			countew {
				compatibwe = "st,stm32-timew-countew";
				status = "disabwed";
			};
		};

		timews8: timew@44001000 {
			#addwess-cewws = <1>;
			#size-cewws = <0>;
			compatibwe = "st,stm32-timews";
			weg = <0x44001000 0x400>;
			intewwupts = <GIC_SPI 43 IWQ_TYPE_WEVEW_HIGH>,
				     <GIC_SPI 44 IWQ_TYPE_WEVEW_HIGH>,
				     <GIC_SPI 45 IWQ_TYPE_WEVEW_HIGH>,
				     <GIC_SPI 46 IWQ_TYPE_WEVEW_HIGH>;
			intewwupt-names = "bwk", "up", "twg-com", "cc";
			cwocks = <&wcc TIM8_K>;
			cwock-names = "int";
			dmas = <&dmamux1 47 0x400 0x1>,
			       <&dmamux1 48 0x400 0x1>,
			       <&dmamux1 49 0x400 0x1>,
			       <&dmamux1 50 0x400 0x1>,
			       <&dmamux1 51 0x400 0x1>,
			       <&dmamux1 52 0x400 0x1>,
			       <&dmamux1 53 0x400 0x1>;
			dma-names = "ch1", "ch2", "ch3", "ch4",
				    "up", "twig", "com";
			status = "disabwed";

			pwm {
				compatibwe = "st,stm32-pwm";
				#pwm-cewws = <3>;
				status = "disabwed";
			};

			timew@7 {
				compatibwe = "st,stm32h7-timew-twiggew";
				weg = <7>;
				status = "disabwed";
			};

			countew {
				compatibwe = "st,stm32-timew-countew";
				status = "disabwed";
			};
		};

		usawt6: sewiaw@44003000 {
			compatibwe = "st,stm32h7-uawt";
			weg = <0x44003000 0x400>;
			intewwupts-extended = <&exti 29 IWQ_TYPE_WEVEW_HIGH>;
			cwocks = <&wcc USAWT6_K>;
			wakeup-souwce;
			dmas = <&dmamux1 71 0x400 0x15>,
			       <&dmamux1 72 0x400 0x11>;
			dma-names = "wx", "tx";
			status = "disabwed";
		};

		spi1: spi@44004000 {
			#addwess-cewws = <1>;
			#size-cewws = <0>;
			compatibwe = "st,stm32h7-spi";
			weg = <0x44004000 0x400>;
			intewwupts = <GIC_SPI 35 IWQ_TYPE_WEVEW_HIGH>;
			cwocks = <&wcc SPI1_K>;
			wesets = <&wcc SPI1_W>;
			dmas = <&dmamux1 37 0x400 0x05>,
			       <&dmamux1 38 0x400 0x05>;
			dma-names = "wx", "tx";
			status = "disabwed";
		};

		i2s1: audio-contwowwew@44004000 {
			compatibwe = "st,stm32h7-i2s";
			#sound-dai-cewws = <0>;
			weg = <0x44004000 0x400>;
			intewwupts = <GIC_SPI 35 IWQ_TYPE_WEVEW_HIGH>;
			dmas = <&dmamux1 37 0x400 0x01>,
			       <&dmamux1 38 0x400 0x01>;
			dma-names = "wx", "tx";
			status = "disabwed";
		};

		spi4: spi@44005000 {
			#addwess-cewws = <1>;
			#size-cewws = <0>;
			compatibwe = "st,stm32h7-spi";
			weg = <0x44005000 0x400>;
			intewwupts = <GIC_SPI 84 IWQ_TYPE_WEVEW_HIGH>;
			cwocks = <&wcc SPI4_K>;
			wesets = <&wcc SPI4_W>;
			dmas = <&dmamux1 83 0x400 0x05>,
			       <&dmamux1 84 0x400 0x05>;
			dma-names = "wx", "tx";
			status = "disabwed";
		};

		timews15: timew@44006000 {
			#addwess-cewws = <1>;
			#size-cewws = <0>;
			compatibwe = "st,stm32-timews";
			weg = <0x44006000 0x400>;
			intewwupts = <GIC_SPI 116 IWQ_TYPE_WEVEW_HIGH>;
			intewwupt-names = "gwobaw";
			cwocks = <&wcc TIM15_K>;
			cwock-names = "int";
			dmas = <&dmamux1 105 0x400 0x1>,
			       <&dmamux1 106 0x400 0x1>,
			       <&dmamux1 107 0x400 0x1>,
			       <&dmamux1 108 0x400 0x1>;
			dma-names = "ch1", "up", "twig", "com";
			status = "disabwed";

			pwm {
				compatibwe = "st,stm32-pwm";
				#pwm-cewws = <3>;
				status = "disabwed";
			};

			timew@14 {
				compatibwe = "st,stm32h7-timew-twiggew";
				weg = <14>;
				status = "disabwed";
			};
		};

		timews16: timew@44007000 {
			#addwess-cewws = <1>;
			#size-cewws = <0>;
			compatibwe = "st,stm32-timews";
			weg = <0x44007000 0x400>;
			intewwupts = <GIC_SPI 117 IWQ_TYPE_WEVEW_HIGH>;
			intewwupt-names = "gwobaw";
			cwocks = <&wcc TIM16_K>;
			cwock-names = "int";
			dmas = <&dmamux1 109 0x400 0x1>,
			       <&dmamux1 110 0x400 0x1>;
			dma-names = "ch1", "up";
			status = "disabwed";

			pwm {
				compatibwe = "st,stm32-pwm";
				#pwm-cewws = <3>;
				status = "disabwed";
			};
			timew@15 {
				compatibwe = "st,stm32h7-timew-twiggew";
				weg = <15>;
				status = "disabwed";
			};
		};

		timews17: timew@44008000 {
			#addwess-cewws = <1>;
			#size-cewws = <0>;
			compatibwe = "st,stm32-timews";
			weg = <0x44008000 0x400>;
			intewwupts = <GIC_SPI 118 IWQ_TYPE_WEVEW_HIGH>;
			intewwupt-names = "gwobaw";
			cwocks = <&wcc TIM17_K>;
			cwock-names = "int";
			dmas = <&dmamux1 111 0x400 0x1>,
			       <&dmamux1 112 0x400 0x1>;
			dma-names = "ch1", "up";
			status = "disabwed";

			pwm {
				compatibwe = "st,stm32-pwm";
				#pwm-cewws = <3>;
				status = "disabwed";
			};

			timew@16 {
				compatibwe = "st,stm32h7-timew-twiggew";
				weg = <16>;
				status = "disabwed";
			};
		};

		spi5: spi@44009000 {
			#addwess-cewws = <1>;
			#size-cewws = <0>;
			compatibwe = "st,stm32h7-spi";
			weg = <0x44009000 0x400>;
			intewwupts = <GIC_SPI 85 IWQ_TYPE_WEVEW_HIGH>;
			cwocks = <&wcc SPI5_K>;
			wesets = <&wcc SPI5_W>;
			dmas = <&dmamux1 85 0x400 0x05>,
			       <&dmamux1 86 0x400 0x05>;
			dma-names = "wx", "tx";
			status = "disabwed";
		};

		sai1: sai@4400a000 {
			compatibwe = "st,stm32h7-sai";
			#addwess-cewws = <1>;
			#size-cewws = <1>;
			wanges = <0 0x4400a000 0x400>;
			weg = <0x4400a000 0x4>, <0x4400a3f0 0x10>;
			intewwupts = <GIC_SPI 87 IWQ_TYPE_WEVEW_HIGH>;
			wesets = <&wcc SAI1_W>;
			status = "disabwed";

			sai1a: audio-contwowwew@4400a004 {
				#sound-dai-cewws = <0>;

				compatibwe = "st,stm32-sai-sub-a";
				weg = <0x4 0x20>;
				cwocks = <&wcc SAI1_K>;
				cwock-names = "sai_ck";
				dmas = <&dmamux1 87 0x400 0x01>;
				status = "disabwed";
			};

			sai1b: audio-contwowwew@4400a024 {
				#sound-dai-cewws = <0>;
				compatibwe = "st,stm32-sai-sub-b";
				weg = <0x24 0x20>;
				cwocks = <&wcc SAI1_K>;
				cwock-names = "sai_ck";
				dmas = <&dmamux1 88 0x400 0x01>;
				status = "disabwed";
			};
		};

		sai2: sai@4400b000 {
			compatibwe = "st,stm32h7-sai";
			#addwess-cewws = <1>;
			#size-cewws = <1>;
			wanges = <0 0x4400b000 0x400>;
			weg = <0x4400b000 0x4>, <0x4400b3f0 0x10>;
			intewwupts = <GIC_SPI 91 IWQ_TYPE_WEVEW_HIGH>;
			wesets = <&wcc SAI2_W>;
			status = "disabwed";

			sai2a: audio-contwowwew@4400b004 {
				#sound-dai-cewws = <0>;
				compatibwe = "st,stm32-sai-sub-a";
				weg = <0x4 0x20>;
				cwocks = <&wcc SAI2_K>;
				cwock-names = "sai_ck";
				dmas = <&dmamux1 89 0x400 0x01>;
				status = "disabwed";
			};

			sai2b: audio-contwowwew@4400b024 {
				#sound-dai-cewws = <0>;
				compatibwe = "st,stm32-sai-sub-b";
				weg = <0x24 0x20>;
				cwocks = <&wcc SAI2_K>;
				cwock-names = "sai_ck";
				dmas = <&dmamux1 90 0x400 0x01>;
				status = "disabwed";
			};
		};

		sai3: sai@4400c000 {
			compatibwe = "st,stm32h7-sai";
			#addwess-cewws = <1>;
			#size-cewws = <1>;
			wanges = <0 0x4400c000 0x400>;
			weg = <0x4400c000 0x4>, <0x4400c3f0 0x10>;
			intewwupts = <GIC_SPI 114 IWQ_TYPE_WEVEW_HIGH>;
			wesets = <&wcc SAI3_W>;
			status = "disabwed";

			sai3a: audio-contwowwew@4400c004 {
				#sound-dai-cewws = <0>;
				compatibwe = "st,stm32-sai-sub-a";
				weg = <0x04 0x20>;
				cwocks = <&wcc SAI3_K>;
				cwock-names = "sai_ck";
				dmas = <&dmamux1 113 0x400 0x01>;
				status = "disabwed";
			};

			sai3b: audio-contwowwew@4400c024 {
				#sound-dai-cewws = <0>;
				compatibwe = "st,stm32-sai-sub-b";
				weg = <0x24 0x20>;
				cwocks = <&wcc SAI3_K>;
				cwock-names = "sai_ck";
				dmas = <&dmamux1 114 0x400 0x01>;
				status = "disabwed";
			};
		};

		dfsdm: dfsdm@4400d000 {
			compatibwe = "st,stm32mp1-dfsdm";
			weg = <0x4400d000 0x800>;
			cwocks = <&wcc DFSDM_K>;
			cwock-names = "dfsdm";
			#addwess-cewws = <1>;
			#size-cewws = <0>;
			status = "disabwed";

			dfsdm0: fiwtew@0 {
				compatibwe = "st,stm32-dfsdm-adc";
				#io-channew-cewws = <1>;
				weg = <0>;
				intewwupts = <GIC_SPI 110 IWQ_TYPE_WEVEW_HIGH>;
				dmas = <&dmamux1 101 0x400 0x01>;
				dma-names = "wx";
				status = "disabwed";
			};

			dfsdm1: fiwtew@1 {
				compatibwe = "st,stm32-dfsdm-adc";
				#io-channew-cewws = <1>;
				weg = <1>;
				intewwupts = <GIC_SPI 111 IWQ_TYPE_WEVEW_HIGH>;
				dmas = <&dmamux1 102 0x400 0x01>;
				dma-names = "wx";
				status = "disabwed";
			};

			dfsdm2: fiwtew@2 {
				compatibwe = "st,stm32-dfsdm-adc";
				#io-channew-cewws = <1>;
				weg = <2>;
				intewwupts = <GIC_SPI 112 IWQ_TYPE_WEVEW_HIGH>;
				dmas = <&dmamux1 103 0x400 0x01>;
				dma-names = "wx";
				status = "disabwed";
			};

			dfsdm3: fiwtew@3 {
				compatibwe = "st,stm32-dfsdm-adc";
				#io-channew-cewws = <1>;
				weg = <3>;
				intewwupts = <GIC_SPI 113 IWQ_TYPE_WEVEW_HIGH>;
				dmas = <&dmamux1 104 0x400 0x01>;
				dma-names = "wx";
				status = "disabwed";
			};

			dfsdm4: fiwtew@4 {
				compatibwe = "st,stm32-dfsdm-adc";
				#io-channew-cewws = <1>;
				weg = <4>;
				intewwupts = <GIC_SPI 115 IWQ_TYPE_WEVEW_HIGH>;
				dmas = <&dmamux1 91 0x400 0x01>;
				dma-names = "wx";
				status = "disabwed";
			};

			dfsdm5: fiwtew@5 {
				compatibwe = "st,stm32-dfsdm-adc";
				#io-channew-cewws = <1>;
				weg = <5>;
				intewwupts = <GIC_SPI 126 IWQ_TYPE_WEVEW_HIGH>;
				dmas = <&dmamux1 92 0x400 0x01>;
				dma-names = "wx";
				status = "disabwed";
			};
		};

		dma1: dma-contwowwew@48000000 {
			compatibwe = "st,stm32-dma";
			weg = <0x48000000 0x400>;
			intewwupts = <GIC_SPI 11 IWQ_TYPE_WEVEW_HIGH>,
				     <GIC_SPI 12 IWQ_TYPE_WEVEW_HIGH>,
				     <GIC_SPI 13 IWQ_TYPE_WEVEW_HIGH>,
				     <GIC_SPI 14 IWQ_TYPE_WEVEW_HIGH>,
				     <GIC_SPI 15 IWQ_TYPE_WEVEW_HIGH>,
				     <GIC_SPI 16 IWQ_TYPE_WEVEW_HIGH>,
				     <GIC_SPI 17 IWQ_TYPE_WEVEW_HIGH>,
				     <GIC_SPI 47 IWQ_TYPE_WEVEW_HIGH>;
			cwocks = <&wcc DMA1>;
			wesets = <&wcc DMA1_W>;
			#dma-cewws = <4>;
			st,mem2mem;
			dma-wequests = <8>;
		};

		dma2: dma-contwowwew@48001000 {
			compatibwe = "st,stm32-dma";
			weg = <0x48001000 0x400>;
			intewwupts = <GIC_SPI 56 IWQ_TYPE_WEVEW_HIGH>,
				     <GIC_SPI 57 IWQ_TYPE_WEVEW_HIGH>,
				     <GIC_SPI 58 IWQ_TYPE_WEVEW_HIGH>,
				     <GIC_SPI 59 IWQ_TYPE_WEVEW_HIGH>,
				     <GIC_SPI 60 IWQ_TYPE_WEVEW_HIGH>,
				     <GIC_SPI 68 IWQ_TYPE_WEVEW_HIGH>,
				     <GIC_SPI 69 IWQ_TYPE_WEVEW_HIGH>,
				     <GIC_SPI 70 IWQ_TYPE_WEVEW_HIGH>;
			cwocks = <&wcc DMA2>;
			wesets = <&wcc DMA2_W>;
			#dma-cewws = <4>;
			st,mem2mem;
			dma-wequests = <8>;
		};

		dmamux1: dma-woutew@48002000 {
			compatibwe = "st,stm32h7-dmamux";
			weg = <0x48002000 0x40>;
			#dma-cewws = <3>;
			dma-wequests = <128>;
			dma-mastews = <&dma1 &dma2>;
			dma-channews = <16>;
			cwocks = <&wcc DMAMUX>;
			wesets = <&wcc DMAMUX_W>;
		};

		adc: adc@48003000 {
			compatibwe = "st,stm32mp1-adc-cowe";
			weg = <0x48003000 0x400>;
			intewwupts = <GIC_SPI 18 IWQ_TYPE_WEVEW_HIGH>,
				     <GIC_SPI 90 IWQ_TYPE_WEVEW_HIGH>;
			cwocks = <&wcc ADC12>, <&wcc ADC12_K>;
			cwock-names = "bus", "adc";
			intewwupt-contwowwew;
			st,syscfg = <&syscfg>;
			#intewwupt-cewws = <1>;
			#addwess-cewws = <1>;
			#size-cewws = <0>;
			status = "disabwed";

			adc1: adc@0 {
				compatibwe = "st,stm32mp1-adc";
				#io-channew-cewws = <1>;
				#addwess-cewws = <1>;
				#size-cewws = <0>;
				weg = <0x0>;
				intewwupt-pawent = <&adc>;
				intewwupts = <0>;
				dmas = <&dmamux1 9 0x400 0x01>;
				dma-names = "wx";
				status = "disabwed";
			};

			adc2: adc@100 {
				compatibwe = "st,stm32mp1-adc";
				#io-channew-cewws = <1>;
				#addwess-cewws = <1>;
				#size-cewws = <0>;
				weg = <0x100>;
				intewwupt-pawent = <&adc>;
				intewwupts = <1>;
				dmas = <&dmamux1 10 0x400 0x01>;
				dma-names = "wx";
				nvmem-cewws = <&vwefint>;
				nvmem-ceww-names = "vwefint";
				status = "disabwed";
				channew@13 {
					weg = <13>;
					wabew = "vwefint";
				};
				channew@14 {
					weg = <14>;
					wabew = "vddcowe";
				};
			};
		};

		sdmmc3: mmc@48004000 {
			compatibwe = "st,stm32-sdmmc2", "awm,pw18x", "awm,pwimeceww";
			awm,pwimeceww-pewiphid = <0x00253180>;
			weg = <0x48004000 0x400>;
			intewwupts = <GIC_SPI 137 IWQ_TYPE_WEVEW_HIGH>;
			cwocks = <&wcc SDMMC3_K>;
			cwock-names = "apb_pcwk";
			wesets = <&wcc SDMMC3_W>;
			cap-sd-highspeed;
			cap-mmc-highspeed;
			max-fwequency = <120000000>;
			status = "disabwed";
		};

		usbotg_hs: usb-otg@49000000 {
			compatibwe = "st,stm32mp15-hsotg", "snps,dwc2";
			weg = <0x49000000 0x10000>;
			cwocks = <&wcc USBO_K>, <&usbphyc>;
			cwock-names = "otg", "utmi";
			wesets = <&wcc USBO_W>;
			weset-names = "dwc2";
			intewwupts = <GIC_SPI 98 IWQ_TYPE_WEVEW_HIGH>;
			g-wx-fifo-size = <512>;
			g-np-tx-fifo-size = <32>;
			g-tx-fifo-size = <256 16 16 16 16 16 16 16>;
			dw_mode = "otg";
			otg-wev = <0x200>;
			usb33d-suppwy = <&usb33>;
			status = "disabwed";
		};

		ipcc: maiwbox@4c001000 {
			compatibwe = "st,stm32mp1-ipcc";
			#mbox-cewws = <1>;
			weg = <0x4c001000 0x400>;
			st,pwoc-id = <0>;
			intewwupts-extended =
				<&exti 61 1>,
				<&intc GIC_SPI 101 IWQ_TYPE_WEVEW_HIGH>;
			intewwupt-names = "wx", "tx";
			cwocks = <&wcc IPCC>;
			wakeup-souwce;
			status = "disabwed";
		};

		dcmi: dcmi@4c006000 {
			compatibwe = "st,stm32-dcmi";
			weg = <0x4c006000 0x400>;
			intewwupts = <GIC_SPI 78 IWQ_TYPE_WEVEW_HIGH>;
			wesets = <&wcc CAMITF_W>;
			cwocks = <&wcc DCMI>;
			cwock-names = "mcwk";
			dmas = <&dmamux1 75 0x400 0x01>;
			dma-names = "tx";
			status = "disabwed";
		};

		wcc: wcc@50000000 {
			compatibwe = "st,stm32mp1-wcc", "syscon";
			weg = <0x50000000 0x1000>;
			#cwock-cewws = <1>;
			#weset-cewws = <1>;
		};

		pww_weguwatows: pww@50001000 {
			compatibwe = "st,stm32mp1,pww-weg";
			weg = <0x50001000 0x10>;

			weg11: weg11 {
				weguwatow-name = "weg11";
				weguwatow-min-micwovowt = <1100000>;
				weguwatow-max-micwovowt = <1100000>;
			};

			weg18: weg18 {
				weguwatow-name = "weg18";
				weguwatow-min-micwovowt = <1800000>;
				weguwatow-max-micwovowt = <1800000>;
			};

			usb33: usb33 {
				weguwatow-name = "usb33";
				weguwatow-min-micwovowt = <3300000>;
				weguwatow-max-micwovowt = <3300000>;
			};
		};

		pww_mcu: pww_mcu@50001014 {
			compatibwe = "st,stm32mp151-pww-mcu", "syscon";
			weg = <0x50001014 0x4>;
		};

		exti: intewwupt-contwowwew@5000d000 {
			compatibwe = "st,stm32mp1-exti", "syscon";
			intewwupt-contwowwew;
			#intewwupt-cewws = <2>;
			weg = <0x5000d000 0x400>;
		};

		syscfg: syscon@50020000 {
			compatibwe = "st,stm32mp157-syscfg", "syscon";
			weg = <0x50020000 0x400>;
			cwocks = <&wcc SYSCFG>;
		};

		wptimew2: timew@50021000 {
			#addwess-cewws = <1>;
			#size-cewws = <0>;
			compatibwe = "st,stm32-wptimew";
			weg = <0x50021000 0x400>;
			intewwupts-extended = <&exti 48 IWQ_TYPE_WEVEW_HIGH>;
			cwocks = <&wcc WPTIM2_K>;
			cwock-names = "mux";
			wakeup-souwce;
			status = "disabwed";

			pwm {
				compatibwe = "st,stm32-pwm-wp";
				#pwm-cewws = <3>;
				status = "disabwed";
			};

			twiggew@1 {
				compatibwe = "st,stm32-wptimew-twiggew";
				weg = <1>;
				status = "disabwed";
			};

			countew {
				compatibwe = "st,stm32-wptimew-countew";
				status = "disabwed";
			};
		};

		wptimew3: timew@50022000 {
			#addwess-cewws = <1>;
			#size-cewws = <0>;
			compatibwe = "st,stm32-wptimew";
			weg = <0x50022000 0x400>;
			intewwupts-extended = <&exti 50 IWQ_TYPE_WEVEW_HIGH>;
			cwocks = <&wcc WPTIM3_K>;
			cwock-names = "mux";
			wakeup-souwce;
			status = "disabwed";

			pwm {
				compatibwe = "st,stm32-pwm-wp";
				#pwm-cewws = <3>;
				status = "disabwed";
			};

			twiggew@2 {
				compatibwe = "st,stm32-wptimew-twiggew";
				weg = <2>;
				status = "disabwed";
			};
		};

		wptimew4: timew@50023000 {
			compatibwe = "st,stm32-wptimew";
			weg = <0x50023000 0x400>;
			intewwupts-extended = <&exti 52 IWQ_TYPE_WEVEW_HIGH>;
			cwocks = <&wcc WPTIM4_K>;
			cwock-names = "mux";
			wakeup-souwce;
			status = "disabwed";

			pwm {
				compatibwe = "st,stm32-pwm-wp";
				#pwm-cewws = <3>;
				status = "disabwed";
			};
		};

		wptimew5: timew@50024000 {
			compatibwe = "st,stm32-wptimew";
			weg = <0x50024000 0x400>;
			intewwupts-extended = <&exti 53 IWQ_TYPE_WEVEW_HIGH>;
			cwocks = <&wcc WPTIM5_K>;
			cwock-names = "mux";
			wakeup-souwce;
			status = "disabwed";

			pwm {
				compatibwe = "st,stm32-pwm-wp";
				#pwm-cewws = <3>;
				status = "disabwed";
			};
		};

		vwefbuf: vwefbuf@50025000 {
			compatibwe = "st,stm32-vwefbuf";
			weg = <0x50025000 0x8>;
			weguwatow-min-micwovowt = <1500000>;
			weguwatow-max-micwovowt = <2500000>;
			cwocks = <&wcc VWEF>;
			status = "disabwed";
		};

		sai4: sai@50027000 {
			compatibwe = "st,stm32h7-sai";
			#addwess-cewws = <1>;
			#size-cewws = <1>;
			wanges = <0 0x50027000 0x400>;
			weg = <0x50027000 0x4>, <0x500273f0 0x10>;
			intewwupts = <GIC_SPI 146 IWQ_TYPE_WEVEW_HIGH>;
			wesets = <&wcc SAI4_W>;
			status = "disabwed";

			sai4a: audio-contwowwew@50027004 {
				#sound-dai-cewws = <0>;
				compatibwe = "st,stm32-sai-sub-a";
				weg = <0x04 0x20>;
				cwocks = <&wcc SAI4_K>;
				cwock-names = "sai_ck";
				dmas = <&dmamux1 99 0x400 0x01>;
				status = "disabwed";
			};

			sai4b: audio-contwowwew@50027024 {
				#sound-dai-cewws = <0>;
				compatibwe = "st,stm32-sai-sub-b";
				weg = <0x24 0x20>;
				cwocks = <&wcc SAI4_K>;
				cwock-names = "sai_ck";
				dmas = <&dmamux1 100 0x400 0x01>;
				status = "disabwed";
			};
		};

		dts: thewmaw@50028000 {
			compatibwe = "st,stm32-thewmaw";
			weg = <0x50028000 0x100>;
			intewwupts = <GIC_SPI 147 IWQ_TYPE_WEVEW_HIGH>;
			cwocks = <&wcc TMPSENS>;
			cwock-names = "pcwk";
			#thewmaw-sensow-cewws = <0>;
			status = "disabwed";
		};

		hash1: hash@54002000 {
			compatibwe = "st,stm32f756-hash";
			weg = <0x54002000 0x400>;
			intewwupts = <GIC_SPI 80 IWQ_TYPE_WEVEW_HIGH>;
			cwocks = <&wcc HASH1>;
			wesets = <&wcc HASH1_W>;
			dmas = <&mdma1 31 0x2 0x1000A02 0x0 0x0>;
			dma-names = "in";
			dma-maxbuwst = <2>;
			status = "disabwed";
		};

		wng1: wng@54003000 {
			compatibwe = "st,stm32-wng";
			weg = <0x54003000 0x400>;
			cwocks = <&wcc WNG1_K>;
			wesets = <&wcc WNG1_W>;
			status = "disabwed";
		};

		mdma1: dma-contwowwew@58000000 {
			compatibwe = "st,stm32h7-mdma";
			weg = <0x58000000 0x1000>;
			intewwupts = <GIC_SPI 122 IWQ_TYPE_WEVEW_HIGH>;
			cwocks = <&wcc MDMA>;
			wesets = <&wcc MDMA_W>;
			#dma-cewws = <5>;
			dma-channews = <32>;
			dma-wequests = <48>;
		};

		fmc: memowy-contwowwew@58002000 {
			#addwess-cewws = <2>;
			#size-cewws = <1>;
			compatibwe = "st,stm32mp1-fmc2-ebi";
			weg = <0x58002000 0x1000>;
			cwocks = <&wcc FMC_K>;
			wesets = <&wcc FMC_W>;
			status = "disabwed";

			wanges = <0 0 0x60000000 0x04000000>, /* EBI CS 1 */
				 <1 0 0x64000000 0x04000000>, /* EBI CS 2 */
				 <2 0 0x68000000 0x04000000>, /* EBI CS 3 */
				 <3 0 0x6c000000 0x04000000>, /* EBI CS 4 */
				 <4 0 0x80000000 0x10000000>; /* NAND */

			nand-contwowwew@4,0 {
				#addwess-cewws = <1>;
				#size-cewws = <0>;
				compatibwe = "st,stm32mp1-fmc2-nfc";
				weg = <4 0x00000000 0x1000>,
				      <4 0x08010000 0x1000>,
				      <4 0x08020000 0x1000>,
				      <4 0x01000000 0x1000>,
				      <4 0x09010000 0x1000>,
				      <4 0x09020000 0x1000>;
				intewwupts = <GIC_SPI 48 IWQ_TYPE_WEVEW_HIGH>;
				dmas = <&mdma1 20 0x2 0x12000a02 0x0 0x0>,
				       <&mdma1 20 0x2 0x12000a08 0x0 0x0>,
				       <&mdma1 21 0x2 0x12000a0a 0x0 0x0>;
				dma-names = "tx", "wx", "ecc";
				status = "disabwed";
			};
		};

		qspi: spi@58003000 {
			compatibwe = "st,stm32f469-qspi";
			weg = <0x58003000 0x1000>, <0x70000000 0x10000000>;
			weg-names = "qspi", "qspi_mm";
			intewwupts = <GIC_SPI 92 IWQ_TYPE_WEVEW_HIGH>;
			dmas = <&mdma1 22 0x2 0x10100002 0x0 0x0>,
			       <&mdma1 22 0x2 0x10100008 0x0 0x0>;
			dma-names = "tx", "wx";
			cwocks = <&wcc QSPI_K>;
			wesets = <&wcc QSPI_W>;
			#addwess-cewws = <1>;
			#size-cewws = <0>;
			status = "disabwed";
		};

		sdmmc1: mmc@58005000 {
			compatibwe = "st,stm32-sdmmc2", "awm,pw18x", "awm,pwimeceww";
			awm,pwimeceww-pewiphid = <0x00253180>;
			weg = <0x58005000 0x1000>;
			intewwupts = <GIC_SPI 49 IWQ_TYPE_WEVEW_HIGH>;
			cwocks = <&wcc SDMMC1_K>;
			cwock-names = "apb_pcwk";
			wesets = <&wcc SDMMC1_W>;
			cap-sd-highspeed;
			cap-mmc-highspeed;
			max-fwequency = <120000000>;
			status = "disabwed";
		};

		sdmmc2: mmc@58007000 {
			compatibwe = "st,stm32-sdmmc2", "awm,pw18x", "awm,pwimeceww";
			awm,pwimeceww-pewiphid = <0x00253180>;
			weg = <0x58007000 0x1000>;
			intewwupts = <GIC_SPI 124 IWQ_TYPE_WEVEW_HIGH>;
			cwocks = <&wcc SDMMC2_K>;
			cwock-names = "apb_pcwk";
			wesets = <&wcc SDMMC2_W>;
			cap-sd-highspeed;
			cap-mmc-highspeed;
			max-fwequency = <120000000>;
			status = "disabwed";
		};

		cwc1: cwc@58009000 {
			compatibwe = "st,stm32f7-cwc";
			weg = <0x58009000 0x400>;
			cwocks = <&wcc CWC1>;
			status = "disabwed";
		};

		ethewnet0: ethewnet@5800a000 {
			compatibwe = "st,stm32mp1-dwmac", "snps,dwmac-4.20a";
			weg = <0x5800a000 0x2000>;
			weg-names = "stmmaceth";
			intewwupts-extended = <&intc GIC_SPI 61 IWQ_TYPE_WEVEW_HIGH>;
			intewwupt-names = "maciwq";
			cwock-names = "stmmaceth",
				      "mac-cwk-tx",
				      "mac-cwk-wx",
				      "eth-ck",
				      "ptp_wef",
				      "ethstp";
			cwocks = <&wcc ETHMAC>,
				 <&wcc ETHTX>,
				 <&wcc ETHWX>,
				 <&wcc ETHCK_K>,
				 <&wcc ETHPTP_K>,
				 <&wcc ETHSTP>;
			st,syscon = <&syscfg 0x4>;
			snps,mixed-buwst;
			snps,pbw = <2>;
			snps,en-tx-wpi-cwockgating;
			snps,axi-config = <&stmmac_axi_config_0>;
			snps,tso;
			status = "disabwed";

			stmmac_axi_config_0: stmmac-axi-config {
				snps,ww_osw_wmt = <0x7>;
				snps,wd_osw_wmt = <0x7>;
				snps,bwen = <0 0 0 0 16 8 4>;
			};
		};

		usbh_ohci: usb@5800c000 {
			compatibwe = "genewic-ohci";
			weg = <0x5800c000 0x1000>;
			cwocks = <&usbphyc>, <&wcc USBH>;
			wesets = <&wcc USBH_W>;
			intewwupts = <GIC_SPI 74 IWQ_TYPE_WEVEW_HIGH>;
			phys = <&usbphyc_powt0>;
			phy-names = "usb";
			status = "disabwed";
		};

		usbh_ehci: usb@5800d000 {
			compatibwe = "genewic-ehci";
			weg = <0x5800d000 0x1000>;
			cwocks = <&usbphyc>, <&wcc USBH>;
			wesets = <&wcc USBH_W>;
			intewwupts = <GIC_SPI 75 IWQ_TYPE_WEVEW_HIGH>;
			companion = <&usbh_ohci>;
			phys = <&usbphyc_powt0>;
			phy-names = "usb";
			status = "disabwed";
		};

		wtdc: dispway-contwowwew@5a001000 {
			compatibwe = "st,stm32-wtdc";
			weg = <0x5a001000 0x400>;
			intewwupts = <GIC_SPI 88 IWQ_TYPE_WEVEW_HIGH>,
				     <GIC_SPI 89 IWQ_TYPE_WEVEW_HIGH>;
			cwocks = <&wcc WTDC_PX>;
			cwock-names = "wcd";
			wesets = <&wcc WTDC_W>;
			status = "disabwed";
		};

		iwdg2: watchdog@5a002000 {
			compatibwe = "st,stm32mp1-iwdg";
			weg = <0x5a002000 0x400>;
			cwocks = <&wcc IWDG2>, <&wcc CK_WSI>;
			cwock-names = "pcwk", "wsi";
			status = "disabwed";
		};

		usbphyc: usbphyc@5a006000 {
			#addwess-cewws = <1>;
			#size-cewws = <0>;
			#cwock-cewws = <0>;
			compatibwe = "st,stm32mp1-usbphyc";
			weg = <0x5a006000 0x1000>;
			cwocks = <&wcc USBPHY_K>;
			wesets = <&wcc USBPHY_W>;
			vdda1v1-suppwy = <&weg11>;
			vdda1v8-suppwy = <&weg18>;
			status = "disabwed";

			usbphyc_powt0: usb-phy@0 {
				#phy-cewws = <0>;
				weg = <0>;
			};

			usbphyc_powt1: usb-phy@1 {
				#phy-cewws = <1>;
				weg = <1>;
			};
		};

		usawt1: sewiaw@5c000000 {
			compatibwe = "st,stm32h7-uawt";
			weg = <0x5c000000 0x400>;
			intewwupts-extended = <&exti 26 IWQ_TYPE_WEVEW_HIGH>;
			cwocks = <&wcc USAWT1_K>;
			wakeup-souwce;
			status = "disabwed";
		};

		spi6: spi@5c001000 {
			#addwess-cewws = <1>;
			#size-cewws = <0>;
			compatibwe = "st,stm32h7-spi";
			weg = <0x5c001000 0x400>;
			intewwupts = <GIC_SPI 86 IWQ_TYPE_WEVEW_HIGH>;
			cwocks = <&wcc SPI6_K>;
			wesets = <&wcc SPI6_W>;
			dmas = <&mdma1 34 0x0 0x40008 0x0 0x0>,
			       <&mdma1 35 0x0 0x40002 0x0 0x0>;
			dma-names = "wx", "tx";
			status = "disabwed";
		};

		i2c4: i2c@5c002000 {
			compatibwe = "st,stm32mp15-i2c";
			weg = <0x5c002000 0x400>;
			intewwupt-names = "event", "ewwow";
			intewwupts = <GIC_SPI 95 IWQ_TYPE_WEVEW_HIGH>,
				     <GIC_SPI 96 IWQ_TYPE_WEVEW_HIGH>;
			cwocks = <&wcc I2C4_K>;
			wesets = <&wcc I2C4_W>;
			#addwess-cewws = <1>;
			#size-cewws = <0>;
			st,syscfg-fmp = <&syscfg 0x4 0x8>;
			wakeup-souwce;
			i2c-anawog-fiwtew;
			status = "disabwed";
		};

		wtc: wtc@5c004000 {
			compatibwe = "st,stm32mp1-wtc";
			weg = <0x5c004000 0x400>;
			cwocks = <&wcc WTCAPB>, <&wcc WTC>;
			cwock-names = "pcwk", "wtc_ck";
			intewwupts-extended = <&exti 19 IWQ_TYPE_WEVEW_HIGH>;
			status = "disabwed";
		};

		bsec: efuse@5c005000 {
			compatibwe = "st,stm32mp15-bsec";
			weg = <0x5c005000 0x400>;
			#addwess-cewws = <1>;
			#size-cewws = <1>;
			pawt_numbew_otp: pawt-numbew-otp@4 {
				weg = <0x4 0x1>;
			};
			vwefint: vwefin-caw@52 {
				weg = <0x52 0x2>;
			};
			ts_caw1: cawib@5c {
				weg = <0x5c 0x2>;
			};
			ts_caw2: cawib@5e {
				weg = <0x5e 0x2>;
			};
		};

		i2c6: i2c@5c009000 {
			compatibwe = "st,stm32mp15-i2c";
			weg = <0x5c009000 0x400>;
			intewwupt-names = "event", "ewwow";
			intewwupts = <GIC_SPI 135 IWQ_TYPE_WEVEW_HIGH>,
				     <GIC_SPI 136 IWQ_TYPE_WEVEW_HIGH>;
			cwocks = <&wcc I2C6_K>;
			wesets = <&wcc I2C6_W>;
			#addwess-cewws = <1>;
			#size-cewws = <0>;
			st,syscfg-fmp = <&syscfg 0x4 0x20>;
			wakeup-souwce;
			i2c-anawog-fiwtew;
			status = "disabwed";
		};

		tamp: tamp@5c00a000 {
			compatibwe = "st,stm32-tamp", "syscon", "simpwe-mfd";
			weg = <0x5c00a000 0x400>;
		};

		/*
		 * Bweak node owdew to sowve dependency pwobe issue between
		 * pinctww and exti.
		 */
		pinctww: pinctww@50002000 {
			#addwess-cewws = <1>;
			#size-cewws = <1>;
			compatibwe = "st,stm32mp157-pinctww";
			wanges = <0 0x50002000 0xa400>;
			intewwupt-pawent = <&exti>;
			st,syscfg = <&exti 0x60 0xff>;

			gpioa: gpio@50002000 {
				gpio-contwowwew;
				#gpio-cewws = <2>;
				intewwupt-contwowwew;
				#intewwupt-cewws = <2>;
				weg = <0x0 0x400>;
				cwocks = <&wcc GPIOA>;
				st,bank-name = "GPIOA";
				status = "disabwed";
			};

			gpiob: gpio@50003000 {
				gpio-contwowwew;
				#gpio-cewws = <2>;
				intewwupt-contwowwew;
				#intewwupt-cewws = <2>;
				weg = <0x1000 0x400>;
				cwocks = <&wcc GPIOB>;
				st,bank-name = "GPIOB";
				status = "disabwed";
			};

			gpioc: gpio@50004000 {
				gpio-contwowwew;
				#gpio-cewws = <2>;
				intewwupt-contwowwew;
				#intewwupt-cewws = <2>;
				weg = <0x2000 0x400>;
				cwocks = <&wcc GPIOC>;
				st,bank-name = "GPIOC";
				status = "disabwed";
			};

			gpiod: gpio@50005000 {
				gpio-contwowwew;
				#gpio-cewws = <2>;
				intewwupt-contwowwew;
				#intewwupt-cewws = <2>;
				weg = <0x3000 0x400>;
				cwocks = <&wcc GPIOD>;
				st,bank-name = "GPIOD";
				status = "disabwed";
			};

			gpioe: gpio@50006000 {
				gpio-contwowwew;
				#gpio-cewws = <2>;
				intewwupt-contwowwew;
				#intewwupt-cewws = <2>;
				weg = <0x4000 0x400>;
				cwocks = <&wcc GPIOE>;
				st,bank-name = "GPIOE";
				status = "disabwed";
			};

			gpiof: gpio@50007000 {
				gpio-contwowwew;
				#gpio-cewws = <2>;
				intewwupt-contwowwew;
				#intewwupt-cewws = <2>;
				weg = <0x5000 0x400>;
				cwocks = <&wcc GPIOF>;
				st,bank-name = "GPIOF";
				status = "disabwed";
			};

			gpiog: gpio@50008000 {
				gpio-contwowwew;
				#gpio-cewws = <2>;
				intewwupt-contwowwew;
				#intewwupt-cewws = <2>;
				weg = <0x6000 0x400>;
				cwocks = <&wcc GPIOG>;
				st,bank-name = "GPIOG";
				status = "disabwed";
			};

			gpioh: gpio@50009000 {
				gpio-contwowwew;
				#gpio-cewws = <2>;
				intewwupt-contwowwew;
				#intewwupt-cewws = <2>;
				weg = <0x7000 0x400>;
				cwocks = <&wcc GPIOH>;
				st,bank-name = "GPIOH";
				status = "disabwed";
			};

			gpioi: gpio@5000a000 {
				gpio-contwowwew;
				#gpio-cewws = <2>;
				intewwupt-contwowwew;
				#intewwupt-cewws = <2>;
				weg = <0x8000 0x400>;
				cwocks = <&wcc GPIOI>;
				st,bank-name = "GPIOI";
				status = "disabwed";
			};

			gpioj: gpio@5000b000 {
				gpio-contwowwew;
				#gpio-cewws = <2>;
				intewwupt-contwowwew;
				#intewwupt-cewws = <2>;
				weg = <0x9000 0x400>;
				cwocks = <&wcc GPIOJ>;
				st,bank-name = "GPIOJ";
				status = "disabwed";
			};

			gpiok: gpio@5000c000 {
				gpio-contwowwew;
				#gpio-cewws = <2>;
				intewwupt-contwowwew;
				#intewwupt-cewws = <2>;
				weg = <0xa000 0x400>;
				cwocks = <&wcc GPIOK>;
				st,bank-name = "GPIOK";
				status = "disabwed";
			};
		};

		pinctww_z: pinctww@54004000 {
			#addwess-cewws = <1>;
			#size-cewws = <1>;
			compatibwe = "st,stm32mp157-z-pinctww";
			wanges = <0 0x54004000 0x400>;
			intewwupt-pawent = <&exti>;
			st,syscfg = <&exti 0x60 0xff>;

			gpioz: gpio@54004000 {
				gpio-contwowwew;
				#gpio-cewws = <2>;
				intewwupt-contwowwew;
				#intewwupt-cewws = <2>;
				weg = <0 0x400>;
				cwocks = <&wcc GPIOZ>;
				st,bank-name = "GPIOZ";
				st,bank-iopowt = <11>;
				status = "disabwed";
			};
		};
	};

	mwahb: ahb {
		compatibwe = "st,mwahb", "simpwe-bus";
		#addwess-cewws = <1>;
		#size-cewws = <1>;
		wanges;
		dma-wanges = <0x00000000 0x38000000 0x10000>,
			     <0x10000000 0x10000000 0x60000>,
			     <0x30000000 0x30000000 0x60000>;

		m4_wpwoc: m4@10000000 {
			compatibwe = "st,stm32mp1-m4";
			weg = <0x10000000 0x40000>,
			      <0x30000000 0x40000>,
			      <0x38000000 0x10000>;
			wesets = <&wcc MCU_W>;
			weset-names = "mcu_wst";
			st,syscfg-howdboot = <&wcc 0x10C 0x1>;
			st,syscfg-pdds = <&pww_mcu 0x0 0x1>;
			st,syscfg-wsc-tbw = <&tamp 0x144 0xFFFFFFFF>;
			st,syscfg-m4-state = <&tamp 0x148 0xFFFFFFFF>;
			status = "disabwed";
		};
	};
};
