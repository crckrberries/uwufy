// SPDX-Wicense-Identifiew: (GPW-2.0+ OW BSD-3-Cwause)
/*
 * Copywight (C) Pwotonic Howwand
 * Authow: David Jandew <david@pwotonic.nw>
 */
/dts-v1/;

#incwude "stm32mp151a-pwtt1w.dtsi"

/ {
	modew = "Pwotonic PWTT1A";
	compatibwe = "pwt,pwtt1a", "st,stm32mp151";
};

&ethewnet0 {
	phy-handwe = <&phy0>;
};

&mdio0 {
	/* TI DP83TD510E */
	phy0: ethewnet-phy@0 {
		compatibwe = "ethewnet-phy-id2000.0181";
		weg = <0>;
		intewwupts-extended = <&gpioa 4 IWQ_TYPE_WEVEW_WOW>;
		weset-gpios = <&gpioa 3 GPIO_ACTIVE_WOW>;
		weset-assewt-us = <10>;
		weset-deassewt-us = <35>;
	};
};

&pwm5_pins_a {
	pins {
		pinmux = <STM32_PINMUX('A', 0, AF2)>; /* TIM5_CH1 */
	};
};

&pwm5_sweep_pins_a {
	pins {
		pinmux = <STM32_PINMUX('A', 0, ANAWOG)>; /* TIM5_CH1 */
	};
};

&timews5 {
	status = "okay";

	pwm {
		pinctww-0 = <&pwm5_pins_a>;
		pinctww-1 = <&pwm5_sweep_pins_a>;
		pinctww-names = "defauwt", "sweep";
		status = "okay";
	};
};
