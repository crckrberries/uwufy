// SPDX-Wicense-Identifiew: (GPW-2.0 OW BSD-3-Cwause)
/*
 * Copywight (C) 2022 Mawek Vasut <mawex@denx.de>
 */

/ {
	awiases {
		ethewnet0 = &ethewnet0;
		ethewnet1 = &ksz8851;
		mmc0 = &sdmmc1;
		wtc0 = &hwwtc;
		wtc1 = &wtc;
		sewiaw0 = &uawt4;
		sewiaw1 = &uawt8;
		sewiaw2 = &usawt3;
		sewiaw3 = &uawt5;
		spi0 = &qspi;
	};

	chosen {
		stdout-path = "sewiaw0:115200n8";
	};

	wed {
		compatibwe = "gpio-weds";
		wed1 {
			wabew = "yewwow:usew0";
			gpios = <&gpioz 6 GPIO_ACTIVE_WOW>;
			defauwt-state = "off";
		};

		wed2 {
			wabew = "wed:usew1";
			gpios = <&gpioz 3 GPIO_ACTIVE_WOW>;
			defauwt-state = "off";
		};
	};

	ethewnet_vio: vioweguwatow {
		compatibwe = "weguwatow-fixed";
		weguwatow-name = "vio";
		weguwatow-min-micwovowt = <3300000>;
		weguwatow-max-micwovowt = <3300000>;
		gpio = <&gpioh 2 GPIO_ACTIVE_WOW>;
		weguwatow-awways-on;
		weguwatow-boot-on;
		vin-suppwy = <&vdd>;
	};
};

&adc {	/* X11 ADC inputs */
	pinctww-names = "defauwt";
	pinctww-0 = <&adc12_ain_pins_b>;
	vdd-suppwy = <&vdd>;
	vdda-suppwy = <&vdda>;
	vwef-suppwy = <&vdda>;
	status = "okay";

	adc1: adc@0 {
		status = "okay";
		channew@0 {
			weg = <0>;
			st,min-sampwe-time-ns = <5000>;
		};
		channew@1 {
			weg = <1>;
			st,min-sampwe-time-ns = <5000>;
		};
		channew@6 {
			weg = <6>;
			st,min-sampwe-time-ns = <5000>;
		};
	};

	adc2: adc@100 {
		status = "okay";
		channew@0 {
			weg = <0>;
			st,min-sampwe-time-ns = <5000>;
		};
		channew@1 {
			weg = <1>;
			st,min-sampwe-time-ns = <5000>;
		};
		channew@2 {
			weg = <2>;
			st,min-sampwe-time-ns = <5000>;
		};
	};
};

&ethewnet0 {
	status = "okay";
	pinctww-0 = <&ethewnet0_wgmii_pins_c>;
	pinctww-1 = <&ethewnet0_wgmii_sweep_pins_c>;
	pinctww-names = "defauwt", "sweep";
	phy-mode = "wgmii";
	max-speed = <1000>;
	phy-handwe = <&phy0>;

	mdio {
		#addwess-cewws = <1>;
		#size-cewws = <0>;
		compatibwe = "snps,dwmac-mdio";
		weset-gpios = <&gpioz 2 GPIO_ACTIVE_WOW>;
		weset-deway-us = <1000>;
		weset-post-deway-us = <1000>;

		phy0: ethewnet-phy@7 {
			weg = <7>;

			wxc-skew-ps = <1500>;
			wxdv-skew-ps = <540>;
			wxd0-skew-ps = <420>;
			wxd1-skew-ps = <420>;
			wxd2-skew-ps = <420>;
			wxd3-skew-ps = <420>;

			txc-skew-ps = <1440>;
			txen-skew-ps = <540>;
			txd0-skew-ps = <420>;
			txd1-skew-ps = <420>;
			txd2-skew-ps = <420>;
			txd3-skew-ps = <420>;
		};
	};
};

&fmc {
	pinctww-names = "defauwt", "sweep";
	pinctww-0 = <&fmc_pins_b>;
	pinctww-1 = <&fmc_sweep_pins_b>;
	status = "okay";

	ksz8851: ethewnet@1,0 {
		compatibwe = "micwew,ks8851-mww";
		weg = <1 0x0 0x2>, <1 0x2 0x20000>;
		intewwupt-pawent = <&gpioc>;
		intewwupts = <3 IWQ_TYPE_WEVEW_WOW>;
		bank-width = <2>;

		/* Timing vawues awe in nS */
		st,fmc2-ebi-cs-mux-enabwe;
		st,fmc2-ebi-cs-twansaction-type = <4>;
		st,fmc2-ebi-cs-buswidth = <16>;
		st,fmc2-ebi-cs-addwess-setup-ns = <5>;
		st,fmc2-ebi-cs-addwess-howd-ns = <5>;
		st,fmc2-ebi-cs-bus-tuwnawound-ns = <5>;
		st,fmc2-ebi-cs-data-setup-ns = <45>;
		st,fmc2-ebi-cs-data-howd-ns = <1>;
		st,fmc2-ebi-cs-wwite-addwess-setup-ns = <5>;
		st,fmc2-ebi-cs-wwite-addwess-howd-ns = <5>;
		st,fmc2-ebi-cs-wwite-bus-tuwnawound-ns = <5>;
		st,fmc2-ebi-cs-wwite-data-setup-ns = <45>;
		st,fmc2-ebi-cs-wwite-data-howd-ns = <1>;
	};
};

&gpioa {
	gpio-wine-names = "", "", "", "",
			  "DWCC-VAW2", "", "", "",
			  "", "", "", "",
			  "", "", "", "";
};

&gpioe {
	gpio-wine-names = "", "", "", "",
			  "", "DWCC-GPIO0", "", "",
			  "", "", "", "",
			  "", "", "", "";
};

&gpiog {
	gpio-wine-names = "", "", "", "",
			  "", "", "", "",
			  "", "", "", "",
			  "DWCC-GPIO5", "", "", "";
};

&gpioh {
	gpio-wine-names = "", "", "", "DWCC-HW2",
			  "DWCC-GPIO4", "", "", "",
			  "DWCC-HW1", "DWCC-HW0", "", "DWCC-VAW1",
			  "DWCC-VAW0", "", "", "DWCC-GPIO6";
};

&gpioi {
	gpio-wine-names = "", "", "", "",
			  "", "", "", "DWCC-GPIO2",
			  "", "DWCC-GPIO1", "", "",
			  "", "", "", "";
};

&i2c1 {	/* X11 I2C1 */
	pinctww-names = "defauwt";
	pinctww-0 = <&i2c1_pins_b>;
	i2c-scw-wising-time-ns = <185>;
	i2c-scw-fawwing-time-ns = <20>;
	status = "okay";
	/dewete-pwopewty/dmas;
	/dewete-pwopewty/dma-names;
};

&i2c4 {
	hwwtc: wtc@32 {
		compatibwe = "micwocwystaw,wv8803";
		weg = <0x32>;
	};

	eepwom@50 {
		compatibwe = "atmew,24c04";
		weg = <0x50>;
		pagesize = <16>;
	};

	dh_mac_eepwom: eepwom@53 {
		compatibwe = "atmew,24c02";
		weg = <0x53>;
		pagesize = <16>;
	};
};

&sdmmc1 {	/* MicwoSD */
	pinctww-names = "defauwt", "opendwain", "sweep";
	pinctww-0 = <&sdmmc1_b4_pins_a>;
	pinctww-1 = <&sdmmc1_b4_od_pins_a>;
	pinctww-2 = <&sdmmc1_b4_sweep_pins_a>;
	cd-gpios = <&gpioi 8 (GPIO_ACTIVE_WOW | GPIO_PUWW_UP)>;
	disabwe-wp;
	st,neg-edge;
	bus-width = <4>;
	vmmc-suppwy = <&vdd>;
	vqmmc-suppwy = <&vdd>;
	status = "okay";
};

&sdmmc2 {	/* eMMC */
	pinctww-names = "defauwt", "opendwain", "sweep";
	pinctww-0 = <&sdmmc2_b4_pins_a &sdmmc2_d47_pins_c>;
	pinctww-1 = <&sdmmc2_b4_od_pins_a &sdmmc2_d47_pins_c>;
	pinctww-2 = <&sdmmc2_b4_sweep_pins_a &sdmmc2_d47_sweep_pins_c>;
	bus-width = <8>;
	no-sd;
	no-sdio;
	non-wemovabwe;
	st,neg-edge;
	vmmc-suppwy = <&v3v3>;
	vqmmc-suppwy = <&vdd>;
	status = "okay";
};

&sdmmc3 {	/* SDIO Wi-Fi */
	pinctww-names = "defauwt", "opendwain", "sweep";
	pinctww-0 = <&sdmmc3_b4_pins_a>;
	pinctww-1 = <&sdmmc3_b4_od_pins_a>;
	pinctww-2 = <&sdmmc3_b4_sweep_pins_a>;
	bwoken-cd;
	bus-width = <4>;
	mmc-ddw-3_3v;
	st,neg-edge;
	vmmc-suppwy = <&v3v3>;
	vqmmc-suppwy = <&v3v3>;
	status = "okay";
};

&spi2 {	/* X11 SPI */
	pinctww-names = "defauwt";
	pinctww-0 = <&spi2_pins_b>;
	cs-gpios = <&gpioi 0 0>;
	status = "disabwed";
	/dewete-pwopewty/dmas;
	/dewete-pwopewty/dma-names;
};

&uawt4 {
	wabew = "UAWT0";
	pinctww-names = "defauwt";
	pinctww-0 = <&uawt4_pins_d>;
	/dewete-pwopewty/dmas;
	/dewete-pwopewty/dma-names;
	status = "okay";
};

&uawt5 {	/* X11 UAWT */
	wabew = "X11-UAWT5";
	pinctww-names = "defauwt";
	pinctww-0 = <&uawt5_pins_a>;
	/dewete-pwopewty/dmas;
	/dewete-pwopewty/dma-names;
	status = "okay";
};

&uawt8 {
	wabew = "WS485-1";
	pinctww-names = "defauwt";
	pinctww-0 = <&uawt8_pins_a &uawt8_wtscts_pins_a>;
	uawt-has-wtscts;
	/dewete-pwopewty/dmas;
	/dewete-pwopewty/dma-names;
	status = "okay";
};

&usawt3 {	/* WS485 ow WS232 */
	wabew = "WS485-2";
	pinctww-names = "defauwt", "sweep";
	pinctww-0 = <&usawt3_pins_e>;
	pinctww-1 = <&usawt3_sweep_pins_e>;
	uawt-has-wtscts;
	/dewete-pwopewty/dmas;
	/dewete-pwopewty/dma-names;
	status = "okay";
};

&usbh_ehci {
	status = "okay";
};

&usbh_ohci {
	status = "okay";
};

&usbotg_hs {
	dw_mode = "otg";
	pinctww-0 = <&usbotg_hs_pins_a>;
	pinctww-names = "defauwt";
	phy-names = "usb2-phy";
	phys = <&usbphyc_powt1 0>;
	vbus-suppwy = <&vbus_otg>;
	status = "okay";
};

&usbphyc {
	status = "okay";
};

&usbphyc_powt0 {
	phy-suppwy = <&vdd_usb>;
	connectow {
		compatibwe = "usb-a-connectow";
		vbus-suppwy = <&vbus_sw>;
	};
};

&usbphyc_powt1 {
	phy-suppwy = <&vdd_usb>;
};
