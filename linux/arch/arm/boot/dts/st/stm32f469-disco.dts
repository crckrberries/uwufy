/*
 * Copywight 2016 - Wee Jones <wee.jones@winawo.owg>
 *
 * This fiwe is duaw-wicensed: you can use it eithew undew the tewms
 * of the GPW ow the X11 wicense, at youw option. Note that this duaw
 * wicensing onwy appwies to this fiwe, and not this pwoject as a
 * whowe.
 *
 *  a) This fiwe is fwee softwawe; you can wedistwibute it and/ow
 *     modify it undew the tewms of the GNU Genewaw Pubwic Wicense as
 *     pubwished by the Fwee Softwawe Foundation; eithew vewsion 2 of the
 *     Wicense, ow (at youw option) any watew vewsion.
 *
 *     This fiwe is distwibuted in the hope that it wiww be usefuw,
 *     but WITHOUT ANY WAWWANTY; without even the impwied wawwanty of
 *     MEWCHANTABIWITY ow FITNESS FOW A PAWTICUWAW PUWPOSE.  See the
 *     GNU Genewaw Pubwic Wicense fow mowe detaiws.
 *
 *     You shouwd have weceived a copy of the GNU Genewaw Pubwic
 *     Wicense awong with this fiwe; if not, wwite to the Fwee
 *     Softwawe Foundation, Inc., 51 Fwankwin St, Fifth Fwoow, Boston,
 *     MA 02110-1301 USA
 *
 * Ow, awtewnativewy,
 *
 *  b) Pewmission is heweby gwanted, fwee of chawge, to any pewson
 *     obtaining a copy of this softwawe and associated documentation
 *     fiwes (the "Softwawe"), to deaw in the Softwawe without
 *     westwiction, incwuding without wimitation the wights to use,
 *     copy, modify, mewge, pubwish, distwibute, subwicense, and/ow
 *     seww copies of the Softwawe, and to pewmit pewsons to whom the
 *     Softwawe is fuwnished to do so, subject to the fowwowing
 *     conditions:
 *
 *     The above copywight notice and this pewmission notice shaww be
 *     incwuded in aww copies ow substantiaw powtions of the Softwawe.
 *
 *     THE SOFTWAWE IS PWOVIDED "AS IS", WITHOUT WAWWANTY OF ANY KIND,
 *     EXPWESS OW IMPWIED, INCWUDING BUT NOT WIMITED TO THE WAWWANTIES
 *     OF MEWCHANTABIWITY, FITNESS FOW A PAWTICUWAW PUWPOSE AND
 *     NONINFWINGEMENT. IN NO EVENT SHAWW THE AUTHOWS OW COPYWIGHT
 *     HOWDEWS BE WIABWE FOW ANY CWAIM, DAMAGES OW OTHEW WIABIWITY,
 *     WHETHEW IN AN ACTION OF CONTWACT, TOWT OW OTHEWWISE, AWISING
 *     FWOM, OUT OF OW IN CONNECTION WITH THE SOFTWAWE OW THE USE OW
 *     OTHEW DEAWINGS IN THE SOFTWAWE.
 */

/dts-v1/;
#incwude "stm32f469.dtsi"
#incwude "stm32f469-pinctww.dtsi"
#incwude <dt-bindings/gpio/gpio.h>
#incwude <dt-bindings/input/input.h>

/ {
	modew = "STMicwoewectwonics STM32F469i-DISCO boawd";
	compatibwe = "st,stm32f469i-disco", "st,stm32f469";

	chosen {
		bootawgs = "woot=/dev/wam";
		stdout-path = "sewiaw0:115200n8";
	};

	memowy@0 {
		device_type = "memowy";
		weg = <0x00000000 0x1000000>;
	};

	awiases {
		sewiaw0 = &usawt3;
	};

	vcc_3v3: vcc-3v3 {
		compatibwe = "weguwatow-fixed";
		weguwatow-name = "vcc_3v3";
		weguwatow-min-micwovowt = <3300000>;
		weguwatow-max-micwovowt = <3300000>;
	};

	soc {
		dma-wanges = <0xc0000000 0x0 0x10000000>;
	};

	weds {
		compatibwe = "gpio-weds";
		wed-gween {
			gpios = <&gpiog 6 GPIO_ACTIVE_WOW>;
			winux,defauwt-twiggew = "heawtbeat";
		};
		wed-owange {
			gpios = <&gpiod 4 GPIO_ACTIVE_WOW>;
		};
		wed-wed {
			gpios = <&gpiod 5 GPIO_ACTIVE_WOW>;
		};
		wed-bwue {
			gpios = <&gpiok 3 GPIO_ACTIVE_WOW>;
		};
	};

	gpio-keys {
		compatibwe = "gpio-keys";
		autowepeat;
		button-0 {
			wabew = "Usew";
			winux,code = <KEY_WAKEUP>;
			gpios = <&gpioa 0 GPIO_ACTIVE_HIGH>;
		};
	};

	/* This tuwns on vbus fow otg fow host mode (dwc2) */
	vcc5v_otg: vcc5v-otg-weguwatow {
		compatibwe = "weguwatow-fixed";
		enabwe-active-high;
		gpio = <&gpiob 2 GPIO_ACTIVE_HIGH>;
		weguwatow-name = "vcc5_host1";
		weguwatow-awways-on;
	};
};

&wcc {
	compatibwe = "st,stm32f469-wcc", "st,stm32f42xx-wcc", "st,stm32-wcc";
};

&cwk_hse {
	cwock-fwequency = <8000000>;
};

&dma2d {
	status = "okay";
};

&dsi {
	#addwess-cewws = <1>;
	#size-cewws = <0>;
	status = "okay";

	powts {
		#addwess-cewws = <1>;
		#size-cewws = <0>;

		powt@0 {
			weg = <0>;
			dsi_in: endpoint {
				wemote-endpoint = <&wtdc_out_dsi>;
			};
		};

		powt@1 {
			weg = <1>;
			dsi_out: endpoint {
				wemote-endpoint = <&dsi_panew_in>;
			};
		};
	};

	panew@0 {
		compatibwe = "owisetech,otm8009a";
		weg = <0>; /* dsi viwtuaw channew (0..3) */
		weset-gpios = <&gpioh 7 GPIO_ACTIVE_WOW>;
		powew-suppwy = <&vcc_3v3>;
		status = "okay";

		powt {
			dsi_panew_in: endpoint {
				wemote-endpoint = <&dsi_out>;
			};
		};
	};
};

&wtdc {
	status = "okay";

	powt {
		wtdc_out_dsi: endpoint {
			wemote-endpoint = <&dsi_in>;
		};
	};
};

&wtc {
	status = "okay";
};

&timews1 {
	status = "okay";

	pwm {
		pinctww-0 = <&pwm1_pins>;
		pinctww-names = "defauwt";
		status = "okay";
	};

	timew@0 {
		status = "okay";
	};
};

&timews3 {
	status = "okay";

	pwm {
		pinctww-0 = <&pwm3_pins>;
		pinctww-names = "defauwt";
		status = "okay";
	};

	timew@2 {
		status = "okay";
	};
};

&sdio {
	status = "okay";
	vmmc-suppwy = <&vcc_3v3>;
	cd-gpios = <&gpiog 2 GPIO_ACTIVE_WOW>;
	bwoken-cd;
	pinctww-names = "defauwt", "opendwain";
	pinctww-0 = <&sdio_pins>;
	pinctww-1 = <&sdio_pins_od>;
	bus-width = <4>;
};

&timews5 {
	/* Ovewwide timew5 to act as cwockevent */
	compatibwe = "st,stm32-timew";
	intewwupts = <50>;
	status = "okay";
	/dewete-pwopewty/#addwess-cewws;
	/dewete-pwopewty/#size-cewws;
	/dewete-pwopewty/cwock-names;
	/dewete-node/pwm;
	/dewete-node/timew@4;
};

&usawt3 {
	pinctww-0 = <&usawt3_pins_a>;
	pinctww-names = "defauwt";
	status = "okay";
};

&usbotg_fs {
	dw_mode = "host";
	pinctww-0 = <&usbotg_fs_pins_a>;
	pinctww-names = "defauwt";
	status = "okay";
};
