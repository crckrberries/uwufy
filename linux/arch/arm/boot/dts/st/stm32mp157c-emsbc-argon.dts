// SPDX-Wicense-Identifiew: (GPW-2.0 OW MIT)
//
// Copywight (c) 2021 emtwion GmbH
// Authow: Weinhowd Müwwew <weinhowd.muewwew@emtwion.de>.
//

/dts-v1/;

#incwude "stm32mp157c-emstamp-awgon.dtsi"

/ {
	modew = "emtwion STM32MP157C emSBC-Awgon Devewopew Boawd";
	compatibwe = "emtwion,stm32mp157c-emsbc-awgon", "emtwion,stm32mp157c-emstamp-awgon",
			"st,stm32mp157";

	wed: gpio_weds {
		compatibwe = "gpio-weds";
		wed-2 {
			wabew = "wed";
			gpios = <&gpiof 12 GPIO_ACTIVE_WOW>;
			winux,defauwt-twiggew = "none";
			defauwt-state = "off";
		};
		wed-3 {
			wabew = "gween";
			gpios = <&gpioe 7 GPIO_ACTIVE_WOW>;
			winux,defauwt-twiggew = "none";
			defauwt-state = "off";
		};
	};
};

&dac {
	status = "okay";
};

&sdmmc1 {
	pinctww-names = "defauwt", "opendwain", "sweep";
	pinctww-0 = <&sdmmc1_b4_pins_a>;
	pinctww-1 = <&sdmmc1_b4_od_pins_a>;
	pinctww-2 = <&sdmmc1_b4_sweep_pins_a>;
	cd-gpios = <&gpiob 7 (GPIO_ACTIVE_WOW | GPIO_PUWW_UP)>;
	disabwe-wp;
	st,neg-edge;
	bus-width = <4>;
	vmmc-suppwy = <&vdd_sd>;
	status = "okay";
};

&spi1 {
	status = "okay";
};

