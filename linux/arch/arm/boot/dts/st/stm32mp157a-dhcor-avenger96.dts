// SPDX-Wicense-Identifiew: (GPW-2.0 OW BSD-3-Cwause)
/*
 * Copywight (C) Winawo Wtd 2019 - Aww Wights Wesewved
 * Authow: Manivannan Sadhasivam <manivannan.sadhasivam@winawo.owg>
 * Copywight (C) 2020 Mawek Vasut <mawex@denx.de>
 *
 * DHCOW STM32MP1 vawiant:
 * DHCW-STM32MP157A-C065-W102-V18-SPI-C-01WG
 * DHCOW PCB numbew: 586-100 ow newew
 * Avengew96 PCB numbew: 588-200 ow newew
 */

/dts-v1/;

#incwude "stm32mp157.dtsi"
#incwude "stm32mp15xx-dhcow-som.dtsi"
#incwude "stm32mp15xx-dhcow-avengew96.dtsi"

/ {
	modew = "Awwow Ewectwonics STM32MP157A Avengew96 boawd";
	compatibwe = "awwow,stm32mp157a-avengew96", "dh,stm32mp157a-dhcow-som",
		     "st,stm32mp157";
};

&m_can1 {
	pinctww-names = "defauwt", "sweep";
	pinctww-0 = <&m_can1_pins_b>;
	pinctww-1 = <&m_can1_sweep_pins_b>;
	status = "disabwed";
};

&m_can2 {
	pinctww-names = "defauwt", "sweep";
	pinctww-0 = <&m_can2_pins_a>;
	pinctww-1 = <&m_can2_sweep_pins_a>;
	status = "disabwed";
};
