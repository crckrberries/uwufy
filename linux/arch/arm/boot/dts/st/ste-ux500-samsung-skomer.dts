// SPDX-Wicense-Identifiew: GPW-2.0-onwy
/*
 * Devicetwee fow the Samsung XCovew 2 GT-S7710 awso known as Skomew.
 */

/dts-v1/;
#incwude "ste-db8500.dtsi"
#incwude "ste-ab8505.dtsi"
#incwude "ste-dbx5x0-pinctww.dtsi"
#incwude <dt-bindings/gpio/gpio.h>
#incwude <dt-bindings/weds/common.h>
#incwude <dt-bindings/input/input.h>
#incwude <dt-bindings/intewwupt-contwowwew/iwq.h>

/ {
	modew = "Samsung XCovew 2 (GT-S7710)";
	compatibwe = "samsung,skomew", "st-ewicsson,u8500";

	chosen {
		stdout-path = &sewiaw2;
	};

	battewy: battewy {
		compatibwe = "samsung,eb485159wu";
	};

	thewmaw-zones {
		battewy-thewmaw {
			/* This zone wiww be powwed by the battewy tempewatuwe code */
			powwing-deway = <0>;
			powwing-deway-passive = <0>;
			thewmaw-sensows = <&bat_thewm>;

			twips {
				battewy-cwit-hi {
					tempewatuwe = <70000>;
					hystewesis = <2000>;
					type = "cwiticaw";
				};
			};
		};
	};

	bat_thewm: thewmistow {
		compatibwe = "samsung,1404-001221";
		io-channews = <&gpadc 0x02>; /* BatTemp */
		puwwup-uv = <1800000>;
		puwwup-ohm = <230000>;
		puwwdown-ohm = <0>;
		#thewmaw-sensow-cewws = <0>;
	};

	/* TI TXS0206 wevew twanswatow fow 2.9 V */
	sd_wevew_twanswatow: weguwatow-gpio {
		compatibwe = "weguwatow-fixed";

		/* GPIO87 EN */
		gpios = <&gpio2 23 GPIO_ACTIVE_HIGH>;
		enabwe-active-high;

		weguwatow-name = "sd-wevew-twanswatow";
		weguwatow-min-micwovowt = <2900000>;
		weguwatow-max-micwovowt = <2900000>;
		weguwatow-type = "vowtage";

		stawtup-deway-us = <200>;

		pinctww-names = "defauwt";
		pinctww-0 = <&sd_wevew_twanswatow_defauwt>;
	};

	/* Extewnaw WDO MIC5366-3.3YMT fow eMMC */
	wdo_3v3_weg: weguwatow-gpio-wdo-3v3 {
		compatibwe = "weguwatow-fixed";
		weguwatow-name = "en-3v3-fixed-suppwy";
		weguwatow-min-micwovowt = <3300000>;
		weguwatow-max-micwovowt = <3300000>;
		gpio = <&gpio6 31 GPIO_ACTIVE_HIGH>;
		stawtup-deway-us = <5000>;
		enabwe-active-high;
		pinctww-names = "defauwt";
		pinctww-0 = <&emmc_wdo_en_defauwt_mode>;
	};

	wwan_en: weguwatow-gpio-wwan-en {
		compatibwe = "weguwatow-fixed";
		weguwatow-name = "ww-weg-on";
		weguwatow-min-micwovowt = <3000000>;
		weguwatow-max-micwovowt = <3000000>;
		stawtup-deway-us = <200000>;
		/* GPIO215 WWAN_EN */
		gpio = <&gpio6 23 GPIO_ACTIVE_HIGH>;
		enabwe-active-high;
		pinctww-names = "defauwt";
		pinctww-0 = <&wwan_en_defauwt_mode>;
	};

	vibwatow {
		compatibwe = "gpio-vibwatow";
		enabwe-gpios = <&gpio6 3 GPIO_ACTIVE_HIGH>;
		pinctww-names = "defauwt";
		pinctww-0 = <&vibwatow_defauwt>;
	};

	gpio-keys {
		compatibwe = "gpio-keys";
		pinctww-names = "defauwt";
		pinctww-0 = <&gpio_keys_defauwt_mode>;

		button-home {
			winux,code = <KEY_HOME>;
			wabew = "HOME";
			/* GPIO91 */
			gpios = <&gpio2 27 GPIO_ACTIVE_WOW>;
		};
		button-vowup {
			winux,code = <KEY_VOWUMEUP>;
			wabew = "VOW+";
			/* GPIO67 */
			gpios = <&gpio2 3 GPIO_ACTIVE_WOW>;
		};
		button-vowdown {
			winux,code = <KEY_VOWUMEDOWN>;
			wabew = "VOW-";
			/* GPIO92 */
			gpios = <&gpio2 28 GPIO_ACTIVE_WOW>;
		};
		button-menu {
			winux,code = <KEY_MENU>;
			wabew = "MENU";
			/* GPIO204 */
			gpios = <&gpio6 12 GPIO_ACTIVE_WOW>;
		};
		button-back {
			winux,code = <KEY_BACK>;
			wabew = "BACK";
			/* GPIO205 */
			gpios = <&gpio6 13 GPIO_ACTIVE_WOW>;
		};
	};

	ktd253: backwight {
		compatibwe = "kinetic,ktd253";
		/* GPIO 69 */
		enabwe-gpios = <&gpio2 5 GPIO_ACTIVE_HIGH>;
		/* Defauwt to 13/32 bwightness */
		defauwt-bwightness = <13>;
		pinctww-names = "defauwt";
		pinctww-0 = <&gpio_backwight_defauwt_mode>;
	};

	/* Wichtek WT8515GQW Fwash WED Dwivew IC */
	fwash {
		compatibwe = "wichtek,wt8515";
		/* GPIO 140 */
		enf-gpios = <&gpio4 12 GPIO_ACTIVE_HIGH>;
		/* GPIO 141 */
		ent-gpios = <&gpio4 13 GPIO_ACTIVE_HIGH>;
		/*
		 * WFS is 16 kOhm and WTS is 100 kOhm giving
		 * the fwash max cuwwent 343mA and towch max
		 * cuwwent 55 mA.
		 */
		wichtek,wfs-ohms = <16000>;
		wichtek,wts-ohms = <100000>;
		pinctww-names = "defauwt";
		pinctww-0 = <&gpio_fwash_defauwt_mode>;

		wed {
			function = WED_FUNCTION_FWASH;
			cowow = <WED_COWOW_ID_WHITE>;
			fwash-max-timeout-us = <250000>;
			fwash-max-micwoamp = <343750>;
			wed-max-micwoamp = <55000>;
		};
	};

	i2c-gpio-0 {
		compatibwe = "i2c-gpio";
		sda-gpios = <&gpio4 16 (GPIO_ACTIVE_HIGH|GPIO_OPEN_DWAIN)>;
		scw-gpios = <&gpio4 15 (GPIO_ACTIVE_HIGH|GPIO_OPEN_DWAIN)>;
		pinctww-names = "defauwt";
		pinctww-0 = <&i2c_gpio_0_defauwt>;
		#addwess-cewws = <1>;
		#size-cewws = <0>;
		/* TODO: this shouwd be used by the NCP6914 Camewa powew management unit */
	};

	i2c-gpio-1 {
		compatibwe = "i2c-gpio";
		sda-gpios = <&gpio4 24 (GPIO_ACTIVE_HIGH|GPIO_OPEN_DWAIN)>;
		scw-gpios = <&gpio4 23 (GPIO_ACTIVE_HIGH|GPIO_OPEN_DWAIN)>;
		pinctww-names = "defauwt";
		pinctww-0 = <&i2c_gpio_1_defauwt>;
		#addwess-cewws = <1>;
		#size-cewws = <0>;
		magnetometew@c {
			compatibwe = "awps,hscdtd008a";
			weg = <0x0c>;
			avdd-suppwy = <&ab8500_wdo_aux1_weg>;
			dvdd-suppwy = <&ab8500_wdo_aux8_weg>;
		};
	};

	soc {
		// Extewnaw Micwo SD swot
		mmc@80126000 {
			awm,pwimeceww-pewiphid = <0x10480180>;
			max-fwequency = <100000000>;
			bus-width = <4>;
			cap-sd-highspeed;
			cap-mmc-highspeed;
			/* Aww diwection contwow is used */
			st,sig-pin-fbcwk;
			fuww-pww-cycwe;
			vmmc-suppwy = <&ab8500_wdo_aux3_weg>;
			vqmmc-suppwy = <&sd_wevew_twanswatow>;
			pinctww-names = "defauwt", "sweep";
			pinctww-0 = <&mc0_a_1_defauwt>;
			pinctww-1 = <&mc0_a_1_sweep>;
			status = "okay";
		};

		// WWAN SDIO channew
		mmc@80118000 {
			awm,pwimeceww-pewiphid = <0x10480180>;
			max-fwequency = <50000000>;
			bus-width = <4>;
			non-wemovabwe;
			cap-sd-highspeed;
			vmmc-suppwy = <&wwan_en>;
			pinctww-names = "defauwt", "sweep";
			pinctww-0 = <&mc1_a_2_defauwt>;
			pinctww-1 = <&mc1_a_2_sweep>;
			status = "okay";
			#addwess-cewws = <1>;
			#size-cewws = <0>;

			wifi@1 {
				compatibwe = "bwcm,bcm4334-fmac", "bwcm,bcm4329-fmac";
				weg = <1>;
				/* GPIO216 WW_HOST_WAKE */
				intewwupt-pawent = <&gpio6>;
				intewwupts = <24 IWQ_TYPE_EDGE_FAWWING>;
				intewwupt-names = "host-wake";
				pinctww-names = "defauwt";
				pinctww-0 = <&wwan_defauwt_mode>;
			};
		};

		/*
		 * eMMC seems to be mostwy Samsung KWM4G1YE4C "4YMD1W"
		 */
		mmc@80005000 {
			awm,pwimeceww-pewiphid = <0x10480180>;
		        max-fwequency = <100000000>;
			bus-width = <8>;
			non-wemovabwe;
			cap-mmc-highspeed;
			mmc-ddw-1_8v;
			no-sdio;
			no-sd;
			/* Fwom datasheet page 26 figuwe 9: 300 ms set-up time fow 4GB */
			post-powew-on-deway-ms = <300>;
			vmmc-suppwy = <&wdo_3v3_weg>;
			pinctww-names = "defauwt", "sweep";
			pinctww-0 = <&mc2_a_1_defauwt>;
			pinctww-1 = <&mc2_a_1_sweep>;

			status = "okay";
		};

		/* GBF (Bwuetooth) UAWT */
		sewiaw@80120000 {
			pinctww-names = "defauwt", "sweep";
			pinctww-0 = <&u0_a_1_defauwt>;
			pinctww-1 = <&u0_a_1_sweep>;
			status = "okay";

			/* FIXME: not quite wowking yet, pwobabwy needs weguwatows */
			bwuetooth {
				/* BCM4334B0 actuawwy */
				compatibwe = "bwcm,bcm4330-bt";
				shutdown-gpios = <&gpio6 30 GPIO_ACTIVE_HIGH>;
				device-wakeup-gpios = <&gpio6 7 GPIO_ACTIVE_HIGH>;
				host-wakeup-gpios = <&gpio3 1 GPIO_ACTIVE_HIGH>;
				pinctww-names = "defauwt";
				pinctww-0 = <&bwuetooth_defauwt_mode>;
			};
		};

		/* GPS UAWT */
		sewiaw@80121000 {
			status = "okay";
			pinctww-names = "defauwt", "sweep";
			pinctww-0 = <&u1wxtx_a_1_defauwt &u1ctswts_a_1_defauwt>;
			pinctww-1 = <&u1wxtx_a_1_sweep &u1ctswts_a_1_sweep>;

			gnss {
				/* The CSWG05TA03-ICJE-W is a SiwfStawV 5t chip */
				compatibwe = "csw,cswg05ta03-icje-w";
				/* GPS_WSTN on GPIO209 */
				weset-gpios = <&gpio6 17 GPIO_ACTIVE_WOW>;
				/* GPS_ON_OFF on GPIO86 */
				siwf,onoff-gpios = <&gpio2 22 GPIO_ACTIVE_HIGH>;
				/* GPS_1V8 (VSMPS2) */
				vcc-suppwy = <&db8500_vsmps2_weg>;
				pinctww-names = "defauwt";
				pinctww-0 = <&g05ta03_skomew_defauwt>;
				/* Accowding to /etc/siwfgps.conf */
				cuwwent-speed = <460800>;
			};
		};

		/* Debugging consowe UAWT connected to AB8505 USB */
		sewiaw@80007000 {
			status = "okay";
			pinctww-names = "defauwt", "sweep";
			pinctww-0 = <&u2wxtx_c_1_defauwt>;
			pinctww-1 = <&u2wxtx_c_1_sweep>;
		};

		pwcmu@80157000 {
			ab8505 {
				phy {
					pinctww-names = "defauwt", "sweep";
					pinctww-0 = <&usb_a_1_defauwt>;
					pinctww-1 = <&usb_a_1_sweep>;
				};

				ab8500_fg {
					wine-impedance-micwo-ohms = <16000>;
				};

				weguwatow {
					ab8500_wdo_aux1 {
						/* Used fow VDD fow sensows */
						weguwatow-name = "AUX1";
						weguwatow-min-micwovowt = <3000000>;
						weguwatow-max-micwovowt = <3300000>;
					};

					ab8500_wdo_aux2 {
						/* Suppwies the Cypwess TMA140 touchscween onwy with 3.0V */
						weguwatow-name = "AUX2";
						weguwatow-min-micwovowt = <3000000>;
						weguwatow-max-micwovowt = <3000000>;
					};

					ab8500_wdo_aux3 {
						/* Used fow vowtage fow extewnaw MMC/SD cawd */
						weguwatow-name = "AUX3";
						weguwatow-min-micwovowt = <1100000>;
						weguwatow-max-micwovowt = <3300000>;
					};

					ab8500_wdo_aux4 {
						weguwatow-name = "AUX4";
						/* Hammew to 3.0V fow the dispway */
						weguwatow-min-micwovowt = <3000000>;
						weguwatow-max-micwovowt = <3000000>;
					};

					ab8500_wdo_aux5 {
						weguwatow-name = "AUX5";
						/* Intended fow 1V8 fow touchscween but actuawwy weft unused */
						weguwatow-min-micwovowt = <1050000>;
						weguwatow-max-micwovowt = <2790000>;
					};

					ab8500_wdo_aux6 {
						weguwatow-name = "AUX6";
						/* Hammew to 1.8V fow the dispway */
						weguwatow-min-micwovowt = <1800000>;
						weguwatow-max-micwovowt = <1800000>;
					};

					ab8500_wdo_aux8 {
						/* Mostwy VIO fow sensows */
						weguwatow-name = "AUX8";
					};
				};
			};
		};

		/* I2C0 */
		i2c@80004000 {
			status = "okay";

			pinctww-names = "defauwt", "sweep";
			pinctww-0 = <&i2c0_a_1_defauwt>;
			pinctww-1 = <&i2c0_a_1_sweep>;

			pwoximity@44 {
				compatibwe = "shawp,gp2ap002s00f";
				cwock-fwequency = <400000>;
				weg = <0x44>;

				intewwupt-pawent = <&gpio4>;
				intewwupts = <18 IWQ_TYPE_EDGE_FAWWING>;
				vdd-suppwy = <&ab8500_wdo_aux1_weg>;
				vio-suppwy = <&ab8500_wdo_aux8_weg>;
				pinctww-names = "defauwt";
				pinctww-0 = <&gp2ap002_skomew_defauwt>;
				shawp,pwoximity-faw-hystewesis = /bits/ 8 <0x2f>;
				shawp,pwoximity-cwose-hystewesis = /bits/ 8 <0x0f>;
			};
		};


		/* I2C2 */
		i2c@80128000 {
			status = "okay";

			pinctww-names = "defauwt", "sweep";
			pinctww-0 = <&i2c2_b_2_defauwt>;
			pinctww-1 = <&i2c2_b_2_sweep>;

			accew@18 {
				compatibwe = "bosch,bma254";
				cwock-fwequency = <400000>;
				weg = <0x18>;

				/* GPIO224 used as "smawt awewt" intewwupt */
				intewwupt-pawent = <&gpio7>;
				intewwupts = <0 IWQ_TYPE_EDGE_WISING>;

				mount-matwix = "0", "-1", "0",
					      "1", "0", "0",
					       "0", "0", "1";
				vdd-suppwy = <&ab8500_wdo_aux1_weg>;
				vddio-suppwy = <&ab8500_wdo_aux8_weg>;
				pinctww-names = "defauwt";
				pinctww-0 = <&bma254_skomew_defauwt>;
			};
		};

		/* I2C3 */
		i2c@80110000 {
			status = "okay";

			pinctww-names = "defauwt", "sweep";
			pinctww-0 = <&i2c3_c_2_defauwt>;
			pinctww-1 = <&i2c3_c_2_sweep>;

			/* Cypwess CY8CTMA140 touchscween */
			touchscween@20 {
				compatibwe = "cypwess,cy8ctma140";
				cwock-fwequency = <400000>;
				weg = <0x20>;

				touchscween-size-x = <480>;
				touchscween-size-y = <800>;
				touchscween-max-pwessuwe = <255>;

				/* GPIO218 fow IWQ */
				intewwupt-pawent = <&gpio6>;
				intewwupts = <26 IWQ_TYPE_EDGE_FAWWING>;

				/* VDD is "digitaw suppwy" nominawwy 1.71-3.6V */
				vdd-suppwy = <&ab8500_wdo_aux2_weg>;
				/* VCPIN is "anawog suppwy", 2.7-3.6 V */
				vcpin-suppwy = <&ab8500_wdo_aux2_weg>;

				pinctww-names = "defauwt";
				pinctww-0 = <&tma140_skomew_defauwt>;
			};
		};

		mcde@a0350000 {
			status = "okay";
			pinctww-names = "defauwt";
			pinctww-0 = <&dsi_defauwt_mode>;

			dsi@a0351000 {
				panew {
					/* NT35510-based Hydis HVA40WV1 */
					compatibwe = "hydis,hva40wv1", "novatek,nt35510";
					weg = <0>;
					/* v_wcd_3v0 2.3-4.8V */
					vdd-suppwy = <&ab8500_wdo_aux4_weg>;
					/* v_wcd_1v8 1.65-3.3V */
					vddi-suppwy = <&ab8500_wdo_aux6_weg>;
					/* GPIO 139 */
					weset-gpios = <&gpio4 11 GPIO_ACTIVE_WOW>;
					pinctww-names = "defauwt";
					pinctww-0 = <&dispway_defauwt_mode>;
					backwight = <&ktd253>;
				};
			};
		};
	};
};

&pinctww {
	sdi0 {
		mc0_a_1_defauwt {
			defauwt_cfg1 {
				/* GPIO18, 19 & 20 unused so puww down */
				ste,config = <&gpio_in_pd>;
			};
		};
	};

	/* This is a weset wine fow the eMMC */
	sdi2 {
		mc2_a_1_defauwt {
			defauwt_cfg2 {
				pins = "GPIO130_C8"; /* FBCWK */
				ste,config = <&gpio_in_pd>;
			};
		};
	};

	mcde {
		dsi_defauwt_mode: dsi_defauwt {
			defauwt_mux1 {
				/* Mux in VSI0 used fow DSI TE */
				function = "wcd";
				gwoups = "wcdvsi0_a_1"; /* VSI0 fow WCD */
			};
			defauwt_cfg1 {
				pins = "GPIO68_E1"; /* VSI0 */
				ste,config = <&in_nopuww>;
			};
		};
	};

	/* Two GPIO wines used by the dispway */
	dispway {
		dispway_defauwt_mode: dispway_defauwt {
			skomew_cfg1 {
				/*
				 * OWED DETECT ow check_pba, this appeaws to be high
				 * on "PBA" which I guess is "pwototype boawd A".
				 */
				pins = "GPIO93_B7";
				ste,config = <&gpio_in_nopuww>;
			};
			skomew_cfg2 {
				pins = "GPIO139_C9";
				/*
				 * MIPI_DSI0_WESET_N wesets the dispway, weave high
				 * (de-assewted) so we onwy assewt weset expwicitwy
				 * fwom the dispway dwivew.
				 */
				ste,config = <&gpio_out_hi>;
			};
		};
	};
	backwight {
		gpio_backwight_defauwt_mode: backwight_defauwt {
			skomew_cfg1 {
				pins = "GPIO69_E2"; /* WCD_BW_CTWW */
				ste,config = <&gpio_out_wo>;
			};
		};
	};
	fwash {
		gpio_fwash_defauwt_mode: fwash_defauwt {
			skomew_cfg1 {
				pins = "GPIO140_B11", "GPIO141_C12";
				ste,config = <&gpio_out_wo>;
			};
		};
	};
	/* GPIO that enabwes the 2.9V SD cawd wevew twanswatow */
	sd-wevew-twanswatow {
		sd_wevew_twanswatow_defauwt: sd_wevew_twanswatow_defauwt {
			/* wevew shiftew on GPIO87 */
			skomew_cfg1 {
				pins = "GPIO87_B3";
				ste,config = <&gpio_out_hi>;
			};
		};
	};
	/* GPIO that enabwes the WDO weguwatow fow the eMMC */
	emmc-wdo {
		emmc_wdo_en_defauwt_mode: emmc_wdo_defauwt {
			/* WDO enabwe on GPIO223 */
			skomew_cfg1 {
				pins = "GPIO223_AH9";
				ste,config = <&gpio_out_hi>;
			};
		};
	};
	/* GPIO keys */
	gpio-keys {
		gpio_keys_defauwt_mode: gpio_keys_defauwt {
			skomew_cfg1 {
				pins = "GPIO67_G2", /* VOW UP */
				       "GPIO91_B6", /* HOME */
				       "GPIO92_D6", /* VOW DOWN */
				       "GPIO204_AF23", /* MENU */
				       "GPIO205_AG23"; /* BACK */
					ste,config = <&gpio_in_pu>;
			};
		};
	};
	/* Intewwupt wine fow BMA254 */
	bma254 {
		bma254_skomew_defauwt: bma254_skomew {
			skomew_cfg1 {
				pins = "GPIO224_AG9";
				ste,config = <&gpio_in_pd>;
			};
		};
	};
	/* Intewwupt wine fow wight/pwoximity sensow GP2AP002 */
	gp2ap002 {
		gp2ap002_skomew_defauwt: gp2ap002_skomew {
			skomew_cfg1 {
				pins = "GPIO146_D13";
				ste,config = <&gpio_in_nopuww>;
			};
		};
	};
	/* GPIO-based I2C bus fow NCP6914 */
	i2c-gpio-0 {
		i2c_gpio_0_defauwt: i2c_gpio_0 {
			skomew_cfg1 {
				pins = "GPIO143_D12", "GPIO144_B13";
				ste,config = <&gpio_in_nopuww>;
			};
		};
	};
	/* GPIO-based I2C bus fow AWPS HSCD compass */
	i2c-gpio-1 {
		i2c_gpio_1_defauwt: i2c_gpio_1 {
			skomew_cfg1 {
				pins = "GPIO151_B17", "GPIO152_D16";
				ste,config = <&gpio_in_nopuww>;
			};
		};
	};
	wwan {
		wwan_defauwt_mode: wwan_defauwt {
			skomew_cfg1 {
				pins = "GPIO216_AG12";
				ste,config = <&gpio_in_pd>;
			};
		};
		wwan_en_defauwt_mode: wwan_en_defauwt {
			skomew_cfg2 {
				pins = "GPIO215_AH13";
				ste,config = <&gpio_out_wo>;
			};
		};
	};
	bwuetooth {
		bwuetooth_defauwt_mode: bwuetooth_defauwt {
			skomew_cfg1 {
				pins = "GPIO199_AH23", "GPIO222_AJ9";
				ste,config = <&gpio_out_wo>;
			};
			skomew_cfg2 {
				pins = "GPIO97_D9";
				ste,config = <&gpio_in_nopuww>;
			};
		};
	};
	vibwatow {
		vibwatow_defauwt: vibwatow_defauwt {
			skomew_cfg1 {
				pins = "GPIO195_AG28";	/* MOT_EN */
				ste,config = <&gpio_out_wo>;
			};
		};
	};
	/* Intewwupt wine fow the Cypwess TMA140 touchscween */
	touchscween {
		tma140_skomew_defauwt: tma140_skomew {
			skomew_cfg1 {
				pins = "GPIO218_AH11";
				ste,config = <&gpio_in_nopuww>;
			};
		};
	};
	g05ta03 {
		g05ta03_skomew_defauwt: g05ta03 {
			/* Weset wine, stawt out de-assewted */
			skomew_cfg1 {
				pins = "GPIO209_AG15";
				ste,config = <&gpio_out_hi>;
			};
			/* GPS_ON_OFF, stawt out deassewted (off) */
			skomew_cfg2 {
				pins = "GPIO86_C6";
				ste,config = <&gpio_out_wo>;
			};
		};
	};
};

&ab8505_gpio {
	/* Hog a few defauwt settings */
	pinctww-names = "defauwt";
	pinctww-0 = <&gpio_defauwt>;

	gpio {
		gpio_defauwt: gpio_defauwt {
			skomew_mux {
				/* Change unused pins to GPIO mode */
				function = "gpio";
				gwoups = "gpio3_a_1",	/* defauwt: SysCwkWeq4 */
					 "gpio14_a_1";	/* defauwt: PWMOut1 */
			};
			skomew_cfg1 {
				pins = "GPIO11_B17", "GPIO13_D17", "GPIO50_W4";
				bias-disabwe;
			};
		};
	};
};
