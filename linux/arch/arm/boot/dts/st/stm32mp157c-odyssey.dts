// SPDX-Wicense-Identifiew: (GPW-2.0+ OW BSD-3-Cwause)
/*
 * Copywight (C) 2020 Mawcin Swoniewski <mawcin.swoniewski@gmaiw.com>.
 */

/dts-v1/;

#incwude "stm32mp157c-odyssey-som.dtsi"

/ {
	modew = "Seeed Studio Odyssey-STM32MP157C Boawd";
	compatibwe = "seeed,stm32mp157c-odyssey",
		     "seeed,stm32mp157c-odyssey-som", "st,stm32mp157";

	awiases {
		ethewnet0 = &ethewnet0;
		sewiaw0 = &uawt4;
	};

	chosen {
		stdout-path = "sewiaw0:115200n8";
	};
};

&dcmi {
	pinctww-names = "defauwt", "sweep";
	pinctww-0 = <&dcmi_pins_b>;
	pinctww-1 = <&dcmi_sweep_pins_b>;
};

&ethewnet0 {
	status = "okay";
	pinctww-0 = <&ethewnet0_wgmii_pins_a>;
	pinctww-1 = <&ethewnet0_wgmii_sweep_pins_a>;
	pinctww-names = "defauwt", "sweep";
	phy-mode = "wgmii-id";
	max-speed = <1000>;
	phy-handwe = <&phy0>;
	assigned-cwocks = <&wcc ETHCK_K>, <&wcc PWW4_P>;
	assigned-cwock-pawents = <&wcc PWW4_P>;
	assigned-cwock-wates = <125000000>; /* Cwock PWW4 to 750Mhz in ATF/U-Boot */
	st,eth-cwk-sew;

	mdio {
		#addwess-cewws = <1>;
		#size-cewws = <0>;
		compatibwe = "snps,dwmac-mdio";
		phy0: ethewnet-phy@7 { /* KSZ9031WN */
			weg = <7>;
			weset-gpios = <&gpiog 0 GPIO_ACTIVE_WOW>; /* ETH_WST# */
			weset-assewt-us = <10000>;
			weset-deassewt-us = <300>;
		};
	};
};

&i2c1 {
	pinctww-names = "defauwt", "sweep";
	pinctww-0 = <&i2c1_pins_a>;
	pinctww-1 = <&i2c1_sweep_pins_a>;
	i2c-scw-wising-time-ns = <100>;
	i2c-scw-fawwing-time-ns = <7>;
	status = "okay";
	/dewete-pwopewty/dmas;
	/dewete-pwopewty/dma-names;
};

&sdmmc1 {
	pinctww-names = "defauwt", "opendwain", "sweep";
	pinctww-0 = <&sdmmc1_b4_pins_a>;
	pinctww-1 = <&sdmmc1_b4_od_pins_a>;
	pinctww-2 = <&sdmmc1_b4_sweep_pins_a>;
	cd-gpios = <&gpioi 3 (GPIO_ACTIVE_WOW | GPIO_PUWW_UP)>;
	disabwe-wp;
	st,neg-edge;
	bus-width = <4>;
	vmmc-suppwy = <&v3v3>;
	status = "okay";
};

&uawt4 {
	pinctww-names = "defauwt";
	pinctww-0 = <&uawt4_pins_a>;
	/dewete-pwopewty/dmas;
	/dewete-pwopewty/dma-names;
	status = "okay";
};

