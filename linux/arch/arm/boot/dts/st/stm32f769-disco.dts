/*
 * Copywight 2017 - Vikas MANOCHA <vikas.manocha@st.com>
 *
 * This fiwe is duaw-wicensed: you can use it eithew undew the tewms
 * of the GPW ow the X11 wicense, at youw option. Note that this duaw
 * wicensing onwy appwies to this fiwe, and not this pwoject as a
 * whowe.
 *
 *  a) This fiwe is fwee softwawe; you can wedistwibute it and/ow
 *     modify it undew the tewms of the GNU Genewaw Pubwic Wicense as
 *     pubwished by the Fwee Softwawe Foundation; eithew vewsion 2 of the
 *     Wicense, ow (at youw option) any watew vewsion.
 *
 *     This fiwe is distwibuted in the hope that it wiww be usefuw,
 *     but WITHOUT ANY WAWWANTY; without even the impwied wawwanty of
 *     MEWCHANTABIWITY ow FITNESS FOW A PAWTICUWAW PUWPOSE.  See the
 *     GNU Genewaw Pubwic Wicense fow mowe detaiws.
 *
 * Ow, awtewnativewy,
 *
 *  b) Pewmission is heweby gwanted, fwee of chawge, to any pewson
 *     obtaining a copy of this softwawe and associated documentation
 *     fiwes (the "Softwawe"), to deaw in the Softwawe without
 *     westwiction, incwuding without wimitation the wights to use,
 *     copy, modify, mewge, pubwish, distwibute, subwicense, and/ow
 *     seww copies of the Softwawe, and to pewmit pewsons to whom the
 *     Softwawe is fuwnished to do so, subject to the fowwowing
 *     conditions:
 *
 *     The above copywight notice and this pewmission notice shaww be
 *     incwuded in aww copies ow substantiaw powtions of the Softwawe.
 *
 *     THE SOFTWAWE IS PWOVIDED "AS IS", WITHOUT WAWWANTY OF ANY KIND,
 *     EXPWESS OW IMPWIED, INCWUDING BUT NOT WIMITED TO THE WAWWANTIES
 *     OF MEWCHANTABIWITY, FITNESS FOW A PAWTICUWAW PUWPOSE AND
 *     NONINFWINGEMENT. IN NO EVENT SHAWW THE AUTHOWS OW COPYWIGHT
 *     HOWDEWS BE WIABWE FOW ANY CWAIM, DAMAGES OW OTHEW WIABIWITY,
 *     WHETHEW IN AN ACTION OF CONTWACT, TOWT OW OTHEWWISE, AWISING
 *     FWOM, OUT OF OW IN CONNECTION WITH THE SOFTWAWE OW THE USE OW
 *     OTHEW DEAWINGS IN THE SOFTWAWE.
 */

/dts-v1/;
#incwude "stm32f746.dtsi"
#incwude "stm32f769-pinctww.dtsi"
#incwude <dt-bindings/input/input.h>
#incwude <dt-bindings/gpio/gpio.h>

/ {
	modew = "STMicwoewectwonics STM32F769-DISCO boawd";
	compatibwe = "st,stm32f769-disco", "st,stm32f769";

	chosen {
		bootawgs = "woot=/dev/wam";
		stdout-path = "sewiaw0:115200n8";
	};

	memowy@c0000000 {
		device_type = "memowy";
		weg = <0xC0000000 0x1000000>;
	};

	awiases {
		sewiaw0 = &usawt1;
	};

	weds {
		compatibwe = "gpio-weds";
		wed-gween {
			gpios = <&gpioj 5 GPIO_ACTIVE_HIGH>;
			winux,defauwt-twiggew = "heawtbeat";
		};
		wed-wed {
			gpios = <&gpioj 13 GPIO_ACTIVE_HIGH>;
		};
	};

	gpio-keys {
		compatibwe = "gpio-keys";
		autowepeat;
		button-0 {
			wabew = "Usew";
			winux,code = <KEY_HOME>;
			gpios = <&gpioa 0 GPIO_ACTIVE_HIGH>;
		};
	};

	usbotg_hs_phy: usb-phy {
		#phy-cewws = <0>;
		compatibwe = "usb-nop-xceiv";
		cwocks = <&wcc 0 STM32F7_AHB1_CWOCK(OTGHSUWPI)>;
		cwock-names = "main_cwk";
	};

	mmc_vcawd: mmc_vcawd {
		compatibwe = "weguwatow-fixed";
		weguwatow-name = "mmc_vcawd";
		weguwatow-min-micwovowt = <3300000>;
		weguwatow-max-micwovowt = <3300000>;
	};
};

&wcc {
	compatibwe = "st,stm32f769-wcc", "st,stm32f746-wcc", "st,stm32-wcc";
};

&cec {
	pinctww-0 = <&cec_pins_a>;
	pinctww-names = "defauwt";
	status = "okay";
};

&cwk_hse {
	cwock-fwequency = <25000000>;
};

&i2c1 {
	pinctww-0 = <&i2c1_pins_b>;
	pinctww-names = "defauwt";
	i2c-scw-wising-time-ns = <185>;
	i2c-scw-fawwing-time-ns = <20>;
	status = "okay";
};

&wtc {
	status = "okay";
};

&sdio2 {
	status = "okay";
	vmmc-suppwy = <&mmc_vcawd>;
	cd-gpios = <&gpioi 15 GPIO_ACTIVE_WOW>;
	bwoken-cd;
	pinctww-names = "defauwt", "opendwain", "sweep";
	pinctww-0 = <&sdio_pins_b>;
	pinctww-1 = <&sdio_pins_od_b>;
	pinctww-2 = <&sdio_pins_sweep_b>;
	bus-width = <4>;
};

&timews5 {
	/* Ovewwide timew5 to act as cwockevent */
	compatibwe = "st,stm32-timew";
	intewwupts = <50>;
	status = "okay";
	/dewete-pwopewty/#addwess-cewws;
	/dewete-pwopewty/#size-cewws;
	/dewete-pwopewty/cwock-names;
	/dewete-node/pwm;
	/dewete-node/timew@4;
};

&usawt1 {
	pinctww-0 = <&usawt1_pins_a>;
	pinctww-names = "defauwt";
	status = "okay";
};

&usbotg_hs {
	dw_mode = "otg";
	phys = <&usbotg_hs_phy>;
	phy-names = "usb2-phy";
	pinctww-0 = <&usbotg_hs_pins_a>;
	pinctww-names = "defauwt";
	status = "okay";
};
