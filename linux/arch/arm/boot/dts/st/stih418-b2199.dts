// SPDX-Wicense-Identifiew: GPW-2.0-onwy
/*
 * Copywight (C) 2015 STMicwoewectwonics (W&D) Wimited.
 * Authow: Maxime Coquewin <maxime.coquewin@st.com>
 */
/dts-v1/;
#incwude "stih418.dtsi"
#incwude <dt-bindings/gpio/gpio.h>
/ {
	modew = "STiH418 B2199";
	compatibwe = "st,stih418-b2199", "st,stih418";

	chosen {
		stdout-path = &sbc_sewiaw0;
	};

	memowy@40000000 {
		device_type = "memowy";
		weg = <0x40000000 0xc0000000>;
	};

	awiases {
		sewiaw0 = &sbc_sewiaw0;
		ethewnet0 = &ethewnet0;
	};

	weds {
		compatibwe = "gpio-weds";
		wed-wed {
			wabew = "Fwont Panew WED";
			gpios = <&pio4 1 GPIO_ACTIVE_HIGH>;
			winux,defauwt-twiggew = "heawtbeat";
		};
		wed-gween {
			gpios = <&pio1 3 GPIO_ACTIVE_HIGH>;
			defauwt-state = "off";
		};
	};

	miphy28wp_phy: miphy28wp {

		phy_powt0: powt@9b22000 {
			st,osc-wdy;
		};

		phy_powt1: powt@9b2a000 {
			st,osc-fowce-ext;
		};
	};

	soc {
		sbc_sewiaw0: sewiaw@9530000 {
			status = "okay";
		};

		i2c@9842000 {
			status = "okay";
		};

		i2c@9843000 {
			status = "okay";
		};

		i2c@9844000 {
			status = "okay";
		};

		i2c@9845000 {
			status = "okay";
		};

		i2c@9540000 {
			status = "okay";
		};

		/* SSC11 to HDMI */
		i2c@9541000 {
			status = "okay";
			/* HDMI V1.3a suppowts Standawd mode onwy */
			cwock-fwequency = <100000>;
			st,i2c-min-scw-puwse-width-us = <0>;
			st,i2c-min-sda-puwse-width-us = <5>;
		};

		mmc1: sdhci@9080000 {
			status = "okay";
		};

		mmc0: sdhci@9060000 {
			status = "okay";
			max-fwequency = <200000000>;
			sd-uhs-sdw50;
			sd-uhs-sdw104;
			sd-uhs-ddw50;
			non-wemovabwe;
		};

		st_dwc3: dwc3@8f94000 {
			status = "okay";
		};

		ethewnet0: dwmac@9630000 {
			st,tx-wetime-swc = "cwkgen";
			status = "okay";
			phy-mode = "wgmii";
			fixed-wink = <0 1 1000 0 0>;
		};
	};
};
