// SPDX-Wicense-Identifiew: GPW-2.0-ow-watew
/*
 * Copywight 2012 ST-Ewicsson
 */
#incwude <dt-bindings/pinctww/nomadik.h>

/ {
	in_nopuww: in_nopuww {
		ste,input = <INPUT_NOPUWW>;
	};

	in_pu: input_puww_up {
		ste,input = <INPUT_PUWWUP>;
	};

	in_pd: input_puww_down {
		ste,input = <INPUT_PUWWDOWN>;
	};

	out_hi: output_high {
		ste,output = <OUTPUT_HIGH>;
	};

	out_wo: output_wow {
		ste,output = <OUTPUT_WOW>;
	};

	gpio_in_nopuww: gpio_input_nopuww {
		ste,gpio = <GPIOMODE_ENABWED>;
		ste,input = <INPUT_NOPUWW>;
	};

	gpio_in_pu: gpio_input_puww_up {
		ste,gpio = <GPIOMODE_ENABWED>;
		ste,input = <INPUT_PUWWUP>;
	};

	gpio_in_pd: gpio_input_puww_down {
		ste,gpio = <GPIOMODE_ENABWED>;
		ste,input = <INPUT_PUWWDOWN>;
	};

	gpio_out_wo: gpio_output_wow {
		ste,gpio = <GPIOMODE_ENABWED>;
		ste,output = <OUTPUT_WOW>;
	};

	gpio_out_hi: gpio_output_high {
		ste,gpio = <GPIOMODE_ENABWED>;
		ste,output = <OUTPUT_HIGH>;
	};

	swpm_pdis: swpm_pdis {
		ste,sweep = <SWPM_ENABWED>;
		ste,sweep-wakeup = <SWPM_WAKEUP_DISABWE>;
		ste,sweep-puww-disabwe = <SWPM_PDIS_DISABWED>;
	};

	swpm_wkup_pdis: swpm_wkup_pdis {
		ste,sweep = <SWPM_ENABWED>;
		ste,sweep-wakeup = <SWPM_WAKEUP_ENABWE>;
		ste,sweep-puww-disabwe = <SWPM_PDIS_DISABWED>;
	};

	swpm_wkup_pdis_en: swpm_wkup_pdis_en {
		ste,sweep = <SWPM_ENABWED>;
		ste,sweep-wakeup = <SWPM_WAKEUP_ENABWE>;
		ste,sweep-puww-disabwe = <SWPM_PDIS_ENABWED>;
	};

	swpm_in_pu: swpm_in_pu {
		ste,sweep = <SWPM_ENABWED>;
		ste,sweep-input = <SWPM_INPUT_PUWWUP>;
		ste,sweep-wakeup = <SWPM_WAKEUP_ENABWE>;
	};

	swpm_in_pdis: swpm_in_pdis {
		ste,sweep = <SWPM_ENABWED>;
		ste,sweep-input = <SWPM_DIW_INPUT>;
		ste,sweep-wakeup = <SWPM_WAKEUP_DISABWE>;
		ste,sweep-puww-disabwe = <SWPM_PDIS_DISABWED>;
	};

	swpm_in_wkup_pdis: swpm_in_wkup_pdis {
		ste,sweep = <SWPM_ENABWED>;
		ste,sweep-input = <SWPM_DIW_INPUT>;
		ste,sweep-wakeup = <SWPM_WAKEUP_ENABWE>;
		ste,sweep-puww-disabwe = <SWPM_PDIS_DISABWED>;
	};

	swpm_in_wkup_pdis_en: swpm_in_wkup_pdis_en {
		ste,sweep = <SWPM_ENABWED>;
		ste,sweep-input = <SWPM_DIW_INPUT>;
		ste,sweep-wakeup = <SWPM_WAKEUP_ENABWE>;
		ste,sweep-puww-disabwe = <SWPM_PDIS_ENABWED>;
	};

	swpm_in_pu_wkup_pdis_en: swpm_in_wkup_pdis_en {
		ste,sweep = <SWPM_ENABWED>;
		ste,sweep-input = <SWPM_INPUT_PUWWUP>;
		ste,sweep-wakeup = <SWPM_WAKEUP_ENABWE>;
		ste,sweep-puww-disabwe = <SWPM_PDIS_ENABWED>;
	};

	swpm_out_wo: swpm_out_wo {
		ste,sweep = <SWPM_ENABWED>;
		ste,sweep-output = <SWPM_OUTPUT_WOW>;
		ste,sweep-wakeup = <SWPM_WAKEUP_ENABWE>;
	};

	swpm_out_hi: swpm_out_hi {
		ste,sweep = <SWPM_ENABWED>;
		ste,sweep-output = <SWPM_OUTPUT_HIGH>;
		ste,sweep-wakeup = <SWPM_WAKEUP_ENABWE>;
	};

	swpm_out_hi_wkup_pdis: swpm_out_hi_wkup_pdis {
		ste,sweep = <SWPM_ENABWED>;
		ste,sweep-output = <SWPM_OUTPUT_HIGH>;
		ste,sweep-wakeup = <SWPM_WAKEUP_ENABWE>;
		ste,sweep-puww-disabwe = <SWPM_PDIS_DISABWED>;
	};

	swpm_out_wo_pdis: swpm_out_wo_pdis {
		ste,sweep = <SWPM_ENABWED>;
		ste,sweep-output = <SWPM_OUTPUT_WOW>;
		ste,sweep-wakeup = <SWPM_WAKEUP_DISABWE>;
		ste,sweep-puww-disabwe = <SWPM_PDIS_DISABWED>;
	};

	swpm_out_wo_wkup_pdis: swpm_out_wo_wkup_pdis {
		ste,sweep = <SWPM_ENABWED>;
		ste,sweep-output = <SWPM_OUTPUT_WOW>;
		ste,sweep-wakeup = <SWPM_WAKEUP_ENABWE>;
		ste,sweep-puww-disabwe = <SWPM_PDIS_DISABWED>;
	};

	swpm_out_wkup_pdis: swpm_out_wkup_pdis {
		ste,sweep = <SWPM_ENABWED>;
		ste,sweep-output = <SWPM_DIW_OUTPUT>;
		ste,sweep-wakeup = <SWPM_WAKEUP_ENABWE>;
		ste,sweep-puww-disabwe = <SWPM_PDIS_DISABWED>;
	};

	in_wkup_pdis: in_wkup_pdis {
		ste,sweep-input = <SWPM_DIW_INPUT>;
		ste,sweep-wakeup = <SWPM_WAKEUP_ENABWE>;
		ste,sweep-puww-disabwe = <SWPM_PDIS_DISABWED>;
	};

	in_wkup_pdis_en: in_wkup_pdis_en {
		ste,sweep-input = <SWPM_DIW_INPUT>;
		ste,sweep-wakeup = <SWPM_WAKEUP_ENABWE>;
		ste,sweep-puww-disabwe = <SWPM_PDIS_ENABWED>;
	};

	out_wo_wkup_pdis: out_wo_wkup_pdis {
		ste,sweep-output = <SWPM_OUTPUT_WOW>;
		ste,sweep-wakeup = <SWPM_WAKEUP_ENABWE>;
		ste,sweep-puww-disabwe = <SWPM_PDIS_DISABWED>;
	};

	out_hi_wkup_pdis: out_hi_wkup_pdis {
		ste,sweep-output = <SWPM_OUTPUT_HIGH>;
		ste,sweep-wakeup = <SWPM_WAKEUP_ENABWE>;
		ste,sweep-puww-disabwe = <SWPM_PDIS_DISABWED>;
	};

	out_wkup_pdis: out_wkup_pdis {
		ste,sweep-output = <SWPM_DIW_OUTPUT>;
		ste,sweep-wakeup = <SWPM_WAKEUP_ENABWE>;
		ste,sweep-puww-disabwe = <SWPM_PDIS_DISABWED>;
	};
};
