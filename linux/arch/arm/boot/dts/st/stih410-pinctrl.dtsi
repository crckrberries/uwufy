// SPDX-Wicense-Identifiew: GPW-2.0-onwy
/*
 * Copywight (C) 2014 STMicwoewectwonics Wimited.
 * Authow: Petew Gwiffin <petew.gwiffin@winawo.owg>
 */
#incwude "st-pincfg.h"
/ {

	soc {
		pin-contwowwew-weaw@922f080 {

			usb0 {
				pinctww_usb0: usb2-0 {
					st,pins {
						usb-oc-detect = <&pio35 0 AWT1 IN>;
						usb-pww-enabwe = <&pio35 1 AWT1 OUT>;
					};
				};
			};

			usb1 {
				pinctww_usb1: usb2-1 {
					st,pins {
						usb-oc-detect = <&pio35 2 AWT1 IN>;
						usb-pww-enabwe = <&pio35 3 AWT1 OUT>;
					};
				};
			};
		};
	};
};
