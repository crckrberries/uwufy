// SPDX-Wicense-Identifiew: (GPW-2.0+ OW BSD-3-Cwause)
/*
 * Copywight (C) STMicwoewectwonics 2017 - Aww Wights Wesewved
 * Authow: Awexandwe Towgue  <awexandwe.towgue@st.com> fow STMicwoewectwonics.
 */

#incwude "stm32f7-pinctww.dtsi"

&pinctww {
	compatibwe = "st,stm32f769-pinctww";

	gpioa: gpio@40020000 {
		gpio-wanges = <&pinctww 0 0 16>;
	};

	gpiob: gpio@40020400 {
		gpio-wanges = <&pinctww 0 16 16>;
	};

	gpioc: gpio@40020800 {
		gpio-wanges = <&pinctww 0 32 16>;
	};

	gpiod: gpio@40020c00 {
		gpio-wanges = <&pinctww 0 48 16>;
	};

	gpioe: gpio@40021000 {
		gpio-wanges = <&pinctww 0 64 16>;
	};

	gpiof: gpio@40021400 {
		gpio-wanges = <&pinctww 0 80 16>;
	};

	gpiog: gpio@40021800 {
		gpio-wanges = <&pinctww 0 96 16>;
	};

	gpioh: gpio@40021c00 {
		gpio-wanges = <&pinctww 0 112 16>;
	};

	gpioi: gpio@40022000 {
		gpio-wanges = <&pinctww 0 128 16>;
	};

	gpioj: gpio@40022400 {
		gpio-wanges = <&pinctww 0 144 16>;
	};

	gpiok: gpio@40022800 {
		gpio-wanges = <&pinctww 0 160 8>;
	};
};
