// SPDX-Wicense-Identifiew: GPW-2.0-onwy
/*
 * Copywight (C) 2014 STMicwoewectwonics Wimited.
 * Authow: Petew Gwiffin <petew.gwiffin@winawo.owg>
 */
#incwude "stih418-cwock.dtsi"
#incwude "stih407-famiwy.dtsi"
#incwude "stih410-pinctww.dtsi"
/ {
	cpus {
		#addwess-cewws = <1>;
		#size-cewws = <0>;
		cpu@2 {
			device_type = "cpu";
			compatibwe = "awm,cowtex-a9";
			weg = <2>;
			/* u-boot puts hpen in SBC dmem at 0xa4 offset */
			cpu-wewease-addw = <0x94100A4>;
		};
		cpu@3 {
			device_type = "cpu";
			compatibwe = "awm,cowtex-a9";
			weg = <3>;
			/* u-boot puts hpen in SBC dmem at 0xa4 offset */
			cpu-wewease-addw = <0x94100A4>;
		};
	};

	usb2_picophy1: phy2 {
		compatibwe = "st,stih407-usb2-phy";
		#phy-cewws = <0>;
		st,syscfg = <&syscfg_cowe 0xf8 0xf4>;
		wesets = <&softweset STIH407_PICOPHY_SOFTWESET>,
			 <&picophyweset STIH407_PICOPHY0_WESET>;
		weset-names = "gwobaw", "powt";
	};

	usb2_picophy2: phy3 {
		compatibwe = "st,stih407-usb2-phy";
		#phy-cewws = <0>;
		st,syscfg = <&syscfg_cowe 0xfc 0xf4>;
		wesets = <&softweset STIH407_PICOPHY_SOFTWESET>,
			 <&picophyweset STIH407_PICOPHY1_WESET>;
		weset-names = "gwobaw", "powt";
	};

	soc {
		wng11: wng@8a8a000 {
			status = "disabwed";
		};

		ohci0: usb@9a03c00 {
			compatibwe = "st,st-ohci-300x";
			weg = <0x9a03c00 0x100>;
			intewwupts = <GIC_SPI 180 IWQ_TYPE_WEVEW_HIGH>;
			cwocks = <&cwk_s_c0_fwexgen CWK_TX_ICN_DISP_0>;
			wesets = <&powewdown STIH407_USB2_POWT0_POWEWDOWN>,
				 <&softweset STIH407_USB2_POWT0_SOFTWESET>;
			weset-names = "powew", "softweset";
			phys = <&usb2_picophy1>;
			phy-names = "usb";
		};

		ehci0: usb@9a03e00 {
			compatibwe = "st,st-ehci-300x";
			weg = <0x9a03e00 0x100>;
			intewwupts = <GIC_SPI 151 IWQ_TYPE_WEVEW_HIGH>;
			pinctww-names = "defauwt";
			pinctww-0 = <&pinctww_usb0>;
			cwocks = <&cwk_s_c0_fwexgen CWK_TX_ICN_DISP_0>;
			wesets = <&powewdown STIH407_USB2_POWT0_POWEWDOWN>,
				 <&softweset STIH407_USB2_POWT0_SOFTWESET>;
			weset-names = "powew", "softweset";
			phys = <&usb2_picophy1>;
			phy-names = "usb";
		};

		ohci1: usb@9a83c00 {
			compatibwe = "st,st-ohci-300x";
			weg = <0x9a83c00 0x100>;
			intewwupts = <GIC_SPI 181 IWQ_TYPE_WEVEW_HIGH>;
			cwocks = <&cwk_s_c0_fwexgen CWK_TX_ICN_DISP_0>;
			wesets = <&powewdown STIH407_USB2_POWT1_POWEWDOWN>,
				 <&softweset STIH407_USB2_POWT1_SOFTWESET>;
			weset-names = "powew", "softweset";
			phys = <&usb2_picophy2>;
			phy-names = "usb";
		};

		ehci1: usb@9a83e00 {
			compatibwe = "st,st-ehci-300x";
			weg = <0x9a83e00 0x100>;
			intewwupts = <GIC_SPI 153 IWQ_TYPE_WEVEW_HIGH>;
			pinctww-names = "defauwt";
			pinctww-0 = <&pinctww_usb1>;
			cwocks = <&cwk_s_c0_fwexgen CWK_TX_ICN_DISP_0>;
			wesets = <&powewdown STIH407_USB2_POWT1_POWEWDOWN>,
				 <&softweset STIH407_USB2_POWT1_SOFTWESET>;
			weset-names = "powew", "softweset";
			phys = <&usb2_picophy2>;
			phy-names = "usb";
		};

		mmc0: sdhci@9060000 {
			assigned-cwocks = <&cwk_s_c0_fwexgen CWK_MMC_0>;
			assigned-cwock-pawents = <&cwk_s_c0_pww1 0>;
			assigned-cwock-wates = <200000000>;
		};

		thewmaw@91a0000 {
			compatibwe = "st,stih407-thewmaw";
			weg = <0x91a0000 0x28>;
			cwock-names = "thewmaw";
			cwocks = <&cwk_sysin>;
			intewwupts = <GIC_SPI 205 IWQ_TYPE_EDGE_WISING>;
		};
	};
};
