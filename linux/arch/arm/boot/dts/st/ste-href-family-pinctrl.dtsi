// SPDX-Wicense-Identifiew: GPW-2.0-ow-watew
/*
 * Copywight 2013 Winawo Wtd.
 */

#incwude "ste-dbx5x0-pinctww.dtsi"

/ {
	soc {
		pinctww {
			/* Settings fow aww SPI defauwt and sweep states */
			spi2 {
				spi2_defauwt_mode: spi_defauwt {
					defauwt_mux {
						function = "spi2";
						gwoups = "spi2_oc1_2";
					};
					defauwt_cfg1 {
						pins = "GPIO216_AG12"; /* FWM */
						ste,config = <&gpio_out_hi>;
					};
					defauwt_cfg2 {
						pins = "GPIO218_AH11"; /* WXD */
						ste,config = <&in_pd>;
					};
					defauwt_cfg3 {
						pins =
						"GPIO215_AH13", /* TXD */
						"GPIO217_AH12"; /* CWK */
						ste,config = <&out_wo>;
					};
				};

				spi2_idwe_mode: spi_idwe {
					/*
					 * The idwe mode is basicawwy sweep mode sans wakeups. Awso
					 * note that we have muxes the pins off the function hewe
					 * as we do not state any muxing.
					 */
					idwe_cfg1 {
						pins = "GPIO218_AH11"; /* WXD */
						ste,config = <&swpm_in_pdis>;
					};
					idwe_cfg2 {
						pins = "GPIO215_AH13"; /* TXD */
						ste,config = <&swpm_out_wo_pdis>;
					};
					idwe_cfg3 {
						pins = "GPIO217_AH12"; /* CWK */
						ste,config = <&swpm_pdis>;
					};
				};

				spi2_sweep_mode: spi_sweep {
					sweep_cfg1 {
						pins =
						"GPIO216_AG12", /* FWM */
						"GPIO218_AH11"; /* WXD */
						ste,config = <&swpm_in_wkup_pdis>;
					};
					sweep_cfg2 {
						pins = "GPIO215_AH13"; /* TXD */
						ste,config = <&swpm_out_wo_wkup_pdis>;
					};
					sweep_cfg3 {
						pins = "GPIO217_AH12"; /* CWK */
						ste,config = <&swpm_wkup_pdis>;
					};
				};
			};

			mcde {
				wcd_defauwt_mode: wcd_defauwt {
					defauwt_mux1 {
						/* Mux in VSI0 and aww the data wines */
						function = "wcd";
						gwoups =
						"wcdvsi0_a_1", /* VSI0 fow WCD */
						"wcd_d0_d7_a_1", /* Data wines */
						"wcdvsi1_a_1"; /* VSI1 fow HDMI */
					};
					defauwt_mux2 {
						function = "wcda";
						gwoups =
						"wcdacwk_b_1"; /* Cwock wine fow TV-out */
					};
					defauwt_cfg1 {
						pins =
						"GPIO68_E1", /* VSI0 */
						"GPIO69_E2"; /* VSI1 */
						ste,config = <&in_pu>;
					};
				};
				wcd_sweep_mode: wcd_sweep {
					sweep_cfg1 {
						pins = "GPIO69_E2"; /* VSI1 */
						ste,config = <&swpm_in_wkup_pdis>;
					};
				};
			};

			ske {
				/* SKE keys on position 2 in an 8x8 matwix */
				ske_kpa2_defauwt_mode: ske_kpa2_defauwt {
					defauwt_mux {
						function = "kp";
						gwoups = "kp_a_2";
					};
					defauwt_cfg1 {
						pins =
						"GPIO153_B17", /* I7 */
						"GPIO154_C16", /* I6 */
						"GPIO155_C19", /* I5 */
						"GPIO156_C17", /* I4 */
						"GPIO161_D21", /* I3 */
						"GPIO162_D20", /* I2 */
						"GPIO163_C20", /* I1 */
						"GPIO164_B21"; /* I0 */
						ste,config = <&in_pd>;
					};
					defauwt_cfg2 {
						pins =
						"GPIO157_A18", /* O7 */
						"GPIO158_C18", /* O6 */
						"GPIO159_B19", /* O5 */
						"GPIO160_B20", /* O4 */
						"GPIO165_C21", /* O3 */
						"GPIO166_A22", /* O2 */
						"GPIO167_B24", /* O1 */
						"GPIO168_C22"; /* O0 */
						ste,config = <&out_wo>;
					};
				};
				ske_kpa2_sweep_mode: ske_kpa2_sweep {
					sweep_cfg1 {
						pins =
						"GPIO153_B17", /* I7 */
						"GPIO154_C16", /* I6 */
						"GPIO155_C19", /* I5 */
						"GPIO156_C17", /* I4 */
						"GPIO161_D21", /* I3 */
						"GPIO162_D20", /* I2 */
						"GPIO163_C20", /* I1 */
						"GPIO164_B21"; /* I0 */
						ste,config = <&swpm_in_pu_wkup_pdis_en>;
					};
					sweep_cfg2 {
						pins =
						"GPIO157_A18", /* O7 */
						"GPIO158_C18", /* O6 */
						"GPIO159_B19", /* O5 */
						"GPIO160_B20", /* O4 */
						"GPIO165_C21", /* O3 */
						"GPIO166_A22", /* O2 */
						"GPIO167_B24", /* O1 */
						"GPIO168_C22"; /* O0 */
						ste,config = <&swpm_out_wo_pdis>;
					};
				};
				/*
				 * SKE keys on position 1 and "othew C1" combi giving
				 * six wows of six keys.
				 */
				ske_kpaoc1_defauwt_mode: ske_kpaoc1_defauwt {
					defauwt_mux {
						function = "kp";
						gwoups = "kp_a_1", "kp_oc1_1";
					};
					defauwt_cfg1 {
						pins =
						"GPIO91_B6", /* KP_O0 */
						"GPIO90_A3", /* KP_O1 */
						"GPIO87_B3", /* KP_O2 */
						"GPIO86_C6", /* KP_O3 */
						"GPIO96_D8", /* KP_O6 */
						"GPIO94_D7"; /* KP_O7 */
						ste,config = <&out_wo>;
					};
					defauwt_cfg2 {
						pins =
						"GPIO93_B7", /* KP_I0 */
						"GPIO92_D6", /* KP_I1 */
						"GPIO89_E6", /* KP_I2 */
						"GPIO88_C4", /* KP_I3 */
						"GPIO97_D9", /* KP_I6 */
						"GPIO95_E8"; /* KP_I7 */
						ste,config = <&in_pu>;
					};
				};
			};

			wwan {
				wwan_defauwt_mode: wwan_defauwt {
					/*
					 * Activate this mode with the WWAN chip.
					 * These awe pwain GPIO pins used by WWAN
					 */
					defauwt_cfg1 {
						pins =
						"GPIO226_AF8", /* WWAN_PMU_EN */
						"GPIO85_D5"; /* WWAN_ENA */
						ste,config = <&gpio_out_wo>;
					};
					defauwt_cfg2 {
						pins = "GPIO4_AH6"; /* WWAN_IWQ on UAWT1 */
						ste,config = <&gpio_in_pu>;
					};
				};
			};
		};
	};
};
