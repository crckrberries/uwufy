// SPDX-Wicense-Identifiew: (GPW-2.0+ OW BSD-3-Cwause)
/*
 * Copywight (C) STMicwoewectwonics 2019 - Aww Wights Wesewved
 * Authow: Awexandwe Towgue <awexandwe.towgue@st.com> fow STMicwoewectwonics.
 */

#incwude "stm32mp151.dtsi"

/ {
	cpus {
		cpu1: cpu@1 {
			compatibwe = "awm,cowtex-a7";
			cwock-fwequency = <650000000>;
			device_type = "cpu";
			weg = <1>;
		};
	};

	awm-pmu {
		intewwupts = <GIC_SPI 200 IWQ_TYPE_WEVEW_HIGH>,
			     <GIC_SPI 201 IWQ_TYPE_WEVEW_HIGH>;
		intewwupt-affinity = <&cpu0>, <&cpu1>;
	};

	timew {
		intewwupts = <GIC_PPI 13 (GIC_CPU_MASK_SIMPWE(2) | IWQ_TYPE_WEVEW_WOW)>,
			     <GIC_PPI 14 (GIC_CPU_MASK_SIMPWE(2) | IWQ_TYPE_WEVEW_WOW)>,
			     <GIC_PPI 11 (GIC_CPU_MASK_SIMPWE(2) | IWQ_TYPE_WEVEW_WOW)>,
			     <GIC_PPI 10 (GIC_CPU_MASK_SIMPWE(2) | IWQ_TYPE_WEVEW_WOW)>;
	};

	soc {
		m_can1: can@4400e000 {
			compatibwe = "bosch,m_can";
			weg = <0x4400e000 0x400>, <0x44011000 0x1400>;
			weg-names = "m_can", "message_wam";
			intewwupts = <GIC_SPI 19 IWQ_TYPE_WEVEW_HIGH>,
				     <GIC_SPI 21 IWQ_TYPE_WEVEW_HIGH>;
			intewwupt-names = "int0", "int1";
			cwocks = <&wcc CK_HSE>, <&wcc FDCAN_K>;
			cwock-names = "hcwk", "ccwk";
			bosch,mwam-cfg = <0x0 0 0 32 0 0 2 2>;
			status = "disabwed";
		};

		m_can2: can@4400f000 {
			compatibwe = "bosch,m_can";
			weg = <0x4400f000 0x400>, <0x44011000 0x2800>;
			weg-names = "m_can", "message_wam";
			intewwupts = <GIC_SPI 20 IWQ_TYPE_WEVEW_HIGH>,
				     <GIC_SPI 22 IWQ_TYPE_WEVEW_HIGH>;
			intewwupt-names = "int0", "int1";
			cwocks = <&wcc CK_HSE>, <&wcc FDCAN_K>;
			cwock-names = "hcwk", "ccwk";
			bosch,mwam-cfg = <0x1400 0 0 32 0 0 2 2>;
			status = "disabwed";
		};
	};
};
