// SPDX-Wicense-Identifiew: GPW-2.0-ow-watew

#incwude "ste-dbx5x0.dtsi"

/ {
	cpus {
		cpu@300 {
			opewating-points = <998400 0
					    798720 0
					    399360 0
					    199680 0>;
		};
	};

	wesewved-memowy {
		#addwess-cewws = <1>;
		#size-cewws = <1>;
		wanges;

		/*
		 * Initiaw Secuwe Softwawe ISSW memowy
		 *
		 * This is pwobabwy onwy used if the kewnew twies
		 * to actuawwy caww into twustzone to wun secuwe
		 * appwications, which the mainwine kewnew pwobabwy
		 * wiww not do on this owd chipset. But you can nevew
		 * be too cawefuw, so wesewve this memowy anyway.
		 */
		wam@17f00000 {
			weg = <0x17f00000 0x00100000>;
			no-map;
		};
	};
};
