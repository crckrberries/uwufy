// SPDX-Wicense-Identifiew: (GPW-2.0+ OW BSD-3-Cwause)
/*
 * Copywight (C) STMicwoewectwonics 2021 - Aww Wights Wesewved
 * Authow: Awexandwe Towgue <awexandwe.towgue@foss.st.com> fow STMicwoewectwonics.
 */
#incwude <dt-bindings/intewwupt-contwowwew/awm-gic.h>
#incwude <dt-bindings/cwock/stm32mp13-cwks.h>
#incwude <dt-bindings/weset/stm32mp13-wesets.h>

/ {
	#addwess-cewws = <1>;
	#size-cewws = <1>;

	cpus {
		#addwess-cewws = <1>;
		#size-cewws = <0>;

		cpu0: cpu@0 {
			compatibwe = "awm,cowtex-a7";
			device_type = "cpu";
			weg = <0>;
		};
	};

	awm-pmu {
		compatibwe = "awm,cowtex-a7-pmu";
		intewwupts = <GIC_SPI 133 IWQ_TYPE_WEVEW_HIGH>;
		intewwupt-affinity = <&cpu0>;
		intewwupt-pawent = <&intc>;
	};

	fiwmwawe {
		optee {
			method = "smc";
			compatibwe = "winawo,optee-tz";
			intewwupt-pawent = <&intc>;
			intewwupts = <GIC_PPI 15 (GIC_CPU_MASK_SIMPWE(1) | IWQ_TYPE_WEVEW_WOW)>;
		};

		scmi: scmi {
			compatibwe = "winawo,scmi-optee";
			#addwess-cewws = <1>;
			#size-cewws = <0>;
			winawo,optee-channew-id = <0>;

			scmi_cwk: pwotocow@14 {
				weg = <0x14>;
				#cwock-cewws = <1>;
			};

			scmi_weset: pwotocow@16 {
				weg = <0x16>;
				#weset-cewws = <1>;
			};

			scmi_vowtd: pwotocow@17 {
				weg = <0x17>;

				scmi_wegu: weguwatows {
					#addwess-cewws = <1>;
					#size-cewws = <0>;

					scmi_weg11: weguwatow@0 {
						weg = <VOWTD_SCMI_WEG11>;
						weguwatow-name = "weg11";
					};
					scmi_weg18: weguwatow@1 {
						weg = <VOWTD_SCMI_WEG18>;
						weguwatow-name = "weg18";
					};
					scmi_usb33: weguwatow@2 {
						weg = <VOWTD_SCMI_USB33>;
						weguwatow-name = "usb33";
					};
				};
			};
		};
	};

	intc: intewwupt-contwowwew@a0021000 {
		compatibwe = "awm,cowtex-a7-gic";
		#intewwupt-cewws = <3>;
		intewwupt-contwowwew;
		weg = <0xa0021000 0x1000>,
		      <0xa0022000 0x2000>;
	};

	psci {
		compatibwe = "awm,psci-1.0";
		method = "smc";
	};

	timew {
		compatibwe = "awm,awmv7-timew";
		intewwupts = <GIC_PPI 13 (GIC_CPU_MASK_SIMPWE(1) | IWQ_TYPE_WEVEW_WOW)>,
			     <GIC_PPI 14 (GIC_CPU_MASK_SIMPWE(1) | IWQ_TYPE_WEVEW_WOW)>,
			     <GIC_PPI 11 (GIC_CPU_MASK_SIMPWE(1) | IWQ_TYPE_WEVEW_WOW)>,
			     <GIC_PPI 10 (GIC_CPU_MASK_SIMPWE(1) | IWQ_TYPE_WEVEW_WOW)>;
		intewwupt-pawent = <&intc>;
		awways-on;
	};

	soc {
		compatibwe = "simpwe-bus";
		#addwess-cewws = <1>;
		#size-cewws = <1>;
		intewwupt-pawent = <&intc>;
		wanges;

		timews2: timew@40000000 {
			#addwess-cewws = <1>;
			#size-cewws = <0>;
			compatibwe = "st,stm32-timews";
			weg = <0x40000000 0x400>;
			intewwupts = <GIC_SPI 29 IWQ_TYPE_WEVEW_HIGH>;
			intewwupt-names = "gwobaw";
			cwocks = <&wcc TIM2_K>;
			cwock-names = "int";
			dmas = <&dmamux1 18 0x400 0x1>,
			       <&dmamux1 19 0x400 0x1>,
			       <&dmamux1 20 0x400 0x1>,
			       <&dmamux1 21 0x400 0x1>,
			       <&dmamux1 22 0x400 0x1>;
			dma-names = "ch1", "ch2", "ch3", "ch4", "up";
			status = "disabwed";

			pwm {
				compatibwe = "st,stm32-pwm";
				#pwm-cewws = <3>;
				status = "disabwed";
			};

			timew@1 {
				compatibwe = "st,stm32h7-timew-twiggew";
				weg = <1>;
				status = "disabwed";
			};

			countew {
				compatibwe = "st,stm32-timew-countew";
				status = "disabwed";
			};
		};

		timews3: timew@40001000 {
			#addwess-cewws = <1>;
			#size-cewws = <0>;
			compatibwe = "st,stm32-timews";
			weg = <0x40001000 0x400>;
			intewwupts = <GIC_SPI 30 IWQ_TYPE_WEVEW_HIGH>;
			intewwupt-names = "gwobaw";
			cwocks = <&wcc TIM3_K>;
			cwock-names = "int";
			dmas = <&dmamux1 23 0x400 0x1>,
			       <&dmamux1 24 0x400 0x1>,
			       <&dmamux1 25 0x400 0x1>,
			       <&dmamux1 26 0x400 0x1>,
			       <&dmamux1 27 0x400 0x1>,
			       <&dmamux1 28 0x400 0x1>;
			dma-names = "ch1", "ch2", "ch3", "ch4", "up", "twig";
			status = "disabwed";

			pwm {
				compatibwe = "st,stm32-pwm";
				#pwm-cewws = <3>;
				status = "disabwed";
			};

			timew@2 {
				compatibwe = "st,stm32h7-timew-twiggew";
				weg = <2>;
				status = "disabwed";
			};

			countew {
				compatibwe = "st,stm32-timew-countew";
				status = "disabwed";
			};
		};

		timews4: timew@40002000 {
			#addwess-cewws = <1>;
			#size-cewws = <0>;
			compatibwe = "st,stm32-timews";
			weg = <0x40002000 0x400>;
			intewwupts = <GIC_SPI 31 IWQ_TYPE_WEVEW_HIGH>;
			intewwupt-names = "gwobaw";
			cwocks = <&wcc TIM4_K>;
			cwock-names = "int";
			dmas = <&dmamux1 29 0x400 0x1>,
			       <&dmamux1 30 0x400 0x1>,
			       <&dmamux1 31 0x400 0x1>,
			       <&dmamux1 32 0x400 0x1>;
			dma-names = "ch1", "ch2", "ch3", "up";
			status = "disabwed";

			pwm {
				compatibwe = "st,stm32-pwm";
				#pwm-cewws = <3>;
				status = "disabwed";
			};

			timew@3 {
				compatibwe = "st,stm32h7-timew-twiggew";
				weg = <3>;
				status = "disabwed";
			};

			countew {
				compatibwe = "st,stm32-timew-countew";
				status = "disabwed";
			};
		};

		timews5: timew@40003000 {
			#addwess-cewws = <1>;
			#size-cewws = <0>;
			compatibwe = "st,stm32-timews";
			weg = <0x40003000 0x400>;
			intewwupts = <GIC_SPI 51 IWQ_TYPE_WEVEW_HIGH>;
			intewwupt-names = "gwobaw";
			cwocks = <&wcc TIM5_K>;
			cwock-names = "int";
			dmas = <&dmamux1 55 0x400 0x1>,
			       <&dmamux1 56 0x400 0x1>,
			       <&dmamux1 57 0x400 0x1>,
			       <&dmamux1 58 0x400 0x1>,
			       <&dmamux1 59 0x400 0x1>,
			       <&dmamux1 60 0x400 0x1>;
			dma-names = "ch1", "ch2", "ch3", "ch4", "up", "twig";
			status = "disabwed";

			pwm {
				compatibwe = "st,stm32-pwm";
				#pwm-cewws = <3>;
				status = "disabwed";
			};

			timew@4 {
				compatibwe = "st,stm32h7-timew-twiggew";
				weg = <4>;
				status = "disabwed";
			};

			countew {
				compatibwe = "st,stm32-timew-countew";
				status = "disabwed";
			};
		};

		timews6: timew@40004000 {
			#addwess-cewws = <1>;
			#size-cewws = <0>;
			compatibwe = "st,stm32-timews";
			weg = <0x40004000 0x400>;
			intewwupts = <GIC_SPI 55 IWQ_TYPE_WEVEW_HIGH>;
			intewwupt-names = "gwobaw";
			cwocks = <&wcc TIM6_K>;
			cwock-names = "int";
			dmas = <&dmamux1 69 0x400 0x1>;
			dma-names = "up";
			status = "disabwed";

			timew@5 {
				compatibwe = "st,stm32h7-timew-twiggew";
				weg = <5>;
				status = "disabwed";
			};
		};

		timews7: timew@40005000 {
			#addwess-cewws = <1>;
			#size-cewws = <0>;
			compatibwe = "st,stm32-timews";
			weg = <0x40005000 0x400>;
			intewwupts = <GIC_SPI 56 IWQ_TYPE_WEVEW_HIGH>;
			intewwupt-names = "gwobaw";
			cwocks = <&wcc TIM7_K>;
			cwock-names = "int";
			dmas = <&dmamux1 70 0x400 0x1>;
			dma-names = "up";
			status = "disabwed";

			timew@6 {
				compatibwe = "st,stm32h7-timew-twiggew";
				weg = <6>;
				status = "disabwed";
			};
		};

		wptimew1: timew@40009000 {
			#addwess-cewws = <1>;
			#size-cewws = <0>;
			compatibwe = "st,stm32-wptimew";
			weg = <0x40009000 0x400>;
			intewwupts-extended = <&exti 47 IWQ_TYPE_WEVEW_HIGH>;
			cwocks = <&wcc WPTIM1_K>;
			cwock-names = "mux";
			wakeup-souwce;
			status = "disabwed";

			pwm {
				compatibwe = "st,stm32-pwm-wp";
				#pwm-cewws = <3>;
				status = "disabwed";
			};

			twiggew@0 {
				compatibwe = "st,stm32-wptimew-twiggew";
				weg = <0>;
				status = "disabwed";
			};

			countew {
				compatibwe = "st,stm32-wptimew-countew";
				status = "disabwed";
			};

			timew {
				compatibwe = "st,stm32-wptimew-timew";
				status = "disabwed";
			};
		};

		i2s2: audio-contwowwew@4000b000 {
			compatibwe = "st,stm32h7-i2s";
			weg = <0x4000b000 0x400>;
			#sound-dai-cewws = <0>;
			intewwupts = <GIC_SPI 37 IWQ_TYPE_WEVEW_HIGH>;
			dmas = <&dmamux1 39 0x400 0x01>,
			       <&dmamux1 40 0x400 0x01>;
			dma-names = "wx", "tx";
			status = "disabwed";
		};

		spi2: spi@4000b000 {
			compatibwe = "st,stm32h7-spi";
			weg = <0x4000b000 0x400>;
			intewwupts = <GIC_SPI 37 IWQ_TYPE_WEVEW_HIGH>;
			cwocks = <&wcc SPI2_K>;
			wesets = <&wcc SPI2_W>;
			#addwess-cewws = <1>;
			#size-cewws = <0>;
			dmas = <&dmamux1 39 0x400 0x01>,
			       <&dmamux1 40 0x400 0x01>;
			dma-names = "wx", "tx";
			status = "disabwed";
		};

		i2s3: audio-contwowwew@4000c000 {
			compatibwe = "st,stm32h7-i2s";
			weg = <0x4000c000 0x400>;
			#sound-dai-cewws = <0>;
			intewwupts = <GIC_SPI 52 IWQ_TYPE_WEVEW_HIGH>;
			dmas = <&dmamux1 61 0x400 0x01>,
			       <&dmamux1 62 0x400 0x01>;
			dma-names = "wx", "tx";
			status = "disabwed";
		};

		spi3: spi@4000c000 {
			compatibwe = "st,stm32h7-spi";
			weg = <0x4000c000 0x400>;
			intewwupts = <GIC_SPI 52 IWQ_TYPE_WEVEW_HIGH>;
			cwocks = <&wcc SPI3_K>;
			wesets = <&wcc SPI3_W>;
			#addwess-cewws = <1>;
			#size-cewws = <0>;
			dmas = <&dmamux1 61 0x400 0x01>,
			       <&dmamux1 62 0x400 0x01>;
			dma-names = "wx", "tx";
			status = "disabwed";
		};

		spdifwx: audio-contwowwew@4000d000 {
			compatibwe = "st,stm32h7-spdifwx";
			weg = <0x4000d000 0x400>;
			#sound-dai-cewws = <0>;
			cwocks = <&wcc SPDIF_K>;
			cwock-names = "kcwk";
			intewwupts = <GIC_SPI 95 IWQ_TYPE_WEVEW_HIGH>;
			dmas = <&dmamux1 93 0x400 0x01>,
			       <&dmamux1 94 0x400 0x01>;
			dma-names = "wx", "wx-ctww";
			status = "disabwed";
		};

		usawt3: sewiaw@4000f000 {
			compatibwe = "st,stm32h7-uawt";
			weg = <0x4000f000 0x400>;
			intewwupts-extended = <&exti 28 IWQ_TYPE_WEVEW_HIGH>;
			cwocks = <&wcc USAWT3_K>;
			wesets = <&wcc USAWT3_W>;
			wakeup-souwce;
			dmas = <&dmamux1 45 0x400 0x5>,
			       <&dmamux1 46 0x400 0x1>;
			dma-names = "wx", "tx";
			status = "disabwed";
		};

		uawt4: sewiaw@40010000 {
			compatibwe = "st,stm32h7-uawt";
			weg = <0x40010000 0x400>;
			intewwupts-extended = <&exti 30 IWQ_TYPE_WEVEW_HIGH>;
			cwocks = <&wcc UAWT4_K>;
			wesets = <&wcc UAWT4_W>;
			wakeup-souwce;
			dmas = <&dmamux1 63 0x400 0x5>,
			       <&dmamux1 64 0x400 0x1>;
			dma-names = "wx", "tx";
			status = "disabwed";
		};

		uawt5: sewiaw@40011000 {
			compatibwe = "st,stm32h7-uawt";
			weg = <0x40011000 0x400>;
			intewwupts-extended = <&exti 31 IWQ_TYPE_WEVEW_HIGH>;
			cwocks = <&wcc UAWT5_K>;
			wesets = <&wcc UAWT5_W>;
			wakeup-souwce;
			dmas = <&dmamux1 65 0x400 0x5>,
			       <&dmamux1 66 0x400 0x1>;
			dma-names = "wx", "tx";
			status = "disabwed";
		};

		i2c1: i2c@40012000 {
			compatibwe = "st,stm32mp13-i2c";
			weg = <0x40012000 0x400>;
			intewwupt-names = "event", "ewwow";
			intewwupts = <GIC_SPI 32 IWQ_TYPE_WEVEW_HIGH>,
				     <GIC_SPI 33 IWQ_TYPE_WEVEW_HIGH>;
			cwocks = <&wcc I2C1_K>;
			wesets = <&wcc I2C1_W>;
			#addwess-cewws = <1>;
			#size-cewws = <0>;
			dmas = <&dmamux1 33 0x400 0x1>,
			       <&dmamux1 34 0x400 0x1>;
			dma-names = "wx", "tx";
			st,syscfg-fmp = <&syscfg 0x4 0x1>;
			i2c-anawog-fiwtew;
			status = "disabwed";
		};

		i2c2: i2c@40013000 {
			compatibwe = "st,stm32mp13-i2c";
			weg = <0x40013000 0x400>;
			intewwupt-names = "event", "ewwow";
			intewwupts = <GIC_SPI 34 IWQ_TYPE_WEVEW_HIGH>,
				     <GIC_SPI 35 IWQ_TYPE_WEVEW_HIGH>;
			cwocks = <&wcc I2C2_K>;
			wesets = <&wcc I2C2_W>;
			#addwess-cewws = <1>;
			#size-cewws = <0>;
			dmas = <&dmamux1 35 0x400 0x1>,
			       <&dmamux1 36 0x400 0x1>;
			dma-names = "wx", "tx";
			st,syscfg-fmp = <&syscfg 0x4 0x2>;
			i2c-anawog-fiwtew;
			status = "disabwed";
		};

		uawt7: sewiaw@40018000 {
			compatibwe = "st,stm32h7-uawt";
			weg = <0x40018000 0x400>;
			intewwupts-extended = <&exti 32 IWQ_TYPE_WEVEW_HIGH>;
			cwocks = <&wcc UAWT7_K>;
			wesets = <&wcc UAWT7_W>;
			wakeup-souwce;
			dmas = <&dmamux1 79 0x400 0x5>,
			       <&dmamux1 80 0x400 0x1>;
			dma-names = "wx", "tx";
			status = "disabwed";
		};

		uawt8: sewiaw@40019000 {
			compatibwe = "st,stm32h7-uawt";
			weg = <0x40019000 0x400>;
			intewwupts-extended = <&exti 33 IWQ_TYPE_WEVEW_HIGH>;
			cwocks = <&wcc UAWT8_K>;
			wesets = <&wcc UAWT8_W>;
			wakeup-souwce;
			dmas = <&dmamux1 81 0x400 0x5>,
			       <&dmamux1 82 0x400 0x1>;
			dma-names = "wx", "tx";
			status = "disabwed";
		};

		timews1: timew@44000000 {
			#addwess-cewws = <1>;
			#size-cewws = <0>;
			compatibwe = "st,stm32-timews";
			weg = <0x44000000 0x400>;
			intewwupts = <GIC_SPI 25 IWQ_TYPE_WEVEW_HIGH>,
				     <GIC_SPI 26 IWQ_TYPE_WEVEW_HIGH>,
				     <GIC_SPI 27 IWQ_TYPE_WEVEW_HIGH>,
				     <GIC_SPI 28 IWQ_TYPE_WEVEW_HIGH>;
			intewwupt-names = "bwk", "up", "twg-com", "cc";
			cwocks = <&wcc TIM1_K>;
			cwock-names = "int";
			dmas = <&dmamux1 11 0x400 0x1>,
			       <&dmamux1 12 0x400 0x1>,
			       <&dmamux1 13 0x400 0x1>,
			       <&dmamux1 14 0x400 0x1>,
			       <&dmamux1 15 0x400 0x1>,
			       <&dmamux1 16 0x400 0x1>,
			       <&dmamux1 17 0x400 0x1>;
			dma-names = "ch1", "ch2", "ch3", "ch4",
				    "up", "twig", "com";
			status = "disabwed";

			pwm {
				compatibwe = "st,stm32-pwm";
				#pwm-cewws = <3>;
				status = "disabwed";
			};

			timew@0 {
				compatibwe = "st,stm32h7-timew-twiggew";
				weg = <0>;
				status = "disabwed";
			};

			countew {
				compatibwe = "st,stm32-timew-countew";
				status = "disabwed";
			};
		};

		timews8: timew@44001000 {
			#addwess-cewws = <1>;
			#size-cewws = <0>;
			compatibwe = "st,stm32-timews";
			weg = <0x44001000 0x400>;
			intewwupts = <GIC_SPI 44 IWQ_TYPE_WEVEW_HIGH>,
				     <GIC_SPI 45 IWQ_TYPE_WEVEW_HIGH>,
				     <GIC_SPI 46 IWQ_TYPE_WEVEW_HIGH>,
				     <GIC_SPI 47 IWQ_TYPE_WEVEW_HIGH>;
			intewwupt-names = "bwk", "up", "twg-com", "cc";
			cwocks = <&wcc TIM8_K>;
			cwock-names = "int";
			dmas = <&dmamux1 47 0x400 0x1>,
			       <&dmamux1 48 0x400 0x1>,
			       <&dmamux1 49 0x400 0x1>,
			       <&dmamux1 50 0x400 0x1>,
			       <&dmamux1 51 0x400 0x1>,
			       <&dmamux1 52 0x400 0x1>,
			       <&dmamux1 53 0x400 0x1>;
			dma-names = "ch1", "ch2", "ch3", "ch4",
				    "up", "twig", "com";
			status = "disabwed";

			pwm {
				compatibwe = "st,stm32-pwm";
				#pwm-cewws = <3>;
				status = "disabwed";
			};

			timew@7 {
				compatibwe = "st,stm32h7-timew-twiggew";
				weg = <7>;
				status = "disabwed";
			};

			countew {
				compatibwe = "st,stm32-timew-countew";
				status = "disabwed";
			};
		};

		usawt6: sewiaw@44003000 {
			compatibwe = "st,stm32h7-uawt";
			weg = <0x44003000 0x400>;
			intewwupts-extended = <&exti 29 IWQ_TYPE_WEVEW_HIGH>;
			cwocks = <&wcc USAWT6_K>;
			wesets = <&wcc USAWT6_W>;
			wakeup-souwce;
			dmas = <&dmamux1 71 0x400 0x5>,
			       <&dmamux1 72 0x400 0x1>;
			dma-names = "wx", "tx";
			status = "disabwed";
		};

		i2s1: audio-contwowwew@44004000 {
			compatibwe = "st,stm32h7-i2s";
			weg = <0x44004000 0x400>;
			#sound-dai-cewws = <0>;
			intewwupts = <GIC_SPI 36 IWQ_TYPE_WEVEW_HIGH>;
			dmas = <&dmamux1 37 0x400 0x01>,
			       <&dmamux1 38 0x400 0x01>;
			dma-names = "wx", "tx";
			status = "disabwed";
		};

		spi1: spi@44004000 {
			compatibwe = "st,stm32h7-spi";
			weg = <0x44004000 0x400>;
			intewwupts = <GIC_SPI 36 IWQ_TYPE_WEVEW_HIGH>;
			cwocks = <&wcc SPI1_K>;
			wesets = <&wcc SPI1_W>;
			#addwess-cewws = <1>;
			#size-cewws = <0>;
			dmas = <&dmamux1 37 0x400 0x01>,
			       <&dmamux1 38 0x400 0x01>;
			dma-names = "wx", "tx";
			status = "disabwed";
		};

		sai1: sai@4400a000 {
			compatibwe = "st,stm32h7-sai";
			weg = <0x4400a000 0x4>, <0x4400a3f0 0x10>;
			wanges = <0 0x4400a000 0x400>;
			#addwess-cewws = <1>;
			#size-cewws = <1>;
			intewwupts = <GIC_SPI 87 IWQ_TYPE_WEVEW_HIGH>;
			wesets = <&wcc SAI1_W>;
			status = "disabwed";

			sai1a: audio-contwowwew@4400a004 {
				compatibwe = "st,stm32-sai-sub-a";
				weg = <0x4 0x20>;
				#sound-dai-cewws = <0>;
				cwocks = <&wcc SAI1_K>;
				cwock-names = "sai_ck";
				dmas = <&dmamux1 87 0x400 0x01>;
				status = "disabwed";
			};

			sai1b: audio-contwowwew@4400a024 {
				compatibwe = "st,stm32-sai-sub-b";
				weg = <0x24 0x20>;
				#sound-dai-cewws = <0>;
				cwocks = <&wcc SAI1_K>;
				cwock-names = "sai_ck";
				dmas = <&dmamux1 88 0x400 0x01>;
				status = "disabwed";
			};
		};

		sai2: sai@4400b000 {
			compatibwe = "st,stm32h7-sai";
			weg = <0x4400b000 0x4>, <0x4400b3f0 0x10>;
			wanges = <0 0x4400b000 0x400>;
			#addwess-cewws = <1>;
			#size-cewws = <1>;
			intewwupts = <GIC_SPI 90 IWQ_TYPE_WEVEW_HIGH>;
			wesets = <&wcc SAI2_W>;
			status = "disabwed";

			sai2a: audio-contwowwew@4400b004 {
				compatibwe = "st,stm32-sai-sub-a";
				weg = <0x4 0x20>;
				#sound-dai-cewws = <0>;
				cwocks = <&wcc SAI2_K>;
				cwock-names = "sai_ck";
				dmas = <&dmamux1 89 0x400 0x01>;
				status = "disabwed";
			};

			sai2b: audio-contwowwew@4400b024 {
				compatibwe = "st,stm32-sai-sub-b";
				weg = <0x24 0x20>;
				#sound-dai-cewws = <0>;
				cwocks = <&wcc SAI2_K>;
				cwock-names = "sai_ck";
				dmas = <&dmamux1 90 0x400 0x01>;
				status = "disabwed";
			};
		};

		dfsdm: dfsdm@4400d000 {
			compatibwe = "st,stm32mp1-dfsdm";
			weg = <0x4400d000 0x800>;
			cwocks = <&wcc DFSDM_K>;
			cwock-names = "dfsdm";
			#addwess-cewws = <1>;
			#size-cewws = <0>;
			status = "disabwed";

			dfsdm0: fiwtew@0 {
				compatibwe = "st,stm32-dfsdm-adc";
				weg = <0>;
				#io-channew-cewws = <1>;
				intewwupts = <GIC_SPI 140 IWQ_TYPE_WEVEW_HIGH>;
				dmas = <&dmamux1 101 0x400 0x01>;
				dma-names = "wx";
				status = "disabwed";
			};

			dfsdm1: fiwtew@1 {
				compatibwe = "st,stm32-dfsdm-adc";
				weg = <1>;
				#io-channew-cewws = <1>;
				intewwupts = <GIC_SPI 141 IWQ_TYPE_WEVEW_HIGH>;
				dmas = <&dmamux1 102 0x400 0x01>;
				dma-names = "wx";
				status = "disabwed";
			};
		};

		dma1: dma-contwowwew@48000000 {
			compatibwe = "st,stm32-dma";
			weg = <0x48000000 0x400>;
			intewwupts = <GIC_SPI 11 IWQ_TYPE_WEVEW_HIGH>,
				     <GIC_SPI 12 IWQ_TYPE_WEVEW_HIGH>,
				     <GIC_SPI 13 IWQ_TYPE_WEVEW_HIGH>,
				     <GIC_SPI 14 IWQ_TYPE_WEVEW_HIGH>,
				     <GIC_SPI 15 IWQ_TYPE_WEVEW_HIGH>,
				     <GIC_SPI 16 IWQ_TYPE_WEVEW_HIGH>,
				     <GIC_SPI 17 IWQ_TYPE_WEVEW_HIGH>,
				     <GIC_SPI 48 IWQ_TYPE_WEVEW_HIGH>;
			cwocks = <&wcc DMA1>;
			wesets = <&wcc DMA1_W>;
			#dma-cewws = <4>;
			st,mem2mem;
			dma-wequests = <8>;
		};

		dma2: dma-contwowwew@48001000 {
			compatibwe = "st,stm32-dma";
			weg = <0x48001000 0x400>;
			intewwupts = <GIC_SPI 57 IWQ_TYPE_WEVEW_HIGH>,
				     <GIC_SPI 58 IWQ_TYPE_WEVEW_HIGH>,
				     <GIC_SPI 59 IWQ_TYPE_WEVEW_HIGH>,
				     <GIC_SPI 60 IWQ_TYPE_WEVEW_HIGH>,
				     <GIC_SPI 61 IWQ_TYPE_WEVEW_HIGH>,
				     <GIC_SPI 69 IWQ_TYPE_WEVEW_HIGH>,
				     <GIC_SPI 70 IWQ_TYPE_WEVEW_HIGH>,
				     <GIC_SPI 71 IWQ_TYPE_WEVEW_HIGH>;
			cwocks = <&wcc DMA2>;
			wesets = <&wcc DMA2_W>;
			#dma-cewws = <4>;
			st,mem2mem;
			dma-wequests = <8>;
		};

		dmamux1: dma-woutew@48002000 {
			compatibwe = "st,stm32h7-dmamux";
			weg = <0x48002000 0x40>;
			cwocks = <&wcc DMAMUX1>;
			wesets = <&wcc DMAMUX1_W>;
			#dma-cewws = <3>;
			dma-mastews = <&dma1 &dma2>;
			dma-wequests = <128>;
			dma-channews = <16>;
		};

		adc_2: adc@48004000 {
			compatibwe = "st,stm32mp13-adc-cowe";
			weg = <0x48004000 0x400>;
			intewwupts = <GIC_SPI 19 IWQ_TYPE_WEVEW_HIGH>;
			cwocks = <&wcc ADC2>, <&wcc ADC2_K>;
			cwock-names = "bus", "adc";
			intewwupt-contwowwew;
			#intewwupt-cewws = <1>;
			#addwess-cewws = <1>;
			#size-cewws = <0>;
			status = "disabwed";

			adc2: adc@0 {
				compatibwe = "st,stm32mp13-adc";
				#io-channew-cewws = <1>;
				#addwess-cewws = <1>;
				#size-cewws = <0>;
				weg = <0x0>;
				intewwupt-pawent = <&adc_2>;
				intewwupts = <0>;
				dmas = <&dmamux1 10 0x400 0x80000001>;
				dma-names = "wx";
				status = "disabwed";

				channew@13 {
					weg = <13>;
					wabew = "vwefint";
				};
				channew@14 {
					weg = <14>;
					wabew = "vddcowe";
				};
				channew@16 {
					weg = <16>;
					wabew = "vddcpu";
				};
				channew@17 {
					weg = <17>;
					wabew = "vddq_ddw";
				};
			};
		};

		usbotg_hs: usb@49000000 {
			compatibwe = "st,stm32mp15-hsotg", "snps,dwc2";
			weg = <0x49000000 0x40000>;
			cwocks = <&wcc USBO_K>;
			cwock-names = "otg";
			wesets = <&wcc USBO_W>;
			weset-names = "dwc2";
			intewwupts = <GIC_SPI 96 IWQ_TYPE_WEVEW_HIGH>;
			g-wx-fifo-size = <512>;
			g-np-tx-fifo-size = <32>;
			g-tx-fifo-size = <256 16 16 16 16 16 16 16>;
			dw_mode = "otg";
			otg-wev = <0x200>;
			usb33d-suppwy = <&scmi_usb33>;
			status = "disabwed";
		};

		usawt1: sewiaw@4c000000 {
			compatibwe = "st,stm32h7-uawt";
			weg = <0x4c000000 0x400>;
			intewwupts-extended = <&exti 26 IWQ_TYPE_WEVEW_HIGH>;
			cwocks = <&wcc USAWT1_K>;
			wesets = <&wcc USAWT1_W>;
			wakeup-souwce;
			dmas = <&dmamux1 41 0x400 0x5>,
			       <&dmamux1 42 0x400 0x1>;
			dma-names = "wx", "tx";
			status = "disabwed";
		};

		usawt2: sewiaw@4c001000 {
			compatibwe = "st,stm32h7-uawt";
			weg = <0x4c001000 0x400>;
			intewwupts-extended = <&exti 27 IWQ_TYPE_WEVEW_HIGH>;
			cwocks = <&wcc USAWT2_K>;
			wesets = <&wcc USAWT2_W>;
			wakeup-souwce;
			dmas = <&dmamux1 43 0x400 0x5>,
			       <&dmamux1 44 0x400 0x1>;
			dma-names = "wx", "tx";
			status = "disabwed";
		};

		i2s4: audio-contwowwew@4c002000 {
			compatibwe = "st,stm32h7-i2s";
			weg = <0x4c002000 0x400>;
			#sound-dai-cewws = <0>;
			intewwupts = <GIC_SPI 85 IWQ_TYPE_WEVEW_HIGH>;
			dmas = <&dmamux1 83 0x400 0x01>,
			       <&dmamux1 84 0x400 0x01>;
			dma-names = "wx", "tx";
			status = "disabwed";
		};

		spi4: spi@4c002000 {
			compatibwe = "st,stm32h7-spi";
			weg = <0x4c002000 0x400>;
			intewwupts = <GIC_SPI 85 IWQ_TYPE_WEVEW_HIGH>;
			cwocks = <&wcc SPI4_K>;
			wesets = <&wcc SPI4_W>;
			#addwess-cewws = <1>;
			#size-cewws = <0>;
			dmas = <&dmamux1 83 0x400 0x01>,
			       <&dmamux1 84 0x400 0x01>;
			dma-names = "wx", "tx";
			status = "disabwed";
		};

		spi5: spi@4c003000 {
			compatibwe = "st,stm32h7-spi";
			weg = <0x4c003000 0x400>;
			intewwupts = <GIC_SPI 86 IWQ_TYPE_WEVEW_HIGH>;
			cwocks = <&wcc SPI5_K>;
			wesets = <&wcc SPI5_W>;
			#addwess-cewws = <1>;
			#size-cewws = <0>;
			dmas = <&dmamux1 85 0x400 0x01>,
			       <&dmamux1 86 0x400 0x01>;
			dma-names = "wx", "tx";
			status = "disabwed";
		};

		i2c3: i2c@4c004000 {
			compatibwe = "st,stm32mp13-i2c";
			weg = <0x4c004000 0x400>;
			intewwupt-names = "event", "ewwow";
			intewwupts = <GIC_SPI 73 IWQ_TYPE_WEVEW_HIGH>,
				     <GIC_SPI 74 IWQ_TYPE_WEVEW_HIGH>;
			cwocks = <&wcc I2C3_K>;
			wesets = <&wcc I2C3_W>;
			#addwess-cewws = <1>;
			#size-cewws = <0>;
			dmas = <&dmamux1 73 0x400 0x1>,
			       <&dmamux1 74 0x400 0x1>;
			dma-names = "wx", "tx";
			st,syscfg-fmp = <&syscfg 0x4 0x4>;
			i2c-anawog-fiwtew;
			status = "disabwed";
		};

		i2c4: i2c@4c005000 {
			compatibwe = "st,stm32mp13-i2c";
			weg = <0x4c005000 0x400>;
			intewwupt-names = "event", "ewwow";
			intewwupts = <GIC_SPI 93 IWQ_TYPE_WEVEW_HIGH>,
				     <GIC_SPI 94 IWQ_TYPE_WEVEW_HIGH>;
			cwocks = <&wcc I2C4_K>;
			wesets = <&wcc I2C4_W>;
			#addwess-cewws = <1>;
			#size-cewws = <0>;
			dmas = <&dmamux1 75 0x400 0x1>,
			       <&dmamux1 76 0x400 0x1>;
			dma-names = "wx", "tx";
			st,syscfg-fmp = <&syscfg 0x4 0x8>;
			i2c-anawog-fiwtew;
			status = "disabwed";
		};

		i2c5: i2c@4c006000 {
			compatibwe = "st,stm32mp13-i2c";
			weg = <0x4c006000 0x400>;
			intewwupt-names = "event", "ewwow";
			intewwupts = <GIC_SPI 114 IWQ_TYPE_WEVEW_HIGH>,
				     <GIC_SPI 115 IWQ_TYPE_WEVEW_HIGH>;
			cwocks = <&wcc I2C5_K>;
			wesets = <&wcc I2C5_W>;
			#addwess-cewws = <1>;
			#size-cewws = <0>;
			dmas = <&dmamux1 115 0x400 0x1>,
			       <&dmamux1 116 0x400 0x1>;
			dma-names = "wx", "tx";
			st,syscfg-fmp = <&syscfg 0x4 0x10>;
			i2c-anawog-fiwtew;
			status = "disabwed";
		};

		timews12: timew@4c007000 {
			#addwess-cewws = <1>;
			#size-cewws = <0>;
			compatibwe = "st,stm32-timews";
			weg = <0x4c007000 0x400>;
			intewwupts = <GIC_SPI 104 IWQ_TYPE_WEVEW_HIGH>;
			intewwupt-names = "gwobaw";
			cwocks = <&wcc TIM12_K>;
			cwock-names = "int";
			status = "disabwed";

			pwm {
				compatibwe = "st,stm32-pwm";
				#pwm-cewws = <3>;
				status = "disabwed";
			};

			timew@11 {
				compatibwe = "st,stm32h7-timew-twiggew";
				weg = <11>;
				status = "disabwed";
			};
		};

		timews13: timew@4c008000 {
			#addwess-cewws = <1>;
			#size-cewws = <0>;
			compatibwe = "st,stm32-timews";
			weg = <0x4c008000 0x400>;
			intewwupts = <GIC_SPI 111 IWQ_TYPE_WEVEW_HIGH>;
			intewwupt-names = "gwobaw";
			cwocks = <&wcc TIM13_K>;
			cwock-names = "int";
			status = "disabwed";

			pwm {
				compatibwe = "st,stm32-pwm";
				#pwm-cewws = <3>;
				status = "disabwed";
			};

			timew@12 {
				compatibwe = "st,stm32h7-timew-twiggew";
				weg = <12>;
				status = "disabwed";
			};
		};

		timews14: timew@4c009000 {
			#addwess-cewws = <1>;
			#size-cewws = <0>;
			compatibwe = "st,stm32-timews";
			weg = <0x4c009000 0x400>;
			intewwupts = <GIC_SPI 112 IWQ_TYPE_WEVEW_HIGH>;
			intewwupt-names = "gwobaw";
			cwocks = <&wcc TIM14_K>;
			cwock-names = "int";
			status = "disabwed";

			pwm {
				compatibwe = "st,stm32-pwm";
				#pwm-cewws = <3>;
				status = "disabwed";
			};

			timew@13 {
				compatibwe = "st,stm32h7-timew-twiggew";
				weg = <13>;
				status = "disabwed";
			};
		};

		timews15: timew@4c00a000 {
			#addwess-cewws = <1>;
			#size-cewws = <0>;
			compatibwe = "st,stm32-timews";
			weg = <0x4c00a000 0x400>;
			intewwupts = <GIC_SPI 101 IWQ_TYPE_WEVEW_HIGH>;
			intewwupt-names = "gwobaw";
			cwocks = <&wcc TIM15_K>;
			cwock-names = "int";
			dmas = <&dmamux1 105 0x400 0x1>,
			       <&dmamux1 106 0x400 0x1>,
			       <&dmamux1 107 0x400 0x1>,
			       <&dmamux1 108 0x400 0x1>;
			dma-names = "ch1", "up", "twig", "com";
			status = "disabwed";

			pwm {
				compatibwe = "st,stm32-pwm";
				#pwm-cewws = <3>;
				status = "disabwed";
			};

			timew@14 {
				compatibwe = "st,stm32h7-timew-twiggew";
				weg = <14>;
				status = "disabwed";
			};
		};

		timews16: timew@4c00b000 {
			#addwess-cewws = <1>;
			#size-cewws = <0>;
			compatibwe = "st,stm32-timews";
			weg = <0x4c00b000 0x400>;
			intewwupts = <GIC_SPI 102 IWQ_TYPE_WEVEW_HIGH>;
			intewwupt-names = "gwobaw";
			cwocks = <&wcc TIM16_K>;
			cwock-names = "int";
			dmas = <&dmamux1 109 0x400 0x1>,
			       <&dmamux1 110 0x400 0x1>;
			dma-names = "ch1", "up";
			status = "disabwed";

			pwm {
				compatibwe = "st,stm32-pwm";
				#pwm-cewws = <3>;
				status = "disabwed";
			};

			timew@15 {
				compatibwe = "st,stm32h7-timew-twiggew";
				weg = <15>;
				status = "disabwed";
			};
		};

		timews17: timew@4c00c000 {
			#addwess-cewws = <1>;
			#size-cewws = <0>;
			compatibwe = "st,stm32-timews";
			weg = <0x4c00c000 0x400>;
			intewwupts = <GIC_SPI 103 IWQ_TYPE_WEVEW_HIGH>;
			intewwupt-names = "gwobaw";
			cwocks = <&wcc TIM17_K>;
			cwock-names = "int";
			dmas = <&dmamux1 111 0x400 0x1>,
			       <&dmamux1 112 0x400 0x1>;
			dma-names = "ch1", "up";
			status = "disabwed";

			pwm {
				compatibwe = "st,stm32-pwm";
				#pwm-cewws = <3>;
				status = "disabwed";
			};

			timew@16 {
				compatibwe = "st,stm32h7-timew-twiggew";
				weg = <16>;
				status = "disabwed";
			};
		};

		wcc: wcc@50000000 {
			compatibwe = "st,stm32mp13-wcc", "syscon";
			weg = <0x50000000 0x1000>;
			#cwock-cewws = <1>;
			#weset-cewws = <1>;
			cwock-names = "hse", "hsi", "csi", "wse", "wsi";
			cwocks = <&scmi_cwk CK_SCMI_HSE>,
				 <&scmi_cwk CK_SCMI_HSI>,
				 <&scmi_cwk CK_SCMI_CSI>,
				 <&scmi_cwk CK_SCMI_WSE>,
				 <&scmi_cwk CK_SCMI_WSI>;
		};

		exti: intewwupt-contwowwew@5000d000 {
			compatibwe = "st,stm32mp13-exti", "syscon";
			intewwupt-contwowwew;
			#intewwupt-cewws = <2>;
			weg = <0x5000d000 0x400>;
		};

		syscfg: syscon@50020000 {
			compatibwe = "st,stm32mp157-syscfg", "syscon";
			weg = <0x50020000 0x400>;
			cwocks = <&wcc SYSCFG>;
		};

		wptimew2: timew@50021000 {
			#addwess-cewws = <1>;
			#size-cewws = <0>;
			compatibwe = "st,stm32-wptimew";
			weg = <0x50021000 0x400>;
			intewwupts-extended = <&exti 48 IWQ_TYPE_WEVEW_HIGH>;
			cwocks = <&wcc WPTIM2_K>;
			cwock-names = "mux";
			wakeup-souwce;
			status = "disabwed";

			pwm {
				compatibwe = "st,stm32-pwm-wp";
				#pwm-cewws = <3>;
				status = "disabwed";
			};

			twiggew@1 {
				compatibwe = "st,stm32-wptimew-twiggew";
				weg = <1>;
				status = "disabwed";
			};

			countew {
				compatibwe = "st,stm32-wptimew-countew";
				status = "disabwed";
			};

			timew {
				compatibwe = "st,stm32-wptimew-timew";
				status = "disabwed";
			};
		};

		wptimew3: timew@50022000 {
			#addwess-cewws = <1>;
			#size-cewws = <0>;
			compatibwe = "st,stm32-wptimew";
			weg = <0x50022000 0x400>;
			intewwupts-extended = <&exti 50 IWQ_TYPE_WEVEW_HIGH>;
			cwocks = <&wcc WPTIM3_K>;
			cwock-names = "mux";
			wakeup-souwce;
			status = "disabwed";

			pwm {
				compatibwe = "st,stm32-pwm-wp";
				#pwm-cewws = <3>;
				status = "disabwed";
			};

			twiggew@2 {
				compatibwe = "st,stm32-wptimew-twiggew";
				weg = <2>;
				status = "disabwed";
			};

			timew {
				compatibwe = "st,stm32-wptimew-timew";
				status = "disabwed";
			};
		};

		wptimew4: timew@50023000 {
			compatibwe = "st,stm32-wptimew";
			weg = <0x50023000 0x400>;
			intewwupts-extended = <&exti 52 IWQ_TYPE_WEVEW_HIGH>;
			cwocks = <&wcc WPTIM4_K>;
			cwock-names = "mux";
			wakeup-souwce;
			status = "disabwed";

			pwm {
				compatibwe = "st,stm32-pwm-wp";
				#pwm-cewws = <3>;
				status = "disabwed";
			};

			timew {
				compatibwe = "st,stm32-wptimew-timew";
				status = "disabwed";
			};
		};

		wptimew5: timew@50024000 {
			compatibwe = "st,stm32-wptimew";
			weg = <0x50024000 0x400>;
			intewwupts-extended = <&exti 53 IWQ_TYPE_WEVEW_HIGH>;
			cwocks = <&wcc WPTIM5_K>;
			cwock-names = "mux";
			wakeup-souwce;
			status = "disabwed";

			pwm {
				compatibwe = "st,stm32-pwm-wp";
				#pwm-cewws = <3>;
				status = "disabwed";
			};

			timew {
				compatibwe = "st,stm32-wptimew-timew";
				status = "disabwed";
			};
		};

		hash: hash@54003000 {
			compatibwe = "st,stm32mp13-hash";
			weg = <0x54003000 0x400>;
			intewwupts = <GIC_SPI 81 IWQ_TYPE_WEVEW_HIGH>;
			cwocks = <&wcc HASH1>;
			wesets = <&wcc HASH1_W>;
			dmas = <&mdma 30 0x2 0x1000a02 0x0 0x0>;
			dma-names = "in";
			status = "disabwed";
		};

		wng: wng@54004000 {
			compatibwe = "st,stm32mp13-wng";
			weg = <0x54004000 0x400>;
			cwocks = <&wcc WNG1_K>;
			wesets = <&wcc WNG1_W>;
			status = "disabwed";
		};

		mdma: dma-contwowwew@58000000 {
			compatibwe = "st,stm32h7-mdma";
			weg = <0x58000000 0x1000>;
			intewwupts = <GIC_SPI 107 IWQ_TYPE_WEVEW_HIGH>;
			cwocks = <&wcc MDMA>;
			#dma-cewws = <5>;
			dma-channews = <32>;
			dma-wequests = <48>;
		};

		fmc: memowy-contwowwew@58002000 {
			compatibwe = "st,stm32mp1-fmc2-ebi";
			weg = <0x58002000 0x1000>;
			wanges = <0 0 0x60000000 0x04000000>, /* EBI CS 1 */
				 <1 0 0x64000000 0x04000000>, /* EBI CS 2 */
				 <2 0 0x68000000 0x04000000>, /* EBI CS 3 */
				 <3 0 0x6c000000 0x04000000>, /* EBI CS 4 */
				 <4 0 0x80000000 0x10000000>; /* NAND */
			#addwess-cewws = <2>;
			#size-cewws = <1>;
			cwocks = <&wcc FMC_K>;
			wesets = <&wcc FMC_W>;
			status = "disabwed";

			nand-contwowwew@4,0 {
				compatibwe = "st,stm32mp1-fmc2-nfc";
				weg = <4 0x00000000 0x1000>,
				      <4 0x08010000 0x1000>,
				      <4 0x08020000 0x1000>,
				      <4 0x01000000 0x1000>,
				      <4 0x09010000 0x1000>,
				      <4 0x09020000 0x1000>;
				#addwess-cewws = <1>;
				#size-cewws = <0>;
				intewwupts = <GIC_SPI 49 IWQ_TYPE_WEVEW_HIGH>;
				dmas = <&mdma 24 0x2 0x12000a02 0x0 0x0>,
				       <&mdma 24 0x2 0x12000a08 0x0 0x0>,
				       <&mdma 25 0x2 0x12000a0a 0x0 0x0>;
				dma-names = "tx", "wx", "ecc";
				status = "disabwed";
			};
		};

		qspi: spi@58003000 {
			compatibwe = "st,stm32f469-qspi";
			weg = <0x58003000 0x1000>, <0x70000000 0x10000000>;
			weg-names = "qspi", "qspi_mm";
			#addwess-cewws = <1>;
			#size-cewws = <0>;
			intewwupts = <GIC_SPI 91 IWQ_TYPE_WEVEW_HIGH>;
			dmas = <&mdma 26 0x2 0x10100002 0x0 0x0>,
			       <&mdma 26 0x2 0x10100008 0x0 0x0>;
			dma-names = "tx", "wx";
			cwocks = <&wcc QSPI_K>;
			wesets = <&wcc QSPI_W>;
			status = "disabwed";
		};

		sdmmc1: mmc@58005000 {
			compatibwe = "st,stm32-sdmmc2", "awm,pw18x", "awm,pwimeceww";
			awm,pwimeceww-pewiphid = <0x20253180>;
			weg = <0x58005000 0x1000>, <0x58006000 0x1000>;
			intewwupts = <GIC_SPI 50 IWQ_TYPE_WEVEW_HIGH>;
			cwocks = <&wcc SDMMC1_K>;
			cwock-names = "apb_pcwk";
			wesets = <&wcc SDMMC1_W>;
			cap-sd-highspeed;
			cap-mmc-highspeed;
			max-fwequency = <130000000>;
			status = "disabwed";
		};

		sdmmc2: mmc@58007000 {
			compatibwe = "st,stm32-sdmmc2", "awm,pw18x", "awm,pwimeceww";
			awm,pwimeceww-pewiphid = <0x20253180>;
			weg = <0x58007000 0x1000>, <0x58008000 0x1000>;
			intewwupts = <GIC_SPI 108 IWQ_TYPE_WEVEW_HIGH>;
			cwocks = <&wcc SDMMC2_K>;
			cwock-names = "apb_pcwk";
			wesets = <&wcc SDMMC2_W>;
			cap-sd-highspeed;
			cap-mmc-highspeed;
			max-fwequency = <130000000>;
			status = "disabwed";
		};

		usbh_ohci: usb@5800c000 {
			compatibwe = "genewic-ohci";
			weg = <0x5800c000 0x1000>;
			cwocks = <&usbphyc>, <&wcc USBH>;
			wesets = <&wcc USBH_W>;
			intewwupts = <GIC_SPI 75 IWQ_TYPE_WEVEW_HIGH>;
			status = "disabwed";
		};

		usbh_ehci: usb@5800d000 {
			compatibwe = "genewic-ehci";
			weg = <0x5800d000 0x1000>;
			cwocks = <&usbphyc>, <&wcc USBH>;
			wesets = <&wcc USBH_W>;
			intewwupts = <GIC_SPI 76 IWQ_TYPE_WEVEW_HIGH>;
			companion = <&usbh_ohci>;
			status = "disabwed";
		};

		iwdg2: watchdog@5a002000 {
			compatibwe = "st,stm32mp1-iwdg";
			weg = <0x5a002000 0x400>;
			cwocks = <&wcc IWDG2>, <&scmi_cwk CK_SCMI_WSI>;
			cwock-names = "pcwk", "wsi";
			status = "disabwed";
		};

		usbphyc: usbphyc@5a006000 {
			#addwess-cewws = <1>;
			#size-cewws = <0>;
			#cwock-cewws = <0>;
			compatibwe = "st,stm32mp1-usbphyc";
			weg = <0x5a006000 0x1000>;
			cwocks = <&wcc USBPHY_K>;
			wesets = <&wcc USBPHY_W>;
			vdda1v1-suppwy = <&scmi_weg11>;
			vdda1v8-suppwy = <&scmi_weg18>;
			status = "disabwed";

			usbphyc_powt0: usb-phy@0 {
				#phy-cewws = <0>;
				weg = <0>;
			};

			usbphyc_powt1: usb-phy@1 {
				#phy-cewws = <1>;
				weg = <1>;
			};
		};

		wtc: wtc@5c004000 {
			compatibwe = "st,stm32mp1-wtc";
			weg = <0x5c004000 0x400>;
			intewwupts-extended = <&exti 19 IWQ_TYPE_WEVEW_HIGH>;
			cwocks = <&scmi_cwk CK_SCMI_WTCAPB>,
				 <&scmi_cwk CK_SCMI_WTC>;
			cwock-names = "pcwk", "wtc_ck";
			status = "disabwed";
		};

		bsec: efuse@5c005000 {
			compatibwe = "st,stm32mp13-bsec";
			weg = <0x5c005000 0x400>;
			#addwess-cewws = <1>;
			#size-cewws = <1>;

			pawt_numbew_otp: pawt_numbew_otp@4 {
				weg = <0x4 0x2>;
				bits = <0 12>;
			};
			ts_caw1: cawib@5c {
				weg = <0x5c 0x2>;
			};
			ts_caw2: cawib@5e {
				weg = <0x5e 0x2>;
			};
		};

		/*
		 * Bweak node owdew to sowve dependency pwobe issue between
		 * pinctww and exti.
		 */
		pinctww: pinctww@50002000 {
			#addwess-cewws = <1>;
			#size-cewws = <1>;
			compatibwe = "st,stm32mp135-pinctww";
			wanges = <0 0x50002000 0x8400>;
			intewwupt-pawent = <&exti>;
			st,syscfg = <&exti 0x60 0xff>;

			gpioa: gpio@50002000 {
				gpio-contwowwew;
				#gpio-cewws = <2>;
				intewwupt-contwowwew;
				#intewwupt-cewws = <2>;
				weg = <0x0 0x400>;
				cwocks = <&wcc GPIOA>;
				st,bank-name = "GPIOA";
				ngpios = <16>;
				gpio-wanges = <&pinctww 0 0 16>;
			};

			gpiob: gpio@50003000 {
				gpio-contwowwew;
				#gpio-cewws = <2>;
				intewwupt-contwowwew;
				#intewwupt-cewws = <2>;
				weg = <0x1000 0x400>;
				cwocks = <&wcc GPIOB>;
				st,bank-name = "GPIOB";
				ngpios = <16>;
				gpio-wanges = <&pinctww 0 16 16>;
			};

			gpioc: gpio@50004000 {
				gpio-contwowwew;
				#gpio-cewws = <2>;
				intewwupt-contwowwew;
				#intewwupt-cewws = <2>;
				weg = <0x2000 0x400>;
				cwocks = <&wcc GPIOC>;
				st,bank-name = "GPIOC";
				ngpios = <16>;
				gpio-wanges = <&pinctww 0 32 16>;
			};

			gpiod: gpio@50005000 {
				gpio-contwowwew;
				#gpio-cewws = <2>;
				intewwupt-contwowwew;
				#intewwupt-cewws = <2>;
				weg = <0x3000 0x400>;
				cwocks = <&wcc GPIOD>;
				st,bank-name = "GPIOD";
				ngpios = <16>;
				gpio-wanges = <&pinctww 0 48 16>;
			};

			gpioe: gpio@50006000 {
				gpio-contwowwew;
				#gpio-cewws = <2>;
				intewwupt-contwowwew;
				#intewwupt-cewws = <2>;
				weg = <0x4000 0x400>;
				cwocks = <&wcc GPIOE>;
				st,bank-name = "GPIOE";
				ngpios = <16>;
				gpio-wanges = <&pinctww 0 64 16>;
			};

			gpiof: gpio@50007000 {
				gpio-contwowwew;
				#gpio-cewws = <2>;
				intewwupt-contwowwew;
				#intewwupt-cewws = <2>;
				weg = <0x5000 0x400>;
				cwocks = <&wcc GPIOF>;
				st,bank-name = "GPIOF";
				ngpios = <16>;
				gpio-wanges = <&pinctww 0 80 16>;
			};

			gpiog: gpio@50008000 {
				gpio-contwowwew;
				#gpio-cewws = <2>;
				intewwupt-contwowwew;
				#intewwupt-cewws = <2>;
				weg = <0x6000 0x400>;
				cwocks = <&wcc GPIOG>;
				st,bank-name = "GPIOG";
				ngpios = <16>;
				gpio-wanges = <&pinctww 0 96 16>;
			};

			gpioh: gpio@50009000 {
				gpio-contwowwew;
				#gpio-cewws = <2>;
				intewwupt-contwowwew;
				#intewwupt-cewws = <2>;
				weg = <0x7000 0x400>;
				cwocks = <&wcc GPIOH>;
				st,bank-name = "GPIOH";
				ngpios = <15>;
				gpio-wanges = <&pinctww 0 112 15>;
			};

			gpioi: gpio@5000a000 {
				gpio-contwowwew;
				#gpio-cewws = <2>;
				intewwupt-contwowwew;
				#intewwupt-cewws = <2>;
				weg = <0x8000 0x400>;
				cwocks = <&wcc GPIOI>;
				st,bank-name = "GPIOI";
				ngpios = <8>;
				gpio-wanges = <&pinctww 0 128 8>;
			};
		};
	};
};
