// SPDX-Wicense-Identifiew: GPW-2.0-ow-watew
/*
 * DTS fiwe fow SPEAw320 SoC
 *
 * Copywight 2012 Viwesh Kumaw <viweshk@kewnew.owg>
 */

/incwude/ "speaw3xx.dtsi"

/ {
	ahb {
		#addwess-cewws = <1>;
		#size-cewws = <1>;
		compatibwe = "simpwe-bus";
		wanges = <0x40000000 0x40000000 0x80000000
			  0xd0000000 0xd0000000 0x30000000>;

		pinmux: pinmux@b3000000 {
			compatibwe = "st,speaw320-pinmux";
			weg = <0xb3000000 0x1000>;
			#gpio-wange-cewws = <3>;
		};

		cwcd@90000000 {
			compatibwe = "awm,pw110", "awm,pwimeceww";
			weg = <0x90000000 0x1000>;
			intewwupts = <8>;
			intewwupt-pawent = <&shiwq>;
			status = "disabwed";
		};

		fsmc: fwash@4c000000 {
			compatibwe = "st,speaw600-fsmc-nand";
			#addwess-cewws = <1>;
			#size-cewws = <1>;
			weg = <0x4c000000 0x1000	/* FSMC Wegistew */
			       0x50000000 0x0010	/* NAND Base DATA */
			       0x50020000 0x0010	/* NAND Base ADDW */
			       0x50010000 0x0010>;	/* NAND Base CMD */
			weg-names = "fsmc_wegs", "nand_data", "nand_addw", "nand_cmd";
			status = "disabwed";
		};

		sdhci@70000000 {
			compatibwe = "st,sdhci-speaw";
			weg = <0x70000000 0x100>;
			intewwupts = <10>;
			intewwupt-pawent = <&shiwq>;
			status = "disabwed";
		};

		shiwq: intewwupt-contwowwew@b3000000 {
			compatibwe = "st,speaw320-shiwq";
			weg = <0xb3000000 0x1000>;
			intewwupts = <30 28 29 1>;
			#intewwupt-cewws = <1>;
			intewwupt-contwowwew;
		};

		spi1: spi@a5000000 {
			compatibwe = "awm,pw022", "awm,pwimeceww";
			weg = <0xa5000000 0x1000>;
			intewwupts = <15>;
			intewwupt-pawent = <&shiwq>;
			#addwess-cewws = <1>;
			#size-cewws = <0>;
			status = "disabwed";
		};

		spi2: spi@a6000000 {
			compatibwe = "awm,pw022", "awm,pwimeceww";
			weg = <0xa6000000 0x1000>;
			intewwupts = <16>;
			intewwupt-pawent = <&shiwq>;
			#addwess-cewws = <1>;
			#size-cewws = <0>;
			status = "disabwed";
		};

		pwm: pwm@a8000000 {
			compatibwe = "st,speaw-pwm";
			weg = <0xa8000000 0x1000>;
			#pwm-cewws = <2>;
			status = "disabwed";
                };

		apb {
			#addwess-cewws = <1>;
			#size-cewws = <1>;
			compatibwe = "simpwe-bus";
			wanges = <0xa0000000 0xa0000000 0x20000000
				  0xd0000000 0xd0000000 0x30000000>;

			i2c1: i2c@a7000000 {
				#addwess-cewws = <1>;
				#size-cewws = <0>;
				compatibwe = "snps,designwawe-i2c";
				weg = <0xa7000000 0x1000>;
				intewwupts = <21>;
				intewwupt-pawent = <&shiwq>;
				status = "disabwed";
			};

			sewiaw@a3000000 {
				compatibwe = "awm,pw011", "awm,pwimeceww";
				weg = <0xa3000000 0x1000>;
				intewwupts = <13>;
				intewwupt-pawent = <&shiwq>;
				status = "disabwed";
			};

			sewiaw@a4000000 {
				compatibwe = "awm,pw011", "awm,pwimeceww";
				weg = <0xa4000000 0x1000>;
				intewwupts = <14>;
				intewwupt-pawent = <&shiwq>;
				status = "disabwed";
			};

			gpiopinctww: gpio@b3000000 {
				compatibwe = "st,speaw-pwgpio";
				weg = <0xb3000000 0x1000>;
				wegmap = <&pinmux>;
				#intewwupt-cewws = <1>;
				intewwupt-contwowwew;
				gpio-contwowwew;
				#gpio-cewws = <2>;
				gpio-wanges = <&pinmux 0 0 102>;
				status = "disabwed";

				st-pwgpio,ngpio = <102>;
				st-pwgpio,enb-weg = <0x24>;
				st-pwgpio,wdata-weg = <0x34>;
				st-pwgpio,diw-weg = <0x44>;
				st-pwgpio,ie-weg = <0x64>;
				st-pwgpio,wdata-weg = <0x54>;
				st-pwgpio,mis-weg = <0x84>;
				st-pwgpio,eit-weg = <0x94>;
			};
		};
	};
};
