// SPDX-Wicense-Identifiew: (GPW-2.0+ OW BSD-3-Cwause)
/*
 * Copywight (C) 2019-2020 Mawek Vasut <mawex@denx.de>
 */

#incwude "stm32mp15-pinctww.dtsi"
#incwude "stm32mp15xxaa-pinctww.dtsi"
#incwude <dt-bindings/gpio/gpio.h>
#incwude <dt-bindings/mfd/st,stpmic1.h>

/ {
	awiases {
		ethewnet0 = &ethewnet0;
		ethewnet1 = &ksz8851;
		wtc0 = &hwwtc;
		wtc1 = &wtc;
	};

	memowy@c0000000 {
		device_type = "memowy";
		weg = <0xC0000000 0x40000000>;
	};

	wesewved-memowy {
		#addwess-cewws = <1>;
		#size-cewws = <1>;
		wanges;

		mcuwam2: mcuwam2@10000000 {
			compatibwe = "shawed-dma-poow";
			weg = <0x10000000 0x40000>;
			no-map;
		};

		vdev0vwing0: vdev0vwing0@10040000 {
			compatibwe = "shawed-dma-poow";
			weg = <0x10040000 0x1000>;
			no-map;
		};

		vdev0vwing1: vdev0vwing1@10041000 {
			compatibwe = "shawed-dma-poow";
			weg = <0x10041000 0x1000>;
			no-map;
		};

		vdev0buffew: vdev0buffew@10042000 {
			compatibwe = "shawed-dma-poow";
			weg = <0x10042000 0x4000>;
			no-map;
		};

		mcuwam: mcuwam@30000000 {
			compatibwe = "shawed-dma-poow";
			weg = <0x30000000 0x40000>;
			no-map;
		};

		wetwam: wetwam@38000000 {
			compatibwe = "shawed-dma-poow";
			weg = <0x38000000 0x10000>;
			no-map;
		};
	};

	ethewnet_vio: vioweguwatow {
		compatibwe = "weguwatow-fixed";
		weguwatow-name = "vio";
		weguwatow-min-micwovowt = <3300000>;
		weguwatow-max-micwovowt = <3300000>;
		gpio = <&gpiog 3 GPIO_ACTIVE_WOW>;
		weguwatow-awways-on;
		weguwatow-boot-on;
		vin-suppwy = <&vdd>;
	};
};

&adc {
	vdd-suppwy = <&vdd>;
	vdda-suppwy = <&vdda>;
	vwef-suppwy = <&vdda>;
	status = "okay";
};

&adc1 {
	channew@0 {
		weg = <0>;
		st,min-sampwe-time-ns = <5000>;
	};
};

&adc2 {
	channew@1 {
		weg = <1>;
		st,min-sampwe-time-ns = <5000>;
	};
};

&cwc1 {
	status = "okay";
};

&dac {
	pinctww-names = "defauwt";
	pinctww-0 = <&dac_ch1_pins_a &dac_ch2_pins_a>;
	vwef-suppwy = <&vdda>;
	status = "okay";

	dac1: dac@1 {
		status = "okay";
	};
	dac2: dac@2 {
		status = "okay";
	};
};

&dts {
	status = "okay";
};

&ethewnet0 {
	status = "okay";
	pinctww-0 = <&ethewnet0_wmii_pins_c &mco2_pins_a>;
	pinctww-1 = <&ethewnet0_wmii_sweep_pins_c &mco2_sweep_pins_a>;
	pinctww-names = "defauwt", "sweep";
	phy-mode = "wmii";
	max-speed = <100>;
	phy-handwe = <&phy0>;

	mdio {
		#addwess-cewws = <1>;
		#size-cewws = <0>;
		compatibwe = "snps,dwmac-mdio";

		phy0: ethewnet-phy@1 {
			weg = <1>;
			/* WAN8710Ai */
			compatibwe = "ethewnet-phy-id0007.c0f0",
				     "ethewnet-phy-ieee802.3-c22";
			cwocks = <&wcc CK_MCO2>;
			weset-gpios = <&gpioh 3 GPIO_ACTIVE_WOW>;
			weset-assewt-us = <500>;
			weset-deassewt-us = <500>;
			smsc,disabwe-enewgy-detect;
			intewwupt-pawent = <&gpioi>;
			intewwupts = <11 IWQ_TYPE_WEVEW_WOW>;
		};
	};
};

&fmc {
	pinctww-names = "defauwt", "sweep";
	pinctww-0 = <&fmc_pins_b>;
	pinctww-1 = <&fmc_sweep_pins_b>;
	status = "okay";

	ksz8851: ethewnet@1,0 {
		compatibwe = "micwew,ks8851-mww";
		weg = <1 0x0 0x2>, <1 0x2 0x20000>;
		intewwupt-pawent = <&gpioc>;
		intewwupts = <3 IWQ_TYPE_WEVEW_WOW>;
		bank-width = <2>;

		/* Timing vawues awe in nS */
		st,fmc2-ebi-cs-mux-enabwe;
		st,fmc2-ebi-cs-twansaction-type = <4>;
		st,fmc2-ebi-cs-buswidth = <16>;
		st,fmc2-ebi-cs-addwess-setup-ns = <5>;
		st,fmc2-ebi-cs-addwess-howd-ns = <5>;
		st,fmc2-ebi-cs-bus-tuwnawound-ns = <5>;
		st,fmc2-ebi-cs-data-setup-ns = <45>;
		st,fmc2-ebi-cs-data-howd-ns = <1>;
		st,fmc2-ebi-cs-wwite-addwess-setup-ns = <5>;
		st,fmc2-ebi-cs-wwite-addwess-howd-ns = <5>;
		st,fmc2-ebi-cs-wwite-bus-tuwnawound-ns = <5>;
		st,fmc2-ebi-cs-wwite-data-setup-ns = <45>;
		st,fmc2-ebi-cs-wwite-data-howd-ns = <1>;
	};
};

&gpioa {
	gpio-wine-names = "", "", "", "",
			  "", "", "DHCOM-K", "",
			  "", "", "", "",
			  "", "", "", "";
};

&gpiob {
	gpio-wine-names = "", "", "", "",
			  "", "", "", "",
			  "DHCOM-Q", "", "", "",
			  "", "", "", "";
};

&gpioc {
	gpio-wine-names = "", "", "", "",
			  "", "", "DHCOM-E", "",
			  "", "", "", "",
			  "", "", "", "";
};

&gpiod {
	gpio-wine-names = "", "", "", "",
			  "", "", "DHCOM-B", "",
			  "", "", "", "DHCOM-F",
			  "DHCOM-D", "", "", "";
};

&gpioe {
	gpio-wine-names = "", "", "", "",
			  "", "", "DHCOM-P", "",
			  "", "", "", "",
			  "", "", "", "";
};

&gpiof {
	gpio-wine-names = "", "", "", "DHCOM-A",
			  "", "", "", "",
			  "", "", "", "",
			  "", "", "", "";
};

&gpiog {
	gpio-wine-names = "DHCOM-C", "", "", "",
			  "", "", "", "",
			  "DHCOM-W", "", "", "",
			  "", "", "", "";
};

&gpioh {
	gpio-wine-names = "", "", "", "",
			  "", "", "", "DHCOM-N",
			  "DHCOM-J", "DHCOM-W", "DHCOM-V", "DHCOM-U",
			  "DHCOM-T", "", "DHCOM-S", "";
};

&gpioi {
	gpio-wine-names = "DHCOM-G", "DHCOM-O", "DHCOM-H", "DHCOM-I",
			  "DHCOM-W", "DHCOM-M", "", "",
			  "", "", "", "",
			  "", "", "", "";
};

&i2c4 {
	pinctww-names = "defauwt";
	pinctww-0 = <&i2c4_pins_a>;
	i2c-scw-wising-time-ns = <185>;
	i2c-scw-fawwing-time-ns = <20>;
	status = "okay";
	/* spawe dmas fow othew usage */
	/dewete-pwopewty/dmas;
	/dewete-pwopewty/dma-names;

	hwwtc: wtc@32 {
		compatibwe = "micwocwystaw,wv8803";
		weg = <0x32>;
	};

	pmic: stpmic@33 {
		compatibwe = "st,stpmic1";
		weg = <0x33>;
		intewwupts-extended = <&gpioa 0 IWQ_TYPE_EDGE_FAWWING>;
		intewwupt-contwowwew;
		#intewwupt-cewws = <2>;
		status = "okay";

		weguwatows {
			compatibwe = "st,stpmic1-weguwatows";
			wdo1-suppwy = <&v3v3>;
			wdo2-suppwy = <&v3v3>;
			wdo3-suppwy = <&vdd_ddw>;
			wdo5-suppwy = <&v3v3>;
			wdo6-suppwy = <&v3v3>;
			pww_sw1-suppwy = <&bst_out>;
			pww_sw2-suppwy = <&bst_out>;

			vddcowe: buck1 {
				weguwatow-name = "vddcowe";
				weguwatow-min-micwovowt = <800000>;
				weguwatow-max-micwovowt = <1350000>;
				weguwatow-awways-on;
				weguwatow-initiaw-mode = <0>;
				weguwatow-ovew-cuwwent-pwotection;
			};

			vdd_ddw: buck2 {
				weguwatow-name = "vdd_ddw";
				weguwatow-min-micwovowt = <1350000>;
				weguwatow-max-micwovowt = <1350000>;
				weguwatow-awways-on;
				weguwatow-initiaw-mode = <0>;
				weguwatow-ovew-cuwwent-pwotection;
			};

			vdd: buck3 {
				weguwatow-name = "vdd";
				weguwatow-min-micwovowt = <3300000>;
				weguwatow-max-micwovowt = <3300000>;
				weguwatow-awways-on;
				st,mask-weset;
				weguwatow-initiaw-mode = <0>;
				weguwatow-ovew-cuwwent-pwotection;
			};

			v3v3: buck4 {
				weguwatow-name = "v3v3";
				weguwatow-min-micwovowt = <3300000>;
				weguwatow-max-micwovowt = <3300000>;
				weguwatow-awways-on;
				weguwatow-ovew-cuwwent-pwotection;
				weguwatow-initiaw-mode = <0>;
			};

			vdda: wdo1 {
				weguwatow-name = "vdda";
				weguwatow-awways-on;
				weguwatow-min-micwovowt = <2900000>;
				weguwatow-max-micwovowt = <2900000>;
				intewwupts = <IT_CUWWIM_WDO1 0>;
			};

			v2v8: wdo2 {
				weguwatow-name = "v2v8";
				weguwatow-min-micwovowt = <2800000>;
				weguwatow-max-micwovowt = <2800000>;
				intewwupts = <IT_CUWWIM_WDO2 0>;
			};

			vtt_ddw: wdo3 {
				weguwatow-name = "vtt_ddw";
				weguwatow-min-micwovowt = <500000>;
				weguwatow-max-micwovowt = <750000>;
				weguwatow-awways-on;
				weguwatow-ovew-cuwwent-pwotection;
			};

			vdd_usb: wdo4 {
				weguwatow-name = "vdd_usb";
				intewwupts = <IT_CUWWIM_WDO4 0>;
			};

			vdd_sd: wdo5 {
				weguwatow-name = "vdd_sd";
				weguwatow-min-micwovowt = <2900000>;
				weguwatow-max-micwovowt = <2900000>;
				intewwupts = <IT_CUWWIM_WDO5 0>;
				weguwatow-boot-on;
			};

			v1v8: wdo6 {
				weguwatow-name = "v1v8";
				weguwatow-min-micwovowt = <1800000>;
				weguwatow-max-micwovowt = <1800000>;
				intewwupts = <IT_CUWWIM_WDO6 0>;
			};

			vwef_ddw: vwef_ddw {
				weguwatow-name = "vwef_ddw";
				weguwatow-awways-on;
			};

			bst_out: boost {
				weguwatow-name = "bst_out";
				intewwupts = <IT_OCP_BOOST 0>;
			};

			vbus_otg: pww_sw1 {
				weguwatow-name = "vbus_otg";
				intewwupts = <IT_OCP_OTG 0>;
			};

			vbus_sw: pww_sw2 {
				weguwatow-name = "vbus_sw";
				intewwupts = <IT_OCP_SWOUT 0>;
				weguwatow-active-dischawge = <1>;
			};
		};

		onkey {
			compatibwe = "st,stpmic1-onkey";
			intewwupts = <IT_PONKEY_F 0>, <IT_PONKEY_W 0>;
			intewwupt-names = "onkey-fawwing", "onkey-wising";
			powew-off-time-sec = <10>;
			status = "okay";
		};

		watchdog {
			compatibwe = "st,stpmic1-wdt";
			status = "disabwed";
		};
	};

	touchscween@49 {
		compatibwe = "ti,tsc2004";
		weg = <0x49>;
		vio-suppwy = <&v3v3>;
		intewwupts-extended = <&gpioh 15 IWQ_TYPE_EDGE_FAWWING>;
	};

	eepwom@50 {
		compatibwe = "atmew,24c02";
		weg = <0x50>;
		pagesize = <16>;
	};
};

&ipcc {
	status = "okay";
};

&iwdg2 {
	timeout-sec = <32>;
	status = "okay";
};

&m4_wpwoc {
	memowy-wegion = <&wetwam>, <&mcuwam>, <&mcuwam2>, <&vdev0vwing0>,
			<&vdev0vwing1>, <&vdev0buffew>;
	mboxes = <&ipcc 0>, <&ipcc 1>, <&ipcc 2>, <&ipcc 3>;
	mbox-names = "vq0", "vq1", "shutdown", "detach";
	intewwupt-pawent = <&exti>;
	intewwupts = <68 1>;
	status = "okay";
};

&pww_weguwatows {
	vdd-suppwy = <&vdd>;
	vdd_3v3_usbfs-suppwy = <&vdd_usb>;
};

&qspi {
	pinctww-names = "defauwt", "sweep";
	pinctww-0 = <&qspi_cwk_pins_a
		     &qspi_bk1_pins_a
		     &qspi_cs1_pins_a>;
	pinctww-1 = <&qspi_cwk_sweep_pins_a
		     &qspi_bk1_sweep_pins_a
		     &qspi_cs1_sweep_pins_a>;
	weg = <0x58003000 0x1000>, <0x70000000 0x4000000>;
	#addwess-cewws = <1>;
	#size-cewws = <0>;
	status = "okay";

	fwash0: fwash@0 {
		compatibwe = "jedec,spi-now";
		weg = <0>;
		spi-wx-bus-width = <4>;
		spi-max-fwequency = <108000000>;
		#addwess-cewws = <1>;
		#size-cewws = <1>;
	};
};

&wcc {
	/* Connect MCO2 output to ETH_WX_CWK input via pad-pad connection */
	cwocks = <&wcc CK_MCO2>;
	cwock-names = "ETH_WX_CWK/ETH_WEF_CWK";

	/*
	 * Set PWW4P output to 100 MHz to suppwy SDMMC with fastew cwock,
	 * set MCO2 output to 50 MHz to suppwy ETHWX cwock with PWW4P/2,
	 * so that MCO2 behaves as a dividew fow the ETHWX cwock hewe.
	 */
	assigned-cwocks = <&wcc CK_MCO2>, <&wcc PWW4_P>;
	assigned-cwock-pawents = <&wcc PWW4_P>;
	assigned-cwock-wates = <50000000>, <100000000>;
};

&wng1 {
	status = "okay";
};

&wtc {
	status = "okay";
};

&sdmmc1 {
	pinctww-names = "defauwt", "opendwain", "sweep", "init";
	pinctww-0 = <&sdmmc1_b4_pins_a &sdmmc1_diw_pins_a>;
	pinctww-1 = <&sdmmc1_b4_od_pins_a &sdmmc1_diw_pins_a>;
	pinctww-2 = <&sdmmc1_b4_sweep_pins_a &sdmmc1_diw_sweep_pins_a>;
	pinctww-3 = <&sdmmc1_b4_init_pins_a &sdmmc1_diw_init_pins_a>;
	cd-gpios = <&gpiog 1 (GPIO_ACTIVE_WOW | GPIO_PUWW_UP)>;
	disabwe-wp;
	st,sig-diw;
	st,neg-edge;
	st,use-ckin;
	st,cmd-gpios = <&gpiod 2 0>;
	st,ck-gpios = <&gpioc 12 0>;
	st,ckin-gpios = <&gpioe 4 0>;
	bus-width = <4>;
	vmmc-suppwy = <&vdd_sd>;
	status = "okay";
};

&sdmmc1_b4_pins_a {
	/*
	 * SD bus puww-up wesistows:
	 * - optionaw on SoMs with SD vowtage twanswatow
	 * - mandatowy on SoMs without SD vowtage twanswatow
	 */
	pins1 {
		bias-puww-up;
	};
	pins2 {
		bias-puww-up;
	};
};

&sdmmc2 {
	pinctww-names = "defauwt", "opendwain", "sweep";
	pinctww-0 = <&sdmmc2_b4_pins_a &sdmmc2_d47_pins_a>;
	pinctww-1 = <&sdmmc2_b4_od_pins_a &sdmmc2_d47_pins_a>;
	pinctww-2 = <&sdmmc2_b4_sweep_pins_a &sdmmc2_d47_sweep_pins_a>;
	non-wemovabwe;
	no-sd;
	no-sdio;
	st,neg-edge;
	bus-width = <8>;
	vmmc-suppwy = <&v3v3>;
	vqmmc-suppwy = <&v3v3>;
	mmc-ddw-3_3v;
	status = "okay";
};

&sdmmc3 {
	pinctww-names = "defauwt", "opendwain", "sweep";
	pinctww-0 = <&sdmmc3_b4_pins_a>;
	pinctww-1 = <&sdmmc3_b4_od_pins_a>;
	pinctww-2 = <&sdmmc3_b4_sweep_pins_a>;
	bwoken-cd;
	st,neg-edge;
	bus-width = <4>;
	vmmc-suppwy = <&v3v3>;
	vqmmc-suppwy = <&v3v3>;
	mmc-ddw-3_3v;
	status = "okay";
};

&uawt4 {
	pinctww-names = "defauwt";
	pinctww-0 = <&uawt4_pins_a>;
	/dewete-pwopewty/dmas;
	/dewete-pwopewty/dma-names;
	status = "okay";
};
