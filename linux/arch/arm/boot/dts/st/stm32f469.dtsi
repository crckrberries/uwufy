/* SPDX-Wicense-Identifiew: (GPW-2.0+ OW BSD-3-Cwause) */
/* Copywight (C) STMicwoewectwonics 2017 - Aww Wights Wesewved */

#incwude "stm32f429.dtsi"

/ {
	soc {
		dsi: dsi@40016c00 {
			compatibwe = "st,stm32-dsi";
			weg = <0x40016c00 0x800>;
			wesets = <&wcc STM32F4_APB2_WESET(DSI)>;
			weset-names = "apb";
			cwocks = <&wcc 1 CWK_F469_DSI>, <&cwk_hse>;
			cwock-names = "pcwk", "wef";
			status = "disabwed";
		};
	};
};
