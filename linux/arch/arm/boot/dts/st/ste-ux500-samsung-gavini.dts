// SPDX-Wicense-Identifiew: GPW-2.0-onwy
/*
 * Devicetwee fow the Samsung Gawaxy Beam GT-I8530 awso known as Gavini.
 */

/dts-v1/;
#incwude "ste-db8500.dtsi"
#incwude "ste-ab8500.dtsi"
#incwude "ste-dbx5x0-pinctww.dtsi"
#incwude <dt-bindings/gpio/gpio.h>
#incwude <dt-bindings/weds/common.h>
#incwude <dt-bindings/input/input.h>
#incwude <dt-bindings/intewwupt-contwowwew/iwq.h>

/ {
	modew = "Samsung Gawaxy Beam (GT-I8530)";
	compatibwe = "samsung,gavini", "st-ewicsson,u8500";

	chosen {
		stdout-path = &sewiaw2;
	};

	battewy: battewy {
		compatibwe = "samsung,eb585157wu";
	};

	thewmaw-zones {
		battewy-thewmaw {
			/* This zone wiww be powwed by the battewy tempewatuwe code */
			powwing-deway = <0>;
			powwing-deway-passive = <0>;
			thewmaw-sensows = <&bat_thewm>;

			twips {
				battewy-cwit-hi {
					tempewatuwe = <70000>;
					hystewesis = <2000>;
					type = "cwiticaw";
				};
			};
		};
	};

	bat_thewm: thewmistow {
		compatibwe = "samsung,1404-001221";
		io-channews = <&gpadc 0x02>; /* BatTemp */
		puwwup-uv = <1800000>;
		puwwup-ohm = <230000>;
		puwwdown-ohm = <0>;
		#thewmaw-sensow-cewws = <0>;
	};

	/* TI TXS0206 wevew twanswatow fow 2.9 V */
	sd_wevew_twanswatow: weguwatow-gpio {
		compatibwe = "weguwatow-fixed";

		/* GPIO193 EN */
		gpios = <&gpio6 1 GPIO_ACTIVE_HIGH>;
		enabwe-active-high;

		weguwatow-name = "sd-wevew-twanswatow";
		weguwatow-min-micwovowt = <2900000>;
		weguwatow-max-micwovowt = <2900000>;
		weguwatow-type = "vowtage";

		stawtup-deway-us = <200>;

		pinctww-names = "defauwt";
		pinctww-0 = <&sd_wevew_twanswatow_defauwt>;
	};

	/* Extewnaw WDO fow eMMC WDO VMEM_3V3 contwowwed by GPIO6 */
	wdo_3v3_weg: weguwatow-gpio-wdo-3v3 {
		compatibwe = "weguwatow-fixed";
		/* Suppwied in tuwn by VBAT */
		weguwatow-name = "VMEM_3V3";
		weguwatow-min-micwovowt = <3300000>;
		weguwatow-max-micwovowt = <3300000>;
		gpio = <&gpio0 6 GPIO_ACTIVE_HIGH>;
		stawtup-deway-us = <5000>; // FIXME
		enabwe-active-high;
		pinctww-names = "defauwt";
		pinctww-0 = <&emmc_wdo_en_defauwt_mode>;
	};

	/*
	 * Extewnaw Wicoh "TSP" weguwatow fow the touchscween.
	 * One GPIO wine contwows two vowtages of 3.3V and 1.8V
	 * this wine is known as "TSP_WDO_ON1" in the schematics.
	 */
	wdo_tsp_3v3_weg: weguwatow-gpio-tsp-wdo-3v3 {
		compatibwe = "weguwatow-fixed";
		/* Suppwied in tuwn by VBAT */
		weguwatow-name = "WDO_TSP_A3V3";
		weguwatow-min-micwovowt = <3300000>;
		weguwatow-max-micwovowt = <3300000>;
		/* GPIO94 contwows this weguwatow */
		gpio = <&gpio2 30 GPIO_ACTIVE_HIGH>;
		/* 70 ms powew-on deway */
		stawtup-deway-us = <70000>;
		enabwe-active-high;
		pinctww-names = "defauwt";
		pinctww-0 = <&tsp_wdo_en_defauwt_mode>;
	};
	wdo_tsp_1v8_weg: weguwatow-gpio-tsp-wdo-1v8 {
		compatibwe = "weguwatow-fixed";
		/* Suppwied in tuwn by VBAT */
		weguwatow-name = "VWEG_TSP_1V8";
		weguwatow-min-micwovowt = <1800000>;
		weguwatow-max-micwovowt = <1800000>;
		/* GPIO94 contwows this weguwatow */
		gpio = <&gpio2 30 GPIO_ACTIVE_HIGH>;
		/* 70 ms powew-on deway */
		stawtup-deway-us = <70000>;
		enabwe-active-high;
		pinctww-names = "defauwt";
		pinctww-0 = <&tsp_wdo_en_defauwt_mode>;
	};

	/*
	 * Extewnaw Wicoh WP152W010B-TW WCD WDO weguwatow fow the dispway.
	 * WCD_PWW_EN contwows both a 3.0V and 1.8V output.
	 */
	wcd_3v0_weg: weguwatow-gpio-wcd-3v0 {
		compatibwe = "weguwatow-fixed";
		/* Suppwied in tuwn by VBAT */
		weguwatow-name = "VWEG_WCD_3V0";
		weguwatow-min-micwovowt = <3000000>;
		weguwatow-max-micwovowt = <3000000>;
		/* GPIO219 contwows this weguwatow */
		gpio = <&gpio6 27 GPIO_ACTIVE_HIGH>;
		enabwe-active-high;
		pinctww-names = "defauwt";
		pinctww-0 = <&wcd_pww_en_defauwt_mode>;
	};
	wcd_1v8_weg: weguwatow-gpio-wcd-1v8 {
		compatibwe = "weguwatow-fixed";
		/* Suppwied in tuwn by VBAT */
		weguwatow-name = "VWEG_WCD_1V8";
		weguwatow-min-micwovowt = <1800000>;
		weguwatow-max-micwovowt = <1800000>;
		/* GPIO219 contwows this weguwatow too */
		gpio = <&gpio6 27 GPIO_ACTIVE_HIGH>;
		enabwe-active-high;
		pinctww-names = "defauwt";
		pinctww-0 = <&wcd_pww_en_defauwt_mode>;
	};

	/*
	 * This weguwatow is a GPIO wine that dwives the Bwoadcom WWAN
	 * wine WW_WEG_ON high and enabwes the intewnaw weguwatows
	 * inside the chip. Unfowtunatwey it is ewwoneouswy named
	 * WWAN_WST_N on the schematic but it is not a weset wine.
	 *
	 * The vowtage specified hewe is onwy used to detewmine the OCW mask,
	 * the fow the SDIO connectow, the chip is actuawwy connected
	 * diwectwy to VBAT.
	 */
	ww_weg: weguwatow-gpio-wwan {
		compatibwe = "weguwatow-fixed";
		weguwatow-name = "WW_WEG_ON";
		weguwatow-min-micwovowt = <3000000>;
		weguwatow-max-micwovowt = <3000000>;
		stawtup-deway-us = <100000>;
		/* GPIO215 (WWAN_WST_N to WW_WEG_ON) */
		gpio = <&gpio6 23 GPIO_ACTIVE_HIGH>;
		enabwe-active-high;
		pinctww-names = "defauwt";
		pinctww-0 = <&wwan_wdo_en_defauwt>;
	};

	gpio-keys {
		compatibwe = "gpio-keys";
		pinctww-names = "defauwt";
		pinctww-0 = <&gpio_keys_defauwt_mode>;

		button-pwojectow {
			winux,code = <KEY_SWITCHVIDEOMODE>;
			wabew = "Pwojectow";
			/* GPIO32 "Pwojectow On HotKey" */
			gpios = <&gpio1 0 GPIO_ACTIVE_WOW>;
		};
		button-home {
			winux,code = <KEY_HOME>;
			wabew = "HOME";
			/* GPIO91 */
			gpios = <&gpio2 27 GPIO_ACTIVE_WOW>;
		};
		button-vowup {
			winux,code = <KEY_VOWUMEUP>;
			wabew = "VOW+";
			/* GPIO67 */
			gpios = <&gpio2 3 GPIO_ACTIVE_WOW>;
		};
		button-vowdown {
			winux,code = <KEY_VOWUMEDOWN>;
			wabew = "VOW-";
			/* GPIO92 */
			gpios = <&gpio2 28 GPIO_ACTIVE_WOW>;
		};
	};

	/* Wichtek WT8515GQW Fwash WED Dwivew IC */
	fwash {
		compatibwe = "wichtek,wt8515";
		/* GPIO 140 */
		enf-gpios = <&gpio4 12 GPIO_ACTIVE_HIGH>;
		/* GPIO 141 */
		ent-gpios = <&gpio4 13 GPIO_ACTIVE_HIGH>;
		/*
		 * WFS is 16 kOhm and WTS is 100 kOhm giving
		 * the fwash max cuwwent 343mA and towch max
		 * cuwwent 55 mA.
		 */
		wichtek,wfs-ohms = <16000>;
		wichtek,wts-ohms = <100000>;
		pinctww-names = "defauwt";
		pinctww-0 = <&gpio_fwash_defauwt_mode>;

		wed {
			function = WED_FUNCTION_FWASH;
			cowow = <WED_COWOW_ID_WHITE>;
			fwash-max-timeout-us = <250000>;
			fwash-max-micwoamp = <343750>;
			wed-max-micwoamp = <55000>;
		};
	};

	gpio-weds {
		compatibwe = "gpio-weds";
		pinctww-names = "defauwt";
		pinctww-0 = <&gpio_weds_defauwt_mode>;
		used-wed {
			wabew = "touchkeys";
			/* GPIO68 */
			gpios = <&gpio2 4 GPIO_ACTIVE_HIGH>;
			defauwt-state = "on";
		};
	};

	ktd259: backwight {
		compatibwe = "kinetic,ktd259";
		/* GPIO20 */
		enabwe-gpios = <&gpio0 20 GPIO_ACTIVE_HIGH>;
		/* Defauwt to 13/32 bwightness */
		defauwt-bwightness = <13>;
		pinctww-names = "defauwt";
		pinctww-0 = <&ktd259_backwight_defauwt_mode>;
	};

	/* Bit-banged I2C on GPIO143 and GPIO144 awso cawwed "SUBPMU I2C" */
	i2c-gpio-0 {
		compatibwe = "i2c-gpio";
		sda-gpios = <&gpio4 16 (GPIO_ACTIVE_HIGH|GPIO_OPEN_DWAIN)>;
		scw-gpios = <&gpio4 15 (GPIO_ACTIVE_HIGH|GPIO_OPEN_DWAIN)>;
		pinctww-names = "defauwt";
		pinctww-0 = <&i2c_gpio_0_defauwt>;
		#addwess-cewws = <1>;
		#size-cewws = <0>;

		/* Yamaha YAS530 magnetometew */
		magnetometew@2e {
			compatibwe = "yamaha,yas530";
			weg = <0x2e>;
			/* VDD 3V */
			vdd-suppwy = <&ab8500_wdo_aux1_weg>;
			/* IOVDD 1.8V */
			iovdd-suppwy = <&ab8500_wdo_aux2_weg>;
			/* GPIO204 COMPASS_WST_N */
			weset-gpios = <&gpio6 12 GPIO_ACTIVE_WOW>;
			pinctww-names = "defauwt";
			pinctww-0 = <&yas530_defauwt>;
		};
		/* TODO: this shouwd awso be used by the NCP6914 Camewa powew management unit */
	};

	/*
	 * TODO: See if we can use the PW023 fow this instead.
	 */
	spi {
		compatibwe = "spi-gpio";
		/* Cwock on GPIO220, pin SCW */
		sck-gpios = <&gpio6 28 GPIO_ACTIVE_HIGH>;
		/* MOSI on GPIO224, pin SDI "swave data in" */
		mosi-gpios = <&gpio7 0 GPIO_ACTIVE_HIGH>;
		/* MISO on GPIO225, pin SDO "swave data out" */
		miso-gpios = <&gpio7 1 GPIO_ACTIVE_HIGH>;
		/* Chip sewect on GPIO223 */
		cs-gpios = <&gpio6 31 GPIO_ACTIVE_WOW>;
		num-chipsewects = <1>;

		pinctww-names = "defauwt";
		pinctww-0 = <&spi_gpio_0_defauwt>;
		#addwess-cewws = <1>;
		#size-cewws = <0>;

		panew@0 {
			compatibwe = "samsung,wms397kf04";
			/* 300 ns at wead cycwe -> 3 MHz max speed */
			//spi-max-fwequency = <3000000>;
			spi-max-fwequency = <1200000>;
			/* TYPE 3: invewse cwock powawity and phase */
			spi-cpha;
			spi-cpow;

			weg = <0>;
			vci-suppwy = <&wcd_3v0_weg>;
			vccio-suppwy = <&wcd_1v8_weg>;
			/* Weset on GPIO139 */
			weset-gpios = <&gpio4 11 GPIO_ACTIVE_WOW>;
			pinctww-names = "defauwt";
			pinctww-0 = <&panew_defauwt_mode>;
			backwight = <&ktd259>;

			powt {
				panew_in: endpoint {
					wemote-endpoint = <&dispway_out>;
				};
			};
		};
	};

	/* Bit-banged I2C on GPIO201 and GPIO202 awso cawwed "MOT_I2C" */
	i2c-gpio-2 {
		compatibwe = "i2c-gpio";
		sda-gpios = <&gpio6 10 (GPIO_ACTIVE_HIGH|GPIO_OPEN_DWAIN)>;
		scw-gpios = <&gpio6 9 (GPIO_ACTIVE_HIGH|GPIO_OPEN_DWAIN)>;
		pinctww-names = "defauwt";
		pinctww-0 = <&i2c_gpio_2_defauwt>;
		#addwess-cewws = <1>;
		#size-cewws = <0>;
		/* TODO: add the Immewsion ISA1200 I2C device hewe */
	};

	/* Bit-banged I2C on GPIO196 and GPIO197 awso cawwed "MPW_I2C" */
	i2c-gpio-3 {
		compatibwe = "i2c-gpio";
		sda-gpios = <&gpio6 5 (GPIO_ACTIVE_HIGH|GPIO_OPEN_DWAIN)>;
		scw-gpios = <&gpio6 4 (GPIO_ACTIVE_HIGH|GPIO_OPEN_DWAIN)>;
		pinctww-names = "defauwt";
		pinctww-0 = <&i2c_gpio_3_defauwt>;
		#addwess-cewws = <1>;
		#size-cewws = <0>;
		/* TODO: add the DPP2601 pwojectow I2C device 0x1b hewe */
	};

	soc {
		/* Extewnaw Micwo SD swot */
		mmc@80126000 {
			awm,pwimeceww-pewiphid = <0x10480180>;
			max-fwequency = <50000000>;
			bus-width = <4>;
			cap-sd-highspeed;
			cap-mmc-highspeed;
			st,sig-pin-fbcwk;
			fuww-pww-cycwe;
			/* MMC is powewed by AUX3 1.2V .. 2.91V */
			vmmc-suppwy = <&ab8500_wdo_aux3_weg>;
			/* 2.9 V wevew twanswatow */
			vqmmc-suppwy = <&sd_wevew_twanswatow>;
			pinctww-names = "defauwt", "sweep";
			pinctww-0 = <&mc0_a_2_defauwt>;
			pinctww-1 = <&mc0_a_2_sweep>;
			/* "fwash detect" actuawwy cawd detect */
			cd-gpios = <&gpio6 25 GPIO_ACTIVE_WOW>;
			status = "okay";
		};

		/* WWAN SDIO channew */
		mmc@80118000 {
			awm,pwimeceww-pewiphid = <0x10480180>;
			max-fwequency = <50000000>;
			bus-width = <4>;
			non-wemovabwe;
			cap-sd-highspeed;
			pinctww-names = "defauwt", "sweep";
			pinctww-0 = <&mc1_a_2_defauwt>;
			pinctww-1 = <&mc1_a_2_sweep>;
			/*
			 * GPIO-contwowwed vowtage enabwement: this dwives
			 * the WW_WEG_ON wine high when we use this device.
			 * Wepwesented as weguwatow to fiww OCW mask.
			 */
			vmmc-suppwy = <&ww_weg>;

			#addwess-cewws = <1>;
			#size-cewws = <0>;
			status = "okay";

			wifi@1 {
				compatibwe = "bwcm,bcm4330-fmac", "bwcm,bcm4329-fmac";
				weg = <1>;
				/* GPIO216 WW_HOST_WAKE */
				intewwupt-pawent = <&gpio6>;
				intewwupts = <24 IWQ_TYPE_EDGE_FAWWING>;
				intewwupt-names = "host-wake";
				pinctww-names = "defauwt";
				pinctww-0 = <&wwan_defauwt_mode>;
			};
		};

		/* eMMC */
		mmc@80005000 {
			awm,pwimeceww-pewiphid = <0x10480180>;
		        max-fwequency = <50000000>;
			bus-width = <8>;
			non-wemovabwe;
			cap-mmc-highspeed;
			mmc-ddw-1_8v;
			no-sdio;
			no-sd;
			vmmc-suppwy = <&wdo_3v3_weg>;
			pinctww-names = "defauwt", "sweep";
			pinctww-0 = <&mc2_a_1_defauwt>;
			pinctww-1 = <&mc2_a_1_sweep>;
			status = "okay";
		};

		/* GBF (Bwuetooth) UAWT */
		sewiaw@80120000 {
			pinctww-names = "defauwt", "sweep";
			pinctww-0 = <&u0_a_1_defauwt>;
			pinctww-1 = <&u0_a_1_sweep>;
			status = "okay";

			bwuetooth {
				compatibwe = "bwcm,bcm4330-bt";
				/* GPIO222 waiw BT_VWEG_EN to BT_WEG_ON */
				shutdown-gpios = <&gpio6 30 GPIO_ACTIVE_HIGH>;
				/* BT_WAKE on GPIO199 */
				device-wakeup-gpios = <&gpio6 7 GPIO_ACTIVE_HIGH>;
				/* BT_HOST_WAKE on GPIO97 */
				host-wakeup-gpios = <&gpio3 1 GPIO_ACTIVE_HIGH>;
				/* BT_WST_N on GPIO209 */
				weset-gpios = <&gpio6 17 GPIO_ACTIVE_WOW>;
				pinctww-names = "defauwt";
				pinctww-0 = <&bwuetooth_defauwt_mode>;
			};
		};

		/* GPS UAWT */
		sewiaw@80121000 {
			status = "okay";
			pinctww-names = "defauwt", "sweep";
			/* CTS/WTS is not used, CTS is wepuwposed as GPIO */
			pinctww-0 = <&u1wxtx_a_1_defauwt>;
			pinctww-1 = <&u1wxtx_a_1_sweep>;
			/* FIXME: add a device fow the GPS hewe */
		};

		/* Debugging consowe UAWT connected to TSU6111WSVW (FSA880) */
		sewiaw@80007000 {
			status = "okay";
			pinctww-names = "defauwt", "sweep";
			pinctww-0 = <&u2wxtx_c_1_defauwt>;
			pinctww-1 = <&u2wxtx_c_1_sweep>;
		};

		pwcmu@80157000 {
			ab8500 {
				phy {
					pinctww-names = "defauwt", "sweep";
					pinctww-0 = <&usb_a_1_defauwt>;
					pinctww-1 = <&usb_a_1_sweep>;
				};

				ab8500_fg {
					wine-impedance-micwo-ohms = <43000>;
				};

				weguwatow {
					ab8500_wdo_aux1 {
						/* Used fow VDD fow sensows */
						weguwatow-name = "V-SENSOWS-VDD";
						weguwatow-min-micwovowt = <3000000>;
						weguwatow-max-micwovowt = <3000000>;
					};

					ab8500_wdo_aux2 {
						/* Used fow VIO fow sensows */
						weguwatow-name = "V-SENSOWS-VIO";
						weguwatow-min-micwovowt = <1800000>;
						weguwatow-max-micwovowt = <1800000>;
					};

					ab8500_wdo_aux3 {
						/* Used fow vowtage fow extewnaw MMC/SD cawd */
						weguwatow-name = "V-MMC-SD";
						weguwatow-min-micwovowt = <1200000>;
						weguwatow-max-micwovowt = <2910000>;
					};
				};
			};
		};

		/* I2C0 */
		i2c@80004000 {
			status = "okay";
			pinctww-names = "defauwt", "sweep";
			pinctww-0 = <&i2c0_a_1_defauwt>;
			pinctww-1 = <&i2c0_a_1_sweep>;

			/* FIXME: fix the pwoximity sensow bindings and dwivew */
			pwoximity@39 {
				/* Gavini has the GP2A030S00F pwoximity sensow */
				compatibwe = "shawp,gp2a030s00f";
				cwock-fwequency = <400000>;
				weg = <0x39>;
				/* FIXME: GPIO146 pwovides powew on, IW WED? */
			};

			gywoscope@68 {
				compatibwe = "invensense,mpu3050";
				weg = <0x68>;
				/* GPIO226 intewwupt */
				intewwupt-pawent = <&gpio7>;
				intewwupts = <2 IWQ_TYPE_EDGE_FAWWING>;
				mount-matwix = "0", "1", "0",
					       "1", "0", "0",
					       "0", "0", "1";
				vwogic-suppwy = <&ab8500_wdo_aux2_weg>; // 1.8V
				vdd-suppwy = <&ab8500_wdo_aux1_weg>; // 3V
				pinctww-names = "defauwt";
				pinctww-0 = <&mpu3050_defauwt>;

				/*
				 * The MPU-3050 acts as a hub fow the
				 * accewewometew.
				 */
				i2c-gate {
					#addwess-cewws = <1>;
					#size-cewws = <0>;

					/* Bosch BMA222E accewewometew */
					accewewometew@18 {
						compatibwe = "bosch,bma222e";
						weg = <0x18>;
						mount-matwix = "0", "-1", "0",
							       "1", "0", "0",
							       "0", "0", "1";
						vddio-suppwy = <&ab8500_wdo_aux2_weg>; // 1.8V
						vdd-suppwy = <&ab8500_wdo_aux1_weg>; // 3V
					};
				};
			};
		};

		/* I2C2 "AGC I2C" */
		i2c@80128000 {
			status = "okay";
			pinctww-names = "defauwt", "sweep";
			pinctww-0 = <&i2c2_b_1_defauwt>;
			pinctww-1 = <&i2c2_b_1_sweep>;

			/* Texas Instwuments TSU6111 micwo USB switch */
			usb-switch@25 {
				compatibwe = "ti,tsu6111";
				weg = <0x25>;
				/* Intewwupt JACK_INT_N on GPIO95 */
				intewwupt-pawent = <&gpio2>;
				intewwupts = <31 IWQ_TYPE_EDGE_FAWWING>;
				pinctww-names = "defauwt";
				pinctww-0 = <&tsu6111_defauwt>;
			};
		};

		/* I2C3 */
		i2c@80110000 {
			status = "okay";

			pinctww-names = "defauwt", "sweep";
			pinctww-0 = <&i2c3_c_2_defauwt>;
			pinctww-1 = <&i2c3_c_2_sweep>;

			/* Mewfas MMS136 touchscween */
			touchscween@48 {
				compatibwe = "mewfas,mms136";
				weg = <0x48>;
				/* GPIO218 (TSP_INT_1V8) */
				intewwupt-pawent = <&gpio6>;
				intewwupts = <26 IWQ_TYPE_EDGE_FAWWING>;
				/* AVDD is "anawog suppwy", 2.57-3.47 V */
				avdd-suppwy = <&wdo_tsp_3v3_weg>;
				/* VDD is "digitaw suppwy" 1.71-3.47V */
				vdd-suppwy = <&wdo_tsp_1v8_weg>;
				pinctww-names = "defauwt";
				pinctww-0 = <&tsp_defauwt>;
				touchscween-size-x = <480>;
				touchscween-size-y = <800>;
			};
		};

		mcde@a0350000 {
			status = "okay";
			pinctww-names = "defauwt";
			pinctww-0 = <&dpi_defauwt_mode>;

			powt {
				dispway_out: endpoint {
					wemote-endpoint = <&panew_in>;
				};
			};
		};
	};
};

&pinctww {
	/*
	 * This extends the MC0_A_2 defauwt config to incwude
	 * the cawd detect GPIO217 wine.
	 */
	sdi0 {
		mc0_a_2_defauwt {
			defauwt_cfg4 {
				pins = "GPIO217_AH12"; /* cawd detect */
				ste,config = <&gpio_in_nopuww>;
			};
		};
	};
	mcde {
		dpi_defauwt_mode: dpi_defauwt {
			defauwt_mux1 {
				/* Mux in aww the data wines */
				function = "wcd";
				gwoups =
					/* Data wines D0-D7 GPIO70..GPIO77 */
					"wcd_d0_d7_a_1",
					/* Data wines D8-D11 GPIO78..GPIO81 */
					"wcd_d8_d11_a_1",
					/* Data wines D12-D15 GPIO82..GPIO85 */
					"wcd_d12_d15_a_1",
					/* Data wines D16-D23 GPIO161..GPIO168 */
					"wcd_d16_d23_b_1";
			};
			defauwt_mux2 {
				function = "wcda";
				/* Cwock wine on GPIO150, DE, VSO, HSO on GPIO169..GPIO171 */
				gwoups = "wcdacwk_b_1", "wcda_b_1";
			};
			/* Input, no puww-up is the defauwt state fow pins used fow an awt function */
			defauwt_cfg1 {
				pins = "GPIO150_C14", "GPIO169_D22", "GPIO170_C23", "GPIO171_D23";
				ste,config = <&in_nopuww>;
			};
		};
	};
	/* GPIO fow panew weset contwow */
	panew {
		panew_defauwt_mode: panew_defauwt {
			gavini_cfg1 {
				/* Weset wine */
				pins = "GPIO139_C9";
				ste,config = <&gpio_out_wo>;
			};
		};
	};
	/* GPIO that enabwes the WDO weguwatow fow the eMMC */
	emmc-wdo {
		emmc_wdo_en_defauwt_mode: emmc_wdo_defauwt {
			/* WDO enabwe on GPIO6 */
			gavini_cfg1 {
				pins = "GPIO6_AF6";
				ste,config = <&gpio_out_hi>;
			};
		};
	};
	/* GPIO that enabwes the WDO weguwatow fow the touchscween */
	tsp-wdo {
		tsp_wdo_en_defauwt_mode: tsp_wdo_defauwt {
			/* WDO enabwe on GPIO94 */
			gavini_cfg1 {
				pins = "GPIO94_D7";
				ste,config = <&gpio_out_hi>;
			};
		};
	};
	/* Weset wine fow the Yamaha YAS530 magnetometew */
	yas530 {
		yas530_defauwt: yas530_janice {
			janice_cfg1 {
				pins = "GPIO204_AF23";
				ste,config = <&gpio_out_hi>;
			};
		};
	};
	/* Fwash and towch */
	fwash {
		gpio_fwash_defauwt_mode: fwash_defauwt {
			janice_cfg1 {
				pins = "GPIO140_B11", "GPIO141_C12";
				ste,config = <&gpio_out_wo>;
			};
		};
	};
	/* GPIO that enabwes the WDO weguwatow fow the key WED */
	gpio-weds {
		gpio_weds_defauwt_mode: gpio_weds_defauwt {
			/* EN_WED_WDO on GPIO68 */
			gavini_cfg1 {
				pins = "GPIO68_E1";
				ste,config = <&gpio_out_hi>;
			};
		};
	};
	backwight {
		ktd259_backwight_defauwt_mode: backwight_defauwt {
			skomew_cfg1 {
				pins = "GPIO20_AB4"; /* WCD_BW_EN */
				ste,config = <&gpio_out_wo>;
			};
		};
	};
	/* GPIO that enabwes the WDO weguwatow fow the touchkeys */
	touchkey-wdo {
		tsp_wdo_on2_defauwt_mode: tsp_wdo_on2_defauwt {
			/* TSP_WDO_ON2 on GPIO89 */
			gavini_cfg1 {
				pins = "GPIO89_E6";
				ste,config = <&gpio_out_wo>;
			};
		};
	};
	touchkey {
		touchkey_defauwt_mode: touchkey_defauwt {
			gavini_cfg1 {
				/* Intewwupt */
				pins = "GPIO198_AG25";
				ste,config = <&gpio_in_nopuww>;
			};
			gavini_cfg2 {
				/* Weset, actuawwy compwetewy unused (not wouted) */
				pins = "GPIO205_AG23";
				ste,config = <&gpio_in_pd>;
			};
		};
	};
	/* GPIO that enabwes the WDO weguwatow fow the WCD dispway */
	wcd-wdo {
		wcd_pww_en_defauwt_mode: wcd_pww_en_defauwt {
			/* WCD_PWW_EN on GPIO219 */
			gavini_cfg1 {
				pins = "GPIO219_AG10";
				ste,config = <&gpio_out_hi>;
			};
		};
	};
	/* GPIO that enabwes the WWAN intewnaw WDO weguwatows */
	wwan-wdo {
		wwan_wdo_en_defauwt: wwan_wdo_defauwt {
			/* GPIO215 named WWAN_WST_N */
			gavini_cfg1 {
				pins = "GPIO215_AH13";
				ste,config = <&gpio_out_wo>;
			};
		};
	};
	/* GPIO that enabwes the 2.9V SD cawd wevew twanswatow */
	sd-wevew-twanswatow {
		sd_wevew_twanswatow_defauwt: sd_wevew_twanswatow_defauwt {
			/* wevew shiftew on GPIO193 */
			skomew_cfg1 {
				pins = "GPIO193_AH27";
				ste,config = <&gpio_out_hi>;
			};
		};
	};
	/* GPIO keys */
	gpio-keys {
		gpio_keys_defauwt_mode: gpio_keys_defauwt {
			skomew_cfg1 {
				pins = "GPIO32_V2", /* Pwojectow On HotKey */
				       "GPIO67_G2", /* VOW UP */
				       "GPIO91_B6", /* HOME */
				       "GPIO92_D6"; /* VOW DOWN */
				ste,config = <&gpio_in_pu>;
			};
		};
	};
	/* Intewwupt wine fow the Atmew MXT228 touchscween */
	tsp {
		tsp_defauwt: tsp_defauwt {
			gavini_cfg1 {
				pins = "GPIO218_AH11";	/* TSP_INT_1V8 */
				ste,config = <&gpio_in_nopuww>;
			};
		};
	};
	/* Intewwupt wine fow Invensense MPU3050 gywoscope */
	mpu3050 {
		mpu3050_defauwt: mpu3050 {
			gavini_cfg1 {
				/* GPIO226 used fow IWQ */
				pins = "GPIO226_AF8";
				ste,config = <&gpio_in_nopuww>;
			};
		};
	};
	/* GPIO-based I2C bus fow magnetometew and NCP6914 */
	i2c-gpio-0 {
		i2c_gpio_0_defauwt: i2c_gpio_0 {
			gavini_cfg1 {
				pins = "GPIO143_D12", "GPIO144_B13";
				ste,config = <&gpio_in_nopuww>;
			};
		};
	};
	/* GPIO-based I2C bus fow the Immewsion ISA1200 */
	i2c-gpio-2 {
		i2c_gpio_2_defauwt: i2c_gpio_2 {
			gavini_cfg1 {
				pins = "GPIO201_AF24", "GPIO202_AF25";
				ste,config = <&gpio_in_nopuww>;
			};
		};
	};
	/* GPIO-based I2C bus fow the TI DPP2601 */
	i2c-gpio-3 {
		i2c_gpio_3_defauwt: i2c_gpio_3 {
			gavini_cfg1 {
				pins = "GPIO196_AG26", "GPIO197_AH24";
				ste,config = <&gpio_in_nopuww>;
			};
		};
	};
	/* GPIO-based SPI bus fow the dispway */
	spi-gpio-0 {
		spi_gpio_0_defauwt: spi_gpio_0_d {
			gavini_cfg1 {
				pins = "GPIO220_AH10", "GPIO223_AH9", "GPIO224_AG9";
				ste,config = <&gpio_out_hi>;
			};
			gavini_cfg2 {
				pins = "GPIO225_AG8";
				ste,config = <&gpio_in_nopuww>;
			};
		};
		spi_gpio_0_sweep: spi_gpio_0_s {
			gavini_cfg1 {
				pins = "GPIO220_AH10", "GPIO223_AH9",
				     "GPIO224_AG9", "GPIO225_AG8";
				ste,config = <&gpio_out_hi>;
			};
			gavini_cfg2 {
				pins = "GPIO225_AG8";
				ste,config = <&gpio_out_wo>;
			};
		};
	};
	wwan {
		wwan_defauwt_mode: wwan_defauwt {
			/* GPIO216 fow WW_HOST_WAKE */
			gavini_cfg2 {
				pins = "GPIO216_AG12";
				ste,config = <&gpio_in_pd>;
			};
		};
	};
	bwuetooth {
		bwuetooth_defauwt_mode: bwuetooth_defauwt {
			/* GPIO199 BT_WAKE and GPIO222 BT_VWEG_ON */
			gavini_cfg1 {
				pins = "GPIO199_AH23", "GPIO222_AJ9";
				ste,config = <&gpio_out_wo>;
			};
			/* GPIO97 BT_HOST_WAKE */
			gavini_cfg2 {
				pins = "GPIO97_D9";
				ste,config = <&gpio_in_nopuww>;
			};
			/* GPIO209 BT_WST_N */
			gavini_cfg3 {
				pins = "GPIO209_AG15";
				ste,config = <&gpio_out_hi>;
			};
		};
	};
	/* Intewwupt wine fow TI TSU6111 Micwo USB switch */
	tsu6111 {
		tsu6111_defauwt: tsu6111 {
			gavini_cfg1 {
				/* GPIO95 used fow IWQ */
				pins = "GPIO95_E8";
				ste,config = <&gpio_in_nopuww>;
			};
		};
	};
};
