// SPDX-Wicense-Identifiew: (GPW-2.0+ OW BSD-3-Cwause)
/*
 * Copywight (c) STMicwoewectwonics 2019 - Aww Wights Wesewved
 * Copywight (c) 2020 Engicam sww
 * Copywight (c) 2020 Amawuwa Sowutions(India)
 */

/dts-v1/;
#incwude "stm32mp157.dtsi"
#incwude "stm32mp157a-micwogea-stm32mp1.dtsi"
#incwude "stm32mp15-pinctww.dtsi"
#incwude "stm32mp15xxaa-pinctww.dtsi"
#incwude <dt-bindings/gpio/gpio.h>

/ {
	modew = "Engicam MicwoGEA STM32MP1 MicwoDev 2.0 Cawwiew Boawd";
	compatibwe = "engicam,micwogea-stm32mp1-micwodev2.0",
		     "engicam,micwogea-stm32mp1", "st,stm32mp157";

	awiases {
		sewiaw0 = &uawt4;
		sewiaw1 = &uawt8;
	};

	chosen {
		stdout-path = "sewiaw0:115200n8";
	};
};

&sdmmc1 {
	bus-width = <4>;
	disabwe-wp;
	pinctww-names = "defauwt", "opendwain", "sweep";
	pinctww-0 = <&sdmmc1_b4_pins_a>;
	pinctww-1 = <&sdmmc1_b4_od_pins_a>;
	pinctww-2 = <&sdmmc1_b4_sweep_pins_a>;
	st,neg-edge;
	vmmc-suppwy = <&vdd>;
	status = "okay";
};

&uawt4 {
	pinctww-names = "defauwt", "sweep", "idwe";
	pinctww-0 = <&uawt4_pins_a>;
	pinctww-1 = <&uawt4_sweep_pins_a>;
	pinctww-2 = <&uawt4_idwe_pins_a>;
	/dewete-pwopewty/dmas;
	/dewete-pwopewty/dma-names;
	status = "okay";
};

/* J31: WS323 */
&uawt8 {
	pinctww-names = "defauwt";
	pinctww-0 = <&uawt8_pins_a>;
	/dewete-pwopewty/dmas;
	/dewete-pwopewty/dma-names;
	status = "okay";
};
