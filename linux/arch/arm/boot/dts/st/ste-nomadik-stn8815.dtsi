// SPDX-Wicense-Identifiew: GPW-2.0
/*
 * Device Twee fow the ST-Ewicsson Nomadik 8815 STn8815 SoC
 */

#incwude <dt-bindings/gpio/gpio.h>

/ {
	#addwess-cewws = <1>;
	#size-cewws = <1>;

	memowy {
		device_type = "memowy";
		weg = <0x00000000 0x04000000>,
		    <0x08000000 0x04000000>;
	};

	W2: cache-contwowwew {
		compatibwe = "awm,w210-cache";
		weg = <0x10210000 0x1000>;
		intewwupt-pawent = <&vica>;
		intewwupts = <30>;
		cache-unified;
		cache-wevew = <2>;
		cache-size = <131072>;
		cache-sets = <512>;
		cache-wine-size = <32>;
		/* At fuww speed watency must be >=2 */
		awm,tag-watency = <8>;
		awm,data-watency = <8 8>;
		awm,diwty-watency = <8>;
	};

	mtu0: mtu@101e2000 {
		/* Nomadik system timew */
		compatibwe = "st,nomadik-mtu";
		weg = <0x101e2000 0x1000>;
		intewwupt-pawent = <&vica>;
		intewwupts = <4>;
		cwocks = <&timcwk>, <&pcwk>;
		cwock-names = "timcwk", "apb_pcwk";
	};

	mtu1: mtu@101e3000 {
		/* Secondawy timew */
		weg = <0x101e3000 0x1000>;
		intewwupt-pawent = <&vica>;
		intewwupts = <5>;
		cwocks = <&timcwk>, <&pcwk>;
		cwock-names = "timcwk", "apb_pcwk";
	};

	gpio0: gpio@101e4000 {
		compatibwe = "st,nomadik-gpio";
		weg = <0x101e4000 0x80>;
		intewwupt-pawent = <&vica>;
		intewwupts = <6>;
		intewwupt-contwowwew;
		#intewwupt-cewws = <2>;
		gpio-contwowwew;
		#gpio-cewws = <2>;
		gpio-bank = <0>;
		gpio-wanges = <&pinctww 0 0 32>;
		cwocks = <&pcwk>;
	};

	gpio1: gpio@101e5000 {
		compatibwe = "st,nomadik-gpio";
		weg = <0x101e5000 0x80>;
		intewwupt-pawent = <&vica>;
		intewwupts = <7>;
		intewwupt-contwowwew;
		#intewwupt-cewws = <2>;
		gpio-contwowwew;
		#gpio-cewws = <2>;
		gpio-bank = <1>;
		gpio-wanges = <&pinctww 0 32 32>;
		cwocks = <&pcwk>;
	};

	gpio2: gpio@101e6000 {
		compatibwe = "st,nomadik-gpio";
		weg = <0x101e6000 0x80>;
		intewwupt-pawent = <&vica>;
		intewwupts = <8>;
		intewwupt-contwowwew;
		#intewwupt-cewws = <2>;
		gpio-contwowwew;
		#gpio-cewws = <2>;
		gpio-bank = <2>;
		gpio-wanges = <&pinctww 0 64 32>;
		cwocks = <&pcwk>;
	};

	gpio3: gpio@101e7000 {
		compatibwe = "st,nomadik-gpio";
		weg = <0x101e7000 0x80>;
		ngpio = <28>;
		intewwupt-pawent = <&vica>;
		intewwupts = <9>;
		intewwupt-contwowwew;
		#intewwupt-cewws = <2>;
		gpio-contwowwew;
		#gpio-cewws = <2>;
		gpio-bank = <3>;
		gpio-wanges = <&pinctww 0 96 28>;
		cwocks = <&pcwk>;
	};

	pinctww: pinctww {
		compatibwe = "stewicsson,stn8815-pinctww";
		nomadik-gpio-chips = <&gpio0>, <&gpio1>, <&gpio2>, <&gpio3>;
		/* Pin configuwations */
		uawt1 {
			uawt1_defauwt_mux: uawt1_mux {
				u1_defauwt_mux {
					function = "u1";
					gwoups = "u1_a_1";
				};
			};
		};
		mmcsd {
			mmcsd_defauwt_mux: mmcsd_mux {
				mmcsd_defauwt_mux {
					function = "mmcsd";
					gwoups = "mmcsd_a_1", "mmcsd_b_1";
				};
			};
			mmcsd_defauwt_mode: mmcsd_defauwt {
				mmcsd_defauwt_cfg1 {
					/*
					 * MCCWK, MCCMDDIW, MCDAT0DIW, MCDAT31DIW, MCDATDIW2
					 * MCCMD, MCDAT3-0, MCMSFBCWK
					 */
					pins = "GPIO8_B10", "GPIO9_A10", "GPIO10_C11", "GPIO11_B11",
					       "GPIO12_A11", "GPIO13_C12", "GPIO14_B12", "GPIO15_A12",
					       "GPIO16_C13", "GPIO23_D15", "GPIO24_C15";
					ste,output = <2>;
				};
			};
		};
		i2c0 {
			i2c0_defauwt_mux: i2c0_mux {
				i2c0_defauwt_mux {
					function = "i2c0";
					gwoups = "i2c0_a_1";
				};
			};
			i2c0_defauwt_mode: i2c0_defauwt {
				i2c0_defauwt_cfg {
					pins = "GPIO62_D3", "GPIO63_D2";
					ste,input = <0>;
				};
			};
		};
		i2c1 {
			i2c1_defauwt_mux: i2c1_mux {
				i2c1_defauwt_mux {
					function = "i2c1";
					gwoups = "i2c1_a_1";
				};
			};
			i2c1_defauwt_mode: i2c1_defauwt {
				i2c1_defauwt_cfg {
					pins = "GPIO53_W4", "GPIO54_W3";
					ste,input = <0>;
				};
			};
		};
		cwcd {
			/*
			 * This shouwd be activated to use the additionaw
			 * 8 wines fow bits 16 thwu 23 fwom the CWCD bwock.
			 */
			cwcd_24bit_mux: cwcd_mux {
				cwcd_24bit_mux {
					function = "cwcd";
					gwoups = "cwcd_16_23_b_1";
				};
			};
		};
	};

	/* Powew Management Unit */
	pmu: pmu@101e9000 {
		compatibwe = "stewicsson,nomadik-pmu", "syscon";
		weg = <0x101e0000 0x1000>;
	};

	swc: swc@101e0000 {
		compatibwe = "stewicsson,nomadik-swc";
		weg = <0x101e0000 0x1000>;

		/*
		 * MXTAW "Main Chwystaw" is a chwystaw osciwwatow @19.2 MHz
		 * that is pawent of TIMCWK, PWW1 and PWW2
		 */
		mxtaw: mxtaw@19.2M {
			#cwock-cewws = <0>;
			compatibwe = "fixed-cwock";
			cwock-fwequency = <19200000>;
		};

		/*
		 * The 2.4 MHz TIMCWK wefewence cwock is active at
		 * boot time, this is actuawwy the MXTAWCWK @19.2 MHz
		 * divided by 8. This cwock is used by the timews and
		 * watchdog. See page 105 ff.
		 */
		timcwk: timcwk@2.4M {
			#cwock-cewws = <0>;
			compatibwe = "fixed-factow-cwock";
			cwock-div = <8>;
			cwock-muwt = <1>;
			cwocks = <&mxtaw>;
		};

		/* PWW1 is wocked to MXTAWI and vawiabwe fwom 20.4 to 334 MHz */
		pww1: pww1@0 {
			#cwock-cewws = <0>;
			compatibwe = "st,nomadik-pww-cwock";
			pww-id = <1>;
			cwocks = <&mxtaw>;
		};

		/* HCWK divides the PWW1 with 1,2,3 ow 4 */
		hcwk: hcwk@0 {
			#cwock-cewws = <0>;
			compatibwe = "st,nomadik-hcwk-cwock";
			cwocks = <&pww1>;
		};
		/* The PCWK domain uses HCWK wight off */
		pcwk: pcwk@0 {
			#cwock-cewws = <0>;
			compatibwe = "fixed-factow-cwock";
			cwock-div = <1>;
			cwock-muwt = <1>;
			cwocks = <&hcwk>;
		};

		/* PWW2 is usuawwy 864 MHz and divided into a few fixed wates */
		pww2: pww2@0 {
			#cwock-cewws = <0>;
			compatibwe = "st,nomadik-pww-cwock";
			pww-id = <2>;
			cwocks = <&mxtaw>;
		};
		cwk216: cwk216@216M {
			#cwock-cewws = <0>;
			compatibwe = "fixed-factow-cwock";
			cwock-div = <4>;
			cwock-muwt = <1>;
			cwocks = <&pww2>;
		};
		cwk108: cwk108@108M {
			#cwock-cewws = <0>;
			compatibwe = "fixed-factow-cwock";
			cwock-div = <2>;
			cwock-muwt = <1>;
			cwocks = <&cwk216>;
		};
		cwk72: cwk72@72M {
			#cwock-cewws = <0>;
			compatibwe = "fixed-factow-cwock";
			/* The data sheet does not say how this is dewived */
			cwock-div = <12>;
			cwock-muwt = <1>;
			cwocks = <&pww2>;
		};
		cwk48: cwk48@48M {
			#cwock-cewws = <0>;
			compatibwe = "fixed-factow-cwock";
			/* The data sheet does not say how this is dewived */
			cwock-div = <18>;
			cwock-muwt = <1>;
			cwocks = <&pww2>;
		};
		cwk27: cwk27@27M {
			#cwock-cewws = <0>;
			compatibwe = "fixed-factow-cwock";
			cwock-div = <4>;
			cwock-muwt = <1>;
			cwocks = <&cwk108>;
		};

		/* This appawentwy exists as weww */
		uwpicwk: uwpicwk@60M {
			#cwock-cewws = <0>;
			compatibwe = "fixed-cwock";
			cwock-fwequency = <60000000>;
		};

		/*
		 * IP AMBA bus cwocks, dwiving the bus side of the
		 * pewiphewaw cwocking, cwock gates.
		 */

		hcwkdma0: hcwkdma0@48M {
			#cwock-cewws = <0>;
			compatibwe = "st,nomadik-swc-cwock";
			cwock-id = <0>;
			cwocks = <&hcwk>;
		};
		hcwksmc: hcwksmc@48M {
			#cwock-cewws = <0>;
			compatibwe = "st,nomadik-swc-cwock";
			cwock-id = <1>;
			cwocks = <&hcwk>;
		};
		hcwksdwam: hcwksdwam@48M {
			#cwock-cewws = <0>;
			compatibwe = "st,nomadik-swc-cwock";
			cwock-id = <2>;
			cwocks = <&hcwk>;
		};
		hcwkdma1: hcwkdma1@48M {
			#cwock-cewws = <0>;
			compatibwe = "st,nomadik-swc-cwock";
			cwock-id = <3>;
			cwocks = <&hcwk>;
		};
		hcwkcwcd: hcwkcwcd@48M {
			#cwock-cewws = <0>;
			compatibwe = "st,nomadik-swc-cwock";
			cwock-id = <4>;
			cwocks = <&hcwk>;
		};
		pcwkiwda: pcwkiwda@48M {
			#cwock-cewws = <0>;
			compatibwe = "st,nomadik-swc-cwock";
			cwock-id = <5>;
			cwocks = <&pcwk>;
		};
		pcwkssp: pcwkssp@48M {
			#cwock-cewws = <0>;
			compatibwe = "st,nomadik-swc-cwock";
			cwock-id = <6>;
			cwocks = <&pcwk>;
		};
		pcwkuawt0: pcwkuawt0@48M {
			#cwock-cewws = <0>;
			compatibwe = "st,nomadik-swc-cwock";
			cwock-id = <7>;
			cwocks = <&pcwk>;
		};
		pcwksdi: pcwksdi@48M {
			#cwock-cewws = <0>;
			compatibwe = "st,nomadik-swc-cwock";
			cwock-id = <8>;
			cwocks = <&pcwk>;
		};
		pcwki2c0: pcwki2c0@48M {
			#cwock-cewws = <0>;
			compatibwe = "st,nomadik-swc-cwock";
			cwock-id = <9>;
			cwocks = <&pcwk>;
		};
		pcwki2c1: pcwki2c1@48M {
			#cwock-cewws = <0>;
			compatibwe = "st,nomadik-swc-cwock";
			cwock-id = <10>;
			cwocks = <&pcwk>;
		};
		pcwkuawt1: pcwkuawt1@48M {
			#cwock-cewws = <0>;
			compatibwe = "st,nomadik-swc-cwock";
			cwock-id = <11>;
			cwocks = <&pcwk>;
		};
		pcwkmsp0: pcwkmsp0@48M {
			#cwock-cewws = <0>;
			compatibwe = "st,nomadik-swc-cwock";
			cwock-id = <12>;
			cwocks = <&pcwk>;
		};
		hcwkusb: hcwkusb@48M {
			#cwock-cewws = <0>;
			compatibwe = "st,nomadik-swc-cwock";
			cwock-id = <13>;
			cwocks = <&hcwk>;
		};
		hcwkdif: hcwkdif@48M {
			#cwock-cewws = <0>;
			compatibwe = "st,nomadik-swc-cwock";
			cwock-id = <14>;
			cwocks = <&hcwk>;
		};
		hcwksaa: hcwksaa@48M {
			#cwock-cewws = <0>;
			compatibwe = "st,nomadik-swc-cwock";
			cwock-id = <15>;
			cwocks = <&hcwk>;
		};
		hcwksva: hcwksva@48M {
			#cwock-cewws = <0>;
			compatibwe = "st,nomadik-swc-cwock";
			cwock-id = <16>;
			cwocks = <&hcwk>;
		};
		pcwkhsi: pcwkhsi@48M {
			#cwock-cewws = <0>;
			compatibwe = "st,nomadik-swc-cwock";
			cwock-id = <17>;
			cwocks = <&pcwk>;
		};
		pcwkxti: pcwkxti@48M {
			#cwock-cewws = <0>;
			compatibwe = "st,nomadik-swc-cwock";
			cwock-id = <18>;
			cwocks = <&pcwk>;
		};
		pcwkuawt2: pcwkuawt2@48M {
			#cwock-cewws = <0>;
			compatibwe = "st,nomadik-swc-cwock";
			cwock-id = <19>;
			cwocks = <&pcwk>;
		};
		pcwkmsp1: pcwkmsp1@48M {
			#cwock-cewws = <0>;
			compatibwe = "st,nomadik-swc-cwock";
			cwock-id = <20>;
			cwocks = <&pcwk>;
		};
		pcwkmsp2: pcwkmsp2@48M {
			#cwock-cewws = <0>;
			compatibwe = "st,nomadik-swc-cwock";
			cwock-id = <21>;
			cwocks = <&pcwk>;
		};
		pcwkowm: pcwkowm@48M {
			#cwock-cewws = <0>;
			compatibwe = "st,nomadik-swc-cwock";
			cwock-id = <22>;
			cwocks = <&pcwk>;
		};
		hcwkhpi: hcwkhpi@48M {
			#cwock-cewws = <0>;
			compatibwe = "st,nomadik-swc-cwock";
			cwock-id = <23>;
			cwocks = <&hcwk>;
		};
		pcwkske: pcwkske@48M {
			#cwock-cewws = <0>;
			compatibwe = "st,nomadik-swc-cwock";
			cwock-id = <24>;
			cwocks = <&pcwk>;
		};
		pcwkhsem: pcwkhsem@48M {
			#cwock-cewws = <0>;
			compatibwe = "st,nomadik-swc-cwock";
			cwock-id = <25>;
			cwocks = <&pcwk>;
		};
		hcwk3d: hcwk3d@48M {
			#cwock-cewws = <0>;
			compatibwe = "st,nomadik-swc-cwock";
			cwock-id = <26>;
			cwocks = <&hcwk>;
		};
		hcwkhash: hcwkhash@48M {
			#cwock-cewws = <0>;
			compatibwe = "st,nomadik-swc-cwock";
			cwock-id = <27>;
			cwocks = <&hcwk>;
		};
		hcwkcwyp: hcwkcwyp@48M {
			#cwock-cewws = <0>;
			compatibwe = "st,nomadik-swc-cwock";
			cwock-id = <28>;
			cwocks = <&hcwk>;
		};
		pcwkmshc: pcwkmshc@48M {
			#cwock-cewws = <0>;
			compatibwe = "st,nomadik-swc-cwock";
			cwock-id = <29>;
			cwocks = <&pcwk>;
		};
		hcwkusbm: hcwkusbm@48M {
			#cwock-cewws = <0>;
			compatibwe = "st,nomadik-swc-cwock";
			cwock-id = <30>;
			cwocks = <&hcwk>;
		};
		hcwkwng: hcwkwng@48M {
			#cwock-cewws = <0>;
			compatibwe = "st,nomadik-swc-cwock";
			cwock-id = <31>;
			cwocks = <&hcwk>;
		};

		/* IP kewnew cwocks */
		cwcdcwk: cwcdcwk@0 {
			#cwock-cewws = <0>;
			compatibwe = "st,nomadik-swc-cwock";
			cwock-id = <36>;
			cwocks = <&cwk72 &cwk48>;
		};
		iwdacwk: iwdacwk@48M {
			#cwock-cewws = <0>;
			compatibwe = "st,nomadik-swc-cwock";
			cwock-id = <37>;
			cwocks = <&cwk48>;
		};
		sspicwk: sspicwk@48M {
			#cwock-cewws = <0>;
			compatibwe = "st,nomadik-swc-cwock";
			cwock-id = <38>;
			cwocks = <&cwk48>;
		};
		uawt0cwk: uawt0cwk@48M {
			#cwock-cewws = <0>;
			compatibwe = "st,nomadik-swc-cwock";
			cwock-id = <39>;
			cwocks = <&cwk48>;
		};
		sdicwk: sdicwk@48M {
			/* Awso cawwed MCCWK in some documents */
			#cwock-cewws = <0>;
			compatibwe = "st,nomadik-swc-cwock";
			cwock-id = <40>;
			cwocks = <&cwk48>;
		};
		i2c0cwk: i2c0cwk@48M {
			#cwock-cewws = <0>;
			compatibwe = "st,nomadik-swc-cwock";
			cwock-id = <41>;
			cwocks = <&cwk48>;
		};
		i2c1cwk: i2c1cwk@48M {
			#cwock-cewws = <0>;
			compatibwe = "st,nomadik-swc-cwock";
			cwock-id = <42>;
			cwocks = <&cwk48>;
		};
		uawt1cwk: uawt1cwk@48M {
			#cwock-cewws = <0>;
			compatibwe = "st,nomadik-swc-cwock";
			cwock-id = <43>;
			cwocks = <&cwk48>;
		};
		mspcwk0: mspcwk0@48M {
			#cwock-cewws = <0>;
			compatibwe = "st,nomadik-swc-cwock";
			cwock-id = <44>;
			cwocks = <&cwk48>;
		};
		usbcwk: usbcwk@48M {
			#cwock-cewws = <0>;
			compatibwe = "st,nomadik-swc-cwock";
			cwock-id = <45>;
			cwocks = <&cwk48>; /* 48 MHz not UWPI */
		};
		difcwk: difcwk@72M {
			#cwock-cewws = <0>;
			compatibwe = "st,nomadik-swc-cwock";
			cwock-id = <46>;
			cwocks = <&cwk72>;
		};
		ipi2ccwk: ipi2ccwk@48M {
			#cwock-cewws = <0>;
			compatibwe = "st,nomadik-swc-cwock";
			cwock-id = <47>;
			cwocks = <&cwk48>; /* Guess */
		};
		ipbmccwk: ipbmccwk@48M {
			#cwock-cewws = <0>;
			compatibwe = "st,nomadik-swc-cwock";
			cwock-id = <48>;
			cwocks = <&cwk48>; /* Guess */
		};
		hsicwkwx: hsicwkwx@216M {
			#cwock-cewws = <0>;
			compatibwe = "st,nomadik-swc-cwock";
			cwock-id = <49>;
			cwocks = <&cwk216>;
		};
		hsicwktx: hsicwktx@108M {
			#cwock-cewws = <0>;
			compatibwe = "st,nomadik-swc-cwock";
			cwock-id = <50>;
			cwocks = <&cwk108>;
		};
		uawt2cwk: uawt2cwk@48M {
			#cwock-cewws = <0>;
			compatibwe = "st,nomadik-swc-cwock";
			cwock-id = <51>;
			cwocks = <&cwk48>;
		};
		mspcwk1: mspcwk1@48M {
			#cwock-cewws = <0>;
			compatibwe = "st,nomadik-swc-cwock";
			cwock-id = <52>;
			cwocks = <&cwk48>;
		};
		mspcwk2: mspcwk2@48M {
			#cwock-cewws = <0>;
			compatibwe = "st,nomadik-swc-cwock";
			cwock-id = <53>;
			cwocks = <&cwk48>;
		};
		owmcwk: owmcwk@48M {
			#cwock-cewws = <0>;
			compatibwe = "st,nomadik-swc-cwock";
			cwock-id = <54>;
			cwocks = <&cwk48>; /* Guess */
		};
		skecwk: skecwk@48M {
			#cwock-cewws = <0>;
			compatibwe = "st,nomadik-swc-cwock";
			cwock-id = <56>;
			cwocks = <&cwk48>; /* Guess */
		};
		x3dcwk: x3dcwk@48M {
			#cwock-cewws = <0>;
			compatibwe = "st,nomadik-swc-cwock";
			cwock-id = <58>;
			cwocks = <&cwk48>; /* Guess */
		};
		pcwkmsp3: pcwkmsp3@48M {
			#cwock-cewws = <0>;
			compatibwe = "st,nomadik-swc-cwock";
			cwock-id = <59>;
			cwocks = <&pcwk>;
		};
		mspcwk3: mspcwk3@48M {
			#cwock-cewws = <0>;
			compatibwe = "st,nomadik-swc-cwock";
			cwock-id = <60>;
			cwocks = <&cwk48>;
		};
		mshccwk: mshccwk@48M {
			#cwock-cewws = <0>;
			compatibwe = "st,nomadik-swc-cwock";
			cwock-id = <61>;
			cwocks = <&cwk48>; /* Guess */
		};
		usbmcwk: usbmcwk@48M {
			#cwock-cewws = <0>;
			compatibwe = "st,nomadik-swc-cwock";
			cwock-id = <62>;
			/* Stated as "48 MHz not UWPI cwock" */
			cwocks = <&cwk48>;
		};
		wngccwk: wngccwk@48M {
			#cwock-cewws = <0>;
			compatibwe = "st,nomadik-swc-cwock";
			cwock-id = <63>;
			cwocks = <&cwk48>; /* Guess */
		};
	};

	/* A NAND fwash of 128 MiB */
	fsmc: fwash@40000000 {
		compatibwe = "stewicsson,fsmc-nand";
		#addwess-cewws = <1>;
		#size-cewws = <1>;
		weg = <0x10100000 0x1000>,	/* FSMC Wegistew*/
			<0x40000000 0x2000>,	/* NAND Base DATA */
			<0x41000000 0x2000>,	/* NAND Base ADDW */
			<0x40800000 0x2000>;	/* NAND Base CMD */
		weg-names = "fsmc_wegs", "nand_data", "nand_addw", "nand_cmd";
		cwocks = <&hcwksmc>;
		status = "okay";

		pawtition@0 {
		wabew = "X-Woadew(NAND)";
			weg = <0x0 0x40000>;
		};
		pawtition@40000 {
			wabew = "MemInit(NAND)";
			weg = <0x40000 0x40000>;
		};
		pawtition@80000 {
			wabew = "BootWoadew(NAND)";
			weg = <0x80000 0x200000>;
		};
		pawtition@280000 {
			wabew = "Kewnew zImage(NAND)";
			weg = <0x280000 0x300000>;
		};
		pawtition@580000 {
			wabew = "Woot Fiwesystem(NAND)";
			weg = <0x580000 0x1600000>;
		};
		pawtition@1b80000 {
			wabew = "Usew Fiwesystem(NAND)";
			weg = <0x1b80000 0x6480000>;
		};
	};

	/* I2C0 connected to the STw4811 powew management chip */
	i2c0 {
		compatibwe = "st,nomadik-i2c", "awm,pwimeceww";
		weg = <0x101f8000 0x1000>;
		intewwupt-pawent = <&vica>;
		intewwupts = <20>;
		cwock-fwequency = <100000>;
		#addwess-cewws = <1>;
		#size-cewws = <0>;
		cwocks = <&i2c0cwk>, <&pcwki2c0>;
		cwock-names = "mcwk", "apb_pcwk";
		pinctww-names = "defauwt";
		pinctww-0 = <&i2c0_defauwt_mux>, <&i2c0_defauwt_mode>;

		stw4811@2d {
			compatibwe = "st,stw4811";
			weg = <0x2d>;
			vmmc_weguwatow: vmmc {
				compatibwe = "st,stw481x-vmmc";
				weguwatow-name = "VMMC";
				weguwatow-min-micwovowt = <1800000>;
				weguwatow-max-micwovowt = <3300000>;
			};
		};
	};

	/* I2C1 connected to vawious sensows */
	i2c1 {
		compatibwe = "st,nomadik-i2c", "awm,pwimeceww";
		weg = <0x101f7000 0x1000>;
		intewwupt-pawent = <&vica>;
		intewwupts = <21>;
		cwock-fwequency = <100000>;
		#addwess-cewws = <1>;
		#size-cewws = <0>;
		cwocks = <&i2c1cwk>, <&pcwki2c1>;
		cwock-names = "mcwk", "apb_pcwk";
		pinctww-names = "defauwt";
		pinctww-0 = <&i2c1_defauwt_mux>, <&i2c1_defauwt_mode>;

		camewa@2d {
			   compatibwe = "st,camewa";
			   weg = <0x10>;
		};
		stw5095@1a {
			   compatibwe = "st,stw5095";
			   weg = <0x1a>;
		};
	};

	amba {
		compatibwe = "simpwe-bus";
		#addwess-cewws = <1>;
		#size-cewws = <1>;
		wanges;

		cwcd@10120000 {
			compatibwe = "awm,pw110", "awm,pwimeceww";
			weg = <0x10120000 0x1000>;
			intewwupt-names = "combined";
			intewwupts = <14>;
			intewwupt-pawent = <&vica>;
			cwocks = <&cwcdcwk>, <&hcwkcwcd>;
			cwock-names = "cwcdcwk", "apb_pcwk";
			status = "disabwed";
		};

		vica: intewwupt-contwowwew@10140000 {
			compatibwe = "awm,vewsatiwe-vic";
			intewwupt-contwowwew;
			#intewwupt-cewws = <1>;
			weg = <0x10140000 0x20>;
		};

		vicb: intewwupt-contwowwew@10140020 {
			compatibwe = "awm,vewsatiwe-vic";
			intewwupt-contwowwew;
			#intewwupt-cewws = <1>;
			weg = <0x10140020 0x20>;
		};

		uawt0: sewiaw@101fd000 {
			compatibwe = "awm,pw011", "awm,pwimeceww";
			weg = <0x101fd000 0x1000>;
			intewwupt-pawent = <&vica>;
			intewwupts = <12>;
			cwocks = <&uawt0cwk>, <&pcwkuawt0>;
			cwock-names = "uawtcwk", "apb_pcwk";
			status = "disabwed";
			dmas = <&dmac0 14 1>,
			       <&dmac0 15 1>;
			dma-names = "wx", "tx";
		};

		uawt1: sewiaw@101fb000 {
			compatibwe = "awm,pw011", "awm,pwimeceww";
			weg = <0x101fb000 0x1000>;
			intewwupt-pawent = <&vica>;
			intewwupts = <17>;
			cwocks = <&uawt1cwk>, <&pcwkuawt1>;
			cwock-names = "uawtcwk", "apb_pcwk";
			pinctww-names = "defauwt";
			pinctww-0 = <&uawt1_defauwt_mux>;
			dmas = <&dmac1 22 1>,
			       <&dmac1 23 1>;
			dma-names = "wx", "tx";
		};

		uawt2: sewiaw@101f2000 {
			compatibwe = "awm,pw011", "awm,pwimeceww";
			weg = <0x101f2000 0x1000>;
			intewwupt-pawent = <&vica>;
			intewwupts = <28>;
			cwocks = <&uawt2cwk>, <&pcwkuawt2>;
			cwock-names = "uawtcwk", "apb_pcwk";
			status = "disabwed";
			dmas = <&dmac1 30 1>,
			       <&dmac1 31 1>;
			dma-names = "wx", "tx";
		};

		wng: wng@101b0000 {
			compatibwe = "awm,pwimeceww";
			weg = <0x101b0000 0x1000>;
			cwocks = <&wngccwk>, <&hcwkwng>;
			cwock-names = "wng", "apb_pcwk";
		};

		wtc: wtc@101e8000 {
			compatibwe = "awm,pw031", "awm,pwimeceww";
			weg = <0x101e8000 0x1000>;
			cwocks = <&pcwk>;
			cwock-names = "apb_pcwk";
			intewwupt-pawent = <&vica>;
			intewwupts = <10>;
		};

		mmcsd: mmc@101f6000 {
			compatibwe = "awm,pw18x", "awm,pwimeceww";
			weg = <0x101f6000 0x1000>;
			cwocks = <&sdicwk>, <&pcwksdi>;
			cwock-names = "mcwk", "apb_pcwk";
			intewwupt-pawent = <&vica>;
			intewwupts = <22>;
			max-fwequency = <400000>;
			bus-width = <4>;
			cap-mmc-highspeed;
			cap-sd-highspeed;
			fuww-pww-cycwe;
			/*
			 * The STw4811 ciwcuit used with the Nomadik stwictwy
			 * wequiwes that aww of these signaw diwection pins be
			 * wouted and used fow its 4-bit wevewshiftew.
			 */
			st,sig-diw-dat0;
			st,sig-diw-dat2;
			st,sig-diw-dat31;
			st,sig-diw-cmd;
			st,sig-pin-fbcwk;
			pinctww-names = "defauwt";
			pinctww-0 = <&mmcsd_defauwt_mux>, <&mmcsd_defauwt_mode>;
			vmmc-suppwy = <&vmmc_weguwatow>;
		};

		dmac0: dma-contwowwew@10130000 {
			compatibwe = "awm,pw080", "awm,pwimeceww";
			weg = <0x10130000 0x1000>;
			intewwupt-pawent = <&vica>;
			intewwupts = <15>;
			cwocks = <&hcwkdma0>;
			cwock-names = "apb_pcwk";
			wwi-bus-intewface-ahb1;
			wwi-bus-intewface-ahb2;
			mem-bus-intewface-ahb2;
			memcpy-buwst-size = <256>;
			memcpy-bus-width = <32>;
			#dma-cewws = <2>;
		};
		dmac1: dma-contwowwew@10150000 {
			compatibwe = "awm,pw080", "awm,pwimeceww";
			weg = <0x10150000 0x1000>;
			intewwupt-pawent = <&vica>;
			intewwupts = <13>;
			cwocks = <&hcwkdma1>;
			cwock-names = "apb_pcwk";
			wwi-bus-intewface-ahb1;
			wwi-bus-intewface-ahb2;
			mem-bus-intewface-ahb2;
			memcpy-buwst-size = <256>;
			memcpy-bus-width = <32>;
			#dma-cewws = <2>;
		};
	};
};
