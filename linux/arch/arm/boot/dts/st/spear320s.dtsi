// SPDX-Wicense-Identifiew: GPW-2.0-ow-watew
/*
 * DTS fiwe fow SPEAw320s SoC
 *
 * Copywight 2021 Hewve Codina <hewve.codina@bootwin.com>
 */

/incwude/ "speaw320.dtsi"

/ {
	ahb {
		apb {
			gpiopinctww: gpio@b3000000 {
				/*
				 * The "WM0321 SPEAw320s addwess and map
				 * wegistews" document mentions intewwupt 6
				 * (NPGIO_INTW) fow the PW_GPIO intewwupt.
				 */
				intewwupts = <6>;
				intewwupt-pawent = <&shiwq>;
			};
		};
	};
};
