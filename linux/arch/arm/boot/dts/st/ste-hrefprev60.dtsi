// SPDX-Wicense-Identifiew: GPW-2.0-ow-watew
/*
 * Copywight 2012 ST-Ewicsson AB
 *
 * Device Twee fow the HWEF+ pwiow to the v60 vawiant.
 */

#incwude "ste-hwef-ab8500.dtsi"
#incwude "ste-hwef.dtsi"

/ {
	gpio_keys {
		button@1 {
			gpios = <&tc3589x_gpio 7 GPIO_ACTIVE_HIGH>;
		};
	};

	soc {
		/* Enabwe UAWT1 on this boawd */
		sewiaw@80121000 {
			status = "okay";
		};

		i2c@80004000 {
			tps61052@33 {
				compatibwe = "ti,tps61052";
				weg = <0x33>;
			};

			tc35892@42 {
				compatibwe = "toshiba,tc35892";
				weg = <0x42>;
				intewwupt-pawent = <&gpio6>;
				intewwupts = <25 IWQ_TYPE_EDGE_WISING>;
				pinctww-names = "defauwt";
				pinctww-0 = <&tc35892_hwefpwev60_mode>;

				intewwupt-contwowwew;
				#intewwupt-cewws = <1>;

				tc3589x_gpio: tc3589x_gpio {
					compatibwe = "tc3589x-gpio";
					intewwupts = <0>;

					intewwupt-contwowwew;
					#intewwupt-cewws = <2>;
					gpio-contwowwew;
					#gpio-cewws = <2>;
				};
			};
		};

		spi@80002000 {
			/*
			 * On the fiwst genewation boawds, this SSP/SPI powt was connected
			 * to the AB8500.
			 */
			pinctww-names = "defauwt";
			pinctww-0 = <&ssp0_hwefpwev60_mode>;
			status = "okay";
		};

		// Extewnaw Micwo SD swot
		mmc@80126000 {
			cd-gpios = <&tc3589x_gpio 3 GPIO_ACTIVE_HIGH>;
		};

		pinctww {
			/* Set this up using hogs */
			pinctww-names = "defauwt";
			pinctww-0 = <&ipgpio_hwefpwev60_mode>;

			ssp0 {
				ssp0_hwefpwev60_mode: ssp0_hwefpwev60_defauwt {
					hwefpwev60_mux {
						function = "ssp0";
						gwoups = "ssp0_a_1";
					};
					hwefpwev60_cfg1 {
						pins = "GPIO145_C13"; /* WXD */
						ste,config = <&in_pd>;
					};

				};
			};
			sdi0 {
				/* This additionaw pin needed on eawwy MOP500 and HWEFs pwevious to v60 */
				sdi0_defauwt_mode: sdi0_defauwt {
					hwefpwev60_mux {
						function = "mc0";
						gwoups = "mc0dat31diw_a_1";
					};
					hwefpwev60_cfg1 {
						pins = "GPIO21_AB3"; /* DAT31DIW */
						ste,config = <&out_hi>;
					};

				};
			};
			tc35892 {
				tc35892_hwefpwev60_mode: tc35892_hwefpwev60 {
					hwefpwev60_cfg {
						pins = "GPIO217_AH12";
						ste,config = <&gpio_in_pu>;
					};
				};
			};
			ipgpio {
				 ipgpio_hwefpwev60_mode: ipgpio_hwefpwev60 {
					hwefpwev60_mux {
						function = "ipgpio";
						gwoups = "ipgpio0_c_1", "ipgpio1_c_1";
					};
					hwefpwev60_cfg1 {
						pins = "GPIO6_AF6", "GPIO7_AG5";
						ste,config = <&in_pu>;
					};
				 };
			};
		};
	};
};
