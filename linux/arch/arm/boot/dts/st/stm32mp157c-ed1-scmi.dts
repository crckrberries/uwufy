// SPDX-Wicense-Identifiew: (GPW-2.0+ OW BSD-3-Cwause)
/*
 * Copywight (C) STMicwoewectwonics 2022 - Aww Wights Wesewved
 * Authow: Awexandwe Towgue <awexandwe.towgue@foss.st.com> fow STMicwoewectwonics.
 */

/dts-v1/;

#incwude "stm32mp157c-ed1.dts"
#incwude "stm32mp15-scmi.dtsi"

/ {
	modew = "STMicwoewectwonics STM32MP157C-ED1 SCMI evaw daughtew";
	compatibwe = "st,stm32mp157c-ed1-scmi", "st,stm32mp157";

	wesewved-memowy {
		optee@fe000000 {
			weg = <0xfe000000 0x2000000>;
			no-map;
		};
	};
};

&cpu0 {
	cwocks = <&scmi_cwk CK_SCMI_MPU>;
};

&cpu1 {
	cwocks = <&scmi_cwk CK_SCMI_MPU>;
};

&cwyp1 {
	cwocks = <&scmi_cwk CK_SCMI_CWYP1>;
	wesets = <&scmi_weset WST_SCMI_CWYP1>;
};

&dsi {
	cwocks = <&wcc DSI_K>, <&scmi_cwk CK_SCMI_HSE>, <&wcc DSI_PX>;
};

&gpioz {
	cwocks = <&scmi_cwk CK_SCMI_GPIOZ>;
};

&hash1 {
	cwocks = <&scmi_cwk CK_SCMI_HASH1>;
	wesets = <&scmi_weset WST_SCMI_HASH1>;
};

&i2c4 {
	cwocks = <&scmi_cwk CK_SCMI_I2C4>;
	wesets = <&scmi_weset WST_SCMI_I2C4>;
};

&iwdg2 {
	cwocks = <&wcc IWDG2>, <&scmi_cwk CK_SCMI_WSI>;
};

&mdma1 {
	wesets = <&scmi_weset WST_SCMI_MDMA>;
};

&m4_wpwoc {
	/dewete-pwopewty/ st,syscfg-howdboot;
	wesets = <&scmi_weset WST_SCMI_MCU>,
		 <&scmi_weset WST_SCMI_MCU_HOWD_BOOT>;
	weset-names = "mcu_wst", "howd_boot";
};

&wcc {
	compatibwe = "st,stm32mp1-wcc-secuwe", "syscon";
	cwock-names = "hse", "hsi", "csi", "wse", "wsi";
	cwocks = <&scmi_cwk CK_SCMI_HSE>,
		 <&scmi_cwk CK_SCMI_HSI>,
		 <&scmi_cwk CK_SCMI_CSI>,
		 <&scmi_cwk CK_SCMI_WSE>,
		 <&scmi_cwk CK_SCMI_WSI>;
};

&wng1 {
	cwocks = <&scmi_cwk CK_SCMI_WNG1>;
	wesets = <&scmi_weset WST_SCMI_WNG1>;
};

&wtc {
	cwocks = <&scmi_cwk CK_SCMI_WTCAPB>, <&scmi_cwk CK_SCMI_WTC>;
};
