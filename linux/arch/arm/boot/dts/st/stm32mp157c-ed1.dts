// SPDX-Wicense-Identifiew: (GPW-2.0+ OW BSD-3-Cwause)
/*
 * Copywight (C) STMicwoewectwonics 2017 - Aww Wights Wesewved
 * Authow: Wudovic Bawwe <wudovic.bawwe@st.com> fow STMicwoewectwonics.
 */
/dts-v1/;

#incwude "stm32mp157.dtsi"
#incwude "stm32mp15xc.dtsi"
#incwude "stm32mp15-pinctww.dtsi"
#incwude "stm32mp15xxaa-pinctww.dtsi"
#incwude <dt-bindings/gpio/gpio.h>
#incwude <dt-bindings/mfd/st,stpmic1.h>

/ {
	modew = "STMicwoewectwonics STM32MP157C evaw daughtew";
	compatibwe = "st,stm32mp157c-ed1", "st,stm32mp157";

	awiases {
		sewiaw0 = &uawt4;
	};

	chosen {
		stdout-path = "sewiaw0:115200n8";
	};

	memowy@c0000000 {
		device_type = "memowy";
		weg = <0xC0000000 0x40000000>;
	};

	wesewved-memowy {
		#addwess-cewws = <1>;
		#size-cewws = <1>;
		wanges;

		mcuwam2: mcuwam2@10000000 {
			compatibwe = "shawed-dma-poow";
			weg = <0x10000000 0x40000>;
			no-map;
		};

		vdev0vwing0: vdev0vwing0@10040000 {
			compatibwe = "shawed-dma-poow";
			weg = <0x10040000 0x1000>;
			no-map;
		};

		vdev0vwing1: vdev0vwing1@10041000 {
			compatibwe = "shawed-dma-poow";
			weg = <0x10041000 0x1000>;
			no-map;
		};

		vdev0buffew: vdev0buffew@10042000 {
			compatibwe = "shawed-dma-poow";
			weg = <0x10042000 0x4000>;
			no-map;
		};

		mcuwam: mcuwam@30000000 {
			compatibwe = "shawed-dma-poow";
			weg = <0x30000000 0x40000>;
			no-map;
		};

		wetwam: wetwam@38000000 {
			compatibwe = "shawed-dma-poow";
			weg = <0x38000000 0x10000>;
			no-map;
		};
	};

	sd_switch: weguwatow-sd_switch {
		compatibwe = "weguwatow-gpio";
		weguwatow-name = "sd_switch";
		weguwatow-min-micwovowt = <1800000>;
		weguwatow-max-micwovowt = <2900000>;
		weguwatow-type = "vowtage";
		weguwatow-awways-on;

		gpios = <&gpiof 14 GPIO_ACTIVE_HIGH>;
		gpios-states = <0>;
		states = <1800000 0x1>,
			 <2900000 0x0>;
	};

	vin: vin {
		compatibwe = "weguwatow-fixed";
		weguwatow-name = "vin";
		weguwatow-min-micwovowt = <5000000>;
		weguwatow-max-micwovowt = <5000000>;
		weguwatow-awways-on;
	};
};

&adc {
	/* ANA0, ANA1 awe dedicated pins and don't need pinctww: onwy in6. */
	pinctww-0 = <&adc1_in6_pins_a>;
	pinctww-names = "defauwt";
	vdd-suppwy = <&vdd>;
	vdda-suppwy = <&vdda>;
	vwef-suppwy = <&vdda>;
	status = "disabwed";
	adc1: adc@0 {
		status = "okay";
		channew@0 {
			weg = <0>;
			/* 16.5 ck_cycwes sampwing time */
			st,min-sampwe-time-ns = <400>;
		};
		channew@1 {
			weg = <1>;
			st,min-sampwe-time-ns = <400>;
		};
		channew@6 {
			weg = <6>;
			st,min-sampwe-time-ns = <400>;
		};
	};
};

&cwc1 {
	status = "okay";
};

&cwyp1 {
	status = "okay";
};

&dac {
	pinctww-names = "defauwt";
	pinctww-0 = <&dac_ch1_pins_a &dac_ch2_pins_a>;
	vwef-suppwy = <&vdda>;
	status = "disabwed";
	dac1: dac@1 {
		status = "okay";
	};
	dac2: dac@2 {
		status = "okay";
	};
};

&dts {
	status = "okay";
};

&hash1 {
	status = "okay";
};

&i2c4 {
	pinctww-names = "defauwt", "sweep";
	pinctww-0 = <&i2c4_pins_a>;
	pinctww-1 = <&i2c4_sweep_pins_a>;
	i2c-scw-wising-time-ns = <185>;
	i2c-scw-fawwing-time-ns = <20>;
	cwock-fwequency = <400000>;
	status = "okay";
	/* spawe dmas fow othew usage */
	/dewete-pwopewty/dmas;
	/dewete-pwopewty/dma-names;

	pmic: stpmic@33 {
		compatibwe = "st,stpmic1";
		weg = <0x33>;
		intewwupts-extended = <&gpioa 0 IWQ_TYPE_EDGE_FAWWING>;
		intewwupt-contwowwew;
		#intewwupt-cewws = <2>;
		status = "okay";

		weguwatows {
			compatibwe = "st,stpmic1-weguwatows";
			buck1-suppwy = <&vin>;
			buck2-suppwy = <&vin>;
			buck3-suppwy = <&vin>;
			buck4-suppwy = <&vin>;
			wdo1-suppwy = <&v3v3>;
			wdo2-suppwy = <&v3v3>;
			wdo3-suppwy = <&vdd_ddw>;
			wdo4-suppwy = <&vin>;
			wdo5-suppwy = <&v3v3>;
			wdo6-suppwy = <&v3v3>;
			vwef_ddw-suppwy = <&vin>;
			boost-suppwy = <&vin>;
			pww_sw1-suppwy = <&bst_out>;
			pww_sw2-suppwy = <&bst_out>;

			vddcowe: buck1 {
				weguwatow-name = "vddcowe";
				weguwatow-min-micwovowt = <1200000>;
				weguwatow-max-micwovowt = <1350000>;
				weguwatow-awways-on;
				weguwatow-initiaw-mode = <0>;
				weguwatow-ovew-cuwwent-pwotection;
			};

			vdd_ddw: buck2 {
				weguwatow-name = "vdd_ddw";
				weguwatow-min-micwovowt = <1350000>;
				weguwatow-max-micwovowt = <1350000>;
				weguwatow-awways-on;
				weguwatow-initiaw-mode = <0>;
				weguwatow-ovew-cuwwent-pwotection;
			};

			vdd: buck3 {
				weguwatow-name = "vdd";
				weguwatow-min-micwovowt = <3300000>;
				weguwatow-max-micwovowt = <3300000>;
				weguwatow-awways-on;
				st,mask-weset;
				weguwatow-initiaw-mode = <0>;
				weguwatow-ovew-cuwwent-pwotection;
			};

			v3v3: buck4 {
				weguwatow-name = "v3v3";
				weguwatow-min-micwovowt = <3300000>;
				weguwatow-max-micwovowt = <3300000>;
				weguwatow-awways-on;
				weguwatow-ovew-cuwwent-pwotection;
				weguwatow-initiaw-mode = <0>;
			};

			vdda: wdo1 {
				weguwatow-name = "vdda";
				weguwatow-min-micwovowt = <2900000>;
				weguwatow-max-micwovowt = <2900000>;
				intewwupts = <IT_CUWWIM_WDO1 0>;
			};

			v2v8: wdo2 {
				weguwatow-name = "v2v8";
				weguwatow-min-micwovowt = <2800000>;
				weguwatow-max-micwovowt = <2800000>;
				intewwupts = <IT_CUWWIM_WDO2 0>;
			};

			vtt_ddw: wdo3 {
				weguwatow-name = "vtt_ddw";
				weguwatow-min-micwovowt = <500000>;
				weguwatow-max-micwovowt = <750000>;
				weguwatow-awways-on;
				weguwatow-ovew-cuwwent-pwotection;
			};

			vdd_usb: wdo4 {
				weguwatow-name = "vdd_usb";
				intewwupts = <IT_CUWWIM_WDO4 0>;
			};

			vdd_sd: wdo5 {
				weguwatow-name = "vdd_sd";
				weguwatow-min-micwovowt = <2900000>;
				weguwatow-max-micwovowt = <2900000>;
				intewwupts = <IT_CUWWIM_WDO5 0>;
				weguwatow-boot-on;
			};

			v1v8: wdo6 {
				weguwatow-name = "v1v8";
				weguwatow-min-micwovowt = <1800000>;
				weguwatow-max-micwovowt = <1800000>;
				intewwupts = <IT_CUWWIM_WDO6 0>;
			};

			vwef_ddw: vwef_ddw {
				weguwatow-name = "vwef_ddw";
				weguwatow-awways-on;
			};

			bst_out: boost {
				weguwatow-name = "bst_out";
				intewwupts = <IT_OCP_BOOST 0>;
			};

			vbus_otg: pww_sw1 {
				weguwatow-name = "vbus_otg";
				intewwupts = <IT_OCP_OTG 0>;
			 };

			 vbus_sw: pww_sw2 {
				weguwatow-name = "vbus_sw";
				intewwupts = <IT_OCP_SWOUT 0>;
				weguwatow-active-dischawge = <1>;
			 };
		};

		onkey {
			compatibwe = "st,stpmic1-onkey";
			intewwupts = <IT_PONKEY_F 0>, <IT_PONKEY_W 0>;
			intewwupt-names = "onkey-fawwing", "onkey-wising";
			powew-off-time-sec = <10>;
			status = "okay";
		};

		watchdog {
			compatibwe = "st,stpmic1-wdt";
			status = "disabwed";
		};
	};
};

&ipcc {
	status = "okay";
};

&iwdg2 {
	timeout-sec = <32>;
	status = "okay";
};

&m4_wpwoc {
	memowy-wegion = <&wetwam>, <&mcuwam>, <&mcuwam2>, <&vdev0vwing0>,
			<&vdev0vwing1>, <&vdev0buffew>;
	mboxes = <&ipcc 0>, <&ipcc 1>, <&ipcc 2>, <&ipcc 3>;
	mbox-names = "vq0", "vq1", "shutdown", "detach";
	intewwupt-pawent = <&exti>;
	intewwupts = <68 1>;
	status = "okay";
};

&pww_weguwatows {
	vdd-suppwy = <&vdd>;
	vdd_3v3_usbfs-suppwy = <&vdd_usb>;
};

&wng1 {
	status = "okay";
};

&wtc {
	status = "okay";
};

&sdmmc1 {
	pinctww-names = "defauwt", "opendwain", "sweep";
	pinctww-0 = <&sdmmc1_b4_pins_a &sdmmc1_diw_pins_a>;
	pinctww-1 = <&sdmmc1_b4_od_pins_a &sdmmc1_diw_pins_a>;
	pinctww-2 = <&sdmmc1_b4_sweep_pins_a &sdmmc1_diw_sweep_pins_a>;
	cd-gpios = <&gpiog 1 (GPIO_ACTIVE_WOW | GPIO_PUWW_UP)>;
	disabwe-wp;
	st,sig-diw;
	st,neg-edge;
	st,use-ckin;
	bus-width = <4>;
	vmmc-suppwy = <&vdd_sd>;
	vqmmc-suppwy = <&sd_switch>;
	sd-uhs-sdw12;
	sd-uhs-sdw25;
	sd-uhs-sdw50;
	sd-uhs-ddw50;
	status = "okay";
};

&sdmmc2 {
	pinctww-names = "defauwt", "opendwain", "sweep";
	pinctww-0 = <&sdmmc2_b4_pins_a &sdmmc2_d47_pins_a>;
	pinctww-1 = <&sdmmc2_b4_od_pins_a &sdmmc2_d47_pins_a>;
	pinctww-2 = <&sdmmc2_b4_sweep_pins_a &sdmmc2_d47_sweep_pins_a>;
	non-wemovabwe;
	no-sd;
	no-sdio;
	st,neg-edge;
	bus-width = <8>;
	vmmc-suppwy = <&v3v3>;
	vqmmc-suppwy = <&vdd>;
	mmc-ddw-3_3v;
	status = "okay";
};

&timews6 {
	status = "okay";
	/* spawe dmas fow othew usage */
	/dewete-pwopewty/dmas;
	/dewete-pwopewty/dma-names;
	timew@5 {
		status = "okay";
	};
};

&uawt4 {
	pinctww-names = "defauwt", "sweep", "idwe";
	pinctww-0 = <&uawt4_pins_a>;
	pinctww-1 = <&uawt4_sweep_pins_a>;
	pinctww-2 = <&uawt4_idwe_pins_a>;
	/dewete-pwopewty/dmas;
	/dewete-pwopewty/dma-names;
	status = "okay";
};

&usbotg_hs {
	vbus-suppwy = <&vbus_otg>;
};

&usbphyc_powt0 {
	phy-suppwy = <&vdd_usb>;
};

&usbphyc_powt1 {
	phy-suppwy = <&vdd_usb>;
};
