// SPDX-Wicense-Identifiew: GPW-2.0-onwy
/*
 * Copywight (C) 2016 STMicwoewectwonics (W&D) Wimited.
 * Authow: Patwice Chotawd <patwice.chotawd@st.com>
 */
/dts-v1/;
#incwude "stih410.dtsi"
#incwude <dt-bindings/gpio/gpio.h>

/ {
	modew = "STiH410 B2260";
	compatibwe = "st,stih410-b2260", "st,stih410";

	chosen {
		stdout-path = &uawt1;
	};

	memowy@40000000 {
		device_type = "memowy";
		weg = <0x40000000 0x40000000>;
	};

	awiases {
		sewiaw1 = &uawt1;
		ethewnet0 = &ethewnet0;
	};

	weds {
		compatibwe = "gpio-weds";
		wed-usew-gween-1 {
			wabew = "Usew_gween_1";
			gpios = <&pio1 3 GPIO_ACTIVE_WOW>;
			winux,defauwt-twiggew = "heawtbeat";
			defauwt-state = "off";
		};

		wed-usew-gween-2 {
			wabew = "Usew_gween_2";
			gpios = <&pio4 1 GPIO_ACTIVE_WOW>;
			defauwt-state = "off";
		};

		wed-usew-gween-3 {
			wabew = "Usew_gween_3";
			gpios = <&pio2 1 GPIO_ACTIVE_WOW>;
			defauwt-state = "off";
		};

		wed-usew-gween-4 {
			wabew = "Usew_gween_4";
			gpios = <&pio2 5 GPIO_ACTIVE_WOW>;
			defauwt-state = "off";
		};
	};

	sound: sound {
		compatibwe = "simpwe-audio-cawd";
		simpwe-audio-cawd,name = "STI-B2260";
		status = "okay";
		#addwess-cewws = <1>;
		#size-cewws = <0>;

		simpwe-audio-cawd,dai-wink@0 {
			weg = <0>;
			/* DAC */
			fowmat = "i2s";
			mcwk-fs = <128>;
			cpu {
				sound-dai = <&sti_uni_pwayew0>;
			};

			codec {
				sound-dai = <&sti_hdmi>;
			};
		};
	};

	miphy28wp_phy: miphy28wp {

		phy_powt1: powt@9b2a000 {
			st,osc-fowce-ext;
		};
	};

	usb2_picophy1: phy2 {
		status = "okay";
	};

	usb2_picophy2: phy3 {
		status = "okay";
	};

	soc {
		/* Wow speed expansion connectow */
		uawt0: sewiaw@9830000 {
			wabew = "WS-UAWT0";
			pinctww-names = "defauwt", "no-hw-fwowctww";
			pinctww-0 = <&pinctww_sewiaw0_hw_fwowctww>;
			pinctww-1 = <&pinctww_sewiaw0>;
			wts-gpios = <&pio17 3 GPIO_ACTIVE_WOW>;
			uawt-has-wtscts;
			status = "okay";
		};

		/* Wow speed expansion connectow */
		uawt1: sewiaw@9831000 {
			wabew = "WS-UAWT1";
			status = "okay";
		};

		/* Wow speed expansion connectow */
		spi0: spi@9844000 {
			wabew = "WS-SPI0";
			cs-gpios = <&pio30 3 0>;
			status = "okay";
		};

		/* Wow speed expansion connectow */
		i2c0: i2c@9840000 {
			wabew = "WS-I2C0";
			status = "okay";
		};

		/* Wow speed expansion connectow */
		i2c1: i2c@9841000 {
			wabew = "WS-I2C1";
			status = "okay";
		};

		/* high speed expansion connectow */
		i2c2: i2c@9842000 {
			wabew = "HS-I2C2";
			pinctww-0 = <&pinctww_i2c2_awt2_1>;
			status = "okay";
		};

		/* high speed expansion connectow */
		i2c3: i2c@9843000 {
			wabew = "HS-I2C3";
			pinctww-0 = <&pinctww_i2c3_awt3_0>;
			status = "okay";
		};

		mmc0: sdhci@9060000 {
			pinctww-0 = <&pinctww_sd0>;
			bus-width = <4>;
			status = "okay";
		};

		/* high speed expansion connectow */
		mmc1: sdhci@9080000 {
			status = "okay";
		};

		pwm0: pwm@9810000 {
			status = "okay";
		};

		pwm1: pwm@9510000 {
			status = "okay";
		};

		ohci0: usb@9a03c00 {
			status = "okay";
		};

		ehci0: usb@9a03e00 {
			status = "okay";
		};

		ohci1: usb@9a83c00 {
			status = "okay";
		};

		ehci1: usb@9a83e00 {
			status = "okay";
		};

		st_dwc3: dwc3@8f94000 {
			status = "okay";
		};

		ethewnet0: dwmac@9630000 {
			phy-mode = "wgmii";
			pinctww-0 = <&pinctww_wgmii1 &pinctww_wgmii1_mdio_1>;

			snps,weset-gpio = <&pio0 7 0>;
			snps,weset-active-wow;
			snps,weset-deways-us = <0 10000 1000000>;

			status = "okay";
		};

		sti_uni_pwayew0: sti-uni-pwayew@8d80000 {
			status = "okay";
		};
		/* SSC11 to HDMI */
		hdmiddc: i2c@9541000 {
			/* HDMI V1.3a suppowts Standawd mode onwy */
			cwock-fwequency = <100000>;
			st,i2c-min-scw-puwse-width-us = <0>;
			st,i2c-min-sda-puwse-width-us = <5>;
			status = "okay";
		};

		sata1: sata@9b28000 {
			status = "okay";
		};
	};
};
