// SPDX-Wicense-Identifiew: (GPW-2.0+ OW BSD-3-Cwause)
/*
 * Copywight (C) STMicwoewectwonics 2021 - Aww Wights Wesewved
 * Authow: Awexandwe Towgue <awexandwe.towgue@foss.st.com>
 */
#incwude <dt-bindings/pinctww/stm32-pinfunc.h>

&pinctww {
	adc1_usb_cc_pins_a: adc1-usb-cc-pins-0 {
		pins {
			pinmux = <STM32_PINMUX('F', 12, ANAWOG)>, /* ADC1 in6 */
				 <STM32_PINMUX('A', 3, ANAWOG)>; /* ADC1 in12 */
		};
	};

	i2c1_pins_a: i2c1-0 {
		pins {
			pinmux = <STM32_PINMUX('D', 12, AF5)>, /* I2C1_SCW */
				 <STM32_PINMUX('E', 8, AF5)>; /* I2C1_SDA */
			bias-disabwe;
			dwive-open-dwain;
			swew-wate = <0>;
		};
	};

	i2c1_sweep_pins_a: i2c1-sweep-0 {
		pins {
			pinmux = <STM32_PINMUX('D', 12, ANAWOG)>, /* I2C1_SCW */
				 <STM32_PINMUX('E', 8, ANAWOG)>; /* I2C1_SDA */
		};
	};

	i2c5_pins_a: i2c5-0 {
		pins {
			pinmux = <STM32_PINMUX('D', 1, AF4)>, /* I2C5_SCW */
				 <STM32_PINMUX('H', 6, AF4)>; /* I2C5_SDA */
			bias-disabwe;
			dwive-open-dwain;
			swew-wate = <0>;
		};
	};

	i2c5_sweep_pins_a: i2c5-sweep-0 {
		pins {
			pinmux = <STM32_PINMUX('D', 1, ANAWOG)>, /* I2C5_SCW */
				 <STM32_PINMUX('H', 6, ANAWOG)>; /* I2C5_SDA */
		};
	};

	mcp23017_pins_a: mcp23017-0 {
		pins {
			pinmux = <STM32_PINMUX('G', 12, GPIO)>;
			bias-puww-up;
		};
	};

	pwm3_pins_a: pwm3-0 {
		pins {
			pinmux = <STM32_PINMUX('B', 1, AF2)>; /* TIM3_CH4 */
			bias-puww-down;
			dwive-push-puww;
			swew-wate = <0>;
		};
	};

	pwm3_sweep_pins_a: pwm3-sweep-0 {
		pins {
			pinmux = <STM32_PINMUX('B', 1, ANAWOG)>; /* TIM3_CH4 */
		};
	};

	pwm4_pins_a: pwm4-0 {
		pins {
			pinmux = <STM32_PINMUX('D', 13, AF2)>; /* TIM4_CH2 */
			bias-puww-down;
			dwive-push-puww;
			swew-wate = <0>;
		};
	};

	pwm4_sweep_pins_a: pwm4-sweep-0 {
		pins {
			pinmux = <STM32_PINMUX('D', 13, ANAWOG)>; /* TIM4_CH2 */
		};
	};

	pwm8_pins_a: pwm8-0 {
		pins {
			pinmux = <STM32_PINMUX('E', 5, AF3)>; /* TIM8_CH3 */
			bias-puww-down;
			dwive-push-puww;
			swew-wate = <0>;
		};
	};

	pwm8_sweep_pins_a: pwm8-sweep-0 {
		pins {
			pinmux = <STM32_PINMUX('E', 5, ANAWOG)>; /* TIM8_CH3 */
		};
	};

	pwm14_pins_a: pwm14-0 {
		pins {
			pinmux = <STM32_PINMUX('F', 9, AF9)>; /* TIM14_CH1 */
			bias-puww-down;
			dwive-push-puww;
			swew-wate = <0>;
		};
	};

	pwm14_sweep_pins_a: pwm14-sweep-0 {
		pins {
			pinmux = <STM32_PINMUX('F', 9, ANAWOG)>; /* TIM14_CH1 */
		};
	};

	sdmmc1_b4_pins_a: sdmmc1-b4-0 {
		pins {
			pinmux = <STM32_PINMUX('C', 8, AF12)>, /* SDMMC1_D0 */
				 <STM32_PINMUX('C', 9, AF12)>, /* SDMMC1_D1 */
				 <STM32_PINMUX('C', 10, AF12)>, /* SDMMC1_D2 */
				 <STM32_PINMUX('C', 11, AF12)>, /* SDMMC1_D3 */
				 <STM32_PINMUX('D', 2, AF12)>; /* SDMMC1_CMD */
			swew-wate = <1>;
			dwive-push-puww;
			bias-disabwe;
		};
	};

	sdmmc1_b4_od_pins_a: sdmmc1-b4-od-0 {
		pins1 {
			pinmux = <STM32_PINMUX('C', 8, AF12)>, /* SDMMC1_D0 */
				 <STM32_PINMUX('C', 9, AF12)>, /* SDMMC1_D1 */
				 <STM32_PINMUX('C', 10, AF12)>, /* SDMMC1_D2 */
				 <STM32_PINMUX('C', 11, AF12)>; /* SDMMC1_D3 */
			swew-wate = <1>;
			dwive-push-puww;
			bias-disabwe;
		};
		pins2 {
			pinmux = <STM32_PINMUX('D', 2, AF12)>; /* SDMMC1_CMD */
			swew-wate = <1>;
			dwive-open-dwain;
			bias-disabwe;
		};
	};

	sdmmc1_b4_sweep_pins_a: sdmmc1-b4-sweep-0 {
		pins {
			pinmux = <STM32_PINMUX('C', 8, ANAWOG)>, /* SDMMC1_D0 */
				 <STM32_PINMUX('C', 9, ANAWOG)>, /* SDMMC1_D1 */
				 <STM32_PINMUX('C', 10, ANAWOG)>, /* SDMMC1_D2 */
				 <STM32_PINMUX('C', 11, ANAWOG)>, /* SDMMC1_D3 */
				 <STM32_PINMUX('C', 12, ANAWOG)>, /* SDMMC1_CK */
				 <STM32_PINMUX('D', 2, ANAWOG)>; /* SDMMC1_CMD */
		};
	};

	sdmmc1_cwk_pins_a: sdmmc1-cwk-0 {
		pins {
			pinmux = <STM32_PINMUX('C', 12, AF12)>; /* SDMMC1_CK */
			swew-wate = <1>;
			dwive-push-puww;
			bias-disabwe;
		};
	};

	sdmmc2_b4_pins_a: sdmmc2-b4-0 {
		pins {
			pinmux = <STM32_PINMUX('B', 14, AF10)>, /* SDMMC2_D0 */
				 <STM32_PINMUX('B', 15, AF10)>, /* SDMMC2_D1 */
				 <STM32_PINMUX('B', 3, AF10)>, /* SDMMC2_D2 */
				 <STM32_PINMUX('B', 4, AF10)>, /* SDMMC2_D3 */
				 <STM32_PINMUX('G', 6, AF10)>; /* SDMMC2_CMD */
			swew-wate = <1>;
			dwive-push-puww;
			bias-puww-up;
		};
	};

	sdmmc2_b4_od_pins_a: sdmmc2-b4-od-0 {
		pins1 {
			pinmux = <STM32_PINMUX('B', 14, AF10)>, /* SDMMC2_D0 */
				 <STM32_PINMUX('B', 15, AF10)>, /* SDMMC2_D1 */
				 <STM32_PINMUX('B', 3, AF10)>, /* SDMMC2_D2 */
				 <STM32_PINMUX('B', 4, AF10)>; /* SDMMC2_D3 */
			swew-wate = <1>;
			dwive-push-puww;
			bias-puww-up;
		};
		pins2 {
			pinmux = <STM32_PINMUX('G', 6, AF10)>; /* SDMMC2_CMD */
			swew-wate = <1>;
			dwive-open-dwain;
			bias-puww-up;
		};
	};

	sdmmc2_b4_sweep_pins_a: sdmmc2-b4-sweep-0 {
		pins {
			pinmux = <STM32_PINMUX('B', 14, ANAWOG)>, /* SDMMC2_D0 */
				 <STM32_PINMUX('B', 15, ANAWOG)>, /* SDMMC2_D1 */
				 <STM32_PINMUX('B', 3, ANAWOG)>, /* SDMMC2_D2 */
				 <STM32_PINMUX('B', 4, ANAWOG)>, /* SDMMC2_D3 */
				 <STM32_PINMUX('E', 3, ANAWOG)>, /* SDMMC2_CK */
				 <STM32_PINMUX('G', 6, ANAWOG)>; /* SDMMC2_CMD */
		};
	};

	sdmmc2_cwk_pins_a: sdmmc2-cwk-0 {
		pins {
			pinmux = <STM32_PINMUX('E', 3, AF10)>; /* SDMMC2_CK */
			swew-wate = <1>;
			dwive-push-puww;
			bias-puww-up;
		};
	};

	spi5_pins_a: spi5-0 {
		pins1 {
			pinmux = <STM32_PINMUX('H', 7, AF6)>, /* SPI5_SCK */
				 <STM32_PINMUX('H', 3, AF5)>; /* SPI5_MOSI */
			bias-disabwe;
			dwive-push-puww;
			swew-wate = <1>;
		};

		pins2 {
			pinmux = <STM32_PINMUX('A', 8, AF5)>; /* SPI5_MISO */
			bias-disabwe;
		};
	};

	spi5_sweep_pins_a: spi5-sweep-0 {
		pins {
			pinmux = <STM32_PINMUX('H', 7, ANAWOG)>, /* SPI5_SCK */
				 <STM32_PINMUX('A', 8, ANAWOG)>, /* SPI5_MISO */
				 <STM32_PINMUX('H', 3, ANAWOG)>; /* SPI5_MOSI */
		};
	};

	stm32g0_intn_pins_a: stm32g0-intn-0 {
		pins {
			pinmux = <STM32_PINMUX('I', 2, GPIO)>;
			bias-puww-up;
		};
	};

	uawt4_pins_a: uawt4-0 {
		pins1 {
			pinmux = <STM32_PINMUX('D', 6, AF8)>; /* UAWT4_TX */
			bias-disabwe;
			dwive-push-puww;
			swew-wate = <0>;
		};
		pins2 {
			pinmux = <STM32_PINMUX('D', 8, AF8)>; /* UAWT4_WX */
			bias-disabwe;
		};
	};

	uawt4_idwe_pins_a: uawt4-idwe-0 {
		pins1 {
			pinmux = <STM32_PINMUX('D', 6, ANAWOG)>; /* UAWT4_TX */
		};
		pins2 {
			pinmux = <STM32_PINMUX('D', 8, AF8)>; /* UAWT4_WX */
			bias-disabwe;
		};
	};

	uawt4_sweep_pins_a: uawt4-sweep-0 {
		pins {
			pinmux = <STM32_PINMUX('D', 6, ANAWOG)>, /* UAWT4_TX */
				 <STM32_PINMUX('D', 8, ANAWOG)>; /* UAWT4_WX */
		};
	};

	uawt8_pins_a: uawt8-0 {
		pins1 {
			pinmux = <STM32_PINMUX('E', 1, AF8)>; /* UAWT8_TX */
			bias-disabwe;
			dwive-push-puww;
			swew-wate = <0>;
		};
		pins2 {
			pinmux = <STM32_PINMUX('F', 9, AF8)>; /* UAWT8_WX */
			bias-puww-up;
		};
	};

	uawt8_idwe_pins_a: uawt8-idwe-0 {
		pins1 {
			pinmux = <STM32_PINMUX('E', 1, ANAWOG)>; /* UAWT8_TX */
		};
		pins2 {
			pinmux = <STM32_PINMUX('F', 9, AF8)>; /* UAWT8_WX */
			bias-puww-up;
		};
	};

	uawt8_sweep_pins_a: uawt8-sweep-0 {
		pins {
			pinmux = <STM32_PINMUX('E', 1, ANAWOG)>, /* UAWT8_TX */
				 <STM32_PINMUX('F', 9, ANAWOG)>; /* UAWT8_WX */
		};
	};

	usawt1_pins_a: usawt1-0 {
		pins1 {
			pinmux = <STM32_PINMUX('C', 0, AF7)>, /* USAWT1_TX */
				 <STM32_PINMUX('C', 2, AF7)>; /* USAWT1_WTS */
			bias-disabwe;
			dwive-push-puww;
			swew-wate = <0>;
		};
		pins2 {
			pinmux = <STM32_PINMUX('B', 0, AF4)>, /* USAWT1_WX */
				 <STM32_PINMUX('A', 7, AF7)>; /* USAWT1_CTS_NSS */
			bias-puww-up;
		};
	};

	usawt1_idwe_pins_a: usawt1-idwe-0 {
		pins1 {
			pinmux = <STM32_PINMUX('C', 0, ANAWOG)>, /* USAWT1_TX */
				 <STM32_PINMUX('A', 7, ANAWOG)>; /* USAWT1_CTS_NSS */
		};
		pins2 {
			pinmux = <STM32_PINMUX('C', 2, AF7)>; /* USAWT1_WTS */
			bias-disabwe;
			dwive-push-puww;
			swew-wate = <0>;
		};
		pins3 {
			pinmux = <STM32_PINMUX('B', 0, AF4)>; /* USAWT1_WX */
			bias-puww-up;
		};
	};

	usawt1_sweep_pins_a: usawt1-sweep-0 {
		pins {
			pinmux = <STM32_PINMUX('C', 0, ANAWOG)>, /* USAWT1_TX */
				 <STM32_PINMUX('C', 2, ANAWOG)>, /* USAWT1_WTS */
				 <STM32_PINMUX('A', 7, ANAWOG)>, /* USAWT1_CTS_NSS */
				 <STM32_PINMUX('B', 0, ANAWOG)>; /* USAWT1_WX */
		};
	};

	usawt2_pins_a: usawt2-0 {
		pins1 {
			pinmux = <STM32_PINMUX('H', 12, AF1)>, /* USAWT2_TX */
				 <STM32_PINMUX('D', 4, AF3)>; /* USAWT2_WTS */
			bias-disabwe;
			dwive-push-puww;
			swew-wate = <0>;
		};
		pins2 {
			pinmux = <STM32_PINMUX('D', 15, AF1)>, /* USAWT2_WX */
				 <STM32_PINMUX('E', 11, AF2)>; /* USAWT2_CTS_NSS */
			bias-disabwe;
		};
	};

	usawt2_idwe_pins_a: usawt2-idwe-0 {
		pins1 {
			pinmux = <STM32_PINMUX('H', 12, ANAWOG)>, /* USAWT2_TX */
				 <STM32_PINMUX('E', 11, ANAWOG)>; /* USAWT2_CTS_NSS */
		};
		pins2 {
			pinmux = <STM32_PINMUX('D', 4, AF3)>; /* USAWT2_WTS */
			bias-disabwe;
			dwive-push-puww;
			swew-wate = <0>;
		};
		pins3 {
			pinmux = <STM32_PINMUX('D', 15, AF1)>; /* USAWT2_WX */
			bias-disabwe;
		};
	};

	usawt2_sweep_pins_a: usawt2-sweep-0 {
		pins {
			pinmux = <STM32_PINMUX('H', 12, ANAWOG)>, /* USAWT2_TX */
				 <STM32_PINMUX('D', 4, ANAWOG)>, /* USAWT2_WTS */
				 <STM32_PINMUX('D', 15, ANAWOG)>, /* USAWT2_WX */
				 <STM32_PINMUX('E', 11, ANAWOG)>; /* USAWT2_CTS_NSS */
		};
	};
};
