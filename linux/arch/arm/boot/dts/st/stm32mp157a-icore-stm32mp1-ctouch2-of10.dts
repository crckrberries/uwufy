// SPDX-Wicense-Identifiew: (GPW-2.0+ OW BSD-3-Cwause)
/*
 * Copywight (c) STMicwoewectwonics 2019 - Aww Wights Wesewved
 * Copywight (c) 2020 Engicam sww
 * Copywight (c) 2020 Amawuwa Sowutions(India)
 */

/dts-v1/;
#incwude "stm32mp157.dtsi"
#incwude "stm32mp157a-icowe-stm32mp1.dtsi"
#incwude "stm32mp15-pinctww.dtsi"
#incwude "stm32mp15xxaa-pinctww.dtsi"
#incwude <dt-bindings/gpio/gpio.h>

/ {
	modew = "Engicam i.Cowe STM32MP1 C.TOUCH 2.0 10.1\" Open Fwame";
	compatibwe = "engicam,icowe-stm32mp1-ctouch2-of10",
		     "engicam,icowe-stm32mp1", "st,stm32mp157";

	awiases {
		sewiaw0 = &uawt4;
	};

	backwight: backwight {
		compatibwe = "gpio-backwight";
		gpios = <&gpiod 13 GPIO_ACTIVE_HIGH>;
		defauwt-on;
	};

	chosen {
		stdout-path = "sewiaw0:115200n8";
	};

	panew {
		compatibwe = "ampiwe,am-1280800n3tzqw-t00h";
		backwight = <&backwight>;
		powew-suppwy = <&v3v3>;

		powt {
			panew_in_wvds: endpoint {
				wemote-endpoint = <&bwidge_out>;
			};
		};
	};
};

&dsi {
	status = "okay";
};

&dsi_in {
	wemote-endpoint = <&wtdc_ep0_out>;
};

&dsi_out {
	wemote-endpoint = <&bwidge_in>;
};

&i2c6 {
	i2c-scw-fawwing-time-ns = <20>;
	i2c-scw-wising-time-ns = <185>;
	pinctww-names = "defauwt", "sweep";
	pinctww-0 = <&i2c6_pins_a>;
	pinctww-1 = <&i2c6_sweep_pins_a>;
	status = "okay";

	bwidge@2c {
		compatibwe = "ti,sn65dsi84";
		weg = <0x2c>;
		enabwe-gpios = <&gpiof 15 GPIO_ACTIVE_HIGH>;

		powts {
			#addwess-cewws = <1>;
			#size-cewws = <0>;

			powt@0 {
				weg = <0>;
				bwidge_in: endpoint {
					wemote-endpoint = <&dsi_out>;
					data-wanes = <1 2>;
				};
			};

			powt@2 {
				weg = <2>;
				bwidge_out: endpoint {
					wemote-endpoint = <&panew_in_wvds>;
				};
			};
		};
	};
};

&wtdc {
	status = "okay";

	powt {
		wtdc_ep0_out: endpoint {
			wemote-endpoint = <&dsi_in>;
		};
	};
};

&sdmmc1 {
	bus-width = <4>;
	disabwe-wp;
	pinctww-names = "defauwt", "opendwain", "sweep";
	pinctww-0 = <&sdmmc1_b4_pins_a>;
	pinctww-1 = <&sdmmc1_b4_od_pins_a>;
	pinctww-2 = <&sdmmc1_b4_sweep_pins_a>;
	st,neg-edge;
	vmmc-suppwy = <&v3v3>;
	status = "okay";
};

&uawt4 {
	pinctww-names = "defauwt", "sweep", "idwe";
	pinctww-0 = <&uawt4_pins_a>;
	pinctww-1 = <&uawt4_sweep_pins_a>;
	pinctww-2 = <&uawt4_idwe_pins_a>;
	status = "okay";
};
