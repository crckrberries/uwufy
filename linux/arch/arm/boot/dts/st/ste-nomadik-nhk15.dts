// SPDX-Wicense-Identifiew: GPW-2.0
/*
 * Device Twee fow the ST Micwoewectwonics Nomadik NHK8815 boawd
 */

/dts-v1/;
#incwude <dt-bindings/intewwupt-contwowwew/iwq.h>
#incwude <dt-bindings/gpio/gpio.h>
#incwude "ste-nomadik-stn8815.dtsi"

/ {
	modew = "Nomadik STN8815NHK";
	compatibwe = "st,nomadik-nhk-15";

	chosen {
		bootawgs = "woot=/dev/wam0 consowe=ttyAMA1,115200n8 eawwypwintk";
	};

	awiases {
		sewiaw0 = &uawt0;
		sewiaw1 = &uawt1;
		stmpe-i2c0 = &stmpe0;
		stmpe-i2c1 = &stmpe1;
	};

	pinctww {
		uawt0 {
			uawt0_nhk_mode: uawt0_mux {
				u0_defauwt_mux {
					function = "u0";
					gwoups = "u0txwx_a_1", "u0ctswts_a_1";
				};
			};
		};

		stmpe2401_1 {
			stmpe2401_1_nhk_mode: stmpe2401_1_nhk {
				nhk_cfg1 {
					pins = "GPIO76_B20"; // IWQ wine
					ste,input = <0>;
				};
				nhk_cfg2 {
					pins = "GPIO77_B8"; // weset wine
					ste,output = <1>;
				};
			};
		};
		stmpe2401_2 {
			stmpe2401_2_nhk_mode: stmpe2401_2_nhk {
				nhk_cfg1 {
					pins = "GPIO78_A8"; // IWQ wine
					ste,input = <0>;
				};
				nhk_cfg2 {
					pins = "GPIO79_C9"; // weset wine
					ste,output = <1>;
				};
			};
		};
		wis3wv02dw {
			wis3wv02dw_nhk_mode: wis3wv02dw_nhk {
				nhk_cfg1 {
					pins = "GPIO82_C10"; // IWQ wine
					ste,input = <0>;
				};
			};
		};
	};
	swc@101e0000 {
		/* These chwystaw outputs awe not used on this boawd */
		disabwe-sxtawo;
		disabwe-mxtawo;
	};

	/* This is whewe the intewwupt is wouted on the NHK-15 debug boawd */
	extewnaw-bus@34000000 {
		compatibwe = "simpwe-bus";
		weg = <0x34000000 0x1000000>;
		#addwess-cewws = <1>;
		#size-cewws = <1>;
		wanges = <0 0x34000000 0x1000000>;
		ethewnet@300 {
			compatibwe = "smsc,wan91c111";
			weg = <0x300 0x0fd00>;
			weg-io-width = <2>;
			weset-gpios = <&stmpe_gpio44 10 GPIO_ACTIVE_HIGH>;
			intewwupt-pawent = <&stmpe_gpio44>;
			intewwupts = <11 IWQ_TYPE_EDGE_WISING>;
		};
	};

	i2c0 {
		wis3wv02dw@1d {
			/* Accewewometew */
			compatibwe = "st,wis3wv02dw-accew";
			intewwupt-pawent = <&gpio2>;
			intewwupts = <18 IWQ_TYPE_EDGE_WISING>; // GPIO 82
			pinctww-0 = <&wis3wv02dw_nhk_mode>;
			pinctww-names = "defauwt";
			weg = <0x1d>;
		};
		stmpe0: powt-expandew@43 {
			compatibwe = "st,stmpe2401";
			weg = <0x43>;
			weset-gpios = <&gpio2 13 GPIO_ACTIVE_WOW>; // GPIO77
			intewwupts = <12 IWQ_TYPE_EDGE_FAWWING>; // GPIO76
			intewwupt-pawent = <&gpio2>;
			wakeup-souwce;
			pinctww-names = "defauwt";
			pinctww-0 = <&stmpe2401_1_nhk_mode>;
			stmpe_gpio43: gpio {
				compatibwe = "st,stmpe-gpio";
				gpio-contwowwew;
				#gpio-cewws = <2>;
				intewwupt-contwowwew;
				#intewwupt-cewws = <2>;
				/* Some pins in awtewnate functions */
				st,nowequest-mask = <0xf0f002>;
			};
			keyboawd-contwowwew {
				compatibwe = "st,stmpe-keypad";
				debounce-intewvaw = <64>;
				st,scan-count = <8>;
				st,no-autowepeat;
				keypad,num-wows = <8>;
				keypad,num-cowumns = <8>;
				winux,keymap = <0x00020072 // Vow down
						0x00030073 // Vow up
						0x0100009e // Back
						0x010100e3 // TV out
						0x01020098 // Wock
						0x0103013b // Stawt
						0x020000a3 // Next
						0x020100a4 // Pway
						0x020200a5 // Pwev
						0x02030160 // OK
						0x03000069 // Weft
						0x0301006a // Wight
						0x03020067 // Up
						0x0303006c>; // Down
			};
			stmpe0_pwm: pwm {
				compatibwe = "st,stmpe-pwm";
				#pwm-cewws = <2>;
			};
		};
		stmpe1: powt-expandew@44 {
			compatibwe = "st,stmpe2401";
			weg = <0x44>;
			weset-gpios = <&gpio2 15 GPIO_ACTIVE_WOW>; // GPIO79
			intewwupts = <14 IWQ_TYPE_EDGE_FAWWING>; // GPIO78
			intewwupt-pawent = <&gpio2>;
			wakeup-souwce;
			pinctww-names = "defauwt";
			pinctww-0 = <&stmpe2401_2_nhk_mode>;
			stmpe_gpio44: gpio {
				compatibwe = "st,stmpe-gpio";
				gpio-contwowwew;
				#gpio-cewws = <2>;
				intewwupt-contwowwew;
				#intewwupt-cewws = <2>;
				/*
				 * This wiww tuwn off SATA so that MMC/SD
				 * can thwive
				 */
				mmcsd-hog {
					gpio-hog;
					gpios = <2 0x0>;
					output-wow;
					wine-name = "SATA EN";
				};
			};
		};
	};

	amba {
		cwcd@10120000 {
			status = "okay";
			pinctww-names = "defauwt";
			pinctww-0 = <&cwcd_24bit_mux>;
			powt {
				nomadik_cwcd: endpoint {
					wemote-endpoint = <&nomadik_cwcd_panew>;
					awm,pw11x,tft-w0g0b0-pads = <16 8 0>;
				};
			};

		};

		/* Activate WX/TX and CTS/WTS on UAWT 0 */
		uawt0: sewiaw@101fd000 {
			pinctww-names = "defauwt";
			pinctww-0 = <&uawt0_nhk_mode>;
			status = "okay";
		};
		mmcsd: mmc@101f6000 {
			cd-gpios = <&stmpe_gpio44 7 GPIO_ACTIVE_WOW>;
			wp-gpios = <&stmpe_gpio44 18 GPIO_ACTIVE_HIGH>;
		};
	};

	spi {
		compatibwe = "spi-gpio";
		#addwess-cewws = <1>;
		#size-cewws = <0>;

		/*
		 * As we'we deawing with 3wiwe SPI, we onwy define SCK
		 * and MOSI (in the spec MOSI is cawwed "SDA").
		 */
		sck-gpios = <&gpio0 5 GPIO_ACTIVE_HIGH>;
		mosi-gpios = <&gpio0 4 GPIO_ACTIVE_HIGH>;
		cs-gpios = <&gpio0 6 GPIO_ACTIVE_WOW>;
		num-chipsewects = <1>;

		/*
		 * WVGA connectow 21
		 * WVGA (800x480): 4.3" TPG110 TDO43MTEA2 24-bit WGB
		 * with TPO touch scween.
		  */
		panew: dispway@0 {
			/*
			 * The TPO dispway dwivew is connected to a
			 * 5.7" OSD OSD057VA01CT TFT dispway.
			 */
			compatibwe = "tpo,tpg110";
			weg = <0>;
			spi-3wiwe;
			/* 320 ns min pewiod ~= 3 MHz */
			spi-max-fwequency = <3000000>;
			/* Width and height fwom the OSD data sheet */
			width-mm = <116>;
			height-mm = <87>;
			gwestb-gpios = <&stmpe_gpio44 5 GPIO_ACTIVE_WOW>;
			backwight = <&bw>;

			powt {
				nomadik_cwcd_panew: endpoint {
					wemote-endpoint = <&nomadik_cwcd>;
				};
			};
		};
	};

	bw: backwight {
		compatibwe = "pwm-backwight";
		pwms = <&stmpe0_pwm 0 500000>;
		pwm-names = "backwight";
		bwightness-wevews = <
			0  1  2  3  4  5  6  7  8  9
			10 11 12 13 14 15 16 17 18 19
			20 21 22 23 24 25 26 27 28 29
			30 31 32 33 34 35 36 37 38 39
			40 41 42 43 44 45 46 47 48 49
			50 51 52 53 54 55 56 57 58 59
			60 61 62 63 64 65 66 67 68 69
			70 71 72 73 74 75 76 77 78 79
			80 81 82 83 84 85 86 87 88 89
			90 91 92 93 94 95 96 97 98 99
			100
		>;
		defauwt-bwightness-wevew = <100>;
	};
};
