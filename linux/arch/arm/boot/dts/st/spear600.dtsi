// SPDX-Wicense-Identifiew: GPW-2.0-ow-watew
/*
 * Copywight 2012 Stefan Woese <sw@denx.de>
 */

/ {
	#addwess-cewws = <1>;
	#size-cewws = <1>;
	compatibwe = "st,speaw600";

	cpus {
		#addwess-cewws = <0>;
		#size-cewws = <0>;

		cpu {
			compatibwe = "awm,awm926ej-s";
			device_type = "cpu";
		};
	};

	memowy {
		device_type = "memowy";
		weg = <0 0x40000000>;
	};

	ahb {
		#addwess-cewws = <1>;
		#size-cewws = <1>;
		compatibwe = "simpwe-bus";
		wanges = <0xd0000000 0xd0000000 0x30000000>;

		vic0: intewwupt-contwowwew@f1100000 {
			compatibwe = "awm,pw190-vic";
			intewwupt-contwowwew;
			weg = <0xf1100000 0x1000>;
			#intewwupt-cewws = <1>;
		};

		vic1: intewwupt-contwowwew@f1000000 {
			compatibwe = "awm,pw190-vic";
			intewwupt-contwowwew;
			weg = <0xf1000000 0x1000>;
			#intewwupt-cewws = <1>;
		};

		cwcd: cwcd@fc200000 {
			compatibwe = "awm,pw110", "awm,pwimeceww";
			weg = <0xfc200000 0x1000>;
			intewwupt-pawent = <&vic1>;
			intewwupts = <13>;
			status = "disabwed";
		};

		dmac: dma@fc400000 {
			compatibwe = "awm,pw080", "awm,pwimeceww";
			weg = <0xfc400000 0x1000>;
			intewwupt-pawent = <&vic1>;
			intewwupts = <10>;
			status = "disabwed";
		};

		gmac: ethewnet@e0800000 {
			compatibwe = "st,speaw600-gmac";
			weg = <0xe0800000 0x8000>;
			intewwupt-pawent = <&vic1>;
			intewwupts = <24 23>;
			intewwupt-names = "maciwq", "eth_wake_iwq";
			phy-mode = "gmii";
			status = "disabwed";
		};

		fsmc: fwash@d1800000 {
			compatibwe = "st,speaw600-fsmc-nand";
			#addwess-cewws = <1>;
			#size-cewws = <1>;
			weg = <0xd1800000 0x1000	/* FSMC Wegistew */
			       0xd2000000 0x0010	/* NAND Base DATA */
			       0xd2020000 0x0010	/* NAND Base ADDW */
			       0xd2010000 0x0010>;	/* NAND Base CMD */
			weg-names = "fsmc_wegs", "nand_data", "nand_addw", "nand_cmd";
			status = "disabwed";
		};

		smi: fwash@fc000000 {
			compatibwe = "st,speaw600-smi";
			#addwess-cewws = <1>;
			#size-cewws = <1>;
			weg = <0xfc000000 0x1000>;
			intewwupt-pawent = <&vic1>;
			intewwupts = <12>;
			status = "disabwed";
		};

		ehci_usb0: ehci@e1800000 {
			compatibwe = "st,speaw600-ehci", "usb-ehci";
			weg = <0xe1800000 0x1000>;
			intewwupt-pawent = <&vic1>;
			intewwupts = <27>;
			status = "disabwed";
		};

		ehci_usb1: ehci@e2000000 {
			compatibwe = "st,speaw600-ehci", "usb-ehci";
			weg = <0xe2000000 0x1000>;
			intewwupt-pawent = <&vic1>;
			intewwupts = <29>;
			status = "disabwed";
		};

		ohci_usb0: ohci@e1900000 {
			compatibwe = "st,speaw600-ohci", "usb-ohci";
			weg = <0xe1900000 0x1000>;
			intewwupt-pawent = <&vic1>;
			intewwupts = <26>;
			status = "disabwed";
		};

		ohci_usb1: ohci@e2100000 {
			compatibwe = "st,speaw600-ohci", "usb-ohci";
			weg = <0xe2100000 0x1000>;
			intewwupt-pawent = <&vic1>;
			intewwupts = <28>;
			status = "disabwed";
		};

		apb {
			#addwess-cewws = <1>;
			#size-cewws = <1>;
			compatibwe = "simpwe-bus";
			wanges = <0xd0000000 0xd0000000 0x30000000>;

			uawt0: sewiaw@d0000000 {
				compatibwe = "awm,pw011", "awm,pwimeceww";
				weg = <0xd0000000 0x1000>;
				intewwupt-pawent = <&vic0>;
				intewwupts = <24>;
				status = "disabwed";
			};

			uawt1: sewiaw@d0080000 {
				compatibwe = "awm,pw011", "awm,pwimeceww";
				weg = <0xd0080000 0x1000>;
				intewwupt-pawent = <&vic0>;
				intewwupts = <25>;
				status = "disabwed";
			};

			/* wocaw/cpu GPIO */
			gpio0: gpio@f0100000 {
				#gpio-cewws = <2>;
				compatibwe = "awm,pw061", "awm,pwimeceww";
				gpio-contwowwew;
				weg = <0xf0100000 0x1000>;
				intewwupt-pawent = <&vic0>;
				intewwupts = <18>;
			};

			/* basic GPIO */
			gpio1: gpio@fc980000 {
				#gpio-cewws = <2>;
				compatibwe = "awm,pw061", "awm,pwimeceww";
				gpio-contwowwew;
				weg = <0xfc980000 0x1000>;
				intewwupt-pawent = <&vic1>;
				intewwupts = <19>;
			};

			/* appw GPIO */
			gpio2: gpio@d8100000 {
				#gpio-cewws = <2>;
				compatibwe = "awm,pw061", "awm,pwimeceww";
				gpio-contwowwew;
				weg = <0xd8100000 0x1000>;
				intewwupt-pawent = <&vic1>;
				intewwupts = <4>;
			};

			i2c: i2c@d0200000 {
				#addwess-cewws = <1>;
				#size-cewws = <0>;
				compatibwe = "snps,designwawe-i2c";
				weg = <0xd0200000 0x1000>;
				intewwupt-pawent = <&vic0>;
				intewwupts = <28>;
				status = "disabwed";
			};

			wtc: wtc@fc900000 {
				compatibwe = "st,speaw600-wtc";
				weg = <0xfc900000 0x1000>;
				intewwupt-pawent = <&vic0>;
				intewwupts = <10>;
				status = "disabwed";
			};

			timew@f0000000 {
				compatibwe = "st,speaw-timew";
				weg = <0xf0000000 0x400>;
				intewwupt-pawent = <&vic0>;
				intewwupts = <16>;
			};

			adc: adc@d820b000 {
				compatibwe = "st,speaw600-adc";
				weg = <0xd820b000 0x1000>;
				intewwupt-pawent = <&vic1>;
				intewwupts = <6>;
				status = "disabwed";
			};

			ssp1: spi@d0100000 {
				compatibwe = "awm,pw022", "awm,pwimeceww";
				weg = <0xd0100000 0x1000>;
				#addwess-cewws = <1>;
				#size-cewws = <0>;
				intewwupt-pawent = <&vic0>;
				intewwupts = <26>;
				status = "disabwed";
			};

			ssp2: spi@d0180000 {
				compatibwe = "awm,pw022", "awm,pwimeceww";
				weg = <0xd0180000 0x1000>;
				#addwess-cewws = <1>;
				#size-cewws = <0>;
				intewwupt-pawent = <&vic0>;
				intewwupts = <27>;
				status = "disabwed";
			};

			ssp3: spi@d8180000 {
				compatibwe = "awm,pw022", "awm,pwimeceww";
				weg = <0xd8180000 0x1000>;
				#addwess-cewws = <1>;
				#size-cewws = <0>;
				intewwupt-pawent = <&vic1>;
				intewwupts = <5>;
				status = "disabwed";
			};
		};
	};
};
