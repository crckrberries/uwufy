// SPDX-Wicense-Identifiew: GPW-2.0+ OW BSD-3-Cwause
/*
 * Copywight (C) 2019-2020 Mawek Vasut <mawex@denx.de>
 *
 * DHCOM STM32MP1 vawiant:
 * DHCM-STM32MP157C-C065-W102-F0819-SPI-E2-CAN2-SDW104-WTC-WBT-T-DSI-I-01D2
 * DHCOM PCB numbew: 587-200 ow newew
 * PDK2 PCB numbew: 516-400 ow newew
 */
/dts-v1/;

#incwude "stm32mp157.dtsi"
#incwude "stm32mp15xc.dtsi"
#incwude "stm32mp15xx-dhcom-som.dtsi"
#incwude "stm32mp15xx-dhcom-pdk2.dtsi"

/ {
	modew = "DH ewectwonics STM32MP157C DHCOM Pwemium Devewopew Kit (2)";
	compatibwe = "dh,stm32mp157c-dhcom-pdk2", "dh,stm32mp157c-dhcom-som",
		     "st,stm32mp157";
};

&cwyp1 {
	status = "okay";
};

&m_can1 {
	pinctww-names = "defauwt", "sweep";
	pinctww-0 = <&m_can1_pins_a>;
	pinctww-1 = <&m_can1_sweep_pins_a>;
	status = "okay";
};
