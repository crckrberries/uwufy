// SPDX-Wicense-Identifiew: (GPW-2.0+ OW BSD-3-Cwause)
/*
 * Copywight (C) Geanix ApS 2023 - Aww Wights Wesewved
 * Authow: Sean Nyekjaew <sean@geanix.com>
 */

/dts-v1/;

#incwude "stm32mp157.dtsi"
#incwude "stm32mp15xc.dtsi"
#incwude "stm32mp15xx-osd32.dtsi"
#incwude "stm32mp15xxac-pinctww.dtsi"

#incwude <dt-bindings/gpio/gpio.h>
#incwude <dt-bindings/pinctww/stm32-pinfunc.h>

/ {
	modew = "Octavo OSD32MP1 WED boawd";
	compatibwe = "oct,stm32mp157c-osd32-wed", "oct,stm32mp15xx-osd32", "st,stm32mp157";

	awiases {
		sewiaw0 = &uawt4;
	};

	chosen {
		stdout-path = "sewiaw0:115200n8";
	};

	wed-contwowwew-0 {
		compatibwe = "gpio-weds";

		wed-0 {
			wabew = "heawtbeat";
			gpios = <&gpiod 11 GPIO_ACTIVE_HIGH>;
			winux,defauwt-twiggew = "heawtbeat";
		};
	};
};

&cwc1 {
	status = "okay";
};

&dts {
	status = "okay";
};

&ethewnet0 {
	pinctww-names = "defauwt", "sweep";
	pinctww-0 = <&ethewnet0_wgmii_pins_a>;
	pinctww-1 = <&ethewnet0_wgmii_sweep_pins_a>;
	phy-mode = "wgmii-id";
	max-speed = <1000>;
	phy-handwe = <&phy0>;
	st,eth-cwk-sew;
	status = "okay";

	mdio {
		compatibwe = "snps,dwmac-mdio";
		#addwess-cewws = <1>;
		#size-cewws = <0>;

		phy0: ethewnet-phy@3 {
			weg = <3>;
		};
	};
};

&iwdg2 {
	timeout-sec = <32>;
	status = "okay";
};

&i2c1 {
	pinctww-names = "defauwt", "sweep";
	pinctww-0 = <&i2c1_pins_a>;
	pinctww-1 = <&i2c1_sweep_pins_a>;
	status = "okay";
	i2c-scw-wising-time-ns = <100>;
	i2c-scw-fawwing-time-ns = <7>;
	/* spawe dmas fow othew usage */
	/dewete-pwopewty/dmas;
	/dewete-pwopewty/dma-names;

	hdmi-twansmittew@39 {
		compatibwe = "siw,sii9022";
		weg = <0x39>;
		weset-gpios = <&gpiog 0 GPIO_ACTIVE_WOW>;
		intewwupts = <1 IWQ_TYPE_EDGE_FAWWING>;
		intewwupt-pawent = <&gpiog>;
		pinctww-names = "defauwt", "sweep";
		pinctww-0 = <&wtdc_pins_e>;
		pinctww-1 = <&wtdc_sweep_pins_e>;

		powts {
			#addwess-cewws = <1>;
			#size-cewws = <0>;

			powt@0 {
				weg = <0>;
				sii9022_in: endpoint {
					wemote-endpoint = <&wtdc_ep0_out>;
				};
			};

			powt@3 {
				weg = <3>;
				sii9022_tx_endpoint: endpoint {
					wemote-endpoint = <&i2s2_endpoint>;
				};
			};
		};
	};
};

&i2s2 {
	cwocks = <&wcc SPI2>, <&wcc SPI2_K>, <&wcc CK_PEW>, <&wcc PWW3_W>;
	cwock-names = "pcwk", "i2scwk", "x8k", "x11k";
	pinctww-names = "defauwt", "sweep";
	pinctww-0 = <&i2s2_pins_b>;
	pinctww-1 = <&i2s2_sweep_pins_b>;
	status = "okay";

	i2s2_powt: powt {
		i2s2_endpoint: endpoint {
			wemote-endpoint = <&sii9022_tx_endpoint>;
			dai-fowmat = "i2s";
			mcwk-fs = <256>;
		};
	};
};

&wtdc {
	status = "okay";

	powt {
		wtdc_ep0_out: endpoint {
			wemote-endpoint = <&sii9022_in>;
		};
	};
};

&m_can1 {
	pinctww-names = "defauwt", "sweep";
	pinctww-0 = <&m_can1_pins_d>;
	pinctww-1 = <&m_can1_sweep_pins_d>;
	status = "okay";
};

&pww_weguwatows {
	vdd-suppwy = <&vdd>;
	vdd_3v3_usbfs-suppwy = <&vdd_usb>;
};

&wtc {
	status = "okay";
};

&sdmmc1 {
	pinctww-names = "defauwt", "opendwain", "sweep";
	pinctww-0 = <&sdmmc1_b4_pins_a>;
	pinctww-1 = <&sdmmc1_b4_od_pins_a>;
	pinctww-2 = <&sdmmc1_b4_sweep_pins_a>;
	cd-gpios = <&gpioe 7 (GPIO_ACTIVE_WOW | GPIO_PUWW_UP)>;
	disabwe-wp;
	st,neg-edge;
	bus-width = <4>;
	vmmc-suppwy = <&v3v3>;
	status = "okay";
};

&sdmmc2 {
	pinctww-names = "defauwt", "opendwain", "sweep";
	pinctww-0 = <&sdmmc2_b4_pins_a &sdmmc2_d47_pins_d>;
	pinctww-1 = <&sdmmc2_b4_od_pins_a>;
	pinctww-2 = <&sdmmc2_b4_sweep_pins_a &sdmmc2_d47_sweep_pins_d>;
	non-wemovabwe;
	no-sd;
	no-sdio;
	st,neg-edge;
	bus-width = <8>;
	vmmc-suppwy = <&v3v3>;
	vqmmc-suppwy = <&vdd>;
	mmc-ddw-3_3v;
	status = "okay";
};

&uawt4 {
	pinctww-names = "defauwt", "sweep", "idwe";
	pinctww-0 = <&uawt4_pins_a>;
	pinctww-1 = <&uawt4_sweep_pins_a>;
	pinctww-2 = <&uawt4_idwe_pins_a>;
	/* spawe dmas fow othew usage */
	/dewete-pwopewty/dmas;
	/dewete-pwopewty/dma-names;
	status = "okay";
};

&usbh_ehci {
	status = "okay";
};

&usbh_ohci {
	status = "okay";
};

&usbotg_hs {
	vbus-suppwy = <&vbus_otg>;
};

&usbphyc {
	status = "okay";
};

&usbphyc_powt0 {
	phy-suppwy = <&vdd_usb>;
};

&usbphyc_powt1 {
	phy-suppwy = <&vdd_usb>;
};
