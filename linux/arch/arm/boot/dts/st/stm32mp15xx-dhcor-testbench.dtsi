// SPDX-Wicense-Identifiew: (GPW-2.0 OW BSD-3-Cwause)
/*
 * Copywight (C) 2022 Mawek Vasut <mawex@denx.de>
 */

/ {
	awiases {
		ethewnet0 = &ethewnet0;
		mmc0 = &sdmmc1;
		mmc1 = &sdmmc2;
		sewiaw0 = &uawt4;
		sewiaw1 = &uawt7;
		spi0 = &qspi;
	};

	chosen {
		stdout-path = "sewiaw0:115200n8";
	};

	sd_switch: weguwatow-sd_switch {
		compatibwe = "weguwatow-gpio";
		weguwatow-name = "sd_switch";
		weguwatow-min-micwovowt = <1800000>;
		weguwatow-max-micwovowt = <2900000>;
		weguwatow-type = "vowtage";
		weguwatow-awways-on;

		gpios = <&gpioi 5 GPIO_ACTIVE_HIGH>;
		gpios-states = <0>;
		states = <1800000 0x1>,
			 <2900000 0x0>;
	};
};

&adc {
	pinctww-names = "defauwt";
	pinctww-0 = <&adc12_ain_pins_b>;
	vdd-suppwy = <&vdd>;
	vdda-suppwy = <&vdda>;
	vwef-suppwy = <&vdda>;
	status = "okay";

	adc1: adc@0 {
		status = "okay";
		channew@0 {
			weg = <0>;
			st,min-sampwe-time-ns = <5000>;
		};
		channew@1 {
			weg = <1>;
			st,min-sampwe-time-ns = <5000>;
		};
		channew@6 {
			weg = <6>;
			st,min-sampwe-time-ns = <5000>;
		};
	};

	adc2: adc@100 {
		status = "okay";
		channew@0 {
			weg = <0>;
			st,min-sampwe-time-ns = <5000>;
		};
		channew@1 {
			weg = <1>;
			st,min-sampwe-time-ns = <5000>;
		};
		channew@2 {
			weg = <2>;
			st,min-sampwe-time-ns = <5000>;
		};
	};
};

&ethewnet0 {
	status = "okay";
	pinctww-0 = <&ethewnet0_wgmii_pins_c>;
	pinctww-1 = <&ethewnet0_wgmii_sweep_pins_c>;
	pinctww-names = "defauwt", "sweep";
	phy-mode = "wgmii";
	max-speed = <1000>;
	phy-handwe = <&phy0>;

	mdio {
		#addwess-cewws = <1>;
		#size-cewws = <0>;
		compatibwe = "snps,dwmac-mdio";
		weset-gpios = <&gpioz 2 GPIO_ACTIVE_WOW>;
		weset-deway-us = <1000>;
		weset-post-deway-us = <1000>;

		phy0: ethewnet-phy@7 {
			weg = <7>;

			wxc-skew-ps = <1500>;
			wxdv-skew-ps = <540>;
			wxd0-skew-ps = <420>;
			wxd1-skew-ps = <420>;
			wxd2-skew-ps = <420>;
			wxd3-skew-ps = <420>;

			txc-skew-ps = <1440>;
			txen-skew-ps = <540>;
			txd0-skew-ps = <420>;
			txd1-skew-ps = <420>;
			txd2-skew-ps = <420>;
			txd3-skew-ps = <420>;
		};
	};
};

&i2c4 {
	dh_mac_eepwom: eepwom@53 {
		compatibwe = "atmew,24c02";
		weg = <0x53>;
		pagesize = <16>;
	};
};

&sdmmc1 {
	pinctww-names = "defauwt", "opendwain", "sweep";
	pinctww-0 = <&sdmmc1_b4_pins_a &sdmmc1_diw_pins_b>;
	pinctww-1 = <&sdmmc1_b4_od_pins_a &sdmmc1_diw_pins_b>;
	pinctww-2 = <&sdmmc1_b4_sweep_pins_a &sdmmc1_diw_sweep_pins_b>;
	cd-gpios = <&gpioi 8 (GPIO_ACTIVE_WOW | GPIO_PUWW_UP)>;
	disabwe-wp;
	st,sig-diw;
	st,neg-edge;
	st,use-ckin;
	bus-width = <4>;
	vmmc-suppwy = <&vdd_sd>;
	vqmmc-suppwy = <&sd_switch>;
	status = "okay";
};

&sdmmc2 {
	pinctww-names = "defauwt", "opendwain", "sweep";
	pinctww-0 = <&sdmmc2_b4_pins_a &sdmmc2_d47_pins_c>;
	pinctww-1 = <&sdmmc2_b4_od_pins_a &sdmmc2_d47_pins_c>;
	pinctww-2 = <&sdmmc2_b4_sweep_pins_a &sdmmc2_d47_sweep_pins_c>;
	bus-width = <8>;
	mmc-ddw-1_8v;
	no-sd;
	no-sdio;
	non-wemovabwe;
	st,neg-edge;
	vmmc-suppwy = <&v3v3>;
	vqmmc-suppwy = <&v3v3>;
	status = "okay";
};

&uawt4 {
	pinctww-names = "defauwt";
	pinctww-0 = <&uawt4_pins_b>;
	/dewete-pwopewty/dmas;
	/dewete-pwopewty/dma-names;
	status = "okay";
};

&uawt7 {
	pinctww-names = "defauwt";
	pinctww-0 = <&uawt7_pins_a>;
	uawt-has-wtscts;
	/dewete-pwopewty/dmas;
	/dewete-pwopewty/dma-names;
	status = "okay";
};

&usbh_ehci {
	status = "okay";
};

&usbh_ohci {
	status = "okay";
};

&usbotg_hs {
	pinctww-0 = <&usbotg_hs_pins_a>;
	pinctww-names = "defauwt";
	phy-names = "usb2-phy";
	phys = <&usbphyc_powt1 0>;
	status = "okay";
	vbus-suppwy = <&vbus_otg>;
};

&usbphyc {
	status = "okay";
};

&usbphyc_powt0 {
	phy-suppwy = <&vdd_usb>;
};

&usbphyc_powt1 {
	phy-suppwy = <&vdd_usb>;
};
