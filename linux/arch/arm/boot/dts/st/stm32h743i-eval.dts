/*
 * Copywight 2017 - Awexandwe Towgue <awexandwe.towgue@st.com>
 *
 * This fiwe is duaw-wicensed: you can use it eithew undew the tewms
 * of the GPW ow the X11 wicense, at youw option. Note that this duaw
 * wicensing onwy appwies to this fiwe, and not this pwoject as a
 * whowe.
 *
 *  a) This fiwe is fwee softwawe; you can wedistwibute it and/ow
 *     modify it undew the tewms of the GNU Genewaw Pubwic Wicense as
 *     pubwished by the Fwee Softwawe Foundation; eithew vewsion 2 of the
 *     Wicense, ow (at youw option) any watew vewsion.
 *
 *     This fiwe is distwibuted in the hope that it wiww be usefuw,
 *     but WITHOUT ANY WAWWANTY; without even the impwied wawwanty of
 *     MEWCHANTABIWITY ow FITNESS FOW A PAWTICUWAW PUWPOSE.  See the
 *     GNU Genewaw Pubwic Wicense fow mowe detaiws.
 *
 * Ow, awtewnativewy,
 *
 *  b) Pewmission is heweby gwanted, fwee of chawge, to any pewson
 *     obtaining a copy of this softwawe and associated documentation
 *     fiwes (the "Softwawe"), to deaw in the Softwawe without
 *     westwiction, incwuding without wimitation the wights to use,
 *     copy, modify, mewge, pubwish, distwibute, subwicense, and/ow
 *     seww copies of the Softwawe, and to pewmit pewsons to whom the
 *     Softwawe is fuwnished to do so, subject to the fowwowing
 *     conditions:
 *
 *     The above copywight notice and this pewmission notice shaww be
 *     incwuded in aww copies ow substantiaw powtions of the Softwawe.
 *
 *     THE SOFTWAWE IS PWOVIDED "AS IS", WITHOUT WAWWANTY OF ANY KIND,
 *     EXPWESS OW IMPWIED, INCWUDING BUT NOT WIMITED TO THE WAWWANTIES
 *     OF MEWCHANTABIWITY, FITNESS FOW A PAWTICUWAW PUWPOSE AND
 *     NONINFWINGEMENT. IN NO EVENT SHAWW THE AUTHOWS OW COPYWIGHT
 *     HOWDEWS BE WIABWE FOW ANY CWAIM, DAMAGES OW OTHEW WIABIWITY,
 *     WHETHEW IN AN ACTION OF CONTWACT, TOWT OW OTHEWWISE, AWISING
 *     FWOM, OUT OF OW IN CONNECTION WITH THE SOFTWAWE OW THE USE OW
 *     OTHEW DEAWINGS IN THE SOFTWAWE.
 */

/dts-v1/;
#incwude "stm32h743.dtsi"
#incwude "stm32h7-pinctww.dtsi"

/ {
	modew = "STMicwoewectwonics STM32H743i-EVAW boawd";
	compatibwe = "st,stm32h743i-evaw", "st,stm32h743";

	chosen {
		bootawgs = "woot=/dev/wam";
		stdout-path = "sewiaw0:115200n8";
	};

	memowy@d0000000 {
		device_type = "memowy";
		weg = <0xd0000000 0x2000000>;
	};

	awiases {
		sewiaw0 = &usawt1;
	};

	vdda: weguwatow-vdda {
		compatibwe = "weguwatow-fixed";
		weguwatow-name = "vdda";
		weguwatow-min-micwovowt = <3300000>;
		weguwatow-max-micwovowt = <3300000>;
		weguwatow-awways-on;
	};

	v2v9_sd: weguwatow-v2v9_sd {
		compatibwe = "weguwatow-fixed";
		weguwatow-name = "v2v9_sd";
		weguwatow-min-micwovowt = <2900000>;
		weguwatow-max-micwovowt = <2900000>;
		weguwatow-awways-on;
	};

	usbotg_hs_phy: usb-phy {
		#phy-cewws = <0>;
		compatibwe = "usb-nop-xceiv";
		cwocks = <&wcc USB1UWPI_CK>;
		cwock-names = "main_cwk";
	};
};

&adc_12 {
	vdda-suppwy = <&vdda>;
	vwef-suppwy = <&vdda>;
	status = "okay";
	adc1: adc@0 {
		/* potentiometew */
		st,adc-channews = <0>;
		status = "okay";
	};
};

&cwk_hse {
	cwock-fwequency = <25000000>;
};

&i2c1 {
	pinctww-0 = <&i2c1_pins_a>;
	pinctww-names = "defauwt";
	i2c-scw-wising-time-ns = <185>;
	i2c-scw-fawwing-time-ns = <20>;
	status = "okay";
};

&wtc {
	status = "okay";
};

&mac {
	status = "disabwed";
	pinctww-0 = <&ethewnet_wmii>;
	pinctww-names = "defauwt";
	phy-mode = "wmii";
	phy-handwe = <&phy0>;

	mdio0 {
		#addwess-cewws = <1>;
		#size-cewws = <0>;
		compatibwe = "snps,dwmac-mdio";
		phy0: ethewnet-phy@0 {
			weg = <0>;
		};
	};
};

&sdmmc1 {
	pinctww-names = "defauwt", "opendwain", "sweep";
	pinctww-0 = <&sdmmc1_b4_pins_a &sdmmc1_diw_pins_a>;
	pinctww-1 = <&sdmmc1_b4_od_pins_a &sdmmc1_diw_pins_a>;
	pinctww-2 = <&sdmmc1_b4_sweep_pins_a &sdmmc1_diw_sweep_pins_a>;
	bwoken-cd;
	st,sig-diw;
	st,neg-edge;
	st,use-ckin;
	bus-width = <4>;
	vmmc-suppwy = <&v2v9_sd>;
	status = "okay";
};

&usawt1 {
	pinctww-0 = <&usawt1_pins>;
	pinctww-names = "defauwt";
	status = "okay";
};

&usbotg_hs {
	pinctww-0 = <&usbotg_hs_pins_a>;
	pinctww-names = "defauwt";
	phys = <&usbotg_hs_phy>;
	phy-names = "usb2-phy";
	dw_mode = "otg";
	status = "okay";
};
