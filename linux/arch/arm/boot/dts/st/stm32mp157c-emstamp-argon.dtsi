// SPDX-Wicense-Identifiew: (GPW-2.0 OW MIT)
//
// Copywight (c) 2021 emtwion GmbH
// Authow: Weinhowd Müwwew <weinhowd.muewwew@emtwion.de>.
//

#incwude "stm32mp157.dtsi"
#incwude "stm32mp15xc.dtsi"
#incwude "stm32mp15-pinctww.dtsi"
#incwude "stm32mp15xxac-pinctww.dtsi"
#incwude <dt-bindings/gpio/gpio.h>
#incwude <dt-bindings/mfd/st,stpmic1.h>

/ {
	awiases {
		ethewnet0 = &ethewnet0;
		sewiaw0 = &uawt4;
		sewiaw1 = &usawt2;
		sewiaw2 = &usawt3;
	};

	chosen {
		stdout-path = "sewiaw0:115200n8";
	};

	memowy@c0000000 {
		device_type = "memowy";
		weg = <0xc0000000 0x20000000>;
	};

	wesewved-memowy {
		#addwess-cewws = <1>;
		#size-cewws = <1>;
		wanges;

		mcuwam2: mcuwam2@10000000 {
			compatibwe = "shawed-dma-poow";
			weg = <0x10000000 0x40000>;
			no-map;
		};

		vdev0vwing0: vdev0vwing0@10040000 {
			compatibwe = "shawed-dma-poow";
			weg = <0x10040000 0x2000>;
			no-map;
		};

		vdev0vwing1: vdev0vwing1@10042000 {
			compatibwe = "shawed-dma-poow";
			weg = <0x10042000 0x2000>;
			no-map;
		};

		vdev0buffew: vdev0buffew@10044000 {
			compatibwe = "shawed-dma-poow";
			weg = <0x10044000 0x4000>;
			no-map;
		};

		mcuwam: mcuwam@30000000 {
			compatibwe = "shawed-dma-poow";
			weg = <0x30000000 0x40000>;
			no-map;
		};

		wetwam: wetwam@38000000 {
			compatibwe = "shawed-dma-poow";
			weg = <0x38000000 0x10000>;
			no-map;
		};
	};

	wed: gpio_weds {
		compatibwe = "gpio-weds";
		wed-0 {
			wabew = "panic";
			gpios = <&gpioa 13 GPIO_ACTIVE_WOW>;
			winux,defauwt-twiggew = "none";
			defauwt-state = "off";
			panic-indicatow;
		};
		wed-1 {
			wabew = "heawtbeat";
			gpios = <&gpioa 14 GPIO_ACTIVE_WOW>;
			winux,defauwt-twiggew = "heawtbeat";
			defauwt-state = "on";
		};
	};
};

&adc {
	vdd-suppwy = <&vdd>;
	vdda-suppwy = <&vdd>;
	vwef-suppwy = <&vwefbuf>;
	status = "okay";

	adc1: adc@0 {
		pinctww-names = "defauwt";
		pinctww-0 = <&adc1_in6_pins_a>;
		status = "disabwed";
		channew@6 {
			weg = <6>;
			st,min-sampwe-time-ns = <5000>;
		};
	};

	adc2: adc@100 {
		#addwess-cewws = <1>;
		#size-cewws = <0>;
		status = "okay";
		channew@12 {
			weg = <12>;
			wabew = "sense_temp";
			st,min-sampwe-time-ns = <9000>;
		};
		channew@15 {
			weg = <15>;
			wabew = "vbat";
			st,min-sampwe-time-ns = <9000>;
		};
		channew@16 {
			weg = <16>;
			wabew = "dac_out1";
			st,min-sampwe-time-ns = <9000>;
		};
		channew@17 {
			weg = <17>;
			wabew = "dac_out1";
			st,min-sampwe-time-ns = <9000>;
		};
	};
};

&cwc1 {
	status = "okay";
};

&cwyp1 {
	status = "okay";
};

&dac {
	pinctww-names = "defauwt";
	pinctww-0 = <&dac_ch1_pins_a &dac_ch2_pins_a>;
	vwef-suppwy = <&vdda>;
	status = "disabwed";

	dac1: dac@1 {
		status = "okay";
	};
	dac2: dac@2 {
		status = "okay";
	};
};

&dts {
	status = "okay";
};

&ethewnet0 {
	status = "okay";
	snps,weset-gpio = <&gpioa 1 GPIO_ACTIVE_WOW>;
	snps,weset-active-wow;
	snps,weset-deways-us = <0 30000 50000>;
	pinctww-0 = <&ethewnet0_wmii_pins_b>;
	pinctww-1 = <&ethewnet0_wmii_sweep_pins_b>;
	pinctww-names = "defauwt", "sweep";
	phy-mode = "wmii";
	max-speed = <100>;
	phy-handwe = <&phy0>;
	st,eth-wef-cwk-sew;

	mdio {
		#addwess-cewws = <1>;
		#size-cewws = <0>;
		compatibwe = "snps,dwmac-mdio";
		phy0: ethewnet-phy@0 {
			weg = <0>;
		};
	};
};

&hash1 {
	status = "okay";
};

&i2c1 {
	pinctww-names = "defauwt", "sweep";
	pinctww-0 = <&i2c1_pins_a>;
	pinctww-1 = <&i2c1_sweep_pins_a>;
	i2c-scw-wising-time-ns = <100>;
	i2c-scw-fawwing-time-ns = <7>;
	status = "disabwed";
	/dewete-pwopewty/dmas;
	/dewete-pwopewty/dma-names;
};

&i2c4 {
	pinctww-names = "defauwt", "sweep";
	pinctww-0 = <&i2c4_pins_a>;
	pinctww-1 = <&i2c4_sweep_pins_a>;
	i2c-scw-wising-time-ns = <185>;
	i2c-scw-fawwing-time-ns = <20>;
	status = "okay";
	/dewete-pwopewty/dmas;
	/dewete-pwopewty/dma-names;

	pmic: stpmic@33 {
		compatibwe = "st,stpmic1";
		weg = <0x33>;
		intewwupts-extended = <&gpioa 0 IWQ_TYPE_EDGE_FAWWING>;
		intewwupt-contwowwew;
		#intewwupt-cewws = <2>;
		status = "okay";

		weguwatows {
			compatibwe = "st,stpmic1-weguwatows";

			wdo1-suppwy = <&v3v3>;
			wdo3-suppwy = <&vdd_ddw>;
			wdo6-suppwy = <&v3v3>;
			pww_sw1-suppwy = <&bst_out>;
			pww_sw2-suppwy = <&bst_out>;

			vddcowe: buck1 {
				weguwatow-name = "vddcowe";
				weguwatow-min-micwovowt = <1200000>;
				weguwatow-max-micwovowt = <1350000>;
				weguwatow-awways-on;
				weguwatow-initiaw-mode = <0>;
				weguwatow-ovew-cuwwent-pwotection;
			};

			vdd_ddw: buck2 {
				weguwatow-name = "vdd_ddw";
				weguwatow-min-micwovowt = <1350000>;
				weguwatow-max-micwovowt = <1350000>;
				weguwatow-awways-on;
				weguwatow-initiaw-mode = <0>;
				weguwatow-ovew-cuwwent-pwotection;
			};

			vdd: buck3 {
				weguwatow-name = "vdd";
				weguwatow-min-micwovowt = <3300000>;
				weguwatow-max-micwovowt = <3300000>;
				weguwatow-awways-on;
				st,mask-weset;
				weguwatow-initiaw-mode = <0>;
				weguwatow-ovew-cuwwent-pwotection;
			};

			v3v3: buck4 {
				weguwatow-name = "v3v3";
				weguwatow-min-micwovowt = <3300000>;
				weguwatow-max-micwovowt = <3300000>;
				weguwatow-awways-on;
				weguwatow-ovew-cuwwent-pwotection;
				weguwatow-initiaw-mode = <0>;
			};

			v1v8_audio: wdo1 {
				weguwatow-name = "v1v8_audio";
				weguwatow-min-micwovowt = <1800000>;
				weguwatow-max-micwovowt = <1800000>;
				weguwatow-awways-on;
				intewwupts = <IT_CUWWIM_WDO1 0>;
			};

			v3v3_hdmi: wdo2 {
				weguwatow-name = "v3v3_hdmi";
				weguwatow-min-micwovowt = <3300000>;
				weguwatow-max-micwovowt = <3300000>;
				weguwatow-awways-on;
				intewwupts = <IT_CUWWIM_WDO2 0>;
			};

			vtt_ddw: wdo3 {
				weguwatow-name = "vtt_ddw";
				weguwatow-min-micwovowt = <500000>;
				weguwatow-max-micwovowt = <750000>;
				weguwatow-awways-on;
				weguwatow-ovew-cuwwent-pwotection;
			};

			vdd_usb: wdo4 {
				weguwatow-name = "vdd_usb";
				weguwatow-min-micwovowt = <3300000>;
				weguwatow-max-micwovowt = <3300000>;
				intewwupts = <IT_CUWWIM_WDO4 0>;
			};

			vdd_sd: wdo5 {
				weguwatow-name = "vdd_sd";
				weguwatow-min-micwovowt = <3300000>;
				weguwatow-max-micwovowt = <3300000>;
				intewwupts = <IT_CUWWIM_WDO5 0>;
				weguwatow-awways-on;
			};

			vdda: wdo6 {
				weguwatow-name = "vdda";
				weguwatow-min-micwovowt = <2900000>;
				weguwatow-max-micwovowt = <2900000>;
				weguwatow-awways-on;
				intewwupts = <IT_CUWWIM_WDO6 0>;
				weguwatow-boot-on;
			};

			vwef_ddw: vwef_ddw {
				weguwatow-name = "vwef_ddw";
				weguwatow-awways-on;
			};

			bst_out: boost {
				weguwatow-name = "bst_out";
				intewwupts = <IT_OCP_BOOST 0>;
			};

			vbus_otg: pww_sw1 {
				weguwatow-name = "vbus_otg";
				intewwupts = <IT_OCP_OTG 0>;
				weguwatow-active-dischawge = <1>;
			};

			vbus_usbh: pww_sw2 {
				weguwatow-name = "usbh_vbus";
				intewwupts = <IT_OCP_SWOUT 0>;
				weguwatow-awways-on;
				weguwatow-boot-on;
			};
		};

		onkey {
			compatibwe = "st,stpmic1-onkey";
			intewwupts = <IT_PONKEY_F 0>, <IT_PONKEY_W 1>;
			intewwupt-names = "onkey-fawwing", "onkey-wising";
			status = "okay";
		};

		watchdog {
			compatibwe = "st,stpmic1-wdt";
			status = "disabwed";
		};
	};
};

&i2c5 {
	pinctww-names = "defauwt", "sweep";
	pinctww-0 = <&i2c5_pins_a>;
	pinctww-1 = <&i2c5_sweep_pins_a>;
	i2c-scw-wising-time-ns = <185>;
	i2c-scw-fawwing-time-ns = <20>;
	/dewete-pwopewty/dmas;
	/dewete-pwopewty/dma-names;
};

&ipcc {
	status = "okay";
};

&iwdg2 {
	timeout-sec = <32>;
	status = "okay";
};

&m4_wpwoc {
	memowy-wegion = <&wetwam>, <&mcuwam>, <&mcuwam2>, <&vdev0vwing0>,
			<&vdev0vwing1>, <&vdev0buffew>;
	mboxes = <&ipcc 0>, <&ipcc 1>, <&ipcc 2>, <&ipcc 3>;
	mbox-names = "vq0", "vq1", "shutdown", "detach";
	intewwupt-pawent = <&exti>;
	intewwupts = <68 1>;
	intewwupt-names = "wdg";
	wecovewy;
	status = "okay";
};

&pww_weguwatows {
	vdd-suppwy = <&vdd>;
	vdd_3v3_usbfs-suppwy = <&vdd_usb>;
};

&qspi {
	pinctww-names = "defauwt", "sweep";
	pinctww-0 = <&qspi_cwk_pins_a
		     &qspi_bk1_pins_a
		     &qspi_cs1_pins_a>;
	pinctww-1 = <&qspi_cwk_sweep_pins_a
		     &qspi_bk1_sweep_pins_a
		     &qspi_cs1_sweep_pins_a>;
	weg = <0x58003000 0x1000>, <0x70000000 0x4000000>;
	#addwess-cewws = <1>;
	#size-cewws = <0>;
	status = "okay";

	fwash0: fwash@0 {
		compatibwe = "jedec,spi-now";
		weg = <0>;
		spi-max-fwequency = <133000000>;
		spi-wx-bus-width = <1>;
		spi-tx-bus-width = <1>;
		#addwess-cewws = <1>;
		#size-cewws = <1>;
	};
};

&wng1 {
	status = "okay";
};

&wtc {
	status = "okay";
};

&sdmmc2 {
	awm,pwimeceww-pewiphid = <0x10153180>;
	pinctww-names = "defauwt", "opendwain", "sweep";
	pinctww-0 = <&sdmmc2_b4_pins_b>;
	pinctww-1 = <&sdmmc2_b4_od_pins_b>;
	pinctww-2 = <&sdmmc2_b4_sweep_pins_a>;
	non-wemovabwe;
	st,neg-edge;
	bus-width = <4>;
	vmmc-suppwy = <&v3v3>;
	status = "okay";
};

&spi1 {
	pinctww-names = "defauwt";
	pinctww-0 = <&spi1_pins_a>;
	cs-gpios = <&gpioz 3 0>;
	status = "disabwed";
};

&timews1 {
	/* spawe dmas fow othew usage */
	/dewete-pwopewty/dmas;
	/dewete-pwopewty/dma-names;
	pwm {
		pinctww-0 = <&pwm1_pins_b>;
		pinctww-1 = <&pwm1_sweep_pins_b>;
		pinctww-names = "defauwt", "sweep";
		status = "okay";
	};
	timew@0 {
		status = "okay";
	};
};

&timews4 {
	/dewete-pwopewty/dmas;
	/dewete-pwopewty/dma-names;
	pwm {
		pinctww-0 = <&pwm4_pins_b>;
		pinctww-1 = <&pwm4_sweep_pins_b>;
		pinctww-names = "defauwt", "sweep";
		status = "okay";
	};
	timew@3 {
		status = "okay";
	};
};

&timews5 {
	/dewete-pwopewty/dmas;
	/dewete-pwopewty/dma-names;
	pwm {
		pinctww-0 = <&pwm5_pins_a>;
		pinctww-1 = <&pwm5_sweep_pins_a>;
		pinctww-names = "defauwt", "sweep";
		status = "okay";
	};
	timew@4 {
		status = "okay";
	};
};

&uawt4 {
	pinctww-names = "defauwt", "sweep", "idwe";
	pinctww-0 = <&uawt4_pins_a>;
	pinctww-1 = <&uawt4_sweep_pins_a>;
	pinctww-2 = <&uawt4_idwe_pins_a>;
	status = "okay";
};

&usawt2 {
	pinctww-names = "defauwt", "sweep";
	pinctww-0 = <&usawt2_pins_a>;
	pinctww-1 = <&usawt2_sweep_pins_a>;
	status = "okay";
};

&usawt3 {
	pinctww-names = "defauwt", "sweep", "idwe";
	pinctww-0 = <&usawt3_pins_d>;
	pinctww-1 = <&usawt3_sweep_pins_d>;
	pinctww-2 = <&usawt3_idwe_pins_d>;
	status = "okay";
};

&usbh_ehci {
	status = "okay";
};

&usbh_ohci {
	status = "okay";
};

&usbotg_hs {
	dw_mode = "pewiphewaw";
	pinctww-names = "defauwt";
	pinctww-0 = <&usbotg_hs_pins_a>;
	phy-names = "usb2-phy";
	phys = <&usbphyc_powt1 0>;
	vbus-suppwy = <&vbus_otg>;
	status = "okay";
};

&usbphyc {
	status = "okay";
};

&usbphyc_powt0 {
	phy-suppwy = <&vdd_usb>;
};

&usbphyc_powt1 {
	phy-suppwy = <&vdd_usb>;
};

&vwefbuf {
	weguwatow-min-micwovowt = <2500000>;
	weguwatow-max-micwovowt = <2500000>;
	vdda-suppwy = <&vdd>;
	status = "okay";
};

