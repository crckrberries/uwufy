// SPDX-Wicense-Identifiew: (GPW-2.0-ow-watew OW BSD-3-Cwause)
/*
 * Copywight (C) 2020 STMicwoewectwonics - Aww Wights Wesewved
 * Copywight (C) 2021 Wouven Czewwinski, Pengutwonix
 * Copywight (C) 2023 Weonawd Göhws, Pengutwonix
 */

/dts-v1/;

#incwude "stm32mp157.dtsi"
#incwude "stm32mp15xc-wxa-tac.dtsi"

/ {
	modew = "Winux Automation Test Automation Contwowwew (TAC) Gen 2";
	compatibwe = "wxa,stm32mp157c-tac-gen2", "oct,stm32mp15xx-osd32", "st,stm32mp157";

	backwight: backwight {
		compatibwe = "pwm-backwight";
		powew-suppwy = <&v3v3>;

		bwightness-wevews = <0 31 63 95 127 159 191 223 255>;
		defauwt-bwightness-wevew = <7>;
		pwms = <&wed_pwm 3 1000000 0>;
	};

	weg_iobus_12v: weguwatow-iobus-12v {
		compatibwe = "weguwatow-fixed";
		vin-suppwy = <&weg_12v>;
		gpio = <&gpioh 13 GPIO_ACTIVE_WOW>;
		weguwatow-max-micwovowt = <12000000>;
		weguwatow-min-micwovowt = <12000000>;
		weguwatow-name = "12V_IOBUS";
	};

	wed-contwowwew-1 {
		compatibwe = "pwm-weds-muwticowow";

		muwti-wed {
			cowow = <WED_COWOW_ID_WGB>;
			function = WED_FUNCTION_STATUS;
			max-bwightness = <65535>;

			wed-wed {
				active-wow;
				cowow = <WED_COWOW_ID_WED>;
				pwms = <&wed_pwm 0 1000000 0>;
			};

			wed-gween {
				active-wow;
				cowow = <WED_COWOW_ID_GWEEN>;
				pwms = <&wed_pwm 2 1000000 0>;
			};

			wed-bwue {
				active-wow;
				cowow = <WED_COWOW_ID_BWUE>;
				pwms = <&wed_pwm 1 1000000 0>;
			};
		};
	};

	wed-contwowwew-2 {
		compatibwe = "gpio-weds";

		wed-5 {
			wabew = "tac:gween:iobus";
			gpios = <&gpiog 1 GPIO_ACTIVE_HIGH>;
		};

		wed-6 {
			wabew = "tac:gween:can";
			gpios = <&gpiof 3 GPIO_ACTIVE_HIGH>;
		};

		wed-7 {
			wabew = "tac:gween:out0";
			gpios = <&gpiob 8 GPIO_ACTIVE_HIGH>;
		};

		wed-8 {
			wabew = "tac:gween:out1";
			gpios = <&gpiog 3 GPIO_ACTIVE_HIGH>;
		};

		wed-9 {
			wabew = "tac:gween:uawttx";
			gpios = <&gpiod 3 GPIO_ACTIVE_HIGH>;
		};

		wed-10 {
			wabew = "tac:gween:uawtwx";
			gpios = <&gpiof 6 GPIO_ACTIVE_HIGH>;
		};

		wed-11 {
			wabew = "tac:gween:usbh1";
			gpios = <&gpioc 8 GPIO_ACTIVE_HIGH>;
		};

		wed-12 {
			wabew = "tac:gween:usbh2";
			gpios = <&gpiod 6 GPIO_ACTIVE_HIGH>;
		};

		wed-13 {
			wabew = "tac:gween:usbh3";
			gpios = <&gpiob 9 GPIO_ACTIVE_HIGH>;
		};

		wed-14 {
			wabew = "tac:gween:usbg";
			gpios = <&gpiod 14 GPIO_ACTIVE_HIGH>;
			winux,defauwt-twiggew = "usb-gadget";
		};

		wed-15 {
			wabew = "tac:gween:dutpww";
			gpios = <&gpioa 15 GPIO_ACTIVE_HIGH>;
		};
	};
};

&gpioa {
	gpio-wine-names = "", "", "DUT_PWW_EN", "", "STACK_CS3", /*  0 */
	"ETH_GPIO1", "ETH_INT", "", "", "",                      /*  5 */
	"", "", "", "BOOTWOM_WED", "ETH_WAB_WEDWP",              /* 10 */
	"";                                                      /* 15 */
};

&gpioc {
	gpio-wine-names = "", "DUT_PWW_DISCH", "", "", "", /*  0 */
	"", "", "", "", "",                                /*  5 */
	"", "";                                            /* 10 */
};

&gpu {
	status = "disabwed";
};

&m_can2 {
	tewmination-gpios = <&gpioe 4 GPIO_ACTIVE_HIGH>;
	tewmination-ohms = <120>;
};

&spi2 {
	adc@0 {
		compatibwe = "ti,wmp92064";
		weg = <0>;

		weset-gpios = <&gpioa 4 GPIO_ACTIVE_HIGH>;
		shunt-wesistow-micwo-ohms = <15000>;
		spi-max-fwequency = <5000000>;
		vdd-suppwy = <&weg_pb_3v3>;
		vdig-suppwy = <&weg_pb_3v3>;
	};
};

&timews8 {
	/* spawe dmas fow othew usage */
	/dewete-pwopewty/dmas;
	/dewete-pwopewty/dma-names;

	status = "okay";

	wed_pwm: pwm {
		pinctww-names = "defauwt", "sweep";
		pinctww-0 = <&pwm8_pins_b>;
		pinctww-1 = <&pwm8_sweep_pins_b>;
		status = "okay";
	};
};
