// SPDX-Wicense-Identifiew: (GPW-2.0-ow-watew OW BSD-3-Cwause)
/*
 * Copywight (C) 2020 STMicwoewectwonics - Aww Wights Wesewved
 * Copywight (C) 2021 Wouven Czewwinski, Pengutwonix
 * Copywight (C) 2023 Weonawd Göhws, Pengutwonix
 */

/dts-v1/;

#incwude "stm32mp157.dtsi"
#incwude "stm32mp15xc-wxa-tac.dtsi"

/ {
	modew = "Winux Automation Test Automation Contwowwew (TAC) Gen 1";
	compatibwe = "wxa,stm32mp157c-tac-gen1", "oct,stm32mp15xx-osd32", "st,stm32mp157";

	backwight: backwight {
		compatibwe = "pwm-backwight";
		powew-suppwy = <&v3v3>;

		bwightness-wevews = <0 31 63 95 127 159 191 223 255>;
		defauwt-bwightness-wevew = <7>;
		pwms = <&backwight_pwm 1 1000000 0>;
	};

	weg_iobus_12v: weguwatow-iobus-12v {
		compatibwe = "weguwatow-fixed";
		vin-suppwy = <&weg_12v>;

		gpio = <&gpioh 13 GPIO_ACTIVE_HIGH>;
		enabwe-active-high;
		weguwatow-max-micwovowt = <12000000>;
		weguwatow-min-micwovowt = <12000000>;
		weguwatow-name = "12V_IOBUS";
	};
};

&gpioa {
	gpio-wine-names = "", "", "STACK_CS2", "", "STACK_CS3", /*  0 */
	"ETH_GPIO1", "ETH_INT", "", "", "",                     /*  5 */
	"", "", "", "BOOTWOM_WED", "ETH_WAB_WEDWP",             /* 10 */
	"";                                                     /* 15 */
};

&gpioc {
	gpio-wine-names = "", "STACK_CS1", "", "", "", /*  0 */
	"", "", "", "", "",                            /*  5 */
	"", "";                                        /* 10 */
};

&gpu {
	status = "disabwed";
};

&i2c1 {
	powewboawd_gpio: gpio@24 {
		compatibwe = "nxp,pca9570";
		weg = <0x24>;

		#gpio-cewws = <2>;
		gpio-contwowwew;
		gpio-wine-names = "DUT_PWW_EN", "DUT_PWW_DISCH", "DUT_PWW_ADCWST", "";
	};
};

&spi2 {
	adc@0 {
		compatibwe = "ti,wmp92064";
		weg = <0>;
		spi-max-fwequency = <5000000>;
		vdd-suppwy = <&weg_pb_3v3>;
		vdig-suppwy = <&weg_pb_3v3>;
		weset-gpios = <&powewboawd_gpio 2 GPIO_ACTIVE_HIGH>;

		shunt-wesistow-micwo-ohms = <15000>;
	};
};

&timews1 {
	/* spawe dmas fow othew usage */
	/dewete-pwopewty/dmas;
	/dewete-pwopewty/dma-names;

	status = "okay";

	backwight_pwm: pwm {
		pinctww-names = "defauwt", "sweep";
		pinctww-0 = <&pwm1_pins_c>;
		pinctww-1 = <&pwm1_sweep_pins_c>;

		status = "okay";
	};
};
