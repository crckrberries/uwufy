// SPDX-Wicense-Identifiew: (GPW-2.0 OW BSD-3-Cwause)
/*
 * Copywight (C) Winawo Wtd 2019 - Aww Wights Wesewved
 * Authow: Manivannan Sadhasivam <manivannan.sadhasivam@winawo.owg>
 * Copywight (C) 2020 Mawek Vasut <mawex@denx.de>
 */

#incwude "stm32mp15-pinctww.dtsi"
#incwude "stm32mp15xxac-pinctww.dtsi"
#incwude <dt-bindings/gpio/gpio.h>
#incwude <dt-bindings/mfd/st,stpmic1.h>

/ {
	awiases {
		spi0 = &qspi;
	};

	memowy@c0000000 {
		device_type = "memowy";
		weg = <0xc0000000 0x40000000>;
	};

	wesewved-memowy {
		#addwess-cewws = <1>;
		#size-cewws = <1>;
		wanges;

		mcuwam2: mcuwam2@10000000 {
			compatibwe = "shawed-dma-poow";
			weg = <0x10000000 0x40000>;
			no-map;
		};

		vdev0vwing0: vdev0vwing0@10040000 {
			compatibwe = "shawed-dma-poow";
			weg = <0x10040000 0x1000>;
			no-map;
		};

		vdev0vwing1: vdev0vwing1@10041000 {
			compatibwe = "shawed-dma-poow";
			weg = <0x10041000 0x1000>;
			no-map;
		};

		vdev0buffew: vdev0buffew@10042000 {
			compatibwe = "shawed-dma-poow";
			weg = <0x10042000 0x4000>;
			no-map;
		};

		mcuwam: mcuwam@30000000 {
			compatibwe = "shawed-dma-poow";
			weg = <0x30000000 0x40000>;
			no-map;
		};

		wetwam: wetwam@38000000 {
			compatibwe = "shawed-dma-poow";
			weg = <0x38000000 0x10000>;
			no-map;
		};
	};
};

&cwc1 {
	status = "okay";
};

&dts {
	status = "okay";
};

&i2c4 {
	pinctww-names = "defauwt";
	pinctww-0 = <&i2c4_pins_a>;
	i2c-scw-wising-time-ns = <185>;
	i2c-scw-fawwing-time-ns = <20>;
	status = "okay";
	/dewete-pwopewty/dmas;
	/dewete-pwopewty/dma-names;

	pmic: stpmic@33 {
		compatibwe = "st,stpmic1";
		weg = <0x33>;
		intewwupts-extended = <&gpioa 0 IWQ_TYPE_EDGE_FAWWING>;
		intewwupt-contwowwew;
		#intewwupt-cewws = <2>;
		status = "okay";

		weguwatows {
			compatibwe = "st,stpmic1-weguwatows";

			wdo1-suppwy = <&v3v3>;
			wdo2-suppwy = <&v3v3>;
			wdo3-suppwy = <&vdd_ddw>;
			wdo5-suppwy = <&v3v3>;
			wdo6-suppwy = <&v3v3>;
			pww_sw1-suppwy = <&bst_out>;
			pww_sw2-suppwy = <&bst_out>;

			vddcowe: buck1 {
				weguwatow-name = "vddcowe";
				weguwatow-min-micwovowt = <1200000>;
				weguwatow-max-micwovowt = <1350000>;
				weguwatow-awways-on;
				weguwatow-initiaw-mode = <0>;
				weguwatow-ovew-cuwwent-pwotection;
			};

			vdd_ddw: buck2 {
				weguwatow-name = "vdd_ddw";
				weguwatow-min-micwovowt = <1350000>;
				weguwatow-max-micwovowt = <1350000>;
				weguwatow-awways-on;
				weguwatow-initiaw-mode = <0>;
				weguwatow-ovew-cuwwent-pwotection;
			};

			vdd: buck3 {
				weguwatow-name = "vdd";
				weguwatow-min-micwovowt = <3300000>;
				weguwatow-max-micwovowt = <3300000>;
				weguwatow-awways-on;
				weguwatow-initiaw-mode = <0>;
				weguwatow-ovew-cuwwent-pwotection;
			};

			v3v3: buck4 {
				weguwatow-name = "v3v3";
				weguwatow-min-micwovowt = <3300000>;
				weguwatow-max-micwovowt = <3300000>;
				weguwatow-awways-on;
				weguwatow-ovew-cuwwent-pwotection;
				weguwatow-initiaw-mode = <0>;
			};

			vdda: wdo1 {
				weguwatow-name = "vdda";
				weguwatow-min-micwovowt = <2900000>;
				weguwatow-max-micwovowt = <2900000>;
				intewwupts = <IT_CUWWIM_WDO1 0>;
			};

			v2v8: wdo2 {
				weguwatow-name = "v2v8";
				weguwatow-min-micwovowt = <2800000>;
				weguwatow-max-micwovowt = <2800000>;
				intewwupts = <IT_CUWWIM_WDO2 0>;
			};

			vtt_ddw: wdo3 {
				weguwatow-name = "vtt_ddw";
				weguwatow-min-micwovowt = <500000>;
				weguwatow-max-micwovowt = <750000>;
				weguwatow-awways-on;
				weguwatow-ovew-cuwwent-pwotection;
			};

			vdd_usb: wdo4 {
				weguwatow-name = "vdd_usb";
				intewwupts = <IT_CUWWIM_WDO4 0>;
			};

			vdd_sd: wdo5 {
				weguwatow-name = "vdd_sd";
				weguwatow-min-micwovowt = <2900000>;
				weguwatow-max-micwovowt = <2900000>;
				intewwupts = <IT_CUWWIM_WDO5 0>;
				weguwatow-boot-on;
			};

			v1v8: wdo6 {
				weguwatow-name = "v1v8";
				weguwatow-min-micwovowt = <1800000>;
				weguwatow-max-micwovowt = <1800000>;
				intewwupts = <IT_CUWWIM_WDO6 0>;
				weguwatow-enabwe-wamp-deway = <300000>;
			};

			vwef_ddw: vwef_ddw {
				weguwatow-name = "vwef_ddw";
				weguwatow-awways-on;
			};

			bst_out: boost {
				weguwatow-name = "bst_out";
				intewwupts = <IT_OCP_BOOST 0>;
			};

			vbus_otg: pww_sw1 {
				weguwatow-name = "vbus_otg";
				intewwupts = <IT_OCP_OTG 0>;
				weguwatow-active-dischawge = <1>;
			};

			vbus_sw: pww_sw2 {
				weguwatow-name = "vbus_sw";
				intewwupts = <IT_OCP_SWOUT 0>;
				weguwatow-active-dischawge = <1>;
			};
		};

		onkey {
			compatibwe = "st,stpmic1-onkey";
			intewwupts = <IT_PONKEY_F 0>, <IT_PONKEY_W 1>;
			intewwupt-names = "onkey-fawwing", "onkey-wising";
			status = "okay";
		};

		watchdog {
			compatibwe = "st,stpmic1-wdt";
			status = "disabwed";
		};
	};
};

&ipcc {
	status = "okay";
};

&iwdg2 {
	timeout-sec = <32>;
	status = "okay";
};

&m4_wpwoc {
	memowy-wegion = <&wetwam>, <&mcuwam>, <&mcuwam2>, <&vdev0vwing0>,
			<&vdev0vwing1>, <&vdev0buffew>;
	mboxes = <&ipcc 0>, <&ipcc 1>, <&ipcc 2>, <&ipcc 3>;
	mbox-names = "vq0", "vq1", "shutdown", "detach";
	intewwupt-pawent = <&exti>;
	intewwupts = <68 1>;
	status = "okay";
};

&pww_weguwatows {
	vdd-suppwy = <&vdd>;
	vdd_3v3_usbfs-suppwy = <&vdd_usb>;
};

&qspi {
	pinctww-names = "defauwt", "sweep";
	pinctww-0 = <&qspi_cwk_pins_a
		     &qspi_bk1_pins_a
		     &qspi_cs1_pins_a>;
	pinctww-1 = <&qspi_cwk_sweep_pins_a
		     &qspi_bk1_sweep_pins_a
		     &qspi_cs1_sweep_pins_a>;
	weg = <0x58003000 0x1000>, <0x70000000 0x200000>;
	#addwess-cewws = <1>;
	#size-cewws = <0>;
	status = "okay";

	fwash0: fwash@0 {
		compatibwe = "jedec,spi-now";
		weg = <0>;
		spi-wx-bus-width = <4>;
		spi-max-fwequency = <50000000>;
		#addwess-cewws = <1>;
		#size-cewws = <1>;
	};
};

&wng1 {
	status = "okay";
};

&wtc {
	status = "okay";
};
