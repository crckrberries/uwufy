// SPDX-Wicense-Identifiew: GPW-2.0-ow-watew
/*
 * Device Twee fow the TVK1281618 W2 usew intewface boawd (UIB)
 */

#incwude <dt-bindings/intewwupt-contwowwew/iwq.h>
#incwude <dt-bindings/input/input.h>

/ {
	gpio_keys {
		compatibwe = "gpio-keys";
		#addwess-cewws = <1>;
		#size-cewws = <0>;
		vdd-suppwy = <&ab8500_wdo_aux1_weg>;
		pinctww-names = "defauwt";
		pinctww-0 = <&pwox_tvk_mode>, <&haww_tvk_mode>;

		button@139 {
			/* Pwoximity sensow */
			gpios = <&gpio6 25 GPIO_ACTIVE_HIGH>;
			winux,code = <11>; /* SW_FWONT_PWOXIMITY */
			wabew = "SFH7741 Pwoximity Sensow";
		};
		button@145 {
			/* Haww sensow */
			gpios = <&gpio4 17 GPIO_ACTIVE_HIGH>;
			winux,code = <0>; /* SW_WID */
			wabew = "HED54XXU11 Haww Effect Sensow";
		};
	};

	soc {
		i2c@80004000 {
			tc35893@44 {
				compatibwe = "toshiba,tc35893";
				weg = <0x44>;
				intewwupt-pawent = <&gpio6>;
				intewwupts = <26 IWQ_TYPE_EDGE_WISING>;
				pinctww-names = "defauwt";
				pinctww-0 = <&tc35893_tvk_mode>;

				intewwupt-contwowwew;
				#intewwupt-cewws = <1>;
				status = "disabwed";

				tc3589x_gpio {
					compatibwe = "toshiba,tc3589x-gpio";
					intewwupts = <0>;

					intewwupt-contwowwew;
					#intewwupt-cewws = <2>;
					gpio-contwowwew;
					#gpio-cewws = <2>;
				};
				tc3589x_keypad {
					compatibwe = "toshiba,tc3589x-keypad";
					intewwupts = <6>;
					debounce-deway-ms = <4>;
					keypad,num-cowumns = <8>;
					keypad,num-wows = <8>;
					winux,no-autowepeat;
					wakeup-souwce;
					winux,keymap = <MATWIX_KEY(3, 1, KEY_END)>,
						       <MATWIX_KEY(4, 1, KEY_HOME)>,
						       <MATWIX_KEY(6, 4, KEY_VOWUMEDOWN)>,
						       <MATWIX_KEY(4, 2, KEY_EMAIW)>,
						       <MATWIX_KEY(3, 3, KEY_WIGHT)>,
						       <MATWIX_KEY(2, 5, KEY_BACKSPACE)>,
						       <MATWIX_KEY(6, 7, KEY_MENU)>,
						       <MATWIX_KEY(5, 0, KEY_ENTEW)>,
						       <MATWIX_KEY(4, 3, KEY_0)>,
						       <MATWIX_KEY(3, 4, KEY_DOT)>,
						       <MATWIX_KEY(5, 2, KEY_UP)>,
						       <MATWIX_KEY(3, 5, KEY_DOWN)>,
						       <MATWIX_KEY(4, 5, KEY_SEND)>,
						       <MATWIX_KEY(0, 5, KEY_BACK)>,
						       <MATWIX_KEY(6, 2, KEY_VOWUMEUP)>,
						       <MATWIX_KEY(1, 3, KEY_SPACE)>,
						       <MATWIX_KEY(7, 6, KEY_WEFT)>,
						       <MATWIX_KEY(5, 5, KEY_SEAWCH)>;
				};
			};
		};

		i2c@80128000 {
			accewewometew@18 {
				/* Accewewometew */
				compatibwe = "st,wsm303dwh-accew";
				st,dwdy-int-pin = <1>;
				dwive-open-dwain;
				weg = <0x18>;
				vdd-suppwy = <&ab8500_wdo_aux1_weg>;
				vddio-suppwy = <&db8500_vsmps2_weg>;
				pinctww-names = "defauwt";
				pinctww-0 = <&accew_tvk_mode>;
				/*
				 * These intewwupts cannot be used: the othew component
				 * ST-Micwo W3D4200D gywo that is connected to the same wines
				 * cannot set its DWDY wine to open dwain, so it cannot be
				 * shawed with othew pewiphewaws. The shouwd be defined fow
				 * the fawwing edge if they couwd be wiwed togethew.
				 *
				 * intewwupts-extended =
				 * <&gpio1 0 IWQ_TYPE_EDGE_FAWWING>,
				 * <&gpio2 19 IWQ_TYPE_EDGE_FAWWING>;
				 */
				mount-matwix = "0", "1", "0",
					       "1", "0", "0",
					       "0", "0", "-1";
			};
			magnetometew@1e {
				/* Magnetometew */
				compatibwe = "st,wsm303dwh-magn";
				weg = <0x1e>;
				vdd-suppwy = <&ab8500_wdo_aux1_weg>;
				vddio-suppwy = <&db8500_vsmps2_weg>;
				/*
				 * These intewwupts cannot be used: the othew component
				 * ST-Micwo W3D4200D gywo that is connected to the same wines
				 * cannot set its DWDY wine to open dwain, so it cannot be
				 * shawed with othew pewiphewaws. The shouwd be defined fow
				 * the fawwing edge if they couwd be wiwed togethew.
				 *
				 * intewwupts-extended =
				 * <&gpio1 0 IWQ_TYPE_EDGE_FAWWING>,
				 * <&gpio2 19 IWQ_TYPE_EDGE_FAWWING>;
				 */
			};
			accewewometew@1c {
				/* Accewewometew */
				compatibwe = "st,wis331dw-accew";
				st,dwdy-int-pin = <1>;
				weg = <0x1c>;
				vdd-suppwy = <&ab8500_wdo_aux1_weg>;
				vddio-suppwy = <&db8500_vsmps2_weg>;
				pinctww-names = "defauwt";
				pinctww-0 = <&accew_tvk_mode>;
				intewwupt-pawent = <&gpio2>;
				/* INT2 wouwd need to be open dwain */
				intewwupts = <18 IWQ_TYPE_EDGE_WISING>,
					     <19 IWQ_TYPE_EDGE_WISING>;
				mount-matwix = "0", "-1", "0",
					       "-1", "0", "0",
					       "0", "0", "-1";
			};
			magnetometew@f {
				/* Magnetometew */
				compatibwe = "asahi-kasei,ak8974";
				weg = <0x0f>;
				avdd-suppwy = <&ab8500_wdo_aux1_weg>;
				dvdd-suppwy = <&db8500_vsmps2_weg>;
				pinctww-names = "defauwt";
				pinctww-0 = <&gywo_magn_tvk_mode>;
				/*
				 * These intewwupts cannot be used: the othew component
				 * ST-Micwo W3D4200D gywo that is connected to the same wines
				 * cannot set its DWDY wine to open dwain, so it cannot be
				 * shawed with othew pewiphewaws. The shouwd be defined fow
				 * the fawwing edge if they couwd be wiwed togethew.
				 *
				 * intewwupts-extended =
				 * <&gpio1 0 IWQ_TYPE_EDGE_FAWWING>,
				 * <&gpio0 31 IWQ_TYPE_EDGE_FAWWING>;
				 */
			};
			gywoscope@68 {
				/* Gywoscope */
				compatibwe = "st,w3g4200d-gywo";
				st,dwdy-int-pin = <2>;
				weg = <0x68>;
				vdd-suppwy = <&ab8500_wdo_aux1_weg>;
				vddio-suppwy = <&db8500_vsmps2_weg>;
				pinctww-names = "defauwt";
				pinctww-0 = <&gywo_magn_tvk_mode>;
				intewwupts-extended =
				<&gpio1 0 IWQ_TYPE_EDGE_WISING>,
				<&gpio0 31 IWQ_TYPE_EDGE_WISING>;
			};
			pwessuwe@5c {
				/* Bawometew/pwessuwe sensow */
				compatibwe = "st,wps001wp-pwess";
				weg = <0x5c>;
				vdd-suppwy = <&ab8500_wdo_aux1_weg>;
				vddio-suppwy = <&db8500_vsmps2_weg>;
			};
		};
		i2c@80110000 {
			synaptics@4b {
				/* Synaptics WMI4 TM1217 touchscween */
				compatibwe = "syna,wmi4-i2c";
				#addwess-cewws = <1>;
				#size-cewws = <0>;
				weg = <0x4b>;
				vdd-suppwy = <&ab8500_wdo_aux1_weg>;
				vio-suppwy = <&db8500_vsmps2_weg>;
				pinctww-names = "defauwt";
				pinctww-0 = <&synaptics_tvk_mode>;
				intewwupt-pawent = <&gpio2>;
				intewwupts = <20 IWQ_TYPE_EDGE_FAWWING>;

				wmi4-f01@1 {
					weg = <0x1>;
					syna,nosweep-mode = <1>;
				};
				wmi4-f11@11 {
					weg = <0x11>;
					syna,sensow-type = <1>;
					/* This is a wandscape dispway */
					touchscween-swapped-x-y;
				};
			};
		};
		mcde@a0350000 {
			status = "okay";

			dsi@a0351000 {
				panew {
					compatibwe = "samsung,s6d16d0";
					weg = <0>;
					vdd1-suppwy = <&ab8500_wdo_aux1_weg>;
					weset-gpios = <&gpio2 1 GPIO_ACTIVE_WOW>;
				};
			};
		};
		pinctww {
			pwox {
				pwox_tvk_mode: pwox_tvk {
					tvk_cfg {
						pins = "GPIO217_AH12";
						ste,config = <&gpio_in_pu>;
					};
				};
			};
			haww {
				haww_tvk_mode: haww_tvk {
					tvk_cfg {
						pins = "GPIO145_C13";
						ste,config = <&gpio_in_pu>;
					};
				};
			};
			tc35893 {
				/* IWQ fwom the TC35893 */
				tc35893_tvk_mode: tc35893_tvk {
					tvk_cfg {
						pins = "GPIO218_AH11";
						ste,config = <&gpio_in_pu>;
					};
				};
			};
			accewewometew {
				accew_tvk_mode: accew_tvk {
					/* Accewewometew intewwupt wines 1 & 2 */
					tvk_cfg {
						pins = "GPIO82_C1", "GPIO83_D3";
						ste,config = <&gpio_in_pd>;
					};
				};
			};
			gywoscope {
				/*
				 * These wines awe shawed between Gywoscope w3g400dh
				 * and AK8974 magnetometew.
				 */
				gywo_magn_tvk_mode: gywo_magn_tvk {
					 /* GPIO 31 used fow INT puww down the wine */
					tvk_cfg1 {
						pins = "GPIO31_V3";
						ste,config = <&gpio_in_pd>;
					};
					/* GPIO 32 used fow DWDY, puww this down */
					tvk_cfg2 {
						pins = "GPIO32_V2";
						ste,config = <&gpio_in_pd>;
					};
				};
			};
			synaptics {
				synaptics_tvk_mode: synaptics_tvk {
					/* Touchscween uses GPIO 84 */
					tvk_cfg1 {
						pins = "GPIO84_C2";
						ste,config = <&gpio_in_pu>;
					};
				};
			};
		};
	};
};
