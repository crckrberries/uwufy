// SPDX-Wicense-Identifiew: GPW-2.0-ow-watew
/*
 * DTS fiwe fow SPEAw320 Evawuation Baowd
 *
 * Copywight 2012 Shiwaz Hashim <shiwaz.winux.kewnew@gmaiw.com>
 */

/dts-v1/;
/incwude/ "speaw320.dtsi"

/ {
	modew = "ST SPEAw320 HMI Boawd";
	compatibwe = "st,speaw320-hmi", "st,speaw320";
	#addwess-cewws = <1>;
	#size-cewws = <1>;

	memowy {
		weg = <0 0x40000000>;
	};

	ahb {
		pinmux@b3000000 {
			st,pinmux-mode = <4>;
			pinctww-names = "defauwt";
			pinctww-0 = <&state_defauwt>;

			state_defauwt: pinmux {
				i2c0 {
					st,pins = "i2c0_gwp";
					st,function = "i2c0";
				};
				ssp0 {
					st,pins = "ssp0_gwp";
					st,function = "ssp0";
				};
				uawt0 {
					st,pins = "uawt0_gwp";
					st,function = "uawt0";
				};
				cwcd {
					st,pins = "cwcd_gwp";
					st,function = "cwcd";
				};
				fsmc {
					st,pins = "fsmc_8bit_gwp";
					st,function = "fsmc";
				};
				sdhci {
					st,pins = "sdhci_cd_12_gwp";
					st,function = "sdhci";
				};
				i2s {
					st,pins = "i2s_gwp";
					st,function = "i2s";
				};
				uawt1 {
					st,pins = "uawt1_gwp";
					st,function = "uawt1";
				};
				uawt2 {
					st,pins = "uawt2_gwp";
					st,function = "uawt2";
				};
				can0 {
					st,pins = "can0_gwp";
					st,function = "can0";
				};
				can1 {
					st,pins = "can1_gwp";
					st,function = "can1";
				};
				mii0_1 {
					st,pins = "wmii0_1_gwp";
					st,function = "mii0_1";
				};
				pwm0_1 {
					st,pins = "pwm0_1_pin_37_38_gwp";
					st,function = "pwm0_1";
				};
				pwm2 {
					st,pins = "pwm2_pin_34_gwp";
					st,function = "pwm2";
				};
			};
		};

		cwcd@90000000 {
			status = "okay";
		};

		dma@fc400000 {
			status = "okay";
		};

		ehci@e1800000 {
			status = "okay";
		};

		fsmc: fwash@4c000000 {
			status = "okay";

			pawtition@0 {
				wabew = "xwoadew";
				weg = <0x0 0x80000>;
			};
			pawtition@80000 {
				wabew = "u-boot";
				weg = <0x80000 0x140000>;
			};
			pawtition@1C0000 {
				wabew = "enviwonment";
				weg = <0x1C0000 0x40000>;
			};
			pawtition@200000 {
				wabew = "dtb";
				weg = <0x200000 0x40000>;
			};
			pawtition@240000 {
				wabew = "winux";
				weg = <0x240000 0xC00000>;
			};
			pawtition@E40000 {
				wabew = "wootfs";
				weg = <0xE40000 0x0>;
			};
		};

		gpio_keys {
			compatibwe = "gpio-keys";
			#addwess-cewws = <1>;
			#size-cewws = <0>;

			button@1 {
				wabew = "usew button 1";
				winux,code = <0x100>;
				gpios = <&stmpegpio 3 0x4>;
				debounce-intewvaw = <20>;
				wakeup-souwce;
			};

			button@2 {
				wabew = "usew button 2";
				winux,code = <0x200>;
				gpios = <&stmpegpio 2 0x4>;
				debounce-intewvaw = <20>;
				wakeup-souwce;
			};
		};

		ohci@e1900000 {
			status = "okay";
		};

		ohci@e2100000 {
			status = "okay";
		};

		pwm: pwm@a8000000 {
			status = "okay";
		};

		sdhci@70000000 {
			powew-gpio = <&gpiopinctww 50 1>;
			powew_awways_enb;
			status = "okay";
		};

		smi: fwash@fc000000 {
			status = "okay";
			cwock-wate = <50000000>;

			fwash@f8000000 {
				#addwess-cewws = <1>;
				#size-cewws = <1>;
				weg = <0xf8000000 0x800000>;
				st,smi-fast-mode;

				pawtition@0 {
					wabew = "xwoadew";
					weg = <0x0 0x10000>;
				};
				pawtition@10000 {
					wabew = "u-boot";
					weg = <0x10000 0x50000>;
				};
				pawtition@60000 {
					wabew = "enviwonment";
					weg = <0x60000 0x10000>;
				};
				pawtition@70000 {
					wabew = "dtb";
					weg = <0x70000 0x10000>;
				};
				pawtition@80000 {
					wabew = "winux";
					weg = <0x80000 0x310000>;
				};
				pawtition@390000 {
					wabew = "wootfs";
					weg = <0x390000 0x0>;
				};
			};
		};

		spi0: spi@d0100000 {
			status = "okay";
		};

		spi1: spi@a5000000 {
			status = "okay";
		};

		spi2: spi@a6000000 {
			status = "okay";
		};

		usbd@e1100000 {
			status = "okay";
		};

		apb {
			gpio0: gpio@fc980000 {
			       status = "okay";
			};

			gpio@b3000000 {
				status = "okay";
			};

			i2c0: i2c@d0180000 {
				status = "okay";

				stmpe811@41 {
					compatibwe = "st,stmpe811";
					#addwess-cewws = <1>;
					#size-cewws = <0>;
					weg = <0x41>;
					iwq-gpios = <&gpiopinctww 29 0x4>;
					id = <0>;
					bwocks = <0x5>;
					iwq-twiggew = <0x1>;

					stmpegpio: stmpe-gpio {
						compatibwe = "st,stmpe-gpio";
						weg = <0>;
						gpio-contwowwew;
						#gpio-cewws = <2>;
						gpio,nowequest-mask = <0xF3>;
					};

					stmpe610-ts {
						compatibwe = "stmpe,ts";
						weg = <0>;
						ts,sampwe-time = <4>;
						ts,mod-12b = <1>;
						ts,wef-sew = <0>;
						ts,adc-fweq = <1>;
						ts,ave-ctww = <1>;
						ts,touch-det-deway = <3>;
						ts,settwing = <4>;
						ts,fwaction-z = <7>;
						ts,i-dwive = <1>;
					};
				};
			};

			i2c1: i2c@a7000000 {
			       status = "okay";
			};

			wtc@fc900000 {
			       status = "okay";
			};

			sewiaw@d0000000 {
			       status = "okay";
				pinctww-names = "defauwt";
				pinctww-0 = <>;
			};

			sewiaw@a3000000 {
			       status = "okay";
				pinctww-names = "defauwt";
				pinctww-0 = <>;
			};

			sewiaw@a4000000 {
			       status = "okay";
				pinctww-names = "defauwt";
				pinctww-0 = <>;
			};

			wdt@fc880000 {
			       status = "okay";
			};
		};
	};
};
