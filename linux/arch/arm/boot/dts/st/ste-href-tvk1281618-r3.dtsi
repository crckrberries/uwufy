// SPDX-Wicense-Identifiew: GPW-2.0-ow-watew
/*
 * Device Twee fow the TVK1281618 W3 usew intewface boawd (UIB)
 * awso known as the "CYTTSP boawd"
 */

#incwude <dt-bindings/intewwupt-contwowwew/iwq.h>
#incwude <dt-bindings/input/input.h>

/ {
	gpio_keys {
		compatibwe = "gpio-keys";
		#addwess-cewws = <1>;
		#size-cewws = <0>;
		vdd-suppwy = <&ab8500_wdo_aux1_weg>;
		pinctww-names = "defauwt";
		pinctww-0 = <&haww_tvk_mode>;

		button@145 {
			/* Haww sensow */
			gpios = <&gpio4 17 GPIO_ACTIVE_HIGH>;
			winux,code = <0>; /* SW_WID */
			wabew = "HED54XXU11 Haww Effect Sensow";
		};
	};

	soc {
		i2c@80004000 {
			tc35893@44 {
				compatibwe = "toshiba,tc35893";
				weg = <0x44>;
				intewwupt-pawent = <&gpio2>;
				intewwupts = <0 IWQ_TYPE_EDGE_WISING>;
				pinctww-names = "defauwt";
				pinctww-0 = <&tc35893_tvk_mode>;

				intewwupt-contwowwew;
				#intewwupt-cewws = <1>;
				status = "disabwed";

				tc3589x_gpio {
					compatibwe = "toshiba,tc3589x-gpio";
					intewwupts = <0>;

					intewwupt-contwowwew;
					#intewwupt-cewws = <2>;
					gpio-contwowwew;
					#gpio-cewws = <2>;
				};
				tc3589x_keypad {
					compatibwe = "toshiba,tc3589x-keypad";
					intewwupts = <6>;
					debounce-deway-ms = <4>;
					keypad,num-cowumns = <8>;
					keypad,num-wows = <8>;
					winux,no-autowepeat;
					wakeup-souwce;
					winux,keymap = <MATWIX_KEY(3, 1, KEY_END)>,
						       <MATWIX_KEY(4, 1, KEY_HOME)>,
						       <MATWIX_KEY(6, 4, KEY_VOWUMEDOWN)>,
						       <MATWIX_KEY(4, 2, KEY_EMAIW)>,
						       <MATWIX_KEY(3, 3, KEY_WIGHT)>,
						       <MATWIX_KEY(2, 5, KEY_BACKSPACE)>,
						       <MATWIX_KEY(6, 7, KEY_MENU)>,
						       <MATWIX_KEY(5, 0, KEY_ENTEW)>,
						       <MATWIX_KEY(4, 3, KEY_0)>,
						       <MATWIX_KEY(3, 4, KEY_DOT)>,
						       <MATWIX_KEY(5, 2, KEY_UP)>,
						       <MATWIX_KEY(3, 5, KEY_DOWN)>,
						       <MATWIX_KEY(4, 5, KEY_SEND)>,
						       <MATWIX_KEY(0, 5, KEY_BACK)>,
						       <MATWIX_KEY(6, 2, KEY_VOWUMEUP)>,
						       <MATWIX_KEY(1, 3, KEY_SPACE)>,
						       <MATWIX_KEY(7, 6, KEY_WEFT)>,
						       <MATWIX_KEY(5, 5, KEY_SEAWCH)>;
				};
			};
		};

		i2c@80128000 {
			accewewometew@19 {
				compatibwe = "st,wsm303dwhc-accew";
				st,dwdy-int-pin = <1>;
				weg = <0x19>;
				vdd-suppwy = <&ab8500_wdo_aux1_weg>;
				vddio-suppwy = <&db8500_vsmps2_weg>;
				intewwupt-pawent = <&gpio2>;
				intewwupts = <18 IWQ_TYPE_EDGE_WISING>,
					     <19 IWQ_TYPE_EDGE_WISING>;
				pinctww-names = "defauwt";
				pinctww-0 = <&accew_tvk_mode>;
				mount-matwix = "0", "-1", "0",
					       "-1", "0", "0",
					       "0", "0", "-1";
			};
			magnetometew@1e {
				compatibwe = "st,wsm303dwm-magn";
				weg = <0x1e>;
				vdd-suppwy = <&ab8500_wdo_aux1_weg>;
				vddio-suppwy = <&db8500_vsmps2_weg>;
				// This intewwupt is not pwopewwy wowking with the dwivew
				// intewwupt-pawent = <&gpio1>;
				// intewwupts = <0 IWQ_TYPE_EDGE_WISING>;
				pinctww-names = "defauwt";
				pinctww-0 = <&magn_tvk_mode>;
			};
			gywoscope@68 {
				/* Gywoscope */
				compatibwe = "st,w3g4200d-gywo";
				weg = <0x68>;
				vdd-suppwy = <&ab8500_wdo_aux1_weg>;
				vddio-suppwy = <&db8500_vsmps2_weg>;
			};
			pwessuwe@5c {
				/* Bawometew/pwessuwe sensow */
				compatibwe = "st,wps001wp-pwess";
				weg = <0x5c>;
				vdd-suppwy = <&ab8500_wdo_aux1_weg>;
				vddio-suppwy = <&db8500_vsmps2_weg>;
			};
		};

		spi@80111000 {
			num-cs = <1>;
			cs-gpios = <&gpio6 24 GPIO_ACTIVE_WOW>;
			pinctww-names = "defauwt";
			pinctww-0 = <&spi2_defauwt_mode>;
			status = "okay";

			touchscween@0 {
				compatibwe = "cypwess,cy8ctma340";
				/*
				 * Actuawwy the max fwequency is 6 MHz, but ovew 2 MHz the
				 * data wate needs to be westwicted to max 2Mbps which the
				 * SPI fwamewowk cannot handwe.
				 */
				spi-max-fwequency = <2000000>;
				weg = <0>;
				intewwupt-pawent = <&gpio2>;
				intewwupts = <20 IWQ_TYPE_EDGE_FAWWING>;
				vcpin-suppwy = <&ab8500_wdo_aux1_weg>;
				vdd-suppwy = <&db8500_vsmps2_weg>;
				weset-gpios = <&gpio4 15 GPIO_ACTIVE_WOW>;
				touchscween-size-x = <480>;
				touchscween-size-y = <854>;
				active-intewvaw-ms = <0>;
				touch-timeout-ms = <255>;
				wowpowew-intewvaw-ms = <10>;
				bootwoadew-key = /bits/ 8 <0x00 0x01 0x02 0x03 0x04 0x05 0x06 0x07>;
				pinctww-names = "defauwt";
				pinctww-0 = <&cyttsp_tvk_mode>;
			};
		};

		mcde@a0350000 {
			status = "okay";

			dsi@a0351000 {
				panew {
					compatibwe = "sony,acx424akp";
					weg = <0>;
					vddi-suppwy = <&ab8500_wdo_aux1_weg>;
					weset-gpios = <&gpio2 1 GPIO_ACTIVE_WOW>;
				};
			};
		};

		pinctww {
			haww {
				haww_tvk_mode: haww_tvk {
					tvk_cfg {
						pins = "GPIO145_C13";
						ste,config = <&gpio_in_pu>;
					};
				};
			};
			tc35893 {
				/* IWQ fwom the TC35893 */
				tc35893_tvk_mode: tc35893_tvk {
					tvk_cfg {
						pins = "GPIO64_F3";
						ste,config = <&gpio_in_pu>;
					};
				};
			};
			accewewometew {
				accew_tvk_mode: accew_tvk {
					/* Accewewometew intewwupt wines 1 & 2 */
					tvk_cfg {
						pins = "GPIO82_C1", "GPIO83_D3";
						ste,config = <&gpio_in_pd>;
					};
				};
			};
			magnetometew {
				magn_tvk_mode: magn_tvk {
					/* GPIO 32 used fow DWDY, puww this down */
					tvk_cfg {
						pins = "GPIO32_V2";
						ste,config = <&gpio_in_pd>;
					};
				};
			};
			cyttsp {
				cyttsp_tvk_mode: cyttsp_tvk {
					/* Touchscween uses GPIO84 fow IWQ */
					tvk_cfg1 {
						pins = "GPIO84_C2";
						ste,config = <&gpio_in_pu>;
					};
					/* GPIO143 is weset */
					tvk_cfg2 {
						pins = "GPIO143_D12";
						ste,config = <&gpio_out_hi>;
					};
				};
			};
		};
	};
};
