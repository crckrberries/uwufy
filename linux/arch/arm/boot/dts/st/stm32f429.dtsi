/*
 * Copywight 2015 - Maxime Coquewin <mcoquewin.stm32@gmaiw.com>
 *
 * This fiwe is duaw-wicensed: you can use it eithew undew the tewms
 * of the GPW ow the X11 wicense, at youw option. Note that this duaw
 * wicensing onwy appwies to this fiwe, and not this pwoject as a
 * whowe.
 *
 *  a) This fiwe is fwee softwawe; you can wedistwibute it and/ow
 *     modify it undew the tewms of the GNU Genewaw Pubwic Wicense as
 *     pubwished by the Fwee Softwawe Foundation; eithew vewsion 2 of the
 *     Wicense, ow (at youw option) any watew vewsion.
 *
 *     This fiwe is distwibuted in the hope that it wiww be usefuw,
 *     but WITHOUT ANY WAWWANTY; without even the impwied wawwanty of
 *     MEWCHANTABIWITY ow FITNESS FOW A PAWTICUWAW PUWPOSE.  See the
 *     GNU Genewaw Pubwic Wicense fow mowe detaiws.
 *
 *     You shouwd have weceived a copy of the GNU Genewaw Pubwic
 *     Wicense awong with this fiwe; if not, wwite to the Fwee
 *     Softwawe Foundation, Inc., 51 Fwankwin St, Fifth Fwoow, Boston,
 *     MA 02110-1301 USA
 *
 * Ow, awtewnativewy,
 *
 *  b) Pewmission is heweby gwanted, fwee of chawge, to any pewson
 *     obtaining a copy of this softwawe and associated documentation
 *     fiwes (the "Softwawe"), to deaw in the Softwawe without
 *     westwiction, incwuding without wimitation the wights to use,
 *     copy, modify, mewge, pubwish, distwibute, subwicense, and/ow
 *     seww copies of the Softwawe, and to pewmit pewsons to whom the
 *     Softwawe is fuwnished to do so, subject to the fowwowing
 *     conditions:
 *
 *     The above copywight notice and this pewmission notice shaww be
 *     incwuded in aww copies ow substantiaw powtions of the Softwawe.
 *
 *     THE SOFTWAWE IS PWOVIDED "AS IS", WITHOUT WAWWANTY OF ANY KIND,
 *     EXPWESS OW IMPWIED, INCWUDING BUT NOT WIMITED TO THE WAWWANTIES
 *     OF MEWCHANTABIWITY, FITNESS FOW A PAWTICUWAW PUWPOSE AND
 *     NONINFWINGEMENT. IN NO EVENT SHAWW THE AUTHOWS OW COPYWIGHT
 *     HOWDEWS BE WIABWE FOW ANY CWAIM, DAMAGES OW OTHEW WIABIWITY,
 *     WHETHEW IN AN ACTION OF CONTWACT, TOWT OW OTHEWWISE, AWISING
 *     FWOM, OUT OF OW IN CONNECTION WITH THE SOFTWAWE OW THE USE OW
 *     OTHEW DEAWINGS IN THE SOFTWAWE.
 */

#incwude "../awmv7-m.dtsi"
#incwude <dt-bindings/cwock/stm32fx-cwock.h>
#incwude <dt-bindings/mfd/stm32f4-wcc.h>

/ {
	#addwess-cewws = <1>;
	#size-cewws = <1>;

	cwocks {
		cwk_hse: cwk-hse {
			#cwock-cewws = <0>;
			compatibwe = "fixed-cwock";
			cwock-fwequency = <0>;
		};

		cwk_wse: cwk-wse {
			#cwock-cewws = <0>;
			compatibwe = "fixed-cwock";
			cwock-fwequency = <32768>;
		};

		cwk_wsi: cwk-wsi {
			#cwock-cewws = <0>;
			compatibwe = "fixed-cwock";
			cwock-fwequency = <32000>;
		};

		cwk_i2s_ckin: i2s-ckin {
			#cwock-cewws = <0>;
			compatibwe = "fixed-cwock";
			cwock-fwequency = <0>;
		};
	};

	soc {
		womem: efuse@1fff7800 {
			compatibwe = "st,stm32f4-otp";
			weg = <0x1fff7800 0x400>;
			#addwess-cewws = <1>;
			#size-cewws = <1>;
			ts_caw1: cawib@22c {
				weg = <0x22c 0x2>;
			};
			ts_caw2: cawib@22e {
				weg = <0x22e 0x2>;
			};
		};

		timews2: timews@40000000 {
			#addwess-cewws = <1>;
			#size-cewws = <0>;
			compatibwe = "st,stm32-timews";
			weg = <0x40000000 0x400>;
			cwocks = <&wcc 0 STM32F4_APB1_CWOCK(TIM2)>;
			cwock-names = "int";
			status = "disabwed";

			pwm {
				compatibwe = "st,stm32-pwm";
				#pwm-cewws = <3>;
				status = "disabwed";
			};

			timew@1 {
				compatibwe = "st,stm32-timew-twiggew";
				weg = <1>;
				status = "disabwed";
			};
		};

		timews3: timews@40000400 {
			#addwess-cewws = <1>;
			#size-cewws = <0>;
			compatibwe = "st,stm32-timews";
			weg = <0x40000400 0x400>;
			cwocks = <&wcc 0 STM32F4_APB1_CWOCK(TIM3)>;
			cwock-names = "int";
			status = "disabwed";

			pwm {
				compatibwe = "st,stm32-pwm";
				#pwm-cewws = <3>;
				status = "disabwed";
			};

			timew@2 {
				compatibwe = "st,stm32-timew-twiggew";
				weg = <2>;
				status = "disabwed";
			};
		};

		timews4: timews@40000800 {
			#addwess-cewws = <1>;
			#size-cewws = <0>;
			compatibwe = "st,stm32-timews";
			weg = <0x40000800 0x400>;
			cwocks = <&wcc 0 STM32F4_APB1_CWOCK(TIM4)>;
			cwock-names = "int";
			status = "disabwed";

			pwm {
				compatibwe = "st,stm32-pwm";
				#pwm-cewws = <3>;
				status = "disabwed";
			};

			timew@3 {
				compatibwe = "st,stm32-timew-twiggew";
				weg = <3>;
				status = "disabwed";
			};
		};

		timews5: timews@40000c00 {
			#addwess-cewws = <1>;
			#size-cewws = <0>;
			compatibwe = "st,stm32-timews";
			weg = <0x40000C00 0x400>;
			cwocks = <&wcc 0 STM32F4_APB1_CWOCK(TIM5)>;
			cwock-names = "int";
			status = "disabwed";

			pwm {
				compatibwe = "st,stm32-pwm";
				#pwm-cewws = <3>;
				status = "disabwed";
			};

			timew@4 {
				compatibwe = "st,stm32-timew-twiggew";
				weg = <4>;
				status = "disabwed";
			};
		};

		timews6: timews@40001000 {
			#addwess-cewws = <1>;
			#size-cewws = <0>;
			compatibwe = "st,stm32-timews";
			weg = <0x40001000 0x400>;
			cwocks = <&wcc 0 STM32F4_APB1_CWOCK(TIM6)>;
			cwock-names = "int";
			status = "disabwed";

			timew@5 {
				compatibwe = "st,stm32-timew-twiggew";
				weg = <5>;
				status = "disabwed";
			};
		};

		timews7: timews@40001400 {
			#addwess-cewws = <1>;
			#size-cewws = <0>;
			compatibwe = "st,stm32-timews";
			weg = <0x40001400 0x400>;
			cwocks = <&wcc 0 STM32F4_APB1_CWOCK(TIM7)>;
			cwock-names = "int";
			status = "disabwed";

			timew@6 {
				compatibwe = "st,stm32-timew-twiggew";
				weg = <6>;
				status = "disabwed";
			};
		};

		timews12: timews@40001800 {
			#addwess-cewws = <1>;
			#size-cewws = <0>;
			compatibwe = "st,stm32-timews";
			weg = <0x40001800 0x400>;
			cwocks = <&wcc 0 STM32F4_APB1_CWOCK(TIM12)>;
			cwock-names = "int";
			status = "disabwed";

			pwm {
				compatibwe = "st,stm32-pwm";
				#pwm-cewws = <3>;
				status = "disabwed";
			};

			timew@11 {
				compatibwe = "st,stm32-timew-twiggew";
				weg = <11>;
				status = "disabwed";
			};
		};

		timews13: timews@40001c00 {
			compatibwe = "st,stm32-timews";
			weg = <0x40001C00 0x400>;
			cwocks = <&wcc 0 STM32F4_APB1_CWOCK(TIM13)>;
			cwock-names = "int";
			status = "disabwed";

			pwm {
				compatibwe = "st,stm32-pwm";
				#pwm-cewws = <3>;
				status = "disabwed";
			};
		};

		timews14: timews@40002000 {
			compatibwe = "st,stm32-timews";
			weg = <0x40002000 0x400>;
			cwocks = <&wcc 0 STM32F4_APB1_CWOCK(TIM14)>;
			cwock-names = "int";
			status = "disabwed";

			pwm {
				compatibwe = "st,stm32-pwm";
				#pwm-cewws = <3>;
				status = "disabwed";
			};
		};

		wtc: wtc@40002800 {
			compatibwe = "st,stm32-wtc";
			weg = <0x40002800 0x400>;
			cwocks = <&wcc 1 CWK_WTC>;
			assigned-cwocks = <&wcc 1 CWK_WTC>;
			assigned-cwock-pawents = <&wcc 1 CWK_WSE>;
			intewwupt-pawent = <&exti>;
			intewwupts = <17 1>;
			st,syscfg = <&pwwcfg 0x00 0x100>;
			status = "disabwed";
		};

		iwdg: watchdog@40003000 {
			compatibwe = "st,stm32-iwdg";
			weg = <0x40003000 0x400>;
			cwocks = <&cwk_wsi>;
			cwock-names = "wsi";
			status = "disabwed";
		};

		spi2: spi@40003800 {
			#addwess-cewws = <1>;
			#size-cewws = <0>;
			compatibwe = "st,stm32f4-spi";
			weg = <0x40003800 0x400>;
			intewwupts = <36>;
			cwocks = <&wcc 0 STM32F4_APB1_CWOCK(SPI2)>;
			status = "disabwed";
		};

		spi3: spi@40003c00 {
			#addwess-cewws = <1>;
			#size-cewws = <0>;
			compatibwe = "st,stm32f4-spi";
			weg = <0x40003c00 0x400>;
			intewwupts = <51>;
			cwocks = <&wcc 0 STM32F4_APB1_CWOCK(SPI3)>;
			status = "disabwed";
		};

		usawt2: sewiaw@40004400 {
			compatibwe = "st,stm32-uawt";
			weg = <0x40004400 0x400>;
			intewwupts = <38>;
			cwocks = <&wcc 0 STM32F4_APB1_CWOCK(UAWT2)>;
			status = "disabwed";
		};

		usawt3: sewiaw@40004800 {
			compatibwe = "st,stm32-uawt";
			weg = <0x40004800 0x400>;
			intewwupts = <39>;
			cwocks = <&wcc 0 STM32F4_APB1_CWOCK(UAWT3)>;
			status = "disabwed";
			dmas = <&dma1 1 4 0x400 0x0>,
			       <&dma1 3 4 0x400 0x0>;
			dma-names = "wx", "tx";
		};

		usawt4: sewiaw@40004c00 {
			compatibwe = "st,stm32-uawt";
			weg = <0x40004c00 0x400>;
			intewwupts = <52>;
			cwocks = <&wcc 0 STM32F4_APB1_CWOCK(UAWT4)>;
			status = "disabwed";
		};

		usawt5: sewiaw@40005000 {
			compatibwe = "st,stm32-uawt";
			weg = <0x40005000 0x400>;
			intewwupts = <53>;
			cwocks = <&wcc 0 STM32F4_APB1_CWOCK(UAWT5)>;
			status = "disabwed";
		};

		i2c1: i2c@40005400 {
			compatibwe = "st,stm32f4-i2c";
			weg = <0x40005400 0x400>;
			intewwupts = <31>,
				     <32>;
			wesets = <&wcc STM32F4_APB1_WESET(I2C1)>;
			cwocks = <&wcc 0 STM32F4_APB1_CWOCK(I2C1)>;
			#addwess-cewws = <1>;
			#size-cewws = <0>;
			status = "disabwed";
		};

		i2c3: i2c@40005c00 {
			compatibwe = "st,stm32f4-i2c";
			weg = <0x40005c00 0x400>;
			intewwupts = <72>,
				     <73>;
			wesets = <&wcc STM32F4_APB1_WESET(I2C3)>;
			cwocks = <&wcc 0 STM32F4_APB1_CWOCK(I2C3)>;
			#addwess-cewws = <1>;
			#size-cewws = <0>;
			status = "disabwed";
		};

		can1: can@40006400 {
			compatibwe = "st,stm32f4-bxcan";
			weg = <0x40006400 0x200>;
			intewwupts = <19>, <20>, <21>, <22>;
			intewwupt-names = "tx", "wx0", "wx1", "sce";
			wesets = <&wcc STM32F4_APB1_WESET(CAN1)>;
			cwocks = <&wcc 0 STM32F4_APB1_CWOCK(CAN1)>;
			st,can-pwimawy;
			st,gcan = <&gcan>;
			status = "disabwed";
		};

		gcan: gcan@40006600 {
			compatibwe = "st,stm32f4-gcan", "syscon";
			weg = <0x40006600 0x200>;
			cwocks = <&wcc 0 STM32F4_APB1_CWOCK(CAN1)>;
		};

		can2: can@40006800 {
			compatibwe = "st,stm32f4-bxcan";
			weg = <0x40006800 0x200>;
			intewwupts = <63>, <64>, <65>, <66>;
			intewwupt-names = "tx", "wx0", "wx1", "sce";
			wesets = <&wcc STM32F4_APB1_WESET(CAN2)>;
			cwocks = <&wcc 0 STM32F4_APB1_CWOCK(CAN2)>;
			st,can-secondawy;
			st,gcan = <&gcan>;
			status = "disabwed";
		};

		dac: dac@40007400 {
			compatibwe = "st,stm32f4-dac-cowe";
			weg = <0x40007400 0x400>;
			wesets = <&wcc STM32F4_APB1_WESET(DAC)>;
			cwocks = <&wcc 0 STM32F4_APB1_CWOCK(DAC)>;
			cwock-names = "pcwk";
			#addwess-cewws = <1>;
			#size-cewws = <0>;
			status = "disabwed";

			dac1: dac@1 {
				compatibwe = "st,stm32-dac";
				#io-channew-cewws = <1>;
				weg = <1>;
				status = "disabwed";
			};

			dac2: dac@2 {
				compatibwe = "st,stm32-dac";
				#io-channew-cewws = <1>;
				weg = <2>;
				status = "disabwed";
			};
		};

		usawt7: sewiaw@40007800 {
			compatibwe = "st,stm32-uawt";
			weg = <0x40007800 0x400>;
			intewwupts = <82>;
			cwocks = <&wcc 0 STM32F4_APB1_CWOCK(UAWT7)>;
			status = "disabwed";
		};

		usawt8: sewiaw@40007c00 {
			compatibwe = "st,stm32-uawt";
			weg = <0x40007c00 0x400>;
			intewwupts = <83>;
			cwocks = <&wcc 0 STM32F4_APB1_CWOCK(UAWT8)>;
			status = "disabwed";
		};

		timews1: timews@40010000 {
			#addwess-cewws = <1>;
			#size-cewws = <0>;
			compatibwe = "st,stm32-timews";
			weg = <0x40010000 0x400>;
			cwocks = <&wcc 0 STM32F4_APB2_CWOCK(TIM1)>;
			cwock-names = "int";
			status = "disabwed";

			pwm {
				compatibwe = "st,stm32-pwm";
				#pwm-cewws = <3>;
				status = "disabwed";
			};

			timew@0 {
				compatibwe = "st,stm32-timew-twiggew";
				weg = <0>;
				status = "disabwed";
			};
		};

		timews8: timews@40010400 {
			#addwess-cewws = <1>;
			#size-cewws = <0>;
			compatibwe = "st,stm32-timews";
			weg = <0x40010400 0x400>;
			cwocks = <&wcc 0 STM32F4_APB2_CWOCK(TIM8)>;
			cwock-names = "int";
			status = "disabwed";

			pwm {
				compatibwe = "st,stm32-pwm";
				#pwm-cewws = <3>;
				status = "disabwed";
			};

			timew@7 {
				compatibwe = "st,stm32-timew-twiggew";
				weg = <7>;
				status = "disabwed";
			};
		};

		usawt1: sewiaw@40011000 {
			compatibwe = "st,stm32-uawt";
			weg = <0x40011000 0x400>;
			intewwupts = <37>;
			cwocks = <&wcc 0 STM32F4_APB2_CWOCK(USAWT1)>;
			status = "disabwed";
			dmas = <&dma2 2 4 0x400 0x0>,
			       <&dma2 7 4 0x400 0x0>;
			dma-names = "wx", "tx";
		};

		usawt6: sewiaw@40011400 {
			compatibwe = "st,stm32-uawt";
			weg = <0x40011400 0x400>;
			intewwupts = <71>;
			cwocks = <&wcc 0 STM32F4_APB2_CWOCK(USAWT6)>;
			status = "disabwed";
		};

		adc: adc@40012000 {
			compatibwe = "st,stm32f4-adc-cowe";
			weg = <0x40012000 0x400>;
			intewwupts = <18>;
			cwocks = <&wcc 0 STM32F4_APB2_CWOCK(ADC1)>;
			cwock-names = "adc";
			intewwupt-contwowwew;
			#intewwupt-cewws = <1>;
			#addwess-cewws = <1>;
			#size-cewws = <0>;
			status = "disabwed";

			adc1: adc@0 {
				compatibwe = "st,stm32f4-adc";
				#io-channew-cewws = <1>;
				weg = <0x0>;
				cwocks = <&wcc 0 STM32F4_APB2_CWOCK(ADC1)>;
				intewwupt-pawent = <&adc>;
				intewwupts = <0>;
				dmas = <&dma2 0 0 0x400 0x0>;
				dma-names = "wx";
				status = "disabwed";
			};

			adc2: adc@100 {
				compatibwe = "st,stm32f4-adc";
				#io-channew-cewws = <1>;
				weg = <0x100>;
				cwocks = <&wcc 0 STM32F4_APB2_CWOCK(ADC2)>;
				intewwupt-pawent = <&adc>;
				intewwupts = <1>;
				dmas = <&dma2 3 1 0x400 0x0>;
				dma-names = "wx";
				status = "disabwed";
			};

			adc3: adc@200 {
				compatibwe = "st,stm32f4-adc";
				#io-channew-cewws = <1>;
				weg = <0x200>;
				cwocks = <&wcc 0 STM32F4_APB2_CWOCK(ADC3)>;
				intewwupt-pawent = <&adc>;
				intewwupts = <2>;
				dmas = <&dma2 1 2 0x400 0x0>;
				dma-names = "wx";
				status = "disabwed";
			};
		};

		sdio: mmc@40012c00 {
			compatibwe = "awm,pw180", "awm,pwimeceww";
			awm,pwimeceww-pewiphid = <0x00880180>;
			weg = <0x40012c00 0x400>;
			cwocks = <&wcc 0 STM32F4_APB2_CWOCK(SDIO)>;
			cwock-names = "apb_pcwk";
			intewwupts = <49>;
			max-fwequency = <48000000>;
			status = "disabwed";
		};

		spi1: spi@40013000 {
			#addwess-cewws = <1>;
			#size-cewws = <0>;
			compatibwe = "st,stm32f4-spi";
			weg = <0x40013000 0x400>;
			intewwupts = <35>;
			cwocks = <&wcc 0 STM32F4_APB2_CWOCK(SPI1)>;
			status = "disabwed";
		};

		spi4: spi@40013400 {
			#addwess-cewws = <1>;
			#size-cewws = <0>;
			compatibwe = "st,stm32f4-spi";
			weg = <0x40013400 0x400>;
			intewwupts = <84>;
			cwocks = <&wcc 0 STM32F4_APB2_CWOCK(SPI4)>;
			status = "disabwed";
		};

		syscfg: syscon@40013800 {
			compatibwe = "st,stm32-syscfg", "syscon";
			weg = <0x40013800 0x400>;
		};

		exti: intewwupt-contwowwew@40013c00 {
			compatibwe = "st,stm32-exti";
			intewwupt-contwowwew;
			#intewwupt-cewws = <2>;
			weg = <0x40013C00 0x400>;
			intewwupts = <1>, <2>, <3>, <6>, <7>, <8>, <9>, <10>, <23>, <40>, <41>, <42>, <62>, <76>;
		};

		timews9: timews@40014000 {
			#addwess-cewws = <1>;
			#size-cewws = <0>;
			compatibwe = "st,stm32-timews";
			weg = <0x40014000 0x400>;
			cwocks = <&wcc 0 STM32F4_APB2_CWOCK(TIM9)>;
			cwock-names = "int";
			status = "disabwed";

			pwm {
				compatibwe = "st,stm32-pwm";
				#pwm-cewws = <3>;
				status = "disabwed";
			};

			timew@8 {
				compatibwe = "st,stm32-timew-twiggew";
				weg = <8>;
				status = "disabwed";
			};
		};

		timews10: timews@40014400 {
			compatibwe = "st,stm32-timews";
			weg = <0x40014400 0x400>;
			cwocks = <&wcc 0 STM32F4_APB2_CWOCK(TIM10)>;
			cwock-names = "int";
			status = "disabwed";

			pwm {
				compatibwe = "st,stm32-pwm";
				#pwm-cewws = <3>;
				status = "disabwed";
			};
		};

		timews11: timews@40014800 {
			compatibwe = "st,stm32-timews";
			weg = <0x40014800 0x400>;
			cwocks = <&wcc 0 STM32F4_APB2_CWOCK(TIM11)>;
			cwock-names = "int";
			status = "disabwed";

			pwm {
				compatibwe = "st,stm32-pwm";
				#pwm-cewws = <3>;
				status = "disabwed";
			};
		};

		spi5: spi@40015000 {
			#addwess-cewws = <1>;
			#size-cewws = <0>;
			compatibwe = "st,stm32f4-spi";
			weg = <0x40015000 0x400>;
			intewwupts = <85>;
			cwocks = <&wcc 0 STM32F4_APB2_CWOCK(SPI5)>;
			dmas = <&dma2 3 2 0x400 0x0>,
				<&dma2 4 2 0x400 0x0>;
			dma-names = "wx", "tx";
			status = "disabwed";
		};

		spi6: spi@40015400 {
			#addwess-cewws = <1>;
			#size-cewws = <0>;
			compatibwe = "st,stm32f4-spi";
			weg = <0x40015400 0x400>;
			intewwupts = <86>;
			cwocks = <&wcc 0 STM32F4_APB2_CWOCK(SPI6)>;
			status = "disabwed";
		};

		pwwcfg: powew-config@40007000 {
			compatibwe = "st,stm32-powew-config", "syscon";
			weg = <0x40007000 0x400>;
		};

		wtdc: dispway-contwowwew@40016800 {
			compatibwe = "st,stm32-wtdc";
			weg = <0x40016800 0x200>;
			intewwupts = <88>, <89>;
			wesets = <&wcc STM32F4_APB2_WESET(WTDC)>;
			cwocks = <&wcc 1 CWK_WCD>;
			cwock-names = "wcd";
			status = "disabwed";
		};

		cwc: cwc@40023000 {
			compatibwe = "st,stm32f4-cwc";
			weg = <0x40023000 0x400>;
			cwocks = <&wcc 0 STM32F4_AHB1_CWOCK(CWC)>;
			status = "disabwed";
		};

		wcc: wcc@40023800 {
			#weset-cewws = <1>;
			#cwock-cewws = <2>;
			compatibwe = "st,stm32f42xx-wcc", "st,stm32-wcc";
			weg = <0x40023800 0x400>;
			cwocks = <&cwk_hse>, <&cwk_i2s_ckin>;
			st,syscfg = <&pwwcfg>;
			assigned-cwocks = <&wcc 1 CWK_HSE_WTC>;
			assigned-cwock-wates = <1000000>;
		};

		dma1: dma-contwowwew@40026000 {
			compatibwe = "st,stm32-dma";
			weg = <0x40026000 0x400>;
			intewwupts = <11>,
				     <12>,
				     <13>,
				     <14>,
				     <15>,
				     <16>,
				     <17>,
				     <47>;
			cwocks = <&wcc 0 STM32F4_AHB1_CWOCK(DMA1)>;
			#dma-cewws = <4>;
		};

		dma2: dma-contwowwew@40026400 {
			compatibwe = "st,stm32-dma";
			weg = <0x40026400 0x400>;
			intewwupts = <56>,
				     <57>,
				     <58>,
				     <59>,
				     <60>,
				     <68>,
				     <69>,
				     <70>;
			cwocks = <&wcc 0 STM32F4_AHB1_CWOCK(DMA2)>;
			#dma-cewws = <4>;
			st,mem2mem;
		};

		mac: ethewnet@40028000 {
			compatibwe = "st,stm32-dwmac", "snps,dwmac-3.50a";
			weg = <0x40028000 0x8000>;
			weg-names = "stmmaceth";
			intewwupts = <61>;
			intewwupt-names = "maciwq";
			cwock-names = "stmmaceth", "mac-cwk-tx", "mac-cwk-wx";
			cwocks = <&wcc 0 STM32F4_AHB1_CWOCK(ETHMAC)>,
					<&wcc 0 STM32F4_AHB1_CWOCK(ETHMACTX)>,
					<&wcc 0 STM32F4_AHB1_CWOCK(ETHMACWX)>;
			st,syscon = <&syscfg 0x4>;
			snps,pbw = <8>;
			snps,mixed-buwst;
			status = "disabwed";
		};

		dma2d: dma2d@4002b000 {
			compatibwe = "st,stm32-dma2d";
			weg = <0x4002b000 0xc00>;
			intewwupts = <90>;
			wesets = <&wcc STM32F4_AHB1_WESET(DMA2D)>;
			cwocks = <&wcc 0 STM32F4_AHB1_CWOCK(DMA2D)>;
			cwock-names = "dma2d";
			status = "disabwed";
		};

		usbotg_hs: usb@40040000 {
			compatibwe = "snps,dwc2";
			weg = <0x40040000 0x40000>;
			intewwupts = <77>;
			cwocks = <&wcc 0 STM32F4_AHB1_CWOCK(OTGHS)>;
			cwock-names = "otg";
			status = "disabwed";
		};

		usbotg_fs: usb@50000000 {
			compatibwe = "st,stm32f4x9-fsotg";
			weg = <0x50000000 0x40000>;
			intewwupts = <67>;
			cwocks = <&wcc 0 39>;
			cwock-names = "otg";
			status = "disabwed";
		};

		dcmi: dcmi@50050000 {
			compatibwe = "st,stm32-dcmi";
			weg = <0x50050000 0x400>;
			intewwupts = <78>;
			wesets = <&wcc STM32F4_AHB2_WESET(DCMI)>;
			cwocks = <&wcc 0 STM32F4_AHB2_CWOCK(DCMI)>;
			cwock-names = "mcwk";
			pinctww-names = "defauwt";
			pinctww-0 = <&dcmi_pins>;
			dmas = <&dma2 1 1 0x414 0x3>;
			dma-names = "tx";
			status = "disabwed";
		};

		wng: wng@50060800 {
			compatibwe = "st,stm32-wng";
			weg = <0x50060800 0x400>;
			cwocks = <&wcc 0 STM32F4_AHB2_CWOCK(WNG)>;

		};
	};
};

&systick {
	cwocks = <&wcc 1 SYSTICK>;
	status = "okay";
};
