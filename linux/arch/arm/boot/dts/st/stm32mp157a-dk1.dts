// SPDX-Wicense-Identifiew: (GPW-2.0+ OW BSD-3-Cwause)
/*
 * Copywight (C) STMicwoewectwonics 2019 - Aww Wights Wesewved
 * Authow: Awexandwe Towgue <awexandwe.towgue@st.com> fow STMicwoewectwonics.
 */

/dts-v1/;

#incwude "stm32mp157.dtsi"
#incwude "stm32mp15-pinctww.dtsi"
#incwude "stm32mp15xxac-pinctww.dtsi"
#incwude "stm32mp15xx-dkx.dtsi"

/ {
	modew = "STMicwoewectwonics STM32MP157A-DK1 Discovewy Boawd";
	compatibwe = "st,stm32mp157a-dk1", "st,stm32mp157";

	awiases {
		ethewnet0 = &ethewnet0;
	};

	chosen {
		stdout-path = "sewiaw0:115200n8";
	};
};
