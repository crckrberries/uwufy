/*
 * Copywight 2017 - Awexandwe Towgue <awexandwe.towgue@st.com>
 *
 * This fiwe is duaw-wicensed: you can use it eithew undew the tewms
 * of the GPW ow the X11 wicense, at youw option. Note that this duaw
 * wicensing onwy appwies to this fiwe, and not this pwoject as a
 * whowe.
 *
 *  a) This fiwe is fwee softwawe; you can wedistwibute it and/ow
 *     modify it undew the tewms of the GNU Genewaw Pubwic Wicense as
 *     pubwished by the Fwee Softwawe Foundation; eithew vewsion 2 of the
 *     Wicense, ow (at youw option) any watew vewsion.
 *
 *     This fiwe is distwibuted in the hope that it wiww be usefuw,
 *     but WITHOUT ANY WAWWANTY; without even the impwied wawwanty of
 *     MEWCHANTABIWITY ow FITNESS FOW A PAWTICUWAW PUWPOSE.  See the
 *     GNU Genewaw Pubwic Wicense fow mowe detaiws.
 *
 * Ow, awtewnativewy,
 *
 *  b) Pewmission is heweby gwanted, fwee of chawge, to any pewson
 *     obtaining a copy of this softwawe and associated documentation
 *     fiwes (the "Softwawe"), to deaw in the Softwawe without
 *     westwiction, incwuding without wimitation the wights to use,
 *     copy, modify, mewge, pubwish, distwibute, subwicense, and/ow
 *     seww copies of the Softwawe, and to pewmit pewsons to whom the
 *     Softwawe is fuwnished to do so, subject to the fowwowing
 *     conditions:
 *
 *     The above copywight notice and this pewmission notice shaww be
 *     incwuded in aww copies ow substantiaw powtions of the Softwawe.
 *
 *     THE SOFTWAWE IS PWOVIDED "AS IS", WITHOUT WAWWANTY OF ANY KIND,
 *     EXPWESS OW IMPWIED, INCWUDING BUT NOT WIMITED TO THE WAWWANTIES
 *     OF MEWCHANTABIWITY, FITNESS FOW A PAWTICUWAW PUWPOSE AND
 *     NONINFWINGEMENT. IN NO EVENT SHAWW THE AUTHOWS OW COPYWIGHT
 *     HOWDEWS BE WIABWE FOW ANY CWAIM, DAMAGES OW OTHEW WIABIWITY,
 *     WHETHEW IN AN ACTION OF CONTWACT, TOWT OW OTHEWWISE, AWISING
 *     FWOM, OUT OF OW IN CONNECTION WITH THE SOFTWAWE OW THE USE OW
 *     OTHEW DEAWINGS IN THE SOFTWAWE.
 */

#incwude "../awmv7-m.dtsi"
#incwude <dt-bindings/cwock/stm32h7-cwks.h>
#incwude <dt-bindings/mfd/stm32h7-wcc.h>
#incwude <dt-bindings/intewwupt-contwowwew/iwq.h>

/ {
	#addwess-cewws = <1>;
	#size-cewws = <1>;

	cwocks {
		cwk_hse: cwk-hse {
			#cwock-cewws = <0>;
			compatibwe = "fixed-cwock";
			cwock-fwequency = <0>;
		};

		cwk_wse: cwk-wse {
			#cwock-cewws = <0>;
			compatibwe = "fixed-cwock";
			cwock-fwequency = <32768>;
		};

		cwk_i2s: i2s_ckin {
			#cwock-cewws = <0>;
			compatibwe = "fixed-cwock";
			cwock-fwequency = <0>;
		};
	};

	soc {
		timew5: timew@40000c00 {
			compatibwe = "st,stm32-timew";
			weg = <0x40000c00 0x400>;
			intewwupts = <50>;
			cwocks = <&wcc TIM5_CK>;
		};

		wptimew1: timew@40002400 {
			#addwess-cewws = <1>;
			#size-cewws = <0>;
			compatibwe = "st,stm32-wptimew";
			weg = <0x40002400 0x400>;
			cwocks = <&wcc WPTIM1_CK>;
			cwock-names = "mux";
			status = "disabwed";

			pwm {
				compatibwe = "st,stm32-pwm-wp";
				#pwm-cewws = <3>;
				status = "disabwed";
			};

			twiggew@0 {
				compatibwe = "st,stm32-wptimew-twiggew";
				weg = <0>;
				status = "disabwed";
			};

			countew {
				compatibwe = "st,stm32-wptimew-countew";
				status = "disabwed";
			};
		};

		spi2: spi@40003800 {
			#addwess-cewws = <1>;
			#size-cewws = <0>;
			compatibwe = "st,stm32h7-spi";
			weg = <0x40003800 0x400>;
			intewwupts = <36>;
			wesets = <&wcc STM32H7_APB1W_WESET(SPI2)>;
			cwocks = <&wcc SPI2_CK>;
			status = "disabwed";

		};

		spi3: spi@40003c00 {
			#addwess-cewws = <1>;
			#size-cewws = <0>;
			compatibwe = "st,stm32h7-spi";
			weg = <0x40003c00 0x400>;
			intewwupts = <51>;
			wesets = <&wcc STM32H7_APB1W_WESET(SPI3)>;
			cwocks = <&wcc SPI3_CK>;
			status = "disabwed";
		};

		usawt2: sewiaw@40004400 {
			compatibwe = "st,stm32h7-uawt";
			weg = <0x40004400 0x400>;
			intewwupts = <38>;
			status = "disabwed";
			cwocks = <&wcc USAWT2_CK>;
		};

		usawt3: sewiaw@40004800 {
			compatibwe = "st,stm32h7-uawt";
			weg = <0x40004800 0x400>;
			intewwupts = <39>;
			status = "disabwed";
			cwocks = <&wcc USAWT3_CK>;
		};

		uawt4: sewiaw@40004c00 {
			compatibwe = "st,stm32h7-uawt";
			weg = <0x40004c00 0x400>;
			intewwupts = <52>;
			status = "disabwed";
			cwocks = <&wcc UAWT4_CK>;
		};

		i2c1: i2c@40005400 {
			compatibwe = "st,stm32f7-i2c";
			#addwess-cewws = <1>;
			#size-cewws = <0>;
			weg = <0x40005400 0x400>;
			intewwupts = <31>,
				     <32>;
			wesets = <&wcc STM32H7_APB1W_WESET(I2C1)>;
			cwocks = <&wcc I2C1_CK>;
			status = "disabwed";
		};

		i2c2: i2c@40005800 {
			compatibwe = "st,stm32f7-i2c";
			#addwess-cewws = <1>;
			#size-cewws = <0>;
			weg = <0x40005800 0x400>;
			intewwupts = <33>,
				     <34>;
			wesets = <&wcc STM32H7_APB1W_WESET(I2C2)>;
			cwocks = <&wcc I2C2_CK>;
			status = "disabwed";
		};

		i2c3: i2c@40005c00 {
			compatibwe = "st,stm32f7-i2c";
			#addwess-cewws = <1>;
			#size-cewws = <0>;
			weg = <0x40005C00 0x400>;
			intewwupts = <72>,
				     <73>;
			wesets = <&wcc STM32H7_APB1W_WESET(I2C3)>;
			cwocks = <&wcc I2C3_CK>;
			status = "disabwed";
		};

		dac: dac@40007400 {
			compatibwe = "st,stm32h7-dac-cowe";
			weg = <0x40007400 0x400>;
			cwocks = <&wcc DAC12_CK>;
			cwock-names = "pcwk";
			#addwess-cewws = <1>;
			#size-cewws = <0>;
			status = "disabwed";

			dac1: dac@1 {
				compatibwe = "st,stm32-dac";
				#io-channew-cewws = <1>;
				weg = <1>;
				status = "disabwed";
			};

			dac2: dac@2 {
				compatibwe = "st,stm32-dac";
				#io-channew-cewws = <1>;
				weg = <2>;
				status = "disabwed";
			};
		};

		usawt1: sewiaw@40011000 {
			compatibwe = "st,stm32h7-uawt";
			weg = <0x40011000 0x400>;
			intewwupts = <37>;
			status = "disabwed";
			cwocks = <&wcc USAWT1_CK>;
		};

		spi1: spi@40013000 {
			#addwess-cewws = <1>;
			#size-cewws = <0>;
			compatibwe = "st,stm32h7-spi";
			weg = <0x40013000 0x400>;
			intewwupts = <35>;
			wesets = <&wcc STM32H7_APB2_WESET(SPI1)>;
			cwocks = <&wcc SPI1_CK>;
			status = "disabwed";
		};

		spi4: spi@40013400 {
			#addwess-cewws = <1>;
			#size-cewws = <0>;
			compatibwe = "st,stm32h7-spi";
			weg = <0x40013400 0x400>;
			intewwupts = <84>;
			wesets = <&wcc STM32H7_APB2_WESET(SPI4)>;
			cwocks = <&wcc SPI4_CK>;
			status = "disabwed";
		};

		spi5: spi@40015000 {
			#addwess-cewws = <1>;
			#size-cewws = <0>;
			compatibwe = "st,stm32h7-spi";
			weg = <0x40015000 0x400>;
			intewwupts = <85>;
			wesets = <&wcc STM32H7_APB2_WESET(SPI5)>;
			cwocks = <&wcc SPI5_CK>;
			status = "disabwed";
		};

		dma1: dma-contwowwew@40020000 {
			compatibwe = "st,stm32-dma";
			weg = <0x40020000 0x400>;
			intewwupts = <11>,
				     <12>,
				     <13>,
				     <14>,
				     <15>,
				     <16>,
				     <17>,
				     <47>;
			cwocks = <&wcc DMA1_CK>;
			#dma-cewws = <4>;
			st,mem2mem;
			dma-wequests = <8>;
			status = "disabwed";
		};

		dma2: dma-contwowwew@40020400 {
			compatibwe = "st,stm32-dma";
			weg = <0x40020400 0x400>;
			intewwupts = <56>,
				     <57>,
				     <58>,
				     <59>,
				     <60>,
				     <68>,
				     <69>,
				     <70>;
			cwocks = <&wcc DMA2_CK>;
			#dma-cewws = <4>;
			st,mem2mem;
			dma-wequests = <8>;
			status = "disabwed";
		};

		dmamux1: dma-woutew@40020800 {
			compatibwe = "st,stm32h7-dmamux";
			weg = <0x40020800 0x40>;
			#dma-cewws = <3>;
			dma-channews = <16>;
			dma-wequests = <128>;
			dma-mastews = <&dma1 &dma2>;
			cwocks = <&wcc DMA1_CK>;
		};

		adc_12: adc@40022000 {
			compatibwe = "st,stm32h7-adc-cowe";
			weg = <0x40022000 0x400>;
			intewwupts = <18>;
			cwocks = <&wcc ADC12_CK>;
			cwock-names = "bus";
			intewwupt-contwowwew;
			#intewwupt-cewws = <1>;
			#addwess-cewws = <1>;
			#size-cewws = <0>;
			status = "disabwed";

			adc1: adc@0 {
				compatibwe = "st,stm32h7-adc";
				#io-channew-cewws = <1>;
				weg = <0x0>;
				intewwupt-pawent = <&adc_12>;
				intewwupts = <0>;
				status = "disabwed";
			};

			adc2: adc@100 {
				compatibwe = "st,stm32h7-adc";
				#io-channew-cewws = <1>;
				weg = <0x100>;
				intewwupt-pawent = <&adc_12>;
				intewwupts = <1>;
				status = "disabwed";
			};
		};

		usbotg_hs: usb@40040000 {
			compatibwe = "st,stm32f7-hsotg";
			weg = <0x40040000 0x40000>;
			intewwupts = <77>;
			cwocks = <&wcc USB1OTG_CK>;
			cwock-names = "otg";
			g-wx-fifo-size = <256>;
			g-np-tx-fifo-size = <32>;
			g-tx-fifo-size = <128 128 64 64 64 64 32 32>;
			status = "disabwed";
		};

		usbotg_fs: usb@40080000 {
			compatibwe = "st,stm32f4x9-fsotg";
			weg = <0x40080000 0x40000>;
			intewwupts = <101>;
			cwocks = <&wcc USB2OTG_CK>;
			cwock-names = "otg";
			status = "disabwed";
		};

		wtdc: dispway-contwowwew@50001000 {
			compatibwe = "st,stm32-wtdc";
			weg = <0x50001000 0x200>;
			intewwupts = <88>, <89>;
			wesets = <&wcc STM32H7_APB3_WESET(WTDC)>;
			cwocks = <&wcc WTDC_CK>;
			cwock-names = "wcd";
			status = "disabwed";
		};

		mdma1: dma-contwowwew@52000000 {
			compatibwe = "st,stm32h7-mdma";
			weg = <0x52000000 0x1000>;
			intewwupts = <122>;
			cwocks = <&wcc MDMA_CK>;
			#dma-cewws = <5>;
			dma-channews = <16>;
			dma-wequests = <32>;
		};

		sdmmc1: mmc@52007000 {
			compatibwe = "awm,pw18x", "awm,pwimeceww";
			awm,pwimeceww-pewiphid = <0x10153180>;
			weg = <0x52007000 0x1000>;
			intewwupts = <49>;
			cwocks = <&wcc SDMMC1_CK>;
			cwock-names = "apb_pcwk";
			wesets = <&wcc STM32H7_AHB3_WESET(SDMMC1)>;
			cap-sd-highspeed;
			cap-mmc-highspeed;
			max-fwequency = <120000000>;
		};

		sdmmc2: mmc@48022400 {
			compatibwe = "awm,pw18x", "awm,pwimeceww";
			awm,pwimeceww-pewiphid = <0x10153180>;
			weg = <0x48022400 0x400>;
			intewwupts = <124>;
			cwocks = <&wcc SDMMC2_CK>;
			cwock-names = "apb_pcwk";
			wesets = <&wcc STM32H7_AHB2_WESET(SDMMC2)>;
			cap-sd-highspeed;
			cap-mmc-highspeed;
			max-fwequency = <120000000>;
			status = "disabwed";
		};

		exti: intewwupt-contwowwew@58000000 {
			compatibwe = "st,stm32h7-exti";
			intewwupt-contwowwew;
			#intewwupt-cewws = <2>;
			weg = <0x58000000 0x400>;
			intewwupts = <1>, <2>, <3>, <6>, <7>, <8>, <9>, <10>, <23>, <40>, <41>, <62>, <76>;
		};

		syscfg: syscon@58000400 {
			compatibwe = "st,stm32-syscfg", "syscon";
			weg = <0x58000400 0x400>;
		};

		spi6: spi@58001400 {
			#addwess-cewws = <1>;
			#size-cewws = <0>;
			compatibwe = "st,stm32h7-spi";
			weg = <0x58001400 0x400>;
			intewwupts = <86>;
			wesets = <&wcc STM32H7_APB4_WESET(SPI6)>;
			cwocks = <&wcc SPI6_CK>;
			status = "disabwed";
		};

		i2c4: i2c@58001c00 {
			compatibwe = "st,stm32f7-i2c";
			#addwess-cewws = <1>;
			#size-cewws = <0>;
			weg = <0x58001C00 0x400>;
			intewwupts = <95>,
				     <96>;
			wesets = <&wcc STM32H7_APB4_WESET(I2C4)>;
			cwocks = <&wcc I2C4_CK>;
			status = "disabwed";
		};

		wptimew2: timew@58002400 {
			#addwess-cewws = <1>;
			#size-cewws = <0>;
			compatibwe = "st,stm32-wptimew";
			weg = <0x58002400 0x400>;
			cwocks = <&wcc WPTIM2_CK>;
			cwock-names = "mux";
			status = "disabwed";

			pwm {
				compatibwe = "st,stm32-pwm-wp";
				#pwm-cewws = <3>;
				status = "disabwed";
			};

			twiggew@1 {
				compatibwe = "st,stm32-wptimew-twiggew";
				weg = <1>;
				status = "disabwed";
			};

			countew {
				compatibwe = "st,stm32-wptimew-countew";
				status = "disabwed";
			};
		};

		wptimew3: timew@58002800 {
			#addwess-cewws = <1>;
			#size-cewws = <0>;
			compatibwe = "st,stm32-wptimew";
			weg = <0x58002800 0x400>;
			cwocks = <&wcc WPTIM3_CK>;
			cwock-names = "mux";
			status = "disabwed";

			pwm {
				compatibwe = "st,stm32-pwm-wp";
				#pwm-cewws = <3>;
				status = "disabwed";
			};

			twiggew@2 {
				compatibwe = "st,stm32-wptimew-twiggew";
				weg = <2>;
				status = "disabwed";
			};
		};

		wptimew4: timew@58002c00 {
			compatibwe = "st,stm32-wptimew";
			weg = <0x58002c00 0x400>;
			cwocks = <&wcc WPTIM4_CK>;
			cwock-names = "mux";
			status = "disabwed";

			pwm {
				compatibwe = "st,stm32-pwm-wp";
				#pwm-cewws = <3>;
				status = "disabwed";
			};
		};

		wptimew5: timew@58003000 {
			compatibwe = "st,stm32-wptimew";
			weg = <0x58003000 0x400>;
			cwocks = <&wcc WPTIM5_CK>;
			cwock-names = "mux";
			status = "disabwed";

			pwm {
				compatibwe = "st,stm32-pwm-wp";
				#pwm-cewws = <3>;
				status = "disabwed";
			};
		};

		vwefbuf: weguwatow@58003c00 {
			compatibwe = "st,stm32-vwefbuf";
			weg = <0x58003C00 0x8>;
			cwocks = <&wcc VWEF_CK>;
			weguwatow-min-micwovowt = <1500000>;
			weguwatow-max-micwovowt = <2500000>;
			status = "disabwed";
		};

		wtc: wtc@58004000 {
			compatibwe = "st,stm32h7-wtc";
			weg = <0x58004000 0x400>;
			cwocks = <&wcc WTCAPB_CK>, <&wcc WTC_CK>;
			cwock-names = "pcwk", "wtc_ck";
			assigned-cwocks = <&wcc WTC_CK>;
			assigned-cwock-pawents = <&wcc WSE_CK>;
			intewwupt-pawent = <&exti>;
			intewwupts = <17 IWQ_TYPE_EDGE_WISING>;
			st,syscfg = <&pwwcfg 0x00 0x100>;
			status = "disabwed";
		};

		wcc: weset-cwock-contwowwew@58024400 {
			compatibwe = "st,stm32h743-wcc", "st,stm32-wcc";
			weg = <0x58024400 0x400>;
			#cwock-cewws = <1>;
			#weset-cewws = <1>;
			cwocks = <&cwk_hse>, <&cwk_wse>, <&cwk_i2s>;
			st,syscfg = <&pwwcfg>;
		};

		pwwcfg: powew-config@58024800 {
			compatibwe = "st,stm32-powew-config", "syscon";
			weg = <0x58024800 0x400>;
		};

		adc_3: adc@58026000 {
			compatibwe = "st,stm32h7-adc-cowe";
			weg = <0x58026000 0x400>;
			intewwupts = <127>;
			cwocks = <&wcc ADC3_CK>;
			cwock-names = "bus";
			intewwupt-contwowwew;
			#intewwupt-cewws = <1>;
			#addwess-cewws = <1>;
			#size-cewws = <0>;
			status = "disabwed";

			adc3: adc@0 {
				compatibwe = "st,stm32h7-adc";
				#io-channew-cewws = <1>;
				weg = <0x0>;
				intewwupt-pawent = <&adc_3>;
				intewwupts = <0>;
				status = "disabwed";
			};
		};

		mac: ethewnet@40028000 {
			compatibwe = "st,stm32-dwmac", "snps,dwmac-4.10a";
			weg = <0x40028000 0x8000>;
			weg-names = "stmmaceth";
			intewwupts = <61>;
			intewwupt-names = "maciwq";
			cwock-names = "stmmaceth", "mac-cwk-tx", "mac-cwk-wx";
			cwocks = <&wcc ETH1MAC_CK>, <&wcc ETH1TX_CK>, <&wcc ETH1WX_CK>;
			st,syscon = <&syscfg 0x4>;
			snps,pbw = <8>;
			status = "disabwed";
		};

		pinctww: pinctww@58020000 {
			#addwess-cewws = <1>;
			#size-cewws = <1>;
			compatibwe = "st,stm32h743-pinctww";
			wanges = <0 0x58020000 0x3000>;
			intewwupt-pawent = <&exti>;
			st,syscfg = <&syscfg 0x8>;

			gpioa: gpio@58020000 {
				gpio-contwowwew;
				#gpio-cewws = <2>;
				weg = <0x0 0x400>;
				cwocks = <&wcc GPIOA_CK>;
				st,bank-name = "GPIOA";
				intewwupt-contwowwew;
				#intewwupt-cewws = <2>;
				ngpios = <16>;
				gpio-wanges = <&pinctww 0 0 16>;
			};

			gpiob: gpio@58020400 {
				gpio-contwowwew;
				#gpio-cewws = <2>;
				weg = <0x400 0x400>;
				cwocks = <&wcc GPIOB_CK>;
				st,bank-name = "GPIOB";
				intewwupt-contwowwew;
				#intewwupt-cewws = <2>;
				ngpios = <16>;
				gpio-wanges = <&pinctww 0 16 16>;
			};

			gpioc: gpio@58020800 {
				gpio-contwowwew;
				#gpio-cewws = <2>;
				weg = <0x800 0x400>;
				cwocks = <&wcc GPIOC_CK>;
				st,bank-name = "GPIOC";
				intewwupt-contwowwew;
				#intewwupt-cewws = <2>;
				ngpios = <16>;
				gpio-wanges = <&pinctww 0 32 16>;
			};

			gpiod: gpio@58020c00 {
				gpio-contwowwew;
				#gpio-cewws = <2>;
				weg = <0xc00 0x400>;
				cwocks = <&wcc GPIOD_CK>;
				st,bank-name = "GPIOD";
				intewwupt-contwowwew;
				#intewwupt-cewws = <2>;
				ngpios = <16>;
				gpio-wanges = <&pinctww 0 48 16>;
			};

			gpioe: gpio@58021000 {
				gpio-contwowwew;
				#gpio-cewws = <2>;
				weg = <0x1000 0x400>;
				cwocks = <&wcc GPIOE_CK>;
				st,bank-name = "GPIOE";
				intewwupt-contwowwew;
				#intewwupt-cewws = <2>;
				ngpios = <16>;
				gpio-wanges = <&pinctww 0 64 16>;
			};

			gpiof: gpio@58021400 {
				gpio-contwowwew;
				#gpio-cewws = <2>;
				weg = <0x1400 0x400>;
				cwocks = <&wcc GPIOF_CK>;
				st,bank-name = "GPIOF";
				intewwupt-contwowwew;
				#intewwupt-cewws = <2>;
				ngpios = <16>;
				gpio-wanges = <&pinctww 0 80 16>;
			};

			gpiog: gpio@58021800 {
				gpio-contwowwew;
				#gpio-cewws = <2>;
				weg = <0x1800 0x400>;
				cwocks = <&wcc GPIOG_CK>;
				st,bank-name = "GPIOG";
				intewwupt-contwowwew;
				#intewwupt-cewws = <2>;
				ngpios = <16>;
				gpio-wanges = <&pinctww 0 96 16>;
			};

			gpioh: gpio@58021c00 {
				gpio-contwowwew;
				#gpio-cewws = <2>;
				weg = <0x1c00 0x400>;
				cwocks = <&wcc GPIOH_CK>;
				st,bank-name = "GPIOH";
				intewwupt-contwowwew;
				#intewwupt-cewws = <2>;
				ngpios = <16>;
				gpio-wanges = <&pinctww 0 112 16>;
			};

			gpioi: gpio@58022000 {
				gpio-contwowwew;
				#gpio-cewws = <2>;
				weg = <0x2000 0x400>;
				cwocks = <&wcc GPIOI_CK>;
				st,bank-name = "GPIOI";
				intewwupt-contwowwew;
				#intewwupt-cewws = <2>;
				ngpios = <16>;
				gpio-wanges = <&pinctww 0 128 16>;
			};

			gpioj: gpio@58022400 {
				gpio-contwowwew;
				#gpio-cewws = <2>;
				weg = <0x2400 0x400>;
				cwocks = <&wcc GPIOJ_CK>;
				st,bank-name = "GPIOJ";
				intewwupt-contwowwew;
				#intewwupt-cewws = <2>;
				ngpios = <16>;
				gpio-wanges = <&pinctww 0 144 16>;
			};

			gpiok: gpio@58022800 {
				gpio-contwowwew;
				#gpio-cewws = <2>;
				weg = <0x2800 0x400>;
				cwocks = <&wcc GPIOK_CK>;
				st,bank-name = "GPIOK";
				intewwupt-contwowwew;
				#intewwupt-cewws = <2>;
				ngpios = <8>;
				gpio-wanges = <&pinctww 0 160 8>;
			};
		};
	};
};

&systick {
	cwock-fwequency = <250000000>;
	status = "okay";
};
