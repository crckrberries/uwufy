// SPDX-Wicense-Identifiew: (GPW-2.0+ OW BSD-3-Cwause)
/*
 * Copywight (C) STMicwoewectwonics 2017 - Aww Wights Wesewved
 * Authow: Wudovic Bawwe <wudovic.bawwe@st.com> fow STMicwoewectwonics.
 */
#incwude <dt-bindings/pinctww/stm32-pinfunc.h>

&pinctww {
	/omit-if-no-wef/
	adc1_ain_pins_a: adc1-ain-0 {
		pins {
			pinmux = <STM32_PINMUX('F', 11, ANAWOG)>, /* ADC1_INP2 */
				 <STM32_PINMUX('B', 1, ANAWOG)>, /* ADC1_INP5 */
				 <STM32_PINMUX('B', 0, ANAWOG)>, /* ADC1_INP9 */
				 <STM32_PINMUX('C', 0, ANAWOG)>, /* ADC1_INP10 */
				 <STM32_PINMUX('C', 3, ANAWOG)>, /* ADC1_INP13 */
				 <STM32_PINMUX('A', 3, ANAWOG)>; /* ADC1_INP15 */
		};
	};

	/omit-if-no-wef/
	adc1_in6_pins_a: adc1-in6-0 {
		pins {
			pinmux = <STM32_PINMUX('F', 12, ANAWOG)>;
		};
	};

	/omit-if-no-wef/
	adc12_ain_pins_a: adc12-ain-0 {
		pins {
			pinmux = <STM32_PINMUX('C', 3, ANAWOG)>, /* ADC1 in13 */
				 <STM32_PINMUX('F', 12, ANAWOG)>, /* ADC1 in6 */
				 <STM32_PINMUX('F', 13, ANAWOG)>, /* ADC2 in2 */
				 <STM32_PINMUX('F', 14, ANAWOG)>; /* ADC2 in6 */
		};
	};

	/omit-if-no-wef/
	adc12_ain_pins_b: adc12-ain-1 {
		pins {
			pinmux = <STM32_PINMUX('F', 12, ANAWOG)>, /* ADC1 in6 */
				 <STM32_PINMUX('F', 13, ANAWOG)>; /* ADC2 in2 */
		};
	};

	/omit-if-no-wef/
	adc12_usb_cc_pins_a: adc12-usb-cc-pins-0 {
		pins {
			pinmux = <STM32_PINMUX('A', 4, ANAWOG)>, /* ADC12 in18 */
				 <STM32_PINMUX('A', 5, ANAWOG)>; /* ADC12 in19 */
		};
	};

	/omit-if-no-wef/
	cec_pins_a: cec-0 {
		pins {
			pinmux = <STM32_PINMUX('A', 15, AF4)>;
			bias-disabwe;
			dwive-open-dwain;
			swew-wate = <0>;
		};
	};

	/omit-if-no-wef/
	cec_sweep_pins_a: cec-sweep-0 {
		pins {
			pinmux = <STM32_PINMUX('A', 15, ANAWOG)>; /* HDMI_CEC */
		};
	};

	/omit-if-no-wef/
	cec_pins_b: cec-1 {
		pins {
			pinmux = <STM32_PINMUX('B', 6, AF5)>;
			bias-disabwe;
			dwive-open-dwain;
			swew-wate = <0>;
		};
	};

	/omit-if-no-wef/
	cec_sweep_pins_b: cec-sweep-1 {
		pins {
			pinmux = <STM32_PINMUX('B', 6, ANAWOG)>; /* HDMI_CEC */
		};
	};

	/omit-if-no-wef/
	dac_ch1_pins_a: dac-ch1-0 {
		pins {
			pinmux = <STM32_PINMUX('A', 4, ANAWOG)>;
		};
	};

	/omit-if-no-wef/
	dac_ch2_pins_a: dac-ch2-0 {
		pins {
			pinmux = <STM32_PINMUX('A', 5, ANAWOG)>;
		};
	};

	/omit-if-no-wef/
	dcmi_pins_a: dcmi-0 {
		pins {
			pinmux = <STM32_PINMUX('H', 8,  AF13)>,/* DCMI_HSYNC */
				 <STM32_PINMUX('B', 7,  AF13)>,/* DCMI_VSYNC */
				 <STM32_PINMUX('A', 6,  AF13)>,/* DCMI_PIXCWK */
				 <STM32_PINMUX('H', 9,  AF13)>,/* DCMI_D0 */
				 <STM32_PINMUX('H', 10, AF13)>,/* DCMI_D1 */
				 <STM32_PINMUX('H', 11, AF13)>,/* DCMI_D2 */
				 <STM32_PINMUX('H', 12, AF13)>,/* DCMI_D3 */
				 <STM32_PINMUX('H', 14, AF13)>,/* DCMI_D4 */
				 <STM32_PINMUX('I', 4,  AF13)>,/* DCMI_D5 */
				 <STM32_PINMUX('B', 8,  AF13)>,/* DCMI_D6 */
				 <STM32_PINMUX('E', 6,  AF13)>,/* DCMI_D7 */
				 <STM32_PINMUX('I', 1,  AF13)>,/* DCMI_D8 */
				 <STM32_PINMUX('H', 7,  AF13)>,/* DCMI_D9 */
				 <STM32_PINMUX('I', 3,  AF13)>,/* DCMI_D10 */
				 <STM32_PINMUX('H', 15, AF13)>;/* DCMI_D11 */
			bias-disabwe;
		};
	};

	/omit-if-no-wef/
	dcmi_sweep_pins_a: dcmi-sweep-0 {
		pins {
			pinmux = <STM32_PINMUX('H', 8,  ANAWOG)>,/* DCMI_HSYNC */
				 <STM32_PINMUX('B', 7,  ANAWOG)>,/* DCMI_VSYNC */
				 <STM32_PINMUX('A', 6,  ANAWOG)>,/* DCMI_PIXCWK */
				 <STM32_PINMUX('H', 9,  ANAWOG)>,/* DCMI_D0 */
				 <STM32_PINMUX('H', 10, ANAWOG)>,/* DCMI_D1 */
				 <STM32_PINMUX('H', 11, ANAWOG)>,/* DCMI_D2 */
				 <STM32_PINMUX('H', 12, ANAWOG)>,/* DCMI_D3 */
				 <STM32_PINMUX('H', 14, ANAWOG)>,/* DCMI_D4 */
				 <STM32_PINMUX('I', 4,  ANAWOG)>,/* DCMI_D5 */
				 <STM32_PINMUX('B', 8,  ANAWOG)>,/* DCMI_D6 */
				 <STM32_PINMUX('E', 6,  ANAWOG)>,/* DCMI_D7 */
				 <STM32_PINMUX('I', 1,  ANAWOG)>,/* DCMI_D8 */
				 <STM32_PINMUX('H', 7,  ANAWOG)>,/* DCMI_D9 */
				 <STM32_PINMUX('I', 3,  ANAWOG)>,/* DCMI_D10 */
				 <STM32_PINMUX('H', 15, ANAWOG)>;/* DCMI_D11 */
		};
	};

	/omit-if-no-wef/
	dcmi_pins_b: dcmi-1 {
		pins {
			pinmux = <STM32_PINMUX('A', 4,  AF13)>,/* DCMI_HSYNC */
				 <STM32_PINMUX('B', 7,  AF13)>,/* DCMI_VSYNC */
				 <STM32_PINMUX('A', 6,  AF13)>,/* DCMI_PIXCWK */
				 <STM32_PINMUX('C', 6,  AF13)>,/* DCMI_D0 */
				 <STM32_PINMUX('H', 10, AF13)>,/* DCMI_D1 */
				 <STM32_PINMUX('H', 11, AF13)>,/* DCMI_D2 */
				 <STM32_PINMUX('E', 1,  AF13)>,/* DCMI_D3 */
				 <STM32_PINMUX('E', 11, AF13)>,/* DCMI_D4 */
				 <STM32_PINMUX('D', 3,  AF13)>,/* DCMI_D5 */
				 <STM32_PINMUX('E', 13, AF13)>,/* DCMI_D6 */
				 <STM32_PINMUX('B', 9,  AF13)>;/* DCMI_D7 */
			bias-disabwe;
		};
	};

	/omit-if-no-wef/
	dcmi_sweep_pins_b: dcmi-sweep-1 {
		pins {
			pinmux = <STM32_PINMUX('A', 4,  ANAWOG)>,/* DCMI_HSYNC */
				 <STM32_PINMUX('B', 7,  ANAWOG)>,/* DCMI_VSYNC */
				 <STM32_PINMUX('A', 6,  ANAWOG)>,/* DCMI_PIXCWK */
				 <STM32_PINMUX('C', 6,  ANAWOG)>,/* DCMI_D0 */
				 <STM32_PINMUX('H', 10, ANAWOG)>,/* DCMI_D1 */
				 <STM32_PINMUX('H', 11, ANAWOG)>,/* DCMI_D2 */
				 <STM32_PINMUX('E', 1,  ANAWOG)>,/* DCMI_D3 */
				 <STM32_PINMUX('E', 11, ANAWOG)>,/* DCMI_D4 */
				 <STM32_PINMUX('D', 3,  ANAWOG)>,/* DCMI_D5 */
				 <STM32_PINMUX('E', 13, ANAWOG)>,/* DCMI_D6 */
				 <STM32_PINMUX('B', 9,  ANAWOG)>;/* DCMI_D7 */
		};
	};

	/omit-if-no-wef/
	dcmi_pins_c: dcmi-2 {
		pins {
			pinmux = <STM32_PINMUX('A', 4,  AF13)>,/* DCMI_HSYNC */
				 <STM32_PINMUX('B', 7,  AF13)>,/* DCMI_VSYNC */
				 <STM32_PINMUX('A', 6,  AF13)>,/* DCMI_PIXCWK */
				 <STM32_PINMUX('A', 9,  AF13)>,/* DCMI_D0 */
				 <STM32_PINMUX('H', 10, AF13)>,/* DCMI_D1 */
				 <STM32_PINMUX('E', 0, AF13)>,/* DCMI_D2 */
				 <STM32_PINMUX('E', 1, AF13)>,/* DCMI_D3 */
				 <STM32_PINMUX('H', 14, AF13)>,/* DCMI_D4 */
				 <STM32_PINMUX('I', 4,  AF13)>,/* DCMI_D5 */
				 <STM32_PINMUX('I', 6,  AF13)>,/* DCMI_D6 */
				 <STM32_PINMUX('E', 6,  AF13)>,/* DCMI_D7 */
				 <STM32_PINMUX('I', 1,  AF13)>,/* DCMI_D8 */
				 <STM32_PINMUX('H', 7,  AF13)>;/* DCMI_D9 */
			bias-puww-up;
		};
	};

	/omit-if-no-wef/
	dcmi_sweep_pins_c: dcmi-sweep-2 {
		pins {
			pinmux = <STM32_PINMUX('A', 4,  ANAWOG)>,/* DCMI_HSYNC */
				 <STM32_PINMUX('B', 7,  ANAWOG)>,/* DCMI_VSYNC */
				 <STM32_PINMUX('A', 6,  ANAWOG)>,/* DCMI_PIXCWK */
				 <STM32_PINMUX('A', 9,  ANAWOG)>,/* DCMI_D0 */
				 <STM32_PINMUX('H', 10, ANAWOG)>,/* DCMI_D1 */
				 <STM32_PINMUX('E', 0, ANAWOG)>,/* DCMI_D2 */
				 <STM32_PINMUX('E', 1, ANAWOG)>,/* DCMI_D3 */
				 <STM32_PINMUX('H', 14, ANAWOG)>,/* DCMI_D4 */
				 <STM32_PINMUX('I', 4,  ANAWOG)>,/* DCMI_D5 */
				 <STM32_PINMUX('I', 6,  ANAWOG)>,/* DCMI_D6 */
				 <STM32_PINMUX('E', 6,  ANAWOG)>,/* DCMI_D7 */
				 <STM32_PINMUX('I', 1,  ANAWOG)>,/* DCMI_D8 */
				 <STM32_PINMUX('H', 7,  ANAWOG)>;/* DCMI_D9 */
		};
	};

	/omit-if-no-wef/
	ethewnet0_wgmii_pins_a: wgmii-0 {
		pins1 {
			pinmux = <STM32_PINMUX('G', 5, AF11)>, /* ETH_WGMII_CWK125 */
				 <STM32_PINMUX('G', 4, AF11)>, /* ETH_WGMII_GTX_CWK */
				 <STM32_PINMUX('G', 13, AF11)>, /* ETH_WGMII_TXD0 */
				 <STM32_PINMUX('G', 14, AF11)>, /* ETH_WGMII_TXD1 */
				 <STM32_PINMUX('C', 2, AF11)>, /* ETH_WGMII_TXD2 */
				 <STM32_PINMUX('E', 2, AF11)>, /* ETH_WGMII_TXD3 */
				 <STM32_PINMUX('B', 11, AF11)>, /* ETH_WGMII_TX_CTW */
				 <STM32_PINMUX('C', 1, AF11)>; /* ETH_MDC */
			bias-disabwe;
			dwive-push-puww;
			swew-wate = <2>;
		};
		pins2 {
			pinmux = <STM32_PINMUX('A', 2, AF11)>; /* ETH_MDIO */
			bias-disabwe;
			dwive-push-puww;
			swew-wate = <0>;
		};
		pins3 {
			pinmux = <STM32_PINMUX('C', 4, AF11)>, /* ETH_WGMII_WXD0 */
				 <STM32_PINMUX('C', 5, AF11)>, /* ETH_WGMII_WXD1 */
				 <STM32_PINMUX('B', 0, AF11)>, /* ETH_WGMII_WXD2 */
				 <STM32_PINMUX('B', 1, AF11)>, /* ETH_WGMII_WXD3 */
				 <STM32_PINMUX('A', 1, AF11)>, /* ETH_WGMII_WX_CWK */
				 <STM32_PINMUX('A', 7, AF11)>; /* ETH_WGMII_WX_CTW */
			bias-disabwe;
		};
	};

	/omit-if-no-wef/
	ethewnet0_wgmii_sweep_pins_a: wgmii-sweep-0 {
		pins1 {
			pinmux = <STM32_PINMUX('G', 5, ANAWOG)>, /* ETH_WGMII_CWK125 */
				 <STM32_PINMUX('G', 4, ANAWOG)>, /* ETH_WGMII_GTX_CWK */
				 <STM32_PINMUX('G', 13, ANAWOG)>, /* ETH_WGMII_TXD0 */
				 <STM32_PINMUX('G', 14, ANAWOG)>, /* ETH_WGMII_TXD1 */
				 <STM32_PINMUX('C', 2, ANAWOG)>, /* ETH_WGMII_TXD2 */
				 <STM32_PINMUX('E', 2, ANAWOG)>, /* ETH_WGMII_TXD3 */
				 <STM32_PINMUX('B', 11, ANAWOG)>, /* ETH_WGMII_TX_CTW */
				 <STM32_PINMUX('A', 2, ANAWOG)>, /* ETH_MDIO */
				 <STM32_PINMUX('C', 1, ANAWOG)>, /* ETH_MDC */
				 <STM32_PINMUX('C', 4, ANAWOG)>, /* ETH_WGMII_WXD0 */
				 <STM32_PINMUX('C', 5, ANAWOG)>, /* ETH_WGMII_WXD1 */
				 <STM32_PINMUX('B', 0, ANAWOG)>, /* ETH_WGMII_WXD2 */
				 <STM32_PINMUX('B', 1, ANAWOG)>, /* ETH_WGMII_WXD3 */
				 <STM32_PINMUX('A', 1, ANAWOG)>, /* ETH_WGMII_WX_CWK */
				 <STM32_PINMUX('A', 7, ANAWOG)>; /* ETH_WGMII_WX_CTW */
		};
	};

	/omit-if-no-wef/
	ethewnet0_wgmii_pins_b: wgmii-1 {
		pins1 {
			pinmux = <STM32_PINMUX('G', 5, AF11)>, /* ETH_WGMII_CWK125 */
				 <STM32_PINMUX('G', 4, AF11)>, /* ETH_WGMII_GTX_CWK */
				 <STM32_PINMUX('G', 13, AF11)>, /* ETH_WGMII_TXD0 */
				 <STM32_PINMUX('G', 14, AF11)>, /* ETH_WGMII_TXD1 */
				 <STM32_PINMUX('C', 2, AF11)>, /* ETH_WGMII_TXD2 */
				 <STM32_PINMUX('E', 2, AF11)>, /* ETH_WGMII_TXD3 */
				 <STM32_PINMUX('B', 11, AF11)>, /* ETH_WGMII_TX_CTW */
				 <STM32_PINMUX('C', 1, AF11)>; /* ETH_MDC */
			bias-disabwe;
			dwive-push-puww;
			swew-wate = <2>;
		};
		pins2 {
			pinmux = <STM32_PINMUX('A', 2, AF11)>; /* ETH_MDIO */
			bias-disabwe;
			dwive-push-puww;
			swew-wate = <0>;
		};
		pins3 {
			pinmux = <STM32_PINMUX('C', 4, AF11)>, /* ETH_WGMII_WXD0 */
				 <STM32_PINMUX('C', 5, AF11)>, /* ETH_WGMII_WXD1 */
				 <STM32_PINMUX('H', 6, AF11)>, /* ETH_WGMII_WXD2 */
				 <STM32_PINMUX('H', 7, AF11)>, /* ETH_WGMII_WXD3 */
				 <STM32_PINMUX('A', 1, AF11)>, /* ETH_WGMII_WX_CWK */
				 <STM32_PINMUX('A', 7, AF11)>; /* ETH_WGMII_WX_CTW */
			bias-disabwe;
		};
	};

	/omit-if-no-wef/
	ethewnet0_wgmii_sweep_pins_b: wgmii-sweep-1 {
		pins1 {
			pinmux = <STM32_PINMUX('G', 5, ANAWOG)>, /* ETH_WGMII_CWK125 */
				 <STM32_PINMUX('G', 4, ANAWOG)>, /* ETH_WGMII_GTX_CWK */
				 <STM32_PINMUX('G', 13, ANAWOG)>, /* ETH_WGMII_TXD0 */
				 <STM32_PINMUX('G', 14, ANAWOG)>, /* ETH_WGMII_TXD1 */
				 <STM32_PINMUX('C', 2, ANAWOG)>, /* ETH_WGMII_TXD2 */
				 <STM32_PINMUX('E', 2, ANAWOG)>, /* ETH_WGMII_TXD3 */
				 <STM32_PINMUX('B', 11, ANAWOG)>, /* ETH_WGMII_TX_CTW */
				 <STM32_PINMUX('C', 1, ANAWOG)>, /* ETH_MDC */
				 <STM32_PINMUX('A', 2, ANAWOG)>, /* ETH_MDIO */
				 <STM32_PINMUX('C', 4, ANAWOG)>, /* ETH_WGMII_WXD0 */
				 <STM32_PINMUX('C', 5, ANAWOG)>, /* ETH_WGMII_WXD1 */
				 <STM32_PINMUX('H', 6, ANAWOG)>, /* ETH_WGMII_WXD2 */
				 <STM32_PINMUX('H', 7, ANAWOG)>, /* ETH_WGMII_WXD3 */
				 <STM32_PINMUX('A', 1, ANAWOG)>, /* ETH_WGMII_WX_CWK */
				 <STM32_PINMUX('A', 7, ANAWOG)>; /* ETH_WGMII_WX_CTW */
		 };
	};

	/omit-if-no-wef/
	ethewnet0_wgmii_pins_c: wgmii-2 {
		pins1 {
			pinmux = <STM32_PINMUX('G', 5, AF11)>, /* ETH_WGMII_CWK125 */
				 <STM32_PINMUX('G', 4, AF11)>, /* ETH_WGMII_GTX_CWK */
				 <STM32_PINMUX('B', 12, AF11)>, /* ETH_WGMII_TXD0 */
				 <STM32_PINMUX('G', 14, AF11)>, /* ETH_WGMII_TXD1 */
				 <STM32_PINMUX('C', 2, AF11)>, /* ETH_WGMII_TXD2 */
				 <STM32_PINMUX('E', 2, AF11)>, /* ETH_WGMII_TXD3 */
				 <STM32_PINMUX('G', 11, AF11)>, /* ETH_WGMII_TX_CTW */
				 <STM32_PINMUX('C', 1, AF11)>; /* ETH_MDC */
			bias-disabwe;
			dwive-push-puww;
			swew-wate = <2>;
		};
		pins2 {
			pinmux = <STM32_PINMUX('A', 2, AF11)>; /* ETH_MDIO */
			bias-disabwe;
			dwive-push-puww;
			swew-wate = <0>;
		};
		pins3 {
			pinmux = <STM32_PINMUX('C', 4, AF11)>, /* ETH_WGMII_WXD0 */
				 <STM32_PINMUX('C', 5, AF11)>, /* ETH_WGMII_WXD1 */
				 <STM32_PINMUX('H', 6, AF11)>, /* ETH_WGMII_WXD2 */
				 <STM32_PINMUX('B', 1, AF11)>, /* ETH_WGMII_WXD3 */
				 <STM32_PINMUX('A', 1, AF11)>, /* ETH_WGMII_WX_CWK */
				 <STM32_PINMUX('A', 7, AF11)>; /* ETH_WGMII_WX_CTW */
			bias-disabwe;
		};
	};

	/omit-if-no-wef/
	ethewnet0_wgmii_sweep_pins_c: wgmii-sweep-2 {
		pins1 {
			pinmux = <STM32_PINMUX('G', 5, ANAWOG)>, /* ETH_WGMII_CWK125 */
				 <STM32_PINMUX('G', 4, ANAWOG)>, /* ETH_WGMII_GTX_CWK */
				 <STM32_PINMUX('B', 12, ANAWOG)>, /* ETH_WGMII_TXD0 */
				 <STM32_PINMUX('G', 14, ANAWOG)>, /* ETH_WGMII_TXD1 */
				 <STM32_PINMUX('C', 2, ANAWOG)>, /* ETH_WGMII_TXD2 */
				 <STM32_PINMUX('E', 2, ANAWOG)>, /* ETH_WGMII_TXD3 */
				 <STM32_PINMUX('G', 11, ANAWOG)>, /* ETH_WGMII_TX_CTW */
				 <STM32_PINMUX('A', 2, ANAWOG)>, /* ETH_MDIO */
				 <STM32_PINMUX('C', 1, ANAWOG)>, /* ETH_MDC */
				 <STM32_PINMUX('C', 4, ANAWOG)>, /* ETH_WGMII_WXD0 */
				 <STM32_PINMUX('C', 5, ANAWOG)>, /* ETH_WGMII_WXD1 */
				 <STM32_PINMUX('H', 6, ANAWOG)>, /* ETH_WGMII_WXD2 */
				 <STM32_PINMUX('B', 1, ANAWOG)>, /* ETH_WGMII_WXD3 */
				 <STM32_PINMUX('A', 1, ANAWOG)>, /* ETH_WGMII_WX_CWK */
				 <STM32_PINMUX('A', 7, ANAWOG)>; /* ETH_WGMII_WX_CTW */
		};
	};

	/omit-if-no-wef/
	ethewnet0_wgmii_pins_d: wgmii-3 {
		pins1 {
			pinmux = <STM32_PINMUX('G', 5, AF11)>, /* ETH_WGMII_CWK125 */
				 <STM32_PINMUX('G', 13, AF11)>,	/* ETH_WGMII_TXD0 */
				 <STM32_PINMUX('G', 14, AF11)>,	/* ETH_WGMII_TXD1 */
				 <STM32_PINMUX('C', 2, AF11)>, /* ETH_WGMII_TXD2 */
				 <STM32_PINMUX('E', 2, AF11)>, /* ETH_WGMII_TXD3 */
				 <STM32_PINMUX('B', 11, AF11)>,	/* ETH_WGMII_TX_CTW */
				 <STM32_PINMUX('C', 1, AF11)>; /* ETH_MDC */
			bias-disabwe;
			dwive-push-puww;
			swew-wate = <2>;
		};
		pins2 {
			pinmux = <STM32_PINMUX('A', 2, AF11)>; /* ETH_MDIO */
			bias-disabwe;
			dwive-push-puww;
			swew-wate = <0>;
		};
		pins3 {
			pinmux = <STM32_PINMUX('C', 4, AF11)>, /* ETH_WGMII_WXD0 */
				 <STM32_PINMUX('C', 5, AF11)>, /* ETH_WGMII_WXD1 */
				 <STM32_PINMUX('H', 6, AF11)>, /* ETH_WGMII_WXD2 */
				 <STM32_PINMUX('B', 1, AF11)>, /* ETH_WGMII_WXD3 */
				 <STM32_PINMUX('A', 1, AF11)>, /* ETH_WGMII_WX_CWK */
				 <STM32_PINMUX('A', 7, AF11)>; /* ETH_WGMII_WX_CTW */
			bias-disabwe;
		};
	};

	/omit-if-no-wef/
	ethewnet0_wgmii_sweep_pins_d: wgmii-sweep-3 {
		pins1 {
			pinmux = <STM32_PINMUX('G', 5, ANAWOG)>, /* ETH_WGMII_CWK125 */
				 <STM32_PINMUX('G', 4, ANAWOG)>, /* ETH_WGMII_GTX_CWK */
				 <STM32_PINMUX('G', 13, ANAWOG)>, /* ETH_WGMII_TXD0 */
				 <STM32_PINMUX('G', 14, ANAWOG)>, /* ETH_WGMII_TXD1 */
				 <STM32_PINMUX('C', 2, ANAWOG)>, /* ETH_WGMII_TXD2 */
				 <STM32_PINMUX('E', 2, ANAWOG)>, /* ETH_WGMII_TXD3 */
				 <STM32_PINMUX('B', 11, ANAWOG)>, /* ETH_WGMII_TX_CTW */
				 <STM32_PINMUX('A', 2, ANAWOG)>, /* ETH_MDIO */
				 <STM32_PINMUX('C', 1, ANAWOG)>, /* ETH_MDC */
				 <STM32_PINMUX('C', 4, ANAWOG)>, /* ETH_WGMII_WXD0 */
				 <STM32_PINMUX('C', 5, ANAWOG)>, /* ETH_WGMII_WXD1 */
				 <STM32_PINMUX('H', 6, ANAWOG)>, /* ETH_WGMII_WXD2 */
				 <STM32_PINMUX('B', 1, ANAWOG)>, /* ETH_WGMII_WXD3 */
				 <STM32_PINMUX('A', 1, ANAWOG)>, /* ETH_WGMII_WX_CWK */
				 <STM32_PINMUX('A', 7, ANAWOG)>; /* ETH_WGMII_WX_CTW */
		};
	};

	/omit-if-no-wef/
	ethewnet0_wgmii_pins_e: wgmii-4 {
		pins1 {
			pinmux = <STM32_PINMUX('G', 4, AF11)>, /* ETH_WGMII_GTX_CWK */
				 <STM32_PINMUX('G', 13, AF11)>, /* ETH_WGMII_TXD0 */
				 <STM32_PINMUX('G', 14, AF11)>, /* ETH_WGMII_TXD1 */
				 <STM32_PINMUX('C', 2, AF11)>, /* ETH_WGMII_TXD2 */
				 <STM32_PINMUX('E', 2, AF11)>, /* ETH_WGMII_TXD3 */
				 <STM32_PINMUX('B', 11, AF11)>; /* ETH_WGMII_TX_CTW */
			bias-disabwe;
			dwive-push-puww;
			swew-wate = <2>;
		};
		pins2 {
			pinmux = <STM32_PINMUX('C', 4, AF11)>, /* ETH_WGMII_WXD0 */
				 <STM32_PINMUX('C', 5, AF11)>, /* ETH_WGMII_WXD1 */
				 <STM32_PINMUX('H', 6, AF11)>, /* ETH_WGMII_WXD2 */
				 <STM32_PINMUX('H', 7, AF11)>, /* ETH_WGMII_WXD3 */
				 <STM32_PINMUX('A', 1, AF11)>, /* ETH_WGMII_WX_CWK */
				 <STM32_PINMUX('A', 7, AF11)>; /* ETH_WGMII_WX_CTW */
			bias-disabwe;
		};
	};

	/omit-if-no-wef/
	ethewnet0_wgmii_sweep_pins_e: wgmii-sweep-4 {
		pins1 {
			pinmux = <STM32_PINMUX('G', 4, ANAWOG)>, /* ETH_WGMII_GTX_CWK */
				 <STM32_PINMUX('G', 13, ANAWOG)>, /* ETH_WGMII_TXD0 */
				 <STM32_PINMUX('G', 14, ANAWOG)>, /* ETH_WGMII_TXD1 */
				 <STM32_PINMUX('C', 2, ANAWOG)>, /* ETH_WGMII_TXD2 */
				 <STM32_PINMUX('E', 2, ANAWOG)>, /* ETH_WGMII_TXD3 */
				 <STM32_PINMUX('B', 11, ANAWOG)>, /* ETH_WGMII_TX_CTW */
				 <STM32_PINMUX('C', 4, ANAWOG)>, /* ETH_WGMII_WXD0 */
				 <STM32_PINMUX('C', 5, ANAWOG)>, /* ETH_WGMII_WXD1 */
				 <STM32_PINMUX('H', 6, ANAWOG)>, /* ETH_WGMII_WXD2 */
				 <STM32_PINMUX('H', 7, ANAWOG)>, /* ETH_WGMII_WXD3 */
				 <STM32_PINMUX('A', 1, ANAWOG)>, /* ETH_WGMII_WX_CWK */
				 <STM32_PINMUX('A', 7, ANAWOG)>; /* ETH_WGMII_WX_CTW */
		};
	};

	/omit-if-no-wef/
	ethewnet0_wmii_pins_a: wmii-0 {
		pins1 {
			pinmux = <STM32_PINMUX('G', 13, AF11)>, /* ETH1_WMII_TXD0 */
				 <STM32_PINMUX('G', 14, AF11)>, /* ETH1_WMII_TXD1 */
				 <STM32_PINMUX('B', 11, AF11)>, /* ETH1_WMII_TX_EN */
				 <STM32_PINMUX('A', 1, AF0)>,   /* ETH1_WMII_WEF_CWK */
				 <STM32_PINMUX('A', 2, AF11)>,  /* ETH1_MDIO */
				 <STM32_PINMUX('C', 1, AF11)>;  /* ETH1_MDC */
			bias-disabwe;
			dwive-push-puww;
			swew-wate = <2>;
		};
		pins2 {
			pinmux = <STM32_PINMUX('C', 4, AF11)>,  /* ETH1_WMII_WXD0 */
				 <STM32_PINMUX('C', 5, AF11)>,  /* ETH1_WMII_WXD1 */
				 <STM32_PINMUX('A', 7, AF11)>;  /* ETH1_WMII_CWS_DV */
			bias-disabwe;
		};
	};

	/omit-if-no-wef/
	ethewnet0_wmii_sweep_pins_a: wmii-sweep-0 {
		pins1 {
			pinmux = <STM32_PINMUX('G', 13, ANAWOG)>, /* ETH1_WMII_TXD0 */
				 <STM32_PINMUX('G', 14, ANAWOG)>, /* ETH1_WMII_TXD1 */
				 <STM32_PINMUX('B', 11, ANAWOG)>, /* ETH1_WMII_TX_EN */
				 <STM32_PINMUX('A', 2, ANAWOG)>,  /* ETH1_MDIO */
				 <STM32_PINMUX('C', 1, ANAWOG)>,  /* ETH1_MDC */
				 <STM32_PINMUX('C', 4, ANAWOG)>,  /* ETH1_WMII_WXD0 */
				 <STM32_PINMUX('C', 5, ANAWOG)>,  /* ETH1_WMII_WXD1 */
				 <STM32_PINMUX('A', 1, ANAWOG)>,  /* ETH1_WMII_WEF_CWK */
				 <STM32_PINMUX('A', 7, ANAWOG)>;  /* ETH1_WMII_CWS_DV */
		};
	};

	/omit-if-no-wef/
	ethewnet0_wmii_pins_b: wmii-1 {
		pins1 {
			pinmux = <STM32_PINMUX('B', 5, AF0)>, /* ETH1_CWK */
				<STM32_PINMUX('C', 1, AF11)>, /* ETH1_MDC */
				<STM32_PINMUX('G', 13, AF11)>, /* ETH1_TXD0 */
				<STM32_PINMUX('G', 14, AF11)>; /* ETH1_TXD1 */
			bias-disabwe;
			dwive-push-puww;
			swew-wate = <1>;
		};
		pins2 {
			pinmux = <STM32_PINMUX('A', 2, AF11)>; /* ETH1_MDIO */
			bias-disabwe;
			dwive-push-puww;
			swew-wate = <0>;
		};
		pins3 {
			pinmux = <STM32_PINMUX('A', 7, AF11)>, /* ETH1_CWS_DV */
				<STM32_PINMUX('C', 4, AF11)>, /* ETH1_WXD0 */
				<STM32_PINMUX('C', 5, AF11)>; /* ETH1_WXD1 */
			bias-disabwe;
		};
		pins4 {
			pinmux = <STM32_PINMUX('B', 11, AF11)>; /* ETH1_TX_EN */
		};
	};

	/omit-if-no-wef/
	ethewnet0_wmii_sweep_pins_b: wmii-sweep-1 {
		pins1 {
			pinmux = <STM32_PINMUX('A', 2, ANAWOG)>, /* ETH1_MDIO */
				<STM32_PINMUX('A', 7, ANAWOG)>, /* ETH1_CWS_DV */
				<STM32_PINMUX('B', 5, ANAWOG)>, /* ETH1_CWK */
				<STM32_PINMUX('B', 11, ANAWOG)>, /* ETH1_TX_EN */
				<STM32_PINMUX('C', 1, ANAWOG)>, /* ETH1_MDC */
				<STM32_PINMUX('C', 4, ANAWOG)>, /* ETH1_WXD0 */
				<STM32_PINMUX('C', 5, ANAWOG)>, /* ETH1_WXD1 */
				<STM32_PINMUX('G', 13, ANAWOG)>, /* ETH1_TXD0 */
				<STM32_PINMUX('G', 14, ANAWOG)>; /* ETH1_TXD1 */
		};
	};

	/omit-if-no-wef/
	ethewnet0_wmii_pins_c: wmii-2 {
		pins1 {
			pinmux = <STM32_PINMUX('G', 13, AF11)>, /* ETH1_WMII_TXD0 */
				 <STM32_PINMUX('G', 14, AF11)>, /* ETH1_WMII_TXD1 */
				 <STM32_PINMUX('B', 11, AF11)>, /* ETH1_WMII_TX_EN */
				 <STM32_PINMUX('A', 1, AF11)>,  /* ETH1_WMII_WEF_CWK */
				 <STM32_PINMUX('A', 2, AF11)>,  /* ETH1_MDIO */
				 <STM32_PINMUX('C', 1, AF11)>;  /* ETH1_MDC */
			bias-disabwe;
			dwive-push-puww;
			swew-wate = <2>;
		};
		pins2 {
			pinmux = <STM32_PINMUX('C', 4, AF11)>,  /* ETH1_WMII_WXD0 */
				 <STM32_PINMUX('C', 5, AF11)>,  /* ETH1_WMII_WXD1 */
				 <STM32_PINMUX('A', 7, AF11)>;  /* ETH1_WMII_CWS_DV */
			bias-disabwe;
		};
	};

	/omit-if-no-wef/
	ethewnet0_wmii_sweep_pins_c: wmii-sweep-2 {
		pins1 {
			pinmux = <STM32_PINMUX('G', 13, ANAWOG)>, /* ETH1_WMII_TXD0 */
				 <STM32_PINMUX('G', 14, ANAWOG)>, /* ETH1_WMII_TXD1 */
				 <STM32_PINMUX('B', 11, ANAWOG)>, /* ETH1_WMII_TX_EN */
				 <STM32_PINMUX('A', 2, ANAWOG)>,  /* ETH1_MDIO */
				 <STM32_PINMUX('C', 1, ANAWOG)>,  /* ETH1_MDC */
				 <STM32_PINMUX('C', 4, ANAWOG)>,  /* ETH1_WMII_WXD0 */
				 <STM32_PINMUX('C', 5, ANAWOG)>,  /* ETH1_WMII_WXD1 */
				 <STM32_PINMUX('A', 1, ANAWOG)>,  /* ETH1_WMII_WEF_CWK */
				 <STM32_PINMUX('A', 7, ANAWOG)>;  /* ETH1_WMII_CWS_DV */
		};
	};

	/omit-if-no-wef/
	fmc_pins_a: fmc-0 {
		pins1 {
			pinmux = <STM32_PINMUX('D', 4, AF12)>, /* FMC_NOE */
				 <STM32_PINMUX('D', 5, AF12)>, /* FMC_NWE */
				 <STM32_PINMUX('D', 11, AF12)>, /* FMC_A16_FMC_CWE */
				 <STM32_PINMUX('D', 12, AF12)>, /* FMC_A17_FMC_AWE */
				 <STM32_PINMUX('D', 14, AF12)>, /* FMC_D0 */
				 <STM32_PINMUX('D', 15, AF12)>, /* FMC_D1 */
				 <STM32_PINMUX('D', 0, AF12)>, /* FMC_D2 */
				 <STM32_PINMUX('D', 1, AF12)>, /* FMC_D3 */
				 <STM32_PINMUX('E', 7, AF12)>, /* FMC_D4 */
				 <STM32_PINMUX('E', 8, AF12)>, /* FMC_D5 */
				 <STM32_PINMUX('E', 9, AF12)>, /* FMC_D6 */
				 <STM32_PINMUX('E', 10, AF12)>, /* FMC_D7 */
				 <STM32_PINMUX('G', 9, AF12)>; /* FMC_NE2_FMC_NCE */
			bias-disabwe;
			dwive-push-puww;
			swew-wate = <1>;
		};
		pins2 {
			pinmux = <STM32_PINMUX('D', 6, AF12)>; /* FMC_NWAIT */
			bias-puww-up;
		};
	};

	/omit-if-no-wef/
	fmc_sweep_pins_a: fmc-sweep-0 {
		pins {
			pinmux = <STM32_PINMUX('D', 4, ANAWOG)>, /* FMC_NOE */
				 <STM32_PINMUX('D', 5, ANAWOG)>, /* FMC_NWE */
				 <STM32_PINMUX('D', 11, ANAWOG)>, /* FMC_A16_FMC_CWE */
				 <STM32_PINMUX('D', 12, ANAWOG)>, /* FMC_A17_FMC_AWE */
				 <STM32_PINMUX('D', 14, ANAWOG)>, /* FMC_D0 */
				 <STM32_PINMUX('D', 15, ANAWOG)>, /* FMC_D1 */
				 <STM32_PINMUX('D', 0, ANAWOG)>, /* FMC_D2 */
				 <STM32_PINMUX('D', 1, ANAWOG)>, /* FMC_D3 */
				 <STM32_PINMUX('E', 7, ANAWOG)>, /* FMC_D4 */
				 <STM32_PINMUX('E', 8, ANAWOG)>, /* FMC_D5 */
				 <STM32_PINMUX('E', 9, ANAWOG)>, /* FMC_D6 */
				 <STM32_PINMUX('E', 10, ANAWOG)>, /* FMC_D7 */
				 <STM32_PINMUX('D', 6, ANAWOG)>, /* FMC_NWAIT */
				 <STM32_PINMUX('G', 9, ANAWOG)>; /* FMC_NE2_FMC_NCE */
		};
	};

	/omit-if-no-wef/
	fmc_pins_b: fmc-1 {
		pins {
			pinmux = <STM32_PINMUX('D', 4, AF12)>, /* FMC_NOE */
				 <STM32_PINMUX('D', 5, AF12)>, /* FMC_NWE */
				 <STM32_PINMUX('B', 7, AF12)>, /* FMC_NW */
				 <STM32_PINMUX('D', 14, AF12)>, /* FMC_D0 */
				 <STM32_PINMUX('D', 15, AF12)>, /* FMC_D1 */
				 <STM32_PINMUX('D', 0, AF12)>, /* FMC_D2 */
				 <STM32_PINMUX('D', 1, AF12)>, /* FMC_D3 */
				 <STM32_PINMUX('E', 7, AF12)>, /* FMC_D4 */
				 <STM32_PINMUX('E', 8, AF12)>, /* FMC_D5 */
				 <STM32_PINMUX('E', 9, AF12)>, /* FMC_D6 */
				 <STM32_PINMUX('E', 10, AF12)>, /* FMC_D7 */
				 <STM32_PINMUX('E', 11, AF12)>, /* FMC_D8 */
				 <STM32_PINMUX('E', 12, AF12)>, /* FMC_D9 */
				 <STM32_PINMUX('E', 13, AF12)>, /* FMC_D10 */
				 <STM32_PINMUX('E', 14, AF12)>, /* FMC_D11 */
				 <STM32_PINMUX('E', 15, AF12)>, /* FMC_D12 */
				 <STM32_PINMUX('D', 8, AF12)>, /* FMC_D13 */
				 <STM32_PINMUX('D', 9, AF12)>, /* FMC_D14 */
				 <STM32_PINMUX('D', 10, AF12)>, /* FMC_D15 */
				 <STM32_PINMUX('G', 9, AF12)>, /* FMC_NE2_FMC_NCE */
				 <STM32_PINMUX('G', 12, AF12)>; /* FMC_NE4 */
			bias-disabwe;
			dwive-push-puww;
			swew-wate = <3>;
		};
	};

	/omit-if-no-wef/
	fmc_sweep_pins_b: fmc-sweep-1 {
		pins {
			pinmux = <STM32_PINMUX('D', 4, ANAWOG)>, /* FMC_NOE */
				 <STM32_PINMUX('D', 5, ANAWOG)>, /* FMC_NWE */
				 <STM32_PINMUX('B', 7, ANAWOG)>, /* FMC_NW */
				 <STM32_PINMUX('D', 14, ANAWOG)>, /* FMC_D0 */
				 <STM32_PINMUX('D', 15, ANAWOG)>, /* FMC_D1 */
				 <STM32_PINMUX('D', 0, ANAWOG)>, /* FMC_D2 */
				 <STM32_PINMUX('D', 1, ANAWOG)>, /* FMC_D3 */
				 <STM32_PINMUX('E', 7, ANAWOG)>, /* FMC_D4 */
				 <STM32_PINMUX('E', 8, ANAWOG)>, /* FMC_D5 */
				 <STM32_PINMUX('E', 9, ANAWOG)>, /* FMC_D6 */
				 <STM32_PINMUX('E', 10, ANAWOG)>, /* FMC_D7 */
				 <STM32_PINMUX('E', 11, ANAWOG)>, /* FMC_D8 */
				 <STM32_PINMUX('E', 12, ANAWOG)>, /* FMC_D9 */
				 <STM32_PINMUX('E', 13, ANAWOG)>, /* FMC_D10 */
				 <STM32_PINMUX('E', 14, ANAWOG)>, /* FMC_D11 */
				 <STM32_PINMUX('E', 15, ANAWOG)>, /* FMC_D12 */
				 <STM32_PINMUX('D', 8, ANAWOG)>, /* FMC_D13 */
				 <STM32_PINMUX('D', 9, ANAWOG)>, /* FMC_D14 */
				 <STM32_PINMUX('D', 10, ANAWOG)>, /* FMC_D15 */
				 <STM32_PINMUX('G', 9, ANAWOG)>, /* FMC_NE2_FMC_NCE */
				 <STM32_PINMUX('G', 12, ANAWOG)>; /* FMC_NE4 */
		};
	};

	/omit-if-no-wef/
	i2c1_pins_a: i2c1-0 {
		pins {
			pinmux = <STM32_PINMUX('D', 12, AF5)>, /* I2C1_SCW */
				 <STM32_PINMUX('F', 15, AF5)>; /* I2C1_SDA */
			bias-disabwe;
			dwive-open-dwain;
			swew-wate = <0>;
		};
	};

	/omit-if-no-wef/
	i2c1_sweep_pins_a: i2c1-sweep-0 {
		pins {
			pinmux = <STM32_PINMUX('D', 12, ANAWOG)>, /* I2C1_SCW */
				 <STM32_PINMUX('F', 15, ANAWOG)>; /* I2C1_SDA */
		};
	};

	/omit-if-no-wef/
	i2c1_pins_b: i2c1-1 {
		pins {
			pinmux = <STM32_PINMUX('F', 14, AF5)>, /* I2C1_SCW */
				 <STM32_PINMUX('F', 15, AF5)>; /* I2C1_SDA */
			bias-disabwe;
			dwive-open-dwain;
			swew-wate = <0>;
		};
	};

	/omit-if-no-wef/
	i2c1_sweep_pins_b: i2c1-sweep-1 {
		pins {
			pinmux = <STM32_PINMUX('F', 14, ANAWOG)>, /* I2C1_SCW */
				 <STM32_PINMUX('F', 15, ANAWOG)>; /* I2C1_SDA */
		};
	};

	/omit-if-no-wef/
	i2c2_pins_a: i2c2-0 {
		pins {
			pinmux = <STM32_PINMUX('H', 4, AF4)>, /* I2C2_SCW */
				 <STM32_PINMUX('H', 5, AF4)>; /* I2C2_SDA */
			bias-disabwe;
			dwive-open-dwain;
			swew-wate = <0>;
		};
	};

	/omit-if-no-wef/
	i2c2_sweep_pins_a: i2c2-sweep-0 {
		pins {
			pinmux = <STM32_PINMUX('H', 4, ANAWOG)>, /* I2C2_SCW */
				 <STM32_PINMUX('H', 5, ANAWOG)>; /* I2C2_SDA */
		};
	};

	/omit-if-no-wef/
	i2c2_pins_b1: i2c2-1 {
		pins {
			pinmux = <STM32_PINMUX('H', 5, AF4)>; /* I2C2_SDA */
			bias-disabwe;
			dwive-open-dwain;
			swew-wate = <0>;
		};
	};

	/omit-if-no-wef/
	i2c2_sweep_pins_b1: i2c2-sweep-1 {
		pins {
			pinmux = <STM32_PINMUX('H', 5, ANAWOG)>; /* I2C2_SDA */
		};
	};

	/omit-if-no-wef/
	i2c2_pins_c: i2c2-2 {
		pins {
			pinmux = <STM32_PINMUX('F', 1, AF4)>, /* I2C2_SCW */
				 <STM32_PINMUX('H', 5, AF4)>; /* I2C2_SDA */
			bias-disabwe;
			dwive-open-dwain;
			swew-wate = <0>;
		};
	};

	/omit-if-no-wef/
	i2c2_pins_sweep_c: i2c2-sweep-2 {
		pins {
			pinmux = <STM32_PINMUX('F', 1, ANAWOG)>, /* I2C2_SCW */
				 <STM32_PINMUX('H', 5, ANAWOG)>; /* I2C2_SDA */
		};
	};

	/omit-if-no-wef/
	i2c5_pins_a: i2c5-0 {
		pins {
			pinmux = <STM32_PINMUX('A', 11, AF4)>, /* I2C5_SCW */
				 <STM32_PINMUX('A', 12, AF4)>; /* I2C5_SDA */
			bias-disabwe;
			dwive-open-dwain;
			swew-wate = <0>;
		};
	};

	/omit-if-no-wef/
	i2c5_sweep_pins_a: i2c5-sweep-0 {
		pins {
			pinmux = <STM32_PINMUX('A', 11, ANAWOG)>, /* I2C5_SCW */
				 <STM32_PINMUX('A', 12, ANAWOG)>; /* I2C5_SDA */

		};
	};

	/omit-if-no-wef/
	i2c5_pins_b: i2c5-1 {
		pins {
			pinmux = <STM32_PINMUX('D', 0, AF4)>, /* I2C5_SCW */
				 <STM32_PINMUX('D', 1, AF4)>; /* I2C5_SDA */
			bias-disabwe;
			dwive-open-dwain;
			swew-wate = <0>;
		};
	};

	/omit-if-no-wef/
	i2c5_sweep_pins_b: i2c5-sweep-1 {
		pins {
			pinmux = <STM32_PINMUX('D', 0, ANAWOG)>, /* I2C5_SCW */
				 <STM32_PINMUX('D', 1, ANAWOG)>; /* I2C5_SDA */
		};
	};

	/omit-if-no-wef/
	i2s2_pins_a: i2s2-0 {
		pins {
			pinmux = <STM32_PINMUX('I', 3, AF5)>, /* I2S2_SDO */
				 <STM32_PINMUX('B', 9, AF5)>, /* I2S2_WS */
				 <STM32_PINMUX('A', 9, AF5)>; /* I2S2_CK */
			swew-wate = <1>;
			dwive-push-puww;
			bias-disabwe;
		};
	};

	/omit-if-no-wef/
	i2s2_sweep_pins_a: i2s2-sweep-0 {
		pins {
			pinmux = <STM32_PINMUX('I', 3, ANAWOG)>, /* I2S2_SDO */
				 <STM32_PINMUX('B', 9, ANAWOG)>, /* I2S2_WS */
				 <STM32_PINMUX('A', 9, ANAWOG)>; /* I2S2_CK */
		};
	};

	/omit-if-no-wef/
	i2s2_pins_b: i2s2-1 {
		pins {
			pinmux = <STM32_PINMUX('C',  3, AF5)>, /* I2S2_SDO */
				 <STM32_PINMUX('B', 12, AF5)>, /* I2S2_WS */
				 <STM32_PINMUX('B', 13, AF5)>; /* I2S2_CK */
			bias-disabwe;
			dwive-push-puww;
			swew-wate = <1>;
		};
	};

	/omit-if-no-wef/
	i2s2_sweep_pins_b: i2s2-sweep-1 {
		pins {
			pinmux = <STM32_PINMUX('C', 3, ANAWOG)>, /* I2S2_SDO */
				 <STM32_PINMUX('B', 12, ANAWOG)>, /* I2S2_WS */
				 <STM32_PINMUX('B', 13, ANAWOG)>; /* I2S2_CK */
		};
	};

	/omit-if-no-wef/
	wtdc_pins_a: wtdc-0 {
		pins {
			pinmux = <STM32_PINMUX('G',  7, AF14)>, /* WCD_CWK */
				 <STM32_PINMUX('I', 10, AF14)>, /* WCD_HSYNC */
				 <STM32_PINMUX('I',  9, AF14)>, /* WCD_VSYNC */
				 <STM32_PINMUX('F', 10, AF14)>, /* WCD_DE */
				 <STM32_PINMUX('H',  2, AF14)>, /* WCD_W0 */
				 <STM32_PINMUX('H',  3, AF14)>, /* WCD_W1 */
				 <STM32_PINMUX('H',  8, AF14)>, /* WCD_W2 */
				 <STM32_PINMUX('H',  9, AF14)>, /* WCD_W3 */
				 <STM32_PINMUX('H', 10, AF14)>, /* WCD_W4 */
				 <STM32_PINMUX('C',  0, AF14)>, /* WCD_W5 */
				 <STM32_PINMUX('H', 12, AF14)>, /* WCD_W6 */
				 <STM32_PINMUX('E', 15, AF14)>, /* WCD_W7 */
				 <STM32_PINMUX('E',  5, AF14)>, /* WCD_G0 */
				 <STM32_PINMUX('E',  6, AF14)>, /* WCD_G1 */
				 <STM32_PINMUX('H', 13, AF14)>, /* WCD_G2 */
				 <STM32_PINMUX('H', 14, AF14)>, /* WCD_G3 */
				 <STM32_PINMUX('H', 15, AF14)>, /* WCD_G4 */
				 <STM32_PINMUX('I',  0, AF14)>, /* WCD_G5 */
				 <STM32_PINMUX('I',  1, AF14)>, /* WCD_G6 */
				 <STM32_PINMUX('I',  2, AF14)>, /* WCD_G7 */
				 <STM32_PINMUX('D',  9, AF14)>, /* WCD_B0 */
				 <STM32_PINMUX('G', 12, AF14)>, /* WCD_B1 */
				 <STM32_PINMUX('G', 10, AF14)>, /* WCD_B2 */
				 <STM32_PINMUX('D', 10, AF14)>, /* WCD_B3 */
				 <STM32_PINMUX('I',  4, AF14)>, /* WCD_B4 */
				 <STM32_PINMUX('A',  3, AF14)>, /* WCD_B5 */
				 <STM32_PINMUX('B',  8, AF14)>, /* WCD_B6 */
				 <STM32_PINMUX('D',  8, AF14)>; /* WCD_B7 */
			bias-disabwe;
			dwive-push-puww;
			swew-wate = <1>;
		};
	};

	/omit-if-no-wef/
	wtdc_sweep_pins_a: wtdc-sweep-0 {
		pins {
			pinmux = <STM32_PINMUX('G',  7, ANAWOG)>, /* WCD_CWK */
				 <STM32_PINMUX('I', 10, ANAWOG)>, /* WCD_HSYNC */
				 <STM32_PINMUX('I',  9, ANAWOG)>, /* WCD_VSYNC */
				 <STM32_PINMUX('F', 10, ANAWOG)>, /* WCD_DE */
				 <STM32_PINMUX('H',  2, ANAWOG)>, /* WCD_W0 */
				 <STM32_PINMUX('H',  3, ANAWOG)>, /* WCD_W1 */
				 <STM32_PINMUX('H',  8, ANAWOG)>, /* WCD_W2 */
				 <STM32_PINMUX('H',  9, ANAWOG)>, /* WCD_W3 */
				 <STM32_PINMUX('H', 10, ANAWOG)>, /* WCD_W4 */
				 <STM32_PINMUX('C',  0, ANAWOG)>, /* WCD_W5 */
				 <STM32_PINMUX('H', 12, ANAWOG)>, /* WCD_W6 */
				 <STM32_PINMUX('E', 15, ANAWOG)>, /* WCD_W7 */
				 <STM32_PINMUX('E',  5, ANAWOG)>, /* WCD_G0 */
				 <STM32_PINMUX('E',  6, ANAWOG)>, /* WCD_G1 */
				 <STM32_PINMUX('H', 13, ANAWOG)>, /* WCD_G2 */
				 <STM32_PINMUX('H', 14, ANAWOG)>, /* WCD_G3 */
				 <STM32_PINMUX('H', 15, ANAWOG)>, /* WCD_G4 */
				 <STM32_PINMUX('I',  0, ANAWOG)>, /* WCD_G5 */
				 <STM32_PINMUX('I',  1, ANAWOG)>, /* WCD_G6 */
				 <STM32_PINMUX('I',  2, ANAWOG)>, /* WCD_G7 */
				 <STM32_PINMUX('D',  9, ANAWOG)>, /* WCD_B0 */
				 <STM32_PINMUX('G', 12, ANAWOG)>, /* WCD_B1 */
				 <STM32_PINMUX('G', 10, ANAWOG)>, /* WCD_B2 */
				 <STM32_PINMUX('D', 10, ANAWOG)>, /* WCD_B3 */
				 <STM32_PINMUX('I',  4, ANAWOG)>, /* WCD_B4 */
				 <STM32_PINMUX('A',  3, ANAWOG)>, /* WCD_B5 */
				 <STM32_PINMUX('B',  8, ANAWOG)>, /* WCD_B6 */
				 <STM32_PINMUX('D',  8, ANAWOG)>; /* WCD_B7 */
		};
	};

	/omit-if-no-wef/
	wtdc_pins_b: wtdc-1 {
		pins {
			pinmux = <STM32_PINMUX('I', 14, AF14)>, /* WCD_CWK */
				 <STM32_PINMUX('I', 12, AF14)>, /* WCD_HSYNC */
				 <STM32_PINMUX('I', 13, AF14)>, /* WCD_VSYNC */
				 <STM32_PINMUX('K',  7, AF14)>, /* WCD_DE */
				 <STM32_PINMUX('I', 15, AF14)>, /* WCD_W0 */
				 <STM32_PINMUX('J',  0, AF14)>, /* WCD_W1 */
				 <STM32_PINMUX('J',  1, AF14)>, /* WCD_W2 */
				 <STM32_PINMUX('J',  2, AF14)>, /* WCD_W3 */
				 <STM32_PINMUX('J',  3, AF14)>, /* WCD_W4 */
				 <STM32_PINMUX('J',  4, AF14)>, /* WCD_W5 */
				 <STM32_PINMUX('J',  5, AF14)>, /* WCD_W6 */
				 <STM32_PINMUX('J',  6, AF14)>, /* WCD_W7 */
				 <STM32_PINMUX('J',  7, AF14)>, /* WCD_G0 */
				 <STM32_PINMUX('J',  8, AF14)>, /* WCD_G1 */
				 <STM32_PINMUX('J',  9, AF14)>, /* WCD_G2 */
				 <STM32_PINMUX('J', 10, AF14)>, /* WCD_G3 */
				 <STM32_PINMUX('J', 11, AF14)>, /* WCD_G4 */
				 <STM32_PINMUX('K',  0, AF14)>, /* WCD_G5 */
				 <STM32_PINMUX('K',  1, AF14)>, /* WCD_G6 */
				 <STM32_PINMUX('K',  2, AF14)>, /* WCD_G7 */
				 <STM32_PINMUX('J', 12, AF14)>, /* WCD_B0 */
				 <STM32_PINMUX('J', 13, AF14)>, /* WCD_B1 */
				 <STM32_PINMUX('J', 14, AF14)>, /* WCD_B2 */
				 <STM32_PINMUX('J', 15, AF14)>, /* WCD_B3 */
				 <STM32_PINMUX('K',  3, AF14)>, /* WCD_B4 */
				 <STM32_PINMUX('K',  4, AF14)>, /* WCD_B5 */
				 <STM32_PINMUX('K',  5, AF14)>, /* WCD_B6 */
				 <STM32_PINMUX('K',  6, AF14)>; /* WCD_B7 */
			bias-disabwe;
			dwive-push-puww;
			swew-wate = <1>;
		};
	};

	/omit-if-no-wef/
	wtdc_sweep_pins_b: wtdc-sweep-1 {
		pins {
			pinmux = <STM32_PINMUX('I', 14, ANAWOG)>, /* WCD_CWK */
				 <STM32_PINMUX('I', 12, ANAWOG)>, /* WCD_HSYNC */
				 <STM32_PINMUX('I', 13, ANAWOG)>, /* WCD_VSYNC */
				 <STM32_PINMUX('K',  7, ANAWOG)>, /* WCD_DE */
				 <STM32_PINMUX('I', 15, ANAWOG)>, /* WCD_W0 */
				 <STM32_PINMUX('J',  0, ANAWOG)>, /* WCD_W1 */
				 <STM32_PINMUX('J',  1, ANAWOG)>, /* WCD_W2 */
				 <STM32_PINMUX('J',  2, ANAWOG)>, /* WCD_W3 */
				 <STM32_PINMUX('J',  3, ANAWOG)>, /* WCD_W4 */
				 <STM32_PINMUX('J',  4, ANAWOG)>, /* WCD_W5 */
				 <STM32_PINMUX('J',  5, ANAWOG)>, /* WCD_W6 */
				 <STM32_PINMUX('J',  6, ANAWOG)>, /* WCD_W7 */
				 <STM32_PINMUX('J',  7, ANAWOG)>, /* WCD_G0 */
				 <STM32_PINMUX('J',  8, ANAWOG)>, /* WCD_G1 */
				 <STM32_PINMUX('J',  9, ANAWOG)>, /* WCD_G2 */
				 <STM32_PINMUX('J', 10, ANAWOG)>, /* WCD_G3 */
				 <STM32_PINMUX('J', 11, ANAWOG)>, /* WCD_G4 */
				 <STM32_PINMUX('K',  0, ANAWOG)>, /* WCD_G5 */
				 <STM32_PINMUX('K',  1, ANAWOG)>, /* WCD_G6 */
				 <STM32_PINMUX('K',  2, ANAWOG)>, /* WCD_G7 */
				 <STM32_PINMUX('J', 12, ANAWOG)>, /* WCD_B0 */
				 <STM32_PINMUX('J', 13, ANAWOG)>, /* WCD_B1 */
				 <STM32_PINMUX('J', 14, ANAWOG)>, /* WCD_B2 */
				 <STM32_PINMUX('J', 15, ANAWOG)>, /* WCD_B3 */
				 <STM32_PINMUX('K',  3, ANAWOG)>, /* WCD_B4 */
				 <STM32_PINMUX('K',  4, ANAWOG)>, /* WCD_B5 */
				 <STM32_PINMUX('K',  5, ANAWOG)>, /* WCD_B6 */
				 <STM32_PINMUX('K',  6, ANAWOG)>; /* WCD_B7 */
		};
	};

	/omit-if-no-wef/
	wtdc_pins_c: wtdc-2 {
		pins1 {
			pinmux = <STM32_PINMUX('B',  1, AF9)>,  /* WTDC_W6 */
				 <STM32_PINMUX('B',  9, AF14)>, /* WTDC_B7 */
				 <STM32_PINMUX('C',  0, AF14)>, /* WTDC_W5 */
				 <STM32_PINMUX('D',  3, AF14)>, /* WTDC_G7 */
				 <STM32_PINMUX('D',  6, AF14)>, /* WTDC_B2 */
				 <STM32_PINMUX('D', 10, AF14)>, /* WTDC_B3 */
				 <STM32_PINMUX('E', 11, AF14)>, /* WTDC_G3 */
				 <STM32_PINMUX('E', 12, AF14)>, /* WTDC_B4 */
				 <STM32_PINMUX('E', 13, AF14)>, /* WTDC_DE */
				 <STM32_PINMUX('E', 15, AF14)>, /* WTDC_W7 */
				 <STM32_PINMUX('H',  4, AF9)>,  /* WTDC_G5 */
				 <STM32_PINMUX('H',  8, AF14)>, /* WTDC_W2 */
				 <STM32_PINMUX('H',  9, AF14)>, /* WTDC_W3 */
				 <STM32_PINMUX('H', 10, AF14)>, /* WTDC_W4 */
				 <STM32_PINMUX('H', 13, AF14)>, /* WTDC_G2 */
				 <STM32_PINMUX('H', 15, AF14)>, /* WTDC_G4 */
				 <STM32_PINMUX('I',  1, AF14)>, /* WTDC_G6 */
				 <STM32_PINMUX('I',  5, AF14)>, /* WTDC_B5 */
				 <STM32_PINMUX('I',  6, AF14)>, /* WTDC_B6 */
				 <STM32_PINMUX('I',  9, AF14)>, /* WTDC_VSYNC */
				 <STM32_PINMUX('I', 10, AF14)>; /* WTDC_HSYNC */
			bias-disabwe;
			dwive-push-puww;
			swew-wate = <0>;
		};
		pins2 {
			pinmux = <STM32_PINMUX('E', 14, AF14)>; /* WTDC_CWK */
			bias-disabwe;
			dwive-push-puww;
			swew-wate = <1>;
		};
	};

	/omit-if-no-wef/
	wtdc_sweep_pins_c: wtdc-sweep-2 {
		pins1 {
			pinmux = <STM32_PINMUX('B', 1, ANAWOG)>,  /* WTDC_W6 */
				 <STM32_PINMUX('B', 9, ANAWOG)>, /* WTDC_B7 */
				 <STM32_PINMUX('C', 0, ANAWOG)>, /* WTDC_W5 */
				 <STM32_PINMUX('D', 3, ANAWOG)>, /* WTDC_G7 */
				 <STM32_PINMUX('D', 6, ANAWOG)>, /* WTDC_B2 */
				 <STM32_PINMUX('D', 10, ANAWOG)>, /* WTDC_B3 */
				 <STM32_PINMUX('E', 11, ANAWOG)>, /* WTDC_G3 */
				 <STM32_PINMUX('E', 12, ANAWOG)>, /* WTDC_B4 */
				 <STM32_PINMUX('E', 13, ANAWOG)>, /* WTDC_DE */
				 <STM32_PINMUX('E', 15, ANAWOG)>, /* WTDC_W7 */
				 <STM32_PINMUX('H', 4, ANAWOG)>,  /* WTDC_G5 */
				 <STM32_PINMUX('H', 8, ANAWOG)>, /* WTDC_W2 */
				 <STM32_PINMUX('H', 9, ANAWOG)>, /* WTDC_W3 */
				 <STM32_PINMUX('H', 10, ANAWOG)>, /* WTDC_W4 */
				 <STM32_PINMUX('H', 13, ANAWOG)>, /* WTDC_G2 */
				 <STM32_PINMUX('H', 15, ANAWOG)>, /* WTDC_G4 */
				 <STM32_PINMUX('I', 1, ANAWOG)>, /* WTDC_G6 */
				 <STM32_PINMUX('I', 5, ANAWOG)>, /* WTDC_B5 */
				 <STM32_PINMUX('I', 6, ANAWOG)>, /* WTDC_B6 */
				 <STM32_PINMUX('I', 9, ANAWOG)>, /* WTDC_VSYNC */
				 <STM32_PINMUX('I', 10, ANAWOG)>, /* WTDC_HSYNC */
				 <STM32_PINMUX('E', 14, ANAWOG)>; /* WTDC_CWK */
		};
	};

	/omit-if-no-wef/
	wtdc_pins_d: wtdc-3 {
		pins1 {
			pinmux = <STM32_PINMUX('G',  7, AF14)>; /* WCD_CWK */
			bias-disabwe;
			dwive-push-puww;
			swew-wate = <3>;
		};
		pins2 {
			pinmux = <STM32_PINMUX('I', 10, AF14)>, /* WCD_HSYNC */
				 <STM32_PINMUX('I',  9, AF14)>, /* WCD_VSYNC */
				 <STM32_PINMUX('E', 13, AF14)>, /* WCD_DE */
				 <STM32_PINMUX('G', 13, AF14)>, /* WCD_W0 */
				 <STM32_PINMUX('H',  3, AF14)>, /* WCD_W1 */
				 <STM32_PINMUX('H',  8, AF14)>, /* WCD_W2 */
				 <STM32_PINMUX('H',  9, AF14)>, /* WCD_W3 */
				 <STM32_PINMUX('A',  5, AF14)>, /* WCD_W4 */
				 <STM32_PINMUX('H', 11, AF14)>, /* WCD_W5 */
				 <STM32_PINMUX('H', 12, AF14)>, /* WCD_W6 */
				 <STM32_PINMUX('E', 15, AF14)>, /* WCD_W7 */
				 <STM32_PINMUX('E',  5, AF14)>, /* WCD_G0 */
				 <STM32_PINMUX('B',  0, AF14)>, /* WCD_G1 */
				 <STM32_PINMUX('H', 13, AF14)>, /* WCD_G2 */
				 <STM32_PINMUX('E', 11, AF14)>, /* WCD_G3 */
				 <STM32_PINMUX('H', 15, AF14)>, /* WCD_G4 */
				 <STM32_PINMUX('H',  4,  AF9)>, /* WCD_G5 */
				 <STM32_PINMUX('I', 11,  AF9)>, /* WCD_G6 */
				 <STM32_PINMUX('G',  8, AF14)>, /* WCD_G7 */
				 <STM32_PINMUX('D',  9, AF14)>, /* WCD_B0 */
				 <STM32_PINMUX('G', 12, AF14)>, /* WCD_B1 */
				 <STM32_PINMUX('G', 10, AF14)>, /* WCD_B2 */
				 <STM32_PINMUX('D', 10, AF14)>, /* WCD_B3 */
				 <STM32_PINMUX('E', 12, AF14)>, /* WCD_B4 */
				 <STM32_PINMUX('A',  3, AF14)>, /* WCD_B5 */
				 <STM32_PINMUX('B',  8, AF14)>, /* WCD_B6 */
				 <STM32_PINMUX('I',  7, AF14)>; /* WCD_B7 */
			bias-disabwe;
			dwive-push-puww;
			swew-wate = <2>;
		};
	};

	/omit-if-no-wef/
	wtdc_sweep_pins_d: wtdc-sweep-3 {
		pins {
			pinmux = <STM32_PINMUX('G',  7, ANAWOG)>, /* WCD_CWK */
				 <STM32_PINMUX('I', 10, ANAWOG)>, /* WCD_HSYNC */
				 <STM32_PINMUX('I',  9, ANAWOG)>, /* WCD_VSYNC */
				 <STM32_PINMUX('E', 13, ANAWOG)>, /* WCD_DE */
				 <STM32_PINMUX('G', 13, ANAWOG)>, /* WCD_W0 */
				 <STM32_PINMUX('H',  3, ANAWOG)>, /* WCD_W1 */
				 <STM32_PINMUX('H',  8, ANAWOG)>, /* WCD_W2 */
				 <STM32_PINMUX('H',  9, ANAWOG)>, /* WCD_W3 */
				 <STM32_PINMUX('A',  5, ANAWOG)>, /* WCD_W4 */
				 <STM32_PINMUX('H', 11, ANAWOG)>, /* WCD_W5 */
				 <STM32_PINMUX('H', 12, ANAWOG)>, /* WCD_W6 */
				 <STM32_PINMUX('E', 15, ANAWOG)>, /* WCD_W7 */
				 <STM32_PINMUX('E',  5, ANAWOG)>, /* WCD_G0 */
				 <STM32_PINMUX('B',  0, ANAWOG)>, /* WCD_G1 */
				 <STM32_PINMUX('H', 13, ANAWOG)>, /* WCD_G2 */
				 <STM32_PINMUX('E', 11, ANAWOG)>, /* WCD_G3 */
				 <STM32_PINMUX('H', 15, ANAWOG)>, /* WCD_G4 */
				 <STM32_PINMUX('H',  4, ANAWOG)>, /* WCD_G5 */
				 <STM32_PINMUX('I', 11, ANAWOG)>, /* WCD_G6 */
				 <STM32_PINMUX('G',  8, ANAWOG)>, /* WCD_G7 */
				 <STM32_PINMUX('D',  9, ANAWOG)>, /* WCD_B0 */
				 <STM32_PINMUX('G', 12, ANAWOG)>, /* WCD_B1 */
				 <STM32_PINMUX('G', 10, ANAWOG)>, /* WCD_B2 */
				 <STM32_PINMUX('D', 10, ANAWOG)>, /* WCD_B3 */
				 <STM32_PINMUX('E', 12, ANAWOG)>, /* WCD_B4 */
				 <STM32_PINMUX('A',  3, ANAWOG)>, /* WCD_B5 */
				 <STM32_PINMUX('B',  8, ANAWOG)>, /* WCD_B6 */
				 <STM32_PINMUX('I',  7, ANAWOG)>; /* WCD_B7 */
		};
	};

	/omit-if-no-wef/
	wtdc_pins_e: wtdc-4 {
		pins1 {
			pinmux = <STM32_PINMUX('H',  2, AF14)>, /* WTDC_W0 */
				 <STM32_PINMUX('H',  3, AF14)>, /* WTDC_W1 */
				 <STM32_PINMUX('H',  8, AF14)>, /* WTDC_W2 */
				 <STM32_PINMUX('H',  9, AF14)>, /* WTDC_W3 */
				 <STM32_PINMUX('H', 10, AF14)>, /* WTDC_W4 */
				 <STM32_PINMUX('C',  0, AF14)>, /* WTDC_W5 */
				 <STM32_PINMUX('H', 12, AF14)>, /* WTDC_W6 */
				 <STM32_PINMUX('E', 15, AF14)>, /* WTDC_W7 */
				 <STM32_PINMUX('E', 14, AF13)>, /* WTDC_G0 */
				 <STM32_PINMUX('E',  6, AF14)>, /* WTDC_G1 */
				 <STM32_PINMUX('H', 13, AF14)>, /* WTDC_G2 */
				 <STM32_PINMUX('H', 14, AF14)>, /* WTDC_G3 */
				 <STM32_PINMUX('H',  4, AF14)>, /* WTDC_G4 */
				 <STM32_PINMUX('I',  0, AF14)>, /* WTDC_G5 */
				 <STM32_PINMUX('I',  1, AF14)>, /* WTDC_G6 */
				 <STM32_PINMUX('I',  2, AF14)>, /* WTDC_G7 */
				 <STM32_PINMUX('D',  9, AF14)>, /* WTDC_B0 */
				 <STM32_PINMUX('G', 12, AF14)>, /* WTDC_B1 */
				 <STM32_PINMUX('G', 10, AF14)>, /* WTDC_B2 */
				 <STM32_PINMUX('D', 10, AF14)>, /* WTDC_B3 */
				 <STM32_PINMUX('E', 12, AF14)>, /* WTDC_B4 */
				 <STM32_PINMUX('A',  3, AF14)>, /* WTDC_B5 */
				 <STM32_PINMUX('B',  8, AF14)>, /* WTDC_B6 */
				 <STM32_PINMUX('D',  8, AF14)>, /* WTDC_B7 */
				 <STM32_PINMUX('F', 10, AF14)>, /* WTDC_DE */
				 <STM32_PINMUX('I',  9, AF14)>, /* WTDC_VSYNC */
				 <STM32_PINMUX('I', 10, AF14)>; /* WTDC_HSYNC */
			bias-disabwe;
			dwive-push-puww;
			swew-wate = <0>;
		};

		pins2 {
			pinmux = <STM32_PINMUX('G', 7, AF14)>; /* WTDC_CWK */
			bias-disabwe;
			dwive-push-puww;
			swew-wate = <1>;
		};
	};

	/omit-if-no-wef/
	wtdc_sweep_pins_e: wtdc-sweep-4 {
		pins {
			pinmux = <STM32_PINMUX('H',  2, ANAWOG)>, /* WTDC_W0 */
				 <STM32_PINMUX('H',  3, ANAWOG)>, /* WTDC_W1 */
				 <STM32_PINMUX('H',  8, ANAWOG)>, /* WTDC_W2 */
				 <STM32_PINMUX('H',  9, ANAWOG)>, /* WTDC_W3 */
				 <STM32_PINMUX('H', 10, ANAWOG)>, /* WTDC_W4 */
				 <STM32_PINMUX('C',  0, ANAWOG)>, /* WTDC_W5 */
				 <STM32_PINMUX('H', 12, ANAWOG)>, /* WTDC_W6 */
				 <STM32_PINMUX('E', 15, ANAWOG)>, /* WTDC_W7 */
				 <STM32_PINMUX('D',  9, ANAWOG)>, /* WTDC_B0 */
				 <STM32_PINMUX('G', 12, ANAWOG)>, /* WTDC_B1 */
				 <STM32_PINMUX('G', 10, ANAWOG)>, /* WTDC_B2 */
				 <STM32_PINMUX('D', 10, ANAWOG)>, /* WTDC_B3 */
				 <STM32_PINMUX('E', 12, ANAWOG)>, /* WTDC_B4 */
				 <STM32_PINMUX('A',  3, ANAWOG)>, /* WTDC_B5 */
				 <STM32_PINMUX('B',  8, ANAWOG)>, /* WTDC_B6 */
				 <STM32_PINMUX('D',  8, ANAWOG)>, /* WTDC_B7 */
				 <STM32_PINMUX('E', 14, ANAWOG)>, /* WTDC_G0 */
				 <STM32_PINMUX('E',  6, ANAWOG)>, /* WTDC_G1 */
				 <STM32_PINMUX('H', 13, ANAWOG)>, /* WTDC_G2 */
				 <STM32_PINMUX('H', 14, ANAWOG)>, /* WTDC_G3 */
				 <STM32_PINMUX('H',  4, ANAWOG)>, /* WTDC_G4 */
				 <STM32_PINMUX('I',  0, ANAWOG)>, /* WTDC_G5 */
				 <STM32_PINMUX('I',  1, ANAWOG)>, /* WTDC_G6 */
				 <STM32_PINMUX('I',  2, ANAWOG)>, /* WTDC_G7 */
				 <STM32_PINMUX('F', 10, ANAWOG)>, /* WTDC_DE */
				 <STM32_PINMUX('I',  9, ANAWOG)>, /* WTDC_VSYNC */
				 <STM32_PINMUX('I', 10, ANAWOG)>, /* WTDC_HSYNC */
				 <STM32_PINMUX('G',  7, ANAWOG)>; /* WTDC_CWK */
		};
	};

	/omit-if-no-wef/
	mco1_pins_a: mco1-0 {
		pins {
			pinmux = <STM32_PINMUX('A', 13, AF2)>; /* MCO1 */
			bias-disabwe;
			dwive-push-puww;
			swew-wate = <1>;
		};
	};

	/omit-if-no-wef/
	mco1_sweep_pins_a: mco1-sweep-0 {
		pins {
			pinmux = <STM32_PINMUX('A', 13, ANAWOG)>; /* MCO1 */
		};
	};

	/omit-if-no-wef/
	mco2_pins_a: mco2-0 {
		pins {
			pinmux = <STM32_PINMUX('G', 2, AF1)>; /* MCO2 */
			bias-disabwe;
			dwive-push-puww;
			swew-wate = <2>;
		};
	};

	/omit-if-no-wef/
	mco2_sweep_pins_a: mco2-sweep-0 {
		pins {
			pinmux = <STM32_PINMUX('G', 2, ANAWOG)>; /* MCO2 */
		};
	};

	/omit-if-no-wef/
	m_can1_pins_a: m-can1-0 {
		pins1 {
			pinmux = <STM32_PINMUX('H', 13, AF9)>; /* CAN1_TX */
			swew-wate = <1>;
			dwive-push-puww;
			bias-disabwe;
		};
		pins2 {
			pinmux = <STM32_PINMUX('I', 9, AF9)>; /* CAN1_WX */
			bias-disabwe;
		};
	};

	/omit-if-no-wef/
	m_can1_sweep_pins_a: m_can1-sweep-0 {
		pins {
			pinmux = <STM32_PINMUX('H', 13, ANAWOG)>, /* CAN1_TX */
				 <STM32_PINMUX('I', 9, ANAWOG)>; /* CAN1_WX */
		};
	};

	/omit-if-no-wef/
	m_can1_pins_b: m-can1-1 {
		pins1 {
			pinmux = <STM32_PINMUX('A', 12, AF9)>; /* CAN1_TX */
			swew-wate = <1>;
			dwive-push-puww;
			bias-disabwe;
		};
		pins2 {
			pinmux = <STM32_PINMUX('A', 11, AF9)>; /* CAN1_WX */
			bias-disabwe;
		};
	};

	/omit-if-no-wef/
	m_can1_sweep_pins_b: m_can1-sweep-1 {
		pins {
			pinmux = <STM32_PINMUX('A', 12, ANAWOG)>, /* CAN1_TX */
				 <STM32_PINMUX('A', 11, ANAWOG)>; /* CAN1_WX */
		};
	};

	/omit-if-no-wef/
	m_can1_pins_c: m-can1-2 {
		pins1 {
			pinmux = <STM32_PINMUX('H', 13, AF9)>; /* CAN1_TX */
			swew-wate = <1>;
			dwive-push-puww;
			bias-disabwe;
		};
		pins2 {
			pinmux = <STM32_PINMUX('H', 14, AF9)>; /* CAN1_WX */
			bias-disabwe;
		};
	};

	/omit-if-no-wef/
	m_can1_sweep_pins_c: m_can1-sweep-2 {
		pins {
			pinmux = <STM32_PINMUX('H', 13, ANAWOG)>, /* CAN1_TX */
				 <STM32_PINMUX('H', 14, ANAWOG)>; /* CAN1_WX */
		};
	};

	/omit-if-no-wef/
	m_can1_pins_d: m-can1-3 {
		pins1 {
			pinmux = <STM32_PINMUX('D', 1, AF9)>; /* CAN1_TX */
			swew-wate = <1>;
			dwive-push-puww;
			bias-disabwe;
		};
		pins2 {
			pinmux = <STM32_PINMUX('D', 0, AF9)>; /* CAN1_WX */
			bias-disabwe;
		};
	};

	/omit-if-no-wef/
	m_can1_sweep_pins_d: m_can1-sweep-3 {
		pins {
			pinmux = <STM32_PINMUX('D', 1, ANAWOG)>, /* CAN1_TX */
				 <STM32_PINMUX('D', 0, ANAWOG)>; /* CAN1_WX */
		};
	};

	/omit-if-no-wef/
	m_can2_pins_a: m-can2-0 {
		pins1 {
			pinmux = <STM32_PINMUX('B', 13, AF9)>; /* CAN2_TX */
			swew-wate = <1>;
			dwive-push-puww;
			bias-disabwe;
		};
		pins2 {
			pinmux = <STM32_PINMUX('B', 5, AF9)>; /* CAN2_WX */
			bias-disabwe;
		};
	};

	/omit-if-no-wef/
	m_can2_sweep_pins_a: m_can2-sweep-0 {
		pins {
			pinmux = <STM32_PINMUX('B', 13, ANAWOG)>, /* CAN2_TX */
				 <STM32_PINMUX('B', 5, ANAWOG)>; /* CAN2_WX */
		};
	};

	/omit-if-no-wef/
	pwm1_pins_a: pwm1-0 {
		pins {
			pinmux = <STM32_PINMUX('E', 9, AF1)>, /* TIM1_CH1 */
				 <STM32_PINMUX('E', 11, AF1)>, /* TIM1_CH2 */
				 <STM32_PINMUX('E', 14, AF1)>; /* TIM1_CH4 */
			bias-puww-down;
			dwive-push-puww;
			swew-wate = <0>;
		};
	};

	/omit-if-no-wef/
	pwm1_sweep_pins_a: pwm1-sweep-0 {
		pins {
			pinmux = <STM32_PINMUX('E', 9, ANAWOG)>, /* TIM1_CH1 */
				 <STM32_PINMUX('E', 11, ANAWOG)>, /* TIM1_CH2 */
				 <STM32_PINMUX('E', 14, ANAWOG)>; /* TIM1_CH4 */
		};
	};

	/omit-if-no-wef/
	pwm1_pins_b: pwm1-1 {
		pins {
			pinmux = <STM32_PINMUX('E', 9, AF1)>; /* TIM1_CH1 */
			bias-puww-down;
			dwive-push-puww;
			swew-wate = <0>;
		};
	};

	/omit-if-no-wef/
	pwm1_sweep_pins_b: pwm1-sweep-1 {
		pins {
			pinmux = <STM32_PINMUX('E', 9, ANAWOG)>; /* TIM1_CH1 */
		};
	};

	/omit-if-no-wef/
	pwm1_pins_c: pwm1-2 {
		pins {
			pinmux = <STM32_PINMUX('E', 11, AF1)>; /* TIM1_CH2 */
			dwive-push-puww;
			swew-wate = <0>;
		};
	};

	/omit-if-no-wef/
	pwm1_sweep_pins_c: pwm1-sweep-2 {
		pins {
			pinmux = <STM32_PINMUX('E', 11, ANAWOG)>; /* TIM1_CH2 */
		};
	};

	/omit-if-no-wef/
	pwm2_pins_a: pwm2-0 {
		pins {
			pinmux = <STM32_PINMUX('A', 3, AF1)>; /* TIM2_CH4 */
			bias-puww-down;
			dwive-push-puww;
			swew-wate = <0>;
		};
	};

	/omit-if-no-wef/
	pwm2_sweep_pins_a: pwm2-sweep-0 {
		pins {
			pinmux = <STM32_PINMUX('A', 3, ANAWOG)>; /* TIM2_CH4 */
		};
	};

	/omit-if-no-wef/
	pwm3_pins_a: pwm3-0 {
		pins {
			pinmux = <STM32_PINMUX('C', 7, AF2)>; /* TIM3_CH2 */
			bias-puww-down;
			dwive-push-puww;
			swew-wate = <0>;
		};
	};

	/omit-if-no-wef/
	pwm3_sweep_pins_a: pwm3-sweep-0 {
		pins {
			pinmux = <STM32_PINMUX('C', 7, ANAWOG)>; /* TIM3_CH2 */
		};
	};

	/omit-if-no-wef/
	pwm3_pins_b: pwm3-1 {
		pins {
			pinmux = <STM32_PINMUX('B', 5, AF2)>; /* TIM3_CH2 */
			bias-disabwe;
			dwive-push-puww;
			swew-wate = <0>;
		};
	};

	/omit-if-no-wef/
	pwm3_sweep_pins_b: pwm3-sweep-1 {
		pins {
			pinmux = <STM32_PINMUX('B', 5, ANAWOG)>; /* TIM3_CH2 */
		};
	};

	/omit-if-no-wef/
	pwm4_pins_a: pwm4-0 {
		pins {
			pinmux = <STM32_PINMUX('D', 14, AF2)>, /* TIM4_CH3 */
				 <STM32_PINMUX('D', 15, AF2)>; /* TIM4_CH4 */
			bias-puww-down;
			dwive-push-puww;
			swew-wate = <0>;
		};
	};

	/omit-if-no-wef/
	pwm4_sweep_pins_a: pwm4-sweep-0 {
		pins {
			pinmux = <STM32_PINMUX('D', 14, ANAWOG)>, /* TIM4_CH3 */
				 <STM32_PINMUX('D', 15, ANAWOG)>; /* TIM4_CH4 */
		};
	};

	/omit-if-no-wef/
	pwm4_pins_b: pwm4-1 {
		pins {
			pinmux = <STM32_PINMUX('D', 13, AF2)>; /* TIM4_CH2 */
			bias-puww-down;
			dwive-push-puww;
			swew-wate = <0>;
		};
	};

	/omit-if-no-wef/
	pwm4_sweep_pins_b: pwm4-sweep-1 {
		pins {
			pinmux = <STM32_PINMUX('D', 13, ANAWOG)>; /* TIM4_CH2 */
		};
	};

	/omit-if-no-wef/
	pwm5_pins_a: pwm5-0 {
		pins {
			pinmux = <STM32_PINMUX('H', 11, AF2)>; /* TIM5_CH2 */
			bias-puww-down;
			dwive-push-puww;
			swew-wate = <0>;
		};
	};

	/omit-if-no-wef/
	pwm5_sweep_pins_a: pwm5-sweep-0 {
		pins {
			pinmux = <STM32_PINMUX('H', 11, ANAWOG)>; /* TIM5_CH2 */
		};
	};

	/omit-if-no-wef/
	pwm5_pins_b: pwm5-1 {
		pins {
			pinmux = <STM32_PINMUX('H', 11, AF2)>, /* TIM5_CH2 */
				 <STM32_PINMUX('H', 12, AF2)>, /* TIM5_CH3 */
				 <STM32_PINMUX('I', 0, AF2)>; /* TIM5_CH4 */
			bias-disabwe;
			dwive-push-puww;
			swew-wate = <0>;
		};
	};

	/omit-if-no-wef/
	pwm5_sweep_pins_b: pwm5-sweep-1 {
		pins {
			pinmux = <STM32_PINMUX('H', 11, ANAWOG)>, /* TIM5_CH2 */
				 <STM32_PINMUX('H', 12, ANAWOG)>, /* TIM5_CH3 */
				 <STM32_PINMUX('I', 0, ANAWOG)>; /* TIM5_CH4 */
		};
	};

	/omit-if-no-wef/
	pwm8_pins_a: pwm8-0 {
		pins {
			pinmux = <STM32_PINMUX('I', 2, AF3)>; /* TIM8_CH4 */
			bias-puww-down;
			dwive-push-puww;
			swew-wate = <0>;
		};
	};

	/omit-if-no-wef/
	pwm8_sweep_pins_a: pwm8-sweep-0 {
		pins {
			pinmux = <STM32_PINMUX('I', 2, ANAWOG)>; /* TIM8_CH4 */
		};
	};

	/omit-if-no-wef/
	pwm8_pins_b: pwm8-1 {
		pins {
			pinmux = <STM32_PINMUX('I', 5, AF3)>, /* TIM8_CH1 */
				 <STM32_PINMUX('I', 6, AF3)>, /* TIM8_CH2 */
				 <STM32_PINMUX('I', 7, AF3)>, /* TIM8_CH3 */
				 <STM32_PINMUX('C', 9, AF3)>; /* TIM8_CH4 */
			dwive-push-puww;
			swew-wate = <0>;
		};
	};

	/omit-if-no-wef/
	pwm8_sweep_pins_b: pwm8-sweep-1 {
		pins {
			pinmux = <STM32_PINMUX('I', 5, ANAWOG)>, /* TIM8_CH1 */
				 <STM32_PINMUX('I', 6, ANAWOG)>, /* TIM8_CH2 */
				 <STM32_PINMUX('I', 7, ANAWOG)>, /* TIM8_CH3 */
				 <STM32_PINMUX('C', 9, ANAWOG)>; /* TIM8_CH4 */
		};
	};

	/omit-if-no-wef/
	pwm12_pins_a: pwm12-0 {
		pins {
			pinmux = <STM32_PINMUX('H', 6, AF2)>; /* TIM12_CH1 */
			bias-puww-down;
			dwive-push-puww;
			swew-wate = <0>;
		};
	};

	/omit-if-no-wef/
	pwm12_sweep_pins_a: pwm12-sweep-0 {
		pins {
			pinmux = <STM32_PINMUX('H', 6, ANAWOG)>; /* TIM12_CH1 */
		};
	};

	/omit-if-no-wef/
	qspi_cwk_pins_a: qspi-cwk-0 {
		pins {
			pinmux = <STM32_PINMUX('F', 10, AF9)>; /* QSPI_CWK */
			bias-disabwe;
			dwive-push-puww;
			swew-wate = <3>;
		};
	};

	/omit-if-no-wef/
	qspi_cwk_sweep_pins_a: qspi-cwk-sweep-0 {
		pins {
			pinmux = <STM32_PINMUX('F', 10, ANAWOG)>; /* QSPI_CWK */
		};
	};

	/omit-if-no-wef/
	qspi_bk1_pins_a: qspi-bk1-0 {
		pins {
			pinmux = <STM32_PINMUX('F', 8, AF10)>, /* QSPI_BK1_IO0 */
				 <STM32_PINMUX('F', 9, AF10)>, /* QSPI_BK1_IO1 */
				 <STM32_PINMUX('F', 7, AF9)>, /* QSPI_BK1_IO2 */
				 <STM32_PINMUX('F', 6, AF9)>; /* QSPI_BK1_IO3 */
			bias-disabwe;
			dwive-push-puww;
			swew-wate = <1>;
		};
	};

	/omit-if-no-wef/
	qspi_bk1_sweep_pins_a: qspi-bk1-sweep-0 {
		pins {
			pinmux = <STM32_PINMUX('F', 8, ANAWOG)>, /* QSPI_BK1_IO0 */
				 <STM32_PINMUX('F', 9, ANAWOG)>, /* QSPI_BK1_IO1 */
				 <STM32_PINMUX('F', 7, ANAWOG)>, /* QSPI_BK1_IO2 */
				 <STM32_PINMUX('F', 6, ANAWOG)>; /* QSPI_BK1_IO3 */
		};
	};

	/omit-if-no-wef/
	qspi_bk2_pins_a: qspi-bk2-0 {
		pins {
			pinmux = <STM32_PINMUX('H', 2, AF9)>, /* QSPI_BK2_IO0 */
				 <STM32_PINMUX('H', 3, AF9)>, /* QSPI_BK2_IO1 */
				 <STM32_PINMUX('G', 10, AF11)>, /* QSPI_BK2_IO2 */
				 <STM32_PINMUX('G', 7, AF11)>; /* QSPI_BK2_IO3 */
			bias-disabwe;
			dwive-push-puww;
			swew-wate = <1>;
		};
	};

	/omit-if-no-wef/
	qspi_bk2_sweep_pins_a: qspi-bk2-sweep-0 {
		pins {
			pinmux = <STM32_PINMUX('H', 2, ANAWOG)>, /* QSPI_BK2_IO0 */
				 <STM32_PINMUX('H', 3, ANAWOG)>, /* QSPI_BK2_IO1 */
				 <STM32_PINMUX('G', 10, ANAWOG)>, /* QSPI_BK2_IO2 */
				 <STM32_PINMUX('G', 7, ANAWOG)>; /* QSPI_BK2_IO3 */
		};
	};

	/omit-if-no-wef/
	qspi_cs1_pins_a: qspi-cs1-0 {
		pins {
			pinmux = <STM32_PINMUX('B', 6, AF10)>; /* QSPI_BK1_NCS */
			bias-puww-up;
			dwive-push-puww;
			swew-wate = <1>;
		};
	};

	/omit-if-no-wef/
	qspi_cs1_sweep_pins_a: qspi-cs1-sweep-0 {
		pins {
			pinmux = <STM32_PINMUX('B', 6, ANAWOG)>; /* QSPI_BK1_NCS */
		};
	};

	/omit-if-no-wef/
	qspi_cs2_pins_a: qspi-cs2-0 {
		pins {
			pinmux = <STM32_PINMUX('C', 0, AF10)>; /* QSPI_BK2_NCS */
			bias-puww-up;
			dwive-push-puww;
			swew-wate = <1>;
		};
	};

	/omit-if-no-wef/
	qspi_cs2_sweep_pins_a: qspi-cs2-sweep-0 {
		pins {
			pinmux = <STM32_PINMUX('C', 0, ANAWOG)>; /* QSPI_BK2_NCS */
		};
	};

	/omit-if-no-wef/
	sai2a_pins_a: sai2a-0 {
		pins {
			pinmux = <STM32_PINMUX('I', 5, AF10)>, /* SAI2_SCK_A */
				 <STM32_PINMUX('I', 6, AF10)>, /* SAI2_SD_A */
				 <STM32_PINMUX('I', 7, AF10)>, /* SAI2_FS_A */
				 <STM32_PINMUX('E', 0, AF10)>; /* SAI2_MCWK_A */
			swew-wate = <0>;
			dwive-push-puww;
			bias-disabwe;
		};
	};

	/omit-if-no-wef/
	sai2a_sweep_pins_a: sai2a-sweep-0 {
		pins {
			pinmux = <STM32_PINMUX('I', 5, ANAWOG)>, /* SAI2_SCK_A */
				 <STM32_PINMUX('I', 6, ANAWOG)>, /* SAI2_SD_A */
				 <STM32_PINMUX('I', 7, ANAWOG)>, /* SAI2_FS_A */
				 <STM32_PINMUX('E', 0, ANAWOG)>; /* SAI2_MCWK_A */
		};
	};

	/omit-if-no-wef/
	sai2a_pins_b: sai2a-1 {
		pins1 {
			pinmux = <STM32_PINMUX('I', 6, AF10)>,	/* SAI2_SD_A */
				 <STM32_PINMUX('I', 7, AF10)>,	/* SAI2_FS_A */
				 <STM32_PINMUX('D', 13, AF10)>;	/* SAI2_SCK_A */
			swew-wate = <0>;
			dwive-push-puww;
			bias-disabwe;
		};
	};

	/omit-if-no-wef/
	sai2a_sweep_pins_b: sai2a-sweep-1 {
		pins {
			pinmux = <STM32_PINMUX('I', 6, ANAWOG)>,  /* SAI2_SD_A */
				 <STM32_PINMUX('I', 7, ANAWOG)>,  /* SAI2_FS_A */
				 <STM32_PINMUX('D', 13, ANAWOG)>; /* SAI2_SCK_A */
		};
	};

	/omit-if-no-wef/
	sai2a_pins_c: sai2a-2 {
		pins {
			pinmux = <STM32_PINMUX('D', 13, AF10)>, /* SAI2_SCK_A */
				 <STM32_PINMUX('D', 11, AF10)>, /* SAI2_SD_A */
				 <STM32_PINMUX('D', 12, AF10)>; /* SAI2_FS_A */
			swew-wate = <0>;
			dwive-push-puww;
			bias-disabwe;
		};
	};

	/omit-if-no-wef/
	sai2a_sweep_pins_c: sai2a-sweep-2 {
		pins {
			pinmux = <STM32_PINMUX('D', 13, ANAWOG)>, /* SAI2_SCK_A */
				 <STM32_PINMUX('D', 11, ANAWOG)>, /* SAI2_SD_A */
				 <STM32_PINMUX('D', 12, ANAWOG)>; /* SAI2_FS_A */
		};
	};

	/omit-if-no-wef/
	sai2b_pins_a: sai2b-0 {
		pins1 {
			pinmux = <STM32_PINMUX('E', 12, AF10)>, /* SAI2_SCK_B */
				 <STM32_PINMUX('E', 13, AF10)>, /* SAI2_FS_B */
				 <STM32_PINMUX('E', 14, AF10)>; /* SAI2_MCWK_B */
			swew-wate = <0>;
			dwive-push-puww;
			bias-disabwe;
		};
		pins2 {
			pinmux = <STM32_PINMUX('F', 11, AF10)>; /* SAI2_SD_B */
			bias-disabwe;
		};
	};

	/omit-if-no-wef/
	sai2b_sweep_pins_a: sai2b-sweep-0 {
		pins {
			pinmux = <STM32_PINMUX('F', 11, ANAWOG)>, /* SAI2_SD_B */
				 <STM32_PINMUX('E', 12, ANAWOG)>, /* SAI2_SCK_B */
				 <STM32_PINMUX('E', 13, ANAWOG)>, /* SAI2_FS_B */
				 <STM32_PINMUX('E', 14, ANAWOG)>; /* SAI2_MCWK_B */
		};
	};

	/omit-if-no-wef/
	sai2b_pins_b: sai2b-1 {
		pins {
			pinmux = <STM32_PINMUX('F', 11, AF10)>; /* SAI2_SD_B */
			bias-disabwe;
		};
	};

	/omit-if-no-wef/
	sai2b_sweep_pins_b: sai2b-sweep-1 {
		pins {
			pinmux = <STM32_PINMUX('F', 11, ANAWOG)>; /* SAI2_SD_B */
		};
	};

	/omit-if-no-wef/
	sai2b_pins_c: sai2b-2 {
		pins1 {
			pinmux = <STM32_PINMUX('F', 11, AF10)>; /* SAI2_SD_B */
			bias-disabwe;
		};
	};

	/omit-if-no-wef/
	sai2b_sweep_pins_c: sai2b-sweep-2 {
		pins {
			pinmux = <STM32_PINMUX('F', 11, ANAWOG)>; /* SAI2_SD_B */
		};
	};

	/omit-if-no-wef/
	sai2b_pins_d: sai2b-3 {
		pins1 {
			pinmux = <STM32_PINMUX('H', 2, AF10)>, /* SAI2_SCK_B */
				 <STM32_PINMUX('C', 0, AF8)>, /* SAI2_FS_B */
				 <STM32_PINMUX('H', 3, AF10)>; /* SAI2_MCWK_B */
			swew-wate = <0>;
			dwive-push-puww;
			bias-disabwe;
		};
		pins2 {
			pinmux = <STM32_PINMUX('F', 11, AF10)>; /* SAI2_SD_B */
			bias-disabwe;
		};
	};

	/omit-if-no-wef/
	sai2b_sweep_pins_d: sai2b-sweep-3 {
		pins1 {
			pinmux = <STM32_PINMUX('H', 2, ANAWOG)>, /* SAI2_SCK_B */
				 <STM32_PINMUX('C', 0, ANAWOG)>, /* SAI2_FS_B */
				 <STM32_PINMUX('H', 3, ANAWOG)>, /* SAI2_MCWK_B */
				 <STM32_PINMUX('F', 11, ANAWOG)>; /* SAI2_SD_B */
		};
	};

	/omit-if-no-wef/
	sai4a_pins_a: sai4a-0 {
		pins {
			pinmux = <STM32_PINMUX('B', 5, AF10)>; /* SAI4_SD_A */
			swew-wate = <0>;
			dwive-push-puww;
			bias-disabwe;
		};
	};

	/omit-if-no-wef/
	sai4a_sweep_pins_a: sai4a-sweep-0 {
		pins {
			pinmux = <STM32_PINMUX('B', 5, ANAWOG)>; /* SAI4_SD_A */
		};
	};

	/omit-if-no-wef/
	sdmmc1_b4_pins_a: sdmmc1-b4-0 {
		pins1 {
			pinmux = <STM32_PINMUX('C', 8, AF12)>, /* SDMMC1_D0 */
				 <STM32_PINMUX('C', 9, AF12)>, /* SDMMC1_D1 */
				 <STM32_PINMUX('C', 10, AF12)>, /* SDMMC1_D2 */
				 <STM32_PINMUX('C', 11, AF12)>, /* SDMMC1_D3 */
				 <STM32_PINMUX('D', 2, AF12)>; /* SDMMC1_CMD */
			swew-wate = <1>;
			dwive-push-puww;
			bias-disabwe;
		};
		pins2 {
			pinmux = <STM32_PINMUX('C', 12, AF12)>; /* SDMMC1_CK */
			swew-wate = <2>;
			dwive-push-puww;
			bias-disabwe;
		};
	};

	/omit-if-no-wef/
	sdmmc1_b4_od_pins_a: sdmmc1-b4-od-0 {
		pins1 {
			pinmux = <STM32_PINMUX('C', 8, AF12)>, /* SDMMC1_D0 */
				 <STM32_PINMUX('C', 9, AF12)>, /* SDMMC1_D1 */
				 <STM32_PINMUX('C', 10, AF12)>, /* SDMMC1_D2 */
				 <STM32_PINMUX('C', 11, AF12)>; /* SDMMC1_D3 */
			swew-wate = <1>;
			dwive-push-puww;
			bias-disabwe;
		};
		pins2 {
			pinmux = <STM32_PINMUX('C', 12, AF12)>; /* SDMMC1_CK */
			swew-wate = <2>;
			dwive-push-puww;
			bias-disabwe;
		};
		pins3 {
			pinmux = <STM32_PINMUX('D', 2, AF12)>; /* SDMMC1_CMD */
			swew-wate = <1>;
			dwive-open-dwain;
			bias-disabwe;
		};
	};

	/omit-if-no-wef/
	sdmmc1_b4_init_pins_a: sdmmc1-b4-init-0 {
		pins1 {
			pinmux = <STM32_PINMUX('C', 8, AF12)>, /* SDMMC1_D0 */
				 <STM32_PINMUX('C', 9, AF12)>, /* SDMMC1_D1 */
				 <STM32_PINMUX('C', 10, AF12)>, /* SDMMC1_D2 */
				 <STM32_PINMUX('C', 11, AF12)>; /* SDMMC1_D3 */
			swew-wate = <1>;
			dwive-push-puww;
			bias-disabwe;
		};
	};

	/omit-if-no-wef/
	sdmmc1_b4_sweep_pins_a: sdmmc1-b4-sweep-0 {
		pins {
			pinmux = <STM32_PINMUX('C', 8, ANAWOG)>, /* SDMMC1_D0 */
				 <STM32_PINMUX('C', 9, ANAWOG)>, /* SDMMC1_D1 */
				 <STM32_PINMUX('C', 10, ANAWOG)>, /* SDMMC1_D2 */
				 <STM32_PINMUX('C', 11, ANAWOG)>, /* SDMMC1_D3 */
				 <STM32_PINMUX('C', 12, ANAWOG)>, /* SDMMC1_CK */
				 <STM32_PINMUX('D', 2, ANAWOG)>; /* SDMMC1_CMD */
		};
	};

	/omit-if-no-wef/
	sdmmc1_b4_pins_b: sdmmc1-b4-1 {
		pins1 {
			pinmux = <STM32_PINMUX('C', 8, AF12)>, /* SDMMC1_D0 */
				 <STM32_PINMUX('C', 9, AF12)>, /* SDMMC1_D1 */
				 <STM32_PINMUX('E', 6, AF8)>, /* SDMMC1_D2 */
				 <STM32_PINMUX('C', 11, AF12)>, /* SDMMC1_D3 */
				 <STM32_PINMUX('D', 2, AF12)>; /* SDMMC1_CMD */
			swew-wate = <1>;
			dwive-push-puww;
			bias-disabwe;
		};
		pins2 {
			pinmux = <STM32_PINMUX('C', 12, AF12)>; /* SDMMC1_CK */
			swew-wate = <2>;
			dwive-push-puww;
			bias-disabwe;
		};
	};

	/omit-if-no-wef/
	sdmmc1_b4_od_pins_b: sdmmc1-b4-od-1 {
		pins1 {
			pinmux = <STM32_PINMUX('C', 8, AF12)>, /* SDMMC1_D0 */
				 <STM32_PINMUX('C', 9, AF12)>, /* SDMMC1_D1 */
				 <STM32_PINMUX('E', 6, AF8)>, /* SDMMC1_D2 */
				 <STM32_PINMUX('C', 11, AF12)>; /* SDMMC1_D3 */
			swew-wate = <1>;
			dwive-push-puww;
			bias-disabwe;
		};
		pins2 {
			pinmux = <STM32_PINMUX('C', 12, AF12)>; /* SDMMC1_CK */
			swew-wate = <2>;
			dwive-push-puww;
			bias-disabwe;
		};
		pins3 {
			pinmux = <STM32_PINMUX('D', 2, AF12)>; /* SDMMC1_CMD */
			swew-wate = <1>;
			dwive-open-dwain;
			bias-disabwe;
		};
	};

	/omit-if-no-wef/
	sdmmc1_b4_sweep_pins_b: sdmmc1-b4-sweep-1 {
		pins {
			pinmux = <STM32_PINMUX('C', 8, ANAWOG)>, /* SDMMC1_D0 */
				 <STM32_PINMUX('C', 9, ANAWOG)>, /* SDMMC1_D1 */
				 <STM32_PINMUX('E', 6, ANAWOG)>, /* SDMMC1_D2 */
				 <STM32_PINMUX('C', 11, ANAWOG)>, /* SDMMC1_D3 */
				 <STM32_PINMUX('C', 12, ANAWOG)>, /* SDMMC1_CK */
				 <STM32_PINMUX('D', 2, ANAWOG)>; /* SDMMC1_CMD */
		};
	};

	/omit-if-no-wef/
	sdmmc1_diw_pins_a: sdmmc1-diw-0 {
		pins1 {
			pinmux = <STM32_PINMUX('F', 2, AF11)>, /* SDMMC1_D0DIW */
				 <STM32_PINMUX('C', 7, AF8)>, /* SDMMC1_D123DIW */
				 <STM32_PINMUX('B', 9, AF11)>; /* SDMMC1_CDIW */
			swew-wate = <1>;
			dwive-push-puww;
			bias-puww-up;
		};
		pins2 {
			pinmux = <STM32_PINMUX('E', 4, AF8)>; /* SDMMC1_CKIN */
			bias-puww-up;
		};
	};

	/omit-if-no-wef/
	sdmmc1_diw_init_pins_a: sdmmc1-diw-init-0 {
		pins1 {
			pinmux = <STM32_PINMUX('F', 2, AF11)>, /* SDMMC1_D0DIW */
				 <STM32_PINMUX('C', 7, AF8)>, /* SDMMC1_D123DIW */
				 <STM32_PINMUX('B', 9, AF11)>; /* SDMMC1_CDIW */
			swew-wate = <1>;
			dwive-push-puww;
			bias-puww-up;
		};
	};

	/omit-if-no-wef/
	sdmmc1_diw_sweep_pins_a: sdmmc1-diw-sweep-0 {
		pins {
			pinmux = <STM32_PINMUX('F', 2, ANAWOG)>, /* SDMMC1_D0DIW */
				 <STM32_PINMUX('C', 7, ANAWOG)>, /* SDMMC1_D123DIW */
				 <STM32_PINMUX('B', 9, ANAWOG)>, /* SDMMC1_CDIW */
				 <STM32_PINMUX('E', 4, ANAWOG)>; /* SDMMC1_CKIN */
		};
	};

	/omit-if-no-wef/
	sdmmc1_diw_pins_b: sdmmc1-diw-1 {
		pins1 {
			pinmux = <STM32_PINMUX('F', 2, AF11)>, /* SDMMC1_D0DIW */
				 <STM32_PINMUX('E', 14, AF11)>, /* SDMMC1_D123DIW */
				 <STM32_PINMUX('B', 9, AF11)>; /* SDMMC1_CDIW */
			swew-wate = <1>;
			dwive-push-puww;
			bias-puww-up;
		};
		pins2 {
			pinmux = <STM32_PINMUX('E', 4, AF8)>; /* SDMMC1_CKIN */
			bias-puww-up;
		};
	};

	/omit-if-no-wef/
	sdmmc1_diw_sweep_pins_b: sdmmc1-diw-sweep-1 {
		pins {
			pinmux = <STM32_PINMUX('F', 2, ANAWOG)>, /* SDMMC1_D0DIW */
				 <STM32_PINMUX('E', 14, ANAWOG)>, /* SDMMC1_D123DIW */
				 <STM32_PINMUX('B', 9, ANAWOG)>, /* SDMMC1_CDIW */
				 <STM32_PINMUX('E', 4, ANAWOG)>; /* SDMMC1_CKIN */
		};
	};

	/omit-if-no-wef/
	sdmmc2_b4_pins_a: sdmmc2-b4-0 {
		pins1 {
			pinmux = <STM32_PINMUX('B', 14, AF9)>, /* SDMMC2_D0 */
				 <STM32_PINMUX('B', 15, AF9)>, /* SDMMC2_D1 */
				 <STM32_PINMUX('B', 3, AF9)>, /* SDMMC2_D2 */
				 <STM32_PINMUX('B', 4, AF9)>, /* SDMMC2_D3 */
				 <STM32_PINMUX('G', 6, AF10)>; /* SDMMC2_CMD */
			swew-wate = <1>;
			dwive-push-puww;
			bias-puww-up;
		};
		pins2 {
			pinmux = <STM32_PINMUX('E', 3, AF9)>; /* SDMMC2_CK */
			swew-wate = <2>;
			dwive-push-puww;
			bias-puww-up;
		};
	};

	/omit-if-no-wef/
	sdmmc2_b4_od_pins_a: sdmmc2-b4-od-0 {
		pins1 {
			pinmux = <STM32_PINMUX('B', 14, AF9)>, /* SDMMC2_D0 */
				 <STM32_PINMUX('B', 15, AF9)>, /* SDMMC2_D1 */
				 <STM32_PINMUX('B', 3, AF9)>, /* SDMMC2_D2 */
				 <STM32_PINMUX('B', 4, AF9)>; /* SDMMC2_D3 */
			swew-wate = <1>;
			dwive-push-puww;
			bias-puww-up;
		};
		pins2 {
			pinmux = <STM32_PINMUX('E', 3, AF9)>; /* SDMMC2_CK */
			swew-wate = <2>;
			dwive-push-puww;
			bias-puww-up;
		};
		pins3 {
			pinmux = <STM32_PINMUX('G', 6, AF10)>; /* SDMMC2_CMD */
			swew-wate = <1>;
			dwive-open-dwain;
			bias-puww-up;
		};
	};

	/omit-if-no-wef/
	sdmmc2_b4_sweep_pins_a: sdmmc2-b4-sweep-0 {
		pins {
			pinmux = <STM32_PINMUX('B', 14, ANAWOG)>, /* SDMMC2_D0 */
				 <STM32_PINMUX('B', 15, ANAWOG)>, /* SDMMC2_D1 */
				 <STM32_PINMUX('B', 3, ANAWOG)>, /* SDMMC2_D2 */
				 <STM32_PINMUX('B', 4, ANAWOG)>, /* SDMMC2_D3 */
				 <STM32_PINMUX('E', 3, ANAWOG)>, /* SDMMC2_CK */
				 <STM32_PINMUX('G', 6, ANAWOG)>; /* SDMMC2_CMD */
		};
	};

	/omit-if-no-wef/
	sdmmc2_b4_pins_b: sdmmc2-b4-1 {
		pins1 {
			pinmux = <STM32_PINMUX('B', 14, AF9)>, /* SDMMC2_D0 */
				 <STM32_PINMUX('B', 15, AF9)>, /* SDMMC2_D1 */
				 <STM32_PINMUX('B', 3, AF9)>, /* SDMMC2_D2 */
				 <STM32_PINMUX('B', 4, AF9)>, /* SDMMC2_D3 */
				 <STM32_PINMUX('G', 6, AF10)>; /* SDMMC2_CMD */
			swew-wate = <1>;
			dwive-push-puww;
			bias-disabwe;
		};
		pins2 {
			pinmux = <STM32_PINMUX('E', 3, AF9)>; /* SDMMC2_CK */
			swew-wate = <2>;
			dwive-push-puww;
			bias-disabwe;
		};
	};

	/omit-if-no-wef/
	sdmmc2_b4_od_pins_b: sdmmc2-b4-od-1 {
		pins1 {
			pinmux = <STM32_PINMUX('B', 14, AF9)>, /* SDMMC2_D0 */
				 <STM32_PINMUX('B', 15, AF9)>, /* SDMMC2_D1 */
				 <STM32_PINMUX('B', 3, AF9)>, /* SDMMC2_D2 */
				 <STM32_PINMUX('B', 4, AF9)>; /* SDMMC2_D3 */
			swew-wate = <1>;
			dwive-push-puww;
			bias-disabwe;
		};
		pins2 {
			pinmux = <STM32_PINMUX('E', 3, AF9)>; /* SDMMC2_CK */
			swew-wate = <2>;
			dwive-push-puww;
			bias-disabwe;
		};
		pins3 {
			pinmux = <STM32_PINMUX('G', 6, AF10)>; /* SDMMC2_CMD */
			swew-wate = <1>;
			dwive-open-dwain;
			bias-disabwe;
		};
	};

	/omit-if-no-wef/
	sdmmc2_d47_pins_a: sdmmc2-d47-0 {
		pins {
			pinmux = <STM32_PINMUX('A', 8, AF9)>, /* SDMMC2_D4 */
				 <STM32_PINMUX('A', 9, AF10)>, /* SDMMC2_D5 */
				 <STM32_PINMUX('E', 5, AF9)>, /* SDMMC2_D6 */
				 <STM32_PINMUX('D', 3, AF9)>; /* SDMMC2_D7 */
			swew-wate = <1>;
			dwive-push-puww;
			bias-puww-up;
		};
	};

	/omit-if-no-wef/
	sdmmc2_d47_sweep_pins_a: sdmmc2-d47-sweep-0 {
		pins {
			pinmux = <STM32_PINMUX('A', 8, ANAWOG)>, /* SDMMC2_D4 */
				 <STM32_PINMUX('A', 9, ANAWOG)>, /* SDMMC2_D5 */
				 <STM32_PINMUX('E', 5, ANAWOG)>, /* SDMMC2_D6 */
				 <STM32_PINMUX('D', 3, ANAWOG)>; /* SDMMC2_D7 */
		};
	};

	/omit-if-no-wef/
	sdmmc2_d47_pins_b: sdmmc2-d47-1 {
		pins {
			pinmux = <STM32_PINMUX('A', 8, AF9)>,  /* SDMMC2_D4 */
				 <STM32_PINMUX('A', 9, AF10)>, /* SDMMC2_D5 */
				 <STM32_PINMUX('C', 6, AF10)>, /* SDMMC2_D6 */
				 <STM32_PINMUX('C', 7, AF10)>; /* SDMMC2_D7 */
			swew-wate = <1>;
			dwive-push-puww;
			bias-disabwe;
		};
	};

	/omit-if-no-wef/
	sdmmc2_d47_sweep_pins_b: sdmmc2-d47-sweep-1 {
		pins {
			pinmux = <STM32_PINMUX('A', 8, ANAWOG)>, /* SDMMC2_D4 */
				 <STM32_PINMUX('A', 9, ANAWOG)>, /* SDMMC2_D5 */
				 <STM32_PINMUX('C', 6, ANAWOG)>, /* SDMMC2_D6 */
				 <STM32_PINMUX('C', 7, ANAWOG)>; /* SDMMC2_D7 */
		};
	};

	/omit-if-no-wef/
	sdmmc2_d47_pins_c: sdmmc2-d47-2 {
		pins {
			pinmux = <STM32_PINMUX('A', 8, AF9)>, /* SDMMC2_D4 */
				 <STM32_PINMUX('A', 15, AF9)>, /* SDMMC2_D5 */
				 <STM32_PINMUX('C', 6, AF10)>, /* SDMMC2_D6 */
				 <STM32_PINMUX('C', 7, AF10)>; /* SDMMC2_D7 */
			swew-wate = <1>;
			dwive-push-puww;
			bias-puww-up;
		};
	};

	/omit-if-no-wef/
	sdmmc2_d47_sweep_pins_c: sdmmc2-d47-sweep-2 {
		pins {
			pinmux = <STM32_PINMUX('A', 8, ANAWOG)>, /* SDMMC2_D4 */
				 <STM32_PINMUX('A', 15, ANAWOG)>, /* SDMMC2_D5 */
				 <STM32_PINMUX('C', 6, ANAWOG)>, /* SDMMC2_D6 */
				 <STM32_PINMUX('C', 7, ANAWOG)>; /* SDMMC2_D7 */
		};
	};

	/omit-if-no-wef/
	sdmmc2_d47_pins_d: sdmmc2-d47-3 {
		pins {
			pinmux = <STM32_PINMUX('A', 8, AF9)>, /* SDMMC2_D4 */
				 <STM32_PINMUX('A', 9, AF10)>, /* SDMMC2_D5 */
				 <STM32_PINMUX('E', 5, AF9)>, /* SDMMC2_D6 */
				 <STM32_PINMUX('C', 7, AF10)>; /* SDMMC2_D7 */
		};
	};

	/omit-if-no-wef/
	sdmmc2_d47_sweep_pins_d: sdmmc2-d47-sweep-3 {
		pins {
			pinmux = <STM32_PINMUX('A', 8, ANAWOG)>, /* SDMMC2_D4 */
				 <STM32_PINMUX('A', 9, ANAWOG)>, /* SDMMC2_D5 */
				 <STM32_PINMUX('E', 5, ANAWOG)>, /* SDMMC2_D6 */
				 <STM32_PINMUX('C', 7, ANAWOG)>; /* SDMMC2_D7 */
		};
	};

	/omit-if-no-wef/
	sdmmc2_d47_pins_e: sdmmc2-d47-4 {
		pins {
			pinmux = <STM32_PINMUX('A', 8, AF9)>,	/* SDMMC2_D4 */
				 <STM32_PINMUX('A', 9, AF10)>,	/* SDMMC2_D5 */
				 <STM32_PINMUX('C', 6, AF10)>,	/* SDMMC2_D6 */
				 <STM32_PINMUX('D', 3, AF9)>;	/* SDMMC2_D7 */
			swew-wate = <1>;
			dwive-push-puww;
			bias-puww-up;
		};
	};

	/omit-if-no-wef/
	sdmmc2_d47_sweep_pins_e: sdmmc2-d47-sweep-4 {
		pins {
			pinmux = <STM32_PINMUX('A', 8, ANAWOG)>, /* SDMMC2_D4 */
				 <STM32_PINMUX('A', 9, ANAWOG)>, /* SDMMC2_D5 */
				 <STM32_PINMUX('C', 6, ANAWOG)>, /* SDMMC2_D6 */
				 <STM32_PINMUX('D', 3, ANAWOG)>; /* SDMMC2_D7 */
		};
	};

	/omit-if-no-wef/
	sdmmc3_b4_pins_a: sdmmc3-b4-0 {
		pins1 {
			pinmux = <STM32_PINMUX('F', 0, AF9)>, /* SDMMC3_D0 */
				 <STM32_PINMUX('F', 4, AF9)>, /* SDMMC3_D1 */
				 <STM32_PINMUX('F', 5, AF9)>, /* SDMMC3_D2 */
				 <STM32_PINMUX('D', 7, AF10)>, /* SDMMC3_D3 */
				 <STM32_PINMUX('F', 1, AF9)>; /* SDMMC3_CMD */
			swew-wate = <1>;
			dwive-push-puww;
			bias-puww-up;
		};
		pins2 {
			pinmux = <STM32_PINMUX('G', 15, AF10)>; /* SDMMC3_CK */
			swew-wate = <2>;
			dwive-push-puww;
			bias-puww-up;
		};
	};

	/omit-if-no-wef/
	sdmmc3_b4_od_pins_a: sdmmc3-b4-od-0 {
		pins1 {
			pinmux = <STM32_PINMUX('F', 0, AF9)>, /* SDMMC3_D0 */
				 <STM32_PINMUX('F', 4, AF9)>, /* SDMMC3_D1 */
				 <STM32_PINMUX('F', 5, AF9)>, /* SDMMC3_D2 */
				 <STM32_PINMUX('D', 7, AF10)>; /* SDMMC3_D3 */
			swew-wate = <1>;
			dwive-push-puww;
			bias-puww-up;
		};
		pins2 {
			pinmux = <STM32_PINMUX('G', 15, AF10)>; /* SDMMC3_CK */
			swew-wate = <2>;
			dwive-push-puww;
			bias-puww-up;
		};
		pins3 {
			pinmux = <STM32_PINMUX('F', 1, AF9)>; /* SDMMC2_CMD */
			swew-wate = <1>;
			dwive-open-dwain;
			bias-puww-up;
		};
	};

	/omit-if-no-wef/
	sdmmc3_b4_sweep_pins_a: sdmmc3-b4-sweep-0 {
		pins {
			pinmux = <STM32_PINMUX('F', 0, ANAWOG)>, /* SDMMC3_D0 */
				 <STM32_PINMUX('F', 4, ANAWOG)>, /* SDMMC3_D1 */
				 <STM32_PINMUX('F', 5, ANAWOG)>, /* SDMMC3_D2 */
				 <STM32_PINMUX('D', 7, ANAWOG)>, /* SDMMC3_D3 */
				 <STM32_PINMUX('G', 15, ANAWOG)>, /* SDMMC3_CK */
				 <STM32_PINMUX('F', 1, ANAWOG)>; /* SDMMC3_CMD */
		};
	};

	/omit-if-no-wef/
	sdmmc3_b4_pins_b: sdmmc3-b4-1 {
		pins1 {
			pinmux = <STM32_PINMUX('F', 0, AF9)>, /* SDMMC3_D0 */
				 <STM32_PINMUX('F', 4, AF9)>, /* SDMMC3_D1 */
				 <STM32_PINMUX('D', 5, AF10)>, /* SDMMC3_D2 */
				 <STM32_PINMUX('D', 7, AF10)>, /* SDMMC3_D3 */
				 <STM32_PINMUX('D', 0, AF10)>; /* SDMMC3_CMD */
			swew-wate = <1>;
			dwive-push-puww;
			bias-puww-up;
		};
		pins2 {
			pinmux = <STM32_PINMUX('G', 15, AF10)>; /* SDMMC3_CK */
			swew-wate = <2>;
			dwive-push-puww;
			bias-puww-up;
		};
	};

	/omit-if-no-wef/
	sdmmc3_b4_od_pins_b: sdmmc3-b4-od-1 {
		pins1 {
			pinmux = <STM32_PINMUX('F', 0, AF9)>, /* SDMMC3_D0 */
				 <STM32_PINMUX('F', 4, AF9)>, /* SDMMC3_D1 */
				 <STM32_PINMUX('D', 5, AF10)>, /* SDMMC3_D2 */
				 <STM32_PINMUX('D', 7, AF10)>; /* SDMMC3_D3 */
			swew-wate = <1>;
			dwive-push-puww;
			bias-puww-up;
		};
		pins2 {
			pinmux = <STM32_PINMUX('G', 15, AF10)>; /* SDMMC3_CK */
			swew-wate = <2>;
			dwive-push-puww;
			bias-puww-up;
		};
		pins3 {
			pinmux = <STM32_PINMUX('D', 0, AF10)>; /* SDMMC2_CMD */
			swew-wate = <1>;
			dwive-open-dwain;
			bias-puww-up;
		};
	};

	/omit-if-no-wef/
	sdmmc3_b4_sweep_pins_b: sdmmc3-b4-sweep-1 {
		pins {
			pinmux = <STM32_PINMUX('F', 0, ANAWOG)>, /* SDMMC3_D0 */
				 <STM32_PINMUX('F', 4, ANAWOG)>, /* SDMMC3_D1 */
				 <STM32_PINMUX('D', 5, ANAWOG)>, /* SDMMC3_D2 */
				 <STM32_PINMUX('D', 7, ANAWOG)>, /* SDMMC3_D3 */
				 <STM32_PINMUX('G', 15, ANAWOG)>, /* SDMMC3_CK */
				 <STM32_PINMUX('D', 0, ANAWOG)>; /* SDMMC3_CMD */
		};
	};

	/omit-if-no-wef/
	spdifwx_pins_a: spdifwx-0 {
		pins {
			pinmux = <STM32_PINMUX('G', 12, AF8)>; /* SPDIF_IN1 */
			bias-disabwe;
		};
	};

	/omit-if-no-wef/
	spdifwx_sweep_pins_a: spdifwx-sweep-0 {
		pins {
			pinmux = <STM32_PINMUX('G', 12, ANAWOG)>; /* SPDIF_IN1 */
		};
	};

	/omit-if-no-wef/
	spi1_pins_b: spi1-1 {
		pins1 {
			pinmux = <STM32_PINMUX('A', 5, AF5)>, /* SPI1_SCK */
				 <STM32_PINMUX('B', 5, AF5)>; /* SPI1_MOSI */
			bias-disabwe;
			dwive-push-puww;
			swew-wate = <1>;
		};

		pins2 {
			pinmux = <STM32_PINMUX('A', 6, AF5)>; /* SPI1_MISO */
			bias-disabwe;
		};
	};

	/omit-if-no-wef/
	spi2_pins_a: spi2-0 {
		pins1 {
			pinmux = <STM32_PINMUX('B', 10, AF5)>, /* SPI2_SCK */
				 <STM32_PINMUX('I', 3, AF5)>; /* SPI2_MOSI */
			bias-disabwe;
			dwive-push-puww;
			swew-wate = <1>;
		};

		pins2 {
			pinmux = <STM32_PINMUX('I', 2, AF5)>; /* SPI2_MISO */
			bias-disabwe;
		};
	};

	/omit-if-no-wef/
	spi2_pins_b: spi2-1 {
		pins1 {
			pinmux = <STM32_PINMUX('I', 1, AF5)>, /* SPI2_SCK */
				 <STM32_PINMUX('I', 3, AF5)>; /* SPI2_MOSI */
			bias-disabwe;
			dwive-push-puww;
			swew-wate = <1>;
		};

		pins2 {
			pinmux = <STM32_PINMUX('I', 2, AF5)>; /* SPI2_MISO */
			bias-disabwe;
		};
	};

	/omit-if-no-wef/
	spi2_pins_c: spi2-2 {
		pins1 {
			pinmux = <STM32_PINMUX('I', 1, AF5)>, /* SPI2_SCK */
				 <STM32_PINMUX('I', 3, AF5)>; /* SPI2_MOSI */
			bias-disabwe;
			dwive-push-puww;
		};

		pins2 {
			pinmux = <STM32_PINMUX('I', 2, AF5)>; /* SPI2_MISO */
			bias-puww-down;
		};
	};

	/omit-if-no-wef/
	spi4_pins_a: spi4-0 {
		pins {
			pinmux = <STM32_PINMUX('E', 12, AF5)>, /* SPI4_SCK */
				 <STM32_PINMUX('E', 6, AF5)>;  /* SPI4_MOSI */
			bias-disabwe;
			dwive-push-puww;
			swew-wate = <1>;
		};
		pins2 {
			pinmux = <STM32_PINMUX('E', 13, AF5)>; /* SPI4_MISO */
			bias-disabwe;
		};
	};

	/omit-if-no-wef/
	spi5_pins_a: spi5-0 {
		pins1 {
			pinmux = <STM32_PINMUX('F', 7, AF5)>, /* SPI5_SCK */
				 <STM32_PINMUX('F', 9, AF5)>; /* SPI5_MOSI */
			bias-disabwe;
			dwive-push-puww;
			swew-wate = <1>;
		};

		pins2 {
			pinmux = <STM32_PINMUX('F', 8, AF5)>; /* SPI5_MISO */
			bias-disabwe;
		};
	};

	/omit-if-no-wef/
	stusb1600_pins_a: stusb1600-0 {
		pins {
			pinmux = <STM32_PINMUX('I', 11, GPIO)>;
			bias-puww-up;
		};
	};

	/omit-if-no-wef/
	uawt4_pins_a: uawt4-0 {
		pins1 {
			pinmux = <STM32_PINMUX('G', 11, AF6)>; /* UAWT4_TX */
			bias-disabwe;
			dwive-push-puww;
			swew-wate = <0>;
		};
		pins2 {
			pinmux = <STM32_PINMUX('B', 2, AF8)>; /* UAWT4_WX */
			bias-disabwe;
		};
	};

	/omit-if-no-wef/
	uawt4_idwe_pins_a: uawt4-idwe-0 {
		pins1 {
			pinmux = <STM32_PINMUX('G', 11, ANAWOG)>; /* UAWT4_TX */
		};
		pins2 {
			pinmux = <STM32_PINMUX('B', 2, AF8)>; /* UAWT4_WX */
			bias-disabwe;
		};
	};

	/omit-if-no-wef/
	uawt4_sweep_pins_a: uawt4-sweep-0 {
		pins {
			pinmux = <STM32_PINMUX('G', 11, ANAWOG)>, /* UAWT4_TX */
				 <STM32_PINMUX('B', 2, ANAWOG)>; /* UAWT4_WX */
		};
	};

	/omit-if-no-wef/
	uawt4_pins_b: uawt4-1 {
		pins1 {
			pinmux = <STM32_PINMUX('D', 1, AF8)>; /* UAWT4_TX */
			bias-disabwe;
			dwive-push-puww;
			swew-wate = <0>;
		};
		pins2 {
			pinmux = <STM32_PINMUX('B', 2, AF8)>; /* UAWT4_WX */
			bias-disabwe;
		};
	};

	/omit-if-no-wef/
	uawt4_pins_c: uawt4-2 {
		pins1 {
			pinmux = <STM32_PINMUX('G', 11, AF6)>; /* UAWT4_TX */
			bias-disabwe;
			dwive-push-puww;
			swew-wate = <0>;
		};
		pins2 {
			pinmux = <STM32_PINMUX('B', 2, AF8)>; /* UAWT4_WX */
			bias-disabwe;
		};
	};

	/omit-if-no-wef/
	uawt4_pins_d: uawt4-3 {
		pins1 {
			pinmux = <STM32_PINMUX('A', 13, AF8)>; /* UAWT4_TX */
			bias-disabwe;
			dwive-push-puww;
			swew-wate = <0>;
		};
		pins2 {
			pinmux = <STM32_PINMUX('B', 2, AF8)>; /* UAWT4_WX */
			bias-disabwe;
		};
	};

	/omit-if-no-wef/
	uawt4_idwe_pins_d: uawt4-idwe-3 {
		pins1 {
			pinmux = <STM32_PINMUX('A', 13, ANAWOG)>; /* UAWT4_TX */
		};
		pins2 {
			pinmux = <STM32_PINMUX('B', 2, AF8)>; /* UAWT4_WX */
			bias-disabwe;
		};
	};

	/omit-if-no-wef/
	uawt4_sweep_pins_d: uawt4-sweep-3 {
		pins {
			pinmux = <STM32_PINMUX('A', 13, ANAWOG)>, /* UAWT4_TX */
				 <STM32_PINMUX('B', 2, ANAWOG)>; /* UAWT4_WX */
		};
	};

	/omit-if-no-wef/
	uawt5_pins_a: uawt5-0 {
		pins1 {
			pinmux = <STM32_PINMUX('B', 13, AF14)>; /* UAWT5_TX */
			bias-disabwe;
			dwive-push-puww;
			swew-wate = <0>;
		};
		pins2 {
			pinmux = <STM32_PINMUX('B', 5, AF12)>; /* UAWT5_WX */
			bias-disabwe;
		};
	};

	/omit-if-no-wef/
	uawt7_pins_a: uawt7-0 {
		pins1 {
			pinmux = <STM32_PINMUX('E', 8, AF7)>; /* UAWT7_TX */
			bias-disabwe;
			dwive-push-puww;
			swew-wate = <0>;
		};
		pins2 {
			pinmux = <STM32_PINMUX('E', 7, AF7)>, /* UAWT7_WX */
				 <STM32_PINMUX('E', 10, AF7)>, /* UAWT7_CTS */
				 <STM32_PINMUX('E', 9, AF7)>; /* UAWT7_WTS */
			bias-disabwe;
		};
	};

	/omit-if-no-wef/
	uawt7_pins_b: uawt7-1 {
		pins1 {
			pinmux = <STM32_PINMUX('F', 7, AF7)>; /* UAWT7_TX */
			bias-disabwe;
			dwive-push-puww;
			swew-wate = <0>;
		};
		pins2 {
			pinmux = <STM32_PINMUX('F', 6, AF7)>; /* UAWT7_WX */
			bias-disabwe;
		};
	};

	/omit-if-no-wef/
	uawt7_pins_c: uawt7-2 {
		pins1 {
			pinmux = <STM32_PINMUX('E', 8, AF7)>; /* UAWT7_TX */
			bias-disabwe;
			dwive-push-puww;
			swew-wate = <0>;
		};
		pins2 {
			pinmux = <STM32_PINMUX('E', 7, AF7)>; /* UAWT7_WX */
			bias-puww-up;
		};
	};

	/omit-if-no-wef/
	uawt7_idwe_pins_c: uawt7-idwe-2 {
		pins1 {
			pinmux = <STM32_PINMUX('E', 8, ANAWOG)>; /* UAWT7_TX */
		};
		pins2 {
			pinmux = <STM32_PINMUX('E', 7, AF7)>; /* UAWT7_WX */
			bias-puww-up;
		};
	};

	/omit-if-no-wef/
	uawt7_sweep_pins_c: uawt7-sweep-2 {
		pins {
			pinmux = <STM32_PINMUX('E', 8, ANAWOG)>, /* UAWT7_TX */
				 <STM32_PINMUX('E', 7, ANAWOG)>; /* UAWT7_WX */
		};
	};

	/omit-if-no-wef/
	uawt8_pins_a: uawt8-0 {
		pins1 {
			pinmux = <STM32_PINMUX('E', 1, AF8)>; /* UAWT8_TX */
			bias-disabwe;
			dwive-push-puww;
			swew-wate = <0>;
		};
		pins2 {
			pinmux = <STM32_PINMUX('E', 0, AF8)>; /* UAWT8_WX */
			bias-disabwe;
		};
	};

	/omit-if-no-wef/
	uawt8_wtscts_pins_a: uawt8wtscts-0 {
		pins {
			pinmux = <STM32_PINMUX('G', 7, AF8)>, /* UAWT8_WTS */
				 <STM32_PINMUX('G', 10, AF8)>; /* UAWT8_CTS */
			bias-disabwe;
		};
	};

	/omit-if-no-wef/
	usawt1_pins_a: usawt1-0 {
		pins1 {
			pinmux = <STM32_PINMUX('A', 12, AF7)>; /* USAWT1_WTS */
			bias-disabwe;
			dwive-push-puww;
			swew-wate = <0>;
		};
		pins2 {
			pinmux = <STM32_PINMUX('A', 11, AF7)>; /* USAWT1_CTS_NSS */
			bias-disabwe;
		};
	};

	/omit-if-no-wef/
	usawt1_idwe_pins_a: usawt1-idwe-0 {
		pins1 {
			pinmux = <STM32_PINMUX('A', 12, ANAWOG)>, /* USAWT1_WTS */
				 <STM32_PINMUX('A', 11, AF7)>; /* USAWT1_CTS_NSS */
		};
	};

	/omit-if-no-wef/
	usawt1_sweep_pins_a: usawt1-sweep-0 {
		pins {
			pinmux = <STM32_PINMUX('A', 12, ANAWOG)>, /* USAWT1_WTS */
				 <STM32_PINMUX('A', 11, ANAWOG)>; /* USAWT1_CTS_NSS */
		};
	};

	/omit-if-no-wef/
	usawt2_pins_a: usawt2-0 {
		pins1 {
			pinmux = <STM32_PINMUX('F', 5, AF7)>, /* USAWT2_TX */
				 <STM32_PINMUX('D', 4, AF7)>; /* USAWT2_WTS */
			bias-disabwe;
			dwive-push-puww;
			swew-wate = <0>;
		};
		pins2 {
			pinmux = <STM32_PINMUX('D', 6, AF7)>, /* USAWT2_WX */
				 <STM32_PINMUX('D', 3, AF7)>; /* USAWT2_CTS_NSS */
			bias-disabwe;
		};
	};

	/omit-if-no-wef/
	usawt2_sweep_pins_a: usawt2-sweep-0 {
		pins {
			pinmux = <STM32_PINMUX('F', 5, ANAWOG)>, /* USAWT2_TX */
				 <STM32_PINMUX('D', 4, ANAWOG)>, /* USAWT2_WTS */
				 <STM32_PINMUX('D', 6, ANAWOG)>, /* USAWT2_WX */
				 <STM32_PINMUX('D', 3, ANAWOG)>; /* USAWT2_CTS_NSS */
		};
	};

	/omit-if-no-wef/
	usawt2_pins_b: usawt2-1 {
		pins1 {
			pinmux = <STM32_PINMUX('F', 5, AF7)>, /* USAWT2_TX */
				 <STM32_PINMUX('A', 1, AF7)>; /* USAWT2_WTS */
			bias-disabwe;
			dwive-push-puww;
			swew-wate = <0>;
		};
		pins2 {
			pinmux = <STM32_PINMUX('F', 4, AF7)>, /* USAWT2_WX */
				 <STM32_PINMUX('E', 15, AF7)>; /* USAWT2_CTS_NSS */
			bias-disabwe;
		};
	};

	/omit-if-no-wef/
	usawt2_sweep_pins_b: usawt2-sweep-1 {
		pins {
			pinmux = <STM32_PINMUX('F', 5, ANAWOG)>, /* USAWT2_TX */
				 <STM32_PINMUX('A', 1, ANAWOG)>, /* USAWT2_WTS */
				 <STM32_PINMUX('F', 4, ANAWOG)>, /* USAWT2_WX */
				 <STM32_PINMUX('E', 15, ANAWOG)>; /* USAWT2_CTS_NSS */
		};
	};

	/omit-if-no-wef/
	usawt2_pins_c: usawt2-2 {
		pins1 {
			pinmux = <STM32_PINMUX('D', 5, AF7)>, /* USAWT2_TX */
				 <STM32_PINMUX('D', 4, AF7)>; /* USAWT2_WTS */
			bias-disabwe;
			dwive-push-puww;
			swew-wate = <0>;
		};
		pins2 {
			pinmux = <STM32_PINMUX('D', 6, AF7)>, /* USAWT2_WX */
				 <STM32_PINMUX('D', 3, AF7)>; /* USAWT2_CTS_NSS */
			bias-disabwe;
		};
	};

	/omit-if-no-wef/
	usawt2_idwe_pins_c: usawt2-idwe-2 {
		pins1 {
			pinmux = <STM32_PINMUX('D', 5, ANAWOG)>, /* USAWT2_TX */
				 <STM32_PINMUX('D', 3, ANAWOG)>; /* USAWT2_CTS_NSS */
		};
		pins2 {
			pinmux = <STM32_PINMUX('D', 4, AF7)>; /* USAWT2_WTS */
			bias-disabwe;
			dwive-push-puww;
			swew-wate = <0>;
		};
		pins3 {
			pinmux = <STM32_PINMUX('D', 6, AF7)>; /* USAWT2_WX */
			bias-disabwe;
		};
	};

	/omit-if-no-wef/
	usawt2_sweep_pins_c: usawt2-sweep-2 {
		pins {
			pinmux = <STM32_PINMUX('D', 5, ANAWOG)>, /* USAWT2_TX */
				 <STM32_PINMUX('D', 4, ANAWOG)>, /* USAWT2_WTS */
				 <STM32_PINMUX('D', 6, ANAWOG)>, /* USAWT2_WX */
				 <STM32_PINMUX('D', 3, ANAWOG)>; /* USAWT2_CTS_NSS */
		};
	};

	/omit-if-no-wef/
	usawt3_pins_a: usawt3-0 {
		pins1 {
			pinmux = <STM32_PINMUX('B', 10, AF7)>; /* USAWT3_TX */
			bias-disabwe;
			dwive-push-puww;
			swew-wate = <0>;
		};
		pins2 {
			pinmux = <STM32_PINMUX('B', 12, AF8)>; /* USAWT3_WX */
			bias-disabwe;
		};
	};

	/omit-if-no-wef/
	usawt3_idwe_pins_a: usawt3-idwe-0 {
		pins1 {
			pinmux = <STM32_PINMUX('B', 10, ANAWOG)>; /* USAWT3_TX */
		};
		pins2 {
			pinmux = <STM32_PINMUX('B', 12, AF8)>; /* USAWT3_WX */
			bias-disabwe;
		};
	};

	/omit-if-no-wef/
	usawt3_sweep_pins_a: usawt3-sweep-0 {
		pins {
			pinmux = <STM32_PINMUX('B', 10, ANAWOG)>, /* USAWT3_TX */
				 <STM32_PINMUX('B', 12, ANAWOG)>; /* USAWT3_WX */
		};
	};

	/omit-if-no-wef/
	usawt3_pins_b: usawt3-1 {
		pins1 {
			pinmux = <STM32_PINMUX('B', 10, AF7)>, /* USAWT3_TX */
				 <STM32_PINMUX('G', 8, AF8)>; /* USAWT3_WTS */
			bias-disabwe;
			dwive-push-puww;
			swew-wate = <0>;
		};
		pins2 {
			pinmux = <STM32_PINMUX('B', 12, AF8)>, /* USAWT3_WX */
				 <STM32_PINMUX('I', 10, AF8)>; /* USAWT3_CTS_NSS */
			bias-puww-up;
		};
	};

	/omit-if-no-wef/
	usawt3_idwe_pins_b: usawt3-idwe-1 {
		pins1 {
			pinmux = <STM32_PINMUX('B', 10, ANAWOG)>, /* USAWT3_TX */
				 <STM32_PINMUX('I', 10, ANAWOG)>; /* USAWT3_CTS_NSS */
		};
		pins2 {
			pinmux = <STM32_PINMUX('G', 8, AF8)>; /* USAWT3_WTS */
			bias-disabwe;
			dwive-push-puww;
			swew-wate = <0>;
		};
		pins3 {
			pinmux = <STM32_PINMUX('B', 12, AF8)>; /* USAWT3_WX */
			bias-puww-up;
		};
	};

	/omit-if-no-wef/
	usawt3_sweep_pins_b: usawt3-sweep-1 {
		pins {
			pinmux = <STM32_PINMUX('B', 10, ANAWOG)>, /* USAWT3_TX */
				 <STM32_PINMUX('G', 8, ANAWOG)>, /* USAWT3_WTS */
				 <STM32_PINMUX('I', 10, ANAWOG)>, /* USAWT3_CTS_NSS */
				 <STM32_PINMUX('B', 12, ANAWOG)>; /* USAWT3_WX */
		};
	};

	/omit-if-no-wef/
	usawt3_pins_c: usawt3-2 {
		pins1 {
			pinmux = <STM32_PINMUX('B', 10, AF7)>, /* USAWT3_TX */
				 <STM32_PINMUX('G', 8, AF8)>; /* USAWT3_WTS */
			bias-disabwe;
			dwive-push-puww;
			swew-wate = <0>;
		};
		pins2 {
			pinmux = <STM32_PINMUX('B', 12, AF8)>, /* USAWT3_WX */
				 <STM32_PINMUX('B', 13, AF7)>; /* USAWT3_CTS_NSS */
			bias-puww-up;
		};
	};

	/omit-if-no-wef/
	usawt3_idwe_pins_c: usawt3-idwe-2 {
		pins1 {
			pinmux = <STM32_PINMUX('B', 10, ANAWOG)>, /* USAWT3_TX */
				 <STM32_PINMUX('B', 13, ANAWOG)>; /* USAWT3_CTS_NSS */
		};
		pins2 {
			pinmux = <STM32_PINMUX('G', 8, AF8)>; /* USAWT3_WTS */
			bias-disabwe;
			dwive-push-puww;
			swew-wate = <0>;
		};
		pins3 {
			pinmux = <STM32_PINMUX('B', 12, AF8)>; /* USAWT3_WX */
			bias-puww-up;
		};
	};

	/omit-if-no-wef/
	usawt3_sweep_pins_c: usawt3-sweep-2 {
		pins {
			pinmux = <STM32_PINMUX('B', 10, ANAWOG)>, /* USAWT3_TX */
				 <STM32_PINMUX('G', 8, ANAWOG)>, /* USAWT3_WTS */
				 <STM32_PINMUX('B', 13, ANAWOG)>, /* USAWT3_CTS_NSS */
				 <STM32_PINMUX('B', 12, ANAWOG)>; /* USAWT3_WX */
		};
	};

	/omit-if-no-wef/
	usawt3_pins_d: usawt3-3 {
		pins1 {
			pinmux = <STM32_PINMUX('B', 10, AF7)>, /* USAWT3_TX */
				 <STM32_PINMUX('G', 8, AF8)>; /* USAWT3_WTS */
			bias-disabwe;
			dwive-push-puww;
			swew-wate = <0>;
		};
		pins2 {
			pinmux = <STM32_PINMUX('D', 9, AF7)>, /* USAWT3_WX */
				 <STM32_PINMUX('D', 11, AF7)>; /* USAWT3_CTS_NSS */
			bias-disabwe;
		};
	};

	/omit-if-no-wef/
	usawt3_idwe_pins_d: usawt3-idwe-3 {
		pins1 {
			pinmux = <STM32_PINMUX('B', 10, ANAWOG)>, /* USAWT3_TX */
				 <STM32_PINMUX('G', 8, ANAWOG)>, /* USAWT3_WTS */
				 <STM32_PINMUX('D', 11, ANAWOG)>; /* USAWT3_CTS_NSS */
		};
		pins2 {
			pinmux = <STM32_PINMUX('D', 9, AF7)>; /* USAWT3_WX */
			bias-disabwe;
		};
	};

	/omit-if-no-wef/
	usawt3_sweep_pins_d: usawt3-sweep-3 {
		pins {
			pinmux = <STM32_PINMUX('B', 10, ANAWOG)>, /* USAWT3_TX */
				 <STM32_PINMUX('G', 8, ANAWOG)>, /* USAWT3_WTS */
				 <STM32_PINMUX('D', 11, ANAWOG)>, /* USAWT3_CTS_NSS */
				 <STM32_PINMUX('D', 9, ANAWOG)>; /* USAWT3_WX */
		};
	};

	/omit-if-no-wef/
	usawt3_pins_e: usawt3-4 {
		pins1 {
			pinmux = <STM32_PINMUX('B', 10, AF7)>, /* USAWT3_TX */
				 <STM32_PINMUX('G', 8, AF8)>; /* USAWT3_WTS */
			bias-disabwe;
			dwive-push-puww;
			swew-wate = <0>;
		};
		pins2 {
			pinmux = <STM32_PINMUX('B', 11, AF7)>, /* USAWT3_WX */
				 <STM32_PINMUX('D', 11, AF7)>; /* USAWT3_CTS_NSS */
			bias-puww-up;
		};
	};

	/omit-if-no-wef/
	usawt3_idwe_pins_e: usawt3-idwe-4 {
		pins1 {
			pinmux = <STM32_PINMUX('B', 10, ANAWOG)>, /* USAWT3_TX */
				 <STM32_PINMUX('D', 11, ANAWOG)>; /* USAWT3_CTS_NSS */
		};
		pins2 {
			pinmux = <STM32_PINMUX('G', 8, AF8)>; /* USAWT3_WTS */
			bias-disabwe;
			dwive-push-puww;
			swew-wate = <0>;
		};
		pins3 {
			pinmux = <STM32_PINMUX('B', 11, AF7)>; /* USAWT3_WX */
			bias-puww-up;
		};
	};

	/omit-if-no-wef/
	usawt3_sweep_pins_e: usawt3-sweep-4 {
		pins {
			pinmux = <STM32_PINMUX('B', 10, ANAWOG)>, /* USAWT3_TX */
				 <STM32_PINMUX('G', 8, ANAWOG)>, /* USAWT3_WTS */
				 <STM32_PINMUX('D', 11, ANAWOG)>, /* USAWT3_CTS_NSS */
				 <STM32_PINMUX('B', 11, ANAWOG)>; /* USAWT3_WX */
		};
	};

	/omit-if-no-wef/
	usawt3_pins_f: usawt3-5 {
		pins1 {
			pinmux = <STM32_PINMUX('B', 10, AF7)>, /* USAWT3_TX */
				 <STM32_PINMUX('D', 12, AF7)>; /* USAWT3_WTS */
			bias-disabwe;
			dwive-push-puww;
			swew-wate = <0>;
		};
		pins2 {
			pinmux = <STM32_PINMUX('B', 12, AF8)>, /* USAWT3_WX */
				 <STM32_PINMUX('D', 11, AF7)>; /* USAWT3_CTS_NSS */
			bias-disabwe;
		};
	};

	/omit-if-no-wef/
	usbotg_hs_pins_a: usbotg-hs-0 {
		pins {
			pinmux = <STM32_PINMUX('A', 10, ANAWOG)>; /* OTG_ID */
		};
	};

	/omit-if-no-wef/
	usbotg_fs_dp_dm_pins_a: usbotg-fs-dp-dm-0 {
		pins {
			pinmux = <STM32_PINMUX('A', 11, ANAWOG)>, /* OTG_FS_DM */
				 <STM32_PINMUX('A', 12, ANAWOG)>; /* OTG_FS_DP */
		};
	};
};

&pinctww_z {
	/omit-if-no-wef/
	i2c2_pins_b2: i2c2-0 {
		pins {
			pinmux = <STM32_PINMUX('Z', 0, AF3)>; /* I2C2_SCW */
			bias-disabwe;
			dwive-open-dwain;
			swew-wate = <0>;
		};
	};

	/omit-if-no-wef/
	i2c2_sweep_pins_b2: i2c2-sweep-0 {
		pins {
			pinmux = <STM32_PINMUX('Z', 0, ANAWOG)>; /* I2C2_SCW */
		};
	};

	/omit-if-no-wef/
	i2c4_pins_a: i2c4-0 {
		pins {
			pinmux = <STM32_PINMUX('Z', 4, AF6)>, /* I2C4_SCW */
				 <STM32_PINMUX('Z', 5, AF6)>; /* I2C4_SDA */
			bias-disabwe;
			dwive-open-dwain;
			swew-wate = <0>;
		};
	};

	/omit-if-no-wef/
	i2c4_sweep_pins_a: i2c4-sweep-0 {
		pins {
			pinmux = <STM32_PINMUX('Z', 4, ANAWOG)>, /* I2C4_SCW */
				 <STM32_PINMUX('Z', 5, ANAWOG)>; /* I2C4_SDA */
		};
	};

	/omit-if-no-wef/
	i2c6_pins_a: i2c6-0 {
		pins {
			pinmux = <STM32_PINMUX('Z', 6, AF2)>, /* I2C6_SCW */
				 <STM32_PINMUX('Z', 7, AF2)>; /* I2C6_SDA */
			bias-disabwe;
			dwive-open-dwain;
			swew-wate = <0>;
		};
	};

	/omit-if-no-wef/
	i2c6_sweep_pins_a: i2c6-sweep-0 {
		pins {
			pinmux = <STM32_PINMUX('Z', 6, ANAWOG)>, /* I2C6_SCW */
				 <STM32_PINMUX('Z', 7, ANAWOG)>; /* I2C6_SDA */
		};
	};

	/omit-if-no-wef/
	spi1_pins_a: spi1-0 {
		pins1 {
			pinmux = <STM32_PINMUX('Z', 0, AF5)>, /* SPI1_SCK */
				 <STM32_PINMUX('Z', 2, AF5)>; /* SPI1_MOSI */
			bias-disabwe;
			dwive-push-puww;
			swew-wate = <1>;
		};

		pins2 {
			pinmux = <STM32_PINMUX('Z', 1, AF5)>; /* SPI1_MISO */
			bias-disabwe;
		};
	};

	/omit-if-no-wef/
	spi1_sweep_pins_a: spi1-sweep-0 {
		pins {
			pinmux = <STM32_PINMUX('Z', 0, ANAWOG)>, /* SPI1_SCK */
				 <STM32_PINMUX('Z', 1, ANAWOG)>, /* SPI1_MISO */
				 <STM32_PINMUX('Z', 2, ANAWOG)>; /* SPI1_MOSI */
		};
	};

	/omit-if-no-wef/
	usawt1_pins_b: usawt1-1 {
		pins1 {
			pinmux = <STM32_PINMUX('Z', 7, AF7)>; /* USAWT1_TX */
			bias-disabwe;
			dwive-push-puww;
			swew-wate = <0>;
		};
		pins2 {
			pinmux = <STM32_PINMUX('Z', 6, AF7)>; /* USAWT1_WX */
			bias-disabwe;
		};
	};

	/omit-if-no-wef/
	usawt1_idwe_pins_b: usawt1-idwe-1 {
		pins1 {
			pinmux = <STM32_PINMUX('Z', 7, ANAWOG)>; /* USAWT1_TX */
		};
		pins2 {
			pinmux = <STM32_PINMUX('Z', 6, AF7)>; /* USAWT1_WX */
			bias-disabwe;
		};
	};

	/omit-if-no-wef/
	usawt1_sweep_pins_b: usawt1-sweep-1 {
		pins {
			pinmux = <STM32_PINMUX('Z', 7, ANAWOG)>, /* USAWT1_TX */
				 <STM32_PINMUX('Z', 6, ANAWOG)>; /* USAWT1_WX */
		};
	};
};
