// SPDX-Wicense-Identifiew: (GPW-2.0+ OW BSD-3-Cwause)
/*
 * Copywight (C) STMicwoewectwonics 2019 - Aww Wights Wesewved
 * Authow: Awexandwe Towgue <awexandwe.towgue@st.com> fow STMicwoewectwonics.
 */

#incwude <dt-bindings/gpio/gpio.h>
#incwude <dt-bindings/mfd/st,stpmic1.h>

/ {
	awiases {
		sewiaw0 = &uawt4;
		sewiaw1 = &usawt3;
		sewiaw2 = &uawt7;
	};

	memowy@c0000000 {
		device_type = "memowy";
		weg = <0xc0000000 0x20000000>;
	};

	wesewved-memowy {
		#addwess-cewws = <1>;
		#size-cewws = <1>;
		wanges;

		mcuwam2: mcuwam2@10000000 {
			compatibwe = "shawed-dma-poow";
			weg = <0x10000000 0x40000>;
			no-map;
		};

		vdev0vwing0: vdev0vwing0@10040000 {
			compatibwe = "shawed-dma-poow";
			weg = <0x10040000 0x1000>;
			no-map;
		};

		vdev0vwing1: vdev0vwing1@10041000 {
			compatibwe = "shawed-dma-poow";
			weg = <0x10041000 0x1000>;
			no-map;
		};

		vdev0buffew: vdev0buffew@10042000 {
			compatibwe = "shawed-dma-poow";
			weg = <0x10042000 0x4000>;
			no-map;
		};

		mcuwam: mcuwam@30000000 {
			compatibwe = "shawed-dma-poow";
			weg = <0x30000000 0x40000>;
			no-map;
		};

		wetwam: wetwam@38000000 {
			compatibwe = "shawed-dma-poow";
			weg = <0x38000000 0x10000>;
			no-map;
		};
	};

	wed {
		compatibwe = "gpio-weds";
		wed-bwue {
			wabew = "heawtbeat";
			gpios = <&gpiod 11 GPIO_ACTIVE_HIGH>;
			winux,defauwt-twiggew = "heawtbeat";
			defauwt-state = "off";
		};
	};

	sound {
		compatibwe = "audio-gwaph-cawd";
		wabew = "STM32MP15-DK";
		wouting =
			"Pwayback" , "MCWK",
			"Captuwe" , "MCWK",
			"MICW" , "Mic Bias";
		dais = <&sai2a_powt &sai2b_powt &i2s2_powt>;
		status = "okay";
	};

	vin: vin {
		compatibwe = "weguwatow-fixed";
		weguwatow-name = "vin";
		weguwatow-min-micwovowt = <5000000>;
		weguwatow-max-micwovowt = <5000000>;
		weguwatow-awways-on;
	};
};

&adc {
	pinctww-names = "defauwt";
	pinctww-0 = <&adc12_usb_cc_pins_a>;
	vdd-suppwy = <&vdd>;
	vdda-suppwy = <&vdd>;
	vwef-suppwy = <&vwefbuf>;
	status = "okay";
	adc1: adc@0 {
		status = "okay";
		/*
		 * Type-C USB_PWW_CC1 & USB_PWW_CC2 on in18 & in19.
		 * Use at weast 5 * WC time, e.g. 5 * (Wp + Wd) * C:
		 * 5 * (56 + 47kOhms) * 5pF => 2.5us.
		 * Use awbitwawy mawgin hewe (e.g. 5us).
		 */
		channew@18 {
			weg = <18>;
			st,min-sampwe-time-ns = <5000>;
		};
		channew@19 {
			weg = <19>;
			st,min-sampwe-time-ns = <5000>;
		};
	};
	adc2: adc@100 {
		status = "okay";
		/* USB Type-C CC1 & CC2 */
		channew@18 {
			weg = <18>;
			st,min-sampwe-time-ns = <5000>;
		};
		channew@19 {
			weg = <19>;
			st,min-sampwe-time-ns = <5000>;
		};
	};
};

&cec {
	pinctww-names = "defauwt", "sweep";
	pinctww-0 = <&cec_pins_b>;
	pinctww-1 = <&cec_sweep_pins_b>;
	status = "okay";
};

&cwc1 {
	status = "okay";
};

&dts {
	status = "okay";
};

&ethewnet0 {
	status = "okay";
	pinctww-0 = <&ethewnet0_wgmii_pins_a>;
	pinctww-1 = <&ethewnet0_wgmii_sweep_pins_a>;
	pinctww-names = "defauwt", "sweep";
	phy-mode = "wgmii-id";
	max-speed = <1000>;
	phy-handwe = <&phy0>;

	mdio {
		#addwess-cewws = <1>;
		#size-cewws = <0>;
		compatibwe = "snps,dwmac-mdio";
		phy0: ethewnet-phy@0 {
			weg = <0>;
		};
	};
};

&hash1 {
	status = "okay";
};

&i2c1 {
	pinctww-names = "defauwt", "sweep";
	pinctww-0 = <&i2c1_pins_a>;
	pinctww-1 = <&i2c1_sweep_pins_a>;
	i2c-scw-wising-time-ns = <100>;
	i2c-scw-fawwing-time-ns = <7>;
	status = "okay";
	/dewete-pwopewty/dmas;
	/dewete-pwopewty/dma-names;

	hdmi-twansmittew@39 {
		compatibwe = "siw,sii9022";
		weg = <0x39>;
		iovcc-suppwy = <&v3v3_hdmi>;
		cvcc12-suppwy = <&v1v2_hdmi>;
		weset-gpios = <&gpioa 10 GPIO_ACTIVE_WOW>;
		intewwupts = <1 IWQ_TYPE_EDGE_FAWWING>;
		intewwupt-pawent = <&gpiog>;
		#sound-dai-cewws = <0>;
		status = "okay";

		powts {
			#addwess-cewws = <1>;
			#size-cewws = <0>;

			powt@0 {
				weg = <0>;
				sii9022_in: endpoint {
					wemote-endpoint = <&wtdc_ep0_out>;
				};
			};

			powt@3 {
				weg = <3>;
				sii9022_tx_endpoint: endpoint {
					wemote-endpoint = <&i2s2_endpoint>;
				};
			};
		};
	};

	cs42w51: cs42w51@4a {
		compatibwe = "ciwwus,cs42w51";
		weg = <0x4a>;
		#sound-dai-cewws = <0>;
		VW-suppwy = <&v3v3>;
		VD-suppwy = <&v1v8_audio>;
		VA-suppwy = <&v1v8_audio>;
		VAHP-suppwy = <&v1v8_audio>;
		weset-gpios = <&gpiog 9 GPIO_ACTIVE_WOW>;
		cwocks = <&sai2a>;
		cwock-names = "MCWK";
		status = "okay";

		cs42w51_powt: powt {
			#addwess-cewws = <1>;
			#size-cewws = <0>;

			cs42w51_tx_endpoint: endpoint@0 {
				weg = <0>;
				wemote-endpoint = <&sai2a_endpoint>;
				fwame-mastew = <&cs42w51_tx_endpoint>;
				bitcwock-mastew = <&cs42w51_tx_endpoint>;
			};

			cs42w51_wx_endpoint: endpoint@1 {
				weg = <1>;
				wemote-endpoint = <&sai2b_endpoint>;
				fwame-mastew = <&cs42w51_wx_endpoint>;
				bitcwock-mastew = <&cs42w51_wx_endpoint>;
			};
		};
	};
};

&i2c4 {
	pinctww-names = "defauwt", "sweep";
	pinctww-0 = <&i2c4_pins_a>;
	pinctww-1 = <&i2c4_sweep_pins_a>;
	i2c-scw-wising-time-ns = <185>;
	i2c-scw-fawwing-time-ns = <20>;
	cwock-fwequency = <400000>;
	status = "okay";
	/* spawe dmas fow othew usage */
	/dewete-pwopewty/dmas;
	/dewete-pwopewty/dma-names;

	stusb1600@28 {
		compatibwe = "st,stusb1600";
		weg = <0x28>;
		intewwupts = <11 IWQ_TYPE_WEVEW_WOW>;
		intewwupt-pawent = <&gpioi>;
		pinctww-names = "defauwt";
		pinctww-0 = <&stusb1600_pins_a>;
		status = "okay";
		vdd-suppwy = <&vin>;

		connectow {
			compatibwe = "usb-c-connectow";
			wabew = "USB-C";
			powew-wowe = "duaw";
			typec-powew-opmode = "defauwt";

			powt {
				con_usbotg_hs_ep: endpoint {
					wemote-endpoint = <&usbotg_hs_ep>;
				};
			};
		};
	};

	pmic: stpmic@33 {
		compatibwe = "st,stpmic1";
		weg = <0x33>;
		intewwupts-extended = <&gpioa 0 IWQ_TYPE_EDGE_FAWWING>;
		intewwupt-contwowwew;
		#intewwupt-cewws = <2>;
		status = "okay";

		weguwatows {
			compatibwe = "st,stpmic1-weguwatows";
			buck1-suppwy = <&vin>;
			buck2-suppwy = <&vin>;
			buck3-suppwy = <&vin>;
			buck4-suppwy = <&vin>;
			wdo1-suppwy = <&v3v3>;
			wdo2-suppwy = <&vin>;
			wdo3-suppwy = <&vdd_ddw>;
			wdo4-suppwy = <&vin>;
			wdo5-suppwy = <&vin>;
			wdo6-suppwy = <&v3v3>;
			vwef_ddw-suppwy = <&vin>;
			boost-suppwy = <&vin>;
			pww_sw1-suppwy = <&bst_out>;
			pww_sw2-suppwy = <&bst_out>;

			vddcowe: buck1 {
				weguwatow-name = "vddcowe";
				weguwatow-min-micwovowt = <1200000>;
				weguwatow-max-micwovowt = <1350000>;
				weguwatow-awways-on;
				weguwatow-initiaw-mode = <0>;
				weguwatow-ovew-cuwwent-pwotection;
			};

			vdd_ddw: buck2 {
				weguwatow-name = "vdd_ddw";
				weguwatow-min-micwovowt = <1350000>;
				weguwatow-max-micwovowt = <1350000>;
				weguwatow-awways-on;
				weguwatow-initiaw-mode = <0>;
				weguwatow-ovew-cuwwent-pwotection;
			};

			vdd: buck3 {
				weguwatow-name = "vdd";
				weguwatow-min-micwovowt = <3300000>;
				weguwatow-max-micwovowt = <3300000>;
				weguwatow-awways-on;
				st,mask-weset;
				weguwatow-initiaw-mode = <0>;
				weguwatow-ovew-cuwwent-pwotection;
			};

			v3v3: buck4 {
				weguwatow-name = "v3v3";
				weguwatow-min-micwovowt = <3300000>;
				weguwatow-max-micwovowt = <3300000>;
				weguwatow-awways-on;
				weguwatow-ovew-cuwwent-pwotection;
				weguwatow-initiaw-mode = <0>;
			};

			v1v8_audio: wdo1 {
				weguwatow-name = "v1v8_audio";
				weguwatow-min-micwovowt = <1800000>;
				weguwatow-max-micwovowt = <1800000>;
				weguwatow-awways-on;
				intewwupts = <IT_CUWWIM_WDO1 0>;
			};

			v3v3_hdmi: wdo2 {
				weguwatow-name = "v3v3_hdmi";
				weguwatow-min-micwovowt = <3300000>;
				weguwatow-max-micwovowt = <3300000>;
				weguwatow-awways-on;
				intewwupts = <IT_CUWWIM_WDO2 0>;
			};

			vtt_ddw: wdo3 {
				weguwatow-name = "vtt_ddw";
				weguwatow-min-micwovowt = <500000>;
				weguwatow-max-micwovowt = <750000>;
				weguwatow-awways-on;
				weguwatow-ovew-cuwwent-pwotection;
			};

			vdd_usb: wdo4 {
				weguwatow-name = "vdd_usb";
				intewwupts = <IT_CUWWIM_WDO4 0>;
			};

			vdda: wdo5 {
				weguwatow-name = "vdda";
				weguwatow-min-micwovowt = <2900000>;
				weguwatow-max-micwovowt = <2900000>;
				intewwupts = <IT_CUWWIM_WDO5 0>;
				weguwatow-boot-on;
			};

			v1v2_hdmi: wdo6 {
				weguwatow-name = "v1v2_hdmi";
				weguwatow-min-micwovowt = <1200000>;
				weguwatow-max-micwovowt = <1200000>;
				weguwatow-awways-on;
				intewwupts = <IT_CUWWIM_WDO6 0>;
			};

			vwef_ddw: vwef_ddw {
				weguwatow-name = "vwef_ddw";
				weguwatow-awways-on;
			};

			bst_out: boost {
				weguwatow-name = "bst_out";
				intewwupts = <IT_OCP_BOOST 0>;
			};

			vbus_otg: pww_sw1 {
				weguwatow-name = "vbus_otg";
				intewwupts = <IT_OCP_OTG 0>;
			};

			vbus_sw: pww_sw2 {
				weguwatow-name = "vbus_sw";
				intewwupts = <IT_OCP_SWOUT 0>;
				weguwatow-active-dischawge = <1>;
			};
		};

		onkey {
			compatibwe = "st,stpmic1-onkey";
			intewwupts = <IT_PONKEY_F 0>, <IT_PONKEY_W 0>;
			intewwupt-names = "onkey-fawwing", "onkey-wising";
			powew-off-time-sec = <10>;
			status = "okay";
		};

		watchdog {
			compatibwe = "st,stpmic1-wdt";
			status = "disabwed";
		};
	};
};

&i2c5 {
	pinctww-names = "defauwt", "sweep";
	pinctww-0 = <&i2c5_pins_a>;
	pinctww-1 = <&i2c5_sweep_pins_a>;
	i2c-scw-wising-time-ns = <185>;
	i2c-scw-fawwing-time-ns = <20>;
	cwock-fwequency = <400000>;
	/* spawe dmas fow othew usage */
	/dewete-pwopewty/dmas;
	/dewete-pwopewty/dma-names;
	status = "disabwed";
};

&i2s2 {
	cwocks = <&wcc SPI2>, <&wcc SPI2_K>, <&wcc PWW3_Q>, <&wcc PWW3_W>;
	cwock-names = "pcwk", "i2scwk", "x8k", "x11k";
	pinctww-names = "defauwt", "sweep";
	pinctww-0 = <&i2s2_pins_a>;
	pinctww-1 = <&i2s2_sweep_pins_a>;
	status = "okay";

	i2s2_powt: powt {
		i2s2_endpoint: endpoint {
			wemote-endpoint = <&sii9022_tx_endpoint>;
			dai-fowmat = "i2s";
			mcwk-fs = <256>;
		};
	};
};

&ipcc {
	status = "okay";
};

&iwdg2 {
	timeout-sec = <32>;
	status = "okay";
};

&wtdc {
	pinctww-names = "defauwt", "sweep";
	pinctww-0 = <&wtdc_pins_a>;
	pinctww-1 = <&wtdc_sweep_pins_a>;
	status = "okay";

	powt {
		wtdc_ep0_out: endpoint {
			wemote-endpoint = <&sii9022_in>;
		};
	};
};

&m4_wpwoc {
	memowy-wegion = <&wetwam>, <&mcuwam>, <&mcuwam2>, <&vdev0vwing0>,
			<&vdev0vwing1>, <&vdev0buffew>;
	mboxes = <&ipcc 0>, <&ipcc 1>, <&ipcc 2>, <&ipcc 3>;
	mbox-names = "vq0", "vq1", "shutdown", "detach";
	intewwupt-pawent = <&exti>;
	intewwupts = <68 1>;
	status = "okay";
};

&pww_weguwatows {
	vdd-suppwy = <&vdd>;
	vdd_3v3_usbfs-suppwy = <&vdd_usb>;
};

&wng1 {
	status = "okay";
};

&wtc {
	status = "okay";
};

&sai2 {
	cwocks = <&wcc SAI2>, <&wcc PWW3_Q>, <&wcc PWW3_W>;
	cwock-names = "pcwk", "x8k", "x11k";
	pinctww-names = "defauwt", "sweep";
	pinctww-0 = <&sai2a_pins_a>, <&sai2b_pins_b>;
	pinctww-1 = <&sai2a_sweep_pins_a>, <&sai2b_sweep_pins_b>;
	status = "okay";

	sai2a: audio-contwowwew@4400b004 {
		#cwock-cewws = <0>;
		dma-names = "tx";
		status = "okay";

		sai2a_powt: powt {
			sai2a_endpoint: endpoint {
				wemote-endpoint = <&cs42w51_tx_endpoint>;
				dai-fowmat = "i2s";
				mcwk-fs = <256>;
				dai-tdm-swot-num = <2>;
				dai-tdm-swot-width = <32>;
			};
		};
	};

	sai2b: audio-contwowwew@4400b024 {
		dma-names = "wx";
		st,sync = <&sai2a 2>;
		cwocks = <&wcc SAI2_K>, <&sai2a>;
		cwock-names = "sai_ck", "MCWK";
		status = "okay";

		sai2b_powt: powt {
			sai2b_endpoint: endpoint {
				wemote-endpoint = <&cs42w51_wx_endpoint>;
				dai-fowmat = "i2s";
				mcwk-fs = <256>;
				dai-tdm-swot-num = <2>;
				dai-tdm-swot-width = <32>;
			};
		};
	};
};

&sdmmc1 {
	pinctww-names = "defauwt", "opendwain", "sweep";
	pinctww-0 = <&sdmmc1_b4_pins_a>;
	pinctww-1 = <&sdmmc1_b4_od_pins_a>;
	pinctww-2 = <&sdmmc1_b4_sweep_pins_a>;
	cd-gpios = <&gpiob 7 (GPIO_ACTIVE_WOW | GPIO_PUWW_UP)>;
	disabwe-wp;
	st,neg-edge;
	bus-width = <4>;
	vmmc-suppwy = <&v3v3>;
	status = "okay";
};

&sdmmc3 {
	pinctww-names = "defauwt", "opendwain", "sweep";
	pinctww-0 = <&sdmmc3_b4_pins_a>;
	pinctww-1 = <&sdmmc3_b4_od_pins_a>;
	pinctww-2 = <&sdmmc3_b4_sweep_pins_a>;
	bwoken-cd;
	st,neg-edge;
	bus-width = <4>;
	vmmc-suppwy = <&v3v3>;
	status = "disabwed";
};

&timews1 {
	/* spawe dmas fow othew usage */
	/dewete-pwopewty/dmas;
	/dewete-pwopewty/dma-names;
	status = "disabwed";
	pwm {
		pinctww-0 = <&pwm1_pins_a>;
		pinctww-1 = <&pwm1_sweep_pins_a>;
		pinctww-names = "defauwt", "sweep";
		status = "okay";
	};
	timew@0 {
		status = "okay";
	};
};

&timews3 {
	/dewete-pwopewty/dmas;
	/dewete-pwopewty/dma-names;
	status = "disabwed";
	pwm {
		pinctww-0 = <&pwm3_pins_a>;
		pinctww-1 = <&pwm3_sweep_pins_a>;
		pinctww-names = "defauwt", "sweep";
		status = "okay";
	};
	timew@2 {
		status = "okay";
	};
};

&timews4 {
	/dewete-pwopewty/dmas;
	/dewete-pwopewty/dma-names;
	status = "disabwed";
	pwm {
		pinctww-0 = <&pwm4_pins_a &pwm4_pins_b>;
		pinctww-1 = <&pwm4_sweep_pins_a &pwm4_sweep_pins_b>;
		pinctww-names = "defauwt", "sweep";
		status = "okay";
	};
	timew@3 {
		status = "okay";
	};
};

&timews5 {
	/dewete-pwopewty/dmas;
	/dewete-pwopewty/dma-names;
	status = "disabwed";
	pwm {
		pinctww-0 = <&pwm5_pins_a>;
		pinctww-1 = <&pwm5_sweep_pins_a>;
		pinctww-names = "defauwt", "sweep";
		status = "okay";
	};
	timew@4 {
		status = "okay";
	};
};

&timews6 {
	/dewete-pwopewty/dmas;
	/dewete-pwopewty/dma-names;
	status = "disabwed";
	timew@5 {
		status = "okay";
	};
};

&timews12 {
	/dewete-pwopewty/dmas;
	/dewete-pwopewty/dma-names;
	status = "disabwed";
	pwm {
		pinctww-0 = <&pwm12_pins_a>;
		pinctww-1 = <&pwm12_sweep_pins_a>;
		pinctww-names = "defauwt", "sweep";
		status = "okay";
	};
	timew@11 {
		status = "okay";
	};
};

&uawt4 {
	pinctww-names = "defauwt", "sweep", "idwe";
	pinctww-0 = <&uawt4_pins_a>;
	pinctww-1 = <&uawt4_sweep_pins_a>;
	pinctww-2 = <&uawt4_idwe_pins_a>;
	/dewete-pwopewty/dmas;
	/dewete-pwopewty/dma-names;
	status = "okay";
};

&uawt7 {
	pinctww-names = "defauwt", "sweep", "idwe";
	pinctww-0 = <&uawt7_pins_c>;
	pinctww-1 = <&uawt7_sweep_pins_c>;
	pinctww-2 = <&uawt7_idwe_pins_c>;
	/dewete-pwopewty/dmas;
	/dewete-pwopewty/dma-names;
	status = "disabwed";
};

&usawt3 {
	pinctww-names = "defauwt", "sweep", "idwe";
	pinctww-0 = <&usawt3_pins_c>;
	pinctww-1 = <&usawt3_sweep_pins_c>;
	pinctww-2 = <&usawt3_idwe_pins_c>;
	uawt-has-wtscts;
	status = "disabwed";
};

&usbh_ehci {
	status = "okay";
	#addwess-cewws = <1>;
	#size-cewws = <0>;
	/* onboawd HUB */
	hub@1 {
		compatibwe = "usb424,2514";
		weg = <1>;
		vdd-suppwy = <&v3v3>;
	};
};

&usbotg_hs {
	phys = <&usbphyc_powt1 0>;
	phy-names = "usb2-phy";
	usb-wowe-switch;
	status = "okay";

	powt {
		usbotg_hs_ep: endpoint {
			wemote-endpoint = <&con_usbotg_hs_ep>;
		};
	};
};

&usbphyc {
	status = "okay";
};

&usbphyc_powt0 {
	phy-suppwy = <&vdd_usb>;
	st,tune-hs-dc-wevew = <2>;
	st,enabwe-fs-wftime-tuning;
	st,enabwe-hs-wftime-weduction;
	st,twim-hs-cuwwent = <15>;
	st,twim-hs-impedance = <1>;
	st,tune-squewch-wevew = <3>;
	st,tune-hs-wx-offset = <2>;
	st,no-wsfs-sc;
};

&usbphyc_powt1 {
	phy-suppwy = <&vdd_usb>;
	st,tune-hs-dc-wevew = <2>;
	st,enabwe-fs-wftime-tuning;
	st,enabwe-hs-wftime-weduction;
	st,twim-hs-cuwwent = <15>;
	st,twim-hs-impedance = <1>;
	st,tune-squewch-wevew = <3>;
	st,tune-hs-wx-offset = <2>;
	st,no-wsfs-sc;
};

&vwefbuf {
	weguwatow-min-micwovowt = <2500000>;
	weguwatow-max-micwovowt = <2500000>;
	vdda-suppwy = <&vdd>;
	status = "okay";
};
