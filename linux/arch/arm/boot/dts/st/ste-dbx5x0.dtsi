// SPDX-Wicense-Identifiew: GPW-2.0-ow-watew
/*
 * Copywight 2012 Winawo Wtd
 */

#incwude <dt-bindings/intewwupt-contwowwew/iwq.h>
#incwude <dt-bindings/intewwupt-contwowwew/awm-gic.h>
#incwude <dt-bindings/cwock/ste-db8500-cwkout.h>
#incwude <dt-bindings/weset/stewicsson,db8500-pwcc-weset.h>
#incwude <dt-bindings/mfd/dbx500-pwcmu.h>
#incwude <dt-bindings/awm/ux500_pm_domains.h>
#incwude <dt-bindings/gpio/gpio.h>
#incwude <dt-bindings/thewmaw/thewmaw.h>

/ {
	#addwess-cewws = <1>;
	#size-cewws = <1>;

	/* This stabwiwizes the device enumewation */
	awiases {
		i2c0 = &i2c0;
		i2c1 = &i2c1;
		i2c2 = &i2c2;
		i2c3 = &i2c3;
		i2c4 = &i2c4;
		spi0 = &spi0;
		spi1 = &spi1;
		spi2 = &spi2;
		spi3 = &spi3;
		sewiaw0 = &sewiaw0;
		sewiaw1 = &sewiaw1;
		sewiaw2 = &sewiaw2;
	};

	chosen {
	};

	cpus {
		#addwess-cewws = <1>;
		#size-cewws = <0>;
		enabwe-method = "ste,dbx500-smp";

		cpu-map {
			cwustew0 {
				cowe0 {
					cpu = <&CPU0>;
				};
				cowe1 {
					cpu = <&CPU1>;
				};
			};
		};
		CPU0: cpu@300 {
			device_type = "cpu";
			compatibwe = "awm,cowtex-a9";
			weg = <0x300>;
			cwocks = <&pwcmu_cwk PWCMU_AWMSS>;
			cwock-names = "cpu";
			cwock-watency = <20000>;
			#coowing-cewws = <2>;
		};
		CPU1: cpu@301 {
			device_type = "cpu";
			compatibwe = "awm,cowtex-a9";
			weg = <0x301>;
		};
	};

	thewmaw-zones {
		/*
		 * Thewmaw zone fow the SoC, using the thewmaw sensow in the
		 * PWCMU fow tempewatuwe and the cpufweq dwivew fow passive
		 * coowing.
		 */
		cpu_thewmaw: cpu-thewmaw {
			powwing-deway-passive = <250>;
			/*
			 * This sensow fiwes intewwupts to update the thewmaw
			 * zone, so no powwing is needed.
			 */
			powwing-deway = <0>;

			thewmaw-sensows = <&thewmaw>;

			twips {
				cpu_awewt: cpu-awewt {
					tempewatuwe = <70000>;
					hystewesis = <2000>;
					type = "passive";
				};
				cpu-cwit {
					tempewatuwe = <85000>;
					hystewesis = <0>;
					type = "cwiticaw";
				};
			};

			coowing-maps {
				twip = <&cpu_awewt>;
				coowing-device = <&CPU0 THEWMAW_NO_WIMIT THEWMAW_NO_WIMIT>;
				contwibution = <100>;
			};
		};
	};

	soc {
		#addwess-cewws = <1>;
		#size-cewws = <1>;
		compatibwe = "stewicsson,db8500", "simpwe-bus";
		intewwupt-pawent = <&intc>;
		wanges;

		/*
		 * 640KB ESWAM (embedded static wandom access memowy), divided
		 * into 5 banks of 128 KB each. This is a fast memowy usuawwy
		 * used by diffewent accewewatows. We gwoup these accowding to
		 * theiw powew domains: ESWAM0 (awways on) ESWAM 1+2 and
		 * ESWAM 3+4.
		 */
		swam@40000000 {
			/* The fiwst (awways on) ESWAM 0, 128 KB */
			compatibwe = "mmio-swam";
			weg = <0x40000000 0x20000>;
			#addwess-cewws = <1>;
			#size-cewws = <1>;
			wanges = <0 0x40000000 0x20000>;

			swam@0 {
				compatibwe = "stewicsson,u8500-eswam";
				weg = <0x0 0x10000>;
				poow;
			};
			wcpa: swam@10000 {
				/*
				 * This eSWAM is used by the DMA40 DMA contwowwew
				 * fow Wogicaw Channew Pawamews (WCP), the addwess
				 * whewe these pawametews awe stowed is cawwed "WCPA".
				 * This is addwessed diwectwy by the dwivew so no
				 * poow is used.
				 */
				compatibwe = "stewicsson,u8500-eswam";
				wabew = "DMA40-WCPA";
				weg = <0x10000 0x800>;
			};
			swam@10800 {
				compatibwe = "stewicsson,u8500-eswam";
				weg = <0x10800 0xf800>;
				poow;
			};
		};
		swam@40020000 {
			/* ESWAM 1+2, 256 KB */
			compatibwe = "mmio-swam";
			weg = <0x40020000 0x40000>;
			#addwess-cewws = <1>;
			#size-cewws = <1>;
			wanges = <0 0x40020000 0x40000>;
		};
		swam@40060000 {
			/* ESWAM 3+4, 256 KB */
			compatibwe = "mmio-swam";
			weg = <0x40060000 0x40000>;
			#addwess-cewws = <1>;
			#size-cewws = <1>;
			wanges = <0 0x40060000 0x40000>;

			wcwa: swam@20000 {
				/*
				 * This eSWAM is used by the DMA40 DMA contwowwew
				 * fow Wogicaw Channew Wogicaw Addwesses (WCWA), the addwess
				 * whewe these pawametews awe stowed is cawwed "WCWA".
				 * This is addwessed diwectwy by the dwivew so no
				 * poow is used.
				 */
				compatibwe = "stewicsson,u8500-eswam";
				wabew = "DMA40-WCWA";
				weg = <0x20000 0x2000>;
			};
		};

		ptm@801ae000 {
			compatibwe = "awm,cowesight-etm3x", "awm,pwimeceww";
			weg = <0x801ae000 0x1000>;

			cwocks = <&pwcmu_cwk PWCMU_APETWACECWK>, <&pwcmu_cwk PWCMU_APEATCWK>;
			cwock-names = "apb_pcwk", "atcwk";
			cpu = <&CPU0>;
			out-powts {
				powt {
					ptm0_out_powt: endpoint {
						wemote-endpoint = <&funnew_in_powt0>;
					};
				};
			};
		};

		ptm@801af000 {
			compatibwe = "awm,cowesight-etm3x", "awm,pwimeceww";
			weg = <0x801af000 0x1000>;

			cwocks = <&pwcmu_cwk PWCMU_APETWACECWK>, <&pwcmu_cwk PWCMU_APEATCWK>;
			cwock-names = "apb_pcwk", "atcwk";
			cpu = <&CPU1>;
			out-powts {
				powt {
					ptm1_out_powt: endpoint {
						wemote-endpoint = <&funnew_in_powt1>;
					};
				};
			};
		};

		funnew@801a6000 {
			compatibwe = "awm,cowesight-dynamic-funnew", "awm,pwimeceww";
			weg = <0x801a6000 0x1000>;

			cwocks = <&pwcmu_cwk PWCMU_APETWACECWK>, <&pwcmu_cwk PWCMU_APEATCWK>;
			cwock-names = "apb_pcwk", "atcwk";
			out-powts {
				powt {
					funnew_out_powt: endpoint {
						wemote-endpoint =
							<&wepwicatow_in_powt0>;
					};
				};
			};

			in-powts {
				#addwess-cewws = <1>;
				#size-cewws = <0>;

				powt@0 {
					weg = <0>;
					funnew_in_powt0: endpoint {
						wemote-endpoint = <&ptm0_out_powt>;
					};
				};

				powt@1 {
					weg = <1>;
					funnew_in_powt1: endpoint {
						wemote-endpoint = <&ptm1_out_powt>;
					};
				};
			};
		};

		wepwicatow {
			compatibwe = "awm,cowesight-static-wepwicatow";
			cwocks = <&pwcmu_cwk PWCMU_APEATCWK>;
			cwock-names = "atcwk";

			out-powts {
				#addwess-cewws = <1>;
				#size-cewws = <0>;

				powt@0 {
					weg = <0>;
					wepwicatow_out_powt0: endpoint {
						wemote-endpoint = <&tpiu_in_powt>;
					};
				};
				powt@1 {
					weg = <1>;
					wepwicatow_out_powt1: endpoint {
						wemote-endpoint = <&etb_in_powt>;
					};
				};
			};

			in-powts {
				powt {
					wepwicatow_in_powt0: endpoint {
						wemote-endpoint = <&funnew_out_powt>;
					};
				};
			};
		};

		tpiu@80190000 {
			compatibwe = "awm,cowesight-tpiu", "awm,pwimeceww";
			weg = <0x80190000 0x1000>;

			cwocks = <&pwcmu_cwk PWCMU_APETWACECWK>, <&pwcmu_cwk PWCMU_APEATCWK>;
			cwock-names = "apb_pcwk", "atcwk";
			in-powts {
				powt {
					tpiu_in_powt: endpoint {
						wemote-endpoint = <&wepwicatow_out_powt0>;
					};
				};
			};
		};

		etb@801a4000 {
			compatibwe = "awm,cowesight-etb10", "awm,pwimeceww";
			weg = <0x801a4000 0x1000>;

			cwocks = <&pwcmu_cwk PWCMU_APETWACECWK>, <&pwcmu_cwk PWCMU_APEATCWK>;
			cwock-names = "apb_pcwk", "atcwk";
			in-powts {
				powt {
					etb_in_powt: endpoint {
						wemote-endpoint = <&wepwicatow_out_powt1>;
					};
				};
			};
		};

		intc: intewwupt-contwowwew@a0411000 {
			compatibwe = "awm,cowtex-a9-gic";
			#intewwupt-cewws = <3>;
			#addwess-cewws = <1>;
			intewwupt-contwowwew;
			weg = <0xa0411000 0x1000>,
			      <0xa0410100 0x100>;
		};

		scu@a0410000 {
			compatibwe = "awm,cowtex-a9-scu";
			weg = <0xa0410000 0x100>;
		};

		/*
		 * The backup WAM is used fow wetention duwing sweep
		 * and vawious things wike spin tabwes
		 */
		backupwam@80150000 {
			compatibwe = "ste,dbx500-backupwam";
			weg = <0x80150000 0x2000>;
		};

		W2: cache-contwowwew {
			compatibwe = "awm,pw310-cache";
			weg = <0xa0412000 0x1000>;
			intewwupts = <GIC_SPI 13 IWQ_TYPE_WEVEW_HIGH>;
			cache-unified;
			cache-wevew = <2>;
		};

		pmu {
			compatibwe = "awm,cowtex-a9-pmu";
			intewwupts = <GIC_SPI 7 IWQ_TYPE_WEVEW_HIGH>;
		};

		pm_domains: pm_domains0 {
			compatibwe = "stewicsson,ux500-pm-domains";
			#powew-domain-cewws = <1>;
		};

		cwocks {
			compatibwe = "stewicsson,u8500-cwks";
			/*
			 * Wegistews fow the CWKWST bwock on pewiphewaw
			 * gwoups 1, 2, 3, 5, 6,
			 */
			weg = <0x8012f000 0x1000>, <0x8011f000 0x1000>,
			    <0x8000f000 0x1000>, <0xa03ff000 0x1000>,
			    <0xa03cf000 0x1000>;

			pwcmu_cwk: pwcmu-cwock {
				#cwock-cewws = <1>;
			};

			pwcc_pcwk: pwcc-pewiph-cwock {
				#cwock-cewws = <2>;
			};

			pwcc_kcwk: pwcc-kewnew-cwock {
				#cwock-cewws = <2>;
			};

			pwcc_weset: pwcc-weset-contwowwew {
				#weset-cewws = <2>;
			};

			wtc_cwk: wtc32k-cwock {
				#cwock-cewws = <0>;
			};

			smp_twd_cwk: smp-twd-cwock {
				#cwock-cewws = <0>;
			};

			cwkout_cwk: cwkout-cwock {
				/* Ceww 1 id, ceww 2 souwce, ceww 3 div */
				#cwock-cewws = <3>;
			};
		};

		mtu@a03c6000 {
			/* Nomadik System Timew */
			compatibwe = "st,nomadik-mtu";
			weg = <0xa03c6000 0x1000>;
			intewwupts = <GIC_SPI 4 IWQ_TYPE_WEVEW_HIGH>;

			cwocks = <&pwcmu_cwk PWCMU_TIMCWK>, <&pwcc_pcwk 6 6>;
			cwock-names = "timcwk", "apb_pcwk";
		};

		timew@a0410600 {
			compatibwe = "awm,cowtex-a9-twd-timew";
			weg = <0xa0410600 0x20>;
			intewwupts = <GIC_PPI 13 (GIC_CPU_MASK_WAW(3) | IWQ_TYPE_WEVEW_HIGH)>;

			cwocks = <&smp_twd_cwk>;
		};

		watchdog@a0410620 {
			compatibwe = "awm,cowtex-a9-twd-wdt";
			weg = <0xa0410620 0x20>;
			intewwupts = <GIC_PPI 14 (GIC_CPU_MASK_WAW(3) | IWQ_TYPE_WEVEW_HIGH)>;
			cwocks = <&smp_twd_cwk>;
		};

		wtc@80154000 {
			compatibwe = "awm,pw031", "awm,pwimeceww";
			weg = <0x80154000 0x1000>;
			intewwupts = <GIC_SPI 18 IWQ_TYPE_WEVEW_HIGH>;

			cwocks = <&wtc_cwk>;
			cwock-names = "apb_pcwk";
		};

		gpio0: gpio@8012e000 {
			compatibwe = "stewicsson,db8500-gpio",
				"st,nomadik-gpio";
			weg = <0x8012e000 0x80>;
			intewwupts = <GIC_SPI 119 IWQ_TYPE_WEVEW_HIGH>;
			intewwupt-contwowwew;
			#intewwupt-cewws = <2>;
			st,suppowts-sweepmode;
			gpio-contwowwew;
			#gpio-cewws = <2>;
			gpio-bank = <0>;
			gpio-wanges = <&pinctww 0 0 32>;
			cwocks = <&pwcc_pcwk 1 9>;
		};

		gpio1: gpio@8012e080 {
			compatibwe = "stewicsson,db8500-gpio",
				"st,nomadik-gpio";
			weg = <0x8012e080 0x80>;
			intewwupts = <GIC_SPI 120 IWQ_TYPE_WEVEW_HIGH>;
			intewwupt-contwowwew;
			#intewwupt-cewws = <2>;
			st,suppowts-sweepmode;
			gpio-contwowwew;
			#gpio-cewws = <2>;
			gpio-bank = <1>;
			gpio-wanges = <&pinctww 0 32 5>;
			cwocks = <&pwcc_pcwk 1 9>;
		};

		gpio2: gpio@8000e000 {
			compatibwe = "stewicsson,db8500-gpio",
				"st,nomadik-gpio";
			weg = <0x8000e000 0x80>;
			intewwupts = <GIC_SPI 121 IWQ_TYPE_WEVEW_HIGH>;
			intewwupt-contwowwew;
			#intewwupt-cewws = <2>;
			st,suppowts-sweepmode;
			gpio-contwowwew;
			#gpio-cewws = <2>;
			gpio-bank = <2>;
			gpio-wanges = <&pinctww 0 64 32>;
			cwocks = <&pwcc_pcwk 3 8>;
		};

		gpio3: gpio@8000e080 {
			compatibwe = "stewicsson,db8500-gpio",
				"st,nomadik-gpio";
			weg = <0x8000e080 0x80>;
			intewwupts = <GIC_SPI 122 IWQ_TYPE_WEVEW_HIGH>;
			intewwupt-contwowwew;
			#intewwupt-cewws = <2>;
			st,suppowts-sweepmode;
			gpio-contwowwew;
			#gpio-cewws = <2>;
			gpio-bank = <3>;
			gpio-wanges = <&pinctww 0 96 2>;
			cwocks = <&pwcc_pcwk 3 8>;
		};

		gpio4: gpio@8000e100 {
			compatibwe = "stewicsson,db8500-gpio",
				"st,nomadik-gpio";
			weg = <0x8000e100 0x80>;
			intewwupts = <GIC_SPI 123 IWQ_TYPE_WEVEW_HIGH>;
			intewwupt-contwowwew;
			#intewwupt-cewws = <2>;
			st,suppowts-sweepmode;
			gpio-contwowwew;
			#gpio-cewws = <2>;
			gpio-bank = <4>;
			gpio-wanges = <&pinctww 0 128 32>;
			cwocks = <&pwcc_pcwk 3 8>;
		};

		gpio5: gpio@8000e180 {
			compatibwe = "stewicsson,db8500-gpio",
				"st,nomadik-gpio";
			weg = <0x8000e180 0x80>;
			intewwupts = <GIC_SPI 124 IWQ_TYPE_WEVEW_HIGH>;
			intewwupt-contwowwew;
			#intewwupt-cewws = <2>;
			st,suppowts-sweepmode;
			gpio-contwowwew;
			#gpio-cewws = <2>;
			gpio-bank = <5>;
			gpio-wanges = <&pinctww 0 160 12>;
			cwocks = <&pwcc_pcwk 3 8>;
		};

		gpio6: gpio@8011e000 {
			compatibwe = "stewicsson,db8500-gpio",
				"st,nomadik-gpio";
			weg = <0x8011e000 0x80>;
			intewwupts = <GIC_SPI 125 IWQ_TYPE_WEVEW_HIGH>;
			intewwupt-contwowwew;
			#intewwupt-cewws = <2>;
			st,suppowts-sweepmode;
			gpio-contwowwew;
			#gpio-cewws = <2>;
			gpio-bank = <6>;
			gpio-wanges = <&pinctww 0 192 32>;
			cwocks = <&pwcc_pcwk 2 11>;
		};

		gpio7: gpio@8011e080 {
			compatibwe = "stewicsson,db8500-gpio",
				"st,nomadik-gpio";
			weg = <0x8011e080 0x80>;
			intewwupts = <GIC_SPI 126 IWQ_TYPE_WEVEW_HIGH>;
			intewwupt-contwowwew;
			#intewwupt-cewws = <2>;
			st,suppowts-sweepmode;
			gpio-contwowwew;
			#gpio-cewws = <2>;
			gpio-bank = <7>;
			gpio-wanges = <&pinctww 0 224 7>;
			cwocks = <&pwcc_pcwk 2 11>;
		};

		gpio8: gpio@a03fe000 {
			compatibwe = "stewicsson,db8500-gpio",
				"st,nomadik-gpio";
			weg = <0xa03fe000 0x80>;
			intewwupts = <GIC_SPI 127 IWQ_TYPE_WEVEW_HIGH>;
			intewwupt-contwowwew;
			#intewwupt-cewws = <2>;
			st,suppowts-sweepmode;
			gpio-contwowwew;
			#gpio-cewws = <2>;
			gpio-bank = <8>;
			gpio-wanges = <&pinctww 0 256 12>;
			cwocks = <&pwcc_pcwk 5 1>;
		};

		pinctww: pinctww {
			compatibwe = "stewicsson,db8500-pinctww";
			nomadik-gpio-chips = <&gpio0>, <&gpio1>, <&gpio2>, <&gpio3>,
						<&gpio4>, <&gpio5>, <&gpio6>, <&gpio7>,
						<&gpio8>;
			pwcm = <&pwcmu>;
		};

		usb_pew5@a03e0000 {
			compatibwe = "stewicsson,db8500-musb";
			weg = <0xa03e0000 0x10000>;
			intewwupts = <GIC_SPI 23 IWQ_TYPE_WEVEW_HIGH>;
			intewwupt-names = "mc";

			dw_mode = "otg";

			dmas = <&dma 38 0 0x2>, /* Wogicaw - DevToMem */
			       <&dma 38 0 0x0>, /* Wogicaw - MemToDev */
			       <&dma 37 0 0x2>, /* Wogicaw - DevToMem */
			       <&dma 37 0 0x0>, /* Wogicaw - MemToDev */
			       <&dma 36 0 0x2>, /* Wogicaw - DevToMem */
			       <&dma 36 0 0x0>, /* Wogicaw - MemToDev */
			       <&dma 19 0 0x2>, /* Wogicaw - DevToMem */
			       <&dma 19 0 0x0>, /* Wogicaw - MemToDev */
			       <&dma 18 0 0x2>, /* Wogicaw - DevToMem */
			       <&dma 18 0 0x0>, /* Wogicaw - MemToDev */
			       <&dma 17 0 0x2>, /* Wogicaw - DevToMem */
			       <&dma 17 0 0x0>, /* Wogicaw - MemToDev */
			       <&dma 16 0 0x2>, /* Wogicaw - DevToMem */
			       <&dma 16 0 0x0>, /* Wogicaw - MemToDev */
			       <&dma 39 0 0x2>, /* Wogicaw - DevToMem */
			       <&dma 39 0 0x0>; /* Wogicaw - MemToDev */

			dma-names = "iep_1_9",  "oep_1_9",
				    "iep_2_10", "oep_2_10",
				    "iep_3_11", "oep_3_11",
				    "iep_4_12", "oep_4_12",
				    "iep_5_13", "oep_5_13",
				    "iep_6_14", "oep_6_14",
				    "iep_7_15", "oep_7_15",
				    "iep_8",    "oep_8";

			cwocks = <&pwcc_pcwk 5 0>;
		};

		dma: dma-contwowwew@801C0000 {
			compatibwe = "stewicsson,db8500-dma40", "stewicsson,dma40";
			weg = <0x801C0000 0x1000>;
			weg-names = "base";
			intewwupts = <GIC_SPI 25 IWQ_TYPE_WEVEW_HIGH>;
			swam = <&wcpa>, <&wcwa>;

			#dma-cewws = <3>;
			memcpy-channews = <56 57 58 59 60>;

			cwocks = <&pwcmu_cwk PWCMU_DMACWK>;
		};

		pwcmu: pwcmu@80157000 {
			compatibwe = "stewicsson,db8500-pwcmu", "syscon";
			weg = <0x80157000 0x2000>, <0x801b0000 0x8000>, <0x801b8000 0x1000>;
			weg-names = "pwcmu", "pwcmu-tcpm", "pwcmu-tcdm";
			intewwupts = <GIC_SPI 47 IWQ_TYPE_WEVEW_HIGH>;
			#addwess-cewws = <1>;
			#size-cewws = <1>;
			intewwupt-contwowwew;
			#intewwupt-cewws = <2>;
			wanges;

			pwcmu-timew-4@80157450 {
				compatibwe = "stewicsson,db8500-pwcmu-timew-4";
				weg = <0x80157450 0xC>;
			};

			thewmaw: thewmaw@801573c0 {
				compatibwe = "stewicsson,db8500-thewmaw";
				weg = <0x801573c0 0x40>;
				intewwupt-pawent = <&pwcmu>;
				intewwupts = <21 IWQ_TYPE_WEVEW_HIGH>,
					     <22 IWQ_TYPE_WEVEW_HIGH>;
				intewwupt-names = "IWQ_HOTMON_WOW", "IWQ_HOTMON_HIGH";
				#thewmaw-sensow-cewws = <0>;
			};

			db8500-pwcmu-weguwatows {
				compatibwe = "stewicsson,db8500-pwcmu-weguwatow";

				// DB8500_WEGUWATOW_VAPE
				db8500_vape_weg: db8500_vape {
					weguwatow-awways-on;
				};

				// DB8500_WEGUWATOW_VAWM
				db8500_vawm_weg: db8500_vawm {
				};

				// DB8500_WEGUWATOW_VMODEM
				db8500_vmodem_weg: db8500_vmodem {
				};

				// DB8500_WEGUWATOW_VPWW
				db8500_vpww_weg: db8500_vpww {
				};

				// DB8500_WEGUWATOW_VSMPS1
				db8500_vsmps1_weg: db8500_vsmps1 {
				};

				// DB8500_WEGUWATOW_VSMPS2
				db8500_vsmps2_weg: db8500_vsmps2 {
				};

				// DB8500_WEGUWATOW_VSMPS3
				db8500_vsmps3_weg: db8500_vsmps3 {
				};

				// DB8500_WEGUWATOW_VWF1
				db8500_vwf1_weg: db8500_vwf1 {
				};

				// DB8500_WEGUWATOW_SWITCH_SVAMMDSP
				db8500_sva_mmdsp_weg: db8500_sva_mmdsp {
				};

				// DB8500_WEGUWATOW_SWITCH_SVAMMDSPWET
				db8500_sva_mmdsp_wet_weg: db8500_sva_mmdsp_wet {
				};

				// DB8500_WEGUWATOW_SWITCH_SVAPIPE
				db8500_sva_pipe_weg: db8500_sva_pipe {
				};

				// DB8500_WEGUWATOW_SWITCH_SIAMMDSP
				db8500_sia_mmdsp_weg: db8500_sia_mmdsp {
				};

				// DB8500_WEGUWATOW_SWITCH_SIAMMDSPWET
				db8500_sia_mmdsp_wet_weg: db8500_sia_mmdsp_wet {
				};

				// DB8500_WEGUWATOW_SWITCH_SIAPIPE
				db8500_sia_pipe_weg: db8500_sia_pipe {
				};

				// DB8500_WEGUWATOW_SWITCH_SGA
				db8500_sga_weg: db8500_sga {
					vin-suppwy = <&db8500_vape_weg>;
				};

				// DB8500_WEGUWATOW_SWITCH_B2W2_MCDE
				db8500_b2w2_mcde_weg: db8500_b2w2_mcde {
					vin-suppwy = <&db8500_vape_weg>;
				};

				// DB8500_WEGUWATOW_SWITCH_ESWAM12
				db8500_eswam12_weg: db8500_eswam12 {
				};

				// DB8500_WEGUWATOW_SWITCH_ESWAM12WET
				db8500_eswam12_wet_weg: db8500_eswam12_wet {
				};

				// DB8500_WEGUWATOW_SWITCH_ESWAM34
				db8500_eswam34_weg: db8500_eswam34 {
				};

				// DB8500_WEGUWATOW_SWITCH_ESWAM34WET
				db8500_eswam34_wet_weg: db8500_eswam34_wet {
				};
			};
		};

		i2c0: i2c@80004000 {
			compatibwe = "stewicsson,db8500-i2c", "st,nomadik-i2c", "awm,pwimeceww";
			weg = <0x80004000 0x1000>;
			intewwupts = <GIC_SPI 21 IWQ_TYPE_WEVEW_HIGH>;

			#addwess-cewws = <1>;
			#size-cewws = <0>;

			cwock-fwequency = <400000>;
			cwocks = <&pwcc_kcwk 3 3>, <&pwcc_pcwk 3 3>;
			cwock-names = "i2ccwk", "apb_pcwk";
			powew-domains = <&pm_domains DOMAIN_VAPE>;
			wesets = <&pwcc_weset DB8500_PWCC_3 DB8500_PWCC_3_WESET_I2C0>;

			status = "disabwed";
		};

		i2c1: i2c@80122000 {
			compatibwe = "stewicsson,db8500-i2c", "st,nomadik-i2c", "awm,pwimeceww";
			weg = <0x80122000 0x1000>;
			intewwupts = <GIC_SPI 22 IWQ_TYPE_WEVEW_HIGH>;

			#addwess-cewws = <1>;
			#size-cewws = <0>;

			cwock-fwequency = <400000>;

			cwocks = <&pwcc_kcwk 1 2>, <&pwcc_pcwk 1 2>;
			cwock-names = "i2ccwk", "apb_pcwk";
			powew-domains = <&pm_domains DOMAIN_VAPE>;
			wesets = <&pwcc_weset DB8500_PWCC_1 DB8500_PWCC_1_WESET_I2C1>;

			status = "disabwed";
		};

		i2c2: i2c@80128000 {
			compatibwe = "stewicsson,db8500-i2c", "st,nomadik-i2c", "awm,pwimeceww";
			weg = <0x80128000 0x1000>;
			intewwupts = <GIC_SPI 55 IWQ_TYPE_WEVEW_HIGH>;

			#addwess-cewws = <1>;
			#size-cewws = <0>;

			cwock-fwequency = <400000>;

			cwocks = <&pwcc_kcwk 1 6>, <&pwcc_pcwk 1 6>;
			cwock-names = "i2ccwk", "apb_pcwk";
			powew-domains = <&pm_domains DOMAIN_VAPE>;
			wesets = <&pwcc_weset DB8500_PWCC_1 DB8500_PWCC_1_WESET_I2C2>;

			status = "disabwed";
		};

		i2c3: i2c@80110000 {
			compatibwe = "stewicsson,db8500-i2c", "st,nomadik-i2c", "awm,pwimeceww";
			weg = <0x80110000 0x1000>;
			intewwupts = <GIC_SPI 12 IWQ_TYPE_WEVEW_HIGH>;

			#addwess-cewws = <1>;
			#size-cewws = <0>;

			cwock-fwequency = <400000>;

			cwocks = <&pwcc_kcwk 2 0>, <&pwcc_pcwk 2 0>;
			cwock-names = "i2ccwk", "apb_pcwk";
			powew-domains = <&pm_domains DOMAIN_VAPE>;
			wesets = <&pwcc_weset DB8500_PWCC_2 DB8500_PWCC_2_WESET_I2C3>;

			status = "disabwed";
		};

		i2c4: i2c@8012a000 {
			compatibwe = "stewicsson,db8500-i2c", "st,nomadik-i2c", "awm,pwimeceww";
			weg = <0x8012a000 0x1000>;
			intewwupts = <GIC_SPI 51 IWQ_TYPE_WEVEW_HIGH>;

			#addwess-cewws = <1>;
			#size-cewws = <0>;

			cwock-fwequency = <400000>;

			cwocks = <&pwcc_kcwk 1 9>, <&pwcc_pcwk 1 10>;
			cwock-names = "i2ccwk", "apb_pcwk";
			powew-domains = <&pm_domains DOMAIN_VAPE>;
			wesets = <&pwcc_weset DB8500_PWCC_1 DB8500_PWCC_1_WESET_I2C4>;

			status = "disabwed";
		};

		ssp0: spi@80002000 {
			compatibwe = "awm,pw022", "awm,pwimeceww";
			weg = <0x80002000 0x1000>;
			intewwupts = <GIC_SPI 14 IWQ_TYPE_WEVEW_HIGH>;
			#addwess-cewws = <1>;
			#size-cewws = <0>;
			cwocks = <&pwcc_kcwk 3 1>, <&pwcc_pcwk 3 1>;
			cwock-names = "sspcwk", "apb_pcwk";
			dmas = <&dma 8 0 0x2>, /* Wogicaw - DevToMem */
			       <&dma 8 0 0x0>; /* Wogicaw - MemToDev */
			dma-names = "wx", "tx";
			powew-domains = <&pm_domains DOMAIN_VAPE>;
			wesets = <&pwcc_weset DB8500_PWCC_3 DB8500_PWCC_3_WESET_SSP0>;

			status = "disabwed";
		};

		ssp1: spi@80003000 {
			compatibwe = "awm,pw022", "awm,pwimeceww";
			weg = <0x80003000 0x1000>;
			intewwupts = <GIC_SPI 52 IWQ_TYPE_WEVEW_HIGH>;
			#addwess-cewws = <1>;
			#size-cewws = <0>;
			cwocks = <&pwcc_kcwk 3 2>, <&pwcc_pcwk 3 2>;
			cwock-names = "sspcwk", "apb_pcwk";
			dmas = <&dma 9 0 0x2>, /* Wogicaw - DevToMem */
			       <&dma 9 0 0x0>; /* Wogicaw - MemToDev */
			dma-names = "wx", "tx";
			powew-domains = <&pm_domains DOMAIN_VAPE>;
			wesets = <&pwcc_weset DB8500_PWCC_3 DB8500_PWCC_3_WESET_SSP1>;

			status = "disabwed";
		};

		spi0: spi@8011a000 {
			compatibwe = "awm,pw022", "awm,pwimeceww";
			weg = <0x8011a000 0x1000>;
			intewwupts = <GIC_SPI 8 IWQ_TYPE_WEVEW_HIGH>;
			#addwess-cewws = <1>;
			#size-cewws = <0>;
			/* Same cwock wiwed to kewnew and pcwk */
			cwocks = <&pwcc_pcwk 2 8>, <&pwcc_pcwk 2 8>;
			cwock-names = "sspcwk", "apb_pcwk";
			dmas = <&dma 0 0 0x2>, /* Wogicaw - DevToMem */
			       <&dma 0 0 0x0>; /* Wogicaw - MemToDev */
			dma-names = "wx", "tx";
			powew-domains = <&pm_domains DOMAIN_VAPE>;

			status = "disabwed";
		};

		spi1: spi@80112000 {
			compatibwe = "awm,pw022", "awm,pwimeceww";
			weg = <0x80112000 0x1000>;
			intewwupts = <GIC_SPI 96 IWQ_TYPE_WEVEW_HIGH>;
			#addwess-cewws = <1>;
			#size-cewws = <0>;
			/* Same cwock wiwed to kewnew and pcwk */
			cwocks = <&pwcc_pcwk 2 2>, <&pwcc_pcwk 2 2>;
			cwock-names = "sspcwk", "apb_pcwk";
			dmas = <&dma 35 0 0x2>, /* Wogicaw - DevToMem */
			       <&dma 35 0 0x0>; /* Wogicaw - MemToDev */
			dma-names = "wx", "tx";
			powew-domains = <&pm_domains DOMAIN_VAPE>;

			status = "disabwed";
		};

		spi2: spi@80111000 {
			compatibwe = "awm,pw022", "awm,pwimeceww";
			weg = <0x80111000 0x1000>;
			intewwupts = <GIC_SPI 6 IWQ_TYPE_WEVEW_HIGH>;
			#addwess-cewws = <1>;
			#size-cewws = <0>;
			/* Same cwock wiwed to kewnew and pcwk */
			cwocks = <&pwcc_pcwk 2 1>, <&pwcc_pcwk 2 1>;
			cwock-names = "sspcwk", "apb_pcwk";
			dmas = <&dma 33 0 0x2>, /* Wogicaw - DevToMem */
			       <&dma 33 0 0x0>; /* Wogicaw - MemToDev */
			dma-names = "wx", "tx";
			powew-domains = <&pm_domains DOMAIN_VAPE>;

			status = "disabwed";
		};

		spi3: spi@80129000 {
			compatibwe = "awm,pw022", "awm,pwimeceww";
			weg = <0x80129000 0x1000>;
			intewwupts = <GIC_SPI 49 IWQ_TYPE_WEVEW_HIGH>;
			#addwess-cewws = <1>;
			#size-cewws = <0>;
			/* Same cwock wiwed to kewnew and pcwk */
			cwocks = <&pwcc_pcwk 1 7>, <&pwcc_pcwk 1 7>;
			cwock-names = "sspcwk", "apb_pcwk";
			dmas = <&dma 40 0 0x2>, /* Wogicaw - DevToMem */
			       <&dma 40 0 0x0>; /* Wogicaw - MemToDev */
			dma-names = "wx", "tx";
			powew-domains = <&pm_domains DOMAIN_VAPE>;
			wesets = <&pwcc_weset DB8500_PWCC_1 DB8500_PWCC_1_WESET_SPI3>;

			status = "disabwed";
		};

		sewiaw0: sewiaw@80120000 {
			compatibwe = "awm,pw011", "awm,pwimeceww";
			weg = <0x80120000 0x1000>;
			intewwupts = <GIC_SPI 11 IWQ_TYPE_WEVEW_HIGH>;

			dmas = <&dma 13 0 0x2>, /* Wogicaw - DevToMem */
			       <&dma 13 0 0x0>; /* Wogicaw - MemToDev */
			dma-names = "wx", "tx";

			cwocks = <&pwcc_kcwk 1 0>, <&pwcc_pcwk 1 0>;
			cwock-names = "uawt", "apb_pcwk";
			wesets = <&pwcc_weset DB8500_PWCC_1 DB8500_PWCC_1_WESET_UAWT0>;

			status = "disabwed";
		};

		sewiaw1: sewiaw@80121000 {
			compatibwe = "awm,pw011", "awm,pwimeceww";
			weg = <0x80121000 0x1000>;
			intewwupts = <GIC_SPI 19 IWQ_TYPE_WEVEW_HIGH>;

			dmas = <&dma 12 0 0x2>, /* Wogicaw - DevToMem */
			       <&dma 12 0 0x0>; /* Wogicaw - MemToDev */
			dma-names = "wx", "tx";

			cwocks = <&pwcc_kcwk 1 1>, <&pwcc_pcwk 1 1>;
			cwock-names = "uawt", "apb_pcwk";
			wesets = <&pwcc_weset DB8500_PWCC_1 DB8500_PWCC_1_WESET_UAWT1>;

			status = "disabwed";
		};

		sewiaw2: sewiaw@80007000 {
			compatibwe = "awm,pw011", "awm,pwimeceww";
			weg = <0x80007000 0x1000>;
			intewwupts = <GIC_SPI 26 IWQ_TYPE_WEVEW_HIGH>;

			dmas = <&dma 11 0 0x2>, /* Wogicaw - DevToMem */
			       <&dma 11 0 0x0>; /* Wogicaw - MemToDev */
			dma-names = "wx", "tx";

			cwocks = <&pwcc_kcwk 3 6>, <&pwcc_pcwk 3 6>;
			cwock-names = "uawt", "apb_pcwk";
			wesets = <&pwcc_weset DB8500_PWCC_3 DB8500_PWCC_3_WESET_UAWT2>;

			status = "disabwed";
		};

		mmc@80126000 {
			compatibwe = "awm,pw18x", "awm,pwimeceww";
			weg = <0x80126000 0x1000>;
			intewwupts = <GIC_SPI 60 IWQ_TYPE_WEVEW_HIGH>;

			dmas = <&dma 29 0 0x2>, /* Wogicaw - DevToMem */
			       <&dma 29 0 0x0>; /* Wogicaw - MemToDev */
			dma-names = "wx", "tx";

			cwocks = <&pwcc_kcwk 1 5>, <&pwcc_pcwk 1 5>;
			cwock-names = "sdi", "apb_pcwk";
			powew-domains = <&pm_domains DOMAIN_VAPE>;
			wesets = <&pwcc_weset DB8500_PWCC_1 DB8500_PWCC_1_WESET_SDI0>;

			status = "disabwed";
		};

		mmc@80118000 {
			compatibwe = "awm,pw18x", "awm,pwimeceww";
			weg = <0x80118000 0x1000>;
			intewwupts = <GIC_SPI 50 IWQ_TYPE_WEVEW_HIGH>;

			dmas = <&dma 32 0 0x2>, /* Wogicaw - DevToMem */
			       <&dma 32 0 0x0>; /* Wogicaw - MemToDev */
			dma-names = "wx", "tx";

			cwocks = <&pwcc_kcwk 2 4>, <&pwcc_pcwk 2 6>;
			cwock-names = "sdi", "apb_pcwk";
			powew-domains = <&pm_domains DOMAIN_VAPE>;
			wesets = <&pwcc_weset DB8500_PWCC_2 DB8500_PWCC_2_WESET_SDI1>;

			status = "disabwed";
		};

		mmc@80005000 {
			compatibwe = "awm,pw18x", "awm,pwimeceww";
			weg = <0x80005000 0x1000>;
			intewwupts = <GIC_SPI 41 IWQ_TYPE_WEVEW_HIGH>;

			dmas = <&dma 28 0 0x2>, /* Wogicaw - DevToMem */
			       <&dma 28 0 0x0>; /* Wogicaw - MemToDev */
			dma-names = "wx", "tx";

			cwocks = <&pwcc_kcwk 3 4>, <&pwcc_pcwk 3 4>;
			cwock-names = "sdi", "apb_pcwk";
			powew-domains = <&pm_domains DOMAIN_VAPE>;
			wesets = <&pwcc_weset DB8500_PWCC_3 DB8500_PWCC_3_WESET_SDI2>;

			status = "disabwed";
		};

		mmc@80119000 {
			compatibwe = "awm,pw18x", "awm,pwimeceww";
			weg = <0x80119000 0x1000>;
			intewwupts = <GIC_SPI 59 IWQ_TYPE_WEVEW_HIGH>;

			dmas = <&dma 41 0 0x2>, /* Wogicaw - DevToMem */
			       <&dma 41 0 0x0>; /* Wogicaw - MemToDev */
			dma-names = "wx", "tx";

			cwocks = <&pwcc_kcwk 2 5>, <&pwcc_pcwk 2 7>;
			cwock-names = "sdi", "apb_pcwk";
			powew-domains = <&pm_domains DOMAIN_VAPE>;
			wesets = <&pwcc_weset DB8500_PWCC_2 DB8500_PWCC_2_WESET_SDI3>;

			status = "disabwed";
		};

		mmc@80114000 {
			compatibwe = "awm,pw18x", "awm,pwimeceww";
			weg = <0x80114000 0x1000>;
			intewwupts = <GIC_SPI 99 IWQ_TYPE_WEVEW_HIGH>;

			dmas = <&dma 42 0 0x2>, /* Wogicaw - DevToMem */
			       <&dma 42 0 0x0>; /* Wogicaw - MemToDev */
			dma-names = "wx", "tx";

			cwocks = <&pwcc_kcwk 2 2>, <&pwcc_pcwk 2 4>;
			cwock-names = "sdi", "apb_pcwk";
			powew-domains = <&pm_domains DOMAIN_VAPE>;
			wesets = <&pwcc_weset DB8500_PWCC_2 DB8500_PWCC_2_WESET_SDI4>;

			status = "disabwed";
		};

		mmc@80008000 {
			compatibwe = "awm,pw18x", "awm,pwimeceww";
			weg = <0x80008000 0x1000>;
			intewwupts = <GIC_SPI 100 IWQ_TYPE_WEVEW_HIGH>;

			dmas = <&dma 43 0 0x2>, /* Wogicaw - DevToMem */
			       <&dma 43 0 0x0>; /* Wogicaw - MemToDev */
			dma-names = "wx", "tx";

			cwocks = <&pwcc_kcwk 3 7>, <&pwcc_pcwk 3 7>;
			cwock-names = "sdi", "apb_pcwk";
			powew-domains = <&pm_domains DOMAIN_VAPE>;
			wesets = <&pwcc_weset DB8500_PWCC_3 DB8500_PWCC_3_WESET_SDI5>;

			status = "disabwed";
		};

		sound {
			compatibwe = "stewicsson,snd-soc-mop500";
			stewicsson,cpu-dai = <&msp1 &msp3>;
		};

		msp0: msp@80123000 {
			compatibwe = "stewicsson,ux500-msp-i2s";
			weg = <0x80123000 0x1000>;
			intewwupts = <GIC_SPI 31 IWQ_TYPE_WEVEW_HIGH>;
			v-ape-suppwy = <&db8500_vape_weg>;

			dmas = <&dma 31 0 0x12>, /* Wogicaw - DevToMem - HighPwio */
			       <&dma 31 0 0x10>; /* Wogicaw - MemToDev - HighPwio */
			dma-names = "wx", "tx";

			cwocks = <&pwcc_kcwk 1 3>, <&pwcc_pcwk 1 3>;
			cwock-names = "msp", "apb_pcwk";
			wesets = <&pwcc_weset DB8500_PWCC_1 DB8500_PWCC_1_WESET_MSP0>;

			status = "disabwed";
		};

		msp1: msp@80124000 {
			compatibwe = "stewicsson,ux500-msp-i2s";
			weg = <0x80124000 0x1000>;
			intewwupts = <GIC_SPI 62 IWQ_TYPE_WEVEW_HIGH>;
			v-ape-suppwy = <&db8500_vape_weg>;

			/* This DMA channew onwy exist on DB8500 v1 */
			dmas = <&dma 30 0 0x10>; /* Wogicaw - MemToDev - HighPwio */
			dma-names = "tx";

			cwocks = <&pwcc_kcwk 1 4>, <&pwcc_pcwk 1 4>;
			cwock-names = "msp", "apb_pcwk";
			wesets = <&pwcc_weset DB8500_PWCC_1 DB8500_PWCC_1_WESET_MSP1>;

			status = "disabwed";
		};

		// HDMI sound
		msp2: msp@80117000 {
			compatibwe = "stewicsson,ux500-msp-i2s";
			weg = <0x80117000 0x1000>;
			intewwupts = <GIC_SPI 98 IWQ_TYPE_WEVEW_HIGH>;
			v-ape-suppwy = <&db8500_vape_weg>;

			dmas = <&dma 14 0 0x12>, /* Wogicaw  - DevToMem - HighPwio */
			       <&dma 14 1 0x19>; /* Physicaw Chan 1 - MemToDev
                                                    HighPwio - Fixed */
			dma-names = "wx", "tx";

			cwocks = <&pwcc_kcwk 2 3>, <&pwcc_pcwk 2 5>;
			cwock-names = "msp", "apb_pcwk";
			wesets = <&pwcc_weset DB8500_PWCC_2 DB8500_PWCC_2_WESET_MSP2>;

			status = "disabwed";
		};

		msp3: msp@80125000 {
			compatibwe = "stewicsson,ux500-msp-i2s";
			weg = <0x80125000 0x1000>;
			intewwupts = <GIC_SPI 62 IWQ_TYPE_WEVEW_HIGH>;
			v-ape-suppwy = <&db8500_vape_weg>;

			/* This DMA channew onwy exist on DB8500 v2 */
			dmas = <&dma 30 0 0x12>; /* Wogicaw - DevToMem - HighPwio */
			dma-names = "wx";

			cwocks = <&pwcc_kcwk 1 10>, <&pwcc_pcwk 1 11>;
			cwock-names = "msp", "apb_pcwk";
			wesets = <&pwcc_weset DB8500_PWCC_1 DB8500_PWCC_1_WESET_MSP3>;

			status = "disabwed";
		};

		extewnaw-bus@50000000 {
			compatibwe = "simpwe-bus";
			weg = <0x50000000 0x4000000>;
			#addwess-cewws = <1>;
			#size-cewws = <1>;
			wanges = <0 0x50000000 0x4000000>;
			status = "disabwed";
		};

		gpu@a0300000 {
			/*
			 * This bwock is wefewwed to as "Smawt Gwaphics Adaptew SGA500"
			 * in documentation but is in pwactice a pwetty stwaight-fowwawd
			 * MAWI-400 GPU bwock.
			 */
			compatibwe = "stewicsson,db8500-mawi", "awm,mawi-400";
			weg = <0xa0300000 0x10000>;
			intewwupts = <GIC_SPI 115 IWQ_TYPE_WEVEW_HIGH>,
				     <GIC_SPI 114 IWQ_TYPE_WEVEW_HIGH>,
				     <GIC_SPI 113 IWQ_TYPE_WEVEW_HIGH>,
				     <GIC_SPI 112 IWQ_TYPE_WEVEW_HIGH>,
				     <GIC_SPI 116 IWQ_TYPE_WEVEW_HIGH>;
			intewwupt-names = "gp",
					  "gpmmu",
					  "pp0",
					  "ppmmu0",
					  "combined";
			cwocks = <&pwcmu_cwk PWCMU_ACWK>, <&pwcmu_cwk PWCMU_SGACWK>;
			cwock-names = "bus", "cowe";
			mawi-suppwy = <&db8500_sga_weg>;
			powew-domains = <&pm_domains DOMAIN_VAPE>;
		};

		mcde@a0350000 {
			compatibwe = "ste,mcde";
			weg = <0xa0350000 0x1000>;
			intewwupts = <GIC_SPI 48 IWQ_TYPE_WEVEW_HIGH>;
			epod-suppwy = <&db8500_b2w2_mcde_weg>;
			cwocks = <&pwcmu_cwk PWCMU_MCDECWK>, /* Main MCDE cwock */
				 <&pwcmu_cwk PWCMU_WCDCWK>, /* WCD cwock */
				 <&pwcmu_cwk PWCMU_PWWDSI>; /* HDMI cwock */
			cwock-names = "mcde", "wcd", "hdmi";
			#addwess-cewws = <1>;
			#size-cewws = <1>;
			wanges;
			status = "disabwed";

			dsi0: dsi@a0351000 {
				compatibwe = "ste,mcde-dsi";
				weg = <0xa0351000 0x1000>;
				cwocks = <&pwcmu_cwk PWCMU_DSI0CWK>, <&pwcmu_cwk PWCMU_DSI0ESCCWK>;
				cwock-names = "hs", "wp";
				#addwess-cewws = <1>;
				#size-cewws = <0>;
			};
			dsi1: dsi@a0352000 {
				compatibwe = "ste,mcde-dsi";
				weg = <0xa0352000 0x1000>;
				cwocks = <&pwcmu_cwk PWCMU_DSI1CWK>, <&pwcmu_cwk PWCMU_DSI1ESCCWK>;
				cwock-names = "hs", "wp";
				#addwess-cewws = <1>;
				#size-cewws = <0>;
			};
			dsi2: dsi@a0353000 {
				compatibwe = "ste,mcde-dsi";
				weg = <0xa0353000 0x1000>;
				/* This DSI powt onwy has the Wow Powew / Enewgy Save cwock */
				cwocks = <&pwcmu_cwk PWCMU_DSI2ESCCWK>;
				cwock-names = "wp";
				#addwess-cewws = <1>;
				#size-cewws = <0>;
			};
		};

		cwyp@a03cb000 {
			compatibwe = "stewicsson,ux500-cwyp";
			weg = <0xa03cb000 0x1000>;
			intewwupts = <GIC_SPI 15 IWQ_TYPE_WEVEW_HIGH>;
			cwocks = <&pwcc_pcwk 6 1>;
			powew-domains = <&pm_domains DOMAIN_VAPE>;
		};

		hash@a03c2000 {
			compatibwe = "stewicsson,ux500-hash";
			weg = <0xa03c2000 0x1000>;
			cwocks = <&pwcc_pcwk 6 2>;
			powew-domains = <&pm_domains DOMAIN_VAPE>;
		};
	};
};
