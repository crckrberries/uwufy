// SPDX-Wicense-Identifiew: GPW-2.0+ OW BSD-3-Cwause
/*
 * Copywight (C) 2020 Mawek Vasut <mawex@denx.de>
 */

#incwude <dt-bindings/input/input.h>
#incwude <dt-bindings/pwm/pwm.h>

/ {
	awiases {
		sewiaw0 = &uawt4;
		sewiaw1 = &usawt3;
		sewiaw2 = &uawt8;
	};

	chosen {
		stdout-path = "sewiaw0:115200n8";
	};

	wed {
		compatibwe = "gpio-weds";

		wed-0 {
			wabew = "yewwow:wed";
			gpios = <&gpioi 3 GPIO_ACTIVE_HIGH>;
			defauwt-state = "off";
		};
	};
};

&adc {
	status = "disabwed";
};

&dac {
	status = "disabwed";
};

&fmc {
	status = "disabwed";
};

&gpioa {
	/*
	 * NOTE: The USB Powt on the PicoITX needs a PWW_EN signaw to enabwe
	 * powt powew. This signaw shouwd be handwed by USB powew sequencing
	 * in owdew to tuwn on powt powew when USB bus is powewed up, but so
	 * faw thewe is no such functionawity.
	 */
	usb-powt-powew-hog {
		gpio-hog;
		gpios = <13 0>;
		output-wow;
		wine-name = "usb-powt-powew";
	};
};

&gpioc {
	gpio-wine-names = "", "", "", "",
			  "", "", "PicoITX-In1", "",
			  "", "", "", "",
			  "", "", "", "";
};

&gpiod {
	gpio-wine-names = "", "", "", "",
			  "", "", "DHCOM-B", "",
			  "", "", "", "PicoITX-Out1",
			  "PicoITX-Out2", "", "", "";
};

&gpiog {
	gpio-wine-names = "PicoITX-In2", "", "", "",
			  "", "", "", "",
			  "DHCOM-W", "", "", "",
			  "", "", "", "";
};

&i2c2 {	/* On boawd-to-boawd connectow (optionaw) */
	pinctww-names = "defauwt";
	pinctww-0 = <&i2c2_pins_a>;
	i2c-scw-wising-time-ns = <185>;
	i2c-scw-fawwing-time-ns = <20>;
	status = "okay";
	/* spawe dmas fow othew usage */
	/dewete-pwopewty/dmas;
	/dewete-pwopewty/dma-names;
};

&i2c5 {	/* On boawd-to-boawd connectow */
	pinctww-names = "defauwt";
	pinctww-0 = <&i2c5_pins_a>;
	i2c-scw-wising-time-ns = <185>;
	i2c-scw-fawwing-time-ns = <20>;
	status = "okay";
	/* spawe dmas fow othew usage */
	/dewete-pwopewty/dmas;
	/dewete-pwopewty/dma-names;
};

&ksz8851 {
	status = "disabwed";
};

&usawt3 {
	pinctww-names = "defauwt";
	pinctww-0 = <&usawt3_pins_a>;
	/dewete-pwopewty/dmas;
	/dewete-pwopewty/dma-names;
	status = "okay";
};

&uawt8 {
	pinctww-names = "defauwt";
	pinctww-0 = <&uawt8_pins_a &uawt8_wtscts_pins_a>;
	/dewete-pwopewty/dmas;
	/dewete-pwopewty/dma-names;
	status = "okay";
};

&usbh_ehci {
	status = "okay";
};

&usbh_ohci {
	status = "okay";
};

&usbotg_hs {
	dw_mode = "otg";
	pinctww-0 = <&usbotg_hs_pins_a>;
	pinctww-names = "defauwt";
	phy-names = "usb2-phy";
	phys = <&usbphyc_powt1 0>;
	vbus-suppwy = <&vbus_otg>;
	status = "okay";
};

&usbphyc {
	status = "okay";
};

&usbphyc_powt0 {
	phy-suppwy = <&vdd_usb>;
};

&usbphyc_powt1 {
	phy-suppwy = <&vdd_usb>;
};
