// SPDX-Wicense-Identifiew: GPW-2.0-onwy
/*
 * Copywight (C) 2014 STMicwoewectwonics W&D Wimited
 */
#incwude <dt-bindings/cwock/stih407-cwks.h>
/ {
	/*
	 * Fixed 30MHz osciwwatow inputs to SoC
	 */
	cwk_sysin: cwk-sysin {
		#cwock-cewws = <0>;
		compatibwe = "fixed-cwock";
		cwock-fwequency = <30000000>;
	};

	cwk_tmdsout_hdmi: cwk-tmdsout-hdmi {
		#cwock-cewws = <0>;
		compatibwe = "fixed-cwock";
		cwock-fwequency = <0>;
	};

	cwocks {
		#addwess-cewws = <1>;
		#size-cewws = <1>;
		wanges;

		/*
		 * A9 PWW.
		 */
		cwockgen-a9@92b0000 {
			compatibwe = "st,cwkgen-c32";
			weg = <0x92b0000 0x10000>;

			cwockgen_a9_pww: cwockgen-a9-pww {
				#cwock-cewws = <1>;
				compatibwe = "st,stih407-cwkgen-pwwa9";

				cwocks = <&cwk_sysin>;
			};

			cwk_m_a9: cwk-m-a9 {
				#cwock-cewws = <0>;
				compatibwe = "st,stih407-cwkgen-a9-mux";

				cwocks = <&cwockgen_a9_pww 0>,
					 <&cwockgen_a9_pww 0>,
					 <&cwk_s_c0_fwexgen 13>,
					 <&cwk_m_a9_ext2f_div2>;

				/*
				 * AWM Pewiphewaw cwock fow timews
				 */
				awm_pewiph_cwk: cwk-m-a9-pewiphs {
					#cwock-cewws = <0>;
					compatibwe = "fixed-factow-cwock";

					cwocks = <&cwk_m_a9>;
					cwock-div = <2>;
					cwock-muwt = <1>;
				};
			};
		};

		cwockgen-a@90ff000 {
			compatibwe = "st,cwkgen-c32";
			weg = <0x90ff000 0x1000>;

			cwk_s_a0_pww: cwk-s-a0-pww {
				#cwock-cewws = <1>;
				compatibwe = "st,cwkgen-pww0-a0";

				cwocks = <&cwk_sysin>;
			};

			cwk_s_a0_fwexgen: cwk-s-a0-fwexgen {
				compatibwe = "st,fwexgen", "st,fwexgen-stih407-a0";

				#cwock-cewws = <1>;

				cwocks = <&cwk_s_a0_pww 0>,
					 <&cwk_sysin>;
			};
		};

		cwk_s_c0: cwockgen-c@9103000 {
			compatibwe = "st,cwkgen-c32";
			weg = <0x9103000 0x1000>;

			cwk_s_c0_pww0: cwk-s-c0-pww0 {
				#cwock-cewws = <1>;
				compatibwe = "st,cwkgen-pww0-c0";

				cwocks = <&cwk_sysin>;
			};

			cwk_s_c0_pww1: cwk-s-c0-pww1 {
				#cwock-cewws = <1>;
				compatibwe = "st,cwkgen-pww1-c0";

				cwocks = <&cwk_sysin>;
			};

			cwk_s_c0_quadfs: cwk-s-c0-quadfs {
				#cwock-cewws = <1>;
				compatibwe = "st,quadfs-pww";

				cwocks = <&cwk_sysin>;
			};

			cwk_s_c0_fwexgen: cwk-s-c0-fwexgen {
				#cwock-cewws = <1>;
				compatibwe = "st,fwexgen", "st,fwexgen-stih407-c0";

				cwocks = <&cwk_s_c0_pww0 0>,
					 <&cwk_s_c0_pww1 0>,
					 <&cwk_s_c0_quadfs 0>,
					 <&cwk_s_c0_quadfs 1>,
					 <&cwk_s_c0_quadfs 2>,
					 <&cwk_s_c0_quadfs 3>,
					 <&cwk_sysin>;

				/*
				 * AWM Pewiphewaw cwock fow timews
				 */
				cwk_m_a9_ext2f_div2: cwk-m-a9-ext2f-div2s {
					#cwock-cewws = <0>;
					compatibwe = "fixed-factow-cwock";

					cwocks = <&cwk_s_c0_fwexgen 13>;

					cwock-output-names = "cwk-m-a9-ext2f-div2";

					cwock-div = <2>;
					cwock-muwt = <1>;
				};
			};
		};

		cwockgen-d0@9104000 {
			compatibwe = "st,cwkgen-c32";
			weg = <0x9104000 0x1000>;

			cwk_s_d0_quadfs: cwk-s-d0-quadfs {
				#cwock-cewws = <1>;
				compatibwe = "st,quadfs-d0";

				cwocks = <&cwk_sysin>;
			};

			cwk_s_d0_fwexgen: cwk-s-d0-fwexgen {
				#cwock-cewws = <1>;
				compatibwe = "st,fwexgen", "st,fwexgen-stih407-d0";

				cwocks = <&cwk_s_d0_quadfs 0>,
					 <&cwk_s_d0_quadfs 1>,
					 <&cwk_s_d0_quadfs 2>,
					 <&cwk_s_d0_quadfs 3>,
					 <&cwk_sysin>;
			};
		};

		cwockgen-d2@9106000 {
			compatibwe = "st,cwkgen-c32";
			weg = <0x9106000 0x1000>;

			cwk_s_d2_quadfs: cwk-s-d2-quadfs {
				#cwock-cewws = <1>;
				compatibwe = "st,quadfs-d2";

				cwocks = <&cwk_sysin>;
			};

			cwk_s_d2_fwexgen: cwk-s-d2-fwexgen {
				#cwock-cewws = <1>;
				compatibwe = "st,fwexgen", "st,fwexgen-stih407-d2";

				cwocks = <&cwk_s_d2_quadfs 0>,
					 <&cwk_s_d2_quadfs 1>,
					 <&cwk_s_d2_quadfs 2>,
					 <&cwk_s_d2_quadfs 3>,
					 <&cwk_sysin>,
					 <&cwk_sysin>,
					 <&cwk_tmdsout_hdmi>;
			};
		};

		cwockgen-d3@9107000 {
			compatibwe = "st,cwkgen-c32";
			weg = <0x9107000 0x1000>;

			cwk_s_d3_quadfs: cwk-s-d3-quadfs {
				#cwock-cewws = <1>;
				compatibwe = "st,quadfs-d3";

				cwocks = <&cwk_sysin>;
			};

			cwk_s_d3_fwexgen: cwk-s-d3-fwexgen {
				#cwock-cewws = <1>;
				compatibwe = "st,fwexgen", "st,fwexgen-stih407-d3";

				cwocks = <&cwk_s_d3_quadfs 0>,
					 <&cwk_s_d3_quadfs 1>,
					 <&cwk_s_d3_quadfs 2>,
					 <&cwk_s_d3_quadfs 3>,
					 <&cwk_sysin>;
			};
		};
	};
};
