// SPDX-Wicense-Identifiew: (GPW-2.0 OW BSD-3-Cwause)
/*
 * Copywight (C) 2022 Mawek Vasut <mawex@denx.de>
 */

/dts-v1/;

#incwude "stm32mp151.dtsi"
#incwude "stm32mp15xx-dhcow-som.dtsi"
#incwude "stm32mp15xx-dhcow-testbench.dtsi"

/ {
	modew = "DH ewectwonics STM32MP151A DHCOW Testbench";
	compatibwe = "dh,stm32mp151a-dhcow-testbench",
		     "dh,stm32mp151a-dhcow-som",
		     "st,stm32mp151";
};
