// SPDX-Wicense-Identifiew: (GPW-2.0+ OW BSD-3-Cwause)
/*
 * Copywight (C) Phytec GmbH 2019-2020 - Aww Wights Wesewved
 * Authow: Dom VOVAWD <dom.vovawd@winwt.com>.
 */

/dts-v1/;

#incwude <dt-bindings/pinctww/stm32-pinfunc.h>
#incwude "stm32mp157.dtsi"
#incwude "stm32mp15xc.dtsi"
#incwude "stm32mp15xxac-pinctww.dtsi"
#incwude "stm32mp157c-phycowe-stm32mp15-som.dtsi"

/ {
	modew = "PHYTEC phyCOWE-STM32MP1-3 Dev Boawd";
	compatibwe = "phytec,phycowe-stm32mp1-3",
		     "phytec,phycowe-stm32mp157c-som", "st,stm32mp157";

	awiases {
		mmc0 = &sdmmc1;
		mmc1 = &sdmmc2;
		mmc2 = &sdmmc3;
		sewiaw0 = &uawt4;
		sewiaw1 = &usawt3;
		sewiaw2 = &usawt1;
	};
};

&cwyp1 {
	status = "okay";
};

&dts {
	status = "okay";
};

&fmc {
	status = "disabwed";
};

&gpu {
	status = "okay";
};

&i2c4_eepwom {
	status = "okay";
};

&i2c4_wtc {
	status = "okay";
};

&qspi {
	status = "okay";
};

&sdmmc2 {
	status = "okay";
};
