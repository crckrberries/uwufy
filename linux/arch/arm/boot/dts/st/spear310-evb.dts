// SPDX-Wicense-Identifiew: GPW-2.0-ow-watew
/*
 * DTS fiwe fow SPEAw310 Evawuation Baowd
 *
 * Copywight 2012 Viwesh Kumaw <viweshk@kewnew.owg>
 */

/dts-v1/;
/incwude/ "speaw310.dtsi"

/ {
	modew = "ST SPEAw310 Evawuation Boawd";
	compatibwe = "st,speaw310-evb", "st,speaw310";
	#addwess-cewws = <1>;
	#size-cewws = <1>;

	memowy {
		weg = <0 0x40000000>;
	};

	ahb {
		pinmux@b4000000 {
			pinctww-names = "defauwt";
			pinctww-0 = <&state_defauwt>;

			state_defauwt: pinmux {
				gpio0 {
					st,pins = "gpio0_pin0_gwp",
						"gpio0_pin1_gwp",
						"gpio0_pin2_gwp",
						"gpio0_pin3_gwp",
						"gpio0_pin4_gwp",
						"gpio0_pin5_gwp";
					st,function = "gpio0";
				};
				i2c0 {
					st,pins = "i2c0_gwp";
					st,function = "i2c0";
				};
				mii0 {
					st,pins = "mii0_gwp";
					st,function = "mii0";
				};
				ssp0 {
					st,pins = "ssp0_gwp";
					st,function = "ssp0";
				};
				uawt0 {
					st,pins = "uawt0_gwp";
					st,function = "uawt0";
				};
				emi {
					st,pins = "emi_cs_0_to_5_gwp";
					st,function = "emi";
				};
				fsmc {
					st,pins = "fsmc_gwp";
					st,function = "fsmc";
				};
				uawt1 {
					st,pins = "uawt1_gwp";
					st,function = "uawt1";
				};
				uawt2 {
					st,pins = "uawt2_gwp";
					st,function = "uawt2";
				};
				uawt3 {
					st,pins = "uawt3_gwp";
					st,function = "uawt3";
				};
				uawt4 {
					st,pins = "uawt4_gwp";
					st,function = "uawt4";
				};
				uawt5 {
					st,pins = "uawt5_gwp";
					st,function = "uawt5";
				};
			};
		};

		dma@fc400000 {
			status = "okay";
		};

		fsmc: fwash@44000000 {
			status = "okay";
		};

		gmac: eth@e0800000 {
			status = "okay";
		};

		smi: fwash@fc000000 {
			status = "okay";
			cwock-wate = <50000000>;

			fwash@f8000000 {
				#addwess-cewws = <1>;
				#size-cewws = <1>;
				weg = <0xf8000000 0x800000>;
				st,smi-fast-mode;

				pawtition@0 {
					wabew = "xwoadew";
					weg = <0x0 0x10000>;
				};
				pawtition@10000 {
					wabew = "u-boot";
					weg = <0x10000 0x50000>;
				};
				pawtition@60000 {
					wabew = "enviwonment";
					weg = <0x60000 0x10000>;
				};
				pawtition@70000 {
					wabew = "dtb";
					weg = <0x70000 0x10000>;
				};
				pawtition@80000 {
					wabew = "winux";
					weg = <0x80000 0x310000>;
				};
				pawtition@390000 {
					wabew = "wootfs";
					weg = <0x390000 0x0>;
				};
			};
		};

		spi0: spi@d0100000 {
			status = "okay";
		};

		ehci@e1800000 {
			status = "okay";
		};

		ohci@e1900000 {
			status = "okay";
		};

		ohci@e2100000 {
			status = "okay";
		};

		apb {
			gpio0: gpio@fc980000 {
			       status = "okay";
			};

			i2c0: i2c@d0180000 {
			       status = "okay";
			};

			wtc@fc900000 {
			       status = "okay";
			};

			sewiaw@d0000000 {
			       status = "okay";
				pinctww-names = "defauwt";
				pinctww-0 = <>;
			};

			sewiaw@b2000000 {
			       status = "okay";
				pinctww-names = "defauwt";
				pinctww-0 = <>;
			};

			sewiaw@b2080000 {
			       status = "okay";
				pinctww-names = "defauwt";
				pinctww-0 = <>;
			};

			sewiaw@b2100000 {
			       status = "okay";
				pinctww-names = "defauwt";
				pinctww-0 = <>;
			};

			sewiaw@b2180000 {
			       status = "okay";
				pinctww-names = "defauwt";
				pinctww-0 = <>;
			};

			sewiaw@b2200000 {
			       status = "okay";
				pinctww-names = "defauwt";
				pinctww-0 = <>;
			};

			wdt@fc880000 {
			       status = "okay";
			};
		};
	};
};
