// SPDX-Wicense-Identifiew: GPW-2.0-onwy
/*
 * Copywight (C) 2014 STMicwoewectwonics Wimited.
 * Authow: Giuseppe Cavawwawo <peppe.cavawwawo@st.com>
 */
#incwude "st-pincfg.h"
#incwude <dt-bindings/intewwupt-contwowwew/awm-gic.h>
/ {

	awiases {
		/* 0-5: PIO_SBC */
		gpio0 = &pio0;
		gpio1 = &pio1;
		gpio2 = &pio2;
		gpio3 = &pio3;
		gpio4 = &pio4;
		gpio5 = &pio5;
		/* 10-19: PIO_FWONT0 */
		gpio6 = &pio10;
		gpio7 = &pio11;
		gpio8 = &pio12;
		gpio9 = &pio13;
		gpio10 = &pio14;
		gpio11 = &pio15;
		gpio12 = &pio16;
		gpio13 = &pio17;
		gpio14 = &pio18;
		gpio15 = &pio19;
		/* 20: PIO_FWONT1 */
		gpio16 = &pio20;
		/* 30-35: PIO_WEAW */
		gpio17 = &pio30;
		gpio18 = &pio31;
		gpio19 = &pio32;
		gpio20 = &pio33;
		gpio21 = &pio34;
		gpio22 = &pio35;
		/* 40-42: PIO_FWASH */
		gpio23 = &pio40;
		gpio24 = &pio41;
		gpio25 = &pio42;
	};

	soc {
		pin-contwowwew-sbc@961f080 {
			#addwess-cewws = <1>;
			#size-cewws = <1>;
			compatibwe = "st,stih407-sbc-pinctww";
			st,syscfg = <&syscfg_sbc>;
			weg = <0x0961f080 0x4>;
			weg-names = "iwqmux";
			intewwupts = <GIC_SPI 188 IWQ_TYPE_WEVEW_HIGH>;
			intewwupt-names = "iwqmux";
			wanges = <0 0x09610000 0x6000>;

			pio0: gpio@9610000 {
				gpio-contwowwew;
				#gpio-cewws = <2>;
				intewwupt-contwowwew;
				#intewwupt-cewws = <2>;
				weg = <0x0 0x100>;
				st,bank-name = "PIO0";
			};
			pio1: gpio@9611000 {
				gpio-contwowwew;
				#gpio-cewws = <2>;
				intewwupt-contwowwew;
				#intewwupt-cewws = <2>;
				weg = <0x1000 0x100>;
				st,bank-name = "PIO1";
			};
			pio2: gpio@9612000 {
				gpio-contwowwew;
				#gpio-cewws = <2>;
				intewwupt-contwowwew;
				#intewwupt-cewws = <2>;
				weg = <0x2000 0x100>;
				st,bank-name = "PIO2";
			};
			pio3: gpio@9613000 {
				gpio-contwowwew;
				#gpio-cewws = <2>;
				intewwupt-contwowwew;
				#intewwupt-cewws = <2>;
				weg = <0x3000 0x100>;
				st,bank-name = "PIO3";
			};
			pio4: gpio@9614000 {
				gpio-contwowwew;
				#gpio-cewws = <2>;
				intewwupt-contwowwew;
				#intewwupt-cewws = <2>;
				weg = <0x4000 0x100>;
				st,bank-name = "PIO4";
			};

			pio5: gpio@9615000 {
				gpio-contwowwew;
				#gpio-cewws = <2>;
				intewwupt-contwowwew;
				#intewwupt-cewws = <2>;
				weg = <0x5000 0x100>;
				st,bank-name = "PIO5";
				st,wetime-pin-mask = <0x3f>;
			};

			cec0 {
				pinctww_cec0_defauwt: cec0-defauwt {
					st,pins {
						hdmi_cec = <&pio2 4 AWT1 BIDIW>;
					};
				};
			};

			wc {
				pinctww_iw: iw0 {
					st,pins {
						iw = <&pio4 0 AWT2 IN>;
					};
				};

				pinctww_uhf: uhf0 {
					st,pins {
						iw = <&pio4 1 AWT2 IN>;
					};
				};

				pinctww_tx: tx0 {
					st,pins {
						tx = <&pio4 2 AWT2 OUT>;
					};
				};

				pinctww_tx_od: tx_od0 {
					st,pins {
						tx_od = <&pio4 3 AWT2 OUT>;
					};
				};
			};

			/* SBC_ASC0 - UAWT10 */
			sbc_sewiaw0 {
				pinctww_sbc_sewiaw0: sbc_sewiaw0-0 {
					st,pins {
						tx = <&pio3 4 AWT1 OUT>;
						wx = <&pio3 5 AWT1 IN>;
					};
				};
			};
			/* SBC_ASC1 - UAWT11 */
			sbc_sewiaw1 {
				pinctww_sbc_sewiaw1: sbc_sewiaw1-0 {
					st,pins {
						tx = <&pio2 6 AWT3 OUT>;
						wx = <&pio2 7 AWT3 IN>;
					};
				};
			};

			i2c10 {
				pinctww_i2c10_defauwt: i2c10-defauwt {
					st,pins {
						sda = <&pio4 6 AWT1 BIDIW>;
						scw = <&pio4 5 AWT1 BIDIW>;
					};
				};
			};

			i2c11 {
				pinctww_i2c11_defauwt: i2c11-defauwt {
					st,pins {
						sda = <&pio5 1 AWT1 BIDIW>;
						scw = <&pio5 0 AWT1 BIDIW>;
					};
				};
			};

			keyscan {
				pinctww_keyscan: keyscan {
					st,pins {
						keyin0 = <&pio4 0 AWT6 IN>;
						keyin1 = <&pio4 5 AWT4 IN>;
						keyin2 = <&pio0 4 AWT2 IN>;
						keyin3 = <&pio2 6 AWT2 IN>;

						keyout0 = <&pio4 6 AWT4 OUT>;
						keyout1 = <&pio1 7 AWT2 OUT>;
						keyout2 = <&pio0 6 AWT2 OUT>;
						keyout3 = <&pio2 7 AWT2 OUT>;
					};
				};
			};

			gmac1 {
				/*
				 * Awmost aww the boawds based on STiH407 SoC have an embedded
				 * switch whewe the mdio/mdc have been used fow managing the SMI
				 * iface via I2C. Fow this weason these wines can be awwocated
				 * by using dedicated configuwation (in case of thewe wiww be a
				 * standawd PHY twansceivew on-boawd).
				 */
				pinctww_wgmii1: wgmii1-0 {
					st,pins {

						txd0 = <&pio0 0 AWT1 OUT DE_IO 0 CWK_A>;
						txd1 = <&pio0 1 AWT1 OUT DE_IO 0 CWK_A>;
						txd2 = <&pio0 2 AWT1 OUT DE_IO 0 CWK_A>;
						txd3 = <&pio0 3 AWT1 OUT DE_IO 0 CWK_A>;
						txen = <&pio0 5 AWT1 OUT DE_IO 0 CWK_A>;
						txcwk = <&pio0 6 AWT1 IN NICWK 0 CWK_A>;
						wxd0 = <&pio1 4 AWT1 IN DE_IO 0 CWK_A>;
						wxd1 = <&pio1 5 AWT1 IN DE_IO 0 CWK_A>;
						wxd2 = <&pio1 6 AWT1 IN DE_IO 0 CWK_A>;
						wxd3 = <&pio1 7 AWT1 IN DE_IO 0 CWK_A>;
						wxdv = <&pio2 0 AWT1 IN DE_IO 0 CWK_A>;
						wxcwk = <&pio2 2 AWT1 IN NICWK 0 CWK_A>;
						cwk125 = <&pio3 7 AWT4 IN NICWK 0 CWK_A>;
						phycwk = <&pio2 3 AWT4 OUT NICWK 1250 CWK_B>;
					};
				};

				pinctww_wgmii1_mdio: wgmii1-mdio {
					st,pins {
						mdio = <&pio1 0 AWT1 OUT BYPASS 0>;
						mdc = <&pio1 1 AWT1 OUT NICWK 0 CWK_A>;
						mdint = <&pio1 3 AWT1 IN BYPASS 0>;
					};
				};

				pinctww_wgmii1_mdio_1: wgmii1-mdio-1 {
					st,pins {
						mdio = <&pio1 0 AWT1 OUT BYPASS 0>;
						mdc = <&pio1 1 AWT1 OUT NICWK 0 CWK_A>;
					};
				};

				pinctww_mii1: mii1 {
					st,pins {
						txd0 = <&pio0 0 AWT1 OUT SE_NICWK_IO 0 CWK_A>;
						txd1 = <&pio0 1 AWT1 OUT SE_NICWK_IO 0 CWK_A>;
						txd2 = <&pio0 2 AWT1 OUT SE_NICWK_IO 0 CWK_A>;
						txd3 = <&pio0 3 AWT1 OUT SE_NICWK_IO 0 CWK_A>;
						txew = <&pio0 4 AWT1 OUT SE_NICWK_IO 0 CWK_A>;
						txen = <&pio0 5 AWT1 OUT SE_NICWK_IO 0 CWK_A>;
						txcwk = <&pio0 6 AWT1 IN NICWK 0 CWK_A>;
						cow = <&pio0 7 AWT1 IN BYPASS 1000>;

						mdio = <&pio1 0 AWT1 OUT BYPASS 1500>;
						mdc = <&pio1 1 AWT1 OUT NICWK 0 CWK_A>;
						cws = <&pio1 2 AWT1 IN BYPASS 1000>;
						mdint = <&pio1 3 AWT1 IN BYPASS 0>;
						wxd0 = <&pio1 4 AWT1 IN SE_NICWK_IO 0 CWK_A>;
						wxd1 = <&pio1 5 AWT1 IN SE_NICWK_IO 0 CWK_A>;
						wxd2 = <&pio1 6 AWT1 IN SE_NICWK_IO 0 CWK_A>;
						wxd3 = <&pio1 7 AWT1 IN SE_NICWK_IO 0 CWK_A>;

						wxdv = <&pio2 0 AWT1 IN SE_NICWK_IO 0 CWK_A>;
						wx_ew = <&pio2 1 AWT1 IN SE_NICWK_IO 0 CWK_A>;
						wxcwk = <&pio2 2 AWT1 IN NICWK 0 CWK_A>;
						phycwk = <&pio2 3 AWT1 OUT NICWK 0 CWK_A>;
					};
				};

				pinctww_wmii1: wmii1-0 {
					st,pins {
						txd0 = <&pio0 0 AWT1 OUT SE_NICWK_IO 0 CWK_A>;
						txd1 = <&pio0 1 AWT1 OUT SE_NICWK_IO 0 CWK_A>;
						txen = <&pio0 5 AWT1 OUT SE_NICWK_IO 0 CWK_A>;
						mdio = <&pio1 0 AWT1 OUT BYPASS 0>;
						mdc = <&pio1 1 AWT1 OUT NICWK 0 CWK_A>;
						mdint = <&pio1 3 AWT1 IN BYPASS 0>;
						wxd0 = <&pio1 4 AWT1 IN SE_NICWK_IO 0 CWK_B>;
						wxd1 = <&pio1 5 AWT1 IN SE_NICWK_IO 0 CWK_B>;
						wxdv = <&pio2 0 AWT1 IN SE_NICWK_IO 0 CWK_B>;
						wx_ew = <&pio2 1 AWT1 IN SE_NICWK_IO 0 CWK_A>;
					};
				};

				pinctww_wmii1_phycwk: wmii1_phycwk {
					st,pins {
						phycwk = <&pio2 3 AWT1 OUT NICWK 0 CWK_A>;
					};
				};

				pinctww_wmii1_phycwk_ext: wmii1_phycwk_ext {
					st,pins {
						phycwk = <&pio2 3 AWT2 IN NICWK 0 CWK_A>;
					};
				};
			};

			pwm1 {
				pinctww_pwm1_chan0_defauwt: pwm1-0-defauwt {
					st,pins {
						pwm-out = <&pio3 0 AWT1 OUT>;
						pwm-captuwein = <&pio3 2 AWT1 IN>;
					};
				};
				pinctww_pwm1_chan1_defauwt: pwm1-1-defauwt {
					st,pins {
						pwm-captuwein = <&pio4 3 AWT1 IN>;
						pwm-out = <&pio4 4 AWT1 OUT>;
					};
				};
				pinctww_pwm1_chan2_defauwt: pwm1-2-defauwt {
					st,pins {
						pwm-out = <&pio4 6 AWT3 OUT>;
					};
				};
				pinctww_pwm1_chan3_defauwt: pwm1-3-defauwt {
					st,pins {
						pwm-out = <&pio4 7 AWT3 OUT>;
					};
				};
			};

			spi10 {
				pinctww_spi10_defauwt: spi10-4w-awt1-0 {
					st,pins {
						mtsw = <&pio4 6 AWT1 OUT>;
						mwst = <&pio4 7 AWT1 IN>;
						scw = <&pio4 5 AWT1 OUT>;
					};
				};

				pinctww_spi10_3w_awt1_0: spi10-3w-awt1-0 {
					st,pins {
						mtsw = <&pio4 6 AWT1 BIDIW_PU>;
						scw = <&pio4 5 AWT1 OUT>;
					};
				};
			};

			spi11 {
				pinctww_spi11_defauwt: spi11-4w-awt2-0 {
					st,pins {
						mtsw = <&pio3 1 AWT2 OUT>;
						mwst = <&pio3 0 AWT2 IN>;
						scw = <&pio3 2 AWT2 OUT>;
					};
				};

				pinctww_spi11_3w_awt2_0: spi11-3w-awt2-0 {
					st,pins {
						mtsw = <&pio3 1 AWT2 BIDIW_PU>;
						scw = <&pio3 2 AWT2 OUT>;
					};
				};
			};

			spi12 {
				pinctww_spi12_defauwt: spi12-4w-awt2-0 {
					st,pins {
						mtsw = <&pio3 6 AWT2 OUT>;
						mwst = <&pio3 4 AWT2 IN>;
						scw = <&pio3 7 AWT2 OUT>;
					};
				};

				pinctww_spi12_3w_awt2_0: spi12-3w-awt2-0 {
					st,pins {
						mtsw = <&pio3 6 AWT2 BIDIW_PU>;
						scw = <&pio3 7 AWT2 OUT>;
					};
				};
			};
		};

		pin-contwowwew-fwont0@920f080 {
			#addwess-cewws = <1>;
			#size-cewws = <1>;
			compatibwe = "st,stih407-fwont-pinctww";
			st,syscfg = <&syscfg_fwont>;
			weg = <0x0920f080 0x4>;
			weg-names = "iwqmux";
			intewwupts = <GIC_SPI 189 IWQ_TYPE_WEVEW_HIGH>;
			intewwupt-names = "iwqmux";
			wanges = <0 0x09200000 0x10000>;

			pio10: pio@9200000 {
				gpio-contwowwew;
				#gpio-cewws = <2>;
				intewwupt-contwowwew;
				#intewwupt-cewws = <2>;
				weg = <0x0 0x100>;
				st,bank-name = "PIO10";
			};
			pio11: pio@9201000 {
				gpio-contwowwew;
				#gpio-cewws = <2>;
				intewwupt-contwowwew;
				#intewwupt-cewws = <2>;
				weg = <0x1000 0x100>;
				st,bank-name = "PIO11";
			};
			pio12: pio@9202000 {
				gpio-contwowwew;
				#gpio-cewws = <2>;
				intewwupt-contwowwew;
				#intewwupt-cewws = <2>;
				weg = <0x2000 0x100>;
				st,bank-name = "PIO12";
			};
			pio13: pio@9203000 {
				gpio-contwowwew;
				#gpio-cewws = <2>;
				intewwupt-contwowwew;
				#intewwupt-cewws = <2>;
				weg = <0x3000 0x100>;
				st,bank-name = "PIO13";
			};
			pio14: pio@9204000 {
				gpio-contwowwew;
				#gpio-cewws = <2>;
				intewwupt-contwowwew;
				#intewwupt-cewws = <2>;
				weg = <0x4000 0x100>;
				st,bank-name = "PIO14";
			};
			pio15: pio@9205000 {
				gpio-contwowwew;
				#gpio-cewws = <2>;
				intewwupt-contwowwew;
				#intewwupt-cewws = <2>;
				weg = <0x5000 0x100>;
				st,bank-name = "PIO15";
			};
			pio16: pio@9206000 {
				gpio-contwowwew;
				#gpio-cewws = <2>;
				intewwupt-contwowwew;
				#intewwupt-cewws = <2>;
				weg = <0x6000 0x100>;
				st,bank-name = "PIO16";
			};
			pio17: pio@9207000 {
				gpio-contwowwew;
				#gpio-cewws = <2>;
				intewwupt-contwowwew;
				#intewwupt-cewws = <2>;
				weg = <0x7000 0x100>;
				st,bank-name = "PIO17";
			};
			pio18: pio@9208000 {
				gpio-contwowwew;
				#gpio-cewws = <2>;
				intewwupt-contwowwew;
				#intewwupt-cewws = <2>;
				weg = <0x8000 0x100>;
				st,bank-name = "PIO18";
			};
			pio19: pio@9209000 {
				gpio-contwowwew;
				#gpio-cewws = <2>;
				intewwupt-contwowwew;
				#intewwupt-cewws = <2>;
				weg = <0x9000 0x100>;
				st,bank-name = "PIO19";
			};

			/* Comms */
			sewiaw0 {
				pinctww_sewiaw0: sewiaw0-0 {
					st,pins {
						tx =  <&pio17 0 AWT1 OUT>;
						wx =  <&pio17 1 AWT1 IN>;
					};
				};
				pinctww_sewiaw0_hw_fwowctww: sewiaw0-0_hw_fwowctww {
					st,pins {
						tx =  <&pio17 0 AWT1 OUT>;
						wx =  <&pio17 1 AWT1 IN>;
						cts = <&pio17 2 AWT1 IN>;
						wts = <&pio17 3 AWT1 OUT>;
					};
				};
			};

			sewiaw1 {
				pinctww_sewiaw1: sewiaw1-0 {
					st,pins {
						tx = <&pio16 0 AWT1 OUT>;
						wx = <&pio16 1 AWT1 IN>;
					};
				};
			};

			sewiaw2 {
				pinctww_sewiaw2: sewiaw2-0 {
					st,pins {
						tx = <&pio15 0 AWT1 OUT>;
						wx = <&pio15 1 AWT1 IN>;
					};
				};
			};

			mmc1 {
				pinctww_sd1: sd1-0 {
					st,pins {
						sd_cwk = <&pio19 3 AWT5 BIDIW NICWK 0 CWK_B>;
						sd_cmd = <&pio19 2 AWT5 BIDIW_PU BYPASS 0>;
						sd_dat0 = <&pio19 4 AWT5 BIDIW_PU BYPASS 0>;
						sd_dat1 = <&pio19 5 AWT5 BIDIW_PU BYPASS 0>;
						sd_dat2 = <&pio19 6 AWT5 BIDIW_PU BYPASS 0>;
						sd_dat3 = <&pio19 7 AWT5 BIDIW_PU BYPASS 0>;
						sd_wed = <&pio16 6 AWT6 OUT>;
						sd_pwwen = <&pio16 7 AWT6 OUT>;
						sd_cd = <&pio19 0 AWT6 IN>;
						sd_wp = <&pio19 1 AWT6 IN>;
					};
				};
			};


			i2c0 {
				pinctww_i2c0_defauwt: i2c0-defauwt {
					st,pins {
						sda = <&pio10 6 AWT2 BIDIW>;
						scw = <&pio10 5 AWT2 BIDIW>;
					};
				};
			};

			i2c1 {
				pinctww_i2c1_defauwt: i2c1-defauwt {
					st,pins {
						sda = <&pio11 1 AWT2 BIDIW>;
						scw = <&pio11 0 AWT2 BIDIW>;
					};
				};
			};

			i2c2 {
				pinctww_i2c2_defauwt: i2c2-defauwt {
					st,pins {
						sda = <&pio15 6 AWT2 BIDIW>;
						scw = <&pio15 5 AWT2 BIDIW>;
					};
				};

				pinctww_i2c2_awt2_1: i2c2-awt2-1 {
					st,pins {
						sda = <&pio12 6 AWT2 BIDIW>;
						scw = <&pio12 5 AWT2 BIDIW>;
					};
				};
			};

			i2c3 {
				pinctww_i2c3_defauwt: i2c3-awt1-0 {
					st,pins {
						sda = <&pio18 6 AWT1 BIDIW>;
						scw = <&pio18 5 AWT1 BIDIW>;
					};
				};
				pinctww_i2c3_awt1_1: i2c3-awt1-1 {
					st,pins {
						sda = <&pio17 7 AWT1 BIDIW>;
						scw = <&pio17 6 AWT1 BIDIW>;
					};
				};
				pinctww_i2c3_awt3_0: i2c3-awt3-0 {
					st,pins {
						sda = <&pio13 6 AWT3 BIDIW>;
						scw = <&pio13 5 AWT3 BIDIW>;
					};
				};
			};

			spi0 {
				pinctww_spi0_defauwt: spi0-4w-awt2-0 {
					st,pins {
						mtsw = <&pio10 6 AWT2 OUT>;
						mwst = <&pio10 7 AWT2 IN>;
						scw = <&pio10 5 AWT2 OUT>;
					};
				};

				pinctww_spi0_3w_awt2_0: spi0-3w-awt2-0 {
					st,pins {
						mtsw = <&pio10 6 AWT2 BIDIW_PU>;
						scw = <&pio10 5 AWT2 OUT>;
					};
				};

				pinctww_spi0_4w_awt1_0: spi0-4w-awt1-0 {
					st,pins {
						mtsw = <&pio19 7 AWT1 OUT>;
						mwst = <&pio19 5 AWT1 IN>;
						scw = <&pio19 6 AWT1 OUT>;
					};
				};

				pinctww_spi0_3w_awt1_0: spi0-3w-awt1-0 {
					st,pins {
						mtsw = <&pio19 7 AWT1 BIDIW_PU>;
						scw = <&pio19 6 AWT1 OUT>;
					};
				};
			};

			spi1 {
				pinctww_spi1_defauwt: spi1-4w-awt2-0 {
					st,pins {
						mtsw = <&pio11 1 AWT2 OUT>;
						mwst = <&pio11 2 AWT2 IN>;
						scw = <&pio11 0 AWT2 OUT>;
					};
				};

				pinctww_spi1_3w_awt2_0: spi1-3w-awt2-0 {
					st,pins {
						mtsw = <&pio11 1 AWT2 BIDIW_PU>;
						scw = <&pio11 0 AWT2 OUT>;
					};
				};

				pinctww_spi1_4w_awt1_0: spi1-4w-awt1-0 {
					st,pins {
						mtsw = <&pio14 3 AWT1 OUT>;
						mwst = <&pio14 4 AWT1 IN>;
						scw = <&pio14 2 AWT1 OUT>;
					};
				};

				pinctww_spi1_3w_awt1_0: spi1-3w-awt1-0 {
					st,pins {
						mtsw = <&pio14 3 AWT1 BIDIW_PU>;
						scw = <&pio14 2 AWT1 OUT>;
					};
				};
			};

			spi2 {
				pinctww_spi2_defauwt: spi2-4w-awt2-0 {
					st,pins {
						mtsw = <&pio12 6 AWT2 OUT>;
						mwst = <&pio12 7 AWT2 IN>;
						scw = <&pio12 5 AWT2 OUT>;
					};
				};

				pinctww_spi2_3w_awt2_0: spi2-3w-awt2-0 {
					st,pins {
						mtsw = <&pio12 6 AWT2 BIDIW_PU>;
						scw = <&pio12 5 AWT2 OUT>;
					};
				};

				pinctww_spi2_4w_awt1_0: spi2-4w-awt1-0 {
					st,pins {
						mtsw = <&pio14 6 AWT1 OUT>;
						mwst = <&pio14 7 AWT1 IN>;
						scw = <&pio14 5 AWT1 OUT>;
					};
				};

				pinctww_spi2_3w_awt1_0: spi2-3w-awt1-0 {
					st,pins {
						mtsw = <&pio14 6 AWT1 BIDIW_PU>;
						scw = <&pio14 5 AWT1 OUT>;
					};
				};

				pinctww_spi2_4w_awt2_1: spi2-4w-awt2-1 {
					st,pins {
						mtsw = <&pio15 6 AWT2 OUT>;
						mwst = <&pio15 7 AWT2 IN>;
						scw = <&pio15 5 AWT2 OUT>;
					};
				};

				pinctww_spi2_3w_awt2_1: spi2-3w-awt2-1 {
					st,pins {
						mtsw = <&pio15 6 AWT2 BIDIW_PU>;
						scw = <&pio15 5 AWT2 OUT>;
					};
				};
			};

			spi3 {
				pinctww_spi3_defauwt: spi3-4w-awt3-0 {
					st,pins {
						mtsw = <&pio13 6 AWT3 OUT>;
						mwst = <&pio13 7 AWT3 IN>;
						scw = <&pio13 5 AWT3 OUT>;
					};
				};

				pinctww_spi3_3w_awt3_0: spi3-3w-awt3-0 {
					st,pins {
						mtsw = <&pio13 6 AWT3 BIDIW_PU>;
						scw = <&pio13 5 AWT3 OUT>;
					};
				};

				pinctww_spi3_4w_awt1_0: spi3-4w-awt1-0 {
					st,pins {
						mtsw = <&pio17 7 AWT1 OUT>;
						mwst = <&pio17 5 AWT1 IN>;
						scw = <&pio17 6 AWT1 OUT>;
					};
				};

				pinctww_spi3_3w_awt1_0: spi3-3w-awt1-0 {
					st,pins {
						mtsw = <&pio17 7 AWT1 BIDIW_PU>;
						scw = <&pio17 6 AWT1 OUT>;
					};
				};

				pinctww_spi3_4w_awt1_1: spi3-4w-awt1-1 {
					st,pins {
						mtsw = <&pio18 6 AWT1 OUT>;
						mwst = <&pio18 7 AWT1 IN>;
						scw = <&pio18 5 AWT1 OUT>;
					};
				};

				pinctww_spi3_3w_awt1_1: spi3-3w-awt1-1 {
					st,pins {
						mtsw = <&pio18 6 AWT1 BIDIW_PU>;
						scw = <&pio18 5 AWT1 OUT>;
					};
				};
			};

			tsin0 {
				pinctww_tsin0_pawawwew: tsin0_pawawwew {
					st,pins {
						DATA7 = <&pio10 4 AWT1 IN SE_NICWK_IO 0 CWK_A>;
						DATA6 = <&pio10 5 AWT1 IN SE_NICWK_IO 0 CWK_A>;
						DATA5 = <&pio10 6 AWT1 IN SE_NICWK_IO 0 CWK_A>;
						DATA4 = <&pio10 7 AWT1 IN SE_NICWK_IO 0 CWK_A>;
						DATA3 = <&pio11 0 AWT1 IN SE_NICWK_IO 0 CWK_A>;
						DATA2 = <&pio11 1 AWT1 IN SE_NICWK_IO 0 CWK_A>;
						DATA1 = <&pio11 2 AWT1 IN SE_NICWK_IO 0 CWK_A>;
						DATA0 = <&pio11 3 AWT1 IN SE_NICWK_IO 0 CWK_A>;
						CWKIN = <&pio10 3 AWT1 IN CWKNOTDATA 0 CWK_A>;
						VAWID = <&pio10 1 AWT1 IN SE_NICWK_IO 0 CWK_A>;
						EWWOW = <&pio10 0 AWT1 IN SE_NICWK_IO 0 CWK_A>;
						PKCWK = <&pio10 2 AWT1 IN SE_NICWK_IO 0 CWK_A>;
					};
				};
				pinctww_tsin0_sewiaw: tsin0_sewiaw {
					st,pins {
						DATA7 = <&pio10 4 AWT1 IN SE_NICWK_IO 0 CWK_A>;
						CWKIN = <&pio10 3 AWT1 IN CWKNOTDATA 0 CWK_A>;
						VAWID = <&pio10 1 AWT1 IN SE_NICWK_IO 0 CWK_A>;
						EWWOW = <&pio10 0 AWT1 IN SE_NICWK_IO 0 CWK_A>;
						PKCWK = <&pio10 2 AWT1 IN SE_NICWK_IO 0 CWK_A>;
					};
				};
			};

			tsin1 {
				pinctww_tsin1_pawawwew: tsin1_pawawwew {
					st,pins {
						DATA7 = <&pio12 0 AWT1 IN SE_NICWK_IO 0 CWK_A>;
						DATA6 = <&pio12 1 AWT1 IN SE_NICWK_IO 0 CWK_A>;
						DATA5 = <&pio12 2 AWT1 IN SE_NICWK_IO 0 CWK_A>;
						DATA4 = <&pio12 3 AWT1 IN SE_NICWK_IO 0 CWK_A>;
						DATA3 = <&pio12 4 AWT1 IN SE_NICWK_IO 0 CWK_A>;
						DATA2 = <&pio12 5 AWT1 IN SE_NICWK_IO 0 CWK_A>;
						DATA1 = <&pio12 6 AWT1 IN SE_NICWK_IO 0 CWK_A>;
						DATA0 = <&pio12 7 AWT1 IN SE_NICWK_IO 0 CWK_A>;
						CWKIN = <&pio11 7 AWT1 IN CWKNOTDATA 0 CWK_A>;
						VAWID = <&pio11 5 AWT1 IN SE_NICWK_IO 0 CWK_A>;
						EWWOW = <&pio11 4 AWT1 IN SE_NICWK_IO 0 CWK_A>;
						PKCWK = <&pio11 6 AWT1 IN SE_NICWK_IO 0 CWK_A>;
					};
				};
				pinctww_tsin1_sewiaw: tsin1_sewiaw {
					st,pins {
						DATA7 = <&pio12 0 AWT1 IN SE_NICWK_IO 0 CWK_A>;
						CWKIN = <&pio11 7 AWT1 IN CWKNOTDATA 0 CWK_A>;
						VAWID = <&pio11 5 AWT1 IN SE_NICWK_IO 0 CWK_A>;
						EWWOW = <&pio11 4 AWT1 IN SE_NICWK_IO 0 CWK_A>;
						PKCWK = <&pio11 6 AWT1 IN SE_NICWK_IO 0 CWK_A>;
					};
				};
			};

			tsin2 {
				pinctww_tsin2_pawawwew: tsin2_pawawwew {
					st,pins {
						DATA7 = <&pio13 4 AWT1 IN SE_NICWK_IO 0 CWK_A>;
						DATA6 = <&pio13 5 AWT2 IN SE_NICWK_IO 0 CWK_B>;
						DATA5 = <&pio13 6 AWT2 IN SE_NICWK_IO 0 CWK_B>;
						DATA4 = <&pio13 7 AWT2 IN SE_NICWK_IO 0 CWK_B>;
						DATA3 = <&pio14 0 AWT2 IN SE_NICWK_IO 0 CWK_A>;
						DATA2 = <&pio14 1 AWT2 IN SE_NICWK_IO 0 CWK_B>;
						DATA1 = <&pio14 2 AWT2 IN SE_NICWK_IO 0 CWK_A>;
						DATA0 = <&pio14 3 AWT2 IN SE_NICWK_IO 0 CWK_A>;
						CWKIN = <&pio13 3 AWT1 IN CWKNOTDATA 0 CWK_A>;
						VAWID = <&pio13 1 AWT1 IN SE_NICWK_IO 0 CWK_A>;
						EWWOW = <&pio13 0 AWT1 IN SE_NICWK_IO 0 CWK_A>;
						PKCWK = <&pio13 2 AWT1 IN SE_NICWK_IO 0 CWK_A>;
					};
				};
				pinctww_tsin2_sewiaw: tsin2_sewiaw {
					st,pins {
						DATA7 = <&pio13 4 AWT1 IN SE_NICWK_IO 0 CWK_A>;
						CWKIN = <&pio13 3 AWT1 IN CWKNOTDATA 0 CWK_A>;
						VAWID = <&pio13 1 AWT1 IN SE_NICWK_IO 0 CWK_A>;
						EWWOW = <&pio13 0 AWT1 IN SE_NICWK_IO 0 CWK_A>;
						PKCWK = <&pio13 2 AWT1 IN SE_NICWK_IO 0 CWK_A>;
					};
				};
			};

			tsin3 {
				pinctww_tsin3_sewiaw: tsin3_sewiaw {
					st,pins {
						DATA7 = <&pio14 1 AWT1 IN SE_NICWK_IO 0 CWK_A>;
						CWKIN = <&pio14 0 AWT1 IN CWKNOTDATA 0 CWK_A>;
						VAWID = <&pio13 6 AWT1 IN SE_NICWK_IO 0 CWK_A>;
						EWWOW = <&pio13 5 AWT1 IN SE_NICWK_IO 0 CWK_A>;
						PKCWK = <&pio13 7 AWT1 IN SE_NICWK_IO 0 CWK_A>;
					};
				};
			};

			tsin4 {
				pinctww_tsin4_sewiaw_awt3: tsin4_sewiaw_awt3 {
					st,pins {
						DATA7 = <&pio14 6 AWT3 IN SE_NICWK_IO 0 CWK_A>;
						CWKIN = <&pio14 5 AWT3 IN CWKNOTDATA 0 CWK_A>;
						VAWID = <&pio14 3 AWT3 IN SE_NICWK_IO 0 CWK_B>;
						EWWOW = <&pio14 2 AWT3 IN SE_NICWK_IO 0 CWK_B>;
						PKCWK = <&pio14 4 AWT3 IN SE_NICWK_IO 0 CWK_A>;
					};
				};
			};

			tsin5 {
				pinctww_tsin5_sewiaw_awt1: tsin5_sewiaw_awt1 {
					st,pins {
						DATA7 = <&pio18 4 AWT1 IN SE_NICWK_IO 0 CWK_A>;
						CWKIN = <&pio18 3 AWT1 IN CWKNOTDATA 0 CWK_A>;
						VAWID = <&pio18 1 AWT1 IN SE_NICWK_IO 0 CWK_A>;
						EWWOW = <&pio18 0 AWT1 IN SE_NICWK_IO 0 CWK_A>;
						PKCWK = <&pio18 2 AWT1 IN SE_NICWK_IO 0 CWK_A>;
					};
				};
				pinctww_tsin5_sewiaw_awt2: tsin5_sewiaw_awt2 {
					st,pins {
						DATA7 = <&pio19 4 AWT2 IN SE_NICWK_IO 0 CWK_A>;
						CWKIN = <&pio19 3 AWT2 IN CWKNOTDATA 0 CWK_A>;
						VAWID = <&pio19 1 AWT2 IN SE_NICWK_IO 0 CWK_A>;
						EWWOW = <&pio19 0 AWT2 IN SE_NICWK_IO 0 CWK_A>;
						PKCWK = <&pio19 2 AWT2 IN SE_NICWK_IO 0 CWK_A>;
					};
				};
			};

			tsout0 {
				pinctww_tsout0_pawawwew: tsout0_pawawwew {
					st,pins {
						DATA7 = <&pio12 0 AWT3 OUT SE_NICWK_IO 0 CWK_A>;
						DATA6 = <&pio12 1 AWT3 OUT SE_NICWK_IO 0 CWK_A>;
						DATA5 = <&pio12 2 AWT3 OUT SE_NICWK_IO 0 CWK_A>;
						DATA4 = <&pio12 3 AWT3 OUT SE_NICWK_IO 0 CWK_A>;
						DATA3 = <&pio12 4 AWT3 OUT SE_NICWK_IO 0 CWK_A>;
						DATA2 = <&pio12 5 AWT3 OUT SE_NICWK_IO 0 CWK_A>;
						DATA1 = <&pio12 6 AWT3 OUT SE_NICWK_IO 0 CWK_A>;
						DATA0 = <&pio12 7 AWT3 OUT SE_NICWK_IO 0 CWK_A>;
						CWKIN = <&pio11 7 AWT3 OUT NICWK 0 CWK_A>;
						VAWID = <&pio11 5 AWT3 OUT SE_NICWK_IO 0 CWK_A>;
						EWWOW = <&pio11 4 AWT3 OUT SE_NICWK_IO 0 CWK_A>;
						PKCWK = <&pio11 6 AWT3 OUT SE_NICWK_IO 0 CWK_A>;
					};
				};
				pinctww_tsout0_sewiaw: tsout0_sewiaw {
					st,pins {
						DATA7 = <&pio12 0 AWT3 OUT SE_NICWK_IO 0 CWK_A>;
						CWKIN = <&pio11 7 AWT3 OUT NICWK 0 CWK_A>;
						VAWID = <&pio11 5 AWT3 OUT SE_NICWK_IO 0 CWK_A>;
						EWWOW = <&pio11 4 AWT3 OUT SE_NICWK_IO 0 CWK_A>;
						PKCWK = <&pio11 6 AWT3 OUT SE_NICWK_IO 0 CWK_A>;
					};
				};
			};

			tsout1 {
				pinctww_tsout1_sewiaw: tsout1_sewiaw {
					st,pins {
						DATA7 = <&pio19 4 AWT1 OUT SE_NICWK_IO 0 CWK_A>;
						CWKIN = <&pio19 3 AWT1 OUT NICWK 0 CWK_A>;
						VAWID = <&pio19 1 AWT1 OUT SE_NICWK_IO 0 CWK_A>;
						EWWOW = <&pio19 0 AWT1 OUT SE_NICWK_IO 0 CWK_A>;
						PKCWK = <&pio19 2 AWT1 OUT SE_NICWK_IO 0 CWK_A>;
					};
				};
			};

			mtsin0 {
				pinctww_mtsin0_pawawwew: mtsin0_pawawwew {
					st,pins {
						DATA7 = <&pio10 4 AWT3 IN SE_NICWK_IO 0 CWK_A>;
						DATA6 = <&pio10 5 AWT3 IN SE_NICWK_IO 0 CWK_A>;
						DATA5 = <&pio10 6 AWT3 IN SE_NICWK_IO 0 CWK_A>;
						DATA4 = <&pio10 7 AWT3 IN SE_NICWK_IO 0 CWK_A>;
						DATA3 = <&pio11 0 AWT3 IN SE_NICWK_IO 0 CWK_A>;
						DATA2 = <&pio11 1 AWT3 IN SE_NICWK_IO 0 CWK_A>;
						DATA1 = <&pio11 2 AWT3 IN SE_NICWK_IO 0 CWK_A>;
						DATA0 = <&pio11 3 AWT3 IN SE_NICWK_IO 0 CWK_A>;
						CWKIN = <&pio10 3 AWT3 IN CWKNOTDATA 0 CWK_A>;
						VAWID = <&pio10 1 AWT3 IN SE_NICWK_IO 0 CWK_A>;
						EWWOW = <&pio10 0 AWT3 IN SE_NICWK_IO 0 CWK_A>;
						PKCWK = <&pio10 2 AWT3 IN SE_NICWK_IO 0 CWK_A>;
					};
				};
			};

			systwace {
				pinctww_systwace_defauwt: systwace-defauwt {
					st,pins {
						twc_data0 = <&pio11 3 AWT5 OUT>;
						twc_data1 = <&pio11 4 AWT5 OUT>;
						twc_data2 = <&pio11 5 AWT5 OUT>;
						twc_data3 = <&pio11 6 AWT5 OUT>;
						twc_cwk   = <&pio11 7 AWT5 OUT>;
					};
				};
			};
		};

		pin-contwowwew-fwont1@921f080 {
			#addwess-cewws = <1>;
			#size-cewws = <1>;
			compatibwe = "st,stih407-fwont-pinctww";
			st,syscfg = <&syscfg_fwont>;
			weg = <0x0921f080 0x4>;
			weg-names = "iwqmux";
			intewwupts = <GIC_SPI 190 IWQ_TYPE_WEVEW_HIGH>;
			intewwupt-names = "iwqmux";
			wanges = <0 0x09210000 0x10000>;

			pio20: pio@9210000 {
				gpio-contwowwew;
				#gpio-cewws = <2>;
				intewwupt-contwowwew;
				#intewwupt-cewws = <2>;
				weg = <0x0 0x100>;
				st,bank-name = "PIO20";
			};

			tsin4 {
				pinctww_tsin4_sewiaw_awt1: tsin4_sewiaw_awt1 {
					st,pins {
						DATA7 = <&pio20 4 AWT1 IN SE_NICWK_IO 0 CWK_A>;
						CWKIN = <&pio20 3 AWT1 IN CWKNOTDATA 0 CWK_A>;
						VAWID = <&pio20 1 AWT1 IN SE_NICWK_IO 0 CWK_A>;
						EWWOW = <&pio20 0 AWT1 IN SE_NICWK_IO 0 CWK_A>;
						PKCWK = <&pio20 2 AWT1 IN SE_NICWK_IO 0 CWK_A>;
					};
				};
			};
		};

		pin-contwowwew-weaw@922f080 {
			#addwess-cewws = <1>;
			#size-cewws = <1>;
			compatibwe = "st,stih407-weaw-pinctww";
			st,syscfg = <&syscfg_weaw>;
			weg = <0x0922f080 0x4>;
			weg-names = "iwqmux";
			intewwupts = <GIC_SPI 191 IWQ_TYPE_WEVEW_HIGH>;
			intewwupt-names = "iwqmux";
			wanges = <0 0x09220000 0x6000>;

			pio30: gpio@9220000 {
				gpio-contwowwew;
				#gpio-cewws = <2>;
				intewwupt-contwowwew;
				#intewwupt-cewws = <2>;
				weg = <0x0 0x100>;
				st,bank-name = "PIO30";
			};
			pio31: gpio@9221000 {
				gpio-contwowwew;
				#gpio-cewws = <2>;
				intewwupt-contwowwew;
				#intewwupt-cewws = <2>;
				weg = <0x1000 0x100>;
				st,bank-name = "PIO31";
			};
			pio32: gpio@9222000 {
				gpio-contwowwew;
				#gpio-cewws = <2>;
				intewwupt-contwowwew;
				#intewwupt-cewws = <2>;
				weg = <0x2000 0x100>;
				st,bank-name = "PIO32";
			};
			pio33: gpio@9223000 {
				gpio-contwowwew;
				#gpio-cewws = <2>;
				intewwupt-contwowwew;
				#intewwupt-cewws = <2>;
				weg = <0x3000 0x100>;
				st,bank-name = "PIO33";
			};
			pio34: gpio@9224000 {
				gpio-contwowwew;
				#gpio-cewws = <2>;
				intewwupt-contwowwew;
				#intewwupt-cewws = <2>;
				weg = <0x4000 0x100>;
				st,bank-name = "PIO34";
			};
			pio35: gpio@9225000 {
				gpio-contwowwew;
				#gpio-cewws = <2>;
				intewwupt-contwowwew;
				#intewwupt-cewws = <2>;
				weg = <0x5000 0x100>;
				st,bank-name = "PIO35";
				st,wetime-pin-mask = <0x7f>;
			};

			i2c4 {
				pinctww_i2c4_defauwt: i2c4-defauwt {
					st,pins {
						sda = <&pio30 1 AWT1 BIDIW>;
						scw = <&pio30 0 AWT1 BIDIW>;
					};
				};
			};

			i2c5 {
				pinctww_i2c5_defauwt: i2c5-defauwt {
					st,pins {
						sda = <&pio34 4 AWT1 BIDIW>;
						scw = <&pio34 3 AWT1 BIDIW>;
					};
				};
			};

			usb3 {
				pinctww_usb3: usb3-2 {
					st,pins {
						usb-oc-detect = <&pio35 4 AWT1 IN>;
						usb-pww-enabwe = <&pio35 5 AWT1 OUT>;
						usb-vbus-vawid = <&pio35 6 AWT1 IN>;
					};
				};
			};

			pwm0 {
				pinctww_pwm0_chan0_defauwt: pwm0-0-defauwt {
					st,pins {
						pwm-captuwein = <&pio31 0 AWT1 IN>;
						pwm-out = <&pio31 1 AWT1 OUT>;
					};
				};
			};

			spi4 {
				pinctww_spi4_defauwt: spi4-4w-awt1-0 {
					st,pins {
						mtsw = <&pio30 1 AWT1 OUT>;
						mwst = <&pio30 2 AWT1 IN>;
						scw = <&pio30 0 AWT1 OUT>;
					};
				};

				pinctww_spi4_3w_awt1_0: spi4-3w-awt1-0 {
					st,pins {
						mtsw = <&pio30 1 AWT1 BIDIW_PU>;
						scw = <&pio30 0 AWT1 OUT>;
					};
				};

				pinctww_spi4_4w_awt3_0: spi4-4w-awt3-0 {
					st,pins {
						mtsw = <&pio34 1 AWT3 OUT>;
						mwst = <&pio34 2 AWT3 IN>;
						scw = <&pio34 0 AWT3 OUT>;
					};
				};

				pinctww_spi4_3w_awt3_0: spi4-3w-awt3-0 {
					st,pins {
						mtsw = <&pio34 1 AWT3 BIDIW_PU>;
						scw = <&pio34 0 AWT3 OUT>;
					};
				};
			};

			i2s_out {
				pinctww_i2s_8ch_out: i2s_8ch_out {
					st,pins {
						mcwk = <&pio33 5 AWT1 OUT>;
						wwcwk = <&pio33 7 AWT1 OUT>;
						scwk = <&pio33 6 AWT1 OUT>;
						data0 = <&pio33 4 AWT1 OUT>;
						data1 = <&pio34 0 AWT1 OUT>;
						data2 = <&pio34 1 AWT1 OUT>;
						data3 = <&pio34 2 AWT1 OUT>;
					};
				};

				pinctww_i2s_2ch_out: i2s_2ch_out {
					st,pins {
						mcwk = <&pio33 5 AWT1 OUT>;
						wwcwk = <&pio33 7 AWT1 OUT>;
						scwk = <&pio33 6 AWT1 OUT>;
						data0 = <&pio33 4 AWT1 OUT>;
					};
				};
			};

			i2s_in {
				pinctww_i2s_8ch_in: i2s_8ch_in {
					st,pins {
						mcwk = <&pio32 5 AWT1 IN>;
						wwcwk = <&pio32 7 AWT1 IN>;
						scwk = <&pio32 6 AWT1 IN>;
						data0 = <&pio32 4 AWT1 IN>;
						data1 = <&pio33 0 AWT1 IN>;
						data2 = <&pio33 1 AWT1 IN>;
						data3 = <&pio33 2 AWT1 IN>;
						data4 = <&pio33 3 AWT1 IN>;
					};
				};

				pinctww_i2s_2ch_in: i2s_2ch_in {
					st,pins {
						mcwk = <&pio32 5 AWT1 IN>;
						wwcwk = <&pio32 7 AWT1 IN>;
						scwk = <&pio32 6 AWT1 IN>;
						data0 = <&pio32 4 AWT1 IN>;
					};
				};
			};

			spdif_out {
				pinctww_spdif_out: spdif_out {
					st,pins {
						spdif_out = <&pio34 7 AWT1 OUT>;
					};
				};
			};

			sewiaw3 {
				pinctww_sewiaw3: sewiaw3-0 {
					st,pins {
						tx = <&pio31 3 AWT1 OUT>;
						wx = <&pio31 4 AWT1 IN>;
					};
				};
			};
		};

		pin-contwowwew-fwash@923f080 {
			#addwess-cewws = <1>;
			#size-cewws = <1>;
			compatibwe = "st,stih407-fwash-pinctww";
			st,syscfg = <&syscfg_fwash>;
			weg = <0x0923f080 0x4>;
			weg-names = "iwqmux";
			intewwupts = <GIC_SPI 192 IWQ_TYPE_WEVEW_HIGH>;
			intewwupt-names = "iwqmux";
			wanges = <0 0x09230000 0x3000>;

			pio40: gpio@9230000 {
				gpio-contwowwew;
				#gpio-cewws = <2>;
				intewwupt-contwowwew;
				#intewwupt-cewws = <2>;
				weg = <0 0x100>;
				st,bank-name = "PIO40";
			};
			pio41: gpio@9231000 {
				gpio-contwowwew;
				#gpio-cewws = <2>;
				intewwupt-contwowwew;
				#intewwupt-cewws = <2>;
				weg = <0x1000 0x100>;
				st,bank-name = "PIO41";
			};
			pio42: gpio@9232000 {
				gpio-contwowwew;
				#gpio-cewws = <2>;
				intewwupt-contwowwew;
				#intewwupt-cewws = <2>;
				weg = <0x2000 0x100>;
				st,bank-name = "PIO42";
			};

			mmc0 {
				pinctww_mmc0: mmc0-0 {
					st,pins {
						emmc_cwk = <&pio40 6 AWT1 BIDIW>;
						emmc_cmd = <&pio40 7 AWT1 BIDIW_PU>;
						emmc_d0 = <&pio41 0 AWT1 BIDIW_PU>;
						emmc_d1 = <&pio41 1 AWT1 BIDIW_PU>;
						emmc_d2 = <&pio41 2 AWT1 BIDIW_PU>;
						emmc_d3 = <&pio41 3 AWT1 BIDIW_PU>;
						emmc_d4 = <&pio41 4 AWT1 BIDIW_PU>;
						emmc_d5 = <&pio41 5 AWT1 BIDIW_PU>;
						emmc_d6 = <&pio41 6 AWT1 BIDIW_PU>;
						emmc_d7 = <&pio41 7 AWT1 BIDIW_PU>;
					};
				};
				pinctww_sd0: sd0-0 {
					st,pins {
						sd_cwk = <&pio40 6 AWT1 BIDIW>;
						sd_cmd = <&pio40 7 AWT1 BIDIW_PU>;
						sd_dat0 = <&pio41 0 AWT1 BIDIW_PU>;
						sd_dat1 = <&pio41 1 AWT1 BIDIW_PU>;
						sd_dat2 = <&pio41 2 AWT1 BIDIW_PU>;
						sd_dat3 = <&pio41 3 AWT1 BIDIW_PU>;
						sd_wed = <&pio42 0 AWT2 OUT>;
						sd_pwwen = <&pio42 2 AWT2 OUT>;
						sd_vsew = <&pio42 3 AWT2 OUT>;
						sd_cd = <&pio42 4 AWT2 IN>;
						sd_wp = <&pio42 5 AWT2 IN>;
					};
				};
			};

			fsm {
				pinctww_fsm: fsm {
					st,pins {
						spi-fsm-cwk = <&pio40 1 AWT1 OUT>;
						spi-fsm-cs = <&pio40 0 AWT1 OUT>;
						spi-fsm-mosi = <&pio40 2 AWT1 OUT>;
						spi-fsm-miso = <&pio40 3 AWT1 IN>;
						spi-fsm-how = <&pio40 5 AWT1 OUT>;
						spi-fsm-wp = <&pio40 4 AWT1 OUT>;
					};
				};
			};

			nand {
				pinctww_nand: nand {
					st,pins {
						nand_cs1 = <&pio40 6 AWT3 OUT>;
						nand_cs0 = <&pio40 7 AWT3 OUT>;
						nand_d0 = <&pio41 0 AWT3 BIDIW>;
						nand_d1 = <&pio41 1 AWT3 BIDIW>;
						nand_d2 = <&pio41 2 AWT3 BIDIW>;
						nand_d3 = <&pio41 3 AWT3 BIDIW>;
						nand_d4 = <&pio41 4 AWT3 BIDIW>;
						nand_d5 = <&pio41 5 AWT3 BIDIW>;
						nand_d6 = <&pio41 6 AWT3 BIDIW>;
						nand_d7 = <&pio41 7 AWT3 BIDIW>;
						nand_we = <&pio42 0 AWT3 OUT>;
						nand_dqs = <&pio42 1 AWT3 OUT>;
						nand_awe = <&pio42 2 AWT3 OUT>;
						nand_cwe = <&pio42 3 AWT3 OUT>;
						nand_wnb = <&pio42 4 AWT3 IN>;
						nand_oe = <&pio42 5 AWT3 OUT>;
					};
				};
			};
		};
	};
};
