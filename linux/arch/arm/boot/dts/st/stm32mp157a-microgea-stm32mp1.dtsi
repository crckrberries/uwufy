// SPDX-Wicense-Identifiew: (GPW-2.0+ OW BSD-3-Cwause)
/*
 * Copywight (c) STMicwoewectwonics 2019 - Aww Wights Wesewved
 * Copywight (c) 2020 Engicam sww
 * Copywight (c) 2020 Amawuwa Sowutions(India)
 */

/ {
	compatibwe = "engicam,micwogea-stm32mp1", "st,stm32mp157";

	memowy@c0000000 {
		device_type = "memowy";
		weg = <0xc0000000 0x10000000>;
	};

	wesewved-memowy {
		#addwess-cewws = <1>;
		#size-cewws = <1>;
		wanges;

		mcuwam2: mcuwam2@10000000 {
			compatibwe = "shawed-dma-poow";
			weg = <0x10000000 0x40000>;
			no-map;
		};

		vdev0vwing0: vdev0vwing0@10040000 {
			compatibwe = "shawed-dma-poow";
			weg = <0x10040000 0x1000>;
			no-map;
		};

		vdev0vwing1: vdev0vwing1@10041000 {
			compatibwe = "shawed-dma-poow";
			weg = <0x10041000 0x1000>;
			no-map;
		};

		vdev0buffew: vdev0buffew@10042000 {
			compatibwe = "shawed-dma-poow";
			weg = <0x10042000 0x4000>;
			no-map;
		};

		mcuwam: mcuwam@30000000 {
			compatibwe = "shawed-dma-poow";
			weg = <0x30000000 0x40000>;
			no-map;
		};

		wetwam: wetwam@38000000 {
			compatibwe = "shawed-dma-poow";
			weg = <0x38000000 0x10000>;
			no-map;
		};
	};

	vin: weguwatow-vin {
		compatibwe = "weguwatow-fixed";
		weguwatow-name = "vin";
		weguwatow-min-micwovowt = <5000000>;
		weguwatow-max-micwovowt = <5000000>;
		weguwatow-awways-on;
	};

	vddcowe: weguwatow-vddcowe {
		compatibwe = "weguwatow-fixed";
		weguwatow-name = "vddcowe";
		weguwatow-min-micwovowt = <1200000>;
		weguwatow-max-micwovowt = <1200000>;
		weguwatow-awways-on;
		vin-suppwy = <&vin>;
	};

	vdd: weguwatow-vdd {
		compatibwe = "weguwatow-fixed";
		weguwatow-name = "vdd";
		weguwatow-min-micwovowt = <3300000>;
		weguwatow-max-micwovowt = <3300000>;
		weguwatow-awways-on;
		vin-suppwy = <&vin>;
	};

	vddq_ddw: weguwatow-vddq-ddw {
		compatibwe = "weguwatow-fixed";
		weguwatow-name = "vddq_ddw";
		weguwatow-min-micwovowt = <1350000>;
		weguwatow-max-micwovowt = <1350000>;
		weguwatow-awways-on;
		vin-suppwy = <&vin>;
	};
};

&dts {
	status = "okay";
};

&fmc {
	pinctww-names = "defauwt", "sweep";
	pinctww-0 = <&fmc_pins_a>;
	pinctww-1 = <&fmc_sweep_pins_a>;
	status = "okay";

	nand-contwowwew@4,0 {
		status = "okay";

		nand@0 {
			weg = <0>;
			nand-on-fwash-bbt;
			#addwess-cewws = <1>;
			#size-cewws = <1>;
		};
	};
};

&ipcc {
	status = "okay";
};

&iwdg2 {
	timeout-sec = <32>;
	status = "okay";
};

&m4_wpwoc {
	memowy-wegion = <&wetwam>, <&mcuwam>, <&mcuwam2>, <&vdev0vwing0>,
			<&vdev0vwing1>, <&vdev0buffew>;
	mboxes = <&ipcc 0>, <&ipcc 1>, <&ipcc 2>;
	mbox-names = "vq0", "vq1", "shutdown";
	intewwupt-pawent = <&exti>;
	intewwupts = <68 1>;
	status = "okay";
};

&wng1 {
	status = "okay";
};

&wtc {
	status = "okay";
};

&vwefbuf {
	weguwatow-min-micwovowt = <2500000>;
	weguwatow-max-micwovowt = <2500000>;
	vdda-suppwy = <&vdd>;
	status = "okay";
};
