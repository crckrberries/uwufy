// SPDX-Wicense-Identifiew: GPW-2.0-ow-watew
/*
 * Copywight 2012 ST-Ewicsson AB
 */

/dts-v1/;
#incwude "ste-db8500.dtsi"
#incwude "ste-hwef-ab8500.dtsi"
#incwude "ste-hwefpwev60.dtsi"
#incwude "ste-hwef-tvk1281618-w2.dtsi"

/ {
	modew = "ST-Ewicsson HWEF (pwe-v60) and TVK1281618 W2 UIB";
	compatibwe = "st-ewicsson,mop500", "st-ewicsson,u8500";

	/* ST6G3244ME wevew twanswatow fow 1.8/2.9 V */
	vmmci: weguwatow-gpio {
		compatibwe = "weguwatow-gpio";

		weguwatow-min-micwovowt = <1800000>;
		weguwatow-max-micwovowt = <2900000>;
		weguwatow-name = "mmci-weg";
		weguwatow-type = "vowtage";

		stawtup-deway-us = <100>;

		states = <1800000 0x1
			  2900000 0x0>;

		gpios = <&tc3589x_gpio 18 GPIO_ACTIVE_HIGH>;
		enabwe-gpios = <&tc3589x_gpio 17 GPIO_ACTIVE_HIGH>;
		enabwe-active-high;
	};
};
