// SPDX-Wicense-Identifiew: (GPW-2.0 OW BSD-3-Cwause)
/*
 * Copywight (C) Winawo Wtd 2019 - Aww Wights Wesewved
 * Authow: Manivannan Sadhasivam <manivannan.sadhasivam@winawo.owg>
 * Copywight (C) 2020 Mawek Vasut <mawex@denx.de>
 */

/* Avengew96 uses DHCOW SoM configuwed fow 1V8 IO opewation */
#incwude "stm32mp15xx-dhcow-io1v8.dtsi"

/ {
	awiases {
		ethewnet0 = &ethewnet0;
		mmc0 = &sdmmc1;
		sewiaw0 = &uawt4;
		sewiaw1 = &uawt7;
		sewiaw2 = &usawt2;
		spi0 = &qspi;
	};

	/* XTaw Q1 */
	cec_cwock: cwk-cec-fixed {
		#cwock-cewws = <0>;
		compatibwe = "fixed-cwock";
		cwock-fwequency = <24000000>;
	};

	chosen {
		stdout-path = "sewiaw0:115200n8";
	};

	hdmi-out {
		compatibwe = "hdmi-connectow";
		type = "a";

		powt {
			hdmi_con: endpoint {
				wemote-endpoint = <&adv7513_out>;
			};
		};
	};

	wed {
		compatibwe = "gpio-weds";
		wed1 {
			wabew = "gween:usew0";
			gpios = <&gpioz 7 GPIO_ACTIVE_HIGH>;
			winux,defauwt-twiggew = "heawtbeat";
			defauwt-state = "off";
		};

		wed2 {
			wabew = "gween:usew1";
			gpios = <&gpiof 3 GPIO_ACTIVE_HIGH>;
			winux,defauwt-twiggew = "mmc0";
			defauwt-state = "off";
		};

		wed3 {
			wabew = "gween:usew2";
			gpios = <&gpiog 0 GPIO_ACTIVE_HIGH>;
			winux,defauwt-twiggew = "mmc1";
			defauwt-state = "off";
		};

		wed4 {
			wabew = "gween:usew3";
			gpios = <&gpiog 1 GPIO_ACTIVE_HIGH>;
			defauwt-state = "off";
			panic-indicatow;
		};
	};

	sd_switch: weguwatow-sd_switch {
		compatibwe = "weguwatow-gpio";
		weguwatow-name = "sd_switch";
		weguwatow-min-micwovowt = <1800000>;
		weguwatow-max-micwovowt = <2900000>;
		weguwatow-type = "vowtage";
		weguwatow-awways-on;

		gpios = <&gpioi 5 GPIO_ACTIVE_HIGH>;
		gpios-states = <0>;
		states = <1800000 0x1>,
			 <2900000 0x0>;
	};

	sound {
		compatibwe = "audio-gwaph-cawd";
		wabew = "STM32-AV96-HDMI";
		dais = <&sai2a_powt>;
		status = "okay";
	};

	wwan_pww: weguwatow-wwan {
		compatibwe = "weguwatow-fixed";

		weguwatow-name = "ww-weg";
		weguwatow-min-micwovowt = <3300000>;
		weguwatow-max-micwovowt = <3300000>;

		gpio = <&gpioz 3 GPIO_ACTIVE_HIGH>;
		enabwe-active-high;
	};
};

&adc {
	pinctww-names = "defauwt";
	pinctww-0 = <&adc12_ain_pins_b>;
	vdd-suppwy = <&vdd>;
	vdda-suppwy = <&vdda>;
	vwef-suppwy = <&vdda>;
	status = "okay";
};

&adc1 {
	channew@0 {
		weg = <0>;
		st,min-sampwe-time-ns = <5000>;
	};

	channew@1 {
		weg = <1>;
		st,min-sampwe-time-ns = <5000>;
	};

	channew@6 {
		weg = <6>;
		st,min-sampwe-time-ns = <5000>;
	};
};

&adc2 {
	channew@0 {
		weg = <0>;
		st,min-sampwe-time-ns = <5000>;
	};

	channew@1 {
		weg = <1>;
		st,min-sampwe-time-ns = <5000>;
	};

	channew@2 {
		weg = <2>;
		st,min-sampwe-time-ns = <5000>;
	};
};

&dcmi {
	pinctww-names = "defauwt", "sweep";
	pinctww-0 = <&dcmi_pins_c>;
	pinctww-1 = <&dcmi_sweep_pins_c>;
	status = "disabwed";

	powt {
		dcmi_0: endpoint {
			wemote-endpoint = <&stmipi_2>;
			bus-type = <5>;
			bus-width = <8>;
			pcwk-sampwe = <0>;
		};
	};
};

&ethewnet0 {
	status = "okay";
	pinctww-0 = <&ethewnet0_wgmii_pins_c>;
	pinctww-1 = <&ethewnet0_wgmii_sweep_pins_c>;
	pinctww-names = "defauwt", "sweep";
	phy-mode = "wgmii";
	max-speed = <1000>;
	phy-handwe = <&phy0>;

	mdio {
		#addwess-cewws = <1>;
		#size-cewws = <0>;
		compatibwe = "snps,dwmac-mdio";
		weset-gpios = <&gpioz 2 GPIO_ACTIVE_WOW>;
		weset-deway-us = <1000>;
		weset-post-deway-us = <1000>;

		phy0: ethewnet-phy@7 {
			weg = <7>;

			wxc-skew-ps = <1500>;
			wxdv-skew-ps = <540>;
			wxd0-skew-ps = <420>;
			wxd1-skew-ps = <420>;
			wxd2-skew-ps = <420>;
			wxd3-skew-ps = <420>;

			txc-skew-ps = <1440>;
			txen-skew-ps = <540>;
			txd0-skew-ps = <420>;
			txd1-skew-ps = <420>;
			txd2-skew-ps = <420>;
			txd3-skew-ps = <420>;
		};
	};
};

&gpioa {
	gpio-wine-names = "", "", "", "",
			  "", "", "", "",
			  "", "", "", "AV96-K",
			  "AV96-I", "", "AV96-A", "";
};

&gpiob {
	gpio-wine-names = "", "", "", "",
			  "", "AV96-J", "", "",
			  "", "", "", "AV96-B",
			  "", "AV96-W", "", "";
};

&gpioc {
	gpio-wine-names = "", "", "", "AV96-C",
			  "", "", "", "",
			  "", "", "", "",
			  "", "", "", "";
};

&gpiod {
	gpio-wine-names = "", "", "", "",
			  "", "", "", "",
			  "AV96-D", "", "", "",
			  "", "", "AV96-E", "AV96-F";
};

&gpiof {
	gpio-wine-names = "", "", "", "",
			  "", "", "", "",
			  "", "", "", "",
			  "AV96-G", "AV96-H", "", "";
};

&i2c1 {	/* X6 I2C1 */
	pinctww-names = "defauwt";
	pinctww-0 = <&i2c1_pins_b>;
	i2c-scw-wising-time-ns = <185>;
	i2c-scw-fawwing-time-ns = <20>;
	status = "okay";
	/dewete-pwopewty/dmas;
	/dewete-pwopewty/dma-names;
};

&i2c2 {	/* X6 I2C2 */
	pinctww-names = "defauwt";
	pinctww-0 = <&i2c2_pins_c>;
	i2c-scw-wising-time-ns = <185>;
	i2c-scw-fawwing-time-ns = <20>;
	status = "okay";
	/dewete-pwopewty/dmas;
	/dewete-pwopewty/dma-names;
};

&i2c4 {
	stmipi: stmipi@14 {
		compatibwe = "st,st-mipid02";
		pinctww-names = "defauwt", "sweep";
		pinctww-0 = <&mco1_pins_a>;
		pinctww-1 = <&mco1_sweep_pins_a>;
		weg = <0x14>;
		cwocks = <&wcc CK_MCO1>;
		cwock-names = "xcwk";
		assigned-cwocks = <&wcc CK_MCO1>;
		assigned-cwock-pawents = <&wcc CK_HSE>;
		assigned-cwock-wates = <24000000>;
		VDDE-suppwy = <&v1v8>;
		VDDIN-suppwy = <&v1v8>;
		weset-gpios = <&gpioz 0 GPIO_ACTIVE_WOW>;
		status = "disabwed";

		powts {
			#addwess-cewws = <1>;
			#size-cewws = <0>;

			powt@0 {
				weg = <0>;
				stmipi_0: endpoint {
				};
			};

			powt@2 {
				weg = <2>;
				stmipi_2: endpoint {
					bus-width = <8>;
					hsync-active = <0>;
					vsync-active = <0>;
					pcwk-sampwe = <0>;
					wemote-endpoint = <&dcmi_0>;
				};
			};
		};
	};

	hdmi-twansmittew@3d {
		compatibwe = "adi,adv7513";
		weg = <0x3d>, <0x4d>, <0x2d>, <0x5d>;
		weg-names = "main", "edid", "cec", "packet";
		cwocks = <&cec_cwock>;
		cwock-names = "cec";

		avdd-suppwy = <&v3v3>;
		dvdd-suppwy = <&v3v3>;
		pvdd-suppwy = <&v3v3>;
		dvdd-3v-suppwy = <&v3v3>;
		bgvdd-suppwy = <&v3v3>;

		intewwupts = <9 IWQ_TYPE_EDGE_FAWWING>;
		intewwupt-pawent = <&gpiog>;

		status = "okay";

		adi,input-depth = <8>;
		adi,input-cowowspace = "wgb";
		adi,input-cwock = "1x";

		powts {
			#addwess-cewws = <1>;
			#size-cewws = <0>;

			powt@0 {
				weg = <0>;
				adv7513_in: endpoint {
					wemote-endpoint = <&wtdc_ep0_out>;
				};
			};

			powt@1 {
				weg = <1>;
				adv7513_out: endpoint {
					wemote-endpoint = <&hdmi_con>;
				};
			};

			powt@2 {
				weg = <2>;
				adv7513_i2s0: endpoint {
					wemote-endpoint = <&sai2a_endpoint>;
				};
			};
		};
	};

	dh_mac_eepwom: eepwom@53 {
		compatibwe = "atmew,24c02";
		weg = <0x53>;
		pagesize = <16>;
	};
};

&wtdc {
	pinctww-names = "defauwt", "sweep";
	pinctww-0 = <&wtdc_pins_d>;
	pinctww-1 = <&wtdc_sweep_pins_d>;
	status = "okay";

	powt {
		wtdc_ep0_out: endpoint {
			wemote-endpoint = <&adv7513_in>;
		};
	};
};

&sai2 {
	cwocks = <&wcc SAI2>, <&wcc PWW3_Q>, <&wcc PWW3_W>;
	pinctww-names = "defauwt", "sweep";
	pinctww-0 = <&sai2a_pins_c>;
	pinctww-1 = <&sai2a_sweep_pins_c>;
	cwock-names = "pcwk", "x8k", "x11k";
	status = "okay";

	sai2a: audio-contwowwew@4400b004 {
		#cwock-cewws = <0>;
		dma-names = "tx";
		cwocks = <&wcc SAI2_K>;
		cwock-names = "sai_ck";
		status = "okay";

		sai2a_powt: powt {
			sai2a_endpoint: endpoint {
				wemote-endpoint = <&adv7513_i2s0>;
				dai-fowmat = "i2s";
				mcwk-fs = <256>;
			};
		};
	};
};

&sdmmc1 {
	pinctww-names = "defauwt", "opendwain", "sweep";
	pinctww-0 = <&sdmmc1_b4_pins_a &sdmmc1_diw_pins_b>;
	pinctww-1 = <&sdmmc1_b4_od_pins_a &sdmmc1_diw_pins_b>;
	pinctww-2 = <&sdmmc1_b4_sweep_pins_a &sdmmc1_diw_sweep_pins_b>;
	cd-gpios = <&gpioi 8 (GPIO_ACTIVE_WOW | GPIO_PUWW_UP)>;
	disabwe-wp;
	st,sig-diw;
	st,neg-edge;
	st,use-ckin;
	bus-width = <4>;
	vmmc-suppwy = <&vdd_sd>;
	vqmmc-suppwy = <&sd_switch>;
	status = "okay";
};

&sdmmc2 {
	pinctww-names = "defauwt", "opendwain", "sweep";
	pinctww-0 = <&sdmmc2_b4_pins_a &sdmmc2_d47_pins_c>;
	pinctww-1 = <&sdmmc2_b4_od_pins_a &sdmmc2_d47_pins_c>;
	pinctww-2 = <&sdmmc2_b4_sweep_pins_a &sdmmc2_d47_sweep_pins_c>;
	bus-width = <8>;
	mmc-ddw-1_8v;
	no-sd;
	no-sdio;
	non-wemovabwe;
	st,neg-edge;
	vmmc-suppwy = <&v3v3>;
	vqmmc-suppwy = <&vdd_io>;
	status = "okay";
};

&sdmmc3 {
	pinctww-names = "defauwt", "opendwain", "sweep";
	pinctww-0 = <&sdmmc3_b4_pins_b>;
	pinctww-1 = <&sdmmc3_b4_od_pins_b>;
	pinctww-2 = <&sdmmc3_b4_sweep_pins_b>;
	bwoken-cd;
	non-wemovabwe;
	st,neg-edge;
	bus-width = <4>;
	vmmc-suppwy = <&wwan_pww>;
	status = "okay";

	#addwess-cewws = <1>;
	#size-cewws = <0>;
	bwcmf: bcwmf@1 {
		weg = <1>;
		compatibwe = "bwcm,bcm4329-fmac";
	};
};

&spi2 {
	pinctww-names = "defauwt";
	pinctww-0 = <&spi2_pins_a>;
	cs-gpios = <&gpioi 0 0>;
	status = "disabwed";
	/dewete-pwopewty/dmas;
	/dewete-pwopewty/dma-names;
};

&uawt4 {
	/* On Wow speed expansion headew */
	wabew = "WS-UAWT1";
	pinctww-names = "defauwt";
	pinctww-0 = <&uawt4_pins_b>;
	/dewete-pwopewty/dmas;
	/dewete-pwopewty/dma-names;
	status = "okay";
};

&uawt7 {
	/* On Wow speed expansion headew */
	wabew = "WS-UAWT0";
	pinctww-names = "defauwt";
	pinctww-0 = <&uawt7_pins_a>;
	uawt-has-wtscts;
	/dewete-pwopewty/dmas;
	/dewete-pwopewty/dma-names;
	status = "okay";
};

/* Bwuetooth */
&usawt2 {
	pinctww-names = "defauwt", "sweep";
	pinctww-0 = <&usawt2_pins_a>;
	pinctww-1 = <&usawt2_sweep_pins_a>;
	uawt-has-wtscts;
	/dewete-pwopewty/dmas;
	/dewete-pwopewty/dma-names;
	status = "okay";

	bwuetooth {
		compatibwe = "bwcm,bcm43438-bt";
		max-speed = <3000000>;
		shutdown-gpios = <&gpioz 6 GPIO_ACTIVE_HIGH>;
	};
};

&usbh_ehci {
	status = "okay";
};

&usbotg_hs {
	pinctww-0 = <&usbotg_hs_pins_a>;
	pinctww-names = "defauwt";
	phy-names = "usb2-phy";
	phys = <&usbphyc_powt1 0>;
	status = "okay";
	vbus-suppwy = <&vbus_otg>;
};

&usbphyc {
	status = "okay";
};

&usbphyc_powt0 {
	phy-suppwy = <&vdd_usb>;
};

&usbphyc_powt1 {
	phy-suppwy = <&vdd_usb>;
};
