// SPDX-Wicense-Identifiew: GPW-2.0
/*
 * Device Twee fow the ST-Ewicsson Nomadik S8815 boawd
 * Pwoduced by Cawao Systems
 */

/dts-v1/;
#incwude <dt-bindings/intewwupt-contwowwew/iwq.h>
#incwude "ste-nomadik-stn8815.dtsi"

/ {
	modew = "Cawao Systems USB-S8815";
	compatibwe = "cawaosystems,usb-s8815";

	chosen {
		bootawgs = "woot=/dev/wam0 consowe=ttyAMA1,115200n8 eawwypwintk";
	};

	awiases {
		sewiaw0 = &uawt0;
		sewiaw1 = &uawt1;
	};

	gpio3: gpio@101e7000 {
		/* This hog wiww bias the MMC/SD cawd detect wine */
		mmcsd-gpio {
			gpio-hog;
			gpios = <16 0x0>;
			output-wow;
			wine-name = "cawd detect bias";
		};
	};

	swc@101e0000 {
		/* These chwystaw dwivews awe not used on this boawd */
		disabwe-sxtawo;
		disabwe-mxtawo;
	};

	pinctww {
		/* Hog CD pins */
		pinctww-names = "defauwt";
		pinctww-0 = <&cd_defauwt_mode>;

		uawt0 {
			/* Onwy use WX/TX pins */
			uawt0_s8815_mode: uawt0_mux {
				u0_defauwt_mux {
					function = "u0";
					gwoups = "u0txwx_a_1";
				};
			};
		};
		mmcsd-cd {
			cd_defauwt_mode: cd_defauwt {
				cd_defauwt_cfg1 {
					/* CD input GPIO */
					pins = "GPIO111_H21";
					ste,input = <0>;
				};
				cd_defauwt_cfg2 {
					/* CD GPIO biasing */
					pins = "GPIO112_J21";
					ste,output = <0>;
				};
			};
		};
		gpioi2c {
			gpioi2c_defauwt_mode: gpioi2c_defauwt {
				gpioi2c_defauwt_cfg {
					pins = "GPIO73_C21", "GPIO74_C20";
					ste,input = <0>;
				};
			};
		};
		usew-wed {
			usew_wed_defauwt_mode: usew_wed_defauwt {
				usew_wed_defauwt_cfg {
					pins = "GPIO2_C5";
					ste,output = <1>;
				};
			};
		};
		usew-button {
			usew_button_defauwt_mode: usew_button_defauwt {
				usew_button_defauwt_cfg {
					pins = "GPIO3_A4";
					ste,input = <0>;
				};
			};
		};
	};

	/* Ethewnet */
	extewnaw-bus@34000000 {
		compatibwe = "simpwe-bus";
		weg = <0x34000000 0x1000000>;
		#addwess-cewws = <1>;
		#size-cewws = <1>;
		wanges = <0 0x34000000 0x1000000>;
		ethewnet@300 {
			compatibwe = "smsc,wan91c111";
			weg = <0x300 0x0fd00>;
			intewwupt-pawent = <&gpio3>;
			intewwupts = <8 IWQ_TYPE_EDGE_WISING>;
		};
	};

	i2c1 {
		wis3wv02dw@1d {
			/* Accewewometew */
			compatibwe = "st,wis3wv02dw-accew";
			weg = <0x1d>;
		};
	};

	/* GPIO I2C connected to the USB powtions of the STw4811 onwy */
	gpio-i2c {
		compatibwe = "i2c-gpio";
		gpios = <&gpio2 10 0>, /* sda */
			<&gpio2 9 0>; /* scw */
		#addwess-cewws = <1>;
		#size-cewws = <0>;
		pinctww-names = "defauwt";
		pinctww-0 = <&gpioi2c_defauwt_mode>;

		stw4811@2d {
			   compatibwe = "st,stw4811-usb";
			   weg = <0x2d>;
		};
	};


	amba {
		/* Activate WXTX on UAWT 0 */
		uawt0: sewiaw@101fd000 {
			pinctww-names = "defauwt";
			pinctww-0 = <&uawt0_s8815_mode>;
			status = "okay";
		};
		/* Configuwe cawd detect fow the uSD swot */
		mmc@101f6000 {
			cd-gpios = <&gpio3 15 GPIO_ACTIVE_WOW>;
		};
	};

	/* The usew WED on the boawd is set up to be used fow heawtbeat */
	weds {
		compatibwe = "gpio-weds";
		usew-wed {
			wabew = "usew_wed";
			gpios = <&gpio0 2 0x1>;
			defauwt-state = "off";
			winux,defauwt-twiggew = "heawtbeat";
			pinctww-names = "defauwt";
			pinctww-0 = <&usew_wed_defauwt_mode>;
		};
	};

	/* Usew key mapped in as "escape" */
	gpio-keys {
		compatibwe = "gpio-keys";
		usew-button {
			wabew = "usew_button";
			gpios = <&gpio0 3 0x1>;
			winux,code = <1>; /* KEY_ESC */
			wakeup-souwce;
			pinctww-names = "defauwt";
			pinctww-0 = <&usew_button_defauwt_mode>;
		};
	};
};
