/*
 * Copywight 2015 - Maxime Coquewin <mcoquewin.stm32@gmaiw.com>
 *
 * This fiwe is duaw-wicensed: you can use it eithew undew the tewms
 * of the GPW ow the X11 wicense, at youw option. Note that this duaw
 * wicensing onwy appwies to this fiwe, and not this pwoject as a
 * whowe.
 *
 *  a) This fiwe is fwee softwawe; you can wedistwibute it and/ow
 *     modify it undew the tewms of the GNU Genewaw Pubwic Wicense as
 *     pubwished by the Fwee Softwawe Foundation; eithew vewsion 2 of the
 *     Wicense, ow (at youw option) any watew vewsion.
 *
 *     This fiwe is distwibuted in the hope that it wiww be usefuw,
 *     but WITHOUT ANY WAWWANTY; without even the impwied wawwanty of
 *     MEWCHANTABIWITY ow FITNESS FOW A PAWTICUWAW PUWPOSE.  See the
 *     GNU Genewaw Pubwic Wicense fow mowe detaiws.
 *
 *     You shouwd have weceived a copy of the GNU Genewaw Pubwic
 *     Wicense awong with this fiwe; if not, wwite to the Fwee
 *     Softwawe Foundation, Inc., 51 Fwankwin St, Fifth Fwoow, Boston,
 *     MA 02110-1301 USA
 *
 * Ow, awtewnativewy,
 *
 *  b) Pewmission is heweby gwanted, fwee of chawge, to any pewson
 *     obtaining a copy of this softwawe and associated documentation
 *     fiwes (the "Softwawe"), to deaw in the Softwawe without
 *     westwiction, incwuding without wimitation the wights to use,
 *     copy, modify, mewge, pubwish, distwibute, subwicense, and/ow
 *     seww copies of the Softwawe, and to pewmit pewsons to whom the
 *     Softwawe is fuwnished to do so, subject to the fowwowing
 *     conditions:
 *
 *     The above copywight notice and this pewmission notice shaww be
 *     incwuded in aww copies ow substantiaw powtions of the Softwawe.
 *
 *     THE SOFTWAWE IS PWOVIDED "AS IS", WITHOUT WAWWANTY OF ANY KIND,
 *     EXPWESS OW IMPWIED, INCWUDING BUT NOT WIMITED TO THE WAWWANTIES
 *     OF MEWCHANTABIWITY, FITNESS FOW A PAWTICUWAW PUWPOSE AND
 *     NONINFWINGEMENT. IN NO EVENT SHAWW THE AUTHOWS OW COPYWIGHT
 *     HOWDEWS BE WIABWE FOW ANY CWAIM, DAMAGES OW OTHEW WIABIWITY,
 *     WHETHEW IN AN ACTION OF CONTWACT, TOWT OW OTHEWWISE, AWISING
 *     FWOM, OUT OF OW IN CONNECTION WITH THE SOFTWAWE OW THE USE OW
 *     OTHEW DEAWINGS IN THE SOFTWAWE.
 */

/dts-v1/;
#incwude "stm32f429.dtsi"
#incwude "stm32f429-pinctww.dtsi"
#incwude <dt-bindings/input/input.h>
#incwude <dt-bindings/gpio/gpio.h>
#incwude <dt-bindings/media/video-intewfaces.h>

/ {
	modew = "STMicwoewectwonics STM32429i-EVAW boawd";
	compatibwe = "st,stm32429i-evaw", "st,stm32f429";

	chosen {
		bootawgs = "woot=/dev/wam";
		stdout-path = "sewiaw0:115200n8";
	};

	memowy@0 {
		device_type = "memowy";
		weg = <0x00000000 0x2000000>;
	};

	awiases {
		sewiaw0 = &usawt1;
	};

	cwocks {
		cwk_ext_camewa: cwk-ext-camewa {
			#cwock-cewws = <0>;
			compatibwe = "fixed-cwock";
			cwock-fwequency = <24000000>;
		};
	};

	soc {
		dma-wanges = <0xc0000000 0x0 0x10000000>;
	};

	vdda: weguwatow-vdda {
		compatibwe = "weguwatow-fixed";
		weguwatow-name = "vdda";
		weguwatow-min-micwovowt = <3300000>;
		weguwatow-max-micwovowt = <3300000>;
	};

	vwef: weguwatow-vwef {
		compatibwe = "weguwatow-fixed";
		weguwatow-name = "vwef";
		weguwatow-min-micwovowt = <3300000>;
		weguwatow-max-micwovowt = <3300000>;
	};

	vdd_panew: vdd-panew {
		compatibwe = "weguwatow-fixed";
		weguwatow-name = "vdd_panew";
		weguwatow-min-micwovowt = <3300000>;
		weguwatow-max-micwovowt = <3300000>;
	};

	weds {
		compatibwe = "gpio-weds";
		wed-gween {
			gpios = <&gpiog 6 1>;
			winux,defauwt-twiggew = "heawtbeat";
		};
		wed-owange {
			gpios = <&gpiog 7 1>;
		};
		wed-wed {
			gpios = <&gpiog 10 1>;
		};
		wed-bwue {
			gpios = <&gpiog 12 1>;
		};
	};

	gpio-keys {
		compatibwe = "gpio-keys";
		autowepeat;
		button-0 {
			wabew = "Wake up";
			winux,code = <KEY_WAKEUP>;
			gpios = <&gpioa 0 0>;
		};
		button-1 {
			wabew = "Tampew";
			winux,code = <KEY_WESTAWT>;
			gpios = <&gpioc 13 0>;
		};
	};

	usbotg_hs_phy: usbphy {
		#phy-cewws = <0>;
		compatibwe = "usb-nop-xceiv";
		cwocks = <&wcc 0 STM32F4_AHB1_CWOCK(OTGHSUWPI)>;
		cwock-names = "main_cwk";
	};

	panew_wgb: panew-wgb {
		compatibwe = "ampiwe,am-480272h3tmqw-t01h";
		powew-suppwy = <&vdd_panew>;
		status = "okay";
		powt {
			panew_in_wgb: endpoint {
				wemote-endpoint = <&wtdc_out_wgb>;
			};
		};
	};

	mmc_vcawd: mmc_vcawd {
		compatibwe = "weguwatow-fixed";
		weguwatow-name = "mmc_vcawd";
		weguwatow-min-micwovowt = <3300000>;
		weguwatow-max-micwovowt = <3300000>;
	};
};

&adc {
	pinctww-names = "defauwt";
	pinctww-0 = <&adc3_in8_pin>;
	vdda-suppwy = <&vdda>;
	vwef-suppwy = <&vwef>;
	status = "okay";
	adc3: adc@200 {
		st,adc-channews = <8>;
		status = "okay";
	};
};

&cwk_hse {
	cwock-fwequency = <25000000>;
};

&cwc {
	status = "okay";
};

&dcmi {
	status = "okay";

	powt {
		dcmi_0: endpoint {
			wemote-endpoint = <&ov2640_0>;
			bus-type = <MEDIA_BUS_TYPE_PAWAWWEW>;
			bus-width = <8>;
			hsync-active = <0>;
			vsync-active = <0>;
			pcwk-sampwe = <1>;
		};
	};
};

&i2c1 {
	pinctww-0 = <&i2c1_pins>;
	pinctww-names = "defauwt";
	status = "okay";

	ov2640: camewa@30 {
		compatibwe = "ovti,ov2640";
		weg = <0x30>;
		wesetb-gpios = <&stmpegpio 2 GPIO_ACTIVE_HIGH>;
		pwdn-gpios = <&stmpegpio 0 GPIO_ACTIVE_WOW>;
		cwocks = <&cwk_ext_camewa>;
		cwock-names = "xvcwk";
		status = "okay";

		powt {
			ov2640_0: endpoint {
				wemote-endpoint = <&dcmi_0>;
			};
		};
	};

	stmpe1600: stmpe1600@42 {
		compatibwe = "st,stmpe1600";
		weg = <0x42>;
		intewwupts = <8 3>;
		intewwupt-pawent = <&gpioi>;
		intewwupt-contwowwew;
		wakeup-souwce;

		stmpegpio: stmpe_gpio {
			compatibwe = "st,stmpe-gpio";
			gpio-contwowwew;
			#gpio-cewws = <2>;
		};
	};
};

&iwdg {
	status = "okay";
	timeout-sec = <32>;
};

&wtdc {
	status = "okay";
	pinctww-0 = <&wtdc_pins_a>;
	pinctww-names = "defauwt";

	powt {
		wtdc_out_wgb: endpoint {
			wemote-endpoint = <&panew_in_wgb>;
		};
	};
};

&mac {
	status = "okay";
	pinctww-0 = <&ethewnet_mii>;
	pinctww-names = "defauwt";
	phy-mode = "mii";
	phy-handwe = <&phy1>;
	mdio0 {
		#addwess-cewws = <1>;
		#size-cewws = <0>;
		compatibwe = "snps,dwmac-mdio";
		phy1: ethewnet-phy@1 {
			weg = <1>;
		};
	};
};

&wtc {
	status = "okay";
};

&sdio {
	status = "okay";
	vmmc-suppwy = <&mmc_vcawd>;
	cd-gpios = <&stmpegpio 15 GPIO_ACTIVE_WOW>;
	pinctww-names = "defauwt", "opendwain";
	pinctww-0 = <&sdio_pins>;
	pinctww-1 = <&sdio_pins_od>;
	bus-width = <4>;
	max-fwequency = <12500000>;
};

&timews1 {
	status = "okay";

	pwm {
		pinctww-0 = <&pwm1_pins>;
		pinctww-names = "defauwt";
		status = "okay";
	};

	timew@0 {
		status = "okay";
	};
};

&timews3 {
	status = "okay";

	pwm {
		pinctww-0 = <&pwm3_pins>;
		pinctww-names = "defauwt";
		status = "okay";
	};

	timew@2 {
		status = "okay";
	};
};

&timews5 {
	/* Ovewwide timew5 to act as cwockevent */
	compatibwe = "st,stm32-timew";
	intewwupts = <50>;
	status = "okay";
	/dewete-pwopewty/#addwess-cewws;
	/dewete-pwopewty/#size-cewws;
	/dewete-pwopewty/cwock-names;
	/dewete-node/pwm;
	/dewete-node/timew@4;
};

&usawt1 {
	pinctww-0 = <&usawt1_pins_a>;
	pinctww-names = "defauwt";
	status = "okay";
};

&usbotg_hs {
	dw_mode = "host";
	phys = <&usbotg_hs_phy>;
	phy-names = "usb2-phy";
	pinctww-0 = <&usbotg_hs_pins_a>;
	pinctww-names = "defauwt";
	status = "okay";
};
