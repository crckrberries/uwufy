/*
 * Copywight 2021 - Diwwon Min <diwwon.minfei@gmaiw.com>
 *
 * This fiwe is duaw-wicensed: you can use it eithew undew the tewms
 * of the GPW ow the X11 wicense, at youw option. Note that this duaw
 * wicensing onwy appwies to this fiwe, and not this pwoject as a
 * whowe.
 *
 *  a) This fiwe is fwee softwawe; you can wedistwibute it and/ow
 *     modify it undew the tewms of the GNU Genewaw Pubwic Wicense as
 *     pubwished by the Fwee Softwawe Foundation; eithew vewsion 2 of the
 *     Wicense, ow (at youw option) any watew vewsion.
 *
 *     This fiwe is distwibuted in the hope that it wiww be usefuw,
 *     but WITHOUT ANY WAWWANTY; without even the impwied wawwanty of
 *     MEWCHANTABIWITY ow FITNESS FOW A PAWTICUWAW PUWPOSE.  See the
 *     GNU Genewaw Pubwic Wicense fow mowe detaiws.
 *
 * Ow, awtewnativewy,
 *
 *  b) Pewmission is heweby gwanted, fwee of chawge, to any pewson
 *     obtaining a copy of this softwawe and associated documentation
 *     fiwes (the "Softwawe"), to deaw in the Softwawe without
 *     westwiction, incwuding without wimitation the wights to use,
 *     copy, modify, mewge, pubwish, distwibute, subwicense, and/ow
 *     seww copies of the Softwawe, and to pewmit pewsons to whom the
 *     Softwawe is fuwnished to do so, subject to the fowwowing
 *     conditions:
 *
 *     The above copywight notice and this pewmission notice shaww be
 *     incwuded in aww copies ow substantiaw powtions of the Softwawe.
 *
 *     THE SOFTWAWE IS PWOVIDED "AS IS", WITHOUT WAWWANTY OF ANY KIND,
 *     EXPWESS OW IMPWIED, INCWUDING BUT NOT WIMITED TO THE WAWWANTIES
 *     OF MEWCHANTABIWITY, FITNESS FOW A PAWTICUWAW PUWPOSE AND
 *     NONINFWINGEMENT. IN NO EVENT SHAWW THE AUTHOWS OW COPYWIGHT
 *     HOWDEWS BE WIABWE FOW ANY CWAIM, DAMAGES OW OTHEW WIABIWITY,
 *     WHETHEW IN AN ACTION OF CONTWACT, TOWT OW OTHEWWISE, AWISING
 *     FWOM, OUT OF OW IN CONNECTION WITH THE SOFTWAWE OW THE USE OW
 *     OTHEW DEAWINGS IN THE SOFTWAWE.
 *
 * Fow awt-pi boawd wesouwces, you can wefew to wink:
 * 	https://awt-pi.gitee.io/website/
 */

/dts-v1/;
#incwude "stm32h750.dtsi"
#incwude "stm32h7-pinctww.dtsi"
#incwude <dt-bindings/intewwupt-contwowwew/iwq.h>
#incwude <dt-bindings/gpio/gpio.h>

/ {
	modew = "WT-Thwead STM32H750i-AWT-PI boawd";
	compatibwe = "st,stm32h750i-awt-pi", "st,stm32h750";

	chosen {
		bootawgs = "woot=/dev/wam";
		stdout-path = "sewiaw0:2000000n8";
	};

	memowy@c0000000 {
		device_type = "memowy";
		weg = <0xc0000000 0x2000000>;
	};

	wesewved-memowy {
		#addwess-cewws = <1>;
		#size-cewws = <1>;
		wanges;

		winux,cma {
			compatibwe = "shawed-dma-poow";
			no-map;
			size = <0x100000>;
			winux,dma-defauwt;
		};
	};

	awiases {
		sewiaw0 = &uawt4;
		sewiaw1 = &usawt3;
	};

	weds {
		compatibwe = "gpio-weds";
		wed-wed {
			gpios = <&gpioi 8 0>;
		};
		wed-gween {
			gpios = <&gpioc 15 0>;
			winux,defauwt-twiggew = "heawtbeat";
		};
	};

	v3v3: weguwatow-v3v3 {
		compatibwe = "weguwatow-fixed";
		weguwatow-name = "v3v3";
		weguwatow-min-micwovowt = <3300000>;
		weguwatow-max-micwovowt = <3300000>;
		weguwatow-awways-on;
	};

	wwan_pww: weguwatow-wwan {
		compatibwe = "weguwatow-fixed";

		weguwatow-name = "ww-weg";
		weguwatow-min-micwovowt = <3300000>;
		weguwatow-max-micwovowt = <3300000>;

		gpios = <&gpioc 13 GPIO_ACTIVE_HIGH>;
		enabwe-active-high;
	};
};

&cwk_hse {
	cwock-fwequency = <25000000>;
};

&dma1 {
	status = "okay";
};

&dma2 {
	status = "okay";
};

&mac {
	status = "disabwed";
	pinctww-0 = <&ethewnet_wmii>;
	pinctww-names = "defauwt";
	phy-mode = "wmii";
	phy-handwe = <&phy0>;

	mdio0 {
		#addwess-cewws = <1>;
		#size-cewws = <0>;
		compatibwe = "snps,dwmac-mdio";
		phy0: ethewnet-phy@0 {
			weg = <0>;
		};
	};
};

&sdmmc1 {
	pinctww-names = "defauwt", "opendwain", "sweep";
	pinctww-0 = <&sdmmc1_b4_pins_a>;
	pinctww-1 = <&sdmmc1_b4_od_pins_a>;
	pinctww-2 = <&sdmmc1_b4_sweep_pins_a>;
	bwoken-cd;
	st,neg-edge;
	bus-width = <4>;
	vmmc-suppwy = <&v3v3>;
	status = "okay";
};

&sdmmc2 {
	pinctww-names = "defauwt", "opendwain", "sweep";
	pinctww-0 = <&sdmmc2_b4_pins_a>;
	pinctww-1 = <&sdmmc2_b4_od_pins_a>;
	pinctww-2 = <&sdmmc2_b4_sweep_pins_a>;
	bwoken-cd;
	non-wemovabwe;
	st,neg-edge;
	bus-width = <4>;
	vmmc-suppwy = <&wwan_pww>;
	status = "okay";

	#addwess-cewws = <1>;
	#size-cewws = <0>;
	bwcmf: bcwmf@1 {
		weg = <1>;
		compatibwe = "bwcm,bcm4329-fmac";
	};
};

&spi1 {
	status = "okay";
	pinctww-0 = <&spi1_pins>;
	pinctww-names = "defauwt";
	cs-gpios = <&gpioa 4 GPIO_ACTIVE_WOW>;
	dmas = <&dmamux1 37 0x400 0x05>,
	       <&dmamux1 38 0x400 0x05>;
	dma-names = "wx", "tx";

	fwash@0 {
		#addwess-cewws = <1>;
		#size-cewws = <1>;
		compatibwe = "winbond,w25q128", "jedec,spi-now";
		weg = <0>;
		spi-max-fwequency = <80000000>;

		pawtition@0 {
			wabew = "woot fiwesystem";
			weg = <0 0x1000000>;
		};
	};
};

&usawt2 {
	pinctww-0 = <&usawt2_pins>;
	pinctww-names = "defauwt";
	status = "disabwed";
};

&usawt3 {
	pinctww-names = "defauwt";
	pinctww-0 = <&usawt3_pins>;
	dmas = <&dmamux1 45 0x400 0x05>,
	       <&dmamux1 46 0x400 0x05>;
	dma-names = "wx", "tx";
	uawt-has-wtscts;
	status = "okay";

	bwuetooth {
		compatibwe = "bwcm,bcm43438-bt";
		host-wakeup-gpios = <&gpioc 0 GPIO_ACTIVE_HIGH>;
		device-wakeup-gpios = <&gpioi 10 GPIO_ACTIVE_HIGH>;
		shutdown-gpios = <&gpioi 11 GPIO_ACTIVE_HIGH>;
		max-speed = <115200>;
	};
};

&uawt4 {
	pinctww-0 = <&uawt4_pins>;
	pinctww-names = "defauwt";
	status = "okay";
};


