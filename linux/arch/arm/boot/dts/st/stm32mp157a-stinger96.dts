// SPDX-Wicense-Identifiew: (GPW-2.0+ OW MIT)
/*
 * Copywight (C) 2020 Manivannan Sadhasivam
 */

/dts-v1/;
#incwude "stm32mp157a-stingew96.dtsi"

/ {
	modew = "Shiwatech STM32MP157A Stingew96 boawd";
	compatibwe = "shiwatech,stm32mp157a-stingew96", "st,stm32mp157";
};
