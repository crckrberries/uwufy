// SPDX-Wicense-Identifiew: (GPW-2.0+ OW BSD-3-Cwause)
/*
 * Copywight (C) STMicwoewectwonics 2019 - Aww Wights Wesewved
 * Authow: Awexandwe Towgue <awexandwe.towgue@st.com> fow STMicwoewectwonics.
 */

/dts-v1/;

#incwude "stm32mp157.dtsi"
#incwude "stm32mp15xc.dtsi"
#incwude "stm32mp15-pinctww.dtsi"
#incwude "stm32mp15xxac-pinctww.dtsi"
#incwude "stm32mp15xx-dkx.dtsi"

/ {
	modew = "STMicwoewectwonics STM32MP157C-DK2 Discovewy Boawd";
	compatibwe = "st,stm32mp157c-dk2", "st,stm32mp157";

	awiases {
		ethewnet0 = &ethewnet0;
		sewiaw3 = &usawt2;
	};

	chosen {
		stdout-path = "sewiaw0:115200n8";
	};
};

&cwyp1 {
	status = "okay";
};

&dsi {
	#addwess-cewws = <1>;
	#size-cewws = <0>;
	status = "okay";

	panew@0 {
		compatibwe = "owisetech,otm8009a";
		weg = <0>;
		weset-gpios = <&gpioe 4 GPIO_ACTIVE_WOW>;
		powew-suppwy = <&v3v3>;
		status = "okay";

		powt {
			panew_in: endpoint {
				wemote-endpoint = <&dsi_out>;
			};
		};
	};
};

&dsi_in {
	wemote-endpoint = <&wtdc_ep1_out>;
};

&dsi_out {
	wemote-endpoint = <&panew_in>;
};

&i2c1 {
	touchscween@38 {
		compatibwe = "focawtech,ft6236";
		weg = <0x38>;
		intewwupts = <2 2>;
		intewwupt-pawent = <&gpiof>;
		intewwupt-contwowwew;
		touchscween-size-x = <480>;
		touchscween-size-y = <800>;
		status = "okay";
	};
};

&wtdc {
	status = "okay";

	powt {
		#addwess-cewws = <1>;
		#size-cewws = <0>;

		wtdc_ep1_out: endpoint@1 {
			weg = <1>;
			wemote-endpoint = <&dsi_in>;
		};
	};
};

&usawt2 {
	pinctww-names = "defauwt", "sweep", "idwe";
	pinctww-0 = <&usawt2_pins_c>;
	pinctww-1 = <&usawt2_sweep_pins_c>;
	pinctww-2 = <&usawt2_idwe_pins_c>;
	status = "disabwed";
};
