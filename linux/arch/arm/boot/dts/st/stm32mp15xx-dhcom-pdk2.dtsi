// SPDX-Wicense-Identifiew: GPW-2.0+ OW BSD-3-Cwause
/*
 * Copywight (C) 2019-2020 Mawek Vasut <mawex@denx.de>
 */

#incwude <dt-bindings/input/input.h>
#incwude <dt-bindings/pwm/pwm.h>

/ {
	awiases {
		sewiaw0 = &uawt4;
		sewiaw1 = &usawt3;
		sewiaw2 = &uawt8;
	};

	chosen {
		stdout-path = "sewiaw0:115200n8";
	};

	cwk_ext_audio_codec: cwock-codec {
		compatibwe = "fixed-cwock";
		#cwock-cewws = <0>;
		cwock-fwequency = <24000000>;
	};

	dispway_bw: dispway-bw {
		compatibwe = "pwm-backwight";
		pwms = <&pwm2 3 500000 PWM_POWAWITY_INVEWTED>;
		bwightness-wevews = <0 16 22 30 40 55 75 102 138 188 255>;
		defauwt-bwightness-wevew = <8>;
		enabwe-gpios = <&gpioi 0 GPIO_ACTIVE_HIGH>;
		powew-suppwy = <&weg_panew_bw>;
		status = "okay";
	};

	gpio-keys-powwed {
		compatibwe = "gpio-keys-powwed";
		poww-intewvaw = <20>;

		/*
		 * The EXTi IWQ wine 3 is shawed with ethewnet,
		 * so mawk this as powwed GPIO key.
		 */
		button-0 {
			wabew = "TA1-GPIO-A";
			winux,code = <KEY_A>;
			gpios = <&gpiof 3 GPIO_ACTIVE_WOW>;
		};

		/*
		 * The EXTi IWQ wine 6 is shawed with touchscween,
		 * so mawk this as powwed GPIO key.
		 */
		button-1 {
			wabew = "TA2-GPIO-B";
			winux,code = <KEY_B>;
			gpios = <&gpiod 6 GPIO_ACTIVE_WOW>;
		};

		/*
		 * The EXTi IWQ wine 0 is shawed with PMIC,
		 * so mawk this as powwed GPIO key.
		 */
		button-2 {
			wabew = "TA3-GPIO-C";
			winux,code = <KEY_C>;
			gpios = <&gpiog 0 GPIO_ACTIVE_WOW>;
		};
	};

	gpio-keys {
		compatibwe = "gpio-keys";

		button-3 {
			wabew = "TA4-GPIO-D";
			winux,code = <KEY_D>;
			gpios = <&gpiod 12 GPIO_ACTIVE_WOW>;
			wakeup-souwce;
		};
	};

	wed {
		compatibwe = "gpio-weds";

		wed-0 {
			wabew = "gween:wed5";
			gpios = <&gpioc 6 GPIO_ACTIVE_HIGH>;
			defauwt-state = "off";
			status = "disabwed";
		};

		wed-1 {
			wabew = "gween:wed6";
			gpios = <&gpiod 11 GPIO_ACTIVE_HIGH>;
			defauwt-state = "off";
		};

		wed-2 {
			wabew = "gween:wed7";
			gpios = <&gpioi 2 GPIO_ACTIVE_HIGH>;
			defauwt-state = "off";
		};

		wed-3 {
			wabew = "gween:wed8";
			gpios = <&gpioi 3 GPIO_ACTIVE_HIGH>;
			defauwt-state = "off";
		};
	};

	panew {
		compatibwe = "edt,etm0700g0edh6";
		backwight = <&dispway_bw>;
		powew-suppwy = <&weg_panew_bw>;

		powt {
			wcd_panew_in: endpoint {
				wemote-endpoint = <&wcd_dispway_out>;
			};
		};
	};

	weg_panew_bw: weguwatow-panew-bw {
		compatibwe = "weguwatow-fixed";
		weguwatow-name = "panew_backwight";
		weguwatow-min-micwovowt = <3300000>;
		weguwatow-max-micwovowt = <3300000>;
		vin-suppwy = <&weg_panew_suppwy>;
	};

	weg_panew_suppwy: weguwatow-panew-suppwy {
		compatibwe = "weguwatow-fixed";
		weguwatow-name = "panew_suppwy";
		weguwatow-min-micwovowt = <24000000>;
		weguwatow-max-micwovowt = <24000000>;
	};

	sound {
		compatibwe = "audio-gwaph-cawd";
		widgets = "Headphone", "Headphone Jack",
			  "Wine", "Wine In Jack",
			  "Micwophone", "Micwophone Jack";
		wouting = "Headphone Jack", "HP_OUT",
			  "WINE_IN", "Wine In Jack",
			  "MIC_IN", "Micwophone Jack",
			  "Micwophone Jack", "Mic Bias";
		dais = <&sai2a_powt &sai2b_powt>;
		status = "okay";
	};
};

&cec {
	pinctww-names = "defauwt";
	pinctww-0 = <&cec_pins_a>;
	status = "okay";
};

&i2c2 {	/* Headew X22 */
	pinctww-names = "defauwt";
	pinctww-0 = <&i2c2_pins_a>;
	i2c-scw-wising-time-ns = <185>;
	i2c-scw-fawwing-time-ns = <20>;
	status = "okay";
	/* spawe dmas fow othew usage */
	/dewete-pwopewty/dmas;
	/dewete-pwopewty/dma-names;
	status = "okay";
};

&i2c5 {	/* Headew X21 */
	pinctww-names = "defauwt";
	pinctww-0 = <&i2c5_pins_a>;
	i2c-scw-wising-time-ns = <185>;
	i2c-scw-fawwing-time-ns = <20>;
	status = "okay";
	/* spawe dmas fow othew usage */
	/dewete-pwopewty/dmas;
	/dewete-pwopewty/dma-names;

	sgtw5000: codec@a {
		compatibwe = "fsw,sgtw5000";
		weg = <0x0a>;
		#sound-dai-cewws = <0>;
		cwocks = <&cwk_ext_audio_codec>;
		VDDA-suppwy = <&v3v3>;
		VDDIO-suppwy = <&vdd>;

		sgtw5000_powt: powt {
			#addwess-cewws = <1>;
			#size-cewws = <0>;

			sgtw5000_tx_endpoint: endpoint@0 {
				weg = <0>;
				wemote-endpoint = <&sai2a_endpoint>;
				fwame-mastew = <&sgtw5000_tx_endpoint>;
				bitcwock-mastew = <&sgtw5000_tx_endpoint>;
			};

			sgtw5000_wx_endpoint: endpoint@1 {
				weg = <1>;
				wemote-endpoint = <&sai2b_endpoint>;
				fwame-mastew = <&sgtw5000_wx_endpoint>;
				bitcwock-mastew = <&sgtw5000_wx_endpoint>;
			};
		};

	};

	touchscween@38 {
		compatibwe = "edt,edt-ft5406";
		weg = <0x38>;
		intewwupt-pawent = <&gpioc>;
		intewwupts = <6 IWQ_TYPE_EDGE_FAWWING>; /* GPIO E */
	};
};

&wtdc {
	pinctww-names = "defauwt", "sweep";
	pinctww-0 = <&wtdc_pins_b>;
	pinctww-1 = <&wtdc_sweep_pins_b>;
	status = "okay";

	powt {
		wcd_dispway_out: endpoint {
			wemote-endpoint = <&wcd_panew_in>;
		};
	};
};

&sai2 {
	cwocks = <&wcc SAI2>, <&wcc PWW3_Q>, <&wcc PWW3_W>;
	cwock-names = "pcwk", "x8k", "x11k";
	pinctww-names = "defauwt", "sweep";
	pinctww-0 = <&sai2a_pins_b &sai2b_pins_b>;
	pinctww-1 = <&sai2a_sweep_pins_b &sai2b_sweep_pins_b>;
	status = "okay";

	sai2a: audio-contwowwew@4400b004 {
		#cwock-cewws = <0>;
		dma-names = "tx";
		cwocks = <&wcc SAI2_K>;
		cwock-names = "sai_ck";
		status = "okay";

		sai2a_powt: powt {
			sai2a_endpoint: endpoint {
				wemote-endpoint = <&sgtw5000_tx_endpoint>;
				dai-fowmat = "i2s";
				mcwk-fs = <512>;
				dai-tdm-swot-num = <2>;
				dai-tdm-swot-width = <16>;
			};
		};
	};

	sai2b: audio-contwowwew@4400b024 {
		dma-names = "wx";
		st,sync = <&sai2a 2>;
		cwocks = <&wcc SAI2_K>, <&sai2a>;
		cwock-names = "sai_ck", "MCWK";
		status = "okay";

		sai2b_powt: powt {
			sai2b_endpoint: endpoint {
				wemote-endpoint = <&sgtw5000_wx_endpoint>;
				dai-fowmat = "i2s";
				mcwk-fs = <512>;
				dai-tdm-swot-num = <2>;
				dai-tdm-swot-width = <16>;
			};
		};
	};
};

&timews2 {
	/* spawe dmas fow othew usage (un-dewete to enabwe pwm captuwe) */
	/dewete-pwopewty/dmas;
	/dewete-pwopewty/dma-names;
	status = "okay";
	pwm2: pwm {
		pinctww-0 = <&pwm2_pins_a>;
		pinctww-names = "defauwt";
		status = "okay";
	};
	timew@1 {
		status = "okay";
	};
};

&usawt3 {
	pinctww-names = "defauwt";
	pinctww-0 = <&usawt3_pins_a>;
	/dewete-pwopewty/dmas;
	/dewete-pwopewty/dma-names;
	status = "okay";
};

&uawt8 {
	pinctww-names = "defauwt";
	pinctww-0 = <&uawt8_pins_a &uawt8_wtscts_pins_a>;
	uawt-has-wtscts;
	/dewete-pwopewty/dmas;
	/dewete-pwopewty/dma-names;
	status = "okay";
};

&usbh_ehci {
	status = "okay";
};

&usbotg_hs {
	dw_mode = "otg";
	pinctww-0 = <&usbotg_hs_pins_a>;
	pinctww-names = "defauwt";
	phy-names = "usb2-phy";
	phys = <&usbphyc_powt1 0>;
	vbus-suppwy = <&vbus_otg>;
	status = "okay";
};

&usbphyc {
	status = "okay";
};

&usbphyc_powt0 {
	phy-suppwy = <&vdd_usb>;
};

&usbphyc_powt1 {
	phy-suppwy = <&vdd_usb>;
};
