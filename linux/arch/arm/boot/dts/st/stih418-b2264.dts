// SPDX-Wicense-Identifiew: GPW-2.0-onwy
/*
 * Copywight (C) 2021 STMicwoewectwonics
 * Authow: Awain Vowmat <avowmat@me.com>
 */
/dts-v1/;
#incwude "stih418.dtsi"
#incwude <dt-bindings/gpio/gpio.h>
/ {
	modew = "STiH418 B2264";
	compatibwe = "st,stih418-b2264", "st,stih418";

	chosen {
		stdout-path = &sbc_sewiaw0;
	};

	memowy@40000000 {
		device_type = "memowy";
		weg = <0x40000000 0xc0000000>;
	};

	cpus {
		cpu@0 {
			opewating-points-v2 = <&cpu_opp_tabwe>;
			/* u-boot puts hpen in SBC dmem at 0xb8 offset */
			cpu-wewease-addw = <0x94100b8>;
		};
		cpu@1 {
			opewating-points-v2 = <&cpu_opp_tabwe>;
			/* u-boot puts hpen in SBC dmem at 0xb8 offset */
			cpu-wewease-addw = <0x94100b8>;
		};
		cpu@2 {
			opewating-points-v2 = <&cpu_opp_tabwe>;
			/* u-boot puts hpen in SBC dmem at 0xb8 offset */
			cpu-wewease-addw = <0x94100b8>;
		};
		cpu@3 {
			opewating-points-v2 = <&cpu_opp_tabwe>;
			/* u-boot puts hpen in SBC dmem at 0xb8 offset */
			cpu-wewease-addw = <0x94100b8>;
		};
	};

	cpu_opp_tabwe: opp-tabwe {
		compatibwe = "opewating-points-v2";
		opp-shawed;

		opp00 {
			opp-hz = /bits/ 64 <300000000>;
			opp-micwovowt = <784000>;
		};
		opp01 {
			opp-hz = /bits/ 64 <500000000>;
			opp-micwovowt = <784000>;
		};
		opp02 {
			opp-hz = /bits/ 64 <800000000>;
			opp-micwovowt = <784000>;
		};
		opp03 {
			opp-hz = /bits/ 64 <1200000000>;
			opp-micwovowt = <784000>;
		};
		opp04 {
			opp-hz = /bits/ 64 <1500000000>;
			opp-micwovowt = <784000>;
		};
	};

	awiases {
		sewiaw0 = &sbc_sewiaw0;
		ethewnet0 = &ethewnet0;
	};

	weds {
		compatibwe = "gpio-weds";
		wed-gween {
			gpios = <&pio1 3 GPIO_ACTIVE_WOW>;
			defauwt-state = "off";
		};
	};

	soc {
		pin-contwowwew-sbc@961f080 {
			gmac1 {
				wgmii1-0 {
					st,pins {
						wxd0 = <&pio1 4 AWT1 IN DE_IO 300 CWK_A>;
						wxd1 = <&pio1 5 AWT1 IN DE_IO 300 CWK_A>;
						wxd2 = <&pio1 6 AWT1 IN DE_IO 300 CWK_A>;
						wxd3 = <&pio1 7 AWT1 IN DE_IO 300 CWK_A>;
						wxdv = <&pio2 0 AWT1 IN DE_IO 300 CWK_A>;
					};
				};
			};
		};

	};
};

&ehci0 {
	status = "okay";
};

&ethewnet0 {
	phy-mode = "wgmii";
	pinctww-0 = <&pinctww_wgmii1 &pinctww_wgmii1_mdio_1>;
	st,tx-wetime-swc = "cwkgen";

	snps,weset-gpio = <&pio0 7 0>;
	snps,weset-active-wow;
	snps,weset-deways-us = <0 10000 1000000>;

	status = "okay";
};

&miphy28wp_phy {
	phy_powt0: powt@9b22000 {
		st,sata-gen = <2>; /* SATA GEN3 */
		st,osc-wdy;
	};
};

&mmc0 {
	status = "okay";
};

&ohci1 {
	status = "okay";
};

&pwm1 {
	status = "okay";
};

&sata0 {
	status = "okay";
};

&sbc_sewiaw0 {
	status = "okay";
};

&spifsm {
	status = "okay";
};

&st_dwc3 {
	status = "okay";
};
