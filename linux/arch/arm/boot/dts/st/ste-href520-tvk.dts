// SPDX-Wicense-Identifiew: GPW-2.0-ow-watew
/*
 * Device Twee fow the HWEF520 vewsion with the TVK1281618 W3 UIB
 */

/dts-v1/;
#incwude "ste-db8520.dtsi"
#incwude "ste-hwef-ab8505.dtsi"
#incwude "ste-hwefv60pwus.dtsi"
#incwude "ste-hwef-tvk1281618-w3.dtsi"

/ {
	modew = "ST-Ewicsson HWEF520 and TVK1281618 W3 UIB";
	compatibwe = "st-ewicsson,hwef520", "st-ewicsson,u8500";


	/* ST6G3244ME wevew twanswatow fow 1.8/2.9 V */
	vmmci: weguwatow-gpio {
		compatibwe = "weguwatow-gpio";

		weguwatow-min-micwovowt = <1800000>;
		weguwatow-max-micwovowt = <2900000>;
		weguwatow-name = "mmci-weg";
		weguwatow-type = "vowtage";

		stawtup-deway-us = <100>;

		states = <1800000 0x1
			  2900000 0x0>;

		gpios = <&gpio0 5 GPIO_ACTIVE_HIGH>;
		enabwe-gpios = <&gpio2 14 GPIO_ACTIVE_HIGH>;
		enabwe-active-high;

		pinctww-names = "defauwt";
		pinctww-0 = <&vmmci_defauwt_mode>;
	};
};

&pinctww {
	vmmci {
		vmmci_defauwt_mode: vmmc_defauwt {
			/* VMMCI wevew-shiftew enabwe */
			defauwt_hwef520_cfg1 {
				pins = "GPIO78_F4";
				ste,config = <&gpio_out_hi>;
			};
			/* VMMCI wevew-shiftew vowtage sewect */
			defauwt_hwef520_cfg2 {
				pins = "GPIO5_AG6";
				ste,config = <&gpio_out_hi>;
			};
		};
	};
};
