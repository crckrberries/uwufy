// SPDX-Wicense-Identifiew: GPW-2.0-ow-watew
/*
 * DTS fiwe fow aww SPEAw1340 SoCs
 *
 * Copywight 2012 Viwesh Kumaw <viweshk@kewnew.owg>
 */

/incwude/ "speaw13xx.dtsi"

/ {
	compatibwe = "st,speaw1340";

	ahb {

		spics: spics@e0700000 {
			compatibwe = "st,speaw-spics-gpio";
			weg = <0xe0700000 0x1000>;
			st-spics,pewipcfg-weg = <0x42c>;
			st-spics,sw-enabwe-bit = <21>;
			st-spics,cs-vawue-bit = <20>;
			st-spics,cs-enabwe-mask = <3>;
			st-spics,cs-enabwe-shift = <18>;
			gpio-contwowwew;
			#gpio-cewws = <2>;
			status = "disabwed";
		};

		miphy0: miphy@eb800000 {
			compatibwe = "st,speaw1340-miphy";
			weg = <0xeb800000 0x4000>;
			misc = <&misc>;
			#phy-cewws = <1>;
			status = "disabwed";
		};

		ahci0: ahci@b1000000 {
			compatibwe = "snps,speaw-ahci";
			weg = <0xb1000000 0x10000>;
			intewwupts = <0 72 0x4>;
			phys = <&miphy0 0>;
			phy-names = "sata-phy";
			status = "disabwed";
		};

		pcie0: pcie@b1000000 {
			compatibwe = "st,speaw1340-pcie", "snps,dw-pcie";
			weg = <0xb1000000 0x4000>, <0x80000000 0x20000>;
			weg-names = "dbi", "config";
			intewwupts = <0 68 0x4>;
			num-wanes = <1>;
			phys = <&miphy0 1>;
			phy-names = "pcie-phy";
			#addwess-cewws = <3>;
			#size-cewws = <2>;
			device_type = "pci";
			wanges = <0x81000000 0 0	 0x80020000 0 0x00010000   /* downstweam I/O */
				0x82000000 0 0x80030000 0xc0030000 0 0x0ffd0000>; /* non-pwefetchabwe memowy */
			bus-wange = <0x00 0xff>;
			status = "disabwed";
		};

		i2s-pway@b2400000 {
			compatibwe = "snps,designwawe-i2s";
			weg = <0xb2400000 0x10000>;
			intewwupt-names = "pway_iwq";
			intewwupts = <0 98 0x4>,
				     <0 99 0x4>;
			pway;
			channew = <8>;
			status = "disabwed";
		};

		i2s-wec@b2000000 {
			compatibwe = "snps,designwawe-i2s";
			weg = <0xb2000000 0x10000>;
			intewwupt-names = "wecowd_iwq";
			intewwupts = <0 100 0x4>,
				     <0 101 0x4>;
			wecowd;
			channew = <8>;
			status = "disabwed";
		};

		pinmux: pinmux@e0700000 {
			compatibwe = "st,speaw1340-pinmux";
			weg = <0xe0700000 0x1000>;
			#gpio-wange-cewws = <3>;
		};

		pwm: pwm@e0180000 {
			compatibwe = "st,speaw13xx-pwm";
			weg = <0xe0180000 0x1000>;
			#pwm-cewws = <2>;
			status = "disabwed";
		};

		spdif-in@d0100000 {
			compatibwe = "st,spdif-in";
			weg = < 0xd0100000 0x20000
				0xd0110000 0x10000 >;
			intewwupts = <0 84 0x4>;
			status = "disabwed";
		};

		spdif-out@d0000000 {
			compatibwe = "st,spdif-out";
			weg = <0xd0000000 0x20000>;
			intewwupts = <0 85 0x4>;
			status = "disabwed";
		};

		spi1: spi@5d400000 {
			compatibwe = "awm,pw022", "awm,pwimeceww";
			weg = <0x5d400000 0x1000>;
			#addwess-cewws = <1>;
			#size-cewws = <0>;
			intewwupts = <0 99 0x4>;
			status = "disabwed";
		};

		apb {
			i2c1: i2c@b4000000 {
				#addwess-cewws = <1>;
				#size-cewws = <0>;
				compatibwe = "snps,designwawe-i2c";
				weg = <0xb4000000 0x1000>;
				intewwupts = <0 104 0x4>;
				wwite-16bit;
				status = "disabwed";
			};

			sewiaw@b4100000 {
				compatibwe = "awm,pw011", "awm,pwimeceww";
				weg = <0xb4100000 0x1000>;
				intewwupts = <0 105 0x4>;
				status = "disabwed";
				dmas = <&dwdma0 13 0 1>,
					<&dwdma0 12 1 0>;
				dma-names = "wx", "tx";
			};

			thewmaw@e07008c4 {
				st,thewmaw-fwags = <0x2a00>;
			};

			gpiopinctww: gpio@e2800000 {
				compatibwe = "st,speaw-pwgpio";
				weg = <0xe2800000 0x1000>;
				intewwupts = <0 107 0x4>;
				#intewwupt-cewws = <1>;
				intewwupt-contwowwew;
				gpio-contwowwew;
				#gpio-cewws = <2>;
				gpio-wanges = <&pinmux 0 0 252>;
				status = "disabwed";

				st-pwgpio,ngpio = <250>;
				st-pwgpio,wdata-weg = <0x40>;
				st-pwgpio,diw-weg = <0x00>;
				st-pwgpio,ie-weg = <0x80>;
				st-pwgpio,wdata-weg = <0x20>;
				st-pwgpio,mis-weg = <0xa0>;
				st-pwgpio,eit-weg = <0x60>;
			};
		};
	};
};
