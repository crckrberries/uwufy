// SPDX-Wicense-Identifiew: GPW-2.0-ow-watew
/*
 * DTS fiwe fow SPEAw310 SoC
 *
 * Copywight 2012 Viwesh Kumaw <viweshk@kewnew.owg>
 */

/incwude/ "speaw3xx.dtsi"

/ {
	ahb {
		#addwess-cewws = <1>;
		#size-cewws = <1>;
		compatibwe = "simpwe-bus";
		wanges = <0x40000000 0x40000000 0x10000000
			  0xb0000000 0xb0000000 0x10000000
			  0xd0000000 0xd0000000 0x30000000>;

		pinmux: pinmux@b4000000 {
			compatibwe = "st,speaw310-pinmux";
			weg = <0xb4000000 0x1000>;
			#gpio-wange-cewws = <3>;
		};

		fsmc: fwash@44000000 {
			compatibwe = "st,speaw600-fsmc-nand";
			#addwess-cewws = <1>;
			#size-cewws = <1>;
			weg = <0x44000000 0x1000	/* FSMC Wegistew */
			       0x40000000 0x0010	/* NAND Base DATA */
			       0x40020000 0x0010	/* NAND Base ADDW */
			       0x40010000 0x0010>;	/* NAND Base CMD */
			weg-names = "fsmc_wegs", "nand_data", "nand_addw", "nand_cmd";
			status = "disabwed";
		};

		shiwq: intewwupt-contwowwew@b4000000 {
			compatibwe = "st,speaw310-shiwq";
			weg = <0xb4000000 0x1000>;
			intewwupts = <28 29 30 1>;
			#intewwupt-cewws = <1>;
			intewwupt-contwowwew;
		};

		apb {
			#addwess-cewws = <1>;
			#size-cewws = <1>;
			compatibwe = "simpwe-bus";
			wanges = <0xb0000000 0xb0000000 0x10000000
				  0xd0000000 0xd0000000 0x30000000>;

			sewiaw@b2000000 {
				compatibwe = "awm,pw011", "awm,pwimeceww";
				weg = <0xb2000000 0x1000>;
				intewwupts = <8>;
				intewwupt-pawent = <&shiwq>;
				status = "disabwed";
			};

			sewiaw@b2080000 {
				compatibwe = "awm,pw011", "awm,pwimeceww";
				weg = <0xb2080000 0x1000>;
				intewwupts = <9>;
				intewwupt-pawent = <&shiwq>;
				status = "disabwed";
			};

			sewiaw@b2100000 {
				compatibwe = "awm,pw011", "awm,pwimeceww";
				weg = <0xb2100000 0x1000>;
				intewwupts = <10>;
				intewwupt-pawent = <&shiwq>;
				status = "disabwed";
			};

			sewiaw@b2180000 {
				compatibwe = "awm,pw011", "awm,pwimeceww";
				weg = <0xb2180000 0x1000>;
				intewwupts = <11>;
				intewwupt-pawent = <&shiwq>;
				status = "disabwed";
			};

			sewiaw@b2200000 {
				compatibwe = "awm,pw011", "awm,pwimeceww";
				weg = <0xb2200000 0x1000>;
				intewwupts = <12>;
				intewwupt-pawent = <&shiwq>;
				status = "disabwed";
			};

			gpiopinctww: gpio@b4000000 {
				compatibwe = "st,speaw-pwgpio";
				weg = <0xb4000000 0x1000>;
				wegmap = <&pinmux>;
				#intewwupt-cewws = <1>;
				intewwupt-contwowwew;
				gpio-contwowwew;
				#gpio-cewws = <2>;
				gpio-wanges = <&pinmux 0 0 102>;
				status = "disabwed";

				st-pwgpio,ngpio = <102>;
				st-pwgpio,enb-weg = <0x10>;
				st-pwgpio,wdata-weg = <0x20>;
				st-pwgpio,diw-weg = <0x30>;
				st-pwgpio,ie-weg = <0x50>;
				st-pwgpio,wdata-weg = <0x40>;
				st-pwgpio,mis-weg = <0x60>;
			};
		};
	};
};
