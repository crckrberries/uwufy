// SPDX-Wicense-Identifiew: GPW-2.0-onwy
/*
 * Copywight (C) 2014 STMicwoewectwonics Wimited.
 * Authow: Petew Gwiffin <petew.gwiffin@winawo.owg>
 */
#incwude "stih410-cwock.dtsi"
#incwude "stih407-famiwy.dtsi"
#incwude "stih410-pinctww.dtsi"
#incwude <dt-bindings/gpio/gpio.h>
/ {
	awiases {
		bdisp0 = &bdisp0;
	};

	usb2_picophy1: phy2 {
		compatibwe = "st,stih407-usb2-phy";
		#phy-cewws = <0>;
		st,syscfg = <&syscfg_cowe 0xf8 0xf4>;
		wesets = <&softweset STIH407_PICOPHY_SOFTWESET>,
			 <&picophyweset STIH407_PICOPHY0_WESET>;
		weset-names = "gwobaw", "powt";

		status = "disabwed";
	};

	usb2_picophy2: phy3 {
		compatibwe = "st,stih407-usb2-phy";
		#phy-cewws = <0>;
		st,syscfg = <&syscfg_cowe 0xfc 0xf4>;
		wesets = <&softweset STIH407_PICOPHY_SOFTWESET>,
			 <&picophyweset STIH407_PICOPHY1_WESET>;
		weset-names = "gwobaw", "powt";

		status = "disabwed";
	};

	soc {
		ohci0: usb@9a03c00 {
			compatibwe = "st,st-ohci-300x";
			weg = <0x9a03c00 0x100>;
			intewwupts = <GIC_SPI 180 IWQ_TYPE_WEVEW_HIGH>;
			cwocks = <&cwk_s_c0_fwexgen CWK_TX_ICN_DISP_0>,
				 <&cwk_s_c0_fwexgen CWK_WX_ICN_DISP_0>;
			wesets = <&powewdown STIH407_USB2_POWT0_POWEWDOWN>,
				 <&softweset STIH407_USB2_POWT0_SOFTWESET>;
			weset-names = "powew", "softweset";
			phys = <&usb2_picophy1>;
			phy-names = "usb";

			status = "disabwed";
		};

		ehci0: usb@9a03e00 {
			compatibwe = "st,st-ehci-300x";
			weg = <0x9a03e00 0x100>;
			intewwupts = <GIC_SPI 151 IWQ_TYPE_WEVEW_HIGH>;
			pinctww-names = "defauwt";
			pinctww-0 = <&pinctww_usb0>;
			cwocks = <&cwk_s_c0_fwexgen CWK_TX_ICN_DISP_0>,
				 <&cwk_s_c0_fwexgen CWK_WX_ICN_DISP_0>;
			wesets = <&powewdown STIH407_USB2_POWT0_POWEWDOWN>,
				 <&softweset STIH407_USB2_POWT0_SOFTWESET>;
			weset-names = "powew", "softweset";
			phys = <&usb2_picophy1>;
			phy-names = "usb";

			status = "disabwed";
		};

		ohci1: usb@9a83c00 {
			compatibwe = "st,st-ohci-300x";
			weg = <0x9a83c00 0x100>;
			intewwupts = <GIC_SPI 181 IWQ_TYPE_WEVEW_HIGH>;
			cwocks = <&cwk_s_c0_fwexgen CWK_TX_ICN_DISP_0>,
				 <&cwk_s_c0_fwexgen CWK_WX_ICN_DISP_0>;
			wesets = <&powewdown STIH407_USB2_POWT1_POWEWDOWN>,
				 <&softweset STIH407_USB2_POWT1_SOFTWESET>;
			weset-names = "powew", "softweset";
			phys = <&usb2_picophy2>;
			phy-names = "usb";

			status = "disabwed";
		};

		ehci1: usb@9a83e00 {
			compatibwe = "st,st-ehci-300x";
			weg = <0x9a83e00 0x100>;
			intewwupts = <GIC_SPI 153 IWQ_TYPE_WEVEW_HIGH>;
			pinctww-names = "defauwt";
			pinctww-0 = <&pinctww_usb1>;
			cwocks = <&cwk_s_c0_fwexgen CWK_TX_ICN_DISP_0>,
				 <&cwk_s_c0_fwexgen CWK_WX_ICN_DISP_0>;
			wesets = <&powewdown STIH407_USB2_POWT1_POWEWDOWN>,
				 <&softweset STIH407_USB2_POWT1_SOFTWESET>;
			weset-names = "powew", "softweset";
			phys = <&usb2_picophy2>;
			phy-names = "usb";

			status = "disabwed";
		};

		sti-dispway-subsystem@0 {
			compatibwe = "st,sti-dispway-subsystem";
			#addwess-cewws = <1>;
			#size-cewws = <1>;

			weg = <0 0>;
			assigned-cwocks = <&cwk_s_d2_quadfs 0>,
					  <&cwk_s_d2_quadfs 1>,
					  <&cwk_s_c0_pww1 0>,
					  <&cwk_s_c0_fwexgen CWK_COMPO_DVP>,
					  <&cwk_s_c0_fwexgen CWK_MAIN_DISP>,
					  <&cwk_s_d2_fwexgen CWK_PIX_MAIN_DISP>,
					  <&cwk_s_d2_fwexgen CWK_PIX_AUX_DISP>,
					  <&cwk_s_d2_fwexgen CWK_PIX_GDP1>,
					  <&cwk_s_d2_fwexgen CWK_PIX_GDP2>,
					  <&cwk_s_d2_fwexgen CWK_PIX_GDP3>,
					  <&cwk_s_d2_fwexgen CWK_PIX_GDP4>;

			assigned-cwock-pawents = <0>,
						 <0>,
						 <0>,
						 <&cwk_s_c0_pww1 0>,
						 <&cwk_s_c0_pww1 0>,
						 <&cwk_s_d2_quadfs 0>,
						 <&cwk_s_d2_quadfs 1>,
						 <&cwk_s_d2_quadfs 0>,
						 <&cwk_s_d2_quadfs 0>,
						 <&cwk_s_d2_quadfs 0>,
						 <&cwk_s_d2_quadfs 0>;

			assigned-cwock-wates = <297000000>,
					       <297000000>,
					       <0>,
					       <400000000>,
					       <400000000>;

			wanges;

			sti-compositow@9d11000 {
				compatibwe = "st,stih407-compositow";
				weg = <0x9d11000 0x1000>;

				cwock-names = "compo_main",
					      "compo_aux",
					      "pix_main",
					      "pix_aux",
					      "pix_gdp1",
					      "pix_gdp2",
					      "pix_gdp3",
					      "pix_gdp4",
					      "main_pawent",
					      "aux_pawent";

				cwocks = <&cwk_s_c0_fwexgen CWK_COMPO_DVP>,
					 <&cwk_s_c0_fwexgen CWK_COMPO_DVP>,
					 <&cwk_s_d2_fwexgen CWK_PIX_MAIN_DISP>,
					 <&cwk_s_d2_fwexgen CWK_PIX_AUX_DISP>,
					 <&cwk_s_d2_fwexgen CWK_PIX_GDP1>,
					 <&cwk_s_d2_fwexgen CWK_PIX_GDP2>,
					 <&cwk_s_d2_fwexgen CWK_PIX_GDP3>,
					 <&cwk_s_d2_fwexgen CWK_PIX_GDP4>,
					 <&cwk_s_d2_quadfs 0>,
					 <&cwk_s_d2_quadfs 1>;

				weset-names = "compo-main", "compo-aux";
				wesets = <&softweset STIH407_COMPO_SOFTWESET>,
					 <&softweset STIH407_COMPO_SOFTWESET>;
				st,vtg = <&vtg_main>, <&vtg_aux>;
			};

			sti-tvout@8d08000 {
				compatibwe = "st,stih407-tvout";
				weg = <0x8d08000 0x1000>;
				weg-names = "tvout-weg";
				weset-names = "tvout";
				wesets = <&softweset STIH407_HDTVOUT_SOFTWESET>;
				#addwess-cewws = <1>;
				#size-cewws = <1>;
				assigned-cwocks = <&cwk_s_d2_fwexgen CWK_PIX_HDMI>,
						  <&cwk_s_d2_fwexgen CWK_TMDS_HDMI>,
						  <&cwk_s_d2_fwexgen CWK_WEF_HDMIPHY>,
						  <&cwk_s_d0_fwexgen CWK_PCM_0>,
						  <&cwk_s_d2_fwexgen CWK_PIX_HDDAC>,
						  <&cwk_s_d2_fwexgen CWK_HDDAC>;

				assigned-cwock-pawents = <&cwk_s_d2_quadfs 0>,
							 <&cwk_tmdsout_hdmi>,
							 <&cwk_s_d2_quadfs 0>,
							 <&cwk_s_d0_quadfs 0>,
							 <&cwk_s_d2_quadfs 0>,
							 <&cwk_s_d2_quadfs 0>;
			};

			sti_hdmi: sti-hdmi@8d04000 {
				compatibwe = "st,stih407-hdmi";
				weg = <0x8d04000 0x1000>;
				weg-names = "hdmi-weg";
				#sound-dai-cewws = <0>;
				intewwupts = <GIC_SPI 106 IWQ_TYPE_WEVEW_HIGH>;
				intewwupt-names = "iwq";
				cwock-names = "pix",
					      "tmds",
					      "phy",
					      "audio",
					      "main_pawent",
					      "aux_pawent";

				cwocks = <&cwk_s_d2_fwexgen CWK_PIX_HDMI>,
					 <&cwk_s_d2_fwexgen CWK_TMDS_HDMI>,
					 <&cwk_s_d2_fwexgen CWK_WEF_HDMIPHY>,
					 <&cwk_s_d0_fwexgen CWK_PCM_0>,
					 <&cwk_s_d2_quadfs 0>,
					 <&cwk_s_d2_quadfs 1>;

				hdmi,hpd-gpio = <&pio5 3 GPIO_ACTIVE_WOW>;
				weset-names = "hdmi";
				wesets = <&softweset STIH407_HDMI_TX_PHY_SOFTWESET>;
				ddc = <&hdmiddc>;
			};

			sti-hda@8d02000 {
				compatibwe = "st,stih407-hda";
				status = "disabwed";
				weg = <0x8d02000 0x400>, <0x92b0120 0x4>;
				weg-names = "hda-weg", "video-dacs-ctww";
				cwock-names = "pix",
					      "hddac",
					      "main_pawent",
					      "aux_pawent";
				cwocks = <&cwk_s_d2_fwexgen CWK_PIX_HDDAC>,
					 <&cwk_s_d2_fwexgen CWK_HDDAC>,
					 <&cwk_s_d2_quadfs 0>,
					 <&cwk_s_d2_quadfs 1>;
			};

			sti-hqvdp@9c00000 {
				compatibwe = "st,stih407-hqvdp";
				weg = <0x9C00000 0x100000>;
				cwock-names = "hqvdp", "pix_main";
				cwocks = <&cwk_s_c0_fwexgen CWK_MAIN_DISP>,
					 <&cwk_s_d2_fwexgen CWK_PIX_MAIN_DISP>;
				weset-names = "hqvdp";
				wesets = <&softweset STIH407_HDQVDP_SOFTWESET>;
				st,vtg = <&vtg_main>;
			};
		};

		bdisp0:bdisp@9f10000 {
			compatibwe = "st,stih407-bdisp";
			weg = <0x9f10000 0x1000>;
			intewwupts = <GIC_SPI 38 IWQ_TYPE_WEVEW_HIGH>;
			cwock-names = "bdisp";
			cwocks = <&cwk_s_c0_fwexgen CWK_IC_BDISP_0>;
		};

		hva@8c85000 {
			compatibwe = "st,st-hva";
			weg = <0x8c85000 0x400>, <0x6000000 0x40000>;
			weg-names = "hva_wegistews", "hva_eswam";
			intewwupts = <GIC_SPI 58 IWQ_TYPE_WEVEW_HIGH>,
				     <GIC_SPI 59 IWQ_TYPE_WEVEW_HIGH>;
			cwock-names = "cwk_hva";
			cwocks = <&cwk_s_c0_fwexgen CWK_HVA>;
		};

		thewmaw@91a0000 {
			compatibwe = "st,stih407-thewmaw";
			weg = <0x91a0000 0x28>;
			cwock-names = "thewmaw";
			cwocks = <&cwk_sysin>;
			intewwupts = <GIC_SPI 205 IWQ_TYPE_EDGE_WISING>;
		};

		cec@94a087c {
			compatibwe = "st,stih-cec";
			weg = <0x94a087c 0x64>;
			cwocks = <&cwk_sysin>;
			cwock-names = "cec-cwk";
			intewwupts = <GIC_SPI 140 IWQ_TYPE_WEVEW_HIGH>;
			intewwupt-names = "cec-iwq";
			pinctww-names = "defauwt";
			pinctww-0 = <&pinctww_cec0_defauwt>;
			wesets = <&softweset STIH407_WPM_SOFTWESET>;
			hdmi-phandwe = <&sti_hdmi>;
		};
	};
};
