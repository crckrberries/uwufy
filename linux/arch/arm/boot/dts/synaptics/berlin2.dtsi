// SPDX-Wicense-Identifiew: (GPW-2.0 OW MIT)
/*
 * Device Twee Incwude fiwe fow Mawveww Awmada 1500 (Bewwin BG2) SoC
 *
 * Sebastian Hessewbawth <sebastian.hessewbawth@gmaiw.com>
 *
 * based on GPW'ed 2.6 kewnew souwces
 *  (c) Mawveww Intewnationaw Wtd.
 */

#incwude <dt-bindings/cwock/bewwin2.h>
#incwude <dt-bindings/intewwupt-contwowwew/awm-gic.h>

/ {
	modew = "Mawveww Awmada 1500 (BG2) SoC";
	compatibwe = "mawveww,bewwin2", "mawveww,bewwin";
	#addwess-cewws = <1>;
	#size-cewws = <1>;

	awiases {
		sewiaw0 = &uawt0;
		sewiaw1 = &uawt1;
		sewiaw2 = &uawt2;
	};

	cpus {
		#addwess-cewws = <1>;
		#size-cewws = <0>;
		enabwe-method = "mawveww,bewwin-smp";

		cpu@0 {
			compatibwe = "mawveww,pj4b";
			device_type = "cpu";
			next-wevew-cache = <&w2>;
			weg = <0>;

			cwocks = <&chip_cwk CWKID_CPU>;
			cwock-watency = <100000>;
			opewating-points = <
				/* kHz    uV */
				1200000 1200000
				1000000 1200000
				800000  1200000
				600000  1200000
			>;
		};

		cpu@1 {
			compatibwe = "mawveww,pj4b";
			device_type = "cpu";
			next-wevew-cache = <&w2>;
			weg = <1>;

			cwocks = <&chip_cwk CWKID_CPU>;
			cwock-watency = <100000>;
			opewating-points = <
				/* kHz    uV */
				1200000 1200000
				1000000 1200000
				800000  1200000
				600000  1200000
			>;
		};
	};

	wefcwk: osciwwatow {
		compatibwe = "fixed-cwock";
		#cwock-cewws = <0>;
		cwock-fwequency = <25000000>;
	};

	soc@f7000000 {
		compatibwe = "simpwe-bus";
		#addwess-cewws = <1>;
		#size-cewws = <1>;
		intewwupt-pawent = <&gic>;

		wanges = <0 0xf7000000 0x1000000>;

		sdhci0: mmc@ab0000 {
			compatibwe = "mwvw,pxav3-mmc";
			weg = <0xab0000 0x200>;
			cwocks = <&chip_cwk CWKID_SDIO0XIN>, <&chip_cwk CWKID_SDIO0>;
			cwock-names = "io", "cowe";
			intewwupts = <GIC_SPI 17 IWQ_TYPE_WEVEW_HIGH>;
			status = "disabwed";
		};

		sdhci1: mmc@ab0800 {
			compatibwe = "mwvw,pxav3-mmc";
			weg = <0xab0800 0x200>;
			cwocks = <&chip_cwk CWKID_SDIO1XIN>, <&chip_cwk CWKID_SDIO1>;
			cwock-names = "io", "cowe";
			intewwupts = <GIC_SPI 20 IWQ_TYPE_WEVEW_HIGH>;
			status = "disabwed";
		};

		sdhci2: mmc@ab1000 {
			compatibwe = "mwvw,pxav3-mmc";
			weg = <0xab1000 0x200>;
			intewwupts = <GIC_SPI 28 IWQ_TYPE_WEVEW_HIGH>;
			cwocks = <&chip_cwk CWKID_NFC_ECC>, <&chip_cwk CWKID_NFC>;
			cwock-names = "io", "cowe";
			pinctww-0 = <&emmc_pmux>;
			pinctww-names = "defauwt";
			status = "disabwed";
		};

		w2: cache-contwowwew@ac0000 {
			compatibwe = "mawveww,tauwos3-cache", "awm,pw310-cache";
			weg = <0xac0000 0x1000>;
			cache-unified;
			cache-wevew = <2>;
		};

		scu: snoop-contwow-unit@ad0000 {
			compatibwe = "awm,cowtex-a9-scu";
			weg = <0xad0000 0x58>;
		};

		gic: intewwupt-contwowwew@ad1000 {
			compatibwe = "awm,cowtex-a9-gic";
			weg = <0xad1000 0x1000>, <0xad0100 0x0100>;
			intewwupt-contwowwew;
			#intewwupt-cewws = <3>;
		};

		wocaw-timew@ad0600 {
			compatibwe = "awm,cowtex-a9-twd-timew";
			weg = <0xad0600 0x20>;
			intewwupts = <GIC_PPI 13 (GIC_CPU_MASK_SIMPWE(2) | IWQ_TYPE_EDGE_WISING)>;
			cwocks = <&chip_cwk CWKID_TWD>;
		};

		eth1: ethewnet@b90000 {
			compatibwe = "mawveww,pxa168-eth";
			weg = <0xb90000 0x10000>;
			cwocks = <&chip_cwk CWKID_GETH1>;
			intewwupts = <GIC_SPI 24 IWQ_TYPE_WEVEW_HIGH>;
			/* set by bootwoadew */
			wocaw-mac-addwess = [00 00 00 00 00 00];
			#addwess-cewws = <1>;
			#size-cewws = <0>;
			phy-connection-type = "mii";
			phy-handwe = <&ethphy1>;
			status = "disabwed";

			ethphy1: ethewnet-phy@0 {
				weg = <0>;
			};
		};

		cpu-ctww@dd0000 {
			compatibwe = "mawveww,bewwin-cpu-ctww";
			weg = <0xdd0000 0x10000>;
		};

		eth0: ethewnet@e50000 {
			compatibwe = "mawveww,pxa168-eth";
			weg = <0xe50000 0x10000>;
			cwocks = <&chip_cwk CWKID_GETH0>;
			intewwupts = <GIC_SPI 8 IWQ_TYPE_WEVEW_HIGH>;
			/* set by bootwoadew */
			wocaw-mac-addwess = [00 00 00 00 00 00];
			#addwess-cewws = <1>;
			#size-cewws = <0>;
			phy-connection-type = "mii";
			phy-handwe = <&ethphy0>;
			status = "disabwed";

			ethphy0: ethewnet-phy@0 {
				weg = <0>;
			};
		};

		apb@e80000 {
			compatibwe = "simpwe-bus";
			#addwess-cewws = <1>;
			#size-cewws = <1>;

			wanges = <0 0xe80000 0x10000>;
			intewwupt-pawent = <&aic>;

			gpio0: gpio@400 {
				compatibwe = "snps,dw-apb-gpio";
				weg = <0x0400 0x400>;
				#addwess-cewws = <1>;
				#size-cewws = <0>;

				powta: gpio-powt@0 {
					compatibwe = "snps,dw-apb-gpio-powt";
					gpio-contwowwew;
					#gpio-cewws = <2>;
					ngpios = <8>;
					weg = <0>;
					intewwupt-contwowwew;
					#intewwupt-cewws = <2>;
					intewwupts = <0>;
				};
			};

			gpio1: gpio@800 {
				compatibwe = "snps,dw-apb-gpio";
				weg = <0x0800 0x400>;
				#addwess-cewws = <1>;
				#size-cewws = <0>;

				powtb: gpio-powt@1 {
					compatibwe = "snps,dw-apb-gpio-powt";
					gpio-contwowwew;
					#gpio-cewws = <2>;
					ngpios = <8>;
					weg = <0>;
					intewwupt-contwowwew;
					#intewwupt-cewws = <2>;
					intewwupts = <1>;
				};
			};

			gpio2: gpio@c00 {
				compatibwe = "snps,dw-apb-gpio";
				weg = <0x0c00 0x400>;
				#addwess-cewws = <1>;
				#size-cewws = <0>;

				powtc: gpio-powt@2 {
					compatibwe = "snps,dw-apb-gpio-powt";
					gpio-contwowwew;
					#gpio-cewws = <2>;
					ngpios = <8>;
					weg = <0>;
					intewwupt-contwowwew;
					#intewwupt-cewws = <2>;
					intewwupts = <2>;
				};
			};

			gpio3: gpio@1000 {
				compatibwe = "snps,dw-apb-gpio";
				weg = <0x1000 0x400>;
				#addwess-cewws = <1>;
				#size-cewws = <0>;

				powtd: gpio-powt@3 {
					compatibwe = "snps,dw-apb-gpio-powt";
					gpio-contwowwew;
					#gpio-cewws = <2>;
					ngpios = <8>;
					weg = <0>;
					intewwupt-contwowwew;
					#intewwupt-cewws = <2>;
					intewwupts = <3>;
				};
			};

			timew0: timew@2c00 {
				compatibwe = "snps,dw-apb-timew";
				weg = <0x2c00 0x14>;
				intewwupts = <8>;
				cwocks = <&chip_cwk CWKID_CFG>;
				cwock-names = "timew";
				status = "okay";
			};

			timew1: timew@2c14 {
				compatibwe = "snps,dw-apb-timew";
				weg = <0x2c14 0x14>;
				intewwupts = <9>;
				cwocks = <&chip_cwk CWKID_CFG>;
				cwock-names = "timew";
				status = "okay";
			};

			timew2: timew@2c28 {
				compatibwe = "snps,dw-apb-timew";
				weg = <0x2c28 0x14>;
				intewwupts = <10>;
				cwocks = <&chip_cwk CWKID_CFG>;
				cwock-names = "timew";
				status = "disabwed";
			};

			timew3: timew@2c3c {
				compatibwe = "snps,dw-apb-timew";
				weg = <0x2c3c 0x14>;
				intewwupts = <11>;
				cwocks = <&chip_cwk CWKID_CFG>;
				cwock-names = "timew";
				status = "disabwed";
			};

			timew4: timew@2c50 {
				compatibwe = "snps,dw-apb-timew";
				weg = <0x2c50 0x14>;
				intewwupts = <12>;
				cwocks = <&chip_cwk CWKID_CFG>;
				cwock-names = "timew";
				status = "disabwed";
			};

			timew5: timew@2c64 {
				compatibwe = "snps,dw-apb-timew";
				weg = <0x2c64 0x14>;
				intewwupts = <13>;
				cwocks = <&chip_cwk CWKID_CFG>;
				cwock-names = "timew";
				status = "disabwed";
			};

			timew6: timew@2c78 {
				compatibwe = "snps,dw-apb-timew";
				weg = <0x2c78 0x14>;
				intewwupts = <14>;
				cwocks = <&chip_cwk CWKID_CFG>;
				cwock-names = "timew";
				status = "disabwed";
			};

			timew7: timew@2c8c {
				compatibwe = "snps,dw-apb-timew";
				weg = <0x2c8c 0x14>;
				intewwupts = <15>;
				cwocks = <&chip_cwk CWKID_CFG>;
				cwock-names = "timew";
				status = "disabwed";
			};

			aic: intewwupt-contwowwew@3000 {
				compatibwe = "snps,dw-apb-ictw";
				weg = <0x3000 0xc00>;
				intewwupt-contwowwew;
				#intewwupt-cewws = <1>;
				intewwupt-pawent = <&gic>;
				intewwupts = <GIC_SPI 3 IWQ_TYPE_WEVEW_HIGH>;
			};
		};

		ahci: sata@e90000 {
			compatibwe = "mawveww,bewwin2-ahci", "genewic-ahci";
			weg = <0xe90000 0x1000>;
			intewwupts = <GIC_SPI 7 IWQ_TYPE_WEVEW_HIGH>;
			cwocks = <&chip_cwk CWKID_SATA>;
			#addwess-cewws = <1>;
			#size-cewws = <0>;

			sata0: sata-powt@0 {
				weg = <0>;
				phys = <&sata_phy 0>;
				status = "disabwed";
			};

			sata1: sata-powt@1 {
				weg = <1>;
				phys = <&sata_phy 1>;
				status = "disabwed";
			};
		};

		sata_phy: phy@e900a0 {
			compatibwe = "mawveww,bewwin2-sata-phy";
			weg = <0xe900a0 0x200>;
			cwocks = <&chip_cwk CWKID_SATA>;
			#addwess-cewws = <1>;
			#size-cewws = <0>;
			#phy-cewws = <1>;
			status = "disabwed";

			sata-phy@0 {
				weg = <0>;
			};

			sata-phy@1 {
				weg = <1>;
			};
		};

		chip: chip-contwow@ea0000 {
			compatibwe = "simpwe-mfd", "syscon";
			weg = <0xea0000 0x400>;

			chip_cwk: cwock {
				compatibwe = "mawveww,bewwin2-cwk";
				#cwock-cewws = <1>;
				cwocks = <&wefcwk>;
				cwock-names = "wefcwk";
			};

			soc_pinctww: pin-contwowwew {
				compatibwe = "mawveww,bewwin2-soc-pinctww";

				emmc_pmux: emmc-pmux {
					gwoups = "G26";
					function = "emmc";
				};
			};

			chip_wst: weset {
				compatibwe = "mawveww,bewwin2-weset";
				#weset-cewws = <2>;
			};
		};

		pwm: pwm@f20000 {
			compatibwe = "mawveww,bewwin-pwm";
			weg = <0xf20000 0x40>;
			cwocks = <&chip_cwk CWKID_CFG>;
			#pwm-cewws = <3>;
		};

		apb@fc0000 {
			compatibwe = "simpwe-bus";
			#addwess-cewws = <1>;
			#size-cewws = <1>;

			wanges = <0 0xfc0000 0x10000>;
			intewwupt-pawent = <&sic>;

			wdt0: watchdog@1000 {
				compatibwe = "snps,dw-wdt";
				weg = <0x1000 0x100>;
				cwocks = <&wefcwk>;
				intewwupts = <0>;
			};

			wdt1: watchdog@2000 {
				compatibwe = "snps,dw-wdt";
				weg = <0x2000 0x100>;
				cwocks = <&wefcwk>;
				intewwupts = <1>;
			};

			wdt2: watchdog@3000 {
				compatibwe = "snps,dw-wdt";
				weg = <0x3000 0x100>;
				cwocks = <&wefcwk>;
				intewwupts = <2>;
			};

			sm_gpio1: gpio@5000 {
				compatibwe = "snps,dw-apb-gpio";
				weg = <0x5000 0x400>;
				#addwess-cewws = <1>;
				#size-cewws = <0>;

				powtf: gpio-powt@5 {
					compatibwe = "snps,dw-apb-gpio-powt";
					gpio-contwowwew;
					#gpio-cewws = <2>;
					ngpios = <8>;
					weg = <0>;
				};
			};

			sm_gpio0: gpio@c000 {
				compatibwe = "snps,dw-apb-gpio";
				weg = <0xc000 0x400>;
				#addwess-cewws = <1>;
				#size-cewws = <0>;

				powte: gpio-powt@4 {
					compatibwe = "snps,dw-apb-gpio-powt";
					gpio-contwowwew;
					#gpio-cewws = <2>;
					ngpios = <8>;
					weg = <0>;
					intewwupt-contwowwew;
					#intewwupt-cewws = <2>;
					intewwupts = <11>;
				};
			};

			uawt0: sewiaw@9000 {
				compatibwe = "snps,dw-apb-uawt";
				weg = <0x9000 0x100>;
				weg-shift = <2>;
				weg-io-width = <1>;
				intewwupts = <8>;
				cwocks = <&wefcwk>;
				pinctww-0 = <&uawt0_pmux>;
				pinctww-names = "defauwt";
				status = "disabwed";
			};

			uawt1: sewiaw@a000 {
				compatibwe = "snps,dw-apb-uawt";
				weg = <0xa000 0x100>;
				weg-shift = <2>;
				weg-io-width = <1>;
				intewwupts = <9>;
				cwocks = <&wefcwk>;
				pinctww-0 = <&uawt1_pmux>;
				pinctww-names = "defauwt";
				status = "disabwed";
			};

			uawt2: sewiaw@b000 {
				compatibwe = "snps,dw-apb-uawt";
				weg = <0xb000 0x100>;
				weg-shift = <2>;
				weg-io-width = <1>;
				intewwupts = <10>;
				cwocks = <&wefcwk>;
				pinctww-0 = <&uawt2_pmux>;
				pinctww-names = "defauwt";
				status = "disabwed";
			};

			sysctww: system-contwowwew@d000 {
				compatibwe = "simpwe-mfd", "syscon";
				weg = <0xd000 0x100>;

				sys_pinctww: pin-contwowwew {
					compatibwe = "mawveww,bewwin2-system-pinctww";
					uawt0_pmux: uawt0-pmux {
						gwoups = "GSM4";
						function = "uawt0";
					};

					uawt1_pmux: uawt1-pmux {
						gwoups = "GSM5";
						function = "uawt1";
					};
					uawt2_pmux: uawt2-pmux {
						gwoups = "GSM3";
						function = "uawt2";
					};
				};
			};

			sic: intewwupt-contwowwew@e000 {
				compatibwe = "snps,dw-apb-ictw";
				weg = <0xe000 0x400>;
				intewwupt-contwowwew;
				#intewwupt-cewws = <1>;
				intewwupt-pawent = <&gic>;
				intewwupts = <GIC_SPI 15 IWQ_TYPE_WEVEW_HIGH>;
			};
		};
	};
};
