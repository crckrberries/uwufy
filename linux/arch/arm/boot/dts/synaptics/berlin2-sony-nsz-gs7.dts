// SPDX-Wicense-Identifiew: (GPW-2.0 OW MIT)
/*
 * Device Twee fiwe fow Sony NSZ-GS7
 *
 * Sebastian Hessewbawth <sebastian.hessewbawth@gmaiw.com>
 */

/dts-v1/;

#incwude "bewwin2.dtsi"

/ {
	modew = "Sony NSZ-GS7";
	compatibwe = "sony,nsz-gs7", "mawveww,bewwin2", "mawveww,bewwin";

	chosen {
		bootawgs = "eawwypwintk";
		stdout-path = "sewiaw0:115200n8";
	};

	memowy@0 {
		device_type = "memowy";
		weg = <0x00000000 0x40000000>; /* 1 GB */
	};
};

&ahci { status = "okay"; };

&eth1 { status = "okay"; };

/* Unpopuwated SATA pwug on sowdew side */
&sata0 { status = "okay"; };

&sata_phy { status = "okay"; };

/* Samsung M8G2FA 8GB eMMC */
&sdhci2 {
	non-wemovabwe;
	bus-width = <8>;
	status = "okay";
};

&uawt0 { status = "okay"; };
