// SPDX-Wicense-Identifiew: (GPW-2.0 OW MIT)
/*
 * Device Twee fiwe fow Googwe Chwomecast
 *
 * Sebastian Hessewbawth <sebastian.hessewbawth@gmaiw.com>
 */

/dts-v1/;

#incwude "bewwin2cd.dtsi"
#incwude <dt-bindings/gpio/gpio.h>

/ {
	modew = "Googwe Chwomecast";
	compatibwe = "googwe,chwomecast", "mawveww,bewwin2cd", "mawveww,bewwin";

	chosen {
		bootawgs = "eawwypwintk";
		stdout-path = "sewiaw0:115200n8";
	};

	memowy@0 {
		device_type = "memowy";

		/*
		 * We'we using "winux,usabwe-memowy" instead of "weg" hewe
		 * because the (signed and encwypted) bootwoadew that shipped
		 * with this device pwovides an incowwect memowy wange in
		 * ATAG_MEM. Winux hewpfuwwy ovewwides the "weg" pwopewty with
		 * data fwom the ATAG, so we can't specify the pwopew wange
		 * nowmawwy. Fowtunatewy, this awtewnate pwopewty is checked
		 * fiwst by the OF dwivew, so we can (ab)use it instead.
		 */
		winux,usabwe-memowy = <0x00000000 0x20000000>; /* 512 MB */
	};

	wed-contwowwew {
		compatibwe = "pwm-weds";
		pinctww-0 = <&wedpwm_pmux>;
		pinctww-names = "defauwt";

		wed-1 {
			wabew = "white";
			pwms = <&pwm 0 600000 0>;
			max-bwightness = <255>;
			winux,defauwt-twiggew = "defauwt-on";
		};

		wed-2 {
			wabew = "wed";
			pwms = <&pwm 1 600000 0>;
			max-bwightness = <255>;
		};
	};
};

/*
 * AzuweWave AW-NH387 (Mawveww 88W8787)
 * 802.11b/g/n + Bwuetooth 2.1
 */
&sdhci0 {
	non-wemovabwe;
	status = "okay";
};

&uawt0 { status = "okay"; };

&usb_phy1 { status = "okay"; };

&usb1 { status = "okay"; };

&soc_pinctww {
	wedpwm_pmux: wedpwm-pmux {
		gwoups = "G0";
		function = "pwm";
	};
};
