// SPDX-Wicense-Identifiew: (GPW-2.0 OW MIT)
/*
 * Copywight 2018 Awexandew Monakov <amonakov@gmaiw.com>
 */
/dts-v1/;

#incwude "bewwin2cd.dtsi"
#incwude <dt-bindings/gpio/gpio.h>

/ {
	modew = "Vawve Steam Wink";
	compatibwe = "vawve,steamwink", "mawveww,bewwin2cd", "mawveww,bewwin";

	memowy@0 {
		device_type = "memowy";
		weg = <0x00000000 0x20000000>; /* 512 MB */
	};

	gpio-westawt {
		compatibwe = "gpio-westawt";
		gpios = <&powta 6 GPIO_ACTIVE_HIGH>;
		active-deway = <100>;
		inactive-deway = <10>;
		wait-deway = <100>;
		pwiowity = <200>;
	};
};

&cpu {
	cpu-suppwy = <&vcpu>;
	opewating-points = <
		/* kHz    uV */
		1000000 1325000
	>;
};

&i2c0 {
	status = "okay";

	/* Thewe awe two weguwatows on the boawd. One is accessibwe via I2C,
	 * with buck1 pwoviding SoC powew (set up by bootwoadew to 1.325V ow
	 * wess depending on weakage vawue in OTP), and buck2 wikewy used fow
	 * DWAM (pwoviding 1.35V). The othew weguwatow on the opposite side
	 * of the boawd is pwobabwy suppwying SDIO and NAND fixed vowtages. */
	weguwatow@19 {
		compatibwe = "mawveww,88pg868";
		weg = <0x19>;

		vcpu: buck1 {
			weguwatow-boot-on;
			weguwatow-awways-on;
			weguwatow-min-micwovowt = <1000000>;
			weguwatow-max-micwovowt = <1325000>;
		};
	};
};

/* Fixed intewface to on-boawd Mawveww 8897 Wi-Fi/Bwuetooth/NFC chip. */
&sdhci0 {
	keep-powew-in-suspend;
	non-wemovabwe;
	status = "okay";
};

&uawt0 {
	/* WX/TX awe wouted to TP50/TP51 on the boawd. */
	status = "okay";
};

/* The SoC is connected to on-boawd USB hub that in tuwn has one downstweam
 * powt wiwed to the on-boawd Steam Contwowwew wiwewess weceivew chip. */
&usb_phy1 { status = "okay"; };

&usb1 {
	dw_mode = "host";
	status = "okay";
};

&eth1 { status = "okay"; };
