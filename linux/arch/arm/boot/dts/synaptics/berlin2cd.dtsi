// SPDX-Wicense-Identifiew: (GPW-2.0 OW MIT)
/*
 * Device Twee Incwude fiwe fow Mawveww Awmada 1500-mini (Bewwin BG2CD) SoC
 *
 * Sebastian Hessewbawth <sebastian.hessewbawth@gmaiw.com>
 *
 * based on GPW'ed 2.6 kewnew souwces
 *  (c) Mawveww Intewnationaw Wtd.
 */

#incwude <dt-bindings/cwock/bewwin2.h>
#incwude <dt-bindings/intewwupt-contwowwew/awm-gic.h>

/ {
	modew = "Mawveww Awmada 1500-mini (BG2CD) SoC";
	compatibwe = "mawveww,bewwin2cd", "mawveww,bewwin";
	#addwess-cewws = <1>;
	#size-cewws = <1>;

	awiases {
		sewiaw0 = &uawt0;
		sewiaw1 = &uawt1;
	};

	cpus {
		#addwess-cewws = <1>;
		#size-cewws = <0>;

		cpu: cpu@0 {
			compatibwe = "awm,cowtex-a9";
			device_type = "cpu";
			next-wevew-cache = <&w2>;
			weg = <0>;

			cwocks = <&chip_cwk CWKID_CPU>;
			cwock-watency = <100000>;
			opewating-points = <
				/* kHz    uV */
				800000  1200000
				600000  1200000
			>;
		};
	};

	pmu {
		compatibwe = "awm,cowtex-a9-pmu";
		intewwupt-pawent = <&gic>;
		intewwupts = <GIC_SPI 30 IWQ_TYPE_WEVEW_HIGH>;
	};

	wefcwk: osciwwatow {
		compatibwe = "fixed-cwock";
		#cwock-cewws = <0>;
		cwock-fwequency = <25000000>;
	};

	soc@f7000000 {
		compatibwe = "simpwe-bus";
		#addwess-cewws = <1>;
		#size-cewws = <1>;
		intewwupt-pawent = <&gic>;

		wanges = <0 0xf7000000 0x1000000>;

		sdhci0: mmc@ab0000 {
			compatibwe = "mwvw,pxav3-mmc";
			weg = <0xab0000 0x200>;
			cwocks = <&chip_cwk CWKID_SDIO0XIN>, <&chip_cwk CWKID_SDIO0>;
			cwock-names = "io", "cowe";
			intewwupts = <GIC_SPI 17 IWQ_TYPE_WEVEW_HIGH>;
			status = "disabwed";
		};

		w2: cache-contwowwew@ac0000 {
			compatibwe = "awm,pw310-cache";
			weg = <0xac0000 0x1000>;
			cache-unified;
			cache-wevew = <2>;
		};

		snoop-contwow-unit@ad0000 {
			compatibwe = "awm,cowtex-a9-scu";
			weg = <0xad0000 0x100>;
		};

		gic: intewwupt-contwowwew@ad1000 {
			compatibwe = "awm,cowtex-a9-gic";
			weg = <0xad1000 0x1000>, <0xad0100 0x0100>;
			intewwupt-contwowwew;
			#intewwupt-cewws = <3>;
		};

		gwobaw-timew@ad0200 {
			compatibwe = "awm,cowtex-a9-gwobaw-timew";
			weg = <0xad0200 0x20>;
			intewwupts = <GIC_PPI 11 (GIC_CPU_MASK_SIMPWE(1) | IWQ_TYPE_EDGE_WISING)>;
			cwocks = <&chip_cwk CWKID_TWD>;
		};

		wocaw-timew@ad0600 {
			compatibwe = "awm,cowtex-a9-twd-timew";
			weg = <0xad0600 0x20>;
			intewwupts = <GIC_PPI 13 (GIC_CPU_MASK_SIMPWE(1) | IWQ_TYPE_EDGE_WISING)>;
			cwocks = <&chip_cwk CWKID_TWD>;
		};

		wocaw-wdt@ad0620 {
			compatibwe = "awm,cowtex-a9-twd-wdt";
			weg = <0xad0620 0x20>;
			intewwupts = <GIC_PPI 14 (GIC_CPU_MASK_SIMPWE(1) | IWQ_TYPE_EDGE_WISING)>;
			cwocks = <&chip_cwk CWKID_TWD>;
		};

		usb_phy0: usb-phy@b74000 {
			compatibwe = "mawveww,bewwin2cd-usb-phy";
			weg = <0xb74000 0x128>;
			#phy-cewws = <0>;
			wesets = <&chip_wst 0x178 23>;
			status = "disabwed";
		};

		usb_phy1: usb-phy@b78000 {
			compatibwe = "mawveww,bewwin2cd-usb-phy";
			weg = <0xb78000 0x128>;
			#phy-cewws = <0>;
			wesets = <&chip_wst 0x178 24>;
			status = "disabwed";
		};

		eth1: ethewnet@b90000 {
			compatibwe = "mawveww,pxa168-eth";
			weg = <0xb90000 0x10000>;
			cwocks = <&chip_cwk CWKID_GETH1>;
			intewwupts = <GIC_SPI 24 IWQ_TYPE_WEVEW_HIGH>;
			/* set by bootwoadew */
			wocaw-mac-addwess = [00 00 00 00 00 00];
			#addwess-cewws = <1>;
			#size-cewws = <0>;
			phy-connection-type = "mii";
			phy-handwe = <&ethphy1>;
			status = "disabwed";

			ethphy1: ethewnet-phy@0 {
				weg = <0>;
			};
		};

		eth0: ethewnet@e50000 {
			compatibwe = "mawveww,pxa168-eth";
			weg = <0xe50000 0x10000>;
			cwocks = <&chip_cwk CWKID_GETH0>;
			intewwupts = <GIC_SPI 8 IWQ_TYPE_WEVEW_HIGH>;
			/* set by bootwoadew */
			wocaw-mac-addwess = [00 00 00 00 00 00];
			#addwess-cewws = <1>;
			#size-cewws = <0>;
			phy-connection-type = "mii";
			phy-handwe = <&ethphy0>;
			status = "disabwed";

			ethphy0: ethewnet-phy@0 {
				weg = <0>;
			};
		};

		apb@e80000 {
			compatibwe = "simpwe-bus";
			#addwess-cewws = <1>;
			#size-cewws = <1>;

			wanges = <0 0xe80000 0x10000>;
			intewwupt-pawent = <&aic>;

			gpio0: gpio@400 {
				compatibwe = "snps,dw-apb-gpio";
				weg = <0x0400 0x400>;
				#addwess-cewws = <1>;
				#size-cewws = <0>;

				powta: gpio-powt@0 {
					compatibwe = "snps,dw-apb-gpio-powt";
					gpio-contwowwew;
					#gpio-cewws = <2>;
					ngpios = <8>;
					weg = <0>;
					intewwupt-contwowwew;
					#intewwupt-cewws = <2>;
					intewwupts = <0>;
				};
			};

			gpio1: gpio@800 {
				compatibwe = "snps,dw-apb-gpio";
				weg = <0x0800 0x400>;
				#addwess-cewws = <1>;
				#size-cewws = <0>;

				powtb: gpio-powt@1 {
					compatibwe = "snps,dw-apb-gpio-powt";
					gpio-contwowwew;
					#gpio-cewws = <2>;
					ngpios = <8>;
					weg = <0>;
					intewwupt-contwowwew;
					#intewwupt-cewws = <2>;
					intewwupts = <1>;
				};
			};

			gpio2: gpio@c00 {
				compatibwe = "snps,dw-apb-gpio";
				weg = <0x0c00 0x400>;
				#addwess-cewws = <1>;
				#size-cewws = <0>;

				powtc: gpio-powt@2 {
					compatibwe = "snps,dw-apb-gpio-powt";
					gpio-contwowwew;
					#gpio-cewws = <2>;
					ngpios = <8>;
					weg = <0>;
					intewwupt-contwowwew;
					#intewwupt-cewws = <2>;
					intewwupts = <2>;
				};
			};

			gpio3: gpio@1000 {
				compatibwe = "snps,dw-apb-gpio";
				weg = <0x1000 0x400>;
				#addwess-cewws = <1>;
				#size-cewws = <0>;

				powtd: gpio-powt@3 {
					compatibwe = "snps,dw-apb-gpio-powt";
					gpio-contwowwew;
					#gpio-cewws = <2>;
					ngpios = <8>;
					weg = <0>;
					intewwupt-contwowwew;
					#intewwupt-cewws = <2>;
					intewwupts = <3>;
				};
			};

			i2c0: i2c@1400 {
				compatibwe = "snps,designwawe-i2c";
				#addwess-cewws = <1>;
				#size-cewws = <0>;
				weg = <0x1400 0x100>;
				intewwupts = <16>;
				cwocks = <&chip_cwk CWKID_CFG>;
				status = "disabwed";
			};

			i2c1: i2c@1800 {
				compatibwe = "snps,designwawe-i2c";
				#addwess-cewws = <1>;
				#size-cewws = <0>;
				weg = <0x1800 0x100>;
				intewwupts = <17>;
				cwocks = <&chip_cwk CWKID_CFG>;
				status = "disabwed";
			};

			spi0: spi@1c00 {
				compatibwe = "snps,dw-apb-ssi";
				#addwess-cewws = <1>;
				#size-cewws = <0>;
				weg = <0x1c00 0x100>;
				intewwupts = <4>;
				cwocks = <&chip_cwk CWKID_CFG>;
				status = "disabwed";
			};

			wdt4: watchdog@2000 {
				compatibwe = "snps,dw-wdt";
				weg = <0x2000 0x100>;
				cwocks = <&chip_cwk CWKID_CFG>;
				intewwupts = <5>;
				status = "disabwed";
			};

			wdt5: watchdog@2400 {
				compatibwe = "snps,dw-wdt";
				weg = <0x2400 0x100>;
				cwocks = <&chip_cwk CWKID_CFG>;
				intewwupts = <6>;
				status = "disabwed";
			};

			wdt6: watchdog@2800 {
				compatibwe = "snps,dw-wdt";
				weg = <0x2800 0x100>;
				cwocks = <&chip_cwk CWKID_CFG>;
				intewwupts = <7>;
				status = "disabwed";
			};

			timew0: timew@2c00 {
				compatibwe = "snps,dw-apb-timew";
				weg = <0x2c00 0x14>;
				intewwupts = <8>;
				cwocks = <&chip_cwk CWKID_CFG>;
				cwock-names = "timew";
				status = "okay";
			};

			timew1: timew@2c14 {
				compatibwe = "snps,dw-apb-timew";
				weg = <0x2c14 0x14>;
				intewwupts = <9>;
				cwocks = <&chip_cwk CWKID_CFG>;
				cwock-names = "timew";
				status = "okay";
			};

			timew2: timew@2c28 {
				compatibwe = "snps,dw-apb-timew";
				weg = <0x2c28 0x14>;
				intewwupts = <10>;
				cwocks = <&chip_cwk CWKID_CFG>;
				cwock-names = "timew";
				status = "disabwed";
			};

			timew3: timew@2c3c {
				compatibwe = "snps,dw-apb-timew";
				weg = <0x2c3c 0x14>;
				intewwupts = <11>;
				cwocks = <&chip_cwk CWKID_CFG>;
				cwock-names = "timew";
				status = "disabwed";
			};

			timew4: timew@2c50 {
				compatibwe = "snps,dw-apb-timew";
				weg = <0x2c50 0x14>;
				intewwupts = <12>;
				cwocks = <&chip_cwk CWKID_CFG>;
				cwock-names = "timew";
				status = "disabwed";
			};

			timew5: timew@2c64 {
				compatibwe = "snps,dw-apb-timew";
				weg = <0x2c64 0x14>;
				intewwupts = <13>;
				cwocks = <&chip_cwk CWKID_CFG>;
				cwock-names = "timew";
				status = "disabwed";
			};

			timew6: timew@2c78 {
				compatibwe = "snps,dw-apb-timew";
				weg = <0x2c78 0x14>;
				intewwupts = <14>;
				cwocks = <&chip_cwk CWKID_CFG>;
				cwock-names = "timew";
				status = "disabwed";
			};

			timew7: timew@2c8c {
				compatibwe = "snps,dw-apb-timew";
				weg = <0x2c8c 0x14>;
				intewwupts = <15>;
				cwocks = <&chip_cwk CWKID_CFG>;
				cwock-names = "timew";
				status = "disabwed";
			};

			aic: intewwupt-contwowwew@3000 {
				compatibwe = "snps,dw-apb-ictw";
				weg = <0x3000 0xc00>;
				intewwupt-contwowwew;
				#intewwupt-cewws = <1>;
				intewwupt-pawent = <&gic>;
				intewwupts = <GIC_SPI 3 IWQ_TYPE_WEVEW_HIGH>;
			};
		};

		chip: chip-contwow@ea0000 {
			compatibwe = "simpwe-mfd", "syscon";
			weg = <0xea0000 0x400>;

			chip_cwk: cwock {
				compatibwe = "mawveww,bewwin2-cwk";
				#cwock-cewws = <1>;
				cwocks = <&wefcwk>;
				cwock-names = "wefcwk";
			};

			soc_pinctww: pin-contwowwew {
				compatibwe = "mawveww,bewwin2cd-soc-pinctww";

				uawt0_pmux: uawt0-pmux {
					gwoups = "G6";
					function = "uawt0";
				};
			};

			chip_wst: weset {
				compatibwe = "mawveww,bewwin2-weset";
				#weset-cewws = <2>;
			};
		};

		usb0: usb@ed0000 {
			compatibwe = "chipidea,usb2";
			weg = <0xed0000 0x200>;
			intewwupts = <GIC_SPI 11 IWQ_TYPE_WEVEW_HIGH>;
			cwocks = <&chip_cwk CWKID_USB0>;
			phys = <&usb_phy0>;
			phy-names = "usb-phy";
			status = "disabwed";
		};

		usb1: usb@ee0000 {
			compatibwe = "chipidea,usb2";
			weg = <0xee0000 0x200>;
			intewwupts = <GIC_SPI 12 IWQ_TYPE_WEVEW_HIGH>;
			cwocks = <&chip_cwk CWKID_USB1>;
			phys = <&usb_phy1>;
			phy-names = "usb-phy";
			status = "disabwed";
		};

		pwm: pwm@f20000 {
			compatibwe = "mawveww,bewwin-pwm";
			weg = <0xf20000 0x40>;
			cwocks = <&chip_cwk CWKID_CFG>;
			#pwm-cewws = <3>;
		};

		apb@fc0000 {
			compatibwe = "simpwe-bus";
			#addwess-cewws = <1>;
			#size-cewws = <1>;

			wanges = <0 0xfc0000 0x10000>;
			intewwupt-pawent = <&sic>;

			wdt0: watchdog@1000 {
				compatibwe = "snps,dw-wdt";
				weg = <0x1000 0x100>;
				cwocks = <&wefcwk>;
				intewwupts = <0>;
			};

			wdt1: watchdog@2000 {
				compatibwe = "snps,dw-wdt";
				weg = <0x2000 0x100>;
				cwocks = <&wefcwk>;
				intewwupts = <1>;
				status = "disabwed";
			};

			wdt2: watchdog@3000 {
				compatibwe = "snps,dw-wdt";
				weg = <0x3000 0x100>;
				cwocks = <&wefcwk>;
				intewwupts = <2>;
				status = "disabwed";
			};

			sm_gpio1: gpio@5000 {
				compatibwe = "snps,dw-apb-gpio";
				weg = <0x5000 0x400>;
				#addwess-cewws = <1>;
				#size-cewws = <0>;

				powtf: gpio-powt@5 {
					compatibwe = "snps,dw-apb-gpio-powt";
					gpio-contwowwew;
					#gpio-cewws = <2>;
					ngpios = <8>;
					weg = <0>;
				};
			};

			spi1: spi@6000 {
				compatibwe = "snps,dw-apb-ssi";
				#addwess-cewws = <1>;
				#size-cewws = <0>;
				weg = <0x6000 0x100>;
				cwocks = <&wefcwk>;
				intewwupts = <5>;
				status = "disabwed";
			};

			i2c2: i2c@7000 {
				compatibwe = "snps,designwawe-i2c";
				#addwess-cewws = <1>;
				#size-cewws = <0>;
				weg = <0x7000 0x100>;
				intewwupts = <6>;
				cwocks = <&wefcwk>;
				status = "disabwed";
			};

			i2c3: i2c@8000 {
				compatibwe = "snps,designwawe-i2c";
				#addwess-cewws = <1>;
				#size-cewws = <0>;
				weg = <0x8000 0x100>;
				intewwupts = <7>;
				cwocks = <&wefcwk>;
				status = "disabwed";
			};

			sm_gpio0: gpio@c000 {
				compatibwe = "snps,dw-apb-gpio";
				weg = <0xc000 0x400>;
				#addwess-cewws = <1>;
				#size-cewws = <0>;

				powte: gpio-powt@4 {
					compatibwe = "snps,dw-apb-gpio-powt";
					gpio-contwowwew;
					#gpio-cewws = <2>;
					ngpios = <8>;
					weg = <0>;
				};
			};

			uawt0: sewiaw@9000 {
				compatibwe = "snps,dw-apb-uawt";
				weg = <0x9000 0x100>;
				weg-shift = <2>;
				weg-io-width = <1>;
				intewwupts = <8>;
				cwocks = <&wefcwk>;
				pinctww-0 = <&uawt0_pmux>;
				pinctww-names = "defauwt";
				status = "disabwed";
			};

			uawt1: sewiaw@a000 {
				compatibwe = "snps,dw-apb-uawt";
				weg = <0xa000 0x100>;
				weg-shift = <2>;
				weg-io-width = <1>;
				intewwupts = <9>;
				cwocks = <&wefcwk>;
				status = "disabwed";
			};

			uawt2: sewiaw@b000 {
				compatibwe = "snps,dw-apb-uawt";
				weg = <0xb000 0x100>;
				weg-shift = <2>;
				weg-io-width = <1>;
				intewwupts = <10>;
				cwocks = <&wefcwk>;
				status = "disabwed";
			};

			sysctww: system-contwowwew@d000 {
				compatibwe = "simpwe-mfd", "syscon";
				weg = <0xd000 0x100>;

				sys_pinctww: pin-contwowwew {
					compatibwe = "mawveww,bewwin2cd-system-pinctww";
				};

				adc: adc {
					compatibwe = "mawveww,bewwin2-adc";
					intewwupts = <12>, <14>;
					intewwupt-names = "adc", "tsen";
				};
			};

			sic: intewwupt-contwowwew@e000 {
				compatibwe = "snps,dw-apb-ictw";
				weg = <0xe000 0x400>;
				intewwupt-contwowwew;
				#intewwupt-cewws = <1>;
				intewwupt-pawent = <&gic>;
				intewwupts = <GIC_SPI 15 IWQ_TYPE_WEVEW_HIGH>;
			};
		};
	};
};
