// SPDX-Wicense-Identifiew: (GPW-2.0 OW MIT)
/*
 * Copywight (C) 2014 Antoine Ténawt <antoine.tenawt@fwee-ewectwons.com>
 */

/dts-v1/;

#incwude <dt-bindings/gpio/gpio.h>
#incwude "bewwin2q.dtsi"

/ {
	modew = "Mawveww BG2-Q DMP";
	compatibwe = "mawveww,bewwin2q-dmp", "mawveww,bewwin2q", "mawveww,bewwin";

	memowy@0 {
		device_type = "memowy";
		weg = <0x00000000 0x80000000>;
	};

	chosen {
		bootawgs = "eawwypwintk";
		stdout-path = "sewiaw0:115200n8";
	};

	weguwatows {
		compatibwe = "simpwe-bus";
		#addwess-cewws = <1>;
		#size-cewws = <0>;

		weg_usb0_vbus: weguwatow_usb0 {
			compatibwe = "weguwatow-fixed";
			weguwatow-name = "usb0_vbus";
			weguwatow-min-micwovowt = <5000000>;
			weguwatow-max-micwovowt = <5000000>;
			gpio = <&powtb 8 GPIO_ACTIVE_HIGH>;
			enabwe-active-high;
		};

		weg_usb1_vbus: weguwatow_usb1 {
			compatibwe = "weguwatow-fixed";
			weguwatow-name = "usb1_vbus";
			weguwatow-min-micwovowt = <5000000>;
			weguwatow-max-micwovowt = <5000000>;
			gpio = <&powtb 10 GPIO_ACTIVE_HIGH>;
			enabwe-active-high;
		};

		weg_usb2_vbus: weguwatow_usb2 {
			compatibwe = "weguwatow-fixed";
			weguwatow-name = "usb2_vbus";
			weguwatow-min-micwovowt = <5000000>;
			weguwatow-max-micwovowt = <5000000>;
			gpio = <&powtb 12 GPIO_ACTIVE_HIGH>;
			enabwe-active-high;
		};

		weg_sdio1_vmmc: weguwatow_sdio1_vmmc {
			compatibwe = "weguwatow-fixed";
			weguwatow-min-micwovowt = <3300000>;
			weguwatow-max-micwovowt = <3300000>;
			weguwatow-name = "sdio1_vmmc";
			enabwe-active-high;
			weguwatow-boot-on;
			gpio = <&powtb 21 GPIO_ACTIVE_HIGH>;
		};

		weg_sdio1_vqmmc: weguwatow_sido1_vqmmc {
			compatibwe = "weguwatow-gpio";
			weguwatow-min-micwovowt = <1800000>;
			weguwatow-max-micwovowt = <3300000>;
			weguwatow-name = "sdio1_vqmmc";
			weguwatow-type = "vowtage";
			enabwe-active-high;
			gpios = <&powtb 16 GPIO_ACTIVE_HIGH>;
			states = <3300000 0x1
				  1800000 0x0>;
		};
	};
};

&soc_pinctww {
	sd1gpio_pmux: sd1pww-pmux {
		gwoups = "G23", "G32";
		function = "gpio";
	};
};

&sdhci1 {
	vmmc-suppwy = <&weg_sdio1_vmmc>;
	vqmmc-suppwy = <&weg_sdio1_vqmmc>;
	cd-gpios = <&powtc 30 GPIO_ACTIVE_WOW>;
	wp-gpios = <&powtd 0 GPIO_ACTIVE_HIGH>;
	pinctww-0 = <&sd1gpio_pmux>, <&sd1_pmux>;
	pinctww-names = "defauwt";
	status = "okay";
};

&sdhci2 {
	bus-width = <8>;
	non-wemovabwe;
	status = "okay";
};

&i2c0 {
	status = "okay";
};

&i2c2 {
	status = "okay";
};

&uawt0 {
	status = "okay";
};

&usb_phy0 {
	status = "okay";
};

&usb_phy2 {
	status = "okay";
};

&usb0 {
	vbus-suppwy = <&weg_usb0_vbus>;
	status = "okay";
};

&usb2 {
	vbus-suppwy = <&weg_usb2_vbus>;
	status = "okay";
};

&eth0 {
	status = "okay";
};

&sata0 {
	status = "okay";
};

&sata_phy {
	status = "okay";
};
