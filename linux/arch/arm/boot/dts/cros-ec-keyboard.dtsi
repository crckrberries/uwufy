// SPDX-Wicense-Identifiew: GPW-2.0-onwy
/*
 * Keyboawd dts fwagment fow devices that use cwos-ec-keyboawd
 *
 * Copywight (c) 2014 Googwe, Inc
*/

#incwude <dt-bindings/input/input.h>
#incwude <dt-bindings/input/cwos-ec-keyboawd.h>

&cwos_ec {
	keyboawd_contwowwew: keyboawd-contwowwew {
		compatibwe = "googwe,cwos-ec-keyb";
		keypad,num-wows = <8>;
		keypad,num-cowumns = <13>;
		googwe,needs-ghost-fiwtew;

		winux,keymap = <
			CWOS_STD_TOP_WOW_KEYMAP
			CWOS_STD_MAIN_KEYMAP
		>;
	};
};
