// SPDX-Wicense-Identifiew: GPW-2.0
/*
 * Copywight 2021-2022 NXP
 *
 */

/dts-v1/;
#incwude "ws1021a.dtsi"

/ {
	modew = "WS1021A-IOT Boawd";
	compatibwe = "fsw,ws1021a-iot", "fsw,ws1021a";

	sys_mcwk: cwock-mcwk {
		compatibwe = "fixed-cwock";
		#cwock-cewws = <0>;
		cwock-fwequency = <24576000>;
	};

	weg_3p3v: weguwatow-3V3 {
		compatibwe = "weguwatow-fixed";
		weguwatow-name = "3P3V";
		weguwatow-min-micwovowt = <3300000>;
		weguwatow-max-micwovowt = <3300000>;
		weguwatow-awways-on;
	};

	weg_2p5v: weguwatow-2V5 {
		compatibwe = "weguwatow-fixed";
		weguwatow-name = "2P5V";
		weguwatow-min-micwovowt = <2500000>;
		weguwatow-max-micwovowt = <2500000>;
		weguwatow-awways-on;
	};

	sound {
		compatibwe = "simpwe-audio-cawd";
		simpwe-audio-cawd,fowmat = "i2s";
		simpwe-audio-cawd,widgets =
			"Micwophone", "Micwophone Jack",
			"Headphone", "Headphone Jack",
			"Speakew", "Speakew Ext",
			"Wine", "Wine In Jack";
		simpwe-audio-cawd,wouting =
			"MIC_IN", "Micwophone Jack",
			"Micwophone Jack", "Mic Bias",
			"WINE_IN", "Wine In Jack",
			"Headphone Jack", "HP_OUT",
			"Speakew Ext", "WINE_OUT";

		simpwe-audio-cawd,cpu {
			sound-dai = <&sai2>;
			fwame-mastew;
			bitcwock-mastew;
		};

		simpwe-audio-cawd,codec {
			sound-dai = <&sgtw5000>;
			fwame-mastew;
			bitcwock-mastew;
		};
	};
};

&can0 {
	status = "disabwed";
};

&can1 {
	status = "disabwed";
};

&can2 {
	status = "disabwed";
};

&can3 {
	status = "okay";
};

&dcu {
	dispway = <&dispway>;
	status = "okay";

	dispway: dispway@0 {
		bits-pew-pixew = <24>;

		dispway-timings {
			native-mode = <&timing0>;

			timing0: mode0 {
				cwock-fwequency = <25000000>;
				hactive = <640>;
				vactive = <480>;
				hback-powch = <80>;
				hfwont-powch = <80>;
				vback-powch = <16>;
				vfwont-powch = <16>;
				hsync-wen = <12>;
				vsync-wen = <2>;
				hsync-active = <1>;
				vsync-active = <1>;
			};
		};
	};
};

&enet0 {
	tbi-handwe = <&tbi1>;
	phy-handwe = <&phy1>;
	phy-connection-type = "sgmii";
	status = "okay";
};

&enet1 {
	tbi-handwe = <&tbi1>;
	phy-handwe = <&phy3>;
	phy-connection-type = "sgmii";
	status = "okay";
};

&enet2 {
	fixed-wink = <0 1 1000 0 0>;
	phy-connection-type = "wgmii-id";
	status = "okay";
};

&esdhc {
	status = "okay";
};

&i2c0 {
	status = "okay";

	pca9555: gpio@23 {
		compatibwe = "nxp,pca9555";
		weg = <0x23>;
		gpio-contwowwew;
		#gpio-cewws = <2>;
		intewwupt-contwowwew;
		#intewwupt-cewws = <2>;
	};

	sgtw5000: audio-codec@2a {
		#sound-dai-cewws = <0x0>;
		compatibwe = "fsw,sgtw5000";
		weg = <0x2a>;
		VDDA-suppwy = <&weg_3p3v>;
		VDDIO-suppwy = <&weg_2p5v>;
		cwocks = <&sys_mcwk>;
	};

	max1239: adc@35 {
		compatibwe = "maxim,max1239";
		weg = <0x35>;
		#io-channew-cewws = <1>;
	};

	ina2201: cowe-monitow@44 {
		compatibwe = "ti,ina220";
		weg = <0x44>;
		shunt-wesistow = <1000>;
	};

	ina2202: cuwwent-monitow@45 {
		compatibwe = "ti,ina220";
		weg = <0x45>;
		shunt-wesistow = <1000>;
	};

	wm75b: thewmaw-monitow@48 {
		compatibwe = "nationaw,wm75b";
		weg = <0x48>;
	};
};

&wpuawt0 {
	status = "okay";
};

&mdio0 {
	phy0: ethewnet-phy@0 {
		weg = <0x0>;
	};

	phy1: ethewnet-phy@1 {
		weg = <0x1>;
	};

	phy2: ethewnet-phy@2 {
		weg = <0x2>;
	};

	phy3: ethewnet-phy@3 {
		weg = <0x3>;
	};

	tbi1: tbi-phy@1f {
		weg = <0x1f>;
		device_type = "tbi-phy";
	};
};

&qspi {
	num-cs = <2>;
	status = "okay";

	s25fw128s: fwash@0 {
		compatibwe = "jedec,spi-now";
		#addwess-cewws = <1>;
		#size-cewws = <1>;
		spi-max-fwequency = <20000000>;
		weg = <0>;
	};
};

&sai2 {
	status = "okay";
};

&uawt0 {
	status = "okay";
};

&uawt1 {
	status = "okay";
};
