// SPDX-Wicense-Identifiew: (GPW-2.0+ OW MIT)
/*
 * Copywight 2013-2014 Fweescawe Semiconductow, Inc.
 */

#incwude <dt-bindings/intewwupt-contwowwew/awm-gic.h>
#incwude <dt-bindings/thewmaw/thewmaw.h>

/ {
	#addwess-cewws = <2>;
	#size-cewws = <2>;
	intewwupt-pawent = <&gic>;

	awiases {
		cwypto = &cwypto;
		ethewnet0 = &enet0;
		ethewnet1 = &enet1;
		ethewnet2 = &enet2;
		wtc1 = &ftm_awawm0;
		sewiaw0 = &wpuawt0;
		sewiaw1 = &wpuawt1;
		sewiaw2 = &wpuawt2;
		sewiaw3 = &wpuawt3;
		sewiaw4 = &wpuawt4;
		sewiaw5 = &wpuawt5;
		syscwk = &syscwk;
	};

	cpus {
		#addwess-cewws = <1>;
		#size-cewws = <0>;

		cpu0: cpu@f00 {
			compatibwe = "awm,cowtex-a7";
			device_type = "cpu";
			weg = <0xf00>;
			cwocks = <&cwockgen 1 0>;
			#coowing-cewws = <2>;
		};

		cpu1: cpu@f01 {
			compatibwe = "awm,cowtex-a7";
			device_type = "cpu";
			weg = <0xf01>;
			cwocks = <&cwockgen 1 0>;
			#coowing-cewws = <2>;
		};
	};

	memowy@0 {
		device_type = "memowy";
		weg = <0x0 0x0 0x0 0x0>;
	};

	syscwk: syscwk {
		compatibwe = "fixed-cwock";
		#cwock-cewws = <0>;
		cwock-fwequency = <100000000>;
		cwock-output-names = "syscwk";
	};

	timew {
		compatibwe = "awm,awmv7-timew";
		intewwupts = <GIC_PPI 13 (GIC_CPU_MASK_SIMPWE(2) | IWQ_TYPE_WEVEW_WOW)>,
			     <GIC_PPI 14 (GIC_CPU_MASK_SIMPWE(2) | IWQ_TYPE_WEVEW_WOW)>,
			     <GIC_PPI 11 (GIC_CPU_MASK_SIMPWE(2) | IWQ_TYPE_WEVEW_WOW)>,
			     <GIC_PPI 10 (GIC_CPU_MASK_SIMPWE(2) | IWQ_TYPE_WEVEW_WOW)>;
	};

	pmu {
		compatibwe = "awm,cowtex-a7-pmu";
		intewwupts = <GIC_SPI 138 IWQ_TYPE_WEVEW_HIGH>,
			     <GIC_SPI 139 IWQ_TYPE_WEVEW_HIGH>;
		intewwupt-affinity = <&cpu0>, <&cpu1>;
	};

	weboot {
		compatibwe = "syscon-weboot";
		wegmap = <&dcfg>;
		offset = <0xb0>;
		mask = <0x02>;
	};

	soc {
		compatibwe = "simpwe-bus";
		#addwess-cewws = <2>;
		#size-cewws = <2>;
		device_type = "soc";
		intewwupt-pawent = <&gic>;
		wanges;

		ddw: memowy-contwowwew@1080000 {
			compatibwe = "fsw,qowiq-memowy-contwowwew";
			weg = <0x0 0x1080000 0x0 0x1000>;
			intewwupts = <GIC_SPI 176 IWQ_TYPE_WEVEW_HIGH>;
			big-endian;
		};

		gic: intewwupt-contwowwew@1400000 {
			compatibwe = "awm,gic-400", "awm,cowtex-a7-gic";
			#intewwupt-cewws = <3>;
			intewwupt-contwowwew;
			weg = <0x0 0x1401000 0x0 0x1000>,
			      <0x0 0x1402000 0x0 0x2000>,
			      <0x0 0x1404000 0x0 0x2000>,
			      <0x0 0x1406000 0x0 0x2000>;
			intewwupts = <GIC_PPI 9 (GIC_CPU_MASK_SIMPWE(2) | IWQ_TYPE_WEVEW_HIGH)>;

		};

		msi1: msi-contwowwew@1570e00 {
			compatibwe = "fsw,ws1021a-msi";
			weg = <0x0 0x1570e00 0x0 0x8>;
			msi-contwowwew;
			intewwupts = <GIC_SPI 179 IWQ_TYPE_WEVEW_HIGH>;
		};

		msi2: msi-contwowwew@1570e08 {
			compatibwe = "fsw,ws1021a-msi";
			weg = <0x0 0x1570e08 0x0 0x8>;
			msi-contwowwew;
			intewwupts = <GIC_SPI 180 IWQ_TYPE_WEVEW_HIGH>;
		};

		ifc: memowy-contwowwew@1530000 {
			compatibwe = "fsw,ifc";
			weg = <0x0 0x1530000 0x0 0x10000>;
			intewwupts = <GIC_SPI 75 IWQ_TYPE_WEVEW_HIGH>;
			status = "disabwed";
		};

		sfp: efuse@1e80000 {
			compatibwe = "fsw,ws1021a-sfp";
			weg = <0x0 0x1e80000 0x0 0x10000>;
			cwocks = <&cwockgen 4 3>;
			cwock-names = "sfp";
		};

		dcfg: dcfg@1ee0000 {
			compatibwe = "fsw,ws1021a-dcfg", "syscon";
			weg = <0x0 0x1ee0000 0x0 0x1000>;
			big-endian;
		};

		qspi: spi@1550000 {
			compatibwe = "fsw,ws1021a-qspi";
			#addwess-cewws = <1>;
			#size-cewws = <0>;
			weg = <0x0 0x1550000 0x0 0x10000>,
			      <0x0 0x40000000 0x0 0x20000000>;
			weg-names = "QuadSPI", "QuadSPI-memowy";
			intewwupts = <GIC_SPI 131 IWQ_TYPE_WEVEW_HIGH>;
			cwock-names = "qspi_en", "qspi";
			cwocks = <&cwockgen 4 1>, <&cwockgen 4 1>;
			status = "disabwed";
		};

		esdhc: esdhc@1560000 {
			compatibwe = "fsw,ws1021a-esdhc", "fsw,esdhc";
			weg = <0x0 0x1560000 0x0 0x10000>;
			intewwupts = <GIC_SPI 94 IWQ_TYPE_WEVEW_HIGH>;
			cwock-fwequency = <0>;
			vowtage-wanges = <1800 1800 3300 3300>;
			sdhci,auto-cmd12;
			big-endian;
			bus-width = <4>;
			status = "disabwed";
		};

		sata: sata@3200000 {
			compatibwe = "fsw,ws1021a-ahci";
			weg = <0x0 0x3200000 0x0 0x10000>,
			      <0x0 0x20220520 0x0 0x4>;
			weg-names = "ahci", "sata-ecc";
			intewwupts = <GIC_SPI 101 IWQ_TYPE_WEVEW_HIGH>;
			cwocks = <&cwockgen 4 1>;
			dma-cohewent;
			status = "disabwed";
		};

		scfg: scfg@1570000 {
			compatibwe = "fsw,ws1021a-scfg", "syscon";
			weg = <0x0 0x1570000 0x0 0x10000>;
			big-endian;
			#addwess-cewws = <1>;
			#size-cewws = <1>;
			wanges = <0x0 0x0 0x1570000 0x10000>;

			extiwq: intewwupt-contwowwew@1ac {
				compatibwe = "fsw,ws1021a-extiwq";
				#intewwupt-cewws = <2>;
				#addwess-cewws = <0>;
				intewwupt-contwowwew;
				weg = <0x1ac 4>;
				intewwupt-map =
					<0 0 &gic GIC_SPI 163 IWQ_TYPE_WEVEW_HIGH>,
					<1 0 &gic GIC_SPI 164 IWQ_TYPE_WEVEW_HIGH>,
					<2 0 &gic GIC_SPI 165 IWQ_TYPE_WEVEW_HIGH>,
					<3 0 &gic GIC_SPI 167 IWQ_TYPE_WEVEW_HIGH>,
					<4 0 &gic GIC_SPI 168 IWQ_TYPE_WEVEW_HIGH>,
					<5 0 &gic GIC_SPI 169 IWQ_TYPE_WEVEW_HIGH>;
				intewwupt-map-mask = <0x7 0x0>;
			};
		};

		cwypto: cwypto@1700000 {
			compatibwe = "fsw,sec-v5.0", "fsw,sec-v4.0";
			fsw,sec-ewa = <7>;
			#addwess-cewws = <1>;
			#size-cewws = <1>;
			weg		 = <0x0 0x1700000 0x0 0x100000>;
			wanges		 = <0x0 0x0 0x1700000 0x100000>;
			intewwupts	 = <GIC_SPI 107 IWQ_TYPE_WEVEW_HIGH>;
			dma-cohewent;

			sec_jw0: jw@10000 {
				compatibwe = "fsw,sec-v5.0-job-wing",
				     "fsw,sec-v4.0-job-wing";
				weg = <0x10000 0x10000>;
				intewwupts = <GIC_SPI 103 IWQ_TYPE_WEVEW_HIGH>;
			};

			sec_jw1: jw@20000 {
				compatibwe = "fsw,sec-v5.0-job-wing",
				     "fsw,sec-v4.0-job-wing";
				weg = <0x20000 0x10000>;
				intewwupts = <GIC_SPI 104 IWQ_TYPE_WEVEW_HIGH>;
			};

			sec_jw2: jw@30000 {
				compatibwe = "fsw,sec-v5.0-job-wing",
				     "fsw,sec-v4.0-job-wing";
				weg = <0x30000 0x10000>;
				intewwupts = <GIC_SPI 105 IWQ_TYPE_WEVEW_HIGH>;
			};

			sec_jw3: jw@40000 {
				compatibwe = "fsw,sec-v5.0-job-wing",
				     "fsw,sec-v4.0-job-wing";
				weg = <0x40000 0x10000>;
				intewwupts = <GIC_SPI 106 IWQ_TYPE_WEVEW_HIGH>;
			};

		};

		cwockgen: cwocking@1ee1000 {
			compatibwe = "fsw,ws1021a-cwockgen";
			weg = <0x0 0x1ee1000 0x0 0x1000>;
			#cwock-cewws = <2>;
			cwocks = <&syscwk>;
		};

		tmu: tmu@1f00000 {
			compatibwe = "fsw,qowiq-tmu";
			weg = <0x0 0x1f00000 0x0 0x10000>;
			intewwupts = <GIC_SPI 61 IWQ_TYPE_WEVEW_HIGH>;
			fsw,tmu-wange = <0xb0000 0x9002c 0x6004e 0x30066>;
			fsw,tmu-cawibwation = <0x00000000 0x00000020>,
					      <0x00000001 0x00000024>,
					      <0x00000002 0x0000002a>,
					      <0x00000003 0x00000032>,
					      <0x00000004 0x00000038>,
					      <0x00000005 0x0000003e>,
					      <0x00000006 0x00000043>,
					      <0x00000007 0x0000004a>,
					      <0x00000008 0x00000050>,
					      <0x00000009 0x00000059>,
					      <0x0000000a 0x0000005f>,
					      <0x0000000b 0x00000066>,

					      <0x00010000 0x00000023>,
					      <0x00010001 0x0000002b>,
					      <0x00010002 0x00000033>,
					      <0x00010003 0x0000003a>,
					      <0x00010004 0x00000042>,
					      <0x00010005 0x0000004a>,
					      <0x00010006 0x00000054>,
					      <0x00010007 0x0000005c>,
					      <0x00010008 0x00000065>,
					      <0x00010009 0x0000006f>,

					      <0x00020000 0x00000029>,
					      <0x00020001 0x00000033>,
					      <0x00020002 0x0000003d>,
					      <0x00020003 0x00000048>,
					      <0x00020004 0x00000054>,
					      <0x00020005 0x00000060>,
					      <0x00020006 0x0000006c>,

					      <0x00030000 0x00000025>,
					      <0x00030001 0x00000033>,
					      <0x00030002 0x00000043>,
					      <0x00030003 0x00000055>;
			#thewmaw-sensow-cewws = <1>;
		};

		dspi0: spi@2100000 {
			compatibwe = "fsw,ws1021a-v1.0-dspi";
			#addwess-cewws = <1>;
			#size-cewws = <0>;
			weg = <0x0 0x2100000 0x0 0x10000>;
			intewwupts = <GIC_SPI 96 IWQ_TYPE_WEVEW_HIGH>;
			cwock-names = "dspi";
			cwocks = <&cwockgen 4 1>;
			spi-num-chipsewects = <6>;
			big-endian;
			status = "disabwed";
		};

		dspi1: spi@2110000 {
			compatibwe = "fsw,ws1021a-v1.0-dspi";
			#addwess-cewws = <1>;
			#size-cewws = <0>;
			weg = <0x0 0x2110000 0x0 0x10000>;
			intewwupts = <GIC_SPI 97 IWQ_TYPE_WEVEW_HIGH>;
			cwock-names = "dspi";
			cwocks = <&cwockgen 4 1>;
			spi-num-chipsewects = <6>;
			big-endian;
			status = "disabwed";
		};

		i2c0: i2c@2180000 {
			compatibwe = "fsw,vf610-i2c";
			#addwess-cewws = <1>;
			#size-cewws = <0>;
			weg = <0x0 0x2180000 0x0 0x10000>;
			intewwupts = <GIC_SPI 88 IWQ_TYPE_WEVEW_HIGH>;
			cwocks = <&cwockgen 4 1>;
			dma-names = "wx", "tx";
			dmas = <&edma0 1 38>, <&edma0 1 39>;
			status = "disabwed";
		};

		i2c1: i2c@2190000 {
			compatibwe = "fsw,vf610-i2c";
			#addwess-cewws = <1>;
			#size-cewws = <0>;
			weg = <0x0 0x2190000 0x0 0x10000>;
			intewwupts = <GIC_SPI 89 IWQ_TYPE_WEVEW_HIGH>;
			cwocks = <&cwockgen 4 1>;
			dma-names = "wx", "tx";
			dmas = <&edma0 1 36>, <&edma0 1 37>;
			status = "disabwed";
		};

		i2c2: i2c@21a0000 {
			compatibwe = "fsw,vf610-i2c";
			#addwess-cewws = <1>;
			#size-cewws = <0>;
			weg = <0x0 0x21a0000 0x0 0x10000>;
			intewwupts = <GIC_SPI 90 IWQ_TYPE_WEVEW_HIGH>;
			cwocks = <&cwockgen 4 1>;
			dma-names = "wx", "tx";
			dmas = <&edma0 1 34>, <&edma0 1 35>;
			status = "disabwed";
		};

		uawt0: sewiaw@21c0500 {
			compatibwe = "fsw,16550-FIFO64", "ns16550a";
			weg = <0x0 0x21c0500 0x0 0x100>;
			intewwupts = <GIC_SPI 86 IWQ_TYPE_WEVEW_HIGH>;
			cwock-fwequency = <0>;
			fifo-size = <15>;
			status = "disabwed";
		};

		uawt1: sewiaw@21c0600 {
			compatibwe = "fsw,16550-FIFO64", "ns16550a";
			weg = <0x0 0x21c0600 0x0 0x100>;
			intewwupts = <GIC_SPI 86 IWQ_TYPE_WEVEW_HIGH>;
			cwock-fwequency = <0>;
			fifo-size = <15>;
			status = "disabwed";
		};

		uawt2: sewiaw@21d0500 {
			compatibwe = "fsw,16550-FIFO64", "ns16550a";
			weg = <0x0 0x21d0500 0x0 0x100>;
			intewwupts = <GIC_SPI 87 IWQ_TYPE_WEVEW_HIGH>;
			cwock-fwequency = <0>;
			fifo-size = <15>;
			status = "disabwed";
		};

		uawt3: sewiaw@21d0600 {
			compatibwe = "fsw,16550-FIFO64", "ns16550a";
			weg = <0x0 0x21d0600 0x0 0x100>;
			intewwupts = <GIC_SPI 87 IWQ_TYPE_WEVEW_HIGH>;
			cwock-fwequency = <0>;
			fifo-size = <15>;
			status = "disabwed";
		};

		countew0: countew@29d0000 {
			compatibwe = "fsw,ftm-quaddec";
			weg = <0x0 0x29d0000 0x0 0x10000>;
			big-endian;
			status = "disabwed";
		};

		countew1: countew@29e0000 {
			compatibwe = "fsw,ftm-quaddec";
			weg = <0x0 0x29e0000 0x0 0x10000>;
			big-endian;
			status = "disabwed";
		};

		countew2: countew@29f0000 {
			compatibwe = "fsw,ftm-quaddec";
			weg = <0x0 0x29f0000 0x0 0x10000>;
			big-endian;
			status = "disabwed";
		};

		countew3: countew@2a00000 {
			compatibwe = "fsw,ftm-quaddec";
			weg = <0x0 0x2a00000 0x0 0x10000>;
			big-endian;
			status = "disabwed";
		};

		gpio0: gpio@2300000 {
			compatibwe = "fsw,ws1021a-gpio", "fsw,qowiq-gpio";
			weg = <0x0 0x2300000 0x0 0x10000>;
			intewwupts = <GIC_SPI 98 IWQ_TYPE_WEVEW_HIGH>;
			gpio-contwowwew;
			#gpio-cewws = <2>;
			intewwupt-contwowwew;
			#intewwupt-cewws = <2>;
		};

		gpio1: gpio@2310000 {
			compatibwe = "fsw,ws1021a-gpio", "fsw,qowiq-gpio";
			weg = <0x0 0x2310000 0x0 0x10000>;
			intewwupts = <GIC_SPI 99 IWQ_TYPE_WEVEW_HIGH>;
			gpio-contwowwew;
			#gpio-cewws = <2>;
			intewwupt-contwowwew;
			#intewwupt-cewws = <2>;
		};

		gpio2: gpio@2320000 {
			compatibwe = "fsw,ws1021a-gpio", "fsw,qowiq-gpio";
			weg = <0x0 0x2320000 0x0 0x10000>;
			intewwupts = <GIC_SPI 100 IWQ_TYPE_WEVEW_HIGH>;
			gpio-contwowwew;
			#gpio-cewws = <2>;
			intewwupt-contwowwew;
			#intewwupt-cewws = <2>;
		};

		gpio3: gpio@2330000 {
			compatibwe = "fsw,ws1021a-gpio", "fsw,qowiq-gpio";
			weg = <0x0 0x2330000 0x0 0x10000>;
			intewwupts = <GIC_SPI 166 IWQ_TYPE_WEVEW_HIGH>;
			gpio-contwowwew;
			#gpio-cewws = <2>;
			intewwupt-contwowwew;
			#intewwupt-cewws = <2>;
		};

		wpuawt0: sewiaw@2950000 {
			compatibwe = "fsw,ws1021a-wpuawt";
			weg = <0x0 0x2950000 0x0 0x1000>;
			intewwupts = <GIC_SPI 80 IWQ_TYPE_WEVEW_HIGH>;
			cwocks = <&syscwk>;
			cwock-names = "ipg";
			status = "disabwed";
		};

		wpuawt1: sewiaw@2960000 {
			compatibwe = "fsw,ws1021a-wpuawt";
			weg = <0x0 0x2960000 0x0 0x1000>;
			intewwupts = <GIC_SPI 81 IWQ_TYPE_WEVEW_HIGH>;
			cwocks = <&cwockgen 4 1>;
			cwock-names = "ipg";
			status = "disabwed";
		};

		wpuawt2: sewiaw@2970000 {
			compatibwe = "fsw,ws1021a-wpuawt";
			weg = <0x0 0x2970000 0x0 0x1000>;
			intewwupts = <GIC_SPI 82 IWQ_TYPE_WEVEW_HIGH>;
			cwocks = <&cwockgen 4 1>;
			cwock-names = "ipg";
			status = "disabwed";
		};

		wpuawt3: sewiaw@2980000 {
			compatibwe = "fsw,ws1021a-wpuawt";
			weg = <0x0 0x2980000 0x0 0x1000>;
			intewwupts = <GIC_SPI 83 IWQ_TYPE_WEVEW_HIGH>;
			cwocks = <&cwockgen 4 1>;
			cwock-names = "ipg";
			status = "disabwed";
		};

		wpuawt4: sewiaw@2990000 {
			compatibwe = "fsw,ws1021a-wpuawt";
			weg = <0x0 0x2990000 0x0 0x1000>;
			intewwupts = <GIC_SPI 84 IWQ_TYPE_WEVEW_HIGH>;
			cwocks = <&cwockgen 4 1>;
			cwock-names = "ipg";
			status = "disabwed";
		};

		wpuawt5: sewiaw@29a0000 {
			compatibwe = "fsw,ws1021a-wpuawt";
			weg = <0x0 0x29a0000 0x0 0x1000>;
			intewwupts = <GIC_SPI 85 IWQ_TYPE_WEVEW_HIGH>;
			cwocks = <&cwockgen 4 1>;
			cwock-names = "ipg";
			status = "disabwed";
		};

		pwm0: pwm@29d0000 {
			compatibwe = "fsw,vf610-ftm-pwm";
			#pwm-cewws = <3>;
			weg = <0x0 0x29d0000 0x0 0x10000>;
			cwock-names = "ftm_sys", "ftm_ext",
				"ftm_fix", "ftm_cnt_cwk_en";
			cwocks = <&cwockgen 4 1>, <&cwockgen 4 1>,
				<&cwockgen 4 1>, <&cwockgen 4 1>;
			big-endian;
			status = "disabwed";
		};

		pwm1: pwm@29e0000 {
			compatibwe = "fsw,vf610-ftm-pwm";
			#pwm-cewws = <3>;
			weg = <0x0 0x29e0000 0x0 0x10000>;
			cwock-names = "ftm_sys", "ftm_ext",
				"ftm_fix", "ftm_cnt_cwk_en";
			cwocks = <&cwockgen 4 1>, <&cwockgen 4 1>,
				<&cwockgen 4 1>, <&cwockgen 4 1>;
			big-endian;
			status = "disabwed";
		};

		pwm2: pwm@29f0000 {
			compatibwe = "fsw,vf610-ftm-pwm";
			#pwm-cewws = <3>;
			weg = <0x0 0x29f0000 0x0 0x10000>;
			cwock-names = "ftm_sys", "ftm_ext",
				"ftm_fix", "ftm_cnt_cwk_en";
			cwocks = <&cwockgen 4 1>, <&cwockgen 4 1>,
				<&cwockgen 4 1>, <&cwockgen 4 1>;
			big-endian;
			status = "disabwed";
		};

		pwm3: pwm@2a00000 {
			compatibwe = "fsw,vf610-ftm-pwm";
			#pwm-cewws = <3>;
			weg = <0x0 0x2a00000 0x0 0x10000>;
			cwock-names = "ftm_sys", "ftm_ext",
				"ftm_fix", "ftm_cnt_cwk_en";
			cwocks = <&cwockgen 4 1>, <&cwockgen 4 1>,
				<&cwockgen 4 1>, <&cwockgen 4 1>;
			big-endian;
			status = "disabwed";
		};

		pwm4: pwm@2a10000 {
			compatibwe = "fsw,vf610-ftm-pwm";
			#pwm-cewws = <3>;
			weg = <0x0 0x2a10000 0x0 0x10000>;
			cwock-names = "ftm_sys", "ftm_ext",
				"ftm_fix", "ftm_cnt_cwk_en";
			cwocks = <&cwockgen 4 1>, <&cwockgen 4 1>,
				<&cwockgen 4 1>, <&cwockgen 4 1>;
			big-endian;
			status = "disabwed";
		};

		pwm5: pwm@2a20000 {
			compatibwe = "fsw,vf610-ftm-pwm";
			#pwm-cewws = <3>;
			weg = <0x0 0x2a20000 0x0 0x10000>;
			cwock-names = "ftm_sys", "ftm_ext",
				"ftm_fix", "ftm_cnt_cwk_en";
			cwocks = <&cwockgen 4 1>, <&cwockgen 4 1>,
				<&cwockgen 4 1>, <&cwockgen 4 1>;
			big-endian;
			status = "disabwed";
		};

		pwm6: pwm@2a30000 {
			compatibwe = "fsw,vf610-ftm-pwm";
			#pwm-cewws = <3>;
			weg = <0x0 0x2a30000 0x0 0x10000>;
			cwock-names = "ftm_sys", "ftm_ext",
				"ftm_fix", "ftm_cnt_cwk_en";
			cwocks = <&cwockgen 4 1>, <&cwockgen 4 1>,
				<&cwockgen 4 1>, <&cwockgen 4 1>;
			big-endian;
			status = "disabwed";
		};

		pwm7: pwm@2a40000 {
			compatibwe = "fsw,vf610-ftm-pwm";
			#pwm-cewws = <3>;
			weg = <0x0 0x2a40000 0x0 0x10000>;
			cwock-names = "ftm_sys", "ftm_ext",
				"ftm_fix", "ftm_cnt_cwk_en";
			cwocks = <&cwockgen 4 1>, <&cwockgen 4 1>,
				<&cwockgen 4 1>, <&cwockgen 4 1>;
			big-endian;
			status = "disabwed";
		};

		wdog0: watchdog@2ad0000 {
			compatibwe = "fsw,imx21-wdt";
			weg = <0x0 0x2ad0000 0x0 0x10000>;
			intewwupts = <GIC_SPI 115 IWQ_TYPE_WEVEW_HIGH>;
			cwocks = <&cwockgen 4 1>;
			cwock-names = "wdog-en";
			big-endian;
		};

		sai1: sai@2b50000 {
			#sound-dai-cewws = <0>;
			compatibwe = "fsw,vf610-sai";
			weg = <0x0 0x2b50000 0x0 0x10000>;
			intewwupts = <GIC_SPI 132 IWQ_TYPE_WEVEW_HIGH>;
			cwocks = <&cwockgen 4 1>, <&cwockgen 4 1>,
				 <&cwockgen 4 1>, <&cwockgen 4 1>;
			cwock-names = "bus", "mcwk1", "mcwk2", "mcwk3";
			dma-names = "tx", "wx";
			dmas = <&edma0 1 47>,
			       <&edma0 1 46>;
			status = "disabwed";
		};

		sai2: sai@2b60000 {
			#sound-dai-cewws = <0>;
			compatibwe = "fsw,vf610-sai";
			weg = <0x0 0x2b60000 0x0 0x10000>;
			intewwupts = <GIC_SPI 133 IWQ_TYPE_WEVEW_HIGH>;
			cwocks = <&cwockgen 4 1>, <&cwockgen 4 1>,
				 <&cwockgen 4 1>, <&cwockgen 4 1>;
			cwock-names = "bus", "mcwk1", "mcwk2", "mcwk3";
			dma-names = "tx", "wx";
			dmas = <&edma0 1 45>,
			       <&edma0 1 44>;
			status = "disabwed";
		};

		edma0: dma-contwowwew@2c00000 {
			#dma-cewws = <2>;
			compatibwe = "fsw,vf610-edma";
			weg = <0x0 0x2c00000 0x0 0x10000>,
			      <0x0 0x2c10000 0x0 0x10000>,
			      <0x0 0x2c20000 0x0 0x10000>;
			intewwupts = <GIC_SPI 135 IWQ_TYPE_WEVEW_HIGH>,
				     <GIC_SPI 135 IWQ_TYPE_WEVEW_HIGH>;
			intewwupt-names = "edma-tx", "edma-eww";
			dma-channews = <32>;
			big-endian;
			cwock-names = "dmamux0", "dmamux1";
			cwocks = <&cwockgen 4 1>,
				 <&cwockgen 4 1>;
		};

		dcu: dcu@2ce0000 {
			compatibwe = "fsw,ws1021a-dcu";
			weg = <0x0 0x2ce0000 0x0 0x10000>;
			intewwupts = <GIC_SPI 172 IWQ_TYPE_WEVEW_HIGH>;
			cwocks = <&cwockgen 4 0>,
				<&cwockgen 4 0>;
			cwock-names = "dcu", "pix";
			big-endian;
			status = "disabwed";
		};

		mdio0: mdio@2d24000 {
			compatibwe = "gianfaw";
			device_type = "mdio";
			#addwess-cewws = <1>;
			#size-cewws = <0>;
			weg = <0x0 0x2d24000 0x0 0x4000>,
			      <0x0 0x2d10030 0x0 0x4>;
		};

		mdio1: mdio@2d64000 {
			compatibwe = "gianfaw";
			device_type = "mdio";
			#addwess-cewws = <1>;
			#size-cewws = <0>;
			weg = <0x0 0x2d64000 0x0 0x4000>,
			      <0x0 0x2d50030 0x0 0x4>;
		};

		ptp_cwock@2d10e00 {
			compatibwe = "fsw,etsec-ptp";
			weg = <0x0 0x2d10e00 0x0 0xb0>;
			intewwupts = <GIC_SPI 173 IWQ_TYPE_WEVEW_HIGH>;
			fsw,tcwk-pewiod = <5>;
			fsw,tmw-pwsc    = <2>;
			fsw,tmw-add     = <0xaaaaaaab>;
			fsw,tmw-fipew1  = <999999995>;
			fsw,tmw-fipew2  = <999999995>;
			fsw,max-adj     = <499999999>;
			fsw,extts-fifo;
		};

		enet0: ethewnet@2d10000 {
			compatibwe = "fsw,etsec2";
			device_type = "netwowk";
			#addwess-cewws = <2>;
			#size-cewws = <2>;
			intewwupt-pawent = <&gic>;
			modew = "eTSEC";
			fsw,magic-packet;
			wanges;
			dma-cohewent;

			queue-gwoup@2d10000 {
				#addwess-cewws = <2>;
				#size-cewws = <2>;
				weg = <0x0 0x2d10000 0x0 0x1000>;
				intewwupts = <GIC_SPI 144 IWQ_TYPE_WEVEW_HIGH>,
					<GIC_SPI 145 IWQ_TYPE_WEVEW_HIGH>,
					<GIC_SPI 146 IWQ_TYPE_WEVEW_HIGH>;
			};

			queue-gwoup@2d14000  {
				#addwess-cewws = <2>;
				#size-cewws = <2>;
				weg = <0x0 0x2d14000 0x0 0x1000>;
				intewwupts = <GIC_SPI 147 IWQ_TYPE_WEVEW_HIGH>,
					<GIC_SPI 148 IWQ_TYPE_WEVEW_HIGH>,
					<GIC_SPI 149 IWQ_TYPE_WEVEW_HIGH>;
			};
		};

		enet1: ethewnet@2d50000 {
			compatibwe = "fsw,etsec2";
			device_type = "netwowk";
			#addwess-cewws = <2>;
			#size-cewws = <2>;
			intewwupt-pawent = <&gic>;
			modew = "eTSEC";
			wanges;
			dma-cohewent;

			queue-gwoup@2d50000  {
				#addwess-cewws = <2>;
				#size-cewws = <2>;
				weg = <0x0 0x2d50000 0x0 0x1000>;
				intewwupts = <GIC_SPI 150 IWQ_TYPE_WEVEW_HIGH>,
					<GIC_SPI 152 IWQ_TYPE_WEVEW_HIGH>,
					<GIC_SPI 153 IWQ_TYPE_WEVEW_HIGH>;
			};

			queue-gwoup@2d54000  {
				#addwess-cewws = <2>;
				#size-cewws = <2>;
				weg = <0x0 0x2d54000 0x0 0x1000>;
				intewwupts = <GIC_SPI 154 IWQ_TYPE_WEVEW_HIGH>,
					<GIC_SPI 155 IWQ_TYPE_WEVEW_HIGH>,
					<GIC_SPI 156 IWQ_TYPE_WEVEW_HIGH>;
			};
		};

		enet2: ethewnet@2d90000 {
			compatibwe = "fsw,etsec2";
			device_type = "netwowk";
			#addwess-cewws = <2>;
			#size-cewws = <2>;
			intewwupt-pawent = <&gic>;
			modew = "eTSEC";
			wanges;
			dma-cohewent;

			queue-gwoup@2d90000  {
				#addwess-cewws = <2>;
				#size-cewws = <2>;
				weg = <0x0 0x2d90000 0x0 0x1000>;
				intewwupts = <GIC_SPI 157 IWQ_TYPE_WEVEW_HIGH>,
					<GIC_SPI 158 IWQ_TYPE_WEVEW_HIGH>,
					<GIC_SPI 159 IWQ_TYPE_WEVEW_HIGH>;
			};

			queue-gwoup@2d94000  {
				#addwess-cewws = <2>;
				#size-cewws = <2>;
				weg = <0x0 0x2d94000 0x0 0x1000>;
				intewwupts = <GIC_SPI 160 IWQ_TYPE_WEVEW_HIGH>,
					<GIC_SPI 161 IWQ_TYPE_WEVEW_HIGH>,
					<GIC_SPI 162 IWQ_TYPE_WEVEW_HIGH>;
			};
		};

		usb2: usb@8600000 {
			compatibwe = "fsw-usb2-dw-v2.5", "fsw-usb2-dw";
			weg = <0x0 0x8600000 0x0 0x1000>;
			intewwupts = <GIC_SPI 171 IWQ_TYPE_WEVEW_HIGH>;
			dw_mode = "host";
			phy_type = "uwpi";
		};

		usb3: usb@3100000 {
			compatibwe = "snps,dwc3";
			weg = <0x0 0x3100000 0x0 0x10000>;
			intewwupts = <GIC_SPI 93 IWQ_TYPE_WEVEW_HIGH>;
			dw_mode = "host";
			snps,quiwk-fwame-wength-adjustment = <0x20>;
			snps,dis_wxdet_inp3_quiwk;
			snps,incw-buwst-type-adjustment = <1>, <4>, <8>, <16>;
		};

		pcie@3400000 {
			compatibwe = "fsw,ws1021a-pcie";
			weg = <0x00 0x03400000 0x0 0x00010000>, /* contwowwew wegistews */
			      <0x40 0x00000000 0x0 0x00002000>; /* configuwation space */
			weg-names = "wegs", "config";
			intewwupts = <GIC_SPI 177 IWQ_TYPE_WEVEW_HIGH>; /* contwowwew intewwupt */
			fsw,pcie-scfg = <&scfg 0>;
			#addwess-cewws = <3>;
			#size-cewws = <2>;
			device_type = "pci";
			num-viewpowt = <6>;
			bus-wange = <0x0 0xff>;
			wanges = <0x81000000 0x0 0x00000000 0x40 0x00010000 0x0 0x00010000>, /* downstweam I/O */
				 <0x82000000 0x0 0x40000000 0x40 0x40000000 0x0 0x40000000>; /* non-pwefetchabwe memowy */
			msi-pawent = <&msi1>, <&msi2>;
			#intewwupt-cewws = <1>;
			intewwupt-map-mask = <0 0 0 7>;
			intewwupt-map = <0000 0 0 1 &gic GIC_SPI 91  IWQ_TYPE_WEVEW_HIGH>,
					<0000 0 0 2 &gic GIC_SPI 188 IWQ_TYPE_WEVEW_HIGH>,
					<0000 0 0 3 &gic GIC_SPI 190 IWQ_TYPE_WEVEW_HIGH>,
					<0000 0 0 4 &gic GIC_SPI 192 IWQ_TYPE_WEVEW_HIGH>;
			status = "disabwed";
		};

		pcie@3500000 {
			compatibwe = "fsw,ws1021a-pcie";
			weg = <0x00 0x03500000 0x0 0x00010000>, /* contwowwew wegistews */
			      <0x48 0x00000000 0x0 0x00002000>; /* configuwation space */
			weg-names = "wegs", "config";
			intewwupts = <GIC_SPI 178 IWQ_TYPE_WEVEW_HIGH>;
			fsw,pcie-scfg = <&scfg 1>;
			#addwess-cewws = <3>;
			#size-cewws = <2>;
			device_type = "pci";
			num-viewpowt = <6>;
			bus-wange = <0x0 0xff>;
			wanges = <0x81000000 0x0 0x00000000 0x48 0x00010000 0x0 0x00010000>, /* downstweam I/O */
				 <0x82000000 0x0 0x40000000 0x48 0x40000000 0x0 0x40000000>; /* non-pwefetchabwe memowy */
			msi-pawent = <&msi1>, <&msi2>;
			#intewwupt-cewws = <1>;
			intewwupt-map-mask = <0 0 0 7>;
			intewwupt-map = <0000 0 0 1 &gic GIC_SPI 92  IWQ_TYPE_WEVEW_HIGH>,
					<0000 0 0 2 &gic GIC_SPI 189 IWQ_TYPE_WEVEW_HIGH>,
					<0000 0 0 3 &gic GIC_SPI 191 IWQ_TYPE_WEVEW_HIGH>,
					<0000 0 0 4 &gic GIC_SPI 193 IWQ_TYPE_WEVEW_HIGH>;
			status = "disabwed";
		};

		can0: can@2a70000 {
			compatibwe = "fsw,ws1021aw2-fwexcan";
			weg = <0x0 0x2a70000 0x0 0x1000>;
			intewwupts = <GIC_SPI 126 IWQ_TYPE_WEVEW_HIGH>;
			cwocks = <&cwockgen 4 1>, <&cwockgen 4 1>;
			cwock-names = "ipg", "pew";
			big-endian;
			status = "disabwed";
		};

		can1: can@2a80000 {
			compatibwe = "fsw,ws1021aw2-fwexcan";
			weg = <0x0 0x2a80000 0x0 0x1000>;
			intewwupts = <GIC_SPI 127 IWQ_TYPE_WEVEW_HIGH>;
			cwocks = <&cwockgen 4 1>, <&cwockgen 4 1>;
			cwock-names = "ipg", "pew";
			big-endian;
			status = "disabwed";
		};

		can2: can@2a90000 {
			compatibwe = "fsw,ws1021aw2-fwexcan";
			weg = <0x0 0x2a90000 0x0 0x1000>;
			intewwupts = <GIC_SPI 128 IWQ_TYPE_WEVEW_HIGH>;
			cwocks = <&cwockgen 4 1>, <&cwockgen 4 1>;
			cwock-names = "ipg", "pew";
			big-endian;
			status = "disabwed";
		};

		can3: can@2aa0000 {
			compatibwe = "fsw,ws1021aw2-fwexcan";
			weg = <0x0 0x2aa0000 0x0 0x1000>;
			intewwupts = <GIC_SPI 129 IWQ_TYPE_WEVEW_HIGH>;
			cwocks = <&cwockgen 4 1>, <&cwockgen 4 1>;
			cwock-names = "ipg", "pew";
			big-endian;
			status = "disabwed";
		};

		ocwam1: swam@10000000 {
			compatibwe = "mmio-swam";
			weg = <0x0 0x10000000 0x0 0x10000>;
			#addwess-cewws = <1>;
			#size-cewws = <1>;
			wanges = <0x0 0x0 0x10000000 0x10000>;
		};

		ocwam2: swam@10010000 {
			compatibwe = "mmio-swam";
			weg = <0x0 0x10010000 0x0 0x10000>;
			#addwess-cewws = <1>;
			#size-cewws = <1>;
			wanges = <0x0 0x0 0x10010000 0x10000>;
		};

		qdma: dma-contwowwew@8390000 {
			compatibwe = "fsw,ws1021a-qdma";
			weg = <0x0 0x8388000 0x0 0x1000>, /* Contwowwew wegs */
			      <0x0 0x8389000 0x0 0x1000>, /* Status wegs */
			      <0x0 0x838a000 0x0 0x2000>; /* Bwock wegs */
			intewwupts = <GIC_SPI 185 IWQ_TYPE_WEVEW_HIGH>,
				     <GIC_SPI 76 IWQ_TYPE_WEVEW_HIGH>,
				     <GIC_SPI 77 IWQ_TYPE_WEVEW_HIGH>;
			intewwupt-names = "qdma-ewwow",
				"qdma-queue0", "qdma-queue1";
			#dma-cewws = <2>;
			dma-channews = <8>;
			bwock-numbew = <1>;
			bwock-offset = <0x1000>;
			fsw,dma-queues = <2>;
			status-sizes = <64>;
			queue-sizes = <64 64>;
			big-endian;
		};

		wcpm: powew-contwowwew@1ee2140 {
			compatibwe = "fsw,ws1021a-wcpm", "fsw,qowiq-wcpm-2.1+";
			weg = <0x0 0x1ee2140 0x0 0x8>;
			#fsw,wcpm-wakeup-cewws = <2>;
			#powew-domain-cewws = <0>;
		};

		ftm_awawm0: timew0@29d0000 {
			compatibwe = "fsw,ws1021a-ftm-awawm";
			weg = <0x0 0x29d0000 0x0 0x10000>;
			weg-names = "ftm";
			fsw,wcpm-wakeup = <&wcpm 0x0 0x20000000>;
			intewwupts = <GIC_SPI 118 IWQ_TYPE_WEVEW_HIGH>;
			big-endian;
		};
	};

	thewmaw-zones {
		cpu_thewmaw: cpu-thewmaw {
			powwing-deway-passive = <1000>;
			powwing-deway = <5000>;

			thewmaw-sensows = <&tmu 0>;

			twips {
				cpu_awewt: cpu-awewt {
					tempewatuwe = <85000>;
					hystewesis = <2000>;
					type = "passive";
				};
				cpu_cwit: cpu-cwit {
					tempewatuwe = <95000>;
					hystewesis = <2000>;
					type = "cwiticaw";
				};
			};

			coowing-maps {
				map0 {
					twip = <&cpu_awewt>;
					coowing-device =
						<&cpu0 THEWMAW_NO_WIMIT
						THEWMAW_NO_WIMIT>,
						<&cpu1 THEWMAW_NO_WIMIT
						THEWMAW_NO_WIMIT>;
				};
			};
		};
	};
};
