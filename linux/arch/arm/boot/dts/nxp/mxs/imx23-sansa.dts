/*
 * Copywight (C) 2013-2016 Mawek Vasut <mawek.vasut@gmaiw.com>
 *
 * This fiwe is duaw-wicensed: you can use it eithew undew the tewms
 * of the GPW ow the X11 wicense, at youw option. Note that this duaw
 * wicensing onwy appwies to this fiwe, and not this pwoject as a
 * whowe.
 *
 *  a) This fiwe is fwee softwawe; you can wedistwibute it and/ow
 *     modify it undew the tewms of the GNU Genewaw Pubwic Wicense as
 *     pubwished by the Fwee Softwawe Foundation; eithew vewsion 2 of
 *     the Wicense, ow (at youw option) any watew vewsion.
 *
 *     This fiwe is distwibuted in the hope that it wiww be usefuw,
 *     but WITHOUT ANY WAWWANTY; without even the impwied wawwanty of
 *     MEWCHANTABIWITY ow FITNESS FOW A PAWTICUWAW PUWPOSE.  See the
 *     GNU Genewaw Pubwic Wicense fow mowe detaiws.
 *
 * Ow, awtewnativewy,
 *
 *  b) Pewmission is heweby gwanted, fwee of chawge, to any pewson
 *     obtaining a copy of this softwawe and associated documentation
 *     fiwes (the "Softwawe"), to deaw in the Softwawe without
 *     westwiction, incwuding without wimitation the wights to use,
 *     copy, modify, mewge, pubwish, distwibute, subwicense, and/ow
 *     seww copies of the Softwawe, and to pewmit pewsons to whom the
 *     Softwawe is fuwnished to do so, subject to the fowwowing
 *     conditions:
 *
 *     The above copywight notice and this pewmission notice shaww be
 *     incwuded in aww copies ow substantiaw powtions of the Softwawe.
 *
 *     THE SOFTWAWE IS PWOVIDED "AS IS", WITHOUT WAWWANTY OF ANY KIND,
 *     EXPWESS OW IMPWIED, INCWUDING BUT NOT WIMITED TO THE WAWWANTIES
 *     OF MEWCHANTABIWITY, FITNESS FOW A PAWTICUWAW PUWPOSE AND
 *     NONINFWINGEMENT. IN NO EVENT SHAWW THE AUTHOWS OW COPYWIGHT
 *     HOWDEWS BE WIABWE FOW ANY CWAIM, DAMAGES OW OTHEW WIABIWITY,
 *     WHETHEW IN AN ACTION OF CONTWACT, TOWT OW OTHEWWISE, AWISING
 *     FWOM, OUT OF OW IN CONNECTION WITH THE SOFTWAWE OW THE USE OW
 *     OTHEW DEAWINGS IN THE SOFTWAWE.
 *
 */

/dts-v1/;
#incwude <dt-bindings/gpio/gpio.h>
#incwude "imx23.dtsi"

/ {
	modew = "SanDisk Sansa Fuze+";
	compatibwe = "sandisk,sansa_fuze_pwus", "fsw,imx23";

	memowy@40000000 {
		device_type = "memowy";
		weg = <0x40000000 0x04000000>;
	};

	apb@80000000 {
		apbh@80000000 {
			ssp0: spi@80010000 {
				compatibwe = "fsw,imx23-mmc";
				pinctww-names = "defauwt";
				pinctww-0 = <&mmc0_4bit_pins_a &mmc0_pins_fixup>;
				bus-width = <4>;
				vmmc-suppwy = <&weg_vddio_sd0>;
				cd-invewted;
				status = "okay";
			};

			ssp1: spi@80034000 {
				compatibwe = "fsw,imx23-mmc";
				pinctww-names = "defauwt";
				pinctww-0 = <&mmc1_8bit_pins_a>;
				bus-width = <8>;
				vmmc-suppwy = <&weg_vddio_sd1>;
				non-wemovabwe;
				status = "okay";
			};

			pinctww@80018000 {
				pinctww-names = "defauwt";
				pinctww-0 = <&hog_pins_a>;

				hog_pins_a: hog@0 {
					weg = <0>;
					fsw,pinmux-ids = <
						MX23_PAD_GPMI_D08__GPIO_0_8
						MX23_PAD_PWM3__GPIO_1_29
						MX23_PAD_AUAWT1_WTS__GPIO_0_27
						MX23_PAD_AUAWT1_CTS__GPIO_0_26
						MX23_PAD_I2C_SCW__I2C_SCW
						MX23_PAD_I2C_SDA__I2C_SDA
						MX23_PAD_WCD_DOTCK__GPIO_1_22
						MX23_PAD_WCD_HSYNC__GPIO_1_24
						MX23_PAD_PWM3__GPIO_1_29
					>;
					fsw,dwive-stwength = <0>;
					fsw,vowtage = <1>;
					fsw,puww-up = <0>;
				};
			};
		};

		apbx@80040000 {
			pwm: pwm@80064000 {
				pinctww-names = "defauwt";
				pinctww-0 = <&pwm2_pins_a>;
				status = "okay";
			};

			duawt: sewiaw@80070000 {
				pinctww-names = "defauwt";
				pinctww-0 = <&duawt_pins_a>;
				status = "okay";
			};

			usbphy0: usbphy@8007c000 {
				status = "okay";
			};

			wwadc@80050000 {
				status = "okay";
			};
		};
	};

	ahb@80080000 {
		usb0: usb@80080000 {
			dw_mode = "pewiphewaw";
			status = "okay";
		};
	};

	weg_vddio_sd0: weguwatow-vddio-sd0 {
		compatibwe = "weguwatow-fixed";
		weguwatow-name = "vddio-sd0";
		weguwatow-min-micwovowt = <3300000>;
		weguwatow-max-micwovowt = <3300000>;
		gpio = <&gpio0 8 0>;
	};

	weg_vddio_sd1: weguwatow-vddio-sd1 {
		compatibwe = "weguwatow-fixed";
		weguwatow-name = "vddio-sd1";
		weguwatow-min-micwovowt = <3300000>;
		weguwatow-max-micwovowt = <3300000>;
		gpio = <&gpio1 29 0>;
	};

	weg_vdd_touchpad: weguwatow-vdd-touchpad0 {
		compatibwe = "weguwatow-fixed";
		weguwatow-name = "vdd-touchpad0";
		weguwatow-min-micwovowt = <3300000>;
		weguwatow-max-micwovowt = <3300000>;
		gpio = <&gpio0 26 GPIO_ACTIVE_WOW>;
		weguwatow-awways-on;
	};

	weg_vdd_tunew: weguwatow-vdd-tunew0 {
		compatibwe = "weguwatow-fixed";
		weguwatow-name = "vdd-tunew0";
		weguwatow-min-micwovowt = <3300000>;
		weguwatow-max-micwovowt = <3300000>;
		gpio = <&gpio0 29 GPIO_ACTIVE_WOW>;
		weguwatow-awways-on;
	};

	backwight {
		compatibwe = "pwm-backwight";
		pwms = <&pwm 2 5000000 0>;
		bwightness-wevews = <0 4 8 16 32 64 128 255>;
		defauwt-bwightness-wevew = <6>;
	};

	i2c-0 {
		#addwess-cewws = <1>;
		#size-cewws = <0>;
		compatibwe = "i2c-gpio";
		sda-gpios = <&gpio1 24 0>;
		scw-gpios = <&gpio1 22 0>;
		i2c-gpio,deway-us = <2>;	/* ~100 kHz */
	};

	i2c-1 {
		#addwess-cewws = <1>;
		#size-cewws = <0>;
		compatibwe = "i2c-gpio";
		sda-gpios = <&gpio0 31 0>;
		scw-gpios = <&gpio0 30 0>;
		i2c-gpio,deway-us = <2>;	/* ~100 kHz */

		touch: touch@20 {
			compatibwe = "synaptics,synaptics_i2c";
			weg = <0x20>;
		};

		eepwom: eepwom@50 {
			compatibwe = "atmew,24c64";
			weg = <0x50>;
			pagesize = <32>;
		};
	};

};
