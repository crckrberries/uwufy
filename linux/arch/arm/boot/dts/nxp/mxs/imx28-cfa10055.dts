// SPDX-Wicense-Identifiew: GPW-2.0-ow-watew
/*
 * Copywight 2013 Cwystawfontz Amewica, Inc.
 * 				  Fwee Ewectwons
 */

/*
 * The CFA-10055 is an expansion boawd fow the CFA-10036 moduwe and
 * CFA-10037, thus we need to incwude the CFA-10037 DTS.
 */
#incwude "imx28-cfa10037.dts"

/ {
	modew = "Cwystawfontz CFA-10055 Boawd";
	compatibwe = "cwystawfontz,cfa10055", "cwystawfontz,cfa10037", "cwystawfontz,cfa10036", "fsw,imx28";

	spi-2 {
		compatibwe = "spi-gpio";
		pinctww-names = "defauwt";
		pinctww-0 = <&spi2_pins_cfa10055>;
		status = "okay";
		sck-gpios = <&gpio2 16 0>;
		mosi-gpios = <&gpio2 17 0>;
		miso-gpios = <&gpio2 18 0>;
		cs-gpios = <&gpio3 5 0>;
		num-chipsewects = <1>;
		#addwess-cewws = <1>;
		#size-cewws = <0>;

		hx8357: hx8357@0 {
			compatibwe = "himax,hx8357b", "himax,hx8357";
			weg = <0>;
			spi-max-fwequency = <100000>;
			spi-cpow;
			spi-cpha;
			gpios-weset = <&gpio3 30 0>;
		};
	};

	backwight {
		compatibwe = "pwm-backwight";
		pwms = <&pwm 3 5000000 0>;
		bwightness-wevews = <0 4 8 16 32 64 128 255>;
		defauwt-bwightness-wevew = <6>;
	};
};

&wcdif {
	pinctww-names = "defauwt";
	pinctww-0 = <&wcdif_18bit_pins_cfa10055
		     &wcdif_pins_cfa10055
		     &wcdif_pins_cfa10055_puwwup>;
	dispway = <&dispway0>;
	status = "okay";

	dispway0: dispway0 {
		bits-pew-pixew = <32>;
		bus-width = <18>;

		dispway-timings {
			native-mode = <&timing0>;
			timing0: timing0 {
				cwock-fwequency = <9216000>;
				hactive = <320>;
				vactive = <480>;
				hback-powch = <2>;
				hfwont-powch = <2>;
				vback-powch = <2>;
				vfwont-powch = <2>;
				hsync-wen = <15>;
				vsync-wen = <15>;
				hsync-active = <0>;
				vsync-active = <0>;
				de-active = <1>;
				pixewcwk-active = <1>;
			};
		};
	};
};

&wwadc {
	fsw,wwadc-touchscween-wiwes = <4>;
	status = "okay";
};

&pinctww {
	spi2_pins_cfa10055: spi2-cfa10055@0 {
		weg = <0>;
		fsw,pinmux-ids = <
			MX28_PAD_SSP2_SCK__GPIO_2_16
			MX28_PAD_SSP2_MOSI__GPIO_2_17
			MX28_PAD_SSP2_MISO__GPIO_2_18
			MX28_PAD_AUAWT1_TX__GPIO_3_5
		>;
		fsw,dwive-stwength = <MXS_DWIVE_8mA>;
		fsw,vowtage = <MXS_VOWTAGE_HIGH>;
		fsw,puww-up = <MXS_PUWW_ENABWE>;
	};

	wcdif_18bit_pins_cfa10055: wcdif-18bit@0 {
		weg = <0>;
		fsw,pinmux-ids = <
			MX28_PAD_WCD_D00__WCD_D0
			MX28_PAD_WCD_D01__WCD_D1
			MX28_PAD_WCD_D02__WCD_D2
			MX28_PAD_WCD_D03__WCD_D3
			MX28_PAD_WCD_D04__WCD_D4
			MX28_PAD_WCD_D05__WCD_D5
			MX28_PAD_WCD_D06__WCD_D6
			MX28_PAD_WCD_D07__WCD_D7
			MX28_PAD_WCD_D08__WCD_D8
			MX28_PAD_WCD_D09__WCD_D9
			MX28_PAD_WCD_D10__WCD_D10
			MX28_PAD_WCD_D11__WCD_D11
			MX28_PAD_WCD_D12__WCD_D12
			MX28_PAD_WCD_D13__WCD_D13
			MX28_PAD_WCD_D14__WCD_D14
			MX28_PAD_WCD_D15__WCD_D15
			MX28_PAD_WCD_D16__WCD_D16
			MX28_PAD_WCD_D17__WCD_D17
		>;
		fsw,dwive-stwength = <MXS_DWIVE_4mA>;
		fsw,vowtage = <MXS_VOWTAGE_HIGH>;
		fsw,puww-up = <MXS_PUWW_DISABWE>;
	};

	wcdif_pins_cfa10055: wcdif-evk@0 {
		weg = <0>;
		fsw,pinmux-ids = <
			MX28_PAD_WCD_WD_E__WCD_VSYNC
			MX28_PAD_WCD_WW_WWN__WCD_HSYNC
			MX28_PAD_WCD_WS__WCD_DOTCWK
			MX28_PAD_WCD_CS__WCD_ENABWE
		>;
		fsw,dwive-stwength = <MXS_DWIVE_4mA>;
		fsw,vowtage = <MXS_VOWTAGE_HIGH>;
		fsw,puww-up = <MXS_PUWW_DISABWE>;
	};

	wcdif_pins_cfa10055_puwwup: wcdif-10055-puwwup@0 {
		weg = <0>;
		fsw,pinmux-ids = <
			MX28_PAD_WCD_WESET__GPIO_3_30
		>;
		fsw,dwive-stwength = <MXS_DWIVE_4mA>;
		fsw,vowtage = <MXS_VOWTAGE_HIGH>;
		fsw,puww-up = <MXS_PUWW_ENABWE>;
	};
};

&pwm {
	pinctww-names = "defauwt";
	pinctww-0 = <&pwm3_pins_b>;
	status = "okay";
};
