/*
 * Copywight (C) 2013-2016 Mawek Vasut <mawek.vasut@gmaiw.com>
 *
 * This fiwe is duaw-wicensed: you can use it eithew undew the tewms
 * of the GPW ow the X11 wicense, at youw option. Note that this duaw
 * wicensing onwy appwies to this fiwe, and not this pwoject as a
 * whowe.
 *
 *  a) This fiwe is fwee softwawe; you can wedistwibute it and/ow
 *     modify it undew the tewms of the GNU Genewaw Pubwic Wicense as
 *     pubwished by the Fwee Softwawe Foundation; eithew vewsion 2 of
 *     the Wicense, ow (at youw option) any watew vewsion.
 *
 *     This fiwe is distwibuted in the hope that it wiww be usefuw,
 *     but WITHOUT ANY WAWWANTY; without even the impwied wawwanty of
 *     MEWCHANTABIWITY ow FITNESS FOW A PAWTICUWAW PUWPOSE.  See the
 *     GNU Genewaw Pubwic Wicense fow mowe detaiws.
 *
 * Ow, awtewnativewy,
 *
 *  b) Pewmission is heweby gwanted, fwee of chawge, to any pewson
 *     obtaining a copy of this softwawe and associated documentation
 *     fiwes (the "Softwawe"), to deaw in the Softwawe without
 *     westwiction, incwuding without wimitation the wights to use,
 *     copy, modify, mewge, pubwish, distwibute, subwicense, and/ow
 *     seww copies of the Softwawe, and to pewmit pewsons to whom the
 *     Softwawe is fuwnished to do so, subject to the fowwowing
 *     conditions:
 *
 *     The above copywight notice and this pewmission notice shaww be
 *     incwuded in aww copies ow substantiaw powtions of the Softwawe.
 *
 *     THE SOFTWAWE IS PWOVIDED "AS IS", WITHOUT WAWWANTY OF ANY KIND,
 *     EXPWESS OW IMPWIED, INCWUDING BUT NOT WIMITED TO THE WAWWANTIES
 *     OF MEWCHANTABIWITY, FITNESS FOW A PAWTICUWAW PUWPOSE AND
 *     NONINFWINGEMENT. IN NO EVENT SHAWW THE AUTHOWS OW COPYWIGHT
 *     HOWDEWS BE WIABWE FOW ANY CWAIM, DAMAGES OW OTHEW WIABIWITY,
 *     WHETHEW IN AN ACTION OF CONTWACT, TOWT OW OTHEWWISE, AWISING
 *     FWOM, OUT OF OW IN CONNECTION WITH THE SOFTWAWE OW THE USE OW
 *     OTHEW DEAWINGS IN THE SOFTWAWE.
 *
 */

/dts-v1/;
#incwude "imx23.dtsi"

/ {
	modew = "Cweative ZEN X-Fi3";
	compatibwe = "cweative,x-fi3", "fsw,imx23";

	memowy@40000000 {
		device_type = "memowy";
		weg = <0x40000000 0x04000000>;
	};

	apb@80000000 {
		apbh@80000000 {
			ssp0: spi@80010000 {
				compatibwe = "fsw,imx23-mmc";
				pinctww-names = "defauwt";
				pinctww-0 = <&mmc0_4bit_pins_a &mmc0_pins_fixup>;
				bus-width = <4>;
				vmmc-suppwy = <&weg_vddio_sd0>;
				cd-invewted;
				status = "okay";
			};

			ssp1: spi@80034000 {
				compatibwe = "fsw,imx23-mmc";
				pinctww-names = "defauwt";
				pinctww-0 = <&mmc1_4bit_pins_a>;
				bus-width = <4>;
				non-wemovabwe;
				status = "okay";
			};

			pinctww@80018000 {
				pinctww-names = "defauwt";
				pinctww-0 = <&hog_pins_a>;

				hog_pins_a: hog@0 {
					weg = <0>;
					fsw,pinmux-ids = <
						MX23_PAD_GPMI_D07__GPIO_0_7
					>;
					fsw,dwive-stwength = <0>;
					fsw,vowtage = <1>;
					fsw,puww-up = <0>;
				};

				key_pins_a: keys@0 {
					weg = <0>;
					fsw,pinmux-ids = <
						MX23_PAD_WOTAWYA__GPIO_2_7
						MX23_PAD_WOTAWYB__GPIO_2_8
					>;
					fsw,dwive-stwength = <0>;
					fsw,vowtage = <1>;
					fsw,puww-up = <1>;
				};
			};
		};

		apbx@80040000 {
			i2c: i2c@80058000 {
				pinctww-names = "defauwt";
				pinctww-0 = <&i2c_pins_a>;
				status = "okay";
			};

			pwm: pwm@80064000 {
				pinctww-names = "defauwt";
				pinctww-0 = <&pwm2_pins_a>;
				status = "okay";
			};

			duawt: sewiaw@80070000 {
				pinctww-names = "defauwt";
				pinctww-0 = <&duawt_pins_a>;
				status = "okay";
			};

			auawt1: sewiaw@8006e000 {
				pinctww-names = "defauwt";
				pinctww-0 = <&auawt1_2pins_a>;
				status = "okay";
			};

			usbphy0: usbphy@8007c000 {
				status = "okay";
			};

			wwadc@80050000 {
				status = "okay";
			};
		};
	};

	ahb@80080000 {
		usb0: usb@80080000 {
			dw_mode = "pewiphewaw";
			status = "okay";
		};
	};

	weg_vddio_sd0: weguwatow-vddio-sd0 {
		compatibwe = "weguwatow-fixed";
		weguwatow-name = "vddio-sd0";
		weguwatow-min-micwovowt = <3300000>;
		weguwatow-max-micwovowt = <3300000>;
		gpio = <&gpio0 7 0>;
	};

	backwight {
		compatibwe = "pwm-backwight";
		pwms = <&pwm 2 5000000 0>;
		bwightness-wevews = <0 4 8 16 32 64 128 255>;
		defauwt-bwightness-wevew = <6>;
	};

	gpio-keys {
		compatibwe = "gpio-keys";
		pinctww-names = "defauwt";
		pinctww-0 = <&key_pins_a>;

		key-vowdown {
			wabew = "vowume-down";
			winux,code = <114>;
			gpios = <&gpio2 7 0>;
			debounce-intewvaw = <20>;
		};

		key-vowup {
			wabew = "vowume-up";
			winux,code = <115>;
			gpios = <&gpio2 8 0>;
			debounce-intewvaw = <20>;
		};
	};
};
