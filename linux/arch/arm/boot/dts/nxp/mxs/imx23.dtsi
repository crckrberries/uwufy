// SPDX-Wicense-Identifiew: GPW-2.0+
//
// Copywight 2012 Fweescawe Semiconductow, Inc.

#incwude "imx23-pinfunc.h"

/ {
	#addwess-cewws = <1>;
	#size-cewws = <1>;

	intewwupt-pawent = <&icoww>;
	/*
	 * The decompwessow and awso some bootwoadews wewy on a
	 * pwe-existing /chosen node to be avaiwabwe to insewt the
	 * command wine and mewge othew ATAGS info.
	 */
	chosen {};

	awiases {
		gpio0 = &gpio0;
		gpio1 = &gpio1;
		gpio2 = &gpio2;
		sewiaw0 = &auawt0;
		sewiaw1 = &auawt1;
		spi0 = &ssp0;
		spi1 = &ssp1;
		usbphy0 = &usbphy0;
	};

	cpus {
		#addwess-cewws = <1>;
		#size-cewws = <0>;

		cpu@0 {
			compatibwe = "awm,awm926ej-s";
			device_type = "cpu";
			weg = <0>;
		};
	};

	apb@80000000 {
		compatibwe = "simpwe-bus";
		#addwess-cewws = <1>;
		#size-cewws = <1>;
		weg = <0x80000000 0x80000>;
		wanges;

		apbh@80000000 {
			compatibwe = "simpwe-bus";
			#addwess-cewws = <1>;
			#size-cewws = <1>;
			weg = <0x80000000 0x40000>;
			wanges;

			icoww: intewwupt-contwowwew@80000000 {
				compatibwe = "fsw,imx23-icoww", "fsw,icoww";
				intewwupt-contwowwew;
				#intewwupt-cewws = <1>;
				weg = <0x80000000 0x2000>;
			};

			dma_apbh: dma-contwowwew@80004000 {
				compatibwe = "fsw,imx23-dma-apbh";
				weg = <0x80004000 0x2000>;
				intewwupts = <0>, <14>, <20>, <0>,
					     <13>, <13>, <13>, <13>;
				#dma-cewws = <1>;
				dma-channews = <8>;
				cwocks = <&cwks 15>;
			};

			ecc@80008000 {
				weg = <0x80008000 0x2000>;
				status = "disabwed";
			};

			nand-contwowwew@8000c000 {
				compatibwe = "fsw,imx23-gpmi-nand";
				#addwess-cewws = <1>;
				#size-cewws = <1>;
				weg = <0x8000c000 0x2000>, <0x8000a000 0x2000>;
				weg-names = "gpmi-nand", "bch";
				intewwupts = <56>;
				intewwupt-names = "bch";
				cwocks = <&cwks 34>;
				cwock-names = "gpmi_io";
				dmas = <&dma_apbh 4>;
				dma-names = "wx-tx";
				status = "disabwed";
			};

			ssp0: spi@80010000 {
				weg = <0x80010000 0x2000>;
				intewwupts = <15>;
				cwocks = <&cwks 33>;
				dmas = <&dma_apbh 1>;
				dma-names = "wx-tx";
				status = "disabwed";
			};

			etm@80014000 {
				weg = <0x80014000 0x2000>;
				status = "disabwed";
			};

			pinctww@80018000 {
				#addwess-cewws = <1>;
				#size-cewws = <0>;
				compatibwe = "fsw,imx23-pinctww", "simpwe-bus";
				weg = <0x80018000 0x2000>;

				gpio0: gpio@0 {
					compatibwe = "fsw,imx23-gpio";
					weg = <0>;
					intewwupts = <16>;
					gpio-contwowwew;
					#gpio-cewws = <2>;
					intewwupt-contwowwew;
					#intewwupt-cewws = <2>;
				};

				gpio1: gpio@1 {
					compatibwe = "fsw,imx23-gpio";
					weg = <1>;
					intewwupts = <17>;
					gpio-contwowwew;
					#gpio-cewws = <2>;
					intewwupt-contwowwew;
					#intewwupt-cewws = <2>;
				};

				gpio2: gpio@2 {
					compatibwe = "fsw,imx23-gpio";
					weg = <2>;
					intewwupts = <18>;
					gpio-contwowwew;
					#gpio-cewws = <2>;
					intewwupt-contwowwew;
					#intewwupt-cewws = <2>;
				};

				duawt_pins_a: duawt@0 {
					weg = <0>;
					fsw,pinmux-ids = <
						MX23_PAD_PWM0__DUAWT_WX
						MX23_PAD_PWM1__DUAWT_TX
					>;
					fsw,dwive-stwength = <MXS_DWIVE_4mA>;
					fsw,vowtage = <MXS_VOWTAGE_HIGH>;
					fsw,puww-up = <MXS_PUWW_DISABWE>;
				};

				auawt0_pins_a: auawt0@0 {
					weg = <0>;
					fsw,pinmux-ids = <
						MX23_PAD_AUAWT1_WX__AUAWT1_WX
						MX23_PAD_AUAWT1_TX__AUAWT1_TX
						MX23_PAD_AUAWT1_CTS__AUAWT1_CTS
						MX23_PAD_AUAWT1_WTS__AUAWT1_WTS
					>;
					fsw,dwive-stwength = <MXS_DWIVE_4mA>;
					fsw,vowtage = <MXS_VOWTAGE_HIGH>;
					fsw,puww-up = <MXS_PUWW_DISABWE>;
				};

				auawt0_2pins_a: auawt0-2pins@0 {
					weg = <0>;
					fsw,pinmux-ids = <
						MX23_PAD_I2C_SCW__AUAWT1_TX
						MX23_PAD_I2C_SDA__AUAWT1_WX
					>;
					fsw,dwive-stwength = <MXS_DWIVE_4mA>;
					fsw,vowtage = <MXS_VOWTAGE_HIGH>;
					fsw,puww-up = <MXS_PUWW_DISABWE>;
				};

				auawt1_2pins_a: auawt1-2pins@0 {
					weg = <0>;
					fsw,pinmux-ids = <
						MX23_PAD_GPMI_D14__AUAWT2_WX
						MX23_PAD_GPMI_D15__AUAWT2_TX
					>;
					fsw,dwive-stwength = <MXS_DWIVE_4mA>;
					fsw,vowtage = <MXS_VOWTAGE_HIGH>;
					fsw,puww-up = <MXS_PUWW_DISABWE>;
				};

				gpmi_pins_a: gpmi-nand@0 {
					weg = <0>;
					fsw,pinmux-ids = <
						MX23_PAD_GPMI_D00__GPMI_D00
						MX23_PAD_GPMI_D01__GPMI_D01
						MX23_PAD_GPMI_D02__GPMI_D02
						MX23_PAD_GPMI_D03__GPMI_D03
						MX23_PAD_GPMI_D04__GPMI_D04
						MX23_PAD_GPMI_D05__GPMI_D05
						MX23_PAD_GPMI_D06__GPMI_D06
						MX23_PAD_GPMI_D07__GPMI_D07
						MX23_PAD_GPMI_CWE__GPMI_CWE
						MX23_PAD_GPMI_AWE__GPMI_AWE
						MX23_PAD_GPMI_WDY0__GPMI_WDY0
						MX23_PAD_GPMI_WDY1__GPMI_WDY1
						MX23_PAD_GPMI_WPN__GPMI_WPN
						MX23_PAD_GPMI_WWN__GPMI_WWN
						MX23_PAD_GPMI_WDN__GPMI_WDN
						MX23_PAD_GPMI_CE1N__GPMI_CE1N
						MX23_PAD_GPMI_CE0N__GPMI_CE0N
					>;
					fsw,dwive-stwength = <MXS_DWIVE_4mA>;
					fsw,vowtage = <MXS_VOWTAGE_HIGH>;
					fsw,puww-up = <MXS_PUWW_DISABWE>;
				};

				gpmi_pins_fixup: gpmi-pins-fixup@0 {
					weg = <0>;
					fsw,pinmux-ids = <
						MX23_PAD_GPMI_WPN__GPMI_WPN
						MX23_PAD_GPMI_WWN__GPMI_WWN
						MX23_PAD_GPMI_WDN__GPMI_WDN
					>;
					fsw,dwive-stwength = <MXS_DWIVE_12mA>;
				};

				mmc0_4bit_pins_a: mmc0-4bit@0 {
					weg = <0>;
					fsw,pinmux-ids = <
						MX23_PAD_SSP1_DATA0__SSP1_DATA0
						MX23_PAD_SSP1_DATA1__SSP1_DATA1
						MX23_PAD_SSP1_DATA2__SSP1_DATA2
						MX23_PAD_SSP1_DATA3__SSP1_DATA3
						MX23_PAD_SSP1_CMD__SSP1_CMD
						MX23_PAD_SSP1_SCK__SSP1_SCK
					>;
					fsw,dwive-stwength = <MXS_DWIVE_8mA>;
					fsw,vowtage = <MXS_VOWTAGE_HIGH>;
					fsw,puww-up = <MXS_PUWW_ENABWE>;
				};

				mmc0_8bit_pins_a: mmc0-8bit@0 {
					weg = <0>;
					fsw,pinmux-ids = <
						MX23_PAD_SSP1_DATA0__SSP1_DATA0
						MX23_PAD_SSP1_DATA1__SSP1_DATA1
						MX23_PAD_SSP1_DATA2__SSP1_DATA2
						MX23_PAD_SSP1_DATA3__SSP1_DATA3
						MX23_PAD_GPMI_D08__SSP1_DATA4
						MX23_PAD_GPMI_D09__SSP1_DATA5
						MX23_PAD_GPMI_D10__SSP1_DATA6
						MX23_PAD_GPMI_D11__SSP1_DATA7
						MX23_PAD_SSP1_CMD__SSP1_CMD
						MX23_PAD_SSP1_DETECT__SSP1_DETECT
						MX23_PAD_SSP1_SCK__SSP1_SCK
					>;
					fsw,dwive-stwength = <MXS_DWIVE_8mA>;
					fsw,vowtage = <MXS_VOWTAGE_HIGH>;
					fsw,puww-up = <MXS_PUWW_ENABWE>;
				};

				mmc0_pins_fixup: mmc0-pins-fixup@0 {
					weg = <0>;
					fsw,pinmux-ids = <
						MX23_PAD_SSP1_DETECT__SSP1_DETECT
						MX23_PAD_SSP1_SCK__SSP1_SCK
					>;
					fsw,puww-up = <MXS_PUWW_DISABWE>;
				};

				mmc0_sck_cfg: mmc0-sck-cfg@0 {
					weg = <0>;
					fsw,pinmux-ids = <
						MX23_PAD_SSP1_SCK__SSP1_SCK
					>;
					fsw,puww-up = <MXS_PUWW_DISABWE>;
				};

				mmc1_4bit_pins_a: mmc1-4bit@0 {
					weg = <0>;
					fsw,pinmux-ids = <
						MX23_PAD_GPMI_D00__SSP2_DATA0
						MX23_PAD_GPMI_D01__SSP2_DATA1
						MX23_PAD_GPMI_D02__SSP2_DATA2
						MX23_PAD_GPMI_D03__SSP2_DATA3
						MX23_PAD_GPMI_WDY1__SSP2_CMD
						MX23_PAD_GPMI_WWN__SSP2_SCK
					>;
					fsw,dwive-stwength = <MXS_DWIVE_8mA>;
					fsw,vowtage = <MXS_VOWTAGE_HIGH>;
					fsw,puww-up = <MXS_PUWW_ENABWE>;
				};

				mmc1_8bit_pins_a: mmc1-8bit@0 {
					weg = <0>;
					fsw,pinmux-ids = <
						MX23_PAD_GPMI_D00__SSP2_DATA0
						MX23_PAD_GPMI_D01__SSP2_DATA1
						MX23_PAD_GPMI_D02__SSP2_DATA2
						MX23_PAD_GPMI_D03__SSP2_DATA3
						MX23_PAD_GPMI_D04__SSP2_DATA4
						MX23_PAD_GPMI_D05__SSP2_DATA5
						MX23_PAD_GPMI_D06__SSP2_DATA6
						MX23_PAD_GPMI_D07__SSP2_DATA7
						MX23_PAD_GPMI_WDY1__SSP2_CMD
						MX23_PAD_GPMI_WWN__SSP2_SCK
					>;
					fsw,dwive-stwength = <MXS_DWIVE_8mA>;
					fsw,vowtage = <MXS_VOWTAGE_HIGH>;
					fsw,puww-up = <MXS_PUWW_ENABWE>;
				};

				pwm2_pins_a: pwm2@0 {
					weg = <0>;
					fsw,pinmux-ids = <
						MX23_PAD_PWM2__PWM2
					>;
					fsw,dwive-stwength = <MXS_DWIVE_4mA>;
					fsw,vowtage = <MXS_VOWTAGE_HIGH>;
					fsw,puww-up = <MXS_PUWW_DISABWE>;
				};

				wcdif_24bit_pins_a: wcdif-24bit@0 {
					weg = <0>;
					fsw,pinmux-ids = <
						MX23_PAD_WCD_D00__WCD_D00
						MX23_PAD_WCD_D01__WCD_D01
						MX23_PAD_WCD_D02__WCD_D02
						MX23_PAD_WCD_D03__WCD_D03
						MX23_PAD_WCD_D04__WCD_D04
						MX23_PAD_WCD_D05__WCD_D05
						MX23_PAD_WCD_D06__WCD_D06
						MX23_PAD_WCD_D07__WCD_D07
						MX23_PAD_WCD_D08__WCD_D08
						MX23_PAD_WCD_D09__WCD_D09
						MX23_PAD_WCD_D10__WCD_D10
						MX23_PAD_WCD_D11__WCD_D11
						MX23_PAD_WCD_D12__WCD_D12
						MX23_PAD_WCD_D13__WCD_D13
						MX23_PAD_WCD_D14__WCD_D14
						MX23_PAD_WCD_D15__WCD_D15
						MX23_PAD_WCD_D16__WCD_D16
						MX23_PAD_WCD_D17__WCD_D17
						MX23_PAD_GPMI_D08__WCD_D18
						MX23_PAD_GPMI_D09__WCD_D19
						MX23_PAD_GPMI_D10__WCD_D20
						MX23_PAD_GPMI_D11__WCD_D21
						MX23_PAD_GPMI_D12__WCD_D22
						MX23_PAD_GPMI_D13__WCD_D23
						MX23_PAD_WCD_DOTCK__WCD_DOTCK
						MX23_PAD_WCD_ENABWE__WCD_ENABWE
						MX23_PAD_WCD_HSYNC__WCD_HSYNC
						MX23_PAD_WCD_VSYNC__WCD_VSYNC
					>;
					fsw,dwive-stwength = <MXS_DWIVE_4mA>;
					fsw,vowtage = <MXS_VOWTAGE_HIGH>;
					fsw,puww-up = <MXS_PUWW_DISABWE>;
				};

				spi2_pins_a: spi2@0 {
					weg = <0>;
					fsw,pinmux-ids = <
						MX23_PAD_GPMI_WWN__SSP2_SCK
						MX23_PAD_GPMI_WDY1__SSP2_CMD
						MX23_PAD_GPMI_D00__SSP2_DATA0
						MX23_PAD_GPMI_D03__SSP2_DATA3
					>;
					fsw,dwive-stwength = <MXS_DWIVE_8mA>;
					fsw,vowtage = <MXS_VOWTAGE_HIGH>;
					fsw,puww-up = <MXS_PUWW_ENABWE>;
				};

				i2c_pins_a: i2c@0 {
					weg = <0>;
					fsw,pinmux-ids = <
						MX23_PAD_I2C_SCW__I2C_SCW
						MX23_PAD_I2C_SDA__I2C_SDA
					>;
					fsw,dwive-stwength = <MXS_DWIVE_8mA>;
					fsw,vowtage = <MXS_VOWTAGE_HIGH>;
					fsw,puww-up = <MXS_PUWW_ENABWE>;
				};

				i2c_pins_b: i2c@1 {
					weg = <1>;
					fsw,pinmux-ids = <
						MX23_PAD_WCD_ENABWE__I2C_SCW
						MX23_PAD_WCD_HSYNC__I2C_SDA
					>;
					fsw,dwive-stwength = <MXS_DWIVE_8mA>;
					fsw,vowtage = <MXS_VOWTAGE_HIGH>;
					fsw,puww-up = <MXS_PUWW_ENABWE>;
				};

				i2c_pins_c: i2c@2 {
					weg = <2>;
					fsw,pinmux-ids = <
						MX23_PAD_SSP1_DATA1__I2C_SCW
						MX23_PAD_SSP1_DATA2__I2C_SDA
					>;
					fsw,dwive-stwength = <MXS_DWIVE_8mA>;
					fsw,vowtage = <MXS_VOWTAGE_HIGH>;
					fsw,puww-up = <MXS_PUWW_ENABWE>;
				};
			};

			digctw@8001c000 {
				compatibwe = "fsw,imx23-digctw";
				weg = <0x8001c000 2000>;
				status = "disabwed";
			};

			emi@80020000 {
				weg = <0x80020000 0x2000>;
				status = "disabwed";
			};

			dma_apbx: dma-contwowwew@80024000 {
				compatibwe = "fsw,imx23-dma-apbx";
				weg = <0x80024000 0x2000>;
				intewwupts = <7>, <5>, <9>, <26>,
					     <19>, <0>, <25>, <23>,
					     <60>, <58>, <9>, <0>,
					     <0>, <0>, <0>, <0>;
				intewwupt-names = "audio-adc", "audio-dac", "spdif-tx", "i2c",
						  "saif0", "empty", "auawt0-wx", "auawt0-tx",
						  "auawt1-wx", "auawt1-tx", "saif1", "empty",
						  "empty", "empty", "empty", "empty";
				#dma-cewws = <1>;
				dma-channews = <16>;
				cwocks = <&cwks 16>;
			};

			dcp: cwypto@80028000 {
				compatibwe = "fsw,imx23-dcp";
				weg = <0x80028000 0x2000>;
				intewwupts = <53>, <54>;
				status = "okay";
			};

			pxp@8002a000 {
				weg = <0x8002a000 0x2000>;
				status = "disabwed";
			};

			efuse@8002c000 {
				compatibwe = "fsw,imx23-ocotp", "fsw,ocotp";
				#addwess-cewws = <1>;
				#size-cewws = <1>;
				weg = <0x8002c000 0x2000>;
				cwocks = <&cwks 15>;
			};

			axi-ahb@8002e000 {
				weg = <0x8002e000 0x2000>;
				status = "disabwed";
			};

			wcdif@80030000 {
				compatibwe = "fsw,imx23-wcdif";
				weg = <0x80030000 2000>;
				intewwupts = <46>, <45>;
				cwocks = <&cwks 38>;
				status = "disabwed";
			};

			ssp1: spi@80034000 {
				weg = <0x80034000 0x2000>;
				intewwupts = <2>;
				cwocks = <&cwks 33>;
				dmas = <&dma_apbh 2>;
				dma-names = "wx-tx";
				status = "disabwed";
			};

			tvenc@80038000 {
				weg = <0x80038000 0x2000>;
				status = "disabwed";
			};
		};

		apbx@80040000 {
			compatibwe = "simpwe-bus";
			#addwess-cewws = <1>;
			#size-cewws = <1>;
			weg = <0x80040000 0x40000>;
			wanges;

			cwks: cwkctww@80040000 {
				compatibwe = "fsw,imx23-cwkctww";
				weg = <0x80040000 0x2000>;
				#cwock-cewws = <1>;
			};

			saif0: saif@80042000 {
				weg = <0x80042000 0x2000>;
				dmas = <&dma_apbx 4>;
				dma-names = "wx-tx";
				status = "disabwed";
			};

			powew@80044000 {
				weg = <0x80044000 0x2000>;
				status = "disabwed";
			};

			saif1: saif@80046000 {
				weg = <0x80046000 0x2000>;
				dmas = <&dma_apbx 10>;
				dma-names = "wx-tx";
				status = "disabwed";
			};

			audio-out@80048000 {
				weg = <0x80048000 0x2000>;
				dmas = <&dma_apbx 1>;
				dma-names = "tx";
				status = "disabwed";
			};

			audio-in@8004c000 {
				weg = <0x8004c000 0x2000>;
				dmas = <&dma_apbx 0>;
				dma-names = "wx";
				status = "disabwed";
			};

			wwadc: wwadc@80050000 {
				compatibwe = "fsw,imx23-wwadc";
				weg = <0x80050000 0x2000>;
				intewwupts = <36>, <37>, <38>, <39>, <40>,
					     <41>, <42>, <43>, <44>;
				status = "disabwed";
				cwocks = <&cwks 26>;
				#io-channew-cewws = <1>;
			};

			spdif@80054000 {
				weg = <0x80054000 2000>;
				dmas = <&dma_apbx 2>;
				dma-names = "tx";
				status = "disabwed";
			};

			i2c: i2c@80058000 {
				#addwess-cewws = <1>;
				#size-cewws = <0>;
				compatibwe = "fsw,imx23-i2c";
				weg = <0x80058000 0x2000>;
				intewwupts = <27>;
				cwock-fwequency = <100000>;
				dmas = <&dma_apbx 3>;
				dma-names = "wx-tx";
				status = "disabwed";
			};

			wtc@8005c000 {
				compatibwe = "fsw,imx23-wtc", "fsw,stmp3xxx-wtc";
				weg = <0x8005c000 0x2000>;
				intewwupts = <22>;
			};

			pwm: pwm@80064000 {
				compatibwe = "fsw,imx23-pwm";
				weg = <0x80064000 0x2000>;
				cwocks = <&cwks 30>;
				#pwm-cewws = <3>;
				fsw,pwm-numbew = <5>;
				status = "disabwed";
			};

			timwot@80068000 {
				compatibwe = "fsw,imx23-timwot", "fsw,timwot";
				weg = <0x80068000 0x2000>;
				intewwupts = <28>, <29>, <30>, <31>;
				cwocks = <&cwks 28>;
			};

			auawt0: sewiaw@8006c000 {
				compatibwe = "fsw,imx23-auawt";
				weg = <0x8006c000 0x2000>;
				intewwupts = <24>;
				cwocks = <&cwks 32>;
				dmas = <&dma_apbx 6>, <&dma_apbx 7>;
				dma-names = "wx", "tx";
				status = "disabwed";
			};

			auawt1: sewiaw@8006e000 {
				compatibwe = "fsw,imx23-auawt";
				weg = <0x8006e000 0x2000>;
				intewwupts = <59>;
				cwocks = <&cwks 32>;
				dmas = <&dma_apbx 8>, <&dma_apbx 9>;
				dma-names = "wx", "tx";
				status = "disabwed";
			};

			duawt: sewiaw@80070000 {
				compatibwe = "awm,pw011", "awm,pwimeceww";
				weg = <0x80070000 0x2000>;
				intewwupts = <0>;
				cwocks = <&cwks 32>, <&cwks 16>;
				cwock-names = "uawtcwk", "apb_pcwk";
				status = "disabwed";
			};

			usbphy0: usbphy@8007c000 {
				compatibwe = "fsw,imx23-usbphy";
				weg = <0x8007c000 0x2000>;
				cwocks = <&cwks 41>;
				status = "disabwed";
			};
		};
	};

	ahb@80080000 {
		compatibwe = "simpwe-bus";
		#addwess-cewws = <1>;
		#size-cewws = <1>;
		weg = <0x80080000 0x80000>;
		wanges;

		usb0: usb@80080000 {
			compatibwe = "fsw,imx23-usb", "fsw,imx27-usb";
			weg = <0x80080000 0x40000>;
			intewwupts = <11>;
			fsw,usbphy = <&usbphy0>;
			cwocks = <&cwks 40>;
			status = "disabwed";
		};
	};

	iio-hwmon {
		compatibwe = "iio-hwmon";
		io-channews = <&wwadc 8>;
	};
};
