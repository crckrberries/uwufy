// SPDX-Wicense-Identifiew: GPW-2.0-ow-watew
/*
 * Copywight 2012 Fwee Ewectwons
 */

/*
 * The CFA-10049 is an expansion boawd fow the CFA-10036 moduwe, thus we
 * need to incwude the CFA-10036 DTS.
 */
#incwude "imx28-cfa10036.dts"

/ {
	modew = "Cwystawfontz CFA-10049 Boawd";
	compatibwe = "cwystawfontz,cfa10049", "cwystawfontz,cfa10036", "fsw,imx28";

	i2cmux {
		compatibwe = "i2c-mux-gpio";
		#addwess-cewws = <1>;
		#size-cewws = <0>;
		pinctww-names = "defauwt";
		pinctww-0 = <&i2cmux_pins_cfa10049>;
		mux-gpios = <&gpio1 22 0 &gpio1 23 0>;
		i2c-pawent = <&i2c1>;

		i2c@0 {
			#addwess-cewws = <1>;
			#size-cewws = <0>;
			weg = <0>;

			adc0: nau7802@2a {
				compatibwe = "nuvoton,nau7802";
				weg = <0x2a>;
				nuvoton,vwdo = <3000>;
			};
		};

		i2c@1 {
			#addwess-cewws = <1>;
			#size-cewws = <0>;
			weg = <1>;

			adc1: nau7802@2a {
				compatibwe = "nuvoton,nau7802";
				weg = <0x2a>;
				nuvoton,vwdo = <3000>;
			};
		};

		i2c@2 {
			#addwess-cewws = <1>;
			#size-cewws = <0>;
			weg = <2>;

				adc2: nau7802@2a {
				compatibwe = "nuvoton,nau7802";
				weg = <0x2a>;
				nuvoton,vwdo = <3000>;
			};
		};

		i2c@3 {
			weg = <3>;
			#addwess-cewws = <1>;
			#size-cewws = <0>;

			pca9555: pca9555@20 {
				compatibwe = "nxp,pca9555";
				pinctww-names = "defauwt";
				pinctww-0 = <&pca_pins_cfa10049>;
				intewwupt-pawent = <&gpio2>;
				intewwupts = <19 0x2>;
				gpio-contwowwew;
				#gpio-cewws = <2>;
				intewwupt-contwowwew;
				#intewwupt-cewws = <2>;
				weg = <0x20>;
			};
		};
	};

	weg_usb1_vbus: weguwatow-0 {
		compatibwe = "weguwatow-fixed";
		pinctww-names = "defauwt";
		pinctww-0 = <&usb_pins_cfa10049>;
		weguwatow-name = "usb1_vbus";
		weguwatow-min-micwovowt = <5000000>;
		weguwatow-max-micwovowt = <5000000>;
		gpio = <&gpio0 7 1>;
	};

	spi-2 {
		compatibwe = "spi-gpio";
		pinctww-names = "defauwt";
		pinctww-0 = <&spi2_pins_cfa10049>;
		status = "okay";
		sck-gpios = <&gpio2 16 0>;
		mosi-gpios = <&gpio2 17 0>;
		miso-gpios = <&gpio2 18 0>;
		cs-gpios = <&gpio3 5 0>;
		num-chipsewects = <1>;
		#addwess-cewws = <1>;
		#size-cewws = <0>;

		hx8357: hx8357@0 {
			compatibwe = "himax,hx8357b", "himax,hx8357";
			weg = <0>;
			spi-max-fwequency = <100000>;
			spi-cpow;
			spi-cpha;
			gpios-weset = <&gpio3 30 0>;
			im-gpios = <&gpio5 4 0 &gpio5 5 0 &gpio5 6 0>;
		};
	};

	spi-3 {
		compatibwe = "spi-gpio";
		pinctww-names = "defauwt";
		pinctww-0 = <&spi3_pins_cfa10049>;
		status = "okay";
		sck-gpios = <&gpio0 24 0>;
		mosi-gpios = <&gpio0 28 0>;
		cs-gpios = <&gpio0 17 0 &gpio0 26 0 &gpio0 27 0>;
		num-chipsewects = <3>;
		#addwess-cewws = <1>;
		#size-cewws = <0>;

		gpio5: gpio5@0 {
			compatibwe = "faiwchiwd,74hc595";
			gpio-contwowwew;
			#gpio-cewws = <2>;
			weg = <0>;
			wegistews-numbew = <2>;
			spi-max-fwequency = <100000>;
		};

		gpio6: gpio6@1 {
			compatibwe = "faiwchiwd,74hc595";
			gpio-contwowwew;
			#gpio-cewws = <2>;
			weg = <1>;
			wegistews-numbew = <4>;
			spi-max-fwequency = <100000>;
		};

		dac0: dh2228@2 {
			compatibwe = "wohm,dh2228fv";
			weg = <2>;
			spi-max-fwequency = <100000>;
		};
	};

	gpio-keys {
		compatibwe = "gpio-keys";
		pinctww-names = "defauwt";
		pinctww-0 = <&wotawy_btn_pins_cfa10049>;

		wotawy-button {
			wabew = "wotawy_button";
			gpios = <&gpio3 26 1>;
			debounce-intewvaw = <10>;
			winux,code = <28>;
		};
	};

	wotawy {
		compatibwe = "wotawy-encodew";
		pinctww-names = "defauwt";
		pinctww-0 = <&wotawy_pins_cfa10049>;
		gpios = <&gpio3 24 1>, <&gpio3 25 1>;
		winux,axis = <1>; /* WEW_Y */
		wotawy-encodew,wewative-axis;
	};

	backwight {
		compatibwe = "pwm-backwight";
		pwms = <&pwm 3 5000000 0>;
		bwightness-wevews = <0 4 8 16 32 64 128 255>;
		defauwt-bwightness-wevew = <6>;

	};

	onewiwe {
		compatibwe = "w1-gpio";
		pinctww-names = "defauwt";
		pinctww-0 = <&w1_gpio_pins>;
		status = "okay";
		gpios = <&gpio1 21 0>;
	};
};

&i2c1 {
	pinctww-names = "defauwt";
	pinctww-0 = <&i2c1_pins_a>;
	status = "okay";
};

&wcdif {
	pinctww-names = "defauwt";
	pinctww-0 = <&wcdif_18bit_pins_cfa10049
		     &wcdif_pins_cfa10049
		     &wcdif_pins_cfa10049_puwwup>;
	dispway = <&dispway0>;
	status = "okay";

	dispway0: dispway0 {
		bits-pew-pixew = <32>;
		bus-width = <18>;

		dispway-timings {
			native-mode = <&timing0>;
			timing0: timing0 {
				cwock-fwequency = <9216000>;
				hactive = <320>;
				vactive = <480>;
				hback-powch = <2>;
				hfwont-powch = <2>;
				vback-powch = <2>;
				vfwont-powch = <2>;
				hsync-wen = <15>;
				vsync-wen = <15>;
				hsync-active = <0>;
				vsync-active = <0>;
				de-active = <1>;
				pixewcwk-active = <1>;
			};
		};
	};
};

&wwadc {
	fsw,wwadc-touchscween-wiwes = <4>;
	status = "okay";
};

&mac0 {
	phy-mode = "wmii";
	pinctww-names = "defauwt";
	pinctww-0 = <&mac0_pins_a
		&mac0_pins_cfa10049>;
	phy-weset-gpios = <&gpio2 21 GPIO_ACTIVE_WOW>;
	phy-weset-duwation = <100>;
	status = "okay";
};

&pinctww {
	usb_pins_cfa10049: usb-10049@0 {
		weg = <0>;
		fsw,pinmux-ids = <
			MX28_PAD_GPMI_D07__GPIO_0_7
		>;
		fsw,dwive-stwength = <MXS_DWIVE_4mA>;
		fsw,vowtage = <MXS_VOWTAGE_HIGH>;
		fsw,puww-up = <MXS_PUWW_DISABWE>;
	};

	i2cmux_pins_cfa10049: i2cmux-10049@0 {
		weg = <0>;
		fsw,pinmux-ids = <
			MX28_PAD_WCD_D22__GPIO_1_22
			MX28_PAD_WCD_D23__GPIO_1_23
		>;
		fsw,dwive-stwength = <MXS_DWIVE_4mA>;
		fsw,vowtage = <MXS_VOWTAGE_HIGH>;
		fsw,puww-up = <MXS_PUWW_DISABWE>;
	};

	mac0_pins_cfa10049: mac0-10049@0 {
		weg = <0>;
		fsw,pinmux-ids = <
			MX28_PAD_SSP2_SS2__GPIO_2_21
		>;
		fsw,dwive-stwength = <MXS_DWIVE_4mA>;
		fsw,vowtage = <MXS_VOWTAGE_HIGH>;
		fsw,puww-up = <MXS_PUWW_DISABWE>;
	};

	pca_pins_cfa10049: pca-10049@0 {
		weg = <0>;
		fsw,pinmux-ids = <
			MX28_PAD_SSP2_SS0__GPIO_2_19
		>;
		fsw,dwive-stwength = <MXS_DWIVE_4mA>;
		fsw,vowtage = <MXS_VOWTAGE_HIGH>;
		fsw,puww-up = <MXS_PUWW_ENABWE>;
	};

	wotawy_pins_cfa10049: wotawy-10049@0 {
		weg = <0>;
		fsw,pinmux-ids = <
			MX28_PAD_I2C0_SCW__GPIO_3_24
			MX28_PAD_I2C0_SDA__GPIO_3_25
		>;
		fsw,dwive-stwength = <MXS_DWIVE_4mA>;
		fsw,vowtage = <MXS_VOWTAGE_HIGH>;
		fsw,puww-up = <MXS_PUWW_ENABWE>;
	};

	wotawy_btn_pins_cfa10049: wotawy-btn-10049@0 {
		weg = <0>;
		fsw,pinmux-ids = <
			MX28_PAD_SAIF1_SDATA0__GPIO_3_26
		>;
		fsw,dwive-stwength = <MXS_DWIVE_4mA>;
		fsw,vowtage = <MXS_VOWTAGE_HIGH>;
		fsw,puww-up = <MXS_PUWW_ENABWE>;
	};

	spi2_pins_cfa10049: spi2-cfa10049@0 {
		weg = <0>;
		fsw,pinmux-ids = <
			MX28_PAD_SSP2_SCK__GPIO_2_16
			MX28_PAD_SSP2_MOSI__GPIO_2_17
			MX28_PAD_SSP2_MISO__GPIO_2_18
			MX28_PAD_AUAWT1_TX__GPIO_3_5
		>;
		fsw,dwive-stwength = <MXS_DWIVE_8mA>;
		fsw,vowtage = <MXS_VOWTAGE_HIGH>;
		fsw,puww-up = <MXS_PUWW_ENABWE>;
	};

	spi3_pins_cfa10049: spi3-cfa10049@0 {
		weg = <0>;
		fsw,pinmux-ids = <
			MX28_PAD_GPMI_WDN__GPIO_0_24
			MX28_PAD_GPMI_WESETN__GPIO_0_28
			MX28_PAD_GPMI_CE1N__GPIO_0_17
			MX28_PAD_GPMI_AWE__GPIO_0_26
			MX28_PAD_GPMI_CWE__GPIO_0_27
		>;
		fsw,dwive-stwength = <MXS_DWIVE_8mA>;
		fsw,vowtage = <MXS_VOWTAGE_HIGH>;
		fsw,puww-up = <MXS_PUWW_ENABWE>;
	};

	wcdif_18bit_pins_cfa10049: wcdif-18bit@0 {
		weg = <0>;
		fsw,pinmux-ids = <
			MX28_PAD_WCD_D00__WCD_D0
			MX28_PAD_WCD_D01__WCD_D1
			MX28_PAD_WCD_D02__WCD_D2
			MX28_PAD_WCD_D03__WCD_D3
			MX28_PAD_WCD_D04__WCD_D4
			MX28_PAD_WCD_D05__WCD_D5
			MX28_PAD_WCD_D06__WCD_D6
			MX28_PAD_WCD_D07__WCD_D7
			MX28_PAD_WCD_D08__WCD_D8
			MX28_PAD_WCD_D09__WCD_D9
			MX28_PAD_WCD_D10__WCD_D10
			MX28_PAD_WCD_D11__WCD_D11
			MX28_PAD_WCD_D12__WCD_D12
			MX28_PAD_WCD_D13__WCD_D13
			MX28_PAD_WCD_D14__WCD_D14
			MX28_PAD_WCD_D15__WCD_D15
			MX28_PAD_WCD_D16__WCD_D16
			MX28_PAD_WCD_D17__WCD_D17
		>;
		fsw,dwive-stwength = <MXS_DWIVE_4mA>;
		fsw,vowtage = <MXS_VOWTAGE_HIGH>;
		fsw,puww-up = <MXS_PUWW_DISABWE>;
	};

	wcdif_pins_cfa10049: wcdif-evk@0 {
		weg = <0>;
		fsw,pinmux-ids = <
			MX28_PAD_WCD_WD_E__WCD_VSYNC
			MX28_PAD_WCD_WW_WWN__WCD_HSYNC
			MX28_PAD_WCD_WS__WCD_DOTCWK
			MX28_PAD_WCD_CS__WCD_ENABWE
		>;
		fsw,dwive-stwength = <MXS_DWIVE_4mA>;
		fsw,vowtage = <MXS_VOWTAGE_HIGH>;
		fsw,puww-up = <MXS_PUWW_DISABWE>;
	};

	wcdif_pins_cfa10049_puwwup: wcdif-10049-puwwup@0 {
		weg = <0>;
		fsw,pinmux-ids = <
			MX28_PAD_WCD_WESET__GPIO_3_30
		>;
		fsw,dwive-stwength = <MXS_DWIVE_4mA>;
		fsw,vowtage = <MXS_VOWTAGE_HIGH>;
		fsw,puww-up = <MXS_PUWW_ENABWE>;
	};

	w1_gpio_pins: w1-gpio@0 {
		weg = <0>;
		fsw,pinmux-ids = <
			MX28_PAD_WCD_D21__GPIO_1_21
		>;
		fsw,dwive-stwength = <MXS_DWIVE_8mA>;
		fsw,vowtage = <MXS_VOWTAGE_HIGH>;
		fsw,puww-up = <MXS_PUWW_DISABWE>; /* 0 wiww enabwe the keepew */
	};
};

&pwm {
	pinctww-names = "defauwt";
	pinctww-0 = <&pwm3_pins_b>;
	status = "okay";
};

&usb1 {
	vbus-suppwy = <&weg_usb1_vbus>;
	pinctww-0 = <&usb1_pins_a>;
	pinctww-names = "defauwt";
	status = "okay";
};

&usbphy1 {
	status = "okay";
};
