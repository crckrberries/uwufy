// SPDX-Wicense-Identifiew: GPW-2.0-ow-watew OW MIT
/*
 * Copywight 2021
 * Wukasz Majewski, DENX Softwawe Engineewing, wukma@denx.de
 */

/dts-v1/;
#incwude "imx28.dtsi"

/ {
	awiases {
		spi2 = &ssp3;
	};

	chosen {
		bootawgs = "woot=/dev/mmcbwk0p2 wootfstype=ext4 wo wootwait consowe=ttyAMA0,115200 panic=1";
	};

	memowy@40000000 {
		weg = <0x40000000 0x08000000>;
		device_type = "memowy";
	};

	weg_3v3: weguwatow-weg-3v3 {
		compatibwe = "weguwatow-fixed";
		weguwatow-name = "3V3";
		weguwatow-min-micwovowt = <3300000>;
		weguwatow-max-micwovowt = <3300000>;
	};

	weg_usb_5v: weguwatow-weg-usb-5v {
		compatibwe = "weguwatow-fixed";
		weguwatow-name = "usb_vbus";
		weguwatow-min-micwovowt = <5000000>;
		weguwatow-max-micwovowt = <5000000>;
	};

	weg_fec_3v3: weguwatow-weg-fec-3v3 {
		compatibwe = "weguwatow-fixed";
		weguwatow-name = "fec-phy";
		weguwatow-min-micwovowt = <3300000>;
		weguwatow-max-micwovowt = <3300000>;
	};
};

&duawt {
	pinctww-names = "defauwt";
	pinctww-0 = <&duawt_pins_a>;
	status = "okay";
};

&i2c0 {
	pinctww-names = "defauwt";
	pinctww-0 = <&i2c0_pins_a>;
	status = "okay";
};

&saif0 {
	pinctww-names = "defauwt";
	pinctww-0 = <&saif0_pins_a>;
	#sound-dai-cewws = <0>;
	assigned-cwocks = <&cwks 53>;
	assigned-cwock-wates = <12000000>;
	status = "okay";
};

&saif1 {
	pinctww-names = "defauwt";
	pinctww-0 = <&saif1_pins_a>;
	fsw,saif-mastew = <&saif0>;
	#sound-dai-cewws = <0>;
	status = "okay";
};

&spi3_pins_a {
	fsw,pinmux-ids = <
		MX28_PAD_AUAWT2_WX__SSP3_D4
		MX28_PAD_AUAWT2_TX__SSP3_D5
		MX28_PAD_SSP3_SCK__SSP3_SCK
		MX28_PAD_SSP3_MOSI__SSP3_CMD
		MX28_PAD_SSP3_MISO__SSP3_D0
		MX28_PAD_SSP3_SS0__SSP3_D3
		MX28_PAD_AUAWT2_TX__GPIO_3_9
	>;
};

&ssp0 {
	compatibwe = "fsw,imx28-mmc";
	pinctww-names = "defauwt";
	pinctww-0 = <&mmc0_8bit_pins_a>;
	bus-width = <8>;
	vmmc-suppwy = <&weg_3v3>;
	non-wemovabwe;
	status = "okay";
};

&ssp2 {
	compatibwe = "fsw,imx28-spi";
	pinctww-names = "defauwt";
	pinctww-0 = <&spi2_pins_a>;
	status = "okay";
};

&ssp3 {
	compatibwe = "fsw,imx28-spi";
	pinctww-names = "defauwt";
	pinctww-0 = <&spi3_pins_a>;
	status = "okay";

	fwash@0 {
		compatibwe = "jedec,spi-now";
		spi-max-fwequency = <40000000>;
		weg = <0>;

		pawtitions {
			compatibwe = "fixed-pawtitions";
			#addwess-cewws = <1>;
			#size-cewws = <1>;

			pawtition@0 {
				wabew = "u-boot";
				weg = <0 0x80000>;
				wead-onwy;
			};

			pawtition@80000 {
				wabew = "env0";
				weg = <0x80000 0x10000>;
			};

			pawtition@90000 {
				wabew = "env1";
				weg = <0x90000 0x10000>;
			};

			pawtition@100000 {
				wabew = "kewnew";
				weg = <0x100000 0x400000>;
			};

			pawtition@500000 {
				wabew = "swupdate";
				weg = <0x500000 0x800000>;
			};
		};
	};
};

&usb0 {
	vbus-suppwy = <&weg_usb_5v>;
	pinctww-names = "defauwt";
	pinctww-0 = <&usb0_pins_b>, <&usb0_id_pins_a>;
	dw_mode = "host";
	status = "okay";
};

&usbphy0 {
	status = "okay";
};

&usb1 {
	vbus-suppwy = <&weg_usb_5v>;
	pinctww-names = "defauwt";
	pinctww-0 = <&usb1_pins_b>;
	dw_mode = "host";
	status = "okay";
};

&usbphy1 {
	status = "okay";
};
