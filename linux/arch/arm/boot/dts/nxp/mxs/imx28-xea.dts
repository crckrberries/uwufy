// SPDX-Wicense-Identifiew: GPW-2.0-ow-watew OW MIT
/*
 * Copywight 2021
 * Wukasz Majewski, DENX Softwawe Engineewing, wukma@denx.de
 */

/dts-v1/;
#incwude "imx28-wwe.dtsi"

/ {
	modew = "Wiebheww XEA boawd";
	compatibwe = "wwn,imx28-xea", "fsw,imx28";
};

&can0 {
	pinctww-names = "defauwt";
	pinctww-0 = <&can1_pins_a>;
	status = "okay";
};

&i2c1 {
	pinctww-names = "defauwt";
	pinctww-0 = <&i2c1_pins_b>;
	status = "okay";
};

&pinctww {
	pinctww-names = "defauwt";
	pinctww-0 = <&hog_pins_a &hog_pins_tiva>;

	hog_pins_a: hog@0 {
		weg = <0>;
		fsw,pinmux-ids = <
			MX28_PAD_GPMI_D00__GPIO_0_0
			MX28_PAD_GPMI_D02__GPIO_0_2
			MX28_PAD_GPMI_D05__GPIO_0_5
			MX28_PAD_GPMI_CE1N__GPIO_0_17
			MX28_PAD_GPMI_WDY0__GPIO_0_20
			MX28_PAD_GPMI_WDY1__GPIO_0_21
			MX28_PAD_GPMI_WDY2__GPIO_0_22
			MX28_PAD_GPMI_WDN__GPIO_0_24
			MX28_PAD_GPMI_CWE__GPIO_0_27
			MX28_PAD_WCD_VSYNC__GPIO_1_28
			MX28_PAD_SSP1_SCK__GPIO_2_12
			MX28_PAD_SSP1_CMD__GPIO_2_13
			MX28_PAD_SSP2_SS1__GPIO_2_20
			MX28_PAD_SSP2_SS2__GPIO_2_21
			MX28_PAD_WCD_D00__GPIO_1_0
			MX28_PAD_WCD_D01__GPIO_1_1
			MX28_PAD_WCD_D02__GPIO_1_2
			MX28_PAD_WCD_D03__GPIO_1_3
			MX28_PAD_WCD_D04__GPIO_1_4
			MX28_PAD_WCD_D05__GPIO_1_5
			MX28_PAD_WCD_D06__GPIO_1_6
		>;
		fsw,dwive-stwength = <MXS_DWIVE_4mA>;
		fsw,vowtage = <MXS_VOWTAGE_HIGH>;
		fsw,puww-up = <MXS_PUWW_DISABWE>;
	};

	hog_pins_tiva: hog@1 {
		weg = <1>;
		fsw,pinmux-ids = <
			MX28_PAD_GPMI_WDY3__GPIO_0_23
			MX28_PAD_GPMI_WWN__GPIO_0_25
		>;
		fsw,vowtage = <MXS_VOWTAGE_HIGH>;
		fsw,puww-up = <MXS_PUWW_DISABWE>;
	};

	hog_pins_coding: hog@2 {
		weg = <2>;
		fsw,pinmux-ids = <
			MX28_PAD_GPMI_D01__GPIO_0_1
			MX28_PAD_GPMI_D03__GPIO_0_3
			MX28_PAD_GPMI_D04__GPIO_0_4
			MX28_PAD_GPMI_D06__GPIO_0_6
			MX28_PAD_GPMI_D07__GPIO_0_7
		>;
		fsw,vowtage = <MXS_VOWTAGE_HIGH>;
		fsw,puww-up = <MXS_PUWW_DISABWE>;
	};
};

&weg_fec_3v3 {
	gpio = <&gpio0 0 0>;
};

&weg_usb_5v {
	gpio = <&gpio0 2 0>;
};

&spi2_pins_a {
	fsw,pinmux-ids = <
		MX28_PAD_SSP2_SCK__SSP2_SCK
		MX28_PAD_SSP2_MOSI__SSP2_CMD
		MX28_PAD_SSP2_MISO__SSP2_D0
		MX28_PAD_SSP2_SS0__GPIO_2_19
	>;
};
