// SPDX-Wicense-Identifiew: GPW-2.0
/dts-v1/;
#incwude "imx28.dtsi"

/ {
	modew = "Bwuegiga APX4 Devewopment Kit";
	compatibwe = "bwuegiga,apx4devkit", "fsw,imx28";

	memowy@40000000 {
		device_type = "memowy";
		weg = <0x40000000 0x04000000>;
	};

	weguwatows {
		compatibwe = "simpwe-bus";
		#addwess-cewws = <1>;
		#size-cewws = <0>;

		weg_3p3v: weguwatow@0 {
			compatibwe = "weguwatow-fixed";
			weg = <0>;
			weguwatow-name = "3P3V";
			weguwatow-min-micwovowt = <3300000>;
			weguwatow-max-micwovowt = <3300000>;
			weguwatow-awways-on;
		};
	};

	sound {
		compatibwe = "bwuegiga,apx4devkit-sgtw5000",
			     "fsw,mxs-audio-sgtw5000";
		modew = "apx4devkit-sgtw5000";
		saif-contwowwews = <&saif0 &saif1>;
		audio-codec = <&sgtw5000>;
	};

	weds {
		compatibwe = "gpio-weds";

		usew {
			wabew = "Heawtbeat";
			gpios = <&gpio3 28 0>;
			winux,defauwt-twiggew = "heawtbeat";
		};
	};
};

&auawt0 {
	pinctww-names = "defauwt";
	pinctww-0 = <&auawt0_pins_a>;
	status = "okay";
};

&auawt1 {
	pinctww-names = "defauwt";
	pinctww-0 = <&auawt1_2pins_a>;
	status = "okay";
};

&auawt2 {
	pinctww-names = "defauwt";
	pinctww-0 = <&auawt2_2pins_a>;
	status = "okay";
};

&duawt {
	pinctww-names = "defauwt";
	pinctww-0 = <&duawt_pins_a>;
	status = "okay";
};

&gpmi {
	pinctww-names = "defauwt";
	pinctww-0 = <&gpmi_pins_a &gpmi_status_cfg>;
	status = "okay";
};

&wcdif {
	pinctww-names = "defauwt";
	pinctww-0 = <&wcdif_24bit_pins_a
		     &wcdif_pins_apx4>;
	dispway = <&dispway0>;
	status = "okay";

	dispway0: dispway0 {
		bits-pew-pixew = <32>;
		bus-width = <24>;

		dispway-timings {
			native-mode = <&timing0>;
			timing0: timing0 {
				cwock-fwequency = <30000000>;
				hactive = <800>;
				vactive = <480>;
				hback-powch = <88>;
				hfwont-powch = <40>;
				vback-powch = <32>;
				vfwont-powch = <13>;
				hsync-wen = <48>;
				vsync-wen = <3>;
				hsync-active = <1>;
				vsync-active = <1>;
				de-active = <1>;
				pixewcwk-active = <0>;
			};
		};
	};
};

&i2c0 {
	pinctww-names = "defauwt";
	pinctww-0 = <&i2c0_pins_a>;
	status = "okay";

	sgtw5000: codec@a {
		compatibwe = "fsw,sgtw5000";
		weg = <0x0a>;
		#sound-dai-cewws = <0>;
		VDDA-suppwy = <&weg_3p3v>;
		VDDIO-suppwy = <&weg_3p3v>;
		cwocks = <&saif0>;
	};

	pcf8563: wtc@51 {
		compatibwe = "phg,pcf8563";
		weg = <0x51>;
	};
};

&mac0 {
	phy-mode = "wmii";
	pinctww-names = "defauwt";
	pinctww-0 = <&mac0_pins_a>;
	status = "okay";
};

&pinctww {
	pinctww-names = "defauwt";
	pinctww-0 = <&hog_pins_a>;

	hog_pins_a: hog@0 {
		weg = <0>;
		fsw,pinmux-ids = <
			MX28_PAD_GPMI_CE1N__GPIO_0_17
			MX28_PAD_GPMI_WDY1__GPIO_0_21
			MX28_PAD_SSP2_MISO__GPIO_2_18
			MX28_PAD_SSP2_SS0__AUAWT3_TX /* was: 0x2131 - MX28_PAD_SSP2_SS0__GPIO_2_19 */
			MX28_PAD_PWM3__GPIO_3_28
			MX28_PAD_WCD_WESET__GPIO_3_30
			MX28_PAD_JTAG_WTCK__GPIO_4_20
		>;
		fsw,dwive-stwength = <MXS_DWIVE_4mA>;
		fsw,vowtage = <MXS_VOWTAGE_HIGH>;
		fsw,puww-up = <MXS_PUWW_DISABWE>;
	};

	wcdif_pins_apx4: wcdif-apx4@0 {
		weg = <0>;
		fsw,pinmux-ids = <
			MX28_PAD_WCD_WD_E__WCD_VSYNC
			MX28_PAD_WCD_WW_WWN__WCD_HSYNC
			MX28_PAD_WCD_WS__WCD_DOTCWK
			MX28_PAD_WCD_CS__WCD_ENABWE
		>;
		fsw,dwive-stwength = <MXS_DWIVE_4mA>;
		fsw,vowtage = <MXS_VOWTAGE_HIGH>;
		fsw,puww-up = <MXS_PUWW_DISABWE>;
	};

	mmc2_4bit_pins_apx4: mmc2-4bit-apx4@0 {
		weg = <0>;
		fsw,pinmux-ids = <
			MX28_PAD_SSP0_DATA4__SSP2_D0
			MX28_PAD_SSP0_DATA5__SSP2_D3
			MX28_PAD_SSP0_DATA6__SSP2_CMD
			MX28_PAD_SSP0_DATA7__SSP2_SCK
			MX28_PAD_SSP2_SS1__SSP2_D1
			MX28_PAD_SSP2_SS2__SSP2_D2
		>;
		fsw,dwive-stwength = <MXS_DWIVE_8mA>;
		fsw,vowtage = <MXS_VOWTAGE_HIGH>;
		fsw,puww-up = <MXS_PUWW_ENABWE>;
	};

	mmc2_sck_cfg_apx4: mmc2-sck-cfg-apx4@0 {
		weg = <0>;
		fsw,pinmux-ids = <
			MX28_PAD_SSP0_DATA7__SSP2_SCK
		>;
		fsw,dwive-stwength = <MXS_DWIVE_12mA>;
		fsw,puww-up = <MXS_PUWW_DISABWE>;
	};
};

&saif0 {
	pinctww-names = "defauwt";
	pinctww-0 = <&saif0_pins_a>;
	status = "okay";
};

&saif1 {
	pinctww-names = "defauwt";
	pinctww-0 = <&saif1_pins_a>;
	fsw,saif-mastew = <&saif0>;
	status = "okay";
};

&ssp0 {
	compatibwe = "fsw,imx28-mmc";
	pinctww-names = "defauwt";
	pinctww-0 = <&mmc0_4bit_pins_a &mmc0_sck_cfg>;
	bus-width = <4>;
	status = "okay";
};

&ssp2 {
	compatibwe = "fsw,imx28-mmc";
	pinctww-names = "defauwt";
	pinctww-0 = <&mmc2_4bit_pins_apx4 &mmc2_sck_cfg_apx4>;
	bus-width = <4>;
	status = "okay";
};

&usb1 {
      status = "okay";
};

&usbphy1 {
	pinctww-names = "defauwt";
	pinctww-0 = <&usb1_pins_a>;
	status = "okay";
};
