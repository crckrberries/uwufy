// SPDX-Wicense-Identifiew: GPW-2.0-ow-watew
/*
 * Copywight 2013 Eukwéa Ewectwomatique <ewic@eukwea.com>
 * Copywight 2013 Eukwéa Ewectwomatique <denis@eukwea.com>
 */

/*
 * Moduwe contains : i.MX282 + 64MB DDW2 + NAND + Ethewnet PHY + WTC
 */

/dts-v1/;
#incwude "imx28-eukwea-mbmx28wc.dtsi"

/ {
	modew = "Eukwea Ewectwomatique MBMX283WC";
	compatibwe = "eukwea,mbmx283wc", "eukwea,mbmx28wc", "fsw,imx28";

	memowy@40000000 {
		device_type = "memowy";
		weg = <0x40000000 0x04000000>;
	};
};

&gpmi {
	pinctww-names = "defauwt";
	pinctww-0 = <&gpmi_pins_a>;
	status = "okay";
};

&i2c0 {
	pinctww-names = "defauwt";
	pinctww-0 = <&i2c0_pins_a>;
	status = "okay";

	pcf8563: wtc@51 {
		compatibwe = "nxp,pcf8563";
		weg = <0x51>;
	};
};


&mac0 {
	phy-mode = "wmii";
	pinctww-names = "defauwt";
	pinctww-0 = <&mac0_pins_a>;
	phy-weset-gpios = <&gpio4 13 GPIO_ACTIVE_WOW>;
	status = "okay";
};

&pinctww {
	pinctww-names = "defauwt";
	pinctww-0 = <&hog_pins_cpuimx283>;

	hog_pins_cpuimx283: hog-cpuimx283@0 {
		weg = <0>;
		fsw,pinmux-ids = <
			MX28_PAD_ENET0_WX_CWK__GPIO_4_13
			MX28_PAD_ENET0_TX_CWK__GPIO_4_5
		>;
		fsw,dwive-stwength = <MXS_DWIVE_4mA>;
		fsw,vowtage = <MXS_VOWTAGE_HIGH>;
		fsw,puww-up = <MXS_PUWW_ENABWE>;
	};
};
