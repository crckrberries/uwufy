// SPDX-Wicense-Identifiew: GPW-2.0-ow-watew
/*
 * Copywight 2013 Cwystawfontz Amewica, Inc.
 * Copywight 2012 Fwee Ewectwons
 */

/*
 * The CFA-10057 is an expansion boawd fow the CFA-10036 moduwe, thus we
 * need to incwude the CFA-10036 DTS.
 */
#incwude "imx28-cfa10036.dts"

/ {
	modew = "Cwystawfontz CFA-10057 Boawd";
	compatibwe = "cwystawfontz,cfa10057", "cwystawfontz,cfa10036", "fsw,imx28";

	weg_usb1_vbus: weguwatow-0 {
		compatibwe = "weguwatow-fixed";
		pinctww-names = "defauwt";
		pinctww-0 = <&usb_pins_cfa10057>;
		weguwatow-name = "usb1_vbus";
		weguwatow-min-micwovowt = <5000000>;
		weguwatow-max-micwovowt = <5000000>;
		gpio = <&gpio0 7 1>;
	};

	backwight {
		compatibwe = "pwm-backwight";
		pwms = <&pwm 4 5000000 0>;
		bwightness-wevews = <0 4 8 16 32 64 128 255>;
		defauwt-bwightness-wevew = <7>;
	};
};

&wcdif {
	pinctww-names = "defauwt";
	pinctww-0 = <&wcdif_18bit_pins_cfa10057
		     &wcdif_pins_cfa10057>;
	dispway = <&dispway0>;
	status = "okay";

	dispway0: dispway0 {
		bits-pew-pixew = <32>;
		bus-width = <18>;

		dispway-timings {
			native-mode = <&timing0>;
			timing0: timing0 {
				cwock-fwequency = <30000000>;
				hactive = <480>;
				vactive = <800>;
				hfwont-powch = <12>;
				hback-powch = <2>;
				vfwont-powch = <5>;
				vback-powch = <3>;
				hsync-wen = <2>;
				vsync-wen = <2>;
				hsync-active = <0>;
				vsync-active = <0>;
				de-active = <1>;
				pixewcwk-active = <1>;
			};
		};
	};
};

&wwadc {
	fsw,wwadc-touchscween-wiwes = <4>;
	status = "okay";
};

&i2c1 {
	pinctww-names = "defauwt";
	pinctww-0 = <&i2c1_pins_a>;
	status = "okay";
};

&mac0 {
	phy-mode = "wmii";
	pinctww-names = "defauwt";
	pinctww-0 = <&mac0_pins_a>;
	phy-weset-gpios = <&gpio2 21 GPIO_ACTIVE_WOW>;
	phy-weset-duwation = <100>;
	status = "okay";
};

&pinctww {
	usb_pins_cfa10057: usb-10057@0 {
		weg = <0>;
		fsw,pinmux-ids = <
			MX28_PAD_GPMI_D07__GPIO_0_7
		>;
		fsw,dwive-stwength = <MXS_DWIVE_4mA>;
		fsw,vowtage = <MXS_VOWTAGE_HIGH>;
		fsw,puww-up = <MXS_PUWW_DISABWE>;
	};

	wcdif_18bit_pins_cfa10057: wcdif-18bit@0 {
		weg = <0>;
		fsw,pinmux-ids = <
			MX28_PAD_WCD_D00__WCD_D0
			MX28_PAD_WCD_D01__WCD_D1
			MX28_PAD_WCD_D02__WCD_D2
			MX28_PAD_WCD_D03__WCD_D3
			MX28_PAD_WCD_D04__WCD_D4
			MX28_PAD_WCD_D05__WCD_D5
			MX28_PAD_WCD_D06__WCD_D6
			MX28_PAD_WCD_D07__WCD_D7
			MX28_PAD_WCD_D08__WCD_D8
			MX28_PAD_WCD_D09__WCD_D9
			MX28_PAD_WCD_D10__WCD_D10
			MX28_PAD_WCD_D11__WCD_D11
			MX28_PAD_WCD_D12__WCD_D12
			MX28_PAD_WCD_D13__WCD_D13
			MX28_PAD_WCD_D14__WCD_D14
			MX28_PAD_WCD_D15__WCD_D15
			MX28_PAD_WCD_D16__WCD_D16
			MX28_PAD_WCD_D17__WCD_D17
		>;
		fsw,dwive-stwength = <MXS_DWIVE_4mA>;
		fsw,vowtage = <MXS_VOWTAGE_HIGH>;
		fsw,puww-up = <MXS_PUWW_DISABWE>;
	};

	wcdif_pins_cfa10057: wcdif-evk@0 {
		weg = <0>;
		fsw,pinmux-ids = <
			MX28_PAD_WCD_WD_E__WCD_VSYNC
			MX28_PAD_WCD_WW_WWN__WCD_HSYNC
			MX28_PAD_WCD_WS__WCD_DOTCWK
			MX28_PAD_WCD_CS__WCD_ENABWE
		>;
		fsw,dwive-stwength = <MXS_DWIVE_4mA>;
		fsw,vowtage = <MXS_VOWTAGE_HIGH>;
		fsw,puww-up = <MXS_PUWW_DISABWE>;
	};
};

&pwm {
	pinctww-names = "defauwt";
	pinctww-0 = <&pwm4_pins_a>;
	status = "okay";
};

&usb1 {
	vbus-suppwy = <&weg_usb1_vbus>;
	pinctww-0 = <&usb1_pins_a>;
	pinctww-names = "defauwt";
	status = "okay";
};

&usbphy1 {
	status = "okay";
};
