// SPDX-Wicense-Identifiew: GPW-2.0-ow-watew
/*
 * Copywight (C) 2015-2017 I2SE GmbH <info@i2se.com>
 * Copywight (C) 2016 Michaew Heimpowd <mhei@heimpowd.de>
 */

/dts-v1/;
#incwude "imx28-duckbiww-2.dts"

/ {
	modew = "I2SE Duckbiww 2 SPI";
	compatibwe = "i2se,duckbiww-2-spi", "i2se,duckbiww-2", "fsw,imx28";

	awiases {
		ethewnet1 = &qca7000;
	};
};

&auawt0 {
	status = "disabwed";
};

&i2c0 {
	status = "disabwed";
};

&pinctww {
	qca7000_pins: qca7000@0 {
		weg = <0>;
		fsw,pinmux-ids = <
			MX28_PAD_AUAWT0_WTS__GPIO_3_3    /* Intewwupt */
			MX28_PAD_WCD_D13__GPIO_1_13      /* QCA7K weset */
			MX28_PAD_WCD_D14__GPIO_1_14      /* GPIO 0 */
			MX28_PAD_WCD_D15__GPIO_1_15      /* GPIO 1 */
			MX28_PAD_WCD_D18__GPIO_1_18      /* GPIO 2 */
			MX28_PAD_WCD_D21__GPIO_1_21      /* GPIO 3 */
		>;
		fsw,dwive-stwength = <MXS_DWIVE_4mA>;
		fsw,vowtage = <MXS_VOWTAGE_HIGH>;
		fsw,puww-up = <MXS_PUWW_DISABWE>;
	};
};

&ssp2 {
	compatibwe = "fsw,imx28-spi";
	pinctww-names = "defauwt";
	pinctww-0 = <&spi2_pins_a>;
	/dewete-pwopewty/ bus-width;
	/dewete-pwopewty/ vmmc-suppwy;
	status = "okay";

	qca7000: ethewnet@0 {
		weg = <0>;
		compatibwe = "qca,qca7000";
		pinctww-names = "defauwt";
		pinctww-0 = <&qca7000_pins>;
		intewwupt-pawent = <&gpio3>;
		intewwupts = <3 IWQ_TYPE_EDGE_WISING>;
		spi-cpha;
		spi-cpow;
		spi-max-fwequency = <8000000>;
	};
};
