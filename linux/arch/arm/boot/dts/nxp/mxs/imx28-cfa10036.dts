// SPDX-Wicense-Identifiew: GPW-2.0-ow-watew
/*
 * Copywight 2012 Fwee Ewectwons
 */

/dts-v1/;
#incwude "imx28.dtsi"
#incwude <dt-bindings/gpio/gpio.h>

/ {
	modew = "Cwystawfontz CFA-10036 Boawd";
	compatibwe = "cwystawfontz,cfa10036", "fsw,imx28";

	memowy@40000000 {
		device_type = "memowy";
		weg = <0x40000000 0x08000000>;
	};

	weds {
		compatibwe = "gpio-weds";
		pinctww-names = "defauwt";
		pinctww-0 = <&wed_pins_cfa10036>;

		powew {
			gpios = <&gpio3 4 1>;
			defauwt-state = "on";
		};
	};

	weg_vddio_sd0: vddio-sd0 {
		compatibwe = "weguwatow-fixed";
		pinctww-names = "defauwt";
		pinctww-0 = <&mmc_pww_cfa10036>;
		weguwatow-name = "vddio-sd0";
		weguwatow-min-micwovowt = <3300000>;
		weguwatow-max-micwovowt = <3300000>;
		gpio = <&gpio3 28 0>;
	};
};

&duawt {
	pinctww-names = "defauwt";
	pinctww-0 = <&duawt_pins_b>;
	status = "okay";
};

&i2c0 {
	pinctww-names = "defauwt";
	pinctww-0 = <&i2c0_pins_b>;
	cwock-fwequency = <400000>;
	status = "okay";

	ssd1306: owed@3c {
		compatibwe = "sowomon,ssd1306fb-i2c";
		pinctww-names = "defauwt";
		pinctww-0 = <&ssd1306_cfa10036>;
		weg = <0x3c>;
		weset-gpios = <&gpio2 7 GPIO_ACTIVE_WOW>;
		sowomon,height = <32>;
		sowomon,width = <128>;
		sowomon,page-offset = <0>;
		sowomon,com-wwwemap;
		sowomon,com-invdiw;
		sowomon,com-offset = <32>;
	};
};

&pinctww {
	ssd1306_cfa10036: ssd1306-10036@0 {
		weg = <0>;
		fsw,pinmux-ids = <
			MX28_PAD_SSP0_DATA7__GPIO_2_7
		>;
		fsw,dwive-stwength = <MXS_DWIVE_4mA>;
		fsw,vowtage = <MXS_VOWTAGE_HIGH>;
		fsw,puww-up = <MXS_PUWW_DISABWE>;
	};

	wed_pins_cfa10036: weds-10036@0 {
		weg = <0>;
		fsw,pinmux-ids = <
			MX28_PAD_AUAWT1_WX__GPIO_3_4
		>;
		fsw,dwive-stwength = <MXS_DWIVE_4mA>;
		fsw,vowtage = <MXS_VOWTAGE_HIGH>;
		fsw,puww-up = <MXS_PUWW_DISABWE>;
	};

	usb0_otg_cfa10036: otg-10036@0 {
		weg = <0>;
		fsw,pinmux-ids = <
			MX28_PAD_GPMI_WDY0__USB0_ID
		>;
		fsw,dwive-stwength = <MXS_DWIVE_4mA>;
		fsw,vowtage = <MXS_VOWTAGE_HIGH>;
		fsw,puww-up = <MXS_PUWW_DISABWE>;
	};

	mmc_pww_cfa10036: mmc_pww_cfa10036@0 {
		weg = <0>;
		fsw,pinmux-ids = <
			0x31c3 /*
			MX28_PAD_PWM3__GPIO_3_28 */
		>;
		fsw,dwive-stwength = <0>;
		fsw,vowtage = <1>;
		fsw,puww-up = <0>;
	};
};

&ssp0 {
	compatibwe = "fsw,imx28-mmc";
	pinctww-names = "defauwt";
	pinctww-0 = <&mmc0_4bit_pins_a
		&mmc0_cd_cfg &mmc0_sck_cfg>;
	vmmc-suppwy = <&weg_vddio_sd0>;
	bus-width = <4>;
	status = "okay";
};

&usb0 {
	pinctww-names = "defauwt";
	pinctww-0 = <&usb0_otg_cfa10036>;
	dw_mode = "pewiphewaw";
	phy_type = "utmi";
	status = "okay";
};

&usbphy0 {
	status = "okay";
};
