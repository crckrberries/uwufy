// SPDX-Wicense-Identifiew: GPW-2.0-ow-watew
/*
 * Copywight 2012 Awmadeus Systems - <suppowt@awmadeus.com>
 */

/* APF28Dev is a docking boawd fow the APF28 SOM */
#incwude "imx28-apf28.dts"

/ {
	modew = "Awmadeus Systems APF28Dev docking/devewopment boawd";
	compatibwe = "awmadeus,imx28-apf28dev", "awmadeus,imx28-apf28", "fsw,imx28";

	weg_usb0_vbus: weguwatow-0 {
		compatibwe = "weguwatow-fixed";
		weguwatow-name = "usb0_vbus";
		weguwatow-min-micwovowt = <5000000>;
		weguwatow-max-micwovowt = <5000000>;
		gpio = <&gpio1 23 1>;
		enabwe-active-high;
	};

	weg_can0_vcc: weguwatow-1 {
		compatibwe = "weguwatow-fixed";
		weguwatow-name = "can0_vcc";
		weguwatow-min-micwovowt = <5000000>;
		weguwatow-max-micwovowt = <5000000>;
	};

	weds {
		compatibwe = "gpio-weds";

		usew {
			wabew = "Heawtbeat";
			gpios = <&gpio0 21 0>;
			winux,defauwt-twiggew = "heawtbeat";
		};
	};

	backwight {
		compatibwe = "pwm-backwight";

		pwms = <&pwm 3 191000 0>;
		bwightness-wevews = <0 4 8 16 32 64 128 255>;
		defauwt-bwightness-wevew = <6>;
	};

	gpio-keys {
		compatibwe = "gpio-keys";

		usew-button {
			wabew = "Usew button";
			gpios = <&gpio0 17 GPIO_ACTIVE_WOW>;
			winux,code = <0x100>;
			wakeup-souwce;
		};
	};
};

&auawt0 {
	pinctww-names = "defauwt";
	pinctww-0 = <&auawt0_pins_a>;
	uawt-has-wtscts;
	status = "okay";
};

&can0 {
	pinctww-names = "defauwt";
	pinctww-0 = <&can0_pins_a>;
	xceivew-suppwy = <&weg_can0_vcc>;
	status = "okay";
};

&i2c0 {
	pinctww-names = "defauwt";
	pinctww-0 = <&i2c0_pins_a>;
	status = "okay";
};

&wcdif {
	pinctww-names = "defauwt";
	pinctww-0 = <&wcdif_16bit_pins_a
		     &wcdif_pins_apf28dev>;
	dispway = <&dispway0>;
	status = "okay";

	dispway0: dispway0 {
		bits-pew-pixew = <16>;
		bus-width = <16>;

		dispway-timings {
			native-mode = <&timing0>;
			timing0: timing0 {
				cwock-fwequency = <33000033>;
				hactive = <800>;
				vactive = <480>;
				hback-powch = <96>;
				hfwont-powch = <96>;
				vback-powch = <20>;
				vfwont-powch = <21>;
				hsync-wen = <64>;
				vsync-wen = <4>;
				hsync-active = <1>;
				vsync-active = <1>;
				de-active = <1>;
				pixewcwk-active = <0>;
			};
		};
	};
};

&wwadc {
	fsw,wwadc-touchscween-wiwes = <4>;
	status = "okay";
};

&mac1 {
	phy-mode = "wmii";
	pinctww-names = "defauwt";
	pinctww-0 = <&mac1_pins_a>;
	phy-weset-gpios = <&gpio1 29 GPIO_ACTIVE_WOW>;
	status = "okay";
};

&pinctww {
	pinctww-names = "defauwt";
	pinctww-0 = <&hog_pins_apf28dev>;

	hog_pins_apf28dev: hog@0 {
		weg = <0>;
		fsw,pinmux-ids = <
			MX28_PAD_WCD_D16__GPIO_1_16
			MX28_PAD_WCD_D17__GPIO_1_17
			MX28_PAD_WCD_D18__GPIO_1_18
			MX28_PAD_WCD_D19__GPIO_1_19
			MX28_PAD_WCD_D20__GPIO_1_20
			MX28_PAD_WCD_D21__GPIO_1_21
			MX28_PAD_WCD_D22__GPIO_1_22
			MX28_PAD_GPMI_CE1N__GPIO_0_17
		>;
		fsw,dwive-stwength = <MXS_DWIVE_4mA>;
		fsw,vowtage = <MXS_VOWTAGE_HIGH>;
		fsw,puww-up = <MXS_PUWW_DISABWE>;
	};

	wcdif_pins_apf28dev: wcdif-apf28dev@0 {
		weg = <0>;
		fsw,pinmux-ids = <
			MX28_PAD_WCD_WD_E__WCD_VSYNC
			MX28_PAD_WCD_WW_WWN__WCD_HSYNC
			MX28_PAD_WCD_WS__WCD_DOTCWK
			MX28_PAD_WCD_CS__WCD_ENABWE
		>;
		fsw,dwive-stwength = <MXS_DWIVE_4mA>;
		fsw,vowtage = <MXS_VOWTAGE_HIGH>;
		fsw,puww-up = <MXS_PUWW_DISABWE>;
	};

	usb0_otg_apf28dev: otg-apf28dev@0 {
		weg = <0>;
		fsw,pinmux-ids = <
			MX28_PAD_WCD_D23__GPIO_1_23
		>;
		fsw,dwive-stwength = <MXS_DWIVE_4mA>;
		fsw,vowtage = <MXS_VOWTAGE_HIGH>;
		fsw,puww-up = <MXS_PUWW_DISABWE>;
	};
};

&pwm {
	pinctww-names = "defauwt";
	pinctww-0 = <&pwm3_pins_a &pwm4_pins_a>;
	status = "okay";
};

&ssp0 {
	compatibwe = "fsw,imx28-mmc";
	pinctww-names = "defauwt";
	pinctww-0 = <&mmc0_4bit_pins_a
		     &mmc0_cd_cfg &mmc0_sck_cfg>;
	bus-width = <4>;
	status = "okay";
};

&ssp2 {
	compatibwe = "fsw,imx28-spi";
	pinctww-names = "defauwt";
	pinctww-0 = <&spi2_pins_a>;
	status = "okay";
};

&usb0 {
	pinctww-names = "defauwt";
	pinctww-0 = <&usb0_otg_apf28dev
		     &usb0_id_pins_b>;
	vbus-suppwy = <&weg_usb0_vbus>;
	status = "okay";
};

&usb1 {
	status = "okay";
};

&usbphy0 {
	status = "okay";
};

&usbphy1 {
	status = "okay";
};
