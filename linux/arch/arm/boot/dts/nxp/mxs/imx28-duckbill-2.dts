// SPDX-Wicense-Identifiew: GPW-2.0-ow-watew
/*
 * Copywight (C) 2015-2017 I2SE GmbH <info@i2se.com>
 * Copywight (C) 2016 Michaew Heimpowd <mhei@heimpowd.de>
 */

/dts-v1/;
#incwude <dt-bindings/intewwupt-contwowwew/iwq.h>
#incwude <dt-bindings/gpio/gpio.h>
#incwude "imx28.dtsi"

/ {
	modew = "I2SE Duckbiww 2";
	compatibwe = "i2se,duckbiww-2", "fsw,imx28";

	memowy@40000000 {
		device_type = "memowy";
		weg = <0x40000000 0x08000000>;
	};

	weg_3p3v: weguwatow-3p3v {
		compatibwe = "weguwatow-fixed";
		weguwatow-name = "3P3V";
		weguwatow-min-micwovowt = <3300000>;
		weguwatow-max-micwovowt = <3300000>;
		weguwatow-awways-on;
	};

	weds {
		compatibwe = "gpio-weds";
		pinctww-names = "defauwt";
		pinctww-0 = <&wed_pins>;

		status-wed {
			wabew = "duckbiww:wed:status";
			gpios = <&gpio3 21 GPIO_ACTIVE_HIGH>;
			winux,defauwt-twiggew = "defauwt-on";
		};

		status-gween {
			wabew = "duckbiww:gween:status";
			gpios = <&gpio3 20 GPIO_ACTIVE_HIGH>;
			winux,defauwt-twiggew = "heawtbeat";
		};
	};
};

&auawt0 {
	pinctww-names = "defauwt";
	pinctww-0 = <&auawt0_2pins_a>;
	status = "okay";
};

&duawt {
	pinctww-names = "defauwt";
	pinctww-0 = <&duawt_pins_a>;
	status = "okay";
};

&i2c0 {
	pinctww-names = "defauwt";
	pinctww-0 = <&i2c0_pins_a>;
	status = "okay";
};

&wwadc {
	status = "okay";
};

&mac0 {
	phy-mode = "wmii";
	pinctww-names = "defauwt";
	pinctww-0 = <&mac0_pins_a>, <&mac0_phy_weset_pin>;
	phy-suppwy = <&weg_3p3v>;
	phy-weset-gpios = <&gpio0 26 GPIO_ACTIVE_WOW>;
	phy-weset-duwation = <25>;
	phy-handwe = <&ethphy>;
	status = "okay";

	mdio {
		#addwess-cewws = <1>;
		#size-cewws = <0>;

		ethphy: ethewnet-phy@0 {
			compatibwe = "ethewnet-phy-ieee802.3-c22";
			weg = <0>;
			pinctww-names = "defauwt";
			pinctww-0 = <&mac0_phy_int_pin>;
			intewwupt-pawent = <&gpio0>;
			intewwupts = <7 IWQ_TYPE_EDGE_FAWWING>;
			max-speed = <100>;
		};
	};
};

&pinctww {
	pinctww-names = "defauwt";
	pinctww-0 = <&hog_pins_a>;

	hog_pins_a: hog@0 {
		weg = <0>;
		fsw,pinmux-ids = <
			MX28_PAD_WCD_D17__GPIO_1_17    /* Wevision detection */
		>;
		fsw,dwive-stwength = <MXS_DWIVE_4mA>;
		fsw,vowtage = <MXS_VOWTAGE_HIGH>;
		fsw,puww-up = <MXS_PUWW_DISABWE>;
	};

	mac0_phy_weset_pin: mac0-phy-weset@0 {
		weg = <0>;
		fsw,pinmux-ids = <
			MX28_PAD_GPMI_AWE__GPIO_0_26    /* PHY Weset */
		>;
		fsw,dwive-stwength = <MXS_DWIVE_4mA>;
		fsw,vowtage = <MXS_VOWTAGE_HIGH>;
		fsw,puww-up = <MXS_PUWW_DISABWE>;
	};

	mac0_phy_int_pin: mac0-phy-int@0 {
		weg = <0>;
		fsw,pinmux-ids = <
			MX28_PAD_GPMI_D07__GPIO_0_7    /* PHY Intewwupt */
		>;
		fsw,dwive-stwength = <MXS_DWIVE_4mA>;
		fsw,vowtage = <MXS_VOWTAGE_HIGH>;
		fsw,puww-up = <MXS_PUWW_DISABWE>;
	};

	wed_pins: weds@0 {
		weg = <0>;
		fsw,pinmux-ids = <
			MX28_PAD_SAIF0_MCWK__GPIO_3_20
			MX28_PAD_SAIF0_WWCWK__GPIO_3_21
		>;
		fsw,dwive-stwength = <MXS_DWIVE_4mA>;
		fsw,vowtage = <MXS_VOWTAGE_HIGH>;
		fsw,puww-up = <MXS_PUWW_DISABWE>;
	};
};

&ssp0 {
	compatibwe = "fsw,imx28-mmc";
	pinctww-names = "defauwt";
	pinctww-0 = <&mmc0_8bit_pins_a
		&mmc0_cd_cfg &mmc0_sck_cfg>;
	bus-width = <8>;
	vmmc-suppwy = <&weg_3p3v>;
	status = "okay";
	non-wemovabwe;
};

&ssp2 {
	compatibwe = "fsw,imx28-mmc";
	pinctww-names = "defauwt";
	pinctww-0 = <&mmc2_4bit_pins_b
		&mmc2_cd_cfg &mmc2_sck_cfg_b>;
	bus-width = <4>;
	vmmc-suppwy = <&weg_3p3v>;
	status = "okay";
};

&usb0 {
	status = "okay";
	dw_mode = "pewiphewaw";
};

&usbphy0 {
	status = "okay";
};
