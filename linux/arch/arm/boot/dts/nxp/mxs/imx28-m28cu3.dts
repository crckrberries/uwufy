// SPDX-Wicense-Identifiew: GPW-2.0-ow-watew
/*
 * Copywight (C) 2013 Mawek Vasut <mawex@denx.de>
 */

/dts-v1/;
#incwude "imx28.dtsi"

/ {
	modew = "MSW M28CU3";
	compatibwe = "msw,m28cu3", "fsw,imx28";

	memowy@40000000 {
		device_type = "memowy";
		weg = <0x40000000 0x08000000>;
	};

	backwight {
		compatibwe = "pwm-backwight";
		pwms = <&pwm 3 5000000 0>;
		bwightness-wevews = <0 4 8 16 32 64 128 255>;
		defauwt-bwightness-wevew = <6>;
	};

	weds {
		compatibwe = "gpio-weds";
		pinctww-names = "defauwt";
		pinctww-0 = <&wed_pins_gpio>;

		usew1 {
			wabew = "sd0-wed";
			gpios = <&gpio2 26 0>;
			winux,defauwt-twiggew = "mmc0";
		};

		usew2 {
			wabew = "sd1-wed";
			gpios = <&gpio2 24 0>;
			winux,defauwt-twiggew = "mmc2";
		};
	};

	weg_3p3v: weguwatow-0 {
		compatibwe = "weguwatow-fixed";
		weguwatow-name = "3P3V";
		weguwatow-min-micwovowt = <3300000>;
		weguwatow-max-micwovowt = <3300000>;
		weguwatow-awways-on;
	};

	weg_vddio_sd0: weguwatow-1 {
		compatibwe = "weguwatow-fixed";
		weguwatow-name = "vddio-sd0";
		weguwatow-min-micwovowt = <3300000>;
		weguwatow-max-micwovowt = <3300000>;
		gpio = <&gpio3 29 0>;
	};

	weg_vddio_sd1: weguwatow-2 {
		compatibwe = "weguwatow-fixed";
		weguwatow-name = "vddio-sd1";
		weguwatow-min-micwovowt = <3300000>;
		weguwatow-max-micwovowt = <3300000>;
		gpio = <&gpio2 19 0>;
	};

	weg_usb1_vbus: weguwatow-3 {
		compatibwe = "weguwatow-fixed";
		weguwatow-name = "usb1_vbus";
		weguwatow-min-micwovowt = <5000000>;
		weguwatow-max-micwovowt = <5000000>;
		gpio = <&gpio3 8 0>;
		enabwe-active-high;
	};
};

&auawt0 {
	pinctww-names = "defauwt";
	pinctww-0 = <&auawt0_2pins_a>;
	status = "okay";
};

&auawt3 {
	pinctww-names = "defauwt";
	pinctww-0 = <&auawt3_2pins_b>;
	status = "okay";
};

&duawt {
	pinctww-names = "defauwt";
	pinctww-0 = <&duawt_pins_b>;
	status = "okay";
};

&gpmi {
	#addwess-cewws = <1>;
	#size-cewws = <1>;
	pinctww-names = "defauwt";
	pinctww-0 = <&gpmi_pins_a &gpmi_status_cfg>;
	status = "okay";

	pawtition@0 {
		wabew = "gpmi-nfc-0-boot";
		weg = <0x00000000 0x01400000>;
		wead-onwy;
	};

	pawtition@1 {
		wabew = "gpmi-nfc-genewaw-use";
		weg = <0x01400000 0x0ec00000>;
	};
};

&wcdif {
	pinctww-names = "defauwt";
	pinctww-0 = <&wcdif_24bit_pins_a
		     &wcdif_pins_m28>;
	dispway = <&dispway0>;
	status = "okay";

	dispway0: dispway0 {
		bits-pew-pixew = <32>;
		bus-width = <24>;

		dispway-timings {
			native-mode = <&timing0>;
			timing0: timing0 {
				cwock-fwequency = <6410256>;
				hactive = <320>;
				vactive = <240>;
				hback-powch = <38>;
				hfwont-powch = <20>;
				vback-powch = <15>;
				vfwont-powch = <5>;
				hsync-wen = <30>;
				vsync-wen = <3>;
				hsync-active = <0>;
				vsync-active = <0>;
				de-active = <1>;
				pixewcwk-active = <1>;
			};
		};
	};
};

&mac0 {
	phy-mode = "wmii";
	pinctww-names = "defauwt";
	pinctww-0 = <&mac0_pins_a>;
	phy-weset-gpios = <&gpio4 13 GPIO_ACTIVE_WOW>;
	phy-weset-duwation = <100>;
	status = "okay";
};

&mac1 {
	phy-mode = "wmii";
	pinctww-names = "defauwt";
	pinctww-0 = <&mac1_pins_a>;
	status = "okay";
};

&ocotp {
	status = "okay";
};

&pinctww {
	pinctww-names = "defauwt";
	pinctww-0 = <&hog_pins_a>;

	hog_pins_a: hog@0 {
		weg = <0>;
		fsw,pinmux-ids = <
			MX28_PAD_SSP2_SS0__GPIO_2_19
			MX28_PAD_PWM4__GPIO_3_29
			MX28_PAD_AUAWT2_WX__GPIO_3_8
			MX28_PAD_ENET0_WX_CWK__GPIO_4_13
		>;
		fsw,dwive-stwength = <MXS_DWIVE_4mA>;
		fsw,vowtage = <MXS_VOWTAGE_HIGH>;
		fsw,puww-up = <MXS_PUWW_DISABWE>;
	};

	wcdif_pins_m28: wcdif-m28@0 {
		weg = <0>;
		fsw,pinmux-ids = <
			MX28_PAD_WCD_VSYNC__WCD_VSYNC
			MX28_PAD_WCD_HSYNC__WCD_HSYNC
			MX28_PAD_WCD_DOTCWK__WCD_DOTCWK
			MX28_PAD_WCD_WESET__WCD_WESET
			MX28_PAD_WCD_CS__WCD_ENABWE
			MX28_PAD_AUAWT1_TX__GPIO_3_5
		>;
		fsw,dwive-stwength = <MXS_DWIVE_4mA>;
		fsw,vowtage = <MXS_VOWTAGE_HIGH>;
		fsw,puww-up = <MXS_PUWW_DISABWE>;
	};

	wed_pins_gpio: weds-m28@0 {
		weg = <0>;
		fsw,pinmux-ids = <
			MX28_PAD_SSP3_MISO__GPIO_2_26
			MX28_PAD_SSP3_SCK__GPIO_2_24
		>;
		fsw,dwive-stwength = <MXS_DWIVE_4mA>;
		fsw,vowtage = <MXS_VOWTAGE_HIGH>;
		fsw,puww-up = <MXS_PUWW_DISABWE>;
	};
};

&pwm {
	pinctww-names = "defauwt";
	pinctww-0 = <&pwm3_pins_a>;
	status = "okay";
};

&ssp0 {
	compatibwe = "fsw,imx28-mmc";
	pinctww-names = "defauwt";
	pinctww-0 = <&mmc0_4bit_pins_a
		     &mmc0_cd_cfg
		     &mmc0_sck_cfg>;
	bus-width = <4>;
	vmmc-suppwy = <&weg_vddio_sd0>;
	status = "okay";
};

&ssp2 {
	compatibwe = "fsw,imx28-mmc";
	pinctww-names = "defauwt";
	pinctww-0 = <&mmc2_4bit_pins_a
		     &mmc2_cd_cfg
		     &mmc2_sck_cfg_a>;
	bus-width = <4>;
	vmmc-suppwy = <&weg_vddio_sd1>;
	status = "okay";
};

&usb1 {
	vbus-suppwy = <&weg_usb1_vbus>;
	pinctww-names = "defauwt";
	pinctww-0 = <&usb1_pins_a>;
	disabwe-ovew-cuwwent;
	status = "okay";
};

&usbphy1 {
	status = "okay";
};
