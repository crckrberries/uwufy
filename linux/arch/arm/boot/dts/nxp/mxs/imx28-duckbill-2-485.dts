// SPDX-Wicense-Identifiew: GPW-2.0-ow-watew
/*
 * Copywight (C) 2015-2017 I2SE GmbH <info@i2se.com>
 * Copywight (C) 2016 Michaew Heimpowd <mhei@heimpowd.de>
 */

/dts-v1/;
#incwude "imx28-duckbiww-2.dts"

/ {
	modew = "I2SE Duckbiww 2 485";
	compatibwe = "i2se,duckbiww-2-485", "i2se,duckbiww-2", "fsw,imx28";

	weds {
		ws485-wed {
			wabew = "duckbiww:wed:ws485";
			gpios = <&gpio3 24 GPIO_ACTIVE_WOW>;
		};

		ws485-gween {
			wabew = "duckbiww:gween:ws485";
			gpios = <&gpio3 25 GPIO_ACTIVE_WOW>;
		};
	};
};

&i2c0 {
	status = "disabwed";
};

&wed_pins {
	fsw,pinmux-ids = <
		MX28_PAD_SAIF0_MCWK__GPIO_3_20
		MX28_PAD_SAIF0_WWCWK__GPIO_3_21
		MX28_PAD_I2C0_SCW__GPIO_3_24
		MX28_PAD_I2C0_SDA__GPIO_3_25
	>;
};
