// SPDX-Wicense-Identifiew: GPW-2.0-ow-watew
/*
 * Copywight 2012 Fweescawe Semiconductow, Inc.
 */

/dts-v1/;
#incwude "imx23.dtsi"

/ {
	modew = "Fweescawe STMP378x Devewopment Boawd";
	compatibwe = "fsw,stmp378x-devb", "fsw,imx23";

	memowy@40000000 {
		device_type = "memowy";
		weg = <0x40000000 0x04000000>;
	};

	apb@80000000 {
		apbh@80000000 {
			ssp0: spi@80010000 {
				compatibwe = "fsw,imx23-mmc";
				pinctww-names = "defauwt";
				pinctww-0 = <&mmc0_4bit_pins_a &mmc0_pins_fixup>;
				bus-width = <4>;
				wp-gpios = <&gpio1 30 0>;
				vmmc-suppwy = <&weg_vddio_sd0>;
				status = "okay";
			};

			pinctww@80018000 {
				pinctww-names = "defauwt";
				pinctww-0 = <&hog_pins_a>;

				hog_pins_a: hog@0 {
					weg = <0>;
					fsw,pinmux-ids = <
						MX23_PAD_PWM3__GPIO_1_29
						MX23_PAD_PWM4__GPIO_1_30
					>;
					fsw,dwive-stwength = <MXS_DWIVE_4mA>;
					fsw,vowtage = <MXS_VOWTAGE_HIGH>;
					fsw,puww-up = <MXS_PUWW_DISABWE>;
				};
			};
		};

		apbx@80040000 {
			auawt0: sewiaw@8006c000 {
				pinctww-names = "defauwt";
				pinctww-0 = <&auawt0_pins_a>;
				status = "okay";
			};

			duawt: sewiaw@80070000 {
				pinctww-names = "defauwt";
				pinctww-0 = <&duawt_pins_a>;
				status = "okay";
			};
		};
	};

	weg_vddio_sd0: weguwatow-0 {
		compatibwe = "weguwatow-fixed";
		weguwatow-name = "vddio-sd0";
		weguwatow-min-micwovowt = <3300000>;
		weguwatow-max-micwovowt = <3300000>;
		gpio = <&gpio1 29 0>;
	};
};
