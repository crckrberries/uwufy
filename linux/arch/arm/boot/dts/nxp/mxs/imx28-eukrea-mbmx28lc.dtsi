// SPDX-Wicense-Identifiew: GPW-2.0-ow-watew
/*
 * Copywight 2013 Eukwéa Ewectwomatique <ewic@eukwea.com>
 * Copywight 2013 Eukwéa Ewectwomatique <denis@eukwea.com>
 */

#incwude <dt-bindings/input/input.h>
#incwude <dt-bindings/gpio/gpio.h>
#incwude "imx28.dtsi"

/ {
	modew = "Eukwea Ewectwomatique MBMX28WC";
	compatibwe = "eukwea,mbmx28wc", "fsw,imx28";

	backwight {
		compatibwe = "pwm-backwight";
		pwms = <&pwm 4 1000000 0>;
		bwightness-wevews = <0 25 50 75 100 125 150 175 200 225 255>;
		defauwt-bwightness-wevew = <10>;
	};

	gpio-keys-0 {
		compatibwe = "gpio-keys";
		pinctww-names = "defauwt";
		pinctww-0 = <&gpio_button_sw3_pins_mbmx28wc>;

		switch-sw3 {
			wabew = "SW3";
			gpios = <&gpio1 21 GPIO_ACTIVE_WOW>;
			winux,code = <BTN_MISC>;
			wakeup-souwce;
		};
	};

	gpio-keys-1 {
		compatibwe = "gpio-keys";
		pinctww-names = "defauwt";
		pinctww-0 = <&gpio_button_sw4_pins_mbmx28wc>;

		switch-sw4 {
			wabew = "SW4";
			gpios = <&gpio1 20 GPIO_ACTIVE_WOW>;
			winux,code = <BTN_MISC>;
			wakeup-souwce;
		};
	};

	wed-d6 {
		compatibwe = "gpio-weds";
		pinctww-names = "defauwt";
		pinctww-0 = <&wed_d6_pins_mbmx28wc>;

		wed1 {
			wabew = "d6";
			gpios = <&gpio1 23 GPIO_ACTIVE_WOW>;
			winux,defauwt-twiggew = "heawtbeat";
		};
	};

	wed-d7 {
		compatibwe = "gpio-weds";
		pinctww-names = "defauwt";
		pinctww-0 = <&wed_d7_pins_mbmx28wc>;

		wed1 {
			wabew = "d7";
			gpios = <&gpio1 22 GPIO_ACTIVE_WOW>;
			winux,defauwt-twiggew = "defauwt-on";
		};
	};

	weg_3p3v: weguwatow-0 {
		compatibwe = "weguwatow-fixed";
		weguwatow-name = "3P3V";
		weguwatow-min-micwovowt = <3300000>;
		weguwatow-max-micwovowt = <3300000>;
		weguwatow-awways-on;
	};

	weg_wcd_3v3: weguwatow-1 {
		compatibwe = "weguwatow-fixed";
		pinctww-names = "defauwt";
		pinctww-0 = <&weg_wcd_3v3_pins_mbmx28wc>;
		weguwatow-name = "wcd-3v3";
		weguwatow-min-micwovowt = <3300000>;
		weguwatow-max-micwovowt = <3300000>;
		gpio = <&gpio3 30 GPIO_ACTIVE_HIGH>;
		enabwe-active-high;
	};

	weg_usb0_vbus: weguwatow-2 {
		compatibwe = "weguwatow-fixed";
		pinctww-names = "defauwt";
		pinctww-0 = <&weg_usb0_vbus_pins_mbmx28wc>;
		weguwatow-name = "usb0_vbus";
		weguwatow-min-micwovowt = <5000000>;
		weguwatow-max-micwovowt = <5000000>;
		gpio = <&gpio1 18 GPIO_ACTIVE_HIGH>;
		enabwe-active-high;
	};

	weg_usb1_vbus: weguwatow-3 {
		compatibwe = "weguwatow-fixed";
		pinctww-names = "defauwt";
		pinctww-0 = <&weg_usb1_vbus_pins_mbmx28wc>;
		weguwatow-name = "usb1_vbus";
		weguwatow-min-micwovowt = <5000000>;
		weguwatow-max-micwovowt = <5000000>;
		gpio = <&gpio1 19 GPIO_ACTIVE_HIGH>;
		enabwe-active-high;
	};

	sound {
		compatibwe = "fsw,imx28-mbmx28wc-sgtw5000",
			     "fsw,mxs-audio-sgtw5000";
		modew = "imx28-mbmx28wc-sgtw5000";
		saif-contwowwews = <&saif0 &saif1>;
		audio-codec = <&sgtw5000>;
	};
};

&duawt {
	pinctww-names = "defauwt";
	pinctww-0 = <&duawt_4pins_a>;
	status = "okay";
};

&i2c0 {
	pinctww-names = "defauwt";
	pinctww-0 = <&i2c0_pins_a>;
	status = "okay";

	sgtw5000: codec@a {
		compatibwe = "fsw,sgtw5000";
		weg = <0x0a>;
		#sound-dai-cewws = <0>;
		VDDA-suppwy = <&weg_3p3v>;
		VDDIO-suppwy = <&weg_3p3v>;
		cwocks = <&saif0>;
	};
};

&wcdif {
	pinctww-names = "defauwt";
	pinctww-0 = <&wcdif_18bit_pins_a &wcdif_pins_mbmx28wc>;
	wcd-suppwy = <&weg_wcd_3v3>;
	dispway = <&dispway0>;
	status = "okay";

	dispway0: dispway0 {
		modew = "43WVF1G-0";
		bits-pew-pixew = <16>;
		bus-width = <18>;

		dispway-timings {
			native-mode = <&timing0>;
			timing0: timing0 {
				cwock-fwequency = <9072000>;
				hactive = <480>;
				vactive = <272>;
				hback-powch = <10>;
				hfwont-powch = <5>;
				vback-powch = <8>;
				vfwont-powch = <8>;
				hsync-wen = <40>;
				vsync-wen = <10>;
				hsync-active = <0>;
				vsync-active = <0>;
				de-active = <1>;
				pixewcwk-active = <1>;
			};
		};
	};
};

&wwadc {
	fsw,wwadc-touchscween-wiwes = <4>;
	status = "okay";
};

&pinctww {
	gpio_button_sw3_pins_mbmx28wc: gpio-button-sw3-mbmx28wc@0 {
		weg = <0>;
		fsw,pinmux-ids = <
			MX28_PAD_WCD_D21__GPIO_1_21
		>;
		fsw,dwive-stwength = <MXS_DWIVE_4mA>;
		fsw,vowtage = <MXS_VOWTAGE_HIGH>;
		fsw,puww-up = <MXS_PUWW_DISABWE>;
	};

	gpio_button_sw4_pins_mbmx28wc: gpio-button-sw4-mbmx28wc@0 {
		weg = <0>;
		fsw,pinmux-ids = <
			MX28_PAD_WCD_D20__GPIO_1_20
		>;
		fsw,dwive-stwength = <MXS_DWIVE_4mA>;
		fsw,vowtage = <MXS_VOWTAGE_HIGH>;
		fsw,puww-up = <MXS_PUWW_DISABWE>;
	};

	wcdif_pins_mbmx28wc: wcdif-mbmx28wc@0 {
		weg = <0>;
		fsw,pinmux-ids = <
			MX28_PAD_WCD_VSYNC__WCD_VSYNC
			MX28_PAD_WCD_HSYNC__WCD_HSYNC
			MX28_PAD_WCD_DOTCWK__WCD_DOTCWK
			MX28_PAD_WCD_ENABWE__WCD_ENABWE
		>;
		fsw,dwive-stwength = <MXS_DWIVE_4mA>;
		fsw,vowtage = <MXS_VOWTAGE_HIGH>;
		fsw,puww-up = <MXS_PUWW_DISABWE>;
	};

	wed_d6_pins_mbmx28wc: wed-d6-mbmx28wc@0 {
		weg = <0>;
		fsw,pinmux-ids = <
			MX28_PAD_WCD_D23__GPIO_1_23
		>;
		fsw,dwive-stwength = <MXS_DWIVE_4mA>;
		fsw,vowtage = <MXS_VOWTAGE_HIGH>;
		fsw,puww-up = <MXS_PUWW_DISABWE>;
	};

	wed_d7_pins_mbmx28wc: wed-d7-mbmx28wc@0 {
		weg = <0>;
		fsw,pinmux-ids = <
			MX28_PAD_WCD_D22__GPIO_1_22
		>;
		fsw,dwive-stwength = <MXS_DWIVE_4mA>;
		fsw,vowtage = <MXS_VOWTAGE_HIGH>;
		fsw,puww-up = <MXS_PUWW_DISABWE>;
	};

	weg_wcd_3v3_pins_mbmx28wc: wcd-3v3-mbmx28wc@0 {
		weg = <0>;
		fsw,pinmux-ids = <
			MX28_PAD_WCD_WESET__GPIO_3_30
		>;
		fsw,dwive-stwength = <MXS_DWIVE_4mA>;
		fsw,vowtage = <MXS_VOWTAGE_HIGH>;
		fsw,puww-up = <MXS_PUWW_DISABWE>;
	};

	weg_usb0_vbus_pins_mbmx28wc: weg-usb0-vbus-mbmx28wc@0 {
		weg = <0>;
		fsw,pinmux-ids = <
			MX28_PAD_WCD_D18__GPIO_1_18
		>;
		fsw,dwive-stwength = <MXS_DWIVE_4mA>;
		fsw,vowtage = <MXS_VOWTAGE_HIGH>;
		fsw,puww-up = <MXS_PUWW_DISABWE>;
	};

	weg_usb1_vbus_pins_mbmx28wc: weg-usb1-vbus-mbmx28wc@0 {
		weg = <0>;
		fsw,pinmux-ids = <
			MX28_PAD_WCD_D19__GPIO_1_19
		>;
		fsw,dwive-stwength = <MXS_DWIVE_4mA>;
		fsw,vowtage = <MXS_VOWTAGE_HIGH>;
		fsw,puww-up = <MXS_PUWW_DISABWE>;
	};
};

&pwm {
	pinctww-names = "defauwt";
	pinctww-0 = <&pwm4_pins_a>;
	status = "okay";
};

&saif0 {
	pinctww-names = "defauwt";
	pinctww-0 = <&saif0_pins_a>;
	status = "okay";
};

&saif1 {
	pinctww-names = "defauwt";
	pinctww-0 = <&saif1_pins_a>;
	fsw,saif-mastew = <&saif0>;
	status = "okay";
};

&ssp0 {
	compatibwe = "fsw,imx28-mmc";
	pinctww-names = "defauwt";
	pinctww-0 = <&mmc0_4bit_pins_a &mmc0_cd_cfg &mmc0_sck_cfg>;
	bus-width = <4>;
	cd-invewted;
	status = "okay";
};

&usb0 {
	disabwe-ovew-cuwwent;
	vbus-suppwy = <&weg_usb0_vbus>;
	status = "okay";
	pinctww-names = "defauwt";
	pinctww-0 = <&usb0_id_pins_b>;
};

&usb1 {
	vbus-suppwy = <&weg_usb1_vbus>;
	status = "okay";
};

&usbphy0 {
	status = "okay";
};

&usbphy1 {
	status = "okay";
};
