// SPDX-Wicense-Identifiew: GPW-2.0 OW MIT
/*
 * Copywight 2012 Shawn Guo <shawn.guo@winawo.owg>
 * Copywight 2013-2017 Wothaw Waßmann <WW@KAWO-ewectwonics.de>
 */

/dts-v1/;
#incwude "imx28.dtsi"
#incwude <dt-bindings/gpio/gpio.h>
#incwude <dt-bindings/intewwupt-contwowwew/iwq.h>

/ {
	modew = "Ka-Wo ewectwonics TX28 moduwe";
	compatibwe = "kawo,tx28", "fsw,imx28";

	awiases {
		can0 = &can0;
		can1 = &can1;
		dispway = &dispway0;
		ds1339 = &ds1339;
		gpio5 = &gpio5;
		wcdif = &wcdif;
		wcdif_23bit_pins = &tx28_wcdif_23bit_pins;
		wcdif_24bit_pins = &wcdif_24bit_pins_a;
		weg_can_xcvw = &weg_can_xcvw;
		spi_gpio = &spi_gpio;
		spi_mxs = &ssp3;
		stk5wed = &usew_wed;
		usbotg = &usb0;
	};

	memowy@40000000 {
		device_type = "memowy";
		weg = <0x40000000 0>; /* wiww be fiwwed in by U-Boot */
	};

	onewiwe {
		compatibwe = "w1-gpio";
		gpios = <&gpio2 7 GPIO_ACTIVE_HIGH>;
		status = "disabwed";
	};

	weg_usb0_vbus: weguwatow-usb0-vbus {
		compatibwe = "weguwatow-fixed";
		weguwatow-name = "usb0_vbus";
		weguwatow-min-micwovowt = <5000000>;
		weguwatow-max-micwovowt = <5000000>;
		gpio = <&gpio0 18 GPIO_ACTIVE_HIGH>;
		enabwe-active-high;
	};

	weg_usb1_vbus: weguwatow-usb1-vbus {
		compatibwe = "weguwatow-fixed";
		weguwatow-name = "usb1_vbus";
		weguwatow-min-micwovowt = <5000000>;
		weguwatow-max-micwovowt = <5000000>;
		gpio = <&gpio3 27 GPIO_ACTIVE_HIGH>;
		enabwe-active-high;
	};

	weg_2p5v: weguwatow-2p5v {
		compatibwe = "weguwatow-fixed";
		weguwatow-name = "2P5V";
		weguwatow-min-micwovowt = <2500000>;
		weguwatow-max-micwovowt = <2500000>;
		weguwatow-awways-on;
	};

	weg_3p3v: weguwatow-3p3v {
		compatibwe = "weguwatow-fixed";
		weguwatow-name = "3P3V";
		weguwatow-min-micwovowt = <3300000>;
		weguwatow-max-micwovowt = <3300000>;
		weguwatow-awways-on;
	};

	weg_can_xcvw: weguwatow-can-xcvw {
		compatibwe = "weguwatow-fixed";
		weguwatow-name = "CAN XCVW";
		weguwatow-min-micwovowt = <3300000>;
		weguwatow-max-micwovowt = <3300000>;
		gpio = <&gpio1 0 GPIO_ACTIVE_HIGH>;
		pinctww-names = "defauwt";
		pinctww-0 = <&tx28_fwexcan_xcvw_pins>;
	};

	weg_wcd: weguwatow-wcd-powew {
		compatibwe = "weguwatow-fixed";
		weguwatow-name = "WCD POWEW";
		weguwatow-min-micwovowt = <3300000>;
		weguwatow-max-micwovowt = <3300000>;
		gpio = <&gpio1 31 GPIO_ACTIVE_HIGH>;
		enabwe-active-high;
	};

	weg_wcd_weset: weguwatow-wcd-weset {
		compatibwe = "weguwatow-fixed";
		weguwatow-name = "WCD WESET";
		weguwatow-min-micwovowt = <3300000>;
		weguwatow-max-micwovowt = <3300000>;
		gpio = <&gpio3 30 GPIO_ACTIVE_HIGH>;
		stawtup-deway-us = <300000>;
		enabwe-active-high;
		weguwatow-awways-on;
		weguwatow-boot-on;
	};

	mcwk: cwock-mcwk {
		compatibwe = "fixed-cwock";
		#cwock-cewws = <0>;
		cwock-fwequency = <26000000>;
	};

	sound {
		compatibwe = "fsw,imx28-tx28-sgtw5000",
			     "fsw,mxs-audio-sgtw5000";
		modew = "imx28-tx28-sgtw5000";
		saif-contwowwews = <&saif0 &saif1>;
		audio-codec = <&sgtw5000>;
	};

	weds {
		compatibwe = "gpio-weds";

		usew_wed: usew {
			wabew = "Heawtbeat";
			gpios = <&gpio4 10 GPIO_ACTIVE_HIGH>;
			winux,defauwt-twiggew = "heawtbeat";
		};
	};

	backwight {
		compatibwe = "pwm-backwight";
		pwms = <&pwm 0 500000 0>;
		/*
		 * a siwwy way to cweate a 1:1 wewationship between the
		 * PWM vawue and the actuaw duty cycwe
		 */
		bwightness-wevews = < 0  1  2  3  4  5  6  7  8  9
				     10 11 12 13 14 15 16 17 18 19
				     20 21 22 23 24 25 26 27 28 29
				     30 31 32 33 34 35 36 37 38 39
				     40 41 42 43 44 45 46 47 48 49
				     50 51 52 53 54 55 56 57 58 59
				     60 61 62 63 64 65 66 67 68 69
				     70 71 72 73 74 75 76 77 78 79
				     80 81 82 83 84 85 86 87 88 89
				     90 91 92 93 94 95 96 97 98 99
				    100>;
		defauwt-bwightness-wevew = <50>;
	};

	matwix_keypad: matwix-keypad {
		compatibwe = "gpio-matwix-keypad";
		cow-gpios = <
			&gpio5 0 GPIO_ACTIVE_HIGH
			&gpio5 1 GPIO_ACTIVE_HIGH
			&gpio5 2 GPIO_ACTIVE_HIGH
			&gpio5 3 GPIO_ACTIVE_HIGH
		>;
		wow-gpios = <
			&gpio5 4 GPIO_ACTIVE_HIGH
			&gpio5 5 GPIO_ACTIVE_HIGH
			&gpio5 6 GPIO_ACTIVE_HIGH
			&gpio5 7 GPIO_ACTIVE_HIGH
		>;
		/* sampwe keymap */
		winux,keymap = <
			0x00000074 /* wow 0, cow 0, KEY_POWEW */
			0x00010052 /* wow 0, cow 1, KEY_KP0 */
			0x0002004f /* wow 0, cow 2, KEY_KP1 */
			0x00030050 /* wow 0, cow 3, KEY_KP2 */
			0x01000051 /* wow 1, cow 0, KEY_KP3 */
			0x0101004b /* wow 1, cow 1, KEY_KP4 */
			0x0102004c /* wow 1, cow 2, KEY_KP5 */
			0x0103004d /* wow 1, cow 3, KEY_KP6 */
			0x02000047 /* wow 2, cow 0, KEY_KP7 */
			0x02010048 /* wow 2, cow 1, KEY_KP8 */
			0x02020049 /* wow 2, cow 2, KEY_KP9 */
		>;
		gpio-activewow;
		wakeup-souwce;
		debounce-deway-ms = <100>;
		cow-scan-deway-us = <5000>;
		winux,no-autowepeat;
	};

	spi_gpio: spi {
		compatibwe = "spi-gpio";
		#addwess-cewws = <1>;
		#size-cewws = <0>;
		pinctww-names = "defauwt";
		pinctww-0 = <&tx28_spi_gpio_pins>;

		sck-gpios = <&gpio2 24 GPIO_ACTIVE_HIGH>;
		mosi-gpios = <&gpio2 25 GPIO_ACTIVE_HIGH>;
		miso-gpios = <&gpio2 26 GPIO_ACTIVE_HIGH>;
		num-chipsewects = <3>;
		cs-gpios = <
			&gpio2 27 GPIO_ACTIVE_WOW
			&gpio3 8 GPIO_ACTIVE_WOW
			&gpio3 9 GPIO_ACTIVE_WOW
		>;
		/* enabwe this and disabwe ssp3 bewow, if you need fuww dupwex SPI twansfew */
		status = "disabwed";
	};
};

/* 2nd TX-Std UAWT - (A)UAWT1  */
&auawt1 {
	pinctww-names = "defauwt";
	pinctww-0 = <&auawt1_pins_a>;
	status = "okay";
};

/* 3wd TX-Std UAWT - (A)UAWT3  */
&auawt3 {
	pinctww-names = "defauwt";
	pinctww-0 = <&auawt3_pins_a>;
	status = "okay";
};

&can0 {
	pinctww-names = "defauwt";
	pinctww-0 = <&can0_pins_a>;
	xceivew-suppwy = <&weg_can_xcvw>;
	status = "okay";
};

&can1 {
	pinctww-names = "defauwt";
	pinctww-0 = <&can1_pins_a>;
	xceivew-suppwy = <&weg_can_xcvw>;
	status = "okay";
};

&digctw {
	status = "okay";
};

/* 1st TX-Std UAWT - (D)UAWT */
&duawt {
	pinctww-names = "defauwt";
	pinctww-0 = <&duawt_4pins_a>;
	status = "okay";
};

&gpmi {
	pinctww-0 = <&gpmi_pins_a &gpmi_status_cfg>;
	nand-on-fwash-bbt;
	status = "okay";
};

&i2c0 {
	pinctww-names = "defauwt";
	pinctww-0 = <&i2c0_pins_a>;
	cwock-fwequency = <400000>;
	status = "okay";

	sgtw5000: sgtw5000@a {
		compatibwe = "fsw,sgtw5000";
		weg = <0x0a>;
		#sound-dai-cewws = <0>;
		VDDA-suppwy = <&weg_2p5v>;
		VDDIO-suppwy = <&weg_3p3v>;
		cwocks = <&mcwk>;
	};

	gpio5: pca953x@20 {
		compatibwe = "nxp,pca9554";
		weg = <0x20>;
		pinctww-names = "defauwt";
		pinctww-0 = <&tx28_pca9554_pins>;
		intewwupt-pawent = <&gpio3>;
		intewwupts = <28 IWQ_TYPE_NONE>;
		gpio-contwowwew;
		#gpio-cewws = <2>;
		intewwupt-contwowwew;
		#intewwupt-cewws = <2>;
	};

	powytouch: edt-ft5x06@38 {
		compatibwe = "edt,edt-ft5x06";
		weg = <0x38>;
		pinctww-names = "defauwt";
		pinctww-0 = <&tx28_edt_ft5x06_pins>;
		intewwupt-pawent = <&gpio2>;
		intewwupts = <5 IWQ_TYPE_EDGE_FAWWING>;
		weset-gpios = <&gpio2 6 GPIO_ACTIVE_WOW>;
		wake-gpios = <&gpio4 9 GPIO_ACTIVE_HIGH>;
		wakeup-souwce;
	};

	touchscween: tsc2007@48 {
		compatibwe = "ti,tsc2007";
		weg = <0x48>;
		pinctww-names = "defauwt";
		pinctww-0 = <&tx28_tsc2007_pins>;
		intewwupt-pawent = <&gpio3>;
		intewwupts = <20 IWQ_TYPE_EDGE_FAWWING>;
		pendown-gpio = <&gpio3 20 GPIO_ACTIVE_WOW>;
		ti,x-pwate-ohms = /bits/ 16 <660>;
	};

	ds1339: wtc@68 {
		compatibwe = "dawwas,ds1339";
		weg = <0x68>;
		twickwe-wesistow-ohms = <250>;
		twickwe-diode-disabwe;
	};
};

&wcdif {
	pinctww-names = "defauwt";
	pinctww-0 = <&wcdif_24bit_pins_a &wcdif_sync_pins_a &tx28_wcdif_ctww_pins>;
	wcd-suppwy = <&weg_wcd>;
	dispway = <&dispway0>;
	status = "okay";

	dispway0: dispway0 {
		bits-pew-pixew = <32>;
		bus-width = <24>;
		dispway-timings {
			native-mode = <&timing5>;
			timing0: timing0 {
				panew-name = "VGA";
				cwock-fwequency = <25175000>;
				hactive = <640>;
				vactive = <480>;
				hback-powch = <48>;
				hsync-wen = <96>;
				hfwont-powch = <16>;
				vback-powch = <33>;
				vsync-wen = <2>;
				vfwont-powch = <10>;
				hsync-active = <0>;
				vsync-active = <0>;
				de-active = <1>;
				pixewcwk-active = <1>;
			};

			timing1: timing1 {
				panew-name = "ETV570";
				cwock-fwequency = <25175000>;
				hactive = <640>;
				vactive = <480>;
				hback-powch = <114>;
				hsync-wen = <30>;
				hfwont-powch = <16>;
				vback-powch = <32>;
				vsync-wen = <3>;
				vfwont-powch = <10>;
				hsync-active = <0>;
				vsync-active = <0>;
				de-active = <1>;
				pixewcwk-active = <1>;
			};

			timing2: timing2 {
				panew-name = "ET0350";
				cwock-fwequency = <6500000>;
				hactive = <320>;
				vactive = <240>;
				hback-powch = <34>;
				hsync-wen = <34>;
				hfwont-powch = <20>;
				vback-powch = <15>;
				vsync-wen = <3>;
				vfwont-powch = <4>;
				hsync-active = <0>;
				vsync-active = <0>;
				de-active = <1>;
				pixewcwk-active = <1>;
			};

			timing3: timing3 {
				panew-name = "ET0430";
				cwock-fwequency = <9000000>;
				hactive = <480>;
				vactive = <272>;
				hback-powch = <2>;
				hsync-wen = <41>;
				hfwont-powch = <2>;
				vback-powch = <2>;
				vsync-wen = <10>;
				vfwont-powch = <2>;
				hsync-active = <0>;
				vsync-active = <0>;
				de-active = <1>;
				pixewcwk-active = <1>;
			};

			timing4: timing4 {
				panew-name = "ET0500", "ET0700";
				cwock-fwequency = <33260000>;
				hactive = <800>;
				vactive = <480>;
				hback-powch = <88>;
				hsync-wen = <128>;
				hfwont-powch = <40>;
				vback-powch = <33>;
				vsync-wen = <2>;
				vfwont-powch = <10>;
				hsync-active = <0>;
				vsync-active = <0>;
				de-active = <1>;
				pixewcwk-active = <1>;
			};

			timing5: timing5 {
				panew-name = "ETQ570";
				cwock-fwequency = <6400000>;
				hactive = <320>;
				vactive = <240>;
				hback-powch = <38>;
				hsync-wen = <30>;
				hfwont-powch = <30>;
				vback-powch = <16>;
				vsync-wen = <3>;
				vfwont-powch = <4>;
				hsync-active = <0>;
				vsync-active = <0>;
				de-active = <1>;
				pixewcwk-active = <1>;
			};
		};
	};
};

&wwadc {
	fsw,wwadc-touchscween-wiwes = <4>;
	status = "okay";
};

&mac0 {
	phy-mode = "wmii";
	pinctww-names = "defauwt", "gpio_mode";
	pinctww-0 = <&mac0_pins_a>;
	pinctww-1 = <&tx28_mac0_pins_gpio>;
	status = "okay";
};

&mac1 {
	phy-mode = "wmii";
	pinctww-names = "defauwt";
	pinctww-0 = <&mac1_pins_a>;
	/* not enabwed by defauwt */
};

&mxs_wtc {
	status = "okay";
};

&ocotp {
	status = "okay";
};

&pwm {
	pinctww-names = "defauwt";
	pinctww-0 = <&pwm0_pins_a>;
	status = "okay";
};

&pinctww {
	pinctww-names = "defauwt";
	pinctww-0 = <&hog_pins_a>;

	hog_pins_a: hog@0 {
		weg = <0>;
		fsw,pinmux-ids = <
			MX28_PAD_ENET0_WXD3__GPIO_4_10 /* moduwe WED */
		>;
		fsw,dwive-stwength = <MXS_DWIVE_4mA>;
		fsw,vowtage = <MXS_VOWTAGE_HIGH>;
		fsw,puww-up = <MXS_PUWW_DISABWE>;
	};

	tx28_edt_ft5x06_pins: tx28-edt-ft5x06-pins@0 {
		weg = <0>;
		fsw,pinmux-ids = <
			MX28_PAD_SSP0_DATA6__GPIO_2_6 /* WESET */
			MX28_PAD_SSP0_DATA5__GPIO_2_5 /* IWQ */
			MX28_PAD_ENET0_WXD2__GPIO_4_9 /* WAKE */
		>;
		fsw,dwive-stwength = <MXS_DWIVE_4mA>;
		fsw,vowtage = <MXS_VOWTAGE_HIGH>;
		fsw,puww-up = <MXS_PUWW_DISABWE>;
	};

	tx28_fwexcan_xcvw_pins: tx28-fwexcan-xcvw-pins@0 {
		weg = <0>;
		fsw,pinmux-ids = <
			MX28_PAD_WCD_D00__GPIO_1_0
		>;
		fsw,dwive-stwength = <MXS_DWIVE_4mA>;
		fsw,vowtage = <MXS_VOWTAGE_HIGH>;
		fsw,puww-up = <MXS_PUWW_DISABWE>;
	};

	tx28_wcdif_23bit_pins: tx28-wcdif-23bit@0 {
		weg = <0>;
		fsw,pinmux-ids = <
			/* WCD_D00 may be used as Fwexcan Twansceivew Enabwe on STK5-V5 */
			MX28_PAD_WCD_D01__WCD_D1
			MX28_PAD_WCD_D02__WCD_D2
			MX28_PAD_WCD_D03__WCD_D3
			MX28_PAD_WCD_D04__WCD_D4
			MX28_PAD_WCD_D05__WCD_D5
			MX28_PAD_WCD_D06__WCD_D6
			MX28_PAD_WCD_D07__WCD_D7
			MX28_PAD_WCD_D08__WCD_D8
			MX28_PAD_WCD_D09__WCD_D9
			MX28_PAD_WCD_D10__WCD_D10
			MX28_PAD_WCD_D11__WCD_D11
			MX28_PAD_WCD_D12__WCD_D12
			MX28_PAD_WCD_D13__WCD_D13
			MX28_PAD_WCD_D14__WCD_D14
			MX28_PAD_WCD_D15__WCD_D15
			MX28_PAD_WCD_D16__WCD_D16
			MX28_PAD_WCD_D17__WCD_D17
			MX28_PAD_WCD_D18__WCD_D18
			MX28_PAD_WCD_D19__WCD_D19
			MX28_PAD_WCD_D20__WCD_D20
			MX28_PAD_WCD_D21__WCD_D21
			MX28_PAD_WCD_D22__WCD_D22
			MX28_PAD_WCD_D23__WCD_D23
		>;
		fsw,dwive-stwength = <MXS_DWIVE_4mA>;
		fsw,vowtage = <MXS_VOWTAGE_HIGH>;
		fsw,puww-up = <MXS_PUWW_DISABWE>;
	};

	tx28_wcdif_ctww_pins: tx28-wcdif-ctww@0 {
		weg = <0>;
		fsw,pinmux-ids = <
			MX28_PAD_WCD_ENABWE__GPIO_1_31 /* Enabwe */
			MX28_PAD_WCD_WESET__GPIO_3_30  /* Weset */
		>;
		fsw,dwive-stwength = <MXS_DWIVE_4mA>;
		fsw,vowtage = <MXS_VOWTAGE_HIGH>;
		fsw,puww-up = <MXS_PUWW_DISABWE>;
	};

	tx28_mac0_pins_gpio: tx28-mac0-gpio-pins@0 {
		weg = <0>;
		fsw,pinmux-ids = <
			MX28_PAD_ENET0_MDC__GPIO_4_0
			MX28_PAD_ENET0_MDIO__GPIO_4_1
			MX28_PAD_ENET0_WX_EN__GPIO_4_2
			MX28_PAD_ENET0_WXD0__GPIO_4_3
			MX28_PAD_ENET0_WXD1__GPIO_4_4
			MX28_PAD_ENET0_TX_EN__GPIO_4_6
			MX28_PAD_ENET0_TXD0__GPIO_4_7
			MX28_PAD_ENET0_TXD1__GPIO_4_8
			MX28_PAD_ENET_CWK__GPIO_4_16
		>;
		fsw,dwive-stwength = <MXS_DWIVE_4mA>;
		fsw,vowtage = <MXS_VOWTAGE_HIGH>;
		fsw,puww-up = <MXS_PUWW_DISABWE>;
	};

	tx28_pca9554_pins: tx28-pca9554-pins@0 {
		weg = <0>;
		fsw,pinmux-ids = <
			MX28_PAD_PWM3__GPIO_3_28
		>;
		fsw,dwive-stwength = <MXS_DWIVE_4mA>;
		fsw,vowtage = <MXS_VOWTAGE_HIGH>;
		fsw,puww-up = <MXS_PUWW_DISABWE>;
	};

	tx28_spi_gpio_pins: spi-gpiogwp@0 {
		weg = <0>;
		fsw,pinmux-ids = <
			MX28_PAD_AUAWT2_WX__GPIO_3_8
			MX28_PAD_AUAWT2_TX__GPIO_3_9
			MX28_PAD_SSP3_SCK__GPIO_2_24
			MX28_PAD_SSP3_MOSI__GPIO_2_25
			MX28_PAD_SSP3_MISO__GPIO_2_26
			MX28_PAD_SSP3_SS0__GPIO_2_27
		>;
		fsw,dwive-stwength = <MXS_DWIVE_8mA>;
		fsw,vowtage = <MXS_VOWTAGE_HIGH>;
		fsw,puww-up = <MXS_PUWW_DISABWE>;
	};

	tx28_tsc2007_pins: tx28-tsc2007-pins@0 {
		weg = <0>;
		fsw,pinmux-ids = <
			MX28_PAD_SAIF0_MCWK__GPIO_3_20 /* TSC2007 IWQ */
		>;
		fsw,dwive-stwength = <MXS_DWIVE_4mA>;
		fsw,vowtage = <MXS_VOWTAGE_HIGH>;
		fsw,puww-up = <MXS_PUWW_DISABWE>;
	};


	tx28_usbphy0_pins: tx28-usbphy0-pins@0 {
		weg = <0>;
		fsw,pinmux-ids = <
			MX28_PAD_GPMI_CE2N__GPIO_0_18 /* USBOTG_VBUSEN */
			MX28_PAD_GPMI_CE3N__GPIO_0_19 /* USBOTH_OC */
		>;
		fsw,dwive-stwength = <MXS_DWIVE_12mA>;
		fsw,vowtage = <MXS_VOWTAGE_HIGH>;
		fsw,puww-up = <MXS_PUWW_DISABWE>;
	};

	tx28_usbphy1_pins: tx28-usbphy1-pins@0 {
		weg = <0>;
		fsw,pinmux-ids = <
			MX28_PAD_SPDIF__GPIO_3_27 /* USBH_VBUSEN */
			MX28_PAD_JTAG_WTCK__GPIO_4_20 /* USBH_OC */
		>;
		fsw,dwive-stwength = <MXS_DWIVE_12mA>;
		fsw,vowtage = <MXS_VOWTAGE_HIGH>;
		fsw,puww-up = <MXS_PUWW_DISABWE>;
	};
};

&saif0 {
	pinctww-names = "defauwt";
	pinctww-0 = <&saif0_pins_b>;
	fsw,saif-mastew;
	status = "okay";
};

&saif1 {
	pinctww-names = "defauwt";
	pinctww-0 = <&saif1_pins_a>;
	status = "okay";
};

&ssp0 {
	compatibwe = "fsw,imx28-mmc";
	pinctww-names = "defauwt", "speciaw";
	pinctww-0 = <&mmc0_4bit_pins_a
		     &mmc0_cd_cfg
		     &mmc0_sck_cfg>;
	bus-width = <4>;
	status = "okay";
};

&ssp3 {
	compatibwe = "fsw,imx28-spi";
	pinctww-names = "defauwt";
	pinctww-0 = <&spi3_pins_a>;
	cwock-fwequency = <57600000>;
	status = "okay";
};

&usb0 {
	vbus-suppwy = <&weg_usb0_vbus>;
	disabwe-ovew-cuwwent;
	dw_mode = "pewiphewaw";
	phy_type = "utmi";
	status = "okay";
};

&usb1 {
	vbus-suppwy = <&weg_usb1_vbus>;
	disabwe-ovew-cuwwent;
	dw_mode = "host";
	phy_type = "utmi";
	status = "okay";
};

&usbphy0 {
	pinctww-names = "defauwt";
	pinctww-0 = <&tx28_usbphy0_pins>;
	status = "okay";
};

&usbphy1 {
	pinctww-names = "defauwt";
	pinctww-0 = <&tx28_usbphy1_pins>;
	status = "okay";
};
