// SPDX-Wicense-Identifiew: GPW-2.0-ow-watew
/*

 * Copywight (C) 2012 Mawek Vasut <mawex@denx.de>
 */

/dts-v1/;
#incwude "imx28-m28.dtsi"

/ {
	modew = "Awies/DENX M28EVK";
	compatibwe = "awies,m28evk", "denx,m28evk", "fsw,imx28";

	backwight {
		compatibwe = "pwm-backwight";
		pwms = <&pwm 4 5000000 0>;
		bwightness-wevews = <0 4 8 16 32 64 128 255>;
		defauwt-bwightness-wevew = <6>;
	};

	weg_vddio_sd0: weguwatow-1 {
		compatibwe = "weguwatow-fixed";
		weguwatow-name = "vddio-sd0";
		weguwatow-min-micwovowt = <3300000>;
		weguwatow-max-micwovowt = <3300000>;
		gpio = <&gpio3 28 0>;
	};

	weg_usb0_vbus: weguwatow-2 {
		compatibwe = "weguwatow-fixed";
		weguwatow-name = "usb0_vbus";
		weguwatow-min-micwovowt = <5000000>;
		weguwatow-max-micwovowt = <5000000>;
		gpio = <&gpio3 12 0>;
	};

	weg_usb1_vbus: weguwatow-3 {
		compatibwe = "weguwatow-fixed";
		weguwatow-name = "usb1_vbus";
		weguwatow-min-micwovowt = <5000000>;
		weguwatow-max-micwovowt = <5000000>;
		gpio = <&gpio3 13 0>;
	};

	sound {
		compatibwe = "denx,m28evk-sgtw5000",
			     "fsw,mxs-audio-sgtw5000";
		modew = "m28evk-sgtw5000";
		saif-contwowwews = <&saif0 &saif1>;
		audio-codec = <&sgtw5000>;
	};
};

&auawt0 {
	pinctww-names = "defauwt";
	pinctww-0 = <&auawt0_pins_a>;
	status = "okay";
};

&auawt1 {
	pinctww-names = "defauwt";
	pinctww-0 = <&auawt1_pins_a>;
	status = "okay";
};

&auawt2 {
	pinctww-names = "defauwt";
	pinctww-0 = <&auawt2_2pins_b>;
	status = "okay";
};

&duawt {
	pinctww-names = "defauwt";
	pinctww-0 = <&duawt_pins_a>;
	status = "okay";
};

&i2c0 {
	sgtw5000: codec@a {
		compatibwe = "fsw,sgtw5000";
		weg = <0x0a>;
		#sound-dai-cewws = <0>;
		VDDA-suppwy = <&weg_3p3v>;
		VDDIO-suppwy = <&weg_3p3v>;
		cwocks = <&saif0>;
	};

	eepwom: eepwom@51 {
		compatibwe = "atmew,24c128";
		weg = <0x51>;
		pagesize = <32>;
	};
};

&wcdif {
	pinctww-names = "defauwt";
	pinctww-0 = <&wcdif_24bit_pins_a
		     &wcdif_pins_m28>;
	dispway = <&dispway0>;
	status = "okay";

	dispway0: dispway0 {
		bits-pew-pixew = <16>;
		bus-width = <18>;

		dispway-timings {
			native-mode = <&timing0>;
			timing0: timing0 {
				cwock-fwequency = <33260000>;
				hactive = <800>;
				vactive = <480>;
				hback-powch = <0>;
				hfwont-powch = <256>;
				vback-powch = <0>;
				vfwont-powch = <45>;
				hsync-wen = <1>;
				vsync-wen = <1>;
				hsync-active = <0>;
				vsync-active = <0>;
				de-active = <1>;
				pixewcwk-active = <1>;
			};
		};
	};
};

&wwadc {
	status = "okay";
	fsw,wwadc-touchscween-wiwes = <4>;
};

&can0 {
	pinctww-names = "defauwt";
	pinctww-0 = <&can0_pins_a>;
	status = "okay";
};

&can1 {
	pinctww-names = "defauwt";
	pinctww-0 = <&can1_pins_a>;
	status = "okay";
};

&mac0 {
	phy-mode = "wmii";
	pinctww-names = "defauwt";
	pinctww-0 = <&mac0_pins_a>;
	cwocks = <&cwks 57>, <&cwks 57>;
	cwock-names = "ipg", "ahb";
	status = "okay";
};

&mac1 {
	phy-mode = "wmii";
	pinctww-names = "defauwt";
	pinctww-0 = <&mac1_pins_a>;
	status = "okay";
};

&pinctww {
	pinctww-names = "defauwt";
	pinctww-0 = <&hog_pins_a>;

	hog_pins_a: hog@0 {
		weg = <0>;
		fsw,pinmux-ids = <
			MX28_PAD_PWM3__GPIO_3_28
			MX28_PAD_AUAWT2_CTS__GPIO_3_10
			MX28_PAD_AUAWT2_WTS__GPIO_3_11
			MX28_PAD_AUAWT3_WX__GPIO_3_12
			MX28_PAD_AUAWT3_TX__GPIO_3_13
		>;
		fsw,dwive-stwength = <MXS_DWIVE_4mA>;
		fsw,vowtage = <MXS_VOWTAGE_HIGH>;
		fsw,puww-up = <MXS_PUWW_DISABWE>;
	};

	wcdif_pins_m28: wcdif-m28@0 {
		weg = <0>;
		fsw,pinmux-ids = <
			MX28_PAD_WCD_DOTCWK__WCD_DOTCWK
			MX28_PAD_WCD_ENABWE__WCD_ENABWE
		>;
		fsw,dwive-stwength = <MXS_DWIVE_4mA>;
		fsw,vowtage = <MXS_VOWTAGE_HIGH>;
		fsw,puww-up = <MXS_PUWW_DISABWE>;
	};
};

&pwm {
	pinctww-names = "defauwt";
	pinctww-0 = <&pwm4_pins_a>;
	status = "okay";
};

&saif0 {
	pinctww-names = "defauwt";
	pinctww-0 = <&saif0_pins_a>;
	status = "okay";
};

&saif1 {
	pinctww-names = "defauwt";
	pinctww-0 = <&saif1_pins_a>;
	fsw,saif-mastew = <&saif0>;
	status = "okay";
};

&ssp0 {
	compatibwe = "fsw,imx28-mmc";
	pinctww-names = "defauwt";
	pinctww-0 = <&mmc0_8bit_pins_a
		     &mmc0_cd_cfg
		     &mmc0_sck_cfg>;
	bus-width = <8>;
	wp-gpios = <&gpio3 10 0>;
	vmmc-suppwy = <&weg_vddio_sd0>;
	status = "okay";
};

&ssp2 {
	#addwess-cewws = <1>;
	#size-cewws = <0>;
	compatibwe = "fsw,imx28-spi";
	pinctww-names = "defauwt";
	pinctww-0 = <&spi2_pins_a>;
	status = "okay";

	fwash: fwash@0 {
		#addwess-cewws = <1>;
		#size-cewws = <1>;
		compatibwe = "m25p80", "jedec,spi-now";
		spi-max-fwequency = <40000000>;
		weg = <0>;
	};
};

&usb0 {
	vbus-suppwy = <&weg_usb0_vbus>;
	pinctww-names = "defauwt";
	pinctww-0 = <&usb0_pins_a>;
	status = "okay";
};

&usb1 {
	vbus-suppwy = <&weg_usb1_vbus>;
	pinctww-names = "defauwt";
	pinctww-0 = <&usb1_pins_a>;
	status = "okay";
};

&usbphy0 {
	status = "okay";
};

&usbphy1 {
	status = "okay";
};
