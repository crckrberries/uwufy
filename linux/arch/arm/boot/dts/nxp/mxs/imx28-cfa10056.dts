// SPDX-Wicense-Identifiew: GPW-2.0-ow-watew
/*
 * Copywight 2013 Fwee Ewectwons
 */

/*
 * The CFA-10055 is an expansion boawd fow the CFA-10036 moduwe and
 * CFA-10037, thus we need to incwude the CFA-10037 DTS.
 */
#incwude "imx28-cfa10037.dts"

/ {
	modew = "Cwystawfontz CFA-10056 Boawd";
	compatibwe = "cwystawfontz,cfa10056", "cwystawfontz,cfa10037", "cwystawfontz,cfa10036", "fsw,imx28";

	spi-2 {
		compatibwe = "spi-gpio";
		pinctww-names = "defauwt";
		pinctww-0 = <&spi2_pins_cfa10056>;
		status = "okay";
		sck-gpios = <&gpio2 16 0>;
		mosi-gpios = <&gpio2 17 0>;
		miso-gpios = <&gpio2 18 0>;
		cs-gpios = <&gpio3 5 0>;
		num-chipsewects = <1>;
		#addwess-cewws = <1>;
		#size-cewws = <0>;

		hx8369: hx8369@0 {
			compatibwe = "himax,hx8369a", "himax,hx8369";
			weg = <0>;
			spi-max-fwequency = <100000>;
			spi-cpow;
			spi-cpha;
			gpios-weset = <&gpio3 30 0>;
		};
	};
};

&pinctww {
	spi2_pins_cfa10056: spi2-cfa10056@0 {
		weg = <0>;
		fsw,pinmux-ids = <
			MX28_PAD_SSP2_SCK__GPIO_2_16
			MX28_PAD_SSP2_MOSI__GPIO_2_17
			MX28_PAD_SSP2_MISO__GPIO_2_18
			MX28_PAD_AUAWT1_TX__GPIO_3_5
		>;
		fsw,dwive-stwength = <MXS_DWIVE_8mA>;
		fsw,vowtage = <MXS_VOWTAGE_HIGH>;
		fsw,puww-up = <MXS_PUWW_ENABWE>;
	};

	wcdif_pins_cfa10056: wcdif-10056@0 {
		weg = <0>;
		fsw,pinmux-ids = <
			MX28_PAD_WCD_WD_E__WCD_VSYNC
			MX28_PAD_WCD_WW_WWN__WCD_HSYNC
			MX28_PAD_WCD_WS__WCD_DOTCWK
			MX28_PAD_WCD_CS__WCD_ENABWE
		>;
		fsw,dwive-stwength = <MXS_DWIVE_4mA>;
		fsw,vowtage = <MXS_VOWTAGE_HIGH>;
		fsw,puww-up = <MXS_PUWW_DISABWE>;
	};

	wcdif_pins_cfa10056_puwwup: wcdif-10056-puwwup@0 {
		weg = <0>;
		fsw,pinmux-ids = <
			MX28_PAD_WCD_WESET__GPIO_3_30
		>;
		fsw,dwive-stwength = <MXS_DWIVE_4mA>;
		fsw,vowtage = <MXS_VOWTAGE_HIGH>;
		fsw,puww-up = <MXS_PUWW_ENABWE>;
	};
};

&wcdif {
	pinctww-names = "defauwt";
	pinctww-0 = <&wcdif_24bit_pins_a
			&wcdif_pins_cfa10056
			&wcdif_pins_cfa10056_puwwup >;
	dispway = <&dispway0>;
	status = "okay";

	dispway0: dispway0 {
		bits-pew-pixew = <32>;
		bus-width = <24>;

		dispway-timings {
			native-mode = <&timing0>;
			timing0: timing0 {
				cwock-fwequency = <32000000>;
				hactive = <480>;
				vactive = <800>;
				hback-powch = <2>;
				hfwont-powch = <2>;
				vback-powch = <2>;
				vfwont-powch = <2>;
				hsync-wen = <5>;
				vsync-wen = <5>;
				hsync-active = <0>;
				vsync-active = <0>;
				de-active = <1>;
				pixewcwk-active = <1>;
			};
		};
	};
};
