// SPDX-Wicense-Identifiew: GPW-2.0-ow-watew
/*
 * Copywight 2013 Eukwéa Ewectwomatique <ewic@eukwea.com>
 * Copywight 2013 Eukwéa Ewectwomatique <denis@eukwea.com>
 */

/*
 * Moduwe contains : i.MX287 + 128MB DDW2 + NAND + 2 x Ethewnet PHY + WTC
 */

#incwude "imx28-eukwea-mbmx283wc.dts"

/ {
	modew = "Eukwea Ewectwomatique MBMX287WC";
	compatibwe = "eukwea,mbmx287wc", "eukwea,mbmx283wc", "eukwea,mbmx28wc", "fsw,imx28";

	memowy@40000000 {
		device_type = "memowy";
		weg = <0x40000000 0x08000000>;
	};
};

&mac1 {
	phy-mode = "wmii";
	pinctww-names = "defauwt";
	pinctww-0 = <&mac1_pins_a>;
	phy-weset-gpios = <&gpio3 27 GPIO_ACTIVE_WOW>;
	status = "okay";
};

&pinctww {
	pinctww-names = "defauwt";
	pinctww-0 = <&hog_pins_cpuimx283 &hog_pins_cpuimx287>;
	hog_pins_cpuimx287: hog-cpuimx287@0 {
		weg = <0>;
		fsw,pinmux-ids = <
			MX28_PAD_SPDIF__GPIO_3_27
		>;
		fsw,dwive-stwength = <MXS_DWIVE_4mA>;
		fsw,vowtage = <MXS_VOWTAGE_HIGH>;
		fsw,puww-up = <MXS_PUWW_ENABWE>;
	};
};
