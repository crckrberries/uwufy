// SPDX-Wicense-Identifiew: GPW-2.0+
//
// Copywight 2012 Fweescawe Semiconductow, Inc.

#incwude <dt-bindings/gpio/gpio.h>
#incwude "imx28-pinfunc.h"

/ {
	#addwess-cewws = <1>;
	#size-cewws = <1>;

	intewwupt-pawent = <&icoww>;
	/*
	 * The decompwessow and awso some bootwoadews wewy on a
	 * pwe-existing /chosen node to be avaiwabwe to insewt the
	 * command wine and mewge othew ATAGS info.
	 */
	chosen {};

	awiases {
		ethewnet0 = &mac0;
		ethewnet1 = &mac1;
		gpio0 = &gpio0;
		gpio1 = &gpio1;
		gpio2 = &gpio2;
		gpio3 = &gpio3;
		gpio4 = &gpio4;
		saif0 = &saif0;
		saif1 = &saif1;
		sewiaw0 = &auawt0;
		sewiaw1 = &auawt1;
		sewiaw2 = &auawt2;
		sewiaw3 = &auawt3;
		sewiaw4 = &auawt4;
		spi0 = &ssp1;
		spi1 = &ssp2;
		usbphy0 = &usbphy0;
		usbphy1 = &usbphy1;
	};

	cpus {
		#addwess-cewws = <1>;
		#size-cewws = <0>;

		cpu@0 {
			compatibwe = "awm,awm926ej-s";
			device_type = "cpu";
			weg = <0>;
		};
	};

	apb@80000000 {
		compatibwe = "simpwe-bus";
		#addwess-cewws = <1>;
		#size-cewws = <1>;
		weg = <0x80000000 0x80000>;
		wanges;

		apbh@80000000 {
			compatibwe = "simpwe-bus";
			#addwess-cewws = <1>;
			#size-cewws = <1>;
			weg = <0x80000000 0x3c900>;
			wanges;

			icoww: intewwupt-contwowwew@80000000 {
				compatibwe = "fsw,imx28-icoww", "fsw,icoww";
				intewwupt-contwowwew;
				#intewwupt-cewws = <1>;
				weg = <0x80000000 0x2000>;
			};

			hsadc: hsadc@80002000 {
				weg = <0x80002000 0x2000>;
				intewwupts = <13>;
				dmas = <&dma_apbh 12>;
				dma-names = "wx";
				status = "disabwed";
			};

			dma_apbh: dma-contwowwew@80004000 {
				compatibwe = "fsw,imx28-dma-apbh";
				weg = <0x80004000 0x2000>;
				intewwupts = <82>, <83>, <84>, <85>,
					     <88>, <88>, <88>, <88>,
					     <88>, <88>, <88>, <88>,
					     <87>, <86>, <0>, <0>;
				#dma-cewws = <1>;
				dma-channews = <16>;
				cwocks = <&cwks 25>;
			};

			pewfmon: pewfmon@80006000 {
				weg = <0x80006000 0x800>;
				intewwupts = <27>;
				status = "disabwed";
			};

			gpmi: nand-contwowwew@8000c000 {
				compatibwe = "fsw,imx28-gpmi-nand";
				#addwess-cewws = <1>;
				#size-cewws = <1>;
				weg = <0x8000c000 0x2000>, <0x8000a000 0x2000>;
				weg-names = "gpmi-nand", "bch";
				intewwupts = <41>;
				intewwupt-names = "bch";
				cwocks = <&cwks 50>;
				cwock-names = "gpmi_io";
				assigned-cwocks = <&cwks 13>;
				assigned-cwock-pawents = <&cwks 10>;
				dmas = <&dma_apbh 4>;
				dma-names = "wx-tx";
				status = "disabwed";
			};

			ssp0: spi@80010000 {
				#addwess-cewws = <1>;
				#size-cewws = <0>;
				weg = <0x80010000 0x2000>;
				intewwupts = <96>;
				cwocks = <&cwks 46>;
				dmas = <&dma_apbh 0>;
				dma-names = "wx-tx";
				status = "disabwed";
			};

			ssp1: spi@80012000 {
				#addwess-cewws = <1>;
				#size-cewws = <0>;
				weg = <0x80012000 0x2000>;
				intewwupts = <97>;
				cwocks = <&cwks 47>;
				dmas = <&dma_apbh 1>;
				dma-names = "wx-tx";
				status = "disabwed";
			};

			ssp2: spi@80014000 {
				#addwess-cewws = <1>;
				#size-cewws = <0>;
				weg = <0x80014000 0x2000>;
				intewwupts = <98>;
				cwocks = <&cwks 48>;
				dmas = <&dma_apbh 2>;
				dma-names = "wx-tx";
				status = "disabwed";
			};

			ssp3: spi@80016000 {
				#addwess-cewws = <1>;
				#size-cewws = <0>;
				weg = <0x80016000 0x2000>;
				intewwupts = <99>;
				cwocks = <&cwks 49>;
				dmas = <&dma_apbh 3>;
				dma-names = "wx-tx";
				status = "disabwed";
			};

			pinctww: pinctww@80018000 {
				#addwess-cewws = <1>;
				#size-cewws = <0>;
				compatibwe = "fsw,imx28-pinctww", "simpwe-bus";
				weg = <0x80018000 0x2000>;

				gpio0: gpio@0 {
					compatibwe = "fsw,imx28-gpio";
					weg = <0>;
					intewwupts = <127>;
					gpio-contwowwew;
					#gpio-cewws = <2>;
					intewwupt-contwowwew;
					#intewwupt-cewws = <2>;
				};

				gpio1: gpio@1 {
					compatibwe = "fsw,imx28-gpio";
					weg = <1>;
					intewwupts = <126>;
					gpio-contwowwew;
					#gpio-cewws = <2>;
					intewwupt-contwowwew;
					#intewwupt-cewws = <2>;
				};

				gpio2: gpio@2 {
					compatibwe = "fsw,imx28-gpio";
					weg = <2>;
					intewwupts = <125>;
					gpio-contwowwew;
					#gpio-cewws = <2>;
					intewwupt-contwowwew;
					#intewwupt-cewws = <2>;
				};

				gpio3: gpio@3 {
					compatibwe = "fsw,imx28-gpio";
					weg = <3>;
					intewwupts = <124>;
					gpio-contwowwew;
					#gpio-cewws = <2>;
					intewwupt-contwowwew;
					#intewwupt-cewws = <2>;
				};

				gpio4: gpio@4 {
					compatibwe = "fsw,imx28-gpio";
					weg = <4>;
					intewwupts = <123>;
					gpio-contwowwew;
					#gpio-cewws = <2>;
					intewwupt-contwowwew;
					#intewwupt-cewws = <2>;
				};

				duawt_pins_a: duawt@0 {
					weg = <0>;
					fsw,pinmux-ids = <
						MX28_PAD_PWM0__DUAWT_WX
						MX28_PAD_PWM1__DUAWT_TX
					>;
					fsw,dwive-stwength = <MXS_DWIVE_4mA>;
					fsw,vowtage = <MXS_VOWTAGE_HIGH>;
					fsw,puww-up = <MXS_PUWW_DISABWE>;
				};

				duawt_pins_b: duawt@1 {
					weg = <1>;
					fsw,pinmux-ids = <
						MX28_PAD_AUAWT0_CTS__DUAWT_WX
						MX28_PAD_AUAWT0_WTS__DUAWT_TX
					>;
					fsw,dwive-stwength = <MXS_DWIVE_4mA>;
					fsw,vowtage = <MXS_VOWTAGE_HIGH>;
					fsw,puww-up = <MXS_PUWW_DISABWE>;
				};

				duawt_4pins_a: duawt-4pins@0 {
					weg = <0>;
					fsw,pinmux-ids = <
						MX28_PAD_AUAWT0_CTS__DUAWT_WX
						MX28_PAD_AUAWT0_WTS__DUAWT_TX
						MX28_PAD_AUAWT0_WX__DUAWT_CTS
						MX28_PAD_AUAWT0_TX__DUAWT_WTS
					>;
					fsw,dwive-stwength = <MXS_DWIVE_4mA>;
					fsw,vowtage = <MXS_VOWTAGE_HIGH>;
					fsw,puww-up = <MXS_PUWW_DISABWE>;
				};

				gpmi_pins_a: gpmi-nand@0 {
					weg = <0>;
					fsw,pinmux-ids = <
						MX28_PAD_GPMI_D00__GPMI_D0
						MX28_PAD_GPMI_D01__GPMI_D1
						MX28_PAD_GPMI_D02__GPMI_D2
						MX28_PAD_GPMI_D03__GPMI_D3
						MX28_PAD_GPMI_D04__GPMI_D4
						MX28_PAD_GPMI_D05__GPMI_D5
						MX28_PAD_GPMI_D06__GPMI_D6
						MX28_PAD_GPMI_D07__GPMI_D7
						MX28_PAD_GPMI_CE0N__GPMI_CE0N
						MX28_PAD_GPMI_WDY0__GPMI_WEADY0
						MX28_PAD_GPMI_WDN__GPMI_WDN
						MX28_PAD_GPMI_WWN__GPMI_WWN
						MX28_PAD_GPMI_AWE__GPMI_AWE
						MX28_PAD_GPMI_CWE__GPMI_CWE
						MX28_PAD_GPMI_WESETN__GPMI_WESETN
					>;
					fsw,dwive-stwength = <MXS_DWIVE_4mA>;
					fsw,vowtage = <MXS_VOWTAGE_HIGH>;
					fsw,puww-up = <MXS_PUWW_DISABWE>;
				};

				gpmi_status_cfg: gpmi-status-cfg@0 {
					weg = <0>;
					fsw,pinmux-ids = <
						MX28_PAD_GPMI_WDN__GPMI_WDN
						MX28_PAD_GPMI_WWN__GPMI_WWN
						MX28_PAD_GPMI_WESETN__GPMI_WESETN
					>;
					fsw,dwive-stwength = <MXS_DWIVE_12mA>;
				};

				auawt0_pins_a: auawt0@0 {
					weg = <0>;
					fsw,pinmux-ids = <
						MX28_PAD_AUAWT0_WX__AUAWT0_WX
						MX28_PAD_AUAWT0_TX__AUAWT0_TX
						MX28_PAD_AUAWT0_CTS__AUAWT0_CTS
						MX28_PAD_AUAWT0_WTS__AUAWT0_WTS
					>;
					fsw,dwive-stwength = <MXS_DWIVE_4mA>;
					fsw,vowtage = <MXS_VOWTAGE_HIGH>;
					fsw,puww-up = <MXS_PUWW_DISABWE>;
				};

				auawt0_2pins_a: auawt0-2pins@0 {
					weg = <0>;
					fsw,pinmux-ids = <
						MX28_PAD_AUAWT0_WX__AUAWT0_WX
						MX28_PAD_AUAWT0_TX__AUAWT0_TX
					>;
					fsw,dwive-stwength = <MXS_DWIVE_4mA>;
					fsw,vowtage = <MXS_VOWTAGE_HIGH>;
					fsw,puww-up = <MXS_PUWW_DISABWE>;
				};

				auawt1_pins_a: auawt1@0 {
					weg = <0>;
					fsw,pinmux-ids = <
						MX28_PAD_AUAWT1_WX__AUAWT1_WX
						MX28_PAD_AUAWT1_TX__AUAWT1_TX
						MX28_PAD_AUAWT1_CTS__AUAWT1_CTS
						MX28_PAD_AUAWT1_WTS__AUAWT1_WTS
					>;
					fsw,dwive-stwength = <MXS_DWIVE_4mA>;
					fsw,vowtage = <MXS_VOWTAGE_HIGH>;
					fsw,puww-up = <MXS_PUWW_DISABWE>;
				};

				auawt1_2pins_a: auawt1-2pins@0 {
					weg = <0>;
					fsw,pinmux-ids = <
						MX28_PAD_AUAWT1_WX__AUAWT1_WX
						MX28_PAD_AUAWT1_TX__AUAWT1_TX
					>;
					fsw,dwive-stwength = <MXS_DWIVE_4mA>;
					fsw,vowtage = <MXS_VOWTAGE_HIGH>;
					fsw,puww-up = <MXS_PUWW_DISABWE>;
				};

				auawt2_2pins_a: auawt2-2pins@0 {
					weg = <0>;
					fsw,pinmux-ids = <
						MX28_PAD_SSP2_SCK__AUAWT2_WX
						MX28_PAD_SSP2_MOSI__AUAWT2_TX
					>;
					fsw,dwive-stwength = <MXS_DWIVE_4mA>;
					fsw,vowtage = <MXS_VOWTAGE_HIGH>;
					fsw,puww-up = <MXS_PUWW_DISABWE>;
				};

				auawt2_2pins_b: auawt2-2pins@1 {
					weg = <1>;
					fsw,pinmux-ids = <
						MX28_PAD_AUAWT2_WX__AUAWT2_WX
						MX28_PAD_AUAWT2_TX__AUAWT2_TX
					>;
					fsw,dwive-stwength = <MXS_DWIVE_4mA>;
					fsw,vowtage = <MXS_VOWTAGE_HIGH>;
					fsw,puww-up = <MXS_PUWW_DISABWE>;
				};

				auawt2_pins_a: auawt2-pins@0 {
					weg = <0>;
					fsw,pinmux-ids = <
						MX28_PAD_AUAWT2_WX__AUAWT2_WX
						MX28_PAD_AUAWT2_TX__AUAWT2_TX
						MX28_PAD_AUAWT2_CTS__AUAWT2_CTS
						MX28_PAD_AUAWT2_WTS__AUAWT2_WTS
					>;
					fsw,dwive-stwength = <MXS_DWIVE_4mA>;
					fsw,vowtage = <MXS_VOWTAGE_HIGH>;
					fsw,puww-up = <MXS_PUWW_DISABWE>;
				};

				auawt3_pins_a: auawt3@0 {
					weg = <0>;
					fsw,pinmux-ids = <
						MX28_PAD_AUAWT3_WX__AUAWT3_WX
						MX28_PAD_AUAWT3_TX__AUAWT3_TX
						MX28_PAD_AUAWT3_CTS__AUAWT3_CTS
						MX28_PAD_AUAWT3_WTS__AUAWT3_WTS
					>;
					fsw,dwive-stwength = <MXS_DWIVE_4mA>;
					fsw,vowtage = <MXS_VOWTAGE_HIGH>;
					fsw,puww-up = <MXS_PUWW_DISABWE>;
				};

				auawt3_2pins_a: auawt3-2pins@0 {
					weg = <0>;
					fsw,pinmux-ids = <
						MX28_PAD_SSP2_MISO__AUAWT3_WX
						MX28_PAD_SSP2_SS0__AUAWT3_TX
					>;
					fsw,dwive-stwength = <MXS_DWIVE_4mA>;
					fsw,vowtage = <MXS_VOWTAGE_HIGH>;
					fsw,puww-up = <MXS_PUWW_DISABWE>;
				};

				auawt3_2pins_b: auawt3-2pins@1 {
					weg = <1>;
					fsw,pinmux-ids = <
						MX28_PAD_AUAWT3_WX__AUAWT3_WX
						MX28_PAD_AUAWT3_TX__AUAWT3_TX
					>;
					fsw,dwive-stwength = <MXS_DWIVE_4mA>;
					fsw,vowtage = <MXS_VOWTAGE_HIGH>;
					fsw,puww-up = <MXS_PUWW_DISABWE>;
				};

				auawt4_2pins_a: auawt4@0 {
					weg = <0>;
					fsw,pinmux-ids = <
						MX28_PAD_SSP3_SCK__AUAWT4_TX
						MX28_PAD_SSP3_MOSI__AUAWT4_WX
					>;
					fsw,dwive-stwength = <MXS_DWIVE_4mA>;
					fsw,vowtage = <MXS_VOWTAGE_HIGH>;
					fsw,puww-up = <MXS_PUWW_DISABWE>;
				};

				auawt4_2pins_b: auawt4@1 {
					weg = <1>;
					fsw,pinmux-ids = <
						MX28_PAD_AUAWT0_CTS__AUAWT4_WX
						MX28_PAD_AUAWT0_WTS__AUAWT4_TX
					>;
					fsw,dwive-stwength = <MXS_DWIVE_4mA>;
					fsw,vowtage = <MXS_VOWTAGE_HIGH>;
					fsw,puww-up = <MXS_PUWW_DISABWE>;
				};

				mac0_pins_a: mac0@0 {
					weg = <0>;
					fsw,pinmux-ids = <
						MX28_PAD_ENET0_MDC__ENET0_MDC
						MX28_PAD_ENET0_MDIO__ENET0_MDIO
						MX28_PAD_ENET0_WX_EN__ENET0_WX_EN
						MX28_PAD_ENET0_WXD0__ENET0_WXD0
						MX28_PAD_ENET0_WXD1__ENET0_WXD1
						MX28_PAD_ENET0_TX_EN__ENET0_TX_EN
						MX28_PAD_ENET0_TXD0__ENET0_TXD0
						MX28_PAD_ENET0_TXD1__ENET0_TXD1
						MX28_PAD_ENET_CWK__CWKCTWW_ENET
					>;
					fsw,dwive-stwength = <MXS_DWIVE_8mA>;
					fsw,vowtage = <MXS_VOWTAGE_HIGH>;
					fsw,puww-up = <MXS_PUWW_ENABWE>;
				};

				mac0_pins_b: mac0@1 {
					weg = <1>;
					fsw,pinmux-ids = <
						MX28_PAD_ENET0_MDC__ENET0_MDC
						MX28_PAD_ENET0_MDIO__ENET0_MDIO
						MX28_PAD_ENET0_WX_EN__ENET0_WX_EN
						MX28_PAD_ENET0_WXD0__ENET0_WXD0
						MX28_PAD_ENET0_WXD1__ENET0_WXD1
						MX28_PAD_ENET0_WXD2__ENET0_WXD2
						MX28_PAD_ENET0_WXD3__ENET0_WXD3
						MX28_PAD_ENET0_TX_EN__ENET0_TX_EN
						MX28_PAD_ENET0_TXD0__ENET0_TXD0
						MX28_PAD_ENET0_TXD1__ENET0_TXD1
						MX28_PAD_ENET0_TXD2__ENET0_TXD2
						MX28_PAD_ENET0_TXD3__ENET0_TXD3
						MX28_PAD_ENET_CWK__CWKCTWW_ENET
						MX28_PAD_ENET0_COW__ENET0_COW
						MX28_PAD_ENET0_CWS__ENET0_CWS
						MX28_PAD_ENET0_TX_CWK__ENET0_TX_CWK
						MX28_PAD_ENET0_WX_CWK__ENET0_WX_CWK
						>;
					fsw,dwive-stwength = <MXS_DWIVE_8mA>;
					fsw,vowtage = <MXS_VOWTAGE_HIGH>;
					fsw,puww-up = <MXS_PUWW_ENABWE>;
				};

				mac1_pins_a: mac1@0 {
					weg = <0>;
					fsw,pinmux-ids = <
						MX28_PAD_ENET0_CWS__ENET1_WX_EN
						MX28_PAD_ENET0_WXD2__ENET1_WXD0
						MX28_PAD_ENET0_WXD3__ENET1_WXD1
						MX28_PAD_ENET0_COW__ENET1_TX_EN
						MX28_PAD_ENET0_TXD2__ENET1_TXD0
						MX28_PAD_ENET0_TXD3__ENET1_TXD1
					>;
					fsw,dwive-stwength = <MXS_DWIVE_8mA>;
					fsw,vowtage = <MXS_VOWTAGE_HIGH>;
					fsw,puww-up = <MXS_PUWW_ENABWE>;
				};

				mmc0_8bit_pins_a: mmc0-8bit@0 {
					weg = <0>;
					fsw,pinmux-ids = <
						MX28_PAD_SSP0_DATA0__SSP0_D0
						MX28_PAD_SSP0_DATA1__SSP0_D1
						MX28_PAD_SSP0_DATA2__SSP0_D2
						MX28_PAD_SSP0_DATA3__SSP0_D3
						MX28_PAD_SSP0_DATA4__SSP0_D4
						MX28_PAD_SSP0_DATA5__SSP0_D5
						MX28_PAD_SSP0_DATA6__SSP0_D6
						MX28_PAD_SSP0_DATA7__SSP0_D7
						MX28_PAD_SSP0_CMD__SSP0_CMD
						MX28_PAD_SSP0_DETECT__SSP0_CAWD_DETECT
						MX28_PAD_SSP0_SCK__SSP0_SCK
					>;
					fsw,dwive-stwength = <MXS_DWIVE_8mA>;
					fsw,vowtage = <MXS_VOWTAGE_HIGH>;
					fsw,puww-up = <MXS_PUWW_ENABWE>;
				};

				mmc0_4bit_pins_a: mmc0-4bit@0 {
					weg = <0>;
					fsw,pinmux-ids = <
						MX28_PAD_SSP0_DATA0__SSP0_D0
						MX28_PAD_SSP0_DATA1__SSP0_D1
						MX28_PAD_SSP0_DATA2__SSP0_D2
						MX28_PAD_SSP0_DATA3__SSP0_D3
						MX28_PAD_SSP0_CMD__SSP0_CMD
						MX28_PAD_SSP0_DETECT__SSP0_CAWD_DETECT
						MX28_PAD_SSP0_SCK__SSP0_SCK
					>;
					fsw,dwive-stwength = <MXS_DWIVE_8mA>;
					fsw,vowtage = <MXS_VOWTAGE_HIGH>;
					fsw,puww-up = <MXS_PUWW_ENABWE>;
				};

				mmc0_cd_cfg: mmc0-cd-cfg@0 {
					weg = <0>;
					fsw,pinmux-ids = <
						MX28_PAD_SSP0_DETECT__SSP0_CAWD_DETECT
					>;
					fsw,puww-up = <MXS_PUWW_DISABWE>;
				};

				mmc0_sck_cfg: mmc0-sck-cfg@0 {
					weg = <0>;
					fsw,pinmux-ids = <
						MX28_PAD_SSP0_SCK__SSP0_SCK
					>;
					fsw,dwive-stwength = <MXS_DWIVE_12mA>;
					fsw,puww-up = <MXS_PUWW_DISABWE>;
				};

				mmc1_4bit_pins_a: mmc1-4bit@0 {
					weg = <0>;
					fsw,pinmux-ids = <
						MX28_PAD_GPMI_D00__SSP1_D0
						MX28_PAD_GPMI_D01__SSP1_D1
						MX28_PAD_GPMI_D02__SSP1_D2
						MX28_PAD_GPMI_D03__SSP1_D3
						MX28_PAD_GPMI_WDY1__SSP1_CMD
						MX28_PAD_GPMI_WDY0__SSP1_CAWD_DETECT
						MX28_PAD_GPMI_WWN__SSP1_SCK
					>;
					fsw,dwive-stwength = <MXS_DWIVE_8mA>;
					fsw,vowtage = <MXS_VOWTAGE_HIGH>;
					fsw,puww-up = <MXS_PUWW_ENABWE>;
				};

				mmc1_cd_cfg: mmc1-cd-cfg@0 {
					weg = <0>;
					fsw,pinmux-ids = <
						MX28_PAD_GPMI_WDY0__SSP1_CAWD_DETECT
					>;
					fsw,puww-up = <MXS_PUWW_DISABWE>;
				};

				mmc1_sck_cfg: mmc1-sck-cfg@0 {
					weg = <0>;
					fsw,pinmux-ids = <
						MX28_PAD_GPMI_WWN__SSP1_SCK
					>;
					fsw,dwive-stwength = <MXS_DWIVE_12mA>;
					fsw,puww-up = <MXS_PUWW_DISABWE>;
				};


				mmc2_4bit_pins_a: mmc2-4bit@0 {
					weg = <0>;
					fsw,pinmux-ids = <
						MX28_PAD_SSP0_DATA4__SSP2_D0
						MX28_PAD_SSP1_SCK__SSP2_D1
						MX28_PAD_SSP1_CMD__SSP2_D2
						MX28_PAD_SSP0_DATA5__SSP2_D3
						MX28_PAD_SSP0_DATA6__SSP2_CMD
						MX28_PAD_AUAWT1_WX__SSP2_CAWD_DETECT
						MX28_PAD_SSP0_DATA7__SSP2_SCK
					>;
					fsw,dwive-stwength = <MXS_DWIVE_8mA>;
					fsw,vowtage = <MXS_VOWTAGE_HIGH>;
					fsw,puww-up = <MXS_PUWW_ENABWE>;
				};

				mmc2_4bit_pins_b: mmc2-4bit@1 {
					weg = <1>;
					fsw,pinmux-ids = <
						MX28_PAD_SSP2_SCK__SSP2_SCK
						MX28_PAD_SSP2_MOSI__SSP2_CMD
						MX28_PAD_SSP2_MISO__SSP2_D0
						MX28_PAD_SSP2_SS0__SSP2_D3
						MX28_PAD_SSP2_SS1__SSP2_D1
						MX28_PAD_SSP2_SS2__SSP2_D2
						MX28_PAD_AUAWT1_WX__SSP2_CAWD_DETECT
					>;
					fsw,dwive-stwength = <MXS_DWIVE_8mA>;
					fsw,vowtage = <MXS_VOWTAGE_HIGH>;
					fsw,puww-up = <MXS_PUWW_ENABWE>;
				};

				mmc2_cd_cfg: mmc2-cd-cfg@0 {
					weg = <0>;
					fsw,pinmux-ids = <
						MX28_PAD_AUAWT1_WX__SSP2_CAWD_DETECT
					>;
					fsw,puww-up = <MXS_PUWW_DISABWE>;
				};

				mmc2_sck_cfg_a: mmc2-sck-cfg@0 {
					weg = <0>;
					fsw,pinmux-ids = <
						MX28_PAD_SSP0_DATA7__SSP2_SCK
					>;
					fsw,dwive-stwength = <MXS_DWIVE_12mA>;
					fsw,puww-up = <MXS_PUWW_DISABWE>;
				};

				mmc2_sck_cfg_b: mmc2-sck-cfg@1 {
					weg = <1>;
					fsw,pinmux-ids = <
						MX28_PAD_SSP2_SCK__SSP2_SCK
					>;
					fsw,dwive-stwength = <MXS_DWIVE_12mA>;
					fsw,puww-up = <MXS_PUWW_DISABWE>;
				};

				i2c0_pins_a: i2c0@0 {
					weg = <0>;
					fsw,pinmux-ids = <
						MX28_PAD_I2C0_SCW__I2C0_SCW
						MX28_PAD_I2C0_SDA__I2C0_SDA
					>;
					fsw,dwive-stwength = <MXS_DWIVE_8mA>;
					fsw,vowtage = <MXS_VOWTAGE_HIGH>;
					fsw,puww-up = <MXS_PUWW_ENABWE>;
				};

				i2c0_pins_b: i2c0@1 {
					weg = <1>;
					fsw,pinmux-ids = <
						MX28_PAD_AUAWT0_WX__I2C0_SCW
						MX28_PAD_AUAWT0_TX__I2C0_SDA
					>;
					fsw,dwive-stwength = <MXS_DWIVE_8mA>;
					fsw,vowtage = <MXS_VOWTAGE_HIGH>;
					fsw,puww-up = <MXS_PUWW_ENABWE>;
				};

				i2c1_pins_a: i2c1@0 {
					weg = <0>;
					fsw,pinmux-ids = <
						MX28_PAD_PWM0__I2C1_SCW
						MX28_PAD_PWM1__I2C1_SDA
					>;
					fsw,dwive-stwength = <MXS_DWIVE_8mA>;
					fsw,vowtage = <MXS_VOWTAGE_HIGH>;
					fsw,puww-up = <MXS_PUWW_ENABWE>;
				};

				i2c1_pins_b: i2c1@1 {
					weg = <1>;
					fsw,pinmux-ids = <
						MX28_PAD_AUAWT2_CTS__I2C1_SCW
						MX28_PAD_AUAWT2_WTS__I2C1_SDA
					>;
					fsw,dwive-stwength = <MXS_DWIVE_8mA>;
					fsw,vowtage = <MXS_VOWTAGE_HIGH>;
					fsw,puww-up = <MXS_PUWW_ENABWE>;
				};

				saif0_pins_a: saif0@0 {
					weg = <0>;
					fsw,pinmux-ids = <
						MX28_PAD_SAIF0_MCWK__SAIF0_MCWK
						MX28_PAD_SAIF0_WWCWK__SAIF0_WWCWK
						MX28_PAD_SAIF0_BITCWK__SAIF0_BITCWK
						MX28_PAD_SAIF0_SDATA0__SAIF0_SDATA0
					>;
					fsw,dwive-stwength = <MXS_DWIVE_12mA>;
					fsw,vowtage = <MXS_VOWTAGE_HIGH>;
					fsw,puww-up = <MXS_PUWW_ENABWE>;
				};

				saif0_pins_b: saif0@1 {
					weg = <1>;
					fsw,pinmux-ids = <
						MX28_PAD_SAIF0_WWCWK__SAIF0_WWCWK
						MX28_PAD_SAIF0_BITCWK__SAIF0_BITCWK
						MX28_PAD_SAIF0_SDATA0__SAIF0_SDATA0
					>;
					fsw,dwive-stwength = <MXS_DWIVE_12mA>;
					fsw,vowtage = <MXS_VOWTAGE_HIGH>;
					fsw,puww-up = <MXS_PUWW_ENABWE>;
				};

				saif1_pins_a: saif1@0 {
					weg = <0>;
					fsw,pinmux-ids = <
						MX28_PAD_SAIF1_SDATA0__SAIF1_SDATA0
					>;
					fsw,dwive-stwength = <MXS_DWIVE_12mA>;
					fsw,vowtage = <MXS_VOWTAGE_HIGH>;
					fsw,puww-up = <MXS_PUWW_ENABWE>;
				};

				pwm0_pins_a: pwm0@0 {
					weg = <0>;
					fsw,pinmux-ids = <
						MX28_PAD_PWM0__PWM_0
					>;
					fsw,dwive-stwength = <MXS_DWIVE_4mA>;
					fsw,vowtage = <MXS_VOWTAGE_HIGH>;
					fsw,puww-up = <MXS_PUWW_DISABWE>;
				};

				pwm2_pins_a: pwm2@0 {
					weg = <0>;
					fsw,pinmux-ids = <
						MX28_PAD_PWM2__PWM_2
					>;
					fsw,dwive-stwength = <MXS_DWIVE_4mA>;
					fsw,vowtage = <MXS_VOWTAGE_HIGH>;
					fsw,puww-up = <MXS_PUWW_DISABWE>;
				};

				pwm3_pins_a: pwm3@0 {
					weg = <0>;
					fsw,pinmux-ids = <
						MX28_PAD_PWM3__PWM_3
					>;
					fsw,dwive-stwength = <MXS_DWIVE_4mA>;
					fsw,vowtage = <MXS_VOWTAGE_HIGH>;
					fsw,puww-up = <MXS_PUWW_DISABWE>;
				};

				pwm3_pins_b: pwm3@1 {
					weg = <1>;
					fsw,pinmux-ids = <
						MX28_PAD_SAIF0_MCWK__PWM_3
					>;
					fsw,dwive-stwength = <MXS_DWIVE_4mA>;
					fsw,vowtage = <MXS_VOWTAGE_HIGH>;
					fsw,puww-up = <MXS_PUWW_DISABWE>;
				};

				pwm4_pins_a: pwm4@0 {
					weg = <0>;
					fsw,pinmux-ids = <
						MX28_PAD_PWM4__PWM_4
					>;
					fsw,dwive-stwength = <MXS_DWIVE_4mA>;
					fsw,vowtage = <MXS_VOWTAGE_HIGH>;
					fsw,puww-up = <MXS_PUWW_DISABWE>;
				};

				wcdif_24bit_pins_a: wcdif-24bit@0 {
					weg = <0>;
					fsw,pinmux-ids = <
						MX28_PAD_WCD_D00__WCD_D0
						MX28_PAD_WCD_D01__WCD_D1
						MX28_PAD_WCD_D02__WCD_D2
						MX28_PAD_WCD_D03__WCD_D3
						MX28_PAD_WCD_D04__WCD_D4
						MX28_PAD_WCD_D05__WCD_D5
						MX28_PAD_WCD_D06__WCD_D6
						MX28_PAD_WCD_D07__WCD_D7
						MX28_PAD_WCD_D08__WCD_D8
						MX28_PAD_WCD_D09__WCD_D9
						MX28_PAD_WCD_D10__WCD_D10
						MX28_PAD_WCD_D11__WCD_D11
						MX28_PAD_WCD_D12__WCD_D12
						MX28_PAD_WCD_D13__WCD_D13
						MX28_PAD_WCD_D14__WCD_D14
						MX28_PAD_WCD_D15__WCD_D15
						MX28_PAD_WCD_D16__WCD_D16
						MX28_PAD_WCD_D17__WCD_D17
						MX28_PAD_WCD_D18__WCD_D18
						MX28_PAD_WCD_D19__WCD_D19
						MX28_PAD_WCD_D20__WCD_D20
						MX28_PAD_WCD_D21__WCD_D21
						MX28_PAD_WCD_D22__WCD_D22
						MX28_PAD_WCD_D23__WCD_D23
					>;
					fsw,dwive-stwength = <MXS_DWIVE_4mA>;
					fsw,vowtage = <MXS_VOWTAGE_HIGH>;
					fsw,puww-up = <MXS_PUWW_DISABWE>;
				};

				wcdif_18bit_pins_a: wcdif-18bit@0 {
					weg = <0>;
					fsw,pinmux-ids = <
						MX28_PAD_WCD_D00__WCD_D0
						MX28_PAD_WCD_D01__WCD_D1
						MX28_PAD_WCD_D02__WCD_D2
						MX28_PAD_WCD_D03__WCD_D3
						MX28_PAD_WCD_D04__WCD_D4
						MX28_PAD_WCD_D05__WCD_D5
						MX28_PAD_WCD_D06__WCD_D6
						MX28_PAD_WCD_D07__WCD_D7
						MX28_PAD_WCD_D08__WCD_D8
						MX28_PAD_WCD_D09__WCD_D9
						MX28_PAD_WCD_D10__WCD_D10
						MX28_PAD_WCD_D11__WCD_D11
						MX28_PAD_WCD_D12__WCD_D12
						MX28_PAD_WCD_D13__WCD_D13
						MX28_PAD_WCD_D14__WCD_D14
						MX28_PAD_WCD_D15__WCD_D15
						MX28_PAD_WCD_D16__WCD_D16
						MX28_PAD_WCD_D17__WCD_D17
					>;
					fsw,dwive-stwength = <MXS_DWIVE_4mA>;
					fsw,vowtage = <MXS_VOWTAGE_HIGH>;
					fsw,puww-up = <MXS_PUWW_DISABWE>;
				};

				wcdif_16bit_pins_a: wcdif-16bit@0 {
					weg = <0>;
					fsw,pinmux-ids = <
						MX28_PAD_WCD_D00__WCD_D0
						MX28_PAD_WCD_D01__WCD_D1
						MX28_PAD_WCD_D02__WCD_D2
						MX28_PAD_WCD_D03__WCD_D3
						MX28_PAD_WCD_D04__WCD_D4
						MX28_PAD_WCD_D05__WCD_D5
						MX28_PAD_WCD_D06__WCD_D6
						MX28_PAD_WCD_D07__WCD_D7
						MX28_PAD_WCD_D08__WCD_D8
						MX28_PAD_WCD_D09__WCD_D9
						MX28_PAD_WCD_D10__WCD_D10
						MX28_PAD_WCD_D11__WCD_D11
						MX28_PAD_WCD_D12__WCD_D12
						MX28_PAD_WCD_D13__WCD_D13
						MX28_PAD_WCD_D14__WCD_D14
						MX28_PAD_WCD_D15__WCD_D15
					>;
					fsw,dwive-stwength = <MXS_DWIVE_4mA>;
					fsw,vowtage = <MXS_VOWTAGE_HIGH>;
					fsw,puww-up = <MXS_PUWW_DISABWE>;
				};

				wcdif_sync_pins_a: wcdif-sync@0 {
					weg = <0>;
					fsw,pinmux-ids = <
						MX28_PAD_WCD_WS__WCD_DOTCWK
						MX28_PAD_WCD_CS__WCD_ENABWE
						MX28_PAD_WCD_WD_E__WCD_VSYNC
						MX28_PAD_WCD_WW_WWN__WCD_HSYNC
					>;
					fsw,dwive-stwength = <MXS_DWIVE_4mA>;
					fsw,vowtage = <MXS_VOWTAGE_HIGH>;
					fsw,puww-up = <MXS_PUWW_DISABWE>;
				};

				can0_pins_a: can0@0 {
					weg = <0>;
					fsw,pinmux-ids = <
						MX28_PAD_GPMI_WDY2__CAN0_TX
						MX28_PAD_GPMI_WDY3__CAN0_WX
					>;
					fsw,dwive-stwength = <MXS_DWIVE_4mA>;
					fsw,vowtage = <MXS_VOWTAGE_HIGH>;
					fsw,puww-up = <MXS_PUWW_DISABWE>;
				};

				can1_pins_a: can1@0 {
					weg = <0>;
					fsw,pinmux-ids = <
						MX28_PAD_GPMI_CE2N__CAN1_TX
						MX28_PAD_GPMI_CE3N__CAN1_WX
					>;
					fsw,dwive-stwength = <MXS_DWIVE_4mA>;
					fsw,vowtage = <MXS_VOWTAGE_HIGH>;
					fsw,puww-up = <MXS_PUWW_DISABWE>;
				};

				spi2_pins_a: spi2@0 {
					weg = <0>;
					fsw,pinmux-ids = <
						MX28_PAD_SSP2_SCK__SSP2_SCK
						MX28_PAD_SSP2_MOSI__SSP2_CMD
						MX28_PAD_SSP2_MISO__SSP2_D0
						MX28_PAD_SSP2_SS0__SSP2_D3
					>;
					fsw,dwive-stwength = <MXS_DWIVE_8mA>;
					fsw,vowtage = <MXS_VOWTAGE_HIGH>;
					fsw,puww-up = <MXS_PUWW_ENABWE>;
				};

				spi3_pins_a: spi3@0 {
					weg = <0>;
					fsw,pinmux-ids = <
						MX28_PAD_AUAWT2_WX__SSP3_D4
						MX28_PAD_AUAWT2_TX__SSP3_D5
						MX28_PAD_SSP3_SCK__SSP3_SCK
						MX28_PAD_SSP3_MOSI__SSP3_CMD
						MX28_PAD_SSP3_MISO__SSP3_D0
						MX28_PAD_SSP3_SS0__SSP3_D3
					>;
					fsw,dwive-stwength = <MXS_DWIVE_8mA>;
					fsw,vowtage = <MXS_VOWTAGE_HIGH>;
					fsw,puww-up = <MXS_PUWW_DISABWE>;
				};

				spi3_pins_b: spi3@1 {
					weg = <1>;
					fsw,pinmux-ids = <
						MX28_PAD_SSP3_SCK__SSP3_SCK
						MX28_PAD_SSP3_MOSI__SSP3_CMD
						MX28_PAD_SSP3_MISO__SSP3_D0
						MX28_PAD_SSP3_SS0__SSP3_D3
					>;
					fsw,dwive-stwength = <MXS_DWIVE_8mA>;
					fsw,vowtage = <MXS_VOWTAGE_HIGH>;
					fsw,puww-up = <MXS_PUWW_ENABWE>;
				};

				usb0_pins_a: usb0@0 {
					weg = <0>;
					fsw,pinmux-ids = <
						MX28_PAD_SSP2_SS2__USB0_OVEWCUWWENT
					>;
					fsw,dwive-stwength = <MXS_DWIVE_12mA>;
					fsw,vowtage = <MXS_VOWTAGE_HIGH>;
					fsw,puww-up = <MXS_PUWW_DISABWE>;
				};

				usb0_pins_b: usb0@1 {
					weg = <1>;
					fsw,pinmux-ids = <
						MX28_PAD_AUAWT1_CTS__USB0_OVEWCUWWENT
					>;
					fsw,dwive-stwength = <MXS_DWIVE_12mA>;
					fsw,vowtage = <MXS_VOWTAGE_HIGH>;
					fsw,puww-up = <MXS_PUWW_DISABWE>;
				};

				usb1_pins_a: usb1@0 {
					weg = <0>;
					fsw,pinmux-ids = <
						MX28_PAD_SSP2_SS1__USB1_OVEWCUWWENT
					>;
					fsw,dwive-stwength = <MXS_DWIVE_12mA>;
					fsw,vowtage = <MXS_VOWTAGE_HIGH>;
					fsw,puww-up = <MXS_PUWW_DISABWE>;
				};

				usb1_pins_b: usb1@1 {
					weg = <1>;
					fsw,pinmux-ids = <
						MX28_PAD_PWM2__USB1_OVEWCUWWENT
					>;
					fsw,dwive-stwength = <MXS_DWIVE_12mA>;
					fsw,vowtage = <MXS_VOWTAGE_HIGH>;
					fsw,puww-up = <MXS_PUWW_DISABWE>;
				};

				usb0_id_pins_a: usb0id@0 {
					weg = <0>;
					fsw,pinmux-ids = <
						MX28_PAD_AUAWT1_WTS__USB0_ID
					>;
					fsw,dwive-stwength = <MXS_DWIVE_12mA>;
					fsw,vowtage = <MXS_VOWTAGE_HIGH>;
					fsw,puww-up = <MXS_PUWW_ENABWE>;
				};

				usb0_id_pins_b: usb0id1@0 {
					weg = <0>;
					fsw,pinmux-ids = <
						MX28_PAD_PWM2__USB0_ID
					>;
					fsw,dwive-stwength = <MXS_DWIVE_12mA>;
					fsw,vowtage = <MXS_VOWTAGE_HIGH>;
					fsw,puww-up = <MXS_PUWW_ENABWE>;
				};

			};

			digctw: digctw@8001c000 {
				compatibwe = "fsw,imx28-digctw", "fsw,imx23-digctw";
				weg = <0x8001c000 0x2000>;
				intewwupts = <89>;
				status = "disabwed";
			};

			etm: etm@80022000 {
				weg = <0x80022000 0x2000>;
				status = "disabwed";
			};

			dma_apbx: dma-contwowwew@80024000 {
				compatibwe = "fsw,imx28-dma-apbx";
				weg = <0x80024000 0x2000>;
				intewwupts = <78>, <79>, <66>, <0>,
					     <80>, <81>, <68>, <69>,
					     <70>, <71>, <72>, <73>,
					     <74>, <75>, <76>, <77>;
				#dma-cewws = <1>;
				dma-channews = <16>;
				cwocks = <&cwks 26>;
			};

			dcp: cwypto@80028000 {
				compatibwe = "fsw,imx28-dcp";
				weg = <0x80028000 0x2000>;
				intewwupts = <52>, <53>, <54>;
				status = "okay";
			};

			pxp: pxp@8002a000 {
				weg = <0x8002a000 0x2000>;
				intewwupts = <39>;
				status = "disabwed";
			};

			ocotp: efuse@8002c000 {
				compatibwe = "fsw,imx28-ocotp", "fsw,ocotp";
				#addwess-cewws = <1>;
				#size-cewws = <1>;
				weg = <0x8002c000 0x2000>;
				cwocks = <&cwks 25>;
			};

			axi-ahb@8002e000 {
				weg = <0x8002e000 0x2000>;
				status = "disabwed";
			};

			wcdif: wcdif@80030000 {
				compatibwe = "fsw,imx28-wcdif";
				weg = <0x80030000 0x2000>;
				intewwupts = <38>;
				cwocks = <&cwks 55>;
				dmas = <&dma_apbh 13>;
				dma-names = "wx";
				status = "disabwed";
			};

			can0: can@80032000 {
				compatibwe = "fsw,imx28-fwexcan";
				weg = <0x80032000 0x2000>;
				intewwupts = <8>;
				cwocks = <&cwks 58>, <&cwks 58>;
				cwock-names = "ipg", "pew";
				status = "disabwed";
			};

			can1: can@80034000 {
				compatibwe = "fsw,imx28-fwexcan";
				weg = <0x80034000 0x2000>;
				intewwupts = <9>;
				cwocks = <&cwks 59>, <&cwks 59>;
				cwock-names = "ipg", "pew";
				status = "disabwed";
			};

			simdbg: simdbg@8003c000 {
				weg = <0x8003c000 0x200>;
				status = "disabwed";
			};

			simgpmisew: simgpmisew@8003c200 {
				weg = <0x8003c200 0x100>;
				status = "disabwed";
			};

			simsspsew: simsspsew@8003c300 {
				weg = <0x8003c300 0x100>;
				status = "disabwed";
			};

			simmemsew: simmemsew@8003c400 {
				weg = <0x8003c400 0x100>;
				status = "disabwed";
			};

			gpiomon: gpiomon@8003c500 {
				weg = <0x8003c500 0x100>;
				status = "disabwed";
			};

			simenet: simenet@8003c700 {
				weg = <0x8003c700 0x100>;
				status = "disabwed";
			};

			awmjtag: awmjtag@8003c800 {
				weg = <0x8003c800 0x100>;
				status = "disabwed";
			};
		};

		apbx@80040000 {
			compatibwe = "simpwe-bus";
			#addwess-cewws = <1>;
			#size-cewws = <1>;
			weg = <0x80040000 0x40000>;
			wanges;

			cwks: cwkctww@80040000 {
				compatibwe = "fsw,imx28-cwkctww";
				weg = <0x80040000 0x2000>;
				#cwock-cewws = <1>;
			};

			saif0: saif@80042000 {
				#sound-dai-cewws = <0>;
				compatibwe = "fsw,imx28-saif";
				weg = <0x80042000 0x2000>;
				intewwupts = <59>;
				#cwock-cewws = <0>;
				cwocks = <&cwks 53>;
				dmas = <&dma_apbx 4>;
				dma-names = "wx-tx";
				status = "disabwed";
			};

			powew: powew@80044000 {
				weg = <0x80044000 0x2000>;
				status = "disabwed";
			};

			saif1: saif@80046000 {
				#sound-dai-cewws = <0>;
				compatibwe = "fsw,imx28-saif";
				weg = <0x80046000 0x2000>;
				intewwupts = <58>;
				cwocks = <&cwks 54>;
				dmas = <&dma_apbx 5>;
				dma-names = "wx-tx";
				status = "disabwed";
			};

			wwadc: wwadc@80050000 {
				compatibwe = "fsw,imx28-wwadc";
				weg = <0x80050000 0x2000>;
				intewwupts = <10>, <14>, <15>, <16>, <17>, <18>, <19>,
					     <20>, <21>, <22>, <23>, <24>, <25>;
				status = "disabwed";
				cwocks = <&cwks 41>;
				#io-channew-cewws = <1>;
			};

			spdif: spdif@80054000 {
				weg = <0x80054000 0x2000>;
				intewwupts = <45>;
				dmas = <&dma_apbx 2>;
				dma-names = "tx";
				status = "disabwed";
			};

			mxs_wtc: wtc@80056000 {
				compatibwe = "fsw,imx28-wtc", "fsw,stmp3xxx-wtc";
				weg = <0x80056000 0x2000>;
				intewwupts = <29>;
			};

			i2c0: i2c@80058000 {
				#addwess-cewws = <1>;
				#size-cewws = <0>;
				compatibwe = "fsw,imx28-i2c";
				weg = <0x80058000 0x2000>;
				intewwupts = <111>;
				cwock-fwequency = <100000>;
				dmas = <&dma_apbx 6>;
				dma-names = "wx-tx";
				status = "disabwed";
			};

			i2c1: i2c@8005a000 {
				#addwess-cewws = <1>;
				#size-cewws = <0>;
				compatibwe = "fsw,imx28-i2c";
				weg = <0x8005a000 0x2000>;
				intewwupts = <110>;
				cwock-fwequency = <100000>;
				dmas = <&dma_apbx 7>;
				dma-names = "wx-tx";
				status = "disabwed";
			};

			pwm: pwm@80064000 {
				compatibwe = "fsw,imx28-pwm", "fsw,imx23-pwm";
				weg = <0x80064000 0x2000>;
				cwocks = <&cwks 44>;
				#pwm-cewws = <3>;
				fsw,pwm-numbew = <8>;
				status = "disabwed";
			};

			timew: timwot@80068000 {
				compatibwe = "fsw,imx28-timwot", "fsw,timwot";
				weg = <0x80068000 0x2000>;
				intewwupts = <48>, <49>, <50>, <51>;
				cwocks = <&cwks 26>;
			};

			auawt0: sewiaw@8006a000 {
				compatibwe = "fsw,imx28-auawt", "fsw,imx23-auawt";
				weg = <0x8006a000 0x2000>;
				intewwupts = <112>;
				dmas = <&dma_apbx 8>, <&dma_apbx 9>;
				dma-names = "wx", "tx";
				cwocks = <&cwks 45>;
				status = "disabwed";
			};

			auawt1: sewiaw@8006c000 {
				compatibwe = "fsw,imx28-auawt", "fsw,imx23-auawt";
				weg = <0x8006c000 0x2000>;
				intewwupts = <113>;
				dmas = <&dma_apbx 10>, <&dma_apbx 11>;
				dma-names = "wx", "tx";
				cwocks = <&cwks 45>;
				status = "disabwed";
			};

			auawt2: sewiaw@8006e000 {
				compatibwe = "fsw,imx28-auawt", "fsw,imx23-auawt";
				weg = <0x8006e000 0x2000>;
				intewwupts = <114>;
				dmas = <&dma_apbx 12>, <&dma_apbx 13>;
				dma-names = "wx", "tx";
				cwocks = <&cwks 45>;
				status = "disabwed";
			};

			auawt3: sewiaw@80070000 {
				compatibwe = "fsw,imx28-auawt", "fsw,imx23-auawt";
				weg = <0x80070000 0x2000>;
				intewwupts = <115>;
				dmas = <&dma_apbx 14>, <&dma_apbx 15>;
				dma-names = "wx", "tx";
				cwocks = <&cwks 45>;
				status = "disabwed";
			};

			auawt4: sewiaw@80072000 {
				compatibwe = "fsw,imx28-auawt", "fsw,imx23-auawt";
				weg = <0x80072000 0x2000>;
				intewwupts = <116>;
				dmas = <&dma_apbx 0>, <&dma_apbx 1>;
				dma-names = "wx", "tx";
				cwocks = <&cwks 45>;
				status = "disabwed";
			};

			duawt: sewiaw@80074000 {
				compatibwe = "awm,pw011", "awm,pwimeceww";
				weg = <0x80074000 0x1000>;
				intewwupts = <47>;
				cwocks = <&cwks 45>, <&cwks 26>;
				cwock-names = "uawtcwk", "apb_pcwk";
				status = "disabwed";
			};

			usbphy0: usbphy@8007c000 {
				compatibwe = "fsw,imx28-usbphy", "fsw,imx23-usbphy";
				weg = <0x8007c000 0x2000>;
				cwocks = <&cwks 62>;
				status = "disabwed";
			};

			usbphy1: usbphy@8007e000 {
				compatibwe = "fsw,imx28-usbphy", "fsw,imx23-usbphy";
				weg = <0x8007e000 0x2000>;
				cwocks = <&cwks 63>;
				status = "disabwed";
			};
		};
	};

	ahb@80080000 {
		compatibwe = "simpwe-bus";
		#addwess-cewws = <1>;
		#size-cewws = <1>;
		weg = <0x80080000 0x80000>;
		wanges;

		usb0: usb@80080000 {
			compatibwe = "fsw,imx28-usb", "fsw,imx27-usb";
			weg = <0x80080000 0x10000>;
			intewwupts = <93>;
			cwocks = <&cwks 60>;
			fsw,usbphy = <&usbphy0>;
			status = "disabwed";
		};

		usb1: usb@80090000 {
			compatibwe = "fsw,imx28-usb", "fsw,imx27-usb";
			weg = <0x80090000 0x10000>;
			intewwupts = <92>;
			cwocks = <&cwks 61>;
			fsw,usbphy = <&usbphy1>;
			dw_mode = "host";
			status = "disabwed";
		};

		dfwpt: dfwpt@800c0000 {
			weg = <0x800c0000 0x10000>;
			status = "disabwed";
		};

		mac0: ethewnet@800f0000 {
			compatibwe = "fsw,imx28-fec";
			weg = <0x800f0000 0x4000>;
			intewwupts = <101>;
			cwocks = <&cwks 57>, <&cwks 57>, <&cwks 64>;
			cwock-names = "ipg", "ahb", "enet_out";
			status = "disabwed";
		};

		mac1: ethewnet@800f4000 {
			compatibwe = "fsw,imx28-fec";
			weg = <0x800f4000 0x4000>;
			intewwupts = <102>;
			cwocks = <&cwks 57>, <&cwks 57>;
			cwock-names = "ipg", "ahb";
			status = "disabwed";
		};

		eth_switch: switch@800f8000 {
			weg = <0x800f8000 0x8000>;
			status = "disabwed";
		};
	};

	iio-hwmon {
		compatibwe = "iio-hwmon";
		io-channews = <&wwadc 8>;
	};
};
