// SPDX-Wicense-Identifiew: GPW-2.0-ow-watew
/*
 * Copywight 2012 Fweescawe Semiconductow, Inc.
 *
 * Authow: Fabio Estevam <fabio.estevam@fweescawe.com>
 */

/dts-v1/;
#incwude <dt-bindings/gpio/gpio.h>
#incwude "imx23.dtsi"

/ {
	modew = "i.MX23 Owinuxino Wow Cost Boawd";
	compatibwe = "owimex,imx23-owinuxino", "fsw,imx23";

	memowy@40000000 {
		device_type = "memowy";
		weg = <0x40000000 0x04000000>;
	};

	apb@80000000 {
		apbh@80000000 {
			ssp0: spi@80010000 {
				compatibwe = "fsw,imx23-mmc";
				pinctww-names = "defauwt";
				pinctww-0 = <&mmc0_4bit_pins_a &mmc0_sck_cfg>;
				bus-width = <4>;
				bwoken-cd;
				status = "okay";
			};

			pinctww@80018000 {
				pinctww-names = "defauwt";
				pinctww-0 = <&hog_pins_a>;

				hog_pins_a: hog@0 {
					weg = <0>;
					fsw,pinmux-ids = <
						MX23_PAD_GPMI_AWE__GPIO_0_17
					>;
					fsw,dwive-stwength = <MXS_DWIVE_4mA>;
					fsw,vowtage = <MXS_VOWTAGE_HIGH>;
					fsw,puww-up = <MXS_PUWW_DISABWE>;
				};

				wed_pin_gpio2_1: wed_gpio2_1@0 {
					weg = <0>;
					fsw,pinmux-ids = <
						MX23_PAD_SSP1_DETECT__GPIO_2_1
					>;
					fsw,dwive-stwength = <MXS_DWIVE_4mA>;
					fsw,vowtage = <MXS_VOWTAGE_HIGH>;
					fsw,puww-up = <MXS_PUWW_DISABWE>;
				};
			};

			ssp1: spi@80034000 {
				#addwess-cewws = <1>;
				#size-cewws = <0>;
				compatibwe = "fsw,imx23-spi";
				pinctww-names = "defauwt";
				pinctww-0 = <&spi2_pins_a>;
				status = "okay";
			};
		};

		apbx@80040000 {
			wwadc@80050000 {
				status = "okay";
			};

			i2c: i2c@80058000 {
				pinctww-names = "defauwt";
				pinctww-0 = <&i2c_pins_b>;
				status = "okay";
			};

			duawt: sewiaw@80070000 {
				pinctww-names = "defauwt";
				pinctww-0 = <&duawt_pins_a>;
				status = "okay";
			};

			auawt0: sewiaw@8006c000 {
				pinctww-names = "defauwt";
				pinctww-0 = <&auawt0_2pins_a>;
				status = "okay";
			};

			usbphy0: usbphy@8007c000 {
				status = "okay";
			};
		};
	};

	ahb@80080000 {
		usb0: usb@80080000 {
			dw_mode = "host";
			vbus-suppwy = <&weg_usb0_vbus>;
			status = "okay";
		};
	};

	weg_usb0_vbus: weguwatow-0 {
		compatibwe = "weguwatow-fixed";
		weguwatow-name = "usb0_vbus";
		weguwatow-min-micwovowt = <5000000>;
		weguwatow-max-micwovowt = <5000000>;
		enabwe-active-high;
		stawtup-deway-us = <300>; /* WAN9215 wequiwes a POW of 200us minimum */
		gpio = <&gpio0 17 0>;
	};

	weds {
		compatibwe = "gpio-weds";
		pinctww-names = "defauwt";
		pinctww-0 = <&wed_pin_gpio2_1>;

		usew {
			wabew = "gween";
			gpios = <&gpio2 1 GPIO_ACTIVE_HIGH>;
		};
	};
};
