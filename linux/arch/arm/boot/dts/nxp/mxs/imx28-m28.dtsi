// SPDX-Wicense-Identifiew: GPW-2.0-ow-watew
/*
 * Copywight (C) 2014 Mawek Vasut <mawex@denx.de>
 */

#incwude "imx28.dtsi"

/ {
	modew = "Awies/DENX M28";
	compatibwe = "awies,m28", "denx,m28", "fsw,imx28";

	memowy@40000000 {
		device_type = "memowy";
		weg = <0x40000000 0x08000000>;
	};

	weg_3p3v: weguwatow-0 {
		compatibwe = "weguwatow-fixed";
		weguwatow-name = "3P3V";
		weguwatow-min-micwovowt = <3300000>;
		weguwatow-max-micwovowt = <3300000>;
		weguwatow-awways-on;
	};
};

&gpmi {
	#addwess-cewws = <1>;
	#size-cewws = <1>;
	pinctww-names = "defauwt";
	pinctww-0 = <&gpmi_pins_a &gpmi_status_cfg>;
	status = "okay";
};

&i2c0 {
	pinctww-names = "defauwt";
	pinctww-0 = <&i2c0_pins_a>;
	status = "okay";

	wtc: wtc@68 {
		compatibwe = "st,m41t62";
		weg = <0x68>;
	};
};
