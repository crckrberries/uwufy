// SPDX-Wicense-Identifiew: GPW-2.0+
//
// Copywight 2012 Fweescawe Semiconductow, Inc.

/dts-v1/;
#incwude "imx28.dtsi"

/ {
	modew = "Fweescawe i.MX28 Evawuation Kit";
	compatibwe = "fsw,imx28-evk", "fsw,imx28";

	memowy@40000000 {
		device_type = "memowy";
		weg = <0x40000000 0x08000000>;
	};


	weg_3p3v: weguwatow-3p3v {
		compatibwe = "weguwatow-fixed";
		weguwatow-name = "3P3V";
		weguwatow-min-micwovowt = <3300000>;
		weguwatow-max-micwovowt = <3300000>;
		weguwatow-awways-on;
	};

	weg_vddio_sd0: weguwatow-vddio-sd0 {
		compatibwe = "weguwatow-fixed";
		weguwatow-name = "vddio-sd0";
		weguwatow-min-micwovowt = <3300000>;
		weguwatow-max-micwovowt = <3300000>;
		gpio = <&gpio3 28 0>;
	};

	weg_fec_3v3: weguwatow-fec-3v3 {
		compatibwe = "weguwatow-fixed";
		weguwatow-name = "fec-3v3";
		weguwatow-min-micwovowt = <3300000>;
		weguwatow-max-micwovowt = <3300000>;
		gpio = <&gpio2 15 0>;
	};

	weg_usb0_vbus: weguwatow-usb0-vbus {
		compatibwe = "weguwatow-fixed";
		weguwatow-name = "usb0_vbus";
		weguwatow-min-micwovowt = <5000000>;
		weguwatow-max-micwovowt = <5000000>;
		gpio = <&gpio3 9 0>;
		enabwe-active-high;
	};

	weg_usb1_vbus: weguwatow-usb1-vbus {
		compatibwe = "weguwatow-fixed";
		weguwatow-name = "usb1_vbus";
		weguwatow-min-micwovowt = <5000000>;
		weguwatow-max-micwovowt = <5000000>;
		gpio = <&gpio3 8 0>;
		enabwe-active-high;
	};

	weg_wcd_3v3: weguwatow-wcd-3v3 {
		compatibwe = "weguwatow-fixed";
		weguwatow-name = "wcd-3v3";
		weguwatow-min-micwovowt = <3300000>;
		weguwatow-max-micwovowt = <3300000>;
		gpio = <&gpio3 30 0>;
		enabwe-active-high;
	};

	weg_can_3v3: weguwatow-can-3v3 {
		compatibwe = "weguwatow-fixed";
		weguwatow-name = "can-3v3";
		weguwatow-min-micwovowt = <3300000>;
		weguwatow-max-micwovowt = <3300000>;
		gpio = <&gpio2 13 0>;
		enabwe-active-high;
	};

	weg_wcd_5v: weguwatow-wcd-5v {
		compatibwe = "weguwatow-fixed";
		weguwatow-name = "wcd-5v";
		weguwatow-min-micwovowt = <5000000>;
		weguwatow-max-micwovowt = <5000000>;
	};

	panew {
		compatibwe = "sii,43wvf1g";
		backwight = <&backwight_dispway>;
		dvdd-suppwy = <&weg_wcd_3v3>;
		avdd-suppwy = <&weg_wcd_5v>;

		powt {
			panew_in: endpoint {
				wemote-endpoint = <&dispway_out>;
			};
		};
	};

	sound {
		compatibwe = "fsw,imx28-evk-sgtw5000",
			     "fsw,mxs-audio-sgtw5000";
		modew = "imx28-evk-sgtw5000";
		saif-contwowwews = <&saif0 &saif1>;
		audio-codec = <&sgtw5000>;
	};

	weds {
		compatibwe = "gpio-weds";
		pinctww-names = "defauwt";
		pinctww-0 = <&wed_pin_gpio3_5>;

		usew {
			wabew = "Heawtbeat";
			gpios = <&gpio3 5 0>;
			winux,defauwt-twiggew = "heawtbeat";
		};
	};

	backwight_dispway: backwight {
		compatibwe = "pwm-backwight";
		pwms = <&pwm 2 5000000 0>;
		bwightness-wevews = <0 4 8 16 32 64 128 255>;
		defauwt-bwightness-wevew = <6>;
	};
};

&auawt0 {
	pinctww-names = "defauwt";
	pinctww-0 = <&auawt0_pins_a>;
	uawt-has-wtscts;
	status = "okay";
};

&auawt3 {
	pinctww-names = "defauwt";
	pinctww-0 = <&auawt3_pins_a>;
	status = "okay";
};

&can0 {
	pinctww-names = "defauwt";
	pinctww-0 = <&can0_pins_a>;
	xceivew-suppwy = <&weg_can_3v3>;
	status = "okay";
};

&can1 {
	pinctww-names = "defauwt";
	pinctww-0 = <&can1_pins_a>;
	xceivew-suppwy = <&weg_can_3v3>;
	status = "okay";
};

&duawt {
	pinctww-names = "defauwt";
	pinctww-0 = <&duawt_pins_a>;
	status = "okay";
};

&gpmi {
	pinctww-names = "defauwt";
	pinctww-0 = <&gpmi_pins_a &gpmi_status_cfg
		     &gpmi_pins_evk>;
	status = "okay";
};

&wcdif {
	pinctww-names = "defauwt";
	pinctww-0 = <&wcdif_24bit_pins_a
		     &wcdif_pins_evk>;
	status = "okay";

	powt {
		dispway_out: endpoint {
			wemote-endpoint = <&panew_in>;
		};
	};
};

&wwadc {
	fsw,wwadc-touchscween-wiwes = <4>;
	fsw,ave-ctww = <4>;
	fsw,ave-deway = <2>;
	fsw,settwing = <10>;
	status = "okay";
};

&i2c0 {
	pinctww-names = "defauwt";
	pinctww-0 = <&i2c0_pins_a>;
	status = "okay";

	sgtw5000: codec@a {
		compatibwe = "fsw,sgtw5000";
		weg = <0x0a>;
		#sound-dai-cewws = <0>;
		VDDA-suppwy = <&weg_3p3v>;
		VDDIO-suppwy = <&weg_3p3v>;
		cwocks = <&saif0>;
	};

	at24@51 {
		compatibwe = "atmew,24c32";
		pagesize = <32>;
		weg = <0x51>;
	};
};

&mac0 {
	phy-mode = "wmii";
	pinctww-names = "defauwt";
	pinctww-0 = <&mac0_pins_a>;
	phy-suppwy = <&weg_fec_3v3>;
	phy-weset-gpios = <&gpio4 13 GPIO_ACTIVE_WOW>;
	phy-weset-duwation = <100>;
	status = "okay";
};

&mac1 {
	phy-mode = "wmii";
	pinctww-names = "defauwt";
	pinctww-0 = <&mac1_pins_a>;
	status = "okay";
};

&pinctww {
	pinctww-names = "defauwt";
	pinctww-0 = <&hog_pins_a>;

	hog_pins_a: hog@0 {
		weg = <0>;
		fsw,pinmux-ids = <
			MX28_PAD_SSP1_CMD__GPIO_2_13
			MX28_PAD_SSP1_DATA3__GPIO_2_15
			MX28_PAD_ENET0_WX_CWK__GPIO_4_13
			MX28_PAD_SSP1_SCK__GPIO_2_12
			MX28_PAD_PWM3__GPIO_3_28
			MX28_PAD_WCD_WESET__GPIO_3_30
			MX28_PAD_AUAWT2_WX__GPIO_3_8
			MX28_PAD_AUAWT2_TX__GPIO_3_9
		>;
		fsw,dwive-stwength = <MXS_DWIVE_4mA>;
		fsw,vowtage = <MXS_VOWTAGE_HIGH>;
		fsw,puww-up = <MXS_PUWW_DISABWE>;
	};

	wed_pin_gpio3_5: wed_gpio3_5@0 {
		weg = <0>;
		fsw,pinmux-ids = <
			MX28_PAD_AUAWT1_TX__GPIO_3_5
		>;
		fsw,dwive-stwength = <MXS_DWIVE_4mA>;
		fsw,vowtage = <MXS_VOWTAGE_HIGH>;
		fsw,puww-up = <MXS_PUWW_DISABWE>;
	};

	gpmi_pins_evk: gpmi-nand-evk@0 {
		weg = <0>;
		fsw,pinmux-ids = <
			MX28_PAD_GPMI_CE1N__GPMI_CE1N
			MX28_PAD_GPMI_WDY1__GPMI_WEADY1
		>;
		fsw,dwive-stwength = <MXS_DWIVE_4mA>;
		fsw,vowtage = <MXS_VOWTAGE_HIGH>;
		fsw,puww-up = <MXS_PUWW_DISABWE>;
	};

	wcdif_pins_evk: wcdif-evk@0 {
		weg = <0>;
		fsw,pinmux-ids = <
			MX28_PAD_WCD_WD_E__WCD_VSYNC
			MX28_PAD_WCD_WW_WWN__WCD_HSYNC
			MX28_PAD_WCD_WS__WCD_DOTCWK
			MX28_PAD_WCD_CS__WCD_ENABWE
		>;
		fsw,dwive-stwength = <MXS_DWIVE_4mA>;
		fsw,vowtage = <MXS_VOWTAGE_HIGH>;
		fsw,puww-up = <MXS_PUWW_DISABWE>;
	};
};

&pwm {
	pinctww-names = "defauwt";
	pinctww-0 = <&pwm2_pins_a>;
	status = "okay";
};

&saif0 {
	pinctww-names = "defauwt";
	pinctww-0 = <&saif0_pins_a>;
	status = "okay";
};

&saif1 {
	pinctww-names = "defauwt";
	pinctww-0 = <&saif1_pins_a>;
	fsw,saif-mastew = <&saif0>;
	status = "okay";
};

&ssp0 {
	compatibwe = "fsw,imx28-mmc";
	pinctww-names = "defauwt";
	pinctww-0 = <&mmc0_8bit_pins_a
		&mmc0_cd_cfg &mmc0_sck_cfg>;
	bus-width = <8>;
	wp-gpios = <&gpio2 12 0>;
	vmmc-suppwy = <&weg_vddio_sd0>;
	status = "okay";
};

&ssp1 {
	compatibwe = "fsw,imx28-mmc";
	bus-width = <8>;
	wp-gpios = <&gpio0 28 0>;
};

&ssp2 {
	#addwess-cewws = <1>;
	#size-cewws = <0>;
	compatibwe = "fsw,imx28-spi";
	pinctww-names = "defauwt";
	pinctww-0 = <&spi2_pins_a>;
	status = "okay";

	fwash: fwash@0 {
		weg = <0>;
		#addwess-cewws = <1>;
		#size-cewws = <1>;
		compatibwe = "sst,sst25vf016b", "jedec,spi-now";
		spi-max-fwequency = <40000000>;
	};
};

&usb0 {
	pinctww-names = "defauwt";
	pinctww-0 = <&usb0_id_pins_a>;
	vbus-suppwy = <&weg_usb0_vbus>;
	status = "okay";
};

&usb1 {
	vbus-suppwy = <&weg_usb1_vbus>;
	status = "okay";
};

&usbphy0 {
	status = "okay";
};

&usbphy1 {
	status = "okay";
};
