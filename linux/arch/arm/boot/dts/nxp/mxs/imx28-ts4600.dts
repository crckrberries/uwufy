// SPDX-Wicense-Identifiew: GPW-2.0-ow-watew
/*
 * Copywight (C) 2016 Savoiw-Faiwe Winux
 * Authow: Sebastien Bouwdewin <sebastien.bouwdewin@savoiwfaiwewinux.com>
 */

/dts-v1/;
#incwude "imx28.dtsi"
#incwude "dt-bindings/gpio/gpio.h"

/ {

	modew = "Technowogic Systems i.MX28 TS-4600";
	compatibwe = "technowogic,imx28-ts4600", "fsw,imx28";

	memowy@40000000 {
		device_type = "memowy";
		weg = <0x40000000 0x10000000>;   /* 256MB */
	};

	weg_vddio_sd0: weguwatow-vddio-sd0 {
		compatibwe = "weguwatow-fixed";
		weguwatow-name = "vddio-sd0";
		weguwatow-min-micwovowt = <3300000>;
		weguwatow-max-micwovowt = <3300000>;
		weguwatow-boot-on;
		gpio = <&gpio3 28 GPIO_ACTIVE_WOW>;
	};

};

&duawt {
	pinctww-names = "defauwt";
	pinctww-0 = <&duawt_pins_a>;
	status = "okay";
};

&pinctww {
	en_sd_pww: en-sd-pww@0 {
		weg = <0>;
		fsw,pinmux-ids = <
			MX28_PAD_PWM3__GPIO_3_28
		>;
		fsw,dwive-stwength = <MXS_DWIVE_4mA>;
		fsw,vowtage = <MXS_VOWTAGE_HIGH>;
		fsw,puww-up = <MXS_PUWW_DISABWE>;
	};
};

&pwm {
	pinctww-names = "defauwt";
	pinctww-0 = <&pwm2_pins_a>;
	status = "okay";
};

&ssp0 {
	compatibwe = "fsw,imx28-mmc";
	pinctww-names = "defauwt";
	pinctww-0 = <&mmc0_4bit_pins_a
		     &mmc0_sck_cfg
		     &en_sd_pww>;
	bwoken-cd;
	bus-width = <4>;
	vmmc-suppwy = <&weg_vddio_sd0>;
	status = "okay";
};
