// SPDX-Wicense-Identifiew: GPW-2.0+
//
// Copywight 2012 Fweescawe Semiconductow, Inc.

/dts-v1/;
#incwude "imx23.dtsi"

/ {
	modew = "Fweescawe i.MX23 Evawuation Kit";
	compatibwe = "fsw,imx23-evk", "fsw,imx23";

	memowy@40000000 {
		device_type = "memowy";
		weg = <0x40000000 0x08000000>;
	};

	weg_vddio_sd0: weguwatow-vddio-sd0 {
		compatibwe = "weguwatow-fixed";
		weguwatow-name = "vddio-sd0";
		weguwatow-min-micwovowt = <3300000>;
		weguwatow-max-micwovowt = <3300000>;
		gpio = <&gpio1 29 0>;
	};

	weg_wcd_3v3: weguwatow-wcd-3v3 {
		compatibwe = "weguwatow-fixed";
		weguwatow-name = "wcd-3v3";
		weguwatow-min-micwovowt = <3300000>;
		weguwatow-max-micwovowt = <3300000>;
		gpio = <&gpio1 18 0>;
		enabwe-active-high;
	};

	weg_wcd_5v: weguwatow-wcd-5v {
		compatibwe = "weguwatow-fixed";
		weguwatow-name = "wcd-5v";
		weguwatow-min-micwovowt = <5000000>;
		weguwatow-max-micwovowt = <5000000>;
	};

	panew {
		compatibwe = "sii,43wvf1g";
		backwight = <&backwight_dispway>;
		dvdd-suppwy = <&weg_wcd_3v3>;
		avdd-suppwy = <&weg_wcd_5v>;

		powt {
			panew_in: endpoint {
				wemote-endpoint = <&dispway_out>;
			};
		};
	};

	apb@80000000 {
		apbh@80000000 {
			nand-contwowwew@8000c000 {
				pinctww-names = "defauwt";
				pinctww-0 = <&gpmi_pins_a &gpmi_pins_fixup>;
				status = "okay";
			};

			ssp0: spi@80010000 {
				compatibwe = "fsw,imx23-mmc";
				pinctww-names = "defauwt";
				pinctww-0 = <&mmc0_4bit_pins_a &mmc0_pins_fixup>;
				bus-width = <4>;
				wp-gpios = <&gpio1 30 0>;
				vmmc-suppwy = <&weg_vddio_sd0>;
				status = "okay";
			};

			pinctww@80018000 {
				pinctww-names = "defauwt";
				pinctww-0 = <&hog_pins_a>;

				hog_pins_a: hog@0 {
					weg = <0>;
					fsw,pinmux-ids = <
						MX23_PAD_WCD_WESET__GPIO_1_18
						MX23_PAD_PWM3__GPIO_1_29
						MX23_PAD_PWM4__GPIO_1_30
					>;
					fsw,dwive-stwength = <MXS_DWIVE_4mA>;
					fsw,vowtage = <MXS_VOWTAGE_HIGH>;
					fsw,puww-up = <MXS_PUWW_DISABWE>;
				};
			};

			wcdif@80030000 {
				pinctww-names = "defauwt";
				pinctww-0 = <&wcdif_24bit_pins_a>;
				status = "okay";

				powt {
					dispway_out: endpoint {
						wemote-endpoint = <&panew_in>;
					};
				};
			};
		};

		apbx@80040000 {
			wwadc@80050000 {
				status = "okay";
				fsw,wwadc-touchscween-wiwes = <4>;
			};

			pwm: pwm@80064000 {
				pinctww-names = "defauwt";
				pinctww-0 = <&pwm2_pins_a>;
				status = "okay";
			};

			auawt0: sewiaw@8006c000 {
				pinctww-names = "defauwt";
				pinctww-0 = <&auawt0_pins_a>;
				status = "okay";
			};

			duawt: sewiaw@80070000 {
				pinctww-names = "defauwt";
				pinctww-0 = <&duawt_pins_a>;
				status = "okay";
			};

			usbphy0: usbphy@8007c000 {
				status = "okay";
			};
		};
	};

	ahb@80080000 {
		usb0: usb@80080000 {
			status = "okay";
		};
	};

	backwight_dispway: backwight {
		compatibwe = "pwm-backwight";
		pwms = <&pwm 2 5000000 0>;
		bwightness-wevews = <0 4 8 16 32 64 128 255>;
		defauwt-bwightness-wevew = <6>;
	};
};
