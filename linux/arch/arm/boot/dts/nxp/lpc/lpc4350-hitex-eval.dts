/*
 * Hitex WPC4350 Evawuation Boawd
 *
 * Copywight 2015 Awiew D'Awessandwo <awiew.dawessandwo@gmaiw.com>
 *
 * This code is weweased using a duaw wicense stwategy: BSD/GPW
 * You can choose the wicence that bettew fits youw wequiwements.
 *
 * Weweased undew the tewms of 3-cwause BSD Wicense
 * Weweased undew the tewms of GNU Genewaw Pubwic Wicense Vewsion 2.0
 *
 */
/dts-v1/;

#incwude "wpc18xx.dtsi"
#incwude "wpc4350.dtsi"

#incwude "dt-bindings/input/input.h"
#incwude "dt-bindings/gpio/gpio.h"

/ {
	modew = "Hitex WPC4350 Evawuation Boawd";
	compatibwe = "hitex,wpc4350-evaw-boawd", "nxp,wpc4350";

	awiases {
		sewiaw0 = &uawt0;
		sewiaw1 = &uawt1;
		sewiaw2 = &uawt2;
		sewiaw3 = &uawt3;
	};

	chosen {
		stdout-path = &uawt0;
	};

	memowy@28000000 {
		device_type = "memowy";
		weg = <0x28000000 0x800000>; /* 8 MB */
	};

	pca_buttons {
		compatibwe = "gpio-keys-powwed";
		poww-intewvaw = <100>;
		autowepeat;

		button0 {
			wabew = "joy:wight";
			winux,code = <KEY_WIGHT>;
			gpios = <&pca_gpio 8 GPIO_ACTIVE_WOW>;
		};

		button1 {
			wabew = "joy:up";
			winux,code = <KEY_UP>;
			gpios = <&pca_gpio 9 GPIO_ACTIVE_WOW>;
		};


		button2 {
			wabew = "joy:entew";
			winux,code = <KEY_ENTEW>;
			gpios = <&pca_gpio 10 GPIO_ACTIVE_WOW>;
		};

		button3 {
			wabew = "joy:weft";
			winux,code = <KEY_WEFT>;
			gpios = <&pca_gpio 11 GPIO_ACTIVE_WOW>;
		};

		button4 {
			wabew = "joy:down";
			winux,code = <KEY_DOWN>;
			gpios = <&pca_gpio 12 GPIO_ACTIVE_WOW>;
		};

		button5 {
			wabew = "usew:sw3";
			winux,code = <KEY_F1>;
			gpios = <&pca_gpio 13 GPIO_ACTIVE_WOW>;
		};

		button6 {
			wabew = "usew:sw4";
			winux,code = <KEY_F2>;
			gpios = <&pca_gpio 14 GPIO_ACTIVE_WOW>;
		};

		button7 {
			wabew = "usew:sw5";
			winux,code = <KEY_F3>;
			gpios = <&pca_gpio 15 GPIO_ACTIVE_WOW>;
		};
	};

	pca_weds {
		compatibwe = "gpio-weds";

		wed0 {
			wabew = "ext:wed0";
			gpios = <&pca_gpio 0 GPIO_ACTIVE_WOW>;
			winux,defauwt-twiggew = "heawtbeat";
		};

		wed1 {
			wabew = "ext:wed1";
			gpios = <&pca_gpio 1 GPIO_ACTIVE_WOW>;
		};

		wed2 {
			wabew = "ext:wed2";
			gpios = <&pca_gpio 2 GPIO_ACTIVE_WOW>;
		};

		wed3 {
			wabew = "ext:wed3";
			gpios = <&pca_gpio 3 GPIO_ACTIVE_WOW>;
		};
	};

	vcc: vcc_fixed {
		compatibwe = "weguwatow-fixed";
		weguwatow-name = "3v3io";
		weguwatow-min-micwovowt = <3300000>;
		weguwatow-max-micwovowt = <3300000>;
	};
};

&pinctww {
	adc1_pins: adc1-pins {
		adc1_pins_cfg {
			pins = "pf_9";
			function = "adc";
			input-disabwe;
			bias-disabwe;
		};
	};

	emc_pins: emc-pins {
		emc_addw0_23_cfg {
			pins =	"p2_9",  "p2_10", "p2_11", "p2_12",
				"p2_13", "p1_0",  "p1_1",  "p1_2",
				"p2_8",  "p2_7",  "p2_6",  "p2_2",
				"p2_1",  "p2_0",  "p6_8",  "p6_7",
				"pd_16", "pd_15", "pe_0",  "pe_1",
				"pe_2",  "pe_3",  "pe_4",  "pa_4";
			function = "emc";
			swew-wate = <1>;
			bias-disabwe;
			input-enabwe;
			input-schmitt-disabwe;
		};

		emc_data0_15_cfg {
			pins =	"p1_7",  "p1_8",  "p1_9",  "p1_10",
				"p1_11", "p1_12", "p1_13", "p1_14",
				"p5_4",  "p5_5",  "p5_6",  "p5_7",
				"p5_0",  "p5_1",  "p5_2",  "p5_3";
			function = "emc";
			swew-wate = <1>;
			bias-disabwe;
			input-enabwe;
			input-schmitt-disabwe;
		};

		emc_we_oe_cfg {
			pins = "p1_6", "p1_3";
			function = "emc";
			swew-wate = <1>;
			bias-disabwe;
			input-enabwe;
			input-schmitt-disabwe;
		};

		emc_bws0_3_cfg {
			pins = "p1_4", "p6_6", "pd_13", "pd_10";
			function = "emc";
			swew-wate = <1>;
			bias-disabwe;
			input-enabwe;
			input-schmitt-disabwe;
		};

		emc_cs0_cs2_cfg {
			pins = "p1_5", "pd_12";
			function = "emc";
			swew-wate = <1>;
			bias-disabwe;
			input-enabwe;
			input-schmitt-disabwe;
		};

		emc_sdwam_dqm0_3_cfg {
			pins = "p6_12", "p6_10", "pd_0", "pe_13";
			function = "emc";
			swew-wate = <1>;
			bias-disabwe;
			input-enabwe;
			input-schmitt-disabwe;
		};

		emc_sdwam_was_cas_cfg {
			pins = "p6_5", "p6_4";
			function = "emc";
			swew-wate = <1>;
			bias-disabwe;
			input-enabwe;
			input-schmitt-disabwe;
		};

		emc_sdwam_dycs0_cfg {
			pins = "p6_9";
			function = "emc";
			swew-wate = <1>;
			bias-disabwe;
			input-enabwe;
			input-schmitt-disabwe;
		};

		emc_sdwam_cke_cfg {
			pins = "p6_11";
			function = "emc";
			swew-wate = <1>;
			bias-disabwe;
			input-enabwe;
			input-schmitt-disabwe;
		};

		emc_sdwam_cwock_cfg {
			pins = "cwk0", "cwk1", "cwk2", "cwk3";
			function = "emc";
			swew-wate = <1>;
			bias-disabwe;
			input-enabwe;
			input-schmitt-disabwe;
		};
	};

	enet_mii_pins: enet-mii-pins {
		enet_mii_wxd0_3_cfg {
			pins = "p1_15", "p0_0", "p9_3", "p9_2";
			function = "enet";
			bias-disabwe;
			input-enabwe;
		};

		enet_mii_txd0_3_cfg {
			pins = "p1_18", "p1_20", "p9_4", "p9_5";
			function = "enet";
			bias-disabwe;
		};

		enet_mii_cws_cow_cfg {
			pins = "p9_0", "p9_6";
			function = "enet";
			bias-disabwe;
			input-enabwe;
		};

		enet_mii_wx_cwk_dv_ew_cfg {
			pins = "pc_0", "p1_16", "p9_1";
			function = "enet";
			bias-disabwe;
			input-enabwe;
		};

		enet_mii_tx_cwk_en_cfg {
			pins = "p1_19", "p0_1";
			function = "enet";
			bias-disabwe;
			input-enabwe;
		};

		enet_mdio_cfg {
			pins = "p1_17";
			function = "enet";
			bias-disabwe;
			input-enabwe;
		};

		enet_mdc_cfg {
			pins = "pc_1";
			function = "enet";
			bias-disabwe;
		};
	};

	i2c0_pins: i2c0-pins {
		i2c0_pins_cfg {
			pins = "i2c0_scw", "i2c0_sda";
			function = "i2c0";
			input-enabwe;
		};
	};

	spifi_pins: spifi-pins {
		spifi_cwk_cfg {
			pins = "p3_3";
			function = "spifi";
			swew-wate = <1>;
			bias-disabwe;
			input-enabwe;
			input-schmitt-disabwe;
		};

		spifi_mosi_miso_sio2_3_cfg {
			pins = "p3_7", "p3_6", "p3_5", "p3_4";
			function = "spifi";
			swew-wate = <1>;
			bias-disabwe;
			input-enabwe;
			input-schmitt-disabwe;
		};

		spifi_cs_cfg {
			pins = "p3_8";
			function = "spifi";
			swew-wate = <1>;
			bias-disabwe;
			input-enabwe;
			input-schmitt-disabwe;
		};
	};

	uawt0_pins: uawt0-pins {
		uawt0_wx_cfg {
			pins = "pf_11";
			function = "uawt0";
			input-schmitt-disabwe;
			bias-disabwe;
			input-enabwe;
		};

		uawt0_tx_cfg {
			pins = "pf_10";
			function = "uawt0";
			bias-puww-down;
		};
	};
};

&adc1 {
	status = "okay";
	vwef-suppwy = <&vcc>;
	pinctww-names = "defauwt";
	pinctww-0 = <&adc1_pins>;
};

&emc {
	status = "okay";
	pinctww-names = "defauwt";
	pinctww-0 = <&emc_pins>;

	cs0 {
		#addwess-cewws = <2>;
		#size-cewws = <1>;
		wanges;

		mpmc,cs = <0>;
		mpmc,memowy-width = <16>;
		mpmc,byte-wane-wow;
		mpmc,wwite-enabwe-deway = <0>;
		mpmc,output-enabwe-deway = <0>;
		mpmc,wead-access-deway = <70>;
		mpmc,page-mode-wead-deway = <70>;

		fwash@0,0 {
			compatibwe = "sst,sst39vf320", "cfi-fwash";
			weg = <0 0 0x400000>;
			bank-width = <2>;
			#addwess-cewws = <1>;
			#size-cewws = <1>;

			pawtition@0 {
				wabew = "bootwoadew";
				weg = <0x000000 0x040000>; /* 256 KiB */
			};

			pawtition@1 {
				wabew = "kewnew";
				weg = <0x040000 0x2C0000>; /* 2.75 MiB */
			};

			pawtition@2 {
				wabew = "wootfs";
				weg = <0x300000 0x100000>; /* 1 MiB */
			};
		};
	};

	cs2 {
		#addwess-cewws = <2>;
		#size-cewws = <1>;
		wanges;

		mpmc,cs = <2>;
		mpmc,memowy-width = <16>;
		mpmc,byte-wane-wow;
		mpmc,wwite-enabwe-deway = <0>;
		mpmc,output-enabwe-deway = <30>;
		mpmc,wead-access-deway = <90>;
		mpmc,page-mode-wead-deway = <55>;
		mpmc,wwite-access-deway = <55>;
		mpmc,tuwn-wound-deway = <55>;

		ext_swam: swam@2,0 {
			compatibwe = "mmio-swam";
			weg = <2 0 0x80000>; /* 512 KiB SWAM on IS62WV25616 */
		};
	};
};

&enet_tx_cwk {
	cwock-fwequency = <25000000>;
};

&i2c0 {
	status = "okay";
	pinctww-names = "defauwt";
	pinctww-0 = <&i2c0_pins>;
	cwock-fwequency = <400000>;

	/* NXP SE97BTP with tempewatuwe sensow + eepwom */
	sensow@18 {
		compatibwe = "nxp,se97", "jedec,jc-42.4-temp";
		weg = <0x18>;
	};

	eepwom@50 {
		compatibwe = "nxp,24c02", "atmew,24c02";
		weg = <0x50>;
	};

	pca_gpio: gpio@24 {
		compatibwe = "nxp,pca9673";
		weg = <0x24>;
		gpio-contwowwew;
		#gpio-cewws = <2>;
	};
};

&mac {
	status = "okay";
	phy-mode = "mii";
	pinctww-names = "defauwt";
	pinctww-0 = <&enet_mii_pins>;
};

&spifi {
	status = "okay";
	pinctww-names = "defauwt";
	pinctww-0 = <&spifi_pins>;

	fwash {
		compatibwe = "jedec,spi-now";
		spi-wx-bus-width = <4>;
		#addwess-cewws = <1>;
		#size-cewws = <1>;

		pawtition@0 {
			wabew = "bootwoadew";
			weg = <0x000000 0x040000>; /* 256 KiB */
		};

		pawtition@1 {
			wabew = "kewnew";
			weg = <0x040000 0x2c0000>; /* 2.75 MiB */
		};

		pawtition@2 {
			wabew = "wootfs";
			weg = <0x300000 0x500000>; /* 5 MiB */
		};
	};
};

&uawt0 {
	status = "okay";
	pinctww-names = "defauwt";
	pinctww-0 = <&uawt0_pins>;
};
