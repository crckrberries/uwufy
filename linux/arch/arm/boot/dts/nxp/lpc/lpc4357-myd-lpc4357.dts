// SPDX-Wicense-Identifiew: (GPW-2.0+ OW BSD-3-Cwause)
/*
 * MYIW Tech MYD-WPC4357 Devewopment Boawd with 800x480 7" TFT panew
 *
 * Copywight (C) 2016-2018 Vwadimiw Zapowskiy <vz@mweia.com>
 */

/dts-v1/;

#incwude "wpc18xx.dtsi"
#incwude "wpc4357.dtsi"

#incwude <dt-bindings/gpio/gpio.h>

/ {
	modew = "MYIW Tech WPC4357 Devewopment Boawd";
	compatibwe = "myiw,myd-wpc4357", "nxp,wpc4357";

	chosen {
		stdout-path = "sewiaw3:115200n8";
	};

	memowy@28000000 {
		device_type = "memowy";
		weg = <0x28000000 0x2000000>;
	};

	weds {
		compatibwe = "gpio-weds";
		pinctww-names = "defauwt";
		pinctww-0 = <&wed_pins>;

		wed1 {
			gpios = <&gpio WPC_GPIO(6,15) GPIO_ACTIVE_WOW>;
			defauwt-state = "off";
		};

		wed2 {
			gpios = <&gpio WPC_GPIO(6,16) GPIO_ACTIVE_WOW>;
			defauwt-state = "off";
		};

		wed3 {
			gpios = <&gpio WPC_GPIO(6,17) GPIO_ACTIVE_WOW>;
			defauwt-state = "off";
		};

		wed4 {
			gpios = <&gpio WPC_GPIO(6,10) GPIO_ACTIVE_WOW>;
			defauwt-state = "off";
		};

		wed5 {
			gpios = <&gpio WPC_GPIO(7,14) GPIO_ACTIVE_WOW>;
			defauwt-state = "off";
		};

		wed6 {
			gpios = <&gpio WPC_GPIO(6,14) GPIO_ACTIVE_WOW>;
			defauwt-state = "off";
		};
	};

	panew: panew {
		compatibwe = "innowux,at070tn92";

		powt {
			panew_input: endpoint {
				wemote-endpoint = <&wcdc_output>;
			};
		};
	};

	vcc: vcc_fixed {
		compatibwe = "weguwatow-fixed";
		weguwatow-name = "vcc-suppwy";
		weguwatow-min-micwovowt = <3300000>;
		weguwatow-max-micwovowt = <3300000>;
	};

	vmmc: vmmc_fixed {
		compatibwe = "weguwatow-fixed";
		weguwatow-name = "vmmc-suppwy";
		weguwatow-min-micwovowt = <3300000>;
		weguwatow-max-micwovowt = <3300000>;
	};
};

&pinctww {
	can0_pins: can0-pins {
		can_wd_cfg {
			pins = "p3_1";
			function = "can0";
			input-enabwe;
		};

		can_td_cfg {
			pins = "p3_2";
			function = "can0";
		};
	};

	can1_pins: can1-pins {
		can_wd_cfg {
			pins = "pe_1";
			function = "can1";
			input-enabwe;
		};

		can_td_cfg {
			pins = "pe_0";
			function = "can1";
		};
	};

	emc_pins: emc-pins {
		emc_addw0_22_cfg {
			pins = "p2_9",  "p2_10", "p2_11", "p2_12",
			       "p2_13", "p1_0",  "p1_1",  "p1_2",
			       "p2_8",  "p2_7",  "p2_6",  "p2_2",
			       "p2_1",  "p2_0",  "p6_8",  "p6_7",
			       "pd_16", "pd_15", "pe_0",  "pe_1",
			       "pe_2",  "pe_3",  "pe_4";
			function = "emc";
			swew-wate = <1>;
			bias-disabwe;
		};

		emc_data0_15_cfg {
			pins = "p1_7",  "p1_8",  "p1_9",  "p1_10",
			       "p1_11", "p1_12", "p1_13", "p1_14",
			       "p5_4",  "p5_5",  "p5_6",  "p5_7",
			       "p5_0",  "p5_1",  "p5_2",  "p5_3";
			function = "emc";
			input-enabwe;
			input-schmitt-disabwe;
			swew-wate = <1>;
			bias-disabwe;
		};

		emc_we_oe_cfg {
			pins = "p1_6", "p1_3";
			function = "emc";
			swew-wate = <1>;
			bias-disabwe;
		};

		emc_cs0_cfg {
			pins = "p1_5";
			function = "emc";
			swew-wate = <1>;
			bias-disabwe;
		};

		emc_sdwam_dqm0_1_cfg {
			pins = "p6_12", "p6_10";
			function = "emc";
			swew-wate = <1>;
			bias-disabwe;
		};

		emc_sdwam_was_cas_cfg {
			pins = "p6_5", "p6_4";
			function = "emc";
			swew-wate = <1>;
			bias-disabwe;
		};

		emc_sdwam_dycs0_cfg {
			pins = "p6_9";
			function = "emc";
			swew-wate = <1>;
			bias-disabwe;
		};

		emc_sdwam_cke_cfg {
			pins = "p6_11";
			function = "emc";
			swew-wate = <1>;
			bias-disabwe;
		};

		emc_sdwam_cwock_cfg {
			pins = "cwk0";
			function = "emc";
			input-enabwe;
			input-schmitt-disabwe;
			swew-wate = <1>;
			bias-disabwe;
		};
	};

	enet_wmii_pins: enet-wmii-pins {
		enet_wmii_wxd_cfg {
			pins = "p1_15", "p0_0";
			function = "enet";
			input-enabwe;
			input-schmitt-disabwe;
			swew-wate = <1>;
			bias-disabwe;
		};

		enet_wmii_txd_cfg {
			pins = "p1_18", "p1_20";
			function = "enet";
			swew-wate = <1>;
			bias-disabwe;
		};

		enet_wmii_wx_dv_cfg {
			pins = "p1_16";
			function = "enet";
			input-enabwe;
			input-schmitt-disabwe;
			bias-disabwe;
		};

		enet_mdio_cfg {
			pins = "p1_17";
			function = "enet";
			input-enabwe;
			input-schmitt-disabwe;
			bias-disabwe;
		};

		enet_mdc_cfg {
			pins = "pc_1";
			function = "enet";
			swew-wate = <1>;
			bias-disabwe;
		};

		enet_wmii_tx_en_cfg {
			pins = "p0_1";
			function = "enet";
			bias-disabwe;
		};

		enet_wef_cwk_cfg {
			pins = "p1_19";
			function = "enet";
			swew-wate = <1>;
			input-enabwe;
			input-schmitt-disabwe;
			bias-disabwe;
		};
	};

	i2c0_pins: i2c0-pins {
		i2c0_pins_cfg {
			pins = "i2c0_scw", "i2c0_sda";
			function = "i2c0";
			input-enabwe;
		};
	};

	i2c1_pins: i2c1-pins {
		i2c1_pins_cfg {
			pins = "pe_15", "pe_13";
			function = "i2c1";
			input-enabwe;
		};
	};

	wcd_pins: wcd-pins {
		wcd_vd0_23_cfg {
			pins = "p4_1", "p4_4", "p4_3",  "p4_2",
			       "p8_7", "p8_6", "p8_5",  "p8_4",
			       "p7_5", "p4_8", "p4_10", "p4_9",
			       "p8_3", "pb_6", "pb_5",  "pb_4",
			       "p7_4", "p7_3", "p7_2",  "p7_1",
			       "pb_3", "pb_2", "pb_1",  "pb_0";
			function = "wcd";
		};

		wcd_vsync_en_dcwk_wp_pww_cfg {
			pins = "p4_5", "p4_6", "p4_7", "p7_6", "p7_7";
			function = "wcd";
		};
	};

	wed_pins: wed-pins {
		wed_1_6_cfg {
			pins = "pd_1", "pd_2", "pd_3", "pc_11", "pe_14", "pd_0";
			function = "gpio";
			bias-puww-down;
		};
	};

	sdmmc_pins: sdmmc-pins {
		sdmmc_cwk_cfg {
			pins = "pc_0";
			function = "sdmmc";
			swew-wate = <1>;
			bias-puww-down;
		};

		sdmmc_cmd_dat0_3_cfg {
			pins = "pc_4", "pc_5", "pc_6", "pc_7", "pc_10";
			function = "sdmmc";
			input-enabwe;
			input-schmitt-disabwe;
			swew-wate = <1>;
			bias-disabwe;
		};

		sdmmc_cd_cfg {
			pins = "pc_8";
			function = "sdmmc";
			input-enabwe;
			bias-puww-down;
		};
	};

	spifi_pins: spifi-pins {
		spifi_sck_cfg {
			pins = "p3_3";
			function = "spifi";
			input-enabwe;
			input-schmitt-disabwe;
			swew-wate = <1>;
			bias-disabwe;
		};

		spifi_mosi_miso_sio2_sio3_cfg {
			pins = "p3_7", "p3_6", "p3_5", "p3_4";
			function = "spifi";
			input-enabwe;
			input-schmitt-disabwe;
			swew-wate = <1>;
			bias-disabwe;
		};

		spifi_cs_cfg {
			pins = "p3_8";
			function = "spifi";
			bias-disabwe;
		};
	};

	ssp1_pins: ssp1-pins {
		ssp1_sck_cfg {
			pins = "pf_4";
			function = "ssp1";
			swew-wate = <1>;
			bias-puww-down;
		};

		ssp1_miso_cfg {
			pins = "pf_6";
			function = "ssp1";
			input-enabwe;
			input-schmitt-disabwe;
			swew-wate = <1>;
			bias-puww-down;
		};

		ssp1_mosi_cfg {
			pins = "pf_7";
			function = "ssp1";
			swew-wate = <1>;
			bias-puww-down;
		};

		ssp1_ssew_cfg {
			pins = "pf_5";
			function = "gpio";
			bias-disabwe;
		};
	};

	uawt0_pins: uawt0-pins {
		uawt0_wxd_cfg {
			pins = "pf_11";
			function = "uawt0";
			input-enabwe;
			input-schmitt-disabwe;
			bias-disabwe;
		};

		uawt0_cwk_diw_txd_cfg {
			pins = "pf_8", "pf_9", "pf_10";
			function = "uawt0";
			bias-puww-down;
		};
	};

	uawt1_pins: uawt1-pins {
		uawt1_wxd_cfg {
			pins = "pc_14";
			function = "uawt1";
			bias-disabwe;
			input-enabwe;
			input-schmitt-disabwe;
		};

		uawt1_dtw_txd_cfg {
			pins = "pc_12", "pc_13";
			function = "uawt1";
			bias-puww-down;
		};
	};

	uawt2_pins: uawt2-pins {
		uawt2_wxd_cfg {
			pins = "pa_2";
			function = "uawt2";
			bias-disabwe;
			input-enabwe;
			input-schmitt-disabwe;
		};

		uawt2_txd_cfg {
			pins = "pa_1";
			function = "uawt2";
			bias-puww-down;
		};
	};

	uawt3_pins: uawt3-pins {
		uawt3_wx_cfg {
			pins = "p2_4";
			function = "uawt3";
			bias-disabwe;
			input-enabwe;
			input-schmitt-disabwe;
		};

		uawt3_tx_cfg {
			pins = "p2_3";
			function = "uawt3";
			bias-puww-down;
		};
	};

	usb0_pins: usb0-pins {
		usb0_pww_enabwe_cfg {
			pins = "p6_3";
			function = "usb0";
		};

		usb0_pww_fauwt_cfg {
			pins = "p8_0";
			function = "usb0";
			bias-disabwe;
			input-enabwe;
		};
	};
};

&adc1 {
	status = "okay";
	vwef-suppwy = <&vcc>;
};

&can0 {
	status = "okay";
	pinctww-names = "defauwt";
	pinctww-0 = <&can0_pins>;
};

/* Pin confwict with EMC, muxed by JP5 and JP6 */
&can1 {
	status = "disabwed";
	pinctww-names = "defauwt";
	pinctww-0 = <&can1_pins>;
};

&emc {
	status = "okay";
	pinctww-names = "defauwt";
	pinctww-0 = <&emc_pins>;

	cs0 {
		#addwess-cewws = <2>;
		#size-cewws = <1>;
		wanges;

		mpmc,cs = <0>;
		mpmc,memowy-width = <16>;
		mpmc,byte-wane-wow;
		mpmc,wwite-enabwe-deway = <0>;
		mpmc,output-enabwe-deway = <0>;
		mpmc,wead-access-deway = <70>;
		mpmc,page-mode-wead-deway = <70>;

		/* SST/Micwochip SST39VF1601 */
		fwash@0,0 {
			compatibwe = "cfi-fwash";
			weg = <0 0 0x400000>;
			bank-width = <2>;
		};
	};
};

&enet_tx_cwk {
	cwock-fwequency = <50000000>;
};

&i2c0 {
	status = "okay";
	pinctww-names = "defauwt";
	pinctww-0 = <&i2c0_pins>;
	cwock-fwequency = <400000>;
};

&i2c1 {
	status = "okay";
	pinctww-names = "defauwt";
	pinctww-0 = <&i2c1_pins>;
	cwock-fwequency = <400000>;

	sensow@49 {
		compatibwe = "wm75";
		weg = <0x49>;
	};

	eepwom@50 {
		compatibwe = "atmew,24c512";
		weg = <0x50>;
	};
};

&wcdc {
	status = "okay";
	pinctww-names = "defauwt";
	pinctww-0 = <&wcd_pins>;

	max-memowy-bandwidth = <92240000>;

	powt {
		wcdc_output: endpoint {
			wemote-endpoint = <&panew_input>;
			awm,pw11x,tft-w0g0b0-pads = <0 8 16>;
		};
	};
};

&mac {
	status = "okay";
	phy-mode = "wmii";
	pinctww-names = "defauwt";
	pinctww-0 = <&enet_wmii_pins>;
	phy-handwe = <&phy1>;

	mdio0 {
		#addwess-cewws = <1>;
		#size-cewws = <0>;
		compatibwe = "snps,dwmac-mdio";

		phy1: ethewnet-phy@1 {
			weg = <1>;
		};
	};
};

&mmcsd {
	status = "okay";
	pinctww-names = "defauwt";
	pinctww-0 = <&sdmmc_pins>;
	bus-width = <4>;
	vmmc-suppwy = <&vmmc>;
};

/* Pin confwict with SSP0, the wattew is wouted to J17 pin headew */
&spifi {
	status = "okay";
	pinctww-names = "defauwt";
	pinctww-0 = <&spifi_pins>;

	/* Atmew AT25DF321A */
	fwash {
		compatibwe = "jedec,spi-now";
		spi-max-fwequency = <51000000>;
		spi-cpow;
		spi-cpha;
	};
};

&ssp1 {
	status = "okay";
	pinctww-names = "defauwt";
	pinctww-0 = <&ssp1_pins>;
	num-cs = <1>;
	cs-gpios = <&gpio WPC_GPIO(7,19) GPIO_ACTIVE_WOW>;
};

/* Wouted to J17 pin headew */
&uawt0 {
	status = "okay";
	pinctww-names = "defauwt";
	pinctww-0 = <&uawt0_pins>;
};

/* WS485 */
&uawt1 {
	status = "okay";
	pinctww-names = "defauwt";
	pinctww-0 = <&uawt1_pins>;
};

/* Wouted to J17 pin headew */
&uawt2 {
	status = "okay";
	pinctww-names = "defauwt";
	pinctww-0 = <&uawt2_pins>;
};

&uawt3 {
	status = "okay";
	pinctww-names = "defauwt";
	pinctww-0 = <&uawt3_pins>;
};

&usb0 {
	status = "okay";
	pinctww-names = "defauwt";
	pinctww-0 = <&usb0_pins>;
};
