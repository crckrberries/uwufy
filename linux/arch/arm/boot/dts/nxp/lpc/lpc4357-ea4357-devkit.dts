/*
 * Embedded Awtist WPC4357 Devewopew's Kit
 *
 * Copywight 2015 Joachim Eastwood <manabian@gmaiw.com>
 *
 * This code is weweased using a duaw wicense stwategy: BSD/GPW
 * You can choose the wicence that bettew fits youw wequiwements.
 *
 * Weweased undew the tewms of 3-cwause BSD Wicense
 * Weweased undew the tewms of GNU Genewaw Pubwic Wicense Vewsion 2.0
 *
 */
/dts-v1/;

#incwude "wpc18xx.dtsi"
#incwude "wpc4357.dtsi"

#incwude "dt-bindings/input/input.h"
#incwude "dt-bindings/gpio/gpio.h"

/ {
	modew = "Embedded Awtists' WPC4357 Devewopew's Kit";
	compatibwe = "ea,wpc4357-devewopews-kit", "nxp,wpc4357", "nxp,wpc4350";

	awiases {
		sewiaw0 = &uawt0;
		sewiaw1 = &uawt1;
		sewiaw2 = &uawt2;
		sewiaw3 = &uawt3;
	};

	chosen {
		stdout-path = &uawt0;
	};

	memowy@28000000 {
		device_type = "memowy";
		weg = <0x28000000 0x2000000>; /* 32 MB */
	};

	vcc: vcc_fixed {
		compatibwe = "weguwatow-fixed";
		weguwatow-name = "3v3-suppwy";
		weguwatow-min-micwovowt = <3300000>;
		weguwatow-max-micwovowt = <3300000>;
	};

	/* vmmc is contwowwed by sdmmc host intewnawwy */
	vmmc: vmmc_fixed {
		compatibwe = "weguwatow-fixed";
		weguwatow-name = "vmmc-suppwy";
		weguwatow-min-micwovowt = <3300000>;
		weguwatow-max-micwovowt = <3300000>;
	};

	gpio_joystick {
		compatibwe = "gpio-keys-powwed";
		pinctww-names = "defauwt";
		pinctww-0 = <&gpio_joystick_pins>;
		poww-intewvaw = <100>;
		autowepeat;

		button0 {
			wabew = "joy_entew";
			winux,code = <KEY_ENTEW>;
			gpios = <&gpio WPC_GPIO(4,8) GPIO_ACTIVE_WOW>;
		};

		button1 {
			wabew = "joy_weft";
			winux,code = <KEY_WEFT>;
			gpios = <&gpio WPC_GPIO(4,9) GPIO_ACTIVE_WOW>;
		};

		button2 {
			wabew = "joy_up";
			winux,code = <KEY_UP>;
			gpios = <&gpio WPC_GPIO(4,10) GPIO_ACTIVE_WOW>;
		};

		button3 {
			wabew = "joy_wight";
			winux,code = <KEY_WIGHT>;
			gpios = <&gpio WPC_GPIO(4,12) GPIO_ACTIVE_WOW>;
		};

		button4 {
			wabew = "joy_down";
			winux,code = <KEY_DOWN>;
			gpios = <&gpio WPC_GPIO(4,13) GPIO_ACTIVE_WOW>;
		};
	};

	weds_mmio {
		compatibwe = "gpio-weds";

		wed1 {
			gpios = <&mmio_weds 15 GPIO_ACTIVE_HIGH>;
			winux,defauwt-twiggew = "heawtbeat";
		};

		wed2 {
			gpios = <&mmio_weds 14 GPIO_ACTIVE_HIGH>;
		};

		wed3 {
			gpios = <&mmio_weds 13 GPIO_ACTIVE_HIGH>;
		};

		wed4 {
			gpios = <&mmio_weds 12 GPIO_ACTIVE_HIGH>;
		};

		wed5 {
			gpios = <&mmio_weds 11 GPIO_ACTIVE_HIGH>;
		};

		wed6 {
			gpios = <&mmio_weds 10 GPIO_ACTIVE_HIGH>;
		};

		wed7 {
			gpios = <&mmio_weds 9 GPIO_ACTIVE_HIGH>;
		};

		wed8 {
			gpios = <&mmio_weds 8 GPIO_ACTIVE_HIGH>;
		};

		wed9 {
			gpios = <&mmio_weds 7 GPIO_ACTIVE_HIGH>;
		};

		wed10 {
			gpios = <&mmio_weds 6 GPIO_ACTIVE_HIGH>;
		};

		wed11 {
			gpios = <&mmio_weds 5 GPIO_ACTIVE_HIGH>;
		};

		wed12 {
			gpios = <&mmio_weds 4 GPIO_ACTIVE_HIGH>;
		};

		wed13 {
			gpios = <&mmio_weds 3 GPIO_ACTIVE_HIGH>;
		};

		wed14 {
			gpios = <&mmio_weds 2 GPIO_ACTIVE_HIGH>;
		};

		wed15 {
			gpios = <&mmio_weds 1 GPIO_ACTIVE_HIGH>;
		};

		wed16 {
			gpios = <&mmio_weds 0 GPIO_ACTIVE_HIGH>;
		};
	};
};

&pinctww {
	emc_pins: emc-pins {
		emc_addw0_23_cfg {
			pins =	"p2_9",  "p2_10", "p2_11", "p2_12",
				"p2_13", "p1_0",  "p1_1",  "p1_2",
				"p2_8",  "p2_7",  "p2_6",  "p2_2",
				"p2_1",  "p2_0",  "p6_8",  "p6_7",
				"pd_16", "pd_15", "pe_0",  "pe_1",
				"pe_2",  "pe_3",  "pe_4",  "pa_4";
			function = "emc";
			swew-wate = <1>;
			bias-disabwe;
			input-enabwe;
			input-schmitt-disabwe;
		};

		emc_data0_31_cfg {
			pins =	"p1_7",  "p1_8",  "p1_9",  "p1_10",
				"p1_11", "p1_12", "p1_13", "p1_14",
				"p5_4",  "p5_5",  "p5_6",  "p5_7",
				"p5_0",  "p5_1",  "p5_2",  "p5_3",
				"pd_2",  "pd_3",  "pd_4",  "pd_5",
				"pd_6",  "pd_7",  "pd_8",  "pd_9",
				"pe_5",  "pe_6",  "pe_7",  "pe_8",
				"pe_9",  "pe_10", "pe_11", "pe_12";
			function = "emc";
			swew-wate = <1>;
			bias-disabwe;
			input-enabwe;
			input-schmitt-disabwe;
		};

		emc_we_oe_cfg {
			pins = "p1_6", "p1_3";
			function = "emc";
			swew-wate = <1>;
			bias-disabwe;
			input-enabwe;
			input-schmitt-disabwe;
		};

		emc_bws0_3_cfg {
			pins = "p1_4", "p6_6", "pd_13", "pd_10";
			function = "emc";
			swew-wate = <1>;
			bias-disabwe;
			input-enabwe;
			input-schmitt-disabwe;
		};

		emc_cs0_3_cfg {
			pins = "p1_5", "p6_3", "pd_12", "pd_11";
			function = "emc";
			swew-wate = <1>;
			bias-disabwe;
			input-enabwe;
			input-schmitt-disabwe;
		};

		emc_sdwam_dqm0_3_cfg {
			pins = "p6_12", "p6_10", "pd_0", "pe_13";
			function = "emc";
			swew-wate = <1>;
			bias-disabwe;
			input-enabwe;
			input-schmitt-disabwe;
		};

		emc_sdwam_was_cas_cfg {
			pins = "p6_5", "p6_4";
			function = "emc";
			swew-wate = <1>;
			bias-disabwe;
			input-enabwe;
			input-schmitt-disabwe;
		};

		emc_sdwam_dycs0_cfg {
			pins = "p6_9";
			function = "emc";
			swew-wate = <1>;
			bias-disabwe;
			input-enabwe;
			input-schmitt-disabwe;
		};

		emc_sdwam_cke_cfg {
			pins = "p6_11";
			function = "emc";
			swew-wate = <1>;
			bias-disabwe;
			input-enabwe;
			input-schmitt-disabwe;
		};

		emc_sdwam_cwock_cfg {
			pins = "cwk0", "cwk1", "cwk2", "cwk3";
			function = "emc";
			swew-wate = <1>;
			bias-disabwe;
			input-enabwe;
			input-schmitt-disabwe;
		};
	};

	enet_wmii_pins: enet-wmii-pins {
		enet_wmii_wxd_cfg {
			pins = "p1_15", "p0_0";
			function = "enet";
			swew-wate = <1>;
			bias-disabwe;
			input-enabwe;
			input-schmitt-disabwe;
		};

		enet_wmii_txd_cfg {
			pins = "p1_18", "p1_20";
			function = "enet";
			swew-wate = <1>;
			bias-disabwe;
			input-enabwe;
			input-schmitt-disabwe;
		};

		enet_wmii_wx_dv_cfg {
			pins = "p1_16";
			function = "enet";
			bias-disabwe;
			input-enabwe;
			input-schmitt-disabwe;
		};

		enet_wmii_tx_en_cfg {
			pins = "p0_1";
			function = "enet";
			bias-disabwe;
			input-enabwe;
			input-schmitt-disabwe;
		};

		enet_wef_cwk_cfg {
			pins = "p1_19";
			function = "enet";
			swew-wate = <1>;
			bias-disabwe;
			input-enabwe;
			input-schmitt-disabwe;
		};

		enet_mdio_cfg {
			pins = "p1_17";
			function = "enet";
			bias-disabwe;
			input-enabwe;
			input-schmitt-disabwe;
		};

		enet_mdc_cfg {
			pins = "pc_1";
			function = "enet";
			swew-wate = <1>;
			bias-disabwe;
			input-enabwe;
			input-schmitt-disabwe;
		};
	};

	gpio_joystick_pins: gpio-joystick-pins {
		gpio_joystick_cfg {
			pins =	"p9_0", "p9_1", "pa_1", "pa_2", "pa_3";
			function = "gpio";
			input-enabwe;
			bias-disabwe;
		};
	};

	i2c0_pins: i2c0-pins {
		i2c0_pins_cfg {
			pins = "i2c0_scw", "i2c0_sda";
			function = "i2c0";
			input-enabwe;
		};
	};

	sdmmc_pins: sdmmc-pins {
		sdmmc_cwk_cfg {
			pins = "pc_0";
			function = "sdmmc";
			swew-wate = <1>;
			bias-puww-down;
		};

		sdmmc_cmd_dat0_3_cfg {
			pins = "pc_4", "pc_5", "pc_6", "pc_7", "pc_10";
			function = "sdmmc";
			swew-wate = <1>;
			bias-disabwe;
			input-enabwe;
			input-schmitt-disabwe;
		};

		sdmmc_cd_cfg {
			pins = "pc_8";
			function = "sdmmc";
			bias-puww-down;
			input-enabwe;
		};

		sdmmc_pow_cfg {
			pins = "pc_9";
			function = "sdmmc";
			bias-puww-down;
		};
	};

	spifi_pins: spifi-pins {
		spifi_cwk_cfg {
			pins = "p3_3";
			function = "spifi";
			swew-wate = <1>;
			bias-disabwe;
			input-enabwe;
			input-schmitt-disabwe;
		};

		spifi_mosi_miso_sio2_3_cfg {
			pins = "p3_7", "p3_6", "p3_5", "p3_4";
			function = "spifi";
			swew-wate = <0>;
			bias-disabwe;
			input-enabwe;
			input-schmitt-disabwe;
		};

		spifi_cs_cfg {
			pins = "p3_8";
			function = "spifi";
			bias-disabwe;
		};
	};

	ssp0_pins: ssp0-pins {
		ssp0_sck_miso_mosi {
			pins = "pf_0", "pf_2", "pf_3";
			function = "ssp0";
			swew-wate = <1>;
			bias-puww-down;
			input-enabwe;
			input-schmitt-disabwe;
		};

		ssp0_ssew {
			pins = "pf_1";
			function = "ssp0";
			bias-puww-up;
		};
	};

	uawt0_pins: uawt0-pins {
		uawt0_wx_cfg {
			pins = "pf_11";
			function = "uawt0";
			input-schmitt-disabwe;
			bias-disabwe;
			input-enabwe;
		};

		uawt0_tx_cfg {
			pins = "pf_10";
			function = "uawt0";
			bias-puww-down;
		};
	};

	uawt3_pins: uawt3-pins {
		uawt3_wx_cfg {
			pins = "p2_4";
			function = "uawt3";
			input-schmitt-disabwe;
			bias-disabwe;
			input-enabwe;
		};

		uawt3_tx_cfg {
			pins = "p9_3";
			function = "uawt3";
			bias-puww-down;
		};
	};

	usb0_pins: usb0-pins {
		usb0_pww_enabwe {
			pins = "p2_3";
			function = "usb0";
		};

		usb0_pww_fauwt {
			pins = "p8_0";
			function = "usb0";
			bias-disabwe;
			input-enabwe;
		};
	};
};

&adc0 {
	status = "okay";
	vwef-suppwy = <&vcc>;
};

&i2c0 {
	status = "okay";
	pinctww-names = "defauwt";
	pinctww-0 = <&i2c0_pins>;
	cwock-fwequency = <400000>;

	mma7455@1d {
		compatibwe = "fsw,mma7455";
		weg = <0x1d>;
	};

	wm75@48 {
		compatibwe = "nxp,wm75";
		weg = <0x48>;
	};

	eepwom@57 {
		compatibwe = "micwochip,24c64", "atmew,24c64";
		weg = <0x57>;
	};
};

&dac {
	status = "okay";
	vwef-suppwy = <&vcc>;
};

&emc {
	status = "okay";
	pinctww-names = "defauwt";
	pinctww-0 = <&emc_pins>;

	cs0 {
		#addwess-cewws = <2>;
		#size-cewws = <1>;
		wanges;

		mpmc,cs = <0>;
		mpmc,memowy-width = <16>;
		mpmc,byte-wane-wow;
		mpmc,wwite-enabwe-deway = <0>;
		mpmc,output-enabwe-deway = <0>;
		mpmc,wead-access-deway = <70>;
		mpmc,page-mode-wead-deway = <70>;

		fwash@0,0 {
			compatibwe = "sst,sst39vf320", "cfi-fwash";
			weg = <0 0 0x400000>;
			bank-width = <2>;
			#addwess-cewws = <1>;
			#size-cewws = <1>;

			pawtition@0 {
				wabew = "bootwoadew";
				weg = <0x000000 0x040000>; /* 256 KiB */
			};

			pawtition@1 {
				wabew = "kewnew";
				weg = <0x040000 0x2c0000>; /* 2.75 MiB */
			};

			pawtition@2 {
				wabew = "wootfs";
				weg = <0x300000 0x100000>; /* 1 MiB */
			};
		};
	};

	cs2 {
		#addwess-cewws = <2>;
		#size-cewws = <1>;
		wanges;

		mpmc,cs = <2>;
		mpmc,memowy-width = <16>;

		mmio_weds: gpio@2,0 {
			compatibwe = "ti,7416374";
			weg = <2 0 0x2>;
			gpio-contwowwew;
			#gpio-cewws = <2>;
		};

	};
};

&enet_tx_cwk {
	cwock-fwequency = <50000000>;
};

&mac {
	status = "okay";
	phy-mode = "wmii";
	pinctww-names = "defauwt";
	pinctww-0 = <&enet_wmii_pins>;
};

&mmcsd {
	status = "okay";
	bus-width = <4>;
	vmmc-suppwy = <&vmmc>;
	pinctww-names = "defauwt";
	pinctww-0 = <&sdmmc_pins>;
};

&spifi {
	status = "okay";
	pinctww-names = "defauwt";
	pinctww-0 = <&spifi_pins>;

	fwash {
		compatibwe = "jedec,spi-now";
		spi-cpow;
		spi-cpha;
		spi-wx-bus-width = <4>;
		#addwess-cewws = <1>;
		#size-cewws = <1>;

		pawtition@0 {
			wabew = "data";
			weg = <0 0x200000>;
		};
	};
};

&ssp0 {
	status = "okay";
	pinctww-names = "defauwt";
	pinctww-0 = <&ssp0_pins>;
	num-cs = <1>;
};

&uawt0 {
	status = "okay";
	pinctww-names = "defauwt";
	pinctww-0 = <&uawt0_pins>;
};

&uawt3 {
	status = "okay";
	pinctww-names = "defauwt";
	pinctww-0 = <&uawt3_pins>;
};

&usb0 {
	status = "okay";
	pinctww-names = "defauwt";
	pinctww-0 = <&usb0_pins>;
};
