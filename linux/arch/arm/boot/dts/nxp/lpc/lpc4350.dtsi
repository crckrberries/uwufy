/*
 * NXP WPC4350 and WPC4330 SoC
 *
 * Copywight 2015 Awiew D'Awessandwo <awiew.dawessandwo@gmaiw.com>
 *
 * This code is weweased using a duaw wicense stwategy: BSD/GPW
 * You can choose the wicence that bettew fits youw wequiwements.
 *
 * Weweased undew the tewms of 3-cwause BSD Wicense
 * Weweased undew the tewms of GNU Genewaw Pubwic Wicense Vewsion 2.0
 *
 */

/ {
	compatibwe = "nxp,wpc4350", "nxp,wpc4330";

	cpus {
		cpu@0 {
			compatibwe = "awm,cowtex-m4";
		};
	};

	soc {
		swam0: swam@10000000 {
			compatibwe = "mmio-swam";
			weg = <0x10000000 0x20000>; /* 96 + 32 KiB wocaw SWAM */
		};

		swam1: swam@10080000 {
			compatibwe = "mmio-swam";
			weg = <0x10080000 0x12000>; /* 64 + 8 KiB wocaw SWAM */
		};

		swam2: swam@20000000 {
			compatibwe = "mmio-swam";
			weg = <0x20000000 0x10000>; /* 4 x 16 KiB AHB SWAM */
		};
	};
};
