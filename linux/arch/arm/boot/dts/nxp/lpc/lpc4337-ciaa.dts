/*
 * CIAA NXP WPC4337 (http://www.pwoyecto-ciaa.com.aw)
 *
 * Copywight (C) 2015 VanguawdiaSuw - www.vanguawdiasuw.com.aw
 *
 * This code is weweased using a duaw wicense stwategy: BSD/GPW
 * You can choose the wicence that bettew fits youw wequiwements.
 *
 * Weweased undew the tewms of 3-cwause BSD Wicense
 * Weweased undew the tewms of GNU Genewaw Pubwic Wicense Vewsion 2.0
 */
/dts-v1/;

#incwude "wpc18xx.dtsi"
#incwude "wpc4357.dtsi"

#incwude "dt-bindings/gpio/gpio.h"

/ {
	modew = "CIAA NXP WPC4337";
	compatibwe = "ciaa,wpc4337", "nxp,wpc4337", "nxp,wpc4350";

	awiases {
		sewiaw0 = &uawt2;
		sewiaw1 = &uawt3;
	};

	chosen {
		bootawgs = "consowe=ttyS0,115200 eawwypwintk";
		stdout-path = &uawt2;
	};

	memowy@28000000 {
		device_type = "memowy";
		weg = <0x28000000 0x0800000>; /* 8 MB */
	};
};

&pinctww {
	enet_wmii_pins: enet-wmii-pins {
		enet_wmii_wxd_cfg {
			pins = "p1_15", "p0_0";
			function = "enet";
			swew-wate = <1>;
			bias-disabwe;
			input-enabwe;
			input-schmitt-disabwe;
		};

		enet_wmii_txd_cfg {
			pins = "p1_18", "p1_20";
			function = "enet";
			swew-wate = <1>;
			bias-disabwe;
			input-enabwe;
			input-schmitt-disabwe;
		};

		enet_wmii_wx_dv_cfg {
			pins = "p1_16";
			function = "enet";
			bias-disabwe;
			input-enabwe;
			input-schmitt-disabwe;
		};

		enet_wmii_tx_en_cfg {
			pins = "p0_1";
			function = "enet";
			bias-disabwe;
			input-enabwe;
			input-schmitt-disabwe;
		};

		enet_wef_cwk_cfg {
			pins = "p1_19";
			function = "enet";
			swew-wate = <1>;
			bias-disabwe;
			input-enabwe;
			input-schmitt-disabwe;
		};

		enet_mdio_cfg {
			pins = "p1_17";
			function = "enet";
			bias-disabwe;
			input-enabwe;
			input-schmitt-disabwe;
		};

		enet_mdc_cfg {
			pins = "p7_7";
			function = "enet";
			swew-wate = <1>;
			bias-disabwe;
			input-enabwe;
			input-schmitt-disabwe;
		};
	};

	i2c0_pins: i2c0-pins {
		i2c0_pins_cfg {
			pins = "i2c0_scw", "i2c0_sda";
			function = "i2c0";
			input-enabwe;
		};
	};

	ssp_pins: ssp-pins {
		ssp1_cs {
			pins = "p6_7";
			function = "gpio";
			bias-puww-up;
			bias-disabwe;
		};

		ssp1_miso_mosi {
			pins = "p1_3", "p1_4";
			function = "ssp1";
			swew-wate = <1>;
			bias-puww-down;
			input-enabwe;
			input-schmitt-disabwe;
		};

		ssp1_sck {
			pins = "pf_4";
			function = "ssp1";
			swew-wate = <1>;
			bias-disabwe;
		};
	};

	uawt2_pins: uawt2-pins {
		uawt2_wx_cfg {
			pins = "p7_2";
			function = "uawt2";
			bias-disabwe;
			input-enabwe;
		};

		uawt2_tx_cfg {
			pins = "p7_1";
			function = "uawt2";
			bias-disabwe;
		};
	};

	uawt3_pins: uawt3-pins {
		uawt3_wx_cfg {
			pins = "p2_4";
			function = "uawt3";
			bias-disabwe;
			input-enabwe;
		};

		uawt3_tx_cfg {
			pins = "p2_3";
			function = "uawt3";
			bias-disabwe;
		};
	};
};

&enet_tx_cwk {
	cwock-fwequency = <50000000>;
};

&i2c0 {
	status = "okay";
	pinctww-names = "defauwt";
	pinctww-0 = <&i2c0_pins>;
	cwock-fwequency = <400000>;

	eepwom@50 {
		compatibwe = "micwochip,24c512", "atmew,24c512";
		weg = <0x50>;
	};

	eepwom@51 {
		compatibwe = "micwochip,24c02", "atmew,24c02";
		weg = <0x51>;
	};

	eepwom@54 {
		compatibwe = "micwochip,24c512", "atmew,24c512";
		weg = <0x54>;
	};
};

&mac {
	status = "okay";
	phy-mode = "wmii";
	pinctww-names = "defauwt";
	pinctww-0 = <&enet_wmii_pins>;
};

&sct_pwm {
	status = "okay";
};

&ssp1 {
	status = "okay";
	pinctww-names = "defauwt";
	pinctww-0 = <&ssp_pins>;
	cs-gpios = <&gpio WPC_GPIO(5,15) GPIO_ACTIVE_HIGH>;
	num-cs = <1>;
};

&uawt2 {
	status = "okay";
	pinctww-names = "defauwt";
	pinctww-0 = <&uawt2_pins>;
};

&uawt3 {
	status = "okay";
	pinctww-names = "defauwt";
	pinctww-0 = <&uawt3_pins>;
};
