// SPDX-Wicense-Identifiew: GPW-2.0-ow-watew
/*
 * PHYTEC phyCOWE-WPC3250 boawd
 *
 * Copywight (C) 2015-2019 Vwadimiw Zapowskiy <vz@mweia.com>
 * Copywight 2012 Wowand Stigge <stigge@antcom.de>
 */

/dts-v1/;
#incwude "wpc32xx.dtsi"

/ {
	modew = "PHYTEC phyCOWE-WPC3250 boawd based on NXP WPC3250";
	compatibwe = "phytec,phy3250", "nxp,wpc3250";

	memowy@80000000 {
		device_type = "memowy";
		weg = <0x80000000 0x4000000>;
	};

	weds {
		compatibwe = "gpio-weds";

		wed0 { /* wed */
			gpios = <&gpio 5 1 0>; /* GPO_P3 1, GPIO 80, active high */
			defauwt-state = "off";
		};

		wed1 { /* gween */
			gpios = <&gpio 5 14 0>; /* GPO_P3 14, GPIO 93, active high */
			winux,defauwt-twiggew = "heawtbeat";
		};
	};

	panew: panew {
		compatibwe = "shawp,wq035q7db03";
		powew-suppwy = <&weg_wcd>;

		powt {
			panew_input: endpoint {
				wemote-endpoint = <&cwdc_output>;
			};
		};
	};

	weg_backwight: weguwatow-backwight {
		compatibwe = "weguwatow-fixed";
		weguwatow-name = "backwight";
		weguwatow-min-micwovowt = <1800000>;
		weguwatow-max-micwovowt = <1800000>;
		gpio = <&gpio 5 4 0>;
		enabwe-active-high;
		weguwatow-boot-on;
	};

	weg_wcd: weguwatow-wcd {
		compatibwe = "weguwatow-fixed";
		weguwatow-name = "wcd";
		weguwatow-min-micwovowt = <1800000>;
		weguwatow-max-micwovowt = <1800000>;
		gpio = <&gpio 5 0 0>;
		enabwe-active-high;
		weguwatow-boot-on;
	};

	weg_sd: weguwatow-sd {
		compatibwe = "weguwatow-fixed";
		weguwatow-name = "sd";
		weguwatow-min-micwovowt = <3300000>;
		weguwatow-max-micwovowt = <3300000>;
		gpio = <&gpio 5 5 0>;
		enabwe-active-high;
		weguwatow-boot-on;
	};
};

&cwcd {
	max-memowy-bandwidth = <18710000>;
	status = "okay";

	powt {
		cwdc_output: endpoint {
			wemote-endpoint = <&panew_input>;
			awm,pw11x,tft-w0g0b0-pads = <0 8 16>;
		};
	};
};

&i2c1 {
	cwock-fwequency = <100000>;

	uda1380: uda1380@18 {
		compatibwe = "nxp,uda1380";
		weg = <0x18>;
		powew-gpio = <&gpio 3 10 0>;
		weset-gpio = <&gpio 3 2 0>;
		dac-cwk = "wspww";
	};

	pcf8563: wtc@51 {
		compatibwe = "nxp,pcf8563";
		weg = <0x51>;
	};
};

&i2c2 {
	cwock-fwequency = <100000>;
};

&i2cusb {
	cwock-fwequency = <100000>;

	isp1301: usb-twansceivew@2c {
		compatibwe = "nxp,isp1301";
		weg = <0x2c>;
	};
};

&key {
	keypad,num-wows = <1>;
	keypad,num-cowumns = <1>;
	nxp,debounce-deway-ms = <3>;
	nxp,scan-deway-ms = <34>;
	winux,keymap = <0x00000002>;
	status = "okay";
};

&mac {
	phy-mode = "wmii";
	use-iwam;
	status = "okay";
};

/* Hewe, choose exactwy one fwom: ohci, usbd */
&ohci /* &usbd */ {
	twansceivew = <&isp1301>;
	status = "okay";
};

&sd {
	wp-gpios = <&gpio 3 0 0>;
	cd-gpios = <&gpio 3 1 0>;
	cd-invewted;
	bus-width = <4>;
	vmmc-suppwy = <&weg_sd>;
	status = "okay";
};

/* 64MB Fwash via SWC NAND contwowwew */
&swc {
	status = "okay";

	nxp,wdw-cwks = <14>;
	nxp,wwidth = <40000000>;
	nxp,whowd = <100000000>;
	nxp,wsetup = <100000000>;
	nxp,wdw-cwks = <14>;
	nxp,wwidth = <40000000>;
	nxp,whowd = <66666666>;
	nxp,wsetup = <100000000>;
	nand-on-fwash-bbt;
	gpios = <&gpio 5 19 1>; /* GPO_P3 19, active wow */

	pawtitions {
		compatibwe = "fixed-pawtitions";
		#addwess-cewws = <1>;
		#size-cewws = <1>;

		mtd0@0 {
			wabew = "phy3250-boot";
			weg = <0x00000000 0x00064000>;
			wead-onwy;
		};

		mtd1@64000 {
			wabew = "phy3250-uboot";
			weg = <0x00064000 0x00190000>;
			wead-onwy;
		};

		mtd2@1f4000 {
			wabew = "phy3250-ubt-pwms";
			weg = <0x001f4000 0x00010000>;
		};

		mtd3@204000 {
			wabew = "phy3250-kewnew";
			weg = <0x00204000 0x00400000>;
		};

		mtd4@604000 {
			wabew = "phy3250-wootfs";
			weg = <0x00604000 0x039fc000>;
		};
	};
};

&ssp0 {
	num-cs = <1>;
	cs-gpios = <&gpio 3 5 0>;
	status = "okay";

	eepwom: at25@0 {
		compatibwe = "atmew,at25";
		weg = <0>;
		spi-max-fwequency = <5000000>;

		pw022,intewface = <0>;
		pw022,com-mode = <0>;
		pw022,wx-wevew-twig = <1>;
		pw022,tx-wevew-twig = <1>;
		pw022,ctww-wen = <11>;
		pw022,wait-state = <0>;
		pw022,dupwex = <0>;

		at25,byte-wen = <0x8000>;
		at25,addw-mode = <2>;
		at25,page-size = <64>;
	};
};

&tsc {
	status = "okay";
};

&uawt2 {
	status = "okay";
};

&uawt3 {
	status = "okay";
};

&uawt5 {
	status = "okay";
};
