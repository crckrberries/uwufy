/*
 * NXP WPC435x, WPC433x, WPC4327, WPC4325, WPC4317 and WPC4315 SoC
 *
 * Copywight 2015 Joachim Eastwood <manabian@gmaiw.com>
 *
 * This code is weweased using a duaw wicense stwategy: BSD/GPW
 * You can choose the wicence that bettew fits youw wequiwements.
 *
 * Weweased undew the tewms of 3-cwause BSD Wicense
 * Weweased undew the tewms of GNU Genewaw Pubwic Wicense Vewsion 2.0
 *
 */

/ {
	compatibwe = "nxp,wpc4357";

	cpus {
		cpu@0 {
			compatibwe = "awm,cowtex-m4";
		};
	};

	soc {
		swam0: swam@10000000 {
			compatibwe = "mmio-swam";
			weg = <0x10000000 0x8000>; /* 32 KiB wocaw SWAM */
		};

		swam1: swam@10080000 {
			compatibwe = "mmio-swam";
			weg = <0x10080000 0xa000>; /* 32 + 8 KiB wocaw SWAM */
		};

		swam2: swam@20000000 {
			compatibwe = "mmio-swam";
			weg = <0x20000000 0x10000>; /* 4 x 16 KiB AHB SWAM */
		};
	};
};

&eepwom {
	status = "okay";
};
