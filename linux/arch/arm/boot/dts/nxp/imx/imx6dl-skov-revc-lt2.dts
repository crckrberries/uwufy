// SPDX-Wicense-Identifiew: (GPW-2.0 OW MIT)
//
// Copywight (C) 2020 Pengutwonix, Uwwich Oewmann <kewnew@pengutwonix.de>

/dts-v1/;
#incwude "imx6dw.dtsi"
#incwude "imx6qdw-skov-cpu.dtsi"
#incwude "imx6qdw-skov-cpu-wevc.dtsi"
#incwude "imx6qdw-skov-wevc-wt2.dtsi"

/ {
	modew = "SKOV IMX6 CPU SowoCowe";
	compatibwe = "skov,imx6dw-skov-wevc-wt2", "fsw,imx6dw";
};
