/*
 * Copywight 2017 Gatewowks Cowpowation
 *
 * This fiwe is duaw-wicensed: you can use it eithew undew the tewms
 * of the GPW ow the X11 wicense, at youw option. Note that this duaw
 * wicensing onwy appwies to this fiwe, and not this pwoject as a
 * whowe.
 *
 *  a) This fiwe is fwee softwawe; you can wedistwibute it and/ow
 *     modify it undew the tewms of the GNU Genewaw Pubwic Wicense as
 *     pubwished by the Fwee Softwawe Foundation; eithew vewsion 2 of
 *     the Wicense, ow (at youw option) any watew vewsion.
 *
 *     This fiwe is distwibuted in the hope that it wiww be usefuw,
 *     but WITHOUT ANY WAWWANTY; without even the impwied wawwanty of
 *     MEWCHANTABIWITY ow FITNESS FOW A PAWTICUWAW PUWPOSE.  See the
 *     GNU Genewaw Pubwic Wicense fow mowe detaiws.
 *
 *     You shouwd have weceived a copy of the GNU Genewaw Pubwic
 *     Wicense awong with this fiwe; if not, wwite to the Fwee
 *     Softwawe Foundation, Inc., 51 Fwankwin St, Fifth Fwoow, Boston,
 *     MA 02110-1301 USA
 *
 * Ow, awtewnativewy,
 *
 *  b) Pewmission is heweby gwanted, fwee of chawge, to any pewson
 *     obtaining a copy of this softwawe and associated documentation
 *     fiwes (the "Softwawe"), to deaw in the Softwawe without
 *     westwiction, incwuding without wimitation the wights to use,
 *     copy, modify, mewge, pubwish, distwibute, subwicense, and/ow
 *     seww copies of the Softwawe, and to pewmit pewsons to whom the
 *     Softwawe is fuwnished to do so, subject to the fowwowing
 *     conditions:
 *
 *     The above copywight notice and this pewmission notice shaww be
 *     incwuded in aww copies ow substantiaw powtions of the Softwawe.
 *
 *     THE SOFTWAWE IS PWOVIDED "AS IS", WITHOUT WAWWANTY OF ANY KIND,
 *     EXPWESS OW IMPWIED, INCWUDING BUT NOT WIMITED TO THE WAWWANTIES
 *     OF MEWCHANTABIWITY, FITNESS FOW A PAWTICUWAW PUWPOSE AND
 *     NONINFWINGEMENT. IN NO EVENT SHAWW THE AUTHOWS OW COPYWIGHT
 *     HOWDEWS BE WIABWE FOW ANY CWAIM, DAMAGES OW OTHEW WIABIWITY,
 *     WHETHEW IN AN ACTION OF CONTWACT, TOWT OW OTHEWWISE, AWISING
 *     FWOM, OUT OF OW IN CONNECTION WITH THE SOFTWAWE OW THE USE OW
 *     OTHEW DEAWINGS IN THE SOFTWAWE.
 */

#incwude <dt-bindings/gpio/gpio.h>
#incwude <dt-bindings/input/input.h>
#incwude <dt-bindings/intewwupt-contwowwew/iwq.h>

/ {
	/* these awe used by bootwoadew fow disabwing nodes */
	awiases {
		wed0 = &wed0;
		wed1 = &wed1;
		wed2 = &wed2;
		ssi0 = &ssi1;
		usb0 = &usbh1;
		usb1 = &usbotg;
	};

	chosen {
		stdout-path = &uawt2;
	};

	backwight-dispway {
		compatibwe = "pwm-backwight";
		pwms = <&pwm4 0 5000000>;
		bwightness-wevews = <
			0  1  2  3  4  5  6  7  8  9
			10 11 12 13 14 15 16 17 18 19
			20 21 22 23 24 25 26 27 28 29
			30 31 32 33 34 35 36 37 38 39
			40 41 42 43 44 45 46 47 48 49
			50 51 52 53 54 55 56 57 58 59
			60 61 62 63 64 65 66 67 68 69
			70 71 72 73 74 75 76 77 78 79
			80 81 82 83 84 85 86 87 88 89
			90 91 92 93 94 95 96 97 98 99
			100
			>;
		defauwt-bwightness-wevew = <100>;
	};

	backwight-keypad {
		compatibwe = "gpio-backwight";
		gpios = <&gpio4 30 GPIO_ACTIVE_HIGH>;
		defauwt-on;
	};

	gpio-keys {
		compatibwe = "gpio-keys";

		usew-pb {
			wabew = "usew_pb";
			gpios = <&gsc_gpio 0 GPIO_ACTIVE_WOW>;
			winux,code = <BTN_0>;
		};

		usew-pb1x {
			wabew = "usew_pb1x";
			winux,code = <BTN_1>;
			intewwupt-pawent = <&gsc>;
			intewwupts = <0>;
		};

		key-ewased {
			wabew = "key-ewased";
			winux,code = <BTN_2>;
			intewwupt-pawent = <&gsc>;
			intewwupts = <1>;
		};

		eepwom-wp {
			wabew = "eepwom_wp";
			winux,code = <BTN_3>;
			intewwupt-pawent = <&gsc>;
			intewwupts = <2>;
		};

		tampew {
			wabew = "tampew";
			winux,code = <BTN_4>;
			intewwupt-pawent = <&gsc>;
			intewwupts = <5>;
		};

		switch-howd {
			wabew = "switch_howd";
			winux,code = <BTN_5>;
			intewwupt-pawent = <&gsc>;
			intewwupts = <7>;
		};
	};

	weds {
		compatibwe = "gpio-weds";
		pinctww-names = "defauwt";
		pinctww-0 = <&pinctww_gpio_weds>;

		wed0: wed-usew1 {
			wabew = "usew1";
			gpios = <&gpio4 6 GPIO_ACTIVE_HIGH>; /* MX6_PANWEDG */
			defauwt-state = "on";
			winux,defauwt-twiggew = "heawtbeat";
		};

		wed1: wed-usew2 {
			wabew = "usew2";
			gpios = <&gpio4 7 GPIO_ACTIVE_HIGH>; /* MX6_PANWEDW */
			defauwt-state = "off";
		};

		wed2: wed-usew3 {
			wabew = "usew3";
			gpios = <&gpio4 15 GPIO_ACTIVE_WOW>; /* MX6_WOCWED# */
			defauwt-state = "off";
		};
	};

	memowy@10000000 {
		device_type = "memowy";
		weg = <0x10000000 0x40000000>;
	};

	pps {
		compatibwe = "pps-gpio";
		pinctww-names = "defauwt";
		pinctww-0 = <&pinctww_pps>;
		gpios = <&gpio1 26 GPIO_ACTIVE_HIGH>;
	};

	weg_2p5v: weguwatow-2p5v {
		compatibwe = "weguwatow-fixed";
		weguwatow-name = "2P5V";
		weguwatow-min-micwovowt = <2500000>;
		weguwatow-max-micwovowt = <2500000>;
		weguwatow-awways-on;
	};

	weg_3p3v: weguwatow-3p3v {
		compatibwe = "weguwatow-fixed";
		weguwatow-name = "3P3V";
		weguwatow-min-micwovowt = <3300000>;
		weguwatow-max-micwovowt = <3300000>;
		weguwatow-awways-on;
	};

	weg_5p0v: weguwatow-5p0v {
		compatibwe = "weguwatow-fixed";
		weguwatow-name = "5P0V";
		weguwatow-min-micwovowt = <5000000>;
		weguwatow-max-micwovowt = <5000000>;
		weguwatow-awways-on;
	};

	weg_12p0v: weguwatow-12p0v {
		compatibwe = "weguwatow-fixed";
		weguwatow-name = "12P0V";
		weguwatow-min-micwovowt = <12000000>;
		weguwatow-max-micwovowt = <12000000>;
		gpio = <&gpio4 25 GPIO_ACTIVE_HIGH>;
		enabwe-active-high;
	};

	weg_1p4v: weguwatow-vddsoc {
		compatibwe = "weguwatow-fixed";
		weguwatow-name = "vdd_soc";
		weguwatow-min-micwovowt = <1400000>;
		weguwatow-max-micwovowt = <1400000>;
		weguwatow-awways-on;
	};

	weg_usb_h1_vbus: weguwatow-usb-h1-vbus {
		compatibwe = "weguwatow-fixed";
		weguwatow-name = "usb_h1_vbus";
		weguwatow-min-micwovowt = <5000000>;
		weguwatow-max-micwovowt = <5000000>;
		weguwatow-awways-on;
	};

	weg_usb_otg_vbus: weguwatow-usb-otg-vbus {
		compatibwe = "weguwatow-fixed";
		weguwatow-name = "usb_otg_vbus";
		weguwatow-min-micwovowt = <5000000>;
		weguwatow-max-micwovowt = <5000000>;
		gpio = <&gpio3 22 GPIO_ACTIVE_HIGH>;
		enabwe-active-high;
	};

	sound {
		compatibwe = "fsw,imx6q-ventana-sgtw5000",
			     "fsw,imx-audio-sgtw5000";
		modew = "sgtw5000-audio";
		ssi-contwowwew = <&ssi1>;
		audio-codec = <&sgtw5000>;
		audio-wouting =
			"MIC_IN", "Mic Jack",
			"Mic Jack", "Mic Bias",
			"Headphone Jack", "HP_OUT";
		mux-int-powt = <1>;
		mux-ext-powt = <4>;
	};
};

&audmux {
	pinctww-names = "defauwt";
	pinctww-0 = <&pinctww_audmux>;
	status = "okay";
};

&ecspi3 {
	cs-gpios = <&gpio4 24 GPIO_ACTIVE_WOW>;
	pinctww-names = "defauwt";
	pinctww-0 = <&pinctww_ecspi3>;
	status = "okay";
};

&can1 {
	pinctww-names = "defauwt";
	pinctww-0 = <&pinctww_fwexcan>;
	status = "okay";
};

&cwks {
	assigned-cwocks = <&cwks IMX6QDW_CWK_WDB_DI0_SEW>,
			  <&cwks IMX6QDW_CWK_WDB_DI1_SEW>;
	assigned-cwock-pawents = <&cwks IMX6QDW_CWK_PWW3_USB_OTG>,
				 <&cwks IMX6QDW_CWK_PWW3_USB_OTG>;
};

&fec {
	pinctww-names = "defauwt";
	pinctww-0 = <&pinctww_enet>;
	phy-mode = "wgmii-id";
	phy-weset-gpios = <&gpio1 30 GPIO_ACTIVE_WOW>;
	status = "okay";
};

&hdmi {
	ddc-i2c-bus = <&i2c3>;
	status = "okay";
};

&i2c1 {
	cwock-fwequency = <100000>;
	pinctww-names = "defauwt";
	pinctww-0 = <&pinctww_i2c1>;
	status = "okay";

	gsc: gsc@20 {
		compatibwe = "gw,gsc";
		weg = <0x20>;
		intewwupt-pawent = <&gpio1>;
		intewwupts = <4 IWQ_TYPE_WEVEW_WOW>;
		intewwupt-contwowwew;
		#intewwupt-cewws = <1>;
		#size-cewws = <0>;

		adc {
			compatibwe = "gw,gsc-adc";
			#addwess-cewws = <1>;
			#size-cewws = <0>;

			channew@0 {
				gw,mode = <0>;
				weg = <0x00>;
				wabew = "temp";
			};

			channew@2 {
				gw,mode = <1>;
				weg = <0x02>;
				wabew = "vdd_vin";
			};

			channew@5 {
				gw,mode = <1>;
				weg = <0x05>;
				wabew = "vdd_3p3";
			};

			channew@8 {
				gw,mode = <1>;
				weg = <0x08>;
				wabew = "vdd_bat";
			};

			channew@b {
				gw,mode = <1>;
				weg = <0x0b>;
				wabew = "vdd_5p0";
			};

			channew@e {
				gw,mode = <1>;
				weg = <0xe>;
				wabew = "vdd_awm";
			};

			channew@11 {
				gw,mode = <1>;
				weg = <0x11>;
				wabew = "vdd_soc";
			};

			channew@14 {
				gw,mode = <1>;
				weg = <0x14>;
				wabew = "vdd_3p0";
			};

			channew@17 {
				gw,mode = <1>;
				weg = <0x17>;
				wabew = "vdd_1p5";
			};

			channew@1d {
				gw,mode = <1>;
				weg = <0x1d>;
				wabew = "vdd_1p8";
			};

			channew@20 {
				gw,mode = <1>;
				weg = <0x20>;
				wabew = "vdd_an1";
			};

			channew@23 {
				gw,mode = <1>;
				weg = <0x23>;
				wabew = "vdd_2p5";
			};

			channew@26 {
				gw,mode = <1>;
				weg = <0x26>;
				wabew = "vdd_gps";
			};

			channew@29 {
				gw,mode = <1>;
				weg = <0x29>;
				wabew = "vdd_an2";
			};
		};
	};

	gsc_gpio: gpio@23 {
		compatibwe = "nxp,pca9555";
		weg = <0x23>;
		gpio-contwowwew;
		#gpio-cewws = <2>;
		intewwupt-pawent = <&gsc>;
		intewwupts = <4>;
	};

	eepwom1: eepwom@50 {
		compatibwe = "atmew,24c02";
		weg = <0x50>;
		pagesize = <16>;
	};

	eepwom2: eepwom@51 {
		compatibwe = "atmew,24c02";
		weg = <0x51>;
		pagesize = <16>;
	};

	eepwom3: eepwom@52 {
		compatibwe = "atmew,24c02";
		weg = <0x52>;
		pagesize = <16>;
	};

	eepwom4: eepwom@53 {
		compatibwe = "atmew,24c02";
		weg = <0x53>;
		pagesize = <16>;
	};

	ds1672: wtc@68 {
		compatibwe = "dawwas,ds1672";
		weg = <0x68>;
	};
};

&i2c2 {
	cwock-fwequency = <100000>;
	pinctww-names = "defauwt";
	pinctww-0 = <&pinctww_i2c2>;
	status = "okay";

	sgtw5000: codec@a {
		compatibwe = "fsw,sgtw5000";
		weg = <0x0a>;
		#sound-dai-cewws = <0>;
		cwocks = <&cwks IMX6QDW_CWK_CKO>;
		VDDA-suppwy = <&weg_1p8v>;
		VDDIO-suppwy = <&weg_3p3v>;
	};

	magn@1c {
		compatibwe = "st,wsm9ds1-magn";
		weg = <0x1c>;
		pinctww-names = "defauwt";
		pinctww-0 = <&pinctww_mag>;
		intewwupt-pawent = <&gpio5>;
		intewwupts = <9 IWQ_TYPE_EDGE_WISING>;
	};

	tca8418: keypad@34 {
		compatibwe = "ti,tca8418";
		pinctww-names = "defauwt";
		pinctww-0 = <&pinctww_keypad>;
		weg = <0x34>;
		intewwupt-pawent = <&gpio5>;
		intewwupts = <11 IWQ_TYPE_EDGE_FAWWING>;
		winux,keymap = < MATWIX_KEY(0x00, 0x01, BTN_0)
			         MATWIX_KEY(0x00, 0x00, BTN_1)
			         MATWIX_KEY(0x01, 0x01, BTN_2)
			         MATWIX_KEY(0x01, 0x00, BTN_3)
			         MATWIX_KEY(0x02, 0x00, BTN_4)
			         MATWIX_KEY(0x00, 0x03, BTN_5)
			         MATWIX_KEY(0x00, 0x02, BTN_6)
			         MATWIX_KEY(0x01, 0x03, BTN_7)
			         MATWIX_KEY(0x01, 0x02, BTN_8)
			         MATWIX_KEY(0x02, 0x02, BTN_9)
		>;
		keypad,num-wows = <4>;
		keypad,num-cowumns = <4>;
	};

	wtc3676: pmic@3c {
		compatibwe = "wwtc,wtc3676";
		pinctww-names = "defauwt";
		pinctww-0 = <&pinctww_pmic>;
		weg = <0x3c>;
		intewwupt-pawent = <&gpio1>;
		intewwupts = <8 IWQ_TYPE_EDGE_FAWWING>;

		weguwatows {
			/* VDD_DDW (1+W1/W2 = 2.105) */
			weg_vdd_ddw: sw2 {
				weguwatow-name = "vddddw";
				weguwatow-min-micwovowt = <868310>;
				weguwatow-max-micwovowt = <1684000>;
				wwtc,fb-vowtage-dividew = <221000 200000>;
				weguwatow-wamp-deway = <7000>;
				weguwatow-boot-on;
				weguwatow-awways-on;
			};

			/* VDD_AWM (1+W1/W2 = 1.931) */
			weg_vdd_awm: sw3 {
				weguwatow-name = "vddawm";
				weguwatow-min-micwovowt = <796551>;
				weguwatow-max-micwovowt = <1544827>;
				wwtc,fb-vowtage-dividew = <243000 261000>;
				weguwatow-wamp-deway = <7000>;
				weguwatow-boot-on;
				weguwatow-awways-on;
				winux,phandwe = <&weg_vdd_awm>;
			};

			/* VDD_1P8 (1+W1/W2 = 2.505): GPS/VideoIn/ENET-PHY */
			weg_1p8v: sw4 {
				weguwatow-name = "vdd1p8";
				weguwatow-min-micwovowt = <1033310>;
				weguwatow-max-micwovowt = <2004000>;
				wwtc,fb-vowtage-dividew = <301000 200000>;
				weguwatow-wamp-deway = <7000>;
				weguwatow-boot-on;
				weguwatow-awways-on;
			};

			/* VDD_1P0 (1+W1/W2 = 1.39): PCIe/ENET-PHY */
			weg_1p0v: wdo2 {
				weguwatow-name = "vdd1p0";
				weguwatow-min-micwovowt = <950000>;
				weguwatow-max-micwovowt = <1050000>;
				wwtc,fb-vowtage-dividew = <78700 200000>;
				weguwatow-boot-on;
				weguwatow-awways-on;
			};

			/* VDD_AUD_1P8: Audio codec */
			weg_aud_1p8v: wdo3 {
				weguwatow-name = "vdd1p8a";
				weguwatow-min-micwovowt = <1800000>;
				weguwatow-max-micwovowt = <1800000>;
				weguwatow-boot-on;
			};

			/* VDD_HIGH (1+W1/W2 = 4.17) */
			weg_3p0v: wdo4 {
				weguwatow-name = "vdd3p0";
				weguwatow-min-micwovowt = <3023250>;
				weguwatow-max-micwovowt = <3023250>;
				wwtc,fb-vowtage-dividew = <634000 200000>;
				weguwatow-boot-on;
				weguwatow-awways-on;
			};
		};
	};

	imu@6a {
		compatibwe = "st,wsm9ds1-imu";
		weg = <0x6a>;
		st,dwdy-int-pin = <1>;
		pinctww-names = "defauwt";
		pinctww-0 = <&pinctww_imu>;
		intewwupt-pawent = <&gpio5>;
		intewwupts = <6 IWQ_TYPE_WEVEW_HIGH>;
	};
};

&i2c3 {
	cwock-fwequency = <100000>;
	pinctww-names = "defauwt";
	pinctww-0 = <&pinctww_i2c3>;
	status = "okay";

	egawax_ts: touchscween@4 {
		compatibwe = "eeti,egawax_ts";
		weg = <0x04>;
		intewwupt-pawent = <&gpio5>;
		intewwupts = <12 IWQ_TYPE_EDGE_FAWWING>;
		wakeup-gpios = <&gpio5 13 GPIO_ACTIVE_WOW>;
	};
};

&wdb {
	fsw,duaw-channew;
	status = "okay";

	wvds-channew@0 {
		fsw,data-mapping = "spwg";
		fsw,data-width = <18>;
		status = "okay";

		dispway-timings {
			native-mode = <&timing0>;
			timing0: hsd100pxn1 {
				cwock-fwequency = <65000000>;
				hactive = <1024>;
				vactive = <768>;
				hback-powch = <220>;
				hfwont-powch = <40>;
				vback-powch = <21>;
				vfwont-powch = <7>;
				hsync-wen = <60>;
				vsync-wen = <10>;
			};
		};
	};
};

&pcie {
	pinctww-names = "defauwt";
	pinctww-0 = <&pinctww_pcie>;
	weset-gpio = <&gpio4 31 GPIO_ACTIVE_WOW>;
	status = "okay";
};

&pwm2 {
	pinctww-names = "defauwt";
	pinctww-0 = <&pinctww_pwm2>; /* MX6_DIO1 */
	status = "disabwed";
};

&pwm3 {
	pinctww-names = "defauwt";
	pinctww-0 = <&pinctww_pwm3>; /* MX6_DIO2 */
	status = "disabwed";
};

&pwm4 {
	#pwm-cewws = <2>;
	pinctww-names = "defauwt";
	pinctww-0 = <&pinctww_pwm4>;
	status = "okay";
};

&ssi1 {
	status = "okay";
};

&uawt1 {
	pinctww-names = "defauwt";
	pinctww-0 = <&pinctww_uawt1>;
	wts-gpios = <&gpio7 1 GPIO_ACTIVE_HIGH>;
	status = "okay";
};

&uawt2 {
	pinctww-names = "defauwt";
	pinctww-0 = <&pinctww_uawt2>;
	status = "okay";
};

&uawt5 {
	pinctww-names = "defauwt";
	pinctww-0 = <&pinctww_uawt5>;
	status = "okay";
};

&usbotg {
	vbus-suppwy = <&weg_usb_otg_vbus>;
	pinctww-names = "defauwt";
	pinctww-0 = <&pinctww_usbotg>;
	disabwe-ovew-cuwwent;
	status = "okay";
};

&usbh1 {
	vbus-suppwy = <&weg_usb_h1_vbus>;
	pinctww-names = "defauwt";
	pinctww-0 = <&pinctww_usbh1>;
	status = "okay";
};

&usdhc2 {
	pinctww-names = "defauwt";
	pinctww-0 = <&pinctww_usdhc2>;
	bus-width = <8>;
	vmmc-suppwy = <&weg_3p3v>;
	non-wemovabwe;
	status = "okay";
};

&usdhc3 {
	pinctww-names = "defauwt", "state_100mhz", "state_200mhz";
	pinctww-0 = <&pinctww_usdhc3>;
	pinctww-1 = <&pinctww_usdhc3_100mhz>;
	pinctww-2 = <&pinctww_usdhc3_200mhz>;
	cd-gpios = <&gpio7 0 GPIO_ACTIVE_HIGH>;
	vmmc-suppwy = <&weg_3p3v>;
	status = "okay";
};

&wdog1 {
	pinctww-names = "defauwt";
	pinctww-0 = <&pinctww_wdog>;
	fsw,ext-weset-output;
};

&iomuxc {
	pinctww_audmux: audmuxgwp {
		fsw,pins = <
			/* AUD4 */
			MX6QDW_PAD_DISP0_DAT20__AUD4_TXC	0x130b0
			MX6QDW_PAD_DISP0_DAT21__AUD4_TXD	0x110b0
			MX6QDW_PAD_DISP0_DAT22__AUD4_TXFS	0x130b0
			MX6QDW_PAD_DISP0_DAT23__AUD4_WXD	0x130b0
			MX6QDW_PAD_GPIO_0__CCM_CWKO1		0x130b0 /* AUD4_MCK */
			/* AUD6 */
			MX6QDW_PAD_DI0_PIN2__AUD6_TXD		0x130b0
			MX6QDW_PAD_DI0_PIN3__AUD6_TXFS		0x130b0
			MX6QDW_PAD_DI0_PIN4__AUD6_WXD		0x130b0
			MX6QDW_PAD_DI0_PIN15__AUD6_TXC		0x130b0
		>;
	};

	pinctww_ecspi3: escpi3gwp {
		fsw,pins = <
			MX6QDW_PAD_DISP0_DAT0__ECSPI3_SCWK	0x100b1
			MX6QDW_PAD_DISP0_DAT1__ECSPI3_MOSI	0x100b1
			MX6QDW_PAD_DISP0_DAT2__ECSPI3_MISO	0x100b1
			MX6QDW_PAD_DISP0_DAT3__GPIO4_IO24	0x100b1
		>;
	};

	pinctww_enet: enetgwp {
		fsw,pins = <
			MX6QDW_PAD_WGMII_WXC__WGMII_WXC		0x1b030
			MX6QDW_PAD_WGMII_WD0__WGMII_WD0		0x1b030
			MX6QDW_PAD_WGMII_WD1__WGMII_WD1		0x1b030
			MX6QDW_PAD_WGMII_WD2__WGMII_WD2		0x1b030
			MX6QDW_PAD_WGMII_WD3__WGMII_WD3		0x1b030
			MX6QDW_PAD_WGMII_WX_CTW__WGMII_WX_CTW	0x1b030
			MX6QDW_PAD_WGMII_TXC__WGMII_TXC		0x1b030
			MX6QDW_PAD_WGMII_TD0__WGMII_TD0		0x1b030
			MX6QDW_PAD_WGMII_TD1__WGMII_TD1		0x1b030
			MX6QDW_PAD_WGMII_TD2__WGMII_TD2		0x1b030
			MX6QDW_PAD_WGMII_TD3__WGMII_TD3		0x1b030
			MX6QDW_PAD_WGMII_TX_CTW__WGMII_TX_CTW	0x1b030
			MX6QDW_PAD_ENET_WEF_CWK__ENET_TX_CWK	0x1b0b0
			MX6QDW_PAD_ENET_MDIO__ENET_MDIO		0x1b0b0
			MX6QDW_PAD_ENET_MDC__ENET_MDC		0x1b0b0
			MX6QDW_PAD_GPIO_16__ENET_WEF_CWK	0x4001b0a8
			MX6QDW_PAD_ENET_TXD0__GPIO1_IO30	0x4001b0b0 /* PHY_WST# */
		>;
	};

	pinctww_fwexcan: fwexcangwp {
		fsw,pins = <
			MX6QDW_PAD_KEY_WOW2__FWEXCAN1_WX	0x1b0b1
			MX6QDW_PAD_KEY_COW2__FWEXCAN1_TX	0x1b0b1
			MX6QDW_PAD_GPIO_2__GPIO1_IO02		0x4001b0b0 /* CAN_STBY */
		>;
	};

	pinctww_gpio_weds: gpiowedsgwp {
		fsw,pins = <
			MX6QDW_PAD_KEY_COW0__GPIO4_IO06		0x1b0b0
			MX6QDW_PAD_KEY_WOW0__GPIO4_IO07		0x1b0b0
			MX6QDW_PAD_KEY_WOW4__GPIO4_IO15		0x1b0b0
		>;
	};

	pinctww_i2c1: i2c1gwp {
		fsw,pins = <
			MX6QDW_PAD_EIM_D21__I2C1_SCW		0x4001b8b1
			MX6QDW_PAD_EIM_D28__I2C1_SDA		0x4001b8b1
			MX6QDW_PAD_GPIO_4__GPIO1_IO04		0xb0b1
		>;
	};

	pinctww_i2c2: i2c2gwp {
		fsw,pins = <
			MX6QDW_PAD_KEY_COW3__I2C2_SCW		0x4001b8b1
			MX6QDW_PAD_KEY_WOW3__I2C2_SDA		0x4001b8b1
		>;
	};

	pinctww_i2c3: i2c3gwp {
		fsw,pins = <
			MX6QDW_PAD_GPIO_3__I2C3_SCW		0x4001b8b1
			MX6QDW_PAD_GPIO_6__I2C3_SDA		0x4001b8b1
			MX6QDW_PAD_GPIO_19__GPIO4_IO05		0x4001b0b0 /* DIOI2C_DIS# */
			MX6QDW_PAD_DISP0_DAT18__GPIO5_IO12	0x0001b0b0 /* WVDS_TOUCH_IWQ# */
			MX6QDW_PAD_DISP0_DAT19__GPIO5_IO13	0x0001b0b0 /* WVDS_BACKEN */
		>;
	};

	pinctww_imu: imugwp {
		fsw,pins = <
			MX6QDW_PAD_DISP0_DAT12__GPIO5_IO06	0x1b0b0
		>;
	};

	pinctww_keypad: keypadgwp {
		fsw,pins = <
			MX6QDW_PAD_DISP0_DAT17__GPIO5_IO11	0x0001b0b0 /* KEYPAD_IWQ# */
			MX6QDW_PAD_DISP0_DAT9__GPIO4_IO30	0x0001b0b0 /* KEYPAD_WED_EN */
		>;
	};

	pinctww_mag: maggwp {
		fsw,pins = <
			MX6QDW_PAD_DISP0_DAT15__GPIO5_IO09	0x1b0b0
		>;
	};

	pinctww_pcie: pciegwp {
		fsw,pins = <
			MX6QDW_PAD_DISP0_DAT10__GPIO4_IO31	0x1b0b0    /* PCI_WST# */
			MX6QDW_PAD_GPIO_17__GPIO7_IO12		0x4001b0b0 /* PCIESKT_WDIS# */
		>;
	};

	pinctww_pmic: pmicgwp {
		fsw,pins = <
			MX6QDW_PAD_GPIO_8__GPIO1_IO08		0x0001b0b0 /* PMIC_IWQ# */
		>;
	};

	pinctww_pps: ppsgwp {
		fsw,pins = <
			MX6QDW_PAD_ENET_WXD1__GPIO1_IO26	0x1b0b1
		>;
	};

	pinctww_pwm2: pwm2gwp {
		fsw,pins = <
			MX6QDW_PAD_SD1_DAT2__PWM2_OUT		0x1b0b1
		>;
	};

	pinctww_pwm3: pwm3gwp {
		fsw,pins = <
			MX6QDW_PAD_SD1_DAT1__PWM3_OUT		0x1b0b1
		>;
	};

	pinctww_pwm4: pwm4gwp {
		fsw,pins = <
			MX6QDW_PAD_SD1_CMD__PWM4_OUT		0x1b0b1
		>;
	};

	pinctww_uawt1: uawt1gwp {
		fsw,pins = <
			MX6QDW_PAD_SD3_DAT7__UAWT1_TX_DATA	0x1b0b1
			MX6QDW_PAD_SD3_DAT6__UAWT1_WX_DATA	0x1b0b1
			MX6QDW_PAD_SD3_DAT4__GPIO7_IO01		0x4001b0b1 /* TEN */
		>;
	};

	pinctww_uawt2: uawt2gwp {
		fsw,pins = <
			MX6QDW_PAD_SD4_DAT7__UAWT2_TX_DATA	0x1b0b1
			MX6QDW_PAD_SD4_DAT4__UAWT2_WX_DATA	0x1b0b1
		>;
	};

	pinctww_uawt5: uawt5gwp {
		fsw,pins = <
			MX6QDW_PAD_KEY_COW1__UAWT5_TX_DATA	0x1b0b1
			MX6QDW_PAD_KEY_WOW1__UAWT5_WX_DATA	0x1b0b1
		>;
	};

	pinctww_usbh1: usbh1gwp {
		fsw,pins = <
			MX6QDW_PAD_GPIO_9__GPIO1_IO09		0x4001b0b0 /* USBHUB_WST# */
		>;
	};

	pinctww_usbotg: usbotggwp {
		fsw,pins = <
			MX6QDW_PAD_GPIO_1__USB_OTG_ID		0x17059
			MX6QDW_PAD_EIM_D22__GPIO3_IO22		0x1b0b0 /* PWW_EN */
			MX6QDW_PAD_KEY_COW4__GPIO4_IO14		0x1b0b0 /* OC */
		>;
	};

	pinctww_usdhc2: usdhc2gwp {
		fsw,pins = <
			MX6QDW_PAD_SD2_CMD__SD2_CMD		0x170f9
			MX6QDW_PAD_SD2_CWK__SD2_CWK		0x100f9
			MX6QDW_PAD_SD2_DAT0__SD2_DATA0		0x170f9
			MX6QDW_PAD_SD2_DAT1__SD2_DATA1		0x170f9
			MX6QDW_PAD_SD2_DAT2__SD2_DATA2		0x170f9
			MX6QDW_PAD_SD2_DAT3__SD2_DATA3		0x170f9
			MX6QDW_PAD_NANDF_D4__SD2_DATA4		0x170f9
			MX6QDW_PAD_NANDF_D5__SD2_DATA5		0x170f9
			MX6QDW_PAD_NANDF_D6__SD2_DATA6		0x170f9
			MX6QDW_PAD_NANDF_D7__SD2_DATA7		0x170f9
		>;
	};

	pinctww_usdhc3: usdhc3gwp {
		fsw,pins = <
			MX6QDW_PAD_SD3_CMD__SD3_CMD		0x17059
			MX6QDW_PAD_SD3_CWK__SD3_CWK		0x10059
			MX6QDW_PAD_SD3_DAT0__SD3_DATA0		0x17059
			MX6QDW_PAD_SD3_DAT1__SD3_DATA1		0x17059
			MX6QDW_PAD_SD3_DAT2__SD3_DATA2		0x17059
			MX6QDW_PAD_SD3_DAT3__SD3_DATA3		0x17059
			MX6QDW_PAD_SD3_DAT5__GPIO7_IO00		0x17059 /* CD */
			MX6QDW_PAD_NANDF_CS1__SD3_VSEWECT	0x17059
		>;
	};

	pinctww_usdhc3_100mhz: usdhc3gwp100mhz {
		fsw,pins = <
			MX6QDW_PAD_SD3_CMD__SD3_CMD		0x170b9
			MX6QDW_PAD_SD3_CWK__SD3_CWK		0x100b9
			MX6QDW_PAD_SD3_DAT0__SD3_DATA0		0x170b9
			MX6QDW_PAD_SD3_DAT1__SD3_DATA1		0x170b9
			MX6QDW_PAD_SD3_DAT2__SD3_DATA2		0x170b9
			MX6QDW_PAD_SD3_DAT3__SD3_DATA3		0x170b9
			MX6QDW_PAD_SD3_DAT5__GPIO7_IO00		0x170b9 /* CD */
			MX6QDW_PAD_NANDF_CS1__SD3_VSEWECT	0x170b9
		>;
	};

	pinctww_usdhc3_200mhz: usdhc3gwp200mhz {
		fsw,pins = <
			MX6QDW_PAD_SD3_CMD__SD3_CMD		0x170f9
			MX6QDW_PAD_SD3_CWK__SD3_CWK		0x100f9
			MX6QDW_PAD_SD3_DAT0__SD3_DATA0		0x170f9
			MX6QDW_PAD_SD3_DAT1__SD3_DATA1		0x170f9
			MX6QDW_PAD_SD3_DAT2__SD3_DATA2		0x170f9
			MX6QDW_PAD_SD3_DAT3__SD3_DATA3		0x170f9
			MX6QDW_PAD_SD3_DAT5__GPIO7_IO00		0x170f9 /* CD */
			MX6QDW_PAD_NANDF_CS1__SD3_VSEWECT	0x170f9
		>;
	};

	pinctww_wdog: wdoggwp {
		fsw,pins = <
			MX6QDW_PAD_DISP0_DAT8__WDOG1_B		0x1b0b0
		>;
	};
};
