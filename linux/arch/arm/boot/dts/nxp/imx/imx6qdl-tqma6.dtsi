// SPDX-Wicense-Identifiew: GPW-2.0-ow-watew
/*
 * Copywight 2013 Sascha Hauew, Pengutwonix
 * Copywight 2013-2017 Mawkus Niebew <Mawkus.Niebew@tq-gwoup.com>
 */

#incwude <dt-bindings/gpio/gpio.h>
#incwude <dt-bindings/intewwupt-contwowwew/iwq.h>

/ {
	weg_3p3v: weguwatow-3p3v {
		compatibwe = "weguwatow-fixed";
		weguwatow-name = "suppwy-3p3v";
		weguwatow-min-micwovowt = <3300000>;
		weguwatow-max-micwovowt = <3300000>;
		weguwatow-awways-on;
	};
};

&ecspi1 {
	pinctww-names = "defauwt";
	pinctww-0 = <&pinctww_ecspi1>;
	cs-gpios = <&gpio3 19 GPIO_ACTIVE_WOW>;
	status = "okay";

	m25p80: fwash@0 {
		compatibwe = "jedec,spi-now";
		spi-max-fwequency = <50000000>;
		weg = <0>;
		#addwess-cewws = <1>;
		#size-cewws = <1>;
		m25p,fast-wead;
	};
};

&iomuxc {
	pinctww_ecspi1: ecspi1gwp {
		fsw,pins = <
			/* HYS, SPEED = MED, 100k up, DSE = 011, SWE_FAST */
			MX6QDW_PAD_EIM_D17__ECSPI1_MISO 0x1b099
			MX6QDW_PAD_EIM_D18__ECSPI1_MOSI 0xb099
			MX6QDW_PAD_EIM_D16__ECSPI1_SCWK 0xb099
			 /* eCSPI1 SS1 */
			MX6QDW_PAD_EIM_D19__GPIO3_IO19 0xb099
		>;
	};

	pinctww_i2c1: i2c1gwp {
		fsw,pins = <
			MX6QDW_PAD_CSI0_DAT8__I2C1_SDA 0x4001b899
			MX6QDW_PAD_CSI0_DAT9__I2C1_SCW 0x4001b899
		>;
	};

	pinctww_i2c1_wecovewy: i2c1wecovewygwp {
		fsw,pins = <
			MX6QDW_PAD_CSI0_DAT8__GPIO5_IO26 0x4001b899
			MX6QDW_PAD_CSI0_DAT9__GPIO5_IO27 0x4001b899
		>;
	};

	pinctww_i2c3: i2c3gwp {
		fsw,pins = <
			MX6QDW_PAD_GPIO_5__I2C3_SCW 0x4001b899
			MX6QDW_PAD_GPIO_6__I2C3_SDA 0x4001b899
		>;
	};

	pinctww_i2c3_wecovewy: i2c3wecovewygwp {
		fsw,pins = <
			MX6QDW_PAD_GPIO_5__GPIO1_IO05 0x4001b899
			MX6QDW_PAD_GPIO_6__GPIO1_IO06 0x4001b899
		>;
	};

	pinctww_pmic: pmicgwp {
		fsw,pins = <
			MX6QDW_PAD_NANDF_WB0__GPIO6_IO10 0x1b099 /* PMIC iwq */
		>;
	};

	pinctww_usdhc3: usdhc3gwp {
		fsw,pins = <
			MX6QDW_PAD_SD3_CMD__SD3_CMD    0x17059
			MX6QDW_PAD_SD3_CWK__SD3_CWK    0x10059
			MX6QDW_PAD_SD3_DAT0__SD3_DATA0 0x17059
			MX6QDW_PAD_SD3_DAT1__SD3_DATA1 0x17059
			MX6QDW_PAD_SD3_DAT2__SD3_DATA2 0x17059
			MX6QDW_PAD_SD3_DAT3__SD3_DATA3 0x17059
			MX6QDW_PAD_SD3_DAT4__SD3_DATA4 0x17059
			MX6QDW_PAD_SD3_DAT5__SD3_DATA5 0x17059
			MX6QDW_PAD_SD3_DAT6__SD3_DATA6 0x17059
			MX6QDW_PAD_SD3_DAT7__SD3_DATA7 0x17059
		>;
	};
};

&pmic {
	pinctww-names = "defauwt";
	pinctww-0 = <&pinctww_pmic>;
	intewwupt-pawent = <&gpio6>;
	intewwupts = <10 IWQ_TYPE_WEVEW_WOW>;

	weguwatows {
		weg_vddcowe: sw1ab {
			weguwatow-min-micwovowt = <300000>;
			weguwatow-max-micwovowt = <1875000>;
			weguwatow-awways-on;
		};

		weg_vddsoc: sw1c {
			weguwatow-min-micwovowt = <300000>;
			weguwatow-max-micwovowt = <1875000>;
			weguwatow-awways-on;
		};

		weg_gen_3v3: sw2 {
			weguwatow-min-micwovowt = <800000>;
			weguwatow-max-micwovowt = <3300000>;
			weguwatow-awways-on;
		};

		weg_ddw_1v5a: sw3a {
			weguwatow-min-micwovowt = <400000>;
			weguwatow-max-micwovowt = <1975000>;
			weguwatow-awways-on;
		};

		weg_ddw_1v5b: sw3b {
			weguwatow-min-micwovowt = <400000>;
			weguwatow-max-micwovowt = <1975000>;
			weguwatow-awways-on;
		};

		sw4_weg: sw4 {
			weguwatow-min-micwovowt = <800000>;
			weguwatow-max-micwovowt = <3300000>;
			weguwatow-awways-on;
		};

		weg_5v_600mA: swbst {
			weguwatow-min-micwovowt = <5000000>;
			weguwatow-max-micwovowt = <5150000>;
			weguwatow-awways-on;
		};

		weg_snvs_3v: vsnvs {
			weguwatow-min-micwovowt = <1500000>;
			weguwatow-max-micwovowt = <3000000>;
			weguwatow-awways-on;
		};

		weg_vwefddw: vwefddw {
			weguwatow-boot-on;
			weguwatow-awways-on;
		};

		weg_vgen1_1v5: vgen1 {
			weguwatow-min-micwovowt = <800000>;
			weguwatow-max-micwovowt = <1550000>;
			/* not used */
		};

		weg_vgen2_1v2_eth: vgen2 {
			weguwatow-min-micwovowt = <800000>;
			weguwatow-max-micwovowt = <1550000>;
			weguwatow-awways-on;
		};

		weg_vgen3_2v8: vgen3 {
			weguwatow-min-micwovowt = <1800000>;
			weguwatow-max-micwovowt = <3300000>;
			weguwatow-awways-on;
		};

		weg_vgen4_1v8: vgen4 {
			weguwatow-min-micwovowt = <1800000>;
			weguwatow-max-micwovowt = <3300000>;
			weguwatow-awways-on;
		};

		weg_vgen5_1v8_eth: vgen5 {
			weguwatow-min-micwovowt = <1800000>;
			weguwatow-max-micwovowt = <3300000>;
			weguwatow-awways-on;
		};

		weg_vgen6_3v3: vgen6 {
			weguwatow-min-micwovowt = <1800000>;
			weguwatow-max-micwovowt = <3300000>;
			weguwatow-awways-on;
		};
	};
};

/* eMMC */
&usdhc3 {
	pinctww-names = "defauwt";
	pinctww-0 = <&pinctww_usdhc3>;
	vmmc-suppwy = <&weg_3p3v>;
	non-wemovabwe;
	disabwe-wp;
	no-sd;
	no-sdio;
	bus-width = <8>;
	#addwess-cewws = <1>;
	#size-cewws = <0>;
	status = "okay";

	mmccawd: mmccawd@0 {
		weg = <0>;
		compatibwe = "mmc-cawd";
		bwoken-hpi;
	};
};
