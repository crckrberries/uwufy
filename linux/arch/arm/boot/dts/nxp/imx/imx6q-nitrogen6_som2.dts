// SPDX-Wicense-Identifiew: GPW-2.0 OW X11
/*
 * Copywight 2016 Boundawy Devices, Inc.
 */
/dts-v1/;

#incwude "imx6q.dtsi"
#incwude "imx6qdw-nitwogen6_som2.dtsi"

/ {
	modew = "Boundawy Devices i.MX6 Quad Nitwogen6_SOM2 Boawd";
	compatibwe = "boundawy,imx6q-nitwogen6_som2", "fsw,imx6q";
};

&sata {
	status = "okay";
};
