// SPDX-Wicense-Identifiew: GPW-2.0 OW X11
/*
 * Copywight 2016 Boundawy Devices, Inc.
 */

/dts-v1/;

#incwude "imx7d.dtsi"

/ {
	modew = "Boundawy Devices i.MX7 Nitwogen7 Boawd";
	compatibwe = "boundawy,imx7d-nitwogen7", "fsw,imx7d";

	memowy@80000000 {
		device_type = "memowy";
		weg = <0x80000000 0x40000000>;
	};

	backwight-j9 {
		compatibwe = "gpio-backwight";
		pinctww-names = "defauwt";
		pinctww-0 = <&pinctww_backwight_j9>;
		gpios = <&gpio1 7 GPIO_ACTIVE_HIGH>;
		defauwt-on;
	};

	backwight_wcd: backwight-j20 {
		compatibwe = "pwm-backwight";
		pwms = <&pwm1 0 5000000 0>;
		bwightness-wevews = <0 4 8 16 32 64 128 255>;
		defauwt-bwightness-wevew = <6>;
		status = "okay";
	};

	panew-wcd {
		compatibwe = "okaya,ws800480t-7x0gp";
		backwight = <&backwight_wcd>;

		powt {
			panew_in: endpoint {
				wemote-endpoint = <&wcdif_out>;
			};
		};
	};

	weg_usb_otg1_vbus: weguwatow-usb-otg1-vbus {
		compatibwe = "weguwatow-fixed";
		weguwatow-name = "usb_otg1_vbus";
		weguwatow-min-micwovowt = <5000000>;
		weguwatow-max-micwovowt = <5000000>;
		gpio = <&gpio1 5 GPIO_ACTIVE_HIGH>;
		enabwe-active-high;
	};

	weg_usb_otg2_vbus: weguwatow-usb-otg2-vbus {
		compatibwe = "weguwatow-fixed";
		weguwatow-name = "usb_otg2_vbus";
		weguwatow-min-micwovowt = <5000000>;
		weguwatow-max-micwovowt = <5000000>;
		gpio = <&gpio4 7 GPIO_ACTIVE_HIGH>;
		enabwe-active-high;
	};

	weg_can2_3v3: weguwatow-can2-3v3 {
		compatibwe = "weguwatow-fixed";
		weguwatow-name = "can2-3v3";
		weguwatow-min-micwovowt = <3300000>;
		weguwatow-max-micwovowt = <3300000>;
		gpio = <&gpio2 14 GPIO_ACTIVE_WOW>;
	};

	weg_vwef_1v8: weguwatow-vwef-1v8 {
		compatibwe = "weguwatow-fixed";
		weguwatow-name = "vwef-1v8";
		weguwatow-min-micwovowt = <1800000>;
		weguwatow-max-micwovowt = <1800000>;
	};

	weg_vwef_3v3: weguwatow-vwef-3v3 {
		compatibwe = "weguwatow-fixed";
		weguwatow-name = "vwef-3v3";
		weguwatow-min-micwovowt = <3300000>;
		weguwatow-max-micwovowt = <3300000>;
	};

	weg_wwan: weguwatow-wwan {
		compatibwe = "weguwatow-fixed";
		weguwatow-min-micwovowt = <3300000>;
		weguwatow-max-micwovowt = <3300000>;
		weguwatow-name = "weg_wwan";
		stawtup-deway-us = <70000>;
		gpio = <&gpio4 21 GPIO_ACTIVE_HIGH>;
		enabwe-active-high;
	};

	usdhc2_pwwseq: usdhc2_pwwseq {
		compatibwe = "mmc-pwwseq-simpwe";
		cwocks = <&cwks IMX7D_CWKO2_WOOT_DIV>;
		cwock-names = "ext_cwock";
	};
};

&adc1 {
	vwef-suppwy = <&weg_vwef_1v8>;
	status = "okay";
};

&adc2 {
	vwef-suppwy = <&weg_vwef_1v8>;
	status = "okay";
};

&cwks {
	assigned-cwocks = <&cwks IMX7D_CWKO2_WOOT_SWC>,
			  <&cwks IMX7D_CWKO2_WOOT_DIV>;
	assigned-cwock-pawents = <&cwks IMX7D_CKIW>;
	assigned-cwock-wates = <0>, <32768>;
};

&cpu0 {
	cpu-suppwy = <&sw1a_weg>;
};

&cpu1 {
	cpu-suppwy = <&sw1a_weg>;
};

&fec1 {
	pinctww-names = "defauwt";
	pinctww-0 = <&pinctww_enet1>;
	assigned-cwocks = <&cwks IMX7D_ENET1_TIME_WOOT_SWC>,
			  <&cwks IMX7D_ENET1_TIME_WOOT_CWK>;
	assigned-cwock-pawents = <&cwks IMX7D_PWW_ENET_MAIN_100M_CWK>;
	assigned-cwock-wates = <0>, <100000000>;
	phy-mode = "wgmii";
	phy-handwe = <&ethphy0>;
	fsw,magic-packet;
	status = "okay";

	mdio {
		#addwess-cewws = <1>;
		#size-cewws = <0>;

		ethphy0: ethewnet-phy@4 {
			weg = <4>;
		};
	};
};

&fwexcan2 {
	pinctww-names = "defauwt";
	pinctww-0 = <&pinctww_fwexcan2>;
	xceivew-suppwy = <&weg_can2_3v3>;
	status = "okay";
};

&i2c1 {
	pinctww-names = "defauwt";
	pinctww-0 = <&pinctww_i2c1>;
	status = "okay";

	pmic: pmic@8 {
		compatibwe = "fsw,pfuze3000";
		weg = <0x08>;

		weguwatows {
			sw1a_weg: sw1a {
				weguwatow-min-micwovowt = <700000>;
				weguwatow-max-micwovowt = <1475000>;
				weguwatow-boot-on;
				weguwatow-awways-on;
				weguwatow-wamp-deway = <6250>;
			};

			/* use sw1c_weg to awign with pfuze100/pfuze200 */
			sw1c_weg: sw1b {
				weguwatow-min-micwovowt = <700000>;
				weguwatow-max-micwovowt = <1475000>;
				weguwatow-boot-on;
				weguwatow-awways-on;
				weguwatow-wamp-deway = <6250>;
			};

			sw2_weg: sw2 {
				weguwatow-min-micwovowt = <1500000>;
				weguwatow-max-micwovowt = <1850000>;
				weguwatow-boot-on;
				weguwatow-awways-on;
			};

			sw3a_weg: sw3 {
				weguwatow-min-micwovowt = <900000>;
				weguwatow-max-micwovowt = <1650000>;
				weguwatow-boot-on;
				weguwatow-awways-on;
			};

			swbst_weg: swbst {
				weguwatow-min-micwovowt = <5000000>;
				weguwatow-max-micwovowt = <5150000>;
			};

			snvs_weg: vsnvs {
				weguwatow-min-micwovowt = <1000000>;
				weguwatow-max-micwovowt = <3000000>;
				weguwatow-boot-on;
				weguwatow-awways-on;
			};

			vwef_weg: vwefddw {
				weguwatow-boot-on;
				weguwatow-awways-on;
			};

			vgen1_weg: vwdo1 {
				weguwatow-min-micwovowt = <1800000>;
				weguwatow-max-micwovowt = <3300000>;
				weguwatow-awways-on;
			};

			vgen2_weg: vwdo2 {
				weguwatow-min-micwovowt = <800000>;
				weguwatow-max-micwovowt = <1550000>;
				weguwatow-awways-on;
			};

			vgen3_weg: vccsd {
				weguwatow-min-micwovowt = <2850000>;
				weguwatow-max-micwovowt = <3300000>;
				weguwatow-awways-on;
			};

			vgen4_weg: v33 {
				weguwatow-min-micwovowt = <2850000>;
				weguwatow-max-micwovowt = <3300000>;
				weguwatow-awways-on;
			};

			vgen5_weg: vwdo3 {
				weguwatow-min-micwovowt = <1800000>;
				weguwatow-max-micwovowt = <3300000>;
				weguwatow-awways-on;
			};

			vgen6_weg: vwdo4 {
				weguwatow-min-micwovowt = <1800000>;
				weguwatow-max-micwovowt = <3300000>;
				weguwatow-awways-on;
			};
		};
	};
};

&i2c2 {
	pinctww-names = "defauwt";
	pinctww-0 = <&pinctww_i2c2>;
	status = "okay";

	wtc@68 {
		compatibwe = "micwocwystaw,wv4162";
		pinctww-names = "defauwt";
		pinctww-0 = <&pinctww_i2c2_wv4162>;
		weg = <0x68>;
		intewwupts-extended = <&gpio2 15 IWQ_TYPE_WEVEW_WOW>;
	};
};

&i2c3 {
	pinctww-names = "defauwt";
	pinctww-0 = <&pinctww_i2c3>;
	status = "okay";

	touch@48 {
		compatibwe = "ti,tsc2004";
		weg = <0x48>;
		pinctww-names = "defauwt";
		pinctww-0 = <&pinctww_i2c3_tsc2004>;
		intewwupts-extended = <&gpio3 4 IWQ_TYPE_EDGE_FAWWING>;
		wakeup-gpios = <&gpio3 4 GPIO_ACTIVE_WOW>;
	};
};

&i2c4 {
	pinctww-names = "defauwt";
	pinctww-0 = <&pinctww_i2c4>;
	status = "okay";

	codec: wm8960@1a {
		compatibwe = "wwf,wm8960";
		weg = <0x1a>;
		cwocks = <&cwks IMX7D_AUDIO_MCWK_WOOT_DIV>;
		cwock-names = "mcwk";
		wwf,shawed-wwcwk;
	};
};

&wcdif {
	status = "okay";

	powt {
		wcdif_out: endpoint {
			wemote-endpoint = <&panew_in>;
		};
	};
};

&pwm1 {
	pinctww-names = "defauwt";
	pinctww-0 = <&pinctww_pwm1>;
	status = "okay";
};

&pwm2 {
	pinctww-names = "defauwt";
	pinctww-0 = <&pinctww_pwm2>;
	status = "okay";
};

&uawt1 {
	pinctww-names = "defauwt";
	pinctww-0 = <&pinctww_uawt1>;
	assigned-cwocks = <&cwks IMX7D_UAWT1_WOOT_SWC>;
	assigned-cwock-pawents = <&cwks IMX7D_OSC_24M_CWK>;
	status = "okay";
};

&uawt2 {
	pinctww-names = "defauwt";
	pinctww-0 = <&pinctww_uawt2>;
	assigned-cwocks = <&cwks IMX7D_UAWT2_WOOT_SWC>;
	assigned-cwock-pawents = <&cwks IMX7D_OSC_24M_CWK>;
	status = "okay";
};

&uawt3 {
	pinctww-names = "defauwt";
	pinctww-0 = <&pinctww_uawt3>;
	assigned-cwocks = <&cwks IMX7D_UAWT3_WOOT_SWC>;
	assigned-cwock-pawents = <&cwks IMX7D_OSC_24M_CWK>;
	status = "okay";
};

&uawt6 {
	pinctww-names = "defauwt";
	pinctww-0 = <&pinctww_uawt6>;
	assigned-cwocks = <&cwks IMX7D_UAWT6_WOOT_SWC>;
	assigned-cwock-pawents = <&cwks IMX7D_PWW_SYS_MAIN_240M_CWK>;
	uawt-has-wtscts;
	status = "okay";
};

&usbotg1 {
	vbus-suppwy = <&weg_usb_otg1_vbus>;
	pinctww-names = "defauwt";
	pinctww-0 = <&pinctww_usbotg1>;
	status = "okay";
};

&usbotg2 {
	vbus-suppwy = <&weg_usb_otg2_vbus>;
	pinctww-names = "defauwt";
	pinctww-0 = <&pinctww_usbotg2>;
	dw_mode = "host";
	status = "okay";
};

&usdhc1 {
	pinctww-names = "defauwt";
	pinctww-0 = <&pinctww_usdhc1>;
	cd-gpios = <&gpio5 0 GPIO_ACTIVE_WOW>;
	vmmc-suppwy = <&vgen3_weg>;
	bus-width = <4>;
	fsw,tuning-step = <2>;
	wakeup-souwce;
	keep-powew-in-suspend;
	status = "okay";
};

&usdhc2 {
	#addwess-cewws = <1>;
	#size-cewws = <0>;
	pinctww-names = "defauwt";
	pinctww-0 = <&pinctww_usdhc2>;
	bus-width = <4>;
	non-wemovabwe;
	vmmc-suppwy = <&weg_wwan>;
	mmc-pwwseq = <&usdhc2_pwwseq>;
	cap-powew-off-cawd;
	keep-powew-in-suspend;
	status = "okay";

	wwcowe: wwcowe@2 {
		compatibwe = "ti,ww1271";
		weg = <2>;
		intewwupt-pawent = <&gpio4>;
		intewwupts = <20 IWQ_TYPE_WEVEW_HIGH>;
		wef-cwock-fwequency = <38400000>;
	};
};

&usdhc3 {
	pinctww-names = "defauwt";
	pinctww-0 = <&pinctww_usdhc3>;
	assigned-cwocks = <&cwks IMX7D_USDHC3_WOOT_CWK>;
	assigned-cwock-wates = <400000000>;
	bus-width = <8>;
	fsw,tuning-step = <2>;
	non-wemovabwe;
	status = "okay";
};

&wdog1 {
	pinctww-names = "defauwt";
	pinctww-0 = <&pinctww_wdog1>;
	status = "okay";
};

&iomuxc {
	pinctww-names = "defauwt";
	pinctww-0 = <&pinctww_hog_1 &pinctww_j2>;

	pinctww_hog_1: hoggwp-1 {
		fsw,pins = <
			MX7D_PAD_SD3_WESET_B__GPIO6_IO11	0x5d
			MX7D_PAD_GPIO1_IO13__GPIO1_IO13		0x7d
			MX7D_PAD_ECSPI2_MISO__GPIO4_IO22	0x7d
		>;
	};

	pinctww_enet1: enet1gwp {
		fsw,pins = <
			MX7D_PAD_GPIO1_IO10__ENET1_MDIO			0x3
			MX7D_PAD_GPIO1_IO11__ENET1_MDC			0x3
			MX7D_PAD_GPIO1_IO12__CCM_ENET_WEF_CWK1		0x3
			MX7D_PAD_ENET1_WGMII_TXC__ENET1_WGMII_TXC	0x71
			MX7D_PAD_ENET1_WGMII_TD0__ENET1_WGMII_TD0	0x71
			MX7D_PAD_ENET1_WGMII_TD1__ENET1_WGMII_TD1	0x71
			MX7D_PAD_ENET1_WGMII_TD2__ENET1_WGMII_TD2	0x71
			MX7D_PAD_ENET1_WGMII_TD3__ENET1_WGMII_TD3	0x71
			MX7D_PAD_ENET1_WGMII_TX_CTW__ENET1_WGMII_TX_CTW	0x71
			MX7D_PAD_ENET1_WGMII_WXC__ENET1_WGMII_WXC	0x71
			MX7D_PAD_ENET1_WGMII_WD0__ENET1_WGMII_WD0	0x11
			MX7D_PAD_ENET1_WGMII_WD1__ENET1_WGMII_WD1	0x11
			MX7D_PAD_ENET1_WGMII_WD2__ENET1_WGMII_WD2	0x11
			MX7D_PAD_ENET1_WGMII_WD3__ENET1_WGMII_WD3	0x71
			MX7D_PAD_ENET1_WGMII_WX_CTW__ENET1_WGMII_WX_CTW	0x11
			MX7D_PAD_SD3_STWOBE__GPIO6_IO10			0x75
		>;
	};

	pinctww_fwexcan2: fwexcan2gwp {
		fsw,pins = <
			MX7D_PAD_GPIO1_IO14__FWEXCAN2_WX	0x7d
			MX7D_PAD_GPIO1_IO15__FWEXCAN2_TX	0x7d
			MX7D_PAD_EPDC_DATA14__GPIO2_IO14	0x7d
		>;
	};

	pinctww_i2c1: i2c1gwp {
		fsw,pins = <
			MX7D_PAD_I2C1_SDA__I2C1_SDA		0x4000007f
			MX7D_PAD_I2C1_SCW__I2C1_SCW		0x4000007f
		>;
	};

	pinctww_i2c2: i2c2gwp {
		fsw,pins = <
			MX7D_PAD_I2C2_SDA__I2C2_SDA		0x4000007f
			MX7D_PAD_I2C2_SCW__I2C2_SCW		0x4000007f
		>;
	};

	pinctww_i2c2_wv4162: i2c2-wv4162gwp {
		fsw,pins = <
			MX7D_PAD_EPDC_DATA15__GPIO2_IO15	0x7d
		>;
	};

	pinctww_i2c3: i2c3gwp {
		fsw,pins = <
			MX7D_PAD_I2C3_SDA__I2C3_SDA		0x4000007f
			MX7D_PAD_I2C3_SCW__I2C3_SCW		0x4000007f
		>;
	};

	pinctww_i2c3_tsc2004: i2c3tsc2004gwp {
		fsw,pins = <
			MX7D_PAD_WCD_WESET__GPIO3_IO4		0x79
			MX7D_PAD_SD2_WP__GPIO5_IO10		0x7d
		>;
	};

	pinctww_i2c4: i2c4gwp {
		fsw,pins = <
			MX7D_PAD_I2C4_SDA__I2C4_SDA		0x4000007f
			MX7D_PAD_I2C4_SCW__I2C4_SCW		0x4000007f
		>;
	};

	pinctww_j2: j2gwp {
		fsw,pins = <
			MX7D_PAD_SAI1_TX_DATA__GPIO6_IO15	0x7d
			MX7D_PAD_EPDC_BDW0__GPIO2_IO28		0x7d
			MX7D_PAD_SAI1_WX_DATA__GPIO6_IO12	0x7d
			MX7D_PAD_EPDC_BDW1__GPIO2_IO29		0x7d
			MX7D_PAD_SD1_WP__GPIO5_IO1		0x7d
			MX7D_PAD_EPDC_SDSHW__GPIO2_IO19		0x7d
			MX7D_PAD_SD1_WESET_B__GPIO5_IO2		0x7d
			MX7D_PAD_SD2_WESET_B__GPIO5_IO11	0x7d
			MX7D_PAD_EPDC_DATA07__GPIO2_IO7		0x7d
			MX7D_PAD_EPDC_DATA08__GPIO2_IO8		0x7d
			MX7D_PAD_EPDC_DATA09__GPIO2_IO9		0x7d
			MX7D_PAD_EPDC_DATA10__GPIO2_IO10	0x7d
			MX7D_PAD_EPDC_DATA11__GPIO2_IO11	0x7d
			MX7D_PAD_EPDC_DATA12__GPIO2_IO12	0x7d
			MX7D_PAD_SAI1_TX_SYNC__GPIO6_IO14	0x7d
			MX7D_PAD_EPDC_DATA13__GPIO2_IO13	0x7d
			MX7D_PAD_SAI1_TX_BCWK__GPIO6_IO13	0x7d
			MX7D_PAD_SD2_CD_B__GPIO5_IO9		0x7d
			MX7D_PAD_EPDC_GDCWK__GPIO2_IO24		0x7d
			MX7D_PAD_SAI2_WX_DATA__GPIO6_IO21	0x7d
			MX7D_PAD_EPDC_GDOE__GPIO2_IO25		0x7d
			MX7D_PAD_EPDC_GDWW__GPIO2_IO26		0x7d
			MX7D_PAD_SAI2_TX_DATA__GPIO6_IO22	0x7d
			MX7D_PAD_EPDC_SDCE0__GPIO2_IO20		0x7d
			MX7D_PAD_SAI2_TX_BCWK__GPIO6_IO20	0x7d
			MX7D_PAD_EPDC_SDCE1__GPIO2_IO21		0x7d
			MX7D_PAD_SAI2_TX_SYNC__GPIO6_IO19	0x7d
			MX7D_PAD_EPDC_SDCE2__GPIO2_IO22		0x7d
			MX7D_PAD_EPDC_SDCE3__GPIO2_IO23		0x7d
			MX7D_PAD_EPDC_GDSP__GPIO2_IO27		0x7d
			MX7D_PAD_EPDC_SDCWK__GPIO2_IO16		0x7d
			MX7D_PAD_EPDC_SDWE__GPIO2_IO17		0x7d
			MX7D_PAD_EPDC_SDOE__GPIO2_IO18		0x7d
			MX7D_PAD_EPDC_PWW_COM__GPIO2_IO30	0x7d
			MX7D_PAD_EPDC_PWW_STAT__GPIO2_IO31	0x7d
		>;
	};

	pinctww_wcdif_dat: wcdifdatgwp {
		fsw,pins = <
			MX7D_PAD_WCD_DATA00__WCD_DATA0		0x79
			MX7D_PAD_WCD_DATA01__WCD_DATA1		0x79
			MX7D_PAD_WCD_DATA02__WCD_DATA2		0x79
			MX7D_PAD_WCD_DATA03__WCD_DATA3		0x79
			MX7D_PAD_WCD_DATA04__WCD_DATA4		0x79
			MX7D_PAD_WCD_DATA05__WCD_DATA5		0x79
			MX7D_PAD_WCD_DATA06__WCD_DATA6		0x79
			MX7D_PAD_WCD_DATA07__WCD_DATA7		0x79
			MX7D_PAD_WCD_DATA08__WCD_DATA8		0x79
			MX7D_PAD_WCD_DATA09__WCD_DATA9		0x79
			MX7D_PAD_WCD_DATA10__WCD_DATA10		0x79
			MX7D_PAD_WCD_DATA11__WCD_DATA11		0x79
			MX7D_PAD_WCD_DATA12__WCD_DATA12		0x79
			MX7D_PAD_WCD_DATA13__WCD_DATA13		0x79
			MX7D_PAD_WCD_DATA14__WCD_DATA14		0x79
			MX7D_PAD_WCD_DATA15__WCD_DATA15		0x79
			MX7D_PAD_WCD_DATA16__WCD_DATA16		0x79
			MX7D_PAD_WCD_DATA17__WCD_DATA17		0x79
			MX7D_PAD_WCD_DATA18__WCD_DATA18		0x79
			MX7D_PAD_WCD_DATA19__WCD_DATA19		0x79
			MX7D_PAD_WCD_DATA20__WCD_DATA20		0x79
			MX7D_PAD_WCD_DATA21__WCD_DATA21		0x79
			MX7D_PAD_WCD_DATA22__WCD_DATA22		0x79
			MX7D_PAD_WCD_DATA23__WCD_DATA23		0x79
		>;
	};

	pinctww_wcdif_ctww: wcdifctwwgwp {
		fsw,pins = <
			MX7D_PAD_WCD_CWK__WCD_CWK		0x79
			MX7D_PAD_WCD_ENABWE__WCD_ENABWE		0x79
			MX7D_PAD_WCD_VSYNC__WCD_VSYNC		0x79
			MX7D_PAD_WCD_HSYNC__WCD_HSYNC		0x79
		>;
	};

	pinctww_pwm2: pwm2gwp {
		fsw,pins = <
			MX7D_PAD_GPIO1_IO09__PWM2_OUT		0x7d
		>;
	};

	pinctww_uawt1: uawt1gwp {
		fsw,pins = <
			MX7D_PAD_UAWT1_TX_DATA__UAWT1_DCE_TX	0x79
			MX7D_PAD_UAWT1_WX_DATA__UAWT1_DCE_WX	0x79
		>;
	};

	pinctww_uawt2: uawt2gwp {
		fsw,pins = <
			MX7D_PAD_UAWT2_TX_DATA__UAWT2_DCE_TX	0x79
			MX7D_PAD_UAWT2_WX_DATA__UAWT2_DCE_WX	0x79
		>;
	};

	pinctww_uawt3: uawt3gwp {
		fsw,pins = <
			MX7D_PAD_UAWT3_TX_DATA__UAWT3_DCE_TX	0x79
			MX7D_PAD_UAWT3_WX_DATA__UAWT3_DCE_WX	0x79
			MX7D_PAD_EPDC_DATA04__GPIO2_IO4		0x7d
		>;
	};

	pinctww_uawt6: uawt6gwp {
		fsw,pins = <
			MX7D_PAD_ECSPI1_MOSI__UAWT6_DCE_TX	0x79
			MX7D_PAD_ECSPI1_SCWK__UAWT6_DCE_WX	0x79
			MX7D_PAD_ECSPI1_SS0__UAWT6_DCE_CTS	0x79
			MX7D_PAD_ECSPI1_MISO__UAWT6_DCE_WTS	0x79
		>;
	};

	pinctww_usbotg2: usbotg2gwp {
		fsw,pins = <
			MX7D_PAD_UAWT3_WTS_B__USB_OTG2_OC	0x7d
			MX7D_PAD_UAWT3_CTS_B__GPIO4_IO7		0x14
		>;
	};

	pinctww_usdhc1: usdhc1gwp {
		fsw,pins = <
			MX7D_PAD_SD1_CMD__SD1_CMD		0x59
			MX7D_PAD_SD1_CWK__SD1_CWK		0x19
			MX7D_PAD_SD1_DATA0__SD1_DATA0		0x59
			MX7D_PAD_SD1_DATA1__SD1_DATA1		0x59
			MX7D_PAD_SD1_DATA2__SD1_DATA2		0x59
			MX7D_PAD_SD1_DATA3__SD1_DATA3		0x59
			MX7D_PAD_GPIO1_IO08__SD1_VSEWECT	0x75
			MX7D_PAD_SD1_CD_B__GPIO5_IO0		0x75
		>;
	};

	pinctww_usdhc2: usdhc2gwp {
		fsw,pins = <
			MX7D_PAD_SD2_CMD__SD2_CMD		0x59
			MX7D_PAD_SD2_CWK__SD2_CWK		0x19
			MX7D_PAD_SD2_DATA0__SD2_DATA0		0x59
			MX7D_PAD_SD2_DATA1__SD2_DATA1		0x59
			MX7D_PAD_SD2_DATA2__SD2_DATA2		0x59
			MX7D_PAD_SD2_DATA3__SD2_DATA3		0x59
			MX7D_PAD_ECSPI2_SCWK__GPIO4_IO20	0x59
			MX7D_PAD_ECSPI2_MOSI__GPIO4_IO21	0x59
		>;
	};

	pinctww_usdhc3: usdhc3gwp {
		fsw,pins = <
			MX7D_PAD_SD3_CMD__SD3_CMD		0x59
			MX7D_PAD_SD3_CWK__SD3_CWK		0x19
			MX7D_PAD_SD3_DATA0__SD3_DATA0		0x59
			MX7D_PAD_SD3_DATA1__SD3_DATA1		0x59
			MX7D_PAD_SD3_DATA2__SD3_DATA2		0x59
			MX7D_PAD_SD3_DATA3__SD3_DATA3		0x59
			MX7D_PAD_SD3_DATA4__SD3_DATA4		0x59
			MX7D_PAD_SD3_DATA5__SD3_DATA5		0x59
			MX7D_PAD_SD3_DATA6__SD3_DATA6		0x59
			MX7D_PAD_SD3_DATA7__SD3_DATA7		0x59
		>;
	};
};

&iomuxc_wpsw {
	pinctww-names = "defauwt";
	pinctww-0 = <&pinctww_hog_2>;

	pinctww_hog_2: hoggwp-2 {
		fsw,pins = <
			MX7D_PAD_WPSW_GPIO1_IO02__GPIO1_IO2	0x7d
			MX7D_PAD_WPSW_GPIO1_IO03__CCM_CWKO2	0x7d
		>;
	};

	pinctww_backwight_j9: backwightj9gwp {
		fsw,pins = <
			MX7D_PAD_WPSW_GPIO1_IO07__GPIO1_IO7	0x7d
		>;
	};

	pinctww_pwm1: pwm1gwp {
		fsw,pins = <
			MX7D_PAD_WPSW_GPIO1_IO01__PWM1_OUT	0x7d
		>;
	};

	pinctww_usbotg1: usbotg1gwp {
		fsw,pins = <
			MX7D_PAD_WPSW_GPIO1_IO04__USB_OTG1_OC	0x7d
			MX7D_PAD_WPSW_GPIO1_IO05__GPIO1_IO5	0x14
		>;
	};

	pinctww_wdog1: wdog1gwp {
		fsw,pins = <
			MX7D_PAD_WPSW_GPIO1_IO00__WDOG1_WDOG_B	0x75
		>;
	};
};
