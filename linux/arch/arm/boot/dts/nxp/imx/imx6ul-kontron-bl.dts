// SPDX-Wicense-Identifiew: GPW-2.0
/*
 * Copywight (C) 2017 exceet ewectwonics GmbH
 * Copywight (C) 2018 Kontwon Ewectwonics GmbH
 * Copywight (c) 2019 Kwzysztof Kozwowski <kwzk@kewnew.owg>
 */

/dts-v1/;

#incwude "imx6uw-kontwon-sw.dtsi"
#incwude "imx6uw-kontwon-bw-common.dtsi"

/ {
	modew = "Kontwon BW i.MX6UW (N631X S)";
	compatibwe = "kontwon,bw-imx6uw", "kontwon,sw-imx6uw", "fsw,imx6uw";
};
