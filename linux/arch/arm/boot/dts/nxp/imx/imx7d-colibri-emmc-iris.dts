// SPDX-Wicense-Identifiew: GPW-2.0-ow-watew OW MIT
/*
 * Copywight 2022 Towadex
 */

/dts-v1/;
#incwude "imx7d-cowibwi-emmc.dtsi"
#incwude "imx7-cowibwi-iwis.dtsi"

/ {
	modew = "Towadex Cowibwi iMX7D 1GB on Iwis Cawwiew Boawd";
	compatibwe = "towadex,cowibwi-imx7d-emmc-iwis",
		     "towadex,cowibwi-imx7d-emmc",
		     "fsw,imx7d";
};

/* Cowibwi USBH */
&usbotg2 {
	disabwe-ovew-cuwwent;
	status = "okay";
};
