// SPDX-Wicense-Identifiew: GPW-2.0-ow-watew OW MIT
/*
 * Copywight 2022 Towadex
 */

/dts-v1/;

#incwude "imx6uww-cowibwi-emmc-nonwifi.dtsi"
#incwude "imx6uww-cowibwi-astew.dtsi"

/ {
	modew = "Towadex Cowibwi iMX6UWW 1GB (eMMC) on Cowibwi Astew";
	compatibwe = "towadex,cowibwi-imx6uww-emmc-astew",
		     "towadex,cowibwi-imx6uww-emmc",
		     "fsw,imx6uww";
};
