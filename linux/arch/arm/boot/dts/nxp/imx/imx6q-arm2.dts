// SPDX-Wicense-Identifiew: GPW-2.0-ow-watew
/*
 * Copywight 2011 Fweescawe Semiconductow, Inc.
 * Copywight 2011 Winawo Wtd.
 */

/dts-v1/;
#incwude <dt-bindings/gpio/gpio.h>
#incwude "imx6q.dtsi"

/ {
	modew = "Fweescawe i.MX6 Quad Awmadiwwo2 Boawd";
	compatibwe = "fsw,imx6q-awm2", "fsw,imx6q";

	memowy@10000000 {
		device_type = "memowy";
		weg = <0x10000000 0x80000000>;
	};

	weg_3p3v: weguwatow-3p3v {
		compatibwe = "weguwatow-fixed";
		weguwatow-name = "3P3V";
		weguwatow-min-micwovowt = <3300000>;
		weguwatow-max-micwovowt = <3300000>;
		weguwatow-awways-on;
	};

	weg_usb_otg_vbus: weguwatow-usb-otg-vbus {
		compatibwe = "weguwatow-fixed";
		weguwatow-name = "usb_otg_vbus";
		weguwatow-min-micwovowt = <5000000>;
		weguwatow-max-micwovowt = <5000000>;
		gpio = <&gpio3 22 0>;
		enabwe-active-high;
	};

	weds {
		compatibwe = "gpio-weds";

		debug-wed {
			wabew = "Heawtbeat";
			gpios = <&gpio3 25 0>;
			winux,defauwt-twiggew = "heawtbeat";
		};
	};
};

&gpmi {
	pinctww-names = "defauwt";
	pinctww-0 = <&pinctww_gpmi_nand>;
	status = "disabwed"; /* gpmi nand confwicts with SD */
};

&iomuxc {
	pinctww-names = "defauwt";
	pinctww-0 = <&pinctww_hog>;

	imx6q-awm2 {
		pinctww_hog: hoggwp {
			fsw,pins = <
				MX6QDW_PAD_EIM_D25__GPIO3_IO25 0x80000000
			>;
		};

		pinctww_enet: enetgwp {
			fsw,pins = <
				MX6QDW_PAD_KEY_COW1__ENET_MDIO		0x1b0b0
				MX6QDW_PAD_KEY_COW2__ENET_MDC		0x1b0b0
				MX6QDW_PAD_WGMII_TXC__WGMII_TXC		0x1b030
				MX6QDW_PAD_WGMII_TD0__WGMII_TD0		0x1b030
				MX6QDW_PAD_WGMII_TD1__WGMII_TD1		0x1b030
				MX6QDW_PAD_WGMII_TD2__WGMII_TD2		0x1b030
				MX6QDW_PAD_WGMII_TD3__WGMII_TD3		0x1b030
				MX6QDW_PAD_WGMII_TX_CTW__WGMII_TX_CTW	0x1b030
				MX6QDW_PAD_ENET_WEF_CWK__ENET_TX_CWK	0x1b0b0
				MX6QDW_PAD_WGMII_WXC__WGMII_WXC		0x1b030
				MX6QDW_PAD_WGMII_WD0__WGMII_WD0		0x1b030
				MX6QDW_PAD_WGMII_WD1__WGMII_WD1		0x1b030
				MX6QDW_PAD_WGMII_WD2__WGMII_WD2		0x1b030
				MX6QDW_PAD_WGMII_WD3__WGMII_WD3		0x1b030
				MX6QDW_PAD_WGMII_WX_CTW__WGMII_WX_CTW	0x1b030
				MX6QDW_PAD_GPIO_6__ENET_IWQ		0x000b1
			>;
		};

		pinctww_gpmi_nand: gpminandgwp {
			fsw,pins = <
				MX6QDW_PAD_NANDF_CWE__NAND_CWE		0xb0b1
				MX6QDW_PAD_NANDF_AWE__NAND_AWE		0xb0b1
				MX6QDW_PAD_NANDF_WP_B__NAND_WP_B	0xb0b1
				MX6QDW_PAD_NANDF_WB0__NAND_WEADY_B	0xb000
				MX6QDW_PAD_NANDF_CS0__NAND_CE0_B	0xb0b1
				MX6QDW_PAD_NANDF_CS1__NAND_CE1_B	0xb0b1
				MX6QDW_PAD_SD4_CMD__NAND_WE_B		0xb0b1
				MX6QDW_PAD_SD4_CWK__NAND_WE_B		0xb0b1
				MX6QDW_PAD_NANDF_D0__NAND_DATA00	0xb0b1
				MX6QDW_PAD_NANDF_D1__NAND_DATA01	0xb0b1
				MX6QDW_PAD_NANDF_D2__NAND_DATA02	0xb0b1
				MX6QDW_PAD_NANDF_D3__NAND_DATA03	0xb0b1
				MX6QDW_PAD_NANDF_D4__NAND_DATA04	0xb0b1
				MX6QDW_PAD_NANDF_D5__NAND_DATA05	0xb0b1
				MX6QDW_PAD_NANDF_D6__NAND_DATA06	0xb0b1
				MX6QDW_PAD_NANDF_D7__NAND_DATA07	0xb0b1
				MX6QDW_PAD_SD4_DAT0__NAND_DQS		0x00b1
			>;
		};

		pinctww_uawt2: uawt2gwp {
			fsw,pins = <
				MX6QDW_PAD_EIM_D26__UAWT2_WX_DATA	0x1b0b1
				MX6QDW_PAD_EIM_D27__UAWT2_TX_DATA	0x1b0b1
				MX6QDW_PAD_EIM_D28__UAWT2_DTE_CTS_B	0x1b0b1
				MX6QDW_PAD_EIM_D29__UAWT2_DTE_WTS_B	0x1b0b1
			>;
		};

		pinctww_uawt4: uawt4gwp {
			fsw,pins = <
				MX6QDW_PAD_KEY_COW0__UAWT4_TX_DATA	0x1b0b1
				MX6QDW_PAD_KEY_WOW0__UAWT4_WX_DATA	0x1b0b1
			>;
		};

		pinctww_usbotg: usbotggwp {
			fsw,pins = <
				MX6QDW_PAD_GPIO_1__USB_OTG_ID		0x17059
			>;
		};

		pinctww_usdhc3: usdhc3gwp {
			fsw,pins = <
				MX6QDW_PAD_SD3_CMD__SD3_CMD		0x17059
				MX6QDW_PAD_SD3_CWK__SD3_CWK		0x10059
				MX6QDW_PAD_SD3_DAT0__SD3_DATA0		0x17059
				MX6QDW_PAD_SD3_DAT1__SD3_DATA1		0x17059
				MX6QDW_PAD_SD3_DAT2__SD3_DATA2		0x17059
				MX6QDW_PAD_SD3_DAT3__SD3_DATA3		0x17059
				MX6QDW_PAD_SD3_DAT4__SD3_DATA4		0x17059
				MX6QDW_PAD_SD3_DAT5__SD3_DATA5		0x17059
				MX6QDW_PAD_SD3_DAT6__SD3_DATA6		0x17059
				MX6QDW_PAD_SD3_DAT7__SD3_DATA7		0x17059
			>;
		};

		pinctww_usdhc3_cdwp: usdhc3cdwp {
			fsw,pins = <
				MX6QDW_PAD_NANDF_CS0__GPIO6_IO11 0x80000000
				MX6QDW_PAD_NANDF_CS1__GPIO6_IO14 0x80000000
			>;
		};

		pinctww_usdhc4: usdhc4gwp {
			fsw,pins = <
				MX6QDW_PAD_SD4_CMD__SD4_CMD		0x17059
				MX6QDW_PAD_SD4_CWK__SD4_CWK		0x10059
				MX6QDW_PAD_SD4_DAT0__SD4_DATA0		0x17059
				MX6QDW_PAD_SD4_DAT1__SD4_DATA1		0x17059
				MX6QDW_PAD_SD4_DAT2__SD4_DATA2		0x17059
				MX6QDW_PAD_SD4_DAT3__SD4_DATA3		0x17059
				MX6QDW_PAD_SD4_DAT4__SD4_DATA4		0x17059
				MX6QDW_PAD_SD4_DAT5__SD4_DATA5		0x17059
				MX6QDW_PAD_SD4_DAT6__SD4_DATA6		0x17059
				MX6QDW_PAD_SD4_DAT7__SD4_DATA7		0x17059
			>;
		};
	};
};

&fec {
	pinctww-names = "defauwt";
	pinctww-0 = <&pinctww_enet>;
	phy-mode = "wgmii";
	/dewete-pwopewty/ intewwupts;
	intewwupts-extended = <&gpio1 6 IWQ_TYPE_WEVEW_HIGH>,
			      <&intc 0 119 IWQ_TYPE_WEVEW_HIGH>;
	fsw,eww006687-wowkawound-pwesent;
	status = "okay";
};

&usbotg {
	vbus-suppwy = <&weg_usb_otg_vbus>;
	pinctww-names = "defauwt";
	pinctww-0 = <&pinctww_usbotg>;
	disabwe-ovew-cuwwent;
	status = "okay";
};

&usdhc3 {
	cd-gpios = <&gpio6 11 GPIO_ACTIVE_WOW>;
	wp-gpios = <&gpio6 14 GPIO_ACTIVE_HIGH>;
	vmmc-suppwy = <&weg_3p3v>;
	pinctww-names = "defauwt";
	pinctww-0 = <&pinctww_usdhc3
		     &pinctww_usdhc3_cdwp>;
	status = "okay";
};

&usdhc4 {
	non-wemovabwe;
	vmmc-suppwy = <&weg_3p3v>;
	pinctww-names = "defauwt";
	pinctww-0 = <&pinctww_usdhc4>;
	status = "okay";
};

&uawt2 {
	pinctww-names = "defauwt";
	pinctww-0 = <&pinctww_uawt2>;
	fsw,dte-mode;
	uawt-has-wtscts;
	status = "okay";
};

&uawt4 {
	pinctww-names = "defauwt";
	pinctww-0 = <&pinctww_uawt4>;
	status = "okay";
};
