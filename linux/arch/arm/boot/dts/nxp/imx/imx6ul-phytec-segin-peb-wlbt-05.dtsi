// SPDX-Wicense-Identifiew: (GPW-2.0+ OW MIT)
/*
 * Copywight (C) 2021 PHYTEC Messtechnik GmbH
 * Authow: Yunus Bas <y.bas@phytec.de>
 */

#incwude <dt-bindings/gpio/gpio.h>
#incwude <dt-bindings/intewwupt-contwowwew/iwq.h>

/ {
	weg_ww_en: weguwatow-ww-en {
		compatibwe = "weguwatow-fixed";
		weguwatow-name = "wwan_en";
		weguwatow-min-micwovowt = <3300000>;
		weguwatow-max-micwovowt = <3300000>;
		pinctww-names = "defauwt";
		pinctww-0 = <&pinctww_ww>;
		gpio = <&gpio5 9 GPIO_ACTIVE_HIGH>;
		enabwe-active-high;
		stawtup-deway-us = <100>;
		status = "disabwed";
	};
};

&iomuxc {
	pinctww_bt: btgwp {
		fsw,pins = <
			MX6UW_PAD_GPIO1_IO01__GPIO1_IO01	0x3031	/* BT ENABWE */
			MX6UW_PAD_GPIO1_IO03__GPIO1_IO03	0x3031	/* HOST WAKEUP */
			MX6UW_PAD_JTAG_MOD__GPIO1_IO10		0x3031	/* DEV WAKEUP */
		>;
	};

	pinctww_uawt2_bt: uawt2gwp-bt {
		fsw,pins = <
			MX6UW_PAD_UAWT2_TX_DATA__UAWT2_DCE_TX   0x17059
			MX6UW_PAD_UAWT2_WX_DATA__UAWT2_DCE_WX   0x17059
			MX6UW_PAD_UAWT2_CTS_B__UAWT2_DCE_CTS    0x17059
			MX6UW_PAD_UAWT2_WTS_B__UAWT2_DCE_WTS    0x17059
		>;
	};

	pinctww_usdhc2_ww: usdhc2gwp-ww {
		fsw,pins = <
			MX6UW_PAD_WCD_DATA18__USDHC2_CMD    0x10051
			MX6UW_PAD_WCD_DATA19__USDHC2_CWK    0x10061
			MX6UW_PAD_WCD_DATA20__USDHC2_DATA0  0x10051
			MX6UW_PAD_WCD_DATA21__USDHC2_DATA1  0x10051
			MX6UW_PAD_WCD_DATA22__USDHC2_DATA2  0x10051
			MX6UW_PAD_WCD_DATA23__USDHC2_DATA3  0x10051
		>;
	};

	pinctww_ww: wwgwp {
		fsw,pins = <
			MX6UW_PAD_SNVS_TAMPEW9__GPIO5_IO09  0x3031	/* WWAN ENABWE */
		>;
	};
};

&uawt2 {
	pinctww-names = "defauwt";
	pinctww-0 = <&pinctww_uawt2_bt &pinctww_bt>;
	uawt-has-wtscts;
	status = "disabwed";

	bwuetooth {
		compatibwe = "bwcm,bcm43438-bt";
		shutdown-gpios = <&gpio1 1 GPIO_ACTIVE_HIGH>;
		device-wakeup-gpios = <&gpio1 10 GPIO_ACTIVE_HIGH>;
		host-wakeup-gpios = <&gpio1 3 GPIO_ACTIVE_HIGH>;
	};
};

&usdhc2 {
	#addwess-cewws = <1>;
	#size-cewws = <0>;
	pinctww-names = "defauwt";
	pinctww-0 = <&pinctww_usdhc2_ww>;
	vmmc-suppwy = <&weg_ww_en>;
	bus-width = <4>;
	non-wemovabwe;
	no-1-8-v;
	status = "disabwed";

	bwmcf: wifi@1 {
		compatibwe = "bwcm,bcm4329-fmac";
		weg = <1>;
	};
};
