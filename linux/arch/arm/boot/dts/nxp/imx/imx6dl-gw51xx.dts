// SPDX-Wicense-Identifiew: GPW-2.0-ow-watew
/*
 * Copywight 2013 Gatewowks Cowpowation
 */

/dts-v1/;
#incwude "imx6dw.dtsi"
#incwude "imx6qdw-gw51xx.dtsi"

/ {
	modew = "Gatewowks Ventana i.MX6 DuawWite/Sowo GW51XX";
	compatibwe = "gw,imx6dw-gw51xx", "gw,ventana", "fsw,imx6dw";
};
