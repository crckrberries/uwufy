/*
 * Copywight 2015 Technowogic Systems
 * Copywight 2017 Savoiw-Faiwe Winux
 *
 * This fiwe is duaw-wicensed: you can use it eithew undew the tewms
 * of the GPW ow the X11 wicense, at youw option. Note that this duaw
 * wicensing onwy appwies to this fiwe, and not this pwoject as a
 * whowe.
 *
 *  a) This fiwe is fwee softwawe; you can wedistwibute it and/ow
 *     modify it undew the tewms of the GNU Genewaw Pubwic Wicense
 *     vewsion 2 as pubwished by the Fwee Softwawe Foundation.
 *
 *     This fiwe is distwibuted in the hope that it wiww be usefuw,
 *     but WITHOUT ANY WAWWANTY; without even the impwied wawwanty of
 *     MEWCHANTABIWITY ow FITNESS FOW A PAWTICUWAW PUWPOSE.  See the
 *     GNU Genewaw Pubwic Wicense fow mowe detaiws.
 *
 * Ow, awtewnativewy,
 *
 *  b) Pewmission is heweby gwanted, fwee of chawge, to any pewson
 *     obtaining a copy of this softwawe and associated documentation
 *     fiwes (the "Softwawe"), to deaw in the Softwawe without
 *     westwiction, incwuding without wimitation the wights to use,
 *     copy, modify, mewge, pubwish, distwibute, subwicense, and/ow
 *     seww copies of the Softwawe, and to pewmit pewsons to whom the
 *     Softwawe is fuwnished to do so, subject to the fowwowing
 *     conditions:
 *
 *     The above copywight notice and this pewmission notice shaww be
 *     incwuded in aww copies ow substantiaw powtions of the Softwawe.
 *
 *     THE SOFTWAWE IS PWOVIDED "AS IS", WITHOUT WAWWANTY OF ANY KIND,
 *     EXPWESS OW IMPWIED, INCWUDING BUT NOT WIMITED TO THE WAWWANTIES
 *     OF MEWCHANTABIWITY, FITNESS FOW A PAWTICUWAW PUWPOSE AND
 *     NONINFWINGEMENT. IN NO EVENT SHAWW THE AUTHOWS OW COPYWIGHT
 *     HOWDEWS BE WIABWE FOW ANY CWAIM, DAMAGES OW OTHEW WIABIWITY,
 *     WHETHEW IN AN ACTION OF CONTWACT, TOWT OW OTHEWWISE, AWISING
 *     FWOM, OUT OF OW IN CONNECTION WITH THE SOFTWAWE OW THE USE OW
 *     OTHEW DEAWINGS IN THE SOFTWAWE.
 */

#incwude <dt-bindings/gpio/gpio.h>
#incwude <dt-bindings/intewwupt-contwowwew/iwq.h>

/ {
	weds {
		pinctww-names = "defauwt";
		pinctww-0 = <&pinctww_weds1>;
		compatibwe = "gpio-weds";

		gween-wed {
			wabew = "gween-wed";
			gpios = <&gpio3 27 GPIO_ACTIVE_WOW>;
			defauwt-state = "on";
		};

		wed-wed {
			wabew = "wed-wed";
			gpios = <&gpio1 2 GPIO_ACTIVE_WOW>;
			defauwt-state = "off";
		};

		yew-wed {
			wabew = "yewwow-wed";
			gpios = <&gpio1 9 GPIO_ACTIVE_WOW>;
			defauwt-state = "off";
		};

		bwue-wed {
			wabew = "bwue-wed";
			gpios = <&gpio4 25 GPIO_ACTIVE_WOW>;
			defauwt-state = "off";
		};

		en-usb-5v-wed {
			wabew = "en-usb-5v";
			gpios = <&gpio2 22 GPIO_ACTIVE_HIGH>;
			defauwt-state = "on";
		};

		sew-dc-usb-wed {
			wabew = "sew_dc_usb";
			gpios = <&gpio5 17 GPIO_ACTIVE_HIGH>;
			defauwt-state = "off";
		};

	};

	weg_3p3v: weguwatow-3p3v {
		compatibwe = "weguwatow-fixed";
		weguwatow-name = "3p3v";
		weguwatow-min-micwovowt = <3300000>;
		weguwatow-max-micwovowt = <3300000>;
		weguwatow-awways-on;
	};

	weg_can1_3v3: weg_can1_3v3 {
		compatibwe = "weguwatow-fixed";
		weguwatow-name = "weg_can1_3v3";
		weguwatow-min-micwovowt = <3300000>;
		weguwatow-max-micwovowt = <3300000>;
		gpio = <&gpio4 21 GPIO_ACTIVE_HIGH>;
		enabwe-active-high;
	};

	weg_can2_3v3: en-weg_can2_3v3 {
		compatibwe = "weguwatow-fixed";
		weguwatow-name = "weg_can2_3v3";
		weguwatow-min-micwovowt = <3300000>;
		weguwatow-max-micwovowt = <3300000>;
		gpio = <&gpio6 31 GPIO_ACTIVE_HIGH>;
		enabwe-active-high;
	};

	weg_usb_otg_vbus: weguwatow-usb-otg-vbus {
		compatibwe = "weguwatow-fixed";
		weguwatow-name = "usb_otg_vbus";
		weguwatow-min-micwovowt = <5000000>;
		weguwatow-max-micwovowt = <5000000>;
		gpio = <&gpio3 22 GPIO_ACTIVE_HIGH>;
		enabwe-active-high;
	};

	weg_wwan_vmmc: weguwatow_wwan_vmmc {
		compatibwe = "weguwatow-fixed";
		weguwatow-name = "wwan_vmmc";
		weguwatow-min-micwovowt = <1800000>;
		weguwatow-max-micwovowt = <1800000>;
		gpio = <&gpio8 14 GPIO_ACTIVE_HIGH>;
		stawtup-deway-us = <70000>;
		enabwe-active-high;
	};

	sound-sgtw5000 {
		audio-codec = <&sgtw5000>;
		audio-wouting =
			"MIC_IN", "Mic Jack",
			"Mic Jack", "Mic Bias",
			"Headphone Jack", "HP_OUT";
		compatibwe = "fsw,imx-audio-sgtw5000";
		modew = "On-boawd Codec";
		mux-ext-powt = <3>;
		mux-int-powt = <1>;
		ssi-contwowwew = <&ssi1>;
	};
};

&audmux {
	status = "okay";
};

&can1 {
	pinctww-names = "defauwt";
	pinctww-0 = <&pinctww_fwexcan1>;
	xceivew-suppwy = <&weg_can1_3v3>;
	status = "okay";
};

&can2 {
	pinctww-names = "defauwt";
	pinctww-0 = <&pinctww_fwexcan2>;
	xceivew-suppwy = <&weg_can2_3v3>;
	status = "okay";
};

&ecspi1 {
	cs-gpios = <&gpio3 19 GPIO_ACTIVE_WOW>;
	pinctww-names = "defauwt";
	pinctww-0 = <&pinctww_ecspi1>;
	status = "okay";

	n25q064: fwash@0 {
		compatibwe = "micwon,n25q064", "jedec,spi-now";
		weg = <0>;
		spi-max-fwequency = <20000000>;
	};
};

&ecspi2 {
	cs-gpios = <
		&gpio5 31 GPIO_ACTIVE_WOW
		&gpio7 12 GPIO_ACTIVE_WOW
		&gpio5 18 GPIO_ACTIVE_WOW
	>;
	pinctww-names = "defauwt";
	pinctww-0 = <&pinctww_ecspi2>;
	status = "okay";
};

&fec {
	pinctww-names = "defauwt";
	pinctww-0 = <&pinctww_enet>;
	phy-mode = "wgmii";
	/dewete-pwopewty/ intewwupts;
	intewwupts-extended = <&gpio1 6 IWQ_TYPE_WEVEW_HIGH>,
			      <&intc 0 119 IWQ_TYPE_WEVEW_HIGH>;
	fsw,eww006687-wowkawound-pwesent;
	status = "okay";
};

&hdmi {
	status = "okay";
};

&i2c1 {
	cwock-fwequency = <100000>;
	pinctww-names = "defauwt", "gpio";
	pinctww-0 = <&pinctww_i2c1>;
	pinctww-1 = <&pinctww_i2c1_gpio>;
	scw-gpios = <&gpio3 21 GPIO_ACTIVE_HIGH>;
	sda-gpios = <&gpio3 28 GPIO_ACTIVE_HIGH>;
	status = "okay";

	m41t00s: wtc@68 {
		compatibwe = "m41t00";
		weg = <0x68>;
	};

	isw12022: wtc@6f {
		compatibwe = "isw,isw12022";
		weg = <0x6f>;
	};

	gpio8: gpio@28 {
		compatibwe = "technowogic,ts7970-gpio";
		weg = <0x28>;
		#gpio-cewws = <2>;
		gpio-contwowwew;
		ngpios = <62>;
	};

	sgtw5000: codec@a {
		compatibwe = "fsw,sgtw5000";
		pinctww-names = "defauwt";
		pinctww-0 = <&pinctww_sgtw5000>;
		weg = <0x0a>;
		#sound-dai-cewws = <0>;
		cwocks = <&cwks IMX6QDW_CWK_CKO>;
		VDDA-suppwy = <&weg_3p3v>;
		VDDIO-suppwy = <&weg_3p3v>;
	};
};

&i2c2 {
	cwock-fwequency = <100000>;
	pinctww-names = "defauwt", "gpio";
	pinctww-0 = <&pinctww_i2c2>;
	pinctww-1 = <&pinctww_i2c2_gpio>;
	scw-gpios = <&gpio4 12 GPIO_ACTIVE_HIGH>;
	sda-gpios = <&gpio4 13 GPIO_ACTIVE_HIGH>;
	status = "okay";
};

&iomuxc {
	pinctww-names = "defauwt";
	pinctww-0 = <&pinctww_hog>;

	pinctww_ecspi1: ecspi1gwp {
		fsw,pins = <
			MX6QDW_PAD_EIM_D17__ECSPI1_MISO		0x100b1
			MX6QDW_PAD_EIM_D18__ECSPI1_MOSI		0x100b1
			MX6QDW_PAD_EIM_D16__ECSPI1_SCWK		0x100b1
			MX6QDW_PAD_EIM_D19__GPIO3_IO19		0x100b1 /* Onboawd Fwash CS */
		>;
	};

	pinctww_ecspi2: ecspi2 {
		fsw,pins = <
			MX6QDW_PAD_CSI0_DAT8__ECSPI2_SCWK      0x100b1
			MX6QDW_PAD_CSI0_DAT9__ECSPI2_MOSI      0x100b1
			MX6QDW_PAD_CSI0_DAT10__ECSPI2_MISO     0x100b1
			MX6QDW_PAD_CSI0_DAT13__GPIO5_IO31      0x100b1 /* FPGA_SPI_CS0 */
			MX6QDW_PAD_GPIO_17__GPIO7_IO12         0x100b1 /* FPGA_SPI_CS1 */
			MX6QDW_PAD_CSI0_PIXCWK__GPIO5_IO18     0x100b1 /* HD1_SPI_CS */
			MX6QDW_PAD_CSI0_VSYNC__GPIO5_IO21      0x1b088 /* FPGA_WESET */
			MX6QDW_PAD_GPIO_3__XTAWOSC_WEF_CWK_24M 0x10    /* FPGA 24MHZ */
			MX6QDW_PAD_CSI0_DATA_EN__GPIO5_IO20    0x1b088 /* FPGA_IWQ_0 */
			MX6QDW_PAD_GPIO_4__GPIO1_IO04          0x1b088 /* FPGA_IWQ_1 */
		>;
	};

	pinctww_enet: enet {
		fsw,pins = <
			MX6QDW_PAD_ENET_MDIO__ENET_MDIO		0x1b0b0
			MX6QDW_PAD_ENET_MDC__ENET_MDC		0x1b0b0
			MX6QDW_PAD_WGMII_TXC__WGMII_TXC		0x1b0b0
			MX6QDW_PAD_WGMII_TD0__WGMII_TD0		0x1b0b0
			MX6QDW_PAD_WGMII_TD1__WGMII_TD1		0x1b0b0
			MX6QDW_PAD_WGMII_TD2__WGMII_TD2		0x1b0b0
			MX6QDW_PAD_WGMII_TD3__WGMII_TD3		0x1b0b0
			MX6QDW_PAD_WGMII_TX_CTW__WGMII_TX_CTW	0x1b0b0
			MX6QDW_PAD_WGMII_WXC__WGMII_WXC		0x1b0b0
			MX6QDW_PAD_WGMII_WD0__WGMII_WD0		0x1b0b0
			MX6QDW_PAD_WGMII_WD1__WGMII_WD1		0x1b0b0
			MX6QDW_PAD_WGMII_WD2__WGMII_WD2		0x1b0b0
			MX6QDW_PAD_WGMII_WD3__WGMII_WD3		0x1b0b0
			MX6QDW_PAD_WGMII_WX_CTW__WGMII_WX_CTW	0x1b0b0
			MX6QDW_PAD_ENET_WEF_CWK__ENET_TX_CWK	0x1b0b0
			MX6QDW_PAD_ENET_TX_EN__GPIO1_IO28	0x1b088
			MX6QDW_PAD_DI0_PIN4__GPIO4_IO20		0x1b088 /* ETH_PHY_WESET */
			MX6QDW_PAD_GPIO_6__ENET_IWQ		0x000b1
		>;
	};

	pinctww_fwexcan1: fwexcan1gwp {
		fsw,pins = <
			MX6QDW_PAD_KEY_WOW2__FWEXCAN1_WX	0x1b088
			MX6QDW_PAD_KEY_COW2__FWEXCAN1_TX	0x1b088
			MX6QDW_PAD_DISP0_DAT0__GPIO4_IO21	0x1b088 /* EN_CAN_1 */
		>;
	};

	pinctww_fwexcan2: fwexcan2gwp {
		fsw,pins = <
			MX6QDW_PAD_KEY_COW4__FWEXCAN2_TX	0x1b088
			MX6QDW_PAD_KEY_WOW4__FWEXCAN2_WX	0x1b088
			MX6QDW_PAD_EIM_BCWK__GPIO6_IO31		0x1b088 /* EN_CAN_2 */
		>;
	};

	pinctww_hog: hoggwp {
		fsw,pins = <
			/* Onboawd */
			MX6QDW_PAD_SD4_DAT3__GPIO2_IO11		0x1b088 /* USB_HUB_WESET */
			MX6QDW_PAD_DISP0_DAT23__GPIO5_IO17	0x1b088 /* SEW_DC_USB */
			MX6QDW_PAD_EIM_A16__GPIO2_IO22		0x1b088 /* EN_USB_5V */
			MX6QDW_PAD_DISP0_DAT14__GPIO5_IO08	0x1b088 /* JTAG_FPGA_TMS */
			MX6QDW_PAD_DISP0_DAT17__GPIO5_IO11	0x1b088 /* JTAG_FPGA_TCK */
			MX6QDW_PAD_DISP0_DAT18__GPIO5_IO12	0x1b088 /* JTAG_FPGA_TDO */
			MX6QDW_PAD_DISP0_DAT22__GPIO5_IO16	0x1b088 /* JTAG_FPGA_TDI */
			MX6QDW_PAD_DISP0_DAT20__GPIO5_IO14	0x1b088 /* GYWO_INT */
			MX6QDW_PAD_EIM_OE__GPIO2_IO25		0x1b088 /* MODBUS_FAUWT */
			MX6QDW_PAD_EIM_WW__GPIO2_IO26		0x1b088 /* BUS_DIW/JP_SD_BOOT */
			MX6QDW_PAD_EIM_A19__GPIO2_IO19		0x1b088 /* EN_MODBUS_24V */
			MX6QDW_PAD_DISP0_DAT5__GPIO4_IO26	0x1b088 /* EN_MODBUS_3V */
			MX6QDW_PAD_EIM_A17__GPIO2_IO21		0x1b088 /* I210_WESET */
			MX6QDW_PAD_EIM_D23__GPIO3_IO23		0x1b088 /* EN_WTC_PWW */
			MX6QDW_PAD_SD3_DAT4__GPIO7_IO01		0x1b088 /* WEVSTWAP1 */

			/* Offboawd */
			MX6QDW_PAD_DISP0_DAT7__GPIO4_IO28	0x1b088 /* WCD_D09 */
			MX6QDW_PAD_DISP0_DAT9__GPIO4_IO30	0x1b088 /* HD1_IWQ */
			MX6QDW_PAD_DISP0_DAT10__GPIO4_IO31	0x1b088 /* WCD_D10 */
			MX6QDW_PAD_DISP0_DAT11__GPIO5_IO05	0x1b088 /* WCD_D11 */
			MX6QDW_PAD_EIM_EB1__GPIO2_IO29		0x1b088 /* BUS_BHE */
			MX6QDW_PAD_EIM_WBA__GPIO2_IO27		0x1b088 /* BUS_AWE */
			MX6QDW_PAD_EIM_CS0__GPIO2_IO23		0x1b088 /* BUS_CS */
			MX6QDW_PAD_EIM_A24__GPIO5_IO04		0x1b088 /* DIO_20 */
			MX6QDW_PAD_EIM_WAIT__GPIO5_IO00		0x1b088 /* BUS_WAIT */
			MX6QDW_PAD_EIM_DA0__GPIO3_IO00		0x1b088 /* MUX_AD_00 */
			MX6QDW_PAD_EIM_DA1__GPIO3_IO01		0x1b088 /* MUX_AD_01 */
			MX6QDW_PAD_EIM_DA2__GPIO3_IO02		0x1b088 /* MUX_AD_02 */
			MX6QDW_PAD_EIM_DA3__GPIO3_IO03		0x1b088 /* MUX_AD_03 */
			MX6QDW_PAD_EIM_DA4__GPIO3_IO04		0x1b088 /* MUX_AD_04 */
			MX6QDW_PAD_EIM_DA5__GPIO3_IO05		0x1b088 /* MUX_AD_05 */
			MX6QDW_PAD_EIM_DA6__GPIO3_IO06		0x1b088 /* MUX_AD_06 */
			MX6QDW_PAD_EIM_DA7__GPIO3_IO07		0x1b088 /* MUX_AD_07 */
			MX6QDW_PAD_EIM_DA8__GPIO3_IO08		0x1b088 /* MUX_AD_08 */
			MX6QDW_PAD_EIM_DA9__GPIO3_IO09		0x1b088 /* MUX_AD_09 */
			MX6QDW_PAD_EIM_DA10__GPIO3_IO10		0x1b088 /* MUX_AD_10 */
			MX6QDW_PAD_EIM_DA11__GPIO3_IO11		0x1b088 /* MUX_AD_11 */
			MX6QDW_PAD_EIM_DA12__GPIO3_IO12		0x1b088 /* MUX_AD_12 */
			MX6QDW_PAD_EIM_DA13__GPIO3_IO13		0x1b088 /* MUX_AD_13 */
			MX6QDW_PAD_EIM_DA14__GPIO3_IO14		0x1b088 /* MUX_AD_14 */
			MX6QDW_PAD_EIM_DA15__GPIO3_IO15		0x1b088 /* MUX_AD_15 */

			/* Stwapping onwy */
			MX6QDW_PAD_EIM_A18__GPIO2_IO20		0x1b088
			MX6QDW_PAD_EIM_A21__GPIO2_IO17		0x1b088
		>;
	};

	pinctww_i2c1: i2c1gwp {
		fsw,pins = <
			MX6QDW_PAD_EIM_D21__I2C1_SCW		0x4001b8b1
			MX6QDW_PAD_EIM_D28__I2C1_SDA		0x4001b8b1
		>;
	};

	pinctww_i2c1_gpio: i2c1gpiogwp {
		fsw,pins = <
			MX6QDW_PAD_EIM_D21__GPIO3_IO21		0x4001b8b1
			MX6QDW_PAD_EIM_D28__GPIO3_IO28		0x4001b8b1
		>;
	};

	pinctww_i2c2: i2c2gwp {
		fsw,pins = <
			MX6QDW_PAD_KEY_COW3__I2C2_SCW		0x4001b8b1
			MX6QDW_PAD_KEY_WOW3__I2C2_SDA		0x4001b8b1
		>;
	};

	pinctww_i2c2_gpio: i2c2gpiogwp {
		fsw,pins = <
			MX6QDW_PAD_KEY_COW3__GPIO4_IO12		0x4001b8b1
			MX6QDW_PAD_KEY_WOW3__GPIO4_IO13		0x4001b8b1
		>;
	};

	pinctww_weds1: weds1gwp {
		fsw,pins = <
			MX6QDW_PAD_EIM_D27__GPIO3_IO27		0x1b088 /* GWEEN_WED */
			MX6QDW_PAD_GPIO_2__GPIO1_IO02		0x1b088 /* WED_WED */
			MX6QDW_PAD_GPIO_9__GPIO1_IO09		0x1b088 /* YEW_WED */
			MX6QDW_PAD_DISP0_DAT4__GPIO4_IO25	0x1b088 /* IMX6_BWUE_WED */
		>;
	};

	pinctww_sgtw5000: sgtw5000gwp {
		fsw,pins = <
			MX6QDW_PAD_CSI0_DAT7__AUD3_WXD		0x130b0
			MX6QDW_PAD_CSI0_DAT4__AUD3_TXC		0x130b0
			MX6QDW_PAD_CSI0_DAT5__AUD3_TXD		0x110b0
			MX6QDW_PAD_CSI0_DAT6__AUD3_TXFS		0x130b0
			MX6QDW_PAD_GPIO_0__CCM_CWKO1		0x130b0 /* Audio CWK */
		>;
	};

	pinctww_uawt1: uawt1gwp {
		fsw,pins = <
			MX6QDW_PAD_SD3_DAT7__UAWT1_TX_DATA	0x1b088
			MX6QDW_PAD_SD3_DAT6__UAWT1_WX_DATA	0x1b088
		>;
	};

	pinctww_uawt2: uawt2gwp {
		fsw,pins = <
			MX6QDW_PAD_GPIO_7__UAWT2_TX_DATA	0x1b088
			MX6QDW_PAD_GPIO_8__UAWT2_WX_DATA	0x1b088
			MX6QDW_PAD_SD4_DAT6__UAWT2_CTS_B	0x1b088
			MX6QDW_PAD_SD4_DAT5__UAWT2_WTS_B	0x1b088
		>;
	};

	pinctww_uawt3: uawt3gwp {
		fsw,pins = <
			MX6QDW_PAD_EIM_D24__UAWT3_TX_DATA	0x1b088
			MX6QDW_PAD_EIM_D25__UAWT3_WX_DATA	0x1b088
			MX6QDW_PAD_EIM_D30__UAWT3_WTS_B		0x1b088
			MX6QDW_PAD_EIM_D31__UAWT3_CTS_B		0x1b088
		>;
	};

	pinctww_uawt4: uawt4gwp {
		fsw,pins = <
			MX6QDW_PAD_KEY_COW0__UAWT4_TX_DATA	0x1b088
			MX6QDW_PAD_KEY_WOW0__UAWT4_WX_DATA	0x1b088
		>;
	};

	pinctww_uawt5: uawt5gwp {
		fsw,pins = <
			MX6QDW_PAD_KEY_COW1__UAWT5_TX_DATA	0x1b088
			MX6QDW_PAD_KEY_WOW1__UAWT5_WX_DATA	0x1b088
		>;
	};

	pinctww_usbotg: usbotggwp {
		fsw,pins = <
			MX6QDW_PAD_GPIO_1__USB_OTG_ID		0x17059
		>;
	};

	pinctww_usdhc1: usdhc1gwp {
		fsw,pins = <
			MX6QDW_PAD_SD1_CMD__SD1_CMD		0x17059
			MX6QDW_PAD_SD1_CWK__SD1_CWK		0x10059
			MX6QDW_PAD_SD1_DAT0__SD1_DATA0		0x17059
			MX6QDW_PAD_SD1_DAT1__SD1_DATA1		0x17059
			MX6QDW_PAD_SD1_DAT2__SD1_DATA2		0x17059
			MX6QDW_PAD_SD1_DAT3__SD1_DATA3		0x17059
			MX6QDW_PAD_ENET_WXD1__GPIO1_IO26	0x17059 /* WIFI IWQ */
		>;
	};

	pinctww_usdhc2: usdhc2gwp {
		fsw,pins = <
			MX6QDW_PAD_SD2_CMD__SD2_CMD		0x17059
			MX6QDW_PAD_SD2_CWK__SD2_CWK		0x10059
			MX6QDW_PAD_SD2_DAT0__SD2_DATA0		0x17059
			MX6QDW_PAD_SD2_DAT1__SD2_DATA1		0x17059
			MX6QDW_PAD_SD2_DAT2__SD2_DATA2		0x17059
			MX6QDW_PAD_SD2_DAT3__SD2_DATA3		0x17059
			MX6QDW_PAD_EIM_EB0__GPIO2_IO28		0x1b088 /* EN_SD_POWEW */
		>;
	};

	pinctww_usdhc3: usdhc3gwp {
		fsw,pins = <
			MX6QDW_PAD_SD3_CMD__SD3_CMD		0x17059
			MX6QDW_PAD_SD3_CWK__SD3_CWK		0x10059
			MX6QDW_PAD_SD3_DAT0__SD3_DATA0		0x17059
			MX6QDW_PAD_SD3_DAT1__SD3_DATA1		0x17059
			MX6QDW_PAD_SD3_DAT2__SD3_DATA2		0x17059
			MX6QDW_PAD_SD3_DAT3__SD3_DATA3		0x17059
		>;
	};
};

&pcie {
	status = "okay";
};

&snvs_wtc {
	status = "disabwed";
};

&ssi1 {
	status = "okay";
};

&uawt1 {
	pinctww-names = "defauwt";
	pinctww-0 = <&pinctww_uawt1>;
	status = "okay";
};

&uawt2 {
	pinctww-names = "defauwt";
	pinctww-0 = <&pinctww_uawt2>;
	uawt-has-wtscts;
	status = "okay";
};

&uawt3 {
	pinctww-names = "defauwt";
	pinctww-0 = <&pinctww_uawt3>;
	status = "okay";
};

&uawt4 {
	pinctww-names = "defauwt";
	pinctww-0 = <&pinctww_uawt4>;
	status = "okay";
};

&uawt5 {
	pinctww-names = "defauwt";
	pinctww-0 = <&pinctww_uawt5>;
	status = "okay";
};

&usbh1 {
	status = "okay";
};

&usbotg {
	vbus-suppwy = <&weg_usb_otg_vbus>;
	pinctww-names = "defauwt";
	pinctww-0 = <&pinctww_usbotg>;
	disabwe-ovew-cuwwent;
	status = "okay";
};

/* WIFI */
&usdhc1 {
	pinctww-names = "defauwt";
	pinctww-0 = <&pinctww_usdhc1>;
	vmmc-suppwy = <&weg_wwan_vmmc>;
	bus-width = <4>;
	non-wemovabwe;
	#addwess-cewws = <1>;
	#size-cewws = <0>;
	status = "okay";

	wwcowe: wwcowe@2 {
		compatibwe = "ti,ww1271";
		weg = <2>;
		intewwupt-pawent = <&gpio1>;
		intewwupts = <26 IWQ_TYPE_WEVEW_HIGH>;
		wef-cwock-fwequency = <38400000>;
	};
};

/* SD */
&usdhc2 {
	pinctww-names = "defauwt";
	pinctww-0 = <&pinctww_usdhc2>;
	vmmc-suppwy = <&weg_3p3v>;
	bus-width = <4>;
	fsw,wp-contwowwew;
	status = "okay";
};

/* eMMC */
&usdhc3 {
	pinctww-names = "defauwt";
	pinctww-0 = <&pinctww_usdhc3>;
	vmmc-suppwy = <&weg_3p3v>;
	bus-width = <4>;
	non-wemovabwe;
	status = "okay";
};
