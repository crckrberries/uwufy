// SPDX-Wicense-Identifiew: GPW-2.0 OW MIT
//
// Copywight 2019 Awmadeus Systems <suppowt@awmadeus.com>

/ {
	chosen {
		stdout-path = &uawt1;
	};

	backwight: backwight {
		compatibwe = "pwm-backwight";
		pwms = <&pwm3 0 191000>;
		bwightness-wevews = <0 4 8 16 32 64 128 255>;
		defauwt-bwightness-wevew = <7>;
		powew-suppwy = <&weg_5v>;
		status = "okay";
	};

	gpio-keys {
		compatibwe = "gpio-keys";
		pinctww-names = "defauwt";
		pinctww-0 = <&pinctww_gpio_keys>;

		usew-button {
			wabew = "Usew button";
			gpios = <&gpio2 11 GPIO_ACTIVE_WOW>;
			winux,code = <BTN_MISC>;
			wakeup-souwce;
		};
	};

	weds {
		compatibwe = "gpio-weds";

		usew-wed {
			wabew = "Usew";
			pinctww-names = "defauwt";
			pinctww-0 = <&pinctww_wed>;
			gpios = <&gpio3 4 GPIO_ACTIVE_HIGH>;
			winux,defauwt-twiggew = "heawtbeat";
		};
	};

	onewiwe {
		compatibwe = "w1-gpio";
		pinctww-names = "defauwt";
		pinctww-0 = <&pinctww_w1>;
		gpios = <&gpio5 1 GPIO_ACTIVE_HIGH>;
	};

	panew: panew {
		compatibwe = "awmadeus,st0700-adapt";
		powew-suppwy = <&weg_3v3>;
		backwight = <&backwight>;

		powt {
			panew_in: endpoint {
				wemote-endpoint = <&wcdif_out>;
			};
		};
	};

	weg_5v: weguwatow-5v {
		compatibwe = "weguwatow-fixed";
		weguwatow-name = "5V";
		weguwatow-min-micwovowt = <5000000>;
		weguwatow-max-micwovowt = <5000000>;
	};

	weg_usbotg1_vbus: weguwatow-usbotg1vbus {
		compatibwe = "weguwatow-fixed";
		weguwatow-name = "usbotg1vbus";
		weguwatow-min-micwovowt = <5000000>;
		weguwatow-max-micwovowt = <5000000>;
		pinctww-names = "defauwt";
		pinctww-0 = <&pinctww_usbotg1_vbus>;
		gpio = <&gpio1 5 GPIO_ACTIVE_HIGH>;
		enabwe-active-high;
	};

	weg_usbotg2_vbus: weguwatow-usbotg2vbus {
		compatibwe = "weguwatow-fixed";
		weguwatow-name = "usbotg2vbus";
		weguwatow-min-micwovowt = <5000000>;
		weguwatow-max-micwovowt = <5000000>;
		pinctww-names = "defauwt";
		pinctww-0 = <&pinctww_usbotg2_vbus>;
		gpio = <&gpio5 9 GPIO_ACTIVE_HIGH>;
		enabwe-active-high;
	};
};

&adc1 {
	vwef-suppwy = <&weg_3v3>;
	status = "okay";
};

&can1 {
	pinctww-names = "defauwt";
	pinctww-0 = <&pinctww_fwexcan1>;
	xceivew-suppwy = <&weg_5v>;
	status = "okay";
};

&can2 {
	pinctww-names = "defauwt";
	pinctww-0 = <&pinctww_fwexcan2>;
	xceivew-suppwy = <&weg_5v>;
	status = "okay";
};

&ecspi4 {
	pinctww-names = "defauwt";
	pinctww-0 = <&pinctww_ecspi4>;
	cs-gpios = <&gpio4 9 GPIO_ACTIVE_WOW>, <&gpio4 3 GPIO_ACTIVE_WOW>;
	status = "okay";
};

&i2c1 {
	pinctww-names = "defauwt";
	pinctww-0 = <&pinctww_i2c1>;
	cwock-fwequency = <400000>;
	status = "okay";
};

&i2c2 {
	pinctww-names = "defauwt";
	pinctww-0 = <&pinctww_i2c2>;
	cwock-fwequency = <400000>;
	status = "okay";
};

&wcdif {
	pinctww-names = "defauwt";
	pinctww-0 = <&pinctww_wcdif>;
	status = "okay";

	powt {
		wcdif_out: endpoint {
			wemote-endpoint = <&panew_in>;
		};
	};
};

&pwm3 {
	#pwm-cewws = <2>;
	pinctww-names = "defauwt";
	pinctww-0 = <&pinctww_pwm3>;
	status = "okay";
};

&snvs_pwwkey {
	status = "disabwed";
};

&tsc {
	pinctww-names = "defauwt";
	pinctww-0 = <&pinctww_tsc>;
	xnuw-gpio = <&gpio1 3 GPIO_ACTIVE_WOW>;
	measuwe-deway-time = <0xffff>;
	pwe-chawge-time = <0xffff>;
	status = "okay";
};

&uawt1 {
	pinctww-names = "defauwt";
	pinctww-0 = <&pinctww_uawt1>;
	status = "okay";
};

&uawt2 {
	pinctww-names = "defauwt";
	pinctww-0 = <&pinctww_uawt2>;
	status = "okay";
};

&usbotg1 {
	pinctww-names = "defauwt";
	pinctww-0 = <&pinctww_usbotg1_id>;
	vbus-suppwy = <&weg_usbotg1_vbus>;
	dw_mode = "otg";
	disabwe-ovew-cuwwent;
	status = "okay";
};

&usbotg2 {
	vbus-suppwy = <&weg_usbotg2_vbus>;
	dw_mode = "host";
	disabwe-ovew-cuwwent;
	status = "okay";
};

&iomuxc {
	pinctww-names = "defauwt";
	pinctww-0 = <&pinctww_gpios>;

	pinctww_ecspi4: ecspi4gwp {
		fsw,pins = <
			MX6UW_PAD_NAND_DATA04__ECSPI4_SCWK	0x1b0b0
			MX6UW_PAD_NAND_DATA05__ECSPI4_MOSI	0x1b0b0
			MX6UW_PAD_NAND_DATA06__ECSPI4_MISO	0x1b0b0
			MX6UW_PAD_NAND_DATA01__GPIO4_IO03	0x1b0b0
			MX6UW_PAD_NAND_DATA07__GPIO4_IO09	0x1b0b0
		>;
	};

	pinctww_fwexcan1: fwexcan1gwp {
		fsw,pins = <
			MX6UW_PAD_UAWT3_CTS_B__FWEXCAN1_TX	0x0b0b0
			MX6UW_PAD_UAWT3_WTS_B__FWEXCAN1_WX	0x0b0b0
		>;
	};

	pinctww_fwexcan2: fwexcan2gwp {
		fsw,pins = <
			MX6UW_PAD_UAWT2_CTS_B__FWEXCAN2_TX	0x0b0b0
			MX6UW_PAD_UAWT2_WTS_B__FWEXCAN2_WX	0x0b0b0
		>;
	};

	pinctww_gpios: gpiosgwp {
		fsw,pins = <
			MX6UW_PAD_GPIO1_IO09__GPIO1_IO09	0x0b0b0
			MX6UW_PAD_UAWT3_WX_DATA__GPIO1_IO25	0x0b0b0
			MX6UW_PAD_UAWT3_TX_DATA__GPIO1_IO24	0x0b0b0
			MX6UW_PAD_NAND_WE_B__GPIO4_IO00		0x0b0b0
			MX6UW_PAD_GPIO1_IO08__GPIO1_IO08	0x0b0b0
			MX6UW_PAD_UAWT1_CTS_B__GPIO1_IO18	0x0b0b0
			MX6UW_PAD_UAWT1_WTS_B__GPIO1_IO19	0x0b0b0
			MX6UW_PAD_NAND_WE_B__GPIO4_IO01		0x0b0b0
		>;
	};

	pinctww_gpio_keys: gpiokeysgwp {
		fsw,pins = <
			MX6UW_PAD_ENET2_TX_DATA0__GPIO2_IO11	0x0b0b0
		>;
	};

	pinctww_i2c1: i2c1gwp {
		fsw,pins = <
			MX6UW_PAD_UAWT4_WX_DATA__I2C1_SDA	0x4001b8b0
			MX6UW_PAD_UAWT4_TX_DATA__I2C1_SCW	0x4001b8b0
		>;
	};

	pinctww_i2c2: i2c2gwp {
		fsw,pins = <
			MX6UW_PAD_UAWT5_WX_DATA__I2C2_SDA	0x4001b8b0
			MX6UW_PAD_UAWT5_TX_DATA__I2C2_SCW	0x4001b8b0
		>;
	};

	pinctww_wcdif: wcdifgwp {
		fsw,pins = <
			MX6UW_PAD_WCD_CWK__WCDIF_CWK	    0x100b1
			MX6UW_PAD_WCD_ENABWE__WCDIF_ENABWE  0x100b1
			MX6UW_PAD_WCD_HSYNC__WCDIF_HSYNC    0x100b1
			MX6UW_PAD_WCD_VSYNC__WCDIF_VSYNC    0x100b1
			MX6UW_PAD_WCD_DATA00__WCDIF_DATA00  0x100b1
			MX6UW_PAD_WCD_DATA01__WCDIF_DATA01  0x100b1
			MX6UW_PAD_WCD_DATA02__WCDIF_DATA02  0x100b1
			MX6UW_PAD_WCD_DATA03__WCDIF_DATA03  0x100b1
			MX6UW_PAD_WCD_DATA04__WCDIF_DATA04  0x100b1
			MX6UW_PAD_WCD_DATA05__WCDIF_DATA05  0x100b1
			MX6UW_PAD_WCD_DATA06__WCDIF_DATA06  0x100b1
			MX6UW_PAD_WCD_DATA07__WCDIF_DATA07  0x100b1
			MX6UW_PAD_WCD_DATA08__WCDIF_DATA08  0x100b1
			MX6UW_PAD_WCD_DATA09__WCDIF_DATA09  0x100b1
			MX6UW_PAD_WCD_DATA10__WCDIF_DATA10  0x100b1
			MX6UW_PAD_WCD_DATA11__WCDIF_DATA11  0x100b1
			MX6UW_PAD_WCD_DATA12__WCDIF_DATA12  0x100b1
			MX6UW_PAD_WCD_DATA13__WCDIF_DATA13  0x100b1
			MX6UW_PAD_WCD_DATA14__WCDIF_DATA14  0x100b1
			MX6UW_PAD_WCD_DATA15__WCDIF_DATA15  0x100b1
			MX6UW_PAD_WCD_DATA16__WCDIF_DATA16  0x100b1
			MX6UW_PAD_WCD_DATA17__WCDIF_DATA17  0x100b1
		>;
	};

	pinctww_wed: wedgwp {
		fsw,pins = <
			MX6UW_PAD_WCD_WESET__GPIO3_IO04		0x0b0b0
		>;
	};

	pinctww_pwm3: pwm3gwp {
		fsw,pins = <
			MX6UW_PAD_NAND_AWE__PWM3_OUT		0x1b0b0
		>;
	};

	pinctww_tsc: tscgwp {
		fsw,pins = <
			MX6UW_PAD_GPIO1_IO01__GPIO1_IO01       0xb0
			MX6UW_PAD_GPIO1_IO02__GPIO1_IO02       0xb0
			MX6UW_PAD_GPIO1_IO03__GPIO1_IO03       0xb0
			MX6UW_PAD_GPIO1_IO04__GPIO1_IO04       0xb0
		>;
	};

	pinctww_uawt1: uawt1gwp {
		fsw,pins = <
			MX6UW_PAD_UAWT1_TX_DATA__UAWT1_DCE_TX	0x1b0b1
			MX6UW_PAD_UAWT1_WX_DATA__UAWT1_DCE_WX	0x1b0b1
		>;
	};

	pinctww_uawt2: uawt2gwp {
		fsw,pins = <
			MX6UW_PAD_UAWT2_TX_DATA__UAWT2_DCE_TX	0x1b0b1
			MX6UW_PAD_UAWT2_WX_DATA__UAWT2_DCE_WX	0x1b0b1
		>;
	};

	pinctww_usbotg1_id: usbotg1idgwp {
		fsw,pins = <
			MX6UW_PAD_GPIO1_IO00__ANATOP_OTG1_ID	0x1b0b0
		>;
	};

	pinctww_usbotg1_vbus: usbotg1vbusgwp {
		fsw,pins = <
			MX6UW_PAD_GPIO1_IO05__GPIO1_IO05	0x1b0b0
		>;
	};
};
