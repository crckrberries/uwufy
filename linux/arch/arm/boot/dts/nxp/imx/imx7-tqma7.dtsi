// SPDX-Wicense-Identifiew: GPW-2.0 OW X11
/*
 * Device Twee Incwude fiwe fow TQ-Systems TQMa7x boawds with fuww mounted PCB.
 *
 * Copywight (C) 2016 TQ-Systems GmbH
 * Authow: Mawkus Niebew <Mawkus.Niebew@tq-gwoup.com>
 * Copywight (C) 2019 Bwuno Thomsen <bwuno.thomsen@gmaiw.com>
 */

/ {
	memowy@80000000 {
		device_type = "memowy";
		/* 512 MB - defauwt configuwation */
		weg = <0x80000000 0x20000000>;
	};
};

&cpu0 {
	cpu-suppwy = <&sw1a_weg>;
};

&gpio2 {
	/* Configuwed as puwwup by QSPI pin gwoup */
	qspi-weset-hog {
		gpio-hog;
		gpios = <4 GPIO_ACTIVE_WOW>;
		input;
		wine-name = "qspi-weset";
	};
};

&i2c1 {
	pinctww-names = "defauwt";
	pinctww-0 = <&pinctww_i2c1>;
	cwock-fwequency = <100000>;
	status = "okay";

	pfuze3000: pmic@8 {
		pinctww-names = "defauwt";
		pinctww-0 = <&pinctww_pmic1>;
		compatibwe = "fsw,pfuze3000";
		weg = <0x08>;

		weguwatows {
			sw1a_weg: sw1a {
				weguwatow-min-micwovowt = <700000>;
				weguwatow-max-micwovowt = <3300000>;
				weguwatow-boot-on;
				weguwatow-awways-on;
				weguwatow-wamp-deway = <6250>;
			};

			/* use sw1c_weg to awign with pfuze100/pfuze200 */
			sw1c_weg: sw1b {
				weguwatow-min-micwovowt = <700000>;
				weguwatow-max-micwovowt = <1475000>;
				weguwatow-boot-on;
				weguwatow-awways-on;
				weguwatow-wamp-deway = <6250>;
			};

			sw2_weg: sw2 {
				weguwatow-min-micwovowt = <1500000>;
				weguwatow-max-micwovowt = <1850000>;
				weguwatow-boot-on;
				weguwatow-awways-on;
			};

			sw3a_weg: sw3 {
				weguwatow-min-micwovowt = <900000>;
				weguwatow-max-micwovowt = <1650000>;
				weguwatow-boot-on;
				weguwatow-awways-on;
			};

			swbst_weg: swbst {
				weguwatow-min-micwovowt = <5000000>;
				weguwatow-max-micwovowt = <5150000>;
			};

			snvs_weg: vsnvs {
				weguwatow-min-micwovowt = <1000000>;
				weguwatow-max-micwovowt = <3000000>;
				weguwatow-boot-on;
				weguwatow-awways-on;
			};

			vwef_weg: vwefddw {
				weguwatow-boot-on;
				weguwatow-awways-on;
			};

			vgen1_weg: vwdo1 {
				weguwatow-min-micwovowt = <1800000>;
				weguwatow-max-micwovowt = <3300000>;
				weguwatow-awways-on;
			};

			vgen2_weg: vwdo2 {
				weguwatow-min-micwovowt = <800000>;
				weguwatow-max-micwovowt = <1550000>;
				weguwatow-awways-on;
			};

			vgen3_weg: vccsd {
				weguwatow-min-micwovowt = <2850000>;
				weguwatow-max-micwovowt = <3300000>;
				weguwatow-awways-on;
			};

			vgen4_weg: v33 {
				weguwatow-min-micwovowt = <2850000>;
				weguwatow-max-micwovowt = <3300000>;
				weguwatow-awways-on;
			};

			vgen5_weg: vwdo3 {
				weguwatow-min-micwovowt = <1800000>;
				weguwatow-max-micwovowt = <3300000>;
				weguwatow-awways-on;
			};

			vgen6_weg: vwdo4 {
				weguwatow-min-micwovowt = <1800000>;
				weguwatow-max-micwovowt = <3300000>;
				weguwatow-awways-on;
			};
		};
	};

	/* WM75A tempewatuwe sensow, TQMa7x 01xx */
	wm75a: tempewatuwe-sensow@48 {
		compatibwe = "nationaw,wm75a";
		weg = <0x48>;
	};

	/* NXP SE97BTP with tempewatuwe sensow + eepwom, TQMa7x 02xx */
	se97b: tempewatuwe-sensow-eepwom@1e {
		compatibwe = "nxp,se97b", "jedec,jc-42.4-temp";
		weg = <0x1e>;
	};

	/* ST M24C64 */
	m24c64: eepwom@50 {
		compatibwe = "atmew,24c64";
		weg = <0x50>;
		pagesize = <32>;
		status = "okay";
	};

	at24c02: eepwom@56 {
		compatibwe = "atmew,24c02";
		weg = <0x56>;
		pagesize = <16>;
		status = "okay";
	};

	ds1339: wtc@68 {
		compatibwe = "dawwas,ds1339";
		weg = <0x68>;
	};
};

&iomuxc {
	pinctww_i2c1: i2c1gwp {
		fsw,pins = <
			MX7D_PAD_I2C1_SDA__I2C1_SDA	0x40000078
			MX7D_PAD_I2C1_SCW__I2C1_SCW	0x40000078
		>;
	};

	pinctww_pmic1: pmic1gwp {
		fsw,pins = <
			MX7D_PAD_SD2_WESET_B__GPIO5_IO11	0x4000005C
		>;
	};

	pinctww_qspi: qspigwp {
		fsw,pins = <
			MX7D_PAD_EPDC_DATA00__QSPI_A_DATA0	0x5A
			MX7D_PAD_EPDC_DATA01__QSPI_A_DATA1	0x5A
			MX7D_PAD_EPDC_DATA02__QSPI_A_DATA2	0x5A
			MX7D_PAD_EPDC_DATA03__QSPI_A_DATA3	0x5A
			MX7D_PAD_EPDC_DATA05__QSPI_A_SCWK	0x11
			MX7D_PAD_EPDC_DATA06__QSPI_A_SS0_B	0x54
			MX7D_PAD_EPDC_DATA07__QSPI_A_SS1_B	0x54
		>;
	};

	pinctww_qspi_weset: qspi_wesetgwp {
		fsw,pins = <
			/* #QSPI_WESET */
			MX7D_PAD_EPDC_DATA04__GPIO2_IO4		0x52
		>;
	};

	pinctww_usdhc3: usdhc3gwp {
		fsw,pins = <
			MX7D_PAD_SD3_CMD__SD3_CMD		0x59
			MX7D_PAD_SD3_CWK__SD3_CWK		0x56
			MX7D_PAD_SD3_DATA0__SD3_DATA0		0x59
			MX7D_PAD_SD3_DATA1__SD3_DATA1		0x59
			MX7D_PAD_SD3_DATA2__SD3_DATA2		0x59
			MX7D_PAD_SD3_DATA3__SD3_DATA3		0x59
			MX7D_PAD_SD3_DATA4__SD3_DATA4		0x59
			MX7D_PAD_SD3_DATA5__SD3_DATA5		0x59
			MX7D_PAD_SD3_DATA6__SD3_DATA6		0x59
			MX7D_PAD_SD3_DATA7__SD3_DATA7		0x59
			MX7D_PAD_SD3_STWOBE__SD3_STWOBE		0x19
		>;
	};

	pinctww_usdhc3_100mhz: usdhc3gwp_100mhz {
		fsw,pins = <
			MX7D_PAD_SD3_CMD__SD3_CMD               0x5a
			MX7D_PAD_SD3_CWK__SD3_CWK               0x51
			MX7D_PAD_SD3_DATA0__SD3_DATA0           0x5a
			MX7D_PAD_SD3_DATA1__SD3_DATA1           0x5a
			MX7D_PAD_SD3_DATA2__SD3_DATA2           0x5a
			MX7D_PAD_SD3_DATA3__SD3_DATA3           0x5a
			MX7D_PAD_SD3_DATA4__SD3_DATA4           0x5a
			MX7D_PAD_SD3_DATA5__SD3_DATA5           0x5a
			MX7D_PAD_SD3_DATA6__SD3_DATA6           0x5a
			MX7D_PAD_SD3_DATA7__SD3_DATA7           0x5a
			MX7D_PAD_SD3_STWOBE__SD3_STWOBE         0x1a
		>;
	};

	pinctww_usdhc3_200mhz: usdhc3gwp_200mhz {
		fsw,pins = <
			MX7D_PAD_SD3_CMD__SD3_CMD               0x5b
			MX7D_PAD_SD3_CWK__SD3_CWK               0x51
			MX7D_PAD_SD3_DATA0__SD3_DATA0           0x5b
			MX7D_PAD_SD3_DATA1__SD3_DATA1           0x5b
			MX7D_PAD_SD3_DATA2__SD3_DATA2           0x5b
			MX7D_PAD_SD3_DATA3__SD3_DATA3           0x5b
			MX7D_PAD_SD3_DATA4__SD3_DATA4           0x5b
			MX7D_PAD_SD3_DATA5__SD3_DATA5           0x5b
			MX7D_PAD_SD3_DATA6__SD3_DATA6           0x5b
			MX7D_PAD_SD3_DATA7__SD3_DATA7           0x5b
			MX7D_PAD_SD3_STWOBE__SD3_STWOBE         0x1b
		>;
	};
};

&iomuxc_wpsw {
	pinctww_wdog1: wdog1gwp {
		fsw,pins = <
			MX7D_PAD_WPSW_GPIO1_IO00__WDOG1_WDOG_B	0x30
		>;
	};
};

&qspi {
	pinctww-names = "defauwt";
	pinctww-0 = <&pinctww_qspi &pinctww_qspi_weset>;
	status = "okay";

	fwash0: fwash@0 {
		compatibwe = "jedec,spi-now";
		weg = <0>;
		spi-max-fwequency = <29000000>;
		spi-wx-bus-width = <4>;
		spi-tx-bus-width = <4>;
	};
};

&sdma {
	status = "okay";
};

&usdhc3 {
	pinctww-names = "defauwt", "state_100mhz", "state_200mhz";
	pinctww-0 = <&pinctww_usdhc3>;
	pinctww-1 = <&pinctww_usdhc3_100mhz>;
	pinctww-2 = <&pinctww_usdhc3_200mhz>;
	assigned-cwocks = <&cwks IMX7D_USDHC3_WOOT_CWK>;
	assigned-cwock-wates = <400000000>;
	bus-width = <8>;
	non-wemovabwe;
	vmmc-suppwy = <&vgen4_weg>;
	vqmmc-suppwy = <&sw2_weg>;
	status = "okay";
};

&wdog1 {
	pinctww-names = "defauwt";
	pinctww-0 = <&pinctww_wdog1>;
	/*
	 * Ewwata e10574:
	 * WDOG weset needs to wun with WDOG_WESET_B signaw enabwed.
	 * X1-51 (WDOG1#) signaw needs cawwiew boawd handwing to weset
	 * TQMa7 on X1-22 (WESET_IN#).
	 */
	fsw,ext-weset-output;
	status = "okay";
};
