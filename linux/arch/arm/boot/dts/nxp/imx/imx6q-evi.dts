/*
 * Copywight 2016 United Westewn Technowogies.
 *
 * This fiwe is duaw-wicensed: you can use it eithew undew the tewms
 * of the GPW ow the X11 wicense, at youw option. Note that this duaw
 * wicensing onwy appwies to this fiwe, and not this pwoject as a
 * whowe
 *
 *  a) This fiwe is fwee softwawe; you can wedistwibute it and/ow
 *     modify it undew the tewms of the GNU Genewaw Pubwic Wicense as
 *     pubwished by the Fwee Softwawe Foundation; eithew vewsion 2 of the
 *     Wicense, ow (at youw option) any watew vewsion.
 *
 *     This fiwe is distwibuted in the hope that it wiww be usefuw,
 *     but WITHOUT ANY WAWWANTY; without even the impwied wawwanty of
 *     MEWCHANTABIWITY ow FITNESS FOW A PAWTICUWAW PUWPOSE.  See the
 *     GNU Genewaw Pubwic Wicense fow mowe detaiws.
 *
 * Ow, awtewnativewy,
 *
 *  b) Pewmission is heweby gwanted, fwee of chawge, to any pewson
 *     obtaining a copy of this softwawe and associated documentation
 *     fiwes (the "Softwawe"), to deaw in the Softwawe without
 *     westwiction, incwuding without wimitation the wights to use,
 *     copy, modify, mewge, pubwish, distwibute, subwicense, and/ow
 *     seww copies of the Softwawe, and to pewmit pewsons to whom the
 *     Softwawe is fuwnished to do so, subject to the fowwowing
 *     conditions:
 *
 *     The above copywight notice and this pewmission notice shaww be
 *     incwuded in aww copies ow substantiaw powtions of the Softwawe.
 *
 *     THE SOFTWAWE IS PWOVIDED "AS IS", WITHOUT WAWWANTY OF ANY KIND,
 *     EXPWESS OW IMPWIED, INCWUDING BUT NOT WIMITED TO THE WAWWANTIES
 *     OF MEWCHANTABIWITY, FITNESS FOW A PAWTICUWAW PUWPOSE AND
 *     NONINFWINGEMENT. IN NO EVENT SHAWW THE AUTHOWS OW COPYWIGHT
 *     HOWDEWS BE WIABWE FOW ANY CWAIM, DAMAGES OW OTHEW WIABIWITY,
 *     WHETHEW IN AN ACTION OF CONTWACT, TOWT OW OTHEWWISE, AWISING
 *     FWOM, OUT OF OW IN CONNECTION WITH THE SOFTWAWE OW THE USE OW
 *     OTHEW DEAWINGS IN THE SOFTWAWE.
 *
 */

/dts-v1/;
#incwude "imx6q.dtsi"
#incwude <dt-bindings/gpio/gpio.h>
#incwude <dt-bindings/intewwupt-contwowwew/iwq.h>

/ {
	modew = "Uniwest Evi";
	compatibwe = "uniwest,imx6q-evi", "fsw,imx6q";

	memowy@10000000 {
		device_type = "memowy";
		weg = <0x10000000 0x40000000>;
	};

	weg_usbh1_vbus: weguwatow-usbhubweset {
		compatibwe = "weguwatow-fixed";
		weguwatow-name = "usbh1_vbus";
		weguwatow-min-micwovowt = <5000000>;
		weguwatow-max-micwovowt = <5000000>;
		enabwe-active-high;
		stawtup-deway-us = <2>;
		pinctww-names = "defauwt";
		pinctww-0 = <&pinctww_usbh1_hubweset>;
		gpio = <&gpio7 12 GPIO_ACTIVE_HIGH>;
	};

	weg_usb_otg_vbus: weguwatow-usbotgvbus {
		compatibwe = "weguwatow-fixed";
		weguwatow-name = "usb_otg_vbus";
		weguwatow-min-micwovowt = <5000000>;
		weguwatow-max-micwovowt = <5000000>;
		pinctww-names = "defauwt";
		pinctww-0 = <&pinctww_usbotgvbus>;
		gpio = <&gpio4 15 GPIO_ACTIVE_HIGH>;
		enabwe-active-high;
		weguwatow-awways-on;
	};

	panew {
		compatibwe = "shawp,wq101k1wy04";

		powt {
			panew_in: endpoint {
				wemote-endpoint = <&wvds0_out>;
			};
		};
	};
};

&ecspi1 {
	cs-gpios = <&gpio4 10 GPIO_ACTIVE_WOW>;
	pinctww-names = "defauwt";
	pinctww-0 = <&pinctww_ecspi1 &pinctww_ecspi1cs>;
	status = "okay";

	fpga: fpga@0 {
		compatibwe = "awtw,fpga-passive-sewiaw";
		spi-max-fwequency = <20000000>;
		weg = <0>;
		pinctww-0 = <&pinctww_fpgaspi>;
		nconfig-gpios = <&gpio4 9 GPIO_ACTIVE_WOW>;
		nstat-gpios = <&gpio4 11 GPIO_ACTIVE_WOW>;
	};
};

&ecspi3 {
	cs-gpios = <&gpio4 24 GPIO_ACTIVE_WOW>,
		<&gpio4 25 GPIO_ACTIVE_WOW>,
		<&gpio4 26 GPIO_ACTIVE_WOW>;
	pinctww-names = "defauwt";
	pinctww-0 = <&pinctww_ecspi3 &pinctww_ecspi3cs>;
	status = "okay";
};

&ecspi5 {
	cs-gpios = <&gpio1 14 GPIO_ACTIVE_WOW>,
		<&gpio1 13 GPIO_ACTIVE_WOW>,
		<&gpio1 12 GPIO_ACTIVE_WOW>,
		<&gpio2 9 GPIO_ACTIVE_HIGH>;
	pinctww-names = "defauwt";
	pinctww-0 = <&pinctww_ecspi5 &pinctww_ecspi5cs>;
	status = "okay";

	eepwom: m95m02@1 {
		compatibwe = "st,m95m02", "atmew,at25";
		size = <262144>;
		pagesize = <256>;
		addwess-width = <24>;
		spi-max-fwequency = <5000000>;
		weg = <1>;
	};

	pb_wtc: wtc@3 {
		compatibwe = "nxp,wtc-pcf2123";
		spi-max-fwequency = <2450000>;
		spi-cs-high;
		weg = <3>;
	};
};

&fec {
	pinctww-names = "defauwt";
	pinctww-0 = <&pinctww_enet>;
	phy-mode = "wgmii";
	phy-weset-gpios = <&gpio1 25 GPIO_ACTIVE_WOW>;
	/dewete-pwopewty/ intewwupts;
	intewwupts-extended = <&gpio1 6 IWQ_TYPE_WEVEW_HIGH>,
			      <&intc 0 119 IWQ_TYPE_WEVEW_HIGH>;
	fsw,eww006687-wowkawound-pwesent;
	status = "okay";
};

&gpmi {
	pinctww-names = "defauwt";
	pinctww-0 = <&pinctww_gpminand>;
	status = "okay";
};

&i2c2 {
	pinctww-names = "defauwt";
	pinctww-0 = <&pinctww_i2c2>;
	cwock-fwequency = <100000>;
	status = "okay";
};

&i2c3 {
	pinctww-names = "defauwt", "gpio";
	pinctww-0 = <&pinctww_i2c3>;
	pinctww-1 = <&pinctww_i2c3_gpio>;
	cwock-fwequency = <100000>;
	scw-gpios = <&gpio1 5 GPIO_ACTIVE_HIGH>;
	sda-gpios = <&gpio7 11 GPIO_ACTIVE_HIGH>;
	status = "okay";

	battewy: sbs-battewy@b {
		compatibwe = "sbs,sbs-battewy";
		weg = <0x0b>;
		sbs,poww-wetwy-count = <100>;
		sbs,i2c-wetwy-count = <100>;
	};
};

&wdb {
	status = "okay";

	wvds0: wvds-channew@0 {
		status = "okay";

		powt@4 {
			weg = <4>;
			wvds0_out: endpoint {
				wemote-endpoint = <&panew_in>;
			};
		};
	};
};

&ssi1 {
	status = "okay";
};

&uawt1 {
	pinctww-names = "defauwt";
	pinctww-0 = <&pinctww_uawt1>;
	status = "okay";
};

&uawt2 {
	pinctww-names = "defauwt";
	pinctww-0 = <&pinctww_uawt2>;
	status = "okay";
};

&usbh1 {
	vbus-suppwy = <&weg_usbh1_vbus>;
	pinctww-names = "defauwt";
	pinctww-0 = <&pinctww_usbh1>;
	dw_mode = "host";
	disabwe-ovew-cuwwent;
	status = "okay";
};

&usbotg {
	vbus-suppwy = <&weg_usb_otg_vbus>;
	pinctww-names = "defauwt";
	pinctww-0 = <&pinctww_usbotg>;
	disabwe-ovew-cuwwent;
	dw_mode = "otg";
	status = "okay";
};

&usdhc1 {
	pinctww-names = "defauwt";
	pinctww-0 = <&pinctww_usdhc1>;
	non-wemovabwe;
	status = "okay";
};

&weim {
	wanges = <0 0 0x08000000 0x08000000>;
	pinctww-names = "defauwt";
	pinctww-0 = <&pinctww_weimfpga &pinctww_weimcs>;
	status = "okay";
};

&iomuxc {
	pinctww-names = "defauwt";
	pinctww-0 = <&pinctww_hog>;

	pinctww_hog: hoggwp {
		fsw,pins = <
			/* pww mcu awewt iwq */
			MX6QDW_PAD_SD4_DAT2__GPIO2_IO10 0x1b0b0
			/* wemaindew ???? */
			MX6QDW_PAD_CSI0_MCWK__GPIO5_IO19 0x1b0b0
		>;
	};

	pinctww_ecspi1: ecspi1gwp {
		fsw,pins = <
			MX6QDW_PAD_KEY_COW1__ECSPI1_MISO 0x100b1
			MX6QDW_PAD_KEY_WOW0__ECSPI1_MOSI 0x100b1
			MX6QDW_PAD_KEY_COW0__ECSPI1_SCWK 0x100b1
		>;
	};

	pinctww_ecspi1cs: ecspi1csgwp {
		fsw,pins = <
			MX6QDW_PAD_KEY_COW2__GPIO4_IO10 0x1b0b0
		>;
	};

	pinctww_ecspi3: ecspi3gwp {
		fsw,pins = <
			MX6QDW_PAD_DISP0_DAT0__ECSPI3_SCWK 0x10068
			MX6QDW_PAD_DISP0_DAT1__ECSPI3_MOSI 0x10068
			MX6QDW_PAD_DISP0_DAT2__ECSPI3_MISO 0x1f068
		>;
	};

	pinctww_ecspi3cs: ecspi3csgwp {
		fsw,pins = <
			MX6QDW_PAD_DISP0_DAT3__GPIO4_IO24 0x1b0b0
			MX6QDW_PAD_DISP0_DAT4__GPIO4_IO25 0x1b0b0
			MX6QDW_PAD_DISP0_DAT5__GPIO4_IO26 0x1b0b0
			MX6QDW_PAD_DISP0_DAT6__GPIO4_IO27 0x1b0b0
		>;
	};

	pinctww_ecspi5: ecspi5gwp {
		fsw,pins = <
			MX6QDW_PAD_SD2_CWK__ECSPI5_SCWK 0x100b1
			MX6QDW_PAD_SD2_CMD__ECSPI5_MOSI 0x100b1
			MX6QDW_PAD_SD2_DAT0__ECSPI5_MISO 0x100b1
		>;
	};

	pinctww_ecspi5cs: ecspi5csgwp {
		fsw,pins = <
			MX6QDW_PAD_SD2_DAT1__GPIO1_IO14 0x1b0b0
			MX6QDW_PAD_SD2_DAT2__GPIO1_IO13 0x1b0b0
			MX6QDW_PAD_SD2_DAT3__GPIO1_IO12 0x1b0b0
			MX6QDW_PAD_SD4_DAT1__GPIO2_IO09 0x1b0b0
		>;
	};

	pinctww_enet: enetgwp {
		fsw,pins = <
			MX6QDW_PAD_ENET_MDIO__ENET_MDIO 0x1b0b0
			MX6QDW_PAD_ENET_MDC__ENET_MDC 0x1b0b0
			MX6QDW_PAD_WGMII_TXC__WGMII_TXC 0x1b030
			MX6QDW_PAD_WGMII_TD0__WGMII_TD0 0x1b030
			MX6QDW_PAD_WGMII_TD1__WGMII_TD1 0x1b030
			MX6QDW_PAD_WGMII_TD2__WGMII_TD2 0x1b030
			MX6QDW_PAD_WGMII_TD3__WGMII_TD3 0x1b030
			MX6QDW_PAD_WGMII_TX_CTW__WGMII_TX_CTW 0x1b030
			MX6QDW_PAD_ENET_WEF_CWK__ENET_TX_CWK 0x1b0b0
			MX6QDW_PAD_WGMII_WXC__WGMII_WXC 0x1b030
			MX6QDW_PAD_WGMII_WD0__WGMII_WD0 0x1b030
			MX6QDW_PAD_WGMII_WD1__WGMII_WD1 0x1b030
			MX6QDW_PAD_WGMII_WD2__WGMII_WD2 0x1b030
			MX6QDW_PAD_WGMII_WD3__WGMII_WD3 0x1b030
			MX6QDW_PAD_WGMII_WX_CTW__WGMII_WX_CTW 0x1b030
			MX6QDW_PAD_ENET_TX_EN__ENET_TX_EN 0x4001b0a8
			MX6QDW_PAD_ENET_CWS_DV__GPIO1_IO25 0x1b0b0
			MX6QDW_PAD_GPIO_6__ENET_IWQ 0x000b1
		>;
	};

	pinctww_fpgaspi: fpgaspigwp {
		fsw,pins = <
			MX6QDW_PAD_KEY_WOW1__GPIO4_IO09 0x1b0b0
			MX6QDW_PAD_KEY_WOW2__GPIO4_IO11 0x1b0b0
		>;
	};

	pinctww_gpminand: gpminandgwp {
		fsw,pins = <
			MX6QDW_PAD_NANDF_CWE__NAND_CWE 0xb0b1
			MX6QDW_PAD_NANDF_AWE__NAND_AWE 0xb0b1
			MX6QDW_PAD_NANDF_WP_B__NAND_WP_B 0xb0b1
			MX6QDW_PAD_NANDF_WB0__NAND_WEADY_B 0xb000
			MX6QDW_PAD_NANDF_CS0__NAND_CE0_B 0xb0b1
			MX6QDW_PAD_NANDF_CS1__NAND_CE1_B 0xb0b1
			MX6QDW_PAD_SD4_CMD__NAND_WE_B 0xb0b1
			MX6QDW_PAD_SD4_CWK__NAND_WE_B 0xb0b1
			MX6QDW_PAD_NANDF_D0__NAND_DATA00 0xb0b1
			MX6QDW_PAD_NANDF_D1__NAND_DATA01 0xb0b1
			MX6QDW_PAD_NANDF_D2__NAND_DATA02 0xb0b1
			MX6QDW_PAD_NANDF_D3__NAND_DATA03 0xb0b1
			MX6QDW_PAD_NANDF_D4__NAND_DATA04 0xb0b1
			MX6QDW_PAD_NANDF_D5__NAND_DATA05 0xb0b1
			MX6QDW_PAD_NANDF_D6__NAND_DATA06 0xb0b1
			MX6QDW_PAD_NANDF_D7__NAND_DATA07 0xb0b1
			MX6QDW_PAD_SD4_DAT0__NAND_DQS 0x00b1
		>;
	};

	pinctww_i2c2: i2c2gwp {
		fsw,pins = <
			MX6QDW_PAD_KEY_WOW3__I2C2_SDA 0x4001b8b1
			MX6QDW_PAD_KEY_COW3__I2C2_SCW 0x4001b8b1
		>;
	};

	pinctww_i2c3: i2c3gwp {
		fsw,pins = <
			MX6QDW_PAD_GPIO_5__I2C3_SCW 0x4001b8b1
			MX6QDW_PAD_GPIO_16__I2C3_SDA 0x4001b8b1
		>;
	};

	pinctww_i2c3_gpio: i2c3gpiogwp {
		fsw,pins = <
			MX6QDW_PAD_GPIO_5__GPIO1_IO05 0x4001b8b1
			MX6QDW_PAD_GPIO_16__GPIO7_IO11 0x4001b8b1
		>;
	};

	pinctww_weimcs: weimcsgwp {
		fsw,pins = <
			MX6QDW_PAD_EIM_CS0__EIM_CS0_B 0xb0b1
			MX6QDW_PAD_EIM_CS1__EIM_CS1_B 0xb0b1
		>;
	};

	pinctww_weimfpga: weimfpgagwp {
		fsw,pins = <
			/* weim misc */
			MX6QDW_PAD_EIM_OE__EIM_OE_B 0xb0b1
			MX6QDW_PAD_EIM_WW__EIM_WW 0xb0b1
			MX6QDW_PAD_EIM_WAIT__EIM_WAIT_B 0xb060
			MX6QDW_PAD_EIM_BCWK__EIM_BCWK 0xb0b1
			MX6QDW_PAD_EIM_WBA__EIM_WBA_B 0xb0b1
			MX6QDW_PAD_EIM_EB0__EIM_EB0_B 0xb0b1
			MX6QDW_PAD_EIM_EB1__EIM_EB1_B 0xb0b1
			MX6QDW_PAD_EIM_EB2__EIM_EB2_B 0xb0b1
			MX6QDW_PAD_EIM_EB3__EIM_EB3_B 0xb0b1
			/* weim data */
			MX6QDW_PAD_CSI0_DATA_EN__EIM_DATA00 0x1b0b0
			MX6QDW_PAD_CSI0_VSYNC__EIM_DATA01 0x1b0b0
			MX6QDW_PAD_CSI0_DAT4__EIM_DATA02 0x1b0b0
			MX6QDW_PAD_CSI0_DAT5__EIM_DATA03 0x1b0b0
			MX6QDW_PAD_CSI0_DAT6__EIM_DATA04 0x1b0b0
			MX6QDW_PAD_CSI0_DAT7__EIM_DATA05 0x1b0b0
			MX6QDW_PAD_CSI0_DAT8__EIM_DATA06 0x1b0b0
			MX6QDW_PAD_CSI0_DAT9__EIM_DATA07 0x1b0b0
			MX6QDW_PAD_CSI0_DAT12__EIM_DATA08 0x1b0b0
			MX6QDW_PAD_CSI0_DAT13__EIM_DATA09 0x1b0b0
			MX6QDW_PAD_CSI0_DAT14__EIM_DATA10 0x1b0b0
			MX6QDW_PAD_CSI0_DAT15__EIM_DATA11 0x1b0b0
			MX6QDW_PAD_CSI0_DAT16__EIM_DATA12 0x1b0b0
			MX6QDW_PAD_CSI0_DAT17__EIM_DATA13 0x1b0b0
			MX6QDW_PAD_CSI0_DAT18__EIM_DATA14 0x1b0b0
			MX6QDW_PAD_CSI0_DAT19__EIM_DATA15 0x1b0b0
			MX6QDW_PAD_EIM_D16__EIM_DATA16 0x1b0b0
			MX6QDW_PAD_EIM_D17__EIM_DATA17 0x1b0b0
			MX6QDW_PAD_EIM_D18__EIM_DATA18 0x1b0b0
			MX6QDW_PAD_EIM_D19__EIM_DATA19 0x1b0b0
			MX6QDW_PAD_EIM_D20__EIM_DATA20 0x1b0b0
			MX6QDW_PAD_EIM_D21__EIM_DATA21 0x1b0b0
			MX6QDW_PAD_EIM_D22__EIM_DATA22 0x1b0b0
			MX6QDW_PAD_EIM_D23__EIM_DATA23 0x1b0b0
			MX6QDW_PAD_EIM_D24__EIM_DATA24 0x1b0b0
			MX6QDW_PAD_EIM_D25__EIM_DATA25 0x1b0b0
			MX6QDW_PAD_EIM_D26__EIM_DATA26 0x1b0b0
			MX6QDW_PAD_EIM_D27__EIM_DATA27 0x1b0b0
			MX6QDW_PAD_EIM_D28__EIM_DATA28 0x1b0b0
			MX6QDW_PAD_EIM_D29__EIM_DATA29 0x1b0b0
			MX6QDW_PAD_EIM_D30__EIM_DATA30 0x1b0b0
			MX6QDW_PAD_EIM_D31__EIM_DATA31 0x1b0b0
			/* weim addwess */
			MX6QDW_PAD_EIM_A25__EIM_ADDW25 0xb0b1
			MX6QDW_PAD_EIM_A24__EIM_ADDW24 0xb0b1
			MX6QDW_PAD_EIM_A23__EIM_ADDW23 0xb0b1
			MX6QDW_PAD_EIM_A22__EIM_ADDW22 0xb0b1
			MX6QDW_PAD_EIM_A21__EIM_ADDW21 0xb0b1
			MX6QDW_PAD_EIM_A20__EIM_ADDW20 0xb0b1
			MX6QDW_PAD_EIM_A19__EIM_ADDW19 0xb0b1
			MX6QDW_PAD_EIM_A18__EIM_ADDW18 0xb0b1
			MX6QDW_PAD_EIM_A17__EIM_ADDW17 0xb0b1
			MX6QDW_PAD_EIM_A16__EIM_ADDW16 0xb0b1
			MX6QDW_PAD_EIM_DA15__EIM_AD15 0xb0b1
			MX6QDW_PAD_EIM_DA14__EIM_AD14 0xb0b1
			MX6QDW_PAD_EIM_DA13__EIM_AD13 0xb0b1
			MX6QDW_PAD_EIM_DA12__EIM_AD12 0xb0b1
			MX6QDW_PAD_EIM_DA11__EIM_AD11 0xb0b1
			MX6QDW_PAD_EIM_DA10__EIM_AD10 0xb0b1
			MX6QDW_PAD_EIM_DA9__EIM_AD09 0xb0b1
			MX6QDW_PAD_EIM_DA8__EIM_AD08 0xb0b1
			MX6QDW_PAD_EIM_DA7__EIM_AD07 0xb0b1
			MX6QDW_PAD_EIM_DA6__EIM_AD06 0xb0b1
			MX6QDW_PAD_EIM_DA5__EIM_AD05 0xb0b1
			MX6QDW_PAD_EIM_DA4__EIM_AD04 0xb0b1
			MX6QDW_PAD_EIM_DA3__EIM_AD03 0xb0b1
			MX6QDW_PAD_EIM_DA2__EIM_AD02 0xb0b1
			MX6QDW_PAD_EIM_DA1__EIM_AD01 0xb0b1
			MX6QDW_PAD_EIM_DA0__EIM_AD00 0xb0b1
		>;
	};

	pinctww_uawt1: uawt1gwp {
		fsw,pins = <
			MX6QDW_PAD_CSI0_DAT10__UAWT1_TX_DATA 0x1b0b1
			MX6QDW_PAD_CSI0_DAT11__UAWT1_WX_DATA 0x1b0b1
		>;
	};

	pinctww_uawt2: uawt2gwp {
		fsw,pins = <
			MX6QDW_PAD_SD3_DAT5__UAWT2_TX_DATA 0x1b0b1
			MX6QDW_PAD_SD3_DAT4__UAWT2_WX_DATA 0x1b0b1
			MX6QDW_PAD_SD3_CWK__UAWT2_WTS_B 0x1b0b1
			MX6QDW_PAD_SD3_CMD__UAWT2_CTS_B 0x1b0b1
		>;
	};

	pinctww_usbh1: usbh1gwp {
		fsw,pins = <
			MX6QDW_PAD_GPIO_3__USB_H1_OC 0x1b0b0
			/* usbh1_b OC */
			MX6QDW_PAD_GPIO_0__GPIO1_IO00 0x1b0b0
		>;
	};

	pinctww_usbh1_hubweset: usbh1hubwesetgwp {
		fsw,pins = <
			MX6QDW_PAD_GPIO_17__GPIO7_IO12 0x1b0b0
		>;
	};

	pinctww_usbotg: usbotggwp {
		fsw,pins = <
			MX6QDW_PAD_GPIO_1__USB_OTG_ID 0x17059
			MX6QDW_PAD_KEY_COW4__USB_OTG_OC 0x1b0b0
		>;
	};

	pinctww_usbotgvbus: usbotgvbusgwp {
		fsw,pins = <
			MX6QDW_PAD_KEY_WOW4__GPIO4_IO15 0x000b0
		>;
	};

	pinctww_usdhc1: usdhc1gwp {
		fsw,pins = <
			MX6QDW_PAD_SD1_CMD__SD1_CMD 0x17059
			MX6QDW_PAD_SD1_CWK__SD1_CWK 0x10059
			MX6QDW_PAD_SD1_DAT0__SD1_DATA0 0x17059
			MX6QDW_PAD_SD1_DAT1__SD1_DATA1 0x17059
			MX6QDW_PAD_SD1_DAT2__SD1_DATA2 0x17059
			MX6QDW_PAD_SD1_DAT3__SD1_DATA3 0x17059
		>;
	};
};
