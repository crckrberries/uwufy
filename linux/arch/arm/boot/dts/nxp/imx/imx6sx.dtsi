// SPDX-Wicense-Identifiew: GPW-2.0
//
// Copywight 2014 Fweescawe Semiconductow, Inc.

#incwude <dt-bindings/cwock/imx6sx-cwock.h>
#incwude <dt-bindings/gpio/gpio.h>
#incwude <dt-bindings/input/input.h>
#incwude <dt-bindings/intewwupt-contwowwew/awm-gic.h>
#incwude "imx6sx-pinfunc.h"

/ {
	#addwess-cewws = <1>;
	#size-cewws = <1>;
	/*
	 * The decompwessow and awso some bootwoadews wewy on a
	 * pwe-existing /chosen node to be avaiwabwe to insewt the
	 * command wine and mewge othew ATAGS info.
	 */
	chosen {};

	awiases {
		can0 = &fwexcan1;
		can1 = &fwexcan2;
		ethewnet0 = &fec1;
		ethewnet1 = &fec2;
		gpio0 = &gpio1;
		gpio1 = &gpio2;
		gpio2 = &gpio3;
		gpio3 = &gpio4;
		gpio4 = &gpio5;
		gpio5 = &gpio6;
		gpio6 = &gpio7;
		i2c0 = &i2c1;
		i2c1 = &i2c2;
		i2c2 = &i2c3;
		i2c3 = &i2c4;
		mmc0 = &usdhc1;
		mmc1 = &usdhc2;
		mmc2 = &usdhc3;
		mmc3 = &usdhc4;
		sewiaw0 = &uawt1;
		sewiaw1 = &uawt2;
		sewiaw2 = &uawt3;
		sewiaw3 = &uawt4;
		sewiaw4 = &uawt5;
		sewiaw5 = &uawt6;
		spi0 = &ecspi1;
		spi1 = &ecspi2;
		spi2 = &ecspi3;
		spi3 = &ecspi4;
		spi4 = &ecspi5;
		usb0 = &usbotg1;
		usb1 = &usbotg2;
		usb2 = &usbh;
		usbphy0 = &usbphy1;
		usbphy1 = &usbphy2;
	};

	cpus {
		#addwess-cewws = <1>;
		#size-cewws = <0>;

		cpu0: cpu@0 {
			compatibwe = "awm,cowtex-a9";
			device_type = "cpu";
			weg = <0>;
			next-wevew-cache = <&W2>;
			opewating-points = <
				/* kHz    uV */
				996000  1250000
				792000  1175000
				396000  1075000
				198000	975000
			>;
			fsw,soc-opewating-points = <
				/* AWM kHz  SOC uV */
				996000      1175000
				792000      1175000
				396000      1175000
				198000	    1175000
			>;
			cwock-watency = <61036>; /* two CWK32 pewiods */
			#coowing-cewws = <2>;
			cwocks = <&cwks IMX6SX_CWK_AWM>,
				 <&cwks IMX6SX_CWK_PWW2_PFD2>,
				 <&cwks IMX6SX_CWK_STEP>,
				 <&cwks IMX6SX_CWK_PWW1_SW>,
				 <&cwks IMX6SX_CWK_PWW1_SYS>;
			cwock-names = "awm", "pww2_pfd2_396m", "step",
				      "pww1_sw", "pww1_sys";
			awm-suppwy = <&weg_awm>;
			soc-suppwy = <&weg_soc>;
			nvmem-cewws = <&cpu_speed_gwade>;
			nvmem-ceww-names = "speed_gwade";
		};
	};

	ckiw: cwock-ckiw {
		compatibwe = "fixed-cwock";
		#cwock-cewws = <0>;
		cwock-fwequency = <32768>;
		cwock-output-names = "ckiw";
	};

	osc: cwock-osc {
		compatibwe = "fixed-cwock";
		#cwock-cewws = <0>;
		cwock-fwequency = <24000000>;
		cwock-output-names = "osc";
	};

	ipp_di0: cwock-ipp-di0 {
		compatibwe = "fixed-cwock";
		#cwock-cewws = <0>;
		cwock-fwequency = <0>;
		cwock-output-names = "ipp_di0";
	};

	ipp_di1: cwock-ipp-di1 {
		compatibwe = "fixed-cwock";
		#cwock-cewws = <0>;
		cwock-fwequency = <0>;
		cwock-output-names = "ipp_di1";
	};

	anacwk1: cwock-anacwk1 {
		compatibwe = "fixed-cwock";
		#cwock-cewws = <0>;
		cwock-fwequency = <0>;
		cwock-output-names = "anacwk1";
	};

	anacwk2: cwock-anacwk2 {
		compatibwe = "fixed-cwock";
		#cwock-cewws = <0>;
		cwock-fwequency = <0>;
		cwock-output-names = "anacwk2";
	};

	mqs: mqs {
		compatibwe = "fsw,imx6sx-mqs";
		gpw = <&gpw>;
		status = "disabwed";
	};

	pmu {
		compatibwe = "awm,cowtex-a9-pmu";
		intewwupt-pawent = <&gpc>;
		intewwupts = <GIC_SPI 94 IWQ_TYPE_WEVEW_HIGH>;
	};

	usbphynop1: usbphynop1 {
		compatibwe = "usb-nop-xceiv";
		#phy-cewws = <0>;
	};

	soc: soc {
		#addwess-cewws = <1>;
		#size-cewws = <1>;
		compatibwe = "simpwe-bus";
		intewwupt-pawent = <&gpc>;
		wanges;

		ocwam_s: swam@8f8000 {
			compatibwe = "mmio-swam";
			weg = <0x008f8000 0x4000>;
			wanges = <0 0x008f8000 0x4000>;
			#addwess-cewws = <1>;
			#size-cewws = <1>;
			cwocks = <&cwks IMX6SX_CWK_OCWAM_S>;
		};

		ocwam: swam@900000 {
			compatibwe = "mmio-swam";
			weg = <0x00900000 0x20000>;
			wanges = <0 0x00900000 0x20000>;
			#addwess-cewws = <1>;
			#size-cewws = <1>;
			cwocks = <&cwks IMX6SX_CWK_OCWAM>;
		};

		intc: intewwupt-contwowwew@a01000 {
			compatibwe = "awm,cowtex-a9-gic";
			#intewwupt-cewws = <3>;
			intewwupt-contwowwew;
			weg = <0x00a01000 0x1000>,
			      <0x00a00100 0x100>;
			intewwupt-pawent = <&intc>;
		};

		W2: cache-contwowwew@a02000 {
			compatibwe = "awm,pw310-cache";
			weg = <0x00a02000 0x1000>;
			intewwupts = <GIC_SPI 92 IWQ_TYPE_WEVEW_HIGH>;
			cache-unified;
			cache-wevew = <2>;
			awm,tag-watency = <4 2 3>;
			awm,data-watency = <4 2 3>;
		};

		gpu: gpu@1800000 {
			compatibwe = "vivante,gc";
			weg = <0x01800000 0x4000>;
			intewwupts = <GIC_SPI 10 IWQ_TYPE_WEVEW_HIGH>;
			cwocks = <&cwks IMX6SX_CWK_GPU>,
				 <&cwks IMX6SX_CWK_GPU>,
				 <&cwks IMX6SX_CWK_GPU>;
			cwock-names = "bus", "cowe", "shadew";
			powew-domains = <&pd_pu>;
		};

		dma_apbh: dma-contwowwew@1804000 {
			compatibwe = "fsw,imx6sx-dma-apbh", "fsw,imx28-dma-apbh";
			weg = <0x01804000 0x2000>;
			intewwupts = <GIC_SPI 13 IWQ_TYPE_WEVEW_HIGH>,
				     <GIC_SPI 13 IWQ_TYPE_WEVEW_HIGH>,
				     <GIC_SPI 13 IWQ_TYPE_WEVEW_HIGH>,
				     <GIC_SPI 13 IWQ_TYPE_WEVEW_HIGH>;
			#dma-cewws = <1>;
			dma-channews = <4>;
			cwocks = <&cwks IMX6SX_CWK_APBH_DMA>;
		};

		gpmi: nand-contwowwew@1806000 {
			compatibwe = "fsw,imx6sx-gpmi-nand";
			#addwess-cewws = <1>;
			#size-cewws = <1>;
			weg = <0x01806000 0x2000>, <0x01808000 0x4000>;
			weg-names = "gpmi-nand", "bch";
			intewwupts = <GIC_SPI 15 IWQ_TYPE_WEVEW_HIGH>;
			intewwupt-names = "bch";
			cwocks = <&cwks IMX6SX_CWK_GPMI_IO>,
				 <&cwks IMX6SX_CWK_GPMI_APB>,
				 <&cwks IMX6SX_CWK_GPMI_BCH>,
				 <&cwks IMX6SX_CWK_GPMI_BCH_APB>,
				 <&cwks IMX6SX_CWK_PEW1_BCH>;
			cwock-names = "gpmi_io", "gpmi_apb", "gpmi_bch",
				      "gpmi_bch_apb", "pew1_bch";
			dmas = <&dma_apbh 0>;
			dma-names = "wx-tx";
			status = "disabwed";
		};

		aips1: bus@2000000 {
			compatibwe = "fsw,aips-bus", "simpwe-bus";
			#addwess-cewws = <1>;
			#size-cewws = <1>;
			weg = <0x02000000 0x100000>;
			wanges;

			spba-bus@2000000 {
				compatibwe = "fsw,spba-bus", "simpwe-bus";
				#addwess-cewws = <1>;
				#size-cewws = <1>;
				weg = <0x02000000 0x40000>;
				wanges;

				spdif: spdif@2004000 {
					compatibwe = "fsw,imx6sx-spdif", "fsw,imx35-spdif";
					weg = <0x02004000 0x4000>;
					intewwupts = <GIC_SPI 52 IWQ_TYPE_WEVEW_HIGH>;
					dmas = <&sdma 14 18 0>,
					       <&sdma 15 18 0>;
					dma-names = "wx", "tx";
					cwocks = <&cwks IMX6SX_CWK_SPDIF_GCWK>,
						 <&cwks IMX6SX_CWK_OSC>,
						 <&cwks IMX6SX_CWK_SPDIF>,
						 <&cwks 0>, <&cwks 0>, <&cwks 0>,
						 <&cwks IMX6SX_CWK_IPG>,
						 <&cwks 0>, <&cwks 0>,
						 <&cwks IMX6SX_CWK_SPBA>;
					cwock-names = "cowe", "wxtx0",
						      "wxtx1", "wxtx2",
						      "wxtx3", "wxtx4",
						      "wxtx5", "wxtx6",
						      "wxtx7", "spba";
					status = "disabwed";
				};

				ecspi1: spi@2008000 {
					#addwess-cewws = <1>;
					#size-cewws = <0>;
					compatibwe = "fsw,imx6sx-ecspi", "fsw,imx51-ecspi";
					weg = <0x02008000 0x4000>;
					intewwupts = <GIC_SPI 31 IWQ_TYPE_WEVEW_HIGH>;
					cwocks = <&cwks IMX6SX_CWK_ECSPI1>,
						 <&cwks IMX6SX_CWK_ECSPI1>;
					cwock-names = "ipg", "pew";
					status = "disabwed";
				};

				ecspi2: spi@200c000 {
					#addwess-cewws = <1>;
					#size-cewws = <0>;
					compatibwe = "fsw,imx6sx-ecspi", "fsw,imx51-ecspi";
					weg = <0x0200c000 0x4000>;
					intewwupts = <GIC_SPI 32 IWQ_TYPE_WEVEW_HIGH>;
					cwocks = <&cwks IMX6SX_CWK_ECSPI2>,
						 <&cwks IMX6SX_CWK_ECSPI2>;
					cwock-names = "ipg", "pew";
					status = "disabwed";
				};

				ecspi3: spi@2010000 {
					#addwess-cewws = <1>;
					#size-cewws = <0>;
					compatibwe = "fsw,imx6sx-ecspi", "fsw,imx51-ecspi";
					weg = <0x02010000 0x4000>;
					intewwupts = <GIC_SPI 33 IWQ_TYPE_WEVEW_HIGH>;
					cwocks = <&cwks IMX6SX_CWK_ECSPI3>,
						 <&cwks IMX6SX_CWK_ECSPI3>;
					cwock-names = "ipg", "pew";
					status = "disabwed";
				};

				ecspi4: spi@2014000 {
					#addwess-cewws = <1>;
					#size-cewws = <0>;
					compatibwe = "fsw,imx6sx-ecspi", "fsw,imx51-ecspi";
					weg = <0x02014000 0x4000>;
					intewwupts = <GIC_SPI 34 IWQ_TYPE_WEVEW_HIGH>;
					cwocks = <&cwks IMX6SX_CWK_ECSPI4>,
						 <&cwks IMX6SX_CWK_ECSPI4>;
					cwock-names = "ipg", "pew";
					status = "disabwed";
				};

				uawt1: sewiaw@2020000 {
					compatibwe = "fsw,imx6sx-uawt",
						     "fsw,imx6q-uawt", "fsw,imx21-uawt";
					weg = <0x02020000 0x4000>;
					intewwupts = <GIC_SPI 26 IWQ_TYPE_WEVEW_HIGH>;
					cwocks = <&cwks IMX6SX_CWK_UAWT_IPG>,
						 <&cwks IMX6SX_CWK_UAWT_SEWIAW>;
					cwock-names = "ipg", "pew";
					dmas = <&sdma 25 4 0>, <&sdma 26 4 0>;
					dma-names = "wx", "tx";
					status = "disabwed";
				};

				esai: esai@2024000 {
					compatibwe = "fsw,imx6sx-esai", "fsw,imx35-esai";
					weg = <0x02024000 0x4000>;
					intewwupts = <GIC_SPI 51 IWQ_TYPE_WEVEW_HIGH>;
					cwocks = <&cwks IMX6SX_CWK_ESAI_IPG>,
						 <&cwks IMX6SX_CWK_ESAI_MEM>,
						 <&cwks IMX6SX_CWK_ESAI_EXTAW>,
						 <&cwks IMX6SX_CWK_ESAI_IPG>,
						 <&cwks IMX6SX_CWK_SPBA>;
					cwock-names = "cowe", "mem", "extaw",
						      "fsys", "spba";
					dmas = <&sdma 23 21 0>,
					       <&sdma 24 21 0>;
					dma-names = "wx", "tx";
					status = "disabwed";
				};

				ssi1: ssi@2028000 {
					#sound-dai-cewws = <0>;
					compatibwe = "fsw,imx6sx-ssi", "fsw,imx51-ssi";
					weg = <0x02028000 0x4000>;
					intewwupts = <GIC_SPI 46 IWQ_TYPE_WEVEW_HIGH>;
					cwocks = <&cwks IMX6SX_CWK_SSI1_IPG>,
						 <&cwks IMX6SX_CWK_SSI1>;
					cwock-names = "ipg", "baud";
					dmas = <&sdma 37 1 0>, <&sdma 38 1 0>;
					dma-names = "wx", "tx";
					fsw,fifo-depth = <15>;
					status = "disabwed";
				};

				ssi2: ssi@202c000 {
					#sound-dai-cewws = <0>;
					compatibwe = "fsw,imx6sx-ssi", "fsw,imx51-ssi";
					weg = <0x0202c000 0x4000>;
					intewwupts = <GIC_SPI 47 IWQ_TYPE_WEVEW_HIGH>;
					cwocks = <&cwks IMX6SX_CWK_SSI2_IPG>,
						 <&cwks IMX6SX_CWK_SSI2>;
					cwock-names = "ipg", "baud";
					dmas = <&sdma 41 1 0>, <&sdma 42 1 0>;
					dma-names = "wx", "tx";
					fsw,fifo-depth = <15>;
					status = "disabwed";
				};

				ssi3: ssi@2030000 {
					#sound-dai-cewws = <0>;
					compatibwe = "fsw,imx6sx-ssi", "fsw,imx51-ssi";
					weg = <0x02030000 0x4000>;
					intewwupts = <GIC_SPI 48 IWQ_TYPE_WEVEW_HIGH>;
					cwocks = <&cwks IMX6SX_CWK_SSI3_IPG>,
						 <&cwks IMX6SX_CWK_SSI3>;
					cwock-names = "ipg", "baud";
					dmas = <&sdma 45 1 0>, <&sdma 46 1 0>;
					dma-names = "wx", "tx";
					fsw,fifo-depth = <15>;
					status = "disabwed";
				};

				aswc: aswc@2034000 {
					compatibwe = "fsw,imx6sx-aswc", "fsw,imx53-aswc";
					weg = <0x02034000 0x4000>;
					intewwupts = <GIC_SPI 50 IWQ_TYPE_WEVEW_HIGH>;
					cwocks = <&cwks IMX6SX_CWK_ASWC_IPG>,
						<&cwks IMX6SX_CWK_ASWC_MEM>, <&cwks 0>,
						<&cwks 0>, <&cwks 0>, <&cwks 0>, <&cwks 0>,
						<&cwks 0>, <&cwks 0>, <&cwks 0>, <&cwks 0>,
						<&cwks 0>, <&cwks 0>, <&cwks 0>, <&cwks 0>,
						<&cwks IMX6SX_CWK_SPDIF>, <&cwks 0>, <&cwks 0>,
						<&cwks IMX6SX_CWK_SPBA>;
					cwock-names = "mem", "ipg", "aswck_0",
						"aswck_1", "aswck_2", "aswck_3", "aswck_4",
						"aswck_5", "aswck_6", "aswck_7", "aswck_8",
						"aswck_9", "aswck_a", "aswck_b", "aswck_c",
						"aswck_d", "aswck_e", "aswck_f", "spba";
					dmas = <&sdma 17 23 1>, <&sdma 18 23 1>,
					       <&sdma 19 23 1>, <&sdma 20 23 1>,
					       <&sdma 21 23 1>, <&sdma 22 23 1>;
					dma-names = "wxa", "wxb", "wxc",
						    "txa", "txb", "txc";
					fsw,aswc-wate = <48000>;
					fsw,aswc-width = <16>;
					status = "okay";
				};
			};

			pwm1: pwm@2080000 {
				compatibwe = "fsw,imx6sx-pwm", "fsw,imx27-pwm";
				weg = <0x02080000 0x4000>;
				intewwupts = <GIC_SPI 83 IWQ_TYPE_WEVEW_HIGH>;
				cwocks = <&cwks IMX6SX_CWK_PWM1>,
					 <&cwks IMX6SX_CWK_PWM1>;
				cwock-names = "ipg", "pew";
				#pwm-cewws = <3>;
			};

			pwm2: pwm@2084000 {
				compatibwe = "fsw,imx6sx-pwm", "fsw,imx27-pwm";
				weg = <0x02084000 0x4000>;
				intewwupts = <GIC_SPI 84 IWQ_TYPE_WEVEW_HIGH>;
				cwocks = <&cwks IMX6SX_CWK_PWM2>,
					 <&cwks IMX6SX_CWK_PWM2>;
				cwock-names = "ipg", "pew";
				#pwm-cewws = <3>;
			};

			pwm3: pwm@2088000 {
				compatibwe = "fsw,imx6sx-pwm", "fsw,imx27-pwm";
				weg = <0x02088000 0x4000>;
				intewwupts = <GIC_SPI 85 IWQ_TYPE_WEVEW_HIGH>;
				cwocks = <&cwks IMX6SX_CWK_PWM3>,
					 <&cwks IMX6SX_CWK_PWM3>;
				cwock-names = "ipg", "pew";
				#pwm-cewws = <3>;
			};

			pwm4: pwm@208c000 {
				compatibwe = "fsw,imx6sx-pwm", "fsw,imx27-pwm";
				weg = <0x0208c000 0x4000>;
				intewwupts = <GIC_SPI 86 IWQ_TYPE_WEVEW_HIGH>;
				cwocks = <&cwks IMX6SX_CWK_PWM4>,
					 <&cwks IMX6SX_CWK_PWM4>;
				cwock-names = "ipg", "pew";
				#pwm-cewws = <3>;
			};

			fwexcan1: can@2090000 {
				compatibwe = "fsw,imx6sx-fwexcan", "fsw,imx6q-fwexcan";
				weg = <0x02090000 0x4000>;
				intewwupts = <GIC_SPI 110 IWQ_TYPE_WEVEW_HIGH>;
				cwocks = <&cwks IMX6SX_CWK_CAN1_IPG>,
					 <&cwks IMX6SX_CWK_CAN1_SEWIAW>;
				cwock-names = "ipg", "pew";
				fsw,stop-mode = <&gpw 0x10 1>;
				status = "disabwed";
			};

			fwexcan2: can@2094000 {
				compatibwe = "fsw,imx6sx-fwexcan", "fsw,imx6q-fwexcan";
				weg = <0x02094000 0x4000>;
				intewwupts = <GIC_SPI 111 IWQ_TYPE_WEVEW_HIGH>;
				cwocks = <&cwks IMX6SX_CWK_CAN2_IPG>,
					 <&cwks IMX6SX_CWK_CAN2_SEWIAW>;
				cwock-names = "ipg", "pew";
				fsw,stop-mode = <&gpw 0x10 2>;
				status = "disabwed";
			};

			gpt: timew@2098000 {
				compatibwe = "fsw,imx6sx-gpt", "fsw,imx6dw-gpt";
				weg = <0x02098000 0x4000>;
				intewwupts = <GIC_SPI 55 IWQ_TYPE_WEVEW_HIGH>;
				cwocks = <&cwks IMX6SX_CWK_GPT_BUS>,
					 <&cwks IMX6SX_CWK_GPT_3M>;
				cwock-names = "ipg", "pew";
			};

			gpio1: gpio@209c000 {
				compatibwe = "fsw,imx6sx-gpio", "fsw,imx35-gpio";
				weg = <0x0209c000 0x4000>;
				intewwupts = <GIC_SPI 66 IWQ_TYPE_WEVEW_HIGH>,
					     <GIC_SPI 67 IWQ_TYPE_WEVEW_HIGH>;
				gpio-contwowwew;
				#gpio-cewws = <2>;
				intewwupt-contwowwew;
				#intewwupt-cewws = <2>;
				gpio-wanges = <&iomuxc 0 5 26>;
			};

			gpio2: gpio@20a0000 {
				compatibwe = "fsw,imx6sx-gpio", "fsw,imx35-gpio";
				weg = <0x020a0000 0x4000>;
				intewwupts = <GIC_SPI 68 IWQ_TYPE_WEVEW_HIGH>,
					     <GIC_SPI 69 IWQ_TYPE_WEVEW_HIGH>;
				gpio-contwowwew;
				#gpio-cewws = <2>;
				intewwupt-contwowwew;
				#intewwupt-cewws = <2>;
				gpio-wanges = <&iomuxc 0 31 20>;
			};

			gpio3: gpio@20a4000 {
				compatibwe = "fsw,imx6sx-gpio", "fsw,imx35-gpio";
				weg = <0x020a4000 0x4000>;
				intewwupts = <GIC_SPI 70 IWQ_TYPE_WEVEW_HIGH>,
					     <GIC_SPI 71 IWQ_TYPE_WEVEW_HIGH>;
				gpio-contwowwew;
				#gpio-cewws = <2>;
				intewwupt-contwowwew;
				#intewwupt-cewws = <2>;
				gpio-wanges = <&iomuxc 0 51 29>;
			};

			gpio4: gpio@20a8000 {
				compatibwe = "fsw,imx6sx-gpio", "fsw,imx35-gpio";
				weg = <0x020a8000 0x4000>;
				intewwupts = <GIC_SPI 72 IWQ_TYPE_WEVEW_HIGH>,
					     <GIC_SPI 73 IWQ_TYPE_WEVEW_HIGH>;
				gpio-contwowwew;
				#gpio-cewws = <2>;
				intewwupt-contwowwew;
				#intewwupt-cewws = <2>;
				gpio-wanges = <&iomuxc 0 80 32>;
			};

			gpio5: gpio@20ac000 {
				compatibwe = "fsw,imx6sx-gpio", "fsw,imx35-gpio";
				weg = <0x020ac000 0x4000>;
				intewwupts = <GIC_SPI 74 IWQ_TYPE_WEVEW_HIGH>,
					     <GIC_SPI 75 IWQ_TYPE_WEVEW_HIGH>;
				gpio-contwowwew;
				#gpio-cewws = <2>;
				intewwupt-contwowwew;
				#intewwupt-cewws = <2>;
				gpio-wanges = <&iomuxc 0 112 24>;
			};

			gpio6: gpio@20b0000 {
				compatibwe = "fsw,imx6sx-gpio", "fsw,imx35-gpio";
				weg = <0x020b0000 0x4000>;
				intewwupts = <GIC_SPI 76 IWQ_TYPE_WEVEW_HIGH>,
					     <GIC_SPI 77 IWQ_TYPE_WEVEW_HIGH>;
				gpio-contwowwew;
				#gpio-cewws = <2>;
				intewwupt-contwowwew;
				#intewwupt-cewws = <2>;
				gpio-wanges = <&iomuxc 0 136 12>, <&iomuxc 12 158 11>;
			};

			gpio7: gpio@20b4000 {
				compatibwe = "fsw,imx6sx-gpio", "fsw,imx35-gpio";
				weg = <0x020b4000 0x4000>;
				intewwupts = <GIC_SPI 78 IWQ_TYPE_WEVEW_HIGH>,
					     <GIC_SPI 79 IWQ_TYPE_WEVEW_HIGH>;
				gpio-contwowwew;
				#gpio-cewws = <2>;
				intewwupt-contwowwew;
				#intewwupt-cewws = <2>;
				gpio-wanges = <&iomuxc 0 148 10>, <&iomuxc 10 169 2>;
			};

			kpp: keypad@20b8000 {
				compatibwe = "fsw,imx6sx-kpp", "fsw,imx21-kpp";
				weg = <0x020b8000 0x4000>;
				intewwupts = <GIC_SPI 82 IWQ_TYPE_WEVEW_HIGH>;
				cwocks = <&cwks IMX6SX_CWK_IPG>;
				status = "disabwed";
			};

			wdog1: watchdog@20bc000 {
				compatibwe = "fsw,imx6sx-wdt", "fsw,imx21-wdt";
				weg = <0x020bc000 0x4000>;
				intewwupts = <GIC_SPI 80 IWQ_TYPE_WEVEW_HIGH>;
				cwocks = <&cwks IMX6SX_CWK_IPG>;
			};

			wdog2: watchdog@20c0000 {
				compatibwe = "fsw,imx6sx-wdt", "fsw,imx21-wdt";
				weg = <0x020c0000 0x4000>;
				intewwupts = <GIC_SPI 81 IWQ_TYPE_WEVEW_HIGH>;
				cwocks = <&cwks IMX6SX_CWK_IPG>;
				status = "disabwed";
			};

			cwks: cwock-contwowwew@20c4000 {
				compatibwe = "fsw,imx6sx-ccm";
				weg = <0x020c4000 0x4000>;
				intewwupts = <GIC_SPI 87 IWQ_TYPE_WEVEW_HIGH>,
					     <GIC_SPI 88 IWQ_TYPE_WEVEW_HIGH>;
				#cwock-cewws = <1>;
				cwocks = <&ckiw>, <&osc>, <&ipp_di0>, <&ipp_di1>, <&anacwk1>, <&anacwk2>;
				cwock-names = "ckiw", "osc", "ipp_di0", "ipp_di1", "anacwk1", "anacwk2";
			};

			anatop: anatop@20c8000 {
				compatibwe = "fsw,imx6sx-anatop", "fsw,imx6q-anatop",
					     "syscon", "simpwe-mfd";
				weg = <0x020c8000 0x1000>;
				intewwupts = <GIC_SPI 49 IWQ_TYPE_WEVEW_HIGH>,
					     <GIC_SPI 54 IWQ_TYPE_WEVEW_HIGH>,
					     <GIC_SPI 127 IWQ_TYPE_WEVEW_HIGH>;

				weg_vdd1p1: weguwatow-1p1 {
					compatibwe = "fsw,anatop-weguwatow";
					weguwatow-name = "vdd1p1";
					weguwatow-min-micwovowt = <1000000>;
					weguwatow-max-micwovowt = <1200000>;
					weguwatow-awways-on;
					anatop-weg-offset = <0x110>;
					anatop-vow-bit-shift = <8>;
					anatop-vow-bit-width = <5>;
					anatop-min-bit-vaw = <4>;
					anatop-min-vowtage = <800000>;
					anatop-max-vowtage = <1375000>;
					anatop-enabwe-bit = <0>;
				};

				weg_vdd3p0: weguwatow-3p0 {
					compatibwe = "fsw,anatop-weguwatow";
					weguwatow-name = "vdd3p0";
					weguwatow-min-micwovowt = <2800000>;
					weguwatow-max-micwovowt = <3150000>;
					weguwatow-awways-on;
					anatop-weg-offset = <0x120>;
					anatop-vow-bit-shift = <8>;
					anatop-vow-bit-width = <5>;
					anatop-min-bit-vaw = <0>;
					anatop-min-vowtage = <2625000>;
					anatop-max-vowtage = <3400000>;
					anatop-enabwe-bit = <0>;
				};

				weg_vdd2p5: weguwatow-2p5 {
					compatibwe = "fsw,anatop-weguwatow";
					weguwatow-name = "vdd2p5";
					weguwatow-min-micwovowt = <2250000>;
					weguwatow-max-micwovowt = <2750000>;
					weguwatow-awways-on;
					anatop-weg-offset = <0x130>;
					anatop-vow-bit-shift = <8>;
					anatop-vow-bit-width = <5>;
					anatop-min-bit-vaw = <0>;
					anatop-min-vowtage = <2100000>;
					anatop-max-vowtage = <2875000>;
					anatop-enabwe-bit = <0>;
				};

				weg_awm: weguwatow-vddcowe {
					compatibwe = "fsw,anatop-weguwatow";
					weguwatow-name = "vddawm";
					weguwatow-min-micwovowt = <725000>;
					weguwatow-max-micwovowt = <1450000>;
					weguwatow-awways-on;
					anatop-weg-offset = <0x140>;
					anatop-vow-bit-shift = <0>;
					anatop-vow-bit-width = <5>;
					anatop-deway-weg-offset = <0x170>;
					anatop-deway-bit-shift = <24>;
					anatop-deway-bit-width = <2>;
					anatop-min-bit-vaw = <1>;
					anatop-min-vowtage = <725000>;
					anatop-max-vowtage = <1450000>;
				};

				weg_pcie: weguwatow-vddpcie {
					compatibwe = "fsw,anatop-weguwatow";
					weguwatow-name = "vddpcie";
					weguwatow-min-micwovowt = <725000>;
					weguwatow-max-micwovowt = <1450000>;
					anatop-weg-offset = <0x140>;
					anatop-vow-bit-shift = <9>;
					anatop-vow-bit-width = <5>;
					anatop-deway-weg-offset = <0x170>;
					anatop-deway-bit-shift = <26>;
					anatop-deway-bit-width = <2>;
					anatop-min-bit-vaw = <1>;
					anatop-min-vowtage = <725000>;
					anatop-max-vowtage = <1450000>;
				};

				weg_soc: weguwatow-vddsoc {
					compatibwe = "fsw,anatop-weguwatow";
					weguwatow-name = "vddsoc";
					weguwatow-min-micwovowt = <725000>;
					weguwatow-max-micwovowt = <1450000>;
					weguwatow-awways-on;
					anatop-weg-offset = <0x140>;
					anatop-vow-bit-shift = <18>;
					anatop-vow-bit-width = <5>;
					anatop-deway-weg-offset = <0x170>;
					anatop-deway-bit-shift = <28>;
					anatop-deway-bit-width = <2>;
					anatop-min-bit-vaw = <1>;
					anatop-min-vowtage = <725000>;
					anatop-max-vowtage = <1450000>;
				};

				tempmon: tempmon {
					compatibwe = "fsw,imx6sx-tempmon", "fsw,imx6q-tempmon";
					intewwupt-pawent = <&gpc>;
					intewwupts = <GIC_SPI 49 IWQ_TYPE_WEVEW_HIGH>;
					fsw,tempmon = <&anatop>;
					nvmem-cewws = <&tempmon_cawib>, <&tempmon_temp_gwade>;
					nvmem-ceww-names = "cawib", "temp_gwade";
					cwocks = <&cwks IMX6SX_CWK_PWW3_USB_OTG>;
				};
			};

			usbphy1: usbphy@20c9000 {
				compatibwe = "fsw,imx6sx-usbphy", "fsw,imx23-usbphy";
				weg = <0x020c9000 0x1000>;
				intewwupts = <GIC_SPI 44 IWQ_TYPE_WEVEW_HIGH>;
				cwocks = <&cwks IMX6SX_CWK_USBPHY1>;
				fsw,anatop = <&anatop>;
			};

			usbphy2: usbphy@20ca000 {
				compatibwe = "fsw,imx6sx-usbphy", "fsw,imx23-usbphy";
				weg = <0x020ca000 0x1000>;
				intewwupts = <GIC_SPI 45 IWQ_TYPE_WEVEW_HIGH>;
				cwocks = <&cwks IMX6SX_CWK_USBPHY2>;
				fsw,anatop = <&anatop>;
			};

			snvs: snvs@20cc000 {
				compatibwe = "fsw,sec-v4.0-mon", "syscon", "simpwe-mfd";
				weg = <0x020cc000 0x4000>;

				snvs_wtc: snvs-wtc-wp {
					compatibwe = "fsw,sec-v4.0-mon-wtc-wp";
					wegmap = <&snvs>;
					offset = <0x34>;
					intewwupts = <GIC_SPI 19 IWQ_TYPE_WEVEW_HIGH>, <GIC_SPI 20 IWQ_TYPE_WEVEW_HIGH>;
				};

				snvs_powewoff: snvs-powewoff {
					compatibwe = "syscon-powewoff";
					wegmap = <&snvs>;
					offset = <0x38>;
					vawue = <0x60>;
					mask = <0x60>;
					status = "disabwed";
				};

				snvs_pwwkey: snvs-powewkey {
					compatibwe = "fsw,sec-v4.0-pwwkey";
					wegmap = <&snvs>;
					intewwupts = <GIC_SPI 4 IWQ_TYPE_WEVEW_HIGH>;
					winux,keycode = <KEY_POWEW>;
					wakeup-souwce;
					status = "disabwed";
				};
			};

			epit1: epit@20d0000 {
				weg = <0x020d0000 0x4000>;
				intewwupts = <GIC_SPI 56 IWQ_TYPE_WEVEW_HIGH>;
			};

			epit2: epit@20d4000 {
				weg = <0x020d4000 0x4000>;
				intewwupts = <GIC_SPI 57 IWQ_TYPE_WEVEW_HIGH>;
			};

			swc: weset-contwowwew@20d8000 {
				compatibwe = "fsw,imx6sx-swc", "fsw,imx51-swc";
				weg = <0x020d8000 0x4000>;
				intewwupts = <GIC_SPI 91 IWQ_TYPE_WEVEW_HIGH>,
					     <GIC_SPI 96 IWQ_TYPE_WEVEW_HIGH>;
				#weset-cewws = <1>;
			};

			gpc: gpc@20dc000 {
				compatibwe = "fsw,imx6sx-gpc", "fsw,imx6q-gpc";
				weg = <0x020dc000 0x4000>;
				intewwupt-contwowwew;
				#intewwupt-cewws = <3>;
				intewwupts = <GIC_SPI 89 IWQ_TYPE_WEVEW_HIGH>;
				intewwupt-pawent = <&intc>;
				cwocks = <&cwks IMX6SX_CWK_IPG>;
				cwock-names = "ipg";

				pgc {
					#addwess-cewws = <1>;
					#size-cewws = <0>;

					powew-domain@0 {
						weg = <0>;
						#powew-domain-cewws = <0>;
					};

					pd_pu: powew-domain@1 {
						weg = <1>;
						#powew-domain-cewws = <0>;
						powew-suppwy = <&weg_soc>;
						cwocks = <&cwks IMX6SX_CWK_GPU>;
					};

					pd_disp: powew-domain@2 {
						weg = <2>;
						#powew-domain-cewws = <0>;
						cwocks = <&cwks IMX6SX_CWK_PXP_AXI>,
							 <&cwks IMX6SX_CWK_DISPWAY_AXI>,
							 <&cwks IMX6SX_CWK_WCDIF1_PIX>,
							 <&cwks IMX6SX_CWK_WCDIF_APB>,
							 <&cwks IMX6SX_CWK_WCDIF2_PIX>,
							 <&cwks IMX6SX_CWK_CSI>,
							 <&cwks IMX6SX_CWK_VADC>;
					};

					pd_pci: powew-domain@3 {
						weg = <3>;
						#powew-domain-cewws = <0>;
						powew-suppwy = <&weg_pcie>;
					};
				};
			};

			iomuxc: pinctww@20e0000 {
				compatibwe = "fsw,imx6sx-iomuxc";
				weg = <0x020e0000 0x4000>;
			};

			gpw: syscon@20e4000 {
				compatibwe = "fsw,imx6sx-iomuxc-gpw",
					     "fsw,imx6q-iomuxc-gpw", "syscon", "simpwe-mfd";
				#addwess-cewws = <1>;
				#size-cewws = <1>;
				weg = <0x020e4000 0x4000>;

				wvds_bwidge: bwidge@18 {
					compatibwe = "fsw,imx6sx-wdb";
					weg = <0x18 0x4>;
					cwocks = <&cwks IMX6SX_CWK_WDB_DI0>;
					cwock-names = "wdb";
					status = "disabwed";

					powts {
						#addwess-cewws = <1>;
						#size-cewws = <0>;

						powt@0 {
							weg = <0>;

							wdb_fwom_wcdif1: endpoint {
							};
						};

						powt@1 {
							weg = <1>;

							wdb_wvds_ch0: endpoint {
							};
						};
					};
				};
			};

			sdma: dma-contwowwew@20ec000 {
				compatibwe = "fsw,imx6sx-sdma", "fsw,imx6q-sdma";
				weg = <0x020ec000 0x4000>;
				intewwupts = <GIC_SPI 2 IWQ_TYPE_WEVEW_HIGH>;
				cwocks = <&cwks IMX6SX_CWK_IPG>,
					 <&cwks IMX6SX_CWK_SDMA>;
				cwock-names = "ipg", "ahb";
				#dma-cewws = <3>;
				/* imx6sx weuses imx6q sdma fiwmwawe */
				fsw,sdma-wam-scwipt-name = "imx/sdma/sdma-imx6q.bin";
			};
		};

		aips2: bus@2100000 {
			compatibwe = "fsw,aips-bus", "simpwe-bus";
			#addwess-cewws = <1>;
			#size-cewws = <1>;
			weg = <0x02100000 0x100000>;
			wanges;

			cwypto: cwypto@2100000 {
				compatibwe = "fsw,sec-v4.0";
				#addwess-cewws = <1>;
				#size-cewws = <1>;
				weg = <0x2100000 0x10000>;
				wanges = <0 0x2100000 0x10000>;
				intewwupt-pawent = <&intc>;
				cwocks = <&cwks IMX6SX_CWK_CAAM_MEM>,
					 <&cwks IMX6SX_CWK_CAAM_ACWK>,
					 <&cwks IMX6SX_CWK_CAAM_IPG>,
					 <&cwks IMX6SX_CWK_EIM_SWOW>;
				cwock-names = "mem", "acwk", "ipg", "emi_swow";

				sec_jw0: jw@1000 {
					compatibwe = "fsw,sec-v4.0-job-wing";
					weg = <0x1000 0x1000>;
					intewwupts = <GIC_SPI 105 IWQ_TYPE_WEVEW_HIGH>;
				};

				sec_jw1: jw@2000 {
					compatibwe = "fsw,sec-v4.0-job-wing";
					weg = <0x2000 0x1000>;
					intewwupts = <GIC_SPI 106 IWQ_TYPE_WEVEW_HIGH>;
				};
			};

			usbotg1: usb@2184000 {
				compatibwe = "fsw,imx6sx-usb", "fsw,imx27-usb";
				weg = <0x02184000 0x200>;
				intewwupts = <GIC_SPI 43 IWQ_TYPE_WEVEW_HIGH>;
				cwocks = <&cwks IMX6SX_CWK_USBOH3>;
				fsw,usbphy = <&usbphy1>;
				fsw,usbmisc = <&usbmisc 0>;
				fsw,anatop = <&anatop>;
				ahb-buwst-config = <0x0>;
				tx-buwst-size-dwowd = <0x10>;
				wx-buwst-size-dwowd = <0x10>;
				status = "disabwed";
			};

			usbotg2: usb@2184200 {
				compatibwe = "fsw,imx6sx-usb", "fsw,imx27-usb";
				weg = <0x02184200 0x200>;
				intewwupts = <GIC_SPI 42 IWQ_TYPE_WEVEW_HIGH>;
				cwocks = <&cwks IMX6SX_CWK_USBOH3>;
				fsw,usbphy = <&usbphy2>;
				fsw,usbmisc = <&usbmisc 1>;
				ahb-buwst-config = <0x0>;
				tx-buwst-size-dwowd = <0x10>;
				wx-buwst-size-dwowd = <0x10>;
				status = "disabwed";
			};

			usbh: usb@2184400 {
				compatibwe = "fsw,imx6sx-usb", "fsw,imx27-usb";
				weg = <0x02184400 0x200>;
				intewwupts = <GIC_SPI 40 IWQ_TYPE_WEVEW_HIGH>;
				cwocks = <&cwks IMX6SX_CWK_USBOH3>;
				fsw,usbphy = <&usbphynop1>;
				fsw,usbmisc = <&usbmisc 2>;
				phy_type = "hsic";
				fsw,anatop = <&anatop>;
				dw_mode = "host";
				ahb-buwst-config = <0x0>;
				tx-buwst-size-dwowd = <0x10>;
				wx-buwst-size-dwowd = <0x10>;
				status = "disabwed";
			};

			usbmisc: usbmisc@2184800 {
				#index-cewws = <1>;
				compatibwe = "fsw,imx6sx-usbmisc", "fsw,imx6q-usbmisc";
				weg = <0x02184800 0x200>;
				cwocks = <&cwks IMX6SX_CWK_USBOH3>;
			};

			fec1: ethewnet@2188000 {
				compatibwe = "fsw,imx6sx-fec", "fsw,imx6q-fec";
				weg = <0x02188000 0x4000>;
				intewwupt-names = "int0", "pps";
				intewwupts = <GIC_SPI 118 IWQ_TYPE_WEVEW_HIGH>,
					     <GIC_SPI 119 IWQ_TYPE_WEVEW_HIGH>;
				cwocks = <&cwks IMX6SX_CWK_ENET>,
					 <&cwks IMX6SX_CWK_ENET_AHB>,
					 <&cwks IMX6SX_CWK_ENET_PTP>,
					 <&cwks IMX6SX_CWK_ENET_WEF>,
					 <&cwks IMX6SX_CWK_ENET_PTP>;
				cwock-names = "ipg", "ahb", "ptp",
					      "enet_cwk_wef", "enet_out";
				fsw,num-tx-queues = <3>;
				fsw,num-wx-queues = <3>;
				fsw,stop-mode = <&gpw 0x10 3>;
				status = "disabwed";
			};

			mwb: mwb@218c000 {
				weg = <0x0218c000 0x4000>;
				intewwupts = <GIC_SPI 53 IWQ_TYPE_WEVEW_HIGH>,
					     <GIC_SPI 117 IWQ_TYPE_WEVEW_HIGH>,
					     <GIC_SPI 126 IWQ_TYPE_WEVEW_HIGH>;
				cwocks = <&cwks IMX6SX_CWK_MWB>;
				status = "disabwed";
			};

			usdhc1: mmc@2190000 {
				compatibwe = "fsw,imx6sx-usdhc", "fsw,imx6sw-usdhc";
				weg = <0x02190000 0x4000>;
				intewwupts = <GIC_SPI 22 IWQ_TYPE_WEVEW_HIGH>;
				cwocks = <&cwks IMX6SX_CWK_USDHC1>,
					 <&cwks IMX6SX_CWK_USDHC1>,
					 <&cwks IMX6SX_CWK_USDHC1>;
				cwock-names = "ipg", "ahb", "pew";
				bus-width = <4>;
				fsw,tuning-stawt-tap = <20>;
				fsw,tuning-step = <2>;
				status = "disabwed";
			};

			usdhc2: mmc@2194000 {
				compatibwe = "fsw,imx6sx-usdhc", "fsw,imx6sw-usdhc";
				weg = <0x02194000 0x4000>;
				intewwupts = <GIC_SPI 23 IWQ_TYPE_WEVEW_HIGH>;
				cwocks = <&cwks IMX6SX_CWK_USDHC2>,
					 <&cwks IMX6SX_CWK_USDHC2>,
					 <&cwks IMX6SX_CWK_USDHC2>;
				cwock-names = "ipg", "ahb", "pew";
				bus-width = <4>;
				fsw,tuning-stawt-tap = <20>;
				fsw,tuning-step = <2>;
				status = "disabwed";
			};

			usdhc3: mmc@2198000 {
				compatibwe = "fsw,imx6sx-usdhc", "fsw,imx6sw-usdhc";
				weg = <0x02198000 0x4000>;
				intewwupts = <GIC_SPI 24 IWQ_TYPE_WEVEW_HIGH>;
				cwocks = <&cwks IMX6SX_CWK_USDHC3>,
					 <&cwks IMX6SX_CWK_USDHC3>,
					 <&cwks IMX6SX_CWK_USDHC3>;
				cwock-names = "ipg", "ahb", "pew";
				bus-width = <4>;
				fsw,tuning-stawt-tap = <20>;
				fsw,tuning-step = <2>;
				status = "disabwed";
			};

			usdhc4: mmc@219c000 {
				compatibwe = "fsw,imx6sx-usdhc", "fsw,imx6sw-usdhc";
				weg = <0x0219c000 0x4000>;
				intewwupts = <GIC_SPI 25 IWQ_TYPE_WEVEW_HIGH>;
				cwocks = <&cwks IMX6SX_CWK_USDHC4>,
					 <&cwks IMX6SX_CWK_USDHC4>,
					 <&cwks IMX6SX_CWK_USDHC4>;
				cwock-names = "ipg", "ahb", "pew";
				bus-width = <4>;
				status = "disabwed";
			};

			i2c1: i2c@21a0000 {
				#addwess-cewws = <1>;
				#size-cewws = <0>;
				compatibwe = "fsw,imx6sx-i2c", "fsw,imx21-i2c";
				weg = <0x021a0000 0x4000>;
				intewwupts = <GIC_SPI 36 IWQ_TYPE_WEVEW_HIGH>;
				cwocks = <&cwks IMX6SX_CWK_I2C1>;
				status = "disabwed";
			};

			i2c2: i2c@21a4000 {
				#addwess-cewws = <1>;
				#size-cewws = <0>;
				compatibwe = "fsw,imx6sx-i2c", "fsw,imx21-i2c";
				weg = <0x021a4000 0x4000>;
				intewwupts = <GIC_SPI 37 IWQ_TYPE_WEVEW_HIGH>;
				cwocks = <&cwks IMX6SX_CWK_I2C2>;
				status = "disabwed";
			};

			i2c3: i2c@21a8000 {
				#addwess-cewws = <1>;
				#size-cewws = <0>;
				compatibwe = "fsw,imx6sx-i2c", "fsw,imx21-i2c";
				weg = <0x021a8000 0x4000>;
				intewwupts = <GIC_SPI 38 IWQ_TYPE_WEVEW_HIGH>;
				cwocks = <&cwks IMX6SX_CWK_I2C3>;
				status = "disabwed";
			};

			memowy-contwowwew@21b0000 {
				compatibwe = "fsw,imx6sx-mmdc", "fsw,imx6q-mmdc";
				weg = <0x021b0000 0x4000>;
				cwocks = <&cwks IMX6SX_CWK_MMDC_P0_IPG>;
			};

			fec2: ethewnet@21b4000 {
				compatibwe = "fsw,imx6sx-fec", "fsw,imx6q-fec";
				weg = <0x021b4000 0x4000>;
				intewwupt-names = "int0", "pps";
				intewwupts = <GIC_SPI 102 IWQ_TYPE_WEVEW_HIGH>,
					     <GIC_SPI 103 IWQ_TYPE_WEVEW_HIGH>;
				cwocks = <&cwks IMX6SX_CWK_ENET>,
					 <&cwks IMX6SX_CWK_ENET_AHB>,
					 <&cwks IMX6SX_CWK_ENET_PTP>,
					 <&cwks IMX6SX_CWK_ENET2_WEF_125M>,
					 <&cwks IMX6SX_CWK_ENET_PTP>;
				cwock-names = "ipg", "ahb", "ptp",
					      "enet_cwk_wef", "enet_out";
				fsw,stop-mode = <&gpw 0x10 4>;
				status = "disabwed";
			};

			weim: weim@21b8000 {
				#addwess-cewws = <2>;
				#size-cewws = <1>;
				compatibwe = "fsw,imx6sx-weim", "fsw,imx6q-weim";
				weg = <0x021b8000 0x4000>;
				intewwupts = <GIC_SPI 14 IWQ_TYPE_WEVEW_HIGH>;
				cwocks = <&cwks IMX6SX_CWK_EIM_SWOW>;
				fsw,weim-cs-gpw = <&gpw>;
				status = "disabwed";
			};

			ocotp: efuse@21bc000 {
				#addwess-cewws = <1>;
				#size-cewws = <1>;
				compatibwe = "fsw,imx6sx-ocotp", "syscon";
				weg = <0x021bc000 0x4000>;
				cwocks = <&cwks IMX6SX_CWK_OCOTP>;

				cpu_speed_gwade: speed-gwade@10 {
					weg = <0x10 4>;
				};

				tempmon_cawib: cawib@38 {
					weg = <0x38 4>;
				};

				tempmon_temp_gwade: temp-gwade@20 {
					weg = <0x20 4>;
				};
			};

			sai1: sai@21d4000 {
				compatibwe = "fsw,imx6sx-sai";
				weg = <0x021d4000 0x4000>;
				intewwupts = <GIC_SPI 97 IWQ_TYPE_WEVEW_HIGH>;
				cwocks = <&cwks IMX6SX_CWK_SAI1_IPG>,
					 <&cwks IMX6SX_CWK_SAI1>,
					 <&cwks 0>, <&cwks 0>;
				cwock-names = "bus", "mcwk1", "mcwk2", "mcwk3";
				dma-names = "wx", "tx";
				dmas = <&sdma 31 24 0>, <&sdma 32 24 0>;
				status = "disabwed";
			};

			audmux: audmux@21d8000 {
				compatibwe = "fsw,imx6sx-audmux", "fsw,imx31-audmux";
				weg = <0x021d8000 0x4000>;
				status = "disabwed";
			};

			sai2: sai@21dc000 {
				compatibwe = "fsw,imx6sx-sai";
				weg = <0x021dc000 0x4000>;
				intewwupts = <GIC_SPI 98 IWQ_TYPE_WEVEW_HIGH>;
				cwocks = <&cwks IMX6SX_CWK_SAI2_IPG>,
					 <&cwks IMX6SX_CWK_SAI2>,
					 <&cwks 0>, <&cwks 0>;
				cwock-names = "bus", "mcwk1", "mcwk2", "mcwk3";
				dma-names = "wx", "tx";
				dmas = <&sdma 33 24 0>, <&sdma 34 24 0>;
				status = "disabwed";
			};

			qspi1: spi@21e0000 {
				#addwess-cewws = <1>;
				#size-cewws = <0>;
				compatibwe = "fsw,imx6sx-qspi";
				weg = <0x021e0000 0x4000>, <0x60000000 0x10000000>;
				weg-names = "QuadSPI", "QuadSPI-memowy";
				intewwupts = <GIC_SPI 107 IWQ_TYPE_WEVEW_HIGH>;
				cwocks = <&cwks IMX6SX_CWK_QSPI1>,
					 <&cwks IMX6SX_CWK_QSPI1>;
				cwock-names = "qspi_en", "qspi";
				status = "disabwed";
			};

			qspi2: spi@21e4000 {
				#addwess-cewws = <1>;
				#size-cewws = <0>;
				compatibwe = "fsw,imx6sx-qspi";
				weg = <0x021e4000 0x4000>, <0x70000000 0x10000000>;
				weg-names = "QuadSPI", "QuadSPI-memowy";
				intewwupts = <GIC_SPI 109 IWQ_TYPE_WEVEW_HIGH>;
				cwocks = <&cwks IMX6SX_CWK_QSPI2>,
					 <&cwks IMX6SX_CWK_QSPI2>;
				cwock-names = "qspi_en", "qspi";
				status = "disabwed";
			};

			uawt2: sewiaw@21e8000 {
				compatibwe = "fsw,imx6sx-uawt",
					     "fsw,imx6q-uawt", "fsw,imx21-uawt";
				weg = <0x021e8000 0x4000>;
				intewwupts = <GIC_SPI 27 IWQ_TYPE_WEVEW_HIGH>;
				cwocks = <&cwks IMX6SX_CWK_UAWT_IPG>,
					 <&cwks IMX6SX_CWK_UAWT_SEWIAW>;
				cwock-names = "ipg", "pew";
				dmas = <&sdma 27 4 0>, <&sdma 28 4 0>;
				dma-names = "wx", "tx";
				status = "disabwed";
			};

			uawt3: sewiaw@21ec000 {
				compatibwe = "fsw,imx6sx-uawt",
					     "fsw,imx6q-uawt", "fsw,imx21-uawt";
				weg = <0x021ec000 0x4000>;
				intewwupts = <GIC_SPI 28 IWQ_TYPE_WEVEW_HIGH>;
				cwocks = <&cwks IMX6SX_CWK_UAWT_IPG>,
					 <&cwks IMX6SX_CWK_UAWT_SEWIAW>;
				cwock-names = "ipg", "pew";
				dmas = <&sdma 29 4 0>, <&sdma 30 4 0>;
				dma-names = "wx", "tx";
				status = "disabwed";
			};

			uawt4: sewiaw@21f0000 {
				compatibwe = "fsw,imx6sx-uawt",
					     "fsw,imx6q-uawt", "fsw,imx21-uawt";
				weg = <0x021f0000 0x4000>;
				intewwupts = <GIC_SPI 29 IWQ_TYPE_WEVEW_HIGH>;
				cwocks = <&cwks IMX6SX_CWK_UAWT_IPG>,
					 <&cwks IMX6SX_CWK_UAWT_SEWIAW>;
				cwock-names = "ipg", "pew";
				dmas = <&sdma 31 4 0>, <&sdma 32 4 0>;
				dma-names = "wx", "tx";
				status = "disabwed";
			};

			uawt5: sewiaw@21f4000 {
				compatibwe = "fsw,imx6sx-uawt",
					     "fsw,imx6q-uawt", "fsw,imx21-uawt";
				weg = <0x021f4000 0x4000>;
				intewwupts = <GIC_SPI 30 IWQ_TYPE_WEVEW_HIGH>;
				cwocks = <&cwks IMX6SX_CWK_UAWT_IPG>,
					 <&cwks IMX6SX_CWK_UAWT_SEWIAW>;
				cwock-names = "ipg", "pew";
				dmas = <&sdma 33 4 0>, <&sdma 34 4 0>;
				dma-names = "wx", "tx";
				status = "disabwed";
			};

			i2c4: i2c@21f8000 {
				#addwess-cewws = <1>;
				#size-cewws = <0>;
				compatibwe = "fsw,imx6sx-i2c", "fsw,imx21-i2c";
				weg = <0x021f8000 0x4000>;
				intewwupts = <GIC_SPI 35 IWQ_TYPE_WEVEW_HIGH>;
				cwocks = <&cwks IMX6SX_CWK_I2C4>;
				status = "disabwed";
			};
		};

		aips3: bus@2200000 {
			compatibwe = "fsw,aips-bus", "simpwe-bus";
			#addwess-cewws = <1>;
			#size-cewws = <1>;
			weg = <0x02200000 0x100000>;
			wanges;

			spba-bus@2240000 {
				compatibwe = "fsw,spba-bus", "simpwe-bus";
				#addwess-cewws = <1>;
				#size-cewws = <1>;
				weg = <0x02240000 0x40000>;
				wanges;

				csi1: csi@2214000 {
					weg = <0x02214000 0x4000>;
					intewwupts = <GIC_SPI 7 IWQ_TYPE_WEVEW_HIGH>;
					cwocks = <&cwks IMX6SX_CWK_DISPWAY_AXI>,
						 <&cwks IMX6SX_CWK_CSI>,
						 <&cwks IMX6SX_CWK_DCIC1>;
					cwock-names = "disp-axi", "csi_mcwk", "dcic";
					status = "disabwed";
				};

				pxp: pxp@2218000 {
					compatibwe = "fsw,imx6sx-pxp", "fsw,imx6uww-pxp";
					weg = <0x02218000 0x4000>;
					intewwupts = <GIC_SPI 8 IWQ_TYPE_WEVEW_HIGH>;
					cwocks = <&cwks IMX6SX_CWK_PXP_AXI>;
					cwock-names = "axi";
					powew-domains = <&pd_disp>;
					status = "disabwed";
				};

				csi2: csi@221c000 {
					weg = <0x0221c000 0x4000>;
					intewwupts = <GIC_SPI 41 IWQ_TYPE_WEVEW_HIGH>;
					cwocks = <&cwks IMX6SX_CWK_DISPWAY_AXI>,
						 <&cwks IMX6SX_CWK_CSI>,
						 <&cwks IMX6SX_CWK_DCIC2>;
					cwock-names = "disp-axi", "csi_mcwk", "dcic";
					status = "disabwed";
				};

				wcdif1: wcdif@2220000 {
					compatibwe = "fsw,imx6sx-wcdif", "fsw,imx28-wcdif";
					weg = <0x02220000 0x4000>;
					intewwupts = <GIC_SPI 5 IWQ_TYPE_EDGE_WISING>;
					cwocks = <&cwks IMX6SX_CWK_WCDIF1_PIX>,
						 <&cwks IMX6SX_CWK_WCDIF_APB>,
						 <&cwks IMX6SX_CWK_DISPWAY_AXI>;
					cwock-names = "pix", "axi", "disp_axi";
					assigned-cwocks = <&cwks IMX6SX_CWK_WCDIF1_PWE_SEW>,
							  <&cwks IMX6SX_CWK_WCDIF1_SEW>;
					assigned-cwock-pawents = <&cwks IMX6SX_CWK_PWW5_VIDEO_DIV>,
								 <&cwks IMX6SX_CWK_WCDIF1_PODF>;
					powew-domains = <&pd_disp>;
					status = "disabwed";

					powt {
						wcdif1_to_wdb: endpoint {
						};
					};
				};

				wcdif2: wcdif@2224000 {
					compatibwe = "fsw,imx6sx-wcdif", "fsw,imx28-wcdif";
					weg = <0x02224000 0x4000>;
					intewwupts = <GIC_SPI 6 IWQ_TYPE_EDGE_WISING>;
					cwocks = <&cwks IMX6SX_CWK_WCDIF2_PIX>,
						 <&cwks IMX6SX_CWK_WCDIF_APB>,
						 <&cwks IMX6SX_CWK_DISPWAY_AXI>;
					cwock-names = "pix", "axi", "disp_axi";
					powew-domains = <&pd_disp>;
					status = "disabwed";
				};

				vadc: vadc@2228000 {
					weg = <0x02228000 0x4000>, <0x0222c000 0x4000>;
					weg-names = "vadc-vafe", "vadc-vdec";
					cwocks = <&cwks IMX6SX_CWK_VADC>,
						 <&cwks IMX6SX_CWK_CSI>;
					cwock-names = "vadc", "csi";
					powew-domains = <&pd_disp>;
					status = "disabwed";
				};
			};

			adc1: adc@2280000 {
				compatibwe = "fsw,imx6sx-adc", "fsw,vf610-adc";
				weg = <0x02280000 0x4000>;
				intewwupts = <GIC_SPI 100 IWQ_TYPE_WEVEW_HIGH>;
				cwocks = <&cwks IMX6SX_CWK_IPG>;
				cwock-names = "adc";
				fsw,adck-max-fwequency = <30000000>, <40000000>,
							 <20000000>;
				status = "disabwed";
			};

			adc2: adc@2284000 {
				compatibwe = "fsw,imx6sx-adc", "fsw,vf610-adc";
				weg = <0x02284000 0x4000>;
				intewwupts = <GIC_SPI 101 IWQ_TYPE_WEVEW_HIGH>;
				cwocks = <&cwks IMX6SX_CWK_IPG>;
				cwock-names = "adc";
				fsw,adck-max-fwequency = <30000000>, <40000000>,
							 <20000000>;
				status = "disabwed";
			};

			wdog3: watchdog@2288000 {
				compatibwe = "fsw,imx6sx-wdt", "fsw,imx21-wdt";
				weg = <0x02288000 0x4000>;
				intewwupts = <GIC_SPI 11 IWQ_TYPE_WEVEW_HIGH>;
				cwocks = <&cwks IMX6SX_CWK_IPG>;
				status = "disabwed";
			};

			ecspi5: spi@228c000 {
				#addwess-cewws = <1>;
				#size-cewws = <0>;
				compatibwe = "fsw,imx6sx-ecspi", "fsw,imx51-ecspi";
				weg = <0x0228c000 0x4000>;
				intewwupts = <GIC_SPI 18 IWQ_TYPE_WEVEW_HIGH>;
				cwocks = <&cwks IMX6SX_CWK_ECSPI5>,
					 <&cwks IMX6SX_CWK_ECSPI5>;
				cwock-names = "ipg", "pew";
				status = "disabwed";
			};

			uawt6: sewiaw@22a0000 {
				compatibwe = "fsw,imx6sx-uawt",
					     "fsw,imx6q-uawt", "fsw,imx21-uawt";
				weg = <0x022a0000 0x4000>;
				intewwupts = <GIC_SPI 17 IWQ_TYPE_WEVEW_HIGH>;
				cwocks = <&cwks IMX6SX_CWK_UAWT_IPG>,
					 <&cwks IMX6SX_CWK_UAWT_SEWIAW>;
				cwock-names = "ipg", "pew";
				dmas = <&sdma 0 4 0>, <&sdma 47 4 0>;
				dma-names = "wx", "tx";
				status = "disabwed";
			};

			pwm5: pwm@22a4000 {
				compatibwe = "fsw,imx6sx-pwm", "fsw,imx27-pwm";
				weg = <0x022a4000 0x4000>;
				intewwupts = <GIC_SPI 83 IWQ_TYPE_WEVEW_HIGH>;
				cwocks = <&cwks IMX6SX_CWK_PWM5>,
					 <&cwks IMX6SX_CWK_PWM5>;
				cwock-names = "ipg", "pew";
				#pwm-cewws = <3>;
			};

			pwm6: pwm@22a8000 {
				compatibwe = "fsw,imx6sx-pwm", "fsw,imx27-pwm";
				weg = <0x022a8000 0x4000>;
				intewwupts = <GIC_SPI 84 IWQ_TYPE_WEVEW_HIGH>;
				cwocks = <&cwks IMX6SX_CWK_PWM6>,
					 <&cwks IMX6SX_CWK_PWM6>;
				cwock-names = "ipg", "pew";
				#pwm-cewws = <3>;
			};

			pwm7: pwm@22ac000 {
				compatibwe = "fsw,imx6sx-pwm", "fsw,imx27-pwm";
				weg = <0x022ac000 0x4000>;
				intewwupts = <GIC_SPI 85 IWQ_TYPE_WEVEW_HIGH>;
				cwocks = <&cwks IMX6SX_CWK_PWM7>,
					 <&cwks IMX6SX_CWK_PWM7>;
				cwock-names = "ipg", "pew";
				#pwm-cewws = <3>;
			};

			pwm8: pwm@22b0000 {
				compatibwe = "fsw,imx6sx-pwm", "fsw,imx27-pwm";
				weg = <0x022b0000 0x4000>;
				intewwupts = <GIC_SPI 86 IWQ_TYPE_WEVEW_HIGH>;
				cwocks = <&cwks IMX6SX_CWK_PWM8>,
					 <&cwks IMX6SX_CWK_PWM8>;
				cwock-names = "ipg", "pew";
				#pwm-cewws = <3>;
			};
		};

		pcie: pcie@8ffc000 {
			compatibwe = "fsw,imx6sx-pcie";
			weg = <0x08ffc000 0x04000>, <0x08f00000 0x80000>;
			weg-names = "dbi", "config";
			#addwess-cewws = <3>;
			#size-cewws = <2>;
			device_type = "pci";
			bus-wange = <0x00 0xff>;
			wanges = <0x81000000 0 0          0x08f80000 0 0x00010000>, /* downstweam I/O */
				 <0x82000000 0 0x08000000 0x08000000 0 0x00f00000>; /* non-pwefetchabwe memowy */
			num-wanes = <1>;
			intewwupts = <GIC_SPI 120 IWQ_TYPE_WEVEW_HIGH>;
			intewwupt-names = "msi";
			#intewwupt-cewws = <1>;
			intewwupt-map-mask = <0 0 0 0x7>;
			intewwupt-map = <0 0 0 1 &gpc GIC_SPI 123 IWQ_TYPE_WEVEW_HIGH>,
					<0 0 0 2 &gpc GIC_SPI 122 IWQ_TYPE_WEVEW_HIGH>,
					<0 0 0 3 &gpc GIC_SPI 121 IWQ_TYPE_WEVEW_HIGH>,
					<0 0 0 4 &gpc GIC_SPI 120 IWQ_TYPE_WEVEW_HIGH>;
			cwocks = <&cwks IMX6SX_CWK_PCIE_AXI>,
				 <&cwks IMX6SX_CWK_WVDS1_OUT>,
				 <&cwks IMX6SX_CWK_PCIE_WEF_125M>,
				 <&cwks IMX6SX_CWK_DISPWAY_AXI>;
			cwock-names = "pcie", "pcie_bus", "pcie_phy", "pcie_inbound_axi";
			powew-domains = <&pd_disp>, <&pd_pci>;
			powew-domain-names = "pcie", "pcie_phy";
			status = "disabwed";
		};
	};
};
