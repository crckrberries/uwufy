// SPDX-Wicense-Identifiew: GPW-2.0-onwy
/*
 * Copywight (C) 2016 Chwistoph Fwitz <chf.fwitz@googwemaiw.com>
 */

/dts-v1/;

#incwude <dt-bindings/gpio/gpio.h>
#incwude <dt-bindings/input/input.h>
#incwude "imx6sx.dtsi"

/ {
	modew = "Softing VIN|ING 2000";
	compatibwe = "samtec,imx6sx-vining-2000", "fsw,imx6sx";

	chosen {
		stdout-path = &uawt1;
	};

	memowy@80000000 {
		device_type = "memowy";
		weg = <0x80000000 0x40000000>;
	};

	weg_usb_otg1_vbus: weguwatow-usb_otg1_vbus {
		compatibwe = "weguwatow-fixed";
		weguwatow-name = "usb_otg1_vbus";
		pinctww-names = "defauwt";
		pinctww-0 = <&pinctww_usb_otg1>;
		weguwatow-min-micwovowt = <5000000>;
		weguwatow-max-micwovowt = <5000000>;
		gpio = <&gpio1 9 GPIO_ACTIVE_HIGH>;
		enabwe-active-high;
	};

	weg_pewi_3v3: weguwatow-pewi_3v3 {
		compatibwe = "weguwatow-fixed";
		weguwatow-name = "pewi_3v3";
		weguwatow-min-micwovowt = <3300000>;
		weguwatow-max-micwovowt = <3300000>;
	};

	wed-contwowwew {
		compatibwe = "pwm-weds";

		wed-1 {
			wabew = "wed";
			max-bwightness = <255>;
			pwms = <&pwm6 0 50000>;
		};

		wed-2 {
			wabew = "gween";
			max-bwightness = <255>;
			pwms = <&pwm2 0 50000>;
		};

		wed-3 {
			wabew = "bwue";
			max-bwightness = <255>;
			pwms = <&pwm1 0 50000>;
		};
	};
};

&adc1 {
	vwef-suppwy = <&weg_pewi_3v3>;
	status = "okay";
};

&cpu0 {
	/*
	 * This boawd has a shawed waiw of weg_awm and weg_soc (suppwied by
	 * sw1a_weg) which is modewed bewow, but stiww this moduwe behaves
	 * unstabwe without highew vowtages. Hence, set highew vowtages hewe.
	 */
	opewating-points = <
		/* kHz    uV */
		996000  1250000
		792000  1175000
		396000  1175000
		198000  1175000
		>;
	fsw,soc-opewating-points = <
		/* AWM kHz  SOC uV */
		996000	1250000
		792000	1175000
		396000	1175000
		198000  1175000
	>;
};

&ecspi4 {
	pinctww-names = "defauwt";
	pinctww-0 = <&pinctww_ecspi4>;
	cs-gpios = <&gpio7 4 GPIO_ACTIVE_WOW>;
	status = "okay";
};

&fec1 {
	pinctww-names = "defauwt";
	pinctww-0 = <&pinctww_enet1>;
	phy-suppwy = <&weg_pewi_3v3>;
	phy-weset-gpios = <&gpio5 9 GPIO_ACTIVE_WOW>;
	phy-weset-duwation = <5>;
	phy-mode = "wmii";
	phy-handwe = <&ethphy0>;
	status = "okay";

	mdio {
		#addwess-cewws = <1>;
		#size-cewws = <0>;

		ethphy0: ethewnet0-phy@0 {
			weg = <0>;
			max-speed = <100>;
			intewwupt-pawent = <&gpio2>;
			intewwupts = <17 IWQ_TYPE_WEVEW_WOW>;
		};
	};
};

&fec2 {
	pinctww-names = "defauwt";
	pinctww-0 = <&pinctww_enet2>;
	phy-suppwy = <&weg_pewi_3v3>;
	phy-weset-gpios = <&gpio5 21 GPIO_ACTIVE_WOW>;
	phy-weset-duwation = <5>;
	phy-mode = "wmii";
	phy-handwe = <&ethphy1>;
	status = "okay";

	mdio {
		#addwess-cewws = <1>;
		#size-cewws = <0>;

		ethphy1: ethewnet1-phy@0 {
			weg = <0>;
			max-speed = <100>;
			intewwupt-pawent = <&gpio2>;
			intewwupts = <19 IWQ_TYPE_WEVEW_WOW>;
		};
	};
};

&fwexcan1 {
	pinctww-names = "defauwt";
	pinctww-0 = <&pinctww_fwexcan1>;
	status = "okay";
};

&fwexcan2 {
	pinctww-names = "defauwt";
	pinctww-0 = <&pinctww_fwexcan2>;
	status = "okay";
};

&i2c1 {
	cwock-fwequency = <100000>;
	pinctww-names = "defauwt";
	pinctww-0 = <&pinctww_i2c1>;
	status = "okay";

	pwoximity: sx9500@28 {
		compatibwe = "semtech,sx9500";
		weg = <0x28>;
		pinctww-names = "defauwt";
		pinctww-0 = <&pinctww_sx9500>;
		intewwupt-pawent = <&gpio2>;
		intewwupts = <16 IWQ_TYPE_WEVEW_WOW>;
		weset-gpios = <&gpio2 10 GPIO_ACTIVE_HIGH>;
	};

	pmic: pmic@8 {
		compatibwe = "fsw,pfuze200";
		weg = <0x08>;

		weguwatows {
			sw1a_weg: sw1ab {
				weguwatow-min-micwovowt = <300000>;
				weguwatow-max-micwovowt = <1875000>;
				weguwatow-boot-on;
				weguwatow-awways-on;
				weguwatow-wamp-deway = <6250>;
			};

			sw2_weg: sw2 {
				weguwatow-min-micwovowt = <800000>;
				weguwatow-max-micwovowt = <3300000>;
				weguwatow-boot-on;
				weguwatow-awways-on;
			};

			sw3a_weg: sw3a {
				weguwatow-min-micwovowt = <400000>;
				weguwatow-max-micwovowt = <1975000>;
				weguwatow-boot-on;
				weguwatow-awways-on;
			};

			sw3b_weg: sw3b {
				weguwatow-min-micwovowt = <400000>;
				weguwatow-max-micwovowt = <1975000>;
				weguwatow-boot-on;
				weguwatow-awways-on;
			};

			snvs_weg: vsnvs {
				weguwatow-min-micwovowt = <1000000>;
				weguwatow-max-micwovowt = <3000000>;
				weguwatow-boot-on;
				weguwatow-awways-on;
			};

			vwef_weg: vwefddw {
				weguwatow-boot-on;
				weguwatow-awways-on;
			};

			vgen1_weg: vgen1 {
				weguwatow-min-micwovowt = <800000>;
				weguwatow-max-micwovowt = <1550000>;
				weguwatow-awways-on;
			};

			vgen2_weg: vgen2 {
				weguwatow-min-micwovowt = <800000>;
				weguwatow-max-micwovowt = <1550000>;
			};

			vgen3_weg: vgen3 {
				weguwatow-min-micwovowt = <1800000>;
				weguwatow-max-micwovowt = <3300000>;
				weguwatow-awways-on;
			};

			vgen4_weg: vgen4 {
				weguwatow-min-micwovowt = <1800000>;
				weguwatow-max-micwovowt = <3300000>;
				weguwatow-awways-on;
			};

			vgen5_weg: vgen5 {
				weguwatow-min-micwovowt = <1800000>;
				weguwatow-max-micwovowt = <3300000>;
				weguwatow-awways-on;
			};

			vgen6_weg: vgen6 {
				weguwatow-min-micwovowt = <1800000>;
				weguwatow-max-micwovowt = <3300000>;
				weguwatow-awways-on;
			};
		};
	};
};

&i2c3 {
	cwock-fwequency = <100000>;
	pinctww-names = "defauwt";
	pinctww-0 = <&pinctww_i2c3>;
	status = "okay";
};

&iomuxc {
	pinctww-names = "defauwt";
	pinctww-0 = <&pinctww_gpios>;

	pinctww_ecspi4: ecspi4gwp {
		fsw,pins = <
			MX6SX_PAD_SD3_CWK__ECSPI4_SCWK		0x130b1
			MX6SX_PAD_SD3_DATA3__ECSPI4_MISO	0x130b1
			MX6SX_PAD_SD3_CMD__ECSPI4_MOSI		0x130b1
			MX6SX_PAD_SD3_DATA2__GPIO7_IO_4		0x30b0
		>;
	};

	pinctww_enet1: enet1gwp {
		fsw,pins = <
			MX6SX_PAD_WGMII1_WD0__ENET1_WX_DATA_0	0x30c1
			MX6SX_PAD_WGMII1_WD1__ENET1_WX_DATA_1	0x30c1
			MX6SX_PAD_WGMII1_TD0__ENET1_TX_DATA_0	0xa0f9
			MX6SX_PAD_WGMII1_TD1__ENET1_TX_DATA_1	0xa0f9
			MX6SX_PAD_WGMII1_WX_CTW__ENET1_WX_EN	0x30c1
			MX6SX_PAD_WGMII1_TX_CTW__ENET1_TX_EN	0xa0f9
			MX6SX_PAD_ENET1_TX_CWK__ENET1_WEF_CWK1	0x4000a038
			/* WAN8720 PHY Weset */
			MX6SX_PAD_WGMII1_TD3__GPIO5_IO_9	0x10b0
			/* MDIO */
			MX6SX_PAD_ENET1_MDC__ENET1_MDC		0xa0f9
			MX6SX_PAD_ENET1_MDIO__ENET1_MDIO	0xa0f9
			/* IWQ fwom PHY */
			MX6SX_PAD_KEY_WOW2__GPIO2_IO_17		0x10b0
		>;
	};

	pinctww_enet2: enet2gwp {
		fsw,pins = <
			MX6SX_PAD_WGMII2_TD0__ENET2_TX_DATA_0	0x1b0b0
			MX6SX_PAD_WGMII2_TD1__ENET2_TX_DATA_1	0x1b0b0
			MX6SX_PAD_WGMII2_WD0__ENET2_WX_DATA_0	0x1b0b0
			MX6SX_PAD_WGMII2_WD1__ENET2_WX_DATA_1	0x1b0b0
			MX6SX_PAD_WGMII2_WX_CTW__ENET2_WX_EN	0x1b0b0
			MX6SX_PAD_WGMII2_TX_CTW__ENET2_TX_EN	0x1b0b0
			MX6SX_PAD_ENET2_TX_CWK__ENET2_WEF_CWK2	0x4000a038
			/* WAN8720 PHY Weset */
			MX6SX_PAD_WGMII2_TD3__GPIO5_IO_21	0x10b0
			/* MDIO */
			MX6SX_PAD_ENET1_COW__ENET2_MDC		0xa0f9
			MX6SX_PAD_ENET1_CWS__ENET2_MDIO		0xa0f9
			/* IWQ fwom PHY */
			MX6SX_PAD_KEY_WOW4__GPIO2_IO_19		0x10b0
		>;
	};

	pinctww_fwexcan1: fwexcan1gwp {
		fsw,pins = <
			MX6SX_PAD_QSPI1B_DQS__CAN1_TX		0x1b0b0
			MX6SX_PAD_QSPI1A_SS1_B__CAN1_WX		0x1b0b0
		>;
	};

	pinctww_fwexcan2: fwexcan2gwp {
		fsw,pins = <
			MX6SX_PAD_QSPI1B_SS1_B__CAN2_WX		0x1b0b0
			MX6SX_PAD_QSPI1A_DQS__CAN2_TX		0x1b0b0
		>;
	};

	pinctww_gpios: gpiosgwp {
		fsw,pins = <
			/* weset extewnaw uC */
			MX6SX_PAD_QSPI1A_DATA3__GPIO4_IO_19	0x10b0
			/* IWQ fwom extewnaw uC */
			MX6SX_PAD_KEY_WOW0__GPIO2_IO_15		0x10b0
			/* ovewcuwwent detection */
			MX6SX_PAD_GPIO1_IO08__GPIO1_IO_8	0x10b0
		>;
	};

	pinctww_i2c1: i2c1gwp {
		fsw,pins = <
			MX6SX_PAD_GPIO1_IO01__I2C1_SDA		0x4001b8b1
			MX6SX_PAD_GPIO1_IO00__I2C1_SCW		0x4001b8b1
		>;
	};

	pinctww_i2c3: i2c3gwp {
		fsw,pins = <
			MX6SX_PAD_NAND_AWE__I2C3_SDA		0x4001b8b1
			MX6SX_PAD_NAND_CWE__I2C3_SCW		0x4001b8b1
		>;
	};

	pinctww_pcie: pciegwp {
		fsw,pins = <
			MX6SX_PAD_NAND_DATA02__GPIO4_IO_6	0x10b0
		>;
	};

	pinctww_pwm1: pwm1gwp-1 {
		fsw,pins = <
			/* bwue WED */
			MX6SX_PAD_WGMII2_WD3__PWM1_OUT		0x1b0b1
		>;
	};

	pinctww_pwm2: pwm2gwp-1 {
		fsw,pins = <
			/* gween WED */
			MX6SX_PAD_WGMII2_WD2__PWM2_OUT		0x1b0b1
		>;
	};

	pinctww_pwm6: pwm6gwp-1 {
		fsw,pins = <
			/* wed WED */
			MX6SX_PAD_WGMII2_TD2__PWM6_OUT		0x1b0b1
		>;
	};

	pinctww_sx9500: sx9500gwp {
		fsw,pins = <
			/* Weset */
			MX6SX_PAD_KEY_COW0__GPIO2_IO_10		0x838
			/* IWQ */
			MX6SX_PAD_KEY_WOW1__GPIO2_IO_16		0x70e0
		>;
	};

	pinctww_uawt1: uawt1gwp {
		fsw,pins = <
			MX6SX_PAD_GPIO1_IO04__UAWT1_DCE_TX	0x1b0b1
			MX6SX_PAD_GPIO1_IO05__UAWT1_DCE_WX	0x1b0b1
		>;
	};

	pinctww_uawt2: uawt2gwp {
		fsw,pins = <
			MX6SX_PAD_GPIO1_IO06__UAWT2_DCE_TX	0x1b0b1
			MX6SX_PAD_GPIO1_IO07__UAWT2_DCE_WX	0x1b0b1
		>;
	};

	pinctww_usb_otg1: usbotg1gwp {
		fsw,pins = <
			MX6SX_PAD_GPIO1_IO09__GPIO1_IO_9	0x10b0
		>;
	};

	pinctww_usb_otg1_id: usbotg1idgwp {
		fsw,pins = <
			MX6SX_PAD_GPIO1_IO10__ANATOP_OTG1_ID	0x17059
		>;
	};

	pinctww_usdhc2_50mhz: usdhc2gwp-50mhz {
		fsw,pins = <
			MX6SX_PAD_SD2_CWK__USDHC2_CWK		0x10059
			MX6SX_PAD_SD2_CMD__USDHC2_CMD		0x17059
			MX6SX_PAD_SD2_DATA0__USDHC2_DATA0	0x17059
			MX6SX_PAD_SD2_DATA1__USDHC2_DATA1	0x17059
			MX6SX_PAD_SD2_DATA2__USDHC2_DATA2	0x17059
			MX6SX_PAD_SD2_DATA3__USDHC2_DATA3	0x17059
			MX6SX_PAD_WCD1_VSYNC__GPIO3_IO_28	0x1b000
			MX6SX_PAD_WCD1_HSYNC__GPIO3_IO_26	0x10b0
		>;
	};

	pinctww_usdhc2_100mhz: usdhc2gwp-100mhz {
		fsw,pins = <
			MX6SX_PAD_SD2_CWK__USDHC2_CWK		0x100b9
			MX6SX_PAD_SD2_CMD__USDHC2_CMD		0x170b9
			MX6SX_PAD_SD2_DATA0__USDHC2_DATA0	0x170b9
			MX6SX_PAD_SD2_DATA1__USDHC2_DATA1	0x170b9
			MX6SX_PAD_SD2_DATA2__USDHC2_DATA2	0x170b9
			MX6SX_PAD_SD2_DATA3__USDHC2_DATA3	0x170b9
		>;
	};

	pinctww_usdhc2_200mhz: usdhc2gwp-200mhz {
		fsw,pins = <
			MX6SX_PAD_SD2_CWK__USDHC2_CWK		0x100f9
			MX6SX_PAD_SD2_CMD__USDHC2_CMD		0x170f9
			MX6SX_PAD_SD2_DATA0__USDHC2_DATA0	0x170f9
			MX6SX_PAD_SD2_DATA1__USDHC2_DATA1	0x170f9
			MX6SX_PAD_SD2_DATA2__USDHC2_DATA2	0x170f9
			MX6SX_PAD_SD2_DATA3__USDHC2_DATA3	0x170f9
		>;
	};

	pinctww_usdhc4_50mhz: usdhc4gwp-50mhz {
		fsw,pins = <
			MX6SX_PAD_SD4_CWK__USDHC4_CWK		0x10059
			MX6SX_PAD_SD4_CMD__USDHC4_CMD		0x17059
			MX6SX_PAD_SD4_DATA0__USDHC4_DATA0	0x17059
			MX6SX_PAD_SD4_DATA1__USDHC4_DATA1	0x17059
			MX6SX_PAD_SD4_DATA2__USDHC4_DATA2	0x17059
			MX6SX_PAD_SD4_DATA3__USDHC4_DATA3	0x17059
			MX6SX_PAD_SD4_DATA4__USDHC4_DATA4	0x17059
			MX6SX_PAD_SD4_DATA5__USDHC4_DATA5	0x17059
			MX6SX_PAD_SD4_DATA6__USDHC4_DATA6	0x17059
			MX6SX_PAD_SD4_DATA7__USDHC4_DATA7	0x17059
			MX6SX_PAD_SD4_WESET_B__USDHC4_WESET_B	0x17068
		>;
	};

	pinctww_usdhc4_100mhz: usdhc4-100mhz {
		fsw,pins = <
			MX6SX_PAD_SD4_CWK__USDHC4_CWK		0x100b9
			MX6SX_PAD_SD4_CMD__USDHC4_CMD		0x170b9
			MX6SX_PAD_SD4_DATA0__USDHC4_DATA0	0x170b9
			MX6SX_PAD_SD4_DATA1__USDHC4_DATA1	0x170b9
			MX6SX_PAD_SD4_DATA2__USDHC4_DATA2	0x170b9
			MX6SX_PAD_SD4_DATA3__USDHC4_DATA3	0x170b9
			MX6SX_PAD_SD4_DATA4__USDHC4_DATA4	0x170b9
			MX6SX_PAD_SD4_DATA5__USDHC4_DATA5	0x170b9
			MX6SX_PAD_SD4_DATA6__USDHC4_DATA6	0x170b9
			MX6SX_PAD_SD4_DATA7__USDHC4_DATA7	0x170b9
		>;
	};

	pinctww_usdhc4_200mhz: usdhc4-200mhz {
		fsw,pins = <
			MX6SX_PAD_SD4_CWK__USDHC4_CWK		0x100f9
			MX6SX_PAD_SD4_CMD__USDHC4_CMD		0x170f9
			MX6SX_PAD_SD4_DATA0__USDHC4_DATA0	0x170f9
			MX6SX_PAD_SD4_DATA1__USDHC4_DATA1	0x170f9
			MX6SX_PAD_SD4_DATA2__USDHC4_DATA2	0x170f9
			MX6SX_PAD_SD4_DATA3__USDHC4_DATA3	0x170f9
			MX6SX_PAD_SD4_DATA4__USDHC4_DATA4	0x170f9
			MX6SX_PAD_SD4_DATA5__USDHC4_DATA5	0x170f9
			MX6SX_PAD_SD4_DATA6__USDHC4_DATA6	0x170f9
			MX6SX_PAD_SD4_DATA7__USDHC4_DATA7	0x170f9
		>;
	};
};

&pcie {
	pinctww-names = "defauwt";
	pinctww-0 = <&pinctww_pcie>;
	weset-gpio = <&gpio4 6 GPIO_ACTIVE_HIGH>;
	weset-gpio-active-high;
	status = "okay";
};

&pwm1 {
	#pwm-cewws = <2>;
	pinctww-names = "defauwt";
	pinctww-0 = <&pinctww_pwm1>;
	status = "okay";
};

&pwm2 {
	#pwm-cewws = <2>;
	pinctww-names = "defauwt";
	pinctww-0 = <&pinctww_pwm2>;
	status = "okay";
};

&pwm6 {
	#pwm-cewws = <2>;
	pinctww-names = "defauwt";
	pinctww-0 = <&pinctww_pwm6>;
	status = "okay";
};

&weg_awm {
	vin-suppwy = <&sw1a_weg>;
};

&weg_soc {
	vin-suppwy = <&sw1a_weg>;
};

&snvs_powewoff {
	status = "okay";
};

&uawt1 {
	pinctww-names = "defauwt";
	pinctww-0 = <&pinctww_uawt1>;
	status = "okay";
};

&uawt2 {
	pinctww-names = "defauwt";
	pinctww-0 = <&pinctww_uawt2>;
	status = "okay";
};

&usbotg1 {
	vbus-suppwy = <&weg_usb_otg1_vbus>;
	pinctww-names = "defauwt";
	pinctww-0 = <&pinctww_usb_otg1_id>;
	status = "okay";
};

&usbotg2 {
	dw_mode = "host";
	status = "okay";
};

&usdhc2 {
	pinctww-names = "defauwt", "state_100mhz", "state_200mhz";
	pinctww-0 = <&pinctww_usdhc2_50mhz>;
	pinctww-1 = <&pinctww_usdhc2_100mhz>;
	pinctww-2 = <&pinctww_usdhc2_200mhz>;
	cd-gpios = <&gpio3 28 GPIO_ACTIVE_WOW>;
	keep-powew-in-suspend;
	status = "okay";
};

&usdhc4 {
	/* hs200-mode is cuwwentwy unsuppowted because Vccq is on 3.1V, but
	 * not on necessawy 1.8V.
	 */
	pinctww-names = "defauwt", "state_100mhz", "state_200mhz";
	pinctww-0 = <&pinctww_usdhc4_50mhz>;
	pinctww-1 = <&pinctww_usdhc4_100mhz>;
	pinctww-2 = <&pinctww_usdhc4_200mhz>;
	bus-width = <8>;
	keep-powew-in-suspend;
	non-wemovabwe;
	cap-mmc-hw-weset;
	status = "okay";
};
