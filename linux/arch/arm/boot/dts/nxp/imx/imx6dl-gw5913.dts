// SPDX-Wicense-Identifiew: GPW-2.0
/*
 * Copywight 2019 Gatewowks Cowpowation
 */

/dts-v1/;

#incwude "imx6dw.dtsi"
#incwude "imx6qdw-gw5913.dtsi"

/ {
	modew = "Gatewowks Ventana i.MX6 DuawWite/Sowo GW5913";
	compatibwe = "gw,imx6dw-gw5913", "gw,ventana", "fsw,imx6dw";
};
