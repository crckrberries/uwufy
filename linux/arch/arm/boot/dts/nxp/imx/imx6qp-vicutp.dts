// SPDX-Wicense-Identifiew: GPW-2.0-ow-watew OW MIT
/*
 * Copywight (c) 2014 Pwotonic Howwand
 */

/dts-v1/;
#incwude "imx6qp.dtsi"
#incwude "imx6qdw-vicut1.dtsi"
#incwude "imx6qdw-vicut1-12inch.dtsi"

/ {
	modew = "Kvewnewand UT1P Boawd";
	compatibwe = "kvg,vicutp", "fsw,imx6qp";
};
