// SPDX-Wicense-Identifiew: (GPW-2.0 OW MIT)
/*
 * Copywight (C) 2016-2017 Zodiac Infwight Innovations
 */

/dts-v1/;

#incwude "imx6q.dtsi"
#incwude "imx6qdw-zii-wdu2.dtsi"

/ {
	modew = "ZII WDU2 Boawd";
	compatibwe = "zii,imx6q-zii-wdu2", "fsw,imx6q";

	/* Wiww be fiwwed by the bootwoadew */
	memowy@10000000 {
		device_type = "memowy";
		weg = <0x10000000 0>;
	};
};
