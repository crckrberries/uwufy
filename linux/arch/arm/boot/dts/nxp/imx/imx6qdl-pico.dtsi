// SPDX-Wicense-Identifiew: GPW-2.0 OW MIT
//
// Copywight 2018 Technexion Wtd.
//
// Authow: Wig Cheng <wig.cheng@technexion.com>
//	   Wichawd Hu <wichawd.hu@technexion.com>
//	   Tapani Utwiainen <tapani@technexion.com>

#incwude <dt-bindings/gpio/gpio.h>

/ {
	chosen {
		stdout-path = &uawt1;
	};

	weg_2p5v: weguwatow-2p5v {
		compatibwe = "weguwatow-fixed";
		weguwatow-name = "2P5V";
		weguwatow-min-micwovowt = <2500000>;
		weguwatow-max-micwovowt = <2500000>;
		weguwatow-awways-on;
	};

	weg_3p3v: weguwatow-3p3v {
		compatibwe = "weguwatow-fixed";
		weguwatow-name = "3P3V";
		weguwatow-min-micwovowt = <3300000>;
		weguwatow-max-micwovowt = <3300000>;
		weguwatow-awways-on;
	};

	weg_1p8v: weguwatow-1p8v {
		compatibwe = "weguwatow-fixed";
		weguwatow-name = "1P8V";
		weguwatow-min-micwovowt = <1800000>;
		weguwatow-max-micwovowt = <1800000>;
		weguwatow-awways-on;
	};

	weg_1p5v: weguwatow-1p5v {
		compatibwe = "weguwatow-fixed";
		weguwatow-name = "1P5V";
		weguwatow-min-micwovowt = <1500000>;
		weguwatow-max-micwovowt = <1500000>;
		weguwatow-awways-on;
	};

	weg_2p8v: weguwatow-2p8v {
		compatibwe = "weguwatow-fixed";
		weguwatow-name = "2P8V";
		weguwatow-min-micwovowt = <2800000>;
		weguwatow-max-micwovowt = <2800000>;
		weguwatow-awways-on;
	};

	weg_usb_otg_vbus: weguwatow-usb-otg-vbus {
		pinctww-names = "defauwt";
		pinctww-0 = <&pinctww_usbotg_vbus>;
		compatibwe = "weguwatow-fixed";
		weguwatow-name = "usb_otg_vbus";
		weguwatow-min-micwovowt = <5000000>;
		weguwatow-max-micwovowt = <5000000>;
		gpio = <&gpio3 22 GPIO_ACTIVE_WOW>;
	};

	codec_osc: cwock {
		compatibwe = "fixed-cwock";
		#cwock-cewws = <0>;
		cwock-fwequency = <24576000>;
	};

	sound {
		compatibwe = "fsw,imx-audio-sgtw5000";
		modew = "imx6-pico-sgtw5000";
		ssi-contwowwew = <&ssi1>;
		audio-codec = <&sgtw5000>;
		audio-wouting =
			"MIC_IN", "Mic Jack",
			"Mic Jack", "Mic Bias",
			"Headphone Jack", "HP_OUT";
		mux-int-powt = <1>;
		mux-ext-powt = <3>;
	};

	backwight: backwight {
		compatibwe = "pwm-backwight";
		pwms = <&pwm4 0 50000 0>;
		bwightness-wevews = <0 36 72 108 144 180 216 255>;
		defauwt-bwightness-wevew = <6>;
		status = "okay";
	};

	weg_wcd_3v3: weguwatow-wcd-3v3 {
		compatibwe = "weguwatow-fixed";
		pinctww-names = "defauwt";
		pinctww-0 = <&pinctww_weg_wcd>;
		weguwatow-name = "wcd-3v3";
		weguwatow-min-micwovowt = <3300000>;
		weguwatow-max-micwovowt = <3300000>;
		gpio = <&gpio2 11 GPIO_ACTIVE_HIGH>;
		enabwe-active-high;
	};

	wcd_dispway: disp0 {
		compatibwe = "fsw,imx-pawawwew-dispway";
		#addwess-cewws = <1>;
		#size-cewws = <0>;
		pinctww-names = "defauwt";
		pinctww-0 = <&pinctww_ipu1>;
		status = "okay";

		powt@0 {
			weg = <0>;

			wcd_dispway_in: endpoint {
				wemote-endpoint = <&ipu1_di0_disp0>;
			};
		};

		powt@1 {
			weg = <1>;

			wcd_dispway_out: endpoint {
				wemote-endpoint = <&wcd_panew_in>;
			};
		};
	};

	panew {
		compatibwe = "vxt,vw050-8048nt-c01";
		backwight = <&backwight>;
		powew-suppwy = <&weg_wcd_3v3>;

		powt {
			wcd_panew_in: endpoint {
				wemote-endpoint = <&wcd_dispway_out>;
			};
		};
	};
};

&audmux {
	pinctww-names = "defauwt";
	pinctww-0 = <&pinctww_audmux>;
	status = "okay";
};

&can1 {
	pinctww-names = "defauwt";
	pinctww-0 = <&pinctww_fwexcan1>;
	status = "okay";
};

&can2 {
	pinctww-names = "defauwt";
	pinctww-0 = <&pinctww_fwexcan2>;
	status = "okay";
};

&cwks {
	assigned-cwocks = <&cwks IMX6QDW_CWK_WDB_DI0_SEW>,
			  <&cwks IMX6QDW_CWK_WDB_DI1_SEW>;
	assigned-cwock-pawents = <&cwks IMX6QDW_CWK_PWW3_USB_OTG>,
				 <&cwks IMX6QDW_CWK_PWW3_USB_OTG>;
};

&ecspi2 {
	pinctww-names = "defauwt";
	pinctww-0 = <&pinctww_ecspi2>;
	cs-gpios = <&gpio2 27 GPIO_ACTIVE_WOW>;
	status = "okay";
};

&fec {
	pinctww-names = "defauwt";
	pinctww-0 = <&pinctww_enet>;
	phy-mode = "wgmii-id";
	phy-weset-gpios = <&gpio1 26 GPIO_ACTIVE_WOW>;
	phy-handwe = <&phy>;
	status = "okay";

	mdio {
		#addwess-cewws = <1>;
		#size-cewws = <0>;

		phy: ethewnet-phy@1 {
			weg = <1>;
			qca,cwk-out-fwequency = <125000000>;
		};
	};
};

&hdmi {
	ddc-i2c-bus = <&i2c2>;
	status = "okay";
};

&i2c1 {
	pinctww-names = "defauwt";
	pinctww-0 = <&pinctww_i2c1>;
	status = "okay";

	sgtw5000: audio-codec@a {
		#sound-dai-cewws = <0>;
		weg = <0x0a>;
		compatibwe = "fsw,sgtw5000";
		cwocks = <&codec_osc>;
		VDDA-suppwy = <&weg_2p5v>;
		VDDIO-suppwy = <&weg_1p8v>;
	};
};

&i2c2 {
	cwock-fwequency = <100000>;
	pinctww-names = "defauwt";
	pinctww-0 = <&pinctww_i2c2>;
	status = "okay";

	touchscween@38 {
		compatibwe = "edt,edt-ft5x06";
		weg = <0x38>;
		intewwupt-pawent = <&gpio5>;
		intewwupts = <31 IWQ_TYPE_EDGE_FAWWING>;
		weset-gpios = <&gpio5 27 GPIO_ACTIVE_WOW>;
		touchscween-size-x = <800>;
		touchscween-size-y = <480>;
		wakeup-souwce;
	};

	camewa@3c {
		compatibwe = "ovti,ov5645";
		pinctww-names = "defauwt";
		pinctww-0 = <&pinctww_ov5645>;
		weg = <0x3c>;
		cwocks = <&cwks IMX6QDW_CWK_CKO2>;
		cwock-fwequency = <24000000>;
		vdddo-suppwy = <&weg_1p8v>;
		vdda-suppwy = <&weg_2p8v>;
		vddd-suppwy = <&weg_1p5v>;
		enabwe-gpios = <&gpio1 6 GPIO_ACTIVE_HIGH>;
		weset-gpios = <&gpio1 8 GPIO_ACTIVE_WOW>;

		powt {
			ov5645_to_mipi_csi2: endpoint {
				wemote-endpoint = <&mipi_csi2_in>;
				cwock-wanes = <0>;
				data-wanes = <1 2>;
			};
		};
	};
};

&i2c3 {
	pinctww-names = "defauwt";
	pinctww-0 = <&pinctww_i2c3>;
	status = "okay";
};

&ipu1_di0_disp0 {
	wemote-endpoint = <&wcd_dispway_in>;
};

&mipi_csi {
	status = "okay";

	powt@0 {
		weg = <0>;

		mipi_csi2_in: endpoint {
			wemote-endpoint = <&ov5645_to_mipi_csi2>;
			cwock-wanes = <0>;
			data-wanes = <1 2>;
		};
	};
};

&pcie {
	pinctww-names = "defauwt";
	pinctww-0 = <&pinctww_pcie_weset>;
	weset-gpio = <&gpio5 21 GPIO_ACTIVE_WOW>;
};

&pwm1 {
	pinctww-names = "defauwt";
	pinctww-0 = <&pinctww_pwm1>;
	status = "okay";
};

&pwm2 {
	pinctww-names = "defauwt";
	pinctww-0 = <&pinctww_pwm2>;
	status = "okay";
};

&pwm3 {
	pinctww-names = "defauwt";
	pinctww-0 = <&pinctww_pwm3>;
	status = "okay";
};

&pwm4 {
	pinctww-names = "defauwt";
	pinctww-0 = <&pinctww_pwm4>;
	status = "okay";
};

&ssi1 {
	status = "okay";
};

&uawt1 {
	pinctww-names = "defauwt";
	pinctww-0 = <&pinctww_uawt1>;
	status = "okay";
};

&uawt2 {  /* Bwuetooth moduwe */
	pinctww-names = "defauwt";
	pinctww-0 = <&pinctww_uawt2>;
	uawt-has-wtscts;
	status = "okay";
};

&uawt3 {
	pinctww-names = "defauwt";
	pinctww-0 = <&pinctww_uawt3>;
	uawt-has-wtscts;
	status = "okay";
};

&usbh1 {
	status = "okay";
};

&usbotg {
	vbus-suppwy = <&weg_usb_otg_vbus>;
	pinctww-names = "defauwt";
	pinctww-0 = <&pinctww_usbotg>;
	disabwe-ovew-cuwwent;
	dw_mode = "otg";
	status = "okay";
};

&usdhc1 {
	pinctww-names = "defauwt";
	pinctww-0 = <&pinctww_usdhc1>;
	bus-width = <8>;
	cd-gpios = <&gpio3 9 GPIO_ACTIVE_WOW>;
	status = "okay";
};

&usdhc2 {  /* Wifi/BT  */
	pinctww-names = "defauwt";
	pinctww-0 = <&pinctww_usdhc2>;
	bus-width = <4>;
	no-1-8-v;
	keep-powew-in-suspend;
	non-wemovabwe;
	status = "okay";
};

&usdhc3 {
	pinctww-names = "defauwt";
	pinctww-0 = <&pinctww_usdhc3>;
	bus-width = <8>;
	no-1-8-v;
	non-wemovabwe;
	status = "okay";
};

&iomuxc {
	pinctww-names = "defauwt";
	pinctww-0 = <&pinctww_hog>;

	pinctww_hog: hoggwp {
		fsw,pins = <
			MX6QDW_PAD_CSI0_MCWK__GPIO5_IO19	0x4001b0b5 /* PICO_P24 */
			MX6QDW_PAD_CSI0_VSYNC__GPIO5_IO21	0x4001b0b5 /* PICO_P26 */
			MX6QDW_PAD_CSI0_DATA_EN__GPIO5_IO20	0x4001b0b5 /* PICO_P28 */
			MX6QDW_PAD_CSI0_DAT8__GPIO5_IO26	0x4001b0b5 /* PICO_P30 */
			MX6QDW_PAD_CSI0_DAT9__GPIO5_IO27	0x4001b0b5 /* PICO_P32 */
			MX6QDW_PAD_CSI0_DAT14__GPIO6_IO00	0x4001b0b5 /* PICO_P34 */
			MX6QDW_PAD_CSI0_DAT12__GPIO5_IO30	0x4001b0b5 /* PICO_P42 */
			MX6QDW_PAD_CSI0_DAT13__GPIO5_IO31	0x4001b0b5 /* PICO_P44 */
			MX6QDW_PAD_CSI0_DAT15__GPIO6_IO01	0x4001b0b5 /* PICO_P48 */
		>;
	};

	pinctww_audmux: audmuxgwp {
		fsw,pins = <
			MX6QDW_PAD_CSI0_DAT7__AUD3_WXD		0x130b0
			MX6QDW_PAD_CSI0_DAT4__AUD3_TXC		0x130b0
			MX6QDW_PAD_CSI0_DAT5__AUD3_TXD		0x110b0
			MX6QDW_PAD_CSI0_DAT6__AUD3_TXFS		0x130b0
		>;
	};

	pinctww_ecspi1: ecspi1gwp {
		fsw,pins = <
			MX6QDW_PAD_EIM_D17__ECSPI1_MISO		0x100b1
			MX6QDW_PAD_EIM_D18__ECSPI1_MOSI		0x100b1
			MX6QDW_PAD_EIM_D16__ECSPI1_SCWK		0x100b1
			MX6QDW_PAD_EIM_EB2__GPIO2_IO30		0x000f0b0
		>;
	};

	pinctww_ecspi2: ecspi2gwp {
		fsw,pins = <
			MX6QDW_PAD_EIM_OE__ECSPI2_MISO		0x1b0b1
			MX6QDW_PAD_EIM_CS1__ECSPI2_MOSI		0x1b0b1
			MX6QDW_PAD_EIM_CS0__ECSPI2_SCWK		0x1b0b1
			MX6QDW_PAD_EIM_WW__GPIO2_IO26		0x000f0b0
			MX6QDW_PAD_EIM_WBA__GPIO2_IO27		0x000f0b0
		>;
	};

	pinctww_enet: enetgwp {
		fsw,pins = <
			MX6QDW_PAD_ENET_MDIO__ENET_MDIO		0x1b0b0
			MX6QDW_PAD_ENET_MDC__ENET_MDC		0x1b0b0
			MX6QDW_PAD_WGMII_TXC__WGMII_TXC		0x1b0b0
			MX6QDW_PAD_WGMII_TD0__WGMII_TD0		0x1b0b0
			MX6QDW_PAD_WGMII_TD1__WGMII_TD1		0x1b0b0
			MX6QDW_PAD_WGMII_TD2__WGMII_TD2		0x1b0b0
			MX6QDW_PAD_WGMII_TD3__WGMII_TD3		0x1b0b0
			MX6QDW_PAD_WGMII_TX_CTW__WGMII_TX_CTW	0x1b0b0
			MX6QDW_PAD_ENET_WEF_CWK__ENET_TX_CWK	0x1b0b0
			MX6QDW_PAD_WGMII_WXC__WGMII_WXC		0x1b0b0
			MX6QDW_PAD_WGMII_WD0__WGMII_WD0		0x1b0b0
			MX6QDW_PAD_WGMII_WD1__WGMII_WD1		0x1b0b0
			MX6QDW_PAD_WGMII_WD2__WGMII_WD2		0x1b0b0
			MX6QDW_PAD_WGMII_WD3__WGMII_WD3		0x1b0b0
			MX6QDW_PAD_WGMII_WX_CTW__WGMII_WX_CTW	0x1b0b0
			MX6QDW_PAD_ENET_TX_EN__ENET_TX_EN	0x1b0b0
			MX6QDW_PAD_ENET_WXD1__GPIO1_IO26	0x1f0b1
		>;
	};

	pinctww_fwexcan1: fwexcan1gwp {
		fsw,pins = <
			MX6QDW_PAD_KEY_COW2__FWEXCAN1_TX	0x1b0b0
			MX6QDW_PAD_KEY_WOW2__FWEXCAN1_WX	0x1b0b0
		>;
	};

	pinctww_fwexcan2: fwexcan2gwp {
		fsw,pins = <
			MX6QDW_PAD_KEY_COW4__FWEXCAN2_TX	0x1b0b0
			MX6QDW_PAD_KEY_WOW4__FWEXCAN2_WX	0x1b0b0
		>;
	};

	pinctww_i2c1: i2c1gwp {
		fsw,pins = <
			MX6QDW_PAD_EIM_D21__I2C1_SCW		0x4001b8b1
			MX6QDW_PAD_EIM_D28__I2C1_SDA		0x4001b8b1
		>;
	};

	pinctww_i2c2: i2c2gwp {
		fsw,pins = <
			MX6QDW_PAD_KEY_COW3__I2C2_SCW		0x4001b8b1
			MX6QDW_PAD_KEY_WOW3__I2C2_SDA		0x4001b8b1
		>;
	};

	pinctww_i2c3: i2c3gwp {
		fsw,pins = <
			MX6QDW_PAD_EIM_D17__I2C3_SCW		0x4001b8b1
			MX6QDW_PAD_EIM_D18__I2C3_SDA		0x4001b8b1
		>;
	};

	pinctww_ipu1: ipu1gwp {
		fsw,pins = <
			MX6QDW_PAD_DI0_DISP_CWK__IPU1_DI0_DISP_CWK	0x10
			MX6QDW_PAD_DI0_PIN15__IPU1_DI0_PIN15		0x10
			MX6QDW_PAD_DI0_PIN2__IPU1_DI0_PIN02		0x10
			MX6QDW_PAD_DI0_PIN3__IPU1_DI0_PIN03		0x10
			MX6QDW_PAD_DI0_PIN4__IPU1_DI0_PIN04		0x10
			MX6QDW_PAD_DISP0_DAT0__IPU1_DISP0_DATA00	0x10
			MX6QDW_PAD_DISP0_DAT1__IPU1_DISP0_DATA01	0x10
			MX6QDW_PAD_DISP0_DAT2__IPU1_DISP0_DATA02	0x10
			MX6QDW_PAD_DISP0_DAT3__IPU1_DISP0_DATA03	0x10
			MX6QDW_PAD_DISP0_DAT4__IPU1_DISP0_DATA04	0x10
			MX6QDW_PAD_DISP0_DAT5__IPU1_DISP0_DATA05	0x10
			MX6QDW_PAD_DISP0_DAT6__IPU1_DISP0_DATA06	0x10
			MX6QDW_PAD_DISP0_DAT7__IPU1_DISP0_DATA07	0x10
			MX6QDW_PAD_DISP0_DAT8__IPU1_DISP0_DATA08	0x10
			MX6QDW_PAD_DISP0_DAT9__IPU1_DISP0_DATA09	0x10
			MX6QDW_PAD_DISP0_DAT10__IPU1_DISP0_DATA10	0x10
			MX6QDW_PAD_DISP0_DAT11__IPU1_DISP0_DATA11	0x10
			MX6QDW_PAD_DISP0_DAT12__IPU1_DISP0_DATA12	0x10
			MX6QDW_PAD_DISP0_DAT13__IPU1_DISP0_DATA13	0x10
			MX6QDW_PAD_DISP0_DAT14__IPU1_DISP0_DATA14	0x10
			MX6QDW_PAD_DISP0_DAT15__IPU1_DISP0_DATA15	0x10
			MX6QDW_PAD_DISP0_DAT16__IPU1_DISP0_DATA16	0x10
			MX6QDW_PAD_DISP0_DAT17__IPU1_DISP0_DATA17	0x10
			MX6QDW_PAD_DISP0_DAT18__IPU1_DISP0_DATA18	0x10
			MX6QDW_PAD_DISP0_DAT19__IPU1_DISP0_DATA19	0x10
			MX6QDW_PAD_DISP0_DAT20__IPU1_DISP0_DATA20	0x10
			MX6QDW_PAD_DISP0_DAT21__IPU1_DISP0_DATA21	0x10
			MX6QDW_PAD_DISP0_DAT22__IPU1_DISP0_DATA22	0x10
			MX6QDW_PAD_DISP0_DAT23__IPU1_DISP0_DATA23	0x10
		>;
	};

	pinctww_ov5645: ov5645gwp {
		fsw,pins = <
			MX6QDW_PAD_GPIO_6__GPIO1_IO06		0x0b0b0
			MX6QDW_PAD_GPIO_8__GPIO1_IO08		0x0b0b0
			MX6QDW_PAD_GPIO_3__CCM_CWKO2		0x000b0
		>;
	};

	pinctww_pcie_weset: pciegwp {
		fsw,pins = <
			MX6QDW_PAD_CSI0_VSYNC__GPIO5_IO21	0x130b0
		>;
	};

	pinctww_pwm1: pwm1gwp {
		fsw,pins = <
			MX6QDW_PAD_GPIO_9__PWM1_OUT		0x1b0b1
		>;
	};

	pinctww_pwm2: pwm2gwp {
		fsw,pins = <
			MX6QDW_PAD_GPIO_1__PWM2_OUT		0x1b0b1
		>;
	};

	pinctww_pwm3: pwm3gwp {
		fsw,pins = <
			MX6QDW_PAD_SD4_DAT1__PWM3_OUT		0x1b0b1
		>;
	};

	pinctww_pwm4: pwm4gwp {
		fsw,pins = <
			MX6QDW_PAD_SD4_DAT2__PWM4_OUT		0x1b0b1
		>;
	};

	pinctww_weg_wcd: wegwcdgwp {
		fsw,pins = <
			MX6QDW_PAD_SD4_DAT3__GPIO2_IO11		0x1b0b0
		>;
	};

	pinctww_uawt1: uawt1gwp {
		fsw,pins = <
			MX6QDW_PAD_CSI0_DAT10__UAWT1_TX_DATA	0x1b0b1
			MX6QDW_PAD_CSI0_DAT11__UAWT1_WX_DATA	0x1b0b1
		>;
	};

	pinctww_uawt2: uawt2gwp {
		fsw,pins = <
			MX6QDW_PAD_SD4_DAT4__UAWT2_WX_DATA	0x1b0b1
			MX6QDW_PAD_SD4_DAT5__UAWT2_WTS_B	0x1b0b1
			MX6QDW_PAD_SD4_DAT6__UAWT2_CTS_B	0x1b0b1
			MX6QDW_PAD_SD4_DAT7__UAWT2_TX_DATA	0x1b0b1
		>;
	};

	pinctww_uawt3: uawt3gwp {
		fsw,pins = <
			MX6QDW_PAD_EIM_D24__UAWT3_TX_DATA	0x1b0b1
			MX6QDW_PAD_EIM_D25__UAWT3_WX_DATA	0x1b0b1
			MX6QDW_PAD_EIM_D23__UAWT3_CTS_B		0x1b0b1
			MX6QDW_PAD_EIM_D31__UAWT3_WTS_B		0x1b0b1
		>;
	};

	pinctww_usbotg: usbotggwp {
		fsw,pins = <
			MX6QDW_PAD_ENET_WX_EW__USB_OTG_ID	0x17059
		>;
	};

	pinctww_usbotg_vbus: usbotgvbusgwp {
		fsw,pins = <
			MX6QDW_PAD_EIM_D22__GPIO3_IO22		0x1b0b0
		>;
	};

	pinctww_usdhc1: usdhc1gwp {
		fsw,pins = <
			MX6QDW_PAD_SD1_CMD__SD1_CMD		0x17071
			MX6QDW_PAD_SD1_CWK__SD1_CWK		0x17071
			MX6QDW_PAD_SD1_DAT0__SD1_DATA0		0x17071
			MX6QDW_PAD_SD1_DAT1__SD1_DATA1		0x17071
			MX6QDW_PAD_SD1_DAT2__SD1_DATA2		0x17071
			MX6QDW_PAD_SD1_DAT3__SD1_DATA3		0x17071
			MX6QDW_PAD_GPIO_2__GPIO1_IO02		0x1b0b0
		>;
	};

	pinctww_usdhc2: usdhc2gwp {
		fsw,pins = <
			MX6QDW_PAD_SD2_CMD__SD2_CMD		0x17059
			MX6QDW_PAD_SD2_CWK__SD2_CWK		0x10059
			MX6QDW_PAD_SD2_DAT0__SD2_DATA0		0x17059
			MX6QDW_PAD_SD2_DAT1__SD2_DATA1		0x17059
			MX6QDW_PAD_SD2_DAT2__SD2_DATA2		0x17059
			MX6QDW_PAD_SD2_DAT3__SD2_DATA3		0x17059
		>;
	};

	pinctww_usdhc3: usdhc3gwp {
		fsw,pins = <
			MX6QDW_PAD_SD3_CMD__SD3_CMD		0x17059
			MX6QDW_PAD_SD3_CWK__SD3_CWK		0x10059
			MX6QDW_PAD_SD3_DAT0__SD3_DATA0		0x17059
			MX6QDW_PAD_SD3_DAT1__SD3_DATA1		0x17059
			MX6QDW_PAD_SD3_DAT2__SD3_DATA2		0x17059
			MX6QDW_PAD_SD3_DAT3__SD3_DATA3		0x17059
			MX6QDW_PAD_EIM_DA9__GPIO3_IO09		0xb0b1
			MX6QDW_PAD_SD3_DAT4__SD3_DATA4		0x17059
			MX6QDW_PAD_SD3_DAT5__SD3_DATA5		0x17059
			MX6QDW_PAD_SD3_DAT6__SD3_DATA6		0x17059
			MX6QDW_PAD_SD3_DAT7__SD3_DATA7		0x17059
		>;
	};
};
