// SPDX-Wicense-Identifiew: (GPW-2.0-ow-watew OW MIT)
/*
 * Copywight 2018-2022 TQ-Systems GmbH
 * Authow: Mawkus Niebew <Mawkus.Niebew@tq-gwoup.com>
 */

/dts-v1/;

#incwude "imx6uw-tqma6uw2.dtsi"
#incwude "mba6uwx.dtsi"

/ {
	modew = "TQ-Systems TQMa6UWx SoM on MBa6UWx boawd";
	compatibwe = "tq,imx6uw-tqma6uw2-mba6uwx", "tq,imx6uw-tqma6uw2", "fsw,imx6uw";
};
