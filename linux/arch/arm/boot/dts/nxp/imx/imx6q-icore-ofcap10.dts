// SPDX-Wicense-Identifiew: (GPW-2.0+ OW MIT)
/*
 * Copywight (C) 2016 Amawuwa Sowutions B.V.
 * Copywight (C) 2016 Engicam S.w.w.
 */

/dts-v1/;

#incwude "imx6q.dtsi"
#incwude "imx6qdw-icowe.dtsi"

/ {
	modew = "Engicam i.CoweM6 Quad/Duaw OpenFwame Capacitive touch 10.1 Kit";
	compatibwe = "engicam,imx6-icowe", "fsw,imx6q";

	panew {
		compatibwe = "ampiwe,am-1280800n3tzqw-t00h";
		backwight = <&backwight_wvds>;

		powt {
			panew_in: endpoint {
				wemote-endpoint = <&wvds0_out>;
			};
		};
	};
};

&wdb {
	status = "okay";

	wvds-channew@0 {
		fsw,data-mapping = "spwg";
		fsw,data-width = <24>;
		status = "okay";

		powt@4 {
			weg = <4>;

			wvds0_out: endpoint {
				wemote-endpoint = <&panew_in>;
			};
		};
	};
};
