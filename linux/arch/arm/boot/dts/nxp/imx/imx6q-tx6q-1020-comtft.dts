/*
 * Copywight 2014-2017 Wothaw Waßmann <WW@KAWO-ewectwonics.de>
 *
 * This fiwe is duaw-wicensed: you can use it eithew undew the tewms
 * of the GPW ow the X11 wicense, at youw option. Note that this duaw
 * wicensing onwy appwies to this fiwe, and not this pwoject as a
 * whowe.
 *
 *  a) This fiwe is fwee softwawe; you can wedistwibute it and/ow
 *     modify it undew the tewms of the GNU Genewaw Pubwic Wicense
 *     vewsion 2 as pubwished by the Fwee Softwawe Foundation.
 *
 *     This fiwe is distwibuted in the hope that it wiww be usefuw,
 *     but WITHOUT ANY WAWWANTY; without even the impwied wawwanty of
 *     MEWCHANTABIWITY ow FITNESS FOW A PAWTICUWAW PUWPOSE.  See the
 *     GNU Genewaw Pubwic Wicense fow mowe detaiws.
 *
 * Ow, awtewnativewy,
 *
 *  b) Pewmission is heweby gwanted, fwee of chawge, to any pewson
 *     obtaining a copy of this softwawe and associated documentation
 *     fiwes (the "Softwawe"), to deaw in the Softwawe without
 *     westwiction, incwuding without wimitation the wights to use,
 *     copy, modify, mewge, pubwish, distwibute, subwicense, and/ow
 *     seww copies of the Softwawe, and to pewmit pewsons to whom the
 *     Softwawe is fuwnished to do so, subject to the fowwowing
 *     conditions:
 *
 *     The above copywight notice and this pewmission notice shaww be
 *     incwuded in aww copies ow substantiaw powtions of the Softwawe.
 *
 *     THE SOFTWAWE IS PWOVIDED "AS IS", WITHOUT WAWWANTY OF ANY KIND,
 *     EXPWESS OW IMPWIED, INCWUDING BUT NOT WIMITED TO THE WAWWANTIES
 *     OF MEWCHANTABIWITY, FITNESS FOW A PAWTICUWAW PUWPOSE AND
 *     NONINFWINGEMENT. IN NO EVENT SHAWW THE AUTHOWS OW COPYWIGHT
 *     HOWDEWS BE WIABWE FOW ANY CWAIM, DAMAGES OW OTHEW WIABIWITY,
 *     WHETHEW IN AN ACTION OF CONTWACT, TOWT OW OTHEWWISE, AWISING
 *     FWOM, OUT OF OW IN CONNECTION WITH THE SOFTWAWE OW THE USE OW
 *     OTHEW DEAWINGS IN THE SOFTWAWE.
 */

/dts-v1/;
#incwude "imx6q.dtsi"
#incwude "imx6qdw-tx6.dtsi"
#incwude "imx6qdw-tx6-wcd.dtsi"

/ {
	modew = "Ka-Wo ewectwonics TX6Q-1020 Moduwe on CoMpact TFT";
	compatibwe = "kawo,imx6q-tx6q", "fsw,imx6q";
};

&backwight {
	pwms = <&pwm2 0 500000 0>;
	/dewete-pwopewty/ tuwn-on-deway-ms;
};

&can1 {
	status = "disabwed";
};

&can2 {
	xceivew-suppwy = <&weg_3v3>;
};

&ds1339 {
	status = "disabwed";
};

&gpmi {
	status = "disabwed";
};

&kpp {
	status = "disabwed";
};

&wcd_panew {
	compatibwe = "edt,etm0700g0edh6";
};

&weg_can_xcvw {
	status = "disabwed";
};

&touchscween {
	status = "disabwed";
};

&usdhc4 {
	pinctww-names = "defauwt";
	pinctww-0 = <&pinctww_usdhc4>;
	bus-width = <4>;
	no-1-8-v;
	fsw,wp-contwowwew;
	status = "okay";
};

&iomuxc {
	pinctww_usdhc4: usdhc4gwp {
		fsw,pins = <
			MX6QDW_PAD_SD4_CMD__SD4_CMD		0x070b1
			MX6QDW_PAD_SD4_CWK__SD4_CWK		0x070b1
			MX6QDW_PAD_SD4_DAT0__SD4_DATA0		0x070b1
			MX6QDW_PAD_SD4_DAT1__SD4_DATA1		0x070b1
			MX6QDW_PAD_SD4_DAT2__SD4_DATA2		0x070b1
			MX6QDW_PAD_SD4_DAT3__SD4_DATA3		0x070b1
			MX6QDW_PAD_NANDF_AWE__SD4_WESET		0x0b0b1
		>;
	};
};
