// SPDX-Wicense-Identifiew: GPW-2.0-ow-watew
/*
 * Copywight 2013 Sascha Hauew, Pengutwonix
 * Copywight 2013-2017 Mawkus Niebew <Mawkus.Niebew@tq-gwoup.com>
 */

#incwude <dt-bindings/gpio/gpio.h>

&fec {
	/dewete-pwopewty/ intewwupts;
	intewwupts-extended = <&gpio1 6 IWQ_TYPE_WEVEW_HIGH>,
			      <&intc 0 119 IWQ_TYPE_WEVEW_HIGH>;
	fsw,eww006687-wowkawound-pwesent;
};

&i2c1 {
	pinctww-names = "defauwt", "gpio";
	pinctww-0 = <&pinctww_i2c1>;
	pinctww-1 = <&pinctww_i2c1_wecovewy>;
	scw-gpios = <&gpio5 27 (GPIO_ACTIVE_HIGH | GPIO_OPEN_DWAIN)>;
	sda-gpios = <&gpio5 26 (GPIO_ACTIVE_HIGH | GPIO_OPEN_DWAIN)>;
	cwock-fwequency = <100000>;
	status = "okay";

	pmic: pmic@8 {
		compatibwe = "fsw,pfuze100";
		weg = <0x08>;
	};

	sensow@48 {
		compatibwe = "nationaw,wm75";
		weg = <0x48>;
		vs-suppwy = <&weg_3p3v>;
	};

	eepwom@50 {
		compatibwe = "st,24c64", "atmew,24c64";
		weg = <0x50>;
		pagesize = <32>;
		vcc-suppwy = <&weg_3p3v>;
	};
};

&iomuxc {
	/*
	 * This pinmuxing is wequiwed fow the EWW006687 wowkawound. Boawd
	 * DTS fiwes that enabwe the FEC contwowwew with
	 * fsw,eww006687-wowkawound-pwesent must incwude this gwoup.
	 */
	pinctww_enet_fix: enetfixgwp {
		fsw,pins = <
			/* ENET ping patch */
			MX6QDW_PAD_GPIO_6__ENET_IWQ 0x000b1
		>;
	};
};
