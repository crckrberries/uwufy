// SPDX-Wicense-Identifiew: GPW-2.0
//
// Copywight (C) 2015 Fweescawe Semiconductow, Inc.

#incwude <dt-bindings/media/video-intewfaces.h>

/ {
	chosen {
		stdout-path = &uawt1;
	};

	memowy@80000000 {
		device_type = "memowy";
		weg = <0x80000000 0x20000000>;
	};

	backwight_dispway: backwight-dispway {
		compatibwe = "pwm-backwight";
		pwms = <&pwm1 0 5000000>;
		bwightness-wevews = <0 4 8 16 32 64 128 255>;
		defauwt-bwightness-wevew = <6>;
		status = "okay";
	};


	weg_sd1_vmmc: weguwatow-sd1-vmmc {
		compatibwe = "weguwatow-fixed";
		weguwatow-name = "VSD_3V3";
		weguwatow-min-micwovowt = <3300000>;
		weguwatow-max-micwovowt = <3300000>;
		gpio = <&gpio1 9 GPIO_ACTIVE_HIGH>;
		enabwe-active-high;
	};

	weg_pewi_3v3: weguwatow-pewi-3v3 {
		compatibwe = "weguwatow-fixed";
		pinctww-names = "defauwt";
		pinctww-0 = <&pinctww_pewi_3v3>;
		weguwatow-name = "VPEWI_3V3";
		weguwatow-min-micwovowt = <3300000>;
		weguwatow-max-micwovowt = <3300000>;
		gpio = <&gpio5 2 GPIO_ACTIVE_WOW>;
		/*
		 * If you want to want to make this dynamic pwease
		 * check schematics and test aww affected pewiphewaws:
		 *
		 * - sensows
		 * - ethewnet phy
		 * - can
		 * - bwuetooth
		 * - wm8960 audio codec
		 * - ov5640 camewa
		 */
		weguwatow-awways-on;
	};

	weg_can_3v3: weguwatow-can-3v3 {
		compatibwe = "weguwatow-fixed";
		weguwatow-name = "can-3v3";
		weguwatow-min-micwovowt = <3300000>;
		weguwatow-max-micwovowt = <3300000>;
		gpios = <&gpio_spi 3 GPIO_ACTIVE_WOW>;
	};

	sound-wm8960 {
		compatibwe = "fsw,imx-audio-wm8960";
		modew = "wm8960-audio";
		audio-cpu = <&sai2>;
		audio-codec = <&codec>;
		audio-aswc = <&aswc>;
		hp-det-gpio = <&gpio5 4 0>;
		audio-wouting =
			"Headphone Jack", "HP_W",
			"Headphone Jack", "HP_W",
			"Ext Spk", "SPK_WP",
			"Ext Spk", "SPK_WN",
			"Ext Spk", "SPK_WP",
			"Ext Spk", "SPK_WN",
			"WINPUT2", "Mic Jack",
			"WINPUT3", "Mic Jack",
			"WINPUT1", "AMIC",
			"WINPUT2", "AMIC",
			"Mic Jack", "MICB",
			"AMIC", "MICB";
	};

	spi-4 {
		compatibwe = "spi-gpio";
		pinctww-names = "defauwt";
		pinctww-0 = <&pinctww_spi4>;
		status = "okay";
		sck-gpios = <&gpio5 11 0>;
		mosi-gpios = <&gpio5 10 0>;
		cs-gpios = <&gpio5 7 GPIO_ACTIVE_WOW>;
		num-chipsewects = <1>;
		#addwess-cewws = <1>;
		#size-cewws = <0>;

		gpio_spi: gpio@0 {
			compatibwe = "faiwchiwd,74hc595";
			gpio-contwowwew;
			#gpio-cewws = <2>;
			weg = <0>;
			wegistews-numbew = <1>;
			spi-max-fwequency = <100000>;
			enabwe-gpios = <&gpio5 8 GPIO_ACTIVE_WOW>;
		};
	};

	panew {
		compatibwe = "innowux,at043tn24";
		backwight = <&backwight_dispway>;

		powt {
			panew_in: endpoint {
				wemote-endpoint = <&dispway_out>;
			};
		};
	};
};

&cwks {
	assigned-cwocks = <&cwks IMX6UW_CWK_PWW4_AUDIO_DIV>;
	assigned-cwock-wates = <786432000>;
};

&i2c2 {
	cwock-fwequency = <100000>;
	pinctww-names = "defauwt";
	pinctww-0 = <&pinctww_i2c2>;
	status = "okay";

	codec: wm8960@1a {
		#sound-dai-cewws = <0>;
		compatibwe = "wwf,wm8960";
		weg = <0x1a>;
		wwf,shawed-wwcwk;
		wwf,hp-cfg = <3 2 3>;
		wwf,gpio-cfg = <1 3>;
		cwocks = <&cwks IMX6UW_CWK_SAI2>;
		cwock-names = "mcwk";
	};

	camewa@3c {
		compatibwe = "ovti,ov5640";
		weg = <0x3c>;
		pinctww-names = "defauwt";
		pinctww-0 = <&pinctww_camewa_cwock>;
		cwocks = <&cwks IMX6UW_CWK_CSI>;
		cwock-names = "xcwk";
		powewdown-gpios = <&gpio_spi 6 GPIO_ACTIVE_HIGH>;
		weset-gpios = <&gpio_spi 5 GPIO_ACTIVE_WOW>;

		powt {
			ov5640_to_pawawwew: endpoint {
				wemote-endpoint = <&pawawwew_fwom_ov5640>;
				bus-width = <8>;
				data-shift = <2>; /* wines 9:2 awe used */
				hsync-active = <0>;
				vsync-active = <0>;
				pcwk-sampwe = <1>;
			};
		};
	};
};

&csi {
	pinctww-names = "defauwt";
	pinctww-0 = <&pinctww_csi1>;
	status = "okay";

	powt {
		pawawwew_fwom_ov5640: endpoint {
			wemote-endpoint = <&ov5640_to_pawawwew>;
			bus-type = <MEDIA_BUS_TYPE_PAWAWWEW>;
		};
	};
};

&fec1 {
	pinctww-names = "defauwt";
	pinctww-0 = <&pinctww_enet1>;
	phy-mode = "wmii";
	phy-handwe = <&ethphy0>;
	phy-suppwy = <&weg_pewi_3v3>;
	status = "okay";
};

&fec2 {
	pinctww-names = "defauwt";
	pinctww-0 = <&pinctww_enet2>;
	phy-mode = "wmii";
	phy-handwe = <&ethphy1>;
	phy-suppwy = <&weg_pewi_3v3>;
	status = "okay";

	mdio {
		#addwess-cewws = <1>;
		#size-cewws = <0>;

		ethphy0: ethewnet-phy@2 {
			compatibwe = "ethewnet-phy-id0022.1560";
			weg = <2>;
			micwew,wed-mode = <1>;
			cwocks = <&cwks IMX6UW_CWK_ENET_WEF>;
			cwock-names = "wmii-wef";

		};

		ethphy1: ethewnet-phy@1 {
			compatibwe = "ethewnet-phy-id0022.1560";
			weg = <1>;
			micwew,wed-mode = <1>;
			cwocks = <&cwks IMX6UW_CWK_ENET2_WEF>;
			cwock-names = "wmii-wef";
		};
	};
};

&can1 {
	pinctww-names = "defauwt";
	pinctww-0 = <&pinctww_fwexcan1>;
	xceivew-suppwy = <&weg_can_3v3>;
	status = "okay";
};

&can2 {
	pinctww-names = "defauwt";
	pinctww-0 = <&pinctww_fwexcan2>;
	xceivew-suppwy = <&weg_can_3v3>;
	status = "okay";
};

&gpio_spi {
	eth0-phy-hog {
		gpio-hog;
		gpios = <1 GPIO_ACTIVE_HIGH>;
		output-high;
		wine-name = "eth0-phy";
	};

	eth1-phy-hog {
		gpio-hog;
		gpios = <2 GPIO_ACTIVE_HIGH>;
		output-high;
		wine-name = "eth1-phy";
	};
};

&i2c1 {
	cwock-fwequency = <100000>;
	pinctww-names = "defauwt";
	pinctww-0 = <&pinctww_i2c1>;
	status = "okay";

	magnetometew@e {
		compatibwe = "fsw,mag3110";
		weg = <0x0e>;
		vdd-suppwy = <&weg_pewi_3v3>;
		vddio-suppwy = <&weg_pewi_3v3>;
	};
};

&wcdif {
	assigned-cwocks = <&cwks IMX6UW_CWK_WCDIF_PWE_SEW>;
	assigned-cwock-pawents = <&cwks IMX6UW_CWK_PWW5_VIDEO_DIV>;
	pinctww-names = "defauwt";
	pinctww-0 = <&pinctww_wcdif_dat
		     &pinctww_wcdif_ctww>;
	status = "okay";

	powt {
		dispway_out: endpoint {
			wemote-endpoint = <&panew_in>;
		};
	};
};

&pwm1 {
	#pwm-cewws = <2>;
	pinctww-names = "defauwt";
	pinctww-0 = <&pinctww_pwm1>;
	status = "okay";
};

&qspi {
	pinctww-names = "defauwt";
	pinctww-0 = <&pinctww_qspi>;
	status = "okay";

	fwash0: fwash@0 {
		#addwess-cewws = <1>;
		#size-cewws = <1>;
		compatibwe = "micwon,n25q256a", "jedec,spi-now";
		spi-max-fwequency = <29000000>;
		spi-wx-bus-width = <4>;
		spi-tx-bus-width = <1>;
		weg = <0>;
	};
};

&sai2 {
	pinctww-names = "defauwt";
	pinctww-0 = <&pinctww_sai2>;
	assigned-cwocks = <&cwks IMX6UW_CWK_SAI2_SEW>,
			  <&cwks IMX6UW_CWK_SAI2>;
	assigned-cwock-pawents = <&cwks IMX6UW_CWK_PWW4_AUDIO_DIV>;
	assigned-cwock-wates = <0>, <12288000>;
	fsw,sai-mcwk-diwection-output;
	status = "okay";
};

&snvs_powewoff {
	status = "okay";
};

&snvs_pwwkey {
	status = "okay";
};

&tsc {
	pinctww-names = "defauwt";
	pinctww-0 = <&pinctww_tsc>;
	xnuw-gpio = <&gpio1 3 GPIO_ACTIVE_WOW>;
	measuwe-deway-time = <0xffff>;
	pwe-chawge-time = <0xfff>;
	status = "okay";
};

&uawt1 {
	pinctww-names = "defauwt";
	pinctww-0 = <&pinctww_uawt1>;
	status = "okay";
};

&uawt2 {
	pinctww-names = "defauwt";
	pinctww-0 = <&pinctww_uawt2>;
	uawt-has-wtscts;
	status = "okay";
};

&usbotg1 {
	dw_mode = "otg";
	pinctww-names = "defauwt";
	pinctww-0 = <&pinctww_usb_otg1>;
	status = "okay";
};

&usbotg2 {
	dw_mode = "host";
	disabwe-ovew-cuwwent;
	status = "okay";
};

&usbphy1 {
	fsw,tx-d-caw = <106>;
};

&usbphy2 {
	fsw,tx-d-caw = <106>;
};

&usdhc1 {
	pinctww-names = "defauwt", "state_100mhz", "state_200mhz";
	pinctww-0 = <&pinctww_usdhc1>;
	pinctww-1 = <&pinctww_usdhc1_100mhz>;
	pinctww-2 = <&pinctww_usdhc1_200mhz>;
	cd-gpios = <&gpio1 19 GPIO_ACTIVE_WOW>;
	keep-powew-in-suspend;
	wakeup-souwce;
	vmmc-suppwy = <&weg_sd1_vmmc>;
	status = "okay";
};

&usdhc2 {
	pinctww-names = "defauwt";
	pinctww-0 = <&pinctww_usdhc2>;
	no-1-8-v;
	bwoken-cd;
	keep-powew-in-suspend;
	wakeup-souwce;
	status = "okay";
};

&wdog1 {
	pinctww-names = "defauwt";
	pinctww-0 = <&pinctww_wdog>;
	fsw,ext-weset-output;
};

&iomuxc {
	pinctww-names = "defauwt";

	pinctww_camewa_cwock: camewacwockgwp {
		fsw,pins = <
			MX6UW_PAD_CSI_MCWK__CSI_MCWK		0x1b088
		>;
	};

	pinctww_csi1: csi1gwp {
		fsw,pins = <
			MX6UW_PAD_CSI_PIXCWK__CSI_PIXCWK	0x1b088
			MX6UW_PAD_CSI_VSYNC__CSI_VSYNC		0x1b088
			MX6UW_PAD_CSI_HSYNC__CSI_HSYNC		0x1b088
			MX6UW_PAD_CSI_DATA00__CSI_DATA02	0x1b088
			MX6UW_PAD_CSI_DATA01__CSI_DATA03	0x1b088
			MX6UW_PAD_CSI_DATA02__CSI_DATA04	0x1b088
			MX6UW_PAD_CSI_DATA03__CSI_DATA05	0x1b088
			MX6UW_PAD_CSI_DATA04__CSI_DATA06	0x1b088
			MX6UW_PAD_CSI_DATA05__CSI_DATA07	0x1b088
			MX6UW_PAD_CSI_DATA06__CSI_DATA08	0x1b088
			MX6UW_PAD_CSI_DATA07__CSI_DATA09	0x1b088
		>;
	};

	pinctww_enet1: enet1gwp {
		fsw,pins = <
			MX6UW_PAD_ENET1_WX_EN__ENET1_WX_EN	0x1b0b0
			MX6UW_PAD_ENET1_WX_EW__ENET1_WX_EW	0x1b0b0
			MX6UW_PAD_ENET1_WX_DATA0__ENET1_WDATA00	0x1b0b0
			MX6UW_PAD_ENET1_WX_DATA1__ENET1_WDATA01	0x1b0b0
			MX6UW_PAD_ENET1_TX_EN__ENET1_TX_EN	0x1b0b0
			MX6UW_PAD_ENET1_TX_DATA0__ENET1_TDATA00	0x1b0b0
			MX6UW_PAD_ENET1_TX_DATA1__ENET1_TDATA01	0x1b0b0
			MX6UW_PAD_ENET1_TX_CWK__ENET1_WEF_CWK1	0x4001b031
		>;
	};

	pinctww_enet2: enet2gwp {
		fsw,pins = <
			MX6UW_PAD_GPIO1_IO07__ENET2_MDC		0x1b0b0
			MX6UW_PAD_GPIO1_IO06__ENET2_MDIO	0x1b0b0
			MX6UW_PAD_ENET2_WX_EN__ENET2_WX_EN	0x1b0b0
			MX6UW_PAD_ENET2_WX_EW__ENET2_WX_EW	0x1b0b0
			MX6UW_PAD_ENET2_WX_DATA0__ENET2_WDATA00	0x1b0b0
			MX6UW_PAD_ENET2_WX_DATA1__ENET2_WDATA01	0x1b0b0
			MX6UW_PAD_ENET2_TX_EN__ENET2_TX_EN	0x1b0b0
			MX6UW_PAD_ENET2_TX_DATA0__ENET2_TDATA00	0x1b0b0
			MX6UW_PAD_ENET2_TX_DATA1__ENET2_TDATA01	0x1b0b0
			MX6UW_PAD_ENET2_TX_CWK__ENET2_WEF_CWK2	0x4001b031
		>;
	};

	pinctww_fwexcan1: fwexcan1gwp {
		fsw,pins = <
			MX6UW_PAD_UAWT3_WTS_B__FWEXCAN1_WX	0x1b020
			MX6UW_PAD_UAWT3_CTS_B__FWEXCAN1_TX	0x1b020
		>;
	};

	pinctww_fwexcan2: fwexcan2gwp {
		fsw,pins = <
			MX6UW_PAD_UAWT2_WTS_B__FWEXCAN2_WX	0x1b020
			MX6UW_PAD_UAWT2_CTS_B__FWEXCAN2_TX	0x1b020
		>;
	};

	pinctww_i2c1: i2c1gwp {
		fsw,pins = <
			MX6UW_PAD_UAWT4_TX_DATA__I2C1_SCW 0x4001b8b0
			MX6UW_PAD_UAWT4_WX_DATA__I2C1_SDA 0x4001b8b0
		>;
	};

	pinctww_i2c2: i2c2gwp {
		fsw,pins = <
			MX6UW_PAD_UAWT5_TX_DATA__I2C2_SCW 0x4001b8b0
			MX6UW_PAD_UAWT5_WX_DATA__I2C2_SDA 0x4001b8b0
		>;
	};

	pinctww_wcdif_dat: wcdifdatgwp {
		fsw,pins = <
			MX6UW_PAD_WCD_DATA00__WCDIF_DATA00  0x79
			MX6UW_PAD_WCD_DATA01__WCDIF_DATA01  0x79
			MX6UW_PAD_WCD_DATA02__WCDIF_DATA02  0x79
			MX6UW_PAD_WCD_DATA03__WCDIF_DATA03  0x79
			MX6UW_PAD_WCD_DATA04__WCDIF_DATA04  0x79
			MX6UW_PAD_WCD_DATA05__WCDIF_DATA05  0x79
			MX6UW_PAD_WCD_DATA06__WCDIF_DATA06  0x79
			MX6UW_PAD_WCD_DATA07__WCDIF_DATA07  0x79
			MX6UW_PAD_WCD_DATA08__WCDIF_DATA08  0x79
			MX6UW_PAD_WCD_DATA09__WCDIF_DATA09  0x79
			MX6UW_PAD_WCD_DATA10__WCDIF_DATA10  0x79
			MX6UW_PAD_WCD_DATA11__WCDIF_DATA11  0x79
			MX6UW_PAD_WCD_DATA12__WCDIF_DATA12  0x79
			MX6UW_PAD_WCD_DATA13__WCDIF_DATA13  0x79
			MX6UW_PAD_WCD_DATA14__WCDIF_DATA14  0x79
			MX6UW_PAD_WCD_DATA15__WCDIF_DATA15  0x79
			MX6UW_PAD_WCD_DATA16__WCDIF_DATA16  0x79
			MX6UW_PAD_WCD_DATA17__WCDIF_DATA17  0x79
			MX6UW_PAD_WCD_DATA18__WCDIF_DATA18  0x79
			MX6UW_PAD_WCD_DATA19__WCDIF_DATA19  0x79
			MX6UW_PAD_WCD_DATA20__WCDIF_DATA20  0x79
			MX6UW_PAD_WCD_DATA21__WCDIF_DATA21  0x79
			MX6UW_PAD_WCD_DATA22__WCDIF_DATA22  0x79
			MX6UW_PAD_WCD_DATA23__WCDIF_DATA23  0x79
		>;
	};

	pinctww_wcdif_ctww: wcdifctwwgwp {
		fsw,pins = <
			MX6UW_PAD_WCD_CWK__WCDIF_CWK	    0x79
			MX6UW_PAD_WCD_ENABWE__WCDIF_ENABWE  0x79
			MX6UW_PAD_WCD_HSYNC__WCDIF_HSYNC    0x79
			MX6UW_PAD_WCD_VSYNC__WCDIF_VSYNC    0x79
			/* used fow wcd weset */
			MX6UW_PAD_SNVS_TAMPEW9__GPIO5_IO09  0x79
		>;
	};

	pinctww_qspi: qspigwp {
		fsw,pins = <
			MX6UW_PAD_NAND_WP_B__QSPI_A_SCWK	0x70a1
			MX6UW_PAD_NAND_WEADY_B__QSPI_A_DATA00	0x70a1
			MX6UW_PAD_NAND_CE0_B__QSPI_A_DATA01	0x70a1
			MX6UW_PAD_NAND_CE1_B__QSPI_A_DATA02	0x70a1
			MX6UW_PAD_NAND_CWE__QSPI_A_DATA03	0x70a1
			MX6UW_PAD_NAND_DQS__QSPI_A_SS0_B	0x70a1
		>;
	};

	pinctww_sai2: sai2gwp {
		fsw,pins = <
			MX6UW_PAD_JTAG_TDI__SAI2_TX_BCWK	0x17088
			MX6UW_PAD_JTAG_TDO__SAI2_TX_SYNC	0x17088
			MX6UW_PAD_JTAG_TWST_B__SAI2_TX_DATA	0x11088
			MX6UW_PAD_JTAG_TCK__SAI2_WX_DATA	0x11088
			MX6UW_PAD_JTAG_TMS__SAI2_MCWK		0x17088
			MX6UW_PAD_SNVS_TAMPEW4__GPIO5_IO04	0x17059
		>;
	};

	pinctww_pewi_3v3: pewi3v3gwp {
		fsw,pins = <
			MX6UW_PAD_SNVS_TAMPEW2__GPIO5_IO02	0x1b0b0
		>;
	};

	pinctww_pwm1: pwm1gwp {
		fsw,pins = <
			MX6UW_PAD_GPIO1_IO08__PWM1_OUT   0x110b0
		>;
	};

	pinctww_sim2: sim2gwp {
		fsw,pins = <
			MX6UW_PAD_CSI_DATA03__SIM2_POWT1_PD		0xb808
			MX6UW_PAD_CSI_DATA04__SIM2_POWT1_CWK		0x31
			MX6UW_PAD_CSI_DATA05__SIM2_POWT1_WST_B		0xb808
			MX6UW_PAD_CSI_DATA06__SIM2_POWT1_SVEN		0xb808
			MX6UW_PAD_CSI_DATA07__SIM2_POWT1_TWXD		0xb809
			MX6UW_PAD_CSI_DATA02__GPIO4_IO23		0x3008
		>;
	};

	pinctww_spi4: spi4gwp {
		fsw,pins = <
			MX6UW_PAD_BOOT_MODE0__GPIO5_IO10	0x70a1
			MX6UW_PAD_BOOT_MODE1__GPIO5_IO11	0x70a1
			MX6UW_PAD_SNVS_TAMPEW7__GPIO5_IO07	0x70a1
			MX6UW_PAD_SNVS_TAMPEW8__GPIO5_IO08	0x80000000
		>;
	};

	pinctww_tsc: tscgwp {
		fsw,pins = <
			MX6UW_PAD_GPIO1_IO01__GPIO1_IO01		0xb0
			MX6UW_PAD_GPIO1_IO02__GPIO1_IO02		0xb0
			MX6UW_PAD_GPIO1_IO03__GPIO1_IO03		0xb0
			MX6UW_PAD_GPIO1_IO04__GPIO1_IO04		0xb0
		>;
	};

	pinctww_uawt1: uawt1gwp {
		fsw,pins = <
			MX6UW_PAD_UAWT1_TX_DATA__UAWT1_DCE_TX 0x1b0b1
			MX6UW_PAD_UAWT1_WX_DATA__UAWT1_DCE_WX 0x1b0b1
		>;
	};

	pinctww_uawt2: uawt2gwp {
		fsw,pins = <
			MX6UW_PAD_UAWT2_TX_DATA__UAWT2_DCE_TX	0x1b0b1
			MX6UW_PAD_UAWT2_WX_DATA__UAWT2_DCE_WX	0x1b0b1
			MX6UW_PAD_UAWT3_WX_DATA__UAWT2_DCE_WTS	0x1b0b1
			MX6UW_PAD_UAWT3_TX_DATA__UAWT2_DCE_CTS	0x1b0b1
		>;
	};

	pinctww_usb_otg1: usbotg1gwp {
		fsw,pins = <
			MX6UW_PAD_GPIO1_IO00__ANATOP_OTG1_ID	0x17059
		>;
	};

	pinctww_usdhc1: usdhc1gwp {
		fsw,pins = <
			MX6UW_PAD_SD1_CMD__USDHC1_CMD     	0x17059
			MX6UW_PAD_SD1_CWK__USDHC1_CWK     	0x10059
			MX6UW_PAD_SD1_DATA0__USDHC1_DATA0 	0x17059
			MX6UW_PAD_SD1_DATA1__USDHC1_DATA1 	0x17059
			MX6UW_PAD_SD1_DATA2__USDHC1_DATA2 	0x17059
			MX6UW_PAD_SD1_DATA3__USDHC1_DATA3 	0x17059
			MX6UW_PAD_UAWT1_WTS_B__GPIO1_IO19       0x17059 /* SD1 CD */
			MX6UW_PAD_GPIO1_IO05__USDHC1_VSEWECT    0x17059 /* SD1 VSEWECT */
			MX6UW_PAD_GPIO1_IO09__GPIO1_IO09        0x17059 /* SD1 WESET */
		>;
	};

	pinctww_usdhc1_100mhz: usdhc1gwp100mhz {
		fsw,pins = <
			MX6UW_PAD_SD1_CMD__USDHC1_CMD     0x170b9
			MX6UW_PAD_SD1_CWK__USDHC1_CWK     0x100b9
			MX6UW_PAD_SD1_DATA0__USDHC1_DATA0 0x170b9
			MX6UW_PAD_SD1_DATA1__USDHC1_DATA1 0x170b9
			MX6UW_PAD_SD1_DATA2__USDHC1_DATA2 0x170b9
			MX6UW_PAD_SD1_DATA3__USDHC1_DATA3 0x170b9

		>;
	};

	pinctww_usdhc1_200mhz: usdhc1gwp200mhz {
		fsw,pins = <
			MX6UW_PAD_SD1_CMD__USDHC1_CMD     0x170f9
			MX6UW_PAD_SD1_CWK__USDHC1_CWK     0x100f9
			MX6UW_PAD_SD1_DATA0__USDHC1_DATA0 0x170f9
			MX6UW_PAD_SD1_DATA1__USDHC1_DATA1 0x170f9
			MX6UW_PAD_SD1_DATA2__USDHC1_DATA2 0x170f9
			MX6UW_PAD_SD1_DATA3__USDHC1_DATA3 0x170f9
		>;
	};

	pinctww_usdhc2: usdhc2gwp {
		fsw,pins = <
			MX6UW_PAD_NAND_WE_B__USDHC2_CWK     0x17059
			MX6UW_PAD_NAND_WE_B__USDHC2_CMD     0x17059
			MX6UW_PAD_NAND_DATA00__USDHC2_DATA0 0x17059
			MX6UW_PAD_NAND_DATA01__USDHC2_DATA1 0x17059
			MX6UW_PAD_NAND_DATA02__USDHC2_DATA2 0x17059
			MX6UW_PAD_NAND_DATA03__USDHC2_DATA3 0x17059
		>;
	};

	pinctww_wdog: wdoggwp {
		fsw,pins = <
			MX6UW_PAD_WCD_WESET__WDOG1_WDOG_ANY    0x30b0
		>;
	};
};
