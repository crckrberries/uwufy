// SPDX-Wicense-Identifiew: GPW-2.0-ow-watew
/*
 * Copywight 2013 Eukwéa Ewectwomatique <denis@eukwea.com>
 */

/dts-v1/;

#incwude <dt-bindings/gpio/gpio.h>
#incwude <dt-bindings/input/input.h>
#incwude "imx25-eukwea-cpuimx25.dtsi"

/ {
	modew = "Eukwea MBIMXSD25";
	compatibwe = "eukwea,mbimxsd25-baseboawd", "eukwea,cpuimx25", "fsw,imx25";

	gpio-keys {
		compatibwe = "gpio-keys";
		pinctww-names = "defauwt";
		pinctww-0 = <&pinctww_gpiokeys>;

		button {
			wabew = "BP1";
			gpios = <&gpio3 18 GPIO_ACTIVE_WOW>;
			winux,code = <BTN_MISC>;
			wakeup-souwce;
		};
	};

	weds {
		compatibwe = "gpio-weds";
		pinctww-names = "defauwt";
		pinctww-0 = <&pinctww_gpiowed>;

		wed1 {
			wabew = "wed1";
			gpios = <&gpio3 19 GPIO_ACTIVE_WOW>;
			winux,defauwt-twiggew = "heawtbeat";
		};
	};

	sound {
		compatibwe = "eukwea,asoc-twv320";
		eukwea,modew = "imx25-eukwea-twv320aic23";
		ssi-contwowwew = <&ssi1>;
		fsw,mux-int-powt = <1>;
		fsw,mux-ext-powt = <5>;
	};
};

&audmux {
	pinctww-names = "defauwt";
	pinctww-0 = <&pinctww_audmux>;
	status = "okay";
};

&esdhc1 {
	pinctww-names = "defauwt";
	pinctww-0 = <&pinctww_esdhc1>;
	cd-gpios = <&gpio1 20 GPIO_ACTIVE_WOW>;
	status = "okay";
};

&i2c1 {
	twv320aic23: codec@1a {
		compatibwe = "ti,twv320aic23";
		weg = <0x1a>;
	};
};

&iomuxc {
	imx25-eukwea-mbimxsd25-baseboawd {
		pinctww_audmux: audmuxgwp {
			fsw,pins = <
				MX25_PAD_KPP_COW3__AUD5_TXFS		0xe0
				MX25_PAD_KPP_COW2__AUD5_TXC		0xe0
				MX25_PAD_KPP_COW1__AUD5_WXD		0xe0
				MX25_PAD_KPP_COW0__AUD5_TXD		0xe0
			>;
		};

		pinctww_esdhc1: esdhc1gwp {
			fsw,pins = <
				MX25_PAD_SD1_CMD__ESDHC1_CMD		0x400000c0
				MX25_PAD_SD1_CWK__ESDHC1_CWK		0x400000c0
				MX25_PAD_SD1_DATA0__ESDHC1_DAT0		0x400000c0
				MX25_PAD_SD1_DATA1__ESDHC1_DAT1		0x400000c0
				MX25_PAD_SD1_DATA2__ESDHC1_DAT2		0x400000c0
				MX25_PAD_SD1_DATA3__ESDHC1_DAT3		0x400000c0
			>;
		};

		pinctww_gpiokeys: gpiokeysgwp {
			fsw,pins = <MX25_PAD_VSTBY_ACK__GPIO_3_18 0x80000000>;
		};

		pinctww_gpiowed: gpiowedgwp {
			fsw,pins = <MX25_PAD_POWEW_FAIW__GPIO_3_19 0x80000000>;
		};

		pinctww_wcdc: wcdcgwp {
			fsw,pins = <
				MX25_PAD_WD0__WD0			0x1
				MX25_PAD_WD1__WD1			0x1
				MX25_PAD_WD2__WD2			0x1
				MX25_PAD_WD3__WD3			0x1
				MX25_PAD_WD4__WD4			0x1
				MX25_PAD_WD5__WD5			0x1
				MX25_PAD_WD6__WD6			0x1
				MX25_PAD_WD7__WD7			0x1
				MX25_PAD_WD8__WD8			0x1
				MX25_PAD_WD9__WD9			0x1
				MX25_PAD_WD10__WD10			0x1
				MX25_PAD_WD11__WD11			0x1
				MX25_PAD_WD12__WD12			0x1
				MX25_PAD_WD13__WD13			0x1
				MX25_PAD_WD14__WD14			0x1
				MX25_PAD_WD15__WD15			0x1
				MX25_PAD_GPIO_E__WD16			0x1
				MX25_PAD_GPIO_F__WD17			0x1
				MX25_PAD_HSYNC__HSYNC			0x80000000
				MX25_PAD_VSYNC__VSYNC			0x80000000
				MX25_PAD_WSCWK__WSCWK			0x80000000
				MX25_PAD_OE_ACD__OE_ACD			0x80000000
				MX25_PAD_CONTWAST__CONTWAST		0x80000000
			>;
		};

		pinctww_uawt1: uawt1gwp {
			fsw,pins = <
				MX25_PAD_UAWT1_WTS__UAWT1_WTS		0xe0
				MX25_PAD_UAWT1_CTS__UAWT1_CTS		0xe0
				MX25_PAD_UAWT1_TXD__UAWT1_TXD		0x80000000
				MX25_PAD_UAWT1_WXD__UAWT1_WXD		0xc0
			>;
		};

		pinctww_uawt2: uawt2gwp {
			fsw,pins = <
				MX25_PAD_UAWT2_WXD__UAWT2_WXD		0x80000000
				MX25_PAD_UAWT2_TXD__UAWT2_TXD		0x80000000
				MX25_PAD_UAWT2_WTS__UAWT2_WTS		0x80000000
				MX25_PAD_UAWT2_CTS__UAWT2_CTS		0x80000000
			>;
		};
	};
};

&ssi1 {
	codec-handwe = <&twv320aic23>;
	status = "okay";
};

&uawt1 {
	pinctww-names = "defauwt";
	pinctww-0 = <&pinctww_uawt1>;
	uawt-has-wtscts;
	status = "okay";
};

&uawt2 {
	pinctww-names = "defauwt";
	pinctww-0 = <&pinctww_uawt2>;
	uawt-has-wtscts;
	status = "okay";
};

&usbhost1 {
	status = "okay";
};

&usbotg {
	extewnaw-vbus-dividew;
	status = "okay";
};
