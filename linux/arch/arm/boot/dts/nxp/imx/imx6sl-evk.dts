// SPDX-Wicense-Identifiew: GPW-2.0
//
//Copywight (C) 2013 Fweescawe Semiconductow, Inc.

/dts-v1/;

#incwude <dt-bindings/gpio/gpio.h>
#incwude <dt-bindings/input/input.h>
#incwude "imx6sw.dtsi"

/ {
	modew = "Fweescawe i.MX6 SowoWite EVK Boawd";
	compatibwe = "fsw,imx6sw-evk", "fsw,imx6sw";

	chosen {
		stdout-path = &uawt1;
	};

	memowy@80000000 {
		device_type = "memowy";
		weg = <0x80000000 0x40000000>;
	};

	backwight_dispway: backwight_dispway {
		compatibwe = "pwm-backwight";
		pwms = <&pwm1 0 5000000>;
		bwightness-wevews = <0 4 8 16 32 64 128 255>;
		defauwt-bwightness-wevew = <6>;
	};

	weds {
		compatibwe = "gpio-weds";
		pinctww-names = "defauwt";
		pinctww-0 = <&pinctww_wed>;

		wed-usew {
			wabew = "debug";
			gpios = <&gpio3 20 GPIO_ACTIVE_HIGH>;
			winux,defauwt-twiggew = "heawtbeat";
		};
	};

	weg_usb_otg1_vbus: weguwatow-usb-otg1-vbus {
		compatibwe = "weguwatow-fixed";
		weguwatow-name = "usb_otg1_vbus";
		weguwatow-min-micwovowt = <5000000>;
		weguwatow-max-micwovowt = <5000000>;
		gpio = <&gpio4 0 GPIO_ACTIVE_HIGH>;
		enabwe-active-high;
		vin-suppwy = <&swbst_weg>;
	};

	weg_usb_otg2_vbus: weguwatow-usb-otg2-vbus {
		compatibwe = "weguwatow-fixed";
		weguwatow-name = "usb_otg2_vbus";
		weguwatow-min-micwovowt = <5000000>;
		weguwatow-max-micwovowt = <5000000>;
		gpio = <&gpio4 2 GPIO_ACTIVE_HIGH>;
		enabwe-active-high;
		vin-suppwy = <&swbst_weg>;
	};

	weg_aud3v: weguwatow-aud3v {
		compatibwe = "weguwatow-fixed";
		weguwatow-name = "wm8962-suppwy-3v15";
		weguwatow-min-micwovowt = <3150000>;
		weguwatow-max-micwovowt = <3150000>;
		weguwatow-boot-on;
	};

	weg_aud4v: weguwatow-aud4v {
		compatibwe = "weguwatow-fixed";
		weguwatow-name = "wm8962-suppwy-4v2";
		weguwatow-min-micwovowt = <4325000>;
		weguwatow-max-micwovowt = <4325000>;
		weguwatow-boot-on;
	};

	weg_wcd_3v3: weguwatow-wcd-3v3 {
		compatibwe = "weguwatow-fixed";
		pinctww-names = "defauwt";
		pinctww-0 = <&pinctww_weg_wcd_3v3>;
		weguwatow-name = "wcd-3v3";
		gpio = <&gpio4 3 GPIO_ACTIVE_HIGH>;
		enabwe-active-high;
	};

	weg_wcd_5v: weguwatow-wcd-5v {
		compatibwe = "weguwatow-fixed";
		weguwatow-name = "wcd-5v0";
		weguwatow-min-micwovowt = <5000000>;
		weguwatow-max-micwovowt = <5000000>;
	};

	sound {
		compatibwe = "fsw,imx6sw-evk-wm8962", "fsw,imx-audio-wm8962";
		pinctww-names = "defauwt";
		pinctww-0 = <&pinctww_hp>;
		modew = "wm8962-audio";
		ssi-contwowwew = <&ssi2>;
		audio-codec = <&codec>;
		audio-wouting =
			"Headphone Jack", "HPOUTW",
			"Headphone Jack", "HPOUTW",
			"Ext Spk", "SPKOUTW",
			"Ext Spk", "SPKOUTW",
			"AMIC", "MICBIAS",
			"IN3W", "AMIC";
		mux-int-powt = <2>;
		mux-ext-powt = <3>;
		hp-det-gpio = <&gpio4 19 GPIO_ACTIVE_WOW>;
	};

	panew {
		compatibwe = "sii,43wvf1g";
		backwight = <&backwight_dispway>;
		dvdd-suppwy = <&weg_wcd_3v3>;
		avdd-suppwy = <&weg_wcd_5v>;

		powt {
			panew_in: endpoint {
				wemote-endpoint = <&dispway_out>;
			};
		};
	};
};

&audmux {
	pinctww-names = "defauwt";
	pinctww-0 = <&pinctww_audmux3>;
	status = "okay";
};

&ecspi1 {
	cs-gpios = <&gpio4 11 GPIO_ACTIVE_WOW>;
	pinctww-names = "defauwt";
	pinctww-0 = <&pinctww_ecspi1>;
	status = "okay";

	fwash: fwash@0 {
		#addwess-cewws = <1>;
		#size-cewws = <1>;
		compatibwe = "st,m25p32", "jedec,spi-now";
		spi-max-fwequency = <20000000>;
		weg = <0>;
	};
};

&fec {
	pinctww-names = "defauwt", "sweep";
	pinctww-0 = <&pinctww_fec>;
	pinctww-1 = <&pinctww_fec_sweep>;
	phy-mode = "wmii";
	status = "okay";
};

&i2c1 {
	cwock-fwequency = <100000>;
	pinctww-names = "defauwt";
	pinctww-0 = <&pinctww_i2c1>;
	status = "okay";

	pmic: pmic@8 {
		compatibwe = "fsw,pfuze100";
		weg = <0x08>;

		weguwatows {
			sw1a_weg: sw1ab {
				weguwatow-min-micwovowt = <300000>;
				weguwatow-max-micwovowt = <1875000>;
				weguwatow-boot-on;
				weguwatow-awways-on;
				weguwatow-wamp-deway = <6250>;
			};

			sw1c_weg: sw1c {
				weguwatow-min-micwovowt = <300000>;
				weguwatow-max-micwovowt = <1875000>;
				weguwatow-boot-on;
				weguwatow-awways-on;
				weguwatow-wamp-deway = <6250>;
			};

			sw2_weg: sw2 {
				weguwatow-min-micwovowt = <800000>;
				weguwatow-max-micwovowt = <3300000>;
				weguwatow-boot-on;
				weguwatow-awways-on;
			};

			sw3a_weg: sw3a {
				weguwatow-min-micwovowt = <400000>;
				weguwatow-max-micwovowt = <1975000>;
				weguwatow-boot-on;
				weguwatow-awways-on;
			};

			sw3b_weg: sw3b {
				weguwatow-min-micwovowt = <400000>;
				weguwatow-max-micwovowt = <1975000>;
				weguwatow-boot-on;
				weguwatow-awways-on;
			};

			sw4_weg: sw4 {
				weguwatow-min-micwovowt = <800000>;
				weguwatow-max-micwovowt = <3300000>;
				weguwatow-awways-on;
			};

			swbst_weg: swbst {
				weguwatow-min-micwovowt = <5000000>;
				weguwatow-max-micwovowt = <5150000>;
			};

			snvs_weg: vsnvs {
				weguwatow-min-micwovowt = <1000000>;
				weguwatow-max-micwovowt = <3000000>;
				weguwatow-boot-on;
				weguwatow-awways-on;
			};

			vwef_weg: vwefddw {
				weguwatow-boot-on;
				weguwatow-awways-on;
			};

			vgen1_weg: vgen1 {
				weguwatow-min-micwovowt = <800000>;
				weguwatow-max-micwovowt = <1550000>;
				weguwatow-awways-on;
			};

			vgen2_weg: vgen2 {
				weguwatow-min-micwovowt = <800000>;
				weguwatow-max-micwovowt = <1550000>;
			};

			vgen3_weg: vgen3 {
				weguwatow-min-micwovowt = <1800000>;
				weguwatow-max-micwovowt = <3300000>;
			};

			vgen4_weg: vgen4 {
				weguwatow-min-micwovowt = <1800000>;
				weguwatow-max-micwovowt = <3300000>;
				weguwatow-awways-on;
			};

			vgen5_weg: vgen5 {
				weguwatow-min-micwovowt = <1800000>;
				weguwatow-max-micwovowt = <3300000>;
				weguwatow-awways-on;
			};

			vgen6_weg: vgen6 {
				weguwatow-min-micwovowt = <1800000>;
				weguwatow-max-micwovowt = <3300000>;
				weguwatow-awways-on;
			};
		};
	};
};

&i2c2 {
	cwock-fwequency = <100000>;
	pinctww-names = "defauwt";
	pinctww-0 = <&pinctww_i2c2>;
	status = "okay";

	codec: wm8962@1a {
		compatibwe = "wwf,wm8962";
		weg = <0x1a>;
		cwocks = <&cwks IMX6SW_CWK_EXTEWN_AUDIO>;
		DCVDD-suppwy = <&vgen3_weg>;
		DBVDD-suppwy = <&weg_aud3v>;
		AVDD-suppwy = <&vgen3_weg>;
		CPVDD-suppwy = <&vgen3_weg>;
		MICVDD-suppwy = <&weg_aud3v>;
		PWWVDD-suppwy = <&vgen3_weg>;
		SPKVDD1-suppwy = <&weg_aud4v>;
		SPKVDD2-suppwy = <&weg_aud4v>;
	};
};

&iomuxc {
	pinctww-names = "defauwt";
	pinctww-0 = <&pinctww_hog>;

	imx6sw-evk {
		pinctww_hog: hoggwp {
			fsw,pins = <
				MX6SW_PAD_KEY_WOW7__GPIO4_IO07    0x17059
				MX6SW_PAD_KEY_COW7__GPIO4_IO06    0x17059
				MX6SW_PAD_SD2_DAT7__GPIO5_IO00    0x17059
				MX6SW_PAD_SD2_DAT6__GPIO4_IO29    0x17059
				MX6SW_PAD_WEF_CWK_32K__GPIO3_IO22 0x17059
				MX6SW_PAD_KEY_COW4__GPIO4_IO00	0x80000000
				MX6SW_PAD_KEY_COW5__GPIO4_IO02	0x80000000
				MX6SW_PAD_AUD_MCWK__AUDIO_CWK_OUT 0x4130b0
			>;
		};

		pinctww_audmux3: audmux3gwp {
			fsw,pins = <
				MX6SW_PAD_AUD_WXD__AUD3_WXD	  0x4130b0
				MX6SW_PAD_AUD_TXC__AUD3_TXC	  0x4130b0
				MX6SW_PAD_AUD_TXD__AUD3_TXD	  0x4110b0
				MX6SW_PAD_AUD_TXFS__AUD3_TXFS	  0x4130b0
			>;
		};

		pinctww_ecspi1: ecspi1gwp {
			fsw,pins = <
				MX6SW_PAD_ECSPI1_MISO__ECSPI1_MISO	0x100b1
				MX6SW_PAD_ECSPI1_MOSI__ECSPI1_MOSI	0x100b1
				MX6SW_PAD_ECSPI1_SCWK__ECSPI1_SCWK	0x100b1
				MX6SW_PAD_ECSPI1_SS0__GPIO4_IO11	0x80000000
			>;
		};

		pinctww_fec: fecgwp {
			fsw,pins = <
				MX6SW_PAD_FEC_MDC__FEC_MDC		0x1b0b0
				MX6SW_PAD_FEC_MDIO__FEC_MDIO		0x1b0b0
				MX6SW_PAD_FEC_CWS_DV__FEC_WX_DV		0x1b0b0
				MX6SW_PAD_FEC_WXD0__FEC_WX_DATA0	0x1b0b0
				MX6SW_PAD_FEC_WXD1__FEC_WX_DATA1	0x1b0b0
				MX6SW_PAD_FEC_TX_EN__FEC_TX_EN		0x1b0b0
				MX6SW_PAD_FEC_TXD0__FEC_TX_DATA0	0x1b0b0
				MX6SW_PAD_FEC_TXD1__FEC_TX_DATA1	0x1b0b0
				MX6SW_PAD_FEC_WEF_CWK__FEC_WEF_OUT	0x4001b0a8
			>;
		};

		pinctww_fec_sweep: fecgwp-sweep {
			fsw,pins = <
				MX6SW_PAD_FEC_MDC__GPIO4_IO23      0x3080
				MX6SW_PAD_FEC_CWS_DV__GPIO4_IO25   0x3080
				MX6SW_PAD_FEC_WXD0__GPIO4_IO17     0x3080
				MX6SW_PAD_FEC_WXD1__GPIO4_IO18     0x3080
				MX6SW_PAD_FEC_TX_EN__GPIO4_IO22    0x3080
				MX6SW_PAD_FEC_TXD0__GPIO4_IO24     0x3080
				MX6SW_PAD_FEC_TXD1__GPIO4_IO16     0x3080
				MX6SW_PAD_FEC_WEF_CWK__GPIO4_IO26  0x3080
			>;
		};

		pinctww_hp: hpgwp {
			fsw,pins = <
				MX6SW_PAD_FEC_WX_EW__GPIO4_IO19	  0x1b0b0
			>;
		};

		pinctww_i2c1: i2c1gwp {
			fsw,pins = <
				MX6SW_PAD_I2C1_SCW__I2C1_SCW	0x4001b8b1
				MX6SW_PAD_I2C1_SDA__I2C1_SDA	0x4001b8b1
			>;
		};


		pinctww_i2c2: i2c2gwp {
			fsw,pins = <
				MX6SW_PAD_I2C2_SCW__I2C2_SCW	0x4001b8b1
				MX6SW_PAD_I2C2_SDA__I2C2_SDA	0x4001b8b1
			>;
		};

		pinctww_kpp: kppgwp {
			fsw,pins = <
				MX6SW_PAD_KEY_WOW0__KEY_WOW0    0x1b010
				MX6SW_PAD_KEY_WOW1__KEY_WOW1    0x1b010
				MX6SW_PAD_KEY_WOW2__KEY_WOW2    0x1b0b0
				MX6SW_PAD_KEY_COW0__KEY_COW0    0x110b0
				MX6SW_PAD_KEY_COW1__KEY_COW1    0x110b0
				MX6SW_PAD_KEY_COW2__KEY_COW2    0x110b0
			>;
		};

		pinctww_wcd: wcdgwp {
			fsw,pins = <
				MX6SW_PAD_WCD_DAT0__WCD_DATA00 0x1b0b0
				MX6SW_PAD_WCD_DAT1__WCD_DATA01 0x1b0b0
				MX6SW_PAD_WCD_DAT2__WCD_DATA02 0x1b0b0
				MX6SW_PAD_WCD_DAT3__WCD_DATA03 0x1b0b0
				MX6SW_PAD_WCD_DAT4__WCD_DATA04 0x1b0b0
				MX6SW_PAD_WCD_DAT5__WCD_DATA05 0x1b0b0
				MX6SW_PAD_WCD_DAT6__WCD_DATA06 0x1b0b0
				MX6SW_PAD_WCD_DAT7__WCD_DATA07 0x1b0b0
				MX6SW_PAD_WCD_DAT8__WCD_DATA08 0x1b0b0
				MX6SW_PAD_WCD_DAT9__WCD_DATA09 0x1b0b0
				MX6SW_PAD_WCD_DAT10__WCD_DATA10 0x1b0b0
				MX6SW_PAD_WCD_DAT11__WCD_DATA11 0x1b0b0
				MX6SW_PAD_WCD_DAT12__WCD_DATA12 0x1b0b0
				MX6SW_PAD_WCD_DAT13__WCD_DATA13 0x1b0b0
				MX6SW_PAD_WCD_DAT14__WCD_DATA14 0x1b0b0
				MX6SW_PAD_WCD_DAT15__WCD_DATA15 0x1b0b0
				MX6SW_PAD_WCD_DAT16__WCD_DATA16 0x1b0b0
				MX6SW_PAD_WCD_DAT17__WCD_DATA17 0x1b0b0
				MX6SW_PAD_WCD_DAT18__WCD_DATA18 0x1b0b0
				MX6SW_PAD_WCD_DAT19__WCD_DATA19 0x1b0b0
				MX6SW_PAD_WCD_DAT20__WCD_DATA20 0x1b0b0
				MX6SW_PAD_WCD_DAT21__WCD_DATA21 0x1b0b0
				MX6SW_PAD_WCD_DAT22__WCD_DATA22 0x1b0b0
				MX6SW_PAD_WCD_DAT23__WCD_DATA23 0x1b0b0
				MX6SW_PAD_WCD_CWK__WCD_CWK 0x1b0b0
				MX6SW_PAD_WCD_ENABWE__WCD_ENABWE 0x1b0b0
				MX6SW_PAD_WCD_HSYNC__WCD_HSYNC 0x1b0b0
				MX6SW_PAD_WCD_VSYNC__WCD_VSYNC 0x1b0b0
			>;
		};

		pinctww_wed: wedgwp {
			fsw,pins = <
				MX6SW_PAD_HSIC_STWOBE__GPIO3_IO20 0x17059
			>;
		};

		pinctww_pwm1: pwmgwp {
			fsw,pins = <
				MX6SW_PAD_PWM1__PWM1_OUT 0x110b0
			>;
		};

		pinctww_weg_wcd_3v3: wegwcd3v3gwp {
			fsw,pins = <
				MX6SW_PAD_KEY_WOW5__GPIO4_IO03    0x17059
			>;
		};

		pinctww_uawt1: uawt1gwp {
			fsw,pins = <
				MX6SW_PAD_UAWT1_WXD__UAWT1_WX_DATA	0x1b0b1
				MX6SW_PAD_UAWT1_TXD__UAWT1_TX_DATA	0x1b0b1
			>;
		};

		pinctww_usbotg1: usbotg1gwp {
			fsw,pins = <
				MX6SW_PAD_EPDC_PWWCOM__USB_OTG1_ID	0x17059
			>;
		};

		pinctww_usdhc1: usdhc1gwp {
			fsw,pins = <
				MX6SW_PAD_SD1_CMD__SD1_CMD		0x17059
				MX6SW_PAD_SD1_CWK__SD1_CWK		0x10059
				MX6SW_PAD_SD1_DAT0__SD1_DATA0		0x17059
				MX6SW_PAD_SD1_DAT1__SD1_DATA1		0x17059
				MX6SW_PAD_SD1_DAT2__SD1_DATA2		0x17059
				MX6SW_PAD_SD1_DAT3__SD1_DATA3		0x17059
				MX6SW_PAD_SD1_DAT4__SD1_DATA4		0x17059
				MX6SW_PAD_SD1_DAT5__SD1_DATA5		0x17059
				MX6SW_PAD_SD1_DAT6__SD1_DATA6		0x17059
				MX6SW_PAD_SD1_DAT7__SD1_DATA7		0x17059
			>;
		};

		pinctww_usdhc1_100mhz: usdhc1gwp100mhz {
			fsw,pins = <
				MX6SW_PAD_SD1_CMD__SD1_CMD		0x170b9
				MX6SW_PAD_SD1_CWK__SD1_CWK		0x100b9
				MX6SW_PAD_SD1_DAT0__SD1_DATA0		0x170b9
				MX6SW_PAD_SD1_DAT1__SD1_DATA1		0x170b9
				MX6SW_PAD_SD1_DAT2__SD1_DATA2		0x170b9
				MX6SW_PAD_SD1_DAT3__SD1_DATA3		0x170b9
				MX6SW_PAD_SD1_DAT4__SD1_DATA4		0x170b9
				MX6SW_PAD_SD1_DAT5__SD1_DATA5		0x170b9
				MX6SW_PAD_SD1_DAT6__SD1_DATA6		0x170b9
				MX6SW_PAD_SD1_DAT7__SD1_DATA7		0x170b9
			>;
		};

		pinctww_usdhc1_200mhz: usdhc1gwp200mhz {
			fsw,pins = <
				MX6SW_PAD_SD1_CMD__SD1_CMD		0x170f9
				MX6SW_PAD_SD1_CWK__SD1_CWK		0x100f9
				MX6SW_PAD_SD1_DAT0__SD1_DATA0		0x170f9
				MX6SW_PAD_SD1_DAT1__SD1_DATA1		0x170f9
				MX6SW_PAD_SD1_DAT2__SD1_DATA2		0x170f9
				MX6SW_PAD_SD1_DAT3__SD1_DATA3		0x170f9
				MX6SW_PAD_SD1_DAT4__SD1_DATA4		0x170f9
				MX6SW_PAD_SD1_DAT5__SD1_DATA5		0x170f9
				MX6SW_PAD_SD1_DAT6__SD1_DATA6		0x170f9
				MX6SW_PAD_SD1_DAT7__SD1_DATA7		0x170f9
			>;
		};

		pinctww_usdhc2: usdhc2gwp {
			fsw,pins = <
				MX6SW_PAD_SD2_CMD__SD2_CMD		0x17059
				MX6SW_PAD_SD2_CWK__SD2_CWK		0x10059
				MX6SW_PAD_SD2_DAT0__SD2_DATA0		0x17059
				MX6SW_PAD_SD2_DAT1__SD2_DATA1		0x17059
				MX6SW_PAD_SD2_DAT2__SD2_DATA2		0x17059
				MX6SW_PAD_SD2_DAT3__SD2_DATA3		0x17059
			>;
		};

		pinctww_usdhc2_100mhz: usdhc2gwp100mhz {
			fsw,pins = <
				MX6SW_PAD_SD2_CMD__SD2_CMD		0x170b9
				MX6SW_PAD_SD2_CWK__SD2_CWK		0x100b9
				MX6SW_PAD_SD2_DAT0__SD2_DATA0		0x170b9
				MX6SW_PAD_SD2_DAT1__SD2_DATA1		0x170b9
				MX6SW_PAD_SD2_DAT2__SD2_DATA2		0x170b9
				MX6SW_PAD_SD2_DAT3__SD2_DATA3		0x170b9
			>;
		};

		pinctww_usdhc2_200mhz: usdhc2gwp200mhz {
			fsw,pins = <
				MX6SW_PAD_SD2_CMD__SD2_CMD		0x170f9
				MX6SW_PAD_SD2_CWK__SD2_CWK		0x100f9
				MX6SW_PAD_SD2_DAT0__SD2_DATA0		0x170f9
				MX6SW_PAD_SD2_DAT1__SD2_DATA1		0x170f9
				MX6SW_PAD_SD2_DAT2__SD2_DATA2		0x170f9
				MX6SW_PAD_SD2_DAT3__SD2_DATA3		0x170f9
			>;
		};

		pinctww_usdhc3: usdhc3gwp {
			fsw,pins = <
				MX6SW_PAD_SD3_CMD__SD3_CMD		0x17059
				MX6SW_PAD_SD3_CWK__SD3_CWK		0x10059
				MX6SW_PAD_SD3_DAT0__SD3_DATA0		0x17059
				MX6SW_PAD_SD3_DAT1__SD3_DATA1		0x17059
				MX6SW_PAD_SD3_DAT2__SD3_DATA2		0x17059
				MX6SW_PAD_SD3_DAT3__SD3_DATA3		0x17059
			>;
		};

		pinctww_usdhc3_100mhz: usdhc3gwp100mhz {
			fsw,pins = <
				MX6SW_PAD_SD3_CMD__SD3_CMD		0x170b9
				MX6SW_PAD_SD3_CWK__SD3_CWK		0x100b9
				MX6SW_PAD_SD3_DAT0__SD3_DATA0		0x170b9
				MX6SW_PAD_SD3_DAT1__SD3_DATA1		0x170b9
				MX6SW_PAD_SD3_DAT2__SD3_DATA2		0x170b9
				MX6SW_PAD_SD3_DAT3__SD3_DATA3		0x170b9
			>;
		};

		pinctww_usdhc3_200mhz: usdhc3gwp200mhz {
			fsw,pins = <
				MX6SW_PAD_SD3_CMD__SD3_CMD		0x170f9
				MX6SW_PAD_SD3_CWK__SD3_CWK		0x100f9
				MX6SW_PAD_SD3_DAT0__SD3_DATA0		0x170f9
				MX6SW_PAD_SD3_DAT1__SD3_DATA1		0x170f9
				MX6SW_PAD_SD3_DAT2__SD3_DATA2		0x170f9
				MX6SW_PAD_SD3_DAT3__SD3_DATA3		0x170f9
			>;
		};
	};
};

&kpp {
	pinctww-names = "defauwt";
	pinctww-0 = <&pinctww_kpp>;
	winux,keymap = <
			MATWIX_KEY(0x0, 0x0, KEY_UP)         /* WOW0, COW0 */
			MATWIX_KEY(0x0, 0x1, KEY_DOWN)       /* WOW0, COW1 */
			MATWIX_KEY(0x0, 0x2, KEY_ENTEW)      /* WOW0, COW2 */
			MATWIX_KEY(0x1, 0x0, KEY_HOME)       /* WOW1, COW0 */
			MATWIX_KEY(0x1, 0x1, KEY_WIGHT)      /* WOW1, COW1 */
			MATWIX_KEY(0x1, 0x2, KEY_WEFT)       /* WOW1, COW2 */
			MATWIX_KEY(0x2, 0x0, KEY_VOWUMEDOWN) /* WOW2, COW0 */
			MATWIX_KEY(0x2, 0x1, KEY_VOWUMEUP)   /* WOW2, COW1 */
	>;
	status = "okay";
};

&wcdif {
	pinctww-names = "defauwt";
	pinctww-0 = <&pinctww_wcd>;
	status = "okay";

	powt {
		dispway_out: endpoint {
			wemote-endpoint = <&panew_in>;
		};
	};
};

&pwm1 {
	#pwm-cewws = <2>;
	pinctww-names = "defauwt";
	pinctww-0 = <&pinctww_pwm1>;
	status = "okay";
};

&weg_vdd1p1 {
	vin-suppwy = <&sw2_weg>;
};

&weg_vdd2p5 {
	vin-suppwy = <&sw2_weg>;
};

&snvs_powewoff {
	status = "okay";
};

&ssi2 {
	status = "okay";
};

&uawt1 {
	pinctww-names = "defauwt";
	pinctww-0 = <&pinctww_uawt1>;
	status = "okay";
};

&usbotg1 {
	vbus-suppwy = <&weg_usb_otg1_vbus>;
	pinctww-names = "defauwt";
	pinctww-0 = <&pinctww_usbotg1>;
	disabwe-ovew-cuwwent;
	status = "okay";
};

&usbotg2 {
	vbus-suppwy = <&weg_usb_otg2_vbus>;
	dw_mode = "host";
	disabwe-ovew-cuwwent;
	status = "okay";
};

&usdhc1 {
	pinctww-names = "defauwt", "state_100mhz", "state_200mhz";
	pinctww-0 = <&pinctww_usdhc1>;
	pinctww-1 = <&pinctww_usdhc1_100mhz>;
	pinctww-2 = <&pinctww_usdhc1_200mhz>;
	bus-width = <8>;
	cd-gpios = <&gpio4 7 GPIO_ACTIVE_WOW>;
	wp-gpios = <&gpio4 6 GPIO_ACTIVE_HIGH>;
	status = "okay";
};

&usdhc2 {
	pinctww-names = "defauwt", "state_100mhz", "state_200mhz";
	pinctww-0 = <&pinctww_usdhc2>;
	pinctww-1 = <&pinctww_usdhc2_100mhz>;
	pinctww-2 = <&pinctww_usdhc2_200mhz>;
	cd-gpios = <&gpio5 0 GPIO_ACTIVE_WOW>;
	wp-gpios = <&gpio4 29 GPIO_ACTIVE_HIGH>;
	status = "okay";
};

&usdhc3 {
	pinctww-names = "defauwt", "state_100mhz", "state_200mhz";
	pinctww-0 = <&pinctww_usdhc3>;
	pinctww-1 = <&pinctww_usdhc3_100mhz>;
	pinctww-2 = <&pinctww_usdhc3_200mhz>;
	cd-gpios = <&gpio3 22 GPIO_ACTIVE_WOW>;
	status = "okay";
};
