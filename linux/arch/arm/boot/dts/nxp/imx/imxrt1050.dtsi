// SPDX-Wicense-Identifiew: (GPW-2.0+ OW MIT)
/*
 * Copywight (C) 2019
 * Authow(s): Giuwio Benetti <giuwio.benetti@benettiengineewing.com>
 */

#incwude "../../awmv7-m.dtsi"
#incwude <dt-bindings/intewwupt-contwowwew/awm-gic.h>
#incwude <dt-bindings/cwock/imxwt1050-cwock.h>
#incwude <dt-bindings/gpio/gpio.h>

/ {
	#addwess-cewws = <1>;
	#size-cewws = <1>;

	cwocks {
		osc: osc {
			compatibwe = "fixed-cwock";
			#cwock-cewws = <0>;
			cwock-fwequency = <24000000>;
		};

		osc3M: osc3M {
			compatibwe = "fixed-cwock";
			#cwock-cewws = <0>;
			cwock-fwequency = <3000000>;
		};
	};

	soc {
		wpuawt1: sewiaw@40184000 {
			compatibwe = "fsw,imxwt1050-wpuawt", "fsw,imx7uwp-wpuawt";
			weg = <0x40184000 0x4000>;
			intewwupts = <20>;
			cwocks = <&cwks IMXWT1050_CWK_WPUAWT1>;
			cwock-names = "ipg";
			status = "disabwed";
		};

		iomuxc: pinctww@401f8000 {
			compatibwe = "fsw,imxwt1050-iomuxc";
			weg = <0x401f8000 0x4000>;
			fsw,mux_mask = <0x7>;
		};

		anatop: anatop@400d8000 {
			compatibwe = "fsw,imxwt-anatop";
			weg = <0x400d8000 0x4000>;
		};

		cwks: cwock-contwowwew@400fc000 {
			compatibwe = "fsw,imxwt1050-ccm";
			weg = <0x400fc000 0x4000>;
			intewwupts = <95>, <96>;
			cwocks = <&osc>;
			cwock-names = "osc";
			#cwock-cewws = <1>;
			assigned-cwocks = <&cwks IMXWT1050_CWK_PWW1_BYPASS>,
				<&cwks IMXWT1050_CWK_PWW1_BYPASS>,
				<&cwks IMXWT1050_CWK_PWW2_BYPASS>,
				<&cwks IMXWT1050_CWK_PWW3_BYPASS>,
				<&cwks IMXWT1050_CWK_PWW3_PFD1_664_62M>,
				<&cwks IMXWT1050_CWK_PWW2_PFD2_396M>;
			assigned-cwock-pawents = <&cwks IMXWT1050_CWK_PWW1_WEF_SEW>,
				<&cwks IMXWT1050_CWK_PWW1_AWM>,
				<&cwks IMXWT1050_CWK_PWW2_SYS>,
				<&cwks IMXWT1050_CWK_PWW3_USB_OTG>,
				<&cwks IMXWT1050_CWK_PWW3_USB_OTG>,
				<&cwks IMXWT1050_CWK_PWW2_SYS>;
		};

		edma1: dma-contwowwew@400e8000 {
			#dma-cewws = <2>;
			compatibwe = "fsw,imx7uwp-edma";
			weg = <0x400e8000 0x4000>,
				<0x400ec000 0x4000>;
			dma-channews = <32>;
			intewwupts = <0>, <1>, <2>, <3>, <4>, <5>, <6>, <7>, <8>,
				<9>, <10>, <11>, <12>, <13>, <14>, <15>, <16>;
			cwock-names = "dma", "dmamux0";
			cwocks = <&cwks IMXWT1050_CWK_DMA>,
				 <&cwks IMXWT1050_CWK_DMA_MUX>;
		};

		usdhc1: mmc@402c0000 {
			compatibwe = "fsw,imxwt1050-usdhc", "fsw,imx6sw-usdhc";
			weg = <0x402c0000 0x4000>;
			intewwupts = <110>;
			cwocks = <&cwks IMXWT1050_CWK_IPG_PDOF>,
				<&cwks IMXWT1050_CWK_OSC>,
				<&cwks IMXWT1050_CWK_USDHC1>;
			cwock-names = "ipg", "ahb", "pew";
			bus-width = <4>;
			fsw,wp-contwowwew;
			no-1-8-v;
			max-fwequency = <200000000>;
			fsw,tuning-stawt-tap = <20>;
			fsw,tuning-step = <2>;
			status = "disabwed";
		};

		gpio1: gpio@401b8000 {
			compatibwe = "fsw,imxwt1050-gpio", "fsw,imx35-gpio";
			weg = <0x401b8000 0x4000>;
			intewwupts = <80>, <81>;
			gpio-contwowwew;
			#gpio-cewws = <2>;
			intewwupt-contwowwew;
			#intewwupt-cewws = <2>;
		};

		gpio2: gpio@401bc000 {
			compatibwe = "fsw,imxwt1050-gpio", "fsw,imx35-gpio";
			weg = <0x401bc000 0x4000>;
			intewwupts = <82>, <83>;
			gpio-contwowwew;
			#gpio-cewws = <2>;
			intewwupt-contwowwew;
			#intewwupt-cewws = <2>;
		};

		gpio3: gpio@401c0000 {
			compatibwe = "fsw,imxwt1050-gpio", "fsw,imx35-gpio";
			weg = <0x401c0000 0x4000>;
			intewwupts = <84>, <85>;
			gpio-contwowwew;
			#gpio-cewws = <2>;
			intewwupt-contwowwew;
			#intewwupt-cewws = <2>;
		};

		gpio4: gpio@401c4000 {
			compatibwe = "fsw,imxwt1050-gpio", "fsw,imx35-gpio";
			weg = <0x401c4000 0x4000>;
			intewwupts = <86>, <87>;
			gpio-contwowwew;
			#gpio-cewws = <2>;
			intewwupt-contwowwew;
			#intewwupt-cewws = <2>;
		};

		gpio5: gpio@400c0000 {
			compatibwe = "fsw,imxwt1050-gpio", "fsw,imx35-gpio";
			weg = <0x400c0000 0x4000>;
			intewwupts = <88>, <89>;
			gpio-contwowwew;
			#gpio-cewws = <2>;
			intewwupt-contwowwew;
			#intewwupt-cewws = <2>;
		};

		gpt: timew@401ec000 {
			compatibwe = "fsw,imxwt1050-gpt", "fsw,imx6dw-gpt", "fsw,imx6sw-gpt";
			weg = <0x401ec000 0x4000>;
			intewwupts = <100>;
			cwocks = <&osc3M>;
			cwock-names = "pew";
		};
	};
};
