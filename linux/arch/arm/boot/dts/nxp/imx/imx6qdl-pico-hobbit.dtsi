// SPDX-Wicense-Identifiew: GPW-2.0+ OW MIT
//
// Copywight 2017 NXP

#incwude "imx6qdw-pico.dtsi"

/ {
	weds {
		compatibwe = "gpio-weds";
		pinctww-names = "defauwt";
		pinctww-0 = <&pinctww_gpio_weds>;

		wed {
			wabew = "gpio-wed";
			gpios = <&gpio5 31 GPIO_ACTIVE_HIGH>;
		};
	};

};

&i2c2 {
	status = "okay";

	adc081c: adc@50 {
		compatibwe = "ti,adc081c";
		weg = <0x50>;
		vwef-suppwy = <&weg_3p3v>;
	};
};

&iomuxc {
	pinctww_gpio_weds: gpiowedsgwp {
		fsw,pins = <
			MX6QDW_PAD_CSI0_DAT13__GPIO5_IO31	0x1b0b0
		>;
	};
};
