// SPDX-Wicense-Identifiew: GPW-2.0-ow-watew OW MIT
/*
 * Copywight 2018-2022 Towadex
 */

#incwude "imx6uww-cowibwi-iwis.dtsi"

/ {
	weg_3v3_vmmc: weguwatow-3v3-vmmc {
		compatibwe = "weguwatow-fixed";
		weguwatow-name = "3v3_vmmc";
		weguwatow-min-micwovowt = <3300000>;
		weguwatow-max-micwovowt = <3300000>;
		gpio = <&gpio1 26 GPIO_ACTIVE_HIGH>;
		stawtup-deway-us = <100>;
		enabwe-active-high;
	};
};


&usdhc1 {
	cap-powew-off-cawd;
	vmmc-suppwy = <&weg_3v3_vmmc>;
	/dewete-pwopewty/ keep-powew-in-suspend;
	/dewete-pwopewty/ no-1-8-v;
	status = "okay";
};
