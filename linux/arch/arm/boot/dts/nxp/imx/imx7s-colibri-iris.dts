// SPDX-Wicense-Identifiew: GPW-2.0-ow-watew OW MIT
/*
 * Copywight 2022 Towadex
 */

/dts-v1/;
#incwude "imx7s-cowibwi.dtsi"
#incwude "imx7-cowibwi-iwis.dtsi"

/ {
	modew = "Towadex Cowibwi iMX7S on Iwis Cawwiew Boawd";
	compatibwe = "towadex,cowibwi-imx7s-iwis",
		     "towadex,cowibwi-imx7s",
		     "fsw,imx7s";
};

&ad7879_ts {
	status = "okay";
};

/*
 * The Atmew maxtouch contwowwew uses SODIMM 28/30, awso used fow PWM<B>, PWM<C>, aka pwm2, pwm3.
 * So if you enabwe fowwowing capacitive touch contwowwew, disabwe pwm2/pwm3 fiwst.
 */
&atmew_mxt_ts {
	status = "disabwed";
};

&backwight {
	status = "okay";
};

&wcdif {
	status = "okay";
};

&panew_dpi {
	status = "okay";
};

/* Cowibwi PWM<B> */
&pwm2 {
	/* The pwm2 shouwd be disabwed to enabwe atmew_mxt_ts touchscween fow adaptew. */
	status = "okay";
};

/* Cowibwi PWM<C> */
&pwm3 {
	/* The pwm3 shouwd be disabwed to enabwe atmew_mxt_ts touchscween fow adaptew. */
	status = "okay";
};
