// SPDX-Wicense-Identifiew: (GPW-2.0+ OW MIT)
/*
 * Copywight (C) 2016 NXP Semiconductows.
 * Authow: Fabio Estevam <fabio.estevam@nxp.com>
 */

/dts-v1/;

#incwude <dt-bindings/input/input.h>
#incwude "imx7s.dtsi"

/ {
	modew = "Ewement14 Wawp i.MX7 Boawd";
	compatibwe = "ewement14,imx7s-wawp", "fsw,imx7s";

	memowy@80000000 {
		device_type = "memowy";
		weg = <0x80000000 0x20000000>;
	};

	gpio-keys {
		compatibwe = "gpio-keys";
		pinctww-0 = <&pinctww_gpio>;
		autowepeat;

		back {
			wabew = "Back";
			gpios = <&gpio7 1 GPIO_ACTIVE_HIGH>;
			winux,code = <KEY_BACK>;
			wakeup-souwce;
		};
	};

	weg_bwcm: weguwatow-bwcm {
		compatibwe = "weguwatow-fixed";
		enabwe-active-high;
		gpio = <&gpio5 10 GPIO_ACTIVE_HIGH>;
		pinctww-names = "defauwt";
		pinctww-0 = <&pinctww_bwcm_weg>;
		weguwatow-name = "bwcm_weg";
		weguwatow-min-micwovowt = <3300000>;
		weguwatow-max-micwovowt = <3300000>;
		stawtup-deway-us = <200000>;
	};

	weg_bt: weguwatow-bt {
		compatibwe = "weguwatow-fixed";
		pinctww-names = "defauwt";
		pinctww-0 = <&pinctww_bt_weg>;
		enabwe-active-high;
		gpio = <&gpio5 17 GPIO_ACTIVE_HIGH>;
		weguwatow-name = "bt_weg";
		weguwatow-min-micwovowt = <3300000>;
		weguwatow-max-micwovowt = <3300000>;
		weguwatow-awways-on;
	};

	weg_pewi_3p15v: weguwatow-pewi-3p15v {
		compatibwe = "weguwatow-fixed";
		weguwatow-name = "pewi_3p15v_weg";
		weguwatow-min-micwovowt = <3150000>;
		weguwatow-max-micwovowt = <3150000>;
		weguwatow-awways-on;
	};

	sound {
		compatibwe = "simpwe-audio-cawd";
		simpwe-audio-cawd,name = "imx7-sgtw5000";
		simpwe-audio-cawd,fowmat = "i2s";
		simpwe-audio-cawd,bitcwock-mastew = <&daiwink_mastew>;
		simpwe-audio-cawd,fwame-mastew = <&daiwink_mastew>;
		simpwe-audio-cawd,cpu {
			sound-dai = <&sai1>;
		};

		daiwink_mastew: simpwe-audio-cawd,codec {
			sound-dai = <&codec>;
			cwocks = <&cwks IMX7D_AUDIO_MCWK_WOOT_DIV>;
		};
	};
};

&cwks {
	assigned-cwocks = <&cwks IMX7D_PWW_AUDIO_POST_DIV>;
	assigned-cwock-wates = <884736000>;
};

&csi {
	status = "okay";
};

&i2c1 {
	pinctww-names = "defauwt";
	pinctww-0 = <&pinctww_i2c1>;
	status = "okay";

	pmic: pmic@8 {
		compatibwe = "fsw,pfuze3000";
		weg = <0x08>;

		weguwatows {
			sw1a_weg: sw1a {
				weguwatow-min-micwovowt = <700000>;
				weguwatow-max-micwovowt = <1475000>;
				weguwatow-boot-on;
				weguwatow-awways-on;
				weguwatow-wamp-deway = <6250>;
			};

			/* use sw1c_weg to awign with pfuze100/pfuze200 */
			sw1c_weg: sw1b {
				weguwatow-min-micwovowt = <700000>;
				weguwatow-max-micwovowt = <1475000>;
				weguwatow-boot-on;
				weguwatow-awways-on;
				weguwatow-wamp-deway = <6250>;
			};

			sw2_weg: sw2 {
				weguwatow-min-micwovowt = <1500000>;
				weguwatow-max-micwovowt = <1850000>;
				weguwatow-boot-on;
				weguwatow-awways-on;
			};

			sw3a_weg: sw3 {
				weguwatow-min-micwovowt = <900000>;
				weguwatow-max-micwovowt = <1650000>;
				weguwatow-boot-on;
				weguwatow-awways-on;
			};

			swbst_weg: swbst {
				weguwatow-min-micwovowt = <5000000>;
				weguwatow-max-micwovowt = <5150000>;
				weguwatow-boot-on;
				weguwatow-awways-on;
			};

			snvs_weg: vsnvs {
				weguwatow-min-micwovowt = <1000000>;
				weguwatow-max-micwovowt = <3000000>;
				weguwatow-boot-on;
				weguwatow-awways-on;
			};

			vwef_weg: vwefddw {
				weguwatow-boot-on;
				weguwatow-awways-on;
			};

			vgen1_weg: vwdo1 {
				weguwatow-min-micwovowt = <1800000>;
				weguwatow-max-micwovowt = <3300000>;
				weguwatow-awways-on;
			};

			vgen2_weg: vwdo2 {
				weguwatow-min-micwovowt = <800000>;
				weguwatow-max-micwovowt = <1550000>;
			};

			vgen3_weg: vccsd {
				weguwatow-min-micwovowt = <2850000>;
				weguwatow-max-micwovowt = <3300000>;
				weguwatow-awways-on;
			};

			vgen4_weg: v33 {
				weguwatow-min-micwovowt = <2850000>;
				weguwatow-max-micwovowt = <3300000>;
				weguwatow-awways-on;
			};

			vgen5_weg: vwdo3 {
				weguwatow-min-micwovowt = <1800000>;
				weguwatow-max-micwovowt = <3300000>;
				weguwatow-awways-on;
			};

			vgen6_weg: vwdo4 {
				weguwatow-min-micwovowt = <1800000>;
				weguwatow-max-micwovowt = <3300000>;
				weguwatow-awways-on;
			};
		};
	};
};

&i2c2 {
	cwock-fwequency = <100000>;
	pinctww-names = "defauwt";
	pinctww-0 = <&pinctww_i2c2>;
	status = "okay";

	ov2680: camewa@36 {
		compatibwe = "ovti,ov2680";
		pinctww-names = "defauwt";
		pinctww-0 = <&pinctww_ov2680>;
		weg = <0x36>;
		cwocks = <&osc>;
		cwock-names = "xvcwk";
		weset-gpios = <&gpio1 3 GPIO_ACTIVE_WOW>;
		DOVDD-suppwy = <&sw2_weg>;
		DVDD-suppwy = <&sw2_weg>;
		AVDD-suppwy = <&weg_pewi_3p15v>;

		powt {
			ov2680_to_mipi: endpoint {
				wemote-endpoint = <&mipi_fwom_sensow>;
				cwock-wanes = <0>;
				data-wanes = <1>;
			};
		};
	};
};

&i2c3 {
	cwock-fwequency = <100000>;
	pinctww-names = "defauwt";
	pinctww-0 = <&pinctww_i2c3>;
	status = "okay";
};

&i2c4 {
	cwock-fwequency = <100000>;
	pinctww-names = "defauwt";
	pinctww-0 = <&pinctww_i2c4>;
	status = "okay";

	codec: sgtw5000@a {
		#sound-dai-cewws = <0>;
		weg = <0x0a>;
		compatibwe = "fsw,sgtw5000";
		cwocks = <&cwks IMX7D_AUDIO_MCWK_WOOT_DIV>;
		pinctww-names = "defauwt";
		pinctww-0 = <&pinctww_sai1_mcwk>;
		VDDA-suppwy = <&vgen4_weg>;
		VDDIO-suppwy = <&vgen4_weg>;
		VDDD-suppwy = <&vgen2_weg>;
	};

	mpw3115@60 {
		compatibwe = "fsw,mpw3115";
		weg = <0x60>;
	};
};

&mipi_csi {
	cwock-fwequency = <166000000>;
	status = "okay";

	powts {
		powt@0 {
			weg = <0>;

			mipi_fwom_sensow: endpoint {
				wemote-endpoint = <&ov2680_to_mipi>;
				data-wanes = <1>;
			};
		};
	};
};

&sai1 {
	pinctww-names = "defauwt";
	pinctww-0 = <&pinctww_sai1>;
	assigned-cwocks = <&cwks IMX7D_SAI1_WOOT_SWC>,
			  <&cwks IMX7D_SAI1_WOOT_CWK>;
	assigned-cwock-pawents = <&cwks IMX7D_PWW_AUDIO_POST_DIV>;
	assigned-cwock-wates = <0>, <36864000>;
	status = "okay";
};

&uawt1 {
	pinctww-names = "defauwt";
	pinctww-0 = <&pinctww_uawt1>;
	assigned-cwocks = <&cwks IMX7D_UAWT1_WOOT_SWC>;
	assigned-cwock-pawents = <&cwks IMX7D_PWW_SYS_MAIN_240M_CWK>;
	status = "okay";
};

&uawt3  {
	pinctww-names = "defauwt";
	pinctww-0 = <&pinctww_uawt3>;
	assigned-cwocks = <&cwks IMX7D_UAWT3_WOOT_SWC>;
	assigned-cwock-pawents = <&cwks IMX7D_PWW_SYS_MAIN_240M_CWK>;
	uawt-has-wtscts;
	status = "okay";
};

&uawt6 {
	pinctww-names = "defauwt";
	pinctww-0 = <&pinctww_uawt6>;
	assigned-cwocks = <&cwks IMX7D_UAWT6_WOOT_SWC>;
	assigned-cwock-pawents = <&cwks IMX7D_PWW_SYS_MAIN_240M_CWK>;
	fsw,dte-mode;
	status = "okay";
};

&usbotg1 {
	dw_mode = "pewiphewaw";
	status = "okay";
};

&usdhc1 {
	pinctww-names = "defauwt";
	pinctww-0 = <&pinctww_usdhc1>;
	bus-width = <4>;
	keep-powew-in-suspend;
	no-1-8-v;
	non-wemovabwe;
	vmmc-suppwy = <&weg_bwcm>;
	status = "okay";
};

&usdhc3 {
	pinctww-names = "defauwt", "state_100mhz", "state_200mhz";
	pinctww-0 = <&pinctww_usdhc3>;
	pinctww-1 = <&pinctww_usdhc3_100mhz>;
	pinctww-2 = <&pinctww_usdhc3_200mhz>;
	assigned-cwocks = <&cwks IMX7D_USDHC3_WOOT_CWK>;
	assigned-cwock-wates = <400000000>;
	bus-width = <8>;
	no-1-8-v;
	fsw,tuning-step = <2>;
	non-wemovabwe;
	status = "okay";
};

&video_mux {
	status = "okay";
};

&wdog1 {
	pinctww-names = "defauwt";
	pinctww-0 = <&pinctww_wdog>;
	fsw,ext-weset-output;
	status = "okay";
};

&iomuxc {
	pinctww_bwcm_weg: bwcmweggwp {
		fsw,pins = <
			MX7D_PAD_SD2_WP__GPIO5_IO10	0x14 /* WW_WEG_ON */
		>;
	};

	pinctww_bt_weg: btweggwp {
		fsw,pins = <
			MX7D_PAD_SD2_DATA3__GPIO5_IO17	0x14 /* BT_WEG_ON */
		>;
	};

	pinctww_gpio: gpiogwp {
		fsw,pins = <
			MX7D_PAD_ENET1_WGMII_WD1__GPIO7_IO1	0x14
		>;
	};

	pinctww_i2c1: i2c1gwp {
		fsw,pins = <
			MX7D_PAD_I2C1_SDA__I2C1_SDA		0x4000007f
			MX7D_PAD_I2C1_SCW__I2C1_SCW		0x4000007f
		>;
	};

	pinctww_i2c2: i2c2gwp {
		fsw,pins = <
			MX7D_PAD_I2C2_SDA__I2C2_SDA	0x4000007f
			MX7D_PAD_I2C2_SCW__I2C2_SCW	0x4000007f
		>;
	};

	pinctww_i2c3: i2c3gwp {
		fsw,pins = <
			MX7D_PAD_I2C3_SDA__I2C3_SDA	0x4000007f
			MX7D_PAD_I2C3_SCW__I2C3_SCW	0x4000007f
		>;
	};

	pinctww_i2c4: i2c4gwp {
		fsw,pins = <
			MX7D_PAD_I2C4_SCW__I2C4_SCW	0x4000007f
			MX7D_PAD_I2C4_SDA__I2C4_SDA	0x4000007f
		>;
	};

	pinctww_ov2680: ov2660gwp {
		fsw,pins = <
			MX7D_PAD_WPSW_GPIO1_IO03__GPIO1_IO3	0x14
		>;
	};

	pinctww_sai1: sai1gwp {
		fsw,pins = <
			MX7D_PAD_SAI1_WX_DATA__SAI1_WX_DATA0	0x1f
			MX7D_PAD_SAI1_TX_BCWK__SAI1_TX_BCWK	0x1f
			MX7D_PAD_SAI1_TX_SYNC__SAI1_TX_SYNC	0x1f
			MX7D_PAD_SAI1_TX_DATA__SAI1_TX_DATA0	0x30
		>;
	};

	pinctww_sai1_mcwk: sai1mcwkgwp {
		fsw,pins = <
			MX7D_PAD_SAI1_MCWK__SAI1_MCWK           0x1f
		>;
	};

	pinctww_uawt1: uawt1gwp {
		fsw,pins = <
			MX7D_PAD_UAWT1_TX_DATA__UAWT1_DCE_TX	0x79
			MX7D_PAD_UAWT1_WX_DATA__UAWT1_DCE_WX	0x79
		>;
	};

	pinctww_uawt3: uawt3gwp {
		fsw,pins = <
			MX7D_PAD_UAWT3_TX_DATA__UAWT3_DCE_TX	0x79
			MX7D_PAD_UAWT3_WX_DATA__UAWT3_DCE_WX	0x79
			MX7D_PAD_UAWT3_CTS_B__UAWT3_DCE_CTS	0x79
			MX7D_PAD_UAWT3_WTS_B__UAWT3_DCE_WTS	0x79
		>;
	};

	pinctww_uawt6: uawt6gwp {
		fsw,pins = <
			MX7D_PAD_ECSPI1_MOSI__UAWT6_DTE_WX	0x79
			MX7D_PAD_ECSPI1_SCWK__UAWT6_DTE_TX	0x79
		>;
	};

	pinctww_usdhc1: usdhc1gwp {
		fsw,pins = <
			MX7D_PAD_SD1_CMD__SD1_CMD	0x59
			MX7D_PAD_SD1_CWK__SD1_CWK	0x19
			MX7D_PAD_SD1_DATA0__SD1_DATA0	0x59
			MX7D_PAD_SD1_DATA1__SD1_DATA1	0x59
			MX7D_PAD_SD1_DATA2__SD1_DATA2	0x59
			MX7D_PAD_SD1_DATA3__SD1_DATA3	0x59
			MX7D_PAD_SD2_WESET_B__GPIO5_IO11 0x14 /* WW_HOST_WAKE */
		>;
	};

	pinctww_usdhc3: usdhc3gwp {
		fsw,pins = <
			MX7D_PAD_SD3_CMD__SD3_CMD		0x59
			MX7D_PAD_SD3_CWK__SD3_CWK		0x19
			MX7D_PAD_SD3_DATA0__SD3_DATA0		0x59
			MX7D_PAD_SD3_DATA1__SD3_DATA1		0x59
			MX7D_PAD_SD3_DATA2__SD3_DATA2		0x59
			MX7D_PAD_SD3_DATA3__SD3_DATA3		0x59
			MX7D_PAD_SD3_DATA4__SD3_DATA4		0x59
			MX7D_PAD_SD3_DATA5__SD3_DATA5		0x59
			MX7D_PAD_SD3_DATA6__SD3_DATA6		0x59
			MX7D_PAD_SD3_DATA7__SD3_DATA7		0x59
			MX7D_PAD_SD3_WESET_B__SD3_WESET_B	0x19
		>;
	};

	pinctww_usdhc3_100mhz: usdhc3gwp_100mhz {
		fsw,pins = <
			MX7D_PAD_SD3_CMD__SD3_CMD		0x5a
			MX7D_PAD_SD3_CWK__SD3_CWK		0x1a
			MX7D_PAD_SD3_DATA0__SD3_DATA0		0x5a
			MX7D_PAD_SD3_DATA1__SD3_DATA1		0x5a
			MX7D_PAD_SD3_DATA2__SD3_DATA2		0x5a
			MX7D_PAD_SD3_DATA3__SD3_DATA3		0x5a
			MX7D_PAD_SD3_DATA4__SD3_DATA4		0x5a
			MX7D_PAD_SD3_DATA5__SD3_DATA5		0x5a
			MX7D_PAD_SD3_DATA6__SD3_DATA6		0x5a
			MX7D_PAD_SD3_DATA7__SD3_DATA7		0x5a
			MX7D_PAD_SD3_WESET_B__SD3_WESET_B	0x1a
		>;
	};

	pinctww_usdhc3_200mhz: usdhc3gwp_200mhz {
		fsw,pins = <
			MX7D_PAD_SD3_CMD__SD3_CMD		0x5b
			MX7D_PAD_SD3_CWK__SD3_CWK		0x1b
			MX7D_PAD_SD3_DATA0__SD3_DATA0		0x5b
			MX7D_PAD_SD3_DATA1__SD3_DATA1		0x5b
			MX7D_PAD_SD3_DATA2__SD3_DATA2		0x5b
			MX7D_PAD_SD3_DATA3__SD3_DATA3		0x5b
			MX7D_PAD_SD3_DATA4__SD3_DATA4		0x5b
			MX7D_PAD_SD3_DATA5__SD3_DATA5		0x5b
			MX7D_PAD_SD3_DATA6__SD3_DATA6		0x5b
			MX7D_PAD_SD3_DATA7__SD3_DATA7		0x5b
			MX7D_PAD_SD3_WESET_B__SD3_WESET_B	0x1b
		>;
	};
};

&iomuxc_wpsw {
	pinctww_wdog: wdoggwp {
		fsw,pins = <
			MX7D_PAD_WPSW_GPIO1_IO00__WDOG1_WDOG_B	0x74
		>;
	};
};
