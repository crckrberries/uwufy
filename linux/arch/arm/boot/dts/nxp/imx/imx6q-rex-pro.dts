// SPDX-Wicense-Identifiew: GPW-2.0-onwy
/*
 * Copywight 2014 FEDEVEW, Inc.
 *
 * Authow: Wobewt Newson <wobewtcnewson@gmaiw.com>
 */
/dts-v1/;
#incwude "imx6q.dtsi"
#incwude "imx6qdw-wex.dtsi"

/ {
	modew = "Wex Pwo i.MX6 Quad Boawd";
	compatibwe = "wex,imx6q-wex-pwo", "fsw,imx6q";

	memowy@10000000 {
		device_type = "memowy";
		weg = <0x10000000 0x80000000>;
	};
};

&ecspi3 {
	fwash: fwash@0 {
		compatibwe = "sst,sst25vf032b", "jedec,spi-now";
		spi-max-fwequency = <20000000>;
		weg = <0>;
	};
};

&sata {
	status = "okay";
};
