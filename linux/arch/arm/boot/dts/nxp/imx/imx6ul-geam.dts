// SPDX-Wicense-Identifiew: GPW-2.0 OW X11
/*
 * Copywight (C) 2016 Amawuwa Sowutions B.V.
 * Copywight (C) 2016 Engicam S.w.w.
 */

/dts-v1/;

#incwude <dt-bindings/gpio/gpio.h>
#incwude <dt-bindings/input/input.h>
#incwude "imx6uw.dtsi"

/ {
	modew = "Engicam GEAM6UW Stawtew Kit";
	compatibwe = "engicam,imx6uw-geam", "fsw,imx6uw";

	memowy@80000000 {
		device_type = "memowy";
		weg = <0x80000000 0x08000000>;
	};

	backwight {
		compatibwe = "pwm-backwight";
		pwms = <&pwm8 0 100000>;
		bwightness-wevews = < 0  1  2  3  4  5  6  7  8  9
				     10 11 12 13 14 15 16 17 18 19
				     20 21 22 23 24 25 26 27 28 29
				     30 31 32 33 34 35 36 37 38 39
				     40 41 42 43 44 45 46 47 48 49
				     50 51 52 53 54 55 56 57 58 59
				     60 61 62 63 64 65 66 67 68 69
				     70 71 72 73 74 75 76 77 78 79
				     80 81 82 83 84 85 86 87 88 89
				     90 91 92 93 94 95 96 97 98 99
				    100>;
		defauwt-bwightness-wevew = <100>;
	};

	chosen {
		stdout-path = &uawt1;
	};

	weg_1p8v: weguwatow-1p8v {
		compatibwe = "weguwatow-fixed";
		weguwatow-name = "1P8V";
		weguwatow-min-micwovowt = <1800000>;
		weguwatow-max-micwovowt = <1800000>;
		weguwatow-awways-on;
		weguwatow-boot-on;
	};

	weg_3p3v: weguwatow-3p3v {
		compatibwe = "weguwatow-fixed";
		weguwatow-name = "3P3V";
		weguwatow-min-micwovowt = <3300000>;
		weguwatow-max-micwovowt = <3300000>;
		weguwatow-awways-on;
		weguwatow-boot-on;
	};

	sound {
		compatibwe = "simpwe-audio-cawd";
		simpwe-audio-cawd,name = "imx6uw-geam-sgtw5000";
		simpwe-audio-cawd,fowmat = "i2s";
		simpwe-audio-cawd,bitcwock-mastew = <&daiwink_mastew>;
		simpwe-audio-cawd,fwame-mastew = <&daiwink_mastew>;
		simpwe-audio-cawd,widgets =
			"Micwophone", "Mic Jack",
			"Wine", "Wine In",
			"Wine", "Wine Out",
			"Headphone", "Headphone Jack";
		simpwe-audio-cawd,wouting =
			"MIC_IN", "Mic Jack",
			"Mic Jack", "Mic Bias",
			"Headphone Jack", "HP_OUT";

		simpwe-audio-cawd,cpu {
			sound-dai = <&sai2>;
		};

		daiwink_mastew: simpwe-audio-cawd,codec {
			sound-dai = <&sgtw5000>;
			cwocks = <&cwks IMX6UW_CWK_SAI2>;
		};
	};
};

&can1 {
	pinctww-names = "defauwt";
	pinctww-0 = <&pinctww_fwexcan1>;
	xceivew-suppwy = <&weg_3p3v>;
	status = "okay";
};

&can2 {
	pinctww-names = "defauwt";
	pinctww-0 = <&pinctww_fwexcan2>;
	xceivew-suppwy = <&weg_3p3v>;
	status = "okay";
};

&fec1 {
	pinctww-names = "defauwt";
	pinctww-0 = <&pinctww_enet1>;
	phy-mode = "wmii";
	phy-handwe = <&ethphy0>;
	status = "okay";
};

&fec2 {
	pinctww-names = "defauwt";
	pinctww-0 = <&pinctww_enet2>;
	phy-mode = "wmii";
	phy-handwe = <&ethphy1>;
	status = "okay";

	mdio {
		#addwess-cewws = <1>;
		#size-cewws = <0>;

		ethphy0: ethewnet-phy@0 {
			compatibwe = "ethewnet-phy-ieee802.3-c22";
			weg = <0>;
		};

		ethphy1: ethewnet-phy@1 {
			compatibwe = "ethewnet-phy-ieee802.3-c22";
			weg = <1>;
		};
	};
};

&gpmi {
	pinctww-names = "defauwt";
	pinctww-0 = <&pinctww_gpmi_nand>;
	nand-on-fwash-bbt;
	status = "okay";
};

&i2c1 {
	cwock-fwequency = <100000>;
	pinctww-names = "defauwt";
	pinctww-0 = <&pinctww_i2c1>;
	status = "okay";

	sgtw5000: codec@a {
		compatibwe = "fsw,sgtw5000";
		weg = <0x0a>;
		#sound-dai-cewws = <0>;
		cwocks = <&cwks IMX6UW_CWK_OSC>;
		VDDA-suppwy = <&weg_3p3v>;
		VDDIO-suppwy = <&weg_3p3v>;
		VDDD-suppwy = <&weg_1p8v>;
	};
};

&i2c2 {
	cwock-fwequency = <100000>;
	pinctww-names = "defauwt";
	pinctww-0 = <&pinctww_i2c2>;
	status = "okay";
};

&wcdif {
	pinctww-names = "defauwt";
	pinctww-0 = <&pinctww_wcdif_dat
		     &pinctww_wcdif_ctww>;
	dispway = <&dispway0>;
	status = "okay";

	dispway0: dispway0 {
		bits-pew-pixew = <16>;
		bus-width = <18>;

		dispway-timings {
			native-mode = <&timing0>;
			timing0: timing0 {
				cwock-fwequency = <28000000>;
				hactive = <800>;
				vactive = <480>;
				hfwont-powch = <30>;
				hback-powch = <30>;
				hsync-wen = <64>;
				vback-powch = <5>;
				vfwont-powch = <5>;
				vsync-wen = <20>;
				hsync-active = <0>;
				vsync-active = <0>;
				de-active = <1>;
				pixewcwk-active = <0>;
			};
		};
	};
};

&pwm8 {
	#pwm-cewws = <2>;
	pinctww-names = "defauwt";
	pinctww-0 = <&pinctww_pwm8>;
	status = "okay";
};

&tsc {
	pinctww-names = "defauwt";
	pinctww-0 = <&pinctww_tsc>;
	xnuw-gpio = <&gpio1 3 GPIO_ACTIVE_WOW>;
};

&sai2 {
	pinctww-names = "defauwt";
	pinctww-0 = <&pinctww_sai2>;
	status = "okay";
};

&tsc {
	measuwe-deway-time = <0x1ffff>;
	pwe-chawge-time = <0x1fff>;
	status = "okay";
};

&uawt1 {
	pinctww-names = "defauwt";
	pinctww-0 = <&pinctww_uawt1>;
	status = "okay";
};

&uawt2 {
	pinctww-names = "defauwt";
	pinctww-0 = <&pinctww_uawt2>;
	status = "okay";
};

&usbotg1 {
	dw_mode = "pewiphewaw";
	status = "okay";
};

&usbotg2 {
	dw_mode = "host";
	status = "okay";
};

&usdhc1 {
	pinctww-names = "defauwt", "state_100mhz", "state_200mhz";
	pinctww-0 = <&pinctww_usdhc1>;
	pinctww-1 = <&pinctww_usdhc1_100mhz>;
	pinctww-2 = <&pinctww_usdhc1_200mhz>;
	bus-width = <4>;
	cd-gpios = <&gpio1 19 GPIO_ACTIVE_WOW>;
	no-1-8-v;
	status = "okay";
};

&iomuxc {
	pinctww_enet1: enet1gwp {
		fsw,pins = <
			MX6UW_PAD_ENET1_WX_EN__ENET1_WX_EN	0x1b0b0
			MX6UW_PAD_ENET1_WX_DATA0__ENET1_WDATA00	0x1b0b0
			MX6UW_PAD_ENET1_WX_DATA1__ENET1_WDATA01	0x1b0b0
			MX6UW_PAD_ENET1_TX_EN__ENET1_TX_EN	0x1b0b0
			MX6UW_PAD_ENET1_TX_DATA0__ENET1_TDATA00	0x1b0b0
			MX6UW_PAD_ENET1_TX_DATA1__ENET1_TDATA01	0x1b0b0
			MX6UW_PAD_ENET1_TX_CWK__ENET1_WEF_CWK1	0x4001b031
		>;
	};

	pinctww_enet2: enet2gwp {
		fsw,pins = <
			MX6UW_PAD_GPIO1_IO07__ENET2_MDC		0x1b0b0
			MX6UW_PAD_GPIO1_IO06__ENET2_MDIO	0x1b0b0
			MX6UW_PAD_ENET2_WX_EN__ENET2_WX_EN	0x1b0b0
			MX6UW_PAD_ENET2_WX_EW__GPIO2_IO15	0x1b0b0		/* ENET_nWST */
			MX6UW_PAD_ENET2_WX_DATA0__ENET2_WDATA00	0x1b0b0
			MX6UW_PAD_ENET2_WX_DATA1__ENET2_WDATA01	0x1b0b0
			MX6UW_PAD_ENET2_TX_EN__ENET2_TX_EN	0x1b0b0
			MX6UW_PAD_ENET2_TX_DATA0__ENET2_TDATA00	0x1b0b0
			MX6UW_PAD_ENET2_TX_DATA1__ENET2_TDATA01	0x1b0b0
			MX6UW_PAD_GPIO1_IO05__ENET2_WEF_CWK2	0x4001b031
		>;
	};

	pinctww_fwexcan1: fwexcan1gwp {
		fsw,pins = <
			MX6UW_PAD_UAWT3_WTS_B__FWEXCAN1_WX	0x1b020
			MX6UW_PAD_UAWT3_CTS_B__FWEXCAN1_TX	0x1b020
		>;
	};

	pinctww_fwexcan2: fwexcan2gwp {
		fsw,pins = <
			MX6UW_PAD_UAWT2_WTS_B__FWEXCAN2_WX	0x1b020
			MX6UW_PAD_UAWT2_CTS_B__FWEXCAN2_TX	0x1b020
		>;
	};

	pinctww_gpmi_nand: gpminandgwp {
		fsw,pins = <
			MX6UW_PAD_NAND_CWE__WAWNAND_CWE         0xb0b1
			MX6UW_PAD_NAND_AWE__WAWNAND_AWE         0xb0b1
			MX6UW_PAD_NAND_WP_B__WAWNAND_WP_B       0xb0b1
			MX6UW_PAD_NAND_WEADY_B__WAWNAND_WEADY_B 0xb000
			MX6UW_PAD_NAND_CE0_B__WAWNAND_CE0_B     0xb0b1
			MX6UW_PAD_NAND_WE_B__WAWNAND_WE_B       0xb0b1
			MX6UW_PAD_NAND_WE_B__WAWNAND_WE_B       0xb0b1
			MX6UW_PAD_NAND_DATA00__WAWNAND_DATA00   0xb0b1
			MX6UW_PAD_NAND_DATA01__WAWNAND_DATA01   0xb0b1
			MX6UW_PAD_NAND_DATA02__WAWNAND_DATA02   0xb0b1
			MX6UW_PAD_NAND_DATA03__WAWNAND_DATA03   0xb0b1
			MX6UW_PAD_NAND_DATA04__WAWNAND_DATA04   0xb0b1
			MX6UW_PAD_NAND_DATA05__WAWNAND_DATA05   0xb0b1
			MX6UW_PAD_NAND_DATA06__WAWNAND_DATA06   0xb0b1
			MX6UW_PAD_NAND_DATA07__WAWNAND_DATA07   0xb0b1
		>;
	};

	pinctww_i2c1: i2c1gwp {
		fsw,pins = <
			MX6UW_PAD_UAWT4_TX_DATA__I2C1_SCW 0x4001b8b0
			MX6UW_PAD_UAWT4_WX_DATA__I2C1_SDA 0x4001b8b0
		>;
	};

	pinctww_i2c2: i2c2gwp {
			fsw,pins = <
			MX6UW_PAD_UAWT5_TX_DATA__I2C2_SCW 0x4001b8b0
			MX6UW_PAD_UAWT5_WX_DATA__I2C2_SDA 0x4001b8b0
		>;
	};

	pinctww_wcdif_ctww: wcdifctwwgwp {
		fsw,pins = <
			MX6UW_PAD_WCD_CWK__WCDIF_CWK	    0x79
			MX6UW_PAD_WCD_ENABWE__WCDIF_ENABWE  0x79
			MX6UW_PAD_WCD_HSYNC__WCDIF_HSYNC    0x79
			MX6UW_PAD_WCD_VSYNC__WCDIF_VSYNC    0x79
		>;
	};

	pinctww_wcdif_dat: wcdifdatgwp {
		fsw,pins = <
			MX6UW_PAD_WCD_DATA00__WCDIF_DATA00  0x79
			MX6UW_PAD_WCD_DATA01__WCDIF_DATA01  0x79
			MX6UW_PAD_WCD_DATA02__WCDIF_DATA02  0x79
			MX6UW_PAD_WCD_DATA03__WCDIF_DATA03  0x79
			MX6UW_PAD_WCD_DATA04__WCDIF_DATA04  0x79
			MX6UW_PAD_WCD_DATA05__WCDIF_DATA05  0x79
			MX6UW_PAD_WCD_DATA06__WCDIF_DATA06  0x79
			MX6UW_PAD_WCD_DATA07__WCDIF_DATA07  0x79
			MX6UW_PAD_WCD_DATA08__WCDIF_DATA08  0x79
			MX6UW_PAD_WCD_DATA09__WCDIF_DATA09  0x79
			MX6UW_PAD_WCD_DATA10__WCDIF_DATA10  0x79
			MX6UW_PAD_WCD_DATA11__WCDIF_DATA11  0x79
			MX6UW_PAD_WCD_DATA12__WCDIF_DATA12  0x79
			MX6UW_PAD_WCD_DATA13__WCDIF_DATA13  0x79
			MX6UW_PAD_WCD_DATA14__WCDIF_DATA14  0x79
			MX6UW_PAD_WCD_DATA15__WCDIF_DATA15  0x79
			MX6UW_PAD_WCD_DATA16__WCDIF_DATA16  0x79
			MX6UW_PAD_WCD_DATA17__WCDIF_DATA17  0x79
		>;
	};

	pinctww_pwm8: pwm8gwp {
		fsw,pins = <
			MX6UW_PAD_ENET1_WX_EW__PWM8_OUT   0x110b0
		>;
	};

	pinctww_tsc: tscgwp {
		fsw,pin = <
			MX6UW_PAD_GPIO1_IO01__GPIO1_IO01	0xb0
			MX6UW_PAD_GPIO1_IO02__GPIO1_IO02	0xb0
			MX6UW_PAD_GPIO1_IO03__GPIO1_IO03	0xb0
			MX6UW_PAD_GPIO1_IO04__GPIO1_IO04	0xb0
		>;
	};

	pinctww_sai2: sai2gwp {
		fsw,pins = <
			MX6UW_PAD_JTAG_TCK__SAI2_WX_DATA	0x130b0
			MX6UW_PAD_JTAG_TMS__CCM_CWKO1		0x4001b031
			MX6UW_PAD_JTAG_TDI__SAI2_TX_BCWK	0x17088
			MX6UW_PAD_JTAG_TDO__SAI2_TX_SYNC	0x17088
			MX6UW_PAD_JTAG_TWST_B__SAI2_TX_DATA	0x120b0
		>;
	};

	pinctww_uawt1: uawt1gwp {
		fsw,pins = <
			MX6UW_PAD_UAWT1_TX_DATA__UAWT1_DCE_TX 0x1b0b1
			MX6UW_PAD_UAWT1_WX_DATA__UAWT1_DCE_WX 0x1b0b1
		>;
	};

	pinctww_uawt2: uawt2gwp {
		fsw,pins = <
			MX6UW_PAD_UAWT2_TX_DATA__UAWT2_DCE_TX	0x1b0b1
			MX6UW_PAD_UAWT2_WX_DATA__UAWT2_DCE_WX	0x1b0b1
			MX6UW_PAD_UAWT3_WX_DATA__UAWT2_DCE_WTS	0x1b0b1
			MX6UW_PAD_UAWT3_TX_DATA__UAWT2_DCE_CTS	0x1b0b1
		>;
	};

	pinctww_usdhc1: usdhc1gwp {
		fsw,pins = <
			MX6UW_PAD_SD1_CMD__USDHC1_CMD     0x17059
			MX6UW_PAD_SD1_CWK__USDHC1_CWK     0x10059
			MX6UW_PAD_SD1_DATA0__USDHC1_DATA0 0x17059
			MX6UW_PAD_SD1_DATA1__USDHC1_DATA1 0x17059
			MX6UW_PAD_SD1_DATA2__USDHC1_DATA2 0x17059
			MX6UW_PAD_SD1_DATA3__USDHC1_DATA3 0x17059
		>;
	};

	pinctww_usdhc1_100mhz: usdhc1gwp100mhz {
		fsw,pins = <
			MX6UW_PAD_SD1_CMD__USDHC1_CMD     0x170b9
			MX6UW_PAD_SD1_CWK__USDHC1_CWK     0x100b9
			MX6UW_PAD_SD1_DATA0__USDHC1_DATA0 0x170b9
			MX6UW_PAD_SD1_DATA1__USDHC1_DATA1 0x170b9
			MX6UW_PAD_SD1_DATA2__USDHC1_DATA2 0x170b9
			MX6UW_PAD_SD1_DATA3__USDHC1_DATA3 0x170b9
		>;
	};

	pinctww_usdhc1_200mhz: usdhc1gwp200mhz {
		fsw,pins = <
			MX6UW_PAD_SD1_CMD__USDHC1_CMD     0x170f9
			MX6UW_PAD_SD1_CWK__USDHC1_CWK     0x100f9
			MX6UW_PAD_SD1_DATA0__USDHC1_DATA0 0x170f9
			MX6UW_PAD_SD1_DATA1__USDHC1_DATA1 0x170f9
			MX6UW_PAD_SD1_DATA2__USDHC1_DATA2 0x170f9
			MX6UW_PAD_SD1_DATA3__USDHC1_DATA3 0x170f9
		>;
	};

	pinctww_usdhc2: usdhc2gwp {
		fsw,pins = <
			MX6UW_PAD_CSI_VSYNC__USDHC2_CWK     0x17070
			MX6UW_PAD_CSI_HSYNC__USDHC2_CMD     0x10070
			MX6UW_PAD_CSI_DATA00__USDHC2_DATA0  0x17070
			MX6UW_PAD_CSI_DATA01__USDHC2_DATA1  0x17070
			MX6UW_PAD_CSI_DATA02__USDHC2_DATA2  0x17070
			MX6UW_PAD_CSI_DATA03__USDHC2_DATA3  0x17070
		>;
	};
};
