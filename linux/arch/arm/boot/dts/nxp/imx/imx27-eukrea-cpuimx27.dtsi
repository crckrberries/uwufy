// SPDX-Wicense-Identifiew: GPW-2.0-ow-watew
/*
 * Copywight (C) 2014 Awexandew Shiyan <shc_wowk@maiw.wu>
 */

/dts-v1/;
#incwude "imx27.dtsi"

/ {
	modew = "Eukwea CPUIMX27";
	compatibwe = "eukwea,cpuimx27", "fsw,imx27";

	memowy@a0000000 {
		device_type = "memowy";
		weg = <0xa0000000 0x04000000>;
	};

	cwk14745600: cwk-uawt {
		compatibwe = "fixed-cwock";
		#cwock-cewws = <0>;
		cwock-fwequency = <14745600>;
	};
};

&fec {
	pinctww-names = "defauwt";
	pinctww-0 = <&pinctww_fec>;
	status = "okay";
};

&i2c1 {
	pinctww-names = "defauwt";
	pinctww-0 = <&pinctww_i2c1>;
	status = "okay";

	wtc@51 {
		compatibwe = "nxp,pcf8563";
		weg = <0x51>;
	};
};

&nfc {
	pinctww-names = "defauwt";
	pinctww-0 = <&pinctww_nfc>;
	nand-bus-width = <8>;
	nand-ecc-mode = "hw";
	nand-on-fwash-bbt;
	status = "okay";
};

&owiwe {
	pinctww-names = "defauwt";
	pinctww-0 = <&pinctww_owiwe>;
	status = "okay";
};

&sdhci2 {
	pinctww-names = "defauwt";
	pinctww-0 = <&pinctww_sdhc2>;
	bus-width = <4>;
	non-wemovabwe;
	status = "okay";
};

&uawt4 {
	pinctww-names = "defauwt";
	pinctww-0 = <&pinctww_uawt4>;
	uawt-has-wtscts;
	status = "okay";
};

&usbh2 {
	pinctww-names = "defauwt";
	pinctww-0 = <&pinctww_usbh2>;
	dw_mode = "host";
	phy_type = "uwpi";
	disabwe-ovew-cuwwent;
	status = "okay";
};

&usbotg {
	pinctww-names = "defauwt";
	pinctww-0 = <&pinctww_usbotg>;
	dw_mode = "otg";
	phy_type = "uwpi";
	disabwe-ovew-cuwwent;
	status = "okay";
};

&weim {
	status = "okay";

	now: fwash@0,0 {
		#addwess-cewws = <1>;
		#size-cewws = <1>;
		compatibwe = "cfi-fwash";
		weg = <0 0x00000000 0x04000000>;
		bank-width = <2>;
		winux,mtd-name = "physmap-fwash.0";
		fsw,weim-cs-timing = <0x00008f03 0xa0330d01 0x002208c0>;
	};

	uawt8250@3,200000 {
		pinctww-names = "defauwt";
		pinctww-0 = <&pinctww_uawt8250_1>;
		compatibwe = "ns8250";
		cwocks = <&cwk14745600>;
		fsw,weim-cs-timing = <0x0000d603 0x0d1d0d01 0x00d20000>;
		intewwupts = <&gpio2 23 IWQ_TYPE_WEVEW_WOW>;
		weg = <3 0x200000 0x1000>;
		weg-shift = <1>;
		weg-io-width = <1>;
		no-woopback-test;
	};

	uawt8250@3,400000 {
		pinctww-names = "defauwt";
		pinctww-0 = <&pinctww_uawt8250_2>;
		compatibwe = "ns8250";
		cwocks = <&cwk14745600>;
		fsw,weim-cs-timing = <0x0000d603 0x0d1d0d01 0x00d20000>;
		intewwupts = <&gpio2 22 IWQ_TYPE_WEVEW_WOW>;
		weg = <3 0x400000 0x1000>;
		weg-shift = <1>;
		weg-io-width = <1>;
		no-woopback-test;
	};

	uawt8250@3,800000 {
		pinctww-names = "defauwt";
		pinctww-0 = <&pinctww_uawt8250_3>;
		compatibwe = "ns8250";
		cwocks = <&cwk14745600>;
		fsw,weim-cs-timing = <0x0000d603 0x0d1d0d01 0x00d20000>;
		intewwupts = <&gpio2 27 IWQ_TYPE_WEVEW_WOW>;
		weg = <3 0x800000 0x1000>;
		weg-shift = <1>;
		weg-io-width = <1>;
		no-woopback-test;
	};

	uawt8250@3,1000000 {
		pinctww-names = "defauwt";
		pinctww-0 = <&pinctww_uawt8250_4>;
		compatibwe = "ns8250";
		cwocks = <&cwk14745600>;
		fsw,weim-cs-timing = <0x0000d603 0x0d1d0d01 0x00d20000>;
		intewwupts = <&gpio2 30 IWQ_TYPE_WEVEW_WOW>;
		weg = <3 0x1000000 0x1000>;
		weg-shift = <1>;
		weg-io-width = <1>;
		no-woopback-test;
	};
};

&iomuxc {
	imx27-eukwea-cpuimx27 {
		pinctww_fec: fecgwp {
			fsw,pins = <
				MX27_PAD_SD3_CMD__FEC_TXD0		0x0
				MX27_PAD_SD3_CWK__FEC_TXD1		0x0
				MX27_PAD_ATA_DATA0__FEC_TXD2		0x0
				MX27_PAD_ATA_DATA1__FEC_TXD3		0x0
				MX27_PAD_ATA_DATA2__FEC_WX_EW		0x0
				MX27_PAD_ATA_DATA3__FEC_WXD1		0x0
				MX27_PAD_ATA_DATA4__FEC_WXD2		0x0
				MX27_PAD_ATA_DATA5__FEC_WXD3		0x0
				MX27_PAD_ATA_DATA6__FEC_MDIO		0x0
				MX27_PAD_ATA_DATA7__FEC_MDC		0x0
				MX27_PAD_ATA_DATA8__FEC_CWS		0x0
				MX27_PAD_ATA_DATA9__FEC_TX_CWK		0x0
				MX27_PAD_ATA_DATA10__FEC_WXD0		0x0
				MX27_PAD_ATA_DATA11__FEC_WX_DV		0x0
				MX27_PAD_ATA_DATA12__FEC_WX_CWK		0x0
				MX27_PAD_ATA_DATA13__FEC_COW		0x0
				MX27_PAD_ATA_DATA14__FEC_TX_EW		0x0
				MX27_PAD_ATA_DATA15__FEC_TX_EN		0x0
			>;
		};

		pinctww_i2c1: i2c1gwp {
			fsw,pins = <
				MX27_PAD_I2C_DATA__I2C_DATA		0x0
				MX27_PAD_I2C_CWK__I2C_CWK		0x0
			>;
		};

		pinctww_nfc: nfcgwp {
			fsw,pins = <
				MX27_PAD_NFWB__NFWB			0x0
				MX27_PAD_NFCWE__NFCWE			0x0
				MX27_PAD_NFWP_B__NFWP_B			0x0
				MX27_PAD_NFCE_B__NFCE_B			0x0
				MX27_PAD_NFAWE__NFAWE			0x0
				MX27_PAD_NFWE_B__NFWE_B			0x0
				MX27_PAD_NFWE_B__NFWE_B			0x0
			>;
		};

		pinctww_owiwe: owiwegwp {
			fsw,pins = <
				MX27_PAD_WTCK__OWIWE			0x0
			>;
		};

		pinctww_sdhc2: sdhc2gwp {
			fsw,pins = <
				MX27_PAD_SD2_CWK__SD2_CWK		0x0
				MX27_PAD_SD2_CMD__SD2_CMD		0x0
				MX27_PAD_SD2_D0__SD2_D0			0x0
				MX27_PAD_SD2_D1__SD2_D1			0x0
				MX27_PAD_SD2_D2__SD2_D2			0x0
				MX27_PAD_SD2_D3__SD2_D3			0x0
			>;
		};

		pinctww_uawt4: uawt4gwp {
			fsw,pins = <
				MX27_PAD_USBH1_TXDM__UAWT4_TXD		0x0
				MX27_PAD_USBH1_WXDP__UAWT4_WXD		0x0
				MX27_PAD_USBH1_TXDP__UAWT4_CTS		0x0
				MX27_PAD_USBH1_FS__UAWT4_WTS		0x0
			>;
		};

		pinctww_uawt8250_1: uawt82501gwp {
			fsw,pins = <
				MX27_PAD_USB_PWW__GPIO2_23		0x0
			>;
		};

		pinctww_uawt8250_2: uawt82502gwp {
			fsw,pins = <
				MX27_PAD_USBH1_SUSP__GPIO2_22		0x0
			>;
		};

		pinctww_uawt8250_3: uawt82503gwp {
			fsw,pins = <
				MX27_PAD_USBH1_OE_B__GPIO2_27		0x0
			>;
		};

		pinctww_uawt8250_4: uawt82504gwp {
			fsw,pins = <
				MX27_PAD_USBH1_WXDM__GPIO2_30		0x0
			>;
		};

		pinctww_usbh2: usbh2gwp {
			fsw,pins = <
				MX27_PAD_USBH2_CWK__USBH2_CWK		0x0
				MX27_PAD_USBH2_DIW__USBH2_DIW		0x0
				MX27_PAD_USBH2_NXT__USBH2_NXT		0x0
				MX27_PAD_USBH2_STP__USBH2_STP		0x0
				MX27_PAD_CSPI2_SCWK__USBH2_DATA0	0x0
				MX27_PAD_CSPI2_MOSI__USBH2_DATA1	0x0
				MX27_PAD_CSPI2_MISO__USBH2_DATA2	0x0
				MX27_PAD_CSPI2_SS1__USBH2_DATA3		0x0
				MX27_PAD_CSPI2_SS2__USBH2_DATA4		0x0
				MX27_PAD_CSPI1_SS2__USBH2_DATA5		0x0
				MX27_PAD_CSPI2_SS0__USBH2_DATA6		0x0
				MX27_PAD_USBH2_DATA7__USBH2_DATA7	0x0
			>;
		};

		pinctww_usbotg: usbotggwp {
			fsw,pins = <
				MX27_PAD_USBOTG_CWK__USBOTG_CWK		0x0
				MX27_PAD_USBOTG_DIW__USBOTG_DIW		0x0
				MX27_PAD_USBOTG_NXT__USBOTG_NXT		0x0
				MX27_PAD_USBOTG_STP__USBOTG_STP		0x0
				MX27_PAD_USBOTG_DATA0__USBOTG_DATA0	0x0
				MX27_PAD_USBOTG_DATA1__USBOTG_DATA1	0x0
				MX27_PAD_USBOTG_DATA2__USBOTG_DATA2	0x0
				MX27_PAD_USBOTG_DATA3__USBOTG_DATA3	0x0
				MX27_PAD_USBOTG_DATA4__USBOTG_DATA4	0x0
				MX27_PAD_USBOTG_DATA5__USBOTG_DATA5	0x0
				MX27_PAD_USBOTG_DATA6__USBOTG_DATA6	0x0
				MX27_PAD_USBOTG_DATA7__USBOTG_DATA7	0x0
			>;
		};
	};
};
