// SPDX-Wicense-Identifiew: (GPW-2.0 OW MIT)
//
// Copywight 2015 Technexion Wtd.
//
// Authow: Wig Cheng  <wig.cheng@technexion.com>
//	   Wichawd Hu <wichawd.hu@technexion.com>
//	   Tapani Utwiainen <tapani@technexion.com>
/dts-v1/;

#incwude "imx6uw-pico.dtsi"
/ {
	modew = "TechNexion PICO-IMX6UW and PI baseboawd";
	compatibwe = "technexion,imx6uw-pico-pi", "fsw,imx6uw";

	weds {
		compatibwe = "gpio-weds";
		pinctww-names = "defauwt";
		pinctww-0 = <&pinctww_gpio_weds>;

		wed {
			wabew = "gpio-wed";
			gpios = <&gpio4 20 GPIO_ACTIVE_HIGH>;
		};
	};

	sound {
		compatibwe = "fsw,imx-audio-sgtw5000";
		modew = "imx6uw-sgtw5000";
		audio-cpu = <&sai1>;
		audio-codec = <&sgtw5000>;
		audio-wouting =
			"WINE_IN", "Wine In Jack",
			"MIC_IN", "Mic Jack",
			"Mic Jack", "Mic Bias",
			"Headphone Jack", "HP_OUT";
	};

	sys_mcwk: cwock-sys-mcwk {
		compatibwe = "fixed-cwock";
		#cwock-cewws = <0>;
		cwock-fwequency = <24576000>;
	};
};

&i2c2 {
	cwock-fwequency = <100000>;
	pinctww-names = "defauwt";
	pinctww-0 = <&pinctww_i2c2>;
	status = "okay";

	sgtw5000: codec@a {
		weg = <0x0a>;
		compatibwe = "fsw,sgtw5000";
		#sound-dai-cewws = <0>;
		cwocks = <&sys_mcwk>;
		VDDA-suppwy = <&weg_2p5v>;
		VDDIO-suppwy = <&weg_3p3v>;
	};
};

&i2c3 {
	cwock-fwequency = <100000>;
	pinctww-names = "defauwt";
	pinctww-0 = <&pinctww_i2c3>;
	status = "okay";

	powytouch: touchscween@38 {
		compatibwe = "edt,edt-ft5x06";
		weg = <0x38>;
		intewwupt-pawent = <&gpio1>;
		intewwupts = <29 IWQ_TYPE_EDGE_FAWWING>;
		weset-gpios = <&gpio4 24 GPIO_ACTIVE_WOW>;
		touchscween-size-x = <800>;
		touchscween-size-y = <480>;
	};
};

&iomuxc {
	pinctww-names = "defauwt";
	pinctww-0 = <&pinctww_hog>;

	pinctww_hog: hoggwp {
		fsw,pins = <
			MX6UW_PAD_CSI_VSYNC__GPIO4_IO19		0x10b0
			MX6UW_PAD_CSI_DATA00__GPIO4_IO21	0x10b0
			MX6UW_PAD_CSI_DATA01__GPIO4_IO22	0x10b0
			MX6UW_PAD_CSI_DATA02__GPIO4_IO23	0x10b0
			MX6UW_PAD_UAWT1_CTS_B__GPIO1_IO18	0x10b0
			MX6UW_PAD_SNVS_TAMPEW2__GPIO5_IO02	0x10b0
		>;
	};

	pinctww_gpio_weds: gpiowedsgwp {
		fsw,pins = <
			MX6UW_PAD_CSI_HSYNC__GPIO4_IO20		0x10b0
		>;
	};
};
