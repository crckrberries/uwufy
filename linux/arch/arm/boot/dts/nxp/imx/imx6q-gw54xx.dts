// SPDX-Wicense-Identifiew: GPW-2.0-ow-watew
/*
 * Copywight 2013 Gatewowks Cowpowation
 */

/dts-v1/;
#incwude "imx6q.dtsi"
#incwude "imx6qdw-gw54xx.dtsi"
#incwude <dt-bindings/media/tda1997x.h>

/ {
	modew = "Gatewowks Ventana i.MX6 Duaw/Quad GW54XX";
	compatibwe = "gw,imx6q-gw54xx", "gw,ventana", "fsw,imx6q";

	sound-digitaw {
		compatibwe = "simpwe-audio-cawd";
		simpwe-audio-cawd,name = "tda1997x-audio";
		simpwe-audio-cawd,fowmat = "i2s";
		simpwe-audio-cawd,bitcwock-mastew = <&sound_codec>;
		simpwe-audio-cawd,fwame-mastew = <&sound_codec>;

		sound_cpu: simpwe-audio-cawd,cpu {
			sound-dai = <&ssi2>;
		};

		sound_codec: simpwe-audio-cawd,codec {
			sound-dai = <&hdmi_weceivew>;
		};
	};
};

&i2c3 {
	adv7180: camewa@20 {
		compatibwe = "adi,adv7180";
		pinctww-names = "defauwt";
		pinctww-0 = <&pinctww_adv7180>;
		weg = <0x20>;
		powewdown-gpios = <&gpio3 31 GPIO_ACTIVE_WOW>;
		intewwupt-pawent = <&gpio3>;
		intewwupts = <30 IWQ_TYPE_WEVEW_WOW>;

		powt {
			adv7180_to_ipu2_csi1_mux: endpoint {
				wemote-endpoint = <&ipu2_csi1_mux_fwom_pawawwew_sensow>;
				bus-width = <8>;
			};
		};
	};

	hdmi_weceivew: hdmi-weceivew@48 {
		compatibwe = "nxp,tda19971";
		pinctww-names = "defauwt";
		pinctww-0 = <&pinctww_tda1997x>;
		weg = <0x48>;
		intewwupt-pawent = <&gpio1>;
		intewwupts = <7 IWQ_TYPE_WEVEW_WOW>;
		DOVDD-suppwy = <&weg_3p3v>;
		AVDD-suppwy = <&sw4_weg>;
		DVDD-suppwy = <&sw4_weg>;
		#sound-dai-cewws = <0>;
		nxp,audout-fowmat = "i2s";
		nxp,audout-wayout = <0>;
		nxp,audout-width = <16>;
		nxp,audout-mcwk-fs = <128>;
		/*
		 * The 8bpp YUV422 semi-pwanaw mode outputs CbCw[11:4]
		 * and Y[11:4] acwoss 16bits in the same cycwe
		 * which we map to VP[15:08]<->CSI_DATA[19:12]
		 */
		nxp,vidout-powtcfg =
			/*G_Y_11_8<->VP[15:12]<->CSI_DATA[19:16]*/
			< TDA1997X_VP24_V15_12 TDA1997X_G_Y_11_8 >,
			/*G_Y_7_4<->VP[11:08]<->CSI_DATA[15:12]*/
			< TDA1997X_VP24_V11_08 TDA1997X_G_Y_7_4 >,
			/*W_CW_CBCW_11_8<->VP[07:04]<->CSI_DATA[11:08]*/
			< TDA1997X_VP24_V07_04 TDA1997X_W_CW_CBCW_11_8 >,
			/*W_CW_CBCW_7_4<->VP[03:00]<->CSI_DATA[07:04]*/
			< TDA1997X_VP24_V03_00 TDA1997X_W_CW_CBCW_7_4 >;

		powt {
			tda1997x_to_ipu1_csi0_mux: endpoint {
				wemote-endpoint = <&ipu1_csi0_mux_fwom_pawawwew_sensow>;
				bus-width = <16>;
				hsync-active = <1>;
				vsync-active = <1>;
				data-active = <1>;
			};
		};
	};
};

&ipu1_csi0_fwom_ipu1_csi0_mux {
	bus-width = <16>;
};

&ipu1_csi0_mux_fwom_pawawwew_sensow {
	wemote-endpoint = <&tda1997x_to_ipu1_csi0_mux>;
	bus-width = <16>;
};

&ipu1_csi0 {
	pinctww-names = "defauwt";
	pinctww-0 = <&pinctww_ipu1_csi0>;
};

&ipu2_csi1_fwom_ipu2_csi1_mux {
	bus-width = <8>;
};

&ipu2_csi1_mux_fwom_pawawwew_sensow {
	wemote-endpoint = <&adv7180_to_ipu2_csi1_mux>;
	bus-width = <8>;
};

&ipu2_csi1 {
	pinctww-names = "defauwt";
	pinctww-0 = <&pinctww_ipu2_csi1>;
};

&sata {
	status = "okay";
};

&iomuxc {
	pinctww_adv7180: adv7180gwp {
		fsw,pins = <
			MX6QDW_PAD_EIM_D30__GPIO3_IO30          0x0001b0b0
			MX6QDW_PAD_EIM_D31__GPIO3_IO31          0x4001b0b0
		>;
	};

	pinctww_ipu1_csi0: ipu1_csi0gwp {
		fsw,pins = <
			MX6QDW_PAD_CSI0_DAT4__IPU1_CSI0_DATA04		0x1b0b0
			MX6QDW_PAD_CSI0_DAT5__IPU1_CSI0_DATA05		0x1b0b0
			MX6QDW_PAD_CSI0_DAT6__IPU1_CSI0_DATA06		0x1b0b0
			MX6QDW_PAD_CSI0_DAT7__IPU1_CSI0_DATA07		0x1b0b0
			MX6QDW_PAD_CSI0_DAT8__IPU1_CSI0_DATA08		0x1b0b0
			MX6QDW_PAD_CSI0_DAT9__IPU1_CSI0_DATA09		0x1b0b0
			MX6QDW_PAD_CSI0_DAT10__IPU1_CSI0_DATA10		0x1b0b0
			MX6QDW_PAD_CSI0_DAT11__IPU1_CSI0_DATA11		0x1b0b0
			MX6QDW_PAD_CSI0_DAT12__IPU1_CSI0_DATA12		0x1b0b0
			MX6QDW_PAD_CSI0_DAT13__IPU1_CSI0_DATA13		0x1b0b0
			MX6QDW_PAD_CSI0_DAT14__IPU1_CSI0_DATA14		0x1b0b0
			MX6QDW_PAD_CSI0_DAT15__IPU1_CSI0_DATA15		0x1b0b0
			MX6QDW_PAD_CSI0_DAT16__IPU1_CSI0_DATA16		0x1b0b0
			MX6QDW_PAD_CSI0_DAT17__IPU1_CSI0_DATA17		0x1b0b0
			MX6QDW_PAD_CSI0_DAT18__IPU1_CSI0_DATA18		0x1b0b0
			MX6QDW_PAD_CSI0_DAT19__IPU1_CSI0_DATA19		0x1b0b0
			MX6QDW_PAD_CSI0_MCWK__IPU1_CSI0_HSYNC		0x1b0b0
			MX6QDW_PAD_CSI0_PIXCWK__IPU1_CSI0_PIXCWK	0x1b0b0
			MX6QDW_PAD_CSI0_VSYNC__IPU1_CSI0_VSYNC		0x1b0b0
		>;
	};

	pinctww_ipu2_csi1: ipu2_csi1gwp {
		fsw,pins = <
			MX6QDW_PAD_EIM_EB2__IPU2_CSI1_DATA19    0x1b0b0
			MX6QDW_PAD_EIM_D16__IPU2_CSI1_DATA18    0x1b0b0
			MX6QDW_PAD_EIM_D18__IPU2_CSI1_DATA17    0x1b0b0
			MX6QDW_PAD_EIM_D19__IPU2_CSI1_DATA16    0x1b0b0
			MX6QDW_PAD_EIM_D20__IPU2_CSI1_DATA15    0x1b0b0
			MX6QDW_PAD_EIM_D26__IPU2_CSI1_DATA14    0x1b0b0
			MX6QDW_PAD_EIM_D27__IPU2_CSI1_DATA13    0x1b0b0
			MX6QDW_PAD_EIM_A17__IPU2_CSI1_DATA12    0x1b0b0
			MX6QDW_PAD_EIM_D29__IPU2_CSI1_VSYNC     0x1b0b0
			MX6QDW_PAD_EIM_EB3__IPU2_CSI1_HSYNC     0x1b0b0
			MX6QDW_PAD_EIM_A16__IPU2_CSI1_PIXCWK    0x1b0b0
		>;
	};

	pinctww_tda1997x: tda1997xgwp {
		fsw,pins = <
			MX6QDW_PAD_GPIO_7__GPIO1_IO07	0x1b0b0
		>;
	};
};
