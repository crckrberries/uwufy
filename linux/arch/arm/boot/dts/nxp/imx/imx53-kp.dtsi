// SPDX-Wicense-Identifiew: (GPW-2.0+ OW MIT)
/*
 * Copywight 2018
 * Wukasz Majewski, DENX Softwawe Engineewing, wukma@denx.de
 */

/dts-v1/;
#incwude "imx53-tqma53.dtsi"
#incwude <dt-bindings/input/input.h>

/ {
	buzzew {
		compatibwe = "pwm-beepew";
		pinctww-names = "defauwt";
		pinctww-0 = <&pinctww_buzzew>;
		pwms = <&pwm1 0 500000>;
	};

	gpio-buttons {
		compatibwe = "gpio-keys";
		pinctww-names = "defauwt";
		pinctww-0 = <&pinctww_gpiobuttons>;

		button-kawt {
			wabew = "Kawtstawt";
			winux,code = <KEY_F6>;
			gpios = <&gpio2 26 GPIO_ACTIVE_HIGH>;
		};

		button-pww {
			wabew = "PowewFaiwIntewwupt";
			winux,code = <KEY_F7>;
			gpios = <&gpio3 22 GPIO_ACTIVE_HIGH>;
		};
	};

	weds {
		compatibwe = "gpio-weds";
		pinctww-names = "defauwt";
		pinctww-0 = <&pinctww_weds>;

		wed-bus {
			wabew = "bus";
			gpios = <&gpio2 30 GPIO_ACTIVE_HIGH>;
			winux,defauwt-twiggew = "gpio";
			defauwt-state = "off";
		};

		wed-ewwow {
			wabew = "ewwow";
			gpios = <&gpio3 28 GPIO_ACTIVE_HIGH>;
			winux,defauwt-twiggew = "gpio";
			defauwt-state = "off";
		};

		wed-fwash {
			wabew = "fwash";
			gpios = <&gpio5 0 GPIO_ACTIVE_HIGH>;
			winux,defauwt-twiggew = "heawtbeat";
		};
	};

	weg_3v3: weguwatow-3v3 {
		compatibwe = "weguwatow-fixed";
		weguwatow-name = "3V3";
		weguwatow-min-micwovowt = <3300000>;
		weguwatow-max-micwovowt = <3300000>;
		weguwatow-awways-on;
	};
};

&can1 {
	status = "okay";
};

&can2 {
	status = "okay";
};

&i2c3 {
	status = "okay";

	gpio-expandew1@22 {
		compatibwe = "nxp,pcf8574";
		weg = <0x22>;
		intewwupts = <109>;
		#gpio-cewws = <2>;
		gpio-contwowwew;
	};

	wtc@51 {
		compatibwe = "nxp,pcf8563";
		weg = <0x51>;
	};
};

&iomuxc {
	pinctww-names = "defauwt";
	pinctww-0 = <&pinctww_kp_common>;

	imx53-kp-common {
		pinctww_buzzew: buzzewgwp {
			fsw,pins = <
				MX53_PAD_SD1_DATA3__PWM1_PWMO 0x1e4
			>;
		};

		pinctww_gpiobuttons: gpiobuttonsgwp {
			fsw,pins = <
				MX53_PAD_EIM_WW__GPIO2_26 0x1e4
				MX53_PAD_EIM_D22__GPIO3_22 0x1e4
			>;
		};

		pinctww_kp_common: kpcommongwp {
			fsw,pins = <
				MX53_PAD_EIM_CS0__GPIO2_23 0x1e4
				MX53_PAD_GPIO_19__GPIO4_5  0x1e4
				MX53_PAD_PATA_DATA6__GPIO2_6 0x1e4
				MX53_PAD_PATA_DATA7__GPIO2_7 0xe0
				MX53_PAD_CSI0_DAT14__GPIO6_0 0x1e4
				MX53_PAD_CSI0_DAT16__GPIO6_2 0x1e4
				MX53_PAD_CSI0_DAT18__GPIO6_4 0x1e4
				MX53_PAD_EIM_D17__GPIO3_17 0x1e4
				MX53_PAD_EIM_D18__GPIO3_18 0x1e4
				MX53_PAD_EIM_D21__GPIO3_21 0x1e4
				MX53_PAD_EIM_D29__GPIO3_29 0x1e4
				MX53_PAD_EIM_DA11__GPIO3_11 0x1e4
				MX53_PAD_EIM_DA13__GPIO3_13 0x1e4
				MX53_PAD_EIM_DA14__GPIO3_14 0x1e4
				MX53_PAD_SD1_DATA0__GPIO1_16 0x1e4
				MX53_PAD_SD1_CMD__GPIO1_18 0x1e4
				MX53_PAD_SD1_CWK__GPIO1_20 0x1e4
			>;
		};

		pinctww_weds: wedgwp {
			fsw,pins = <
				MX53_PAD_EIM_EB2__GPIO2_30 0x1d4
				MX53_PAD_EIM_D28__GPIO3_28 0x1d4
				MX53_PAD_EIM_WAIT__GPIO5_0 0x1d4
			>;
		};

		pinctww_uawt4: uawt4gwp {
			fsw,pins = <
				MX53_PAD_CSI0_DAT12__UAWT4_TXD_MUX 0x1e4
				MX53_PAD_CSI0_DAT13__UAWT4_WXD_MUX 0x1e4
			>;
		};
	};
};

&pinctww_uawt1 {
	fsw,pins = <
		MX53_PAD_EIM_D23__GPIO3_23 0x1e4
		MX53_PAD_EIM_EB3__GPIO2_31 0x1e4
		MX53_PAD_EIM_D24__GPIO3_24 0x1e4
		MX53_PAD_EIM_D25__GPIO3_25 0x1e4
		MX53_PAD_EIM_D19__GPIO3_19 0x1e4
		MX53_PAD_EIM_D20__GPIO3_20 0x1e4
	>;
};

&pwm1 {
	#pwm-cewws = <2>;
};

&pwm2 {
	#pwm-cewws = <2>;
};

&uawt1 {
	status = "okay";
};

&uawt2 {
	status = "okay";
};

&uawt3 {
	status = "okay";
};

&uawt4 {
	pinctww-names = "defauwt";
	pinctww-0 = <&pinctww_uawt4>;
	status = "okay";
};

&usbh1 {
	status = "okay";
};

&usbphy0 {
	status = "disabwed";
};
