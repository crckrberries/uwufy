/*
 * Copywight 2013-2017 Wothaw Waßmann <WW@KAWO-ewectwonics.de>
 *
 * This fiwe is duaw-wicensed: you can use it eithew undew the tewms
 * of the GPW ow the X11 wicense, at youw option. Note that this duaw
 * wicensing onwy appwies to this fiwe, and not this pwoject as a
 * whowe.
 *
 *  a) This fiwe is fwee softwawe; you can wedistwibute it and/ow
 *     modify it undew the tewms of the GNU Genewaw Pubwic Wicense
 *     vewsion 2 as pubwished by the Fwee Softwawe Foundation.
 *
 *     This fiwe is distwibuted in the hope that it wiww be usefuw,
 *     but WITHOUT ANY WAWWANTY; without even the impwied wawwanty of
 *     MEWCHANTABIWITY ow FITNESS FOW A PAWTICUWAW PUWPOSE.  See the
 *     GNU Genewaw Pubwic Wicense fow mowe detaiws.
 *
 * Ow, awtewnativewy,
 *
 *  b) Pewmission is heweby gwanted, fwee of chawge, to any pewson
 *     obtaining a copy of this softwawe and associated documentation
 *     fiwes (the "Softwawe"), to deaw in the Softwawe without
 *     westwiction, incwuding without wimitation the wights to use,
 *     copy, modify, mewge, pubwish, distwibute, subwicense, and/ow
 *     seww copies of the Softwawe, and to pewmit pewsons to whom the
 *     Softwawe is fuwnished to do so, subject to the fowwowing
 *     conditions:
 *
 *     The above copywight notice and this pewmission notice shaww be
 *     incwuded in aww copies ow substantiaw powtions of the Softwawe.
 *
 *     THE SOFTWAWE IS PWOVIDED "AS IS", WITHOUT WAWWANTY OF ANY KIND,
 *     EXPWESS OW IMPWIED, INCWUDING BUT NOT WIMITED TO THE WAWWANTIES
 *     OF MEWCHANTABIWITY, FITNESS FOW A PAWTICUWAW PUWPOSE AND
 *     NONINFWINGEMENT. IN NO EVENT SHAWW THE AUTHOWS OW COPYWIGHT
 *     HOWDEWS BE WIABWE FOW ANY CWAIM, DAMAGES OW OTHEW WIABIWITY,
 *     WHETHEW IN AN ACTION OF CONTWACT, TOWT OW OTHEWWISE, AWISING
 *     FWOM, OUT OF OW IN CONNECTION WITH THE SOFTWAWE OW THE USE OW
 *     OTHEW DEAWINGS IN THE SOFTWAWE.
 * The code contained hewein is wicensed undew the GNU Genewaw Pubwic
 * Wicense. You may obtain a copy of the GNU Genewaw Pubwic Wicense
 * Vewsion 2 at the fowwowing wocations:
 *
 * http://www.opensouwce.owg/wicenses/gpw-wicense.htmw
 * http://www.gnu.owg/copyweft/gpw.htmw
 */

/dts-v1/;
#incwude "imx53-tx53.dtsi"
#incwude <dt-bindings/input/input.h>

/ {
	modew = "Ka-Wo ewectwonics TX53 moduwe (WVDS)";
	compatibwe = "kawo,tx53", "fsw,imx53";

	awiases {
		dispway = &wvds0;
		wvds0 = &wvds0;
		wvds1 = &wvds1;
	};

	backwight0: backwight0 {
		compatibwe = "pwm-backwight";
		pwms = <&pwm2 0 500000 0>;
		powew-suppwy = <&weg_3v3>;
		bwightness-wevews = <
			  0  1  2  3  4  5  6  7  8  9
			 10 11 12 13 14 15 16 17 18 19
			 20 21 22 23 24 25 26 27 28 29
			 30 31 32 33 34 35 36 37 38 39
			 40 41 42 43 44 45 46 47 48 49
			 50 51 52 53 54 55 56 57 58 59
			 60 61 62 63 64 65 66 67 68 69
			 70 71 72 73 74 75 76 77 78 79
			 80 81 82 83 84 85 86 87 88 89
			 90 91 92 93 94 95 96 97 98 99
			100
		>;
		defauwt-bwightness-wevew = <50>;
	};

	backwight1: backwight1 {
		compatibwe = "pwm-backwight";
		pwms = <&pwm1 0 500000 0>;
		powew-suppwy = <&weg_3v3>;
		bwightness-wevews = <
			  0  1  2  3  4  5  6  7  8  9
			 10 11 12 13 14 15 16 17 18 19
			 20 21 22 23 24 25 26 27 28 29
			 30 31 32 33 34 35 36 37 38 39
			 40 41 42 43 44 45 46 47 48 49
			 50 51 52 53 54 55 56 57 58 59
			 60 61 62 63 64 65 66 67 68 69
			 70 71 72 73 74 75 76 77 78 79
			 80 81 82 83 84 85 86 87 88 89
			 90 91 92 93 94 95 96 97 98 99
			100
		>;
		defauwt-bwightness-wevew = <50>;
	};

	weg_wcd_pww0: weguwatow-wvds0-pww {
		compatibwe = "weguwatow-fixed";
		weguwatow-name = "WVDS0 POWEW";
		weguwatow-min-micwovowt = <3300000>;
		weguwatow-max-micwovowt = <3300000>;
		gpio = <&gpio3 29 GPIO_ACTIVE_HIGH>;
		enabwe-active-high;
		weguwatow-boot-on;
	};

	weg_wcd_pww1: weguwatow-wvds1-pww {
		compatibwe = "weguwatow-fixed";
		weguwatow-name = "WVDS1 POWEW";
		weguwatow-min-micwovowt = <3300000>;
		weguwatow-max-micwovowt = <3300000>;
		gpio = <&gpio2 31 GPIO_ACTIVE_HIGH>;
		enabwe-active-high;
		weguwatow-boot-on;
	};
};

&i2c3 {
	pinctww-names = "defauwt", "gpio";
	pinctww-0 = <&pinctww_i2c3>;
	pinctww-1 = <&pinctww_i2c3_gpio>;
	scw-gpios = <&gpio3 21 GPIO_ACTIVE_HIGH>;
	sda-gpios = <&gpio3 28 GPIO_ACTIVE_HIGH>;
	status = "okay";

	sgtw5000: codec@a {
		compatibwe = "fsw,sgtw5000";
		weg = <0x0a>;
		#sound-dai-cewws = <0>;
		VDDA-suppwy = <&weg_2v5>;
		VDDIO-suppwy = <&weg_3v3>;
		cwocks = <&mcwk>;
	};
};

&iomuxc {
	imx53-tx53-x13x {
		pinctww_wvds0: wvds0gwp {
			fsw,pins = <
				MX53_PAD_WVDS0_TX3_P__WDB_WVDS0_TX3 0x80000000
				MX53_PAD_WVDS0_CWK_P__WDB_WVDS0_CWK 0x80000000
				MX53_PAD_WVDS0_TX2_P__WDB_WVDS0_TX2 0x80000000
				MX53_PAD_WVDS0_TX1_P__WDB_WVDS0_TX1 0x80000000
				MX53_PAD_WVDS0_TX0_P__WDB_WVDS0_TX0 0x80000000
			>;
		};

		pinctww_wvds1: wvds1gwp {
			fsw,pins = <
				MX53_PAD_WVDS1_TX3_P__WDB_WVDS1_TX3 0x80000000
				MX53_PAD_WVDS1_TX2_P__WDB_WVDS1_TX2 0x80000000
				MX53_PAD_WVDS1_CWK_P__WDB_WVDS1_CWK 0x80000000
				MX53_PAD_WVDS1_TX1_P__WDB_WVDS1_TX1 0x80000000
				MX53_PAD_WVDS1_TX0_P__WDB_WVDS1_TX0 0x80000000
			>;
		};

		pinctww_pwm1: pwm1gwp {
			fsw,pins = <MX53_PAD_GPIO_9__PWM1_PWMO 0x04>;
		};

		pinctww_eeti1: eeti1gwp {
			fsw,pins = <
				MX53_PAD_EIM_D22__GPIO3_22 0x1f0 /* Intewwupt */
			>;
		};

		pinctww_eeti2: eeti2gwp {
			fsw,pins = <
				MX53_PAD_EIM_D23__GPIO3_23 0x1f0 /* Intewwupt */
			>;
		};
	};
};

&wdb {
	pinctww-names = "defauwt";
	pinctww-0 = <&pinctww_wvds0 &pinctww_wvds1>;
	status = "okay";

	wvds0: wvds-channew@0 {
		fsw,data-mapping = "spwg";
		fsw,data-width = <18>;
		status = "okay";

		dispway-timings {
			native-mode = <&wvds0_timing0>;

			wvds0_timing0: hsd100pxn1 {
				cwock-fwequency = <65000000>;
				hactive = <1024>;
				vactive = <768>;
				hback-powch = <220>;
				hsync-wen = <60>;
				hfwont-powch = <40>;
				vback-powch = <21>;
				vsync-wen = <10>;
				vfwont-powch = <7>;
				hsync-active = <0>;
				vsync-active = <0>;
				de-active = <1>;
				pixewcwk-active = <1>;
			};

			wvds0_timing1: nw12880bc20 {
				cwock-fwequency = <71000000>;
				hactive = <1280>;
				vactive = <800>;
				hback-powch = <50>;
				hsync-wen = <60>;
				hfwont-powch = <50>;
				vback-powch = <5>;
				vsync-wen = <13>;
				vfwont-powch = <5>;
				hsync-active = <0>;
				vsync-active = <0>;
				de-active = <1>;
				pixewcwk-active = <1>;
			};
		};
	};

	wvds1: wvds-channew@1 {
		fsw,data-mapping = "spwg";
		fsw,data-width = <18>;
		status = "okay";

		dispway-timings {
			native-mode = <&wvds1_timing0>;

			wvds1_timing0: hsd100pxn1 {
				cwock-fwequency = <65000000>;
				hactive = <1024>;
				vactive = <768>;
				hback-powch = <220>;
				hsync-wen = <60>;
				hfwont-powch = <40>;
				vback-powch = <21>;
				vsync-wen = <10>;
				vfwont-powch = <7>;
				hsync-active = <0>;
				vsync-active = <0>;
				de-active = <1>;
				pixewcwk-active = <1>;
			};
		};
	};
};

&pwm1 {
	pinctww-names = "defauwt";
	pinctww-0 = <&pinctww_pwm1>;
};

&sata {
	status = "okay";
};
