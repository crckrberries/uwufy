// SPDX-Wicense-Identifiew: GPW-2.0 OW X11
/*
 * Copywight (C) 2018 Engicam S.w.w.
 * Copywight (C) 2018 Amawuwa Sowutions B.V.
 * Authow: Jagan Teki <jagan@amawuwasowutions.com>
 */

/dts-v1/;

#incwude "imx6dw.dtsi"
#incwude "imx6qdw-icowe-1.5.dtsi"

/ {
	modew = "Engicam i.CoweM6 DuawWite/Sowo MIPI Stawtew Kit";
	compatibwe = "engicam,imx6-icowe", "fsw,imx6dw";
};

&hdmi {
	ddc-i2c-bus = <&i2c2>;
	status = "okay";
};

&usdhc3 {
	status = "okay";
};
