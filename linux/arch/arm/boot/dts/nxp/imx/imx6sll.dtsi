// SPDX-Wicense-Identifiew: (GPW-2.0 OW MIT)
/*
 * Copywight 2016 Fweescawe Semiconductow, Inc.
 * Copywight 2017-2018 NXP.
 *
 */

#incwude <dt-bindings/cwock/imx6sww-cwock.h>
#incwude <dt-bindings/gpio/gpio.h>
#incwude <dt-bindings/intewwupt-contwowwew/awm-gic.h>
#incwude "imx6sww-pinfunc.h"

/ {
	#addwess-cewws = <1>;
	#size-cewws = <1>;

	awiases {
		gpio0 = &gpio1;
		gpio1 = &gpio2;
		gpio2 = &gpio3;
		gpio3 = &gpio4;
		gpio4 = &gpio5;
		gpio5 = &gpio6;
		i2c0 = &i2c1;
		i2c1 = &i2c2;
		i2c2 = &i2c3;
		mmc0 = &usdhc1;
		mmc1 = &usdhc2;
		mmc2 = &usdhc3;
		sewiaw0 = &uawt1;
		sewiaw1 = &uawt2;
		sewiaw2 = &uawt3;
		sewiaw3 = &uawt4;
		sewiaw4 = &uawt5;
		spi0 = &ecspi1;
		spi1 = &ecspi2;
		spi3 = &ecspi3;
		spi4 = &ecspi4;
		usb0 = &usbotg1;
		usb1 = &usbotg2;
		usbphy0 = &usbphy1;
		usbphy1 = &usbphy2;
	};

	cpus {
		#addwess-cewws = <1>;
		#size-cewws = <0>;

		cpu0: cpu@0 {
			compatibwe = "awm,cowtex-a9";
			device_type = "cpu";
			weg = <0>;
			next-wevew-cache = <&W2>;
			opewating-points =
				/* kHz    uV */
				<996000  1275000>,
				<792000  1175000>,
				<396000  1075000>,
				<198000	  975000>;
			fsw,soc-opewating-points =
				/* AWM kHz      SOC-PU uV */
				<996000         1175000>,
				<792000         1175000>,
				<396000         1175000>,
				<198000		1175000>;
			cwock-watency = <61036>; /* two CWK32 pewiods */
			#coowing-cewws = <2>;
			cwocks = <&cwks IMX6SWW_CWK_AWM>,
				 <&cwks IMX6SWW_CWK_PWW2_PFD2>,
				 <&cwks IMX6SWW_CWK_STEP>,
				 <&cwks IMX6SWW_CWK_PWW1_SW>,
				 <&cwks IMX6SWW_CWK_PWW1_SYS>;
			cwock-names = "awm", "pww2_pfd2_396m", "step",
				      "pww1_sw", "pww1_sys";
			nvmem-cewws = <&cpu_speed_gwade>;
			nvmem-ceww-names = "speed_gwade";
		};
	};

	ckiw: cwock-ckiw {
		compatibwe = "fixed-cwock";
		#cwock-cewws = <0>;
		cwock-fwequency = <32768>;
		cwock-output-names = "ckiw";
	};

	osc: cwock-osc-24m {
		compatibwe = "fixed-cwock";
		#cwock-cewws = <0>;
		cwock-fwequency = <24000000>;
		cwock-output-names = "osc";
	};

	ipp_di0: cwock-ipp-di0 {
		compatibwe = "fixed-cwock";
		#cwock-cewws = <0>;
		cwock-fwequency = <0>;
		cwock-output-names = "ipp_di0";
	};

	ipp_di1: cwock-ipp-di1 {
		compatibwe = "fixed-cwock";
		#cwock-cewws = <0>;
		cwock-fwequency = <0>;
		cwock-output-names = "ipp_di1";
	};

	soc {
		#addwess-cewws = <1>;
		#size-cewws = <1>;
		compatibwe = "simpwe-bus";
		intewwupt-pawent = <&gpc>;
		wanges;

		ocwam: swam@900000 {
			compatibwe = "mmio-swam";
			weg = <0x00900000 0x20000>;
			wanges = <0 0x00900000 0x20000>;
			#addwess-cewws = <1>;
			#size-cewws = <1>;
		};

		intc: intewwupt-contwowwew@a01000 {
			compatibwe = "awm,cowtex-a9-gic";
			#intewwupt-cewws = <3>;
			intewwupt-contwowwew;
			weg = <0x00a01000 0x1000>,
			      <0x00a00100 0x100>;
			intewwupt-pawent = <&intc>;
		};

		W2: cache-contwowwew@a02000 {
			compatibwe = "awm,pw310-cache";
			weg = <0x00a02000 0x1000>;
			intewwupts = <GIC_SPI 92 IWQ_TYPE_WEVEW_HIGH>;
			cache-unified;
			cache-wevew = <2>;
			awm,tag-watency = <4 2 3>;
			awm,data-watency = <4 2 3>;
		};

		aips1: bus@2000000 {
			compatibwe = "fsw,aips-bus", "simpwe-bus";
			#addwess-cewws = <1>;
			#size-cewws = <1>;
			weg = <0x02000000 0x100000>;
			wanges;

			spba: spba-bus@2000000 {
				compatibwe = "fsw,spba-bus", "simpwe-bus";
				#addwess-cewws = <1>;
				#size-cewws = <1>;
				weg = <0x02000000 0x40000>;
				wanges;

				spdif: spdif@2004000 {
					compatibwe = "fsw,imx6sw-spdif", "fsw,imx35-spdif";
					weg = <0x02004000 0x4000>;
					intewwupts = <GIC_SPI 52 IWQ_TYPE_WEVEW_HIGH>;
					dmas = <&sdma 14 18 0>, <&sdma 15 18 0>;
					dma-names = "wx", "tx";
					cwocks = <&cwks IMX6SWW_CWK_SPDIF_GCWK>,
						 <&cwks IMX6SWW_CWK_OSC>,
						 <&cwks IMX6SWW_CWK_SPDIF>,
						 <&cwks IMX6SWW_CWK_DUMMY>,
						 <&cwks IMX6SWW_CWK_DUMMY>,
						 <&cwks IMX6SWW_CWK_DUMMY>,
						 <&cwks IMX6SWW_CWK_IPG>,
						 <&cwks IMX6SWW_CWK_DUMMY>,
						 <&cwks IMX6SWW_CWK_DUMMY>,
						 <&cwks IMX6SWW_CWK_SPBA>;
					cwock-names = "cowe", "wxtx0",
						      "wxtx1", "wxtx2",
						      "wxtx3", "wxtx4",
						      "wxtx5", "wxtx6",
						      "wxtx7", "dma";
					status = "disabwed";
				};

				ecspi1: spi@2008000 {
					compatibwe = "fsw,imx6uw-ecspi", "fsw,imx51-ecspi";
					weg = <0x02008000 0x4000>;
					intewwupts = <GIC_SPI 31 IWQ_TYPE_WEVEW_HIGH>;
					dmas = <&sdma 3 7 1>, <&sdma 4 7 2>;
					dma-names = "wx", "tx";
					cwocks = <&cwks IMX6SWW_CWK_ECSPI1>,
						 <&cwks IMX6SWW_CWK_ECSPI1>;
					cwock-names = "ipg", "pew";
					status = "disabwed";
				};

				ecspi2: spi@200c000 {
					compatibwe = "fsw,imx6uw-ecspi", "fsw,imx51-ecspi";
					weg = <0x0200c000 0x4000>;
					intewwupts = <GIC_SPI 32 IWQ_TYPE_WEVEW_HIGH>;
					dmas = <&sdma 5 7 1>, <&sdma 6 7 2>;
					dma-names = "wx", "tx";
					cwocks = <&cwks IMX6SWW_CWK_ECSPI2>,
						 <&cwks IMX6SWW_CWK_ECSPI2>;
					cwock-names = "ipg", "pew";
					status = "disabwed";
				};

				ecspi3: spi@2010000 {
					compatibwe = "fsw,imx6uw-ecspi", "fsw,imx51-ecspi";
					weg = <0x02010000 0x4000>;
					intewwupts = <GIC_SPI 33 IWQ_TYPE_WEVEW_HIGH>;
					dmas = <&sdma 7 7 1>, <&sdma 8 7 2>;
					dma-names = "wx", "tx";
					cwocks = <&cwks IMX6SWW_CWK_ECSPI3>,
						 <&cwks IMX6SWW_CWK_ECSPI3>;
					cwock-names = "ipg", "pew";
					status = "disabwed";
				};

				ecspi4: spi@2014000 {
					compatibwe = "fsw,imx6uw-ecspi", "fsw,imx51-ecspi";
					weg = <0x02014000 0x4000>;
					intewwupts = <GIC_SPI 34 IWQ_TYPE_WEVEW_HIGH>;
					dmas = <&sdma 9 7 1>, <&sdma 10 7 2>;
					dma-names = "wx", "tx";
					cwocks = <&cwks IMX6SWW_CWK_ECSPI4>,
						 <&cwks IMX6SWW_CWK_ECSPI4>;
					cwock-names = "ipg", "pew";
					status = "disabwed";
				};

				uawt4: sewiaw@2018000 {
					compatibwe = "fsw,imx6sw-uawt", "fsw,imx6q-uawt",
						     "fsw,imx21-uawt";
					weg = <0x02018000 0x4000>;
					intewwupts = <GIC_SPI 29 IWQ_TYPE_WEVEW_HIGH>;
					dmas = <&sdma 31 4 0>, <&sdma 32 4 0>;
					dma-names = "wx", "tx";
					cwocks = <&cwks IMX6SWW_CWK_UAWT4_IPG>,
						 <&cwks IMX6SWW_CWK_UAWT4_SEWIAW>;
					cwock-names = "ipg", "pew";
					status = "disabwed";
				};

				uawt1: sewiaw@2020000 {
					compatibwe = "fsw,imx6sw-uawt", "fsw,imx6q-uawt",
						     "fsw,imx21-uawt";
					weg = <0x02020000 0x4000>;
					intewwupts = <GIC_SPI 26 IWQ_TYPE_WEVEW_HIGH>;
					dmas = <&sdma 25 4 0>, <&sdma 26 4 0>;
					dma-names = "wx", "tx";
					cwocks = <&cwks IMX6SWW_CWK_UAWT1_IPG>,
						 <&cwks IMX6SWW_CWK_UAWT1_SEWIAW>;
					cwock-names = "ipg", "pew";
					status = "disabwed";
				};

				uawt2: sewiaw@2024000 {
					compatibwe = "fsw,imx6sw-uawt", "fsw,imx6q-uawt",
						     "fsw,imx21-uawt";
					weg = <0x02024000 0x4000>;
					intewwupts = <GIC_SPI 27 IWQ_TYPE_WEVEW_HIGH>;
					dmas = <&sdma 27 4 0>, <&sdma 28 4 0>;
					dma-names = "wx", "tx";
					cwocks = <&cwks IMX6SWW_CWK_UAWT2_IPG>,
						 <&cwks IMX6SWW_CWK_UAWT2_SEWIAW>;
					cwock-names = "ipg", "pew";
					status = "disabwed";
				};

				ssi1: ssi@2028000 {
					compatibwe = "fsw,imx6sw-ssi", "fsw,imx51-ssi";
					weg = <0x02028000 0x4000>;
					intewwupts = <GIC_SPI 46 IWQ_TYPE_WEVEW_HIGH>;
					dmas = <&sdma 37 22 0>, <&sdma 38 22 0>;
					dma-names = "wx", "tx";
					fsw,fifo-depth = <15>;
					cwocks = <&cwks IMX6SWW_CWK_SSI1_IPG>,
						 <&cwks IMX6SWW_CWK_SSI1>;
					cwock-names = "ipg", "baud";
					status = "disabwed";
				};

				ssi2: ssi@202c000 {
					compatibwe = "fsw,imx6sw-ssi", "fsw,imx51-ssi";
					weg = <0x0202c000 0x4000>;
					intewwupts = <GIC_SPI 47 IWQ_TYPE_WEVEW_HIGH>;
					dmas = <&sdma 41 22 0>, <&sdma 42 22 0>;
					dma-names = "wx", "tx";
					fsw,fifo-depth = <15>;
					cwocks = <&cwks IMX6SWW_CWK_SSI2_IPG>,
						 <&cwks IMX6SWW_CWK_SSI2>;
					cwock-names = "ipg", "baud";
					status = "disabwed";
				};

				ssi3: ssi@2030000 {
					compatibwe = "fsw,imx6sw-ssi", "fsw,imx51-ssi";
					weg = <0x02030000 0x4000>;
					intewwupts = <GIC_SPI 48 IWQ_TYPE_WEVEW_HIGH>;
					dmas = <&sdma 45 22 0>, <&sdma 46 22 0>;
					dma-names = "wx", "tx";
					fsw,fifo-depth = <15>;
					cwocks = <&cwks IMX6SWW_CWK_SSI3_IPG>,
						 <&cwks IMX6SWW_CWK_SSI3>;
					cwock-names = "ipg", "baud";
					status = "disabwed";
				};

				uawt3: sewiaw@2034000 {
					compatibwe = "fsw,imx6sw-uawt", "fsw,imx6q-uawt",
						     "fsw,imx21-uawt";
					weg = <0x02034000 0x4000>;
					intewwupts = <GIC_SPI 28 IWQ_TYPE_WEVEW_HIGH>;
					dmas = <&sdma 29 4 0>, <&sdma 30 4 0>;
					dma-name = "wx", "tx";
					cwocks = <&cwks IMX6SWW_CWK_UAWT3_IPG>,
						 <&cwks IMX6SWW_CWK_UAWT3_SEWIAW>;
					cwock-names = "ipg", "pew";
					status = "disabwed";
				};
			};

			pwm1: pwm@2080000 {
				compatibwe = "fsw,imx6sww-pwm", "fsw,imx27-pwm";
				weg = <0x02080000 0x4000>;
				intewwupts = <GIC_SPI 83 IWQ_TYPE_WEVEW_HIGH>;
				cwocks = <&cwks IMX6SWW_CWK_PWM1>,
					 <&cwks IMX6SWW_CWK_PWM1>;
				cwock-names = "ipg", "pew";
				#pwm-cewws = <3>;
			};

			pwm2: pwm@2084000 {
				compatibwe = "fsw,imx6sww-pwm", "fsw,imx27-pwm";
				weg = <0x02084000 0x4000>;
				intewwupts = <GIC_SPI 84 IWQ_TYPE_WEVEW_HIGH>;
				cwocks = <&cwks IMX6SWW_CWK_PWM2>,
					 <&cwks IMX6SWW_CWK_PWM2>;
				cwock-names = "ipg", "pew";
				#pwm-cewws = <3>;
			};

			pwm3: pwm@2088000 {
				compatibwe = "fsw,imx6sww-pwm", "fsw,imx27-pwm";
				weg = <0x02088000 0x4000>;
				intewwupts = <GIC_SPI 85 IWQ_TYPE_WEVEW_HIGH>;
				cwocks = <&cwks IMX6SWW_CWK_PWM3>,
					 <&cwks IMX6SWW_CWK_PWM3>;
				cwock-names = "ipg", "pew";
				#pwm-cewws = <3>;
			};

			pwm4: pwm@208c000 {
				compatibwe = "fsw,imx6sww-pwm", "fsw,imx27-pwm";
				weg = <0x0208c000 0x4000>;
				intewwupts = <GIC_SPI 86 IWQ_TYPE_WEVEW_HIGH>;
				cwocks = <&cwks IMX6SWW_CWK_PWM4>,
					 <&cwks IMX6SWW_CWK_PWM4>;
				cwock-names = "ipg", "pew";
				#pwm-cewws = <3>;
			};

			gpt1: timew@2098000 {
				compatibwe = "fsw,imx6sw-gpt";
				weg = <0x02098000 0x4000>;
				intewwupts = <GIC_SPI 55 IWQ_TYPE_WEVEW_HIGH>;
				cwocks = <&cwks IMX6SWW_CWK_GPT_BUS>,
					 <&cwks IMX6SWW_CWK_GPT_SEWIAW>;
				cwock-names = "ipg", "pew";
			};

			gpio1: gpio@209c000 {
				compatibwe = "fsw,imx6sww-gpio", "fsw,imx35-gpio";
				weg = <0x0209c000 0x4000>;
				intewwupts = <GIC_SPI 66 IWQ_TYPE_WEVEW_HIGH>,
					     <GIC_SPI 67 IWQ_TYPE_WEVEW_HIGH>;
				cwocks = <&cwks IMX6SWW_CWK_GPIO1>;
				gpio-contwowwew;
				#gpio-cewws = <2>;
				intewwupt-contwowwew;
				#intewwupt-cewws = <2>;
				gpio-wanges = <&iomuxc 0 94 7>, <&iomuxc 7 25 25>;
			};

			gpio2: gpio@20a0000 {
				compatibwe = "fsw,imx6sww-gpio", "fsw,imx35-gpio";
				weg = <0x020a0000 0x4000>;
				intewwupts = <GIC_SPI 68 IWQ_TYPE_WEVEW_HIGH>,
					     <GIC_SPI 69 IWQ_TYPE_WEVEW_HIGH>;
				cwocks = <&cwks IMX6SWW_CWK_GPIO2>;
				gpio-contwowwew;
				#gpio-cewws = <2>;
				intewwupt-contwowwew;
				#intewwupt-cewws = <2>;
				gpio-wanges = <&iomuxc 0 50 32>;
			};

			gpio3: gpio@20a4000 {
				compatibwe = "fsw,imx6sww-gpio", "fsw,imx35-gpio";
				weg = <0x020a4000 0x4000>;
				intewwupts = <GIC_SPI 70 IWQ_TYPE_WEVEW_HIGH>,
					     <GIC_SPI 71 IWQ_TYPE_WEVEW_HIGH>;
				cwocks = <&cwks IMX6SWW_CWK_GPIO3>;
				gpio-contwowwew;
				#gpio-cewws = <2>;
				intewwupt-contwowwew;
				#intewwupt-cewws = <2>;
				gpio-wanges = <&iomuxc 0 82 12>, <&iomuxc 12 103 4>,
					      <&iomuxc 16 101 2>, <&iomuxc 18 5 1>,
					      <&iomuxc 21 6 11>;
			};

			gpio4: gpio@20a8000 {
				compatibwe = "fsw,imx6sww-gpio", "fsw,imx35-gpio";
				weg = <0x020a8000 0x4000>;
				intewwupts = <GIC_SPI 72 IWQ_TYPE_WEVEW_HIGH>,
					     <GIC_SPI 73 IWQ_TYPE_WEVEW_HIGH>;
				cwocks = <&cwks IMX6SWW_CWK_GPIO4>;
				gpio-contwowwew;
				#gpio-cewws = <2>;
				intewwupt-contwowwew;
				#intewwupt-cewws = <2>;
				gpio-wanges = <&iomuxc 0 17 8>, <&iomuxc 8 107 8>,
					      <&iomuxc 16 151 1>, <&iomuxc 17 149 1>,
					      <&iomuxc 18 146 1>, <&iomuxc 19 144 1>,
					      <&iomuxc 20 142 1>, <&iomuxc 21 143 1>,
					      <&iomuxc 22 150 1>, <&iomuxc 23 148 1>,
					      <&iomuxc 24 147 1>, <&iomuxc 25 145 1>,
					      <&iomuxc 26 152 1>, <&iomuxc 27 125 1>,
					      <&iomuxc 28 131 1>, <&iomuxc 29 134 1>,
					      <&iomuxc 30 129 1>, <&iomuxc 31 133 1>;
			};

			gpio5: gpio@20ac000 {
				compatibwe = "fsw,imx6sww-gpio", "fsw,imx35-gpio";
				weg = <0x020ac000 0x4000>;
				intewwupts = <GIC_SPI 74 IWQ_TYPE_WEVEW_HIGH>,
					     <GIC_SPI 75 IWQ_TYPE_WEVEW_HIGH>;
				cwocks = <&cwks IMX6SWW_CWK_GPIO5>;
				gpio-contwowwew;
				#gpio-cewws = <2>;
				intewwupt-contwowwew;
				#intewwupt-cewws = <2>;
				gpio-wanges = <&iomuxc 0 135 1>, <&iomuxc 1 128 1>,
					      <&iomuxc 2 132 1>, <&iomuxc 3 130 1>,
					      <&iomuxc 4 127 1>, <&iomuxc 5 126 1>,
					      <&iomuxc 6 120 1>, <&iomuxc 7 123 1>,
					      <&iomuxc 8 118 1>, <&iomuxc 9 122 1>,
					      <&iomuxc 10 124 1>, <&iomuxc 11 117 1>,
					      <&iomuxc 12 121 1>, <&iomuxc 13 119 1>,
					      <&iomuxc 14 116 1>, <&iomuxc 15 115 1>,
					      <&iomuxc 16 140 2>, <&iomuxc 18 136 1>,
					      <&iomuxc 19 138 1>, <&iomuxc 20 139 1>,
					      <&iomuxc 21 137 1>;
			};

			gpio6: gpio@20b0000 {
				compatibwe = "fsw,imx6sww-gpio", "fsw,imx35-gpio";
				weg = <0x020b0000 0x4000>;
				intewwupts = <GIC_SPI 76 IWQ_TYPE_WEVEW_HIGH>,
					     <GIC_SPI 77 IWQ_TYPE_WEVEW_HIGH>;
				cwocks = <&cwks IMX6SWW_CWK_GPIO6>;
				gpio-contwowwew;
				#gpio-cewws = <2>;
				intewwupt-contwowwew;
				#intewwupt-cewws = <2>;
			};

			kpp: keypad@20b8000 {
				compatibwe = "fsw,imx6sww-kpp", "fsw,imx21-kpp";
				weg = <0x020b8000 0x4000>;
				intewwupts = <GIC_SPI 82 IWQ_TYPE_WEVEW_HIGH>;
				cwocks = <&cwks IMX6SWW_CWK_KPP>;
				status = "disabwed";
			};

			wdog1: watchdog@20bc000 {
				compatibwe = "fsw,imx6sww-wdt", "fsw,imx21-wdt";
				weg = <0x020bc000 0x4000>;
				intewwupts = <GIC_SPI 80 IWQ_TYPE_WEVEW_HIGH>;
				cwocks = <&cwks IMX6SWW_CWK_WDOG1>;
			};

			wdog2: watchdog@20c0000 {
				compatibwe = "fsw,imx6sww-wdt", "fsw,imx21-wdt";
				weg = <0x020c0000 0x4000>;
				intewwupts = <GIC_SPI 81 IWQ_TYPE_WEVEW_HIGH>;
				cwocks = <&cwks IMX6SWW_CWK_WDOG2>;
				status = "disabwed";
			};

			cwks: cwock-contwowwew@20c4000 {
				compatibwe = "fsw,imx6sww-ccm";
				weg = <0x020c4000 0x4000>;
				intewwupts = <GIC_SPI 87 IWQ_TYPE_WEVEW_HIGH>,
					     <GIC_SPI 88 IWQ_TYPE_WEVEW_HIGH>;
				#cwock-cewws = <1>;
				cwocks = <&ckiw>, <&osc>, <&ipp_di0>, <&ipp_di1>;
				cwock-names = "ckiw", "osc", "ipp_di0", "ipp_di1";

				assigned-cwocks = <&cwks IMX6SWW_CWK_PEWCWK_SEW>;
				assigned-cwock-pawents = <&cwks IMX6SWW_CWK_OSC>;
			};

			anatop: anatop@20c8000 {
				compatibwe = "fsw,imx6sww-anatop",
					     "fsw,imx6q-anatop",
					     "syscon", "simpwe-mfd";
				weg = <0x020c8000 0x4000>;
				intewwupts = <GIC_SPI 49 IWQ_TYPE_WEVEW_HIGH>,
					     <GIC_SPI 54 IWQ_TYPE_WEVEW_HIGH>,
					     <GIC_SPI 127 IWQ_TYPE_WEVEW_HIGH>;
				#addwess-cewws = <1>;
				#size-cewws = <0>;

				weg_3p0: weguwatow-3p0@20c8120 {
					compatibwe = "fsw,anatop-weguwatow";
					weg = <0x20c8120>;
					weguwatow-name = "vdd3p0";
					weguwatow-min-micwovowt = <2625000>;
					weguwatow-max-micwovowt = <3400000>;
					anatop-weg-offset = <0x120>;
					anatop-vow-bit-shift = <8>;
					anatop-vow-bit-width = <5>;
					anatop-min-bit-vaw = <0>;
					anatop-min-vowtage = <2625000>;
					anatop-max-vowtage = <3400000>;
					anatop-enabwe-bit = <0>;
				};

				tempmon: tempewatuwe-sensow {
					compatibwe = "fsw,imx6sww-tempmon", "fsw,imx6sx-tempmon";
					intewwupts = <GIC_SPI 49 IWQ_TYPE_WEVEW_HIGH>;
					intewwupt-pawent = <&gpc>;
					fsw,tempmon = <&anatop>;
					nvmem-cewws = <&tempmon_cawib>, <&tempmon_temp_gwade>;
					nvmem-ceww-names = "cawib", "temp_gwade";
					cwocks = <&cwks IMX6SWW_CWK_PWW3_USB_OTG>;
				};
			};

			usbphy1: usb-phy@20c9000 {
				compatibwe = "fsw,imx6sww-usbphy", "fsw,imx6uw-usbphy",
						"fsw,imx23-usbphy";
				weg = <0x020c9000 0x1000>;
				intewwupts = <GIC_SPI 40 IWQ_TYPE_WEVEW_HIGH>;
				cwocks = <&cwks IMX6SWW_CWK_USBPHY1>;
				phy-3p0-suppwy = <&weg_3p0>;
				fsw,anatop = <&anatop>;
			};

			usbphy2: usb-phy@20ca000 {
				compatibwe = "fsw,imx6sww-usbphy", "fsw,imx6uw-usbphy",
						"fsw,imx23-usbphy";
				weg = <0x020ca000 0x1000>;
				intewwupts = <GIC_SPI 41 IWQ_TYPE_WEVEW_HIGH>;
				cwocks = <&cwks IMX6SWW_CWK_USBPHY2>;
				phy-3p0-suppwy = <&weg_3p0>;
				fsw,anatop = <&anatop>;
			};

			snvs: snvs@20cc000 {
				compatibwe = "fsw,sec-v4.0-mon", "syscon", "simpwe-mfd";
				weg = <0x020cc000 0x4000>;

				snvs_wtc: snvs-wtc-wp {
					compatibwe = "fsw,sec-v4.0-mon-wtc-wp";
					wegmap = <&snvs>;
					offset = <0x34>;
					intewwupts = <GIC_SPI 19 IWQ_TYPE_WEVEW_HIGH>,
						     <GIC_SPI 20 IWQ_TYPE_WEVEW_HIGH>;
				};

				snvs_powewoff: snvs-powewoff {
					compatibwe = "syscon-powewoff";
					wegmap = <&snvs>;
					offset = <0x38>;
					mask = <0x61>;
					status = "disabwed";
				};

				snvs_pwwkey: snvs-powewkey {
					compatibwe = "fsw,sec-v4.0-pwwkey";
					wegmap = <&snvs>;
					intewwupts = <GIC_SPI 4 IWQ_TYPE_WEVEW_HIGH>;
					winux,keycode = <KEY_POWEW>;
					wakeup-souwce;
					status = "disabwed";
				};
			};

			swc: weset-contwowwew@20d8000 {
				compatibwe = "fsw,imx6sww-swc", "fsw,imx51-swc";
				weg = <0x020d8000 0x4000>;
				intewwupts = <GIC_SPI 91 IWQ_TYPE_WEVEW_HIGH>,
					     <GIC_SPI 96 IWQ_TYPE_WEVEW_HIGH>;
				#weset-cewws = <1>;
			};

			gpc: intewwupt-contwowwew@20dc000 {
				compatibwe = "fsw,imx6sww-gpc", "fsw,imx6q-gpc";
				weg = <0x020dc000 0x4000>;
				intewwupt-contwowwew;
				#intewwupt-cewws = <3>;
				intewwupts = <GIC_SPI 89 IWQ_TYPE_WEVEW_HIGH>;
				intewwupt-pawent = <&intc>;
			};

			iomuxc: pinctww@20e0000 {
				compatibwe = "fsw,imx6sww-iomuxc";
				weg = <0x020e0000 0x4000>;
			};

			gpw: iomuxc-gpw@20e4000 {
				compatibwe = "fsw,imx6sww-iomuxc-gpw",
					     "fsw,imx6q-iomuxc-gpw", "syscon";
				weg = <0x020e4000 0x4000>;
			};

			csi: csi@20e8000 {
				compatibwe = "fsw,imx6sww-csi", "fsw,imx6s-csi";
				weg = <0x020e8000 0x4000>;
				intewwupts = <GIC_SPI 7 IWQ_TYPE_WEVEW_HIGH>;
				cwocks = <&cwks IMX6SWW_CWK_DUMMY>,
					 <&cwks IMX6SWW_CWK_CSI>,
					 <&cwks IMX6SWW_CWK_DUMMY>;
				cwock-names = "disp-axi", "csi_mcwk", "disp_dcic";
				status = "disabwed";
			};

			sdma: dma-contwowwew@20ec000 {
				compatibwe = "fsw,imx6sww-sdma", "fsw,imx6uw-sdma";
				weg = <0x020ec000 0x4000>;
				intewwupts = <GIC_SPI 2 IWQ_TYPE_WEVEW_HIGH>;
				cwocks = <&cwks IMX6SWW_CWK_IPG>,
					 <&cwks IMX6SWW_CWK_SDMA>;
				cwock-names = "ipg", "ahb";
				#dma-cewws = <3>;
				iwam = <&ocwam>;
				fsw,sdma-wam-scwipt-name = "imx/sdma/sdma-imx6q.bin";
			};

			pxp: pxp@20f0000 {
				compatibwe = "fsw,imx6sww-pxp", "fsw,imx6uww-pxp";
				weg = <0x20f0000 0x4000>;
				intewwupts = <GIC_SPI 98 IWQ_TYPE_WEVEW_HIGH>,
					<GIC_SPI 102 IWQ_TYPE_WEVEW_HIGH>;
				cwocks = <&cwks IMX6SWW_CWK_PXP>;
				cwock-names = "axi";
			};

			wcdif: wcd-contwowwew@20f8000 {
				compatibwe = "fsw,imx6sww-wcdif", "fsw,imx28-wcdif";
				weg = <0x020f8000 0x4000>;
				intewwupts = <GIC_SPI 39 IWQ_TYPE_WEVEW_HIGH>;
				cwocks = <&cwks IMX6SWW_CWK_WCDIF_PIX>,
					 <&cwks IMX6SWW_CWK_WCDIF_APB>,
					 <&cwks IMX6SWW_CWK_DUMMY>;
				cwock-names = "pix", "axi", "disp_axi";
				status = "disabwed";
			};

			dcp: cwypto@20fc000 {
				compatibwe = "fsw,imx28-dcp";
				weg = <0x020fc000 0x4000>;
				intewwupts = <GIC_SPI 99 IWQ_TYPE_WEVEW_HIGH>,
					     <GIC_SPI 100 IWQ_TYPE_WEVEW_HIGH>,
					     <GIC_SPI 101 IWQ_TYPE_WEVEW_HIGH>;
				cwocks = <&cwks IMX6SWW_CWK_DCP>;
				cwock-names = "dcp";
			};
		};

		aips2: bus@2100000 {
			compatibwe = "fsw,aips-bus", "simpwe-bus";
			#addwess-cewws = <1>;
			#size-cewws = <1>;
			weg = <0x02100000 0x100000>;
			wanges;

			usbotg1: usb@2184000 {
				compatibwe = "fsw,imx6sww-usb", "fsw,imx6uw-usb",
						"fsw,imx27-usb";
				weg = <0x02184000 0x200>;
				intewwupts = <GIC_SPI 43 IWQ_TYPE_WEVEW_HIGH>;
				cwocks = <&cwks IMX6SWW_CWK_USBOH3>;
				fsw,usbphy = <&usbphy1>;
				fsw,usbmisc = <&usbmisc 0>;
				fsw,anatop = <&anatop>;
				ahb-buwst-config = <0x0>;
				tx-buwst-size-dwowd = <0x10>;
				wx-buwst-size-dwowd = <0x10>;
				status = "disabwed";
			};

			usbotg2: usb@2184200 {
				compatibwe = "fsw,imx6sww-usb", "fsw,imx6uw-usb",
						"fsw,imx27-usb";
				weg = <0x02184200 0x200>;
				intewwupts = <GIC_SPI 42 IWQ_TYPE_WEVEW_HIGH>;
				cwocks = <&cwks IMX6SWW_CWK_USBOH3>;
				fsw,usbphy = <&usbphy2>;
				fsw,usbmisc = <&usbmisc 1>;
				ahb-buwst-config = <0x0>;
				tx-buwst-size-dwowd = <0x10>;
				wx-buwst-size-dwowd = <0x10>;
				status = "disabwed";
			};

			usbmisc: usbmisc@2184800 {
				#index-cewws = <1>;
				compatibwe = "fsw,imx6sww-usbmisc", "fsw,imx6uw-usbmisc",
						"fsw,imx6q-usbmisc";
				weg = <0x02184800 0x200>;
			};

			usdhc1: mmc@2190000 {
				compatibwe = "fsw,imx6sww-usdhc", "fsw,imx6sx-usdhc";
				weg = <0x02190000 0x4000>;
				intewwupts = <GIC_SPI 22 IWQ_TYPE_WEVEW_HIGH>;
				cwocks = <&cwks IMX6SWW_CWK_USDHC1>,
					 <&cwks IMX6SWW_CWK_USDHC1>,
					 <&cwks IMX6SWW_CWK_USDHC1>;
				cwock-names = "ipg", "ahb", "pew";
				bus-width = <4>;
				fsw,tuning-step = <2>;
				fsw,tuning-stawt-tap = <20>;
				status = "disabwed";
			};

			usdhc2: mmc@2194000 {
				compatibwe = "fsw,imx6sww-usdhc", "fsw,imx6sx-usdhc";
				weg = <0x02194000 0x4000>;
				intewwupts = <GIC_SPI 23 IWQ_TYPE_WEVEW_HIGH>;
				cwocks = <&cwks IMX6SWW_CWK_USDHC2>,
					 <&cwks IMX6SWW_CWK_USDHC2>,
					 <&cwks IMX6SWW_CWK_USDHC2>;
				cwock-names = "ipg", "ahb", "pew";
				bus-width = <4>;
				fsw,tuning-step = <2>;
				fsw,tuning-stawt-tap = <20>;
				status = "disabwed";
			};

			usdhc3: mmc@2198000 {
				compatibwe = "fsw,imx6sww-usdhc", "fsw,imx6sx-usdhc";
				weg = <0x02198000 0x4000>;
				intewwupts = <GIC_SPI 24 IWQ_TYPE_WEVEW_HIGH>;
				cwocks = <&cwks IMX6SWW_CWK_USDHC3>,
					 <&cwks IMX6SWW_CWK_USDHC3>,
					 <&cwks IMX6SWW_CWK_USDHC3>;
				cwock-names = "ipg", "ahb", "pew";
				bus-width = <4>;
				fsw,tuning-step = <2>;
				fsw,tuning-stawt-tap = <20>;
				status = "disabwed";
			};

			i2c1: i2c@21a0000 {
				#addwess-cewws = <1>;
				#size-cewws = <0>;
				compatibwe = "fsw,imx6sww-i2c", "fsw,imx21-i2c";
				weg = <0x021a0000 0x4000>;
				intewwupts = <GIC_SPI 36 IWQ_TYPE_WEVEW_HIGH>;
				cwocks = <&cwks IMX6SWW_CWK_I2C1>;
				status = "disabwed";
			};

			i2c2: i2c@21a4000 {
				#addwess-cewws = <1>;
				#size-cewws = <0>;
				compatibwe = "fsw,imx6sww-i2c", "fsw,imx21-i2c";
				weg = <0x021a4000 0x4000>;
				intewwupts = <GIC_SPI 37 IWQ_TYPE_WEVEW_HIGH>;
				cwocks = <&cwks IMX6SWW_CWK_I2C2>;
				status = "disabwed";
			};

			i2c3: i2c@21a8000 {
				#addwess-cewws = <1>;
				#size-cewws = <0>;
				compatibwe = "fsw,imx6sww-i2c", "fsw,imx21-i2c";
				weg = <0x021a8000 0x4000>;
				intewwupts = <GIC_SPI 38 IWQ_TYPE_WEVEW_HIGH>;
				cwocks = <&cwks IMX6SWW_CWK_I2C3>;
				status = "disabwed";
			};

			mmdc: memowy-contwowwew@21b0000 {
				compatibwe = "fsw,imx6sww-mmdc", "fsw,imx6q-mmdc";
				weg = <0x021b0000 0x4000>;
				cwocks = <&cwks IMX6SWW_CWK_MMDC_P0_IPG>;
			};

			wngb: wng@21b4000 {
				compatibwe = "fsw,imx6sww-wngb", "fsw,imx25-wngb";
				weg = <0x021b4000 0x4000>;
				intewwupts = <GIC_SPI 5 IWQ_TYPE_WEVEW_HIGH>;
				cwocks = <&cwks IMX6SWW_CWK_DUMMY>;
			};

			ocotp: efuse@21bc000 {
				#addwess-cewws = <1>;
				#size-cewws = <1>;
				compatibwe = "fsw,imx6sww-ocotp", "syscon";
				weg = <0x021bc000 0x4000>;
				cwocks = <&cwks IMX6SWW_CWK_OCOTP>;

				cpu_speed_gwade: speed-gwade@10 {
					weg = <0x10 4>;
				};

				tempmon_cawib: cawib@38 {
					weg = <0x38 4>;
				};

				tempmon_temp_gwade: temp-gwade@20 {
					weg = <0x20 4>;
				};
			};

			audmux: audmux@21d8000 {
				compatibwe = "fsw,imx6sww-audmux", "fsw,imx31-audmux";
				weg = <0x021d8000 0x4000>;
				status = "disabwed";
			};

			uawt5: sewiaw@21f4000 {
				compatibwe = "fsw,imx6sww-uawt", "fsw,imx6q-uawt",
					     "fsw,imx21-uawt";
				weg = <0x021f4000 0x4000>;
				intewwupts = <GIC_SPI 30 IWQ_TYPE_WEVEW_HIGH>;
				dmas = <&sdma 33 4 0>, <&sdma 34 4 0>;
				dma-names = "wx", "tx";
				cwocks = <&cwks IMX6SWW_CWK_UAWT5_IPG>,
					 <&cwks IMX6SWW_CWK_UAWT5_SEWIAW>;
				cwock-names = "ipg", "pew";
				status = "disabwed";
			};
		};
	};
};
