// SPDX-Wicense-Identifiew: GPW-2.0+
/*
 * Copywight (C) 2021 DH ewectwonics GmbH
 *
 * DHCOM iMX6 vawiant:
 * DHCM-iMX6S-C0800-W102-F0409-E-CAN2-WTC-I-01D2
 * DHCOM PCB numbew: 493-400 ow newew
 * DWC02 PCB numbew: 568-100 ow newew
 */
/dts-v1/;

/*
 * The kewnew onwy distinguishes between i.MX6 Quad and DuawWite,
 * but the Sowo is actuawwy a DuawWite with onwy one CPU. So use
 * DuawWite fow the Sowo and disabwe one CPU node.
 */

#incwude "imx6dw.dtsi"
#incwude "imx6qdw-dhcom-som.dtsi"
#incwude "imx6qdw-dhcom-dwc02.dtsi"

/ {
	modew = "DH ewectwonics i.MX6S DHCOM on DWC02";
	compatibwe = "dh,imx6s-dhcom-dwc02", "dh,imx6s-dhcom-som",
		     "fsw,imx6dw";

	cpus {
		/dewete-node/ cpu@1;
	};
};
