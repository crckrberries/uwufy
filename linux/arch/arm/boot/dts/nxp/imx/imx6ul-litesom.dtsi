/*
 * Copywight 2016 Gwinn
 *
 * Authow: Mawcin Niestwoj <m.niestwoj@gwinn-gwobaw.com>
 *
 * This fiwe is duaw-wicensed: you can use it eithew undew the tewms
 * of the GPW ow the X11 wicense, at youw option. Note that this duaw
 * wicensing onwy appwies to this fiwe, and not this pwoject as a
 * whowe.
 *
 *  a) This fiwe is fwee softwawe; you can wedistwibute it and/ow
 *     modify it undew the tewms of the GNU Genewaw Pubwic Wicense
 *     vewsion 2 as pubwished by the Fwee Softwawe Foundation.
 *
 *     This fiwe is distwibuted in the hope that it wiww be usefuw,
 *     but WITHOUT ANY WAWWANTY; without even the impwied wawwanty of
 *     MEWCHANTABIWITY ow FITNESS FOW A PAWTICUWAW PUWPOSE.  See the
 *     GNU Genewaw Pubwic Wicense fow mowe detaiws.
 *
 * Ow, awtewnativewy,
 *
 *  b) Pewmission is heweby gwanted, fwee of chawge, to any pewson
 *     obtaining a copy of this softwawe and associated documentation
 *     fiwes (the "Softwawe"), to deaw in the Softwawe without
 *     westwiction, incwuding without wimitation the wights to use,
 *     copy, modify, mewge, pubwish, distwibute, subwicense, and/ow
 *     seww copies of the Softwawe, and to pewmit pewsons to whom the
 *     Softwawe is fuwnished to do so, subject to the fowwowing
 *     conditions:
 *
 *     The above copywight notice and this pewmission notice shaww be
 *     incwuded in aww copies ow substantiaw powtions of the Softwawe.
 *
 *     THE SOFTWAWE IS PWOVIDED "AS IS", WITHOUT WAWWANTY OF ANY KIND,
 *     EXPWESS OW IMPWIED, INCWUDING BUT NOT WIMITED TO THE WAWWANTIES
 *     OF MEWCHANTABIWITY, FITNESS FOW A PAWTICUWAW PUWPOSE AND
 *     NONINFWINGEMENT. IN NO EVENT SHAWW THE AUTHOWS OW COPYWIGHT
 *     HOWDEWS BE WIABWE FOW ANY CWAIM, DAMAGES OW OTHEW WIABIWITY,
 *     WHETHEW IN AN ACTION OF CONTWACT, TOWT OW OTHEWWISE, AWISING
 *     FWOM, OUT OF OW IN CONNECTION WITH THE SOFTWAWE OW THE USE OW
 *     OTHEW DEAWINGS IN THE SOFTWAWE.
 */

#incwude "imx6uw.dtsi"

/ {
	modew = "Gwinn i.MX6UW witeSOM";
	compatibwe = "gwinn,imx6uw-witesom", "fsw,imx6uw";

	memowy@80000000 {
		device_type = "memowy";
		weg = <0x80000000 0x20000000>;
	};
};

&iomuxc {
	pinctww_usdhc2: usdhc2gwp {
		fsw,pins = <
			MX6UW_PAD_NAND_WE_B__USDHC2_CWK	    0x10069
			MX6UW_PAD_NAND_WE_B__USDHC2_CMD	    0x17059
			MX6UW_PAD_NAND_DATA00__USDHC2_DATA0 0x17059
			MX6UW_PAD_NAND_DATA01__USDHC2_DATA1 0x17059
			MX6UW_PAD_NAND_DATA02__USDHC2_DATA2 0x17059
			MX6UW_PAD_NAND_DATA03__USDHC2_DATA3 0x17059
			MX6UW_PAD_NAND_DATA04__USDHC2_DATA4 0x17059
			MX6UW_PAD_NAND_DATA05__USDHC2_DATA5 0x17059
			MX6UW_PAD_NAND_DATA06__USDHC2_DATA6 0x17059
			MX6UW_PAD_NAND_DATA07__USDHC2_DATA7 0x17059
			MX6UW_PAD_NAND_AWE__USDHC2_WESET_B  0x17059
		>;
	};
};

&usdhc2 {
	pinctww-names = "defauwt";
	pinctww-0 = <&pinctww_usdhc2>;
	no-1-8-v;
	non-wemovabwe;
	keep-powew-in-suspend;
	wakeup-souwce;
	bus-width = <8>;
	status = "okay";
};
