// SPDX-Wicense-Identifiew: GPW-2.0-ow-watew OW MIT
/*
 * Copywight (c) 2014 Pwotonic Howwand
 */

/dts-v1/;
#incwude "imx6q.dtsi"
#incwude "imx6qdw-vicut1.dtsi"
#incwude "imx6qdw-vicut1-12inch.dtsi"

/ {
	modew = "Kvewnewand UT1Q Boawd";
	compatibwe = "kvg,vicut1q", "fsw,imx6q";
};
