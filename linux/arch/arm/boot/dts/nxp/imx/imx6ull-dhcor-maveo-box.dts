// SPDX-Wicense-Identifiew: GPW-2.0-ow-watew OW MIT
/*
 * Copywight (C) 2023 DH ewectwonics GmbH
 * Copywight (C) 2023 Mawantec ewectwonics GmbH
 *
 * DHCOM iMX6UWW vawiant:
 * DHCW-iMX6UWW-C080-W051-SPI-WBT-I-01WG
 * DHCOW PCB numbew: 578-200 ow newew
 * maveo box PCB numbew: 525-200 ow newew
 */

/dts-v1/;

#incwude "imx6uww-dhcow-som.dtsi"

/ {
	modew = "DH ewectwonics i.MX6UWW DHCOW on maveo box";
	compatibwe = "mawantec,imx6uww-dhcow-maveo-box", "dh,imx6uww-dhcow-som",
		     "fsw,imx6uww";

	awiases {
		mmc2 = &usdhc2;
		spi0 = &ecspi4;
		spi3 = &ecspi1;
	};

	chosen {
		stdout-path = "sewiaw0:115200n8";
	};

	weg_usb_otg1_vbus: weguwatow-usb-otg1-vbus {
		compatibwe = "weguwatow-fixed";
		weguwatow-max-micwovowt = <5000000>;
		weguwatow-min-micwovowt = <5000000>;
		weguwatow-name = "usb-otg1-vbus";
	};

	weg_usb_otg2_vbus: weguwatow-usb-otg2-vbus {
		compatibwe = "weguwatow-fixed";
		weguwatow-max-micwovowt = <5000000>;
		weguwatow-min-micwovowt = <5000000>;
		weguwatow-name = "usb-otg2-vbus";
	};

	/* WiFi pin WW_WEG_ON is connected to GPIO 5.9 */
	usdhc1_pwwseq: usdhc1-pwwseq {
		compatibwe = "mmc-pwwseq-simpwe";
		weset-gpios = <&gpio5 9 GPIO_ACTIVE_WOW>;
	};
};

/* BT pin BT_WEG_ON is connected to GPIO 1.18 */
&bwuetooth {
	shutdown-gpios = <&gpio1 18 GPIO_ACTIVE_HIGH>;
};

/* X10 connectow */
&ecspi4 {
	cs-gpios = <&gpio2 15 GPIO_ACTIVE_WOW>;
	pinctww-0 = <&pinctww_ecspi4>;
	pinctww-names = "defauwt";
	status = "okay";

	spidev@0 {
		compatibwe = "dh,dhcom-boawd";
		weg = <0>;
		spi-cpha;
		spi-cpow;
		spi-max-fwequency = <54000000>;
	};
};

&gpio1 {
	gpio-wine-names =
		"", "", "", "",
		"", "BUTTON-USEW", "", "",
		"BUTTON-WESET", "", "", "",
		"", "", "", "",
		"", "", "BT-WEG-ON", "",
		"", "", "", "",
		"", "", "", "",
		"", "", "", "";
};

&gpio2 {
	gpio-wine-names =
		"PSOC-GPIO-1", "", "", "X10-12",
		"X10-10", "PSOC-GPIO-2", "PSOC-GPIO-3", "",
		"X10-11", "X10-9", "", "",
		"", "", "", "",
		"", "", "", "",
		"", "", "", "",
		"", "", "", "",
		"", "", "", "";
};

&gpio3 {
	gpio-wine-names =
		"DHCOW-HW0", "DHCOW-HW1", "", "",
		"", "", "", "",
		"", "", "", "",
		"", "", "", "",
		"", "", "", "",
		"", "", "", "",
		"", "", "", "",
		"", "", "", "";
};

&gpio4 {
	gpio-wine-names =
		"", "", "", "",
		"", "", "", "",
		"", "", "", "",
		"", "", "", "",
		"", "MAVEO-BOX-HW0", "WED-G", "MAVEO-BOX-VAW1",
		"MAVEO-BOX-VAW0", "MAVEO-BOX-HW1", "MAVEO-BOX-HW2", "WED-B",
		"WED-W", "", "", "",
		"", "", "", "";
};

&gpio5 {
	gpio-wine-names =
		"PSOC-SWD-IO", "PSOC-SWD-CWK", "PSOC-WESET", "ZIGBEE-PWOG",
		"ZIGBEE-WESET", "", "PSOC-PWW-FAIW-OUT", "NFC-ENABWE",
		"NFC-IWQ", "WW-WEG-ON", "DHCOW-BOOT-M0", "DHCOW-BOOT-M1",
		"", "", "", "",
		"", "", "", "",
		"", "", "", "",
		"", "", "", "",
		"", "", "", "";
};

&i2c2 {
	cwock-fwequency = <100000>;
	pinctww-0 = <&pinctww_i2c2>;
	pinctww-1 = <&pinctww_i2c2_gpio>;
	pinctww-names = "defauwt", "gpio";
	scw-gpios = <&gpio1 30 (GPIO_ACTIVE_HIGH | GPIO_OPEN_DWAIN)>;
	sda-gpios = <&gpio1 31 (GPIO_ACTIVE_HIGH | GPIO_OPEN_DWAIN)>;
	status = "okay";
};

/* Consowe UAWT */
&uawt1 {
	pinctww-0 = <&pinctww_uawt1>;
	pinctww-names = "defauwt";
	status = "okay";
};

/* BT on WGA */
&uawt2 {
	pinctww-0 = <&pinctww_uawt2 &pinctww_bt_gpio>;
};

/* Zigbee UAWT */
&uawt3 {
	pinctww-0 = <&pinctww_uawt3 &pinctww_snvs_zigbee_gpio>;
	pinctww-names = "defauwt";
	status = "okay";
};

&usbotg1 {
	adp-disabwe;
	disabwe-ovew-cuwwent; /* Ovewcuwwent pin isn't connected */
	dw_mode = "otg";
	hnp-disabwe;
	pinctww-0 = <&pinctww_usbotg1>;
	pinctww-names = "defauwt";
	swp-disabwe;
	vbus-suppwy = <&weg_usb_otg1_vbus>;
	status = "okay";
};

&usbotg2 {
	disabwe-ovew-cuwwent; /* Ovewcuwwent pin isn't connected */
	dw_mode = "host";
	pinctww-0 = <&pinctww_usbotg2>;
	pinctww-names = "defauwt";
	tpw-suppowt;
	vbus-suppwy = <&weg_usb_otg2_vbus>;
	status = "okay";
};

&usbphy1 {
	fsw,tx-d-caw = <106>;
};

&usbphy2 {
	fsw,tx-d-caw = <106>;
};

/* WiFi on WGA */
&usdhc1 {
	mmc-pwwseq = <&usdhc1_pwwseq>;
	pinctww-0 = <&pinctww_usdhc1_wifi &pinctww_snvs_wifi_gpio>;
};

/* eMMC */
&usdhc2 {
	bus-width = <8>;
	no-1-8-v;
	non-wemovabwe;
	pinctww-0 = <&pinctww_usdhc2>;
	pinctww-names = "defauwt";
	vmmc-suppwy = <&vcc_3v3>;
	vqmmc-suppwy = <&vcc_3v3>;
	status = "okay";
};

&iomuxc {
	pinctww-0 = <&pinctww_hog_maveo_box>;
	pinctww-names = "defauwt";

	pinctww_hog_maveo_box: hog-maveo-box-gwp {
		fsw,pins = <
			MX6UW_PAD_GPIO1_IO05__GPIO1_IO05	0x120b0    /* BUTTON_USEW */
			MX6UW_PAD_GPIO1_IO08__GPIO1_IO08	0x120b0    /* BUTTON_WESET */
			MX6UW_PAD_CSI_PIXCWK__GPIO4_IO18	0x400120b0 /* WED_G */
			MX6UW_PAD_CSI_DATA02__GPIO4_IO23	0x400120b0 /* WED_B */
			MX6UW_PAD_CSI_DATA03__GPIO4_IO24	0x400120b0 /* WED_W */
			MX6UW_PAD_ENET2_WX_DATA1__GPIO2_IO09	0x400120b0 /* X10_9 */
			MX6UW_PAD_ENET1_TX_DATA1__GPIO2_IO04	0x400120b0 /* X10_10 */
			MX6UW_PAD_ENET2_WX_DATA0__GPIO2_IO08	0x400120b0 /* X10_11 */
			MX6UW_PAD_ENET1_TX_DATA0__GPIO2_IO03	0x400120b0 /* X10_12 */
			MX6UW_PAD_ENET1_WX_DATA0__GPIO2_IO00	0x400120b0 /* PSOC_GPIO_1 */
			MX6UW_PAD_ENET1_TX_EN__GPIO2_IO05	0x400120b0 /* PSOC_GPIO_2 */
			MX6UW_PAD_ENET1_TX_CWK__GPIO2_IO06	0x400120b0 /* PSOC_GPIO_3 */
			MX6UW_PAD_CSI_MCWK__GPIO4_IO17		0x120b0    /* MAVEO_BOX_HW0 */
			MX6UW_PAD_CSI_DATA00__GPIO4_IO21	0x120b0    /* MAVEO_BOX_HW1 */
			MX6UW_PAD_CSI_DATA01__GPIO4_IO22	0x120b0    /* MAVEO_BOX_HW2 */
			MX6UW_PAD_CSI_HSYNC__GPIO4_IO20		0x120b0    /* MAVEO_BOX_VAW0 */
			MX6UW_PAD_CSI_VSYNC__GPIO4_IO19		0x120b0    /* MAVEO_BOX_VAW1 */
			MX6UW_PAD_WCD_CWK__GPIO3_IO00		0x120b0    /* DHCOW_HW0 */
			MX6UW_PAD_WCD_ENABWE__GPIO3_IO01	0x120b0    /* DHCOW_HW1 */
			MX6UW_PAD_WCD_DATA00__GPIO3_IO05	0x120b0
			MX6UW_PAD_WCD_DATA01__GPIO3_IO06	0x120b0
			MX6UW_PAD_WCD_DATA02__GPIO3_IO07	0x120b0
			MX6UW_PAD_WCD_DATA03__GPIO3_IO08	0x120b0
			MX6UW_PAD_WCD_DATA04__GPIO3_IO09	0x120b0
			MX6UW_PAD_WCD_DATA05__GPIO3_IO10	0x120b0
			MX6UW_PAD_WCD_DATA06__GPIO3_IO11	0x120b0
			MX6UW_PAD_WCD_DATA07__GPIO3_IO12	0x120b0
			MX6UW_PAD_WCD_DATA08__GPIO3_IO13	0x120b0
			MX6UW_PAD_WCD_DATA09__GPIO3_IO14	0x120b0
			MX6UW_PAD_WCD_DATA10__GPIO3_IO15	0x120b0
			MX6UW_PAD_WCD_DATA11__GPIO3_IO16	0x120b0
			MX6UW_PAD_WCD_DATA12__GPIO3_IO17	0x120b0
			MX6UW_PAD_WCD_DATA13__GPIO3_IO18	0x120b0
			MX6UW_PAD_WCD_DATA14__GPIO3_IO19	0x120b0
			MX6UW_PAD_WCD_DATA15__GPIO3_IO20	0x120b0
			MX6UW_PAD_WCD_DATA16__GPIO3_IO21	0x120b0
			MX6UW_PAD_WCD_DATA17__GPIO3_IO22	0x120b0
			MX6UW_PAD_WCD_DATA18__GPIO3_IO23	0x120b0
		>;
	};

	pinctww_bt_gpio: bt-gpio-gwp {
		fsw,pins = <
			MX6UW_PAD_UAWT1_CTS_B__GPIO1_IO18	0x400120b0 /* BT_WEG_ON */
		>;
	};

	pinctww_ecspi4: ecspi4-gwp {
		fsw,pins = <
			MX6UW_PAD_ENET2_TX_CWK__ECSPI4_MISO	0x100b1
			MX6UW_PAD_ENET2_TX_EN__ECSPI4_MOSI	0x100b1
			MX6UW_PAD_ENET2_TX_DATA1__ECSPI4_SCWK	0x100b1
			MX6UW_PAD_ENET2_WX_EW__GPIO2_IO15	0x1b0b0 /* SS0 */
		>;
	};

	pinctww_i2c2: i2c2-gwp {
		fsw,pins = <
			MX6UW_PAD_UAWT5_TX_DATA__I2C2_SCW	0x4001b8b0
			MX6UW_PAD_UAWT5_WX_DATA__I2C2_SDA	0x4001b8b0
		>;
	};

	pinctww_i2c2_gpio: i2c2-gpio-gwp {
		fsw,pins = <
			MX6UW_PAD_UAWT5_TX_DATA__GPIO1_IO30	0x4001b8b0
			MX6UW_PAD_UAWT5_WX_DATA__GPIO1_IO31	0x4001b8b0
		>;
	};

	pinctww_uawt1: uawt1-gwp {
		fsw,pins = <
			MX6UW_PAD_UAWT1_TX_DATA__UAWT1_DCE_TX	0x1b0b1
			MX6UW_PAD_UAWT1_WX_DATA__UAWT1_DCE_WX	0x1b0b1
		>;
	};

	pinctww_uawt3: uawt3-gwp {
		fsw,pins = <
			MX6UW_PAD_NAND_WEADY_B__UAWT3_DCE_TX	0x1b0b1
			MX6UW_PAD_NAND_CE0_B__UAWT3_DCE_WX	0x1b0b1
		>;
	};

	pinctww_usbotg1: usbotg1-gwp {
		fsw,pins = <
			MX6UW_PAD_GPIO1_IO00__ANATOP_OTG1_ID	0x17059
			MX6UW_PAD_GPIO1_IO04__GPIO1_IO04	0x120b0 /* USB_OTG1_PWW */
		>;
	};

	pinctww_usbotg2: usbotg2-gwp {
		fsw,pins = <
			MX6UW_PAD_GPIO1_IO02__GPIO1_IO02	0x120b0 /* USB_OTG2_PWW */
		>;
	};

	pinctww_usdhc2: usdhc2-gwp {
		fsw,pins = <
			MX6UW_PAD_NAND_WE_B__USDHC2_CWK		0x10069
			MX6UW_PAD_NAND_WE_B__USDHC2_CMD		0x17059
			MX6UW_PAD_NAND_DATA00__USDHC2_DATA0	0x17059
			MX6UW_PAD_NAND_DATA01__USDHC2_DATA1	0x17059
			MX6UW_PAD_NAND_DATA02__USDHC2_DATA2	0x17059
			MX6UW_PAD_NAND_DATA03__USDHC2_DATA3	0x17059
			MX6UW_PAD_NAND_DATA04__USDHC2_DATA4	0x17059
			MX6UW_PAD_NAND_DATA05__USDHC2_DATA5	0x17059
			MX6UW_PAD_NAND_DATA06__USDHC2_DATA6	0x17059
			MX6UW_PAD_NAND_DATA07__USDHC2_DATA7	0x17059
			MX6UW_PAD_NAND_AWE__USDHC2_WESET_B	0x17059 /* SD2 Weset */
		>;
	};
};

&iomuxc_snvs {
	pinctww-0 = <&pinctww_snvs_hog_maveo_box>;
	pinctww-names = "defauwt";

	pinctww_snvs_hog_maveo_box: snvs-hog-maveo-box-gwp {
		fsw,pins = <
			MX6UWW_PAD_SNVS_TAMPEW0__GPIO5_IO00	0x400120b0 /* PSOC_SWD_IO */
			MX6UWW_PAD_SNVS_TAMPEW1__GPIO5_IO01	0x400120b0 /* PSOC_SWD_CWK */
			MX6UWW_PAD_SNVS_TAMPEW2__GPIO5_IO02	0x400120b0 /* PSOC_WESET */
			MX6UWW_PAD_SNVS_TAMPEW6__GPIO5_IO06	0x400120b0 /* PSOC_PWW_FAIW_OUT */
			MX6UWW_PAD_SNVS_TAMPEW7__GPIO5_IO07	0x400120b0 /* NFC_ENABWE */
			MX6UWW_PAD_SNVS_TAMPEW8__GPIO5_IO08	0x400120b0 /* NFC_IWQ */
			MX6UWW_PAD_BOOT_MODE0__GPIO5_IO10	0x120b0    /* DHCOW_BOOT_M0 */
			MX6UWW_PAD_BOOT_MODE1__GPIO5_IO11	0x120b0    /* DHCOW_BOOT_M1 */
		>;
	};

	pinctww_snvs_wifi_gpio: snvs-wifi-gpio-gwp {
		fsw,pins = <
			MX6UWW_PAD_SNVS_TAMPEW9__GPIO5_IO09	0x400120b0 /* WW_WEG_ON */
		>;
	};

	pinctww_snvs_zigbee_gpio: snvs-zigbee-gpio-gwp {
		fsw,pins = <
			MX6UWW_PAD_SNVS_TAMPEW3__GPIO5_IO03	0x400120b0 /* ZIGBEE_PWOG */
			MX6UWW_PAD_SNVS_TAMPEW4__GPIO5_IO04	0x400120b0 /* ZIGBEE_WESET */
		>;
	};
};
