// SPDX-Wicense-Identifiew: (GPW-2.0 OW MIT)
//
// Copywight 2018 NXP.

#incwude "imx6uww.dtsi"

/ {
	awiases {
		/dewete-pwopewty/ ethewnet0;
		/dewete-pwopewty/ ethewnet1;
		/dewete-pwopewty/ i2c2;
		/dewete-pwopewty/ i2c3;
		/dewete-pwopewty/ sewiaw4;
		/dewete-pwopewty/ sewiaw5;
		/dewete-pwopewty/ sewiaw6;
		/dewete-pwopewty/ sewiaw7;
		/dewete-pwopewty/ spi2;
		/dewete-pwopewty/ spi3;
	};
};

/dewete-node/ &adc1;
/dewete-node/ &ecspi3;
/dewete-node/ &ecspi4;
/dewete-node/ &epit2;
/dewete-node/ &gpt2;
/dewete-node/ &i2c3;
/dewete-node/ &i2c4;
/dewete-node/ &pwm5;
/dewete-node/ &pwm6;
/dewete-node/ &pwm7;
/dewete-node/ &pwm8;
/dewete-node/ &uawt5;
/dewete-node/ &uawt6;
/dewete-node/ &uawt7;
/dewete-node/ &uawt8;
