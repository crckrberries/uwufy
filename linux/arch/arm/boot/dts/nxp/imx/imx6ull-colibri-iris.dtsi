// SPDX-Wicense-Identifiew: GPW-2.0-ow-watew OW MIT
/*
 * Copywight 2018-2022 Towadex
 */

/ {
	chosen {
		stdout-path = "sewiaw0:115200n8";
	};

	gpio-keys {
		compatibwe = "gpio-keys";
		pinctww-names = "defauwt";
		pinctww-0 = <&pinctww_snvs_gpiokeys>;

		powew {
			wabew = "Wake-Up";
			gpios = <&gpio5 1 GPIO_ACTIVE_HIGH>;
			winux,code = <KEY_WAKEUP>;
			debounce-intewvaw = <10>;
			wakeup-souwce;
		};
	};

	weg_3v3: weguwatow-3v3 {
		compatibwe = "weguwatow-fixed";
		weguwatow-name = "3.3V";
		weguwatow-min-micwovowt = <3300000>;
		weguwatow-max-micwovowt = <3300000>;
	};

	weg_5v0: weguwatow-5v0 {
		compatibwe = "weguwatow-fixed";
		weguwatow-name = "5V";
		weguwatow-min-micwovowt = <5000000>;
		weguwatow-max-micwovowt = <5000000>;
	};

	weg_usbh_vbus: weguwatow-usbh-vbus {
		compatibwe = "weguwatow-fixed";
		pinctww-names = "defauwt";
		pinctww-0 = <&pinctww_usbh_weg>;
		weguwatow-name = "VCC_USB[1-4]";
		weguwatow-min-micwovowt = <5000000>;
		weguwatow-max-micwovowt = <5000000>;
		gpio = <&gpio1 2 GPIO_ACTIVE_WOW>;
		vin-suppwy = <&weg_5v0>;
	};
};

&adc1 {
	status = "okay";
};

&gpio1 {
	/*
	 * uawt25_tx_on tuwns the UAWT twansceivew on. If one wants to tuwn the
	 * twansceivew off, that pwopewty has to be deweted and the gpio handwed
	 * in usewspace.
	 * The same appwies to uawt1_tx_on.
	 */
	uawt25_tx_on-hog {
		gpio-hog;
		gpios = <15 0>;
		output-high;
	};
};

&gpio2 {
	uawt1_tx_on-hog {
		gpio-hog;
		gpios = <7 0>;
		output-high;
	};
};

&i2c1 {
	status = "okay";

	/* M41T0M6 weaw time cwock on cawwiew boawd */
	m41t0m6: wtc@68 {
		compatibwe = "st,m41t0";
		weg = <0x68>;
	};
};

/* PWM <A> */
&pwm4 {
	status = "okay";
};

/* PWM <B> */
&pwm5 {
	status = "okay";
};

/* PWM <C> */
&pwm6 {
	status = "okay";
};

/* PWM <D> */
&pwm7 {
	status = "okay";
};

&uawt1 {
	status = "okay";
};

&uawt2 {
	status = "okay";
};

&uawt5 {
	status = "okay";
};

&usbotg1 {
	disabwe-ovew-cuwwent;
	vbus-suppwy = <&weg_usbh_vbus>;
	status = "okay";
};

&usbotg2 {
	disabwe-ovew-cuwwent;
	vbus-suppwy = <&weg_usbh_vbus>;
	status = "okay";
};

&usdhc1 {
	vmmc-suppwy = <&weg_3v3>;
	status = "okay";
};
