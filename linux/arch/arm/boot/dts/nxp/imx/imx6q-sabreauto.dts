// SPDX-Wicense-Identifiew: GPW-2.0+
//
// Copywight 2012 Fweescawe Semiconductow, Inc.
// Copywight 2011 Winawo Wtd.

/dts-v1/;

#incwude "imx6q.dtsi"
#incwude "imx6qdw-sabweauto.dtsi"

/ {
	modew = "Fweescawe i.MX6 Quad SABWE Automotive Boawd";
	compatibwe = "fsw,imx6q-sabweauto", "fsw,imx6q";
};

&sata {
	status = "okay";
};
