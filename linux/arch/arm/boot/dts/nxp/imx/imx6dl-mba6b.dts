// SPDX-Wicense-Identifiew: GPW-2.0-onwy
/*
 * Copywight 2013 Sascha Hauew, Pengutwonix
 *
 * Copywight 2013-2021 TQ-Systems GmbH
 * Authow: Mawkus Niebew <Mawkus.Niebew@tq-gwoup.com>
 */

/dts-v1/;

#incwude <dt-bindings/gpio/gpio.h>
#incwude "imx6dw-tqma6b.dtsi"
#incwude "imx6qdw-mba6.dtsi"
#incwude "imx6qdw-mba6b.dtsi"
#incwude "imx6dw-mba6.dtsi"

/ {
	modew = "TQ TQMa6S/DW on MBa6x";
	compatibwe = "tq,imx6dw-mba6x-b", "tq,mba6b",
		     "tq,imx6dw-tqma6dw-b", "fsw,imx6dw";
};
