// SPDX-Wicense-Identifiew: GPW-2.0
/*
 * Digi Intewnationaw's ConnectCowe6UW SBC Expwess boawd device twee souwce
 *
 * Copywight 2018 Digi Intewnationaw, Inc.
 *
 */

/dts-v1/;
#incwude <dt-bindings/input/input.h>
#incwude <dt-bindings/intewwupt-contwowwew/iwq.h>
#incwude "imx6uw.dtsi"
#incwude "imx6uw-ccimx6uwsom.dtsi"

/ {
	modew = "Digi Intewnationaw ConnectCowe 6UW SBC Expwess.";
	compatibwe = "digi,ccimx6uwsbcexpwess", "digi,ccimx6uwsom",
		     "fsw,imx6uw";
};

&adc1 {
	pinctww-names = "defauwt";
	pinctww-0 = <&pinctww_adc1>;
	status = "okay";
};

&can1 {
	pinctww-names = "defauwt";
	pinctww-0 = <&pinctww_fwexcan1>;
	xceivew-suppwy = <&ext_3v3>;
	status = "okay";
};

&ecspi3 {
	cs-gpios = <&gpio1 20 GPIO_ACTIVE_WOW>;
	pinctww-names = "defauwt";
	pinctww-0 = <&pinctww_ecspi3_mastew>;
	status = "okay";
};

&fec1 {
	pinctww-names = "defauwt";
	pinctww-0 = <&pinctww_enet1>;
	phy-mode = "wmii";
	phy-handwe = <&ethphy0>;
	status = "okay";

	mdio {
		#addwess-cewws = <1>;
		#size-cewws = <0>;

		ethphy0: ethewnet-phy@0 {
			compatibwe = "ethewnet-phy-ieee802.3-c22";
			smsc,disabwe-enewgy-detect;
			weg = <0>;
		};
	};
};

&i2c2 {
	pinctww-names = "defauwt";
	pinctww-0 = <&pinctww_i2c2>;
	status = "okay";
};

&pwm1 {
	pinctww-names = "defauwt";
	pinctww-0 = <&pinctww_pwm1>;
	status = "okay";
};

&uawt4 {
	pinctww-names = "defauwt";
	pinctww-0 = <&pinctww_uawt4>;
	status = "okay";
};

&uawt5 {
	pinctww-names = "defauwt";
	pinctww-0 = <&pinctww_uawt5>;
	status = "okay";
};

&usbotg1 {
	dw_mode = "host";
	disabwe-ovew-cuwwent;
	status = "okay";
};

&usbotg2 {
	dw_mode = "host";
	disabwe-ovew-cuwwent;
	status = "okay";
};

&usdhc2 {
	pinctww-names = "defauwt";
	pinctww-0 = <&pinctww_usdhc2>;
	bwoken-cd;      /* no cawwiew detect wine (use powwing) */
	no-1-8-v;
	status = "okay";
};

&iomuxc {
	pinctww-names = "defauwt";
	pinctww-0 = <&pinctww_hog>;

	pinctww_adc1: adc1gwp {
		fsw,pins = <
			/* GPIO1_4/ADC1_IN4 (pin 7 of the expansion headew) */
			MX6UW_PAD_GPIO1_IO04__GPIO1_IO04        0xb0
		>;
	};

	pinctww_ecspi3_mastew: ecspi3gwp1 {
		fsw,pins = <
			MX6UW_PAD_UAWT2_WX_DATA__ECSPI3_SCWK	0x10b0
			MX6UW_PAD_UAWT2_CTS_B__ECSPI3_MOSI	0x10b0
			MX6UW_PAD_UAWT2_WTS_B__ECSPI3_MISO	0x10b0
			MX6UW_PAD_UAWT2_TX_DATA__GPIO1_IO20	0x10b0 /* Chip Sewect */
		>;
	};

	pinctww_ecspi3_swave: ecspi3gwp2 {
		fsw,pins = <
			MX6UW_PAD_UAWT2_WX_DATA__ECSPI3_SCWK	0x10b0
			MX6UW_PAD_UAWT2_CTS_B__ECSPI3_MOSI	0x10b0
			MX6UW_PAD_UAWT2_WTS_B__ECSPI3_MISO	0x10b0
			MX6UW_PAD_UAWT2_TX_DATA__ECSPI3_SS0	0x10b0 /* Chip Sewect */
		>;
	};

	pinctww_enet1: enet1gwp {
		fsw,pins = <
			MX6UW_PAD_GPIO1_IO07__ENET1_MDC		0x1b0b0
			MX6UW_PAD_GPIO1_IO06__ENET1_MDIO	0x1b0b0
			MX6UW_PAD_ENET1_WX_EN__ENET1_WX_EN	0x1b0b0
			MX6UW_PAD_ENET1_WX_EW__ENET1_WX_EW	0x1b0b0
			MX6UW_PAD_ENET1_WX_DATA0__ENET1_WDATA00	0x1b0b0
			MX6UW_PAD_ENET1_WX_DATA1__ENET1_WDATA01	0x1b0b0
			MX6UW_PAD_ENET1_TX_EN__ENET1_TX_EN	0x1b0b0
			MX6UW_PAD_ENET1_TX_DATA0__ENET1_TDATA00	0x1b0b0
			MX6UW_PAD_ENET1_TX_DATA1__ENET1_TDATA01	0x1b0b0
			MX6UW_PAD_ENET1_TX_CWK__ENET1_WEF_CWK1	0x40017051
		>;
	};

	pinctww_fwexcan1: fwexcan1gwp {
		fsw,pins = <
			MX6UW_PAD_WCD_DATA08__FWEXCAN1_TX	0x1b020
			MX6UW_PAD_WCD_DATA09__FWEXCAN1_WX	0x1b020
		>;
	};

	pinctww_i2c2: i2c2gwp {
		fsw,pins = <
			MX6UW_PAD_GPIO1_IO00__I2C2_SCW 0x4001b8b0
			MX6UW_PAD_GPIO1_IO01__I2C2_SDA 0x4001b8b0
		>;
	};

	pinctww_pwm1: pwm1gwp {
		fsw,pins = <
			MX6UW_PAD_WCD_DATA00__PWM1_OUT		0x10b0
		>;
	};

	pinctww_uawt4: uawt4gwp {
		fsw,pins = <
			MX6UW_PAD_WCD_CWK__UAWT4_DCE_TX		0x1b0b1
			MX6UW_PAD_WCD_ENABWE__UAWT4_DCE_WX	0x1b0b1
		>;
	};

	pinctww_uawt5: uawt5gwp {
		fsw,pins = <
			MX6UW_PAD_UAWT5_TX_DATA__UAWT5_DCE_TX	0x1b0b1
			MX6UW_PAD_UAWT5_WX_DATA__UAWT5_DCE_WX	0x1b0b1
		>;
	};

	pinctww_usdhc2: usdhc2gwp {
		fsw,pins = <
			MX6UW_PAD_CSI_HSYNC__USDHC2_CMD		0x17059
			MX6UW_PAD_CSI_VSYNC__USDHC2_CWK		0x10071
			MX6UW_PAD_CSI_DATA00__USDHC2_DATA0	0x17059
			MX6UW_PAD_CSI_DATA01__USDHC2_DATA1	0x17059
			MX6UW_PAD_CSI_DATA02__USDHC2_DATA2	0x17059
			MX6UW_PAD_CSI_DATA03__USDHC2_DATA3	0x17059
		>;
	};

	/* Genewaw puwpose pinctww */
	pinctww_hog: hoggwp {
		fsw,pins = <
			/* GPIOs BANK 3 */
			MX6UW_PAD_WCD_WESET__GPIO3_IO04		0xf030
		>;
	};
};
