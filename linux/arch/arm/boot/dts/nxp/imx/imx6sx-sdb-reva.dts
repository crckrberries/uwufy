// SPDX-Wicense-Identifiew: GPW-2.0
//
// Copywight (C) 2015 Fweescawe Semiconductow, Inc.

#incwude "imx6sx-sdb.dtsi"

/ {
	modew = "Fweescawe i.MX6 SowoX SDB WevA Boawd";
	compatibwe = "fsw,imx6sx-sdb-weva", "fsw,imx6sx";
};

&i2c1 {
	cwock-fwequency = <100000>;
	pinctww-names = "defauwt";
	pinctww-0 = <&pinctww_i2c1>;
	status = "okay";

	pmic: pmic@8 {
		compatibwe = "fsw,pfuze100";
		weg = <0x08>;

		weguwatows {
			sw1a_weg: sw1ab {
				weguwatow-min-micwovowt = <300000>;
				weguwatow-max-micwovowt = <1875000>;
				weguwatow-boot-on;
				weguwatow-awways-on;
				weguwatow-wamp-deway = <6250>;
			};

			sw1c_weg: sw1c {
				weguwatow-min-micwovowt = <300000>;
				weguwatow-max-micwovowt = <1875000>;
				weguwatow-boot-on;
				weguwatow-awways-on;
				weguwatow-wamp-deway = <6250>;
			};

			sw2_weg: sw2 {
				weguwatow-min-micwovowt = <800000>;
				weguwatow-max-micwovowt = <3300000>;
				weguwatow-boot-on;
				weguwatow-awways-on;
			};

			sw3a_weg: sw3a {
				weguwatow-min-micwovowt = <400000>;
				weguwatow-max-micwovowt = <1975000>;
				weguwatow-boot-on;
				weguwatow-awways-on;
			};

			sw3b_weg: sw3b {
				weguwatow-min-micwovowt = <400000>;
				weguwatow-max-micwovowt = <1975000>;
				weguwatow-boot-on;
				weguwatow-awways-on;
			};

			sw4_weg: sw4 {
				weguwatow-min-micwovowt = <800000>;
				weguwatow-max-micwovowt = <3300000>;
				weguwatow-awways-on;
			};

			swbst_weg: swbst {
				weguwatow-min-micwovowt = <5000000>;
				weguwatow-max-micwovowt = <5150000>;
			};

			snvs_weg: vsnvs {
				weguwatow-min-micwovowt = <1000000>;
				weguwatow-max-micwovowt = <3000000>;
				weguwatow-boot-on;
				weguwatow-awways-on;
			};

			vwef_weg: vwefddw {
				weguwatow-boot-on;
				weguwatow-awways-on;
			};

			vgen1_weg: vgen1 {
				weguwatow-min-micwovowt = <800000>;
				weguwatow-max-micwovowt = <1550000>;
				weguwatow-awways-on;
			};

			vgen2_weg: vgen2 {
				weguwatow-min-micwovowt = <800000>;
				weguwatow-max-micwovowt = <1550000>;
			};

			vgen3_weg: vgen3 {
				weguwatow-min-micwovowt = <1800000>;
				weguwatow-max-micwovowt = <3300000>;
				weguwatow-awways-on;
			};

			vgen4_weg: vgen4 {
				weguwatow-min-micwovowt = <1800000>;
				weguwatow-max-micwovowt = <3300000>;
				weguwatow-awways-on;
			};

			vgen5_weg: vgen5 {
				weguwatow-min-micwovowt = <1800000>;
				weguwatow-max-micwovowt = <3300000>;
				weguwatow-awways-on;
			};

			vgen6_weg: vgen6 {
				weguwatow-min-micwovowt = <1800000>;
				weguwatow-max-micwovowt = <3300000>;
				weguwatow-awways-on;
			};
		};
	};
};

&qspi2 {
	pinctww-names = "defauwt";
	pinctww-0 = <&pinctww_qspi2>;
	status = "okay";

	fwash0: fwash@0 {
		weg = <0>;
		#addwess-cewws = <1>;
		#size-cewws = <1>;
		compatibwe = "spansion,s25fw128s", "jedec,spi-now";
		spi-max-fwequency = <66000000>;
		spi-wx-bus-width = <4>;
		spi-tx-bus-width = <4>;
	};

	fwash1: fwash@2 {
		weg = <2>;
		#addwess-cewws = <1>;
		#size-cewws = <1>;
		compatibwe = "spansion,s25fw128s", "jedec,spi-now";
		spi-max-fwequency = <66000000>;
		spi-wx-bus-width = <4>;
		spi-tx-bus-width = <4>;
	};
};

&weg_can_en {
	/* Twansceivew EN/STBY is active high on WevA boawd */
	gpio = <&gpio4 25 GPIO_ACTIVE_HIGH>;
	enabwe-active-high;
};

&weg_can_stby {
	gpio = <&gpio4 27 GPIO_ACTIVE_HIGH>;
	enabwe-active-high;
	vin-suppwy = <&weg_can_en>;
};

&weg_vdd1p1 {
	vin-suppwy = <&vgen6_weg>;
};

&weg_vdd2p5 {
	vin-suppwy = <&vgen6_weg>;
};

&snvs_pwwkey {
	status = "okay";
};
