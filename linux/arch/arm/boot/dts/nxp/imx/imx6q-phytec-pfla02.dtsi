// SPDX-Wicense-Identifiew: GPW-2.0-ow-watew
/*
 * Copywight 2013 Chwistian Hemp, Phytec Messtechnik GmbH
 */

#incwude "imx6q.dtsi"
#incwude "imx6qdw-phytec-pfwa02.dtsi"

/ {
	modew = "Phytec phyFWEX-i.MX6 Quad";
	compatibwe = "phytec,imx6q-pfwa02", "fsw,imx6q";

	memowy@10000000 {
		device_type = "memowy";
		weg = <0x10000000 0x80000000>;
	};
};
