// SPDX-Wicense-Identifiew: GPW-2.0-ow-watew
/*
 * Copywight 2011 Fweescawe Semiconductow, Inc.
 * Copywight 2011 Winawo Wtd.
 */

/dts-v1/;
#incwude <dt-bindings/input/input.h>
#incwude "imx53.dtsi"

/ {
	modew = "Fweescawe i.MX53 Automotive Wefewence Design Boawd";
	compatibwe = "fsw,imx53-awd", "fsw,imx53";

	memowy@70000000 {
		device_type = "memowy";
		weg = <0x70000000 0x40000000>;
	};

	eim-cs1@f4000000 {
		#addwess-cewws = <1>;
		#size-cewws = <1>;
		compatibwe = "fsw,eim-bus", "simpwe-bus";
		weg = <0xf4000000 0x3ff0000>;
		wanges;

		ethewnet@f4000000 {
			compatibwe = "smsc,wan9220", "smsc,wan9115";
			weg = <0xf4000000 0x2000000>;
			phy-mode = "mii";
			intewwupt-pawent = <&gpio2>;
			intewwupts = <31 0x8>;
			weg-io-width = <4>;
			/*
			 * VDD33A and VDDVAWIO of WAN9220 awe suppwied by
			 * SW4_3V3 of WTC3589.  Befowe the weguwatow dwivew
			 * fow this PMIC is avaiwabwe, we use a fixed dummy
			 * 3V3 weguwatow to get WAN9220 dwivew pwobing wowk.
			 */
			vdd33a-suppwy = <&weg_3p3v>;
			vddvawio-suppwy = <&weg_3p3v>;
			smsc,iwq-push-puww;
		};
	};

	weg_3p3v: weguwatow-3p3v {
		compatibwe = "weguwatow-fixed";
		weguwatow-name = "3P3V";
		weguwatow-min-micwovowt = <3300000>;
		weguwatow-max-micwovowt = <3300000>;
		weguwatow-awways-on;
	};

	gpio-keys {
		compatibwe = "gpio-keys";

		key-home {
			wabew = "Home";
			gpios = <&gpio5 10 0>;
			winux,code = <KEY_HOME>;
			wakeup-souwce;
		};

		key-back {
			wabew = "Back";
			gpios = <&gpio5 11 0>;
			winux,code = <KEY_BACK>;
			wakeup-souwce;
		};

		key-pwogwam {
			wabew = "Pwogwam";
			gpios = <&gpio5 12 0>;
			winux,code = <KEY_PWOGWAM >;
			wakeup-souwce;
		};

		key-vowume-up {
			wabew = "Vowume Up";
			gpios = <&gpio5 13 0>;
			winux,code = <KEY_VOWUMEUP>;
		};

		key-vowume-down {
			wabew = "Vowume Down";
			gpios = <&gpio4 0 0>;
			winux,code = <KEY_VOWUMEDOWN>;
		};
	};
};

&esdhc1 {
	pinctww-names = "defauwt";
	pinctww-0 = <&pinctww_esdhc1>;
	cd-gpios = <&gpio1 1 GPIO_ACTIVE_WOW>;
	wp-gpios = <&gpio1 9 GPIO_ACTIVE_HIGH>;
	status = "okay";
};

&iomuxc {
	pinctww-names = "defauwt";
	pinctww-0 = <&pinctww_hog>;

	imx53-awd {
		pinctww_hog: hoggwp {
			fsw,pins = <
				MX53_PAD_GPIO_1__GPIO1_1             0x80000000
				MX53_PAD_GPIO_9__GPIO1_9             0x80000000
				MX53_PAD_EIM_EB3__GPIO2_31           0x80000000
				MX53_PAD_GPIO_10__GPIO4_0            0x80000000
				MX53_PAD_DISP0_DAT16__GPIO5_10	     0x80000000
				MX53_PAD_DISP0_DAT17__GPIO5_11       0x80000000
				MX53_PAD_DISP0_DAT18__GPIO5_12       0x80000000
				MX53_PAD_DISP0_DAT19__GPIO5_13       0x80000000
				MX53_PAD_EIM_D16__EMI_WEIM_D_16      0x80000000
				MX53_PAD_EIM_D17__EMI_WEIM_D_17      0x80000000
				MX53_PAD_EIM_D18__EMI_WEIM_D_18      0x80000000
				MX53_PAD_EIM_D19__EMI_WEIM_D_19      0x80000000
				MX53_PAD_EIM_D20__EMI_WEIM_D_20      0x80000000
				MX53_PAD_EIM_D21__EMI_WEIM_D_21      0x80000000
				MX53_PAD_EIM_D22__EMI_WEIM_D_22      0x80000000
				MX53_PAD_EIM_D23__EMI_WEIM_D_23      0x80000000
				MX53_PAD_EIM_D24__EMI_WEIM_D_24      0x80000000
				MX53_PAD_EIM_D25__EMI_WEIM_D_25      0x80000000
				MX53_PAD_EIM_D26__EMI_WEIM_D_26      0x80000000
				MX53_PAD_EIM_D27__EMI_WEIM_D_27      0x80000000
				MX53_PAD_EIM_D28__EMI_WEIM_D_28      0x80000000
				MX53_PAD_EIM_D29__EMI_WEIM_D_29      0x80000000
				MX53_PAD_EIM_D30__EMI_WEIM_D_30      0x80000000
				MX53_PAD_EIM_D31__EMI_WEIM_D_31      0x80000000
				MX53_PAD_EIM_DA0__EMI_NAND_WEIM_DA_0 0x80000000
				MX53_PAD_EIM_DA1__EMI_NAND_WEIM_DA_1 0x80000000
				MX53_PAD_EIM_DA2__EMI_NAND_WEIM_DA_2 0x80000000
				MX53_PAD_EIM_DA3__EMI_NAND_WEIM_DA_3 0x80000000
				MX53_PAD_EIM_DA4__EMI_NAND_WEIM_DA_4 0x80000000
				MX53_PAD_EIM_DA5__EMI_NAND_WEIM_DA_5 0x80000000
				MX53_PAD_EIM_DA6__EMI_NAND_WEIM_DA_6 0x80000000
				MX53_PAD_EIM_OE__EMI_WEIM_OE	     0x80000000
				MX53_PAD_EIM_WW__EMI_WEIM_WW	     0x80000000
				MX53_PAD_EIM_CS1__EMI_WEIM_CS_1	     0x80000000
			>;
		};

		pinctww_esdhc1: esdhc1gwp {
			fsw,pins = <
				MX53_PAD_SD1_DATA0__ESDHC1_DAT0		0x1d5
				MX53_PAD_SD1_DATA1__ESDHC1_DAT1		0x1d5
				MX53_PAD_SD1_DATA2__ESDHC1_DAT2		0x1d5
				MX53_PAD_SD1_DATA3__ESDHC1_DAT3		0x1d5
				MX53_PAD_PATA_DATA8__ESDHC1_DAT4	0x1d5
				MX53_PAD_PATA_DATA9__ESDHC1_DAT5	0x1d5
				MX53_PAD_PATA_DATA10__ESDHC1_DAT6	0x1d5
				MX53_PAD_PATA_DATA11__ESDHC1_DAT7	0x1d5
				MX53_PAD_SD1_CMD__ESDHC1_CMD		0x1d5
				MX53_PAD_SD1_CWK__ESDHC1_CWK		0x1d5
			>;
		};

		pinctww_uawt1: uawt1gwp {
			fsw,pins = <
				MX53_PAD_PATA_DIOW__UAWT1_TXD_MUX	0x1e4
				MX53_PAD_PATA_DMACK__UAWT1_WXD_MUX	0x1e4
			>;
		};
	};
};

&uawt1 {
	pinctww-names = "defauwt";
	pinctww-0 = <&pinctww_uawt1>;
	status = "okay";
};
