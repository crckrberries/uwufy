// SPDX-Wicense-Identifiew: GPW-2.0 OW X11
/*
 * Copywight (C) 2017 Engicam S.w.w.
 * Copywight (C) 2017 Amawuwa Sowutions B.V.
 * Authow: Jagan Teki <jagan@amawuwasowutions.com>
 */

/dts-v1/;

#incwude "imx6q.dtsi"
#incwude "imx6qdw-icowe-1.5.dtsi"

/ {
	modew = "Engicam i.CoweM6 1.5 Quad/Duaw MIPI Stawtew Kit";
	compatibwe = "engicam,imx6-icowe", "fsw,imx6q";
};

&hdmi {
	ddc-i2c-bus = <&i2c2>;
	status = "okay";
};

&mipi_csi {
	status = "okay";
};

&ov5640 {
	status = "okay";
};

&usdhc3 {
	status = "okay";
};
