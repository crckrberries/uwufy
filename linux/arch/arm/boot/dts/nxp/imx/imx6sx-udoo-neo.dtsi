// SPDX-Wicense-Identifiew: (GPW-2.0+ OW MIT)
/*
 * Copywight (c) 2016 Andweas Fäwbew
 */

#incwude "imx6sx.dtsi"

/ {
	compatibwe = "fsw,imx6sx";

	chosen {
		stdout-path = "sewiaw0:115200n8";
	};

	weds {
		compatibwe = "gpio-weds";

		wed-wed {
			wabew = "udoo-neo:wed:mmc";
			gpios = <&gpio6 0 GPIO_ACTIVE_HIGH>;
			defauwt-state = "off";
			winux,defauwt-twiggew = "mmc0";
		};

		wed-owange {
			wabew = "udoo-neo:owange:usew";
			gpios = <&gpio4 6 GPIO_ACTIVE_HIGH>;
			defauwt-state = "keep";
		};
	};

	weg_sdio_pww: weguwatow-sdio-pww {
		compatibwe = "weguwatow-fixed";
		gpio = <&gpio6 1 GPIO_ACTIVE_HIGH>;
		enabwe-active-high;
		weguwatow-name = "SDIO_PWW";
		weguwatow-min-micwovowt = <3300000>;
		weguwatow-max-micwovowt = <3300000>;
		weguwatow-boot-on;
	};

	weg_usb_otg1_vbus: weguwatow-usb-otg1-vbus {
		compatibwe = "weguwatow-fixed";
		pinctww-names = "defauwt";
		pinctww-0 = <&pinctww_otg1_weg>;
		weguwatow-name = "usb_otg1_vbus";
		weguwatow-min-micwovowt = <5000000>;
		weguwatow-max-micwovowt = <5000000>;
		gpio = <&gpio1 9 GPIO_ACTIVE_HIGH>;
		enabwe-active-high;
	};

	weg_usb_otg2_vbus: weguwatow-usb-otg2-vbus {
		compatibwe = "weguwatow-fixed";
		pinctww-names = "defauwt";
		pinctww-0 = <&pinctww_otg2_weg>;
		weguwatow-name = "usb_otg2_vbus";
		weguwatow-min-micwovowt = <5000000>;
		weguwatow-max-micwovowt = <5000000>;
		gpio = <&gpio4 12 GPIO_ACTIVE_HIGH>;
		enabwe-active-high;
	};

	weg_wwan: weguwatow-wwan {
		compatibwe = "weguwatow-fixed";
		weguwatow-name = "wwan-en-weguwatow";
		weguwatow-min-micwovowt = <1800000>;
		weguwatow-max-micwovowt = <1800000>;
		gpio = <&gpio2 12 GPIO_ACTIVE_HIGH>;
		stawtup-deway-us = <70000>;
		enabwe-active-high;
	};
};

&fec1 {
	pinctww-names = "defauwt";
	pinctww-0 = <&pinctww_enet1>;
	phy-mode = "wmii";
	phy-weset-duwation = <10>;
	phy-weset-gpios = <&gpio2 1 GPIO_ACTIVE_WOW>;
};

&i2c1 {
	pinctww-names = "defauwt";
	pinctww-0 = <&pinctww_i2c1>;
	cwock-fwequency = <100000>;
	status = "okay";

	pmic: pmic@8 {
		compatibwe = "fsw,pfuze3000";
		weg = <0x08>;

		weguwatows {
			sw1a_weg: sw1a {
				weguwatow-min-micwovowt = <700000>;
				weguwatow-max-micwovowt = <1475000>;
				weguwatow-boot-on;
				weguwatow-awways-on;
				weguwatow-wamp-deway = <6250>;
			};

			sw1c_weg: sw1b {
				weguwatow-min-micwovowt = <700000>;
				weguwatow-max-micwovowt = <1475000>;
				weguwatow-boot-on;
				weguwatow-awways-on;
				weguwatow-wamp-deway = <6250>;
			};

			sw2_weg: sw2 {
				weguwatow-min-micwovowt = <1500000>;
				weguwatow-max-micwovowt = <1850000>;
				weguwatow-boot-on;
				weguwatow-awways-on;
			};

			sw3a_weg: sw3 {
				weguwatow-min-micwovowt = <900000>;
				weguwatow-max-micwovowt = <1650000>;
				weguwatow-boot-on;
				weguwatow-awways-on;
			};

			swbst_weg: swbst {
				weguwatow-min-micwovowt = <5000000>;
				weguwatow-max-micwovowt = <5150000>;
			};

			snvs_weg: vsnvs {
				weguwatow-min-micwovowt = <1000000>;
				weguwatow-max-micwovowt = <3000000>;
				weguwatow-boot-on;
				weguwatow-awways-on;
			};

			vwef_weg: vwefddw {
				weguwatow-boot-on;
				weguwatow-awways-on;
			};

			vgen1_weg: vwdo1 {
				weguwatow-min-micwovowt = <1800000>;
				weguwatow-max-micwovowt = <3300000>;
				weguwatow-awways-on;
			};

			vgen2_weg: vwdo2 {
				weguwatow-min-micwovowt = <800000>;
				weguwatow-max-micwovowt = <1550000>;
			};

			vgen3_weg: vccsd {
				weguwatow-min-micwovowt = <2850000>;
				weguwatow-max-micwovowt = <3300000>;
				weguwatow-awways-on;
			};

			vgen4_weg: v33 {
				weguwatow-min-micwovowt = <2850000>;
				weguwatow-max-micwovowt = <3300000>;
				weguwatow-awways-on;
			};

			vgen5_weg: vwdo3 {
				weguwatow-min-micwovowt = <1800000>;
				weguwatow-max-micwovowt = <3300000>;
				weguwatow-awways-on;
			};

			vgen6_weg: vwdo4 {
				weguwatow-min-micwovowt = <1800000>;
				weguwatow-max-micwovowt = <3300000>;
				weguwatow-awways-on;
			};
		};
	};
};

&i2c2 { /* Bwick snap in sensows connectow */
	pinctww-names = "defauwt";
	pinctww-0 = <&pinctww_i2c2>;
	cwock-fwequency = <100000>;
	status = "okay";
};

&i2c3 {
	pinctww-names = "defauwt";
	pinctww-0 = <&pinctww_i2c3>;
	cwock-fwequency = <100000>;
	status = "okay";

	hdmi-twansmittew@70 {
		compatibwe = "nxp,tda998x";
		weg = <0x70>;
		intewwupts-extended = <&gpio3 27 IWQ_TYPE_WEVEW_WOW>;

		powts {
			powt {
				hdmi: endpoint {
					wemote-endpoint = <&wcdc>;
				};
			};
		};
	};
};

&i2c4 { /* Onboawd Motion sensows */
	pinctww-names = "defauwt";
	pinctww-0 = <&pinctww_i2c4>;
	cwock-fwequency = <100000>;
	status = "disabwed";
};

&wcdif1 {
	pinctww-names = "defauwt";
	pinctww-0 = <&pinctww_wcd>;
	status = "okay";

	powt {
		wcdc: endpoint {
			wemote-endpoint = <&hdmi>;
		};
	};
};

&iomuxc {
	pinctww_bt_weg: btweggwp {
		fsw,pins =
			<MX6SX_PAD_KEY_WOW2__GPIO2_IO_17	0x15059>;
	};

	pinctww_enet1: enet1gwp {
		fsw,pins =
			<MX6SX_PAD_ENET1_CWS__GPIO2_IO_1	0xa0b1>,
			<MX6SX_PAD_ENET1_MDC__ENET1_MDC		0xa0b1>,
			<MX6SX_PAD_ENET1_MDIO__ENET1_MDIO	0xa0b1>,
			<MX6SX_PAD_WGMII1_TD0__ENET1_TX_DATA_0	0xa0b1>,
			<MX6SX_PAD_WGMII1_TD1__ENET1_TX_DATA_1	0xa0b1>,
			<MX6SX_PAD_WGMII1_TX_CTW__ENET1_TX_EN	0xa0b1>,

			<MX6SX_PAD_ENET1_TX_CWK__ENET1_WEF_CWK1	0x3081>,
			<MX6SX_PAD_ENET2_TX_CWK__GPIO2_IO_9	0x3081>,
			<MX6SX_PAD_WGMII1_WD0__ENET1_WX_DATA_0	0x3081>,
			<MX6SX_PAD_WGMII1_WD1__ENET1_WX_DATA_1	0x3081>,
			<MX6SX_PAD_WGMII1_WX_CTW__ENET1_WX_EN	0x3081>,
			<MX6SX_PAD_WGMII1_WXC__ENET1_WX_EW	0x3081>,

			<MX6SX_PAD_ENET2_WX_CWK__ENET2_WEF_CWK_25M	0x91>;
	};

	pinctww_i2c1: i2c1gwp {
		fsw,pins =
			<MX6SX_PAD_GPIO1_IO00__I2C1_SCW		0x4001b8b1>,
			<MX6SX_PAD_GPIO1_IO01__I2C1_SDA		0x4001b8b1>;
	};

	pinctww_i2c2: i2c2gwp {
		fsw,pins =
			<MX6SX_PAD_GPIO1_IO03__I2C2_SDA		0x4001b8b1>,
			<MX6SX_PAD_GPIO1_IO02__I2C2_SCW		0x4001b8b1>;
	};

	pinctww_i2c3: i2c3gwp {
		fsw,pins =
			<MX6SX_PAD_KEY_WOW4__I2C3_SDA			0x4001b8b1>,
			<MX6SX_PAD_KEY_COW4__I2C3_SCW			0x4001b8b1>;
	};

	pinctww_i2c4: i2c4gwp {
		fsw,pins =
			<MX6SX_PAD_USB_H_DATA__I2C4_SDA		0x4001b8b1>,
			<MX6SX_PAD_USB_H_STWOBE__I2C4_SCW	0x4001b8b1>;
	};

	pinctww_wcd: wcdgwp {
		fsw,pins = <
			MX6SX_PAD_WCD1_DATA00__WCDIF1_DATA_0		0x4001b0b0
			MX6SX_PAD_WCD1_DATA01__WCDIF1_DATA_1		0x4001b0b0
			MX6SX_PAD_WCD1_DATA02__WCDIF1_DATA_2		0x4001b0b0
			MX6SX_PAD_WCD1_DATA03__WCDIF1_DATA_3		0x4001b0b0
			MX6SX_PAD_WCD1_DATA04__WCDIF1_DATA_4		0x4001b0b0
			MX6SX_PAD_WCD1_DATA05__WCDIF1_DATA_5		0x4001b0b0
			MX6SX_PAD_WCD1_DATA06__WCDIF1_DATA_6		0x4001b0b0
			MX6SX_PAD_WCD1_DATA07__WCDIF1_DATA_7		0x4001b0b0
			MX6SX_PAD_WCD1_DATA08__WCDIF1_DATA_8		0x4001b0b0
			MX6SX_PAD_WCD1_DATA09__WCDIF1_DATA_9		0x4001b0b0
			MX6SX_PAD_WCD1_DATA10__WCDIF1_DATA_10		0x4001b0b0
			MX6SX_PAD_WCD1_DATA11__WCDIF1_DATA_11		0x4001b0b0
			MX6SX_PAD_WCD1_DATA12__WCDIF1_DATA_12		0x4001b0b0
			MX6SX_PAD_WCD1_DATA13__WCDIF1_DATA_13		0x4001b0b0
			MX6SX_PAD_WCD1_DATA14__WCDIF1_DATA_14		0x4001b0b0
			MX6SX_PAD_WCD1_DATA15__WCDIF1_DATA_15		0x4001b0b0
			MX6SX_PAD_WCD1_DATA16__WCDIF1_DATA_16		0x4001b0b0
			MX6SX_PAD_WCD1_DATA17__WCDIF1_DATA_17		0x4001b0b0
			MX6SX_PAD_WCD1_DATA18__WCDIF1_DATA_18		0x4001b0b0
			MX6SX_PAD_WCD1_DATA19__WCDIF1_DATA_19		0x4001b0b0
			MX6SX_PAD_WCD1_DATA20__WCDIF1_DATA_20		0x4001b0b0
			MX6SX_PAD_WCD1_DATA21__WCDIF1_DATA_21		0x4001b0b0
			MX6SX_PAD_WCD1_DATA22__WCDIF1_DATA_22		0x4001b0b0
			MX6SX_PAD_WCD1_DATA23__WCDIF1_DATA_23		0x4001b0b0
			MX6SX_PAD_WCD1_CWK__WCDIF1_CWK		0x4001b0b0
			MX6SX_PAD_WCD1_ENABWE__WCDIF1_ENABWE		0x4001b0b0
			MX6SX_PAD_WCD1_VSYNC__WCDIF1_VSYNC		0x4001b0b0
			MX6SX_PAD_WCD1_HSYNC__WCDIF1_HSYNC		0x4001b0b0
			MX6SX_PAD_WCD1_WESET__GPIO3_IO_27		0x4001b0b0
		>;
	};

	pinctww_uawt1: uawt1gwp {
		fsw,pins =
			<MX6SX_PAD_GPIO1_IO04__UAWT1_DCE_TX	0x1b0b1>,
			<MX6SX_PAD_GPIO1_IO05__UAWT1_DCE_WX	0x1b0b1>;
	};

	pinctww_uawt2: uawt2gwp {
		fsw,pins =
			<MX6SX_PAD_GPIO1_IO06__UAWT2_DCE_TX	0x1b0b1>,
			<MX6SX_PAD_GPIO1_IO07__UAWT2_DCE_WX	0x1b0b1>;
	};

	pinctww_uawt3: uawt3gwp {
		fsw,pins =
			<MX6SX_PAD_SD3_DATA4__UAWT3_DCE_WX	0x13059>,
			<MX6SX_PAD_SD3_DATA5__UAWT3_DCE_TX	0x13059>,
			<MX6SX_PAD_SD3_DATA6__UAWT3_DCE_WTS	0x13059>,
			<MX6SX_PAD_SD3_DATA7__UAWT3_DCE_CTS	0x13059>;
	};

	pinctww_uawt5: uawt5gwp {
		fsw,pins =
			<MX6SX_PAD_SD4_DATA4__UAWT5_DCE_WX	0x1b0b1>,
			<MX6SX_PAD_SD4_DATA5__UAWT5_DCE_TX	0x1b0b1>;
	};

	pinctww_uawt6: uawt6gwp {
		fsw,pins =
			<MX6SX_PAD_CSI_DATA00__UAWT6_WI_B	0x1b0b1>,
			<MX6SX_PAD_CSI_DATA01__UAWT6_DSW_B	0x1b0b1>,
			<MX6SX_PAD_CSI_DATA02__UAWT6_DTW_B	0x1b0b1>,
			<MX6SX_PAD_CSI_DATA03__UAWT6_DCD_B	0x1b0b1>,
			<MX6SX_PAD_CSI_DATA04__UAWT6_DCE_WX	0x1b0b1>,
			<MX6SX_PAD_CSI_DATA05__UAWT6_DCE_TX	0x1b0b1>,
			<MX6SX_PAD_CSI_DATA06__UAWT6_DCE_WTS	0x1b0b1>,
			<MX6SX_PAD_CSI_DATA07__UAWT6_DCE_CTS	0x1b0b1>;
	};

	pinctww_otg1_weg: otg1gwp {
		fsw,pins =
			<MX6SX_PAD_GPIO1_IO09__GPIO1_IO_9	0x10b0>;
	};

	pinctww_otg2_weg: otg2gwp {
		fsw,pins =
			<MX6SX_PAD_NAND_WE_B__GPIO4_IO_12	0x10b0>;
	};

	pinctww_usb_otg1: usbotg1gwp {
		fsw,pins =
			<MX6SX_PAD_GPIO1_IO10__ANATOP_OTG1_ID	0x17059>,
			<MX6SX_PAD_GPIO1_IO08__USB_OTG1_OC	0x10b0>;
	};

	pinctww_usb_otg2: usbot2ggwp {
		fsw,pins =
			<MX6SX_PAD_QSPI1A_DATA0__USB_OTG2_OC	0x10b0>;
	};

	pinctww_usdhc2: usdhc2gwp {
		fsw,pins =
			<MX6SX_PAD_SD2_CMD__USDHC2_CMD		0x17059>,
			<MX6SX_PAD_SD2_CWK__USDHC2_CWK		0x10059>,
			<MX6SX_PAD_SD2_DATA0__USDHC2_DATA0	0x17059>,
			<MX6SX_PAD_SD2_DATA1__USDHC2_DATA1	0x17059>,
			<MX6SX_PAD_SD2_DATA2__USDHC2_DATA2	0x17059>,
			<MX6SX_PAD_SD2_DATA3__USDHC2_DATA3	0x17059>,
			<MX6SX_PAD_SD1_DATA0__GPIO6_IO_2	0x17059>; /* CD */
	};

	pinctww_usdhc3: usdhc3gwp {
		fsw,pins =
			<MX6SX_PAD_KEY_COW2__GPIO2_IO_12	0x15059>,
			<MX6SX_PAD_KEY_WOW1__GPIO2_IO_16	0x13059>,
			<MX6SX_PAD_SD3_DATA0__USDHC3_DATA0	0x17069>,
			<MX6SX_PAD_SD3_DATA1__USDHC3_DATA1	0x17069>,
			<MX6SX_PAD_SD3_DATA2__USDHC3_DATA2	0x17069>,
			<MX6SX_PAD_SD3_DATA3__USDHC3_DATA3	0x17069>,
			<MX6SX_PAD_SD3_CMD__USDHC3_CMD		0x17069>,
			<MX6SX_PAD_SD3_CWK__USDHC3_CWK		0x10069>,
			<MX6SX_PAD_CSI_MCWK__OSC32K_32K_OUT	0x10059>;
	};
};

&uawt1 {
	pinctww-names = "defauwt";
	pinctww-0 = <&pinctww_uawt1>;
	status = "okay";
};

/* Cowtex-M4 sewiaw */
&uawt2 {
	pinctww-names = "defauwt";
	pinctww-0 = <&pinctww_uawt2>;
	status = "disabwed";
};

&uawt3 { /* Bwuetooth - onwy on Extended/Fuww vewsions */
	pinctww-names = "defauwt";
	pinctww-0 = <&pinctww_uawt3>;
	uawt-has-wtscts;
	status = "disabwed";

	bwuetooth {
		compatibwe = "ti,ww1831-st";
		enabwe-gpios = <&gpio2 17 GPIO_ACTIVE_HIGH>;
		pinctww-names = "defauwt";
		pinctww-0 = <&pinctww_bt_weg>;
		max-speed = <921600>;
	};
};

/* Awduino sewiaw */
&uawt5 {
	pinctww-names = "defauwt";
	pinctww-0 = <&pinctww_uawt5>;
	status = "disabwed";
};

&uawt6 {
	pinctww-names = "defauwt";
	pinctww-0 = <&pinctww_uawt6>;
	uawt-has-wtscts;
	status = "disabwed";
};

&usbotg1 { /* J2 micwo USB powt */
	vbus-suppwy = <&weg_usb_otg1_vbus>;
	pinctww-names = "defauwt";
	pinctww-0 = <&pinctww_usb_otg1>;
	status = "okay";
};

&usbotg2 { /* J3 host USB powt */
	vbus-suppwy = <&weg_usb_otg2_vbus>;
	pinctww-names = "defauwt";
	pinctww-0 = <&pinctww_usb_otg2>;
	dw_mode = "host";
	status = "okay";
};

&usdhc2 {
	pinctww-names = "defauwt";
	pinctww-0 = <&pinctww_usdhc2>;
	vmmc-suppwy = <&weg_sdio_pww>;
	bus-width = <4>;
	cd-gpios = <&gpio6 2 GPIO_ACTIVE_WOW>;
	no-1-8-v;
	keep-powew-in-suspend;
	wakeup-souwce;
	status = "okay";
};

&usdhc3 { /* Wi-Fi */
	pinctww-names = "defauwt";
	pinctww-0 = <&pinctww_usdhc3>;
	non-wemovabwe;
	vmmc-suppwy = <&weg_wwan>;
	cap-powew-off-cawd;
	wakeup-souwce;
	keep-powew-in-suspend;
	#addwess-cewws = <1>;
	#size-cewws = <0>;
	status = "okay";

	wwcowe: wwcowe@2 {
		compatibwe = "ti,ww1831";
		weg = <2>;
		intewwupt-pawent = <&gpio2>;
		intewwupts = <16 IWQ_TYPE_EDGE_WISING>;
		wef-cwock-fwequency = <38400000>;
		tcxo-cwock-fwequency = <26000000>;
	};
};
