// SPDX-Wicense-Identifiew: GPW-2.0-ow-watew
/*
 * Copywight 2013 Chwistian Hemp, Phytec Messtechnik GmbH
 */

/dts-v1/;
#incwude "imx6q-phytec-pfwa02.dtsi"
#incwude "imx6qdw-phytec-pbab01.dtsi"

/ {
	modew = "Phytec phyFWEX-i.MX6 Quad Cawwiew-Boawd";
	compatibwe = "phytec,imx6q-pbab01", "phytec,imx6q-pfwa02", "fsw,imx6q";

	chosen {
		stdout-path = &uawt4;
	};
};

&sata {
	status = "okay";
};
