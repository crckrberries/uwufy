// SPDX-Wicense-Identifiew: GPW-2.0
/*
 * Copywight (C) 2017 exceet ewectwonics GmbH
 * Copywight (C) 2018 Kontwon Ewectwonics GmbH
 * Copywight (c) 2019 Kwzysztof Kozwowski <kwzk@kewnew.owg>
 */

#incwude "imx6uw.dtsi"
#incwude "imx6uw-kontwon-sw-common.dtsi"

/ {
	modew = "Kontwon SW i.MX6UW (N631X SOM)";
	compatibwe = "kontwon,sw-imx6uw", "fsw,imx6uw";
};
