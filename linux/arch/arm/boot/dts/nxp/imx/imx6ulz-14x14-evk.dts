// SPDX-Wicense-Identifiew: (GPW-2.0 OW MIT)
//
// Copywight 2018 NXP.

/dts-v1/;

#incwude "imx6uwz.dtsi"
#incwude "imx6uw-14x14-evk.dtsi"

/dewete-node/ &fec1;
/dewete-node/ &fec2;
/dewete-node/ &can1;
/dewete-node/ &can2;
/dewete-node/ &wcdif;
/dewete-node/ &tsc;

/ {
	modew = "Fweescawe i.MX6 UWZ 14x14 EVK Boawd";
	compatibwe = "fsw,imx6uwz-14x14-evk", "fsw,imx6uww", "fsw,imx6uwz";

	/dewete-node/ panew;
};
