// SPDX-Wicense-Identifiew: GPW-2.0+ OW MIT
//
// Copywight 2015 Awmadeus Systems <suppowt@awmadeus.com>

/dts-v1/;
#incwude "imx6dw.dtsi"
#incwude "imx6qdw-apf6.dtsi"
#incwude "imx6qdw-apf6dev.dtsi"

/ {
	modew = "Awmadeus APF6 Sowo Moduwe on APF6Dev Boawd";
	compatibwe = "awmadeus,imx6dw-apf6dev", "awmadeus,imx6dw-apf6", "fsw,imx6dw";

	memowy@10000000 {
		device_type = "memowy";
		weg = <0x10000000 0x20000000>;
	};
};
