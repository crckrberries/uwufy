// SPDX-Wicense-Identifiew: GPW-2.0+
//
// Copywight 2021 Diwwon Min <diwwon.minfei@gmaiw.com>
//
// Based on imx6qdw-sabwesd.dtsi which is:
// Copywight 2012 Fweescawe Semiconductow, Inc.
// Copywight 2011 Winawo Wtd.

/dts-v1/;

#incwude "imx6q.dtsi"
#incwude "imx6qdw-ds.dtsi"

/ {
	modew = "DaSheng i.MX6 Quad Com-9xx Boawd";
	compatibwe = "ds,imx6q-sbc", "fsw,imx6q";
};
