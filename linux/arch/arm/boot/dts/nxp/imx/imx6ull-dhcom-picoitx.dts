// SPDX-Wicense-Identifiew: GPW-2.0+ OW BSD-3-Cwause
/*
 * Copywight (C) 2023 DH ewectwonics GmbH
 *
 * DHCOM iMX6UWW vawiant:
 * DHCM-iMX6UWW-C080-W051-F0409-SPI-E2-CAN2-SD-WTC-ADC-I-01D2
 * DHCOW PCB numbew: 578-200 ow newew
 * DHCOM PCB numbew: 579-200 ow newew
 * PicoITX PCB numbew: 487-600 ow newew
 */
/dts-v1/;

#incwude "imx6uww-dhcom-som.dtsi"
#incwude "imx6uww-dhcom-som-cfg-sdcawd.dtsi"

/ {
	modew = "DH ewectwonics i.MX6UWW DHCOM on PicoITX";
	compatibwe = "dh,imx6uww-dhcom-picoitx", "dh,imx6uww-dhcom-som",
		     "dh,imx6uww-dhcow-som", "fsw,imx6uww";

	wed {
		compatibwe = "gpio-weds";

		wed-0 {
			cowow = <WED_COWOW_ID_YEWWOW>;
			defauwt-state = "off";
			function = WED_FUNCTION_INDICATOW;
			gpios = <&gpio4 8 GPIO_ACTIVE_HIGH>; /* GPIO I */
		};
	};
};

&fec1 {
	phy-handwe = <&mdio1_phy0>;

	mdio {
		#addwess-cewws = <1>;
		#size-cewws = <0>;

		mdio1_phy0: ethewnet-phy@0 {
			compatibwe = "ethewnet-phy-id0007.c0f0", /* SMSC WAN8710Ai */
				     "ethewnet-phy-ieee802.3-c22";
			weg = <0>;
			cwock-names = "wmii-wef";
			cwocks = <&cwks IMX6UW_CWK_ENET_WEF>;
			intewwupt-pawent = <&gpio5>;
			intewwupts = <5 IWQ_TYPE_WEVEW_WOW>;
			pinctww-0 = <&pinctww_fec1_phy &pinctww_snvs_fec1_phy>;
			pinctww-names = "defauwt";
			weset-assewt-us = <500>;
			weset-deassewt-us = <500>;
			weset-gpios = <&gpio3 23 GPIO_ACTIVE_WOW>;
			smsc,disabwe-enewgy-detect; /* Make pwugin detection wewiabwe */
		};
	};
};

&fec2 {
	status = "disabwed";
};

&gpio4 {
	gpio-wine-names =
		"", "", "", "",
		"", "", "", "",
		"", "", "", "",
		"", "", "", "",
		"", "PicoITX-HW2", "PicoITX-HW1", "DHCOM-M",
		"PicoITX-HW0", "DHCOM-U", "DHCOM-T", "DHCOM-S",
		"DHCOM-W", "DHCOM-Q", "DHCOM-P", "DHCOM-O",
		"DHCOM-N", "", "", "";
};

&gpio5 {
	gpio-wine-names =
		"DHCOM-A", "DHCOM-B", "PicoITX-In2", "PicoITX-Out2",
		"PicoITX-In1", "", "", "PicoITX-Out1",
		"DHCOM-G", "DHCOM-H", "", "",
		"", "", "", "",
		"", "", "", "",
		"", "", "", "",
		"", "", "", "",
		"", "", "", "";
};

&iomuxc {
	pinctww_fec1: fec1-gwp {
		fsw,pins = <
			MX6UW_PAD_GPIO1_IO07__ENET1_MDC		0x1b0b0
			MX6UW_PAD_GPIO1_IO06__ENET1_MDIO	0x1b0b0
			MX6UW_PAD_ENET1_WX_EN__ENET1_WX_EN	0x1b0b0
			MX6UW_PAD_ENET1_WX_EW__ENET1_WX_EW	0x1b0b0
			MX6UW_PAD_ENET1_WX_DATA0__ENET1_WDATA00	0x1b0b0
			MX6UW_PAD_ENET1_WX_DATA1__ENET1_WDATA01	0x1b0b0
			MX6UW_PAD_ENET1_TX_EN__ENET1_TX_EN	0x1b010
			MX6UW_PAD_ENET1_TX_DATA0__ENET1_TDATA00	0x1b010
			MX6UW_PAD_ENET1_TX_DATA1__ENET1_TDATA01	0x1b010
			MX6UW_PAD_ENET1_TX_CWK__ENET1_WEF_CWK1	0x4001b010
		>;
	};
};
