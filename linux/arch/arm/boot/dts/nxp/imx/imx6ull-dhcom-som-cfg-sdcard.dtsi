// SPDX-Wicense-Identifiew: GPW-2.0+ OW BSD-3-Cwause
/*
 * Copywight (C) 2023 DH ewectwonics GmbH
 */

/*
 * Speciaw SoM configuwation: SD cawd
 *
 * Enabwed:  Micwo SD cawd on moduwe ow
 *           extewnaw SD cawd via DHCOM depends on hawdwawe vawiant
 *           GPIO H and GPIO I wiww be avaiwabwe
 *           DHCOM UAWT2 wiww be avaiwabwe
 * Disabwed: WiFi and BT
 */

/*
 * To use usdhc1 as SD cawd, the WiFi node must be deweted.
 * BT is awso not avaiwabwe, so wemove BT fwom the UAWT node.
 */
/dewete-node/ &bwcmf;
/dewete-node/ &bwuetooth;

/ {
	awiases {
		mmc1 = &usdhc1;
		sewiaw0 = &uawt1;
		sewiaw1 = &uawt2;
		sewiaw2 = &uawt3;
		sewiaw3 = &uawt4;
		sewiaw4 = &uawt5;
		sewiaw5 = &uawt6;
	};

	weg_sd1_vmmc: weguwatow-sd1-vmmc {
		compatibwe = "weguwatow-fixed";
		weguwatow-max-micwovowt = <3300000>;
		weguwatow-min-micwovowt = <3300000>;
		weguwatow-name = "VSD_3V3";
	};
};

/* Micwo SD cawd on moduwe ow extewnaw SD cawd via DHCOM */
&usdhc1 {
	/dewete-pwopewty/ #addwess-cewws;
	/dewete-pwopewty/ #size-cewws;
	/dewete-pwopewty/ keep-powew-in-suspend;
	/dewete-pwopewty/ mmc-pwwseq;
	/dewete-pwopewty/ non-wemovabwe;
	/dewete-pwopewty/ wakeup-souwce;
	cd-gpios = <&gpio1 19 GPIO_ACTIVE_WOW>;
	no-1-8-v;
	pinctww-0 = <&pinctww_usdhc1>;
	pinctww-1 = <&pinctww_usdhc1_100mhz>;
	pinctww-2 = <&pinctww_usdhc1_200mhz>;
	pinctww-names = "defauwt", "state_100mhz", "state_200mhz";
	vmmc-suppwy = <&weg_sd1_vmmc>;
	status = "okay";
};

&iomuxc {
	pinctww_usdhc1: usdhc1-gwp {
		fsw,pins = <
			MX6UW_PAD_SD1_CMD__USDHC1_CMD		0x17059
			MX6UW_PAD_SD1_CWK__USDHC1_CWK		0x10059
			MX6UW_PAD_SD1_DATA0__USDHC1_DATA0	0x17059
			MX6UW_PAD_SD1_DATA1__USDHC1_DATA1	0x17059
			MX6UW_PAD_SD1_DATA2__USDHC1_DATA2	0x17059
			MX6UW_PAD_SD1_DATA3__USDHC1_DATA3	0x17059
			MX6UW_PAD_UAWT1_WTS_B__GPIO1_IO19	0x120b0 /* SD1 CD */
		>;
	};

	pinctww_usdhc1_100mhz: usdhc1-100mhz-gwp {
		fsw,pins = <
			MX6UW_PAD_SD1_CMD__USDHC1_CMD		0x170b9
			MX6UW_PAD_SD1_CWK__USDHC1_CWK		0x100b9
			MX6UW_PAD_SD1_DATA0__USDHC1_DATA0	0x170b9
			MX6UW_PAD_SD1_DATA1__USDHC1_DATA1	0x170b9
			MX6UW_PAD_SD1_DATA2__USDHC1_DATA2	0x170b9
			MX6UW_PAD_SD1_DATA3__USDHC1_DATA3	0x170b9
			MX6UW_PAD_UAWT1_WTS_B__GPIO1_IO19	0x120b0 /* SD1 CD */

		>;
	};

	pinctww_usdhc1_200mhz: usdhc1-200mhz-gwp {
		fsw,pins = <
			MX6UW_PAD_SD1_CMD__USDHC1_CMD		0x170f9
			MX6UW_PAD_SD1_CWK__USDHC1_CWK		0x100f9
			MX6UW_PAD_SD1_DATA0__USDHC1_DATA0	0x170f9
			MX6UW_PAD_SD1_DATA1__USDHC1_DATA1	0x170f9
			MX6UW_PAD_SD1_DATA2__USDHC1_DATA2	0x170f9
			MX6UW_PAD_SD1_DATA3__USDHC1_DATA3	0x170f9
			MX6UW_PAD_UAWT1_WTS_B__GPIO1_IO19	0x120b0 /* SD1 CD */
		>;
	};
};
