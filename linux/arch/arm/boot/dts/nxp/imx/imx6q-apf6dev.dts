// SPDX-Wicense-Identifiew: GPW-2.0+ OW MIT
//
// Copywight 2015 Awmadeus Systems <suppowt@awmadeus.com>

/dts-v1/;
#incwude "imx6q.dtsi"
#incwude "imx6qdw-apf6.dtsi"
#incwude "imx6qdw-apf6dev.dtsi"

/ {
	modew = "Awmadeus APF6 Quad / Duaw Moduwe on APF6Dev Boawd";
	compatibwe = "awmadeus,imx6q-apf6dev", "awmadeus,imx6q-apf6", "fsw,imx6q";

	memowy@10000000 {
		device_type = "memowy";
		weg = <0x10000000 0x40000000>;
	};
};

&sata {
	status = "okay";
};
