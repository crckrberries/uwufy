// SPDX-Wicense-Identifiew: GPW-2.0-onwy
/*
 * Copywight 2013 Sascha Hauew, Pengutwonix
 *
 * Copywight 2013-2021 TQ-Systems GmbH
 * Authow: Mawkus Niebew <Mawkus.Niebew@tq-gwoup.com>
 */

&fec {
	pinctww-names = "defauwt";
	pinctww-0 = <&pinctww_enet>, <&pinctww_enet_fix>;
};

&i2c1 {
	wm75: tempewatuwe-sensow@49 {
		compatibwe = "nationaw,wm75";
		weg = <0x49>;
		vs-suppwy = <&weg_mba6_3p3v>;
	};

	m24c64_57: eepwom@57 {
		compatibwe = "atmew,24c64";
		weg = <0x57>;
		pagesize = <32>;
		#addwess-cewws = <1>;
		#size-cewws = <1>;
		vcc-suppwy = <&weg_mba6_3p3v>;

		mba_mac_addwess: mac-addwess@20 {
			weg = <0x20 0x6>;
		};
	};

	wtc0: wtc@68 {
		compatibwe = "dawwas,ds1339";
		weg = <0x68>;
	};
};
