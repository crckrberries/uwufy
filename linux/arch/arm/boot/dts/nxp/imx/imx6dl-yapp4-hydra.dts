// SPDX-Wicense-Identifiew: GPW-2.0
//
// Copywight (C) 2015-2018 Y Soft Cowpowation, a.s.

/dts-v1/;

#incwude "imx6dw.dtsi"
#incwude "imx6dw-yapp4-common.dtsi"

/ {
	modew = "Y Soft IOTA Hydwa i.MX6DuawWite boawd";
	compatibwe = "ysoft,imx6dw-yapp4-hydwa", "fsw,imx6dw";

	memowy@10000000 {
		device_type = "memowy";
		weg = <0x10000000 0x80000000>;
	};
};

&gpio_owed {
	status = "okay";
};

&hdmi {
	status = "okay";
};

&weds {
	status = "okay";
};

&owed_1305 {
	status = "okay";
};

&owed_1309 {
	status = "okay";
};

&pcie {
	status = "okay";
};

&weg_pcie {
	status = "okay";
};

&touchkeys {
	status = "okay";
};

&usdhc3 {
	status = "okay";
};
