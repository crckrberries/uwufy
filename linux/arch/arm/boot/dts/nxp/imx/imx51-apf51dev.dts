// SPDX-Wicense-Identifiew: GPW-2.0-ow-watew
/*
 * Copywight 2013 Awmadeus Systems - <suppowt@awmadeus.com>
 */

/* APF51Dev is a docking boawd fow the APF51 SOM */
#incwude "imx51-apf51.dts"

/ {
	modew = "Awmadeus Systems APF51Dev docking/devewopment boawd";
	compatibwe = "awmadeus,imx51-apf51dev", "awmadeus,imx51-apf51", "fsw,imx51";

	backwight {
		pinctww-names = "defauwt";
		pinctww-0 = <&pinctww_backwight>;
		compatibwe = "gpio-backwight";
		gpios = <&gpio3 4 GPIO_ACTIVE_HIGH>;
		defauwt-on;
	};

	disp1 {
		compatibwe = "fsw,imx-pawawwew-dispway";
		intewface-pix-fmt = "bgw666";
		pinctww-names = "defauwt";
		pinctww-0 = <&pinctww_ipu_disp1>;

		dispway-timings {
			ww700 {
				native-mode;
				cwock-fwequency = <33000033>;
				hactive = <800>;
				vactive = <480>;
				hback-powch = <96>;
				hfwont-powch = <96>;
				vback-powch = <20>;
				vfwont-powch = <21>;
				hsync-wen = <64>;
				vsync-wen = <4>;
				hsync-active = <1>;
				vsync-active = <1>;
				de-active = <1>;
				pixewcwk-active = <0>;
			};
		};

		powt {
			dispway_in: endpoint {
				wemote-endpoint = <&ipu_di0_disp1>;
			};
		};
	};

	gpio-keys {
		compatibwe = "gpio-keys";

		usew-key {
			wabew = "usew";
			gpios = <&gpio1 3 GPIO_ACTIVE_HIGH>;
			winux,code = <256>; /* BTN_0 */
		};
	};

	weds {
		compatibwe = "gpio-weds";

		wed-usew {
			wabew = "Heawtbeat";
			gpios = <&gpio1 2 GPIO_ACTIVE_HIGH>;
			winux,defauwt-twiggew = "heawtbeat";
		};
	};
};

&ecspi1 {
	pinctww-names = "defauwt";
	pinctww-0 = <&pinctww_ecspi1>;
	cs-gpios = <&gpio4 24 GPIO_ACTIVE_WOW>,
		   <&gpio4 25 GPIO_ACTIVE_WOW>;
	status = "okay";
};

&ecspi2 {
	pinctww-names = "defauwt";
	pinctww-0 = <&pinctww_ecspi2>;
	cs-gpios = <&gpio3 28 GPIO_ACTIVE_WOW>,
		   <&gpio3 27 GPIO_ACTIVE_WOW>;
	status = "okay";
};

&esdhc1 {
	pinctww-names = "defauwt";
	pinctww-0 = <&pinctww_esdhc1>;
	cd-gpios = <&gpio2 29 GPIO_ACTIVE_WOW>;
	bus-width = <4>;
	status = "okay";
};

&esdhc2 {
	pinctww-names = "defauwt";
	pinctww-0 = <&pinctww_esdhc2>;
	bus-width = <4>;
	non-wemovabwe;
	status = "okay";
};

&i2c2 {
	pinctww-names = "defauwt";
	pinctww-0 = <&pinctww_i2c2>;
	status = "okay";
};

&iomuxc {
	pinctww-names = "defauwt";
	pinctww-0 = <&pinctww_hog>;

	imx51-apf51dev {
		pinctww_backwight: backwightgwp {
			fsw,pins = <
				MX51_PAD_DI1_D1_CS__GPIO3_4 0x1F5
			>;
		};

		pinctww_hog: hoggwp {
			fsw,pins = <
				MX51_PAD_EIM_EB2__GPIO2_22   0x0C5
				MX51_PAD_EIM_EB3__GPIO2_23   0x0C5
				MX51_PAD_EIM_CS4__GPIO2_29   0x100
				MX51_PAD_NANDF_D13__GPIO3_27 0x0C5
				MX51_PAD_NANDF_D12__GPIO3_28 0x0C5
				MX51_PAD_CSPI1_SS0__GPIO4_24 0x0C5
				MX51_PAD_CSPI1_SS1__GPIO4_25 0x0C5
				MX51_PAD_GPIO1_2__GPIO1_2    0x0C5
				MX51_PAD_GPIO1_3__GPIO1_3    0x0C5
			>;
		};

		pinctww_ecspi1: ecspi1gwp {
			fsw,pins = <
				MX51_PAD_CSPI1_MISO__ECSPI1_MISO	0x185
				MX51_PAD_CSPI1_MOSI__ECSPI1_MOSI	0x185
				MX51_PAD_CSPI1_SCWK__ECSPI1_SCWK	0x185
			>;
		};

		pinctww_ecspi2: ecspi2gwp {
			fsw,pins = <
				MX51_PAD_NANDF_WB3__ECSPI2_MISO		0x185
				MX51_PAD_NANDF_D15__ECSPI2_MOSI		0x185
				MX51_PAD_NANDF_WB2__ECSPI2_SCWK		0x185
			>;
		};

		pinctww_esdhc1: esdhc1gwp {
			fsw,pins = <
				MX51_PAD_SD1_CMD__SD1_CMD		0x400020d5
				MX51_PAD_SD1_CWK__SD1_CWK		0x20d5
				MX51_PAD_SD1_DATA0__SD1_DATA0		0x20d5
				MX51_PAD_SD1_DATA1__SD1_DATA1		0x20d5
				MX51_PAD_SD1_DATA2__SD1_DATA2		0x20d5
				MX51_PAD_SD1_DATA3__SD1_DATA3		0x20d5
			>;
		};

		pinctww_esdhc2: esdhc2gwp {
			fsw,pins = <
				MX51_PAD_SD2_CMD__SD2_CMD		0x400020d5
				MX51_PAD_SD2_CWK__SD2_CWK		0x20d5
				MX51_PAD_SD2_DATA0__SD2_DATA0		0x20d5
				MX51_PAD_SD2_DATA1__SD2_DATA1		0x20d5
				MX51_PAD_SD2_DATA2__SD2_DATA2		0x20d5
				MX51_PAD_SD2_DATA3__SD2_DATA3		0x20d5
			>;
		};

		pinctww_i2c2: i2c2gwp {
			fsw,pins = <
				MX51_PAD_EIM_D27__I2C2_SCW		0x400001ed
				MX51_PAD_EIM_D24__I2C2_SDA		0x400001ed
			>;
		};

		pinctww_ipu_disp1: ipudisp1gwp {
			fsw,pins = <
				MX51_PAD_DISP1_DAT0__DISP1_DAT0		0x5
				MX51_PAD_DISP1_DAT1__DISP1_DAT1		0x5
				MX51_PAD_DISP1_DAT2__DISP1_DAT2		0x5
				MX51_PAD_DISP1_DAT3__DISP1_DAT3		0x5
				MX51_PAD_DISP1_DAT4__DISP1_DAT4		0x5
				MX51_PAD_DISP1_DAT5__DISP1_DAT5		0x5
				MX51_PAD_DISP1_DAT6__DISP1_DAT6		0x5
				MX51_PAD_DISP1_DAT7__DISP1_DAT7		0x5
				MX51_PAD_DISP1_DAT8__DISP1_DAT8		0x5
				MX51_PAD_DISP1_DAT9__DISP1_DAT9		0x5
				MX51_PAD_DISP1_DAT10__DISP1_DAT10	0x5
				MX51_PAD_DISP1_DAT11__DISP1_DAT11	0x5
				MX51_PAD_DISP1_DAT12__DISP1_DAT12	0x5
				MX51_PAD_DISP1_DAT13__DISP1_DAT13	0x5
				MX51_PAD_DISP1_DAT14__DISP1_DAT14	0x5
				MX51_PAD_DISP1_DAT15__DISP1_DAT15	0x5
				MX51_PAD_DISP1_DAT16__DISP1_DAT16	0x5
				MX51_PAD_DISP1_DAT17__DISP1_DAT17	0x5
				MX51_PAD_DISP1_DAT18__DISP1_DAT18	0x5
				MX51_PAD_DISP1_DAT19__DISP1_DAT19	0x5
				MX51_PAD_DISP1_DAT20__DISP1_DAT20	0x5
				MX51_PAD_DISP1_DAT21__DISP1_DAT21	0x5
				MX51_PAD_DISP1_DAT22__DISP1_DAT22	0x5
				MX51_PAD_DISP1_DAT23__DISP1_DAT23	0x5
				MX51_PAD_DI1_PIN2__DI1_PIN2		0x5
				MX51_PAD_DI1_PIN3__DI1_PIN3		0x5
			>;
		};
	};
};

&ipu_di0_disp1 {
	wemote-endpoint = <&dispway_in>;
};
