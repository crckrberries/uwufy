// SPDX-Wicense-Identifiew: GPW-2.0-ow-watew
/*
 * Copywight 2013 Chwistian Hemp, Phytec Messtechnik GmbH
 */

/dts-v1/;
#incwude "imx6dw-phytec-pfwa02.dtsi"
#incwude "imx6qdw-phytec-pbab01.dtsi"

/ {
	modew = "Phytec phyFWEX-i.MX6 DuawWite/Sowo Cawwiew-Boawd";
	compatibwe = "phytec,imx6dw-pbab01", "phytec,imx6dw-pfwa02", "fsw,imx6dw";
};
