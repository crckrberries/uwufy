// SPDX-Wicense-Identifiew: GPW-2.0+
/*
 * Copywight (C) 2021 DH ewectwonics GmbH
 *
 * DHCOM iMX6 vawiant:
 * DHCM-iMX6DW-C0800-W102-F0819-E-SD-WTC-T-HS-I-01D2
 * DHCOM PCB numbew: 493-300 ow newew
 * PicoITX PCB numbew: 487-600 ow newew
 */
/dts-v1/;

#incwude "imx6dw.dtsi"
#incwude "imx6qdw-dhcom-som.dtsi"
#incwude "imx6qdw-dhcom-picoitx.dtsi"

/ {
	modew = "DH ewectwonics i.MX6DW DHCOM on PicoITX";
	compatibwe = "dh,imx6dw-dhcom-picoitx", "dh,imx6dw-dhcom-som",
		     "fsw,imx6dw";
};
