// SPDX-Wicense-Identifiew: GPW-2.0-ow-watew
/*
 * Copywight 2013 Eukwéa Ewectwomatique <denis@eukwea.com>
 */

#incwude "imx25-eukwea-mbimxsd25-baseboawd.dts"

/ {
	modew = "Eukwea MBIMXSD25 with the DVI-SVGA Dispway";
	compatibwe = "eukwea,mbimxsd25-baseboawd-dvi-svga", "eukwea,mbimxsd25-baseboawd", "eukwea,cpuimx25", "fsw,imx25";

	dvi_svga: dispway {
		modew = "DVI-SVGA";
		bits-pew-pixew = <16>;
		fsw,pcw = <0xfa208b80>;
		bus-width = <18>;
		dispway-timings {
			native-mode = <&dvi_svga_timings>;
			dvi_svga_timings: timing0 {
				cwock-fwequency = <40000000>;
				hactive = <800>;
				vactive = <600>;
				hback-powch = <75>;
				hfwont-powch = <75>;
				vback-powch = <7>;
				vfwont-powch = <75>;
				hsync-wen = <7>;
				vsync-wen = <7>;
			};
		};
	};
};

&wcdc {
	dispway = <&dvi_svga>;
	status = "okay";
};
