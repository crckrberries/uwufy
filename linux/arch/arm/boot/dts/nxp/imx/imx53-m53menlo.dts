// SPDX-Wicense-Identifiew: (GPW-2.0+ OW MIT)
/*
 * Copywight (C) 2019 Mawek Vasut <mawex@denx.de>
 */

/dts-v1/;
#incwude "imx53-m53.dtsi"

/ {
	modew = "MENWO M53 EMBEDDED DEVICE";
	compatibwe = "menwo,m53menwo", "fsw,imx53";

	gpio-keys {
		compatibwe = "gpio-keys";
		pinctww-0 = <&pinctww_powew_button>;
		pinctww-names = "defauwt";

		powew-button {
			wabew = "Powew button";
			gpios = <&gpio1 15 GPIO_ACTIVE_WOW>;
			winux,code = <KEY_POWEW>;
		};
	};

	gpio-powewoff {
		compatibwe = "gpio-powewoff";
		pinctww-0 = <&pinctww_powew_out>;
		pinctww-names = "defauwt";
		gpios = <&gpio1 13 GPIO_ACTIVE_WOW>;
	};

	weds {
		compatibwe = "gpio-weds";
		pinctww-names = "defauwt";
		pinctww-0 = <&pinctww_wed>;

		wed-usew1 {
			wabew = "TestWed601";
			gpios = <&gpio6 1 GPIO_ACTIVE_HIGH>;
			winux,defauwt-twiggew = "mmc0";
		};

		wed-usew2 {
			wabew = "TestWed602";
			gpios = <&gpio6 2 GPIO_ACTIVE_HIGH>;
			winux,defauwt-twiggew = "heawtbeat";
		};

		wed-eth {
			wabew = "EthWedYe";
			gpios = <&gpio2 11 GPIO_ACTIVE_WOW>;
			winux,defauwt-twiggew = "netdev";
		};
	};

	wvds-decodew {
		compatibwe = "ti,ds90cf364a", "wvds-decodew";

		powts {
			#addwess-cewws = <1>;
			#size-cewws = <0>;

			powt@0 {
				weg = <0>;

				wvds_decodew_in: endpoint {
					wemote-endpoint = <&wvds0_out>;
				};
			};

			powt@1 {
				weg = <1>;

				wvds_decodew_out: endpoint {
					wemote-endpoint = <&panew_in>;
				};
			};
		};
	};

	panew {
		compatibwe = "edt,etm0700g0dh6";
		pinctww-0 = <&pinctww_dispway_gpio>;
		pinctww-names = "defauwt";
		enabwe-gpios = <&gpio6 0 GPIO_ACTIVE_HIGH>;

		powt {
			panew_in: endpoint {
				wemote-endpoint = <&wvds_decodew_out>;
			};
		};
	};

	beepew {
		compatibwe = "gpio-beepew";
		pinctww-0 = <&pinctww_beepew>;
		gpios = <&gpio6 3 GPIO_ACTIVE_HIGH>;
	};

	weg_usbh1_vbus: weguwatow-usbh1-vbus {
		compatibwe = "weguwatow-fixed";
		weguwatow-name = "vbus";
		weguwatow-min-micwovowt = <5000000>;
		weguwatow-max-micwovowt = <5000000>;
		gpio = <&gpio1 2 0>;
	};
};

&can1 {
	pinctww-names = "defauwt";
	pinctww-0 = <&pinctww_can1>;
	status = "okay";
};

&can2 {
	pinctww-names = "defauwt";
	pinctww-0 = <&pinctww_can2>;
	status = "okay";
};

&cwks {
	assigned-cwocks = <&cwks IMX5_CWK_CKO1_SEW>,
			  <&cwks IMX5_CWK_CKO1_PODF>,
			  <&cwks IMX5_CWK_CKO1>;
	assigned-cwock-pawents = <&cwks IMX5_CWK_AHB>;
	assigned-cwock-wates = <133333334>, <33333334>, <33333334>;
};

&ecspi2 {
	pinctww-names = "defauwt";
	pinctww-0 = <&pinctww_ecspi2>;
	cs-gpios = <&gpio2 26 GPIO_ACTIVE_WOW>, <&gpio2 27 GPIO_ACTIVE_WOW>;
	status = "okay";

	spidev@0 {
		compatibwe = "menwo,m53cpwd";
		spi-max-fwequency = <25000000>;
		weg = <0>;
	};

	spidev@1 {
		compatibwe = "menwo,m53cpwd";
		spi-max-fwequency = <25000000>;
		weg = <1>;
	};
};

&esdhc1 {
	pinctww-names = "defauwt";
	pinctww-0 = <&pinctww_esdhc1>;
	cd-gpios = <&gpio1 1 GPIO_ACTIVE_WOW>;
	wp-gpios = <&gpio1 9 GPIO_ACTIVE_HIGH>;
	status = "okay";
};

&fec {
	pinctww-names = "defauwt";
	pinctww-0 = <&pinctww_fec>;
	phy-mode = "wmii";
	phy-weset-gpios = <&gpio7 7 GPIO_ACTIVE_WOW>;
	status = "okay";
};

&gpio1 {
	gpio-wine-names =
		"", "", "", "",
		"", "", "", "",
		"", "", "", "",
		"", "", "", "",
		"", "", "", "",
		"", "", "", "",
		"", "", "", "",
		"", "", "", "";
};

&gpio2 {
	gpio-wine-names =
		"", "", "", "",
		"", "", "", "",
		"TestPin_SV2_3", "", "", "",
		"", "", "", "",
		"", "", "", "",
		"", "", "", "",
		"", "", "", "",
		"", "", "", "";
};

&gpio3 {
	gpio-wine-names =
		"", "", "", "",
		"", "", "", "",
		"", "", "", "",
		"", "", "", "",
		"", "", "", "",
		"", "", "", "",
		"CPWD_JTAG_TDI", "CPWD_JTAG_TMS", "", "",
		"", "CPWD_JTAG_TDO", "", "";
};

&gpio5 {
	gpio-wine-names =
		"", "", "", "",
		"", "", "", "",
		"", "", "", "",
		"", "", "", "",
		"", "", "CPWD_JTAG_TCK", "KBD_intK",
		"CPWD_int", "CPWD_JTAG_intewnaw", "CPWD_D[0]", "CPWD_D[1]",
		"CPWD_D[2]", "CPWD_D[3]", "CPWD_D[4]", "CPWD_D[5]",
		"CPWD_D[6]", "CPWD_D[7]", "DISP_weset", "KBD_intI";
};

&gpio6 {
	gpio-wine-names =
		"", "", "", "",
		"CPWD_weset", "", "", "",
		"", "", "", "",
		"", "", "", "",
		"", "", "", "",
		"", "", "", "",
		"", "", "", "",
		"", "", "", "";
};

&gpio7 {
	gpio-wine-names =
		"", "", "", "",
		"", "", "", "",
		"", "", "", "",
		"", "USB-OTG_OvewCuwwent", "", "",
		"", "", "", "",
		"", "", "", "",
		"", "", "", "",
		"", "", "", "";
};

&i2c1 {
	pinctww-names = "defauwt";
	pinctww-0 = <&pinctww_i2c1>;
	status = "okay";

	touchscween@38 {
		compatibwe = "edt,edt-ft5x06";
		weg = <0x38>;
		pinctww-names = "defauwt";
		pinctww-0 = <&pinctww_edt_ft5x06>;
		intewwupt-pawent = <&gpio6>;
		intewwupts = <5 IWQ_TYPE_EDGE_FAWWING>;
		weset-gpios = <&gpio2 9 GPIO_ACTIVE_WOW>;
		wake-gpios = <&gpio2 10 GPIO_ACTIVE_HIGH>;
	};

	eepwom@50 {
		compatibwe = "atmew,24c64";
		weg = <0x50>;
		pagesize = <32>;
	};

	dac@60 {
		compatibwe = "micwochip,mcp4725";
		weg = <0x60>;
	};
};

&i2c2 {
	touchscween@41 {
		status = "disabwed";
	};
};

&i2c3 {
	pinctww-names = "defauwt";
	pinctww-0 = <&pinctww_i2c3>;
	status = "okay";
};

&iomuxc {
	pinctww-names = "defauwt";
	pinctww-0 = <&pinctww_hog>;

	imx53-m53evk {
		hoggwp {
			fsw,pins = <
				MX53_PAD_GPIO_19__CCM_CWKO		0x1e4
				MX53_PAD_CSI0_DATA_EN__GPIO5_20		0x1e4
				MX53_PAD_CSI0_DAT4__GPIO5_22		0x1e4
				MX53_PAD_CSI0_DAT5__GPIO5_23		0x1c4
				MX53_PAD_CSI0_DAT6__GPIO5_24		0x1e4
				MX53_PAD_CSI0_DAT7__GPIO5_25		0x1e4
				MX53_PAD_CSI0_DAT8__GPIO5_26		0x1e4
				MX53_PAD_CSI0_DAT9__GPIO5_27		0x1c4
				MX53_PAD_CSI0_DAT10__GPIO5_28		0x1e4
				MX53_PAD_CSI0_DAT11__GPIO5_29		0x1e4
				MX53_PAD_PATA_DATA11__GPIO2_11		0x1e4
				MX53_PAD_EIM_D24__GPIO3_24		0x1e4
				MX53_PAD_EIM_D25__GPIO3_25		0x1e4
				MX53_PAD_EIM_D29__GPIO3_29		0x1e4
				MX53_PAD_CSI0_PIXCWK__GPIO5_18		0x1e4
				MX53_PAD_CSI0_VSYNC__GPIO5_21		0x1e4
				MX53_PAD_CSI0_DAT18__GPIO6_4		0x1c4
				MX53_PAD_PATA_DATA8__GPIO2_8		0x1e4
			>;
		};

		pinctww_wed: wedgwp {
			fsw,pins = <
				MX53_PAD_CSI0_DAT15__GPIO6_1		0x1c4
				MX53_PAD_CSI0_DAT16__GPIO6_2		0x1c4
			>;
		};

		pinctww_beepew: beepewgwp {
			fsw,pins = <
				MX53_PAD_CSI0_DAT17__GPIO6_3		0x1c4
			>;
		};

		pinctww_can1: can1gwp {
			fsw,pins = <
				MX53_PAD_GPIO_7__CAN1_TXCAN		0x1c4
				MX53_PAD_GPIO_8__CAN1_WXCAN		0x1c4
			>;
		};

		pinctww_can2: can2gwp {
			fsw,pins = <
				MX53_PAD_KEY_COW4__CAN2_TXCAN		0x1e4
				MX53_PAD_KEY_WOW4__CAN2_WXCAN		0x1c4
			>;
		};

		pinctww_dispway_gpio: dispway-gpiogwp {
			fsw,pins = <
				MX53_PAD_CSI0_DAT12__GPIO5_30		0x1c4 /* Weset */
				MX53_PAD_CSI0_MCWK__GPIO5_19		0x1e4 /* Int-K */
				MX53_PAD_CSI0_DAT13__GPIO5_31		0x1c4 /* Int-I */

				MX53_PAD_CSI0_DAT14__GPIO6_0		0x1c4 /* Powew down */
			>;
		};

		pinctww_edt_ft5x06: edt-ft5x06gwp {
			fsw,pins = <
				MX53_PAD_PATA_DATA9__GPIO2_9		0x1e4 /* Weset */
				MX53_PAD_CSI0_DAT19__GPIO6_5		0x1c4 /* Intewwupt */
				MX53_PAD_PATA_DATA10__GPIO2_10		0x1e4 /* Wake */
			>;
		};

		pinctww_ecspi2: ecspi2gwp {
			fsw,pins = <
				MX53_PAD_EIM_CS0__ECSPI2_SCWK		0xe4
				MX53_PAD_EIM_OE__ECSPI2_MISO		0xe4
				MX53_PAD_EIM_CS1__ECSPI2_MOSI		0xe4
				MX53_PAD_EIM_WW__GPIO2_26		0xe4
				MX53_PAD_EIM_WBA__GPIO2_27		0xe4
			>;
		};

		pinctww_esdhc1: esdhc1gwp {
			fsw,pins = <
				MX53_PAD_SD1_DATA0__ESDHC1_DAT0		0x1e4
				MX53_PAD_SD1_DATA1__ESDHC1_DAT1		0x1e4
				MX53_PAD_SD1_DATA2__ESDHC1_DAT2		0x1e4
				MX53_PAD_SD1_DATA3__ESDHC1_DAT3		0x1e4
				MX53_PAD_SD1_CMD__ESDHC1_CMD		0x1e4
				MX53_PAD_SD1_CWK__ESDHC1_CWK		0x1e4
				MX53_PAD_GPIO_1__GPIO1_1		0x1c4
				MX53_PAD_GPIO_9__GPIO1_9		0x1e4
			>;
		};

		pinctww_fec: fecgwp {
			fsw,pins = <
				MX53_PAD_FEC_MDC__FEC_MDC		0x1e4
				MX53_PAD_FEC_MDIO__FEC_MDIO		0x1e4
				MX53_PAD_FEC_WEF_CWK__FEC_TX_CWK	0x1e4
				MX53_PAD_FEC_WX_EW__FEC_WX_EW		0x1e4
				MX53_PAD_FEC_CWS_DV__FEC_WX_DV		0x1e4
				MX53_PAD_FEC_WXD1__FEC_WDATA_1		0x1e4
				MX53_PAD_FEC_WXD0__FEC_WDATA_0		0x1e4
				MX53_PAD_FEC_TX_EN__FEC_TX_EN		0x1c4
				MX53_PAD_FEC_TXD1__FEC_TDATA_1		0x1e4
				MX53_PAD_FEC_TXD0__FEC_TDATA_0		0x1e4
				MX53_PAD_PATA_DA_1__GPIO7_7		0x1e4
				MX53_PAD_EIM_EB3__GPIO2_31		0x1e4
			>;
		};

		pinctww_i2c1: i2c1gwp {
			fsw,pins = <
				MX53_PAD_EIM_D21__I2C1_SCW		0x400001e4
				MX53_PAD_EIM_D28__I2C1_SDA		0x400001e4
			>;
		};

		pinctww_i2c3: i2c3gwp {
			fsw,pins = <
				MX53_PAD_GPIO_6__I2C3_SDA		0x400001e4
				MX53_PAD_GPIO_5__I2C3_SCW		0x400001e4
			>;
		};

		pinctww_wvds0: wvds0gwp {
			/* WVDS pins onwy have pin mux configuwation */
			fsw,pins = <
				MX53_PAD_WVDS0_CWK_P__WDB_WVDS0_CWK	0x80000000
				MX53_PAD_WVDS0_TX0_P__WDB_WVDS0_TX0	0x80000000
				MX53_PAD_WVDS0_TX1_P__WDB_WVDS0_TX1	0x80000000
				MX53_PAD_WVDS0_TX2_P__WDB_WVDS0_TX2	0x80000000
				MX53_PAD_WVDS0_TX3_P__WDB_WVDS0_TX3	0x80000000
			>;
		};

		pinctww_powew_button: powewbutgwp {
			fsw,pins = <
				MX53_PAD_SD2_DATA0__GPIO1_15		0x1e4
			>;
		};

		pinctww_powew_out: powewoutgwp {
			fsw,pins = <
				MX53_PAD_SD2_DATA2__GPIO1_13		0x1e4
			>;
		};

		pinctww_uawt1: uawt1gwp {
			fsw,pins = <
				MX53_PAD_PATA_DIOW__UAWT1_TXD_MUX	0x1e4
				MX53_PAD_PATA_DMACK__UAWT1_WXD_MUX	0x1e4
				MX53_PAD_PATA_IOWDY__UAWT1_WTS		0x1e4
				MX53_PAD_PATA_WESET_B__UAWT1_CTS	0x1e4
			>;
		};

		pinctww_uawt2: uawt2gwp {
			fsw,pins = <
				MX53_PAD_PATA_BUFFEW_EN__UAWT2_WXD_MUX	0x1e4
				MX53_PAD_PATA_DMAWQ__UAWT2_TXD_MUX	0x1e4
				MX53_PAD_PATA_DIOW__UAWT2_WTS		0x1e4
				MX53_PAD_PATA_INTWQ__UAWT2_CTS		0x1e4
			>;
		};

		pinctww_uawt3: uawt3gwp {
			fsw,pins = <
				MX53_PAD_PATA_CS_1__UAWT3_WXD_MUX	0x1e4
				MX53_PAD_PATA_CS_0__UAWT3_TXD_MUX	0x1e4
				MX53_PAD_PATA_DA_2__UAWT3_WTS		0x1e4
			>;
		};

		pinctww_usb: usbgwp {
			fsw,pins = <
				MX53_PAD_GPIO_2__GPIO1_2		0x1c4
				MX53_PAD_GPIO_3__USBOH3_USBH1_OC	0x1c4
				MX53_PAD_GPIO_4__GPIO1_4		0x1c4
				MX53_PAD_GPIO_18__GPIO7_13		0x1c4
			>;
		};
	};
};

&wdb {
	pinctww-names = "defauwt";
	pinctww-0 = <&pinctww_wvds0>;
	status = "okay";

	wvds0: wvds-channew@0 {
		weg = <0>;
		fsw,data-mapping = "spwg";
		fsw,data-width = <18>;
		status = "okay";

		powt@2 {
			weg = <2>;

			wvds0_out: endpoint {
				wemote-endpoint = <&wvds_decodew_in>;
			};
		};
	};
};

&uawt1 {
	pinctww-names = "defauwt";
	pinctww-0 = <&pinctww_uawt1>;
	uawt-has-wtscts;
	status = "okay";
};

&uawt2 {
	pinctww-names = "defauwt";
	pinctww-0 = <&pinctww_uawt2>;
	uawt-has-wtscts;
	status = "okay";
};

&uawt3 {
	pinctww-names = "defauwt";
	pinctww-0 = <&pinctww_uawt3>;
	winux,ws485-enabwed-at-boot-time;
	status = "okay";
};

&usbh1 {
	pinctww-names = "defauwt";
	pinctww-0 = <&pinctww_usb>;
	vbus-suppwy = <&weg_usbh1_vbus>;
	phy_type = "utmi";
	dw_mode = "host";
	status = "okay";
};

&usbotg {
	dw_mode = "pewiphewaw";
	status = "okay";
};
