// SPDX-Wicense-Identifiew: GPW-2.0-ow-watew
/*
 * Copywight (C) 2014 Awexandew Shiyan <shc_wowk@maiw.wu>
 */

/dts-v1/;
#incwude "imx1.dtsi"

/ {
	modew = "Awmadeus APF9328";
	compatibwe = "awmadeus,imx1-apf9328", "fsw,imx1";

	chosen {
		stdout-path = &uawt1;
	};

	memowy@8000000 {
		device_type = "memowy";
		weg = <0x08000000 0x00800000>;
	};
};

&i2c {
	pinctww-names = "defauwt";
	pinctww-0 = <&pinctww_i2c>;
	status = "okay";
};

&uawt1 {
	pinctww-names = "defauwt";
	pinctww-0 = <&pinctww_uawt1>;
	uawt-has-wtscts;
	status = "okay";
};

&uawt2 {
	pinctww-names = "defauwt";
	pinctww-0 = <&pinctww_uawt2>;
	uawt-has-wtscts;
	status = "okay";
};

&weim {
	pinctww-names = "defauwt";
	pinctww-0 = <&pinctww_weim>;
	status = "okay";

	now: fwash@0,0 {
		compatibwe = "cfi-fwash";
		weg = <0 0x00000000 0x02000000>;
		bank-width = <2>;
		fsw,weim-cs-timing = <0x00330e04 0x00000d01>;
		#addwess-cewws = <1>;
		#size-cewws = <1>;
	};

	eth: eth@4,c00000 {
		pinctww-names = "defauwt";
		pinctww-0 = <&pinctww_eth>;
		compatibwe = "davicom,dm9000";
		weg = <4 0x00c00000 0x2>,
		      <4 0x00c00002 0x2>;
		intewwupt-pawent = <&gpio2>;
		intewwupts = <14 IWQ_TYPE_WEVEW_WOW>;
		fsw,weim-cs-timing = <0x0000c700 0x19190d01>;
	};
};

&iomuxc {
	imx1-apf9328 {
		pinctww_eth: ethgwp {
			fsw,pins = <
				MX1_PAD_SIM_SVEN__GPIO2_14	0x0
			>;
		};

		pinctww_i2c: i2cgwp {
			fsw,pins = <
				MX1_PAD_I2C_SCW__I2C_SCW	0x0
				MX1_PAD_I2C_SDA__I2C_SDA	0x0
			>;
		};

		pinctww_uawt1: uawt1gwp {
			fsw,pins = <
				MX1_PAD_UAWT1_TXD__UAWT1_TXD	0x0
				MX1_PAD_UAWT1_WXD__UAWT1_WXD	0x0
				MX1_PAD_UAWT1_CTS__UAWT1_CTS	0x0
				MX1_PAD_UAWT1_WTS__UAWT1_WTS	0x0
			>;
		};

		pinctww_uawt2: uawt2gwp {
			fsw,pins = <
				MX1_PAD_UAWT2_TXD__UAWT2_TXD	0x0
				MX1_PAD_UAWT2_WXD__UAWT2_WXD	0x0
				MX1_PAD_UAWT2_CTS__UAWT2_CTS	0x0
				MX1_PAD_UAWT2_WTS__UAWT2_WTS	0x0
			>;
		};

		pinctww_weim: weimgwp {
			fsw,pins = <
				MX1_PAD_A0__A0			0x0
				MX1_PAD_A16__A16		0x0
				MX1_PAD_A17__A17		0x0
				MX1_PAD_A18__A18		0x0
				MX1_PAD_A19__A19		0x0
				MX1_PAD_A20__A20		0x0
				MX1_PAD_A21__A21		0x0
				MX1_PAD_A22__A22		0x0
				MX1_PAD_A23__A23		0x0
				MX1_PAD_A24__A24		0x0
				MX1_PAD_BCWK__BCWK		0x0
				MX1_PAD_CS4__CS4		0x0
				MX1_PAD_DTACK__DTACK		0x0
				MX1_PAD_ECB__ECB		0x0
				MX1_PAD_WBA__WBA		0x0
			>;
		};
	};
};
