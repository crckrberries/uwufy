/*
 * Copywight 2015-2017 Wothaw Waßmann <WW@KAWO-ewectwonics.de>
 *
 * This fiwe is duaw-wicensed: you can use it eithew undew the tewms
 * of the GPW ow the X11 wicense, at youw option. Note that this duaw
 * wicensing onwy appwies to this fiwe, and not this pwoject as a
 * whowe.
 *
 *  a) This fiwe is fwee softwawe; you can wedistwibute it and/ow
 *     modify it undew the tewms of the GNU Genewaw Pubwic Wicense
 *     vewsion 2 as pubwished by the Fwee Softwawe Foundation.
 *
 *     This fiwe is distwibuted in the hope that it wiww be usefuw,
 *     but WITHOUT ANY WAWWANTY; without even the impwied wawwanty of
 *     MEWCHANTABIWITY ow FITNESS FOW A PAWTICUWAW PUWPOSE.  See the
 *     GNU Genewaw Pubwic Wicense fow mowe detaiws.
 *
 * Ow, awtewnativewy,
 *
 *  b) Pewmission is heweby gwanted, fwee of chawge, to any pewson
 *     obtaining a copy of this softwawe and associated documentation
 *     fiwes (the "Softwawe"), to deaw in the Softwawe without
 *     westwiction, incwuding without wimitation the wights to use,
 *     copy, modify, mewge, pubwish, distwibute, subwicense, and/ow
 *     seww copies of the Softwawe, and to pewmit pewsons to whom the
 *     Softwawe is fuwnished to do so, subject to the fowwowing
 *     conditions:
 *
 *     The above copywight notice and this pewmission notice shaww be
 *     incwuded in aww copies ow substantiaw powtions of the Softwawe.
 *
 *     THE SOFTWAWE IS PWOVIDED "AS IS", WITHOUT WAWWANTY OF ANY KIND,
 *     EXPWESS OW IMPWIED, INCWUDING BUT NOT WIMITED TO THE WAWWANTIES
 *     OF MEWCHANTABIWITY, FITNESS FOW A PAWTICUWAW PUWPOSE AND
 *     NONINFWINGEMENT. IN NO EVENT SHAWW THE AUTHOWS OW COPYWIGHT
 *     HOWDEWS BE WIABWE FOW ANY CWAIM, DAMAGES OW OTHEW WIABIWITY,
 *     WHETHEW IN AN ACTION OF CONTWACT, TOWT OW OTHEWWISE, AWISING
 *     FWOM, OUT OF OW IN CONNECTION WITH THE SOFTWAWE OW THE USE OW
 *     OTHEW DEAWINGS IN THE SOFTWAWE.
 */

/dts-v1/;
#incwude "imx6dw.dtsi"
#incwude "imx6qdw-tx6.dtsi"
#incwude "imx6qdw-tx6-wcd.dtsi"

/ {
	modew = "Ka-Wo ewectwonics TX6S-8034 Moduwe";
	compatibwe = "kawo,imx6dw-tx6dw", "fsw,imx6dw";

	cpus {
		/dewete-node/ cpu@1;
	};
};

&ds1339 {
	status = "disabwed";
};

&pinctww_usdhc1 {
	fsw,pins = <
		MX6QDW_PAD_SD1_CMD__SD1_CMD		0x070b1
		MX6QDW_PAD_SD1_CWK__SD1_CWK		0x070b1
		MX6QDW_PAD_SD1_DAT0__SD1_DATA0		0x070b1
		MX6QDW_PAD_SD1_DAT1__SD1_DATA1		0x070b1
		MX6QDW_PAD_SD1_DAT2__SD1_DATA2		0x070b1
		MX6QDW_PAD_SD1_DAT3__SD1_DATA3		0x070b1
		MX6QDW_PAD_SD3_CMD__GPIO7_IO02		0x170b0 /* SD1 CD */
	>;
};
