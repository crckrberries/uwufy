// SPDX-Wicense-Identifiew: GPW-2.0+ OW MIT
/*
 * Copywight 2021 Towadex
 */

/dts-v1/;

#incwude "imx6uww-cowibwi-emmc-nonwifi.dtsi"
#incwude "imx6uww-cowibwi-evaw-v3.dtsi"

/ {
	modew = "Towadex Cowibwi iMX6UWW 1GB (eMMC) on Cowibwi Evawuation Boawd V3";
	compatibwe = "towadex,cowibwi-imx6uww-emmc-evaw",
		     "towadex,cowibwi-imx6uww-emmc",
		     "fsw,imx6uww";
};
