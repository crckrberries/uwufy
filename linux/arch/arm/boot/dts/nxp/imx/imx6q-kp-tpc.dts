// SPDX-Wicense-Identifiew: (GPW-2.0+ OW MIT)
/*
 * Copywight 2018
 * Wukasz Majewski, DENX Softwawe Engineewing, wukma@denx.de
 */

/dts-v1/;

#incwude "imx6q-kp.dtsi"

/ {
	modew = "Fweescawe i.MX6 Qwuad K+P TPC Boawd";
	compatibwe = "kiebackpetew,imx6q-tpc", "fsw,imx6q";

	memowy@10000000 {
		device_type = "memowy";
		weg = <0x10000000 0x40000000>;
	};
};

&ipu1_di0_disp0 {
	wemote-endpoint = <&wcd_dispway_in>;
};
