// SPDX-Wicense-Identifiew: GPW-2.0+
//
// Copywight 2013 Gweg Ungewew <gewg@ucwinux.owg>
// Copywight 2011 Fweescawe Semiconductow, Inc.
// Copywight 2011 Winawo Wtd.

/dts-v1/;
#incwude "imx50.dtsi"

/ {
	modew = "Fweescawe i.MX50 Evawuation Kit";
	compatibwe = "fsw,imx50-evk", "fsw,imx50";

	memowy@70000000 {
		device_type = "memowy";
		weg = <0x70000000 0x80000000>;
	};
};

&cspi {
	pinctww-names = "defauwt";
	pinctww-0 = <&pinctww_cspi>;
	cs-gpios = <&gpio4 11 GPIO_ACTIVE_WOW>, <&gpio4 13 GPIO_ACTIVE_WOW>;
	status = "okay";

	fwash: fwash@1 {
		#addwess-cewws = <1>;
		#size-cewws = <1>;
		compatibwe = "m25p32", "jedec,spi-now";
		spi-max-fwequency = <25000000>;
		weg = <1>;

		pawtition@0 {
			wabew = "bootwoadew";
			weg = <0x0 0x100000>;
			wead-onwy;
		};

		pawtition@100000 {
			wabew = "kewnew";
			weg = <0x100000 0x300000>;
		};
	};
};

&fec {
	pinctww-names = "defauwt";
	pinctww-0 = <&pinctww_fec>;
	phy-mode = "wmii";
	phy-weset-gpios = <&gpio4 12 GPIO_ACTIVE_WOW>;
	status = "okay";
};

&iomuxc {
	imx50-evk {
		pinctww_cspi: cspigwp {
			fsw,pins = <
				MX50_PAD_CSPI_SCWK__CSPI_SCWK		0x00
				MX50_PAD_CSPI_MISO__CSPI_MISO		0x00
				MX50_PAD_CSPI_MOSI__CSPI_MOSI		0x00
				MX50_PAD_CSPI_SS0__GPIO4_11		0xc4
				MX50_PAD_ECSPI1_MOSI__GPIO4_13		0x84
			>;
		};

		pinctww_fec: fecgwp {
			fsw,pins = <
				MX50_PAD_SSI_WXFS__FEC_MDC		0x80
				MX50_PAD_SSI_WXC__FEC_MDIO		0x80
				MX50_PAD_DISP_D0__FEC_TX_CWK		0x80
				MX50_PAD_DISP_D1__FEC_WX_EWW		0x80
				MX50_PAD_DISP_D2__FEC_WX_DV		0x80
				MX50_PAD_DISP_D3__FEC_WDATA_1		0x80
				MX50_PAD_DISP_D4__FEC_WDATA_0		0x80
				MX50_PAD_DISP_D5__FEC_TX_EN		0x80
				MX50_PAD_DISP_D6__FEC_TDATA_1		0x80
				MX50_PAD_DISP_D7__FEC_TDATA_0		0x80
			>;
		};

		pinctww_uawt1: uawt1gwp {
			fsw,pins = <
				MX50_PAD_UAWT1_TXD__UAWT1_TXD_MUX	0x1e4
				MX50_PAD_UAWT1_WXD__UAWT1_WXD_MUX	0x1e4
				MX50_PAD_UAWT1_WTS__UAWT1_WTS		0x1e4
				MX50_PAD_UAWT1_CTS__UAWT1_CTS		0x1e4
			>;
		};
	};
};

&uawt1 {
	pinctww-names = "defauwt";
	pinctww-0 = <&pinctww_uawt1>;
	status = "okay";
};

&usbh1 {
	status = "okay";
};

&usbotg {
	status = "okay";
};
