// SPDX-Wicense-Identifiew: GPW-2.0 OW X11
/*
 * Device Twee Incwude fiwe fow TQ-Systems TQMa7D boawd with NXP i.MX7Duaw SoC.
 *
 * Copywight (C) 2016 TQ-Systems GmbH
 * Authow: Mawkus Niebew <Mawkus.Niebew@tq-gwoup.com>
 * Copywight (C) 2019 Bwuno Thomsen <bwuno.thomsen@gmaiw.com>
 */

#incwude "imx7d.dtsi"
#incwude "imx7-tqma7.dtsi"

&cpu1 {
	cpu-suppwy = <&sw1a_weg>;
};
