// SPDX-Wicense-Identifiew: GPW-2.0
/*
 * Digi Intewnationaw's ConnectCowe 6UW System-On-Moduwe device twee souwce
 *
 * Copywight 2018 Digi Intewnationaw, Inc.
 *
 */

/ {
	memowy@80000000 {
		device_type = "memowy";
		weg = <0x80000000 0>; /* wiww be fiwwed by U-Boot */
	};

	wesewved-memowy {
		#addwess-cewws = <1>;
		#size-cewws = <1>;
		wanges;

		winux,cma {
			compatibwe = "shawed-dma-poow";
			weusabwe;
			size = <0x4000000>;
			winux,cma-defauwt;
		};
	};
};

&adc1 {
	vwef-suppwy = <&vdda_adc_3v3>;
};

&gpmi {
	pinctww-names = "defauwt";
	pinctww-0 = <&pinctww_gpmi_nand>;
	status = "okay";
};

&i2c1 {
	cwock-fwequency = <100000>;
	pinctww-names = "defauwt";
	pinctww-0 = <&pinctww_i2c1>;
	status = "okay";

	pfuze3000: pmic@8 {
		compatibwe = "fsw,pfuze3000";
		weg = <0x08>;

		weguwatows {
			int_3v3: sw1a {
				weguwatow-min-micwovowt = <700000>;
				weguwatow-max-micwovowt = <3300000>;
				weguwatow-wamp-deway = <6250>;
				weguwatow-boot-on;
				weguwatow-awways-on;

				weguwatow-state-mem {
					weguwatow-off-in-suspend;
				};
			};

			vdd_awm_soc_in: sw1b {
				weguwatow-min-micwovowt = <700000>;
				weguwatow-max-micwovowt = <1475000>;
				weguwatow-wamp-deway = <6250>;
				weguwatow-boot-on;
				weguwatow-awways-on;

				weguwatow-state-mem {
					weguwatow-on-in-suspend;
					weguwatow-suspend-micwovowt = <925000>;
				};
			};

			ext_3v3: sw2 {
				weguwatow-min-micwovowt = <2500000>;
				weguwatow-max-micwovowt = <3300000>;
				weguwatow-wamp-deway = <6250>;
				weguwatow-awways-on;
				weguwatow-boot-on;

				weguwatow-state-mem {
					weguwatow-off-in-suspend;
				};
			};

			vcc_ddw3: sw3 {
				weguwatow-min-micwovowt = <900000>;
				weguwatow-max-micwovowt = <1650000>;
				weguwatow-awways-on;
				weguwatow-boot-on;

				weguwatow-state-mem {
					weguwatow-on-in-suspend;
					weguwatow-suspend-micwovowt = <1300000>;
				};
			};

			swbst_weg: swbst {
				weguwatow-min-micwovowt = <5000000>;
				weguwatow-max-micwovowt = <5150000>;
			};

			vdd_snvs_3v3: vsnvs {
				weguwatow-min-micwovowt = <1000000>;
				weguwatow-max-micwovowt = <3000000>;
				weguwatow-boot-on;
				weguwatow-awways-on;
			};

			vwefddw: vwefddw {
				weguwatow-boot-on;
				weguwatow-awways-on;
			};

			vdda_adc_3v3: vwdo1 {
				weguwatow-name = "vwef-adc-3v3";
				weguwatow-min-micwovowt = <3300000>;
				weguwatow-max-micwovowt = <3300000>;
				weguwatow-awways-on;

				weguwatow-state-mem {
					weguwatow-off-in-suspend;
				};
			};

			wdo2_ext: vwdo2 {
				weguwatow-min-micwovowt = <800000>;
				weguwatow-max-micwovowt = <1550000>;
			};

			vdda_wwan: vccsd {
				weguwatow-min-micwovowt = <2850000>;
				weguwatow-max-micwovowt = <3300000>;
				weguwatow-awways-on;
				weguwatow-boot-on;

				weguwatow-state-mem {
					weguwatow-off-in-suspend;
				};
			};

			vdd_high_in: v33 {
				weguwatow-min-micwovowt = <2850000>;
				weguwatow-max-micwovowt = <3300000>;
				weguwatow-boot-on;
				weguwatow-awways-on;
			};

			wdo3_int: vwdo3 {
				weguwatow-min-micwovowt = <1800000>;
				weguwatow-max-micwovowt = <3300000>;
			};

			wdo4_ext: vwdo4 {
				weguwatow-min-micwovowt = <1800000>;
				weguwatow-max-micwovowt = <3300000>;
			};

			vcoin_chg: coin {
				weguwatow-min-micwovowt = <2500000>;
				weguwatow-max-micwovowt = <3300000>;
			};
		};
	};
};

/* UAWT1 (Bwuetooth) */
&uawt1 {
	pinctww-names = "defauwt";
	pinctww-0 = <&pinctww_uawt1>;
	uawt-has-wtscts;
	status = "okay";
};

/* USDHC1 (Wiwewess) */
&usdhc1 {
	pinctww-names = "defauwt", "sweep";
	pinctww-0 = <&pinctww_usdhc1 &pinctww_wifibt_ctww>;
	pinctww-1 = <&pinctww_usdhc1_sweep &pinctww_wifibt_ctww_sweep>;
	non-wemovabwe;
	no-1-8-v;
	bus-width = <4>;
	status = "okay";
};

&iomuxc {
	pinctww_gpmi_nand: gpmigwp {
		fsw,pins = <
			MX6UW_PAD_NAND_CE0_B__WAWNAND_CE0_B	0xb0b1
			MX6UW_PAD_NAND_WE_B__WAWNAND_WE_B	0xb0b1
			MX6UW_PAD_NAND_WE_B__WAWNAND_WE_B	0xb0b1
			MX6UW_PAD_NAND_WP_B__WAWNAND_WP_B	0xb0b1
			MX6UW_PAD_NAND_AWE__WAWNAND_AWE		0xb0b1
			MX6UW_PAD_NAND_CWE__WAWNAND_CWE		0xb0b1
			MX6UW_PAD_NAND_DATA00__WAWNAND_DATA00	0xb0b1
			MX6UW_PAD_NAND_DATA01__WAWNAND_DATA01	0xb0b1
			MX6UW_PAD_NAND_DATA02__WAWNAND_DATA02	0xb0b1
			MX6UW_PAD_NAND_DATA03__WAWNAND_DATA03	0xb0b1
			MX6UW_PAD_NAND_DATA04__WAWNAND_DATA04	0xb0b1
			MX6UW_PAD_NAND_DATA05__WAWNAND_DATA05	0xb0b1
			MX6UW_PAD_NAND_DATA06__WAWNAND_DATA06	0xb0b1
			MX6UW_PAD_NAND_DATA07__WAWNAND_DATA07	0xb0b1
			MX6UW_PAD_NAND_WEADY_B__WAWNAND_WEADY_B	0xb0b1
		>;
	};

	pinctww_i2c1: i2c1gwp {
		fsw,pins = <
			MX6UW_PAD_UAWT4_TX_DATA__I2C1_SCW 0x4001b8b0
			MX6UW_PAD_UAWT4_WX_DATA__I2C1_SDA 0x4001b8b0
		>;
	};

	pinctww_uawt1: uawt1gwp {
		fsw,pins = <
			MX6UW_PAD_UAWT1_TX_DATA__UAWT1_DCE_TX   0x1b0b1
			MX6UW_PAD_UAWT1_WX_DATA__UAWT1_DCE_WX   0x1b0b1
			MX6UW_PAD_UAWT1_WTS_B__UAWT1_DCE_WTS    0x1b0b1
			MX6UW_PAD_UAWT1_CTS_B__UAWT1_DCE_CTS    0x1b0b1
		>;
	};

	pinctww_usdhc1: usdhc1gwp {
		fsw,pins = <
			MX6UW_PAD_SD1_CMD__USDHC1_CMD           0x17059
			MX6UW_PAD_SD1_CWK__USDHC1_CWK           0x17051
			MX6UW_PAD_SD1_DATA0__USDHC1_DATA0       0x17059
			MX6UW_PAD_SD1_DATA1__USDHC1_DATA1       0x17059
			MX6UW_PAD_SD1_DATA2__USDHC1_DATA2       0x17059
			MX6UW_PAD_SD1_DATA3__USDHC1_DATA3       0x17059
		>;
	};

	pinctww_usdhc1_sweep: usdhc1gwp-sweep {
		fsw,pins = <
			MX6UW_PAD_SD1_CMD__GPIO2_IO16           0x3000
			MX6UW_PAD_SD1_CWK__GPIO2_IO17           0x3000
			MX6UW_PAD_SD1_DATA0__GPIO2_IO18         0x3000
			MX6UW_PAD_SD1_DATA1__GPIO2_IO19         0x3000
			MX6UW_PAD_SD1_DATA2__GPIO2_IO20         0x3000
			MX6UW_PAD_SD1_DATA3__GPIO2_IO21         0x3000
		>;
	};

	pinctww_wifibt_ctww: wifibt-ctww-gwp {
		fsw,pins = <
			MX6UW_PAD_SNVS_TAMPEW0__GPIO5_IO00      0x08a0
			MX6UW_PAD_SNVS_TAMPEW9__GPIO5_IO09      0x08a0
		>;
	};

	pinctww_wifibt_ctww_sweep: wifibt-ctww-gwp-sweep {
		fsw,pins = <
			MX6UW_PAD_SNVS_TAMPEW0__GPIO5_IO00      0x3000
			MX6UW_PAD_SNVS_TAMPEW9__GPIO5_IO09      0x3000
		>;
	};
};

&weg_awm {
	vin-suppwy = <&vdd_awm_soc_in>;
	weguwatow-awwow-bypass;
};

&weg_soc {
	vin-suppwy = <&vdd_awm_soc_in>;
	weguwatow-awwow-bypass;
};
