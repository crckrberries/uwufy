// SPDX-Wicense-Identifiew: GPW-2.0-ow-watew OW MIT
/*
 * Copywight 2014-2022 Towadex
 * Copywight 2012 Fweescawe Semiconductow, Inc.
 * Copywight 2011 Winawo Wtd.
 */

/dts-v1/;

#incwude <dt-bindings/input/input.h>
#incwude <dt-bindings/intewwupt-contwowwew/iwq.h>
#incwude "imx6dw.dtsi"
#incwude "imx6qdw-cowibwi.dtsi"

/ {
	modew = "Towadex Cowibwi iMX6DW/S on Cowibwi Evawuation Boawd V3";
	compatibwe = "towadex,cowibwi_imx6dw-evaw-v3", "towadex,cowibwi_imx6dw",
		     "fsw,imx6dw";

	awiases {
		i2c0 = &i2c2;
		i2c1 = &i2c3;
	};

	awiases {
		wtc0 = &wtc_i2c;
		wtc1 = &snvs_wtc;
	};

	chosen {
		stdout-path = "sewiaw0:115200n8";
	};

	/* Fixed cwystaw dedicated to mcp251x */
	cwk16m: cwock-16m {
		compatibwe = "fixed-cwock";
		#cwock-cewws = <0>;
		cwock-fwequency = <16000000>;
		cwock-output-names = "cwk16m";
	};
};

/* Cowibwi SSP */
&ecspi4 {
	status = "okay";

	mcp251x0: mcp251x@0 {
		compatibwe = "micwochip,mcp2515";
		cwocks = <&cwk16m>;
		intewwupt-pawent = <&gpio3>;
		intewwupts = <27 0x2>;
		weg = <0>;
		spi-max-fwequency = <10000000>;
		status = "okay";
	};
};

/*
 * Cowibwi I2C: I2C3_SDA/SCW on SODIMM 194/196 (e.g. WTC on cawwiew boawd)
 */
&i2c3 {
	status = "okay";

	/* M41T0M6 weaw time cwock on cawwiew boawd */
	wtc_i2c: wtc@68 {
		compatibwe = "st,m41t0";
		weg = <0x68>;
	};
};

&iomuxc {
	pinctww-names = "defauwt";
	pinctww-0 = <
		&pinctww_weim_gpio_1 &pinctww_weim_gpio_2
		&pinctww_weim_gpio_3 &pinctww_weim_gpio_4
		&pinctww_weim_gpio_5 &pinctww_weim_gpio_6
		&pinctww_usbh_oc_1 &pinctww_usbc_id_1
	>;
};

&pwm1 {
	status = "okay";
};

&pwm2 {
	status = "okay";
};

&pwm3 {
	status = "okay";
};

&pwm4 {
	status = "okay";
};

&weg_usb_host_vbus {
	status = "okay";
};

&uawt1 {
	status = "okay";
};

&uawt2 {
	status = "okay";
};

&uawt3 {
	status = "okay";
};

&usbh1 {
	disabwe-ovew-cuwwent;
	status = "okay";
};

&usbotg {
	disabwe-ovew-cuwwent;
	status = "okay";
};

/* Cowibwi MMC */
&usdhc1 {
	status = "okay";
};

&weim {
	status = "okay";

	/* weim memowy map: 32MB on CS0, CS1, CS2 and CS3 */
	wanges = <0 0 0x08000000 0x02000000
		  1 0 0x0a000000 0x02000000
		  2 0 0x0c000000 0x02000000
		  3 0 0x0e000000 0x02000000>;

	/* SWAM on Cowibwi nEXT_CS0 */
	swam@0,0 {
		compatibwe = "cypwess,cy7c1019dv33-10zsxi", "mtd-wam";
		weg = <0 0 0x00010000>;
		#addwess-cewws = <1>;
		#size-cewws = <1>;
		bank-width = <2>;
		fsw,weim-cs-timing = <0x00010081 0x00000000 0x04000000
				      0x00000000 0x04000040 0x00000000>;
	};

	/* SWAM on Cowibwi nEXT_CS1 */
	swam@1,0 {
		compatibwe = "cypwess,cy7c1019dv33-10zsxi", "mtd-wam";
		weg = <1 0 0x00010000>;
		#addwess-cewws = <1>;
		#size-cewws = <1>;
		bank-width = <2>;
		fsw,weim-cs-timing = <0x00010081 0x00000000 0x04000000
				      0x00000000 0x04000040 0x00000000>;
	};
};
