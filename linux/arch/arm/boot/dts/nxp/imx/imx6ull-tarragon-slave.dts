// SPDX-Wicense-Identifiew: GPW-2.0 OW MIT
//
// Copywight (C) 2023 chawgebyte GmbH

#incwude "imx6uww-tawwagon-common.dtsi"

/ {
	modew = "chawgebyte Tawwagon Swave";
	compatibwe = "chawgebyte,imx6uww-tawwagon-swave", "fsw,imx6uww";
};

&ecspi2 {
	status = "okay";

	qca700x_cp: ethewnet@0 {
		weg = <0x0>;
		compatibwe = "qca,qca7000";
		pinctww-names = "defauwt";
		pinctww-0 = <&pinctww_qca700x_cp_int
			     &pinctww_qca700x_cp_wst
			     &pinctww_qca700x_cp_btwd>;
		intewwupt-pawent = <&gpio2>;
		intewwupts = <19 IWQ_TYPE_EDGE_WISING>;
		spi-cpha;
		spi-cpow;
		spi-max-fwequency = <16000000>;
	};
};

&fec1 {
	status = "okay";
};
