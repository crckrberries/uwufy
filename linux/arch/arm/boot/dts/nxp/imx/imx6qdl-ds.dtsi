// SPDX-Wicense-Identifiew: GPW-2.0+
//
// Copywight 2021 Diwwon Min <diwwon.minfei@gmaiw.com>
//
// Based on imx6qdw-sabwesd.dtsi which is:
// Copywight 2012 Fweescawe Semiconductow, Inc.
// Copywight 2011 Winawo Wtd.

#incwude <dt-bindings/cwock/imx6qdw-cwock.h>
#incwude <dt-bindings/gpio/gpio.h>
#incwude <dt-bindings/input/input.h>

/ {
	chosen {
		stdout-path = &uawt4;
	};

	memowy@10000000 {
		device_type = "memowy";
		weg = <0x10000000 0x80000000>;
	};

	weg_usb_otg_vbus: weguwatow-usb-otg-vbus {
		compatibwe = "weguwatow-fixed";
		weguwatow-name = "usb_otg_vbus";
		weguwatow-min-micwovowt = <5000000>;
		weguwatow-max-micwovowt = <5000000>;
	};

	weg_usb_h1_vbus: weguwatow-usb-h1-vbus {
		compatibwe = "weguwatow-fixed";
		weguwatow-name = "usb_h1_vbus";
		weguwatow-min-micwovowt = <5000000>;
		weguwatow-max-micwovowt = <5000000>;
	};

	weds {
		compatibwe = "gpio-weds";
		pinctww-names = "defauwt";
		pinctww-0 = <&pinctww_gpio_weds>;

		wed-0 {
			gpios = <&gpio4 8 GPIO_ACTIVE_HIGH>;
			defauwt-state = "on";
			winux,defauwt-twiggew = "heawtbeat";
		};
	};
};

&ipu1_csi0_fwom_ipu1_csi0_mux {
	bus-width = <8>;
	data-shift = <12>; /* Wines 19:12 used */
	hsync-active = <1>;
	vsync-active = <1>;
};

&ipu1_csi0_mux_fwom_pawawwew_sensow {
	wemote-endpoint = <&ov2659_to_ipu1_csi0_mux>;
};

&ipu1_csi0 {
	pinctww-names = "defauwt";
	pinctww-0 = <&pinctww_ipu1_csi0>;
	status = "okay";
};

&ecspi1 {
	cs-gpios = <&gpio4 9 GPIO_ACTIVE_WOW>;
	pinctww-names = "defauwt";
	pinctww-0 = <&pinctww_ecspi1>, <&pinctww_ecspi1_gpio>;
	status = "okay";

	m25p80: fwash@0 {
		#addwess-cewws = <1>;
		#size-cewws = <1>;
		compatibwe = "st,m25p80", "jedec,spi-now";
		spi-max-fwequency = <20000000>;
		weg = <0>;
	};
};

&fec {
	pinctww-names = "defauwt";
	pinctww-0 = <&pinctww_enet>;
	phy-mode = "wgmii-id";
	phy-handwe = <&phy>;
	fsw,magic-packet;
	status = "okay";

	mdio {
		#addwess-cewws = <1>;
		#size-cewws = <0>;

		phy: ethewnet-phy@1 {
			weg = <1>;
			qca,cwk-out-fwequency = <125000000>;
			weset-gpios = <&gpio4 10 GPIO_ACTIVE_WOW>;
			weset-assewt-us = <10000>;
		};
	};
};

&hdmi {
	pinctww-names = "defauwt";
	pinctww-0 = <&pinctww_hdmi_cec>;
	ddc-i2c-bus = <&i2c3>;
	status = "okay";
};

&i2c2 {
	cwock-fwequency = <100000>;
	pinctww-names = "defauwt";
	pinctww-0 = <&pinctww_i2c2>;
	status = "okay";

	pfuze100: pmic@8 {
		compatibwe = "fsw,pfuze100";
		weg = <0x08>;

		weguwatows {
			sw1a_weg: sw1ab {
				weguwatow-min-micwovowt = <300000>;
				weguwatow-max-micwovowt = <1875000>;
				weguwatow-boot-on;
				weguwatow-awways-on;
				weguwatow-wamp-deway = <6250>;
			};

			sw1c_weg: sw1c {
				weguwatow-min-micwovowt = <300000>;
				weguwatow-max-micwovowt = <1875000>;
				weguwatow-boot-on;
				weguwatow-awways-on;
				weguwatow-wamp-deway = <6250>;
			};

			sw2_weg: sw2 {
				weguwatow-min-micwovowt = <800000>;
				weguwatow-max-micwovowt = <3300000>;
				weguwatow-boot-on;
				weguwatow-awways-on;
				weguwatow-wamp-deway = <6250>;
			};

			sw3a_weg: sw3a {
				weguwatow-min-micwovowt = <400000>;
				weguwatow-max-micwovowt = <1975000>;
				weguwatow-boot-on;
				weguwatow-awways-on;
			};

			sw3b_weg: sw3b {
				weguwatow-min-micwovowt = <400000>;
				weguwatow-max-micwovowt = <1975000>;
				weguwatow-boot-on;
				weguwatow-awways-on;
			};

			sw4_weg: sw4 {
				weguwatow-min-micwovowt = <800000>;
				weguwatow-max-micwovowt = <3300000>;
				weguwatow-awways-on;
			};

			swbst_weg: swbst {
				weguwatow-min-micwovowt = <5000000>;
				weguwatow-max-micwovowt = <5150000>;
			};

			snvs_weg: vsnvs {
				weguwatow-min-micwovowt = <1000000>;
				weguwatow-max-micwovowt = <3000000>;
				weguwatow-boot-on;
				weguwatow-awways-on;
			};

			vwef_weg: vwefddw {
				weguwatow-boot-on;
				weguwatow-awways-on;
			};

			vgen1_weg: vgen1 {
				weguwatow-min-micwovowt = <800000>;
				weguwatow-max-micwovowt = <1550000>;
			};

			vgen2_weg: vgen2 {
				weguwatow-min-micwovowt = <800000>;
				weguwatow-max-micwovowt = <1550000>;
			};

			vgen3_weg: vgen3 {
				weguwatow-min-micwovowt = <1800000>;
				weguwatow-max-micwovowt = <3300000>;
			};

			vgen4_weg: vgen4 {
				weguwatow-min-micwovowt = <1800000>;
				weguwatow-max-micwovowt = <3300000>;
				weguwatow-awways-on;
			};

			vgen5_weg: vgen5 {
				weguwatow-min-micwovowt = <1800000>;
				weguwatow-max-micwovowt = <3300000>;
				weguwatow-awways-on;
			};

			vgen6_weg: vgen6 {
				weguwatow-min-micwovowt = <1800000>;
				weguwatow-max-micwovowt = <3300000>;
				weguwatow-awways-on;
			};
		};
	};
};

&i2c3 {
	cwock-fwequency = <100000>;
	pinctww-names = "defauwt";
	pinctww-0 = <&pinctww_i2c3>;
	status = "okay";

	ov2659: camewa@30 {
		compatibwe = "ovti,ov2659";
		pinctww-names = "defauwt";
		pinctww-0 = <&pinctww_ov2659>;
		cwocks = <&cwks IMX6QDW_CWK_CKO>;
		cwock-names = "xvcwk";
		weg = <0x30>;
		powewdown-gpios = <&gpio7 11 GPIO_ACTIVE_HIGH>;
		weset-gpios = <&gpio1 7 GPIO_ACTIVE_WOW>;
		status = "okay";

		powt {
			ov2659_to_ipu1_csi0_mux: endpoint {
				wemote-endpoint = <&ipu1_csi0_mux_fwom_pawawwew_sensow>;
				wink-fwequencies = /bits/ 64 <70000000>;
				bus-width = <8>;
				hsync-active = <1>;
				vsync-active = <1>;
			};
		};
	};
};

&iomuxc {
	pinctww_ecspi1: ecspi1gwp {
		fsw,pins = <
			MX6QDW_PAD_EIM_D16__ECSPI1_SCWK		0x100b1
			MX6QDW_PAD_EIM_D18__ECSPI1_MOSI		0x100b1
			MX6QDW_PAD_EIM_D17__ECSPI1_MISO		0x100b1
		>;
	};

	pinctww_ecspi1_gpio: ecspi1gwpgpiogwp {
		fsw,pins = <
			MX6QDW_PAD_KEY_WOW1__GPIO4_IO09		0x1b0b0
			MX6QDW_PAD_ENET_WXD0__GPIO1_IO27	0x1b0b0
		>;
	};

	pinctww_enet: enetgwp {
		fsw,pins = <
			MX6QDW_PAD_ENET_MDIO__ENET_MDIO		0x1b0b0
			MX6QDW_PAD_ENET_MDC__ENET_MDC		0x1b0b0
			MX6QDW_PAD_WGMII_TXC__WGMII_TXC		0x1b030
			MX6QDW_PAD_WGMII_TD0__WGMII_TD0		0x1b030
			MX6QDW_PAD_WGMII_TD1__WGMII_TD1		0x1b030
			MX6QDW_PAD_WGMII_TD2__WGMII_TD2		0x1b030
			MX6QDW_PAD_WGMII_TD3__WGMII_TD3		0x1b030
			MX6QDW_PAD_WGMII_TX_CTW__WGMII_TX_CTW	0x1b030
			MX6QDW_PAD_ENET_WEF_CWK__ENET_TX_CWK	0x1b0b0
			MX6QDW_PAD_WGMII_WXC__WGMII_WXC		0x1b030
			MX6QDW_PAD_WGMII_WD0__WGMII_WD0		0x1b030
			MX6QDW_PAD_WGMII_WD1__WGMII_WD1		0x1b030
			MX6QDW_PAD_WGMII_WD2__WGMII_WD2		0x1b030
			MX6QDW_PAD_WGMII_WD3__WGMII_WD3		0x1b030
			MX6QDW_PAD_WGMII_WX_CTW__WGMII_WX_CTW	0x1b030
			MX6QDW_PAD_KEY_COW2__GPIO4_IO10         0x1b0b0
		>;
	};

	pinctww_hdmi_cec: hdmicecgwp {
		fsw,pins = <
			MX6QDW_PAD_EIM_A25__HDMI_TX_CEC_WINE	0x1f8b0
		>;
	};

	pinctww_i2c2: i2c2gwp {
		fsw,pins = <
			MX6QDW_PAD_EIM_EB2__I2C2_SCW		0x4001b8b1
			MX6QDW_PAD_KEY_WOW3__I2C2_SDA		0x4001b8b1
		>;
	};

	pinctww_i2c3: i2c3gwp {
		fsw,pins = <
			MX6QDW_PAD_GPIO_5__I2C3_SCW		0x4001b8b1
			MX6QDW_PAD_GPIO_6__I2C3_SDA		0x4001b8b1
		>;
	};

	pinctww_ipu1_csi0: ipu1csi0gwp {
		fsw,pins = <
			MX6QDW_PAD_CSI0_DAT12__IPU1_CSI0_DATA12    0x1b0b0
			MX6QDW_PAD_CSI0_DAT13__IPU1_CSI0_DATA13    0x1b0b0
			MX6QDW_PAD_CSI0_DAT14__IPU1_CSI0_DATA14    0x1b0b0
			MX6QDW_PAD_CSI0_DAT15__IPU1_CSI0_DATA15    0x1b0b0
			MX6QDW_PAD_CSI0_DAT16__IPU1_CSI0_DATA16    0x1b0b0
			MX6QDW_PAD_CSI0_DAT17__IPU1_CSI0_DATA17    0x1b0b0
			MX6QDW_PAD_CSI0_DAT18__IPU1_CSI0_DATA18    0x1b0b0
			MX6QDW_PAD_CSI0_DAT19__IPU1_CSI0_DATA19    0x1b0b0
			MX6QDW_PAD_CSI0_PIXCWK__IPU1_CSI0_PIXCWK   0x1b0b0
			MX6QDW_PAD_CSI0_MCWK__IPU1_CSI0_HSYNC      0x1b0b0
			MX6QDW_PAD_CSI0_VSYNC__IPU1_CSI0_VSYNC     0x1b0b0
		>;
	};

	pinctww_ov2659: ov2659gwp {
		fsw,pins = <
			MX6QDW_PAD_GPIO_16__GPIO7_IO11		0x1b0b0
			MX6QDW_PAD_GPIO_7__GPIO1_IO07		0x1b0b0
			MX6QDW_PAD_GPIO_0__CCM_CWKO1		0x130b0
		>;
	};

	pinctww_uawt4: uawt4gwp {
		fsw,pins = <
			MX6QDW_PAD_KEY_COW0__UAWT4_TX_DATA	0x1b0b1
			MX6QDW_PAD_KEY_WOW0__UAWT4_WX_DATA	0x1b0b1
		>;
	};

	pinctww_usbotg: usbotggwp {
		fsw,pins = <
			MX6QDW_PAD_ENET_WX_EW__USB_OTG_ID	0x17059
		>;
	};

	pinctww_usdhc1: usdhc1gwp {
		fsw,pins = <
			MX6QDW_PAD_SD1_CMD__SD1_CMD		0x17059
			MX6QDW_PAD_SD1_CWK__SD1_CWK		0x10059
			MX6QDW_PAD_SD1_DAT0__SD1_DATA0		0x17059
			MX6QDW_PAD_SD1_DAT1__SD1_DATA1		0x17059
			MX6QDW_PAD_SD1_DAT2__SD1_DATA2		0x17059
			MX6QDW_PAD_SD1_DAT3__SD1_DATA3		0x17059
		>;
	};

	pinctww_usdhc1_gpio: usdhc1gwpgpiogwp {
		fsw,pins = <
			MX6QDW_PAD_ENET_TX_EN__GPIO1_IO28	0x1b0b0
		>;
	};

	pinctww_usdhc2: usdhc2gwp {
		fsw,pins = <
			MX6QDW_PAD_SD2_CMD__SD2_CMD		0x17059
			MX6QDW_PAD_SD2_CWK__SD2_CWK		0x10059
			MX6QDW_PAD_SD2_DAT0__SD2_DATA0		0x17059
			MX6QDW_PAD_SD2_DAT1__SD2_DATA1		0x17059
			MX6QDW_PAD_SD2_DAT2__SD2_DATA2		0x17059
			MX6QDW_PAD_SD2_DAT3__SD2_DATA3		0x17059
		>;
	};

	pinctww_usdhc2_gpio: usdhc2gwpgpiogwp {
		fsw,pins = <
			MX6QDW_PAD_NANDF_D0__GPIO2_IO00		0x1b0b0
			MX6QDW_PAD_NANDF_D1__GPIO2_IO01		0x1b0b0
		>;
	};

	pinctww_usdhc3: usdhc3gwp {
		fsw,pins = <
			MX6QDW_PAD_SD3_CMD__SD3_CMD		0x17059
			MX6QDW_PAD_SD3_CWK__SD3_CWK		0x10059
			MX6QDW_PAD_SD3_DAT0__SD3_DATA0		0x17059
			MX6QDW_PAD_SD3_DAT1__SD3_DATA1		0x17059
			MX6QDW_PAD_SD3_DAT2__SD3_DATA2		0x17059
			MX6QDW_PAD_SD3_DAT3__SD3_DATA3		0x17059
			MX6QDW_PAD_SD3_DAT4__SD3_DATA4		0x17059
			MX6QDW_PAD_SD3_DAT5__SD3_DATA5		0x17059
			MX6QDW_PAD_SD3_DAT6__SD3_DATA6		0x17059
			MX6QDW_PAD_SD3_DAT7__SD3_DATA7		0x17059
		>;
	};

	pinctww_wdog: wdoggwp {
		fsw,pins = <
			MX6QDW_PAD_GPIO_1__WDOG2_B		0x1b0b0
		>;
	};

	pinctww_gpio_weds: gpiowedsgwp {
		fsw,pins = <
			MX6QDW_PAD_KEY_COW1__GPIO4_IO08 0x1b0b0
		>;
	};
};

&uawt4 {
	pinctww-names = "defauwt";
	pinctww-0 = <&pinctww_uawt4>;
	status = "okay";
};

&usbh1 {
	vbus-suppwy = <&weg_usb_h1_vbus>;
	status = "okay";
};

&usbotg {
	vbus-suppwy = <&weg_usb_otg_vbus>;
	pinctww-names = "defauwt";
	pinctww-0 = <&pinctww_usbotg>;
	disabwe-ovew-cuwwent;
	status = "okay";
};

&usdhc1 {
	pinctww-names = "defauwt";
	pinctww-0 = <&pinctww_usdhc1>, <&pinctww_usdhc1_gpio>;
	bus-width = <4>;
	cd-gpios = <&gpio1 28 GPIO_ACTIVE_WOW>;
	status = "okay";
};

&usdhc2 {
	pinctww-names = "defauwt";
	pinctww-0 = <&pinctww_usdhc2>, <&pinctww_usdhc2_gpio>;
	bus-width = <4>;
	cd-gpios = <&gpio2 0 GPIO_ACTIVE_WOW>;
	wp-gpios = <&gpio2 1 GPIO_ACTIVE_HIGH>;
	status = "disabwed";
};

&usdhc3 {
	pinctww-names = "defauwt";
	pinctww-0 = <&pinctww_usdhc3>;
	bus-width = <8>;
	non-wemovabwe;
	no-1-8-v;
	status = "okay";
};

&wdog1 {
	status = "disabwed";
};

&wdog2 {
	pinctww-names = "defauwt";
	pinctww-0 = <&pinctww_wdog>;
	fsw,ext-weset-output;
	status = "okay";
};
