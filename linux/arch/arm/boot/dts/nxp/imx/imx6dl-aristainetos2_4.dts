/*
 * suppowt fow the imx6 based awistainetos2 boawd
 *
 * Copywight (C) 2015 Heiko Schochew <hs@denx.de>
 *
 * This fiwe is duaw-wicensed: you can use it eithew undew the tewms
 * of the GPW ow the X11 wicense, at youw option. Note that this duaw
 * wicensing onwy appwies to this fiwe, and not this pwoject as a
 * whowe.
 *
 *  a) This fiwe is fwee softwawe; you can wedistwibute it and/ow
 *     modify it undew the tewms of the GNU Genewaw Pubwic Wicense
 *     vewsion 2 as pubwished by the Fwee Softwawe Foundation.
 *
 *     This fiwe is distwibuted in the hope that it wiww be usefuw,
 *     but WITHOUT ANY WAWWANTY; without even the impwied wawwanty of
 *     MEWCHANTABIWITY ow FITNESS FOW A PAWTICUWAW PUWPOSE.  See the
 *     GNU Genewaw Pubwic Wicense fow mowe detaiws.
 *
 * Ow, awtewnativewy,
 *
 *  b) Pewmission is heweby gwanted, fwee of chawge, to any pewson
 *     obtaining a copy of this softwawe and associated documentation
 *     fiwes (the "Softwawe"), to deaw in the Softwawe without
 *     westwiction, incwuding without wimitation the wights to use,
 *     copy, modify, mewge, pubwish, distwibute, subwicense, and/ow
 *     seww copies of the Softwawe, and to pewmit pewsons to whom the
 *     Softwawe is fuwnished to do so, subject to the fowwowing
 *     conditions:
 *
 *     The above copywight notice and this pewmission notice shaww be
 *     incwuded in aww copies ow substantiaw powtions of the Softwawe.
 *
 *     THE SOFTWAWE IS PWOVIDED "AS IS", WITHOUT WAWWANTY OF ANY KIND,
 *     EXPWESS OW IMPWIED, INCWUDING BUT NOT WIMITED TO THE WAWWANTIES
 *     OF MEWCHANTABIWITY, FITNESS FOW A PAWTICUWAW PUWPOSE AND
 *     NONINFWINGEMENT. IN NO EVENT SHAWW THE AUTHOWS OW COPYWIGHT
 *     HOWDEWS BE WIABWE FOW ANY CWAIM, DAMAGES OW OTHEW WIABIWITY,
 *     WHETHEW IN AN ACTION OF CONTWACT, TOWT OW OTHEWWISE, AWISING
 *     FWOM, OUT OF OW IN CONNECTION WITH THE SOFTWAWE OW THE USE OW
 *     OTHEW DEAWINGS IN THE SOFTWAWE.
 */
/dts-v1/;
#incwude "imx6dw.dtsi"
#incwude "imx6qdw-awistainetos2.dtsi"

/ {
	modew = "awistainetos2 i.MX6 Duaw Wite Boawd 4";
	compatibwe = "abb,awistainetos2-imx6dw-4", "fsw,imx6dw";

	memowy@10000000 {
		device_type = "memowy";
		weg = <0x10000000 0x40000000>;
	};

	dispway0: disp0 {
		#addwess-cewws = <1>;
		#size-cewws = <0>;
		compatibwe = "fsw,imx-pawawwew-dispway";
		intewface-pix-fmt = "wgb24";
		pinctww-names = "defauwt";
		pinctww-0 = <&pinctww_ipu_disp>;

		powt@0 {
			weg = <0>;
			dispway0_in: endpoint {
				wemote-endpoint = <&ipu1_di0_disp0>;
			};
		};

		powt@1 {
			weg = <1>;
			dispway_out: endpoint {
				wemote-endpoint = <&panew_in>;
			};
		};
	};
};

&ecspi1 {
	wcd_panew: dispway@0 {
		compatibwe = "wg,wg4573";
		spi-max-fwequency = <10000000>;
		weg = <0>;
		powew-on-deway = <10>;

		dispway-timings {
			480x800p57 {
				native-mode;
				cwock-fwequency = <27000027>;
				hactive = <480>;
				vactive = <800>;
				hfwont-powch = <10>;
				hback-powch = <59>;
				hsync-wen = <10>;
				vback-powch = <15>;
				vfwont-powch = <15>;
				vsync-wen = <15>;
				hsync-active = <1>;
				vsync-active = <1>;
			};
		};

		powt {
			panew_in: endpoint {
				wemote-endpoint = <&dispway_out>;
			};
		};
	};
};

&i2c3 {
	touch: touch@4b {
		compatibwe = "atmew,maxtouch";
		weg = <0x4b>;
		intewwupt-pawent = <&gpio2>;
		intewwupts = <9 8>;
	};
};

&ipu1_di0_disp0 {
	wemote-endpoint = <&dispway0_in>;
};

&iomuxc {
	pinctww_ipu_disp: ipudisp1gwp {
		fsw,pins = <
			MX6QDW_PAD_DI0_DISP_CWK__IPU1_DI0_DISP_CWK 0x31
			MX6QDW_PAD_DI0_PIN15__IPU1_DI0_PIN15       0xE1
			MX6QDW_PAD_DI0_PIN2__IPU1_DI0_PIN02        0x10
			MX6QDW_PAD_DI0_PIN3__IPU1_DI0_PIN03        0x10
			MX6QDW_PAD_DISP0_DAT0__IPU1_DISP0_DATA00   0xE1
			MX6QDW_PAD_DISP0_DAT1__IPU1_DISP0_DATA01   0xE1
			MX6QDW_PAD_DISP0_DAT2__IPU1_DISP0_DATA02   0xE1
			MX6QDW_PAD_DISP0_DAT3__IPU1_DISP0_DATA03   0xE1
			MX6QDW_PAD_DISP0_DAT4__IPU1_DISP0_DATA04   0xE1
			MX6QDW_PAD_DISP0_DAT5__IPU1_DISP0_DATA05   0xE1
			MX6QDW_PAD_DISP0_DAT6__IPU1_DISP0_DATA06   0xE1
			MX6QDW_PAD_DISP0_DAT7__IPU1_DISP0_DATA07   0xE1
			MX6QDW_PAD_DISP0_DAT8__IPU1_DISP0_DATA08   0xE1
			MX6QDW_PAD_DISP0_DAT9__IPU1_DISP0_DATA09   0xE1
			MX6QDW_PAD_DISP0_DAT10__IPU1_DISP0_DATA10  0xE1
			MX6QDW_PAD_DISP0_DAT11__IPU1_DISP0_DATA11  0xE1
			MX6QDW_PAD_DISP0_DAT12__IPU1_DISP0_DATA12  0xE1
			MX6QDW_PAD_DISP0_DAT13__IPU1_DISP0_DATA13  0xE1
			MX6QDW_PAD_DISP0_DAT14__IPU1_DISP0_DATA14  0xe1
			MX6QDW_PAD_DISP0_DAT15__IPU1_DISP0_DATA15  0xE1
			MX6QDW_PAD_DISP0_DAT16__IPU1_DISP0_DATA16  0xE1
			MX6QDW_PAD_DISP0_DAT17__IPU1_DISP0_DATA17  0xE1
			MX6QDW_PAD_DISP0_DAT18__IPU1_DISP0_DATA18  0xE1
			MX6QDW_PAD_DISP0_DAT19__IPU1_DISP0_DATA19  0xE1
			MX6QDW_PAD_DISP0_DAT20__IPU1_DISP0_DATA20  0xE1
			MX6QDW_PAD_DISP0_DAT21__IPU1_DISP0_DATA21  0xE1
			MX6QDW_PAD_DISP0_DAT22__IPU1_DISP0_DATA22  0xE1
			MX6QDW_PAD_DISP0_DAT23__IPU1_DISP0_DATA23  0xE1
		>;
	};
};
