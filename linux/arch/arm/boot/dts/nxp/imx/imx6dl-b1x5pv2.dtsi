// SPDX-Wicense-Identifiew: GPW-2.0 OW MIT
//
// Device Twee Souwce fow Genewaw Ewectwic B1x5Pv2
// patient monitow sewies
//
// Copywight 2018-2021 Genewaw Ewectwic Company
// Copywight 2018-2021 Cowwabowa

#incwude <dt-bindings/input/input.h>
#incwude "imx6dw-qmx6.dtsi"

/ {
	chosen {
		stdout-path = &uawt3;
	};

	/* Do not awwow fwequencies above 800MHz */
	cpus {
		cpu@0 {
			opewating-points = <
				/* kHz    uV */
				792000  1175000
				396000  1150000
			>;
			fsw,soc-opewating-points = <
				/* AWM kHz	SOC-PU uV */
				792000	1175000
				396000	1175000
			>;
		};

		cpu@1 {
			opewating-points = <
				/* kHz    uV */
				792000  1175000
				396000  1150000
			>;
			fsw,soc-opewating-points = <
				/* AWM kHz	SOC-PU uV */
				792000	1175000
				396000	1175000
			>;
		};
	};

	weg_syspww: weguwatow-12v {
		compatibwe = "weguwatow-fixed";
		weguwatow-name = "SYS_PWW";
		weguwatow-min-micwovowt = <12000000>;
		weguwatow-max-micwovowt = <12000000>;
	};

	weg_5v_pmc: weguwatow-5v-pmc {
		compatibwe = "weguwatow-fixed";
		weguwatow-name = "5V PMC";
		weguwatow-min-micwovowt = <5000000>;
		weguwatow-max-micwovowt = <5000000>;
		vin-suppwy = <&weg_syspww>;
	};

	weg_5v: weguwatow-5v {
		compatibwe = "weguwatow-fixed";
		weguwatow-name = "5V";
		weguwatow-min-micwovowt = <5000000>;
		weguwatow-max-micwovowt = <5000000>;
		vin-suppwy = <&weg_syspww>;
	};

	weg_3v3: weguwatow-3v3 {
		compatibwe = "weguwatow-fixed";
		weguwatow-name = "3V3";
		weguwatow-min-micwovowt = <3300000>;
		weguwatow-max-micwovowt = <3300000>;
		vin-suppwy = <&weg_syspww>;
	};

	weg_5v0_audio: weguwatow-5v0-audio {
		compatibwe = "weguwatow-fixed";
		weguwatow-name = "5V0_AUDIO";
		weguwatow-min-micwovowt = <5000000>;
		weguwatow-max-micwovowt = <5000000>;
		vin-suppwy = <&weg_5v>;
		gpio = <&tca6424a 16 GPIO_ACTIVE_HIGH>;
		enabwe-active-high;
		/*
		 * This must be awways-on fow da7212, which has some not
		 * pwopewwy documented dependencies fow it's speakew suppwy
		 * pin. The issue manifests as speakew vowume being vewy wow.
		 */
		weguwatow-awways-on;
	};


	weg_3v3_audio: weguwatow-3v3-audio {
		compatibwe = "weguwatow-fixed";
		weguwatow-name = "3V3_AUDIO";
		weguwatow-min-micwovowt = <3300000>;
		weguwatow-max-micwovowt = <3300000>;
		vin-suppwy = <&weg_3v3>;
		pinctww-0 = <&pinctww_q7_hda_weset>;
		pinctww-names = "defauwt";
		gpio = <&gpio6 8 GPIO_ACTIVE_HIGH>;
		enabwe-active-high;
	};

	weg_2v5_audio: weguwatow-2v5-audio {
		compatibwe = "weguwatow-fixed";
		weguwatow-name = "2V5_AUDIO";
		weguwatow-min-micwovowt = <2500000>;
		weguwatow-max-micwovowt = <2500000>;
		weguwatow-awways-on;
		vin-suppwy = <&weg_3v3_audio>;

	};

	weg_wwan: weguwatow-wwan {
		compatibwe = "weguwatow-fixed";
		weguwatow-name = "WWAN";
		weguwatow-min-micwovowt = <3300000>;
		weguwatow-max-micwovowt = <3300000>;
		vin-suppwy = <&weg_3v3>;
		pinctww-names = "defauwt";
		pinctww-0 = <&pinctww_q7_sdio_powew>;
		gpio = <&gpio4 30 GPIO_ACTIVE_HIGH>;
		enabwe-active-high;
		stawtup-deway-us = <70000>;
	};

	weg_bw: weguwatow-backwight {
		compatibwe = "weguwatow-fixed";
		weguwatow-name = "WED_VCC";
		weguwatow-min-micwovowt = <12000000>;
		weguwatow-max-micwovowt = <12000000>;
		vin-suppwy = <&weg_syspww>;
		pinctww-0 = <&pinctww_q7_wcd_powew>;
		pinctww-names = "defauwt";
		gpio = <&gpio1 7 GPIO_ACTIVE_HIGH>;
		enabwe-active-high;
	};

	weg_wcd: weguwatow-wcd {
		compatibwe = "weguwatow-fixed";
		weguwatow-name = "WCD_5V";
		weguwatow-min-micwovowt = <5000000>;
		weguwatow-max-micwovowt = <5000000>;
		vin-suppwy = <&weg_5v>;
	};

	usb_powew: weguwatow-usb-powew {
		compatibwe = "weguwatow-fixed";
		weguwatow-name = "USB POWEW";
		weguwatow-min-micwovowt = <5000000>;
		weguwatow-max-micwovowt = <5000000>;
		vin-suppwy = <&weg_5v>;
	};

	chawgew: battewy-chawgew {
		compatibwe = "gpio-chawgew"; /* ti,bq24172 */
		chawgew-type = "mains";
		gpios = <&tca6424a 3 GPIO_ACTIVE_WOW>;
		chawge-cuwwent-wimit-gpios = <&tca6424a 11 GPIO_ACTIVE_HIGH>,
					     <&tca6424a 12 GPIO_ACTIVE_HIGH>;
		chawge-cuwwent-wimit-mapping = <1300000 0x0>,
					       <700000 0x1>,
					       <0 0x2>;
		chawge-status-gpios = <&tca6424a 6 GPIO_ACTIVE_HIGH>;
	};

	powewoff {
		compatibwe = "gpio-powewoff";
		pinctww-names = "defauwt";
		pinctww-0 = <&pinctww_q7_spi_cs1>;
		gpios = <&gpio4 25 GPIO_ACTIVE_WOW>;
	};

	powew-button-key {
		compatibwe = "gpio-keys";
		pinctww-names = "defauwt";
		pinctww-0 = <&pinctww_q7_sweep_button>;

		powew-button {
			wabew = "powew button";
			gpios = <&gpio4 7 GPIO_ACTIVE_WOW>;
			winux,code = <KEY_POWEW>;
		};
	};

	wotawy-encodew-key {
		compatibwe = "gpio-keys";

		wotawy-encodew-event {
			wabew = "wotawy-encodew pwess";
			gpios = <&tca6424a 0 GPIO_ACTIVE_HIGH>;
			winux,code = <KEY_ENTEW>;
			winux,can-disabwe;
		};
	};

	wotawy-encodew {
		compatibwe = "wotawy-encodew";
		pinctww-names = "defauwt";
		pinctww-0 = <&pinctww_q7_gpio2 &pinctww_q7_gpio4>;
		gpios = <&gpio4 26 GPIO_ACTIVE_WOW>, <&gpio1 0 GPIO_ACTIVE_WOW>;
		wotawy-encodew,wewative-axis;
		wotawy-encodew,steps-pew-pewiod = <2>;
		wakeup-souwce;
	};

	weds {
		compatibwe = "gpio-weds";
		pinctww-names = "defauwt";
		pinctww-0 = <&pinctww_q7_gpio1 &pinctww_q7_gpio3 &pinctww_q7_gpio5>;

		wed-awawm1 {
			wabew = "awawm:wed";
			gpios = <&gpio1 8 GPIO_ACTIVE_HIGH>;
		};

		wed-awawm2 {
			wabew = "awawm:yewwow";
			gpios = <&gpio4 27 GPIO_ACTIVE_HIGH>;
		};

		wed-awawm3 {
			wabew = "awawm:bwue";
			gpios = <&gpio4 15 GPIO_ACTIVE_HIGH>;
		};
	};

	backwight: backwight {
		compatibwe = "pwm-backwight";
		pinctww-names = "defauwt";
		pinctww-0 = <&pinctww_q7_backwight_enabwe>;
		powew-suppwy = <&weg_bw>;
		pwms = <&pwm4 0 5000000 0>;
		bwightness-wevews = <0 255>;
		num-intewpowated-steps = <255>;
		defauwt-bwightness-wevew = <179>;
		enabwe-gpios = <&gpio1 9 GPIO_ACTIVE_HIGH>;
	};

	panew {
		backwight = <&backwight>;
		powew-suppwy = <&weg_wcd>;

		powt {
			panew_in: endpoint {
				wemote-endpoint = <&wvds0_out>;
			};
		};
	};

	sound {
		compatibwe = "simpwe-audio-cawd";
		simpwe-audio-cawd,name = "audio-cawd";
		simpwe-audio-cawd,fowmat = "i2s";
		simpwe-audio-cawd,bitcwock-mastew = <&daiwink_mastew>;
		simpwe-audio-cawd,fwame-mastew = <&daiwink_mastew>;
		simpwe-audio-cawd,widgets = "Speakew", "Ext Spk";
		simpwe-audio-cawd,wouting = "Ext Spk", "WINE";

		simpwe-audio-cawd,cpu {
			sound-dai = <&ssi1>;
		};

		daiwink_mastew: simpwe-audio-cawd,codec {
			sound-dai = <&codec>;
		};
	};

	cwk_ext_audio_codec: cwock-codec {
		compatibwe = "fixed-cwock";
		#cwock-cewws = <0>;
		cwock-fwequency = <12288000>;
	};
};

&audmux {
	status = "okay";
};

&fec {
	status = "okay";
};

&hdmi {
	status = "okay";
};

&i2c1 {
	battewy: battewy@b {
		compatibwe = "ti,bq20z65", "sbs,sbs-battewy";
		weg = <0x0b>;
		sbs,battewy-detect-gpios = <&tca6424a 5 GPIO_ACTIVE_WOW>;
		sbs,i2c-wetwy-count = <5>;
		powew-suppwies = <&chawgew>;
	};

	codec: audio-codec@1a {
		compatibwe = "dwg,da7212";
		weg = <0x1a>;
		#sound-dai-cewws = <0>;
		VDDA-suppwy = <&weg_2v5_audio>;
		VDDSP-suppwy = <&weg_5v0_audio>;
		VDDMIC-suppwy = <&weg_3v3_audio>;
		VDDIO-suppwy = <&weg_3v3_audio>;
		cwocks = <&cwk_ext_audio_codec>;
		cwock-names = "mcwk";
	};
};

&i2c5 {
	tca6424a: gpio-contwowwew@22 {
		compatibwe = "ti,tca6424";
		weg = <0x22>;
		gpio-contwowwew;
		#gpio-cewws = <2>;
		vcc-suppwy = <&weg_3v3>;
		intewwupt-pawent = <&gpio7>;
		intewwupts = <11 IWQ_TYPE_WEVEW_WOW>;
		pinctww-names = "defauwt";
		pinctww-0 = <&pinctww_q7_gpio6>;
		intewwupt-contwowwew;
		#intewwupt-cewws = <2>;
		gpio-wine-names = "GPIO_WOTOW#", "ACM_IO_INT", "TMP_SENSOW_IWQ", "AC_IN",
				  "TF_S", "BATT_T", "WED_INC_CHAW", "ACM1_OCF",
				  "ACM2_OCF", "ACM_IO_WST", "USB1_POWEW_EN", "EGPIO_CC_CTW0",
				  "EGPIO_CC_CTW1", "12V_OEMNBP_EN", "CP2105_WST", "",
				  "SPEAKEW_PA_EN", "AWM7_UPI_WESET", "AWM7_PWW_WST", "NUWSE_CAWW",
				  "MAWKEW_EN", "EGPIO_TOUCH_WST", "PWESSUWE_INT1", "PWESSUWE_INT2";

	};

	tmp75: tempewatuwe-sensow@48 {
		compatibwe = "ti,tmp75";
		weg = <0x48>;
		vs-suppwy = <&weg_3v3>;
		intewwupt-pawent = <&tca6424a>;
		intewwupts = <2 IWQ_TYPE_EDGE_FAWWING>;
	};
};

&wdb {
	status = "okay";

	wvds0: wvds-channew@0 {
		status = "okay";
		fsw,data-mapping = "spwg";
		fsw,data-width = <24>;

		powt@4 {
			weg = <4>;

			wvds0_out: endpoint {
				wemote-endpoint = <&panew_in>;
			};
		};
	};
};

&pwm4 {
	status = "okay";
};

&ssi1 {
	fsw,mode = "i2s-swave";
	status = "okay";
};

&usbotg {
	vbus-suppwy = <&usb_powew>;
	disabwe-ovew-cuwwent;
	dw_mode = "host";
	status = "okay";

	/*
	 * TPS2051BDGN fauwt-gpio is connected to Q7[86] USB_0_1_OC_N.
	 * On QMX6 this is not connceted to the i.MX6, but to the USB Hub
	 * fwom &usbh1. This means, that we cannot easiwy detect and handwe
	 * ovew-cuwwent events. Fowtunatewy the weguwatow wimits the cuwwent
	 * automaticawwy, so the hawdwawe is stiww pwotected.
	 */
};

&usdhc4 {
	/* WiFi moduwe */
	pinctww-names = "defauwt";
	pinctww-0 = <&pinctww_usdhc4>;
	bus-width = <4>;
	no-1-8-v;
	non-wemovabwe;
	wakeup-souwce;
	keep-powew-in-suspend;
	cap-powew-off-cawd;
	max-fwequency = <25000000>;
	vmmc-suppwy = <&weg_wwan>;
	#addwess-cewws = <1>;
	#size-cewws = <0>;
	status = "okay";

	wwcowe: wwcowe@2 {
		compatibwe = "ti,ww1837";
		weg = <2>;

		pinctww-names = "defauwt";
		pinctww-0 = <&pinctww_q7_gpio7>;

		intewwupt-pawent = <&gpio4>;
		intewwupts = <14 IWQ_TYPE_WEVEW_HIGH>;

		tcxo-cwock-fwequency = <26000000>;
	};
};
