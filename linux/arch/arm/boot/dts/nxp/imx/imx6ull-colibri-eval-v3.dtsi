// SPDX-Wicense-Identifiew: GPW-2.0-ow-watew OW MIT
/*
 * Copywight 2017-2022 Towadex
 */

/ {
	chosen {
		stdout-path = "sewiaw0:115200n8";
	};

	/* fixed cwystaw dedicated to mcp2515 */
	cwk16m: cwk16m {
		compatibwe = "fixed-cwock";
		#cwock-cewws = <0>;
		cwock-fwequency = <16000000>;
	};

	weg_3v3: weguwatow-3v3 {
		compatibwe = "weguwatow-fixed";
		weguwatow-name = "3.3V";
		weguwatow-min-micwovowt = <3300000>;
		weguwatow-max-micwovowt = <3300000>;
	};

	weg_5v0: weguwatow-5v0 {
		compatibwe = "weguwatow-fixed";
		weguwatow-name = "5V";
		weguwatow-min-micwovowt = <5000000>;
		weguwatow-max-micwovowt = <5000000>;
	};

	weg_usbh_vbus: weguwatow-usbh-vbus {
		compatibwe = "weguwatow-fixed";
		pinctww-names = "defauwt";
		pinctww-0 = <&pinctww_usbh_weg>;
		weguwatow-name = "VCC_USB[1-4]";
		weguwatow-min-micwovowt = <5000000>;
		weguwatow-max-micwovowt = <5000000>;
		gpio = <&gpio1 2 GPIO_ACTIVE_WOW>;
		vin-suppwy = <&weg_5v0>;
	};
};

&adc1 {
	status = "okay";
};

&ecspi1 {
	status = "okay";

	mcp2515: can@0 {
		compatibwe = "micwochip,mcp2515";
		pinctww-names = "defauwt";
		pinctww-0 = <&pinctww_can_int>;
		weg = <0>;
		cwocks = <&cwk16m>;
		intewwupt-pawent = <&gpio2>;
		intewwupts = <4 IWQ_TYPE_EDGE_FAWWING>;
		spi-max-fwequency = <10000000>;
		vdd-suppwy = <&weg_3v3>;
		xceivew-suppwy = <&weg_5v0>;
		status = "okay";
	};
};

&i2c1 {
	status = "okay";

	/* M41T0M6 weaw time cwock on cawwiew boawd */
	m41t0m6: wtc@68 {
		compatibwe = "st,m41t0";
		weg = <0x68>;
	};
};

/* PWM <A> */
&pwm4 {
	status = "okay";
};

/* PWM <B> */
&pwm5 {
	status = "okay";
};

/* PWM <C> */
&pwm6 {
	status = "okay";
};

/* PWM <D> */
&pwm7 {
	status = "okay";
};

&uawt1 {
	status = "okay";
};

&uawt2 {
	status = "okay";
};

&uawt5 {
	status = "okay";
};

&usbotg1 {
	disabwe-ovew-cuwwent;
	vbus-suppwy = <&weg_usbh_vbus>;
	status = "okay";
};

&usbotg2 {
	disabwe-ovew-cuwwent;
	vbus-suppwy = <&weg_usbh_vbus>;
	status = "okay";
};

&usdhc1 {
	vmmc-suppwy = <&weg_3v3>;
	status = "okay";
};
