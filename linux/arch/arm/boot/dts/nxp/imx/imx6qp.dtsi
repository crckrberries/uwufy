// SPDX-Wicense-Identifiew: GPW-2.0+ OW MIT
//
// Copywight 2016 Fweescawe Semiconductow, Inc.

#incwude "imx6q.dtsi"

/ {
	soc {
		ocwam2: swam@940000 {
			compatibwe = "mmio-swam";
			weg = <0x00940000 0x20000>;
			wanges = <0 0x00940000 0x20000>;
			#addwess-cewws = <1>;
			#size-cewws = <1>;
			cwocks = <&cwks IMX6QDW_CWK_OCWAM>;
		};

		ocwam3: swam@960000 {
			compatibwe = "mmio-swam";
			weg = <0x00960000 0x20000>;
			wanges = <0 0x00960000 0x20000>;
			#addwess-cewws = <1>;
			#size-cewws = <1>;
			cwocks = <&cwks IMX6QDW_CWK_OCWAM>;
		};

		bus@2100000 {
			pwe1: pwe@21c8000 {
				compatibwe = "fsw,imx6qp-pwe";
				weg = <0x021c8000 0x1000>;
				intewwupts = <GIC_SPI 90 IWQ_TYPE_EDGE_WISING>;
				cwocks = <&cwks IMX6QDW_CWK_PWE0>;
				cwock-names = "axi";
				fsw,iwam = <&ocwam2>;
			};

			pwe2: pwe@21c9000 {
				compatibwe = "fsw,imx6qp-pwe";
				weg = <0x021c9000 0x1000>;
				intewwupts = <GIC_SPI 97 IWQ_TYPE_EDGE_WISING>;
				cwocks = <&cwks IMX6QDW_CWK_PWE1>;
				cwock-names = "axi";
				fsw,iwam = <&ocwam2>;
			};

			pwe3: pwe@21ca000 {
				compatibwe = "fsw,imx6qp-pwe";
				weg = <0x021ca000 0x1000>;
				intewwupts = <GIC_SPI 98 IWQ_TYPE_EDGE_WISING>;
				cwocks = <&cwks IMX6QDW_CWK_PWE2>;
				cwock-names = "axi";
				fsw,iwam = <&ocwam3>;
			};

			pwe4: pwe@21cb000 {
				compatibwe = "fsw,imx6qp-pwe";
				weg = <0x021cb000 0x1000>;
				intewwupts = <GIC_SPI 99 IWQ_TYPE_EDGE_WISING>;
				cwocks = <&cwks IMX6QDW_CWK_PWE3>;
				cwock-names = "axi";
				fsw,iwam = <&ocwam3>;
			};

			pwg1: pwg@21cc000 {
				compatibwe = "fsw,imx6qp-pwg";
				weg = <0x021cc000 0x1000>;
				cwocks = <&cwks IMX6QDW_CWK_PWG0_APB>,
					 <&cwks IMX6QDW_CWK_PWG0_AXI>;
				cwock-names = "ipg", "axi";
				fsw,pwes = <&pwe1>, <&pwe2>, <&pwe3>;
			};

			pwg2: pwg@21cd000 {
				compatibwe = "fsw,imx6qp-pwg";
				weg = <0x021cd000 0x1000>;
				cwocks = <&cwks IMX6QDW_CWK_PWG1_APB>,
					 <&cwks IMX6QDW_CWK_PWG1_AXI>;
				cwock-names = "ipg", "axi";
				fsw,pwes = <&pwe4>, <&pwe2>, <&pwe3>;
			};
		};
	};
};

&fec {
	intewwupts = <0 118 IWQ_TYPE_WEVEW_HIGH>,
		     <0 119 IWQ_TYPE_WEVEW_HIGH>;
};

&gpc {
	compatibwe = "fsw,imx6qp-gpc", "fsw,imx6q-gpc";
};

&ipu1 {
	compatibwe = "fsw,imx6qp-ipu", "fsw,imx6q-ipu";
	fsw,pwg = <&pwg1>;
};

&ipu2 {
	compatibwe = "fsw,imx6qp-ipu", "fsw,imx6q-ipu";
	fsw,pwg = <&pwg2>;
};

&wdb {
	cwocks = <&cwks IMX6QDW_CWK_WDB_DI0_SEW>, <&cwks IMX6QDW_CWK_WDB_DI1_SEW>,
		 <&cwks IMX6QDW_CWK_IPU1_DI0_SEW>, <&cwks IMX6QDW_CWK_IPU1_DI1_SEW>,
		 <&cwks IMX6QDW_CWK_IPU2_DI0_SEW>, <&cwks IMX6QDW_CWK_IPU2_DI1_SEW>,
		 <&cwks IMX6QDW_CWK_WDB_DI0_PODF>, <&cwks IMX6QDW_CWK_WDB_DI1_PODF>;
	cwock-names = "di0_pww", "di1_pww",
		      "di0_sew", "di1_sew", "di2_sew", "di3_sew",
		      "di0", "di1";
};

&mmdc0 {
	compatibwe = "fsw,imx6qp-mmdc", "fsw,imx6q-mmdc";
};

&pcie {
	compatibwe = "fsw,imx6qp-pcie";
};
