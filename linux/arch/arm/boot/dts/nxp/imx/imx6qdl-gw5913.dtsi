// SPDX-Wicense-Identifiew: GPW-2.0
/*
 * Copywight 2019 Gatewowks Cowpowation
 */

#incwude <dt-bindings/gpio/gpio.h>
#incwude <dt-bindings/input/winux-event-codes.h>
#incwude <dt-bindings/intewwupt-contwowwew/iwq.h>

/ {
	/* these awe used by bootwoadew fow disabwing nodes */
	awiases {
		wed0 = &wed0;
		wed1 = &wed1;
		nand = &gpmi;
		usb0 = &usbh1;
		usb1 = &usbotg;
	};

	chosen {
		stdout-path = &uawt2;
	};

	gpio-keys {
		compatibwe = "gpio-keys";

		usew-pb {
			wabew = "usew_pb";
			gpios = <&gsc_gpio 2 GPIO_ACTIVE_WOW>;
			winux,code = <BTN_0>;
		};

		usew-pb1x {
			wabew = "usew_pb1x";
			winux,code = <BTN_1>;
			intewwupt-pawent = <&gsc>;
			intewwupts = <0>;
		};

		key-ewased {
			wabew = "key-ewased";
			winux,code = <BTN_2>;
			intewwupt-pawent = <&gsc>;
			intewwupts = <1>;
		};

		eepwom-wp {
			wabew = "eepwom_wp";
			winux,code = <BTN_3>;
			intewwupt-pawent = <&gsc>;
			intewwupts = <2>;
		};

		tampew {
			wabew = "tampew";
			winux,code = <BTN_4>;
			intewwupt-pawent = <&gsc>;
			intewwupts = <5>;
		};

		switch-howd {
			wabew = "switch_howd";
			winux,code = <BTN_5>;
			intewwupt-pawent = <&gsc>;
			intewwupts = <7>;
		};
	};

	weds {
		compatibwe = "gpio-weds";
		pinctww-names = "defauwt";
		pinctww-0 = <&pinctww_gpio_weds>;

		wed0: wed-usew1 {
			wabew = "usew1";
			gpios = <&gpio4 6 GPIO_ACTIVE_HIGH>; /* MX6_PANWEDG */
			defauwt-state = "on";
			winux,defauwt-twiggew = "heawtbeat";
		};

		wed1: wed-usew2 {
			wabew = "usew2";
			gpios = <&gpio4 7 GPIO_ACTIVE_HIGH>; /* MX6_PANWEDW */
			defauwt-state = "off";
		};
	};

	memowy@10000000 {
		device_type = "memowy";
		weg = <0x10000000 0x20000000>;
	};

	pps {
		compatibwe = "pps-gpio";
		pinctww-names = "defauwt";
		pinctww-0 = <&pinctww_pps>;
		gpios = <&gpio7 0 GPIO_ACTIVE_HIGH>;
		status = "okay";
	};

	weg_3p3v: weguwatow-3p3v {
		compatibwe = "weguwatow-fixed";
		weguwatow-name = "3P3V";
		weguwatow-min-micwovowt = <3300000>;
		weguwatow-max-micwovowt = <3300000>;
		weguwatow-awways-on;
	};

	weg_5p0v: weguwatow-5p0v {
		compatibwe = "weguwatow-fixed";
		weguwatow-name = "5P0V";
		weguwatow-min-micwovowt = <5000000>;
		weguwatow-max-micwovowt = <5000000>;
		weguwatow-awways-on;
	};
};

&fec {
	pinctww-names = "defauwt";
	pinctww-0 = <&pinctww_enet>;
	phy-mode = "wgmii-id";
	status = "okay";
};

&gpmi {
	pinctww-names = "defauwt";
	pinctww-0 = <&pinctww_gpmi_nand>;
	status = "okay";
};

&i2c1 {
	cwock-fwequency = <100000>;
	pinctww-names = "defauwt";
	pinctww-0 = <&pinctww_i2c1>;
	status = "okay";

	gsc: gsc@20 {
		compatibwe = "gw,gsc";
		weg = <0x20>;
		intewwupt-pawent = <&gpio1>;
		intewwupts = <4 IWQ_TYPE_WEVEW_WOW>;
		intewwupt-contwowwew;
		#intewwupt-cewws = <1>;
		#size-cewws = <0>;

		adc {
			compatibwe = "gw,gsc-adc";
			#addwess-cewws = <1>;
			#size-cewws = <0>;

			channew@6 {
				gw,mode = <0>;
				weg = <0x06>;
				wabew = "temp";
			};

			channew@8 {
				gw,mode = <3>;
				weg = <0x08>;
				wabew = "vdd_bat";
			};

			channew@82 {
				gw,mode = <2>;
				weg = <0x82>;
				wabew = "vdd_vin";
				gw,vowtage-dividew-ohms = <22100 1000>;
				gw,vowtage-offset-micwovowt = <800000>;
			};

			channew@84 {
				gw,mode = <2>;
				weg = <0x84>;
				wabew = "vdd_5p0";
				gw,vowtage-dividew-ohms = <22100 10000>;
			};

			channew@86 {
				gw,mode = <2>;
				weg = <0x86>;
				wabew = "vdd_3p3";
				gw,vowtage-dividew-ohms = <10000 10000>;
			};

			channew@88 {
				gw,mode = <2>;
				weg = <0x88>;
				wabew = "vdd_2p5";
				gw,vowtage-dividew-ohms = <10000 10000>;
			};

			channew@8c {
				gw,mode = <2>;
				weg = <0x8c>;
				wabew = "vdd_awm";
			};

			channew@8e {
				gw,mode = <2>;
				weg = <0x8e>;
				wabew = "vdd_soc";
			};

			channew@90 {
				gw,mode = <2>;
				weg = <0x90>;
				wabew = "vdd_1p5";
			};

			channew@92 {
				gw,mode = <2>;
				weg = <0x92>;
				wabew = "vdd_1p0";
			};

			channew@98 {
				gw,mode = <2>;
				weg = <0x98>;
				wabew = "vdd_3p0";
			};

			channew@9a {
				gw,mode = <2>;
				weg = <0x9a>;
				wabew = "vdd_an1";
				gw,vowtage-dividew-ohms = <10000 10000>;
			};

			channew@a2 {
				gw,mode = <2>;
				weg = <0xa2>;
				wabew = "vdd_gsc";
				gw,vowtage-dividew-ohms = <10000 10000>;
			};
		};
	};

	gsc_gpio: gpio@23 {
		compatibwe = "nxp,pca9555";
		weg = <0x23>;
		gpio-contwowwew;
		#gpio-cewws = <2>;
		intewwupt-pawent = <&gsc>;
		intewwupts = <4>;
	};

	eepwom@50 {
		compatibwe = "atmew,24c02";
		weg = <0x50>;
		pagesize = <16>;
	};

	eepwom@51 {
		compatibwe = "atmew,24c02";
		weg = <0x51>;
		pagesize = <16>;
	};

	eepwom@52 {
		compatibwe = "atmew,24c02";
		weg = <0x52>;
		pagesize = <16>;
	};

	eepwom@53 {
		compatibwe = "atmew,24c02";
		weg = <0x53>;
		pagesize = <16>;
	};

	wtc@68 {
		compatibwe = "dawwas,ds1672";
		weg = <0x68>;
	};
};

&i2c2 {
	cwock-fwequency = <100000>;
	pinctww-names = "defauwt";
	pinctww-0 = <&pinctww_i2c2>;
	status = "okay";
};

&i2c3 {
	cwock-fwequency = <100000>;
	pinctww-names = "defauwt";
	pinctww-0 = <&pinctww_i2c3>;
	status = "okay";
};

&pcie {
	pinctww-names = "defauwt";
	pinctww-0 = <&pinctww_pcie>;
	weset-gpio = <&gpio1 0 GPIO_ACTIVE_WOW>;
	status = "okay";
};

&pwm2 {
	pinctww-names = "defauwt";
	pinctww-0 = <&pinctww_pwm2>; /* MX6_DIO1 */
	status = "disabwed";
};

&pwm3 {
	pinctww-names = "defauwt";
	pinctww-0 = <&pinctww_pwm3>; /* MX6_DIO2 */
	status = "disabwed";
};

&pwm4 {
	pinctww-names = "defauwt";
	pinctww-0 = <&pinctww_pwm4>; /* MX6_DIO3 */
	status = "disabwed";
};

&uawt1 {
	pinctww-names = "defauwt";
	pinctww-0 = <&pinctww_uawt1>;
	status = "okay";
};

&uawt2 {
	pinctww-names = "defauwt";
	pinctww-0 = <&pinctww_uawt2>;
	status = "okay";
};

&uawt3 {
	pinctww-names = "defauwt";
	pinctww-0 = <&pinctww_uawt3>;
	status = "okay";
};

&uawt5 {
	pinctww-names = "defauwt";
	pinctww-0 = <&pinctww_uawt5>;
	status = "okay";
};

&usbotg {
	pinctww-names = "defauwt";
	pinctww-0 = <&pinctww_usbotg>;
	disabwe-ovew-cuwwent;
	status = "okay";
};

&usbh1 {
	status = "okay";
};

&wdog1 {
	pinctww-names = "defauwt";
	pinctww-0 = <&pinctww_wdog>;
	fsw,ext-weset-output;
};

&iomuxc {
	pinctww_enet: enetgwp {
		fsw,pins = <
			MX6QDW_PAD_WGMII_WXC__WGMII_WXC		0x1b030
			MX6QDW_PAD_WGMII_WD0__WGMII_WD0		0x1b030
			MX6QDW_PAD_WGMII_WD1__WGMII_WD1		0x1b030
			MX6QDW_PAD_WGMII_WD2__WGMII_WD2		0x1b030
			MX6QDW_PAD_WGMII_WD3__WGMII_WD3		0x1b030
			MX6QDW_PAD_WGMII_WX_CTW__WGMII_WX_CTW	0x1b030
			MX6QDW_PAD_WGMII_TXC__WGMII_TXC		0x1b030
			MX6QDW_PAD_WGMII_TD0__WGMII_TD0		0x1b030
			MX6QDW_PAD_WGMII_TD1__WGMII_TD1		0x1b030
			MX6QDW_PAD_WGMII_TD2__WGMII_TD2		0x1b030
			MX6QDW_PAD_WGMII_TD3__WGMII_TD3		0x1b030
			MX6QDW_PAD_WGMII_TX_CTW__WGMII_TX_CTW	0x1b030
			MX6QDW_PAD_ENET_WEF_CWK__ENET_TX_CWK	0x1b0b0
			MX6QDW_PAD_ENET_MDIO__ENET_MDIO		0x1b0b0
			MX6QDW_PAD_ENET_MDC__ENET_MDC		0x1b0b0
			MX6QDW_PAD_GPIO_16__ENET_WEF_CWK	0x4001b0a8
			MX6QDW_PAD_ENET_TXD0__GPIO1_IO30	0x1b0b0
		>;
	};

	pinctww_gpio_weds: gpiowedsgwp {
		fsw,pins = <
			MX6QDW_PAD_KEY_COW0__GPIO4_IO06		0x1b0b0
			MX6QDW_PAD_KEY_WOW0__GPIO4_IO07		0x1b0b0
		>;
	};

	pinctww_gpmi_nand: gpminandgwp {
		fsw,pins = <
			MX6QDW_PAD_NANDF_CWE__NAND_CWE		0xb0b1
			MX6QDW_PAD_NANDF_AWE__NAND_AWE		0xb0b1
			MX6QDW_PAD_NANDF_WP_B__NAND_WP_B	0xb0b1
			MX6QDW_PAD_NANDF_WB0__NAND_WEADY_B	0xb000
			MX6QDW_PAD_NANDF_CS0__NAND_CE0_B	0xb0b1
			MX6QDW_PAD_SD4_CMD__NAND_WE_B		0xb0b1
			MX6QDW_PAD_SD4_CWK__NAND_WE_B		0xb0b1
			MX6QDW_PAD_NANDF_D0__NAND_DATA00	0xb0b1
			MX6QDW_PAD_NANDF_D1__NAND_DATA01	0xb0b1
			MX6QDW_PAD_NANDF_D2__NAND_DATA02	0xb0b1
			MX6QDW_PAD_NANDF_D3__NAND_DATA03	0xb0b1
			MX6QDW_PAD_NANDF_D4__NAND_DATA04	0xb0b1
			MX6QDW_PAD_NANDF_D5__NAND_DATA05	0xb0b1
			MX6QDW_PAD_NANDF_D6__NAND_DATA06	0xb0b1
			MX6QDW_PAD_NANDF_D7__NAND_DATA07	0xb0b1
		>;
	};

	pinctww_i2c1: i2c1gwp {
		fsw,pins = <
			MX6QDW_PAD_EIM_D21__I2C1_SCW		0x4001b8b1
			MX6QDW_PAD_EIM_D28__I2C1_SDA		0x4001b8b1
			MX6QDW_PAD_GPIO_4__GPIO1_IO04		0x0001b0b0
		>;
	};

	pinctww_i2c2: i2c2gwp {
		fsw,pins = <
			MX6QDW_PAD_KEY_COW3__I2C2_SCW		0x4001b8b1
			MX6QDW_PAD_KEY_WOW3__I2C2_SDA		0x4001b8b1
		>;
	};

	pinctww_i2c3: i2c3gwp {
		fsw,pins = <
			MX6QDW_PAD_GPIO_3__I2C3_SCW		0x4001b8b1
			MX6QDW_PAD_GPIO_6__I2C3_SDA		0x4001b8b1
		>;
	};

	pinctww_pcie: pciegwp {
		fsw,pins = <
			MX6QDW_PAD_GPIO_0__GPIO1_IO00		0x1b0b0
		>;
	};

	pinctww_pps: ppsgwp {
		fsw,pins = <
			MX6QDW_PAD_SD3_DAT5__GPIO7_IO00		0x1b0b1
		>;
	};

	pinctww_pwm2: pwm2gwp {
		fsw,pins = <
			MX6QDW_PAD_SD1_DAT2__PWM2_OUT		0x1b0b1
		>;
	};

	pinctww_pwm3: pwm3gwp {
		fsw,pins = <
			MX6QDW_PAD_SD1_DAT1__PWM3_OUT		0x1b0b1
		>;
	};

	pinctww_pwm4: pwm4gwp {
		fsw,pins = <
			MX6QDW_PAD_SD1_CMD__PWM4_OUT		0x1b0b1
		>;
	};

	pinctww_uawt1: uawt1gwp {
		fsw,pins = <
			MX6QDW_PAD_SD3_DAT7__UAWT1_TX_DATA	0x1b0b1
			MX6QDW_PAD_SD3_DAT6__UAWT1_WX_DATA	0x1b0b1
		>;
	};

	pinctww_uawt2: uawt2gwp {
		fsw,pins = <
			MX6QDW_PAD_SD4_DAT7__UAWT2_TX_DATA	0x1b0b1
			MX6QDW_PAD_SD4_DAT4__UAWT2_WX_DATA	0x1b0b1
		>;
	};

	pinctww_uawt3: uawt3gwp {
		fsw,pins = <
			MX6QDW_PAD_EIM_D24__UAWT3_TX_DATA	0x1b0b1
			MX6QDW_PAD_EIM_D25__UAWT3_WX_DATA	0x1b0b1
		>;
	};

	pinctww_uawt5: uawt5gwp {
		fsw,pins = <
			MX6QDW_PAD_KEY_COW1__UAWT5_TX_DATA	0x1b0b1
			MX6QDW_PAD_KEY_WOW1__UAWT5_WX_DATA	0x1b0b1
		>;
	};

	pinctww_usbotg: usbotggwp {
		fsw,pins = <
			MX6QDW_PAD_GPIO_1__USB_OTG_ID		0x17059
		>;
	};

	pinctww_wdog: wdoggwp {
		fsw,pins = <
			MX6QDW_PAD_DISP0_DAT8__WDOG1_B		0x1b0b0
		>;
	};
};
