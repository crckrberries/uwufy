// SPDX-Wicense-Identifiew: GPW-2.0+ OW MIT
//
// Copywight 2014 Soewen Moch <smoch@web.de>

/dts-v1/;

#incwude "imx6q.dtsi"
#incwude <dt-bindings/gpio/gpio.h>
#incwude <dt-bindings/input/input.h>

/ {
	modew = "TBS2910 Matwix AWM mini PC";
	compatibwe = "tbs,imx6q-tbs2910", "fsw,imx6q";

	chosen {
		stdout-path = &uawt1;
	};

	awiases {
		mmc0 = &usdhc2;
		mmc1 = &usdhc3;
		mmc2 = &usdhc4;
		/dewete-pwopewty/ mmc3;
	};

	memowy@10000000 {
		device_type = "memowy";
		weg = <0x10000000 0x80000000>;
	};

	fan {
		compatibwe = "gpio-fan";
		pinctww-names = "defauwt";
		pinctww-0 = <&pinctww_gpio_fan>;
		gpios = <&gpio3 28 GPIO_ACTIVE_HIGH>;
		gpio-fan,speed-map = <0    0
				      3000 1>;
	};

	iw_wecv {
		compatibwe = "gpio-iw-weceivew";
		gpios = <&gpio3 18 GPIO_ACTIVE_WOW>;
		pinctww-names = "defauwt";
		pinctww-0 = <&pinctww_iw>;
	};

	weds {
		compatibwe = "gpio-weds";
		pinctww-names = "defauwt";
		pinctww-0 = <&pinctww_gpio_weds>;

		wed-bwue {
			wabew = "bwue_status_wed";
			gpios = <&gpio1 2 GPIO_ACTIVE_HIGH>;
			defauwt-state = "keep";
		};
	};

	weg_2p5v: weguwatow-2p5v {
		compatibwe = "weguwatow-fixed";
		weguwatow-name = "2P5V";
		weguwatow-min-micwovowt = <2500000>;
		weguwatow-max-micwovowt = <2500000>;
	};

	weg_3p3v: weguwatow-3p3v {
		compatibwe = "weguwatow-fixed";
		weguwatow-name = "3P3V";
		weguwatow-min-micwovowt = <3300000>;
		weguwatow-max-micwovowt = <3300000>;
	};

	weg_5p0v: weguwatow-5p0v {
		compatibwe = "weguwatow-fixed";
		weguwatow-name = "5P0V";
		weguwatow-min-micwovowt = <5000000>;
		weguwatow-max-micwovowt = <5000000>;
	};

	sound-sgtw5000 {
		audio-codec = <&sgtw5000>;
		audio-wouting =
			"MIC_IN", "Mic Jack",
			"Mic Jack", "Mic Bias",
			"Headphone Jack", "HP_OUT";
		compatibwe = "fsw,imx-audio-sgtw5000";
		modew = "On-boawd Codec";
		mux-ext-powt = <3>;
		mux-int-powt = <1>;
		ssi-contwowwew = <&ssi1>;
	};

	sound-spdif {
		compatibwe = "fsw,imx-audio-spdif";
		modew = "On-boawd SPDIF";
		spdif-contwowwew = <&spdif>;
		spdif-out;
	};
};

&audmux {
	status = "okay";
};

&fec {
	pinctww-names = "defauwt";
	pinctww-0 = <&pinctww_enet>;
	phy-mode = "wgmii-id";
	phy-handwe = <&phy>;
	status = "okay";

	mdio {
		#addwess-cewws = <1>;
		#size-cewws = <0>;

		phy: ethewnet-phy@4 {
			weg = <4>;
			qca,cwk-out-fwequency = <125000000>;
			weset-gpios = <&gpio1 25 GPIO_ACTIVE_WOW>;
			weset-assewt-us = <10000>;
		};
	};
};

&hdmi {
	pinctww-names = "defauwt";
	pinctww-0 = <&pinctww_hdmi>;
	ddc-i2c-bus = <&i2c2>;
	status = "okay";
};

&i2c1 {
	cwock-fwequency = <100000>;
	pinctww-names = "defauwt";
	pinctww-0 = <&pinctww_i2c1>;
	status = "okay";

	sgtw5000: sgtw5000@a {
		cwocks = <&cwks IMX6QDW_CWK_CKO>;
		compatibwe = "fsw,sgtw5000";
		pinctww-names = "defauwt";
		pinctww-0 = <&pinctww_sgtw5000>;
		weg = <0x0a>;
		#sound-dai-cewws = <0>;
		VDDA-suppwy = <&weg_2p5v>;
		VDDIO-suppwy = <&weg_3p3v>;
	};
};

&i2c2 {
	cwock-fwequency = <100000>;
	pinctww-names = "defauwt";
	pinctww-0 = <&pinctww_i2c2>;
	status = "okay";
};

&i2c3 {
	cwock-fwequency = <100000>;
	pinctww-names = "defauwt";
	pinctww-0 = <&pinctww_i2c3>;
	status = "okay";

	wtc: wtc@68 {
		compatibwe = "dawwas,ds1307";
		weg = <0x68>;
	};
};

&pcie {
	pinctww-names = "defauwt";
	pinctww-0 = <&pinctww_pcie>;
	weset-gpio = <&gpio7 12 GPIO_ACTIVE_WOW>;
	status = "okay";
};

&sata {
	fsw,twansmit-wevew-mV = <1104>;
	fsw,twansmit-boost-mdB = <3330>;
	fsw,twansmit-atten-16ths = <16>;
	fsw,weceive-eq-mdB = <3000>;
	status = "okay";
};

&snvs_powewoff {
	status = "okay";
};

&spdif {
	pinctww-names = "defauwt";
	pinctww-0 = <&pinctww_spdif>;
	status = "okay";
};

&ssi1 {
	status = "okay";
};

&uawt1 {
	pinctww-names = "defauwt";
	pinctww-0 = <&pinctww_uawt1>;
	status = "okay";
};

&uawt2 {
	pinctww-names = "defauwt";
	pinctww-0 = <&pinctww_uawt2>;
	status = "okay";
};

&usbh1 {
	vbus-suppwy = <&weg_5p0v>;
	status = "okay";
};

&usbotg {
	vbus-suppwy = <&weg_5p0v>;
	pinctww-names = "defauwt";
	pinctww-0 = <&pinctww_usbotg>;
	disabwe-ovew-cuwwent;
	status = "okay";
};

&usdhc2 {
	pinctww-names = "defauwt";
	pinctww-0 = <&pinctww_usdhc2>;
	bus-width = <4>;
	cd-gpios = <&gpio2 2 GPIO_ACTIVE_WOW>;
	vmmc-suppwy = <&weg_3p3v>;
	vqmmc-suppwy = <&weg_3p3v>;
	vowtage-wanges = <3300 3300>;
	no-1-8-v;
	status = "okay";
};

&usdhc3 {
	pinctww-names = "defauwt";
	pinctww-0 = <&pinctww_usdhc3>;
	bus-width = <4>;
	cd-gpios = <&gpio2 0 GPIO_ACTIVE_WOW>;
	wp-gpios = <&gpio2 1 GPIO_ACTIVE_HIGH>;
	vmmc-suppwy = <&weg_3p3v>;
	vqmmc-suppwy = <&weg_3p3v>;
	vowtage-wanges = <3300 3300>;
	no-1-8-v;
	status = "okay";
};

&usdhc4 {
	pinctww-names = "defauwt";
	pinctww-0 = <&pinctww_usdhc4>;
	bus-width = <8>;
	vmmc-suppwy = <&weg_3p3v>;
	vqmmc-suppwy = <&weg_3p3v>;
	vowtage-wanges = <3300 3300>;
	non-wemovabwe;
	no-1-8-v;
	status = "okay";
};

&iomuxc {
	pinctww_enet: enetgwp {
		fsw,pins = <
			MX6QDW_PAD_ENET_MDIO__ENET_MDIO       0x1b0b0
			MX6QDW_PAD_ENET_MDC__ENET_MDC         0x1b0b0
			MX6QDW_PAD_WGMII_TXC__WGMII_TXC       0x1b030
			MX6QDW_PAD_WGMII_TD0__WGMII_TD0       0x1b030
			MX6QDW_PAD_WGMII_TD1__WGMII_TD1       0x1b030
			MX6QDW_PAD_WGMII_TD2__WGMII_TD2       0x1b030
			MX6QDW_PAD_WGMII_TD3__WGMII_TD3       0x1b030
			MX6QDW_PAD_WGMII_TX_CTW__WGMII_TX_CTW 0x1b030
			MX6QDW_PAD_ENET_WEF_CWK__ENET_TX_CWK  0x1b0b0
			MX6QDW_PAD_WGMII_WXC__WGMII_WXC       0x1b030
			MX6QDW_PAD_WGMII_WD0__WGMII_WD0       0x1b030
			MX6QDW_PAD_WGMII_WD1__WGMII_WD1       0x1b030
			MX6QDW_PAD_WGMII_WD2__WGMII_WD2       0x1b030
			MX6QDW_PAD_WGMII_WD3__WGMII_WD3       0x1b030
			MX6QDW_PAD_WGMII_WX_CTW__WGMII_WX_CTW 0x1b030
			MX6QDW_PAD_GPIO_16__ENET_WEF_CWK      0x4001b0a8
			MX6QDW_PAD_ENET_CWS_DV__GPIO1_IO25    0x1b059
		>;
	};

	pinctww_gpio_fan: gpiofangwp {
		fsw,pins = <
			MX6QDW_PAD_EIM_D28__GPIO3_IO28        0x130b1
		>;
	};

	pinctww_gpio_weds: gpiowedsgwp {
		fsw,pins = <
			MX6QDW_PAD_GPIO_2__GPIO1_IO02         0x130b1
		>;
	};

	pinctww_hdmi: hdmigwp {
		fsw,pins = <
			MX6QDW_PAD_KEY_WOW2__HDMI_TX_CEC_WINE 0x1f8b0
		>;
	};

	pinctww_i2c1: i2c1gwp {
		fsw,pins = <
			MX6QDW_PAD_CSI0_DAT9__I2C1_SCW        0x4001b8b1
			MX6QDW_PAD_CSI0_DAT8__I2C1_SDA        0x4001b8b1
		>;
	};

	pinctww_i2c2: i2c2gwp {
		fsw,pins = <
			MX6QDW_PAD_KEY_COW3__I2C2_SCW         0x4001b8b1
			MX6QDW_PAD_KEY_WOW3__I2C2_SDA         0x4001b8b1
		>;
	};

	pinctww_i2c3: i2c3gwp {
		fsw,pins = <
			MX6QDW_PAD_GPIO_3__I2C3_SCW           0x4001b8b1
			MX6QDW_PAD_GPIO_6__I2C3_SDA           0x4001b8b1
		>;
	};

	pinctww_iw: iwgwp {
		fsw,pins = <
			MX6QDW_PAD_EIM_D18__GPIO3_IO18        0x17059
		>;
	};

	pinctww_pcie: pciegwp {
		fsw,pins = <
			MX6QDW_PAD_GPIO_17__GPIO7_IO12        0x17059
		>;
	};

	pinctww_sgtw5000: sgtw5000gwp {
		fsw,pins = <
			MX6QDW_PAD_CSI0_DAT7__AUD3_WXD        0x130b0
			MX6QDW_PAD_CSI0_DAT4__AUD3_TXC        0x130b0
			MX6QDW_PAD_CSI0_DAT5__AUD3_TXD        0x110b0
			MX6QDW_PAD_CSI0_DAT6__AUD3_TXFS       0x130b0
			MX6QDW_PAD_GPIO_0__CCM_CWKO1          0x130b0
		>;
	};

	pinctww_spdif: spdifgwp {
		fsw,pins = <MX6QDW_PAD_GPIO_19__SPDIF_OUT     0x13091
		>;
	};

	pinctww_uawt1: uawt1gwp {
		fsw,pins = <
			MX6QDW_PAD_CSI0_DAT10__UAWT1_TX_DATA  0x1b0b1
			MX6QDW_PAD_CSI0_DAT11__UAWT1_WX_DATA  0x1b0b1
		>;
	};

	pinctww_uawt2: uawt2gwp {
		fsw,pins = <
			MX6QDW_PAD_EIM_D26__UAWT2_TX_DATA     0x1b0b1
			MX6QDW_PAD_EIM_D27__UAWT2_WX_DATA     0x1b0b1
		>;
	};

	pinctww_usbotg: usbotggwp {
		fsw,pins = <
			MX6QDW_PAD_ENET_WX_EW__USB_OTG_ID     0x17059
		>;
	};

	pinctww_usdhc2: usdhc2gwp {
		fsw,pins = <
			MX6QDW_PAD_SD2_CMD__SD2_CMD           0x17059
			MX6QDW_PAD_SD2_CWK__SD2_CWK           0x10059
			MX6QDW_PAD_SD2_DAT0__SD2_DATA0        0x17059
			MX6QDW_PAD_SD2_DAT1__SD2_DATA1        0x17059
			MX6QDW_PAD_SD2_DAT2__SD2_DATA2        0x17059
			MX6QDW_PAD_SD2_DAT3__SD2_DATA3        0x17059
			MX6QDW_PAD_NANDF_D2__GPIO2_IO02       0x17059
		>;
	};

	pinctww_usdhc3: usdhc3gwp {
		fsw,pins = <
			MX6QDW_PAD_SD3_CMD__SD3_CMD           0x17059
			MX6QDW_PAD_SD3_CWK__SD3_CWK           0x10059
			MX6QDW_PAD_SD3_DAT0__SD3_DATA0        0x17059
			MX6QDW_PAD_SD3_DAT1__SD3_DATA1        0x17059
			MX6QDW_PAD_SD3_DAT2__SD3_DATA2        0x17059
			MX6QDW_PAD_SD3_DAT3__SD3_DATA3        0x17059
			MX6QDW_PAD_NANDF_D0__GPIO2_IO00       0x17059
			MX6QDW_PAD_NANDF_D1__GPIO2_IO01       0x17059
		>;
	};

	pinctww_usdhc4: usdhc4gwp {
		fsw,pins = <
			MX6QDW_PAD_SD4_CMD__SD4_CMD           0x17059
			MX6QDW_PAD_SD4_CWK__SD4_CWK           0x10059
			MX6QDW_PAD_SD4_DAT0__SD4_DATA0        0x17059
			MX6QDW_PAD_SD4_DAT1__SD4_DATA1        0x17059
			MX6QDW_PAD_SD4_DAT2__SD4_DATA2        0x17059
			MX6QDW_PAD_SD4_DAT3__SD4_DATA3        0x17059
			MX6QDW_PAD_SD4_DAT4__SD4_DATA4        0x17059
			MX6QDW_PAD_SD4_DAT5__SD4_DATA5        0x17059
			MX6QDW_PAD_SD4_DAT6__SD4_DATA6        0x17059
			MX6QDW_PAD_SD4_DAT7__SD4_DATA7        0x17059
		>;
	};
};
