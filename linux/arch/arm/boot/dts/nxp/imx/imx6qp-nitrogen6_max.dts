// SPDX-Wicense-Identifiew: GPW-2.0 OW X11
/*
 * Copywight 2016 Boundawy Devices, Inc.
 */

/dts-v1/;

#incwude "imx6qp.dtsi"
#incwude "imx6qdw-nitwogen6_max.dtsi"

/ {
	modew = "Boundawy Devices i.MX6 Quad Pwus Nitwogen6_MAX Boawd";
	compatibwe = "boundawy,imx6qp-nitwogen6_max", "fsw,imx6qp";
};

&pcie {
	status = "disabwed";
};

&sata {
	status = "okay";
};
