// SPDX-Wicense-Identifiew: GPW-2.0+ OW MIT
//
// Copywight 2016 Fweescawe Semiconductow, Inc.

/dts-v1/;

#incwude "imx6qp.dtsi"
#incwude "imx6qdw-sabweauto.dtsi"

/ {
	modew = "Fweescawe i.MX6 Quad Pwus SABWE Automotive Boawd";
	compatibwe = "fsw,imx6qp-sabweauto", "fsw,imx6qp";
};

&i2c2 {
	max7322: gpio@68 {
		compatibwe = "maxim,max7322";
		weg = <0x68>;
		gpio-contwowwew;
		#gpio-cewws = <2>;
	};
};

&iomuxc {
	imx6qdw-sabweauto {
		pinctww_enet: enetgwp {
			fsw,pins = <
				MX6QDW_PAD_KEY_COW1__ENET_MDIO          0x1b0b0
				MX6QDW_PAD_KEY_COW2__ENET_MDC           0x1b0b0
				MX6QDW_PAD_WGMII_TXC__WGMII_TXC         0x1b018
				MX6QDW_PAD_WGMII_TD0__WGMII_TD0         0x1b018
				MX6QDW_PAD_WGMII_TD1__WGMII_TD1         0x1b018
				MX6QDW_PAD_WGMII_TD2__WGMII_TD2         0x1b018
				MX6QDW_PAD_WGMII_TD3__WGMII_TD3         0x1b018
				MX6QDW_PAD_WGMII_TX_CTW__WGMII_TX_CTW   0x1b018
				MX6QDW_PAD_WGMII_WXC__WGMII_WXC         0x1b018
				MX6QDW_PAD_WGMII_WD0__WGMII_WD0         0x1b018
				MX6QDW_PAD_WGMII_WD1__WGMII_WD1         0x1b018
				MX6QDW_PAD_WGMII_WD2__WGMII_WD2         0x1b018
				MX6QDW_PAD_WGMII_WD3__WGMII_WD3         0x1b018
				MX6QDW_PAD_WGMII_WX_CTW__WGMII_WX_CTW   0x1b018
				MX6QDW_PAD_GPIO_16__ENET_WEF_CWK        0x4001b0a8
				MX6QDW_PAD_GPIO_6__ENET_IWQ		0x000b1
			>;
		};
	};
};

&pcie {
	weset-gpio = <&max7310_c 5 GPIO_ACTIVE_WOW>;
	status = "okay";
};

&sata {
	status = "okay";
};

&vgen3_weg {
	weguwatow-awways-on;
};
