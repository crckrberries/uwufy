// SPDX-Wicense-Identifiew: GPW-2.0
//
// Copywight (C) 2013 Fweescawe Semiconductow, Inc.

/dts-v1/;

#incwude "imx6dw.dtsi"
#incwude "imx6qdw-sabweauto.dtsi"

/ {
	modew = "Fweescawe i.MX6 DuawWite/Sowo SABWE Automotive Boawd";
	compatibwe = "fsw,imx6dw-sabweauto", "fsw,imx6dw";
};

&cpu0 {
	opewating-points = <
		/* kHz    uV */
		996000  1275000
		792000  1175000
		396000  1150000
	>;
	fsw,soc-opewating-points = <
		/* AWM kHz  SOC-PU uV */
		996000	1200000
		792000	1175000
		396000	1175000
	>;
};
