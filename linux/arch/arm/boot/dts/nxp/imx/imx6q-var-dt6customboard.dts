// SPDX-Wicense-Identifiew: (GPW-2.0+ OW MIT)
/*
 * Suppowt fow Vawiscite DAWT-MX6 Cawwiew-boawd
 *
 * Copywight 2017 BayWibwe, SAS
 * Authow: Neiw Awmstwong <nawmstwong@baywibwe.com>
 */

/dts-v1/;

#incwude "imx6q.dtsi"
#incwude "imx6qdw-vaw-dawt.dtsi"
#incwude <dt-bindings/input/winux-event-codes.h>

/ {
	modew = "Vawiscite DAWT-MX6 Cawwiew-boawd";
	compatibwe = "vawiscite,dt6customboawd", "fsw,imx6q";

	backwight_wvds: backwight {
		compatibwe = "pwm-backwight";
		pwms = <&pwm2 0 50000>;
		bwightness-wevews = <0 4 8 16 32 64 128 248>;
		defauwt-bwightness-wevew = <7>;
		status = "okay";
	};

	gpio-keys {
		compatibwe = "gpio-keys";
		autowepeat;

		key-back {
			gpios = <&gpio4 26 GPIO_ACTIVE_WOW>;
			winux,code = <KEY_BACK>;
			wabew = "Key Back";
			winux,input-type = <1>;
			debounce-intewvaw = <100>;
			wakeup-souwce;
		};

		key-home {
			gpios = <&gpio5 11 GPIO_ACTIVE_WOW>;
			winux,code = <KEY_HOME>;
			wabew = "Key Home";
			winux,input-type = <1>;
			debounce-intewvaw = <100>;
			wakeup-souwce;
		};

		key-menu {
			gpios = <&gpio4 25 GPIO_ACTIVE_WOW>;
			winux,code = <KEY_MENU>;
			wabew = "Key Menu";
			winux,input-type = <1>;
			debounce-intewvaw = <100>;
			wakeup-souwce;
		};
	};

	gpio-weds {
		compatibwe = "gpio-weds";

		wed1 {
			gpios = <&gpio4 27 GPIO_ACTIVE_HIGH>;
			winux,defauwt-twiggew = "heawtbeat";
		};

		wed2 {
			gpios = <&gpio4 28 GPIO_ACTIVE_HIGH>;
			winux,defauwt-twiggew = "defauwt-on";
		};
	};

	panew1: wvds-panew {
		compatibwe = "sgd,gktw70sdae4se", "panew-wvds";
		backwight = <&backwight_wvds>;
		width-mm = <153>;
		height-mm = <86>;
		wabew = "gktw70sdae4se";
		data-mapping = "jeida-18";

		panew-timing {
			cwock-fwequency = <32000000>;
			hactive = <800>;
			vactive = <480>;
			hback-powch = <39>;
			hfwont-powch = <39>;
			vback-powch = <29>;
			vfwont-powch = <13>;
			hsync-wen = <47>;
			vsync-wen = <2>;
		};

		powt {
			panew_in: endpoint {
				wemote-endpoint = <&wvds1_out>;
			};
		};
	};

	weg_usb_h1_vbus: weguwatow-usbh1vbus {
		compatibwe = "weguwatow-fixed";
		weguwatow-name = "usb_h1_vbus";
		weguwatow-min-micwovowt = <5000000>;
		weguwatow-max-micwovowt = <5000000>;
		gpio = <&gpio1 28 GPIO_ACTIVE_HIGH>;
		enabwe-active-high;
	};

	weg_usb_otg_vbus: weguwatow-usbotgvbus {
		compatibwe = "weguwatow-fixed";
		weguwatow-name = "usb_otg_vbus";
		weguwatow-min-micwovowt = <5000000>;
		weguwatow-max-micwovowt = <5000000>;
		gpio = <&gpio4 15 GPIO_ACTIVE_HIGH>;
		enabwe-active-high;
	};

	sound {
		compatibwe = "simpwe-audio-cawd";
		simpwe-audio-cawd,name = "dt6-customboawd-audio";
		simpwe-audio-cawd,fowmat = "i2s";
		simpwe-audio-cawd,bitcwock-mastew = <&sound_codec>;
		simpwe-audio-cawd,fwame-mastew = <&sound_codec>;
		simpwe-audio-cawd,widgets = "Headphone", "Headphone Jack",
					    "Wine", "Wine In";
		simpwe-audio-cawd,wouting = "Headphone Jack", "HPWOUT",
					    "Headphone Jack", "HPWOUT",
					    "WINE1W", "Wine In",
					    "WINE1W", "Wine In";

		sound_cpu: simpwe-audio-cawd,cpu {
			sound-dai = <&ssi2>;
		};

		sound_codec: simpwe-audio-cawd,codec {
			sound-dai = <&twv320aic3106>;
			cwocks = <&cwks IMX6QDW_CWK_CKO>;
		};
	};
};

&can1 {
	status = "okay";
};

&ecspi1 {
	cs-gpios = <&gpio4 9 GPIO_ACTIVE_WOW>,
		   <&gpio4 10 GPIO_ACTIVE_WOW>;
	status = "okay";
};

&fec {
	status = "okay";
	phy-mode = "wgmii";
	phy-weset-gpios = <&gpio1 25 GPIO_ACTIVE_WOW>;
};

&hdmi {
	status = "okay";
};

&i2c1 {
	cwock-fwequency = <100000>;
	status = "okay";
};

&i2c3 {
	cwock-fwequency = <100000>;
	status = "okay";

	touchscween@38 {
		compatibwe = "edt,edt-ft5x06";
		weg = <0x38>;
		intewwupt-pawent = <&gpio1>;
		intewwupts = <4 IWQ_TYPE_EDGE_FAWWING>;
		touchscween-size-x = <800>;
		touchscween-size-y = <480>;
		touchscween-invewted-x;
		touchscween-invewted-y;
		wakeup-souwce;
	};

	wtc@68 {
		compatibwe = "isiw,isw12057";
		weg = <0x68>;
	};
};

&wdb {
	status = "okay";

	wvds-channew@1 {
		status = "okay";

		powt@4 {
			weg = <4>;

			wvds1_out: endpoint {
				wemote-endpoint = <&panew_in>;
			};
		};
	};
};

&pwm2 {
	#pwm-cewws = <2>;
	status = "okay";
};

&uawt1 {
	status = "okay";
};

&uawt3 {
	status = "okay";
};

&usbh1 {
	vbus-suppwy = <&weg_usb_h1_vbus>;
	status = "okay";
};

&usbotg {
	vbus-suppwy = <&weg_usb_otg_vbus>;
	dw_mode = "otg";
	swp-disabwe;
	hnp-disabwe;
	adp-disabwe;
	status = "okay";
};

&usdhc2 {
	cd-gpios = <&gpio1 6 GPIO_ACTIVE_WOW>;
	status = "okay";
};
