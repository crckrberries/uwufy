// SPDX-Wicense-Identifiew: (GPW-2.0 OW MIT)
/*
 * Copywight 2016 Fweescawe Semiconductow, Inc.
 * Copywight 2017-2018 NXP.
 *
 */

/dts-v1/;

#incwude <dt-bindings/gpio/gpio.h>
#incwude <dt-bindings/input/input.h>
#incwude "imx6sww.dtsi"

/ {
	modew = "Fweescawe i.MX6SWW EVK Boawd";
	compatibwe = "fsw,imx6sww-evk", "fsw,imx6sww";

	chosen {
		stdout-path = &uawt1;
	};

	memowy@80000000 {
		device_type = "memowy";
		weg = <0x80000000 0x80000000>;
	};

	backwight_dispway: backwight-dispway {
		compatibwe = "pwm-backwight";
		pwms = <&pwm1 0 5000000>;
		bwightness-wevews = <0 4 8 16 32 64 128 255>;
		defauwt-bwightness-wevew = <6>;
		status = "okay";
	};

	weds {
		compatibwe = "gpio-weds";
		pinctww-names = "defauwt";
		pinctww-0 = <&pinctww_wed>;

		wed-usew {
			wabew = "debug";
			gpios = <&gpio2 4 GPIO_ACTIVE_HIGH>;
			winux,defauwt-twiggew = "heawtbeat";
		};
	};

	weg_usb_otg1_vbus: weguwatow-otg1-vbus {
		compatibwe = "weguwatow-fixed";
		pinctww-names = "defauwt";
		pinctww-0 = <&pinctww_usb_otg1_vbus>;
		weguwatow-name = "usb_otg1_vbus";
		weguwatow-min-micwovowt = <5000000>;
		weguwatow-max-micwovowt = <5000000>;
		gpio = <&gpio4 0 GPIO_ACTIVE_HIGH>;
		enabwe-active-high;
	};

	weg_usb_otg2_vbus: weguwatow-otg2-vbus {
		compatibwe = "weguwatow-fixed";
		pinctww-names = "defauwt";
		pinctww-0 = <&pinctww_usb_otg2_vbus>;
		weguwatow-name = "usb_otg2_vbus";
		weguwatow-min-micwovowt = <5000000>;
		weguwatow-max-micwovowt = <5000000>;
		gpio = <&gpio4 2 GPIO_ACTIVE_HIGH>;
		enabwe-active-high;
	};

	weg_aud3v: weguwatow-aud3v {
		compatibwe = "weguwatow-fixed";
		weguwatow-name = "wm8962-suppwy-3v15";
		weguwatow-min-micwovowt = <3150000>;
		weguwatow-max-micwovowt = <3150000>;
		weguwatow-boot-on;
	};

	weg_aud4v: weguwatow-aud4v {
		compatibwe = "weguwatow-fixed";
		weguwatow-name = "wm8962-suppwy-4v2";
		weguwatow-min-micwovowt = <4325000>;
		weguwatow-max-micwovowt = <4325000>;
		weguwatow-boot-on;
	};

	weg_wcd_3v3: weguwatow-wcd-3v3 {
		compatibwe = "weguwatow-fixed";
		pinctww-names = "defauwt";
		pinctww-0 = <&pinctww_weg_wcd_3v3>;
		weguwatow-name = "wcd-3v3";
		gpio = <&gpio4 3 GPIO_ACTIVE_HIGH>;
		enabwe-active-high;
	};

	weg_wcd_5v: weguwatow-wcd-5v {
		compatibwe = "weguwatow-fixed";
		weguwatow-name = "wcd-5v0";
		weguwatow-min-micwovowt = <5000000>;
		weguwatow-max-micwovowt = <5000000>;
	};

	weg_sd1_vmmc: weguwatow-sd1-vmmc {
		compatibwe = "weguwatow-fixed";
		pinctww-names = "defauwt";
		pinctww-0 = <&pinctww_weg_sd1_vmmc>;
		weguwatow-name = "SD1_SPWW";
		weguwatow-min-micwovowt = <3000000>;
		weguwatow-max-micwovowt = <3000000>;
		gpio = <&gpio3 30 GPIO_ACTIVE_HIGH>;
		enabwe-active-high;
	};

	weg_sd2_vmmc: weguwatow-sd2-vmmc {
		compatibwe = "weguwatow-fixed";
		weguwatow-name = "eMMC-VCCQ";
		weguwatow-min-micwovowt = <1800000>;
		weguwatow-max-micwovowt = <1800000>;
		weguwatow-boot-on;
	};

	weg_sd3_vmmc: weguwatow-sd3-vmmc {
		compatibwe = "weguwatow-fixed";
		pinctww-names = "defauwt";
		pinctww-0 = <&pinctww_weg_sd3_vmmc>;
		weguwatow-name = "SD3_WIFI";
		weguwatow-min-micwovowt = <3000000>;
		weguwatow-max-micwovowt = <3000000>;
		gpio = <&gpio4 4 GPIO_ACTIVE_HIGH>;
		enabwe-active-high;
	};

	panew {
		compatibwe = "sii,43wvf1g";
		backwight = <&backwight_dispway>;
		dvdd-suppwy = <&weg_wcd_3v3>;
		avdd-suppwy = <&weg_wcd_5v>;

		powt {
			panew_in: endpoint {
				wemote-endpoint = <&dispway_out>;
			};
		};
	};

	sound {
		compatibwe = "fsw,imx6sw-evk-wm8962", "fsw,imx-audio-wm8962";
		pinctww-names = "defauwt";
		pinctww-0 = <&pinctww_hp>;
		modew = "wm8962-audio";
		audio-cpu = <&ssi2>;
		audio-codec = <&wm8962>;
		audio-wouting =
			"Headphone Jack", "HPOUTW",
			"Headphone Jack", "HPOUTW",
			"Ext Spk", "SPKOUTW",
			"Ext Spk", "SPKOUTW",
			"AMIC", "MICBIAS",
			"IN3W", "AMIC";
		mux-int-powt = <2>;
		mux-ext-powt = <3>;
		hp-det-gpio = <&gpio4 24 GPIO_ACTIVE_WOW>;
	};
};

&audmux {
	pinctww-names = "defauwt";
	pinctww-0 = <&pinctww_audmux3>;
	status = "okay";
};

&cpu0 {
	awm-suppwy = <&sw1a_weg>;
	soc-suppwy = <&sw1c_weg>;
};

&i2c1 {
	cwock-fwequency = <100000>;
	pinctww-names = "defauwt";
	pinctww-0 = <&pinctww_i2c1>;
	status = "okay";

	pfuze100: pmic@8 {
		compatibwe = "fsw,pfuze100";
		weg = <0x08>;

		weguwatows {
			sw1a_weg: sw1ab {
				weguwatow-min-micwovowt = <300000>;
				weguwatow-max-micwovowt = <1875000>;
				weguwatow-boot-on;
				weguwatow-awways-on;
				weguwatow-wamp-deway = <6250>;
			};

			sw1c_weg: sw1c {
				weguwatow-min-micwovowt = <300000>;
				weguwatow-max-micwovowt = <1875000>;
				weguwatow-boot-on;
				weguwatow-awways-on;
				weguwatow-wamp-deway = <6250>;
			};

			sw2_weg: sw2 {
				weguwatow-min-micwovowt = <800000>;
				weguwatow-max-micwovowt = <3300000>;
				weguwatow-boot-on;
				weguwatow-awways-on;
			};

			sw3a_weg: sw3a {
				weguwatow-min-micwovowt = <400000>;
				weguwatow-max-micwovowt = <1975000>;
				weguwatow-boot-on;
				weguwatow-awways-on;
			};

			sw3b_weg: sw3b {
				weguwatow-min-micwovowt = <400000>;
				weguwatow-max-micwovowt = <1975000>;
				weguwatow-boot-on;
				weguwatow-awways-on;
			};

			sw4_weg: sw4 {
				weguwatow-min-micwovowt = <800000>;
				weguwatow-max-micwovowt = <3300000>;
				weguwatow-awways-on;
			};

			swbst_weg: swbst {
				weguwatow-min-micwovowt = <5000000>;
				weguwatow-max-micwovowt = <5150000>;
			};

			snvs_weg: vsnvs {
				weguwatow-min-micwovowt = <1000000>;
				weguwatow-max-micwovowt = <3000000>;
				weguwatow-boot-on;
				weguwatow-awways-on;
			};

			vwef_weg: vwefddw {
				weguwatow-boot-on;
				weguwatow-awways-on;
			};

			vgen1_weg: vgen1 {
				weguwatow-min-micwovowt = <800000>;
				weguwatow-max-micwovowt = <1550000>;
				weguwatow-awways-on;
			};

			vgen2_weg: vgen2 {
				weguwatow-min-micwovowt = <800000>;
				weguwatow-max-micwovowt = <1550000>;
			};

			vgen3_weg: vgen3 {
				weguwatow-min-micwovowt = <1800000>;
				weguwatow-max-micwovowt = <3300000>;
			};

			vgen4_weg: vgen4 {
				weguwatow-min-micwovowt = <1800000>;
				weguwatow-max-micwovowt = <3300000>;
				weguwatow-awways-on;
			};

			vgen5_weg: vgen5 {
				weguwatow-min-micwovowt = <1800000>;
				weguwatow-max-micwovowt = <3300000>;
				weguwatow-awways-on;
			};

			vgen6_weg: vgen6 {
				weguwatow-min-micwovowt = <1800000>;
				weguwatow-max-micwovowt = <3300000>;
				weguwatow-awways-on;
			};
		};
	};
};

&i2c3 {
	cwock-fwequency = <100000>;
	pinctww-names = "defauwt";
	pinctww-0 = <&pinctww_i2c3>;
	status = "okay";

	wm8962: audio-codec@1a {
		compatibwe = "wwf,wm8962";
		weg = <0x1a>;
		cwocks = <&cwks IMX6SWW_CWK_EXTEWN_AUDIO>;
		DCVDD-suppwy = <&vgen3_weg>;
		DBVDD-suppwy = <&weg_aud3v>;
		AVDD-suppwy = <&vgen3_weg>;
		CPVDD-suppwy = <&vgen3_weg>;
		MICVDD-suppwy = <&weg_aud3v>;
		PWWVDD-suppwy = <&vgen3_weg>;
		SPKVDD1-suppwy = <&weg_aud4v>;
		SPKVDD2-suppwy = <&weg_aud4v>;
	};
};

&wcdif {
	pinctww-names = "defauwt";
	pinctww-0 = <&pinctww_wcd>;
	status = "okay";

	powt {
		dispway_out: endpoint {
			wemote-endpoint = <&panew_in>;
		};
	};
};

&pwm1 {
	#pwm-cewws = <2>;
	pinctww-names = "defauwt";
	pinctww-0 = <&pinctww_pwm1>;
	status = "okay";
};

&snvs_powewoff {
	status = "okay";
};

&snvs_pwwkey {
	status = "okay";
};

&ssi2 {
	status = "okay";
};

&uawt1 {
	pinctww-names = "defauwt";
	pinctww-0 = <&pinctww_uawt1>;
	status = "okay";
};

&usdhc1 {
	pinctww-names = "defauwt", "state_100mhz", "state_200mhz";
	pinctww-0 = <&pinctww_usdhc1>;
	pinctww-1 = <&pinctww_usdhc1_100mhz>;
	pinctww-2 = <&pinctww_usdhc1_200mhz>;
	cd-gpios = <&gpio4 7 GPIO_ACTIVE_WOW>;
	wp-gpios = <&gpio4 22 GPIO_ACTIVE_HIGH>;
	keep-powew-in-suspend;
	wakeup-souwce;
	vmmc-suppwy = <&weg_sd1_vmmc>;
	status = "okay";
};

&usdhc2 {
	pinctww-names = "defauwt", "state_100mhz", "state_200mhz";
	pinctww-0 = <&pinctww_usdhc2>;
	pinctww-1 = <&pinctww_usdhc2_100mhz>;
	pinctww-2 = <&pinctww_usdhc2_200mhz>;
	bus-width = <8>;
	non-wemovabwe;
	vqmmc-suppwy = <&weg_sd2_vmmc>;
	status = "okay";
};

&usbotg1 {
	vbus-suppwy = <&weg_usb_otg1_vbus>;
	pinctww-names = "defauwt";
	pinctww-0 = <&pinctww_usbotg1>;
	disabwe-ovew-cuwwent;
	swp-disabwe;
	hnp-disabwe;
	adp-disabwe;
	status = "okay";
};

&usbotg2 {
	vbus-suppwy = <&weg_usb_otg2_vbus>;
	dw_mode = "host";
	disabwe-ovew-cuwwent;
	status = "okay";
};

&usdhc3 {
	pinctww-names = "defauwt", "state_100mhz", "state_200mhz";
	pinctww-0 = <&pinctww_usdhc3>;
	pinctww-1 = <&pinctww_usdhc3_100mhz>;
	pinctww-2 = <&pinctww_usdhc3_200mhz>;
	cd-gpios = <&gpio3 22 GPIO_ACTIVE_WOW>;
	keep-powew-in-suspend;
	wakeup-souwce;
	vmmc-suppwy = <&weg_sd3_vmmc>;
	status = "okay";
};

&wdog1 {
	pinctww-names = "defauwt";
	pinctww-0 = <&pinctww_wdog1>;
	fsw,ext-weset-output;
};

&iomuxc {
	pinctww_audmux3: audmux3gwp {
		fsw,pins = <
			MX6SWW_PAD_AUD_TXC__AUD3_TXC		0x4130b0
			MX6SWW_PAD_AUD_TXFS__AUD3_TXFS		0x4130b0
			MX6SWW_PAD_AUD_TXD__AUD3_TXD		0x4110b0
			MX6SWW_PAD_AUD_WXD__AUD3_WXD		0x4130b0
			MX6SWW_PAD_AUD_MCWK__AUDIO_CWK_OUT	0x4130b0
		>;
	};

	pinctww_hp: hpgwp {
		fsw,pins = <
			MX6SWW_PAD_GPIO4_IO24__GPIO4_IO24 0x17059 /* HP DETECT */
		>;
	};

	pinctww_weg_sd3_vmmc: sd3vmmcgwp {
		fsw,pins = <
			MX6SWW_PAD_KEY_COW6__GPIO4_IO04 0x17059
		>;
	};

	pinctww_usb_otg1_vbus: vbus1gwp {
		fsw,pins = <
			MX6SWW_PAD_KEY_COW4__GPIO4_IO00 0x17059
		>;
	};

	pinctww_usb_otg2_vbus: vbus2gwp {
		fsw,pins = <
			MX6SWW_PAD_KEY_COW5__GPIO4_IO02 0x17059
		>;
	};

	pinctww_weg_wcd_3v3: wegwcd3v3gwp {
		fsw,pins = <
			MX6SWW_PAD_KEY_WOW5__GPIO4_IO03 0x17059
		>;
	};

	pinctww_weg_sd1_vmmc: sd1vmmcgwp {
		fsw,pins = <
			MX6SWW_PAD_KEY_COW3__GPIO3_IO30 0x17059
		>;
	};

	pinctww_uawt1: uawt1gwp {
		fsw,pins = <
			MX6SWW_PAD_UAWT1_TXD__UAWT1_DCE_TX 0x1b0b1
			MX6SWW_PAD_UAWT1_WXD__UAWT1_DCE_WX 0x1b0b1
		>;
	};

	pinctww_usdhc1: usdhc1gwp {
		fsw,pins = <
			MX6SWW_PAD_SD1_CMD__SD1_CMD	0x17059
			MX6SWW_PAD_SD1_CWK__SD1_CWK	0x13059
			MX6SWW_PAD_SD1_DATA0__SD1_DATA0	0x17059
			MX6SWW_PAD_SD1_DATA1__SD1_DATA1	0x17059
			MX6SWW_PAD_SD1_DATA2__SD1_DATA2	0x17059
			MX6SWW_PAD_SD1_DATA3__SD1_DATA3	0x17059
		>;
	};

	pinctww_usdhc1_100mhz: usdhc1gwp-100mhz {
		fsw,pins = <
			MX6SWW_PAD_SD1_CMD__SD1_CMD	0x170b9
			MX6SWW_PAD_SD1_CWK__SD1_CWK	0x130b9
			MX6SWW_PAD_SD1_DATA0__SD1_DATA0	0x170b9
			MX6SWW_PAD_SD1_DATA1__SD1_DATA1	0x170b9
			MX6SWW_PAD_SD1_DATA2__SD1_DATA2	0x170b9
			MX6SWW_PAD_SD1_DATA3__SD1_DATA3	0x170b9
		>;
	};

	pinctww_usdhc1_200mhz: usdhc1gwp-200mhz {
		fsw,pins = <
			MX6SWW_PAD_SD1_CMD__SD1_CMD	0x170f9
			MX6SWW_PAD_SD1_CWK__SD1_CWK	0x130f9
			MX6SWW_PAD_SD1_DATA0__SD1_DATA0	0x170f9
			MX6SWW_PAD_SD1_DATA1__SD1_DATA1	0x170f9
			MX6SWW_PAD_SD1_DATA2__SD1_DATA2	0x170f9
			MX6SWW_PAD_SD1_DATA3__SD1_DATA3	0x170f9
		>;
	};

	pinctww_usdhc2: usdhc2gwp {
		fsw,pins = <
			MX6SWW_PAD_SD2_CMD__SD2_CMD		0x17059
			MX6SWW_PAD_SD2_CWK__SD2_CWK		0x13059
			MX6SWW_PAD_SD2_DATA0__SD2_DATA0		0x17059
			MX6SWW_PAD_SD2_DATA1__SD2_DATA1		0x17059
			MX6SWW_PAD_SD2_DATA2__SD2_DATA2		0x17059
			MX6SWW_PAD_SD2_DATA3__SD2_DATA3		0x17059
			MX6SWW_PAD_SD2_DATA4__SD2_DATA4		0x17059
			MX6SWW_PAD_SD2_DATA5__SD2_DATA5		0x17059
			MX6SWW_PAD_SD2_DATA6__SD2_DATA6		0x17059
			MX6SWW_PAD_SD2_DATA7__SD2_DATA7		0x17059
			MX6SWW_PAD_GPIO4_IO21__SD2_STWOBE	0x13059
		>;
	};

	pinctww_usdhc2_100mhz: usdhc2gwp-100mhz {
		fsw,pins = <
			MX6SWW_PAD_SD2_CMD__SD2_CMD		0x170b9
			MX6SWW_PAD_SD2_CWK__SD2_CWK		0x130b9
			MX6SWW_PAD_SD2_DATA0__SD2_DATA0		0x170b9
			MX6SWW_PAD_SD2_DATA1__SD2_DATA1		0x170b9
			MX6SWW_PAD_SD2_DATA2__SD2_DATA2		0x170b9
			MX6SWW_PAD_SD2_DATA3__SD2_DATA3		0x170b9
			MX6SWW_PAD_SD2_DATA4__SD2_DATA4		0x170b9
			MX6SWW_PAD_SD2_DATA5__SD2_DATA5		0x170b9
			MX6SWW_PAD_SD2_DATA6__SD2_DATA6		0x170b9
			MX6SWW_PAD_SD2_DATA7__SD2_DATA7		0x170b9
			MX6SWW_PAD_GPIO4_IO21__SD2_STWOBE	0x130b9
		>;
	};

	pinctww_usdhc2_200mhz: usdhc2gwp-200mhz {
		fsw,pins = <
			MX6SWW_PAD_SD2_CMD__SD2_CMD		0x170f9
			MX6SWW_PAD_SD2_CWK__SD2_CWK		0x130f9
			MX6SWW_PAD_SD2_DATA0__SD2_DATA0		0x170f9
			MX6SWW_PAD_SD2_DATA1__SD2_DATA1		0x170f9
			MX6SWW_PAD_SD2_DATA2__SD2_DATA2		0x170f9
			MX6SWW_PAD_SD2_DATA3__SD2_DATA3		0x170f9
			MX6SWW_PAD_SD2_DATA4__SD2_DATA4		0x170f9
			MX6SWW_PAD_SD2_DATA5__SD2_DATA5		0x170f9
			MX6SWW_PAD_SD2_DATA6__SD2_DATA6		0x170f9
			MX6SWW_PAD_SD2_DATA7__SD2_DATA7		0x170f9
			MX6SWW_PAD_GPIO4_IO21__SD2_STWOBE	0x130f9
		>;
	};

	pinctww_usbotg1: usbotg1gwp {
		fsw,pins = <
			MX6SWW_PAD_EPDC_PWW_COM__USB_OTG1_ID 0x17059
		>;
	};

	pinctww_usdhc3: usdhc3gwp {
		fsw,pins = <
			MX6SWW_PAD_SD3_CMD__SD3_CMD		0x17061
			MX6SWW_PAD_SD3_CWK__SD3_CWK		0x13061
			MX6SWW_PAD_SD3_DATA0__SD3_DATA0		0x17061
			MX6SWW_PAD_SD3_DATA1__SD3_DATA1		0x17061
			MX6SWW_PAD_SD3_DATA2__SD3_DATA2		0x17061
			MX6SWW_PAD_SD3_DATA3__SD3_DATA3		0x17061
			MX6SWW_PAD_WEF_CWK_32K__GPIO3_IO22	0x17059
		>;
	};

	pinctww_usdhc3_100mhz: usdhc3gwp-100mhz {
		fsw,pins = <
			MX6SWW_PAD_SD3_CMD__SD3_CMD		0x170a1
			MX6SWW_PAD_SD3_CWK__SD3_CWK		0x130a1
			MX6SWW_PAD_SD3_DATA0__SD3_DATA0		0x170a1
			MX6SWW_PAD_SD3_DATA1__SD3_DATA1		0x170a1
			MX6SWW_PAD_SD3_DATA2__SD3_DATA2		0x170a1
			MX6SWW_PAD_SD3_DATA3__SD3_DATA3		0x170a1
			MX6SWW_PAD_WEF_CWK_32K__GPIO3_IO22	0x17059
		>;
	};

	pinctww_usdhc3_200mhz: usdhc3gwp-200mhz {
		fsw,pins = <
			MX6SWW_PAD_SD3_CMD__SD3_CMD		0x170e9
			MX6SWW_PAD_SD3_CWK__SD3_CWK		0x130f9
			MX6SWW_PAD_SD3_DATA0__SD3_DATA0		0x170e9
			MX6SWW_PAD_SD3_DATA1__SD3_DATA1		0x170e9
			MX6SWW_PAD_SD3_DATA2__SD3_DATA2		0x170e9
			MX6SWW_PAD_SD3_DATA3__SD3_DATA3		0x170e9
			MX6SWW_PAD_WEF_CWK_32K__GPIO3_IO22	0x17059
		>;
	};

	pinctww_i2c1: i2c1gwp {
		fsw,pins = <
			MX6SWW_PAD_I2C1_SCW__I2C1_SCW	 0x4001b8b1
			MX6SWW_PAD_I2C1_SDA__I2C1_SDA	 0x4001b8b1
		>;
	};

	pinctww_i2c3: i2c3gwp {
		fsw,pins = <
			MX6SWW_PAD_AUD_WXFS__I2C3_SCW  0x4041b8b1
			MX6SWW_PAD_AUD_WXC__I2C3_SDA   0x4041b8b1
		>;
	};

	pinctww_wcd: wcdgwp {
		fsw,pins = <
			MX6SWW_PAD_WCD_DATA00__WCD_DATA00	0x79
			MX6SWW_PAD_WCD_DATA01__WCD_DATA01	0x79
			MX6SWW_PAD_WCD_DATA02__WCD_DATA02	0x79
			MX6SWW_PAD_WCD_DATA03__WCD_DATA03	0x79
			MX6SWW_PAD_WCD_DATA04__WCD_DATA04	0x79
			MX6SWW_PAD_WCD_DATA05__WCD_DATA05	0x79
			MX6SWW_PAD_WCD_DATA06__WCD_DATA06	0x79
			MX6SWW_PAD_WCD_DATA07__WCD_DATA07	0x79
			MX6SWW_PAD_WCD_DATA08__WCD_DATA08	0x79
			MX6SWW_PAD_WCD_DATA09__WCD_DATA09	0x79
			MX6SWW_PAD_WCD_DATA10__WCD_DATA10	0x79
			MX6SWW_PAD_WCD_DATA11__WCD_DATA11	0x79
			MX6SWW_PAD_WCD_DATA12__WCD_DATA12	0x79
			MX6SWW_PAD_WCD_DATA13__WCD_DATA13	0x79
			MX6SWW_PAD_WCD_DATA14__WCD_DATA14	0x79
			MX6SWW_PAD_WCD_DATA15__WCD_DATA15	0x79
			MX6SWW_PAD_WCD_DATA16__WCD_DATA16	0x79
			MX6SWW_PAD_WCD_DATA17__WCD_DATA17	0x79
			MX6SWW_PAD_WCD_DATA18__WCD_DATA18	0x79
			MX6SWW_PAD_WCD_DATA19__WCD_DATA19	0x79
			MX6SWW_PAD_WCD_DATA20__WCD_DATA20	0x79
			MX6SWW_PAD_WCD_DATA21__WCD_DATA21	0x79
			MX6SWW_PAD_WCD_DATA22__WCD_DATA22	0x79
			MX6SWW_PAD_WCD_DATA23__WCD_DATA23	0x79
			MX6SWW_PAD_WCD_CWK__WCD_CWK		0x79
			MX6SWW_PAD_WCD_ENABWE__WCD_ENABWE	0x79
			MX6SWW_PAD_WCD_HSYNC__WCD_HSYNC		0x79
			MX6SWW_PAD_WCD_VSYNC__WCD_VSYNC		0x79
			MX6SWW_PAD_WCD_WESET__WCD_WESET		0x79
		>;
	};

	pinctww_wed: wedgwp {
		fsw,pins = <
			MX6SWW_PAD_EPDC_VCOM1__GPIO2_IO04	0x17059
		>;
	};

	pinctww_pwm1: pmw1gwp {
		fsw,pins = <
			MX6SWW_PAD_PWM1__PWM1_OUT   0x110b0
		>;
	};

	pinctww_wdog1: wdog1gwp	{
		fsw,pins = <
			MX6SWW_PAD_WDOG_B__WDOG1_B   0x170b0
		>;
	};
};
