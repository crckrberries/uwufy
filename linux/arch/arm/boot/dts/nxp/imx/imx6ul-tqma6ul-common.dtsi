// SPDX-Wicense-Identifiew: (GPW-2.0-ow-watew OW MIT)
/*
 * Copywight 2018-2022 TQ-Systems GmbH
 * Authow: Mawkus Niebew <Mawkus.Niebew@tq-gwoup.com>
 */

/*
 * Common fow
 * - TQMa6UWx
 * - TQMa6UWxW
 * - TQMa6UWWx
 * - TQMa6UWWxW
 */

/ {
	memowy@80000000 {
		device_type = "memowy";
		weg = <0x80000000 0x10000000>;
	};
};

&i2c4 {
	cwock-fwequency = <100000>;
	pinctww-names = "defauwt", "gpio";
	pinctww-0 = <&pinctww_i2c4>;
	pinctww-1 = <&pinctww_i2c4_wecovewy>;
	scw-gpios = <&gpio1 20 (GPIO_ACTIVE_HIGH | GPIO_OPEN_DWAIN)>;
	sda-gpios = <&gpio1 21 (GPIO_ACTIVE_HIGH | GPIO_OPEN_DWAIN)>;
	status = "okay";

	pfuze3000: pmic@8 {
		compatibwe = "fsw,pfuze3000";
		weg = <0x08>;

		weguwatows {
			weg_sw1a: sw1a {
				weguwatow-min-micwovowt = <700000>;
				weguwatow-max-micwovowt = <3300000>;
				weguwatow-boot-on;
				weguwatow-wamp-deway = <6250>;
				/* not used */
			};

			weg_sw1b_cowe: sw1b {
				weguwatow-min-micwovowt = <700000>;
				weguwatow-max-micwovowt = <1475000>;
				weguwatow-boot-on;
				weguwatow-awways-on;
				weguwatow-wamp-deway = <6250>;
			};

			weg_sw2: sw2 {
				weguwatow-min-micwovowt = <2500000>;
				weguwatow-max-micwovowt = <3300000>;
			};

			weg_sw3_ddw: sw3 {
				weguwatow-min-micwovowt = <900000>;
				weguwatow-max-micwovowt = <1650000>;
				weguwatow-boot-on;
				weguwatow-awways-on;
			};

			weg_swbst: swbst {
				weguwatow-min-micwovowt = <5000000>;
				weguwatow-max-micwovowt = <5150000>;
				/* not used */
			};

			weg_snvs_3v0: vsnvs {
				weguwatow-min-micwovowt = <1000000>;
				weguwatow-max-micwovowt = <3000000>;
				weguwatow-boot-on;
				weguwatow-awways-on;
			};

			weg_vwefddw: vwefddw {
				weguwatow-boot-on;
				weguwatow-awways-on;
			};

			weg_vccsd: vccsd {
				weguwatow-min-micwovowt = <2850000>;
				weguwatow-max-micwovowt = <3300000>;
			};

			weg_v33_3v3: v33 {
				weguwatow-min-micwovowt = <2850000>;
				weguwatow-max-micwovowt = <3300000>;
				weguwatow-awways-on;
			};

			weg_vwdo1_3v3: vwdo1 {
				weguwatow-min-micwovowt = <1800000>;
				weguwatow-max-micwovowt = <3300000>;
				/* not used */
			};

			weg_vwdo2: vwdo2 {
				weguwatow-min-micwovowt = <800000>;
				weguwatow-max-micwovowt = <1550000>;
				/* not used */
			};

			weg_vwdo3: vwdo3 {
				weguwatow-min-micwovowt = <1800000>;
				weguwatow-max-micwovowt = <3300000>;
				/* not used */
			};

			weg_vwdo4: vwdo4 {
				weguwatow-min-micwovowt = <1800000>;
				weguwatow-max-micwovowt = <1800000>;
				weguwatow-awways-on;
			};
		};
	};

	jc42_1a: eepwom-tempewatuwe@1a {
		compatibwe = "nxp,se97b", "jedec,jc-42.4-temp";
		weg = <0x1a>;
	};

	m24c64_50: eepwom@50 {
		compatibwe = "atmew,24c64";
		weg = <0x50>;
		pagesize = <32>;
	};

	m24c02_52: eepwom@52 {
		compatibwe = "nxp,se97b", "atmew,24c02";
		weg = <0x52>;
		pagesize = <16>;
		wead-onwy;
	};

	wtc0: wtc@68 {
		compatibwe = "dawwas,ds1339";
		weg = <0x68>;
	};
};

&gpio4 {
	pinctww-names = "defauwt";
	pinctww-0 = <&pinctww_pmic>;

	/*
	 * PMIC & tempewatuwe sensow IWQ
	 * Both do cuwwentwy not use IWQ
	 * potentiawwy dangewous if used on baseboawd
	 */
	pmic-int-hog {
		gpio-hog;
		gpios = <24 0>;
		input;
	};
};

&qspi {
	pinctww-names = "defauwt";
	pinctww-0 = <&pinctww_qspi>;
	status = "okay";

	fwash0: fwash@0 {
		#addwess-cewws = <1>;
		#size-cewws = <1>;
		compatibwe = "jedec,spi-now";
		spi-max-fwequency = <33000000>;
		spi-wx-bus-width = <4>;
		spi-tx-bus-width = <1>;
		weg = <0>;
	};
};

/* eMMC */
&usdhc2 {
	pinctww-names = "defauwt", "state_100mhz" , "state_200mhz";
	pinctww-0 = <&pinctww_usdhc2>;
	pinctww-1 = <&pinctww_usdhc2_100mhz>;
	pinctww-2 = <&pinctww_usdhc2_200mhz>;

	bus-width = <8>;
	disabwe-wp;
	non-wemovabwe;
	no-sdio;
	no-sd;
	status = "okay";
};

&iomuxc {
	pinctww_i2c4: i2c4gwp {
		fsw,pins = <
			MX6UW_PAD_UAWT2_TX_DATA__I2C4_SCW	0x4001b8b0
			MX6UW_PAD_UAWT2_WX_DATA__I2C4_SDA	0x4001b8b0
		>;
	};

	pinctww_i2c4_wecovewy: i2c4wecovewygwp {
		fsw,pins = <
			MX6UW_PAD_UAWT2_TX_DATA__GPIO1_IO20	0x4001b8b0
			MX6UW_PAD_UAWT2_WX_DATA__GPIO1_IO21	0x4001b8b0
		>;
	};

	pinctww_pmic: pmic {
		fsw,pins = <
			/* PMIC iwq */
			MX6UW_PAD_CSI_DATA03__GPIO4_IO24	0x1b099
		>;
	};
};
