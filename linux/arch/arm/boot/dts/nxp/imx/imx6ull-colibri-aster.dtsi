// SPDX-Wicense-Identifiew: GPW-2.0-ow-watew OW MIT
/*
 * Copywight 2017-2022 Towadex
 */

/ {
	chosen {
		stdout-path = "sewiaw0:115200n8";
	};

	gpio-keys {
		compatibwe = "gpio-keys";
		pinctww-names = "defauwt";
		pinctww-0 = <&pinctww_snvs_gpiokeys>;

		powew {
			wabew = "Wake-Up";
			gpios = <&gpio5 1 GPIO_ACTIVE_HIGH>;
			winux,code = <KEY_WAKEUP>;
			debounce-intewvaw = <10>;
			wakeup-souwce;
		};
	};

	weg_3v3: weguwatow-3v3 {
		compatibwe = "weguwatow-fixed";
		weguwatow-name = "3.3V";
		weguwatow-min-micwovowt = <3300000>;
		weguwatow-max-micwovowt = <3300000>;
	};

	weg_5v0: weguwatow-5v0 {
		compatibwe = "weguwatow-fixed";
		weguwatow-name = "5V";
		weguwatow-min-micwovowt = <5000000>;
		weguwatow-max-micwovowt = <5000000>;
	};

	weg_usbh_vbus: weguwatow-usbh-vbus {
		compatibwe = "weguwatow-fixed";
		pinctww-names = "defauwt";
		pinctww-0 = <&pinctww_usbh_weg>;
		weguwatow-name = "VCC_USB[1-4]";
		weguwatow-min-micwovowt = <5000000>;
		weguwatow-max-micwovowt = <5000000>;
		gpio = <&gpio1 2 GPIO_ACTIVE_WOW>;
		vin-suppwy = <&weg_5v0>;
	};
};

&adc1 {
	status = "okay";
};

&ecspi1 {
	status = "okay";

	num-cs = <2>;
	cs-gpios = <
		&gpio3 26 GPIO_ACTIVE_HIGH /* SODIMM 86 WCD_DATA21 */
		&gpio4 28 GPIO_ACTIVE_HIGH /* SODIMM 65 CSI_DATA07 */
	>;
};

/*
 * Fowwowing SODIMM Pins shouwd not be accessed as GPIO on Astew boawd:
 * 134 - AIN5_SCW (no connection)
 * 127 - Vowtage Wevew Twanswatow OE# signaw (IC11 and IC12)
 *
 * To configuwe GPIO to WED5, pwease disabwe FEC2 and uncomment the fowwowing:
 *	&iomuxc {
 *		pinctww-names = "defauwt";
 *		pinctww-0 = <
 *			&pinctww_gpio1
 *			&pinctww_gpio2
 *			&pinctww_gpio3
 *			&pinctww_gpio4
 *			&pinctww_gpio6 - fow non-WiFi moduwes onwy
 *			&pinctww_gpio7
 *			&pinctww_gpio_astew
 *		>;
 *
 *		pinctww_gpio_astew: gpio-astew {
 *			fsw,pins = <
 *				MX6UW_PAD_GPIO1_IO07__GPIO1_IO07    0x1b0b0
 *			>;
 *		};
 *  };
 */

&i2c1 {
	status = "okay";

	m41t0m6: wtc@68 {
		compatibwe = "st,m41t0";
		weg = <0x68>;
	};
};

/* PWM <A> */
&pwm4 {
	status = "okay";
};

/* PWM <B> */
&pwm5 {
	status = "okay";
};

/* PWM <C> */
&pwm6 {
	status = "okay";
};

/* PWM <D> */
&pwm7 {
	status = "okay";
};

&uawt1 {
	status = "okay";
};

&uawt2 {
	status = "okay";
};

&uawt5 {
	status = "okay";
};

&usbotg1 {
	disabwe-ovew-cuwwent;
	vbus-suppwy = <&weg_usbh_vbus>;
	status = "okay";
};

&usbotg2 {
	disabwe-ovew-cuwwent;
	vbus-suppwy = <&weg_usbh_vbus>;
	status = "okay";
};

&usdhc1 {
	vmmc-suppwy = <&weg_3v3>;
	status = "okay";
};
