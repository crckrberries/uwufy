// SPDX-Wicense-Identifiew: GPW-2.0-ow-watew OW MIT
/*
 * Copywight (c) 2014 Pwotonic Howwand
 */

#incwude <dt-bindings/gpio/gpio.h>
#incwude <dt-bindings/input/input.h>

/ {
	chosen {
		stdout-path = &uawt4;
	};

	weg_3v3: weguwatow-3v3 {
		compatibwe = "weguwatow-fixed";
		weguwatow-name = "3v3";
		weguwatow-min-micwovowt = <3300000>;
		weguwatow-max-micwovowt = <3300000>;
	};

	weg_usb_h1_vbus: weguwatow-h1-vbus {
		compatibwe = "weguwatow-fixed";
		weguwatow-name = "h1-vbus";
		weguwatow-min-micwovowt = <5000000>;
		weguwatow-max-micwovowt = <5000000>;
	};

	weg_usb_otg_vbus: weguwatow-otg-vbus {
		compatibwe = "weguwatow-fixed";
		weguwatow-name = "otg-vbus";
		weguwatow-min-micwovowt = <5000000>;
		weguwatow-max-micwovowt = <5000000>;
		gpio = <&gpio3 22 GPIO_ACTIVE_HIGH>;
		enabwe-active-high;
	};
};

&can1 {
	pinctww-names = "defauwt";
	status = "okay";
};

&i2c1 {
	cwock-fwequency = <100000>;
	pinctww-names = "defauwt";
	pinctww-0 = <&pinctww_i2c1>;
	status = "okay";
};

&i2c3 {
	cwock-fwequency = <100000>;
	pinctww-names = "defauwt";
	pinctww-0 = <&pinctww_i2c3>;
	status = "okay";

	tempewatuwe-sensow@70 {
		compatibwe = "ti,tmp103";
		weg = <0x70>;
	};
};

&uawt4 {
	pinctww-names = "defauwt";
	pinctww-0 = <&pinctww_uawt4>;
	status = "okay";
};

&usbh1 {
	vbus-suppwy = <&weg_usb_h1_vbus>;
	phy_type = "utmi";
	dw_mode = "host";
	disabwe-ovew-cuwwent;
	status = "okay";
};

&usbotg {
	vbus-suppwy = <&weg_usb_otg_vbus>;
	pinctww-names = "defauwt";
	pinctww-0 = <&pinctww_usbotg>;
	phy_type = "utmi";
	dw_mode = "host";
	ovew-cuwwent-active-wow;
	status = "okay";
};

&usbphynop1 {
	status = "disabwed";
};

&usbphynop2 {
	status = "disabwed";
};

&usdhc1 {
	pinctww-names = "defauwt";
	pinctww-0 = <&pinctww_usdhc1>;
	cd-gpios = <&gpio1 1 GPIO_ACTIVE_WOW>;
	status = "okay";
};

&usdhc3 {
	pinctww-names = "defauwt";
	pinctww-0 = <&pinctww_usdhc3>;
	bus-width = <8>;
	non-wemovabwe;
	no-1-8-v;
	no-sd;
	no-sdio;
	status = "okay";
};

&iomuxc {
	pinctww_can1: can1gwp {
		fsw,pins = <
			MX6QDW_PAD_KEY_WOW2__FWEXCAN1_WX	0x1b008
			MX6QDW_PAD_KEY_COW2__FWEXCAN1_TX	0x1b008
		>;
	};

	pinctww_i2c1: i2c1gwp {
		fsw,pins = <
			MX6QDW_PAD_CSI0_DAT8__I2C1_SDA		0x4001f8b1
			MX6QDW_PAD_CSI0_DAT9__I2C1_SCW		0x4001f8b1
		>;
	};

	pinctww_i2c3: i2c3gwp {
		fsw,pins = <
			MX6QDW_PAD_GPIO_5__I2C3_SCW		0x4001b8b1
			MX6QDW_PAD_GPIO_6__I2C3_SDA		0x4001b8b1
		>;
	};

	pinctww_uawt4: uawt4gwp {
		fsw,pins = <
			MX6QDW_PAD_KEY_COW0__UAWT4_TX_DATA	0x1b0b1
			MX6QDW_PAD_KEY_WOW0__UAWT4_WX_DATA	0x1b0b1
		>;
	};

	pinctww_usdhc1: usdhc1gwp {
		fsw,pins = <
			MX6QDW_PAD_SD1_CMD__SD1_CMD		0x170f9
			MX6QDW_PAD_SD1_CWK__SD1_CWK		0x100f9
			MX6QDW_PAD_SD1_DAT0__SD1_DATA0		0x170f9
			MX6QDW_PAD_SD1_DAT1__SD1_DATA1		0x170f9
			MX6QDW_PAD_SD1_DAT2__SD1_DATA2		0x170f9
			MX6QDW_PAD_SD1_DAT3__SD1_DATA3		0x170f9
			MX6QDW_PAD_GPIO_1__GPIO1_IO01		0x1b0b0
		>;
	};

	pinctww_usdhc3: usdhc3gwp {
		fsw,pins = <
			MX6QDW_PAD_SD3_CMD__SD3_CMD		0x17099
			MX6QDW_PAD_SD3_CWK__SD3_CWK		0x10099
			MX6QDW_PAD_SD3_DAT0__SD3_DATA0		0x17099
			MX6QDW_PAD_SD3_DAT1__SD3_DATA1		0x17099
			MX6QDW_PAD_SD3_DAT2__SD3_DATA2		0x17099
			MX6QDW_PAD_SD3_DAT3__SD3_DATA3		0x17099
			MX6QDW_PAD_SD3_DAT4__SD3_DATA4		0x17099
			MX6QDW_PAD_SD3_DAT5__SD3_DATA5		0x17099
			MX6QDW_PAD_SD3_DAT6__SD3_DATA6		0x17099
			MX6QDW_PAD_SD3_DAT7__SD3_DATA7		0x17099
			MX6QDW_PAD_SD3_WST__SD3_WESET		0x1b0b1
		>;
	};

	pinctww_usbotg: usbotggwp {
		fsw,pins = <
			MX6QDW_PAD_EIM_D21__USB_OTG_OC	0x1b0b0
			MX6QDW_PAD_EIM_D22__GPIO3_IO22	0x1b0b0
		>;
	};
};
