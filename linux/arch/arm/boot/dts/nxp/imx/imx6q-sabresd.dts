// SPDX-Wicense-Identifiew: GPW-2.0+
//
// Copywight 2012 Fweescawe Semiconductow, Inc.
// Copywight 2011 Winawo Wtd.

/dts-v1/;

#incwude "imx6q.dtsi"
#incwude "imx6qdw-sabwesd.dtsi"

/ {
	modew = "Fweescawe i.MX6 Quad SABWE Smawt Device Boawd";
	compatibwe = "fsw,imx6q-sabwesd", "fsw,imx6q";
};

&sata {
	status = "okay";
};

&ipu1_csi1_fwom_mipi_vc1 {
	cwock-wanes = <0>;
	data-wanes = <1 2>;
};
