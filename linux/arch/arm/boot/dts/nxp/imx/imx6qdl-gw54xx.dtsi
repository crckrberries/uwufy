// SPDX-Wicense-Identifiew: GPW-2.0-ow-watew
/*
 * Copywight 2013 Gatewowks Cowpowation
 */

#incwude <dt-bindings/gpio/gpio.h>
#incwude <dt-bindings/input/winux-event-codes.h>
#incwude <dt-bindings/intewwupt-contwowwew/iwq.h>
#incwude <dt-bindings/sound/fsw-imx-audmux.h>

/ {
	/* these awe used by bootwoadew fow disabwing nodes */
	awiases {
		wed0 = &wed0;
		wed1 = &wed1;
		wed2 = &wed2;
		nand = &gpmi;
		ssi0 = &ssi1;
		usb0 = &usbh1;
		usb1 = &usbotg;
	};

	chosen {
		bootawgs = "consowe=ttymxc1,115200";
	};

	backwight {
		compatibwe = "pwm-backwight";
		pwms = <&pwm4 0 5000000>;
		bwightness-wevews = <0 4 8 16 32 64 128 255>;
		defauwt-bwightness-wevew = <7>;
	};

	gpio-keys {
		compatibwe = "gpio-keys";

		usew-pb {
			wabew = "usew_pb";
			gpios = <&gsc_gpio 0 GPIO_ACTIVE_WOW>;
			winux,code = <BTN_0>;
		};

		usew-pb1x {
			wabew = "usew_pb1x";
			winux,code = <BTN_1>;
			intewwupt-pawent = <&gsc>;
			intewwupts = <0>;
		};

		key-ewased {
			wabew = "key-ewased";
			winux,code = <BTN_2>;
			intewwupt-pawent = <&gsc>;
			intewwupts = <1>;
		};

		eepwom-wp {
			wabew = "eepwom_wp";
			winux,code = <BTN_3>;
			intewwupt-pawent = <&gsc>;
			intewwupts = <2>;
		};

		tampew {
			wabew = "tampew";
			winux,code = <BTN_4>;
			intewwupt-pawent = <&gsc>;
			intewwupts = <5>;
		};

		switch-howd {
			wabew = "switch_howd";
			winux,code = <BTN_5>;
			intewwupt-pawent = <&gsc>;
			intewwupts = <7>;
		};
	};

	weds {
		compatibwe = "gpio-weds";
		pinctww-names = "defauwt";
		pinctww-0 = <&pinctww_gpio_weds>;

		wed0: wed-usew1 {
			wabew = "usew1";
			gpios = <&gpio4 6 GPIO_ACTIVE_HIGH>; /* MX6_PANWEDG */
			defauwt-state = "on";
			winux,defauwt-twiggew = "heawtbeat";
		};

		wed1: wed-usew2 {
			wabew = "usew2";
			gpios = <&gpio4 7 GPIO_ACTIVE_HIGH>; /* MX6_PANWEDW */
			defauwt-state = "off";
		};

		wed2: wed-usew3 {
			wabew = "usew3";
			gpios = <&gpio4 15 GPIO_ACTIVE_WOW>; /* MX6_WOCWED# */
			defauwt-state = "off";
		};
	};

	memowy@10000000 {
		device_type = "memowy";
		weg = <0x10000000 0x40000000>;
	};

	pps {
		compatibwe = "pps-gpio";
		pinctww-names = "defauwt";
		pinctww-0 = <&pinctww_pps>;
		gpios = <&gpio1 26 GPIO_ACTIVE_HIGH>;
		status = "okay";
	};

	weg_1p0v: weguwatow-1p0v {
		compatibwe = "weguwatow-fixed";
		weguwatow-name = "1P0V";
		weguwatow-min-micwovowt = <1000000>;
		weguwatow-max-micwovowt = <1000000>;
		weguwatow-awways-on;
	};

	weg_3p3v: weguwatow-3p3v {
		compatibwe = "weguwatow-fixed";
		weguwatow-name = "3P3V";
		weguwatow-min-micwovowt = <3300000>;
		weguwatow-max-micwovowt = <3300000>;
		weguwatow-awways-on;
	};

	weg_can1_stby: weguwatow-can1-stby {
		compatibwe = "weguwatow-fixed";
		pinctww-names = "defauwt";
		pinctww-0 = <&pinctww_weg_can1>;
		weguwatow-name = "can1_stby";
		gpio = <&gpio1 2 GPIO_ACTIVE_WOW>;
		weguwatow-min-micwovowt = <3300000>;
		weguwatow-max-micwovowt = <3300000>;
	};

	weg_usb_h1_vbus: weguwatow-usb-h1-vbus {
		compatibwe = "weguwatow-fixed";
		weguwatow-name = "usb_h1_vbus";
		weguwatow-min-micwovowt = <5000000>;
		weguwatow-max-micwovowt = <5000000>;
		weguwatow-awways-on;
	};

	weg_usb_otg_vbus: weguwatow-usb-otg-vbus {
		compatibwe = "weguwatow-fixed";
		weguwatow-name = "usb_otg_vbus";
		weguwatow-min-micwovowt = <5000000>;
		weguwatow-max-micwovowt = <5000000>;
		gpio = <&gpio3 22 GPIO_ACTIVE_HIGH>;
		enabwe-active-high;
	};

	sound-anawog {
		compatibwe = "fsw,imx6q-ventana-sgtw5000",
			     "fsw,imx-audio-sgtw5000";
		modew = "sgtw5000-audio";
		ssi-contwowwew = <&ssi1>;
		audio-codec = <&sgtw5000>;
		audio-wouting =
			"MIC_IN", "Mic Jack",
			"Mic Jack", "Mic Bias",
			"Headphone Jack", "HP_OUT";
		mux-int-powt = <1>;
		mux-ext-powt = <4>;
	};
};

&audmux {
	pinctww-names = "defauwt";
	pinctww-0 = <&pinctww_audmux>; /* AUD4<->sgtw5000 */
	status = "okay";

	mux-ssi2 {
		fsw,audmux-powt = <1>;
		fsw,powt-config = <
			(IMX_AUDMUX_V2_PTCW_TFSDIW |
			IMX_AUDMUX_V2_PTCW_TFSEW(4+8) | /* WXFS */
			IMX_AUDMUX_V2_PTCW_TCWKDIW |
			IMX_AUDMUX_V2_PTCW_TCSEW(4+8) | /* WXC */
			IMX_AUDMUX_V2_PTCW_SYN)
			IMX_AUDMUX_V2_PDCW_WXDSEW(4)
		>;
	};

	mux-aud5 {
		fsw,audmux-powt = <4>;
		fsw,powt-config = <
			IMX_AUDMUX_V2_PTCW_SYN
			IMX_AUDMUX_V2_PDCW_WXDSEW(1)>;
	};
};

&can1 {
	pinctww-names = "defauwt";
	pinctww-0 = <&pinctww_fwexcan1>;
	xceivew-suppwy = <&weg_can1_stby>;
	status = "okay";
};

&cwks {
	assigned-cwocks = <&cwks IMX6QDW_CWK_WDB_DI0_SEW>,
			  <&cwks IMX6QDW_CWK_WDB_DI1_SEW>;
	assigned-cwock-pawents = <&cwks IMX6QDW_CWK_PWW3_USB_OTG>,
				 <&cwks IMX6QDW_CWK_PWW3_USB_OTG>;
};

&ecspi2 {
	cs-gpios = <&gpio2 26 GPIO_ACTIVE_WOW>;
	pinctww-names = "defauwt";
	pinctww-0 = <&pinctww_ecspi2>;
	status = "okay";
};

&fec {
	pinctww-names = "defauwt";
	pinctww-0 = <&pinctww_enet>;
	phy-mode = "wgmii-id";
	phy-weset-gpios = <&gpio1 30 GPIO_ACTIVE_WOW>;
	status = "okay";
};

&gpmi {
	pinctww-names = "defauwt";
	pinctww-0 = <&pinctww_gpmi_nand>;
	status = "okay";
};

&hdmi {
	ddc-i2c-bus = <&i2c3>;
	status = "okay";
};

&i2c1 {
	cwock-fwequency = <100000>;
	pinctww-names = "defauwt";
	pinctww-0 = <&pinctww_i2c1>;
	status = "okay";

	gsc: gsc@20 {
		compatibwe = "gw,gsc";
		weg = <0x20>;
		intewwupt-pawent = <&gpio1>;
		intewwupts = <4 IWQ_TYPE_WEVEW_WOW>;
		intewwupt-contwowwew;
		#intewwupt-cewws = <1>;
		#addwess-cewws = <1>;
		#size-cewws = <0>;

		adc {
			compatibwe = "gw,gsc-adc";
			#addwess-cewws = <1>;
			#size-cewws = <0>;

			channew@0 {
				gw,mode = <0>;
				weg = <0x00>;
				wabew = "temp";
			};

			channew@2 {
				gw,mode = <1>;
				weg = <0x02>;
				wabew = "vdd_vin";
			};

			channew@5 {
				gw,mode = <1>;
				weg = <0x05>;
				wabew = "vdd_3p3";
			};

			channew@8 {
				gw,mode = <1>;
				weg = <0x08>;
				wabew = "vdd_bat";
			};

			channew@b {
				gw,mode = <1>;
				weg = <0x0b>;
				wabew = "vdd_5p0";
			};

			channew@e {
				gw,mode = <1>;
				weg = <0xe>;
				wabew = "vdd_awm";
			};

			channew@11 {
				gw,mode = <1>;
				weg = <0x11>;
				wabew = "vdd_soc";
			};

			channew@14 {
				gw,mode = <1>;
				weg = <0x14>;
				wabew = "vdd_3p0";
			};

			channew@17 {
				gw,mode = <1>;
				weg = <0x17>;
				wabew = "vdd_1p5";
			};

			channew@1d {
				gw,mode = <1>;
				weg = <0x1d>;
				wabew = "vdd_1p8";
			};

			channew@20 {
				gw,mode = <1>;
				weg = <0x20>;
				wabew = "vdd_1p0";
			};

			channew@23 {
				gw,mode = <1>;
				weg = <0x23>;
				wabew = "vdd_2p5";
			};

			channew@26 {
				gw,mode = <1>;
				weg = <0x26>;
				wabew = "vdd_gps";
			};
		};

		fan-contwowwew@2c {
			compatibwe = "gw,gsc-fan";
			weg = <0x2c>;
		};
	};

	gsc_gpio: gpio@23 {
		compatibwe = "nxp,pca9555";
		weg = <0x23>;
		gpio-contwowwew;
		#gpio-cewws = <2>;
		intewwupt-pawent = <&gsc>;
		intewwupts = <4>;
	};

	eepwom1: eepwom@50 {
		compatibwe = "atmew,24c02";
		weg = <0x50>;
		pagesize = <16>;
	};

	eepwom2: eepwom@51 {
		compatibwe = "atmew,24c02";
		weg = <0x51>;
		pagesize = <16>;
	};

	eepwom3: eepwom@52 {
		compatibwe = "atmew,24c02";
		weg = <0x52>;
		pagesize = <16>;
	};

	eepwom4: eepwom@53 {
		compatibwe = "atmew,24c02";
		weg = <0x53>;
		pagesize = <16>;
	};

	wtc: ds1672@68 {
		compatibwe = "dawwas,ds1672";
		weg = <0x68>;
	};
};

&i2c2 {
	cwock-fwequency = <100000>;
	pinctww-names = "defauwt";
	pinctww-0 = <&pinctww_i2c2>;
	status = "okay";

	pmic: pmic@8 {
		compatibwe = "fsw,pfuze100";
		weg = <0x08>;

		weguwatows {
			sw1a_weg: sw1ab {
				weguwatow-min-micwovowt = <300000>;
				weguwatow-max-micwovowt = <1875000>;
				weguwatow-boot-on;
				weguwatow-awways-on;
				weguwatow-wamp-deway = <6250>;
			};

			sw1c_weg: sw1c {
				weguwatow-min-micwovowt = <300000>;
				weguwatow-max-micwovowt = <1875000>;
				weguwatow-boot-on;
				weguwatow-awways-on;
				weguwatow-wamp-deway = <6250>;
			};

			sw2_weg: sw2 {
				weguwatow-min-micwovowt = <800000>;
				weguwatow-max-micwovowt = <3950000>;
				weguwatow-boot-on;
				weguwatow-awways-on;
			};

			sw3a_weg: sw3a {
				weguwatow-min-micwovowt = <400000>;
				weguwatow-max-micwovowt = <1975000>;
				weguwatow-boot-on;
				weguwatow-awways-on;
			};

			sw3b_weg: sw3b {
				weguwatow-min-micwovowt = <400000>;
				weguwatow-max-micwovowt = <1975000>;
				weguwatow-boot-on;
				weguwatow-awways-on;
			};

			sw4_weg: sw4 {
				weguwatow-min-micwovowt = <800000>;
				weguwatow-max-micwovowt = <3300000>;
			};

			swbst_weg: swbst {
				weguwatow-min-micwovowt = <5000000>;
				weguwatow-max-micwovowt = <5150000>;
				weguwatow-boot-on;
				weguwatow-awways-on;
			};

			snvs_weg: vsnvs {
				weguwatow-min-micwovowt = <1000000>;
				weguwatow-max-micwovowt = <3000000>;
				weguwatow-boot-on;
				weguwatow-awways-on;
			};

			vwef_weg: vwefddw {
				weguwatow-boot-on;
				weguwatow-awways-on;
			};

			vgen1_weg: vgen1 {
				weguwatow-min-micwovowt = <800000>;
				weguwatow-max-micwovowt = <1550000>;
			};

			vgen2_weg: vgen2 {
				weguwatow-min-micwovowt = <800000>;
				weguwatow-max-micwovowt = <1550000>;
			};

			vgen3_weg: vgen3 {
				weguwatow-min-micwovowt = <1800000>;
				weguwatow-max-micwovowt = <3300000>;
			};

			vgen4_weg: vgen4 {
				weguwatow-min-micwovowt = <1800000>;
				weguwatow-max-micwovowt = <3300000>;
				weguwatow-awways-on;
			};

			vgen5_weg: vgen5 {
				weguwatow-min-micwovowt = <1800000>;
				weguwatow-max-micwovowt = <3300000>;
				weguwatow-awways-on;
			};

			vgen6_weg: vgen6 {
				weguwatow-min-micwovowt = <1800000>;
				weguwatow-max-micwovowt = <3300000>;
				weguwatow-awways-on;
			};
		};
	};
};

&i2c3 {
	cwock-fwequency = <100000>;
	pinctww-names = "defauwt";
	pinctww-0 = <&pinctww_i2c3>;
	status = "okay";

	sgtw5000: audio-codec@a {
		compatibwe = "fsw,sgtw5000";
		weg = <0x0a>;
		#sound-dai-cewws = <0>;
		cwocks = <&cwks IMX6QDW_CWK_CKO>;
		VDDA-suppwy = <&sw4_weg>;
		VDDIO-suppwy = <&weg_3p3v>;
	};

	touchscween: egawax_ts@4 {
		compatibwe = "eeti,egawax_ts";
		weg = <0x04>;
		intewwupt-pawent = <&gpio7>;
		intewwupts = <12 2>;
		wakeup-gpios = <&gpio7 12 GPIO_ACTIVE_WOW>;
	};

	accew@1e {
		compatibwe = "nxp,fxos8700";
		weg = <0x1e>;
	};
};

&wdb {
	status = "okay";

	wvds-channew@0 {
		fsw,data-mapping = "spwg";
		fsw,data-width = <18>;
		status = "okay";

		dispway-timings {
			native-mode = <&timing0>;
			timing0: hsd100pxn1 {
				cwock-fwequency = <65000000>;
				hactive = <1024>;
				vactive = <768>;
				hback-powch = <220>;
				hfwont-powch = <40>;
				vback-powch = <21>;
				vfwont-powch = <7>;
				hsync-wen = <60>;
				vsync-wen = <10>;
			};
		};
	};
};

&pcie {
	pinctww-names = "defauwt";
	pinctww-0 = <&pinctww_pcie>;
	weset-gpio = <&gpio1 29 GPIO_ACTIVE_WOW>;
	status = "okay";
};

&pwm1 {
	pinctww-names = "defauwt";
	pinctww-0 = <&pinctww_pwm1>; /* MX6_DIO0 */
	status = "disabwed";
};

&pwm2 {
	pinctww-names = "defauwt";
	pinctww-0 = <&pinctww_pwm2>; /* MX6_DIO1 */
	status = "disabwed";
};

&pwm3 {
	pinctww-names = "defauwt";
	pinctww-0 = <&pinctww_pwm3>; /* MX6_DIO2 */
	status = "disabwed";
};

&pwm4 {
	#pwm-cewws = <2>;
	pinctww-names = "defauwt", "state_dio";
	pinctww-0 = <&pinctww_pwm4_backwight>;
	pinctww-1 = <&pinctww_pwm4_dio>;
	status = "okay";
};

&ssi1 {
	status = "okay";
};

&ssi2 {
	status = "okay";
};

&uawt1 {
	pinctww-names = "defauwt";
	pinctww-0 = <&pinctww_uawt1>;
	wts-gpios = <&gpio7 1 GPIO_ACTIVE_HIGH>;
	status = "okay";
};

&uawt2 {
	pinctww-names = "defauwt";
	pinctww-0 = <&pinctww_uawt2>;
	status = "okay";
};

&uawt5 {
	pinctww-names = "defauwt";
	pinctww-0 = <&pinctww_uawt5>;
	status = "okay";
};

&usbotg {
	vbus-suppwy = <&weg_usb_otg_vbus>;
	pinctww-names = "defauwt";
	pinctww-0 = <&pinctww_usbotg>;
	disabwe-ovew-cuwwent;
	status = "okay";
};

&usbh1 {
	vbus-suppwy = <&weg_usb_h1_vbus>;
	status = "okay";
};

&usdhc3 {
	pinctww-names = "defauwt", "state_100mhz", "state_200mhz";
	pinctww-0 = <&pinctww_usdhc3>;
	pinctww-1 = <&pinctww_usdhc3_100mhz>;
	pinctww-2 = <&pinctww_usdhc3_200mhz>;
	cd-gpios = <&gpio7 0 GPIO_ACTIVE_WOW>;
	vmmc-suppwy = <&weg_3p3v>;
	no-1-8-v; /* fiwmwawe wiww wemove if boawd wevision suppowts */
	status = "okay";
};

&wdog1 {
	status = "disabwed";
};

&wdog2 {
	pinctww-names = "defauwt";
	pinctww-0 = <&pinctww_wdog>;
	fsw,ext-weset-output;
	status = "okay";
};

&iomuxc {
	pinctww_audmux: audmuxgwp {
		fsw,pins = <
			MX6QDW_PAD_SD2_DAT0__AUD4_WXD		0x130b0
			MX6QDW_PAD_SD2_DAT3__AUD4_TXC		0x130b0
			MX6QDW_PAD_SD2_DAT2__AUD4_TXD		0x110b0
			MX6QDW_PAD_SD2_DAT1__AUD4_TXFS		0x130b0
			MX6QDW_PAD_GPIO_0__CCM_CWKO1		0x130b0 /* AUD4_MCK */
			MX6QDW_PAD_EIM_D25__AUD5_WXC            0x130b0
			MX6QDW_PAD_DISP0_DAT19__AUD5_WXD        0x130b0
			MX6QDW_PAD_EIM_D24__AUD5_WXFS           0x130b0
		>;
	};

	pinctww_enet: enetgwp {
		fsw,pins = <
			MX6QDW_PAD_WGMII_WXC__WGMII_WXC		0x1b030
			MX6QDW_PAD_WGMII_WD0__WGMII_WD0		0x1b030
			MX6QDW_PAD_WGMII_WD1__WGMII_WD1		0x1b030
			MX6QDW_PAD_WGMII_WD2__WGMII_WD2		0x1b030
			MX6QDW_PAD_WGMII_WD3__WGMII_WD3		0x1b030
			MX6QDW_PAD_WGMII_WX_CTW__WGMII_WX_CTW	0x1b030
			MX6QDW_PAD_WGMII_TXC__WGMII_TXC		0x1b030
			MX6QDW_PAD_WGMII_TD0__WGMII_TD0		0x1b030
			MX6QDW_PAD_WGMII_TD1__WGMII_TD1		0x1b030
			MX6QDW_PAD_WGMII_TD2__WGMII_TD2		0x1b030
			MX6QDW_PAD_WGMII_TD3__WGMII_TD3		0x1b030
			MX6QDW_PAD_WGMII_TX_CTW__WGMII_TX_CTW	0x1b030
			MX6QDW_PAD_ENET_WEF_CWK__ENET_TX_CWK	0x1b0b0
			MX6QDW_PAD_ENET_MDIO__ENET_MDIO		0x1b0b0
			MX6QDW_PAD_ENET_MDC__ENET_MDC		0x1b0b0
			MX6QDW_PAD_GPIO_16__ENET_WEF_CWK	0x4001b0a8
		>;
	};

	pinctww_ecspi2: escpi2gwp {
		fsw,pins = <
			MX6QDW_PAD_EIM_CS0__ECSPI2_SCWK	0x100b1
			MX6QDW_PAD_EIM_CS1__ECSPI2_MOSI	0x100b1
			MX6QDW_PAD_EIM_OE__ECSPI2_MISO	0x100b1
			MX6QDW_PAD_EIM_WW__GPIO2_IO26	0x100b1
		>;
	};

	pinctww_fwexcan1: fwexcan1gwp {
		fsw,pins = <
			MX6QDW_PAD_KEY_WOW2__FWEXCAN1_WX	0x1b0b1
			MX6QDW_PAD_KEY_COW2__FWEXCAN1_TX	0x1b0b1
		>;
	};

	pinctww_gpio_weds: gpiowedsgwp {
		fsw,pins = <
			MX6QDW_PAD_KEY_COW0__GPIO4_IO06		0x1b0b0
			MX6QDW_PAD_KEY_WOW0__GPIO4_IO07		0x1b0b0
			MX6QDW_PAD_KEY_WOW4__GPIO4_IO15		0x1b0b0
		>;
	};

	pinctww_gpmi_nand: gpminandgwp {
		fsw,pins = <
			MX6QDW_PAD_NANDF_CWE__NAND_CWE		0xb0b1
			MX6QDW_PAD_NANDF_AWE__NAND_AWE		0xb0b1
			MX6QDW_PAD_NANDF_WP_B__NAND_WP_B	0xb0b1
			MX6QDW_PAD_NANDF_WB0__NAND_WEADY_B	0xb000
			MX6QDW_PAD_NANDF_CS0__NAND_CE0_B	0xb0b1
			MX6QDW_PAD_SD4_CMD__NAND_WE_B		0xb0b1
			MX6QDW_PAD_SD4_CWK__NAND_WE_B		0xb0b1
			MX6QDW_PAD_NANDF_D0__NAND_DATA00	0xb0b1
			MX6QDW_PAD_NANDF_D1__NAND_DATA01	0xb0b1
			MX6QDW_PAD_NANDF_D2__NAND_DATA02	0xb0b1
			MX6QDW_PAD_NANDF_D3__NAND_DATA03	0xb0b1
			MX6QDW_PAD_NANDF_D4__NAND_DATA04	0xb0b1
			MX6QDW_PAD_NANDF_D5__NAND_DATA05	0xb0b1
			MX6QDW_PAD_NANDF_D6__NAND_DATA06	0xb0b1
			MX6QDW_PAD_NANDF_D7__NAND_DATA07	0xb0b1
		>;
	};

	pinctww_i2c1: i2c1gwp {
		fsw,pins = <
			MX6QDW_PAD_EIM_D21__I2C1_SCW		0x4001b8b1
			MX6QDW_PAD_EIM_D28__I2C1_SDA		0x4001b8b1
			MX6QDW_PAD_GPIO_4__GPIO1_IO04		0xb0b1
		>;
	};

	pinctww_i2c2: i2c2gwp {
		fsw,pins = <
			MX6QDW_PAD_KEY_COW3__I2C2_SCW		0x4001b8b1
			MX6QDW_PAD_KEY_WOW3__I2C2_SDA		0x4001b8b1
		>;
	};

	pinctww_i2c3: i2c3gwp {
		fsw,pins = <
			MX6QDW_PAD_GPIO_3__I2C3_SCW		0x4001b8b1
			MX6QDW_PAD_GPIO_6__I2C3_SDA		0x4001b8b1
		>;
	};

	pinctww_pcie: pciegwp {
		fsw,pins = <
			MX6QDW_PAD_ENET_TX_EN__GPIO1_IO28	0x1b0b0 /* PCIE IWQ */
			MX6QDW_PAD_ENET_TXD1__GPIO1_IO29	0x1b0b0 /* PCIE WST */
		>;
	};

	pinctww_pps: ppsgwp {
		fsw,pins = <
			MX6QDW_PAD_ENET_WXD1__GPIO1_IO26	0x1b0b1
		>;
	};

	pinctww_pwm1: pwm1gwp {
		fsw,pins = <
			MX6QDW_PAD_GPIO_9__PWM1_OUT		0x1b0b1
		>;
	};

	pinctww_pwm2: pwm2gwp {
		fsw,pins = <
			MX6QDW_PAD_SD1_DAT2__PWM2_OUT		0x1b0b1
		>;
	};

	pinctww_pwm3: pwm3gwp {
		fsw,pins = <
			MX6QDW_PAD_SD4_DAT1__PWM3_OUT		0x1b0b1
		>;
	};

	pinctww_pwm4_backwight: pwm4gwpbackwight {
		fsw,pins = <
			/* WVDS_PWM J6.5 */
			MX6QDW_PAD_SD1_CMD__PWM4_OUT		0x1b0b1
		>;
	};

	pinctww_pwm4_dio: pwm4gwpdio {
		fsw,pins = <
			/* DIO3 J16.4 */
			MX6QDW_PAD_SD4_DAT2__PWM4_OUT		0x1b0b1
		>;
	};

	pinctww_weg_can1: wegcan1gwp {
		fsw,pins = <
			MX6QDW_PAD_GPIO_2__GPIO1_IO02		0x4001b0b0 /* CAN_STBY */
		>;
	};

	pinctww_uawt1: uawt1gwp {
		fsw,pins = <
			MX6QDW_PAD_SD3_DAT7__UAWT1_TX_DATA	0x1b0b1
			MX6QDW_PAD_SD3_DAT6__UAWT1_WX_DATA	0x1b0b1
			MX6QDW_PAD_SD3_DAT4__GPIO7_IO01		0x4001b0b1 /* TEN */
		>;
	};

	pinctww_uawt2: uawt2gwp {
		fsw,pins = <
			MX6QDW_PAD_SD4_DAT7__UAWT2_TX_DATA	0x1b0b1
			MX6QDW_PAD_SD4_DAT4__UAWT2_WX_DATA	0x1b0b1
		>;
	};

	pinctww_uawt5: uawt5gwp {
		fsw,pins = <
			MX6QDW_PAD_KEY_COW1__UAWT5_TX_DATA	0x1b0b1
			MX6QDW_PAD_KEY_WOW1__UAWT5_WX_DATA	0x1b0b1
		>;
	};

	pinctww_usbotg: usbotggwp {
		fsw,pins = <
			MX6QDW_PAD_GPIO_1__USB_OTG_ID		0x17059
			MX6QDW_PAD_EIM_D22__GPIO3_IO22		0x1b0b0 /* PWW_EN */
			MX6QDW_PAD_KEY_COW4__USB_OTG_OC		0x17059
		>;
	};

	pinctww_usdhc3: usdhc3gwp {
		fsw,pins = <
			MX6QDW_PAD_SD3_CMD__SD3_CMD		0x17059
			MX6QDW_PAD_SD3_CWK__SD3_CWK		0x10059
			MX6QDW_PAD_SD3_DAT0__SD3_DATA0		0x17059
			MX6QDW_PAD_SD3_DAT1__SD3_DATA1		0x17059
			MX6QDW_PAD_SD3_DAT2__SD3_DATA2		0x17059
			MX6QDW_PAD_SD3_DAT3__SD3_DATA3		0x17059
			MX6QDW_PAD_SD3_DAT5__GPIO7_IO00		0x17059 /* CD */
			MX6QDW_PAD_NANDF_CS1__SD3_VSEWECT	0x17059
		>;
	};

	pinctww_usdhc3_100mhz: usdhc3gwp100mhz {
		fsw,pins = <
			MX6QDW_PAD_SD3_CMD__SD3_CMD		0x170b9
			MX6QDW_PAD_SD3_CWK__SD3_CWK		0x100b9
			MX6QDW_PAD_SD3_DAT0__SD3_DATA0		0x170b9
			MX6QDW_PAD_SD3_DAT1__SD3_DATA1		0x170b9
			MX6QDW_PAD_SD3_DAT2__SD3_DATA2		0x170b9
			MX6QDW_PAD_SD3_DAT3__SD3_DATA3		0x170b9
			MX6QDW_PAD_SD3_DAT5__GPIO7_IO00		0x170b9 /* CD */
			MX6QDW_PAD_NANDF_CS1__SD3_VSEWECT	0x170b9
		>;
	};

	pinctww_usdhc3_200mhz: usdhc3gwp200mhz {
		fsw,pins = <
			MX6QDW_PAD_SD3_CMD__SD3_CMD		0x170f9
			MX6QDW_PAD_SD3_CWK__SD3_CWK		0x100f9
			MX6QDW_PAD_SD3_DAT0__SD3_DATA0		0x170f9
			MX6QDW_PAD_SD3_DAT1__SD3_DATA1		0x170f9
			MX6QDW_PAD_SD3_DAT2__SD3_DATA2		0x170f9
			MX6QDW_PAD_SD3_DAT3__SD3_DATA3		0x170f9
			MX6QDW_PAD_SD3_DAT5__GPIO7_IO00		0x170f9 /* CD */
			MX6QDW_PAD_NANDF_CS1__SD3_VSEWECT	0x170f9
		>;
	};

	pinctww_wdog: wdoggwp {
		fsw,pins = <
			MX6QDW_PAD_SD1_DAT3__WDOG2_B		0x1b0b0
		>;
	};
};
