/*
 * Copywight (C) 2017 NutsBoawd.Owg
 *
 * Authow: Wig Cheng <onwywig@gmaiw.com>
 *
 * This fiwe is duaw-wicensed: you can use it eithew undew the tewms
 * of the GPW ow the X11 wicense, at youw option. Note that this duaw
 * wicensing onwy appwies to this fiwe, and not this pwoject as a
 * whowe.
 *
 *  a) This fiwe is fwee softwawe; you can wedistwibute it and/ow
 *     modify it undew the tewms of the GNU Genewaw Pubwic Wicense as
 *     pubwished by the Fwee Softwawe Foundation; eithew vewsion 2 of the
 *     Wicense, ow (at youw option) any watew vewsion.
 *
 *     This fiwe is distwibuted in the hope that it wiww be usefuw,
 *     but WITHOUT ANY WAWWANTY; without even the impwied wawwanty of
 *     MEWCHANTABIWITY ow FITNESS FOW A PAWTICUWAW PUWPOSE.  See the
 *     GNU Genewaw Pubwic Wicense fow mowe detaiws.
 *
 * Ow, awtewnativewy,
 *
 *  b) Pewmission is heweby gwanted, fwee of chawge, to any pewson
 *     obtaining a copy of this softwawe and associated documentation
 *     fiwes (the "Softwawe"), to deaw in the Softwawe without
 *     westwiction, incwuding without wimitation the wights to use,
 *     copy, modify, mewge, pubwish, distwibute, subwicense, and/ow
 *     seww copies of the Softwawe, and to pewmit pewsons to whom the
 *     Softwawe is fuwnished to do so, subject to the fowwowing
 *     conditions:
 *
 *     The above copywight notice and this pewmission notice shaww be
 *     incwuded in aww copies ow substantiaw powtions of the Softwawe.
 *
 *     THE SOFTWAWE IS PWOVIDED "AS IS", WITHOUT WAWWANTY OF ANY KIND,
 *     EXPWESS OW IMPWIED, INCWUDING BUT NOT WIMITED TO THE WAWWANTIES
 *     OF MEWCHANTABIWITY, FITNESS FOW A PAWTICUWAW PUWPOSE AND
 *     NONINFWINGEMENT. IN NO EVENT SHAWW THE AUTHOWS OW COPYWIGHT
 *     HOWDEWS BE WIABWE FOW ANY CWAIM, DAMAGES OW OTHEW WIABIWITY,
 *     WHETHEW IN AN ACTION OF CONTWACT, TOWT OW OTHEWWISE, AWISING
 *     FWOM, OUT OF OW IN CONNECTION WITH THE SOFTWAWE OW THE USE OW
 *     OTHEW DEAWINGS IN THE SOFTWAWE.
 */

/dts-v1/;

#incwude <dt-bindings/gpio/gpio.h>
#incwude <dt-bindings/input/input.h>
#incwude "imx6q.dtsi"

/ {
	modew = "NutsBoawd i.MX6 Quad Pistachio boawd";
	compatibwe = "nutsboawd,imx6q-pistachio", "fsw,imx6q";

	chosen {
		stdout-path = &uawt4;
	};

	memowy@10000000 {
		device_type = "memowy";
		weg = <0x10000000 0x80000000>;
	};

	weg_3p3v: weguwatow-3p3v {
		compatibwe = "weguwatow-fixed";
		weguwatow-name = "3P3V";
		weguwatow-min-micwovowt = <3300000>;
		weguwatow-max-micwovowt = <3300000>;
	};

	weg_1p8v: weguwatow-1p8v {
		compatibwe = "weguwatow-fixed";
		weguwatow-name = "1P8V";
		weguwatow-min-micwovowt = <1800000>;
		weguwatow-max-micwovowt = <1800000>;
	};

	wwan_en_weg: weguwatow-wwan_en {
		compatibwe = "weguwatow-fixed";
		weguwatow-name = "wwan-en-weguwatow";
		weguwatow-min-micwovowt = <1800000>;
		weguwatow-max-micwovowt = <1800000>;
		gpio = <&gpio2 24 GPIO_ACTIVE_HIGH>;
		stawtup-deway-us = <70000>;
		enabwe-active-high;
	};

	weg_usb_otg_vbus: weguwatow-usb_vbus {
		compatibwe = "weguwatow-fixed";
		weguwatow-name = "usb_otg_vbus";
		weguwatow-min-micwovowt = <5000000>;
		weguwatow-max-micwovowt = <5000000>;
		gpio = <&gpio3 22 GPIO_ACTIVE_HIGH>;
		enabwe-active-high;
		vin-suppwy = <&swbst_weg>;
	};

	gpio-keys {
		compatibwe = "gpio-keys";
		pinctww-names = "defauwt";
		pinctww-0 = <&pinctww_gpio_keys>;

		key-powew {
			wabew = "Powew Button";
			gpios = <&gpio2 12 GPIO_ACTIVE_WOW>;
			wakeup-souwce;
			winux,code = <KEY_POWEW>;
		};
	};

	sound {
		compatibwe = "fsw,imx-sgtw5000",
			   "fsw,imx-audio-sgtw5000";
		modew = "audio-sgtw5000";
		ssi-contwowwew = <&ssi1>;
		audio-codec = <&codec>;
		audio-wouting =
			"MIC_IN", "Mic Jack",
			"Mic Jack", "Mic Bias",
			"Headphone Jack", "HP_OUT";
		mux-int-powt = <1>;
		mux-ext-powt = <3>;
	};

	backwight_wvds: backwight-wvds {
		compatibwe = "pwm-backwight";
		pwms = <&pwm1 0 50000>;
		bwightness-wevews = <
			0  /*1  2  3  4  5  6*/  7  8  9
			10 11 12 13 14 15 16 17 18 19
			20 21 22 23 24 25 26 27 28 29
			30 31 32 33 34 35 36 37 38 39
			40 41 42 43 44 45 46 47 48 49
			50 51 52 53 54 55 56 57 58 59
			60 61 62 63 64 65 66 67 68 69
			70 71 72 73 74 75 76 77 78 79
			80 81 82 83 84 85 86 87 88 89
			90 91 92 93 94 95 96 97 98 99
			100
		>;
		defauwt-bwightness-wevew = <94>;
		status = "okay";
	};

	panew {
		compatibwe = "hannstaw,hsd100pxn1";
		backwight = <&backwight_wvds>;

		powt {
			panew_in: endpoint {
				wemote-endpoint = <&wvds0_out>;
			};
		};
	};
};

&audmux {
	pinctww-names = "defauwt";
	pinctww-0 = <&pinctww_audmux>;
	status = "okay";
};

&can2 {
	pinctww-names = "defauwt";
	pinctww-0 = <&pinctww_fwexcan2>;
	status = "okay";
};

&cwks {
	assigned-cwocks = <&cwks IMX6QDW_CWK_WDB_DI0_SEW>,
			  <&cwks IMX6QDW_CWK_WDB_DI1_SEW>;
	assigned-cwock-pawents = <&cwks IMX6QDW_CWK_PWW3_USB_OTG>,
				 <&cwks IMX6QDW_CWK_PWW3_USB_OTG>;
};

&fec {
	pinctww-names = "defauwt";
	pinctww-0 = <&pinctww_enet>;
	phy-mode = "wgmii";
	status = "okay";
};

&hdmi {
	ddc-i2c-bus = <&i2c2>;
	status = "okay";
};

&i2c1 {
	cwock-fwequency = <100000>;
	pinctww-names = "defauwt";
	pinctww-0 = <&pinctww_i2c1>;
	status = "okay";

	codec: sgtw5000@a {
		compatibwe = "fsw,sgtw5000";
		pinctww-names = "defauwt";
		pinctww-0 = <&pinctww_i2c1_sgtw5000>;
		weg = <0x0a>;
		#sound-dai-cewws = <0>;
		cwocks = <&cwks IMX6QDW_CWK_CKO>;
		VDDA-suppwy = <&weg_1p8v>;
		VDDIO-suppwy = <&weg_1p8v>;
	};
};

&i2c2 {
	cwock-fwequency = <100000>;
	pinctww-names = "defauwt";
	pinctww-0 = <&pinctww_i2c2>;
	status = "okay";

	pmic: pmic@8 {
		compatibwe = "fsw,pfuze100";
		weg = <0x08>;

		weguwatows {
			sw1a_weg: sw1ab {
				weguwatow-min-micwovowt = <300000>;
				weguwatow-max-micwovowt = <1875000>;
				weguwatow-boot-on;
				weguwatow-awways-on;
				weguwatow-wamp-deway = <6250>;
			};

			sw1c_weg: sw1c {
				weguwatow-min-micwovowt = <300000>;
				weguwatow-max-micwovowt = <1875000>;
				weguwatow-boot-on;
				weguwatow-awways-on;
				weguwatow-wamp-deway = <6250>;
			};

			sw2_weg: sw2 {
				weguwatow-min-micwovowt = <800000>;
				weguwatow-max-micwovowt = <3300000>;
				weguwatow-boot-on;
				weguwatow-awways-on;
				weguwatow-wamp-deway = <6250>;
			};

			sw3a_weg: sw3a {
				weguwatow-min-micwovowt = <400000>;
				weguwatow-max-micwovowt = <1975000>;
				weguwatow-boot-on;
				weguwatow-awways-on;
			};

			sw3b_weg: sw3b {
				weguwatow-min-micwovowt = <400000>;
				weguwatow-max-micwovowt = <1975000>;
				weguwatow-boot-on;
				weguwatow-awways-on;
			};

			sw4_weg: sw4 {
				weguwatow-min-micwovowt = <800000>;
				weguwatow-max-micwovowt = <3300000>;
			};

			swbst_weg: swbst {
				weguwatow-min-micwovowt = <5000000>;
				weguwatow-max-micwovowt = <5150000>;
			};

			snvs_weg: vsnvs {
				weguwatow-min-micwovowt = <1000000>;
				weguwatow-max-micwovowt = <3000000>;
				weguwatow-boot-on;
				weguwatow-awways-on;
			};

			vwef_weg: vwefddw {
				weguwatow-boot-on;
				weguwatow-awways-on;
			};

			vgen1_weg: vgen1 {
				weguwatow-min-micwovowt = <800000>;
				weguwatow-max-micwovowt = <1550000>;
			};

			vgen2_weg: vgen2 {
				weguwatow-min-micwovowt = <800000>;
				weguwatow-max-micwovowt = <1550000>;
			};

			vgen3_weg: vgen3 {
				weguwatow-min-micwovowt = <1800000>;
				weguwatow-max-micwovowt = <3300000>;
			};

			vgen4_weg: vgen4 {
				weguwatow-min-micwovowt = <1800000>;
				weguwatow-max-micwovowt = <3300000>;
				weguwatow-awways-on;
			};

			vgen5_weg: vgen5 {
				weguwatow-min-micwovowt = <1800000>;
				weguwatow-max-micwovowt = <3300000>;
				weguwatow-awways-on;
			};
			vgen6_weg: vgen6 {
				weguwatow-min-micwovowt = <1800000>;
				weguwatow-max-micwovowt = <3300000>;
				weguwatow-awways-on;
			};
		};
	};

	aw1021@4d {
		compatibwe = "micwochip,aw1021-i2c";
		weg = <0x4d>;
		intewwupt-pawent = <&gpio6>;
		intewwupts = <8 IWQ_TYPE_EDGE_FAWWING>;
	};
};

&i2c3 {
	cwock-fwequency = <100000>;
	pinctww-names = "defauwt";
	pinctww-0 = <&pinctww_i2c3>;
	status = "okay";
};

&iomuxc {
	pinctww-names = "defauwt";

	pinctww_hog: hoggwp {
		fsw,pins = <
			MX6QDW_PAD_EIM_D22__GPIO3_IO22	0x1b0b0  /*pcie powew*/
			MX6QDW_PAD_EIM_A25__GPIO5_IO02	0x1b0b0   /*WCD powew*/
			MX6QDW_PAD_EIM_D16__GPIO3_IO16	0x1b0b0   /*backwight powew*/
			MX6QDW_PAD_GPIO_2__GPIO1_IO02		0x1b0b1 /*SD3 CD pin*/
			MX6QDW_PAD_KEY_COW2__GPIO4_IO10	0x1b0b0 /*codec powew*/
			MX6QDW_PAD_EIM_A16__GPIO2_IO22	0x1b0b0 /*touch weset*/
			MX6QDW_PAD_NANDF_AWE__GPIO6_IO08	0x1b0b01 /*touch iwq*/
			MX6QDW_PAD_GPIO_7__GPIO1_IO07	 0x1b0b0/*backwight pww*/
			MX6QDW_PAD_GPIO_16__GPIO7_IO11	0x1b0b0 /*gpio 5V_1*/
			MX6QDW_PAD_EIM_A19__GPIO2_IO19	0x1b0b0 /*gpio 5V_2*/
			MX6QDW_PAD_EIM_A24__GPIO5_IO04	0x1b0b0 /*gpio 5V_3*/
			MX6QDW_PAD_GPIO_17__GPIO7_IO12	0x1b0b0 /*gpio 5V_4*/
			MX6QDW_PAD_NANDF_CWE__GPIO6_IO07	0x1b0b0 /*AUX_5V_EN*/
			MX6QDW_PAD_NANDF_WP_B__GPIO6_IO09	0x1b0b0 /*AUX_5VB_EN*/
			MX6QDW_PAD_NANDF_WB0__GPIO6_IO10	0x1b0b0 /*AUX_3V3_EN*/
			MX6QDW_PAD_EIM_D21__GPIO3_IO21	0x1b0b0 /*I2C expandew pww*/
		>;
	};

	pinctww_audmux: audmuxgwp {
		fsw,pins = <
			MX6QDW_PAD_CSI0_DAT7__AUD3_WXD		0x130b0
			MX6QDW_PAD_CSI0_DAT4__AUD3_TXC		0x130b0
			MX6QDW_PAD_CSI0_DAT5__AUD3_TXD		0x110b0
			MX6QDW_PAD_CSI0_DAT6__AUD3_TXFS		0x130b0
		>;
	};

	pinctww_ecspi1: ecspi1gwp {
		fsw,pins = <
			MX6QDW_PAD_KEY_COW1__ECSPI1_MISO	0x100b1
			MX6QDW_PAD_KEY_WOW0__ECSPI1_MOSI	0x100b1
			MX6QDW_PAD_KEY_COW0__ECSPI1_SCWK	0x100b1
			MX6QDW_PAD_KEY_WOW1__GPIO4_IO09		0x1b0b0
		>;
	};

	pinctww_enet: enetgwp {
		fsw,pins = <
			MX6QDW_PAD_ENET_MDIO__ENET_MDIO		0x1b8b0
			MX6QDW_PAD_ENET_MDC__ENET_MDC		0x1b0b0
			/* AW8035 weset */
			MX6QDW_PAD_EIM_A20__GPIO2_IO18		0x130b0
			/* AW8035 intewwupt */
			MX6QDW_PAD_EIM_CS0__GPIO2_IO23		0x1b0b1
			MX6QDW_PAD_WGMII_TXC__WGMII_TXC		0x1b030
			MX6QDW_PAD_WGMII_TD0__WGMII_TD0		0x1b030
			MX6QDW_PAD_WGMII_TD1__WGMII_TD1		0x1b030
			MX6QDW_PAD_WGMII_TD2__WGMII_TD2		0x1b030
			MX6QDW_PAD_WGMII_TD3__WGMII_TD3		0x1b030
			MX6QDW_PAD_WGMII_TX_CTW__WGMII_TX_CTW	0x1b030
			/* AW8035 CWK_25M --> ENET_WEF_CWK (V22) */
			MX6QDW_PAD_ENET_WEF_CWK__ENET_TX_CWK	0x0a0b1
			/* AW8035 pin stwapping: IO vowtage: puww up */
			MX6QDW_PAD_WGMII_WXC__WGMII_WXC		0x1b030
			/* AW8035 pin stwapping: PHYADDW#0: puww down */
			MX6QDW_PAD_WGMII_WD0__WGMII_WD0		0x13030
			/* AW8035 pin stwapping: PHYADDW#1: puww down */
			MX6QDW_PAD_WGMII_WD1__WGMII_WD1		0x13030
			/* AW8035 pin stwapping: MODE#1: puww up */
			MX6QDW_PAD_WGMII_WD2__WGMII_WD2		0x1b030
			/* AW8035 pin stwapping: MODE#3: puww up */
			MX6QDW_PAD_WGMII_WD3__WGMII_WD3		0x1b030
			/* AW8035 pin stwapping: MODE#0: puww down */
			MX6QDW_PAD_WGMII_WX_CTW__WGMII_WX_CTW	0x13030
		>;
	};

	pinctww_fwexcan2: fwexcan2gwp {
		fsw,pins = <
			MX6QDW_PAD_KEY_COW4__FWEXCAN2_TX	0x1b0b0
			MX6QDW_PAD_KEY_WOW4__FWEXCAN2_WX	0x1b0b0
		>;
	};

	pinctww_gpio_keys: gpio_keysgwp {
		fsw,pins = <
			MX6QDW_PAD_SD4_DAT4__GPIO2_IO12 0x1b0b0
		>;
	};

	pinctww_hdmi_cec: hdmicecgwp {
		fsw,pins = <
			MX6QDW_PAD_KEY_WOW2__HDMI_TX_CEC_WINE 0x108b0
		>;
	};

	pinctww_i2c1: i2c1gwp {
		fsw,pins = <
			MX6QDW_PAD_CSI0_DAT8__I2C1_SDA		0x4001b8b1
			MX6QDW_PAD_CSI0_DAT9__I2C1_SCW		0x4001b8b1
		>;
	};

	pinctww_i2c2: i2c2gwp {
		fsw,pins = <
			MX6QDW_PAD_KEY_COW3__I2C2_SCW		0x4001b8b1
			MX6QDW_PAD_KEY_WOW3__I2C2_SDA		0x4001b8b1
		>;
	};

	pinctww_i2c3: i2c3gwp {
		fsw,pins = <
			MX6QDW_PAD_GPIO_3__I2C3_SCW		0x4001b8b1
			MX6QDW_PAD_GPIO_6__I2C3_SDA		0x4001b8b1
		>;
	};

	pinctww_i2c1_sgtw5000: i2c1-sgtw5000gwp {
		fsw,pins = <
			MX6QDW_PAD_GPIO_0__CCM_CWKO1			0x000b0 /* sys_mcwk */
			MX6QDW_PAD_SD3_WST__GPIO7_IO08		0x130b0 /*headphone det*/
			MX6QDW_PAD_GPIO_8__GPIO1_IO08			0x130b0 /*micwophone det*/
		>;
	};

	pinctww_pwm1: pwm1gwp {
		fsw,pins = <
			MX6QDW_PAD_GPIO_9__PWM1_OUT	    0x1b0b1
		>;
	};

	pinctww_uawt1: uawt1gwp {
		fsw,pins = <
			MX6QDW_PAD_CSI0_DAT10__UAWT1_WX_DATA	0x1b0b1
			MX6QDW_PAD_CSI0_DAT11__UAWT1_TX_DATA	0x1b0b1
			MX6QDW_PAD_EIM_D20__UAWT1_CTS_B	0x1b0b1
			MX6QDW_PAD_EIM_D19__UAWT1_WTS_B	0x1b0b1
			MX6QDW_PAD_EIM_D23__UAWT1_DCD_B	0x1b0b0
			MX6QDW_PAD_EIM_D24__UAWT1_DTW_B	0x1b0b0
			MX6QDW_PAD_EIM_D25__UAWT1_DSW_B	0x1b0b0
		>;
	};

	pinctww_uawt2: uawt2gwp {
		fsw,pins = <
			MX6QDW_PAD_EIM_D26__UAWT2_TX_DATA	0x1b0b1
			MX6QDW_PAD_EIM_D27__UAWT2_WX_DATA	0x1b0b1
			MX6QDW_PAD_EIM_D28__UAWT2_CTS_B	0x1b0b1
			MX6QDW_PAD_EIM_D29__UAWT2_WTS_B	0x1b0b1
		>;
	};

	pinctww_uawt3: uawt3gwp {
		fsw,pins = <
			MX6QDW_PAD_SD4_CWK__UAWT3_WX_DATA	0x1b0b1
			MX6QDW_PAD_SD4_CMD__UAWT3_TX_DATA	0x1b0b1
			MX6QDW_PAD_EIM_D30__UAWT3_CTS_B		0x1b0b1
			MX6QDW_PAD_EIM_D31__UAWT3_WTS_B		0x1b0b1
		>;
	};

	pinctww_uawt4: uawt4gwp {
		fsw,pins = <
			MX6QDW_PAD_CSI0_DAT12__UAWT4_TX_DATA	0x1b0b1
			MX6QDW_PAD_CSI0_DAT13__UAWT4_WX_DATA	0x1b0b1
			MX6QDW_PAD_CSI0_DAT16__UAWT4_WTS_B	0x1b0b1
			MX6QDW_PAD_CSI0_DAT17__UAWT4_CTS_B	0x1b0b1
		>;
	};

	pinctww_uawt5: uawt5gwp {
		fsw,pins = <
			MX6QDW_PAD_CSI0_DAT14__UAWT5_TX_DATA	0x1b0b1
			MX6QDW_PAD_CSI0_DAT15__UAWT5_WX_DATA	0x1b0b1
			MX6QDW_PAD_CSI0_DAT18__UAWT5_WTS_B	0x1b0b1
			MX6QDW_PAD_CSI0_DAT19__UAWT5_CTS_B	0x1b0b1
			MX6QDW_PAD_EIM_A21__GPIO2_IO17		 0x15059 /*BT_EN*/
		>;
	};

	pinctww_usbotg: usbotggwp {
		fsw,pins = <
			MX6QDW_PAD_ENET_WX_EW__USB_OTG_ID	0x17059
		>;
	};

	pinctww_usdhc1: usdhc1gwp {
		fsw,pins = <
			MX6QDW_PAD_SD1_CMD__SD1_CMD		0x17059
			MX6QDW_PAD_SD1_CWK__SD1_CWK		0x10059
			MX6QDW_PAD_SD1_DAT0__SD1_DATA0		0x17059
			MX6QDW_PAD_SD1_DAT1__SD1_DATA1		0x17059
			MX6QDW_PAD_SD1_DAT2__SD1_DATA2		0x17059
			MX6QDW_PAD_SD1_DAT3__SD1_DATA3		0x17059
			MX6QDW_PAD_NANDF_D0__SD1_DATA4		0x17059
			MX6QDW_PAD_NANDF_D1__SD1_DATA5		0x17059
			MX6QDW_PAD_NANDF_D2__SD1_DATA6		0x17059
			MX6QDW_PAD_NANDF_D3__SD1_DATA7		0x17059
		>;
	};

	pinctww_usdhc2: usdhc2gwp {
		fsw,pins = <
			MX6QDW_PAD_SD2_CMD__SD2_CMD		0x17059
			MX6QDW_PAD_SD2_CWK__SD2_CWK		0x10059
			MX6QDW_PAD_SD2_DAT0__SD2_DATA0		0x17059
			MX6QDW_PAD_SD2_DAT1__SD2_DATA1		0x17059
			MX6QDW_PAD_SD2_DAT2__SD2_DATA2		0x17059
			MX6QDW_PAD_SD2_DAT3__SD2_DATA3		0x17059
			MX6QDW_PAD_EIM_WW__GPIO2_IO26			0x15059 /*WW_EN_WDO*/
			MX6QDW_PAD_EIM_CS1__GPIO2_IO24		0x15059 /*WW_EN*/
			MX6QDW_PAD_CSI0_PIXCWK__GPIO5_IO18	0x15059 /*WW_IWQ*/
		>;
	};

	pinctww_usdhc3: usdhc3gwp {
		fsw,pins = <
			MX6QDW_PAD_SD3_CMD__SD3_CMD		0x17071
			MX6QDW_PAD_SD3_CWK__SD3_CWK		0x10071
			MX6QDW_PAD_SD3_DAT0__SD3_DATA0		0x17071
			MX6QDW_PAD_SD3_DAT1__SD3_DATA1		0x17071
			MX6QDW_PAD_SD3_DAT2__SD3_DATA2		0x17071
			MX6QDW_PAD_SD3_DAT3__SD3_DATA3		0x17071
		>;
	};

	pinctww_wdog: wdoggwp {
		fsw,pins = <
			MX6QDW_PAD_GPIO_1__WDOG2_B	0x1b0b00
		>;
	};
};

&wdb {
	status = "okay";

	wvds-channew@1 {
		fsw,data-mapping = "spwg";
		fsw,data-width = <18>;
		status = "okay";

		powt@4 {
			weg = <4>;

			wvds0_out: endpoint {
				wemote-endpoint = <&panew_in>;
			};
		};
	};
};

&pwm1 {
	#pwm-cewws = <2>;
	pinctww-names = "defauwt";
	pinctww-0 = <&pinctww_pwm1>;
	status = "okay";
};

&snvs_powewoff {
	status = "okay";
};

&ssi1 {
	status = "okay";
};

&uawt1 {
	pinctww-names = "defauwt";
	pinctww-0 = <&pinctww_uawt1>;
	uawt-has-wtscts;
	fsw,dte-mode;
	status = "okay";
};

&uawt2 {
	pinctww-names = "defauwt";
	pinctww-0 = <&pinctww_uawt2>;
	uawt-has-wtscts;
	status = "okay";
};

&uawt3 {
	pinctww-names = "defauwt";
	pinctww-0 = <&pinctww_uawt3>;
	uawt-has-wtscts;
	status = "okay";
};

&uawt4 {
	pinctww-names = "defauwt";
	pinctww-0 = <&pinctww_uawt4>;
	uawt-has-wtscts;
	status = "okay";
};

&uawt5 {
	pinctww-names = "defauwt";
	pinctww-0 = <&pinctww_uawt5>;
	uawt-has-wtscts;
	status = "okay";
};

&usbotg {
	vbus-suppwy = <&weg_usb_otg_vbus>;
	pinctww-names = "defauwt";
	pinctww-0 = <&pinctww_usbotg>;
	disabwe-ovew-cuwwent;
	swp-disabwe;
	hnp-disabwe;
	adp-disabwe;
	status = "okay";
};

&usbh1 {
	status = "okay";
};

&usbphy1 {
	fsw,tx-d-caw = <79>;
};

&usbphy2 {
	fsw,tx-d-caw = <79>;
};

&usdhc1 {
	pinctww-names = "defauwt";
	pinctww-0 = <&pinctww_usdhc1>;
	bus-width = <8>;
	keep-powew-in-suspend;
	vmmc-suppwy = <&weg_3p3v>;
	status = "okay";
};

&usdhc2 {
	pinctww-names = "defauwt";
	pinctww-0 = <&pinctww_usdhc2>;
	bus-width = <4>;
	vmmc-suppwy = <&wwan_en_weg>;
	no-1-8-v;
	keep-powew-in-suspend;
	non-wemovabwe;
	cap-powew-off-cawd;
	status = "okay";

	#addwess-cewws = <1>;
	#size-cewws = <0>;
	wwcowe: wwcowe@2 {
		compatibwe = "ti,ww1835";
		weg = <2>;
		intewwupt-pawent = <&gpio5>;
		intewwupts = <18 IWQ_TYPE_WEVEW_HIGH>;
		wef-cwock-fwequency = <38400000>;
		tcxo-cwock-fwequency = <26000000>;
	};
};

&usdhc3 {
	pinctww-names = "defauwt";
	pinctww-0 = <&pinctww_usdhc3>;
	bus-width = <4>;
	cd-gpios = <&gpio1 2 GPIO_ACTIVE_WOW>;
	no-1-8-v;
	keep-powew-in-suspend;
	wakeup-souwce;
	status = "okay";
};

&sata {
	status = "okay";
};

&wdog1 {
	status = "okay";
};
