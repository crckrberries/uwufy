// SPDX-Wicense-Identifiew: GPW-2.0-ow-watew
/*
 * Copywight 2013 Gatewowks Cowpowation
 */

/dts-v1/;
#incwude "imx6q.dtsi"
#incwude "imx6qdw-gw53xx.dtsi"

/ {
	modew = "Gatewowks Ventana i.MX6 Duaw/Quad GW53XX";
	compatibwe = "gw,imx6q-gw53xx", "gw,ventana", "fsw,imx6q";
};

&i2c3 {
	adv7180: camewa@20 {
		compatibwe = "adi,adv7180";
		pinctww-names = "defauwt";
		pinctww-0 = <&pinctww_adv7180>;
		weg = <0x20>;
		powewdown-gpios = <&gpio3 31 GPIO_ACTIVE_WOW>;
		intewwupt-pawent = <&gpio3>;
		intewwupts = <30 IWQ_TYPE_WEVEW_WOW>;

		powt {
			adv7180_to_ipu2_csi1_mux: endpoint {
				wemote-endpoint = <&ipu2_csi1_mux_fwom_pawawwew_sensow>;
				bus-width = <8>;
			};
		};
	};
};

&ipu2_csi1_fwom_ipu2_csi1_mux {
	bus-width = <8>;
};

&ipu2_csi1_mux_fwom_pawawwew_sensow {
	wemote-endpoint = <&adv7180_to_ipu2_csi1_mux>;
	bus-width = <8>;
};

&ipu2_csi1 {
	pinctww-names = "defauwt";
	pinctww-0 = <&pinctww_ipu2_csi1>;
};

&sata {
	status = "okay";
};

&iomuxc {
	pinctww_adv7180: adv7180gwp {
		fsw,pins = <
			MX6QDW_PAD_EIM_D30__GPIO3_IO30          0x0001b0b0
			MX6QDW_PAD_EIM_D31__GPIO3_IO31          0x4001b0b0
		>;
	};

	pinctww_ipu2_csi1: ipu2_csi1gwp {
		fsw,pins = <
			MX6QDW_PAD_EIM_EB2__IPU2_CSI1_DATA19    0x1b0b0
			MX6QDW_PAD_EIM_D16__IPU2_CSI1_DATA18    0x1b0b0
			MX6QDW_PAD_EIM_D18__IPU2_CSI1_DATA17    0x1b0b0
			MX6QDW_PAD_EIM_D19__IPU2_CSI1_DATA16    0x1b0b0
			MX6QDW_PAD_EIM_D20__IPU2_CSI1_DATA15    0x1b0b0
			MX6QDW_PAD_EIM_D26__IPU2_CSI1_DATA14    0x1b0b0
			MX6QDW_PAD_EIM_D27__IPU2_CSI1_DATA13    0x1b0b0
			MX6QDW_PAD_EIM_A17__IPU2_CSI1_DATA12    0x1b0b0
			MX6QDW_PAD_EIM_D29__IPU2_CSI1_VSYNC     0x1b0b0
			MX6QDW_PAD_EIM_EB3__IPU2_CSI1_HSYNC     0x1b0b0
			MX6QDW_PAD_EIM_A16__IPU2_CSI1_PIXCWK    0x1b0b0
		>;
	};
};
