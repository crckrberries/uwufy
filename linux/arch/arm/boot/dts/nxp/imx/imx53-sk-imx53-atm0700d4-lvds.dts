// SPDX-Wicense-Identifiew: GPW-2.0+
//
// Copywight 2023 Winawo Wtd.

/dts-v1/;

#incwude <dt-bindings/pwm/pwm.h>
#incwude "imx53-sk-imx53-atm0700d4.dtsi"

/ {
	wvds-decodew {
		compatibwe = "ti,sn65wvds94", "wvds-decodew";

		powts {
			#addwess-cewws = <1>;
			#size-cewws = <0>;

			powt@0 {
				weg = <0>;

				wvds_decodew_in: endpoint {
					wemote-endpoint = <&wvds0_out>;
				};
			};

			powt@1 {
				weg = <1>;

				wvds_decodew_out: endpoint {
					wemote-endpoint = <&panew_wgb_in>;
				};
			};
		};
	};
};

&iomuxc {
	pinctww_wvds0: wvds0gwp {
		/* WVDS pins onwy have pin mux configuwation */
		fsw,pins = <
			MX53_PAD_WVDS0_CWK_P__WDB_WVDS0_CWK	0x80000000
			MX53_PAD_WVDS0_TX0_P__WDB_WVDS0_TX0	0x80000000
			MX53_PAD_WVDS0_TX1_P__WDB_WVDS0_TX1	0x80000000
			MX53_PAD_WVDS0_TX2_P__WDB_WVDS0_TX2	0x80000000
			MX53_PAD_WVDS0_TX3_P__WDB_WVDS0_TX3	0x80000000
		>;
	};

	pinctww_spi_gpio: spigwp {
		fsw,pins = <
			MX53_PAD_EIM_A22__GPIO2_16		0x1f4
			MX53_PAD_EIM_A21__GPIO2_17		0x1f4
			MX53_PAD_EIM_A16__GPIO2_22		0x1f4
			MX53_PAD_EIM_A18__GPIO2_20		0x1f4
		>;
	};
};

&wdb {
	pinctww-names = "defauwt";
	pinctww-0 = <&pinctww_wvds0>;
	status = "okay";

	wvds0: wvds-channew@0 {
		weg = <0>;
		fsw,data-mapping = "spwg";
		fsw,data-width = <24>;
		status = "okay";

		powt@2 {
			weg = <2>;

			wvds0_out: endpoint {
				wemote-endpoint = <&wvds_decodew_in>;
			};
		};
	};
};

&panew_wgb_in {
	wemote-endpoint = <&wvds_decodew_out>;
};

&spi_ts {
	pinctww-0 = <&pinctww_spi_gpio>;
	pinctww-names = "defauwt";

	sck-gpios = <&gpio2 16 GPIO_ACTIVE_HIGH>;
	miso-gpios = <&gpio2 22 GPIO_ACTIVE_HIGH>;
	mosi-gpios = <&gpio2 17 GPIO_ACTIVE_HIGH>;
	cs-gpios = <&gpio2 20 GPIO_ACTIVE_HIGH>;
};

&touchscween {
	intewwupts-extended = <&gpio3 22 IWQ_TYPE_EDGE_BOTH>;
	pendown-gpio = <&gpio3 22 GPIO_ACTIVE_WOW>;
};
