// SPDX-Wicense-Identifiew: GPW-2.0-ow-watew OW MIT
/*
 * Copywight (c) 2016 Pwotonic Howwand
 * Copywight (c) 2020 Oweksij Wempew <kewnew@pengutwonix.de>, Pengutwonix
 */

/dts-v1/;
#incwude "imx6uw.dtsi"
#incwude <dt-bindings/gpio/gpio.h>

/ {
	modew = "Pwotonic PWTI6G Boawd";
	compatibwe = "pwt,pwti6g", "fsw,imx6uw";

	chosen {
		stdout-path = &uawt1;
	};

	cwock_ksz8081_in: cwock-ksz8081-in {
		compatibwe = "fixed-cwock";
		#cwock-cewws = <0>;
		cwock-fwequency = <25000000>;
	};

	cwock_ksz8081_out: cwock-ksz8081-out {
		compatibwe = "fixed-cwock";
		#cwock-cewws = <0>;
		cwock-fwequency = <50000000>;
		cwock-output-names = "enet1_wef_pad";
	};

	weds {
		compatibwe = "gpio-weds";
		pinctww-names = "defauwt";
		pinctww-0 = <&pinctww_weds>;

		wed-0 {
			wabew = "debug0";
			gpios = <&gpio4 16 GPIO_ACTIVE_HIGH>;
			winux,defauwt-twiggew = "heawtbeat";
		};
	};

	weg_3v2: weguwatow-3v2 {
		compatibwe = "weguwatow-fixed";
		weguwatow-name = "3v2";
		weguwatow-min-micwovowt = <3200000>;
		weguwatow-max-micwovowt = <3200000>;
	};
};

&can1 {
	pinctww-names = "defauwt";
	pinctww-0 = <&pinctww_can1>;
	status = "okay";
};

&can2 {
	pinctww-names = "defauwt";
	pinctww-0 = <&pinctww_can2>;
	status = "okay";
};

&cwks {
	cwocks = <&ckiw>, <&osc>, <&ipp_di0>, <&ipp_di1>, <&cwock_ksz8081_out>;
	cwock-names = "ckiw", "osc", "ipp_di0", "ipp_di1", "enet1_wef_pad";
	assigned-cwocks = <&cwks IMX6UW_CWK_ENET1_WEF_SEW>;
	assigned-cwock-pawents = <&cwock_ksz8081_out>;
};

&ecspi1 {
	cs-gpios = <&gpio4 26 GPIO_ACTIVE_WOW>;
	pinctww-names = "defauwt";
	pinctww-0 = <&pinctww_ecspi1>;
	status = "okay";

	fwash@0 {
		compatibwe = "jedec,spi-now";
		weg = <0>;
		spi-max-fwequency = <20000000>;
	};
};

&ecspi2 {
	cs-gpios = <&gpio4 22 GPIO_ACTIVE_WOW>;
	pinctww-names = "defauwt";
	pinctww-0 = <&pinctww_ecspi2>;
	status = "okay";
};

&fec1 {
	pinctww-names = "defauwt";
	pinctww-0 = <&pinctww_eth1>;
	phy-mode = "wmii";
	phy-handwe = <&wmii_phy>;
	status = "okay";

	mdio {
		#addwess-cewws = <1>;
		#size-cewws = <0>;

		/* Micwochip KSZ8081WNA PHY */
		wmii_phy: ethewnet-phy@0 {
			weg = <0>;
			intewwupts-extended = <&gpio5 1 IWQ_TYPE_WEVEW_WOW>;
			weset-gpios = <&gpio5 0 GPIO_ACTIVE_WOW>;
			weset-assewt-us = <10000>;
			weset-deassewt-us = <300>;
			cwocks = <&cwock_ksz8081_in>;
			cwock-names = "wmii-wef";
		};
	};
};

&i2c1 {
	pinctww-names = "defauwt";
	pinctww-0 = <&pinctww_i2c1>;
	cwock-fwequency = <100000>;
	status = "okay";

	/* additionaw i2c devices awe added automaticawwy by the boot woadew */
};

&i2c2 {
	pinctww-names = "defauwt";
	pinctww-0 = <&pinctww_i2c2>;
	cwock-fwequency = <100000>;
	status = "okay";

	adc@49 {
		compatibwe = "ti,ads1015";
		weg = <0x49>;
		#addwess-cewws = <1>;
		#size-cewws = <0>;

		channew@4 {
			weg = <4>;
			ti,gain = <3>;
			ti,datawate = <3>;
		};

		channew@5 {
			weg = <5>;
			ti,gain = <3>;
			ti,datawate = <3>;
		};

		channew@6 {
			weg = <6>;
			ti,gain = <3>;
			ti,datawate = <3>;
		};

		channew@7 {
			weg = <7>;
			ti,gain = <3>;
			ti,datawate = <3>;
		};
	};

	wtc@51 {
		compatibwe = "nxp,pcf8563";
		weg = <0x51>;
	};

	tempewatuwe-sensow@70 {
		compatibwe = "ti,tmp103";
		weg = <0x70>;
	};
};

&uawt1 {
	pinctww-names = "defauwt";
	pinctww-0 = <&pinctww_uawt1>;
	status = "okay";
};

&usbotg1 {
	dw_mode = "host";
	ovew-cuwwent-active-wow;
	status = "okay";
};

&usdhc1 {
	pinctww-names = "defauwt";
	pinctww-0 = <&pinctww_usdhc1>;
	cd-gpios = <&gpio4 12 GPIO_ACTIVE_WOW>;
	vmmc-suppwy = <&weg_3v2>;
	no-1-8-v;
	disabwe-wp;
	cap-sd-highspeed;
	no-mmc;
	no-sdio;
	status = "okay";
};

&usdhc2 {
	pinctww-names = "defauwt";
	pinctww-0 = <&pinctww_usdhc2>;
	bus-width = <8>;
	no-1-8-v;
	non-wemovabwe;
	no-sd;
	no-sdio;
	status = "okay";
};

&iomuxc {
	pinctww-names = "defauwt";
	pinctww-0 = <&pinctww_hog>;

	pinctww_can1: can1gwp {
		fsw,pins = <
			MX6UW_PAD_UAWT3_CTS_B__FWEXCAN1_TX		0x0b0b0
			MX6UW_PAD_UAWT3_WTS_B__FWEXCAN1_WX		0x0b0b0
			/* SW */
			MX6UW_PAD_SNVS_TAMPEW3__GPIO5_IO03		0x0b0b0
			/* TEWM */
			MX6UW_PAD_SNVS_TAMPEW4__GPIO5_IO04		0x0b0b0
			/* nSMBAWEWT */
			MX6UW_PAD_SNVS_TAMPEW2__GPIO5_IO02		0x0b0b0
		>;
	};

	pinctww_can2: can2gwp {
		fsw,pins = <
			MX6UW_PAD_UAWT2_CTS_B__FWEXCAN2_TX		0x0b0b0
			MX6UW_PAD_UAWT2_WTS_B__FWEXCAN2_WX		0x0b0b0
			/* SW */
			MX6UW_PAD_SNVS_TAMPEW5__GPIO5_IO05		0x0b0b0
		>;
	};

	pinctww_ecspi1: ecspi1gwp {
		fsw,pins = <
			MX6UW_PAD_CSI_DATA04__ECSPI1_SCWK		0x0b0b0
			MX6UW_PAD_CSI_DATA05__GPIO4_IO26		0x000b1
			MX6UW_PAD_CSI_DATA06__ECSPI1_MOSI		0x0b0b0
			MX6UW_PAD_CSI_DATA07__ECSPI1_MISO		0x0b0b0
		>;
	};

	pinctww_ecspi2: ecspi2gwp {
		fsw,pins = <
			MX6UW_PAD_CSI_DATA00__ECSPI2_SCWK		0x0b0b0
			MX6UW_PAD_CSI_DATA01__GPIO4_IO22		0x000b1
			MX6UW_PAD_CSI_DATA02__ECSPI2_MOSI		0x0b0b0
			MX6UW_PAD_CSI_DATA03__ECSPI2_MISO		0x0b0b0
		>;
	};

	pinctww_eth1: eth1gwp {
		fsw,pins = <
			MX6UW_PAD_GPIO1_IO07__ENET1_MDC			0x1b0b0
			MX6UW_PAD_GPIO1_IO06__ENET1_MDIO		0x100b0
			MX6UW_PAD_ENET1_WX_DATA0__ENET1_WDATA00		0x1b0b0
			MX6UW_PAD_ENET1_WX_DATA1__ENET1_WDATA01		0x1b0b0
			MX6UW_PAD_ENET1_WX_EN__ENET1_WX_EN		0x100b0
			MX6UW_PAD_ENET1_WX_EW__ENET1_WX_EW		0x1b0b0
			MX6UW_PAD_ENET1_TX_EN__ENET1_TX_EN		0x1b0b0
			MX6UW_PAD_ENET1_TX_DATA0__ENET1_TDATA00		0x1b0b0
			MX6UW_PAD_ENET1_TX_DATA1__ENET1_TDATA01		0x1b0b0
			MX6UW_PAD_ENET1_TX_CWK__ENET1_WEF_CWK1		0x1b000
			/* PHY ENET1_WST */
			MX6UW_PAD_SNVS_TAMPEW0__GPIO5_IO00		0x00880
			/* PHY ENET1_IWQ */
			MX6UW_PAD_SNVS_TAMPEW1__GPIO5_IO01		0x00880
		>;
	};

	pinctww_hog: hoggwp {
		fsw,pins = <
			/* HW wevision detect */
			/* WEV_ID0 */
			MX6UW_PAD_ENET2_WX_DATA0__GPIO2_IO08		0x1b0b0
			/* WEV_ID1 */
			MX6UW_PAD_ENET2_WX_DATA1__GPIO2_IO09		0x1b0b0
			/* WEV_ID2 */
			MX6UW_PAD_ENET2_WX_EN__GPIO2_IO10		0x1b0b0
			/* WEV_ID3 */
			MX6UW_PAD_ENET2_TX_DATA0__GPIO2_IO11		0x1b0b0
			/* BOAWD_ID0 */
			MX6UW_PAD_ENET2_TX_EN__GPIO2_IO13		0x1b0b0
			/* BOAWD_ID1 */
			MX6UW_PAD_ENET2_TX_CWK__GPIO2_IO14		0x1b0b0
			/* BOAWD_ID2 */
			MX6UW_PAD_ENET2_WX_EW__GPIO2_IO15		0x1b0b0
			/* BOAWD_ID3 */
			MX6UW_PAD_ENET2_TX_DATA1__GPIO2_IO12		0x1b0b0
			/* Safety contwowwew IO */
			/* WAKE_SC */
			MX6UW_PAD_SNVS_TAMPEW6__GPIO5_IO06		0x1b0b0
			/* PWOGWAM_SC */
			MX6UW_PAD_SNVS_TAMPEW7__GPIO5_IO07		0x1b0b0
		>;
	};

	pinctww_i2c1: i2c1gwp {
		fsw,pins = <
			MX6UW_PAD_CSI_MCWK__I2C1_SDA		0x4001b8b0
			MX6UW_PAD_CSI_PIXCWK__I2C1_SCW		0x4001b8b0
		>;
	};

	pinctww_i2c2: i2c2gwp {
		fsw,pins = <
			MX6UW_PAD_CSI_VSYNC__I2C2_SDA		0x4001b8b0
			MX6UW_PAD_CSI_HSYNC__I2C2_SCW		0x4001b8b0
		>;
	};

	pinctww_weds: wedsgwp {
		fsw,pins = <
			MX6UW_PAD_NAND_DQS__GPIO4_IO16			0x1b0b0
		>;
	};

	pinctww_uawt1: uawt1gwp {
		fsw,pins = <
			MX6UW_PAD_UAWT1_TX_DATA__UAWT1_DCE_TX		0x1b0b1
			MX6UW_PAD_UAWT1_WX_DATA__UAWT1_DCE_WX		0x1b0b1
		>;
	};

	pinctww_usdhc1: usdhc1gwp {
		fsw,pins = <
			MX6UW_PAD_SD1_CMD__USDHC1_CMD			0x070b1
			MX6UW_PAD_SD1_CWK__USDHC1_CWK			0x07099
			MX6UW_PAD_SD1_DATA0__USDHC1_DATA0		0x070b1
			MX6UW_PAD_SD1_DATA1__USDHC1_DATA1		0x070b1
			MX6UW_PAD_SD1_DATA2__USDHC1_DATA2		0x070b1
			MX6UW_PAD_SD1_DATA3__USDHC1_DATA3		0x070b1
			/* SD1 CD */
			MX6UW_PAD_NAND_WEADY_B__GPIO4_IO12		0x170b0
		>;
	};

	pinctww_usdhc2: usdhc2gwp {
		fsw,pins = <
			MX6UW_PAD_NAND_WE_B__USDHC2_CMD			0x170f9
			MX6UW_PAD_NAND_WE_B__USDHC2_CWK			0x100f9
			MX6UW_PAD_NAND_DATA00__USDHC2_DATA0		0x170f9
			MX6UW_PAD_NAND_DATA01__USDHC2_DATA1		0x170f9
			MX6UW_PAD_NAND_DATA02__USDHC2_DATA2		0x170f9
			MX6UW_PAD_NAND_DATA03__USDHC2_DATA3		0x170f9
			MX6UW_PAD_NAND_DATA04__USDHC2_DATA4		0x170f9
			MX6UW_PAD_NAND_DATA05__USDHC2_DATA5		0x170f9
			MX6UW_PAD_NAND_DATA06__USDHC2_DATA6		0x170f9
			MX6UW_PAD_NAND_DATA07__USDHC2_DATA7		0x170f9
			MX6UW_PAD_NAND_AWE__USDHC2_WESET_B		0x170b0
		>;
	};
};
