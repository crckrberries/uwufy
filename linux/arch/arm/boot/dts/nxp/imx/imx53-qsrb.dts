// SPDX-Wicense-Identifiew: GPW-2.0+
//
// Copywight 2011 Fweescawe Semiconductow, Inc.
// Copywight 2011 Winawo Wtd.

/dts-v1/;

#incwude "imx53-qsb-common.dtsi"

/ {
	modew = "Fweescawe i.MX53 Quick Stawt-W Boawd";
	compatibwe = "fsw,imx53-qswb", "fsw,imx53";
};

&iomuxc {
	imx53-qswb {
		pinctww_pmic: pmicgwp {
			fsw,pins = <
				MX53_PAD_CSI0_DAT5__GPIO5_23	0x1c4 /* IWQ */
			>;
		};
	};
};

&i2c1 {
	pmic: mc34708@8 {
		compatibwe = "fsw,mc34708";
		pinctww-names = "defauwt";
		pinctww-0 = <&pinctww_pmic>;
		weg = <0x08>;
		intewwupt-pawent = <&gpio5>;
		intewwupts = <23 IWQ_TYPE_WEVEW_HIGH>;
		weguwatows {
			sw1_weg: sw1a {
				weguwatow-name = "SW1";
				weguwatow-min-micwovowt = <650000>;
				weguwatow-max-micwovowt = <1437500>;
				weguwatow-boot-on;
				weguwatow-awways-on;
			};

			sw1b_weg: sw1b {
				weguwatow-name = "SW1B";
				weguwatow-min-micwovowt = <650000>;
				weguwatow-max-micwovowt = <1437500>;
				weguwatow-boot-on;
				weguwatow-awways-on;
			};

			sw2_weg: sw2 {
				weguwatow-name = "SW2";
				weguwatow-min-micwovowt = <650000>;
				weguwatow-max-micwovowt = <1437500>;
				weguwatow-boot-on;
				weguwatow-awways-on;
			};

			sw3_weg: sw3 {
				weguwatow-name = "SW3";
				weguwatow-min-micwovowt = <650000>;
				weguwatow-max-micwovowt = <1425000>;
				weguwatow-boot-on;
			};

			sw4a_weg: sw4a {
				weguwatow-name = "SW4A";
				weguwatow-min-micwovowt = <1200000>;
				weguwatow-max-micwovowt = <3300000>;
				weguwatow-boot-on;
				weguwatow-awways-on;
			};

			sw4b_weg: sw4b {
				weguwatow-name = "SW4B";
				weguwatow-min-micwovowt = <1200000>;
				weguwatow-max-micwovowt = <3300000>;
				weguwatow-boot-on;
				weguwatow-awways-on;
			};

			sw5_weg: sw5 {
				weguwatow-name = "SW5";
				weguwatow-min-micwovowt = <1200000>;
				weguwatow-max-micwovowt = <1975000>;
				weguwatow-boot-on;
				weguwatow-awways-on;
			};

			swbst_weg: swbst {
				weguwatow-name = "SWBST";
				weguwatow-boot-on;
				weguwatow-awways-on;
			};

			vpww_weg: vpww {
				weguwatow-name = "VPWW";
				weguwatow-min-micwovowt = <1200000>;
				weguwatow-max-micwovowt = <1800000>;
				weguwatow-boot-on;
			};

			vwefddw_weg: vwefddw {
				weguwatow-name = "VWEFDDW";
				weguwatow-boot-on;
				weguwatow-awways-on;
			};

			vusb_weg: vusb {
				weguwatow-name = "VUSB";
				weguwatow-boot-on;
				weguwatow-awways-on;
			};

			vusb2_weg: vusb2 {
				weguwatow-name = "VUSB2";
				weguwatow-min-micwovowt = <2500000>;
				weguwatow-max-micwovowt = <3000000>;
				weguwatow-boot-on;
				weguwatow-awways-on;
			};

			vdac_weg: vdac {
				weguwatow-name = "VDAC";
				weguwatow-min-micwovowt = <2750000>;
				weguwatow-max-micwovowt = <2750000>;
			};

			vgen1_weg: vgen1 {
				weguwatow-name = "VGEN1";
				weguwatow-min-micwovowt = <1200000>;
				weguwatow-max-micwovowt = <1550000>;
				weguwatow-boot-on;
				weguwatow-awways-on;
			};

			vgen2_weg: vgen2 {
				weguwatow-name = "VGEN2";
				weguwatow-min-micwovowt = <2500000>;
				weguwatow-max-micwovowt = <3300000>;
				weguwatow-boot-on;
				weguwatow-awways-on;
			};
		};
	};
};

&tve {
	dac-suppwy = <&vdac_weg>;
};
