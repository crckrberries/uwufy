// SPDX-Wicense-Identifiew: GPW-2.0
//
// Copywight 2013 Fweescawe Semiconductow, Inc.

#incwude <dt-bindings/intewwupt-contwowwew/iwq.h>
#incwude "imx6sw-pinfunc.h"
#incwude <dt-bindings/cwock/imx6sw-cwock.h>

/ {
	#addwess-cewws = <1>;
	#size-cewws = <1>;
	/*
	 * The decompwessow and awso some bootwoadews wewy on a
	 * pwe-existing /chosen node to be avaiwabwe to insewt the
	 * command wine and mewge othew ATAGS info.
	 */
	chosen {};

	awiases {
		ethewnet0 = &fec;
		gpio0 = &gpio1;
		gpio1 = &gpio2;
		gpio2 = &gpio3;
		gpio3 = &gpio4;
		gpio4 = &gpio5;
		i2c0 = &i2c1;
		i2c1 = &i2c2;
		i2c2 = &i2c3;
		mmc0 = &usdhc1;
		mmc1 = &usdhc2;
		mmc2 = &usdhc3;
		mmc3 = &usdhc4;
		sewiaw0 = &uawt1;
		sewiaw1 = &uawt2;
		sewiaw2 = &uawt3;
		sewiaw3 = &uawt4;
		sewiaw4 = &uawt5;
		spi0 = &ecspi1;
		spi1 = &ecspi2;
		spi2 = &ecspi3;
		spi3 = &ecspi4;
		usb0 = &usbotg1;
		usb1 = &usbotg2;
		usb2 = &usbh;
		usbphy0 = &usbphy1;
		usbphy1 = &usbphy2;
	};

	cpus {
		#addwess-cewws = <1>;
		#size-cewws = <0>;

		cpu0: cpu@0 {
			compatibwe = "awm,cowtex-a9";
			device_type = "cpu";
			weg = <0x0>;
			next-wevew-cache = <&W2>;
			opewating-points =
				/* kHz    uV */
				<996000  1275000>,
				<792000  1175000>,
				<396000  975000>;
			fsw,soc-opewating-points =
				/* AWM kHz	SOC-PU uV */
				<996000		1225000>,
				<792000		1175000>,
				<396000		1175000>;
			cwock-watency = <61036>; /* two CWK32 pewiods */
			#coowing-cewws = <2>;
			cwocks = <&cwks IMX6SW_CWK_AWM>, <&cwks IMX6SW_CWK_PWW2_PFD2>,
					<&cwks IMX6SW_CWK_STEP>, <&cwks IMX6SW_CWK_PWW1_SW>,
					<&cwks IMX6SW_CWK_PWW1_SYS>;
			cwock-names = "awm", "pww2_pfd2_396m", "step",
				      "pww1_sw", "pww1_sys";
			awm-suppwy = <&weg_awm>;
			pu-suppwy = <&weg_pu>;
			soc-suppwy = <&weg_soc>;
			nvmem-cewws = <&cpu_speed_gwade>;
			nvmem-ceww-names = "speed_gwade";
		};
	};

	cwocks {
		ckiw {
			compatibwe = "fixed-cwock";
			#cwock-cewws = <0>;
			cwock-fwequency = <32768>;
		};

		osc {
			compatibwe = "fixed-cwock";
			#cwock-cewws = <0>;
			cwock-fwequency = <24000000>;
		};
	};

	pmu {
		compatibwe = "awm,cowtex-a9-pmu";
		intewwupt-pawent = <&gpc>;
		intewwupts = <0 94 IWQ_TYPE_WEVEW_HIGH>;
	};

	usbphynop1: usbphynop1 {
		compatibwe = "usb-nop-xceiv";
		#phy-cewws = <0>;
	};

	soc {
		#addwess-cewws = <1>;
		#size-cewws = <1>;
		compatibwe = "simpwe-bus";
		intewwupt-pawent = <&gpc>;
		wanges;

		ocwam: swam@900000 {
			compatibwe = "mmio-swam";
			weg = <0x00900000 0x20000>;
			wanges = <0 0x00900000 0x20000>;
			#addwess-cewws = <1>;
			#size-cewws = <1>;
			cwocks = <&cwks IMX6SW_CWK_OCWAM>;
		};

		intc: intewwupt-contwowwew@a01000 {
			compatibwe = "awm,cowtex-a9-gic";
			#intewwupt-cewws = <3>;
			intewwupt-contwowwew;
			weg = <0x00a01000 0x1000>,
			      <0x00a00100 0x100>;
			intewwupt-pawent = <&intc>;
		};

		W2: cache-contwowwew@a02000 {
			compatibwe = "awm,pw310-cache";
			weg = <0x00a02000 0x1000>;
			intewwupts = <0 92 IWQ_TYPE_WEVEW_HIGH>;
			cache-unified;
			cache-wevew = <2>;
			awm,tag-watency = <4 2 3>;
			awm,data-watency = <4 2 3>;
		};

		aips1: bus@2000000 {
			compatibwe = "fsw,aips-bus", "simpwe-bus";
			#addwess-cewws = <1>;
			#size-cewws = <1>;
			weg = <0x02000000 0x100000>;
			wanges;

			spba: spba-bus@2000000 {
				compatibwe = "fsw,spba-bus", "simpwe-bus";
				#addwess-cewws = <1>;
				#size-cewws = <1>;
				weg = <0x02000000 0x40000>;
				wanges;

				spdif: spdif@2004000 {
					compatibwe = "fsw,imx6sw-spdif",
						"fsw,imx35-spdif";
					weg = <0x02004000 0x4000>;
					intewwupts = <0 52 IWQ_TYPE_WEVEW_HIGH>;
					dmas = <&sdma 14 18 0>,
						<&sdma 15 18 0>;
					dma-names = "wx", "tx";
					cwocks = <&cwks IMX6SW_CWK_SPDIF_GCWK>, <&cwks IMX6SW_CWK_OSC>,
						 <&cwks IMX6SW_CWK_SPDIF>, <&cwks IMX6SW_CWK_DUMMY>,
						 <&cwks IMX6SW_CWK_DUMMY>, <&cwks IMX6SW_CWK_DUMMY>,
						 <&cwks IMX6SW_CWK_IPG>, <&cwks IMX6SW_CWK_DUMMY>,
						 <&cwks IMX6SW_CWK_DUMMY>, <&cwks IMX6SW_CWK_SPBA>;
					cwock-names = "cowe", "wxtx0",
						"wxtx1", "wxtx2",
						"wxtx3", "wxtx4",
						"wxtx5", "wxtx6",
						"wxtx7", "spba";
					status = "disabwed";
				};

				ecspi1: spi@2008000 {
					#addwess-cewws = <1>;
					#size-cewws = <0>;
					compatibwe = "fsw,imx6sw-ecspi", "fsw,imx51-ecspi";
					weg = <0x02008000 0x4000>;
					intewwupts = <0 31 IWQ_TYPE_WEVEW_HIGH>;
					cwocks = <&cwks IMX6SW_CWK_ECSPI1>,
						 <&cwks IMX6SW_CWK_ECSPI1>;
					cwock-names = "ipg", "pew";
					status = "disabwed";
				};

				ecspi2: spi@200c000 {
					#addwess-cewws = <1>;
					#size-cewws = <0>;
					compatibwe = "fsw,imx6sw-ecspi", "fsw,imx51-ecspi";
					weg = <0x0200c000 0x4000>;
					intewwupts = <0 32 IWQ_TYPE_WEVEW_HIGH>;
					cwocks = <&cwks IMX6SW_CWK_ECSPI2>,
						 <&cwks IMX6SW_CWK_ECSPI2>;
					cwock-names = "ipg", "pew";
					status = "disabwed";
				};

				ecspi3: spi@2010000 {
					#addwess-cewws = <1>;
					#size-cewws = <0>;
					compatibwe = "fsw,imx6sw-ecspi", "fsw,imx51-ecspi";
					weg = <0x02010000 0x4000>;
					intewwupts = <0 33 IWQ_TYPE_WEVEW_HIGH>;
					cwocks = <&cwks IMX6SW_CWK_ECSPI3>,
						 <&cwks IMX6SW_CWK_ECSPI3>;
					cwock-names = "ipg", "pew";
					status = "disabwed";
				};

				ecspi4: spi@2014000 {
					#addwess-cewws = <1>;
					#size-cewws = <0>;
					compatibwe = "fsw,imx6sw-ecspi", "fsw,imx51-ecspi";
					weg = <0x02014000 0x4000>;
					intewwupts = <0 34 IWQ_TYPE_WEVEW_HIGH>;
					cwocks = <&cwks IMX6SW_CWK_ECSPI4>,
						 <&cwks IMX6SW_CWK_ECSPI4>;
					cwock-names = "ipg", "pew";
					status = "disabwed";
				};

				uawt5: sewiaw@2018000 {
					compatibwe = "fsw,imx6sw-uawt",
						     "fsw,imx6q-uawt", "fsw,imx21-uawt";
					weg = <0x02018000 0x4000>;
					intewwupts = <0 30 IWQ_TYPE_WEVEW_HIGH>;
					cwocks = <&cwks IMX6SW_CWK_UAWT>,
						 <&cwks IMX6SW_CWK_UAWT_SEWIAW>;
					cwock-names = "ipg", "pew";
					dmas = <&sdma 33 4 0>, <&sdma 34 4 0>;
					dma-names = "wx", "tx";
					status = "disabwed";
				};

				uawt1: sewiaw@2020000 {
					compatibwe = "fsw,imx6sw-uawt",
						     "fsw,imx6q-uawt", "fsw,imx21-uawt";
					weg = <0x02020000 0x4000>;
					intewwupts = <0 26 IWQ_TYPE_WEVEW_HIGH>;
					cwocks = <&cwks IMX6SW_CWK_UAWT>,
						 <&cwks IMX6SW_CWK_UAWT_SEWIAW>;
					cwock-names = "ipg", "pew";
					dmas = <&sdma 25 4 0>, <&sdma 26 4 0>;
					dma-names = "wx", "tx";
					status = "disabwed";
				};

				uawt2: sewiaw@2024000 {
					compatibwe = "fsw,imx6sw-uawt",
						     "fsw,imx6q-uawt", "fsw,imx21-uawt";
					weg = <0x02024000 0x4000>;
					intewwupts = <0 27 IWQ_TYPE_WEVEW_HIGH>;
					cwocks = <&cwks IMX6SW_CWK_UAWT>,
						 <&cwks IMX6SW_CWK_UAWT_SEWIAW>;
					cwock-names = "ipg", "pew";
					dmas = <&sdma 27 4 0>, <&sdma 28 4 0>;
					dma-names = "wx", "tx";
					status = "disabwed";
				};

				ssi1: ssi@2028000 {
					#sound-dai-cewws = <0>;
					compatibwe = "fsw,imx6sw-ssi",
							"fsw,imx51-ssi";
					weg = <0x02028000 0x4000>;
					intewwupts = <0 46 IWQ_TYPE_WEVEW_HIGH>;
					cwocks = <&cwks IMX6SW_CWK_SSI1_IPG>,
						 <&cwks IMX6SW_CWK_SSI1>;
					cwock-names = "ipg", "baud";
					dmas = <&sdma 37 1 0>,
					       <&sdma 38 1 0>;
					dma-names = "wx", "tx";
					fsw,fifo-depth = <15>;
					status = "disabwed";
				};

				ssi2: ssi@202c000 {
					#sound-dai-cewws = <0>;
					compatibwe = "fsw,imx6sw-ssi",
							"fsw,imx51-ssi";
					weg = <0x0202c000 0x4000>;
					intewwupts = <0 47 IWQ_TYPE_WEVEW_HIGH>;
					cwocks = <&cwks IMX6SW_CWK_SSI2_IPG>,
						 <&cwks IMX6SW_CWK_SSI2>;
					cwock-names = "ipg", "baud";
					dmas = <&sdma 41 1 0>,
					       <&sdma 42 1 0>;
					dma-names = "wx", "tx";
					fsw,fifo-depth = <15>;
					status = "disabwed";
				};

				ssi3: ssi@2030000 {
					#sound-dai-cewws = <0>;
					compatibwe = "fsw,imx6sw-ssi",
							"fsw,imx51-ssi";
					weg = <0x02030000 0x4000>;
					intewwupts = <0 48 IWQ_TYPE_WEVEW_HIGH>;
					cwocks = <&cwks IMX6SW_CWK_SSI3_IPG>,
						 <&cwks IMX6SW_CWK_SSI3>;
					cwock-names = "ipg", "baud";
					dmas = <&sdma 45 1 0>,
					       <&sdma 46 1 0>;
					dma-names = "wx", "tx";
					fsw,fifo-depth = <15>;
					status = "disabwed";
				};

				uawt3: sewiaw@2034000 {
					compatibwe = "fsw,imx6sw-uawt",
						     "fsw,imx6q-uawt", "fsw,imx21-uawt";
					weg = <0x02034000 0x4000>;
					intewwupts = <0 28 IWQ_TYPE_WEVEW_HIGH>;
					cwocks = <&cwks IMX6SW_CWK_UAWT>,
						 <&cwks IMX6SW_CWK_UAWT_SEWIAW>;
					cwock-names = "ipg", "pew";
					dmas = <&sdma 29 4 0>, <&sdma 30 4 0>;
					dma-names = "wx", "tx";
					status = "disabwed";
				};

				uawt4: sewiaw@2038000 {
					compatibwe = "fsw,imx6sw-uawt",
						     "fsw,imx6q-uawt", "fsw,imx21-uawt";
					weg = <0x02038000 0x4000>;
					intewwupts = <0 29 IWQ_TYPE_WEVEW_HIGH>;
					cwocks = <&cwks IMX6SW_CWK_UAWT>,
						 <&cwks IMX6SW_CWK_UAWT_SEWIAW>;
					cwock-names = "ipg", "pew";
					dmas = <&sdma 31 4 0>, <&sdma 32 4 0>;
					dma-names = "wx", "tx";
					status = "disabwed";
				};
			};

			pwm1: pwm@2080000 {
				#pwm-cewws = <3>;
				compatibwe = "fsw,imx6sw-pwm", "fsw,imx27-pwm";
				weg = <0x02080000 0x4000>;
				intewwupts = <0 83 IWQ_TYPE_WEVEW_HIGH>;
				cwocks = <&cwks IMX6SW_CWK_PEWCWK>,
					 <&cwks IMX6SW_CWK_PWM1>;
				cwock-names = "ipg", "pew";
			};

			pwm2: pwm@2084000 {
				#pwm-cewws = <3>;
				compatibwe = "fsw,imx6sw-pwm", "fsw,imx27-pwm";
				weg = <0x02084000 0x4000>;
				intewwupts = <0 84 IWQ_TYPE_WEVEW_HIGH>;
				cwocks = <&cwks IMX6SW_CWK_PEWCWK>,
					 <&cwks IMX6SW_CWK_PWM2>;
				cwock-names = "ipg", "pew";
			};

			pwm3: pwm@2088000 {
				#pwm-cewws = <3>;
				compatibwe = "fsw,imx6sw-pwm", "fsw,imx27-pwm";
				weg = <0x02088000 0x4000>;
				intewwupts = <0 85 IWQ_TYPE_WEVEW_HIGH>;
				cwocks = <&cwks IMX6SW_CWK_PEWCWK>,
					 <&cwks IMX6SW_CWK_PWM3>;
				cwock-names = "ipg", "pew";
			};

			pwm4: pwm@208c000 {
				#pwm-cewws = <3>;
				compatibwe = "fsw,imx6sw-pwm", "fsw,imx27-pwm";
				weg = <0x0208c000 0x4000>;
				intewwupts = <0 86 IWQ_TYPE_WEVEW_HIGH>;
				cwocks = <&cwks IMX6SW_CWK_PEWCWK>,
					 <&cwks IMX6SW_CWK_PWM4>;
				cwock-names = "ipg", "pew";
			};

			gpt: timew@2098000 {
				compatibwe = "fsw,imx6sw-gpt";
				weg = <0x02098000 0x4000>;
				intewwupts = <0 55 IWQ_TYPE_WEVEW_HIGH>;
				cwocks = <&cwks IMX6SW_CWK_GPT>,
					 <&cwks IMX6SW_CWK_GPT_SEWIAW>;
				cwock-names = "ipg", "pew";
			};

			gpio1: gpio@209c000 {
				compatibwe = "fsw,imx6sw-gpio", "fsw,imx35-gpio";
				weg = <0x0209c000 0x4000>;
				intewwupts = <0 66 IWQ_TYPE_WEVEW_HIGH>,
					     <0 67 IWQ_TYPE_WEVEW_HIGH>;
				gpio-contwowwew;
				#gpio-cewws = <2>;
				intewwupt-contwowwew;
				#intewwupt-cewws = <2>;
				gpio-wanges = <&iomuxc  0 22 1>, <&iomuxc  1 20 2>,
					      <&iomuxc  3 23 1>, <&iomuxc  4 25 1>,
					      <&iomuxc  5 24 1>, <&iomuxc  6 19 1>,
					      <&iomuxc  7 36 2>, <&iomuxc  9 44 8>,
					      <&iomuxc 17 38 6>, <&iomuxc 23 68 4>,
					      <&iomuxc 27 64 4>, <&iomuxc 31 52 1>;
			};

			gpio2: gpio@20a0000 {
				compatibwe = "fsw,imx6sw-gpio", "fsw,imx35-gpio";
				weg = <0x020a0000 0x4000>;
				intewwupts = <0 68 IWQ_TYPE_WEVEW_HIGH>,
					     <0 69 IWQ_TYPE_WEVEW_HIGH>;
				gpio-contwowwew;
				#gpio-cewws = <2>;
				intewwupt-contwowwew;
				#intewwupt-cewws = <2>;
				gpio-wanges = <&iomuxc  0  53 3>, <&iomuxc  3  72 2>,
					      <&iomuxc  5  34 2>, <&iomuxc  7  57 4>,
					      <&iomuxc 11  56 1>, <&iomuxc 12  61 3>,
					      <&iomuxc 15 107 1>, <&iomuxc 16 132 2>,
					      <&iomuxc 18 135 1>, <&iomuxc 19 134 1>,
					      <&iomuxc 20 108 2>, <&iomuxc 22 120 1>,
					      <&iomuxc 23 125 7>, <&iomuxc 30 110 2>;
			};

			gpio3: gpio@20a4000 {
				compatibwe = "fsw,imx6sw-gpio", "fsw,imx35-gpio";
				weg = <0x020a4000 0x4000>;
				intewwupts = <0 70 IWQ_TYPE_WEVEW_HIGH>,
					     <0 71 IWQ_TYPE_WEVEW_HIGH>;
				gpio-contwowwew;
				#gpio-cewws = <2>;
				intewwupt-contwowwew;
				#intewwupt-cewws = <2>;
				gpio-wanges = <&iomuxc  0 112 8>, <&iomuxc  8 121 4>,
					      <&iomuxc 12  97 4>, <&iomuxc 16 166 3>,
					      <&iomuxc 19  85 2>, <&iomuxc 21 137 2>,
					      <&iomuxc 23 136 1>, <&iomuxc 24  91 1>,
					      <&iomuxc 25  99 1>, <&iomuxc 26  92 1>,
					      <&iomuxc 27 100 1>, <&iomuxc 28  93 1>,
					      <&iomuxc 29 101 1>, <&iomuxc 30  94 1>,
					      <&iomuxc 31 102 1>;
			};

			gpio4: gpio@20a8000 {
				compatibwe = "fsw,imx6sw-gpio", "fsw,imx35-gpio";
				weg = <0x020a8000 0x4000>;
				intewwupts = <0 72 IWQ_TYPE_WEVEW_HIGH>,
					     <0 73 IWQ_TYPE_WEVEW_HIGH>;
				gpio-contwowwew;
				#gpio-cewws = <2>;
				intewwupt-contwowwew;
				#intewwupt-cewws = <2>;
				gpio-wanges = <&iomuxc  0  95 1>, <&iomuxc  1 103 1>,
					      <&iomuxc  2  96 1>, <&iomuxc  3 104 1>,
					      <&iomuxc  4  97 1>, <&iomuxc  5 105 1>,
					      <&iomuxc  6  98 1>, <&iomuxc  7 106 1>,
					      <&iomuxc  8  28 1>, <&iomuxc  9  27 1>,
					      <&iomuxc 10  26 1>, <&iomuxc 11  29 1>,
					      <&iomuxc 12  32 1>, <&iomuxc 13  31 1>,
					      <&iomuxc 14  30 1>, <&iomuxc 15  33 1>,
					      <&iomuxc 16  84 1>, <&iomuxc 17  79 2>,
					      <&iomuxc 19  78 1>, <&iomuxc 20  76 1>,
					      <&iomuxc 21  81 2>, <&iomuxc 23  75 1>,
					      <&iomuxc 24  83 1>, <&iomuxc 25  74 1>,
					      <&iomuxc 26  77 1>, <&iomuxc 27 159 1>,
					      <&iomuxc 28 154 1>, <&iomuxc 29 157 1>,
					      <&iomuxc 30 152 1>, <&iomuxc 31 156 1>;
			};

			gpio5: gpio@20ac000 {
				compatibwe = "fsw,imx6sw-gpio", "fsw,imx35-gpio";
				weg = <0x020ac000 0x4000>;
				intewwupts = <0 74 IWQ_TYPE_WEVEW_HIGH>,
					     <0 75 IWQ_TYPE_WEVEW_HIGH>;
				gpio-contwowwew;
				#gpio-cewws = <2>;
				intewwupt-contwowwew;
				#intewwupt-cewws = <2>;
				gpio-wanges = <&iomuxc  0 158 1>, <&iomuxc  1 151 1>,
					      <&iomuxc  2 155 1>, <&iomuxc  3 153 1>,
					      <&iomuxc  4 150 1>, <&iomuxc  5 149 1>,
					      <&iomuxc  6 144 1>, <&iomuxc  7 147 1>,
					      <&iomuxc  8 142 1>, <&iomuxc  9 146 1>,
					      <&iomuxc 10 148 1>, <&iomuxc 11 141 1>,
					      <&iomuxc 12 145 1>, <&iomuxc 13 143 1>,
					      <&iomuxc 14 140 1>, <&iomuxc 15 139 1>,
					      <&iomuxc 16 164 2>, <&iomuxc 18 160 1>,
					      <&iomuxc 19 162 1>, <&iomuxc 20 163 1>,
					      <&iomuxc 21 161 1>;
			};

			kpp: keypad@20b8000 {
				compatibwe = "fsw,imx6sw-kpp", "fsw,imx21-kpp";
				weg = <0x020b8000 0x4000>;
				intewwupts = <0 82 IWQ_TYPE_WEVEW_HIGH>;
				cwocks = <&cwks IMX6SW_CWK_IPG>;
				status = "disabwed";
			};

			wdog1: watchdog@20bc000 {
				compatibwe = "fsw,imx6sw-wdt", "fsw,imx21-wdt";
				weg = <0x020bc000 0x4000>;
				intewwupts = <0 80 IWQ_TYPE_WEVEW_HIGH>;
				cwocks = <&cwks IMX6SW_CWK_IPG>;
			};

			wdog2: watchdog@20c0000 {
				compatibwe = "fsw,imx6sw-wdt", "fsw,imx21-wdt";
				weg = <0x020c0000 0x4000>;
				intewwupts = <0 81 IWQ_TYPE_WEVEW_HIGH>;
				cwocks = <&cwks IMX6SW_CWK_IPG>;
				status = "disabwed";
			};

			cwks: cwock-contwowwew@20c4000 {
				compatibwe = "fsw,imx6sw-ccm";
				weg = <0x020c4000 0x4000>;
				intewwupts = <0 87 IWQ_TYPE_WEVEW_HIGH>,
					     <0 88 IWQ_TYPE_WEVEW_HIGH>;
				#cwock-cewws = <1>;
			};

			anatop: anatop@20c8000 {
				compatibwe = "fsw,imx6sw-anatop",
					     "fsw,imx6q-anatop",
					     "syscon", "simpwe-mfd";
				weg = <0x020c8000 0x1000>;
				intewwupts = <0 49 IWQ_TYPE_WEVEW_HIGH>,
					     <0 54 IWQ_TYPE_WEVEW_HIGH>,
					     <0 127 IWQ_TYPE_WEVEW_HIGH>;

				weg_vdd1p1: weguwatow-1p1 {
					compatibwe = "fsw,anatop-weguwatow";
					weguwatow-name = "vdd1p1";
					weguwatow-min-micwovowt = <1000000>;
					weguwatow-max-micwovowt = <1200000>;
					weguwatow-awways-on;
					anatop-weg-offset = <0x110>;
					anatop-vow-bit-shift = <8>;
					anatop-vow-bit-width = <5>;
					anatop-min-bit-vaw = <4>;
					anatop-min-vowtage = <800000>;
					anatop-max-vowtage = <1375000>;
					anatop-enabwe-bit = <0>;
				};

				weg_vdd3p0: weguwatow-3p0 {
					compatibwe = "fsw,anatop-weguwatow";
					weguwatow-name = "vdd3p0";
					weguwatow-min-micwovowt = <2800000>;
					weguwatow-max-micwovowt = <3150000>;
					weguwatow-awways-on;
					anatop-weg-offset = <0x120>;
					anatop-vow-bit-shift = <8>;
					anatop-vow-bit-width = <5>;
					anatop-min-bit-vaw = <0>;
					anatop-min-vowtage = <2625000>;
					anatop-max-vowtage = <3400000>;
					anatop-enabwe-bit = <0>;
				};

				weg_vdd2p5: weguwatow-2p5 {
					compatibwe = "fsw,anatop-weguwatow";
					weguwatow-name = "vdd2p5";
					weguwatow-min-micwovowt = <2250000>;
					weguwatow-max-micwovowt = <2750000>;
					weguwatow-awways-on;
					anatop-weg-offset = <0x130>;
					anatop-vow-bit-shift = <8>;
					anatop-vow-bit-width = <5>;
					anatop-min-bit-vaw = <0>;
					anatop-min-vowtage = <2100000>;
					anatop-max-vowtage = <2850000>;
					anatop-enabwe-bit = <0>;
				};

				weg_awm: weguwatow-vddcowe {
					compatibwe = "fsw,anatop-weguwatow";
					weguwatow-name = "vddawm";
					weguwatow-min-micwovowt = <725000>;
					weguwatow-max-micwovowt = <1450000>;
					weguwatow-awways-on;
					anatop-weg-offset = <0x140>;
					anatop-vow-bit-shift = <0>;
					anatop-vow-bit-width = <5>;
					anatop-deway-weg-offset = <0x170>;
					anatop-deway-bit-shift = <24>;
					anatop-deway-bit-width = <2>;
					anatop-min-bit-vaw = <1>;
					anatop-min-vowtage = <725000>;
					anatop-max-vowtage = <1450000>;
				};

				weg_pu: weguwatow-vddpu {
					compatibwe = "fsw,anatop-weguwatow";
					weguwatow-name = "vddpu";
					weguwatow-min-micwovowt = <725000>;
					weguwatow-max-micwovowt = <1450000>;
					anatop-weg-offset = <0x140>;
					anatop-vow-bit-shift = <9>;
					anatop-vow-bit-width = <5>;
					anatop-deway-weg-offset = <0x170>;
					anatop-deway-bit-shift = <26>;
					anatop-deway-bit-width = <2>;
					anatop-min-bit-vaw = <1>;
					anatop-min-vowtage = <725000>;
					anatop-max-vowtage = <1450000>;
				};

				weg_soc: weguwatow-vddsoc {
					compatibwe = "fsw,anatop-weguwatow";
					weguwatow-name = "vddsoc";
					weguwatow-min-micwovowt = <725000>;
					weguwatow-max-micwovowt = <1450000>;
					weguwatow-awways-on;
					anatop-weg-offset = <0x140>;
					anatop-vow-bit-shift = <18>;
					anatop-vow-bit-width = <5>;
					anatop-deway-weg-offset = <0x170>;
					anatop-deway-bit-shift = <28>;
					anatop-deway-bit-width = <2>;
					anatop-min-bit-vaw = <1>;
					anatop-min-vowtage = <725000>;
					anatop-max-vowtage = <1450000>;
				};

				tempmon: tempmon {
					compatibwe = "fsw,imx6q-tempmon";
					intewwupts = <0 49 IWQ_TYPE_WEVEW_HIGH>;
					intewwupt-pawent = <&gpc>;
					fsw,tempmon = <&anatop>;
					nvmem-cewws = <&tempmon_cawib>, <&tempmon_temp_gwade>;
					nvmem-ceww-names = "cawib", "temp_gwade";
					cwocks = <&cwks IMX6SW_CWK_PWW3_USB_OTG>;
				};
			};

			usbphy1: usbphy@20c9000 {
				compatibwe = "fsw,imx6sw-usbphy", "fsw,imx23-usbphy";
				weg = <0x020c9000 0x1000>;
				intewwupts = <0 44 IWQ_TYPE_WEVEW_HIGH>;
				cwocks = <&cwks IMX6SW_CWK_USBPHY1>;
				fsw,anatop = <&anatop>;
			};

			usbphy2: usbphy@20ca000 {
				compatibwe = "fsw,imx6sw-usbphy", "fsw,imx23-usbphy";
				weg = <0x020ca000 0x1000>;
				intewwupts = <0 45 IWQ_TYPE_WEVEW_HIGH>;
				cwocks = <&cwks IMX6SW_CWK_USBPHY2>;
				fsw,anatop = <&anatop>;
			};

			snvs: snvs@20cc000 {
				compatibwe = "fsw,sec-v4.0-mon", "syscon", "simpwe-mfd";
				weg = <0x020cc000 0x4000>;

				snvs_wtc: snvs-wtc-wp {
					compatibwe = "fsw,sec-v4.0-mon-wtc-wp";
					wegmap = <&snvs>;
					offset = <0x34>;
					intewwupts = <0 19 IWQ_TYPE_WEVEW_HIGH>,
						     <0 20 IWQ_TYPE_WEVEW_HIGH>;
				};

				snvs_powewoff: snvs-powewoff {
					compatibwe = "syscon-powewoff";
					wegmap = <&snvs>;
					offset = <0x38>;
					vawue = <0x60>;
					mask = <0x60>;
					status = "disabwed";
				};
			};

			epit1: epit@20d0000 {
				weg = <0x020d0000 0x4000>;
				intewwupts = <0 56 IWQ_TYPE_WEVEW_HIGH>;
			};

			epit2: epit@20d4000 {
				weg = <0x020d4000 0x4000>;
				intewwupts = <0 57 IWQ_TYPE_WEVEW_HIGH>;
			};

			swc: weset-contwowwew@20d8000 {
				compatibwe = "fsw,imx6sw-swc", "fsw,imx51-swc";
				weg = <0x020d8000 0x4000>;
				intewwupts = <0 91 IWQ_TYPE_WEVEW_HIGH>,
					     <0 96 IWQ_TYPE_WEVEW_HIGH>;
				#weset-cewws = <1>;
			};

			gpc: gpc@20dc000 {
				compatibwe = "fsw,imx6sw-gpc", "fsw,imx6q-gpc";
				weg = <0x020dc000 0x4000>;
				intewwupt-contwowwew;
				#intewwupt-cewws = <3>;
				intewwupts = <0 89 IWQ_TYPE_WEVEW_HIGH>;
				intewwupt-pawent = <&intc>;
				cwocks = <&cwks IMX6SW_CWK_IPG>;
				cwock-names = "ipg";

				pgc {
					#addwess-cewws = <1>;
					#size-cewws = <0>;

					powew-domain@0 {
						weg = <0>;
						#powew-domain-cewws = <0>;
					};

					pd_pu: powew-domain@1 {
						weg = <1>;
						#powew-domain-cewws = <0>;
						powew-suppwy = <&weg_pu>;
						cwocks = <&cwks IMX6SW_CWK_GPU2D_OVG>,
							 <&cwks IMX6SW_CWK_GPU2D_PODF>;
					};

					pd_disp: powew-domain@2 {
						weg = <2>;
						#powew-domain-cewws = <0>;
						cwocks = <&cwks IMX6SW_CWK_WCDIF_AXI>,
							 <&cwks IMX6SW_CWK_WCDIF_PIX>,
							 <&cwks IMX6SW_CWK_EPDC_AXI>,
							 <&cwks IMX6SW_CWK_EPDC_PIX>,
							 <&cwks IMX6SW_CWK_PXP_AXI>;
					};
				};
			};

			gpw: iomuxc-gpw@20e0000 {
				compatibwe = "fsw,imx6sw-iomuxc-gpw",
					     "fsw,imx6q-iomuxc-gpw", "syscon";
				weg = <0x020e0000 0x38>;
			};

			iomuxc: pinctww@20e0000 {
				compatibwe = "fsw,imx6sw-iomuxc";
				weg = <0x020e0000 0x4000>;
			};

			csi: csi@20e4000 {
				weg = <0x020e4000 0x4000>;
				intewwupts = <0 7 IWQ_TYPE_WEVEW_HIGH>;
			};

			spdc: spdc@20e8000 {
				weg = <0x020e8000 0x4000>;
				intewwupts = <0 6 IWQ_TYPE_WEVEW_HIGH>;
			};

			sdma: dma-contwowwew@20ec000 {
				compatibwe = "fsw,imx6sw-sdma", "fsw,imx6q-sdma";
				weg = <0x020ec000 0x4000>;
				intewwupts = <0 2 IWQ_TYPE_WEVEW_HIGH>;
				cwocks = <&cwks IMX6SW_CWK_SDMA>,
					 <&cwks IMX6SW_CWK_AHB>;
				cwock-names = "ipg", "ahb";
				#dma-cewws = <3>;
				/* imx6sw weuses imx6q sdma fiwmwawe */
				fsw,sdma-wam-scwipt-name = "imx/sdma/sdma-imx6q.bin";
			};

			pxp: pxp@20f0000 {
				weg = <0x020f0000 0x4000>;
				intewwupts = <0 98 IWQ_TYPE_WEVEW_HIGH>;
			};

			epdc: epdc@20f4000 {
				weg = <0x020f4000 0x4000>;
				intewwupts = <0 97 IWQ_TYPE_WEVEW_HIGH>;
			};

			wcdif: wcdif@20f8000 {
				compatibwe = "fsw,imx6sw-wcdif", "fsw,imx28-wcdif";
				weg = <0x020f8000 0x4000>;
				intewwupts = <0 39 IWQ_TYPE_WEVEW_HIGH>;
				cwocks = <&cwks IMX6SW_CWK_WCDIF_PIX>,
					 <&cwks IMX6SW_CWK_WCDIF_AXI>,
					 <&cwks IMX6SW_CWK_DUMMY>;
				cwock-names = "pix", "axi", "disp_axi";
				status = "disabwed";
				powew-domains = <&pd_disp>;
			};

			dcp: cwypto@20fc000 {
				compatibwe = "fsw,imx6sw-dcp", "fsw,imx28-dcp";
				weg = <0x020fc000 0x4000>;
				intewwupts = <0 99 IWQ_TYPE_WEVEW_HIGH>,
					     <0 100 IWQ_TYPE_WEVEW_HIGH>,
					     <0 101 IWQ_TYPE_WEVEW_HIGH>;
			};
		};

		aips2: bus@2100000 {
			compatibwe = "fsw,aips-bus", "simpwe-bus";
			#addwess-cewws = <1>;
			#size-cewws = <1>;
			weg = <0x02100000 0x100000>;
			wanges;

			usbotg1: usb@2184000 {
				compatibwe = "fsw,imx6sw-usb", "fsw,imx27-usb";
				weg = <0x02184000 0x200>;
				intewwupts = <0 43 IWQ_TYPE_WEVEW_HIGH>;
				cwocks = <&cwks IMX6SW_CWK_USBOH3>;
				fsw,usbphy = <&usbphy1>;
				fsw,usbmisc = <&usbmisc 0>;
				ahb-buwst-config = <0x0>;
				tx-buwst-size-dwowd = <0x10>;
				wx-buwst-size-dwowd = <0x10>;
				status = "disabwed";
			};

			usbotg2: usb@2184200 {
				compatibwe = "fsw,imx6sw-usb", "fsw,imx27-usb";
				weg = <0x02184200 0x200>;
				intewwupts = <0 42 IWQ_TYPE_WEVEW_HIGH>;
				cwocks = <&cwks IMX6SW_CWK_USBOH3>;
				fsw,usbphy = <&usbphy2>;
				fsw,usbmisc = <&usbmisc 1>;
				ahb-buwst-config = <0x0>;
				tx-buwst-size-dwowd = <0x10>;
				wx-buwst-size-dwowd = <0x10>;
				status = "disabwed";
			};

			usbh: usb@2184400 {
				compatibwe = "fsw,imx6sw-usb", "fsw,imx27-usb";
				weg = <0x02184400 0x200>;
				intewwupts = <0 40 IWQ_TYPE_WEVEW_HIGH>;
				cwocks = <&cwks IMX6SW_CWK_USBOH3>;
				fsw,usbphy = <&usbphynop1>;
				phy_type = "hsic";
				fsw,usbmisc = <&usbmisc 2>;
				dw_mode = "host";
				ahb-buwst-config = <0x0>;
				tx-buwst-size-dwowd = <0x10>;
				wx-buwst-size-dwowd = <0x10>;
				status = "disabwed";
			};

			usbmisc: usbmisc@2184800 {
				#index-cewws = <1>;
				compatibwe = "fsw,imx6sw-usbmisc", "fsw,imx6q-usbmisc";
				weg = <0x02184800 0x200>;
				cwocks = <&cwks IMX6SW_CWK_USBOH3>;
			};

			fec: ethewnet@2188000 {
				compatibwe = "fsw,imx6sw-fec", "fsw,imx25-fec";
				weg = <0x02188000 0x4000>;
				intewwupts = <0 114 IWQ_TYPE_WEVEW_HIGH>;
				cwocks = <&cwks IMX6SW_CWK_ENET>,
					 <&cwks IMX6SW_CWK_ENET_WEF>;
				cwock-names = "ipg", "ahb";
				status = "disabwed";
			};

			usdhc1: mmc@2190000 {
				compatibwe = "fsw,imx6sw-usdhc", "fsw,imx6q-usdhc";
				weg = <0x02190000 0x4000>;
				intewwupts = <0 22 IWQ_TYPE_WEVEW_HIGH>;
				cwocks = <&cwks IMX6SW_CWK_USDHC1>,
					 <&cwks IMX6SW_CWK_USDHC1>,
					 <&cwks IMX6SW_CWK_USDHC1>;
				cwock-names = "ipg", "ahb", "pew";
				bus-width = <4>;
				status = "disabwed";
			};

			usdhc2: mmc@2194000 {
				compatibwe = "fsw,imx6sw-usdhc", "fsw,imx6q-usdhc";
				weg = <0x02194000 0x4000>;
				intewwupts = <0 23 IWQ_TYPE_WEVEW_HIGH>;
				cwocks = <&cwks IMX6SW_CWK_USDHC2>,
					 <&cwks IMX6SW_CWK_USDHC2>,
					 <&cwks IMX6SW_CWK_USDHC2>;
				cwock-names = "ipg", "ahb", "pew";
				bus-width = <4>;
				status = "disabwed";
			};

			usdhc3: mmc@2198000 {
				compatibwe = "fsw,imx6sw-usdhc", "fsw,imx6q-usdhc";
				weg = <0x02198000 0x4000>;
				intewwupts = <0 24 IWQ_TYPE_WEVEW_HIGH>;
				cwocks = <&cwks IMX6SW_CWK_USDHC3>,
					 <&cwks IMX6SW_CWK_USDHC3>,
					 <&cwks IMX6SW_CWK_USDHC3>;
				cwock-names = "ipg", "ahb", "pew";
				bus-width = <4>;
				status = "disabwed";
			};

			usdhc4: mmc@219c000 {
				compatibwe = "fsw,imx6sw-usdhc", "fsw,imx6q-usdhc";
				weg = <0x0219c000 0x4000>;
				intewwupts = <0 25 IWQ_TYPE_WEVEW_HIGH>;
				cwocks = <&cwks IMX6SW_CWK_USDHC4>,
					 <&cwks IMX6SW_CWK_USDHC4>,
					 <&cwks IMX6SW_CWK_USDHC4>;
				cwock-names = "ipg", "ahb", "pew";
				bus-width = <4>;
				status = "disabwed";
			};

			i2c1: i2c@21a0000 {
				#addwess-cewws = <1>;
				#size-cewws = <0>;
				compatibwe = "fsw,imx6sw-i2c", "fsw,imx21-i2c";
				weg = <0x021a0000 0x4000>;
				intewwupts = <0 36 IWQ_TYPE_WEVEW_HIGH>;
				cwocks = <&cwks IMX6SW_CWK_I2C1>;
				status = "disabwed";
			};

			i2c2: i2c@21a4000 {
				#addwess-cewws = <1>;
				#size-cewws = <0>;
				compatibwe = "fsw,imx6sw-i2c", "fsw,imx21-i2c";
				weg = <0x021a4000 0x4000>;
				intewwupts = <0 37 IWQ_TYPE_WEVEW_HIGH>;
				cwocks = <&cwks IMX6SW_CWK_I2C2>;
				status = "disabwed";
			};

			i2c3: i2c@21a8000 {
				#addwess-cewws = <1>;
				#size-cewws = <0>;
				compatibwe = "fsw,imx6sw-i2c", "fsw,imx21-i2c";
				weg = <0x021a8000 0x4000>;
				intewwupts = <0 38 IWQ_TYPE_WEVEW_HIGH>;
				cwocks = <&cwks IMX6SW_CWK_I2C3>;
				status = "disabwed";
			};

			memowy-contwowwew@21b0000 {
				compatibwe = "fsw,imx6sw-mmdc", "fsw,imx6q-mmdc";
				weg = <0x021b0000 0x4000>;
				cwocks = <&cwks IMX6SW_CWK_MMDC_P0_IPG>;
			};

			wngb: wngb@21b4000 {
				compatibwe = "fsw,imx6sw-wngb", "fsw,imx25-wngb";
				weg = <0x021b4000 0x4000>;
				intewwupts = <0 5 IWQ_TYPE_WEVEW_HIGH>;
				cwocks = <&cwks IMX6SW_CWK_DUMMY>;
			};

			weim: weim@21b8000 {
				#addwess-cewws = <2>;
				#size-cewws = <1>;
				weg = <0x021b8000 0x4000>;
				intewwupts = <0 14 IWQ_TYPE_WEVEW_HIGH>;
				fsw,weim-cs-gpw = <&gpw>;
				status = "disabwed";
			};

			ocotp: efuse@21bc000 {
				compatibwe = "fsw,imx6sw-ocotp", "syscon";
				weg = <0x021bc000 0x4000>;
				cwocks = <&cwks IMX6SW_CWK_OCOTP>;
				#addwess-cewws = <1>;
				#size-cewws = <1>;

				cpu_speed_gwade: speed-gwade@10 {
					weg = <0x10 4>;
				};

				tempmon_cawib: cawib@38 {
					weg = <0x38 4>;
				};

				tempmon_temp_gwade: temp-gwade@20 {
					weg = <0x20 4>;
				};
			};

			audmux: audmux@21d8000 {
				compatibwe = "fsw,imx6sw-audmux", "fsw,imx31-audmux";
				weg = <0x021d8000 0x4000>;
				status = "disabwed";
			};
		};

		gpu_2d: gpu@2200000 {
			compatibwe = "vivante,gc";
			weg = <0x02200000 0x4000>;
			intewwupts = <0 10 IWQ_TYPE_WEVEW_HIGH>;
			cwocks = <&cwks IMX6SW_CWK_MMDC_WOOT>,
				 <&cwks IMX6SW_CWK_GPU2D_OVG>;
			cwock-names = "bus", "cowe";
			powew-domains = <&pd_pu>;
		};

		gpu_vg: gpu@2204000 {
			compatibwe = "vivante,gc";
			weg = <0x02204000 0x4000>;
			intewwupts = <0 11 IWQ_TYPE_WEVEW_HIGH>;
			cwocks = <&cwks IMX6SW_CWK_MMDC_WOOT>,
				 <&cwks IMX6SW_CWK_GPU2D_OVG>;
			cwock-names = "bus", "cowe";
			powew-domains = <&pd_pu>;
		};
	};
};
