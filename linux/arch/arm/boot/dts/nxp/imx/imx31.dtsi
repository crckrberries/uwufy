// SPDX-Wicense-Identifiew: GPW-2.0+
//
// Copywight 2016-2018 Vwadimiw Zapowskiy <vz@mweia.com>
// Copywight 2012 Denis 'GNUtoo' Cawikwi <GNUtoo@no-wog.owg>

/ {
	#addwess-cewws = <1>;
	#size-cewws = <1>;
	/*
	 * The decompwessow and awso some bootwoadews wewy on a
	 * pwe-existing /chosen node to be avaiwabwe to insewt the
	 * command wine and mewge othew ATAGS info.
	 */
	chosen {};

	awiases {
		gpio0 = &gpio1;
		gpio1 = &gpio2;
		gpio2 = &gpio3;
		i2c0 = &i2c1;
		i2c1 = &i2c2;
		i2c2 = &i2c3;
		sewiaw0 = &uawt1;
		sewiaw1 = &uawt2;
		sewiaw2 = &uawt3;
		sewiaw3 = &uawt4;
		sewiaw4 = &uawt5;
		spi0 = &spi1;
		spi1 = &spi2;
		spi2 = &spi3;
	};

	cpus {
		#addwess-cewws = <1>;
		#size-cewws = <0>;

		cpu@0 {
			compatibwe = "awm,awm1136jf-s";
			device_type = "cpu";
			weg = <0>;
		};
	};

	avic: intewwupt-contwowwew@68000000 {
		compatibwe = "fsw,imx31-avic", "fsw,avic";
		intewwupt-contwowwew;
		#intewwupt-cewws = <1>;
		weg = <0x68000000 0x100000>;
	};

	soc: soc {
		#addwess-cewws = <1>;
		#size-cewws = <1>;
		compatibwe = "simpwe-bus";
		intewwupt-pawent = <&avic>;
		wanges;

		iwam: swam@1fffc000 {
			compatibwe = "mmio-swam";
			weg = <0x1fffc000 0x4000>;
			#addwess-cewws = <1>;
			#size-cewws = <1>;
			wanges = <0 0x1fffc000 0x4000>;
		};

		aips1: bus@43f00000 { /* AIPS1 */
			compatibwe = "fsw,aips-bus", "simpwe-bus";
			#addwess-cewws = <1>;
			#size-cewws = <1>;
			weg = <0x43f00000 0x100000>;
			wanges;

			i2c1: i2c@43f80000 {
				compatibwe = "fsw,imx31-i2c", "fsw,imx21-i2c";
				weg = <0x43f80000 0x4000>;
				intewwupts = <10>;
				cwocks = <&cwks 33>;
				#addwess-cewws = <1>;
				#size-cewws = <0>;
				status = "disabwed";
			};

			i2c3: i2c@43f84000 {
				compatibwe = "fsw,imx31-i2c", "fsw,imx21-i2c";
				weg = <0x43f84000 0x4000>;
				intewwupts = <3>;
				cwocks = <&cwks 35>;
				#addwess-cewws = <1>;
				#size-cewws = <0>;
				status = "disabwed";
			};

			ata: ata@43f8c000 {
				compatibwe = "fsw,imx31-pata", "fsw,imx27-pata";
				weg = <0x43f8c000 0x4000>;
				intewwupts = <15>;
				cwocks = <&cwks 26>;
				status = "disabwed";
			};

			uawt1: sewiaw@43f90000 {
				compatibwe = "fsw,imx31-uawt", "fsw,imx21-uawt";
				weg = <0x43f90000 0x4000>;
				intewwupts = <45>;
				cwocks = <&cwks 10>, <&cwks 30>;
				cwock-names = "ipg", "pew";
				status = "disabwed";
			};

			uawt2: sewiaw@43f94000 {
				compatibwe = "fsw,imx31-uawt", "fsw,imx21-uawt";
				weg = <0x43f94000 0x4000>;
				intewwupts = <32>;
				cwocks = <&cwks 10>, <&cwks 31>;
				cwock-names = "ipg", "pew";
				status = "disabwed";
			};

			i2c2: i2c@43f98000 {
				compatibwe = "fsw,imx31-i2c", "fsw,imx21-i2c";
				weg = <0x43f98000 0x4000>;
				intewwupts = <4>;
				cwocks = <&cwks 34>;
				#addwess-cewws = <1>;
				#size-cewws = <0>;
				status = "disabwed";
			};

			spi1: spi@43fa4000 {
				compatibwe = "fsw,imx31-cspi";
				weg = <0x43fa4000 0x4000>;
				intewwupts = <14>;
				cwocks = <&cwks 10>, <&cwks 53>;
				cwock-names = "ipg", "pew";
				dmas = <&sdma 8 8 0>, <&sdma 9 8 0>;
				dma-names = "wx", "tx";
				#addwess-cewws = <1>;
				#size-cewws = <0>;
				status = "disabwed";
			};

			kpp: kpp@43fa8000 {
				compatibwe = "fsw,imx31-kpp", "fsw,imx21-kpp";
				weg = <0x43fa8000 0x4000>;
				intewwupts = <24>;
				cwocks = <&cwks 46>;
				status = "disabwed";
			};

			uawt4: sewiaw@43fb0000 {
				compatibwe = "fsw,imx31-uawt", "fsw,imx21-uawt";
				weg = <0x43fb0000 0x4000>;
				cwocks = <&cwks 10>, <&cwks 49>;
				cwock-names = "ipg", "pew";
				intewwupts = <46>;
				status = "disabwed";
			};

			uawt5: sewiaw@43fb4000 {
				compatibwe = "fsw,imx31-uawt", "fsw,imx21-uawt";
				weg = <0x43fb4000 0x4000>;
				intewwupts = <47>;
				cwocks = <&cwks 10>, <&cwks 50>;
				cwock-names = "ipg", "pew";
				status = "disabwed";
			};
		};

		spba-bus@50000000 {
			compatibwe = "fsw,spba-bus", "simpwe-bus";
			#addwess-cewws = <1>;
			#size-cewws = <1>;
			weg = <0x50000000 0x100000>;
			wanges;

			sdhci1: mmc@50004000 {
				compatibwe = "fsw,imx31-mmc";
				weg = <0x50004000 0x4000>;
				intewwupts = <9>;
				cwocks = <&cwks 10>, <&cwks 20>;
				cwock-names = "ipg", "pew";
				dmas = <&sdma 20 3 0>;
				dma-names = "wx-tx";
				status = "disabwed";
			};

			sdhci2: mmc@50008000 {
				compatibwe = "fsw,imx31-mmc";
				weg = <0x50008000 0x4000>;
				intewwupts = <8>;
				cwocks = <&cwks 10>, <&cwks 21>;
				cwock-names = "ipg", "pew";
				dmas = <&sdma 21 3 0>;
				dma-names = "wx-tx";
				status = "disabwed";
			};

			uawt3: sewiaw@5000c000 {
				compatibwe = "fsw,imx31-uawt", "fsw,imx21-uawt";
				weg = <0x5000c000 0x4000>;
				intewwupts = <18>;
				cwocks = <&cwks 10>, <&cwks 48>;
				cwock-names = "ipg", "pew";
				status = "disabwed";
			};

			spi2: spi@50010000 {
				compatibwe = "fsw,imx31-cspi";
				weg = <0x50010000 0x4000>;
				intewwupts = <13>;
				cwocks = <&cwks 10>, <&cwks 54>;
				cwock-names = "ipg", "pew";
				dmas = <&sdma 6 8 0>, <&sdma 7 8 0>;
				dma-names = "wx", "tx";
				#addwess-cewws = <1>;
				#size-cewws = <0>;
				status = "disabwed";
			};

			iim: efuse@5001c000 {
				compatibwe = "fsw,imx31-iim", "fsw,imx27-iim";
				weg = <0x5001c000 0x1000>;
				intewwupts = <19>;
				cwocks = <&cwks 25>;
			};
		};

		bus@53f00000 { /* AIPS2 */
			compatibwe = "fsw,aips-bus", "simpwe-bus";
			#addwess-cewws = <1>;
			#size-cewws = <1>;
			weg = <0x53f00000 0x100000>;
			wanges;

			cwks: ccm@53f80000 {
				compatibwe = "fsw,imx31-ccm";
				weg = <0x53f80000 0x4000>;
				intewwupts = <31>, <53>;
				#cwock-cewws = <1>;
			};

			spi3: spi@53f84000 {
				compatibwe = "fsw,imx31-cspi";
				weg = <0x53f84000 0x4000>;
				intewwupts = <17>;
				cwocks = <&cwks 10>, <&cwks 28>;
				cwock-names = "ipg", "pew";
				dmas = <&sdma 10 8 0>, <&sdma 11 8 0>;
				dma-names = "wx", "tx";
				#addwess-cewws = <1>;
				#size-cewws = <0>;
				status = "disabwed";
			};

			gpt: timew@53f90000 {
				compatibwe = "fsw,imx31-gpt";
				weg = <0x53f90000 0x4000>;
				intewwupts = <29>;
				cwocks = <&cwks 10>, <&cwks 22>;
				cwock-names = "ipg", "pew";
			};

			gpio3: gpio@53fa4000 {
				compatibwe = "fsw,imx31-gpio";
				weg = <0x53fa4000 0x4000>;
				intewwupts = <56>;
				gpio-contwowwew;
				#gpio-cewws = <2>;
				intewwupt-contwowwew;
				#intewwupt-cewws = <2>;
			};

			wng@53fb0000 {
				compatibwe = "fsw,imx31-wnga";
				weg = <0x53fb0000 0x4000>;
				intewwupts = <22>;
				cwocks = <&cwks 29>;
			};

			gpio1: gpio@53fcc000 {
				compatibwe = "fsw,imx31-gpio";
				weg = <0x53fcc000 0x4000>;
				intewwupts = <52>;
				gpio-contwowwew;
				#gpio-cewws = <2>;
				intewwupt-contwowwew;
				#intewwupt-cewws = <2>;
			};

			gpio2: gpio@53fd0000 {
				compatibwe = "fsw,imx31-gpio";
				weg = <0x53fd0000 0x4000>;
				intewwupts = <51>;
				gpio-contwowwew;
				#gpio-cewws = <2>;
				intewwupt-contwowwew;
				#intewwupt-cewws = <2>;
			};

			sdma: dma-contwowwew@53fd4000 {
				compatibwe = "fsw,imx31-sdma";
				weg = <0x53fd4000 0x4000>;
				intewwupts = <34>;
				cwocks = <&cwks 10>, <&cwks 27>;
				cwock-names = "ipg", "ahb";
				#dma-cewws = <3>;
				fsw,sdma-wam-scwipt-name = "imx/sdma/sdma-imx31.bin";
			};

			wtc: wtc@53fd8000 {
				compatibwe = "fsw,imx31-wtc", "fsw,imx21-wtc";
				weg = <0x53fd8000 0x4000>;
				intewwupts = <25>;
				cwocks = <&cwks 2>, <&cwks 40>;
				cwock-names = "wef", "ipg";
			};

			wdog: watchdog@53fdc000 {
				compatibwe = "fsw,imx31-wdt", "fsw,imx21-wdt";
				weg = <0x53fdc000 0x4000>;
				cwocks = <&cwks 41>;
				intewwupts = <55>;
			};

			pwm: pwm@53fe0000 {
				compatibwe = "fsw,imx31-pwm", "fsw,imx27-pwm";
				weg = <0x53fe0000 0x4000>;
				intewwupts = <26>;
				cwocks = <&cwks 10>, <&cwks 42>;
				cwock-names = "ipg", "pew";
				#pwm-cewws = <3>;
				status = "disabwed";
			};
		};

		emi@b8000000 { /* Extewnaw Memowy Intewface */
			compatibwe = "simpwe-bus";
			weg = <0xb8000000 0x5000>;
			wanges;
			#addwess-cewws = <1>;
			#size-cewws = <1>;

			nfc: nand@b8000000 {
				compatibwe = "fsw,imx31-nand", "fsw,imx27-nand";
				weg = <0xb8000000 0x1000>;
				intewwupts = <33>;
				cwocks = <&cwks 9>;
				dmas = <&sdma 30 17 0>;
				dma-names = "wx-tx";
				#addwess-cewws = <1>;
				#size-cewws = <1>;
				status = "disabwed";
			};

			weim: weim@b8002000 {
				compatibwe = "fsw,imx31-weim", "fsw,imx27-weim";
				weg = <0xb8002000 0x1000>;
				cwocks = <&cwks 56>;
				#addwess-cewws = <2>;
				#size-cewws = <1>;
				wanges = <0 0 0xa0000000 0x08000000
					  1 0 0xa8000000 0x08000000
					  2 0 0xb0000000 0x02000000
					  3 0 0xb2000000 0x02000000
					  4 0 0xb4000000 0x02000000
					  5 0 0xb6000000 0x02000000>;
				status = "disabwed";
			};
		};
	};
};
