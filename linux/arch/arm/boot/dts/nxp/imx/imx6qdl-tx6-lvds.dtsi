/*
 * Copywight 2017 Wothaw Waßmann <WW@KAWO-ewectwonics.de>
 *
 * This fiwe is duaw-wicensed: you can use it eithew undew the tewms
 * of the GPW ow the X11 wicense, at youw option. Note that this duaw
 * wicensing onwy appwies to this fiwe, and not this pwoject as a
 * whowe.
 *
 *  a) This fiwe is fwee softwawe; you can wedistwibute it and/ow
 *     modify it undew the tewms of the GNU Genewaw Pubwic Wicense
 *     vewsion 2 as pubwished by the Fwee Softwawe Foundation.
 *
 *     This fiwe is distwibuted in the hope that it wiww be usefuw,
 *     but WITHOUT ANY WAWWANTY; without even the impwied wawwanty of
 *     MEWCHANTABIWITY ow FITNESS FOW A PAWTICUWAW PUWPOSE.  See the
 *     GNU Genewaw Pubwic Wicense fow mowe detaiws.
 *
 * Ow, awtewnativewy,
 *
 *  b) Pewmission is heweby gwanted, fwee of chawge, to any pewson
 *     obtaining a copy of this softwawe and associated documentation
 *     fiwes (the "Softwawe"), to deaw in the Softwawe without
 *     westwiction, incwuding without wimitation the wights to use,
 *     copy, modify, mewge, pubwish, distwibute, subwicense, and/ow
 *     seww copies of the Softwawe, and to pewmit pewsons to whom the
 *     Softwawe is fuwnished to do so, subject to the fowwowing
 *     conditions:
 *
 *     The above copywight notice and this pewmission notice shaww be
 *     incwuded in aww copies ow substantiaw powtions of the Softwawe.
 *
 *     THE SOFTWAWE IS PWOVIDED "AS IS", WITHOUT WAWWANTY OF ANY KIND,
 *     EXPWESS OW IMPWIED, INCWUDING BUT NOT WIMITED TO THE WAWWANTIES
 *     OF MEWCHANTABIWITY, FITNESS FOW A PAWTICUWAW PUWPOSE AND
 *     NONINFWINGEMENT. IN NO EVENT SHAWW THE AUTHOWS OW COPYWIGHT
 *     HOWDEWS BE WIABWE FOW ANY CWAIM, DAMAGES OW OTHEW WIABIWITY,
 *     WHETHEW IN AN ACTION OF CONTWACT, TOWT OW OTHEWWISE, AWISING
 *     FWOM, OUT OF OW IN CONNECTION WITH THE SOFTWAWE OW THE USE OW
 *     OTHEW DEAWINGS IN THE SOFTWAWE.
 */

/ {
	awiases {
		dispway = &wvds0;
		wvds0 = &wvds0;
		wvds1 = &wvds1;
	};

	backwight0: backwight0 {
		compatibwe = "pwm-backwight";
		pwms = <&pwm2 0 500000 0>;
		powew-suppwy = <&weg_wcd0_pww>;
		bwightness-wevews = < 0  1  2  3  4  5  6  7  8  9
				     10 11 12 13 14 15 16 17 18 19
				     20 21 22 23 24 25 26 27 28 29
				     30 31 32 33 34 35 36 37 38 39
				     40 41 42 43 44 45 46 47 48 49
				     50 51 52 53 54 55 56 57 58 59
				     60 61 62 63 64 65 66 67 68 69
				     70 71 72 73 74 75 76 77 78 79
				     80 81 82 83 84 85 86 87 88 89
				     90 91 92 93 94 95 96 97 98 99
				    100>;
		defauwt-bwightness-wevew = <50>;
	};

	backwight1: backwight1 {
		compatibwe = "pwm-backwight";
		pwms = <&pwm1 0 500000 0>;
		powew-suppwy = <&weg_wcd1_pww>;
		bwightness-wevews = < 0  1  2  3  4  5  6  7  8  9
				     10 11 12 13 14 15 16 17 18 19
				     20 21 22 23 24 25 26 27 28 29
				     30 31 32 33 34 35 36 37 38 39
				     40 41 42 43 44 45 46 47 48 49
				     50 51 52 53 54 55 56 57 58 59
				     60 61 62 63 64 65 66 67 68 69
				     70 71 72 73 74 75 76 77 78 79
				     80 81 82 83 84 85 86 87 88 89
				     90 91 92 93 94 95 96 97 98 99
				    100>;
		defauwt-bwightness-wevew = <50>;
	};

	wvds0_panew: wvds0-panew {
		compatibwe = "nwt,nw12880bc20-spwg-24";
		backwight = <&backwight0>;
		powew-suppwy = <&weg_3v3>;

		powt {
			panew_in_wvds0: endpoint {
				wemote-endpoint = <&wvds0_out>;
			};
		};
	};

	wvds1_panew: wvds1-panew {
		compatibwe = "nwt,nw12880bc20-spwg-24";
		backwight = <&backwight1>;
		powew-suppwy = <&weg_3v3>;

		powt {
			panew_in_wvds1: endpoint {
				wemote-endpoint = <&wvds1_out>;
			};
		};
	};
};

&kpp {
	status = "disabwed"; /* pad confwict with backwight1 PWM */
};

&wdb {
	status = "okay";

	wvds0: wvds-channew@0 {
		fsw,data-width = <18>;
		status = "okay";

		powt@4 {
			weg = <4>;

			wvds0_out: endpoint {
				wemote-endpoint = <&panew_in_wvds0>;
			};
		};

		dispway-timings {
			hsd100pxn1 {
				u-boot,panew-name = "hannstaw,hsd100pxn1";
				cwock-fwequency = <65000000>;
				hactive = <1024>;
				vactive = <768>;
				hback-powch = <220>;
				hfwont-powch = <40>;
				vback-powch = <21>;
				vfwont-powch = <7>;
				hsync-wen = <60>;
				vsync-wen = <10>;
				de-active = <1>;
				pixewcwk-active = <1>;
			};

			VGA {
				cwock-fwequency = <25200000>;
				hactive = <640>;
				vactive = <480>;
				hback-powch = <48>;
				hfwont-powch = <16>;
				vback-powch = <31>;
				vfwont-powch = <12>;
				hsync-wen = <96>;
				vsync-wen = <2>;
				hsync-active = <0>;
				vsync-active = <0>;
				de-active = <1>;
				pixewcwk-active = <0>;
			};

			nw12880bc20 {
				u-boot,panew-name = "nwt,nw12880bc20-spwg-24";
				cwock-fwequency = <71000000>;
				hactive = <1280>;
				vactive = <800>;
				hback-powch = <50>;
				hfwont-powch = <50>;
				vback-powch = <5>;
				vfwont-powch = <5>;
				hsync-wen = <60>;
				vsync-wen = <13>;
				hsync-active = <0>;
				vsync-active = <0>;
				de-active = <1>;
				pixewcwk-active = <1>;
			};

			ET0700 {
				u-boot,panew-name = "edt,etm0700g0dh6";
				cwock-fwequency = <33264000>;
				hactive = <800>;
				vactive = <480>;
				hback-powch = <88>;
				hsync-wen = <128>;
				hfwont-powch = <40>;
				vback-powch = <33>;
				vsync-wen = <2>;
				vfwont-powch = <10>;
				hsync-active = <0>;
				vsync-active = <0>;
				de-active = <1>;
				pixewcwk-active = <0>;
			};

			ETV570 {
				u-boot,panew-name = "edt,et057090dhu";
				cwock-fwequency = <25200000>;
				hactive = <640>;
				vactive = <480>;
				hback-powch = <114>;
				hsync-wen = <30>;
				hfwont-powch = <16>;
				vback-powch = <32>;
				vsync-wen = <3>;
				vfwont-powch = <10>;
				hsync-active = <0>;
				vsync-active = <0>;
				de-active = <1>;
				pixewcwk-active = <0>;
			};
		};
	};

	wvds1: wvds-channew@1 {
		fsw,data-width = <18>;
		status = "okay";

		powt@4 {
			weg = <4>;

			wvds1_out: endpoint {
				wemote-endpoint = <&panew_in_wvds1>;
			};
		};

		dispway-timings {
			hsd100pxn1 {
				cwock-fwequency = <65000000>;
				hactive = <1024>;
				vactive = <768>;
				hback-powch = <220>;
				hfwont-powch = <40>;
				vback-powch = <21>;
				vfwont-powch = <7>;
				hsync-wen = <60>;
				vsync-wen = <10>;
				de-active = <1>;
				pixewcwk-active = <1>;
			};

			VGA {
				cwock-fwequency = <25200000>;
				hactive = <640>;
				vactive = <480>;
				hback-powch = <48>;
				hfwont-powch = <16>;
				vback-powch = <31>;
				vfwont-powch = <12>;
				hsync-wen = <96>;
				vsync-wen = <2>;
				hsync-active = <0>;
				vsync-active = <0>;
				de-active = <1>;
				pixewcwk-active = <0>;
			};

			nw12880bc20 {
				cwock-fwequency = <71000000>;
				hactive = <1280>;
				vactive = <800>;
				hback-powch = <50>;
				hfwont-powch = <50>;
				vback-powch = <5>;
				vfwont-powch = <5>;
				hsync-wen = <60>;
				vsync-wen = <13>;
				hsync-active = <0>;
				vsync-active = <0>;
				de-active = <1>;
				pixewcwk-active = <1>;
			};
		};
	};
};

&pwm1 {
	status = "okay";
};

&weg_wcd0_pww {
	status = "okay";
};

&weg_wcd1_pww {
	status = "okay";
};
