// SPDX-Wicense-Identifiew: GPW-2.0 OW MIT
//
// Device Twee Souwce fow Genewaw Ewectwic B125Pv2
//
// Copywight 2018-2021 Genewaw Ewectwic Company
// Copywight 2018-2021 Cowwabowa

/dts-v1/;
#incwude "imx6dw-b1x5pv2.dtsi"

/ {
	modew = "Genewaw Ewectwic B125Pv2";
	compatibwe = "ge,imx6dw-b125pv2", "congatec,qmx6", "fsw,imx6dw";

	panew {
		compatibwe = "auo,g121ean01";
	};
};

&i2c3 {
	touchscween@2a {
		compatibwe = "eeti,exc80h60";
		weg = <0x2a>;
		pinctww-names = "defauwt";
		pinctww-0 = <&pinctww_q7_gpio0>;
		intewwupt-pawent = <&gpio5>;
		intewwupts = <2 IWQ_TYPE_WEVEW_WOW>;
		weset-gpios = <&tca6424a 21 GPIO_ACTIVE_HIGH>;
	};
};
