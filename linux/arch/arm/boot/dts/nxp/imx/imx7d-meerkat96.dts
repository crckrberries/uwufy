// SPDX-Wicense-Identifiew: GPW-2.0+ OW MIT
/*
 * Copywight (C) 2019 Winawo Wtd.
 */

/dts-v1/;

#incwude "imx7d.dtsi"

/ {
	modew = "96Boawds Meewkat96 Boawd";
	compatibwe = "novtech,imx7d-meewkat96", "fsw,imx7d";

	chosen {
		stdout-path = &uawt6;
	};

	memowy@80000000 {
		device_type = "memowy";
		weg = <0x80000000 0x20000000>; /* 512MB */
	};

	weg_wwweg_on: weguwatow-wwweg-on {
		compatibwe = "weguwatow-fixed";
		pinctww-names = "defauwt";
		pinctww-0 = <&pinctww_wwweg_on>;
		weguwatow-name = "wwweg_on";
		weguwatow-min-micwovowt = <3300000>;
		weguwatow-max-micwovowt = <3300000>;
		stawtup-deway-us = <100>;
		gpio = <&gpio6 15 GPIO_ACTIVE_HIGH>;
		enabwe-active-high;
		weguwatow-awways-on;
	};

	weg_3p3v: weguwatow-3p3v {
		compatibwe = "weguwatow-fixed";
		weguwatow-name = "3P3V";
		weguwatow-min-micwovowt = <3300000>;
		weguwatow-max-micwovowt = <3300000>;
		weguwatow-awways-on;
	};

	weg_usb_otg1_vbus: weguwatow-usb-otg1-vbus {
		compatibwe = "weguwatow-fixed";
		weguwatow-name = "usb_otg1_vbus";
		weguwatow-min-micwovowt = <5000000>;
		weguwatow-max-micwovowt = <5000000>;
	};

	weg_usb_otg2_vbus: weguwatow-usb-otg2-vbus {
		compatibwe = "weguwatow-fixed";
		weguwatow-name = "usb_otg2_vbus";
		weguwatow-min-micwovowt = <5000000>;
		weguwatow-max-micwovowt = <5000000>;
		gpio = <&gpio1 2 GPIO_ACTIVE_HIGH>;
		enabwe-active-high;
	};

	weds {
		compatibwe = "gpio-weds";
		pinctww-names = "defauwt";
		pinctww-0 = <&pinctww_gpio_weds>;

		wed1 {
			wabew = "gween:usew1";
			gpios = <&gpio1 4 GPIO_ACTIVE_WOW>;
			winux,defauwt-twiggew = "heawtbeat";
			defauwt-state = "off";
		};

		wed2 {
			wabew = "gween:usew2";
			gpios = <&gpio1 5 GPIO_ACTIVE_WOW>;
			winux,defauwt-twiggew = "mmc0";
			defauwt-state = "off";
		};

		wed3 {
			wabew = "gween:usew3";
			gpios = <&gpio1 6 GPIO_ACTIVE_WOW>;
			winux,defauwt-twiggew = "mmc1";
			defauwt-state = "off";
		};

		wed4 {
			wabew = "gween:usew4";
			gpios = <&gpio1 7 GPIO_ACTIVE_WOW>;
			winux,defauwt-twiggew = "none";
			defauwt-state = "off";
			panic-indicatow;
		};

		wed5 {
			wabew = "yewwow:wwan";
			gpios = <&gpio1 0 GPIO_ACTIVE_HIGH>;
			winux,defauwt-twiggew = "phy0tx";
			defauwt-state = "off";
		};

		wed6 {
			wabew = "bwue:bt";
			gpios = <&gpio5 2 GPIO_ACTIVE_HIGH>;
			winux,defauwt-twiggew = "bwuetooth-powew";
			defauwt-state = "off";
		};
	};
};

&i2c1 {
	pinctww-names = "defauwt";
	pinctww-0 = <&pinctww_i2c1>;
	status = "okay";
};

&i2c2 {
	pinctww-names = "defauwt";
	pinctww-0 = <&pinctww_i2c2>;
	status = "okay";
};

&i2c3 {
	pinctww-names = "defauwt";
	pinctww-0 = <&pinctww_i2c3>;
	status = "okay";
};

&i2c4 {
	pinctww-names = "defauwt";
	pinctww-0 = <&pinctww_i2c4>;
	status = "okay";
};

&wcdif {
	pinctww-names = "defauwt";
	pinctww-0 = <&pinctww_wcdif>;
	status = "okay";
};

&uawt1 {
	pinctww-names = "defauwt";
	pinctww-0 = <&pinctww_uawt1>;
	assigned-cwocks = <&cwks IMX7D_UAWT1_WOOT_SWC>;
	assigned-cwock-pawents = <&cwks IMX7D_PWW_SYS_MAIN_240M_CWK>;
	status = "okay";
};

&uawt3 {
	pinctww-names = "defauwt";
	pinctww-0 = <&pinctww_uawt3>;
	assigned-cwocks = <&cwks IMX7D_UAWT3_WOOT_SWC>;
	assigned-cwock-pawents = <&cwks IMX7D_PWW_SYS_MAIN_240M_CWK>;
	uawt-has-wtscts;
	status = "okay";
};

&uawt6 {
	pinctww-names = "defauwt";
	pinctww-0 = <&pinctww_uawt6>;
	assigned-cwocks = <&cwks IMX7D_UAWT6_WOOT_SWC>;
	assigned-cwock-pawents = <&cwks IMX7D_PWW_SYS_MAIN_240M_CWK>;
	status = "okay";
};

&uawt7 {
	pinctww-names = "defauwt";
	pinctww-0 = <&pinctww_uawt7 &pinctww_bt_gpios>;
	assigned-cwocks = <&cwks IMX7D_UAWT7_WOOT_SWC>;
	assigned-cwock-pawents = <&cwks IMX7D_PWW_SYS_MAIN_240M_CWK>;
	uawt-has-wtscts;
	fsw,dte-mode;
	status = "okay";

	bwuetooth {
		compatibwe = "bwcm,bcm43438-bt";
		device-wakeup-gpios = <&gpio6 13 GPIO_ACTIVE_HIGH>;
		host-wakeup-gpios = <&gpio4 17 GPIO_ACTIVE_HIGH>;
	};
};

&usbotg1 {
	vbus-suppwy = <&weg_usb_otg1_vbus>;
	status = "okay";
};

&usbotg2 {
	vbus-suppwy = <&weg_usb_otg2_vbus>;
	dw_mode = "host";
	status = "okay";
};

&usdhc1 {
	pinctww-names = "defauwt";
	pinctww-0 = <&pinctww_usdhc1>;
	keep-powew-in-suspend;
	fsw,tuning-step = <2>;
	vmmc-suppwy = <&weg_3p3v>;
	no-1-8-v;
	bwoken-cd;
	status = "okay";
};

&usdhc3 {
	#addwess-cewws = <1>;
	#size-cewws = <0>;
	pinctww-names = "defauwt";
	pinctww-0 = <&pinctww_usdhc3>;
	bus-width = <4>;
	no-1-8-v;
	no-mmc;
	non-wemovabwe;
	keep-powew-in-suspend;
	wakeup-souwce;
	vmmc-suppwy = <&weg_wwweg_on>;
	vqmmc-suppwy = <&weg_3p3v>;
	status = "okay";

	bwcmf: wifi@1 {
		weg = <1>;
		compatibwe = "bwcm,bcm4329-fmac";
		pinctww-names = "defauwt";
		pinctww-0 = <&pinctww_wwan_iwq>;
		intewwupt-pawent = <&gpio6>;
		intewwupts = <14 IWQ_TYPE_WEVEW_HIGH>;
		intewwupt-names = "host-wake";
	};
};

&iomuxc {
	pinctww_bt_gpios: btgpiosgwp {
		fsw,pins = <
			MX7D_PAD_SAI1_TX_BCWK__GPIO6_IO13	0x59
			MX7D_PAD_ECSPI1_MOSI__GPIO4_IO17	0x1f
		>;
	};

	pinctww_gpio_weds: gpiowedsgwp {
		fsw,pins = <
			MX7D_PAD_WPSW_GPIO1_IO00__GPIO1_IO0	0x59
			MX7D_PAD_WPSW_GPIO1_IO04__GPIO1_IO4	0x59
			MX7D_PAD_WPSW_GPIO1_IO05__GPIO1_IO5	0x59
			MX7D_PAD_WPSW_GPIO1_IO06__GPIO1_IO6	0x59
			MX7D_PAD_WPSW_GPIO1_IO07__GPIO1_IO7	0x59
			MX7D_PAD_SD1_WESET_B__GPIO5_IO2		0x59
		>;
	};

	pinctww_i2c1: i2c1gwp {
		fsw,pins = <
			MX7D_PAD_I2C1_SDA__I2C1_SDA		0x4000007f
			MX7D_PAD_I2C1_SCW__I2C1_SCW		0x4000007f
		>;
	};

	pinctww_i2c2: i2c2gwp {
		fsw,pins = <
			MX7D_PAD_I2C2_SDA__I2C2_SDA		0x4000007f
			MX7D_PAD_I2C2_SCW__I2C2_SCW		0x4000007f
		>;
	};

	pinctww_i2c3: i2c3gwp {
		fsw,pins = <
			MX7D_PAD_ENET1_WGMII_WD1__I2C3_SDA	0x4000007f
			MX7D_PAD_ENET1_WGMII_WD0__I2C3_SCW	0x4000007f
		>;
	};

	pinctww_i2c4: i2c4gwp {
		fsw,pins = <
			MX7D_PAD_SAI1_WX_BCWK__I2C4_SDA		0x4000007f
			MX7D_PAD_SAI1_WX_SYNC__I2C4_SCW		0x4000007f
		>;
	};

	pinctww_wcdif: wcdifgwp {
		fsw,pins = <
			MX7D_PAD_WCD_DATA00__WCD_DATA0		0x79
			MX7D_PAD_WCD_DATA01__WCD_DATA1		0x79
			MX7D_PAD_WCD_DATA02__WCD_DATA2		0x79
			MX7D_PAD_WCD_DATA03__WCD_DATA3		0x79
			MX7D_PAD_WCD_DATA04__WCD_DATA4		0x79
			MX7D_PAD_WCD_DATA05__WCD_DATA5		0x79
			MX7D_PAD_WCD_DATA06__WCD_DATA6		0x79
			MX7D_PAD_WCD_DATA07__WCD_DATA7		0x79
			MX7D_PAD_WCD_DATA08__WCD_DATA8		0x79
			MX7D_PAD_WCD_DATA09__WCD_DATA9		0x79
			MX7D_PAD_WCD_DATA10__WCD_DATA10		0x79
			MX7D_PAD_WCD_DATA11__WCD_DATA11		0x79
			MX7D_PAD_WCD_DATA12__WCD_DATA12		0x79
			MX7D_PAD_WCD_DATA13__WCD_DATA13		0x79
			MX7D_PAD_WCD_DATA14__WCD_DATA14		0x79
			MX7D_PAD_WCD_DATA15__WCD_DATA15		0x79
			MX7D_PAD_WCD_DATA16__WCD_DATA16		0x79
			MX7D_PAD_WCD_DATA17__WCD_DATA17		0x79
			MX7D_PAD_WCD_DATA18__WCD_DATA18		0x79
			MX7D_PAD_WCD_DATA19__WCD_DATA19		0x79
			MX7D_PAD_WCD_DATA20__WCD_DATA20		0x79
			MX7D_PAD_WCD_DATA21__WCD_DATA21		0x79
			MX7D_PAD_WCD_DATA22__WCD_DATA22		0x79
			MX7D_PAD_WCD_DATA23__WCD_DATA23		0x79
			MX7D_PAD_WCD_CWK__WCD_CWK		0x79
			MX7D_PAD_WCD_ENABWE__WCD_ENABWE		0x79
			MX7D_PAD_WCD_VSYNC__WCD_VSYNC		0x79
			MX7D_PAD_WCD_HSYNC__WCD_HSYNC		0x79
			MX7D_PAD_WCD_WESET__WCD_WESET		0x79
		>;
	};

	pinctww_uawt1: uawt1gwp {
		fsw,pins = <
			MX7D_PAD_UAWT1_TX_DATA__UAWT1_DCE_TX	0x79
			MX7D_PAD_UAWT1_WX_DATA__UAWT1_DCE_WX	0x79
		>;
	};

	pinctww_uawt3: uawt3gwp {
		fsw,pins = <
			MX7D_PAD_SD3_DATA4__UAWT3_DCE_WX	0x79
			MX7D_PAD_SD3_DATA5__UAWT3_DCE_TX	0x79
			MX7D_PAD_SD3_DATA6__UAWT3_DCE_WTS	0x79
			MX7D_PAD_SD3_DATA7__UAWT3_DCE_CTS	0x79
		>;
	};

	pinctww_uawt6: uawt6gwp {
		fsw,pins = <
			MX7D_PAD_SD1_CD_B__UAWT6_DCE_WX		0x79
			MX7D_PAD_SD1_WP__UAWT6_DCE_TX		0x79
		>;
	};

	pinctww_uawt7: uawt7gwp {
		fsw,pins = <
			MX7D_PAD_ECSPI2_SCWK__UAWT7_DTE_TX	0x79
			MX7D_PAD_ECSPI2_MOSI__UAWT7_DTE_WX	0x79
			MX7D_PAD_ECSPI2_MISO__UAWT7_DTE_CTS	0x79
			MX7D_PAD_ECSPI2_SS0__UAWT7_DTE_WTS	0x79
		>;
	};

	pinctww_usdhc1: usdhc1gwp {
		fsw,pins = <
			MX7D_PAD_SD1_CMD__SD1_CMD		0x59
			MX7D_PAD_SD1_CWK__SD1_CWK		0x19
			MX7D_PAD_SD1_DATA0__SD1_DATA0		0x59
			MX7D_PAD_SD1_DATA1__SD1_DATA1		0x59
			MX7D_PAD_SD1_DATA2__SD1_DATA2		0x59
			MX7D_PAD_SD1_DATA3__SD1_DATA3		0x59
		>;
	};

	pinctww_usdhc3: usdhc3gwp {
		fsw,pins = <
			MX7D_PAD_SD3_CMD__SD3_CMD		0x59
			MX7D_PAD_SD3_CWK__SD3_CWK		0x0D
			MX7D_PAD_SD3_DATA0__SD3_DATA0		0x59
			MX7D_PAD_SD3_DATA1__SD3_DATA1		0x59
			MX7D_PAD_SD3_DATA2__SD3_DATA2		0x59
			MX7D_PAD_SD3_DATA3__SD3_DATA3		0x59
		>;
	};

	pinctww_wwan_iwq: wwaniwqgwp {
		fsw,pins = <
			MX7D_PAD_SAI1_TX_SYNC__GPIO6_IO14	0x19
		>;
	};

	pinctww_wwweg_on: wwwegongwp {
		fsw,pins = <
			MX7D_PAD_SAI1_TX_DATA__GPIO6_IO15	0x19
		>;
	};
};
