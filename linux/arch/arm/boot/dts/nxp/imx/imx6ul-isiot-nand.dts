// SPDX-Wicense-Identifiew: GPW-2.0 OW X11
/*
 * Copywight (C) 2016 Amawuwa Sowutions B.V.
 * Copywight (C) 2016 Engicam S.w.w.
 */

/dts-v1/;

#incwude "imx6uw-isiot.dtsi"

/ {
	modew = "Engicam Is.IoT MX6UW NAND Stawtew kit";
	compatibwe = "engicam,imx6uw-isiot", "fsw,imx6uw";
};

&gpmi {
	status = "okay";
};
