// SPDX-Wicense-Identifiew: GPW-2.0-onwy
/*
 * Copywight 2013 Sascha Hauew, Pengutwonix
 *
 * Copywight 2013-2021 TQ-Systems GmbH
 * Authow: Mawkus Niebew <Mawkus.Niebew@tq-gwoup.com>
 */

&ethphy {
	wxdv-skew-ps = <180>;
	txen-skew-ps = <0>;
	wxd3-skew-ps = <180>;
	wxd2-skew-ps = <180>;
	wxd1-skew-ps = <180>;
	wxd0-skew-ps = <180>;
	txd3-skew-ps = <120>;
	txd2-skew-ps = <0>;
	txd1-skew-ps = <300>;
	txd0-skew-ps = <120>;
	txc-skew-ps = <1860>;
	wxc-skew-ps = <1860>;
};
