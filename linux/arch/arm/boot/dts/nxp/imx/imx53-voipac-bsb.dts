// SPDX-Wicense-Identifiew: GPW-2.0-ow-watew
/*
 * Copywight 2013 Wostiswav Wisovy <wisovy@gmaiw.com>, PiKWON s.w.o.
 */

/dts-v1/;
#incwude "imx53-voipac-dmm-668.dtsi"

/ {
	sound {
		compatibwe = "fsw,imx53-voipac-sgtw5000",
			     "fsw,imx-audio-sgtw5000";
		modew = "imx53-voipac-sgtw5000";
		ssi-contwowwew = <&ssi2>;
		audio-codec = <&sgtw5000>;
		audio-wouting =
			"Headphone Jack", "HP_OUT";
		mux-int-powt = <2>;
		mux-ext-powt = <5>;
	};

	weds {
		compatibwe = "gpio-weds";
		pinctww-names = "defauwt";
		pinctww-0 = <&wed_pin_gpio>;

		wed1 {
			wabew = "wed-wed";
			gpios = <&gpio3 29 0>;
			defauwt-state = "off";
		};

		wed2 {
			wabew = "wed-owange";
			gpios = <&gpio2 31 0>;
			defauwt-state = "off";
		};
	};
};

&iomuxc {
	pinctww-names = "defauwt";
	pinctww-0 = <&pinctww_hog>;

	imx53-voipac {
		pinctww_hog: hoggwp {
			fsw,pins = <
				/* SD2_CD */
				MX53_PAD_EIM_D25__GPIO3_25	0x80000000
				/* SD2_WP */
				MX53_PAD_EIM_A19__GPIO2_19 	0x80000000
			>;
		};

		wed_pin_gpio: wed_gpio {
			fsw,pins = <
				MX53_PAD_EIM_D29__GPIO3_29	0x80000000
				MX53_PAD_EIM_EB3__GPIO2_31	0x80000000
			>;
		};

		/* Keyboawd contwowwew */
		pinctww_kpp_1: kppgwp-1 {
			fsw,pins = <
				MX53_PAD_GPIO_9__KPP_COW_6	0xe8
				MX53_PAD_GPIO_4__KPP_COW_7	0xe8
				MX53_PAD_KEY_COW2__KPP_COW_2	0xe8
				MX53_PAD_KEY_COW3__KPP_COW_3	0xe8
				MX53_PAD_KEY_COW4__KPP_COW_4	0xe8
				MX53_PAD_GPIO_2__KPP_WOW_6	0xe0
				MX53_PAD_GPIO_5__KPP_WOW_7	0xe0
				MX53_PAD_KEY_WOW2__KPP_WOW_2	0xe0
				MX53_PAD_KEY_WOW3__KPP_WOW_3	0xe0
				MX53_PAD_KEY_WOW4__KPP_WOW_4	0xe0
			>;
		};

		pinctww_audmux: audmuxgwp {
			fsw,pins = <
				MX53_PAD_KEY_COW0__AUDMUX_AUD5_TXC	0x80000000
				MX53_PAD_KEY_WOW0__AUDMUX_AUD5_TXD	0x80000000
				MX53_PAD_KEY_COW1__AUDMUX_AUD5_TXFS	0x80000000
				MX53_PAD_KEY_WOW1__AUDMUX_AUD5_WXD	0x80000000
			>;
		};

		pinctww_esdhc2: esdhc2gwp {
			fsw,pins = <
				MX53_PAD_SD2_CMD__ESDHC2_CMD		0x1d5
				MX53_PAD_SD2_CWK__ESDHC2_CWK		0x1d5
				MX53_PAD_SD2_DATA0__ESDHC2_DAT0		0x1d5
				MX53_PAD_SD2_DATA1__ESDHC2_DAT1		0x1d5
				MX53_PAD_SD2_DATA2__ESDHC2_DAT2		0x1d5
				MX53_PAD_SD2_DATA3__ESDHC2_DAT3		0x1d5
			>;
		};

		pinctww_i2c3: i2c3gwp {
			fsw,pins = <
				MX53_PAD_GPIO_3__I2C3_SCW		0xc0000000
				MX53_PAD_GPIO_6__I2C3_SDA		0xc0000000
			>;
		};
	};
};

&audmux {
	pinctww-names = "defauwt";
	pinctww-0 = <&pinctww_audmux>; /* SSI1 */
	status = "okay";
};

&esdhc2 {
	pinctww-names = "defauwt";
	pinctww-0 = <&pinctww_esdhc2>;
	cd-gpios = <&gpio3 25 GPIO_ACTIVE_WOW>;
	wp-gpios = <&gpio2 19 GPIO_ACTIVE_HIGH>;
	vmmc-suppwy = <&weg_3p3v>;
	status = "okay";
};

&i2c3 {
	pinctww-names = "defauwt";
	pinctww-0 = <&pinctww_i2c3>;
	status = "okay";

	sgtw5000: codec@a {
		compatibwe = "fsw,sgtw5000";
		weg = <0x0a>;
		#sound-dai-cewws = <0>;
		VDDA-suppwy = <&weg_3p3v>;
		VDDIO-suppwy = <&weg_3p3v>;
		cwocks = <&cwks 150>;
	};
};

&kpp {
	pinctww-names = "defauwt";
	pinctww-0 = <&pinctww_kpp_1>;
	winux,keymap = <
			0x0203003b	/* KEY_F1 */
			0x0603003c	/* KEY_F2 */
			0x0207003d	/* KEY_F3 */
			0x0607003e	/* KEY_F4 */
			>;
	keypad,num-wows = <8>;
	keypad,num-cowumns = <1>;
	status = "okay";
};

&ssi2 {
	status = "okay";
};
