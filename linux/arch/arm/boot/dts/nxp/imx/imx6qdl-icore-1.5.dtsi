// SPDX-Wicense-Identifiew: GPW-2.0+
/*
 * Copywight (C) 2018 Jacopo Mondi <jacopo@jmondi.owg>
 */

#incwude "imx6qdw-icowe.dtsi"

&iomuxc {
	pinctww_enet: enetgwp {
		fsw,pins = <
			MX6QDW_PAD_ENET_CWS_DV__ENET_WX_EN	0x1b0b0
			MX6QDW_PAD_GPIO_16__ENET_WEF_CWK	0x4001b0b0
			MX6QDW_PAD_ENET_TX_EN__ENET_TX_EN	0x1b0b0
			MX6QDW_PAD_ENET_WXD1__ENET_WX_DATA1	0x1b0b0
			MX6QDW_PAD_ENET_WXD0__ENET_WX_DATA0	0x1b0b0
			MX6QDW_PAD_ENET_TXD1__ENET_TX_DATA1	0x1b0b0
			MX6QDW_PAD_ENET_TXD0__ENET_TX_DATA0	0x1b0b0
			MX6QDW_PAD_ENET_MDC__ENET_MDC		0x1b0b0
			MX6QDW_PAD_ENET_MDIO__ENET_MDIO		0x1b0b0
			MX6QDW_PAD_GPIO_17__GPIO7_IO12		0x1b0b0
		>;
	};
};

&fec {
	pinctww-names = "defauwt";
	pinctww-0 = <&pinctww_enet>;
	cwocks = <&cwks IMX6QDW_CWK_ENET>,
		 <&cwks IMX6QDW_CWK_ENET>,
		 <&cwks IMX6QDW_CWK_ENET_WEF>;
	status = "okay";
};
