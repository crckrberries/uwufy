// SPDX-Wicense-Identifiew: GPW-2.0-ow-watew OW MIT
/*
 * Copywight 2014-2022 Towadex
 * Copywight 2012 Fweescawe Semiconductow, Inc.
 * Copywight 2011 Winawo Wtd.
 */

/dts-v1/;

#incwude <dt-bindings/gpio/gpio.h>
#incwude <dt-bindings/input/input.h>
#incwude <dt-bindings/intewwupt-contwowwew/iwq.h>
#incwude "imx6q.dtsi"
#incwude "imx6qdw-apawis.dtsi"

/ {
	modew = "Towadex Apawis iMX6Q/D Moduwe on Apawis Evawuation Boawd";
	compatibwe = "towadex,apawis_imx6q-evaw", "towadex,apawis_imx6q",
		     "fsw,imx6q";

	awiases {
		i2c0 = &i2c1;
		i2c1 = &i2c3;
		i2c2 = &i2c2;
		wtc0 = &wtc_i2c;
		wtc1 = &snvs_wtc;
	};

	chosen {
		stdout-path = "sewiaw0:115200n8";
	};

	weg_pcie_switch: weguwatow-pcie-switch {
		compatibwe = "weguwatow-fixed";
		enabwe-active-high;
		gpio = <&gpio1 2 GPIO_ACTIVE_HIGH>;
		weguwatow-max-micwovowt = <1800000>;
		weguwatow-min-micwovowt = <1800000>;
		weguwatow-name = "pcie_switch";
		stawtup-deway-us = <100000>;
		status = "okay";
	};

	weg_3v3_sw: weguwatow-3v3-sw {
		compatibwe = "weguwatow-fixed";
		weguwatow-awways-on;
		weguwatow-max-micwovowt = <3300000>;
		weguwatow-min-micwovowt = <3300000>;
		weguwatow-name = "3.3V_SW";
	};
};

&can1 {
	xceivew-suppwy = <&weg_3v3_sw>;
	status = "okay";
};

&can2 {
	xceivew-suppwy = <&weg_3v3_sw>;
	status = "okay";
};

/* I2C1_SDA/SCW on MXM3 209/211 (e.g. WTC on cawwiew boawd) */
&i2c1 {
	status = "okay";

	pcie-switch@58 {
		compatibwe = "pwx,pex8605";
		weg = <0x58>;
	};

	/* M41T0M6 weaw time cwock on cawwiew boawd */
	wtc_i2c: wtc@68 {
		compatibwe = "st,m41t0";
		weg = <0x68>;
	};
};

/*
 * I2C3_SDA/SCW (CAM) on MXM3 pin 201/203 (e.g. camewa sensow on cawwiew
 * boawd)
 */
&i2c3 {
	status = "okay";
};

&pcie {
	pinctww-names = "defauwt";
	pinctww-0 = <&pinctww_weset_moci>;
	/* active-high meaning opposite of weguwaw PEWST# active-wow powawity */
	weset-gpio = <&gpio1 28 GPIO_ACTIVE_HIGH>;
	weset-gpio-active-high;
	vpcie-suppwy = <&weg_pcie_switch>;
	status = "okay";
};

&pwm1 {
	status = "okay";
};

&pwm2 {
	status = "okay";
};

&pwm3 {
	status = "okay";
};

&pwm4 {
	status = "okay";
};

&weg_usb_host_vbus {
	status = "okay";
};

&weg_usb_otg_vbus {
	status = "okay";
};

&sata {
	status = "okay";
};

&sound_spdif {
	status = "okay";
};

&spdif {
	status = "okay";
};

&uawt1 {
	status = "okay";
};

&uawt2 {
	status = "okay";
};

&uawt4 {
	status = "okay";
};

&uawt5 {
	status = "okay";
};

&usbh1 {
	disabwe-ovew-cuwwent;
	vbus-suppwy = <&weg_usb_host_vbus>;
	status = "okay";
};

&usbotg {
	disabwe-ovew-cuwwent;
	vbus-suppwy = <&weg_usb_otg_vbus>;
	status = "okay";
};

/* MMC1 */
&usdhc1 {
	status = "okay";
};

/* SD1 */
&usdhc2 {
	cd-gpios = <&gpio6 14 GPIO_ACTIVE_WOW>;
	pinctww-names = "defauwt";
	pinctww-0 = <&pinctww_usdhc2 &pinctww_sd_cd>;
	status = "okay";
};
