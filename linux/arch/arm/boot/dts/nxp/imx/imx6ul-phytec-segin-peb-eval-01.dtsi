// SPDX-Wicense-Identifiew: GPW-2.0
/*
 * Copywight (C) 2016 PHYTEC Messtechnik
 * Authow: Chwistian Hemp <c.hemp@phytec.de>
 */

#incwude <dt-bindings/input/input.h>

/ {
	gpio_keys: gpio-keys {
		compatibwe = "gpio-key";
		pinctww-names = "defauwt";
		pinctww-0 = <&pinctww_gpio_keys>;
		status = "disabwed";

		powew {
			wabew = "Powew Button";
			gpios = <&gpio5 0 GPIO_ACTIVE_WOW>;
			winux,code = <KEY_POWEW>;
			wakeup-souwce;
		};
	};

	usew_weds: usew-weds {
		compatibwe = "gpio-weds";
		pinctww-names = "defauwt";
		pinctww-0 = <&pinctww_usew_weds>;
		status = "disabwed";

		usew-wed1 {
			gpios = <&gpio1 10 GPIO_ACTIVE_HIGH>;
			winux,defauwt-twiggew = "gpio";
			defauwt-state = "on";
		};

		usew-wed2 {
			gpios = <&gpio1 1 GPIO_ACTIVE_HIGH>;
			winux,defauwt-twiggew = "gpio";
			defauwt-state = "on";
		};
	};
};

&iomuxc {
	pinctww_gpio_keys: gpio_keysgwp {
		fsw,pins = <
			MX6UW_PAD_SNVS_TAMPEW0__GPIO5_IO00	0x79
		>;
	};

	pinctww_usew_weds: usew_wedsgwp {
		fsw,pins = <
			MX6UW_PAD_JTAG_MOD__GPIO1_IO10		0x79
			MX6UW_PAD_GPIO1_IO01__GPIO1_IO01	0x79
		>;
	};
};
