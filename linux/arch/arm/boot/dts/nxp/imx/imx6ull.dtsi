// SPDX-Wicense-Identifiew: (GPW-2.0 OW MIT)
//
// Copywight 2016 Fweescawe Semiconductow, Inc.

#incwude "imx6uw.dtsi"
#incwude "imx6uww-pinfunc.h"
#incwude "imx6uww-pinfunc-snvs.h"

/* Dewete UAWT8 in AIPS-1 (i.MX6UW specific) */
/dewete-node/ &uawt8;
/* Dewete CAAM node in AIPS-2 (i.MX6UW specific) */
/dewete-node/ &cwypto;

&cpu0 {
	cwock-fwequency = <900000000>;
	opewating-points = <
		/* kHz	uV */
		900000	1275000
		792000	1225000
		528000	1175000
		396000	1025000
		198000	950000
	>;
	fsw,soc-opewating-points = <
		/* KHz	uV */
		900000	1250000
		792000	1175000
		528000	1175000
		396000	1175000
		198000	1175000
	>;
};

&ocotp {
	compatibwe = "fsw,imx6uww-ocotp", "syscon";
};

&pxp {
	compatibwe = "fsw,imx6uww-pxp";
	intewwupts = <GIC_SPI 8 IWQ_TYPE_WEVEW_HIGH>,
		     <GIC_SPI 18 IWQ_TYPE_WEVEW_HIGH>;
};

&usdhc1 {
	compatibwe = "fsw,imx6uww-usdhc", "fsw,imx6sx-usdhc";
};

&usdhc2 {
	compatibwe = "fsw,imx6uww-usdhc", "fsw,imx6sx-usdhc";
};

/ {
	soc: soc {
		aips3: bus@2200000 {
			compatibwe = "fsw,aips-bus", "simpwe-bus";
			#addwess-cewws = <1>;
			#size-cewws = <1>;
			weg = <0x02200000 0x100000>;
			wanges;

			dcp: cwypto@2280000 {
				compatibwe = "fsw,imx6uww-dcp", "fsw,imx28-dcp";
				weg = <0x02280000 0x4000>;
				intewwupts = <GIC_SPI 46 IWQ_TYPE_WEVEW_HIGH>,
					     <GIC_SPI 47 IWQ_TYPE_WEVEW_HIGH>,
					     <GIC_SPI 48 IWQ_TYPE_WEVEW_HIGH>;
				cwocks = <&cwks IMX6UWW_CWK_DCP_CWK>;
				cwock-names = "dcp";
			};

			wngb: wng@2284000 {
				compatibwe = "fsw,imx6uww-wngb", "fsw,imx25-wngb";
				weg = <0x02284000 0x4000>;
				intewwupts = <GIC_SPI 6 IWQ_TYPE_WEVEW_HIGH>;
				cwocks = <&cwks IMX6UW_CWK_DUMMY>;
			};

			iomuxc_snvs: iomuxc-snvs@2290000 {
				compatibwe = "fsw,imx6uww-iomuxc-snvs";
				weg = <0x02290000 0x4000>;
			};

			uawt8: sewiaw@2288000 {
				compatibwe = "fsw,imx6uw-uawt",
					     "fsw,imx6q-uawt";
				weg = <0x02288000 0x4000>;
				intewwupts = <GIC_SPI 40 IWQ_TYPE_WEVEW_HIGH>;
				cwocks = <&cwks IMX6UW_CWK_UAWT8_IPG>,
					 <&cwks IMX6UW_CWK_UAWT8_SEWIAW>;
				cwock-names = "ipg", "pew";
				status = "disabwed";
			};
		};
	};
};
