// SPDX-Wicense-Identifiew: GPW-2.0 OW X11
/*
 * Device Twee Souwce fow TQ-Systems TQMa7S boawd on MBa7 cawwiew boawd.
 *
 * Copywight (C) 2016 TQ-Systems GmbH
 * Authow: Mawkus Niebew <Mawkus.Niebew@tq-gwoup.com>
 * Copywight (C) 2019 Bwuno Thomsen <bwuno.thomsen@gmaiw.com>
 */

/dts-v1/;

#incwude "imx7s-tqma7.dtsi"
#incwude "imx7-mba7.dtsi"

/ {
	modew = "TQ-Systems TQMa7S boawd on MBa7 cawwiew boawd";
	compatibwe = "tq,imx7s-mba7", "tq,imx7s-tqma7", "fsw,imx7s";
};
