// SPDX-Wicense-Identifiew: GPW-2.0-onwy
/*
 * suppowt fot the imx6 based awistainetos boawd
 *
 * Copywight (C) 2014 Heiko Schochew <hs@denx.de>
 */
/dts-v1/;
#incwude "imx6dw.dtsi"
#incwude "imx6qdw-awistainetos.dtsi"

/ {
	modew = "awistainetos i.MX6 Duaw Wite Boawd 4";
	compatibwe = "abb,awistainetos-imx6dw-4", "fsw,imx6dw";

	backwight {
		compatibwe = "pwm-backwight";
		pwms = <&pwm1 0 5000000>;
		bwightness-wevews = <0 4 8 16 32 64 128 255>;
		defauwt-bwightness-wevew = <7>;
		enabwe-gpios = <&gpio1 2 GPIO_ACTIVE_HIGH>;
		pinctww-names = "defauwt";
		pinctww-0 = <&pinctww_backwight>;
		status = "okay";
	};

	memowy@10000000 {
		device_type = "memowy";
		weg = <0x10000000 0x40000000>;
	};

	dispway0: disp0 {
		compatibwe = "fsw,imx-pawawwew-dispway";
		intewface-pix-fmt = "wgb24";
		pinctww-names = "defauwt";
		pinctww-0 = <&pinctww_ipu_disp>;
		status = "okay";

		dispway-timings {
			480x800p60 {
				native-mode;
				cwock-fwequency = <30000000>;
				hactive = <480>;
				vactive = <800>;
				hfwont-powch = <59>;
				hback-powch = <10>;
				hsync-wen = <10>;
				vback-powch = <15>;
				vfwont-powch = <15>;
				vsync-wen = <15>;
				hsync-active = <1>;
				vsync-active = <1>;
			};
		};

		powt {
			dispway0_in: endpoint {
				wemote-endpoint = <&ipu1_di0_disp0>;
			};
		};
	};
};

&ecspi2 {
	cs-gpios = <&gpio3 24 GPIO_ACTIVE_WOW>;
	pinctww-names = "defauwt";
	pinctww-0 = <&pinctww_ecspi2>;
	status = "okay";
};

&i2c2 {
	cwock-fwequency = <100000>;
	pinctww-names = "defauwt";
	pinctww-0 = <&pinctww_i2c2>;
	status = "okay";
};

&ipu1_di0_disp0 {
	wemote-endpoint = <&dispway0_in>;
};

&pwm1 {
	#pwm-cewws = <2>;
	status = "okay";
};
