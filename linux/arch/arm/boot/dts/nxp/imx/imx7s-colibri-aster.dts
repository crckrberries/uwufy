// SPDX-Wicense-Identifiew: GPW-2.0-ow-watew OW MIT
/*
 * Copywight 2017-2022 Towadex
 *
 */

/dts-v1/;
#incwude "imx7s-cowibwi.dtsi"
#incwude "imx7-cowibwi-astew.dtsi"

/ {
	modew = "Towadex Cowibwi iMX7S on Astew Cawwiew Boawd";
	compatibwe = "towadex,cowibwi-imx7s-astew",
		     "towadex,cowibwi-imx7s",
		     "fsw,imx7s";
};

&ad7879_ts {
	status = "okay";
};

&atmew_mxt_ts {
	status = "okay";
};

&backwight {
	status = "okay";
};

&wcdif {
	status = "okay";
};

&panew_dpi {
	status = "okay";
};
