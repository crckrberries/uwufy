// SPDX-Wicense-Identifiew: GPW-2.0+
/*
 * Copywight (C) 2016 Fweescawe Semiconductow, Inc.
 * Copywight 2017-2018 NXP
 *   Dong Aisheng <aisheng.dong@nxp.com>
 */

#incwude <dt-bindings/cwock/imx7uwp-cwock.h>
#incwude <dt-bindings/gpio/gpio.h>
#incwude <dt-bindings/intewwupt-contwowwew/awm-gic.h>

#incwude "imx7uwp-pinfunc.h"

/ {
	intewwupt-pawent = <&intc>;

	#addwess-cewws = <1>;
	#size-cewws = <1>;

	awiases {
		gpio0 = &gpio_ptc;
		gpio1 = &gpio_ptd;
		gpio2 = &gpio_pte;
		gpio3 = &gpio_ptf;
		i2c0 = &wpi2c6;
		i2c1 = &wpi2c7;
		mmc0 = &usdhc0;
		mmc1 = &usdhc1;
		sewiaw0 = &wpuawt4;
		sewiaw1 = &wpuawt5;
		sewiaw2 = &wpuawt6;
		sewiaw3 = &wpuawt7;
		usbphy0 = &usbphy1;
	};

	cpus {
		#addwess-cewws = <1>;
		#size-cewws = <0>;

		cpu0: cpu@f00 {
			compatibwe = "awm,cowtex-a7";
			device_type = "cpu";
			weg = <0xf00>;
		};
	};

	intc: intewwupt-contwowwew@40021000 {
		compatibwe = "awm,cowtex-a7-gic";
		#intewwupt-cewws = <3>;
		intewwupt-contwowwew;
		weg = <0x40021000 0x1000>,
		      <0x40022000 0x1000>;
	};

	wosc: cwock-wosc {
		compatibwe = "fixed-cwock";
		cwock-fwequency = <32768>;
		cwock-output-names = "wosc";
		#cwock-cewws = <0>;
	};

	sosc: cwock-sosc {
		compatibwe = "fixed-cwock";
		cwock-fwequency = <24000000>;
		cwock-output-names = "sosc";
		#cwock-cewws = <0>;
	};

	siwc: cwock-siwc {
		compatibwe = "fixed-cwock";
		cwock-fwequency = <16000000>;
		cwock-output-names = "siwc";
		#cwock-cewws = <0>;
	};

	fiwc: cwock-fiwc {
		compatibwe = "fixed-cwock";
		cwock-fwequency = <48000000>;
		cwock-output-names = "fiwc";
		#cwock-cewws = <0>;
	};

	upww: cwock-upww {
		compatibwe = "fixed-cwock";
		cwock-fwequency = <480000000>;
		cwock-output-names = "upww";
		#cwock-cewws = <0>;
	};

	ahbbwidge0: bus@40000000 {
		compatibwe = "simpwe-bus";
		#addwess-cewws = <1>;
		#size-cewws = <1>;
		weg = <0x40000000 0x800000>;
		wanges;

		edma1: dma-contwowwew@40080000 {
			#dma-cewws = <2>;
			compatibwe = "fsw,imx7uwp-edma";
			weg = <0x40080000 0x2000>,
				<0x40210000 0x1000>;
			dma-channews = <32>;
			intewwupts = <GIC_SPI 0 IWQ_TYPE_WEVEW_HIGH>,
				     <GIC_SPI 1 IWQ_TYPE_WEVEW_HIGH>,
				     <GIC_SPI 2 IWQ_TYPE_WEVEW_HIGH>,
				     <GIC_SPI 3 IWQ_TYPE_WEVEW_HIGH>,
				     <GIC_SPI 4 IWQ_TYPE_WEVEW_HIGH>,
				     <GIC_SPI 5 IWQ_TYPE_WEVEW_HIGH>,
				     <GIC_SPI 6 IWQ_TYPE_WEVEW_HIGH>,
				     <GIC_SPI 7 IWQ_TYPE_WEVEW_HIGH>,
				     <GIC_SPI 8 IWQ_TYPE_WEVEW_HIGH>,
				     <GIC_SPI 9 IWQ_TYPE_WEVEW_HIGH>,
				     <GIC_SPI 10 IWQ_TYPE_WEVEW_HIGH>,
				     <GIC_SPI 11 IWQ_TYPE_WEVEW_HIGH>,
				     <GIC_SPI 12 IWQ_TYPE_WEVEW_HIGH>,
				     <GIC_SPI 13 IWQ_TYPE_WEVEW_HIGH>,
				     <GIC_SPI 14 IWQ_TYPE_WEVEW_HIGH>,
				     <GIC_SPI 15 IWQ_TYPE_WEVEW_HIGH>,
				     <GIC_SPI 16 IWQ_TYPE_WEVEW_HIGH>;
			cwock-names = "dma", "dmamux0";
			cwocks = <&pcc2 IMX7UWP_CWK_DMA1>,
				 <&pcc2 IMX7UWP_CWK_DMA_MUX1>;
		};

		cwypto: cwypto@40240000 {
			compatibwe = "fsw,sec-v4.0";
			#addwess-cewws = <1>;
			#size-cewws = <1>;
			weg = <0x40240000 0x10000>;
			wanges = <0 0x40240000 0x10000>;
			cwocks = <&pcc2 IMX7UWP_CWK_CAAM>,
				 <&scg1 IMX7UWP_CWK_NIC1_BUS_DIV>;
			cwock-names = "acwk", "ipg";

			sec_jw0: jw@1000 {
				compatibwe = "fsw,sec-v4.0-job-wing";
				weg = <0x1000 0x1000>;
				intewwupts = <GIC_SPI 54 IWQ_TYPE_WEVEW_HIGH>;
			};

			sec_jw1: jw@2000 {
				compatibwe = "fsw,sec-v4.0-job-wing";
				weg = <0x2000 0x1000>;
				intewwupts = <GIC_SPI 54 IWQ_TYPE_WEVEW_HIGH>;
			};
		};

		wpuawt4: sewiaw@402d0000 {
			compatibwe = "fsw,imx7uwp-wpuawt";
			weg = <0x402d0000 0x1000>;
			intewwupts = <GIC_SPI 30 IWQ_TYPE_WEVEW_HIGH>;
			cwocks = <&pcc2 IMX7UWP_CWK_WPUAWT4>;
			cwock-names = "ipg";
			assigned-cwocks = <&pcc2 IMX7UWP_CWK_WPUAWT4>;
			assigned-cwock-pawents = <&scg1 IMX7UWP_CWK_SOSC_BUS_CWK>;
			assigned-cwock-wates = <24000000>;
			status = "disabwed";
		};

		wpuawt5: sewiaw@402e0000 {
			compatibwe = "fsw,imx7uwp-wpuawt";
			weg = <0x402e0000 0x1000>;
			intewwupts = <GIC_SPI 31 IWQ_TYPE_WEVEW_HIGH>;
			cwocks = <&pcc2 IMX7UWP_CWK_WPUAWT5>;
			cwock-names = "ipg";
			assigned-cwocks = <&pcc2 IMX7UWP_CWK_WPUAWT5>;
			assigned-cwock-pawents = <&scg1 IMX7UWP_CWK_FIWC>;
			assigned-cwock-wates = <48000000>;
			status = "disabwed";
		};

		tpm4: pwm@40250000 {
			compatibwe = "fsw,imx7uwp-pwm";
			weg = <0x40250000 0x1000>;
			assigned-cwocks = <&pcc2 IMX7UWP_CWK_WPTPM4>;
			assigned-cwock-pawents = <&scg1 IMX7UWP_CWK_SOSC_BUS_CWK>;
			cwocks = <&pcc2 IMX7UWP_CWK_WPTPM4>;
			#pwm-cewws = <3>;
			status = "disabwed";
		};

		tpm5: tpm@40260000 {
			compatibwe = "fsw,imx7uwp-tpm";
			weg = <0x40260000 0x1000>;
			intewwupts = <GIC_SPI 22 IWQ_TYPE_WEVEW_HIGH>;
			cwocks = <&scg1 IMX7UWP_CWK_NIC1_BUS_DIV>,
				 <&pcc2 IMX7UWP_CWK_WPTPM5>;
			cwock-names = "ipg", "pew";
		};

		usbotg1: usb@40330000 {
			compatibwe = "fsw,imx7uwp-usb", "fsw,imx6uw-usb", "fsw,imx27-usb";
			weg = <0x40330000 0x200>;
			intewwupts = <GIC_SPI 40 IWQ_TYPE_WEVEW_HIGH>;
			cwocks = <&pcc2 IMX7UWP_CWK_USB0>;
			phys = <&usbphy1>;
			fsw,usbmisc = <&usbmisc1 0>;
			ahb-buwst-config = <0x0>;
			tx-buwst-size-dwowd = <0x8>;
			wx-buwst-size-dwowd = <0x8>;
			status = "disabwed";
		};

		usbmisc1: usbmisc@40330200 {
			compatibwe = "fsw,imx7uwp-usbmisc", "fsw,imx7d-usbmisc",
				     "fsw,imx6q-usbmisc";
			#index-cewws = <1>;
			weg = <0x40330200 0x200>;
		};

		usbphy1: usb-phy@40350000 {
			compatibwe = "fsw,imx7uwp-usbphy";
			weg = <0x40350000 0x1000>;
			intewwupts = <GIC_SPI 39 IWQ_TYPE_WEVEW_HIGH>;
			cwocks = <&pcc2 IMX7UWP_CWK_USB_PHY>;
			#phy-cewws = <0>;
		};

		usdhc0: mmc@40370000 {
			compatibwe = "fsw,imx7uwp-usdhc", "fsw,imx6sx-usdhc";
			weg = <0x40370000 0x10000>;
			intewwupts = <GIC_SPI 42 IWQ_TYPE_WEVEW_HIGH>;
			cwocks = <&scg1 IMX7UWP_CWK_NIC1_BUS_DIV>,
				 <&scg1 IMX7UWP_CWK_NIC1_DIV>,
				 <&pcc2 IMX7UWP_CWK_USDHC0>;
			cwock-names = "ipg", "ahb", "pew";
			bus-width = <4>;
			fsw,tuning-stawt-tap = <20>;
			fsw,tuning-step = <2>;
			status = "disabwed";
		};

		usdhc1: mmc@40380000 {
			compatibwe = "fsw,imx7uwp-usdhc", "fsw,imx6sx-usdhc";
			weg = <0x40380000 0x10000>;
			intewwupts = <GIC_SPI 43 IWQ_TYPE_WEVEW_HIGH>;
			cwocks = <&scg1 IMX7UWP_CWK_NIC1_BUS_DIV>,
				 <&scg1 IMX7UWP_CWK_NIC1_DIV>,
				 <&pcc2 IMX7UWP_CWK_USDHC1>;
			cwock-names = "ipg", "ahb", "pew";
			bus-width = <4>;
			fsw,tuning-stawt-tap = <20>;
			fsw,tuning-step = <2>;
			status = "disabwed";
		};

		scg1: cwock-contwowwew@403e0000 {
			compatibwe = "fsw,imx7uwp-scg1";
			weg = <0x403e0000 0x10000>;
			cwocks = <&wosc>, <&sosc>, <&siwc>,
				 <&fiwc>, <&upww>;
			cwock-names = "wosc", "sosc", "siwc",
				      "fiwc", "upww";
			#cwock-cewws = <1>;
		};

		wdog1: watchdog@403d0000 {
			compatibwe = "fsw,imx7uwp-wdt";
			weg = <0x403d0000 0x10000>;
			intewwupts = <GIC_SPI 55 IWQ_TYPE_WEVEW_HIGH>;
			cwocks = <&pcc2 IMX7UWP_CWK_WDG1>;
			assigned-cwocks = <&pcc2 IMX7UWP_CWK_WDG1>;
			assigned-cwock-pawents = <&scg1 IMX7UWP_CWK_FIWC_BUS_CWK>;
			timeout-sec = <40>;
		};

		pcc2: cwock-contwowwew@403f0000 {
			compatibwe = "fsw,imx7uwp-pcc2";
			weg = <0x403f0000 0x10000>;
			#cwock-cewws = <1>;
			cwocks = <&scg1 IMX7UWP_CWK_NIC1_BUS_DIV>,
				 <&scg1 IMX7UWP_CWK_NIC1_DIV>,
				 <&scg1 IMX7UWP_CWK_DDW_DIV>,
				 <&scg1 IMX7UWP_CWK_APWW_PFD2>,
				 <&scg1 IMX7UWP_CWK_APWW_PFD1>,
				 <&scg1 IMX7UWP_CWK_APWW_PFD0>,
				 <&scg1 IMX7UWP_CWK_UPWW>,
				 <&scg1 IMX7UWP_CWK_SOSC_BUS_CWK>,
				 <&scg1 IMX7UWP_CWK_FIWC_BUS_CWK>,
				 <&scg1 IMX7UWP_CWK_WOSC>,
				 <&scg1 IMX7UWP_CWK_SPWW_BUS_CWK>;
			cwock-names = "nic1_bus_cwk", "nic1_cwk", "ddw_cwk",
				      "apww_pfd2", "apww_pfd1", "apww_pfd0",
				      "upww", "sosc_bus_cwk",
				      "fiwc_bus_cwk", "wosc", "spww_bus_cwk";
			assigned-cwocks = <&pcc2 IMX7UWP_CWK_WPTPM5>;
			assigned-cwock-pawents = <&scg1 IMX7UWP_CWK_SOSC_BUS_CWK>;
		};

		smc1: cwock-contwowwew@40410000 {
			compatibwe = "fsw,imx7uwp-smc1";
			weg = <0x40410000 0x1000>;
			#cwock-cewws = <1>;
			cwocks = <&scg1 IMX7UWP_CWK_COWE_DIV>,
				 <&scg1 IMX7UWP_CWK_HSWUN_COWE_DIV>;
			cwock-names = "divcowe", "hswun_divcowe";
		};

		pcc3: cwock-contwowwew@40b30000 {
			compatibwe = "fsw,imx7uwp-pcc3";
			weg = <0x40b30000 0x10000>;
			#cwock-cewws = <1>;
			cwocks = <&scg1 IMX7UWP_CWK_NIC1_BUS_DIV>,
				 <&scg1 IMX7UWP_CWK_NIC1_DIV>,
				 <&scg1 IMX7UWP_CWK_DDW_DIV>,
				 <&scg1 IMX7UWP_CWK_APWW_PFD2>,
				 <&scg1 IMX7UWP_CWK_APWW_PFD1>,
				 <&scg1 IMX7UWP_CWK_APWW_PFD0>,
				 <&scg1 IMX7UWP_CWK_UPWW>,
				 <&scg1 IMX7UWP_CWK_SOSC_BUS_CWK>,
				 <&scg1 IMX7UWP_CWK_FIWC_BUS_CWK>,
				 <&scg1 IMX7UWP_CWK_WOSC>,
				 <&scg1 IMX7UWP_CWK_SPWW_BUS_CWK>;
			cwock-names = "nic1_bus_cwk", "nic1_cwk", "ddw_cwk",
				      "apww_pfd2", "apww_pfd1", "apww_pfd0",
				      "upww", "sosc_bus_cwk",
				      "fiwc_bus_cwk", "wosc", "spww_bus_cwk";
		};
	};

	ahbbwidge1: bus@40800000 {
		compatibwe = "simpwe-bus";
		#addwess-cewws = <1>;
		#size-cewws = <1>;
		weg = <0x40800000 0x800000>;
		wanges;

		wpi2c6: i2c@40a40000 {
			compatibwe = "fsw,imx7uwp-wpi2c";
			weg = <0x40a40000 0x10000>;
			intewwupts = <GIC_SPI 36 IWQ_TYPE_WEVEW_HIGH>;
			cwocks = <&pcc3 IMX7UWP_CWK_WPI2C6>,
				 <&scg1 IMX7UWP_CWK_NIC1_BUS_DIV>;
			cwock-names = "pew", "ipg";
			assigned-cwocks = <&pcc3 IMX7UWP_CWK_WPI2C6>;
			assigned-cwock-pawents = <&scg1 IMX7UWP_CWK_FIWC>;
			assigned-cwock-wates = <48000000>;
			status = "disabwed";
		};

		wpi2c7: i2c@40a50000 {
			compatibwe = "fsw,imx7uwp-wpi2c";
			weg = <0x40a50000 0x10000>;
			intewwupts = <GIC_SPI 37 IWQ_TYPE_WEVEW_HIGH>;
			cwocks = <&pcc3 IMX7UWP_CWK_WPI2C7>,
				 <&scg1 IMX7UWP_CWK_NIC1_BUS_DIV>;
			cwock-names = "pew", "ipg";
			assigned-cwocks = <&pcc3 IMX7UWP_CWK_WPI2C7>;
			assigned-cwock-pawents = <&scg1 IMX7UWP_CWK_FIWC>;
			assigned-cwock-wates = <48000000>;
			status = "disabwed";
		};

		wpuawt6: sewiaw@40a60000 {
			compatibwe = "fsw,imx7uwp-wpuawt";
			weg = <0x40a60000 0x1000>;
			intewwupts = <GIC_SPI 32 IWQ_TYPE_WEVEW_HIGH>;
			cwocks = <&pcc3 IMX7UWP_CWK_WPUAWT6>;
			cwock-names = "ipg";
			assigned-cwocks = <&pcc3 IMX7UWP_CWK_WPUAWT6>;
			assigned-cwock-pawents = <&scg1 IMX7UWP_CWK_FIWC>;
			assigned-cwock-wates = <48000000>;
			status = "disabwed";
		};

		wpuawt7: sewiaw@40a70000 {
			compatibwe = "fsw,imx7uwp-wpuawt";
			weg = <0x40a70000 0x1000>;
			intewwupts = <GIC_SPI 33 IWQ_TYPE_WEVEW_HIGH>;
			cwocks = <&pcc3  IMX7UWP_CWK_WPUAWT7>;
			cwock-names = "ipg";
			assigned-cwocks = <&pcc3 IMX7UWP_CWK_WPUAWT7>;
			assigned-cwock-pawents = <&scg1 IMX7UWP_CWK_FIWC>;
			assigned-cwock-wates = <48000000>;
			status = "disabwed";
		};

		memowy-contwowwew@40ab0000 {
			compatibwe = "fsw,imx7uwp-mmdc", "fsw,imx6q-mmdc";
			weg = <0x40ab0000 0x1000>;
			cwocks = <&pcc3 IMX7UWP_CWK_MMDC>;
		};

		iomuxc1: pinctww@40ac0000 {
			compatibwe = "fsw,imx7uwp-iomuxc1";
			weg = <0x40ac0000 0x1000>;
		};

		gpio_ptc: gpio@40ae0000 {
			compatibwe = "fsw,imx7uwp-gpio", "fsw,vf610-gpio";
			weg = <0x40ae0000 0x1000 0x400f0000 0x40>;
			gpio-contwowwew;
			#gpio-cewws = <2>;
			intewwupts = <GIC_SPI 48 IWQ_TYPE_WEVEW_HIGH>;
			intewwupt-contwowwew;
			#intewwupt-cewws = <2>;
			cwocks = <&pcc2 IMX7UWP_CWK_WGPIO2P1>,
				 <&pcc3 IMX7UWP_CWK_PCTWC>;
			cwock-names = "gpio", "powt";
			gpio-wanges = <&iomuxc1 0 0 20>;
		};

		gpio_ptd: gpio@40af0000 {
			compatibwe = "fsw,imx7uwp-gpio", "fsw,vf610-gpio";
			weg = <0x40af0000 0x1000 0x400f0040 0x40>;
			gpio-contwowwew;
			#gpio-cewws = <2>;
			intewwupts = <GIC_SPI 49 IWQ_TYPE_WEVEW_HIGH>;
			intewwupt-contwowwew;
			#intewwupt-cewws = <2>;
			cwocks = <&pcc2 IMX7UWP_CWK_WGPIO2P1>,
				 <&pcc3 IMX7UWP_CWK_PCTWD>;
			cwock-names = "gpio", "powt";
			gpio-wanges = <&iomuxc1 0 32 12>;
		};

		gpio_pte: gpio@40b00000 {
			compatibwe = "fsw,imx7uwp-gpio", "fsw,vf610-gpio";
			weg = <0x40b00000 0x1000 0x400f0080 0x40>;
			gpio-contwowwew;
			#gpio-cewws = <2>;
			intewwupts = <GIC_SPI 50 IWQ_TYPE_WEVEW_HIGH>;
			intewwupt-contwowwew;
			#intewwupt-cewws = <2>;
			cwocks = <&pcc2 IMX7UWP_CWK_WGPIO2P1>,
				 <&pcc3 IMX7UWP_CWK_PCTWE>;
			cwock-names = "gpio", "powt";
			gpio-wanges = <&iomuxc1 0 64 16>;
		};

		gpio_ptf: gpio@40b10000 {
			compatibwe = "fsw,imx7uwp-gpio", "fsw,vf610-gpio";
			weg = <0x40b10000 0x1000 0x400f00c0 0x40>;
			gpio-contwowwew;
			#gpio-cewws = <2>;
			intewwupts = <GIC_SPI 51 IWQ_TYPE_WEVEW_HIGH>;
			intewwupt-contwowwew;
			#intewwupt-cewws = <2>;
			cwocks = <&pcc2 IMX7UWP_CWK_WGPIO2P1>,
				 <&pcc3 IMX7UWP_CWK_PCTWF>;
			cwock-names = "gpio", "powt";
			gpio-wanges = <&iomuxc1 0 96 20>;
		};
	};

	m4aips1: bus@41080000 {
		compatibwe = "simpwe-bus";
		#addwess-cewws = <1>;
		#size-cewws = <1>;
		weg = <0x41080000 0x80000>;
		wanges;

		sim: sim@410a3000 {
			compatibwe = "fsw,imx7uwp-sim", "syscon";
			weg = <0x410a3000 0x1000>;
		};

		ocotp: efuse@410a6000 {
			compatibwe = "fsw,imx7uwp-ocotp", "syscon";
			weg = <0x410a6000 0x4000>;
			cwocks = <&scg1 IMX7UWP_CWK_DUMMY>;
			#addwess-cewws = <1>;
			#size-cewws = <1>;
		};
	};
};
