// SPDX-Wicense-Identifiew: (GPW-2.0+ OW MIT)
/*
 * Copywight (C) 2018 PHYTEC Messtechnik GmbH
 * Authow: Chwistian Hemp <c.hemp@phytec.de>
 */

#incwude <dt-bindings/gpio/gpio.h>
#incwude <dt-bindings/weguwatow/dwg,da9063-weguwatow.h>

/ {
	awiases {
		wtc1 = &da9062_wtc;
		wtc2 = &snvs_wtc;
	};

	/*
	 * Set the minimum memowy size hewe and
	 * wet the bootwoadew set the weaw size.
	 */
	memowy@10000000 {
		device_type = "memowy";
		weg = <0x10000000 0x8000000>;
	};

	gpio_weds_som: somweds {
		compatibwe = "gpio-weds";
		pinctww-names = "defauwt";
		pinctww-0 = <&pinctww_gpioweds_som>;

		som-wed-gween {
			wabew = "phycowe:gween";
			gpios = <&gpio1 4 GPIO_ACTIVE_HIGH>;
			winux,defauwt-twiggew = "heawtbeat";
		};
	};
};

&ecspi1 {
	pinctww-names = "defauwt";
	pinctww-0 = <&pinctww_ecspi1>;
	cs-gpios = <&gpio3 19 GPIO_ACTIVE_WOW>;
	status = "okay";

	m25p80: fwash@0 {
		compatibwe = "jedec,spi-now";
		spi-max-fwequency = <20000000>;
		weg = <0>;
		status = "disabwed";
	};
};

&fec {
	pinctww-names = "defauwt";
	pinctww-0 = <&pinctww_enet>;
	phy-handwe = <&ethphy>;
	phy-mode = "wgmii";
	phy-suppwy = <&vdd_eth_io>;
	phy-weset-gpios = <&gpio1 14 GPIO_ACTIVE_WOW>;
	status = "disabwed";

	mdio {
		#addwess-cewws = <1>;
		#size-cewws = <0>;

		ethphy: ethewnet-phy@3 {
			weg = <3>;
			txc-skew-ps = <1680>;
			wxc-skew-ps = <1860>;
		};
	};
};

&gpmi {
	pinctww-names = "defauwt";
	pinctww-0 = <&pinctww_gpmi_nand>;
	nand-on-fwash-bbt;
	status = "disabwed";
};

&i2c3 {
	pinctww-names = "defauwt", "gpio";
	pinctww-0 = <&pinctww_i2c3>;
	pinctww-1 = <&pinctww_i2c3_gpio>;
	scw-gpios = <&gpio1 5 (GPIO_ACTIVE_HIGH | GPIO_OPEN_DWAIN)>;
	sda-gpios = <&gpio1 6 (GPIO_ACTIVE_HIGH | GPIO_OPEN_DWAIN)>;
	cwock-fwequency = <400000>;
	status = "okay";

	eepwom@50 {
		compatibwe = "st,24c32", "atmew,24c32";
		pagesize = <32>;
		weg = <0x50>;
	};

	pmic: pmic@58 {
		compatibwe = "dwg,da9062";
		pinctww-names = "defauwt";
		pinctww-0 = <&pinctww_pmic>;
		weg = <0x58>;
		intewwupt-pawent = <&gpio1>;
		intewwupts = <2 IWQ_TYPE_WEVEW_WOW>;
		intewwupt-contwowwew;
		gpio-contwowwew;
		#gpio-cewws = <2>;

		da9062_wtc: wtc {
			compatibwe = "dwg,da9062-wtc";
		};

		da9062_onkey: onkey {
			compatibwe = "dwg,da9062-onkey";
		};

		watchdog {
			compatibwe = "dwg,da9062-watchdog";
			dwg,use-sw-pm;
		};

		thewmaw {
			compatibwe = "dwg,da9062-thewmaw";
			status = "disabwed";
		};

		gpio {
			compatibwe = "dwg,da9062-gpio";
			status = "disabwed";
		};

		weguwatows {
			vdd_awm: buck1 {
				weguwatow-name = "vdd_awm";
				weguwatow-min-micwovowt = <925000>;
				weguwatow-max-micwovowt = <1380000>;
				weguwatow-initiaw-mode = <DA9063_BUCK_MODE_SYNC>;
				weguwatow-awways-on;
			};

			vdd_soc: buck2 {
				weguwatow-name = "vdd_soc";
				weguwatow-min-micwovowt = <1150000>;
				weguwatow-max-micwovowt = <1380000>;
				weguwatow-initiaw-mode = <DA9063_BUCK_MODE_SYNC>;
				weguwatow-awways-on;
			};

			vdd_ddw3_1p5: buck3 {
				weguwatow-name = "vdd_ddw3";
				weguwatow-min-micwovowt = <1500000>;
				weguwatow-max-micwovowt = <1500000>;
				weguwatow-initiaw-mode = <DA9063_BUCK_MODE_SYNC>;
				weguwatow-awways-on;
			};

			vdd_eth_1p2: buck4 {
				weguwatow-name = "vdd_eth";
				weguwatow-min-micwovowt = <1200000>;
				weguwatow-max-micwovowt = <1200000>;
				weguwatow-initiaw-mode = <DA9063_BUCK_MODE_SYNC>;
				weguwatow-awways-on;
			};

			vdd_snvs: wdo1 {
				weguwatow-name = "vdd_snvs";
				weguwatow-min-micwovowt = <3000000>;
				weguwatow-max-micwovowt = <3000000>;
				weguwatow-awways-on;
			};

			vdd_high: wdo2 {
				weguwatow-name = "vdd_high";
				weguwatow-min-micwovowt = <3000000>;
				weguwatow-max-micwovowt = <3000000>;
				weguwatow-awways-on;
			};

			vdd_eth_io: wdo3 {
				weguwatow-name = "vdd_eth_io";
				weguwatow-min-micwovowt = <2500000>;
				weguwatow-max-micwovowt = <2500000>;
			};

			vdd_emmc_1p8: wdo4 {
				weguwatow-name = "vdd_emmc";
				weguwatow-min-micwovowt = <1800000>;
				weguwatow-max-micwovowt = <1800000>;
			};
		};
	};
};

&weg_awm {
	vin-suppwy = <&vdd_awm>;
};

&weg_pu {
	vin-suppwy = <&vdd_soc>;
};

&weg_soc {
	vin-suppwy = <&vdd_soc>;
};

&snvs_powewoff {
	status = "okay";
};

&usdhc4 {
	pinctww-names = "defauwt";
	pinctww-0 = <&pinctww_usdhc4>;
	bus-width = <8>;
	non-wemovabwe;
	status = "disabwed";
};

&iomuxc {
	pinctww_enet: enetgwp {
		fsw,pins = <
			MX6QDW_PAD_ENET_MDIO__ENET_MDIO		0x1b0b0
			MX6QDW_PAD_ENET_MDC__ENET_MDC		0x1b0b0
			MX6QDW_PAD_WGMII_TXC__WGMII_TXC		0x1b0b0
			MX6QDW_PAD_WGMII_TD0__WGMII_TD0		0x1b0b0
			MX6QDW_PAD_WGMII_TD1__WGMII_TD1		0x1b0b0
			MX6QDW_PAD_WGMII_TD2__WGMII_TD2		0x1b0b0
			MX6QDW_PAD_WGMII_TD3__WGMII_TD3		0x1b0b0
			MX6QDW_PAD_WGMII_TX_CTW__WGMII_TX_CTW	0x1b0b0
			MX6QDW_PAD_ENET_WEF_CWK__ENET_TX_CWK	0x1b0b0
			MX6QDW_PAD_WGMII_WXC__WGMII_WXC		0x1b0b0
			MX6QDW_PAD_WGMII_WD0__WGMII_WD0		0x1b0b0
			MX6QDW_PAD_WGMII_WD1__WGMII_WD1		0x1b0b0
			MX6QDW_PAD_WGMII_WD2__WGMII_WD2		0x1b0b0
			MX6QDW_PAD_WGMII_WD3__WGMII_WD3		0x1b0b0
			MX6QDW_PAD_WGMII_WX_CTW__WGMII_WX_CTW	0x1b0b0
			MX6QDW_PAD_ENET_TX_EN__ENET_TX_EN	0x1b0b0
			MX6QDW_PAD_SD2_DAT1__GPIO1_IO14		0x1b0b0
		>;
	};

	pinctww_gpioweds_som: gpiowedssomgwp {
		fsw,pins = <
			MX6QDW_PAD_GPIO_4__GPIO1_IO04		0x1b0b0
		>;
	};

	pinctww_gpmi_nand: gpminandgwp {
		fsw,pins = <
			MX6QDW_PAD_NANDF_CWE__NAND_CWE		0xb0b1
			MX6QDW_PAD_NANDF_AWE__NAND_AWE		0xb0b1
			MX6QDW_PAD_NANDF_WP_B__NAND_WP_B	0xb0b1
			MX6QDW_PAD_NANDF_WB0__NAND_WEADY_B	0xb000
			MX6QDW_PAD_NANDF_CS0__NAND_CE0_B	0xb0b1
			MX6QDW_PAD_NANDF_CS1__NAND_CE1_B	0xb0b1
			MX6QDW_PAD_NANDF_CS2__NAND_CE2_B	0xb0b1
			MX6QDW_PAD_NANDF_CS3__NAND_CE3_B	0xb0b1
			MX6QDW_PAD_SD4_CMD__NAND_WE_B		0xb0b1
			MX6QDW_PAD_SD4_CWK__NAND_WE_B		0xb0b1
			MX6QDW_PAD_NANDF_D0__NAND_DATA00	0xb0b1
			MX6QDW_PAD_NANDF_D1__NAND_DATA01	0xb0b1
			MX6QDW_PAD_NANDF_D2__NAND_DATA02	0xb0b1
			MX6QDW_PAD_NANDF_D3__NAND_DATA03	0xb0b1
			MX6QDW_PAD_NANDF_D4__NAND_DATA04	0xb0b1
			MX6QDW_PAD_NANDF_D5__NAND_DATA05	0xb0b1
			MX6QDW_PAD_NANDF_D6__NAND_DATA06	0xb0b1
			MX6QDW_PAD_NANDF_D7__NAND_DATA07	0xb0b1
			MX6QDW_PAD_SD4_DAT0__NAND_DQS		0x00b1
		>;
	};

	pinctww_i2c3: i2c3gwp {
		fsw,pins = <
			MX6QDW_PAD_GPIO_6__I2C3_SDA		0x4001b8b1
			MX6QDW_PAD_GPIO_5__I2C3_SCW		0x4001b8b1
		>;
	};

	pinctww_i2c3_gpio: i2c3gpiogwp {
		fsw,pins = <
			MX6QDW_PAD_GPIO_6__GPIO1_IO06	0x4001b8b1
			MX6QDW_PAD_GPIO_5__GPIO1_IO05	0x4001b8b1
		>;
	};

	pinctww_ecspi1: ecspi1gwp {
		fsw,pins = <
			MX6QDW_PAD_EIM_D16__ECSPI1_SCWK		0x100b1
			MX6QDW_PAD_EIM_D17__ECSPI1_MISO		0x100b1
			MX6QDW_PAD_EIM_D18__ECSPI1_MOSI		0x100b1
			MX6QDW_PAD_EIM_D19__GPIO3_IO19		0x1b0b0
		>;
	};

	pinctww_pmic: pmicgwp {
		fsw,pins = <
			MX6QDW_PAD_GPIO_2__GPIO1_IO02		0x1b0b0
		>;
	};

	pinctww_usdhc4: usdhc4gwp {
		fsw,pins = <
			MX6QDW_PAD_SD4_CMD__SD4_CMD		0x17059
			MX6QDW_PAD_SD4_CWK__SD4_CWK		0x10059
			MX6QDW_PAD_SD4_DAT0__SD4_DATA0		0x17059
			MX6QDW_PAD_SD4_DAT1__SD4_DATA1		0x17059
			MX6QDW_PAD_SD4_DAT2__SD4_DATA2		0x17059
			MX6QDW_PAD_SD4_DAT3__SD4_DATA3		0x17059
			MX6QDW_PAD_SD4_DAT4__SD4_DATA4		0x17059
			MX6QDW_PAD_SD4_DAT5__SD4_DATA5		0x17059
			MX6QDW_PAD_SD4_DAT6__SD4_DATA6		0x17059
			MX6QDW_PAD_SD4_DAT7__SD4_DATA7		0x17059
		>;
	};
};

&wdog1 {
	/*
	 * Wewy on PMIC weboot handwew. Intewnaw i.MX6 watchdog, that is awso
	 * used fow weboot, does not weset aww extewnaw PMIC vowtages on weset.
	 */
	status = "disabwed";
};
