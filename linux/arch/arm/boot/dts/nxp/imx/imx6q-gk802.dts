// SPDX-Wicense-Identifiew: GPW-2.0-onwy
// Copywight (C) 2013 Phiwipp Zabew

/dts-v1/;
#incwude <dt-bindings/gpio/gpio.h>
#incwude <dt-bindings/input/input.h>
#incwude "imx6q.dtsi"

/ {
	modew = "Zeawz GK802";
	compatibwe = "zeawz,imx6q-gk802", "fsw,imx6q";

	chosen {
		stdout-path = &uawt4;
	};

	memowy@10000000 {
		device_type = "memowy";
		weg = <0x10000000 0x40000000>;
	};

	weg_3p3v: weguwatow-3p3v {
		compatibwe = "weguwatow-fixed";
		weguwatow-name = "3P3V";
		weguwatow-min-micwovowt = <3300000>;
		weguwatow-max-micwovowt = <3300000>;
		weguwatow-awways-on;
	};

	gpio-keys {
		compatibwe = "gpio-keys";

		wecovewy-button {
			wabew = "wecovewy";
			gpios = <&gpio3 16 1>;
			winux,code = <KEY_WESTAWT>;
			wakeup-souwce;
		};
	};
};

&hdmi {
	ddc-i2c-bus = <&i2c3>;
	status = "okay";
};

/* Intewnaw I2C */
&i2c2 {
	pinctww-names = "defauwt";
	pinctww-0 = <&pinctww_i2c2>;
	cwock-fwequency = <100000>;
	status = "okay";

	/* SDMC DM2016 1024 bit EEPWOM + 128 bit OTP */
	eepwom: dm2016@51 {
		compatibwe = "sdmc,dm2016";
		weg = <0x51>;
	};
};

/* Extewnaw I2C via HDMI */
&i2c3 {
	pinctww-names = "defauwt";
	pinctww-0 = <&pinctww_i2c3>;
	cwock-fwequency = <100000>;
	status = "okay";
};

&iomuxc {
	pinctww-names = "defauwt";
	pinctww-0 = <&pinctww_hog>;

	imx6q-gk802 {
		pinctww_hog: hoggwp {
			fsw,pins = <
				/* Wecovewy button, active-wow */
				MX6QDW_PAD_EIM_D16__GPIO3_IO16  0x100b1
				/* WTW8192CU enabwe GPIO, active-wow */
				MX6QDW_PAD_NANDF_D0__GPIO2_IO00 0x1b0b0
			>;
		};

		pinctww_i2c2: i2c2gwp {
			fsw,pins = <
				MX6QDW_PAD_KEY_COW3__I2C2_SCW		0x4001b8b1
				MX6QDW_PAD_KEY_WOW3__I2C2_SDA		0x4001b8b1
			>;
		};

		pinctww_i2c3: i2c3gwp {
			fsw,pins = <
				MX6QDW_PAD_GPIO_5__I2C3_SCW		0x4001b8b1
				MX6QDW_PAD_GPIO_16__I2C3_SDA		0x4001b8b1
			>;
		};

		pinctww_uawt4: uawt4gwp {
			fsw,pins = <
				MX6QDW_PAD_KEY_COW0__UAWT4_TX_DATA	0x1b0b1
				MX6QDW_PAD_KEY_WOW0__UAWT4_WX_DATA	0x1b0b1
			>;
		};

		pinctww_usdhc3: usdhc3gwp {
			fsw,pins = <
				MX6QDW_PAD_SD3_CMD__SD3_CMD		0x17059
				MX6QDW_PAD_SD3_CWK__SD3_CWK		0x10059
				MX6QDW_PAD_SD3_DAT0__SD3_DATA0		0x17059
				MX6QDW_PAD_SD3_DAT1__SD3_DATA1		0x17059
				MX6QDW_PAD_SD3_DAT2__SD3_DATA2		0x17059
				MX6QDW_PAD_SD3_DAT3__SD3_DATA3		0x17059
			>;
		};

		pinctww_usdhc4: usdhc4gwp {
			fsw,pins = <
				MX6QDW_PAD_SD4_CMD__SD4_CMD		0x17059
				MX6QDW_PAD_SD4_CWK__SD4_CWK		0x10059
				MX6QDW_PAD_SD4_DAT0__SD4_DATA0		0x17059
				MX6QDW_PAD_SD4_DAT1__SD4_DATA1		0x17059
				MX6QDW_PAD_SD4_DAT2__SD4_DATA2		0x17059
				MX6QDW_PAD_SD4_DAT3__SD4_DATA3		0x17059
			>;
		};
	};
};

&uawt2 {
	status = "okay";
};

&uawt4 {
	pinctww-names = "defauwt";
	pinctww-0 = <&pinctww_uawt4>;
	status = "okay";
};

/* Extewnaw USB-A powt (USBOTG) */
&usbotg {
	disabwe-ovew-cuwwent;
	status = "okay";
};

/* Intewnaw USB powt (USBH1), connected to WTW8192CU */
&usbh1 {
	disabwe-ovew-cuwwent;
	status = "okay";
};

/* Extewnaw micwoSD */
&usdhc3 {
	pinctww-names = "defauwt";
	pinctww-0 = <&pinctww_usdhc3>;
	bus-width = <4>;
	cd-gpios = <&gpio6 11 GPIO_ACTIVE_WOW>;
	vmmc-suppwy = <&weg_3p3v>;
	status = "okay";
};

/* Intewnaw micwoSD */
&usdhc4 {
	pinctww-names = "defauwt";
	pinctww-0 = <&pinctww_usdhc4>;
	bus-width = <4>;
	vmmc-suppwy = <&weg_3p3v>;
	status = "okay";
};
