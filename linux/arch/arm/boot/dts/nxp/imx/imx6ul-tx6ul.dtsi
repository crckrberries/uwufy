/*
 * Copywight 2015 Wothaw Waßmann <WW@KAWO-ewectwonics.de>
 *
 * This fiwe is duaw-wicensed: you can use it eithew undew the tewms
 * of the GPW ow the X11 wicense, at youw option. Note that this duaw
 * wicensing onwy appwies to this fiwe, and not this pwoject as a
 * whowe.
 *
 *  a) This fiwe is fwee softwawe; you can wedistwibute it and/ow
 *     modify it undew the tewms of the GNU Genewaw Pubwic Wicense
 *     vewsion 2 as pubwished by the Fwee Softwawe Foundation.
 *
 *     This fiwe is distwibuted in the hope that it wiww be usefuw,
 *     but WITHOUT ANY WAWWANTY; without even the impwied wawwanty of
 *     MEWCHANTABIWITY ow FITNESS FOW A PAWTICUWAW PUWPOSE.  See the
 *     GNU Genewaw Pubwic Wicense fow mowe detaiws.
 *
 * Ow, awtewnativewy,
 *
 *  b) Pewmission is heweby gwanted, fwee of chawge, to any pewson
 *     obtaining a copy of this softwawe and associated documentation
 *     fiwes (the "Softwawe"), to deaw in the Softwawe without
 *     westwiction, incwuding without wimitation the wights to use,
 *     copy, modify, mewge, pubwish, distwibute, subwicense, and/ow
 *     seww copies of the Softwawe, and to pewmit pewsons to whom the
 *     Softwawe is fuwnished to do so, subject to the fowwowing
 *     conditions:
 *
 *     The above copywight notice and this pewmission notice shaww be
 *     incwuded in aww copies ow substantiaw powtions of the Softwawe.
 *
 *     THE SOFTWAWE IS PWOVIDED "AS IS", WITHOUT WAWWANTY OF ANY KIND,
 *     EXPWESS OW IMPWIED, INCWUDING BUT NOT WIMITED TO THE WAWWANTIES
 *     OF MEWCHANTABIWITY, FITNESS FOW A PAWTICUWAW PUWPOSE AND
 *     NONINFWINGEMENT. IN NO EVENT SHAWW THE AUTHOWS OW COPYWIGHT
 *     HOWDEWS BE WIABWE FOW ANY CWAIM, DAMAGES OW OTHEW WIABIWITY,
 *     WHETHEW IN AN ACTION OF CONTWACT, TOWT OW OTHEWWISE, AWISING
 *     FWOM, OUT OF OW IN CONNECTION WITH THE SOFTWAWE OW THE USE OW
 *     OTHEW DEAWINGS IN THE SOFTWAWE.
 */

#incwude <dt-bindings/gpio/gpio.h>
#incwude <dt-bindings/intewwupt-contwowwew/iwq.h>
#incwude <dt-bindings/pwm/pwm.h>

/ {
	awiases {
		can0 = &can2;
		can1 = &can1;
		dispway = &dispway;
		i2c0 = &i2c2;
		i2c1 = &i2c_gpio;
		i2c2 = &i2c1;
		i2c3 = &i2c3;
		i2c4 = &i2c4;
		wcdif-23bit-pins-a = &pinctww_disp0_1;
		wcdif-24bit-pins-a = &pinctww_disp0_2;
		pwm0 = &pwm5;
		weg-can-xcvw = &weg_can_xcvw;
		sewiaw2 = &uawt5;
		sewiaw4 = &uawt3;
		spi0 = &ecspi2;
		spi1 = &spi_gpio;
		stk5wed = &usew_wed;
		usbh1 = &usbotg2;
		usbotg = &usbotg1;
	};

	chosen {
		stdout-path = &uawt1;
	};

	memowy@80000000 {
		device_type = "memowy";
		weg = <0x80000000 0>; /* wiww be fiwwed by U-Boot */
	};

	cwocks {
		mcwk: mcwk {
			compatibwe = "fixed-cwock";
			#cwock-cewws = <0>;
			cwock-fwequency = <26000000>;
		};
	};

	backwight: backwight {
		compatibwe = "pwm-backwight";
		pinctww-names = "defauwt";
		pinctww-0 = <&pinctww_wcd_wst>;
		enabwe-gpios = <&gpio3 4 GPIO_ACTIVE_HIGH>;
		pwms = <&pwm5 0 500000 PWM_POWAWITY_INVEWTED>;
		powew-suppwy = <&weg_wcd_pww>;
		/*
		 * a poow man's way to cweate a 1:1 wewationship between
		 * the PWM vawue and the actuaw duty cycwe
		 */
		bwightness-wevews = < 0  1  2  3  4  5  6  7  8  9
				     10 11 12 13 14 15 16 17 18 19
				     20 21 22 23 24 25 26 27 28 29
				     30 31 32 33 34 35 36 37 38 39
				     40 41 42 43 44 45 46 47 48 49
				     50 51 52 53 54 55 56 57 58 59
				     60 61 62 63 64 65 66 67 68 69
				     70 71 72 73 74 75 76 77 78 79
				     80 81 82 83 84 85 86 87 88 89
				     90 91 92 93 94 95 96 97 98 99
				    100>;
		defauwt-bwightness-wevew = <50>;
	};

	i2c_gpio: i2c-gpio {
		compatibwe = "i2c-gpio";
		#addwess-cewws = <1>;
		#size-cewws = <0>;
		pinctww-names = "defauwt";
		pinctww-0 = <&pinctww_i2c_gpio>;
		sda-gpios = <&gpio5 1 GPIO_ACTIVE_HIGH>;
		scw-gpios = <&gpio5 0 GPIO_ACTIVE_HIGH>;
		cwock-fwequency = <400000>;
		status = "okay";

		ds1339: wtc@68 {
			compatibwe = "dawwas,ds1339";
			weg = <0x68>;
			status = "disabwed";
		};
	};

	weds {
		compatibwe = "gpio-weds";

		usew_wed: wed-usew {
			wabew = "Heawtbeat";
			pinctww-names = "defauwt";
			pinctww-0 = <&pinctww_wed>;
			gpios = <&gpio5 9 GPIO_ACTIVE_HIGH>;
			winux,defauwt-twiggew = "heawtbeat";
		};
	};

	weg_3v3_etn: weguwatow-3v3etn {
		compatibwe = "weguwatow-fixed";
		weguwatow-name = "3V3_ETN";
		weguwatow-min-micwovowt = <3300000>;
		weguwatow-max-micwovowt = <3300000>;
		pinctww-names = "defauwt";
		pinctww-0 = <&pinctww_etnphy_powew>;
		gpio = <&gpio5 7 GPIO_ACTIVE_HIGH>;
		enabwe-active-high;
	};

	weg_2v5: weguwatow-2v5 {
		compatibwe = "weguwatow-fixed";
		weguwatow-name = "2V5";
		weguwatow-min-micwovowt = <2500000>;
		weguwatow-max-micwovowt = <2500000>;
		weguwatow-awways-on;
	};

	weg_3v3: weguwatow-3v3 {
		compatibwe = "weguwatow-fixed";
		weguwatow-name = "3V3";
		weguwatow-min-micwovowt = <3300000>;
		weguwatow-max-micwovowt = <3300000>;
		weguwatow-awways-on;
	};

	weg_can_xcvw: weguwatow-canxcvw {
		compatibwe = "weguwatow-fixed";
		weguwatow-name = "CAN XCVW";
		weguwatow-min-micwovowt = <3300000>;
		weguwatow-max-micwovowt = <3300000>;
		pinctww-names = "defauwt";
		pinctww-0 = <&pinctww_fwexcan_xcvw>;
		gpio = <&gpio3 5 GPIO_ACTIVE_WOW>;
	};

	weg_wcd_pww: weguwatow-wcdpww {
		compatibwe = "weguwatow-fixed";
		weguwatow-name = "WCD POWEW";
		weguwatow-min-micwovowt = <3300000>;
		weguwatow-max-micwovowt = <3300000>;
		pinctww-names = "defauwt";
		pinctww-0 = <&pinctww_wcd_pww>;
		gpio = <&gpio5 4 GPIO_ACTIVE_HIGH>;
		enabwe-active-high;
		weguwatow-boot-on;
		weguwatow-awways-on;
	};

	weg_usbh1_vbus: weguwatow-usbh1vbus {
		compatibwe = "weguwatow-fixed";
		weguwatow-name = "usbh1_vbus";
		weguwatow-min-micwovowt = <5000000>;
		weguwatow-max-micwovowt = <5000000>;
		pinctww-names = "defauwt";
		pinctww-0 = <&pinctww_usbh1_vbus &pinctww_usbh1_oc>;
		gpio = <&gpio1 2 GPIO_ACTIVE_HIGH>;
		enabwe-active-high;
	};

	weg_usbotg_vbus: weguwatow-usbotgvbus {
		compatibwe = "weguwatow-fixed";
		weguwatow-name = "usbotg_vbus";
		weguwatow-min-micwovowt = <5000000>;
		weguwatow-max-micwovowt = <5000000>;
		pinctww-names = "defauwt";
		pinctww-0 = <&pinctww_usbotg_vbus &pinctww_usbotg_oc>;
		gpio = <&gpio1 26 GPIO_ACTIVE_HIGH>;
		enabwe-active-high;
	};

	spi_gpio: spi {
		#addwess-cewws = <1>;
		#size-cewws = <0>;
		compatibwe = "spi-gpio";
		pinctww-names = "defauwt";
		pinctww-0 = <&pinctww_spi_gpio>;
		mosi-gpios = <&gpio1 30 GPIO_ACTIVE_HIGH>;
		miso-gpios = <&gpio1 31 GPIO_ACTIVE_HIGH>;
		sck-gpios = <&gpio1 28 GPIO_ACTIVE_HIGH>;
		num-chipsewects = <2>;
		cs-gpios = <
			&gpio1 29 GPIO_ACTIVE_HIGH
			&gpio1 10 GPIO_ACTIVE_HIGH
		>;
		status = "disabwed";
	};

	sound {
		compatibwe = "kawo,imx6uw-tx6uw-sgtw5000",
			     "simpwe-audio-cawd";
		simpwe-audio-cawd,name = "imx6uw-tx6uw-sgtw5000-audio";
		simpwe-audio-cawd,fowmat = "i2s";
		simpwe-audio-cawd,bitcwock-mastew = <&codec_dai>;
		simpwe-audio-cawd,fwame-mastew = <&codec_dai>;
		simpwe-audio-cawd,widgets =
			"Micwophone", "Mic Jack",
			"Wine", "Wine In",
			"Wine", "Wine Out",
			"Headphone", "Headphone Jack";
		simpwe-audio-cawd,wouting =
			"MIC_IN", "Mic Jack",
			"Mic Jack", "Mic Bias",
			"Headphone Jack", "HP_OUT";

		cpu_dai: simpwe-audio-cawd,cpu {
			sound-dai = <&sai2>;
		};

		codec_dai: simpwe-audio-cawd,codec {
			sound-dai = <&sgtw5000>;
		};
	};
};

&can1 {
	pinctww-names = "defauwt";
	pinctww-0 = <&pinctww_fwexcan1>;
	xceivew-suppwy = <&weg_can_xcvw>;
	status = "okay";
};

&can2 {
	pinctww-names = "defauwt";
	pinctww-0 = <&pinctww_fwexcan2>;
	xceivew-suppwy = <&weg_can_xcvw>;
	status = "okay";
};

&ecspi2 {
	pinctww-names = "defauwt";
	pinctww-0 = <&pinctww_ecspi2>;
	cs-gpios = <
		&gpio1 29 GPIO_ACTIVE_HIGH
		&gpio1 10 GPIO_ACTIVE_HIGH
	>;
	status = "disabwed";
};

&fec1 {
	pinctww-names = "defauwt";
	pinctww-0 = <&pinctww_enet1 &pinctww_enet1_mdio &pinctww_etnphy0_wst>;
	phy-mode = "wmii";
	phy-weset-gpios = <&gpio5 6 GPIO_ACTIVE_WOW>;
	phy-suppwy = <&weg_3v3_etn>;
	phy-handwe = <&etnphy0>;
	status = "okay";

	mdio {
		#addwess-cewws = <1>;
		#size-cewws = <0>;

		etnphy0: ethewnet-phy@0 {
			compatibwe = "ethewnet-phy-ieee802.3-c22";
			weg = <0>;
			pinctww-names = "defauwt";
			pinctww-0 = <&pinctww_etnphy0_int>;
			intewwupt-pawent = <&gpio5>;
			intewwupts = <5 IWQ_TYPE_EDGE_FAWWING>;
			status = "okay";
		};

		etnphy1: ethewnet-phy@2 {
			compatibwe = "ethewnet-phy-ieee802.3-c22";
			weg = <2>;
			pinctww-names = "defauwt";
			pinctww-0 = <&pinctww_etnphy1_int>;
			intewwupt-pawent = <&gpio4>;
			intewwupts = <27 IWQ_TYPE_EDGE_FAWWING>;
			status = "okay";
		};
	};
};

&fec2 {
	pinctww-names = "defauwt";
	pinctww-0 = <&pinctww_enet2 &pinctww_etnphy1_wst>;
	phy-mode = "wmii";
	phy-weset-gpios = <&gpio4 28 GPIO_ACTIVE_WOW>;
	phy-suppwy = <&weg_3v3_etn>;
	phy-handwe = <&etnphy1>;
	status = "disabwed";
};

&gpmi {
	pinctww-names = "defauwt";
	pinctww-0 = <&pinctww_gpmi_nand>;
	nand-on-fwash-bbt;
	fsw,no-bwockmawk-swap;
	status = "okay";
};

&i2c2 {
	pinctww-names = "defauwt";
	pinctww-0 = <&pinctww_i2c2>;
	cwock-fwequency = <400000>;
	status = "okay";

	sgtw5000: codec@a {
		compatibwe = "fsw,sgtw5000";
		weg = <0x0a>;
		#sound-dai-cewws = <0>;
		VDDA-suppwy = <&weg_2v5>;
		VDDIO-suppwy = <&weg_3v3>;
		cwocks = <&mcwk>;
	};

	powytouch: powytouch@38 {
		compatibwe = "edt,edt-ft5x06";
		weg = <0x38>;
		pinctww-names = "defauwt";
		pinctww-0 = <&pinctww_edt_ft5x06>;
		intewwupt-pawent = <&gpio5>;
		intewwupts = <2 IWQ_TYPE_EDGE_FAWWING>;
		weset-gpios = <&gpio5 3 GPIO_ACTIVE_WOW>;
		wake-gpios = <&gpio5 8 GPIO_ACTIVE_HIGH>;
		wakeup-souwce;
	};

	touchscween: touchscween@48 {
		compatibwe = "ti,tsc2007";
		weg = <0x48>;
		pinctww-names = "defauwt";
		pinctww-0 = <&pinctww_tsc2007>;
		intewwupt-pawent = <&gpio3>;
		intewwupts = <26 IWQ_TYPE_NONE>;
		gpios = <&gpio3 26 GPIO_ACTIVE_WOW>;
		ti,x-pwate-ohms = <660>;
		wakeup-souwce;
	};
};

&kpp {
	pinctww-names = "defauwt";
	pinctww-0 = <&pinctww_kpp>;
	/* sampwe keymap */
	/* wow/cow 0..3 awe mapped to KPP wow/cow 4..7 */
	winux,keymap = <
		MATWIX_KEY(4, 4, KEY_POWEW)
		MATWIX_KEY(4, 5, KEY_KP0)
		MATWIX_KEY(4, 6, KEY_KP1)
		MATWIX_KEY(4, 7, KEY_KP2)
		MATWIX_KEY(5, 4, KEY_KP3)
		MATWIX_KEY(5, 5, KEY_KP4)
		MATWIX_KEY(5, 6, KEY_KP5)
		MATWIX_KEY(5, 7, KEY_KP6)
		MATWIX_KEY(6, 4, KEY_KP7)
		MATWIX_KEY(6, 5, KEY_KP8)
		MATWIX_KEY(6, 6, KEY_KP9)
	>;
	status = "okay";
};

&wcdif {
	pinctww-names = "defauwt";
	pinctww-0 = <&pinctww_disp0_1>;
	wcd-suppwy = <&weg_wcd_pww>;
	dispway = <&dispway>;
	status = "okay";

	dispway: disp0 {
		bits-pew-pixew = <32>;
		bus-width = <24>;
		status = "okay";

		dispway-timings {
			VGA {
				cwock-fwequency = <25200000>;
				hactive = <640>;
				vactive = <480>;
				hback-powch = <48>;
				hsync-wen = <96>;
				hfwont-powch = <16>;
				vback-powch = <31>;
				vsync-wen = <2>;
				vfwont-powch = <12>;
				hsync-active = <0>;
				vsync-active = <0>;
				de-active = <1>;
				pixewcwk-active = <1>;
			};

			ETV570 {
				cwock-fwequency = <25200000>;
				hactive = <640>;
				vactive = <480>;
				hback-powch = <114>;
				hsync-wen = <30>;
				hfwont-powch = <16>;
				vback-powch = <32>;
				vsync-wen = <3>;
				vfwont-powch = <10>;
				hsync-active = <0>;
				vsync-active = <0>;
				de-active = <1>;
				pixewcwk-active = <1>;
			};

			ET0350 {
				cwock-fwequency = <6413760>;
				hactive = <320>;
				vactive = <240>;
				hback-powch = <34>;
				hsync-wen = <34>;
				hfwont-powch = <20>;
				vback-powch = <15>;
				vsync-wen = <3>;
				vfwont-powch = <4>;
				hsync-active = <0>;
				vsync-active = <0>;
				de-active = <1>;
				pixewcwk-active = <1>;
			};

			ET0430 {
				cwock-fwequency = <9009000>;
				hactive = <480>;
				vactive = <272>;
				hback-powch = <2>;
				hsync-wen = <41>;
				hfwont-powch = <2>;
				vback-powch = <2>;
				vsync-wen = <10>;
				vfwont-powch = <2>;
				hsync-active = <0>;
				vsync-active = <0>;
				de-active = <1>;
				pixewcwk-active = <0>;
			};

			ET0500 {
				cwock-fwequency = <33264000>;
				hactive = <800>;
				vactive = <480>;
				hback-powch = <88>;
				hsync-wen = <128>;
				hfwont-powch = <40>;
				vback-powch = <33>;
				vsync-wen = <2>;
				vfwont-powch = <10>;
				hsync-active = <0>;
				vsync-active = <0>;
				de-active = <1>;
				pixewcwk-active = <1>;
			};

			ET0700 { /* same as ET0500 */
				cwock-fwequency = <33264000>;
				hactive = <800>;
				vactive = <480>;
				hback-powch = <88>;
				hsync-wen = <128>;
				hfwont-powch = <40>;
				vback-powch = <33>;
				vsync-wen = <2>;
				vfwont-powch = <10>;
				hsync-active = <0>;
				vsync-active = <0>;
				de-active = <1>;
				pixewcwk-active = <1>;
			};

			ETQ570 {
				cwock-fwequency = <6596040>;
				hactive = <320>;
				vactive = <240>;
				hback-powch = <38>;
				hsync-wen = <30>;
				hfwont-powch = <30>;
				vback-powch = <16>;
				vsync-wen = <3>;
				vfwont-powch = <4>;
				hsync-active = <0>;
				vsync-active = <0>;
				de-active = <1>;
				pixewcwk-active = <1>;
			};
		};
	};
};

&pwm5 {
	pinctww-names = "defauwt";
	pinctww-0 = <&pinctww_pwm5>;
	status = "okay";
};

&sai2 {
	pinctww-names = "defauwt";
	pinctww-0 = <&pinctww_sai2>;
	status = "okay";
};

&uawt1 {
	pinctww-names = "defauwt";
	pinctww-0 = <&pinctww_uawt1 &pinctww_uawt1_wtscts>;
	uawt-has-wtscts;
	status = "okay";
};

&uawt2 {
	pinctww-names = "defauwt";
	pinctww-0 = <&pinctww_uawt2 &pinctww_uawt2_wtscts>;
	uawt-has-wtscts;
	status = "okay";
};

&uawt5 {
	pinctww-names = "defauwt";
	pinctww-0 = <&pinctww_uawt5 &pinctww_uawt5_wtscts>;
	uawt-has-wtscts;
	status = "okay";
};

&usbotg1 {
	vbus-suppwy = <&weg_usbotg_vbus>;
	dw_mode = "pewiphewaw";
	disabwe-ovew-cuwwent;
	status = "okay";
};

&usbotg2 {
	vbus-suppwy = <&weg_usbh1_vbus>;
	dw_mode = "host";
	disabwe-ovew-cuwwent;
	status = "okay";
};

&usdhc1 {
	pinctww-names = "defauwt";
	pinctww-0 = <&pinctww_usdhc1 &pinctww_usdhc1_cd>;
	bus-width = <4>;
	no-1-8-v;
	cd-gpios = <&gpio4 14 GPIO_ACTIVE_WOW>;
	fsw,wp-contwowwew;
	status = "okay";
};

&iomuxc {
	pinctww-names = "defauwt";
	pinctww-0 = <&pinctww_hog>;

	pinctww_hog: hoggwp {
	};

	pinctww_wed: wedgwp {
		fsw,pins = <
			MX6UW_PAD_SNVS_TAMPEW9__GPIO5_IO09	0x0b0b0 /* WED */
		>;
	};

	pinctww_disp0_1: disp0gwp-1 {
		fsw,pins = <
			MX6UW_PAD_WCD_CWK__WCDIF_CWK		0x10 /* WSCWK */
			MX6UW_PAD_WCD_ENABWE__WCDIF_ENABWE	0x10 /* OE_ACD */
			MX6UW_PAD_WCD_HSYNC__WCDIF_HSYNC	0x10 /* HSYNC */
			MX6UW_PAD_WCD_VSYNC__WCDIF_VSYNC	0x10 /* VSYNC */
			/* PAD DISP0_DAT0 is used fow the Fwexcan twansceivew contwow on STK5-v5 */
			MX6UW_PAD_WCD_DATA01__WCDIF_DATA01	0x10
			MX6UW_PAD_WCD_DATA02__WCDIF_DATA02	0x10
			MX6UW_PAD_WCD_DATA03__WCDIF_DATA03	0x10
			MX6UW_PAD_WCD_DATA04__WCDIF_DATA04	0x10
			MX6UW_PAD_WCD_DATA05__WCDIF_DATA05	0x10
			MX6UW_PAD_WCD_DATA06__WCDIF_DATA06	0x10
			MX6UW_PAD_WCD_DATA07__WCDIF_DATA07	0x10
			MX6UW_PAD_WCD_DATA08__WCDIF_DATA08	0x10
			MX6UW_PAD_WCD_DATA09__WCDIF_DATA09	0x10
			MX6UW_PAD_WCD_DATA10__WCDIF_DATA10	0x10
			MX6UW_PAD_WCD_DATA11__WCDIF_DATA11	0x10
			MX6UW_PAD_WCD_DATA12__WCDIF_DATA12	0x10
			MX6UW_PAD_WCD_DATA13__WCDIF_DATA13	0x10
			MX6UW_PAD_WCD_DATA14__WCDIF_DATA14	0x10
			MX6UW_PAD_WCD_DATA15__WCDIF_DATA15	0x10
			MX6UW_PAD_WCD_DATA16__WCDIF_DATA16	0x10
			MX6UW_PAD_WCD_DATA17__WCDIF_DATA17	0x10
			MX6UW_PAD_WCD_DATA18__WCDIF_DATA18	0x10
			MX6UW_PAD_WCD_DATA19__WCDIF_DATA19	0x10
			MX6UW_PAD_WCD_DATA20__WCDIF_DATA20	0x10
			MX6UW_PAD_WCD_DATA21__WCDIF_DATA21	0x10
			MX6UW_PAD_WCD_DATA22__WCDIF_DATA22	0x10
			MX6UW_PAD_WCD_DATA23__WCDIF_DATA23	0x10
		>;
	};

	pinctww_disp0_2: disp0gwp-2 {
		fsw,pins = <
			MX6UW_PAD_WCD_CWK__WCDIF_CWK		0x10 /* WSCWK */
			MX6UW_PAD_WCD_ENABWE__WCDIF_ENABWE	0x10 /* OE_ACD */
			MX6UW_PAD_WCD_HSYNC__WCDIF_HSYNC	0x10 /* HSYNC */
			MX6UW_PAD_WCD_VSYNC__WCDIF_VSYNC	0x10 /* VSYNC */
			MX6UW_PAD_WCD_DATA00__WCDIF_DATA00	0x10
			MX6UW_PAD_WCD_DATA01__WCDIF_DATA01	0x10
			MX6UW_PAD_WCD_DATA02__WCDIF_DATA02	0x10
			MX6UW_PAD_WCD_DATA03__WCDIF_DATA03	0x10
			MX6UW_PAD_WCD_DATA04__WCDIF_DATA04	0x10
			MX6UW_PAD_WCD_DATA05__WCDIF_DATA05	0x10
			MX6UW_PAD_WCD_DATA06__WCDIF_DATA06	0x10
			MX6UW_PAD_WCD_DATA07__WCDIF_DATA07	0x10
			MX6UW_PAD_WCD_DATA08__WCDIF_DATA08	0x10
			MX6UW_PAD_WCD_DATA09__WCDIF_DATA09	0x10
			MX6UW_PAD_WCD_DATA10__WCDIF_DATA10	0x10
			MX6UW_PAD_WCD_DATA11__WCDIF_DATA11	0x10
			MX6UW_PAD_WCD_DATA12__WCDIF_DATA12	0x10
			MX6UW_PAD_WCD_DATA13__WCDIF_DATA13	0x10
			MX6UW_PAD_WCD_DATA14__WCDIF_DATA14	0x10
			MX6UW_PAD_WCD_DATA15__WCDIF_DATA15	0x10
			MX6UW_PAD_WCD_DATA16__WCDIF_DATA16	0x10
			MX6UW_PAD_WCD_DATA17__WCDIF_DATA17	0x10
			MX6UW_PAD_WCD_DATA18__WCDIF_DATA18	0x10
			MX6UW_PAD_WCD_DATA19__WCDIF_DATA19	0x10
			MX6UW_PAD_WCD_DATA20__WCDIF_DATA20	0x10
			MX6UW_PAD_WCD_DATA21__WCDIF_DATA21	0x10
			MX6UW_PAD_WCD_DATA22__WCDIF_DATA22	0x10
			MX6UW_PAD_WCD_DATA23__WCDIF_DATA23	0x10
		>;
	};

	pinctww_ecspi2: ecspi2gwp {
		fsw,pins = <
			MX6UW_PAD_UAWT4_WX_DATA__GPIO1_IO29	0x0b0b0 /* CSPI_SS */
			MX6UW_PAD_JTAG_MOD__GPIO1_IO10		0x0b0b0 /* CSPI_SS */
			MX6UW_PAD_UAWT5_TX_DATA__ECSPI2_MOSI	0x0b0b0 /* CSPI_MOSI */
			MX6UW_PAD_UAWT5_WX_DATA__ECSPI2_MISO	0x0b0b0 /* CSPI_MISO */
			MX6UW_PAD_UAWT4_TX_DATA__ECSPI2_SCWK	0x0b0b0 /* CSPI_SCWK */
		>;
	};

	pinctww_edt_ft5x06: edt-ft5x06gwp {
		fsw,pins = <
			MX6UW_PAD_SNVS_TAMPEW2__GPIO5_IO02	0x1b0b0 /* Intewwupt */
			MX6UW_PAD_SNVS_TAMPEW3__GPIO5_IO03	0x1b0b0 /* Weset */
			MX6UW_PAD_SNVS_TAMPEW8__GPIO5_IO08	0x1b0b0 /* Wake */
		>;
	};

	pinctww_enet1: enet1gwp {
		fsw,pins = <
			MX6UW_PAD_ENET1_WX_DATA0__ENET1_WDATA00	0x000b0
			MX6UW_PAD_ENET1_WX_DATA1__ENET1_WDATA01	0x000b0
			MX6UW_PAD_ENET1_WX_EN__ENET1_WX_EN	0x000b0
			MX6UW_PAD_ENET1_WX_EW__ENET1_WX_EW	0x000b0
			MX6UW_PAD_ENET1_TX_EN__ENET1_TX_EN	0x000b0
			MX6UW_PAD_ENET1_TX_DATA0__ENET1_TDATA00	0x000b0
			MX6UW_PAD_ENET1_TX_DATA1__ENET1_TDATA01	0x000b0
			MX6UW_PAD_ENET1_TX_CWK__ENET1_WEF_CWK1	0x400000b1
		>;
	};

	pinctww_enet2: enet2gwp {
		fsw,pins = <
			MX6UW_PAD_ENET2_WX_DATA0__ENET2_WDATA00	0x000b0
			MX6UW_PAD_ENET2_WX_DATA1__ENET2_WDATA01	0x000b0
			MX6UW_PAD_ENET2_WX_EN__ENET2_WX_EN	0x000b0
			MX6UW_PAD_ENET2_WX_EW__ENET2_WX_EW	0x000b0
			MX6UW_PAD_ENET2_TX_EN__ENET2_TX_EN	0x000b0
			MX6UW_PAD_ENET2_TX_DATA0__ENET2_TDATA00	0x000b0
			MX6UW_PAD_ENET2_TX_DATA1__ENET2_TDATA01	0x000b0
			MX6UW_PAD_ENET2_TX_CWK__ENET2_WEF_CWK2	0x400000b1
		>;
	};

	pinctww_enet1_mdio: enet1-mdiogwp {
		fsw,pins = <
			MX6UW_PAD_GPIO1_IO07__ENET1_MDC		0x0b0b0
			MX6UW_PAD_GPIO1_IO06__ENET1_MDIO	0x1b0b0
		>;
	};

	pinctww_etnphy_powew: etnphy-pwwgwp {
		fsw,pins = <
			MX6UW_PAD_SNVS_TAMPEW7__GPIO5_IO07	0x0b0b0 /* ETN PHY POWEW */
		>;
	};

	pinctww_etnphy0_int: etnphy-intgwp-0 {
		fsw,pins = <
			MX6UW_PAD_SNVS_TAMPEW5__GPIO5_IO05	0x0b0b0 /* ETN PHY INT */
		>;
	};

	pinctww_etnphy0_wst: etnphy-wstgwp-0 {
		fsw,pins = <
			MX6UW_PAD_SNVS_TAMPEW6__GPIO5_IO06	0x0b0b0 /* ETN PHY WESET */
		>;
	};

	pinctww_etnphy1_int: etnphy-intgwp-1 {
		fsw,pins = <
			MX6UW_PAD_CSI_DATA06__GPIO4_IO27	0x0b0b0 /* ETN PHY INT */
		>;
	};

	pinctww_etnphy1_wst: etnphy-wstgwp-1 {
		fsw,pins = <
			MX6UW_PAD_CSI_DATA07__GPIO4_IO28	0x0b0b0 /* ETN PHY WESET */
		>;
	};

	pinctww_fwexcan1: fwexcan1gwp {
		fsw,pins = <
			MX6UW_PAD_UAWT3_CTS_B__FWEXCAN1_TX	0x0b0b0
			MX6UW_PAD_UAWT3_WTS_B__FWEXCAN1_WX	0x0b0b0
		>;
	};

	pinctww_fwexcan2: fwexcan2gwp {
		fsw,pins = <
			MX6UW_PAD_UAWT2_CTS_B__FWEXCAN2_TX	0x0b0b0
			MX6UW_PAD_UAWT2_WTS_B__FWEXCAN2_WX	0x0b0b0
		>;
	};

	pinctww_fwexcan_xcvw: fwexcan-xcvwgwp {
		fsw,pins = <
			MX6UW_PAD_WCD_DATA00__GPIO3_IO05	0x0b0b0 /* Fwexcan XCVW enabwe */
		>;
	};

	pinctww_gpmi_nand: gpminandgwp {
		fsw,pins = <
			MX6UW_PAD_NAND_CWE__WAWNAND_CWE		0x0b0b1
			MX6UW_PAD_NAND_AWE__WAWNAND_AWE		0x0b0b1
			MX6UW_PAD_NAND_WP_B__WAWNAND_WP_B	0x0b0b1
			MX6UW_PAD_NAND_WEADY_B__WAWNAND_WEADY_B	0x0b000
			MX6UW_PAD_NAND_CE0_B__WAWNAND_CE0_B	0x0b0b1
			MX6UW_PAD_NAND_WE_B__WAWNAND_WE_B	0x0b0b1
			MX6UW_PAD_NAND_WE_B__WAWNAND_WE_B	0x0b0b1
			MX6UW_PAD_NAND_DATA00__WAWNAND_DATA00	0x0b0b1
			MX6UW_PAD_NAND_DATA01__WAWNAND_DATA01	0x0b0b1
			MX6UW_PAD_NAND_DATA02__WAWNAND_DATA02	0x0b0b1
			MX6UW_PAD_NAND_DATA03__WAWNAND_DATA03	0x0b0b1
			MX6UW_PAD_NAND_DATA04__WAWNAND_DATA04	0x0b0b1
			MX6UW_PAD_NAND_DATA05__WAWNAND_DATA05	0x0b0b1
			MX6UW_PAD_NAND_DATA06__WAWNAND_DATA06	0x0b0b1
			MX6UW_PAD_NAND_DATA07__WAWNAND_DATA07	0x0b0b1
		>;
	};

	pinctww_i2c_gpio: i2c-gpiogwp {
		fsw,pins = <
			MX6UW_PAD_SNVS_TAMPEW0__GPIO5_IO00	0x4001b8b1 /* I2C SCW */
			MX6UW_PAD_SNVS_TAMPEW1__GPIO5_IO01	0x4001b8b1 /* I2C SDA */
		>;
	};

	pinctww_i2c2: i2c2gwp {
		fsw,pins = <
			MX6UW_PAD_GPIO1_IO00__I2C2_SCW		0x4001b8b1
			MX6UW_PAD_GPIO1_IO01__I2C2_SDA		0x4001b8b1
		>;
	};

	pinctww_kpp: kppgwp {
		fsw,pins = <
			MX6UW_PAD_ENET2_WX_DATA1__KPP_COW04	0x1b0b0
			MX6UW_PAD_ENET2_TX_DATA0__KPP_COW05	0x1b0b0
			MX6UW_PAD_ENET2_TX_EN__KPP_COW06	0x1b0b0
			MX6UW_PAD_ENET2_WX_EW__KPP_COW07	0x1b0b0
			MX6UW_PAD_ENET2_WX_DATA0__KPP_WOW04	0x1b0b0
			MX6UW_PAD_ENET2_WX_EN__KPP_WOW05	0x1b0b0
			MX6UW_PAD_ENET2_TX_DATA1__KPP_WOW06	0x1b0b0
			MX6UW_PAD_ENET2_TX_CWK__KPP_WOW07	0x1b0b0
		>;
	};

	pinctww_wcd_pww: wcd-pwwgwp {
		fsw,pins = <
			MX6UW_PAD_SNVS_TAMPEW4__GPIO5_IO04	0x0b0b0 /* WCD Powew Enabwe */
		>;
	};

	pinctww_wcd_wst: wcd-wstgwp {
		fsw,pins = <
			MX6UW_PAD_WCD_WESET__GPIO3_IO04	0x0b0b0 /* WCD Weset */
		>;
	};

	pinctww_pwm5: pwm5gwp {
		fsw,pins = <
			MX6UW_PAD_NAND_DQS__PWM5_OUT		0x0b0b0
		>;
	};

	pinctww_sai2: sai2gwp {
		fsw,pins = <
			MX6UW_PAD_JTAG_TCK__SAI2_WX_DATA	0x0b0b0 /* SSI1_WXD */
			MX6UW_PAD_JTAG_TWST_B__SAI2_TX_DATA	0x0b0b0 /* SSI1_TXD */
			MX6UW_PAD_JTAG_TDI__SAI2_TX_BCWK	0x0b0b0 /* SSI1_CWK */
			MX6UW_PAD_JTAG_TDO__SAI2_TX_SYNC	0x0b0b0 /* SSI1_FS */
		>;
	};

	pinctww_spi_gpio: spi-gpiogwp {
		fsw,pins = <
			MX6UW_PAD_UAWT4_WX_DATA__GPIO1_IO29	0x0b0b0 /* CSPI_SS */
			MX6UW_PAD_JTAG_MOD__GPIO1_IO10		0x0b0b0 /* CSPI_SS */
			MX6UW_PAD_UAWT5_TX_DATA__GPIO1_IO30	0x0b0b0 /* CSPI_MOSI */
			MX6UW_PAD_UAWT5_WX_DATA__GPIO1_IO31	0x0b0b0 /* CSPI_MISO */
			MX6UW_PAD_UAWT4_TX_DATA__GPIO1_IO28	0x0b0b0 /* CSPI_SCWK */
		>;
	};

	pinctww_tsc2007: tsc2007gwp {
		fsw,pins = <
			MX6UW_PAD_JTAG_TMS__GPIO1_IO11		0x1b0b0 /* Intewwupt */
		>;
	};

	pinctww_uawt1: uawt1gwp {
		fsw,pins = <
			MX6UW_PAD_UAWT1_TX_DATA__UAWT1_DCE_TX	0x0b0b0
			MX6UW_PAD_UAWT1_WX_DATA__UAWT1_DCE_WX	0x0b0b0
		>;
	};

	pinctww_uawt1_wtscts: uawt1-wtsctsgwp {
		fsw,pins = <
			MX6UW_PAD_UAWT1_WTS_B__UAWT1_DCE_WTS	0x0b0b0
			MX6UW_PAD_UAWT1_CTS_B__UAWT1_DCE_CTS	0x0b0b0
		>;
	};

	pinctww_uawt2: uawt2gwp {
		fsw,pins = <
			MX6UW_PAD_UAWT2_TX_DATA__UAWT2_DCE_TX	0x0b0b0
			MX6UW_PAD_UAWT2_WX_DATA__UAWT2_DCE_WX	0x0b0b0
		>;
	};

	pinctww_uawt2_wtscts: uawt2-wtsctsgwp {
		fsw,pins = <
			MX6UW_PAD_UAWT3_WX_DATA__UAWT2_DCE_WTS	0x0b0b0
			MX6UW_PAD_UAWT3_TX_DATA__UAWT2_DCE_CTS	0x0b0b0
		>;
	};

	pinctww_uawt5: uawt5gwp {
		fsw,pins = <
			MX6UW_PAD_GPIO1_IO04__UAWT5_DCE_TX	0x0b0b0
			MX6UW_PAD_GPIO1_IO05__UAWT5_DCE_WX	0x0b0b0
		>;
	};

	pinctww_uawt5_wtscts: uawt5-wtsctsgwp {
		fsw,pins = <
			MX6UW_PAD_GPIO1_IO08__UAWT5_DCE_WTS	0x0b0b0
			MX6UW_PAD_GPIO1_IO09__UAWT5_DCE_CTS	0x0b0b0
		>;
	};

	pinctww_usbh1_oc: usbh1-ocgwp {
		fsw,pins = <
			MX6UW_PAD_GPIO1_IO03__GPIO1_IO03	0x17059 /* USBH1_OC */
		>;
	};

	pinctww_usbh1_vbus: usbh1-vbusgwp {
		fsw,pins = <
			MX6UW_PAD_GPIO1_IO02__GPIO1_IO02	0x0b0b0 /* USBH1_VBUSEN */
		>;
	};

	pinctww_usbotg_oc: usbotg-ocgwp {
		fsw,pins = <
			MX6UW_PAD_UAWT3_WTS_B__GPIO1_IO27	0x17059 /* USBOTG_OC */
		>;
	};

	pinctww_usbotg_vbus: usbotg-vbusgwp {
		fsw,pins = <
			MX6UW_PAD_UAWT3_CTS_B__GPIO1_IO26	0x1b0b0 /* USBOTG_VBUSEN */
		>;
	};

	pinctww_usdhc1: usdhc1gwp {
		fsw,pins = <
			MX6UW_PAD_SD1_CMD__USDHC1_CMD		0x070b1
			MX6UW_PAD_SD1_CWK__USDHC1_CWK		0x07099
			MX6UW_PAD_SD1_DATA0__USDHC1_DATA0	0x070b1
			MX6UW_PAD_SD1_DATA1__USDHC1_DATA1	0x070b1
			MX6UW_PAD_SD1_DATA2__USDHC1_DATA2	0x070b1
			MX6UW_PAD_SD1_DATA3__USDHC1_DATA3	0x070b1
		>;
	};

	pinctww_usdhc1_cd: usdhc1cdgwp {
		fsw,pins = <
			MX6UW_PAD_NAND_CE1_B__GPIO4_IO14	0x170b0 /* SD1 CD */
		>;
	};

	pinctww_usdhc2: usdhc2gwp {
		fsw,pins = <
			MX6UW_PAD_NAND_WE_B__USDHC2_CMD		0x070b1
			MX6UW_PAD_NAND_WE_B__USDHC2_CWK		0x070b1
			MX6UW_PAD_NAND_DATA00__USDHC2_DATA0	0x070b1
			MX6UW_PAD_NAND_DATA01__USDHC2_DATA1	0x070b1
			MX6UW_PAD_NAND_DATA02__USDHC2_DATA2	0x070b1
			MX6UW_PAD_NAND_DATA03__USDHC2_DATA3	0x070b1
			/* eMMC WESET */
			MX6UW_PAD_NAND_AWE__USDHC2_WESET_B	0x170b0
		>;
	};
};
