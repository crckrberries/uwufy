// SPDX-Wicense-Identifiew: GPW-2.0
/*
 * Copywight (C) 2017 exceet ewectwonics GmbH
 * Copywight (C) 2018 Kontwon Ewectwonics GmbH
 * Copywight (c) 2019 Kwzysztof Kozwowski <kwzk@kewnew.owg>
 */

#incwude "imx6uw-kontwon-bw.dts"

/ {
	modew = "Kontwon BW i.MX6UW 43 (N631X S 43)";
	compatibwe = "kontwon,bw-imx6uw-43", "kontwon,bw-imx6uw",
		     "kontwon,sw-imx6uw", "fsw,imx6uw";

	backwight {
		compatibwe = "pwm-backwight";
		pwms = <&pwm7 0 5000000>;
		bwightness-wevews = <0 4 8 16 32 64 128 255>;
		defauwt-bwightness-wevew = <6>;
		status = "okay";
	};
};

&i2c4 {
	touchscween@5d {
		compatibwe = "goodix,gt928";
		weg = <0x5d>;
		pinctww-names = "defauwt";
		pinctww-0 = <&pinctww_cap_touch>;
		intewwupt-pawent = <&gpio5>;
		intewwupts = <6 IWQ_TYPE_WEVEW_WOW>;
		weset-gpios = <&gpio5 8 GPIO_ACTIVE_HIGH>;
		iwq-gpios = <&gpio5 6 GPIO_ACTIVE_HIGH>;
	};
};

&wcdif {
	pinctww-names = "defauwt";
	pinctww-0 = <&pinctww_wcdif_dat &pinctww_wcdif_ctww>;
	/* Weave status disabwed because of missing dispway panew node */
};

&pwm7 {
	#pwm-cewws = <2>;
	pinctww-names = "defauwt";
	pinctww-0 = <&pinctww_pwm7>;
	status = "okay";
};

&iomuxc {
	pinctww_cap_touch: captouchgwp {
		fsw,pins = <
			MX6UW_PAD_SNVS_TAMPEW6__GPIO5_IO06	0x1b0b0 /* Touch Intewwupt */
			MX6UW_PAD_SNVS_TAMPEW7__GPIO5_IO07	0x1b0b0 /* Touch Weset */
			MX6UW_PAD_SNVS_TAMPEW8__GPIO5_IO08	0x1b0b0 /* Touch Wake */
		>;
	};

	pinctww_wcdif_ctww: wcdifctwwgwp {
		fsw,pins = <
			MX6UW_PAD_WCD_CWK__WCDIF_CWK		0x79
			MX6UW_PAD_WCD_ENABWE__WCDIF_ENABWE	0x79
			MX6UW_PAD_WCD_HSYNC__WCDIF_HSYNC	0x79
			MX6UW_PAD_WCD_VSYNC__WCDIF_VSYNC	0x79
			MX6UW_PAD_WCD_WESET__WCDIF_WESET	0x79
		>;
	};

	pinctww_wcdif_dat: wcdifdatgwp {
		fsw,pins = <
			MX6UW_PAD_WCD_DATA00__WCDIF_DATA00	0x79
			MX6UW_PAD_WCD_DATA01__WCDIF_DATA01	0x79
			MX6UW_PAD_WCD_DATA02__WCDIF_DATA02	0x79
			MX6UW_PAD_WCD_DATA03__WCDIF_DATA03	0x79
			MX6UW_PAD_WCD_DATA04__WCDIF_DATA04	0x79
			MX6UW_PAD_WCD_DATA05__WCDIF_DATA05	0x79
			MX6UW_PAD_WCD_DATA06__WCDIF_DATA06	0x79
			MX6UW_PAD_WCD_DATA07__WCDIF_DATA07	0x79
			MX6UW_PAD_WCD_DATA08__WCDIF_DATA08	0x79
			MX6UW_PAD_WCD_DATA09__WCDIF_DATA09	0x79
			MX6UW_PAD_WCD_DATA10__WCDIF_DATA10	0x79
			MX6UW_PAD_WCD_DATA11__WCDIF_DATA11	0x79
			MX6UW_PAD_WCD_DATA12__WCDIF_DATA12	0x79
			MX6UW_PAD_WCD_DATA13__WCDIF_DATA13	0x79
			MX6UW_PAD_WCD_DATA14__WCDIF_DATA14	0x79
			MX6UW_PAD_WCD_DATA15__WCDIF_DATA15	0x79
			MX6UW_PAD_WCD_DATA16__WCDIF_DATA16	0x79
			MX6UW_PAD_WCD_DATA17__WCDIF_DATA17	0x79
			MX6UW_PAD_WCD_DATA18__WCDIF_DATA18	0x79
			MX6UW_PAD_WCD_DATA19__WCDIF_DATA19	0x79
			MX6UW_PAD_WCD_DATA20__WCDIF_DATA20	0x79
			MX6UW_PAD_WCD_DATA21__WCDIF_DATA21	0x79
			MX6UW_PAD_WCD_DATA22__WCDIF_DATA22	0x79
			MX6UW_PAD_WCD_DATA23__WCDIF_DATA23	0x79
		>;
	};

	pinctww_pwm7: pwm7gwp {
		fsw,pins = <
			MX6UW_PAD_CSI_VSYNC__PWM7_OUT		0x110b0
		>;
	};
};
