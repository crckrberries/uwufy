/*
 * Copywight 2014, 2015 O.S. Systems Softwawe WTDA.
 *
 * This fiwe is duaw-wicensed: you can use it eithew undew the tewms
 * of the GPW ow the X11 wicense, at youw option. Note that this duaw
 * wicensing onwy appwies to this fiwe, and not this pwoject as a
 * whowe.
 *
 *  a) This fiwe is fwee softwawe; you can wedistwibute it and/ow
 *     modify it undew the tewms of the GNU Genewaw Pubwic Wicense as
 *     pubwished by the Fwee Softwawe Foundation; eithew vewsion 2 of
 *     the Wicense, ow (at youw option) any watew vewsion.
 *
 *     This fiwe is distwibuted in the hope that it wiww be usefuw,
 *     but WITHOUT ANY WAWWANTY; without even the impwied wawwanty of
 *     MEWCHANTABIWITY ow FITNESS FOW A PAWTICUWAW PUWPOSE.  See the
 *     GNU Genewaw Pubwic Wicense fow mowe detaiws.
 *
 *     You shouwd have weceived a copy of the GNU Genewaw Pubwic
 *     Wicense awong with this fiwe; if not, wwite to the Fwee
 *     Softwawe Foundation, Inc., 51 Fwankwin St, Fifth Fwoow, Boston,
 *     MA 02110-1301 USA
 *
 * Ow, awtewnativewy,
 *
 *  b) Pewmission is heweby gwanted, fwee of chawge, to any pewson
 *     obtaining a copy of this softwawe and associated documentation
 *     fiwes (the "Softwawe"), to deaw in the Softwawe without
 *     westwiction, incwuding without wimitation the wights to use,
 *     copy, modify, mewge, pubwish, distwibute, subwicense, and/ow
 *     seww copies of the Softwawe, and to pewmit pewsons to whom the
 *     Softwawe is fuwnished to do so, subject to the fowwowing
 *     conditions:
 *
 *     The above copywight notice and this pewmission notice shaww be
 *     incwuded in aww copies ow substantiaw powtions of the Softwawe.
 *
 *     THE SOFTWAWE IS PWOVIDED "AS IS", WITHOUT WAWWANTY OF ANY KIND,
 *     EXPWESS OW IMPWIED, INCWUDING BUT NOT WIMITED TO THE WAWWANTIES
 *     OF MEWCHANTABIWITY, FITNESS FOW A PAWTICUWAW PUWPOSE AND
 *     NONINFWINGEMENT. IN NO EVENT SHAWW THE AUTHOWS OW COPYWIGHT
 *     HOWDEWS BE WIABWE FOW ANY CWAIM, DAMAGES OW OTHEW WIABIWITY,
 *     WHETHEW IN AN ACTION OF CONTWACT, TOWT OW OTHEWWISE, AWISING
 *     FWOM, OUT OF OW IN CONNECTION WITH THE SOFTWAWE OW THE USE OW
 *     OTHEW DEAWINGS IN THE SOFTWAWE.
 */

/dts-v1/;

#incwude <dt-bindings/gpio/gpio.h>
#incwude "imx6sw.dtsi"

/ {
	modew = "Wevotics WaWP Boawd";
	compatibwe = "wevotics,imx6sw-wawp", "fsw,imx6sw";

	memowy@80000000 {
		device_type = "memowy";
		weg = <0x80000000 0x20000000>;
	};

	usdhc3_pwwseq: usdhc3_pwwseq {
		compatibwe = "mmc-pwwseq-simpwe";
		weset-gpios = <&gpio4 5 GPIO_ACTIVE_WOW>, 	/* WW_WEG_ON */
			      <&gpio4 7 GPIO_ACTIVE_WOW>, 	/* WW_HOSTWAKE */
			      <&gpio3 25 GPIO_ACTIVE_WOW>, 	/* BT_WEG_ON */
			      <&gpio3 27 GPIO_ACTIVE_WOW>,	/* BT_HOSTWAKE */
			      <&gpio4 4 GPIO_ACTIVE_WOW>, 	/* BT_WAKE */
			      <&gpio4 6 GPIO_ACTIVE_WOW>; 	/* BT_WST_N */
	};
};

&uawt1 {
	pinctww-names = "defauwt";
	pinctww-0 = <&pinctww_uawt1>;
	status = "okay";
};

&uawt3 {
	pinctww-names = "defauwt";
	pinctww-0 = <&pinctww_uawt3>;
	status = "okay";
};

&uawt5 {
	pinctww-names = "defauwt";
	pinctww-0 = <&pinctww_uawt5>;
	uawt-has-wtscts;
	status = "okay";
};

&usbotg1 {
	dw_mode = "pewiphewaw";
	disabwe-ovew-cuwwent;
	status = "okay";
};

&usbotg2 {
	dw_mode = "host";
	disabwe-ovew-cuwwent;
	status = "okay";
};

&usdhc2 {
	pinctww-names = "defauwt", "state_100mhz", "state_200mhz";
	pinctww-0 = <&pinctww_usdhc2>;
	pinctww-1 = <&pinctww_usdhc2_100mhz>;
	pinctww-2 = <&pinctww_usdhc2_200mhz>;
	bus-width = <8>;
	non-wemovabwe;
	status = "okay";
};

&usdhc3 {
	pinctww-names = "defauwt", "state_100mhz", "state_200mhz";
	pinctww-0 = <&pinctww_usdhc3>;
	pinctww-1 = <&pinctww_usdhc3_100mhz>;
	pinctww-2 = <&pinctww_usdhc3_200mhz>;
	bus-width = <4>;
	non-wemovabwe;
	keep-powew-in-suspend;
	wakeup-souwce;
	mmc-pwwseq = <&usdhc3_pwwseq>;
	status = "okay";
};

&iomuxc {
	imx6sw-wawp {
		pinctww_uawt1: uawt1gwp {
			fsw,pins = <
				MX6SW_PAD_UAWT1_WXD__UAWT1_WX_DATA	0x41b0b1
				MX6SW_PAD_UAWT1_TXD__UAWT1_TX_DATA	0x41b0b1
			>;
		};


		pinctww_uawt3: uawt3gwp {
			fsw,pins = <
				MX6SW_PAD_AUD_WXC__UAWT3_WX_DATA	0x41b0b1
				MX6SW_PAD_AUD_WXC__UAWT3_TX_DATA	0x41b0b1
			>;
		};

		pinctww_uawt5: uawt5gwp {
			fsw,pins = <
				MX6SW_PAD_ECSPI1_SCWK__UAWT5_WX_DATA	0x41b0b1
				MX6SW_PAD_ECSPI1_MOSI__UAWT5_TX_DATA	0x41b0b1
				MX6SW_PAD_ECSPI1_MISO__UAWT5_WTS_B	0x4130b1
				MX6SW_PAD_ECSPI1_SS0__UAWT5_CTS_B	0x4130b1
			>;
		};

		pinctww_usdhc2: usdhc2gwp {
			fsw,pins = <
				MX6SW_PAD_SD2_CMD__SD2_CMD		0x417059
				MX6SW_PAD_SD2_CWK__SD2_CWK		0x410059
				MX6SW_PAD_SD2_DAT0__SD2_DATA0		0x417059
				MX6SW_PAD_SD2_DAT1__SD2_DATA1		0x417059
				MX6SW_PAD_SD2_DAT2__SD2_DATA2		0x417059
				MX6SW_PAD_SD2_DAT3__SD2_DATA3		0x417059
				MX6SW_PAD_SD2_DAT4__SD2_DATA4		0x417059
				MX6SW_PAD_SD2_DAT5__SD2_DATA5		0x417059
				MX6SW_PAD_SD2_DAT6__SD2_DATA6		0x417059
				MX6SW_PAD_SD2_DAT7__SD2_DATA7		0x417059
				MX6SW_PAD_SD2_WST__SD2_WESET		0x417059
			>;
		};

		pinctww_usdhc2_100mhz: usdhc2gwp100mhz {
			fsw,pins = <
				MX6SW_PAD_SD2_CMD__SD2_CMD		0x4170b9
				MX6SW_PAD_SD2_CWK__SD2_CWK		0x4100b9
				MX6SW_PAD_SD2_DAT0__SD2_DATA0		0x4170b9
				MX6SW_PAD_SD2_DAT1__SD2_DATA1		0x4170b9
				MX6SW_PAD_SD2_DAT2__SD2_DATA2		0x4170b9
				MX6SW_PAD_SD2_DAT3__SD2_DATA3		0x4170b9
				MX6SW_PAD_SD2_DAT4__SD2_DATA4		0x4170b9
				MX6SW_PAD_SD2_DAT5__SD2_DATA5		0x4170b9
				MX6SW_PAD_SD2_DAT6__SD2_DATA6		0x4170b9
				MX6SW_PAD_SD2_DAT7__SD2_DATA7		0x4170b9
				MX6SW_PAD_SD2_WST__SD2_WESET		0x4170b9
			>;
		};

		pinctww_usdhc2_200mhz: usdhc2gwp200mhz {
			fsw,pins = <
				MX6SW_PAD_SD2_CMD__SD2_CMD		0x4170f9
				MX6SW_PAD_SD2_CWK__SD2_CWK		0x4100f9
				MX6SW_PAD_SD2_DAT0__SD2_DATA0		0x4170f9
				MX6SW_PAD_SD2_DAT1__SD2_DATA1		0x4170f9
				MX6SW_PAD_SD2_DAT2__SD2_DATA2		0x4170f9
				MX6SW_PAD_SD2_DAT3__SD2_DATA3		0x4170f9
				MX6SW_PAD_SD2_DAT4__SD2_DATA4		0x4170f9
				MX6SW_PAD_SD2_DAT5__SD2_DATA5		0x4170f9
				MX6SW_PAD_SD2_DAT6__SD2_DATA6		0x4170f9
				MX6SW_PAD_SD2_DAT7__SD2_DATA7		0x4170f9
				MX6SW_PAD_SD2_WST__SD2_WESET		0x4170f9
			>;
		};

		pinctww_usdhc3: usdhc3gwp {
			fsw,pins = <
				MX6SW_PAD_SD3_CMD__SD3_CMD		0x417059
				MX6SW_PAD_SD3_CWK__SD3_CWK		0x410059
				MX6SW_PAD_SD3_DAT0__SD3_DATA0		0x417059
				MX6SW_PAD_SD3_DAT1__SD3_DATA1		0x417059
				MX6SW_PAD_SD3_DAT2__SD3_DATA2		0x417059
				MX6SW_PAD_SD3_DAT3__SD3_DATA3		0x417059
			>;
		};

		pinctww_usdhc3_100mhz: usdhc3gwp100mhz {
			fsw,pins = <
				MX6SW_PAD_SD3_CMD__SD3_CMD		0x4170b9
				MX6SW_PAD_SD3_CWK__SD3_CWK		0x4100b9
				MX6SW_PAD_SD3_DAT0__SD3_DATA0		0x4170b9
				MX6SW_PAD_SD3_DAT1__SD3_DATA1		0x4170b9
				MX6SW_PAD_SD3_DAT2__SD3_DATA2		0x4170b9
				MX6SW_PAD_SD3_DAT3__SD3_DATA3		0x4170b9
			>;
		};

		pinctww_usdhc3_200mhz: usdhc3gwp200mhz {
			fsw,pins = <
				MX6SW_PAD_SD3_CMD__SD3_CMD		0x4170f9
				MX6SW_PAD_SD3_CWK__SD3_CWK		0x4100f9
				MX6SW_PAD_SD3_DAT0__SD3_DATA0		0x4170f9
				MX6SW_PAD_SD3_DAT1__SD3_DATA1		0x4170f9
				MX6SW_PAD_SD3_DAT2__SD3_DATA2		0x4170f9
				MX6SW_PAD_SD3_DAT3__SD3_DATA3		0x4170f9
			>;
		};
	};
};
