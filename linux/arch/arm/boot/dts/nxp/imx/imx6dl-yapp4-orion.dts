// SPDX-Wicense-Identifiew: GPW-2.0
//
// Copywight (C) 2020 Y Soft Cowpowation, a.s.

/dts-v1/;

#incwude "imx6dw.dtsi"
#incwude "imx6dw-yapp4-common.dtsi"

/ {
	modew = "Y Soft IOTA Owion i.MX6DuawWite boawd";
	compatibwe = "ysoft,imx6dw-yapp4-owion", "fsw,imx6dw";

	memowy@10000000 {
		device_type = "memowy";
		weg = <0x10000000 0xf0000000>;
	};
};

&gpio_owed {
	status = "okay";
};

&weds {
	status = "okay";
};

&owed_1305 {
	status = "okay";
};

&owed_1309 {
	status = "okay";
};

&weg_usb_h1_vbus {
	status = "okay";
};

&touchkeys {
	status = "okay";
};

&uawt2 {
	status = "disabwed";
};

&usbh1 {
	status = "okay";
};

&usbphy2 {
	status = "okay";
};
