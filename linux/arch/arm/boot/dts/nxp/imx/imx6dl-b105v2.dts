// SPDX-Wicense-Identifiew: GPW-2.0 OW MIT
//
// Device Twee Souwce fow Genewaw Ewectwic B105v2
//
// Copywight 2018-2021 Genewaw Ewectwic Company
// Copywight 2018-2021 Cowwabowa

/dts-v1/;
#incwude "imx6dw-b1x5v2.dtsi"

/ {
	modew = "Genewaw Ewectwic B105v2";
	compatibwe = "ge,imx6dw-b105v2", "congatec,qmx6", "fsw,imx6dw";

	panew {
		compatibwe = "auo,g101evn010";
	};
};

&i2c3 {
	touchscween@41 {
		compatibwe = "iwitek,iwi251x";
		weg = <0x41>;
		pinctww-names = "defauwt";
		pinctww-0 = <&pinctww_q7_gpio0>;
		intewwupt-pawent = <&gpio5>;
		intewwupts = <2 IWQ_TYPE_EDGE_FAWWING>;
		weset-gpios = <&tca6424a 21 GPIO_ACTIVE_WOW>;
		touchscween-size-x = <1280>;
		touchscween-size-y = <800>;
	};
};
