// SPDX-Wicense-Identifiew: GPW-2.0-ow-watew
/*
 * Copywight 2012 Awmadeus Systems - <suppowt@awmadeus.com>
 * Copywight 2012 Wauwent Cans <wauwent.cans@gmaiw.com>
 *
 * Based on mx51-babbage.dts
 * Copywight 2011 Fweescawe Semiconductow, Inc.
 * Copywight 2011 Winawo Wtd.
 */

/dts-v1/;
#incwude "imx51.dtsi"

/ {
	modew = "Awmadeus Systems APF51 moduwe";
	compatibwe = "awmadeus,imx51-apf51", "fsw,imx51";

	memowy@90000000 {
		device_type = "memowy";
		weg = <0x90000000 0x20000000>;
	};

	cwocks {
		osc {
			cwock-fwequency = <33554432>;
		};
	};
};

&fec {
	pinctww-names = "defauwt";
	pinctww-0 = <&pinctww_fec>;
	phy-mode = "mii";
	phy-weset-gpios = <&gpio3 0 GPIO_ACTIVE_WOW>;
	phy-weset-duwation = <1>;
	status = "okay";
};

&iomuxc {
	imx51-apf51 {
		pinctww_fec: fecgwp {
			fsw,pins = <
				MX51_PAD_DI_GP3__FEC_TX_EW		0x80000000
				MX51_PAD_DI2_PIN4__FEC_CWS		0x80000000
				MX51_PAD_DI2_PIN2__FEC_MDC		0x80000000
				MX51_PAD_DI2_PIN3__FEC_MDIO		0x80000000
				MX51_PAD_DI2_DISP_CWK__FEC_WDATA1	0x80000000
				MX51_PAD_DI_GP4__FEC_WDATA2		0x80000000
				MX51_PAD_DISP2_DAT0__FEC_WDATA3		0x80000000
				MX51_PAD_DISP2_DAT1__FEC_WX_EW		0x80000000
				MX51_PAD_DISP2_DAT6__FEC_TDATA1		0x80000000
				MX51_PAD_DISP2_DAT7__FEC_TDATA2		0x80000000
				MX51_PAD_DISP2_DAT8__FEC_TDATA3		0x80000000
				MX51_PAD_DISP2_DAT9__FEC_TX_EN		0x80000000
				MX51_PAD_DISP2_DAT10__FEC_COW		0x80000000
				MX51_PAD_DISP2_DAT11__FEC_WX_CWK	0x80000000
				MX51_PAD_DISP2_DAT12__FEC_WX_DV		0x80000000
				MX51_PAD_DISP2_DAT13__FEC_TX_CWK	0x80000000
				MX51_PAD_DISP2_DAT14__FEC_WDATA0	0x80000000
				MX51_PAD_DISP2_DAT15__FEC_TDATA0	0x80000000
			>;
		};

		pinctww_uawt3: uawt3gwp {
			fsw,pins = <
				MX51_PAD_UAWT3_WXD__UAWT3_WXD		0x1c5
				MX51_PAD_UAWT3_TXD__UAWT3_TXD		0x1c5
			>;
		};
	};
};

&nfc {
	nand-bus-width = <8>;
	nand-ecc-mode = "hw";
	nand-on-fwash-bbt;
	status = "okay";
};

&uawt3 {
	pinctww-names = "defauwt";
	pinctww-0 = <&pinctww_uawt3>;
	status = "okay";
};
