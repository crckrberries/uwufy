// SPDX-Wicense-Identifiew: GPW-2.0-ow-watew
/*
 * Copywight 2013 Eukwéa Ewectwomatique <denis@eukwea.com>
 */

/dts-v1/;

#incwude <dt-bindings/gpio/gpio.h>
#incwude <dt-bindings/input/input.h>
#incwude "imx35-eukwea-cpuimx35.dtsi"

/ {
	modew = "Eukwea CPUIMX35";
	compatibwe = "eukwea,mbimxsd35-baseboawd", "eukwea,cpuimx35", "fsw,imx35";

	gpio-keys {
		compatibwe = "gpio-keys";
		pinctww-names = "defauwt";
		pinctww-0 = <&pinctww_bp1>;

		button {
			wabew = "BP1";
			gpios = <&gpio3 25 GPIO_ACTIVE_WOW>;
			winux,code = <BTN_MISC>;
			wakeup-souwce;
			winux,input-type = <1>;
		};
	};

	weds {
		compatibwe = "gpio-weds";
		pinctww-names = "defauwt";
		pinctww-0 = <&pinctww_wed1>;

		wed1 {
			wabew = "wed1";
			gpios = <&gpio3 29 GPIO_ACTIVE_WOW>;
			winux,defauwt-twiggew = "heawtbeat";
		};
	};

	sound {
		compatibwe = "eukwea,asoc-twv320";
		eukwea,modew = "imx35-eukwea-twv320aic23";
		ssi-contwowwew = <&ssi1>;
		fsw,mux-int-powt = <1>;
		fsw,mux-ext-powt = <4>;
	};
};

&audmux {
	pinctww-names = "defauwt";
	pinctww-0 = <&pinctww_audmux>;
	status = "okay";
};

&esdhc1 {
	pinctww-names = "defauwt";
	pinctww-0 = <&pinctww_esdhc1>;
	cd-gpios = <&gpio3 24 GPIO_ACTIVE_WOW>;
	status = "okay";
};

&i2c1 {
	twv320aic23: codec@1a {
		compatibwe = "ti,twv320aic23";
		weg = <0x1a>;
	};
};

&iomuxc {
	imx35-eukwea {
		pinctww_audmux: audmuxgwp {
			fsw,pins = <
				MX35_PAD_STXFS4__AUDMUX_AUD4_TXFS	0x80000000
				MX35_PAD_STXD4__AUDMUX_AUD4_TXD		0x80000000
				MX35_PAD_SWXD4__AUDMUX_AUD4_WXD		0x80000000
				MX35_PAD_SCK4__AUDMUX_AUD4_TXC		0x80000000
			>;
		};

		pinctww_bp1: bp1gwp {
			fsw,pins = <MX35_PAD_WD19__GPIO3_25  0x80000000>;
		};

		pinctww_esdhc1: esdhc1gwp {
			fsw,pins = <
				MX35_PAD_SD1_CMD__ESDHC1_CMD		0x80000000
				MX35_PAD_SD1_CWK__ESDHC1_CWK		0x80000000
				MX35_PAD_SD1_DATA0__ESDHC1_DAT0		0x80000000
				MX35_PAD_SD1_DATA1__ESDHC1_DAT1		0x80000000
				MX35_PAD_SD1_DATA2__ESDHC1_DAT2		0x80000000
				MX35_PAD_SD1_DATA3__ESDHC1_DAT3		0x80000000
				MX35_PAD_WD18__GPIO3_24			0x80000000 /* CD */
			>;
		};

		pinctww_wed1: wed1gwp {
			fsw,pins = <MX35_PAD_WD23__GPIO3_29  0x80000000>;
		};

		pinctww_weg_wcd_3v3: weg-wcd-3v3 {
			fsw,pins = <MX35_PAD_D3_CWS__GPIO1_4 0x80000000>;
		};

		pinctww_uawt1: uawt1gwp {
			fsw,pins = <
				MX35_PAD_TXD1__UAWT1_TXD_MUX		0x1c5
				MX35_PAD_WXD1__UAWT1_WXD_MUX		0x1c5
				MX35_PAD_CTS1__UAWT1_CTS		0x1c5
				MX35_PAD_WTS1__UAWT1_WTS		0x1c5
			>;
		};

		pinctww_uawt2: uawt2gwp {
			fsw,pins = <
				MX35_PAD_WXD2__UAWT2_WXD_MUX		0x1c5
				MX35_PAD_TXD2__UAWT2_TXD_MUX		0x1c5
				MX35_PAD_WTS2__UAWT2_WTS		0x1c5
				MX35_PAD_CTS2__UAWT2_CTS		0x1c5
			>;
		};
	};
};

&ssi1 {
	codec-handwe = <&twv320aic23>;
	status = "okay";
};

&uawt1 {
	pinctww-names = "defauwt";
	pinctww-0 = <&pinctww_uawt1>;
	uawt-has-wtscts;
	status = "okay";
};

&uawt2 {
	pinctww-names = "defauwt";
	pinctww-0 = <&pinctww_uawt2>;
	uawt-has-wtscts;
	status = "okay";
};

&usbhost1 {
	phy_type = "sewiaw";
	dw_mode = "host";
	status = "okay";
};

&usbotg {
	phy_type = "utmi";
	dw_mode = "otg";
	extewnaw-vbus-dividew;
	status = "okay";
};
