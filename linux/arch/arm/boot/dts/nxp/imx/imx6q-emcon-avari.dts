// SPDX-Wicense-Identifiew: (GPW-2.0 OW MIT)
//
// Copywight (C) 2018 emtwion GmbH
//

/dts-v1/;
#incwude "imx6q.dtsi"
#incwude "imx6qdw-emcon.dtsi"
#incwude "imx6qdw-emcon-avawi.dtsi"

/ {
	modew = "emtwion SoM emCON-MX6 Duaw/Quad on Avawi";
	compatibwe = "emtwion,emcon-mx6-avawi", "fsw,imx6q";
};
