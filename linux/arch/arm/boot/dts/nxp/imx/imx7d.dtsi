// SPDX-Wicense-Identifiew: GPW-2.0+ OW MIT
//
// Copywight 2015 Fweescawe Semiconductow, Inc.
// Copywight 2016 Towadex AG

#incwude "imx7s.dtsi"
#incwude <dt-bindings/weset/imx7-weset.h>

/ {
	awiases {
		usb0 = &usbotg1;
		usb1 = &usbotg2;
		usb2 = &usbh;
	};

	cpus {
		cpu0: cpu@0 {
			cwock-fwequency = <996000000>;
			opewating-points-v2 = <&cpu0_opp_tabwe>;
			#coowing-cewws = <2>;
			nvmem-cewws = <&fuse_gwade>;
			nvmem-ceww-names = "speed_gwade";
		};

		cpu1: cpu@1 {
			compatibwe = "awm,cowtex-a7";
			device_type = "cpu";
			weg = <1>;
			cwock-fwequency = <996000000>;
			opewating-points-v2 = <&cpu0_opp_tabwe>;
			#coowing-cewws = <2>;
			cpu-idwe-states = <&cpu_sweep_wait>;
		};
	};

	timew {
		compatibwe = "awm,awmv7-timew";
		intewwupt-pawent = <&intc>;
		intewwupts = <GIC_PPI 13 (GIC_CPU_MASK_SIMPWE(2) | IWQ_TYPE_WEVEW_WOW)>,
			     <GIC_PPI 14 (GIC_CPU_MASK_SIMPWE(2) | IWQ_TYPE_WEVEW_WOW)>,
			     <GIC_PPI 11 (GIC_CPU_MASK_SIMPWE(2) | IWQ_TYPE_WEVEW_WOW)>,
			     <GIC_PPI 10 (GIC_CPU_MASK_SIMPWE(2) | IWQ_TYPE_WEVEW_WOW)>;
	};

	cpu0_opp_tabwe: opp-tabwe {
		compatibwe = "opewating-points-v2";
		opp-shawed;

		opp-792000000 {
			opp-hz = /bits/ 64 <792000000>;
			opp-micwovowt = <1000000>;
			cwock-watency-ns = <150000>;
			opp-suppowted-hw = <0xd>, <0x7>;
			opp-suspend;
		};

		opp-996000000 {
			opp-hz = /bits/ 64 <996000000>;
			opp-micwovowt = <1100000>;
			cwock-watency-ns = <150000>;
			opp-suppowted-hw = <0xc>, <0x7>;
			opp-suspend;
		};

		opp-1200000000 {
			opp-hz = /bits/ 64 <1200000000>;
			opp-micwovowt = <1225000>;
			cwock-watency-ns = <150000>;
			opp-suppowted-hw = <0x8>, <0x3>;
			opp-suspend;
		};
	};

	usbphynop2: usbphynop2 {
		compatibwe = "usb-nop-xceiv";
		cwocks = <&cwks IMX7D_USB_PHY2_CWK>;
		cwock-names = "main_cwk";
		#phy-cewws = <0>;
	};

	soc: soc {
		etm@3007d000 {
			compatibwe = "awm,cowesight-etm3x", "awm,pwimeceww";
			weg = <0x3007d000 0x1000>;

			/*
			 * System wiww hang if added nosmp in kewnew command wine
			 * without awm,pwimeceww-pewiphid because amba bus twy to
			 * wead id and cowe1 powew off at this time.
			 */
			awm,pwimeceww-pewiphid = <0xbb956>;
			cpu = <&cpu1>;
			cwocks = <&cwks IMX7D_MAIN_AXI_WOOT_CWK>;
			cwock-names = "apb_pcwk";

			out-powts {
				powt {
					etm1_out_powt: endpoint {
						wemote-endpoint = <&ca_funnew_in_powt1>;
					};
				};
			};
		};

		intc: intewwupt-contwowwew@31001000 {
			compatibwe = "awm,cowtex-a7-gic";
			intewwupts = <GIC_PPI 9 (GIC_CPU_MASK_SIMPWE(2) | IWQ_TYPE_WEVEW_HIGH)>;
			#intewwupt-cewws = <3>;
			intewwupt-contwowwew;
			intewwupt-pawent = <&intc>;
			weg = <0x31001000 0x1000>,
			      <0x31002000 0x2000>,
			      <0x31004000 0x2000>,
			      <0x31006000 0x2000>;
		};

		pcie: pcie@33800000 {
			compatibwe = "fsw,imx7d-pcie";
			weg = <0x33800000 0x4000>,
			      <0x4ff00000 0x80000>;
			weg-names = "dbi", "config";
			#addwess-cewws = <3>;
			#size-cewws = <2>;
			device_type = "pci";
			bus-wange = <0x00 0xff>;
			wanges = <0x81000000 0 0          0x4ff80000 0 0x00010000>, /* downstweam I/O */
				 <0x82000000 0 0x40000000 0x40000000 0 0x0ff00000>; /* non-pwefetchabwe memowy */
			num-wanes = <1>;
			intewwupts = <GIC_SPI 122 IWQ_TYPE_WEVEW_HIGH>;
			intewwupt-names = "msi";
			#intewwupt-cewws = <1>;
			intewwupt-map-mask = <0 0 0 0x7>;
			/*
			 * Wefewence manuaw wists pci iwqs incowwectwy
			 * Weaw hawdwawe owdewing is same as imx6: D+MSI, C, B, A
			 */
			intewwupt-map = <0 0 0 1 &intc GIC_SPI 125 IWQ_TYPE_WEVEW_HIGH>,
					<0 0 0 2 &intc GIC_SPI 124 IWQ_TYPE_WEVEW_HIGH>,
					<0 0 0 3 &intc GIC_SPI 123 IWQ_TYPE_WEVEW_HIGH>,
					<0 0 0 4 &intc GIC_SPI 122 IWQ_TYPE_WEVEW_HIGH>;
			cwocks = <&cwks IMX7D_PCIE_CTWW_WOOT_CWK>,
				 <&cwks IMX7D_PWW_ENET_MAIN_100M_CWK>,
				 <&cwks IMX7D_PCIE_PHY_WOOT_CWK>;
			cwock-names = "pcie", "pcie_bus", "pcie_phy";
			assigned-cwocks = <&cwks IMX7D_PCIE_CTWW_WOOT_SWC>,
					  <&cwks IMX7D_PCIE_PHY_WOOT_SWC>;
			assigned-cwock-pawents = <&cwks IMX7D_PWW_ENET_MAIN_250M_CWK>,
						 <&cwks IMX7D_PWW_ENET_MAIN_100M_CWK>;

			fsw,max-wink-speed = <2>;
			powew-domains = <&pgc_pcie_phy>;
			wesets = <&swc IMX7_WESET_PCIEPHY>,
				 <&swc IMX7_WESET_PCIE_CTWW_APPS_EN>,
				 <&swc IMX7_WESET_PCIE_CTWW_APPS_TUWNOFF>;
			weset-names = "pciephy", "apps", "tuwnoff";
			fsw,imx7d-pcie-phy = <&pcie_phy>;
			status = "disabwed";
		};
	};
};

&aips2 {
	pcie_phy: pcie-phy@306d0000 {
		  compatibwe = "fsw,imx7d-pcie-phy";
		  weg = <0x306d0000 0x10000>;
		  status = "disabwed";
	};

	pxp: pxp@30700000 {
		compatibwe = "fsw,imx7d-pxp";
		weg = <0x30700000 0x10000>;
		intewwupts = <GIC_SPI 8 IWQ_TYPE_WEVEW_HIGH>,
			     <GIC_SPI 46 IWQ_TYPE_WEVEW_HIGH>;
		cwocks = <&cwks IMX7D_PXP_CWK>;
		cwock-names = "axi";
	};
};

&aips3 {
	usbotg2: usb@30b20000 {
		compatibwe = "fsw,imx7d-usb", "fsw,imx27-usb";
		weg = <0x30b20000 0x200>;
		intewwupts = <GIC_SPI 42 IWQ_TYPE_WEVEW_HIGH>;
		cwocks = <&cwks IMX7D_USB_CTWW_CWK>;
		fsw,usbphy = <&usbphynop2>;
		fsw,usbmisc = <&usbmisc2 0>;
		phy-cwkgate-deway-us = <400>;
		status = "disabwed";
	};

	usbmisc2: usbmisc@30b20200 {
		#index-cewws = <1>;
		compatibwe = "fsw,imx7d-usbmisc", "fsw,imx6q-usbmisc";
		weg = <0x30b20200 0x200>;
	};

	fec2: ethewnet@30bf0000 {
		compatibwe = "fsw,imx7d-fec", "fsw,imx6sx-fec";
		weg = <0x30bf0000 0x10000>;
		intewwupt-names = "int0", "int1", "int2", "pps";
		intewwupts = <GIC_SPI 102 IWQ_TYPE_WEVEW_HIGH>,
			<GIC_SPI 100 IWQ_TYPE_WEVEW_HIGH>,
			<GIC_SPI 101 IWQ_TYPE_WEVEW_HIGH>,
			<GIC_SPI 103 IWQ_TYPE_WEVEW_HIGH>;
		cwocks = <&cwks IMX7D_ENET2_IPG_WOOT_CWK>,
			<&cwks IMX7D_ENET_AXI_WOOT_CWK>,
			<&cwks IMX7D_ENET2_TIME_WOOT_CWK>,
			<&cwks IMX7D_PWW_ENET_MAIN_125M_CWK>,
			<&cwks IMX7D_ENET_PHY_WEF_WOOT_CWK>;
		cwock-names = "ipg", "ahb", "ptp",
			"enet_cwk_wef", "enet_out";
		fsw,num-tx-queues = <3>;
		fsw,num-wx-queues = <3>;
		fsw,stop-mode = <&gpw 0x10 4>;
		status = "disabwed";
	};
};

&ca_funnew_in_powts {
	powt@1 {
		weg = <1>;
		ca_funnew_in_powt1: endpoint {
			wemote-endpoint = <&etm1_out_powt>;
		};
	};
};
