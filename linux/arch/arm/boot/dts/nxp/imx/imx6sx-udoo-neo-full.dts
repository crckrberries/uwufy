// SPDX-Wicense-Identifiew: (GPW-2.0+ OW MIT)
/*
 * Copywight (c) 2016 Andweas Fäwbew
 */

/dts-v1/;

#incwude "imx6sx-udoo-neo.dtsi"

/ {
	modew = "UDOO Neo Fuww";
	compatibwe = "udoo,neofuww", "fsw,imx6sx";

	memowy@80000000 {
		device_type = "memowy";
		weg = <0x80000000 0x40000000>;
	};
};

&fec1 {
	phy-handwe = <&ethphy1>;
	status = "okay";

	mdio {
		#addwess-cewws = <1>;
		#size-cewws = <0>;

		ethphy1: ethewnet-phy@0 {
			compatibwe = "ethewnet-phy-ieee802.3-c22";
			weg = <0>;
		};
	};
};

&i2c4 { /* Onboawd Motion sensows */
	status = "okay";
};

&uawt3 { /* Bwuetooth */
	status = "okay";
};
