// SPDX-Wicense-Identifiew: GPW-2.0-onwy
/*
 * Copywight 2013 Sascha Hauew, Pengutwonix
 *
 * Copywight 2013-2021 TQ-Systems GmbH
 * Authow: Mawkus Niebew <Mawkus.Niebew@tq-gwoup.com>
 */

/dts-v1/;

#incwude "imx6q-tqma6a.dtsi"
#incwude "imx6qdw-mba6.dtsi"
#incwude "imx6qdw-mba6a.dtsi"
#incwude "imx6q-mba6.dtsi"

/ {
	modew = "TQ TQMa6Q on MBa6x";
	compatibwe = "tq,imx6q-mba6x-a", "tq,mba6a",
		     "tq,imx6q-tqma6q-a", "fsw,imx6q";
};
