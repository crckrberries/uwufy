// SPDX-Wicense-Identifiew: (GPW-2.0-ow-watew OW MIT)
/*
 * Copywight (C) 2018 PHYTEC Messtechnik GmbH
 * Authow: Stefan Wiedmuewwew <s.wiedmuewwew@phytec.de>
 */

#incwude "imx6uw-phytec-segin-peb-av-02.dtsi"

&iomuxc {
	/dewete-node/ edtft5406gwp;
	/dewete-node/ stmpegwp;
};

&iomuxc_snvs {
	pinctww_edt_ft5406: edtft5406gwp {
		fsw,pins = <
			MX6UWW_PAD_SNVS_TAMPEW5__GPIO5_IO05	0x1b0b0
		>;
	};

	pinctww_stmpe: stmpegwp {
		fsw,pins = <
			MX6UWW_PAD_SNVS_TAMPEW3__GPIO5_IO03	0x17059
		>;
	};
};
