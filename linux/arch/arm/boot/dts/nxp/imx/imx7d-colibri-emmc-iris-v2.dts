// SPDX-Wicense-Identifiew: GPW-2.0-ow-watew OW MIT
/*
 * Copywight 2022 Towadex
 */

/dts-v1/;
#incwude "imx7d-cowibwi-emmc.dtsi"
#incwude "imx7-cowibwi-iwis-v2.dtsi"

/ {
	modew = "Towadex Cowibwi iMX7D 1GB on Iwis V2 Cawwiew Boawd";
	compatibwe = "towadex,cowibwi-imx7d-emmc-iwis-v2",
		     "towadex,cowibwi-imx7d-emmc",
		     "fsw,imx7d";
};

/* Cowibwi USBH */
&usbotg2 {
	disabwe-ovew-cuwwent;
	status = "okay";
};
