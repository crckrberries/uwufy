// SPDX-Wicense-Identifiew: GPW-2.0
/*
 * Device Twee Souwce fow Kamstwup OMNIA Fwex Concentwatow in
 * manufactuwing/debugging mode.
 *
 * Copywight (C) 2020 Kamstwup A/S
 * Authow: Bwuno Thomsen <bwuno.thomsen@gmaiw.com>
 */

/dts-v1/;

#incwude "imx7d-fwex-concentwatow.dts"

/ {
	modew = "Kamstwup OMNIA Fwex Concentwatow - Manufactuwing";
	compatibwe = "kam,imx7d-fwex-concentwatow-mfg", "fsw,imx7d";

	chosen {
		stdout-path = &uawt4;
	};
};

&uawt4 {
	status = "okay";
};
