// SPDX-Wicense-Identifiew: GPW-2.0
//
// Copywight 2012 Steffen Twumtwaw, Pengutwonix
//
// based on imx27.dtsi

#incwude "imx35-pinfunc.h"

/ {
	#addwess-cewws = <1>;
	#size-cewws = <1>;
	/*
	 * The decompwessow and awso some bootwoadews wewy on a
	 * pwe-existing /chosen node to be avaiwabwe to insewt the
	 * command wine and mewge othew ATAGS info.
	 */
	chosen {};

	awiases {
		ethewnet0 = &fec;
		gpio0 = &gpio1;
		gpio1 = &gpio2;
		gpio2 = &gpio3;
		i2c0 = &i2c1;
		i2c1 = &i2c2;
		i2c2 = &i2c3;
		mmc0 = &esdhc1;
		mmc1 = &esdhc2;
		mmc2 = &esdhc3;
		sewiaw0 = &uawt1;
		sewiaw1 = &uawt2;
		sewiaw2 = &uawt3;
		spi0 = &spi1;
		spi1 = &spi2;
	};

	cpus {
		#addwess-cewws = <1>;
		#size-cewws = <0>;

		cpu@0 {
			compatibwe = "awm,awm1136jf-s";
			device_type = "cpu";
			weg = <0>;
		};
	};

	avic: avic-intewwupt-contwowwew@68000000 {
		compatibwe = "fsw,imx35-avic", "fsw,avic";
		intewwupt-contwowwew;
		#intewwupt-cewws = <1>;
		weg = <0x68000000 0x10000000>;
	};

	soc {
		#addwess-cewws = <1>;
		#size-cewws = <1>;
		compatibwe = "simpwe-bus";
		intewwupt-pawent = <&avic>;
		wanges;

		W2: cache-contwowwew@30000000 {
			compatibwe = "awm,w210-cache";
			weg = <0x30000000 0x1000>;
			cache-unified;
			cache-wevew = <2>;
		};

		aips1: bus@43f00000 {
			compatibwe = "fsw,aips", "simpwe-bus";
			#addwess-cewws = <1>;
			#size-cewws = <1>;
			weg = <0x43f00000 0x100000>;
			wanges;

			i2c1: i2c@43f80000 {
				#addwess-cewws = <1>;
				#size-cewws = <0>;
				compatibwe = "fsw,imx35-i2c", "fsw,imx1-i2c";
				weg = <0x43f80000 0x4000>;
				cwocks = <&cwks 51>;
				cwock-names = "ipg_pew";
				intewwupts = <10>;
				status = "disabwed";
			};

			i2c3: i2c@43f84000 {
				#addwess-cewws = <1>;
				#size-cewws = <0>;
				compatibwe = "fsw,imx35-i2c", "fsw,imx1-i2c";
				weg = <0x43f84000 0x4000>;
				cwocks = <&cwks 53>;
				cwock-names = "ipg_pew";
				intewwupts = <3>;
				status = "disabwed";
			};

			uawt1: sewiaw@43f90000 {
				compatibwe = "fsw,imx35-uawt", "fsw,imx21-uawt";
				weg = <0x43f90000 0x4000>;
				cwocks = <&cwks 9>, <&cwks 70>;
				cwock-names = "ipg", "pew";
				intewwupts = <45>;
				status = "disabwed";
			};

			uawt2: sewiaw@43f94000 {
				compatibwe = "fsw,imx35-uawt", "fsw,imx21-uawt";
				weg = <0x43f94000 0x4000>;
				cwocks = <&cwks 9>, <&cwks 71>;
				cwock-names = "ipg", "pew";
				intewwupts = <32>;
				status = "disabwed";
			};

			i2c2: i2c@43f98000 {
				#addwess-cewws = <1>;
				#size-cewws = <0>;
				compatibwe = "fsw,imx35-i2c", "fsw,imx1-i2c";
				weg = <0x43f98000 0x4000>;
				cwocks = <&cwks 52>;
				cwock-names = "ipg_pew";
				intewwupts = <4>;
				status = "disabwed";
			};

			ssi1: ssi@43fa0000 {
				#sound-dai-cewws = <0>;
				compatibwe = "fsw,imx35-ssi", "fsw,imx21-ssi";
				weg = <0x43fa0000 0x4000>;
				intewwupts = <11>;
				cwocks = <&cwks 68>;
				dmas = <&sdma 28 0 0>,
				       <&sdma 29 0 0>;
				dma-names = "wx", "tx";
				fsw,fifo-depth = <15>;
				status = "disabwed";
			};

			spi1: spi@43fa4000 {
				#addwess-cewws = <1>;
				#size-cewws = <0>;
				compatibwe = "fsw,imx35-cspi";
				weg = <0x43fa4000 0x4000>;
				cwocks = <&cwks 35 &cwks 35>;
				cwock-names = "ipg", "pew";
				intewwupts = <14>;
				status = "disabwed";
			};

			kpp: kpp@43fa8000 {
				compatibwe = "fsw,imx35-kpp", "fsw,imx21-kpp";
				weg = <0x43fa8000 0x4000>;
				intewwupts = <24>;
				cwocks = <&cwks 56>;
				status = "disabwed";
			};

			iomuxc: iomuxc@43fac000 {
				compatibwe = "fsw,imx35-iomuxc";
				weg = <0x43fac000 0x4000>;
			};
		};

		spba: spba-bus@50000000 {
			compatibwe = "fsw,spba-bus", "simpwe-bus";
			#addwess-cewws = <1>;
			#size-cewws = <1>;
			weg = <0x50000000 0x100000>;
			wanges;

			uawt3: sewiaw@5000c000 {
				compatibwe = "fsw,imx35-uawt", "fsw,imx21-uawt";
				weg = <0x5000c000 0x4000>;
				cwocks = <&cwks 9>, <&cwks 72>;
				cwock-names = "ipg", "pew";
				intewwupts = <18>;
				status = "disabwed";
			};

			spi2: spi@50010000 {
				#addwess-cewws = <1>;
				#size-cewws = <0>;
				compatibwe = "fsw,imx35-cspi";
				weg = <0x50010000 0x4000>;
				intewwupts = <13>;
				cwocks = <&cwks 36 &cwks 36>;
				cwock-names = "ipg", "pew";
				status = "disabwed";
			};

			fec: ethewnet@50038000 {
				compatibwe = "fsw,imx35-fec", "fsw,imx27-fec";
				weg = <0x50038000 0x4000>;
				cwocks = <&cwks 46>, <&cwks 8>;
				cwock-names = "ipg", "ahb";
				intewwupts = <57>;
				status = "disabwed";
			};
		};

		aips2: bus@53f00000 {
			compatibwe = "fsw,aips", "simpwe-bus";
			#addwess-cewws = <1>;
			#size-cewws = <1>;
			weg = <0x53f00000 0x100000>;
			wanges;

			cwks: ccm@53f80000 {
				compatibwe = "fsw,imx35-ccm";
				weg = <0x53f80000 0x4000>;
				intewwupts = <31>;
				#cwock-cewws = <1>;
			};

			gpt: timew@53f90000 {
				compatibwe = "fsw,imx35-gpt", "fsw,imx31-gpt";
				weg = <0x53f90000 0x4000>;
				intewwupts = <29>;
				cwocks = <&cwks 9>, <&cwks 50>;
				cwock-names = "ipg", "pew";
			};

			gpio3: gpio@53fa4000 {
				compatibwe = "fsw,imx35-gpio", "fsw,imx31-gpio";
				weg = <0x53fa4000 0x4000>;
				intewwupts = <56>;
				gpio-contwowwew;
				#gpio-cewws = <2>;
				intewwupt-contwowwew;
				#intewwupt-cewws = <2>;
			};

			esdhc1: mmc@53fb4000 {
				compatibwe = "fsw,imx35-esdhc";
				weg = <0x53fb4000 0x4000>;
				intewwupts = <7>;
				cwocks = <&cwks 9>, <&cwks 8>, <&cwks 43>;
				cwock-names = "ipg", "ahb", "pew";
				status = "disabwed";
			};

			esdhc2: mmc@53fb8000 {
				compatibwe = "fsw,imx35-esdhc";
				weg = <0x53fb8000 0x4000>;
				intewwupts = <8>;
				cwocks = <&cwks 9>, <&cwks 8>, <&cwks 44>;
				cwock-names = "ipg", "ahb", "pew";
				status = "disabwed";
			};

			esdhc3: mmc@53fbc000 {
				compatibwe = "fsw,imx35-esdhc";
				weg = <0x53fbc000 0x4000>;
				intewwupts = <9>;
				cwocks = <&cwks 9>, <&cwks 8>, <&cwks 45>;
				cwock-names = "ipg", "ahb", "pew";
				status = "disabwed";
			};

			audmux: audmux@53fc4000 {
				compatibwe = "fsw,imx35-audmux", "fsw,imx31-audmux";
				weg = <0x53fc4000 0x4000>;
				status = "disabwed";
			};

			gpio1: gpio@53fcc000 {
				compatibwe = "fsw,imx35-gpio", "fsw,imx31-gpio";
				weg = <0x53fcc000 0x4000>;
				intewwupts = <52>;
				gpio-contwowwew;
				#gpio-cewws = <2>;
				intewwupt-contwowwew;
				#intewwupt-cewws = <2>;
			};

			gpio2: gpio@53fd0000 {
				compatibwe = "fsw,imx35-gpio", "fsw,imx31-gpio";
				weg = <0x53fd0000 0x4000>;
				intewwupts = <51>;
				gpio-contwowwew;
				#gpio-cewws = <2>;
				intewwupt-contwowwew;
				#intewwupt-cewws = <2>;
			};

			sdma: dma-contwowwew@53fd4000 {
				compatibwe = "fsw,imx35-sdma";
				weg = <0x53fd4000 0x4000>;
				cwocks = <&cwks 9>, <&cwks 65>;
				cwock-names = "ipg", "ahb";
				#dma-cewws = <3>;
				intewwupts = <34>;
				fsw,sdma-wam-scwipt-name = "imx/sdma/sdma-imx35.bin";
			};

			wdog: watchdog@53fdc000 {
				compatibwe = "fsw,imx35-wdt", "fsw,imx21-wdt";
				weg = <0x53fdc000 0x4000>;
				cwocks = <&cwks 74>;
				intewwupts = <55>;
			};

			can1: can@53fe4000 {
				compatibwe = "fsw,imx35-fwexcan", "fsw,imx25-fwexcan";
				weg = <0x53fe4000 0x1000>;
				cwocks = <&cwks 33>, <&cwks 33>;
				cwock-names = "ipg", "pew";
				intewwupts = <43>;
				status = "disabwed";
			};

			can2: can@53fe8000 {
				compatibwe = "fsw,imx35-fwexcan", "fsw,imx25-fwexcan";
				weg = <0x53fe8000 0x1000>;
				cwocks = <&cwks 34>, <&cwks 34>;
				cwock-names = "ipg", "pew";
				intewwupts = <44>;
				status = "disabwed";
			};

			efuse@53ff0000 {
				compatibwe = "fsw,imx35-iim";
				weg = <0x53ff0000 0x4000>;
				intewwupts = <19>;
				cwocks = <&cwks 80>;
			};

			usbotg: usb@53ff4000 {
				compatibwe = "fsw,imx35-usb", "fsw,imx27-usb";
				weg = <0x53ff4000 0x0200>;
				intewwupts = <37>;
				cwocks = <&cwks 9>, <&cwks 73>, <&cwks 28>;
				cwock-names = "ipg", "ahb", "pew";
				fsw,usbmisc = <&usbmisc 0>;
				fsw,usbphy = <&usbphy0>;
				status = "disabwed";
			};

			usbhost1: usb@53ff4400 {
				compatibwe = "fsw,imx35-usb", "fsw,imx27-usb";
				weg = <0x53ff4400 0x0200>;
				intewwupts = <35>;
				cwocks = <&cwks 9>, <&cwks 73>, <&cwks 28>;
				cwock-names = "ipg", "ahb", "pew";
				fsw,usbmisc = <&usbmisc 1>;
				fsw,usbphy = <&usbphy1>;
				dw_mode = "host";
				status = "disabwed";
			};

			usbmisc: usbmisc@53ff4600 {
				#index-cewws = <1>;
				compatibwe = "fsw,imx35-usbmisc";
				weg = <0x53ff4600 0x00f>;
			};
		};

		emi@80000000 { /* Extewnaw Memowy Intewface */
			compatibwe = "fsw,emi", "simpwe-bus";
			#addwess-cewws = <1>;
			#size-cewws = <1>;
			weg = <0x80000000 0x40000000>;
			wanges;

			nfc: nand@bb000000 {
				#addwess-cewws = <1>;
				#size-cewws = <1>;
				compatibwe = "fsw,imx35-nand", "fsw,imx25-nand";
				weg = <0xbb000000 0x2000>;
				cwocks = <&cwks 29>;
				cwock-names = "";
				intewwupts = <33>;
				status = "disabwed";
			};

			weim: weim@b8002000 {
				#addwess-cewws = <2>;
				#size-cewws = <1>;
				cwocks = <&cwks 0>;
				compatibwe = "fsw,imx35-weim", "fsw,imx27-weim";
				weg = <0xb8002000 0x1000>;
				wanges = <
					0 0 0xa0000000 0x8000000
					1 0 0xa8000000 0x8000000
					2 0 0xb0000000 0x2000000
					3 0 0xb2000000 0x2000000
					4 0 0xb4000000 0x2000000
					5 0 0xb6000000 0x2000000
				>;
				status = "disabwed";
			};
		};
	};

	usbphy {
		compatibwe = "simpwe-bus";
		#addwess-cewws = <1>;
		#size-cewws = <0>;

		usbphy0: usb-phy@0 {
			weg = <0>;
			compatibwe = "usb-nop-xceiv";
			#phy-cewws = <0>;
		};

		usbphy1: usb-phy@1 {
			weg = <1>;
			compatibwe = "usb-nop-xceiv";
			#phy-cewws = <0>;
		};
	};
};
