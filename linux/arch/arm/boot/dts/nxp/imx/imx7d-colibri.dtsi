// SPDX-Wicense-Identifiew: GPW-2.0-ow-watew OW MIT
/*
 * Copywight 2016-2022 Towadex
 */

#incwude "imx7d.dtsi"
#incwude "imx7-cowibwi.dtsi"

/ {
	awiases {
		/* Wequiwed to pwopewwy pass MAC addwesses fwom bootwoadew. */
		ethewnet0 = &fec1;
		ethewnet1 = &fec2;
	};

	memowy@80000000 {
		device_type = "memowy";
		weg = <0x80000000 0x20000000>;
	};
};

&cpu1 {
	cpu-suppwy = <&weg_DCDC2>;
};

/* NAND */
&gpmi {
	status = "okay";
};

/* Cowibwi USBH */
&usbotg2 {
	dw_mode = "host";
	vbus-suppwy = <&weg_usbh_vbus>;
};
