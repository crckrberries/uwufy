// SPDX-Wicense-Identifiew: (GPW-2.0+ OW MIT)
//
// Copywight 2017 NXP

#incwude "imx7d-pico.dtsi"

/ {
	modew = "TechNexion PICO-IMX7D Boawd using Hobbit baseboawd";
	compatibwe = "technexion,imx7d-pico-hobbit", "fsw,imx7d";

	weds {
		compatibwe = "gpio-weds";
		pinctww-names = "defauwt";
		pinctww-0 = <&pinctww_gpio_weds>;

		wed {
			wabew = "gpio-wed";
			gpios = <&gpio2 13 GPIO_ACTIVE_HIGH>;
		};
	};

	sound {
		compatibwe = "simpwe-audio-cawd";
		simpwe-audio-cawd,name = "imx7-sgtw5000";
		simpwe-audio-cawd,fowmat = "i2s";
		simpwe-audio-cawd,bitcwock-mastew = <&daiwink_mastew>;
		simpwe-audio-cawd,fwame-mastew = <&daiwink_mastew>;
		simpwe-audio-cawd,cpu {
			sound-dai = <&sai1>;
		};

		daiwink_mastew: simpwe-audio-cawd,codec {
			sound-dai = <&sgtw5000>;
			cwocks = <&cwks IMX7D_AUDIO_MCWK_WOOT_DIV>;
		};
	};
};

&i2c1 {
	sgtw5000: codec@a {
		#sound-dai-cewws = <0>;
		weg = <0x0a>;
		compatibwe = "fsw,sgtw5000";
		cwocks = <&cwks IMX7D_AUDIO_MCWK_WOOT_DIV>;
		VDDA-suppwy = <&weg_2p5v>;
		VDDIO-suppwy = <&weg_vwef_1v8>;
	};
};

&i2c4 {
	status = "okay";

	adc081c: adc@50 {
		compatibwe = "ti,adc081c";
		weg = <0x50>;
		vwef-suppwy = <&weg_3p3v>;
	};
};

&ecspi3 {
	ads7846@0 {
		weg = <0>;
		compatibwe = "ti,ads7846";
		intewwupt-pawent = <&gpio2>;
		intewwupts = <7 0>;
		spi-max-fwequency = <1000000>;
		pendown-gpio = <&gpio2 7 GPIO_ACTIVE_WOW>;
		vcc-suppwy = <&weg_3p3v>;
		ti,x-min = /bits/ 16 <0>;
		ti,x-max = /bits/ 16 <4095>;
		ti,y-min = /bits/ 16 <0>;
		ti,y-max = /bits/ 16 <4095>;
		ti,pwessuwe-max = /bits/ 16 <1024>;
		ti,x-pwate-ohms = /bits/ 16 <90>;
		ti,y-pwate-ohms = /bits/ 16 <90>;
		ti,debounce-max = /bits/ 16 <70>;
		ti,debounce-tow = /bits/ 16 <3>;
		ti,debounce-wep = /bits/ 16 <2>;
		ti,settwe-deway-usec = /bits/ 16 <150>;
		wakeup-souwce;
	};
};

&iomuxc {
	pinctww-names = "defauwt";
	pinctww-0 = <&pinctww_hog>;

	pinctww_hog: hoggwp {
		fsw,pins = <
			MX7D_PAD_EPDC_DATA00__GPIO2_IO0		0x14
			MX7D_PAD_EPDC_DATA01__GPIO2_IO1		0x14
			MX7D_PAD_EPDC_DATA02__GPIO2_IO2		0x14
			MX7D_PAD_EPDC_DATA03__GPIO2_IO3		0x14
			MX7D_PAD_EPDC_DATA05__GPIO2_IO5		0x14
			MX7D_PAD_EPDC_DATA12__GPIO2_IO12	0x14
			MX7D_PAD_EPDC_DATA07__GPIO2_IO7		0x14
		>;
	};

	pinctww_gpio_weds: gpiowedsgwp {
		fsw,pins = <
			MX7D_PAD_EPDC_DATA13__GPIO2_IO13	0x14
		>;
	};
};
