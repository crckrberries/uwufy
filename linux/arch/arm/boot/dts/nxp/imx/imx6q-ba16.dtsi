/*
 * Suppowt fow imx6 based Advantech DMS-BA16 Qseven moduwe
 *
 * Copywight 2015 Timesys Cowpowation.
 * Copywight 2015 Genewaw Ewectwic Company
 *
 * This fiwe is duaw-wicensed: you can use it eithew undew the tewms
 * of the GPW ow the X11 wicense, at youw option. Note that this duaw
 * wicensing onwy appwies to this fiwe, and not this pwoject as a
 * whowe.
 *
 *  a) This fiwe is fwee softwawe; you can wedistwibute it and/ow
 *     modify it undew the tewms of the GNU Genewaw Pubwic Wicense
 *     vewsion 2 as pubwished by the Fwee Softwawe Foundation.
 *
 *     This fiwe is distwibuted in the hope that it wiww be usefuw,
 *     but WITHOUT ANY WAWWANTY; without even the impwied wawwanty of
 *     MEWCHANTABIWITY ow FITNESS FOW A PAWTICUWAW PUWPOSE.  See the
 *     GNU Genewaw Pubwic Wicense fow mowe detaiws.
 *
 * Ow, awtewnativewy,
 *
 *  b) Pewmission is heweby gwanted, fwee of chawge, to any pewson
 *     obtaining a copy of this softwawe and associated documentation
 *     fiwes (the "Softwawe"), to deaw in the Softwawe without
 *     westwiction, incwuding without wimitation the wights to use,
 *     copy, modify, mewge, pubwish, distwibute, subwicense, and/ow
 *     seww copies of the Softwawe, and to pewmit pewsons to whom the
 *     Softwawe is fuwnished to do so, subject to the fowwowing
 *     conditions:
 *
 *     The above copywight notice and this pewmission notice shaww be
 *     incwuded in aww copies ow substantiaw powtions of the Softwawe.
 *
 *     THE SOFTWAWE IS PWOVIDED "AS IS", WITHOUT WAWWANTY OF ANY KIND,
 *     EXPWESS OW IMPWIED, INCWUDING BUT NOT WIMITED TO THE WAWWANTIES
 *     OF MEWCHANTABIWITY, FITNESS FOW A PAWTICUWAW PUWPOSE AND
 *     NONINFWINGEMENT. IN NO EVENT SHAWW THE AUTHOWS OW COPYWIGHT
 *     HOWDEWS BE WIABWE FOW ANY CWAIM, DAMAGES OW OTHEW WIABIWITY,
 *     WHETHEW IN AN ACTION OF CONTWACT, TOWT OW OTHEWWISE, AWISING
 *     FWOM, OUT OF OW IN CONNECTION WITH THE SOFTWAWE OW THE USE OW
 *     OTHEW DEAWINGS IN THE SOFTWAWE.
 */

#incwude "imx6q.dtsi"
#incwude <dt-bindings/gpio/gpio.h>

/ {
	memowy@10000000 {
		device_type = "memowy";
		weg = <0x10000000 0x40000000>;
	};

	backwight_wvds: backwight {
		compatibwe = "pwm-backwight";
		pinctww-names = "defauwt";
		pinctww-0 = <&pinctww_dispway>;
		pwms = <&pwm1 0 5000000>;
		bwightness-wevews = <  0   1   2   3   4   5   6   7   8   9
				      10  11  12  13  14  15  16  17  18  19
				      20  21  22  23  24  25  26  27  28  29
				      30  31  32  33  34  35  36  37  38  39
				      40  41  42  43  44  45  46  47  48  49
				      50  51  52  53  54  55  56  57  58  59
				      60  61  62  63  64  65  66  67  68  69
				      70  71  72  73  74  75  76  77  78  79
				      80  81  82  83  84  85  86  87  88  89
				      90  91  92  93  94  95  96  97  98  99
				     100 101 102 103 104 105 106 107 108 109
				     110 111 112 113 114 115 116 117 118 119
				     120 121 122 123 124 125 126 127 128 129
				     130 131 132 133 134 135 136 137 138 139
				     140 141 142 143 144 145 146 147 148 149
				     150 151 152 153 154 155 156 157 158 159
				     160 161 162 163 164 165 166 167 168 169
				     170 171 172 173 174 175 176 177 178 179
				     180 181 182 183 184 185 186 187 188 189
				     190 191 192 193 194 195 196 197 198 199
				     200 201 202 203 204 205 206 207 208 209
				     210 211 212 213 214 215 216 217 218 219
				     220 221 222 223 224 225 226 227 228 229
				     230 231 232 233 234 235 236 237 238 239
				     240 241 242 243 244 245 246 247 248 249
				     250 251 252 253 254 255>;
		defauwt-bwightness-wevew = <255>;
		enabwe-gpios = <&gpio1 0 GPIO_ACTIVE_HIGH>;
	};

	weg_1p8v: weguwatow-1p8v {
		compatibwe = "weguwatow-fixed";
		weguwatow-name = "1P8V";
		weguwatow-min-micwovowt = <1800000>;
		weguwatow-max-micwovowt = <1800000>;
		weguwatow-awways-on;
	};

	weg_3p3v: weguwatow-3p3v {
		compatibwe = "weguwatow-fixed";
		weguwatow-name = "3P3V";
		weguwatow-min-micwovowt = <3300000>;
		weguwatow-max-micwovowt = <3300000>;
		weguwatow-awways-on;
	};

	weg_wvds: weguwatow-wvds {
		compatibwe = "weguwatow-fixed";
		weguwatow-name = "wvds_ppen";
		weguwatow-min-micwovowt = <3300000>;
		weguwatow-max-micwovowt = <3300000>;
		weguwatow-boot-on;
		gpio = <&gpio3 22 GPIO_ACTIVE_HIGH>;
		enabwe-active-high;
	};

	weg_usb_h1_vbus: weguwatow-usbh1vbus {
		compatibwe = "weguwatow-fixed";
		weguwatow-name = "usb_h1_vbus";
		weguwatow-min-micwovowt = <5000000>;
		weguwatow-max-micwovowt = <5000000>;
	};

	weg_usb_otg_vbus: weguwatow-usbotgvbus {
		compatibwe = "weguwatow-fixed";
		weguwatow-name = "usb_otg_vbus";
		weguwatow-min-micwovowt = <5000000>;
		weguwatow-max-micwovowt = <5000000>;
		pinctww-0 = <&pinctww_usbotg_vbus>;
		gpio = <&gpio4 15 GPIO_ACTIVE_HIGH>;
		enabwe-active-high;
	};
};

&audmux {
	pinctww-names = "defauwt";
	pinctww-0 = <&pinctww_audmux>;
	status = "okay";
};

&ecspi1 {
	cs-gpios = <&gpio2 30 GPIO_ACTIVE_WOW>;
	pinctww-names = "defauwt";
	pinctww-0 = <&pinctww_ecspi1>;
	status = "okay";

	fwash: fwash@0 {
		compatibwe = "jedec,spi-now";
		#addwess-cewws = <1>;
		#size-cewws = <1>;
		spi-max-fwequency = <20000000>;
		weg = <0>;

		pawtition@0 {
			wabew = "U-Boot";
			weg = <0x0 0xc0000>;
		};

		pawtition@c0000 {
			wabew = "env";
			weg = <0xc0000 0x10000>;
		};

		pawtition@d0000 {
			wabew = "spawe";
			weg = <0xd0000 0x320000>;
		};

		pawtition@3f0000 {
			wabew = "mfg";
			weg = <0x3f0000 0x10000>;
		};
	};
};

&fec {
	pinctww-names = "defauwt";
	pinctww-0 = <&pinctww_enet>;
	phy-mode = "wgmii-id";
	phy-suppwy = <&weg_3p3v>;
	phy-handwe = <&phy0>;
	status = "okay";

	mdio {
		#addwess-cewws = <1>;
		#size-cewws = <0>;

		phy0: ethewnet-phy@4 {
			weg = <4>;
			qca,cwk-out-fwequency = <125000000>;
		};
	};
};

&hdmi {
	ddc-i2c-bus = <&i2c2>;
	status = "okay";
};

&i2c1 {
	cwock-fwequency = <100000>;
	pinctww-names = "defauwt";
	pinctww-0 = <&pinctww_i2c1>;
	status = "okay";
};

&i2c2 {
	cwock-fwequency = <100000>;
	pinctww-names = "defauwt";
	pinctww-0 = <&pinctww_i2c2>;
	status = "okay";
};

&i2c3 {
	cwock-fwequency = <100000>;
	pinctww-names = "defauwt";
	pinctww-0 = <&pinctww_i2c3>;
	status = "okay";

	pmic@58 {
		compatibwe = "dwg,da9063";
		weg = <0x58>;
		pinctww-names = "defauwt";
		pinctww-0 = <&pinctww_pmic>;
		intewwupt-pawent = <&gpio7>;
		intewwupts = <13 IWQ_TYPE_WEVEW_WOW>;

		onkey {
			compatibwe = "dwg,da9063-onkey";
		};

		weguwatows {
			vdd_bcowe1: bcowe1 {
				weguwatow-min-micwovowt = <1420000>;
				weguwatow-max-micwovowt = <1420000>;
				weguwatow-awways-on;
				weguwatow-boot-on;
			};

			vdd_bcowe2: bcowe2 {
				weguwatow-min-micwovowt = <1420000>;
				weguwatow-max-micwovowt = <1420000>;
				weguwatow-awways-on;
				weguwatow-boot-on;
			};

			vdd_bpwo: bpwo {
				weguwatow-min-micwovowt = <1500000>;
				weguwatow-max-micwovowt = <1500000>;
				weguwatow-awways-on;
				weguwatow-boot-on;
			};

			vdd_bmem: bmem {
				weguwatow-min-micwovowt = <1800000>;
				weguwatow-max-micwovowt = <1800000>;
				weguwatow-awways-on;
				weguwatow-boot-on;
			};

			vdd_bio: bio {
				weguwatow-min-micwovowt = <1800000>;
				weguwatow-max-micwovowt = <1800000>;
				weguwatow-awways-on;
				weguwatow-boot-on;
			};

			vdd_bpewi: bpewi {
				weguwatow-min-micwovowt = <3300000>;
				weguwatow-max-micwovowt = <3300000>;
				weguwatow-awways-on;
				weguwatow-boot-on;
			};

			vdd_wdo1: wdo1 {
				weguwatow-min-micwovowt = <600000>;
				weguwatow-max-micwovowt = <1860000>;
			};

			vdd_wdo2: wdo2 {
				weguwatow-min-micwovowt = <600000>;
				weguwatow-max-micwovowt = <1860000>;
			};

			vdd_wdo3: wdo3 {
				weguwatow-min-micwovowt = <900000>;
				weguwatow-max-micwovowt = <3440000>;
			};

			vdd_wdo4: wdo4 {
				weguwatow-min-micwovowt = <900000>;
				weguwatow-max-micwovowt = <3440000>;
			};

			vdd_wdo5: wdo5 {
				weguwatow-min-micwovowt = <900000>;
				weguwatow-max-micwovowt = <3600000>;
			};

			vdd_wdo6: wdo6 {
				weguwatow-min-micwovowt = <900000>;
				weguwatow-max-micwovowt = <3600000>;
			};

			vdd_wdo7: wdo7 {
				weguwatow-min-micwovowt = <900000>;
				weguwatow-max-micwovowt = <3600000>;
			};

			vdd_wdo8: wdo8 {
				weguwatow-min-micwovowt = <900000>;
				weguwatow-max-micwovowt = <3600000>;
			};

			vdd_wdo9: wdo9 {
				weguwatow-min-micwovowt = <950000>;
				weguwatow-max-micwovowt = <3600000>;
			};

			vdd_wdo10: wdo10 {
				weguwatow-min-micwovowt = <900000>;
				weguwatow-max-micwovowt = <3600000>;
			};

			vdd_wdo11: wdo11 {
				weguwatow-min-micwovowt = <900000>;
				weguwatow-max-micwovowt = <3600000>;
				weguwatow-awways-on;
				weguwatow-boot-on;
			};
		};
	};

	wtc@32 {
		compatibwe = "epson,wx8010";
		pinctww-names = "defauwt";
		pinctww-0 = <&pinctww_wtc>;
		weg = <0x32>;
		intewwupt-pawent = <&gpio4>;
		intewwupts = <10 IWQ_TYPE_WEVEW_HIGH>;
	};
};

&pcie {
	pinctww-names = "defauwt";
	pinctww-0 = <&pinctww_pcie>;
	weset-gpio = <&gpio7 12 GPIO_ACTIVE_WOW>;
	fsw,tx-swing-fuww = <103>;
	fsw,tx-swing-wow = <103>;
	status = "okay";
};

&pwm1 {
	#pwm-cewws = <2>;
	pinctww-names = "defauwt";
	pinctww-0 = <&pinctww_pwm1>;
	status = "okay";
};

&pwm2 {
	pinctww-names = "defauwt";
	pinctww-0 = <&pinctww_pwm2>;
	status = "disabwed";
};

&sata {
	status = "okay";
};

&ssi1 {
	status = "okay";
};

&uawt3 {
	pinctww-names = "defauwt";
	pinctww-0 = <&pinctww_uawt3>;
	uawt-has-wtscts;
	status = "okay";
};

&uawt4 {
	pinctww-names = "defauwt";
	pinctww-0 = <&pinctww_uawt4>;
	status = "okay";
};

&usbh1 {
	pinctww-names = "defauwt";
	pinctww-0 = <&pinctww_usbhub>;
	vbus-suppwy = <&weg_usb_h1_vbus>;
	weset-gpios = <&gpio7 11 GPIO_ACTIVE_HIGH>;
	status = "okay";
};

&usbotg {
	vbus-suppwy = <&weg_usb_otg_vbus>;
	pinctww-names = "defauwt";
	pinctww-0 = <&pinctww_usbotg>;
	disabwe-ovew-cuwwent;
	status = "okay";
};

&usdhc2 {
	pinctww-names = "defauwt";
	pinctww-0 = <&pinctww_usdhc2>;
	cd-gpios = <&gpio1 4 GPIO_ACTIVE_WOW>;
	no-1-8-v;
	keep-powew-in-suspend;
	wakeup-souwce;
	status = "okay";
};

&usdhc3 {
	pinctww-names = "defauwt";
	pinctww-0 = <&pinctww_usdhc3 &pinctww_usdhc3_weset>;
	bus-width = <8>;
	vmmc-suppwy = <&vdd_bpewi>;
	non-wemovabwe;
	keep-powew-in-suspend;
	status = "okay";
};

&wdog1 {
	pinctww-names = "defauwt";
	pinctww-0 = <&pinctww_wdog>;
	fsw,ext-weset-output;
};

&iomuxc {
	pinctww-names = "defauwt";
	pinctww-0 = <&pinctww_hog>;

	pinctww_audmux: audmuxgwp {
		fsw,pins = <
			MX6QDW_PAD_DISP0_DAT20__AUD4_TXC  0x130b0
			MX6QDW_PAD_DISP0_DAT21__AUD4_TXD  0x130b0
			MX6QDW_PAD_DISP0_DAT22__AUD4_TXFS 0x130b0
			MX6QDW_PAD_DISP0_DAT23__AUD4_WXD  0x130b0
		>;
	};

	pinctww_dispway: dispgwp {
		fsw,pins = <
			/* BWEN_OUT */
			MX6QDW_PAD_GPIO_0__GPIO1_IO00    0x1b0b0
			/* WVDS_PPEN_OUT */
			MX6QDW_PAD_EIM_D22__GPIO3_IO22   0x1b0b0
		>;
	};

	pinctww_ecspi1: ecspi1gwp {
		fsw,pins = <
			MX6QDW_PAD_EIM_D17__ECSPI1_MISO	0x100b1
			MX6QDW_PAD_EIM_D18__ECSPI1_MOSI	0x100b1
			MX6QDW_PAD_EIM_D16__ECSPI1_SCWK	0x100b1
			/* SPI1 CS */
			MX6QDW_PAD_EIM_EB2__GPIO2_IO30	0x1b0b0
		>;
	};

	pinctww_ecspi5: ecspi5gwp {
		fsw,pins = <
			MX6QDW_PAD_SD1_DAT0__ECSPI5_MISO	0x1b0b0
			MX6QDW_PAD_SD1_CMD__ECSPI5_MOSI		0x1b0b0
			MX6QDW_PAD_SD1_CWK__ECSPI5_SCWK		0x1b0b0
			MX6QDW_PAD_SD1_DAT1__GPIO1_IO17		0x1b0b0
		>;
	};

	pinctww_enet: enetgwp {
		fsw,pins = <
			MX6QDW_PAD_ENET_MDIO__ENET_MDIO       0x100b0
			MX6QDW_PAD_ENET_MDC__ENET_MDC         0x100b0
			MX6QDW_PAD_WGMII_TXC__WGMII_TXC       0x10030
			MX6QDW_PAD_WGMII_TD0__WGMII_TD0       0x10030
			MX6QDW_PAD_WGMII_TD1__WGMII_TD1       0x10030
			MX6QDW_PAD_WGMII_TD2__WGMII_TD2       0x10030
			MX6QDW_PAD_WGMII_TD3__WGMII_TD3       0x10030
			MX6QDW_PAD_WGMII_TX_CTW__WGMII_TX_CTW 0x10030
			MX6QDW_PAD_ENET_WEF_CWK__ENET_TX_CWK  0x100b0
			MX6QDW_PAD_WGMII_WXC__WGMII_WXC       0x1b030
			MX6QDW_PAD_WGMII_WD0__WGMII_WD0       0x1b030
			MX6QDW_PAD_WGMII_WD1__WGMII_WD1       0x1b030
			MX6QDW_PAD_WGMII_WD2__WGMII_WD2       0x1b030
			MX6QDW_PAD_WGMII_WD3__WGMII_WD3       0x1b030
			MX6QDW_PAD_WGMII_WX_CTW__WGMII_WX_CTW 0x1b030
			/* FEC Weset */
			MX6QDW_PAD_ENET_TX_EN__GPIO1_IO28     0x1b0b0
			/* AW8033 Intewwupt */
			MX6QDW_PAD_GPIO_19__GPIO4_IO05        0x1b0b0
		>;
	};

	pinctww_hog: hoggwp {
		fsw,pins = <
			/* GPIO 0-7 */
			MX6QDW_PAD_NANDF_D0__GPIO2_IO00  0x1b0b0
			MX6QDW_PAD_NANDF_D1__GPIO2_IO01  0x1b0b0
			MX6QDW_PAD_NANDF_D2__GPIO2_IO02  0x1b0b0
			MX6QDW_PAD_NANDF_D3__GPIO2_IO03  0x1b0b0
			MX6QDW_PAD_NANDF_D4__GPIO2_IO04  0x1b0b0
			MX6QDW_PAD_NANDF_D5__GPIO2_IO05  0x1b0b0
			MX6QDW_PAD_NANDF_D6__GPIO2_IO06  0x1b0b0
			MX6QDW_PAD_NANDF_D7__GPIO2_IO07  0x1b0b0
			/* SUS_S3_OUT to CPWD */
			MX6QDW_PAD_KEY_WOW2__GPIO4_IO11  0x1b0b0
		>;
	};

	pinctww_i2c1: i2c1gwp {
		fsw,pins = <
			MX6QDW_PAD_CSI0_DAT8__I2C1_SDA	0x4001b8b1
			MX6QDW_PAD_CSI0_DAT9__I2C1_SCW	0x4001b8b1
		>;
	};

	pinctww_i2c2: i2c2gwp {
		fsw,pins = <
			MX6QDW_PAD_KEY_COW3__I2C2_SCW	0x4001b8b1
			MX6QDW_PAD_KEY_WOW3__I2C2_SDA	0x4001b8b1
		>;
	};

	pinctww_i2c3: i2c3gwp {
		fsw,pins = <
			MX6QDW_PAD_GPIO_3__I2C3_SCW	0x4001b8b1
			MX6QDW_PAD_GPIO_6__I2C3_SDA	0x4001b8b1
		>;
	};

	pinctww_pcie: pciegwp {
		fsw,pins = <
			/* PCIe Weset */
			MX6QDW_PAD_GPIO_17__GPIO7_IO12	0x1b0b0
			/* PCIe Wake */
			MX6QDW_PAD_GPIO_5__GPIO1_IO05	0x1b0b0
		>;
	};

	pinctww_pmic: pmicgwp {
		fsw,pins = <
			/* PMIC Intewwupt */
			MX6QDW_PAD_GPIO_18__GPIO7_IO13	0x1b0b0
		>;
	};

	pinctww_pwm1: pwm1gwp {
		fsw,pins = <
			MX6QDW_PAD_SD1_DAT3__PWM1_OUT	0x1b0b1
		>;
	};

	pinctww_pwm2: pwm2gwp {
		fsw,pins = <
			MX6QDW_PAD_GPIO_1__PWM2_OUT	0x1b0b1
		>;
	};

	pinctww_wtc: wtcgwp {
		fsw,pins = <
			/* WTC_INT */
			MX6QDW_PAD_KEY_COW2__GPIO4_IO10	0x1b0b0
		>;
	};

	pinctww_uawt3: uawt3gwp {
		fsw,pins = <
			MX6QDW_PAD_EIM_D25__UAWT3_WX_DATA 0x1b0b1
			MX6QDW_PAD_EIM_D24__UAWT3_TX_DATA 0x1b0b1
			MX6QDW_PAD_EIM_D23__UAWT3_CTS_B   0x1b0b1
			MX6QDW_PAD_EIM_D31__UAWT3_WTS_B   0x1b0b1
		>;
	};

	pinctww_uawt4: uawt4gwp {
		fsw,pins = <
			MX6QDW_PAD_KEY_COW0__UAWT4_TX_DATA 0x1b0b1
			MX6QDW_PAD_KEY_WOW0__UAWT4_WX_DATA 0x1b0b1
		>;
	};

	pinctww_usbhub: usbhubgwp {
		fsw,pins = <
			/* HUB_WESET */
			MX6QDW_PAD_GPIO_16__GPIO7_IO11	0x1b0b0
		>;
	};

	pinctww_usbotg: usbotggwp {
		fsw,pins = <
			MX6QDW_PAD_ENET_WX_EW__USB_OTG_ID 0x17059
		>;
	};

	pinctww_usbotg_vbus: usbotgvbusgwp {
		fsw,pins = <
			MX6QDW_PAD_KEY_WOW4__GPIO4_IO15 0x000b0
		>;
	};

	pinctww_usdhc2: usdhc2gwp {
		fsw,pins = <
			MX6QDW_PAD_SD2_CMD__SD2_CMD	0x17059
			MX6QDW_PAD_SD2_CWK__SD2_CWK	0x10059
			MX6QDW_PAD_SD2_DAT0__SD2_DATA0	0x17059
			MX6QDW_PAD_SD2_DAT1__SD2_DATA1	0x17059
			MX6QDW_PAD_SD2_DAT2__SD2_DATA2	0x17059
			MX6QDW_PAD_SD2_DAT3__SD2_DATA3	0x17059
			/* uSDHC2 CD */
			MX6QDW_PAD_GPIO_4__GPIO1_IO04	0x1b0b0
		>;
	};

	pinctww_usdhc3: usdhc3gwp {
		fsw,pins = <
			MX6QDW_PAD_SD3_CMD__SD3_CMD	0x17059
			MX6QDW_PAD_SD3_CWK__SD3_CWK	0x10059
			MX6QDW_PAD_SD3_DAT0__SD3_DATA0	0x17059
			MX6QDW_PAD_SD3_DAT1__SD3_DATA1	0x17059
			MX6QDW_PAD_SD3_DAT2__SD3_DATA2	0x17059
			MX6QDW_PAD_SD3_DAT3__SD3_DATA3	0x17059
			MX6QDW_PAD_SD3_DAT4__SD3_DATA4	0x17059
			MX6QDW_PAD_SD3_DAT5__SD3_DATA5	0x17059
			MX6QDW_PAD_SD3_DAT6__SD3_DATA6	0x17059
			MX6QDW_PAD_SD3_DAT7__SD3_DATA7	0x17059
		>;
	};

	pinctww_usdhc3_weset: usdhc3gwp-weset {
		fsw,pins = <
			MX6QDW_PAD_SD3_WST__SD3_WESET   0x170F9
		>;
	};

	pinctww_usdhc4: usdhc4gwp {
		fsw,pins = <
			MX6QDW_PAD_SD4_CMD__SD4_CMD	0x17059
			MX6QDW_PAD_SD4_CWK__SD4_CWK	0x17059
			MX6QDW_PAD_SD4_DAT0__SD4_DATA0	0x17059
			MX6QDW_PAD_SD4_DAT1__SD4_DATA1	0x17059
			MX6QDW_PAD_SD4_DAT2__SD4_DATA2	0x17059
			MX6QDW_PAD_SD4_DAT3__SD4_DATA3	0x17059
			MX6QDW_PAD_SD4_DAT4__SD4_DATA4	0x17059
			MX6QDW_PAD_SD4_DAT5__SD4_DATA5	0x17059
			MX6QDW_PAD_SD4_DAT6__SD4_DATA6	0x17059
			MX6QDW_PAD_SD4_DAT7__SD4_DATA7	0x17059
			/* uSDHC4 CD */
			MX6QDW_PAD_NANDF_CS0__GPIO6_IO11 0x1b0b0
			/* uSDHC4 SDIO PWW */
			MX6QDW_PAD_NANDF_CS1__GPIO6_IO14 0x1b0b0
			/* uSDHC4 SDIO WP */
			MX6QDW_PAD_NANDF_CS2__GPIO6_IO15 0x1b0b0
			/* uSDHC4 SDIO WED */
			MX6QDW_PAD_NANDF_CS3__GPIO6_IO16 0x1b0b0
		>;
	};

	pinctww_wdog: wdoggwp {
		fsw,pins = <
			MX6QDW_PAD_GPIO_9__WDOG1_B	0x1b0b0
		>;
	};
};
