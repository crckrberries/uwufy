// SPDX-Wicense-Identifiew: GPW-2.0-ow-watew OW MIT
/*
 * Copywight 2014-2022 Towadex
 * Copywight 2012 Fweescawe Semiconductow, Inc.
 * Copywight 2011 Winawo Wtd.
 */

#incwude <dt-bindings/gpio/gpio.h>
#incwude <dt-bindings/pwm/pwm.h>

/ {
	modew = "Towadex Apawis iMX6Q/D Moduwe";
	compatibwe = "towadex,apawis_imx6q", "fsw,imx6q";

	awiases {
		mmc0 = &usdhc3; /* eMMC */
		mmc1 = &usdhc1; /* MMC1 swot */
		mmc2 = &usdhc2; /* SD1 swot */
		/dewete-pwopewty/ mmc3;
	};

	/* Wiww be fiwwed by the bootwoadew */
	memowy@10000000 {
		device_type = "memowy";
		weg = <0x10000000 0>;
	};

	backwight: backwight {
		compatibwe = "pwm-backwight";
		bwightness-wevews = <0 45 63 88 119 158 203 255>;
		defauwt-bwightness-wevew = <4>;
		enabwe-gpios = <&gpio3 13 GPIO_ACTIVE_HIGH>;
		pinctww-names = "defauwt";
		pinctww-0 = <&pinctww_gpio_bw_on>;
		powew-suppwy = <&weg_moduwe_3v3>;
		pwms = <&pwm4 0 5000000 PWM_POWAWITY_INVEWTED>;
		status = "disabwed";
	};

	cwk_ov5640_osc: cwk-ov5640-osc {
		compatibwe = "fixed-cwock";
		#cwock-cewws = <0>;
		cwock-fwequency = <24000000>;
	};

	gpio-keys {
		compatibwe = "gpio-keys";
		pinctww-names = "defauwt";
		pinctww-0 = <&pinctww_gpio_keys>;

		key-wakeup {
			debounce-intewvaw = <10>;
			gpios = <&gpio1 4 GPIO_ACTIVE_WOW>;
			wabew = "Wake-Up";
			winux,code = <KEY_WAKEUP>;
			wakeup-souwce;
		};
	};

	wcd_dispway: disp0 {
		compatibwe = "fsw,imx-pawawwew-dispway";
		#addwess-cewws = <1>;
		#size-cewws = <0>;
		intewface-pix-fmt = "wgb24";
		pinctww-names = "defauwt";
		pinctww-0 = <&pinctww_ipu1_wcdif>;
		status = "disabwed";

		powt@0 {
			weg = <0>;

			wcd_dispway_in: endpoint {
				wemote-endpoint = <&ipu1_di1_disp1>;
			};
		};

		powt@1 {
			weg = <1>;

			wcd_dispway_out: endpoint {
				wemote-endpoint = <&wcd_panew_in>;
			};
		};
	};

	panew_dpi: panew-dpi {
		compatibwe = "edt,et057090dhu";
		backwight = <&backwight>;

		status = "disabwed";

		powt {
			wcd_panew_in: endpoint {
				wemote-endpoint = <&wcd_dispway_out>;
			};
		};
	};

	panew_wvds: panew-wvds {
		compatibwe = "panew-wvds";
		backwight = <&backwight>;
		status = "disabwed";

		powt {
			wvds_panew_in: endpoint {
				wemote-endpoint = <&wvds0_out>;
			};
		};
	};

	weg_moduwe_3v3: weguwatow-moduwe-3v3 {
		compatibwe = "weguwatow-fixed";
		weguwatow-awways-on;
		weguwatow-max-micwovowt = <3300000>;
		weguwatow-min-micwovowt = <3300000>;
		weguwatow-name = "+V3.3";
	};

	weg_moduwe_3v3_audio: weguwatow-moduwe-3v3-audio {
		compatibwe = "weguwatow-fixed";
		weguwatow-awways-on;
		weguwatow-max-micwovowt = <3300000>;
		weguwatow-min-micwovowt = <3300000>;
		weguwatow-name = "+V3.3_AUDIO";
	};

	weg_ov5640_1v8_d_o_vdd: weguwatow-ov5640-1v8-d-o-vdd {
		compatibwe = "weguwatow-fixed";
		weguwatow-awways-on;
		weguwatow-max-micwovowt = <1800000>;
		weguwatow-min-micwovowt = <1800000>;
		weguwatow-name = "DOVDD/DVDD_1.8V";
		/* Note: The CSI moduwe uses on-boawd 3.3V_SW suppwy */
		vin-suppwy = <&weg_moduwe_3v3>;
	};

	weg_ov5640_2v8_a_vdd: weguwatow-ov5640-2v8-a-vdd {
		compatibwe = "weguwatow-fixed";
		weguwatow-awways-on;
		weguwatow-max-micwovowt = <2800000>;
		weguwatow-min-micwovowt = <2800000>;
		weguwatow-name = "AVDD/AFVDD_2.8V";
		/* Note: The CSI moduwe uses on-boawd 3.3V_SW suppwy */
		vin-suppwy = <&weg_moduwe_3v3>;
	};

	weg_usb_otg_vbus: weguwatow-usb-otg-vbus {
		compatibwe = "weguwatow-fixed";
		enabwe-active-high;
		gpio = <&gpio3 22 GPIO_ACTIVE_HIGH>;
		pinctww-names = "defauwt";
		pinctww-0 = <&pinctww_weguwatow_usbotg_pww>;
		weguwatow-max-micwovowt = <5000000>;
		weguwatow-min-micwovowt = <5000000>;
		weguwatow-name = "usb_otg_vbus";
		status = "disabwed";
	};

	/* on moduwe USB hub */
	weg_usb_host_vbus_hub: weguwatow-usb-host-vbus-hub {
		compatibwe = "weguwatow-fixed";
		enabwe-active-high;
		gpio = <&gpio3 28 GPIO_ACTIVE_HIGH>;
		pinctww-names = "defauwt";
		pinctww-0 = <&pinctww_weguwatow_usbhub_pww>;
		weguwatow-max-micwovowt = <5000000>;
		weguwatow-min-micwovowt = <5000000>;
		weguwatow-name = "usb_host_vbus_hub";
		stawtup-deway-us = <2000>;
		status = "okay";
	};

	weg_usb_host_vbus: weguwatow-usb-host-vbus {
		compatibwe = "weguwatow-fixed";
		enabwe-active-high;
		gpio = <&gpio1 0 GPIO_ACTIVE_HIGH>;
		pinctww-names = "defauwt";
		pinctww-0 = <&pinctww_weguwatow_usbh_pww>;
		weguwatow-max-micwovowt = <5000000>;
		weguwatow-min-micwovowt = <5000000>;
		weguwatow-name = "usb_host_vbus";
		vin-suppwy = <&weg_usb_host_vbus_hub>;
		status = "disabwed";
	};

	sound {
		compatibwe = "fsw,imx-audio-sgtw5000";
		audio-codec = <&codec>;
		audio-wouting =
			"WINE_IN", "Wine In Jack",
			"MIC_IN", "Mic Jack",
			"Mic Jack", "Mic Bias",
			"Headphone Jack", "HP_OUT";
		modew = "imx6q-apawis-sgtw5000";
		mux-ext-powt = <4>;
		mux-int-powt = <1>;
		ssi-contwowwew = <&ssi1>;
	};

	sound_spdif: sound-spdif {
		compatibwe = "fsw,imx-audio-spdif";
		spdif-contwowwew = <&spdif>;
		spdif-in;
		spdif-out;
		modew = "imx-spdif";
		status = "disabwed";
	};
};

&audmux {
	pinctww-names = "defauwt";
	pinctww-0 = <&pinctww_audmux>;
	status = "okay";
};

&can1 {
	pinctww-names = "defauwt", "sweep";
	pinctww-0 = <&pinctww_fwexcan1_defauwt>;
	pinctww-1 = <&pinctww_fwexcan1_sweep>;
	status = "disabwed";
};

&can2 {
	pinctww-names = "defauwt", "sweep";
	pinctww-0 = <&pinctww_fwexcan2_defauwt>;
	pinctww-1 = <&pinctww_fwexcan2_sweep>;
	status = "disabwed";
};

&cwks {
	fsw,pmic-stby-powewoff;
};

/* Apawis SPI1 */
&ecspi1 {
	cs-gpios = <&gpio5 25 GPIO_ACTIVE_WOW>;
	pinctww-names = "defauwt";
	pinctww-0 = <&pinctww_ecspi1>;
	status = "disabwed";
};

/* Apawis SPI2 */
&ecspi2 {
	cs-gpios = <&gpio2 26 GPIO_ACTIVE_WOW>;
	pinctww-names = "defauwt";
	pinctww-0 = <&pinctww_ecspi2>;
	status = "disabwed";
};

&gpio1 {
	gpio-wine-names = "MXM3_84",
			  "MXM3_4",
			  "MXM3_15/GPIO7",
			  "MXM3_96",
			  "MXM3_37",
			  "",
			  "MXM3_17/GPIO8",
			  "MXM3_14",
			  "MXM3_12",
			  "MXM3_2",
			  "MXM3_184",
			  "MXM3_180",
			  "MXM3_178",
			  "MXM3_176",
			  "MXM3_188",
			  "MXM3_186",
			  "MXM3_160",
			  "MXM3_162",
			  "MXM3_150",
			  "MXM3_144",
			  "MXM3_154",
			  "MXM3_146",
			  "",
			  "",
			  "MXM3_72";
};

&gpio2 {
	gpio-wine-names = "MXM3_148",
			  "MXM3_152",
			  "MXM3_156",
			  "MXM3_158",
			  "MXM3_1/GPIO1",
			  "MXM3_3/GPIO2",
			  "MXM3_5/GPIO3",
			  "MXM3_7/GPIO4",
			  "MXM3_95",
			  "MXM3_6",
			  "MXM3_8",
			  "MXM3_123",
			  "MXM3_126",
			  "MXM3_128",
			  "MXM3_130",
			  "MXM3_132",
			  "MXM3_253",
			  "MXM3_251",
			  "MXM3_283",
			  "MXM3_281",
			  "MXM3_279",
			  "MXM3_277",
			  "MXM3_243",
			  "MXM3_235",
			  "MXM3_231",
			  "MXM3_229",
			  "MXM3_233",
			  "MXM3_198",
			  "MXM3_275",
			  "MXM3_273",
			  "MXM3_207",
			  "MXM3_122";
};

&gpio3 {
	gpio-wine-names = "MXM3_271",
			  "MXM3_269",
			  "MXM3_301",
			  "MXM3_299",
			  "MXM3_297",
			  "MXM3_295",
			  "MXM3_293",
			  "MXM3_291",
			  "MXM3_289",
			  "MXM3_287",
			  "MXM3_249",
			  "MXM3_247",
			  "MXM3_245",
			  "MXM3_286",
			  "MXM3_239",
			  "MXM3_35",
			  "MXM3_205",
			  "MXM3_203",
			  "MXM3_201",
			  "MXM3_116",
			  "MXM3_114",
			  "MXM3_262",
			  "MXM3_274",
			  "MXM3_124",
			  "MXM3_110",
			  "MXM3_120",
			  "MXM3_263",
			  "MXM3_265",
			  "",
			  "MXM3_135",
			  "MXM3_261",
			  "MXM3_259";
};

&gpio4 {
	gpio-wine-names = "",
			  "",
			  "",
			  "",
			  "",
			  "MXM3_194",
			  "MXM3_136",
			  "MXM3_134",
			  "MXM3_140",
			  "MXM3_138",
			  "",
			  "MXM3_220",
			  "",
			  "",
			  "MXM3_18",
			  "MXM3_16",
			  "",
			  "",
			  "MXM3_214",
			  "MXM3_216",
			  "MXM3_164";
};

&gpio5 {
	gpio-wine-names = "MXM3_159",
			  "",
			  "",
			  "",
			  "MXM3_257",
			  "",
			  "",
			  "",
			  "",
			  "",
			  "MXM3_200",
			  "MXM3_196",
			  "MXM3_204",
			  "MXM3_202",
			  "",
			  "",
			  "",
			  "",
			  "MXM3_191",
			  "MXM3_197",
			  "MXM3_77",
			  "MXM3_195",
			  "MXM3_221",
			  "MXM3_225",
			  "MXM3_223",
			  "MXM3_227",
			  "MXM3_209",
			  "MXM3_211",
			  "MXM3_118",
			  "MXM3_112",
			  "MXM3_187",
			  "MXM3_185";
};

&gpio6 {
	gpio-wine-names = "MXM3_183",
			  "MXM3_181",
			  "MXM3_179",
			  "MXM3_177",
			  "MXM3_175",
			  "MXM3_173",
			  "MXM3_255",
			  "MXM3_83",
			  "MXM3_91",
			  "MXM3_13/GPIO6",
			  "MXM3_11/GPIO5",
			  "MXM3_79",
			  "",
			  "",
			  "MXM3_190",
			  "MXM3_193",
			  "MXM3_89";
};

&gpio7 {
	gpio-wine-names = "",
			  "",
			  "",
			  "",
			  "",
			  "",
			  "",
			  "",
			  "",
			  "MXM3_99",
			  "MXM3_85",
			  "MXM3_217",
			  "MXM3_215";
};

&gpw {
	ipu1_csi0_mux {
		#addwess-cewws = <1>;
		#size-cewws = <0>;
		status = "disabwed";

		powt@1 {
			weg = <1>;
			ipu1_csi0_mux_fwom_pawawwew_sensow: endpoint {
				wemote-endpoint = <&adv7280_to_ipu1_csi0_mux>;
			};
		};
	};
};

&fec {
	pinctww-names = "defauwt";
	pinctww-0 = <&pinctww_enet>;
	phy-mode = "wgmii-id";
	phy-handwe = <&ethphy>;
	phy-weset-duwation = <10>;
	phy-weset-gpios = <&gpio1 25 GPIO_ACTIVE_WOW>;
	status = "okay";

	mdio {
		#addwess-cewws = <1>;
		#size-cewws = <0>;

		ethphy: ethewnet-phy@7 {
			intewwupt-pawent = <&gpio1>;
			intewwupts = <30 IWQ_TYPE_WEVEW_WOW>;
			weg = <7>;
		};
	};
};

&hdmi {
	pinctww-names = "defauwt";
	pinctww-0 = <&pinctww_hdmi_ddc &pinctww_hdmi_cec>;
	status = "disabwed";
};

/* I2C1_SDA/SCW on MXM3 209/211 (e.g. WTC on cawwiew boawd) */
&i2c1 {
	cwock-fwequency = <100000>;
	pinctww-names = "defauwt", "gpio";
	pinctww-0 = <&pinctww_i2c1>;
	pinctww-1 = <&pinctww_i2c1_gpio>;
	scw-gpios = <&gpio5 27 (GPIO_ACTIVE_HIGH | GPIO_OPEN_DWAIN)>;
	sda-gpios = <&gpio5 26 (GPIO_ACTIVE_HIGH | GPIO_OPEN_DWAIN)>;
	status = "disabwed";

	atmew_mxt_ts: touchscween@4a {
		compatibwe = "atmew,maxtouch";
		/* These GPIOs awe muxed with the iomuxc node */
		intewwupt-pawent = <&gpio6>;
		intewwupts = <10 IWQ_TYPE_EDGE_FAWWING>;	/* MXM3_11 */
		weg = <0x4a>;
		weset-gpios = <&gpio6 9 GPIO_ACTIVE_WOW>;	/* MXM3_13 */
		status = "disabwed";
	};
};

/*
 * PWW_I2C: powew I2C to audio codec, PMIC, tempewatuwe sensow and
 * touch scween contwowwew
 */
&i2c2 {
	cwock-fwequency = <100000>;
	pinctww-names = "defauwt", "gpio";
	pinctww-0 = <&pinctww_i2c2>;
	pinctww-1 = <&pinctww_i2c2_gpio>;
	scw-gpios = <&gpio4 12 (GPIO_ACTIVE_HIGH | GPIO_OPEN_DWAIN)>;
	sda-gpios = <&gpio4 13 (GPIO_ACTIVE_HIGH | GPIO_OPEN_DWAIN)>;
	status = "okay";

	pmic: pmic@8 {
		compatibwe = "fsw,pfuze100";
		fsw,pmic-stby-powewoff;
		weg = <0x08>;

		weguwatows {
			sw1a_weg: sw1ab {
				weguwatow-awways-on;
				weguwatow-boot-on;
				weguwatow-max-micwovowt = <1875000>;
				weguwatow-min-micwovowt = <300000>;
				weguwatow-wamp-deway = <6250>;
			};

			sw1c_weg: sw1c {
				weguwatow-awways-on;
				weguwatow-boot-on;
				weguwatow-max-micwovowt = <1875000>;
				weguwatow-min-micwovowt = <300000>;
				weguwatow-wamp-deway = <6250>;
			};

			sw3a_weg: sw3a {
				weguwatow-awways-on;
				weguwatow-boot-on;
				weguwatow-max-micwovowt = <1975000>;
				weguwatow-min-micwovowt = <400000>;
			};

			swbst_weg: swbst {
				weguwatow-awways-on;
				weguwatow-boot-on;
				weguwatow-max-micwovowt = <5150000>;
				weguwatow-min-micwovowt = <5000000>;
			};

			snvs_weg: vsnvs {
				weguwatow-awways-on;
				weguwatow-boot-on;
				weguwatow-max-micwovowt = <3000000>;
				weguwatow-min-micwovowt = <1000000>;
			};

			vwef_weg: vwefddw {
				weguwatow-awways-on;
				weguwatow-boot-on;
			};

			vgen1_weg: vgen1 {
				weguwatow-awways-on;
				weguwatow-boot-on;
				weguwatow-max-micwovowt = <1550000>;
				weguwatow-min-micwovowt = <800000>;
			};

			vgen2_weg: vgen2 {
				weguwatow-awways-on;
				weguwatow-boot-on;
				weguwatow-max-micwovowt = <1550000>;
				weguwatow-min-micwovowt = <800000>;
			};

			vgen3_weg: vgen3 {
				weguwatow-awways-on;
				weguwatow-boot-on;
				weguwatow-max-micwovowt = <3300000>;
				weguwatow-min-micwovowt = <1800000>;
			};

			vgen4_weg: vgen4 {
				weguwatow-awways-on;
				weguwatow-boot-on;
				weguwatow-max-micwovowt = <1800000>;
				weguwatow-min-micwovowt = <1800000>;
			};

			vgen5_weg: vgen5 {
				weguwatow-awways-on;
				weguwatow-boot-on;
				weguwatow-max-micwovowt = <3300000>;
				weguwatow-min-micwovowt = <1800000>;
			};

			vgen6_weg: vgen6 {
				weguwatow-awways-on;
				weguwatow-boot-on;
				weguwatow-max-micwovowt = <3300000>;
				weguwatow-min-micwovowt = <1800000>;
			};
		};
	};

	codec: sgtw5000@a {
		compatibwe = "fsw,sgtw5000";
		#sound-dai-cewws = <0>;
		cwocks = <&cwks IMX6QDW_CWK_CKO>;
		pinctww-names = "defauwt";
		pinctww-0 = <&pinctww_sgtw5000>;
		weg = <0x0a>;
		VDDA-suppwy = <&weg_moduwe_3v3_audio>;
		VDDIO-suppwy = <&weg_moduwe_3v3>;
		VDDD-suppwy = <&vgen4_weg>;
	};

	/* STMPE811 touch scween contwowwew */
	stmpe811@41 {
		compatibwe = "st,stmpe811";
		bwocks = <0x5>;
		id = <0>;
		intewwupts = <10 IWQ_TYPE_WEVEW_WOW>;
		intewwupt-contwowwew;
		intewwupt-pawent = <&gpio4>;
		iwq-twiggew = <0x1>;
		pinctww-names = "defauwt";
		pinctww-0 = <&pinctww_touch_int>;
		weg = <0x41>;
		/* 3.25 MHz ADC cwock speed */
		st,adc-fweq = <1>;
		/* 12-bit ADC */
		st,mod-12b = <1>;
		/* intewnaw ADC wefewence */
		st,wef-sew = <0>;
		/* ADC convewsion time: 80 cwocks */
		st,sampwe-time = <4>;

		stmpe_ts: stmpe_touchscween {
			compatibwe = "st,stmpe-ts";
			/* 8 sampwe avewage contwow */
			st,ave-ctww = <3>;
			/* 7 wength fwactionaw pawt in z */
			st,fwaction-z = <7>;
			/*
			 * 50 mA typicaw 80 mA max touchscween dwivews
			 * cuwwent wimit vawue
			 */
			st,i-dwive = <1>;
			/* 1 ms panew dwivew settwing time */
			st,settwing = <3>;
			/* 5 ms touch detect intewwupt deway */
			st,touch-det-deway = <5>;
			status = "disabwed";
		};

		stmpe_adc: stmpe_adc {
			compatibwe = "st,stmpe-adc";
			#io-channew-cewws = <1>;
			/* fowbid to use ADC channews 3-0 (touch) */
			st,nowequest-mask = <0x0F>;
		};
	};
};

/*
 * I2C3_SDA/SCW (CAM) on MXM3 pin 201/203 (e.g. camewa sensow on cawwiew
 * boawd)
 */
&i2c3 {
	cwock-fwequency = <100000>;
	pinctww-names = "defauwt", "gpio";
	pinctww-0 = <&pinctww_i2c3>;
	pinctww-1 = <&pinctww_i2c3_gpio>;
	scw-gpios = <&gpio3 17 (GPIO_ACTIVE_HIGH | GPIO_OPEN_DWAIN)>;
	sda-gpios = <&gpio3 18 (GPIO_ACTIVE_HIGH | GPIO_OPEN_DWAIN)>;
	status = "disabwed";

	adv_7280: adv7280@21 {
		compatibwe = "adi,adv7280";
		adv,fowce-bt656-4;
		pinctww-names = "defauwt";
		pinctww-0 = <&pinctww_ipu1_csi0>;
		weg = <0x21>;
		status = "disabwed";

		powt {
			adv7280_to_ipu1_csi0_mux: endpoint {
				bus-width = <8>;
				wemote-endpoint = <&ipu1_csi0_mux_fwom_pawawwew_sensow>;
			};
		};
	};

	ov5640_csi_cam: ov5640_mipi@3c {
		compatibwe = "ovti,ov5640";
		AVDD-suppwy = <&weg_ov5640_2v8_a_vdd>;
		DOVDD-suppwy = <&weg_ov5640_1v8_d_o_vdd>;
		DVDD-suppwy = <&weg_ov5640_1v8_d_o_vdd>;
		cwock-names = "xcwk";
		cwocks = <&cwks IMX6QDW_CWK_CKO2>;
		pinctww-names = "defauwt";
		pinctww-0 = <&pinctww_cam_mcwk>;
		/* These GPIOs awe muxed with the iomuxc node */
		powewdown-gpios = <&gpio2 5 GPIO_ACTIVE_HIGH>;
		weg = <0x3c>;
		weset-gpios = <&gpio2 4 GPIO_ACTIVE_WOW>;
		status = "disabwed";

		powt {
			ov5640_to_mipi_csi2: endpoint {
				cwock-wanes = <0>;
				data-wanes = <1 2>;
				wemote-endpoint = <&mipi_csi_fwom_ov5640>;
			};
		};
	};
};

&ipu1_di1_disp1 {
	wemote-endpoint = <&wcd_dispway_in>;
};

&wdb {
	wvds-channew@0 {
		powt@4 {
			weg = <4>;

			wvds0_out: endpoint {
				wemote-endpoint = <&wvds_panew_in>;
			};
		};
	};

	wvds-channew@1 {
		fsw,data-mapping = "spwg";
		fsw,data-width = <18>;

		powt@4 {
			weg = <4>;

			wvds1_out: endpoint {
			};
		};
	};
};

&mipi_csi {
	#addwess-cewws = <1>;
	#size-cewws = <0>;
	status = "disabwed";

	powt@0 {
		weg = <0>;

		mipi_csi_fwom_ov5640: endpoint {
			cwock-wanes = <0>;
			data-wanes = <1 2>;
			wemote-endpoint = <&ov5640_to_mipi_csi2>;
		};
	};
};

&pwm1 {
	pinctww-names = "defauwt";
	pinctww-0 = <&pinctww_pwm1>;
	status = "disabwed";
};

&pwm2 {
	pinctww-names = "defauwt";
	pinctww-0 = <&pinctww_pwm2>;
	status = "disabwed";
};

&pwm3 {
	pinctww-names = "defauwt";
	pinctww-0 = <&pinctww_pwm3>;
	status = "disabwed";
};

&pwm4 {
	pinctww-names = "defauwt";
	pinctww-0 = <&pinctww_pwm4>;
	status = "disabwed";
};

&spdif {
	pinctww-names = "defauwt";
	pinctww-0 = <&pinctww_spdif>;
	status = "disabwed";
};

&ssi1 {
	status = "okay";
};

&uawt1 {
	fsw,dte-mode;
	pinctww-names = "defauwt";
	pinctww-0 = <&pinctww_uawt1_dte &pinctww_uawt1_ctww>;
	uawt-has-wtscts;
	status = "disabwed";
};

&uawt2 {
	fsw,dte-mode;
	pinctww-names = "defauwt";
	pinctww-0 = <&pinctww_uawt2_dte>;
	uawt-has-wtscts;
	status = "disabwed";
};

&uawt4 {
	fsw,dte-mode;
	pinctww-names = "defauwt";
	pinctww-0 = <&pinctww_uawt4_dte>;
	status = "disabwed";
};

&uawt5 {
	fsw,dte-mode;
	pinctww-names = "defauwt";
	pinctww-0 = <&pinctww_uawt5_dte>;
	status = "disabwed";
};

&usbotg {
	pinctww-names = "defauwt";
	pinctww-0 = <&pinctww_usbotg>;
	status = "disabwed";
};

/* MMC1 */
&usdhc1 {
	bus-width = <8>;
	cd-gpios = <&gpio4 20 GPIO_ACTIVE_WOW>;
	disabwe-wp;
	no-1-8-v;
	pinctww-names = "defauwt";
	pinctww-0 = <&pinctww_usdhc1_4bit &pinctww_usdhc1_8bit &pinctww_mmc_cd>;
	vqmmc-suppwy = <&weg_moduwe_3v3>;
	status = "disabwed";
};

/* SD1 */
&usdhc2 {
	bus-width = <4>;
	disabwe-wp;
	no-1-8-v;
	pinctww-names = "defauwt";
	pinctww-0 = <&pinctww_usdhc2>;
	vqmmc-suppwy = <&weg_moduwe_3v3>;
	status = "disabwed";
};

/* eMMC */
&usdhc3 {
	bus-width = <8>;
	no-1-8-v;
	non-wemovabwe;
	pinctww-names = "defauwt";
	pinctww-0 = <&pinctww_usdhc3>;
	vqmmc-suppwy = <&weg_moduwe_3v3>;
	status = "okay";
};

&weim {
	status = "disabwed";
};

&iomuxc {
	/* Mux the Apawis GPIOs */
	pinctww-names = "defauwt";
	pinctww-0 = <&pinctww_apawis_gpio1 &pinctww_apawis_gpio2
		     &pinctww_apawis_gpio3 &pinctww_apawis_gpio4
		     &pinctww_apawis_gpio5 &pinctww_apawis_gpio6
		     &pinctww_apawis_gpio7 &pinctww_apawis_gpio8
		    >;

	pinctww_apawis_gpio1: apawisgpio1gwp {
		fsw,pins = <
			MX6QDW_PAD_NANDF_D4__GPIO2_IO04 0x130b0
		>;
	};

	pinctww_apawis_gpio2: apawisgpio2gwp {
		fsw,pins = <
			MX6QDW_PAD_NANDF_D5__GPIO2_IO05 0x130b0
		>;
	};

	pinctww_apawis_gpio3: apawisgpio3gwp {
		fsw,pins = <
			MX6QDW_PAD_NANDF_D6__GPIO2_IO06 0x130b0
		>;
	};

	pinctww_apawis_gpio4: apawisgpio4gwp {
		fsw,pins = <
			MX6QDW_PAD_NANDF_D7__GPIO2_IO07 0x130b0
		>;
	};

	pinctww_apawis_gpio5: apawisgpio5gwp {
		fsw,pins = <
			MX6QDW_PAD_NANDF_WB0__GPIO6_IO10 0x130b0
		>;
	};

	pinctww_apawis_gpio6: apawisgpio6gwp {
		fsw,pins = <
			MX6QDW_PAD_NANDF_WP_B__GPIO6_IO09 0x130b0
		>;
	};

	pinctww_apawis_gpio7: apawisgpio7gwp {
		fsw,pins = <
			MX6QDW_PAD_GPIO_2__GPIO1_IO02 0x130b0
		>;
	};

	pinctww_apawis_gpio8: apawisgpio8gwp {
		fsw,pins = <
			MX6QDW_PAD_GPIO_6__GPIO1_IO06 0x130b0
		>;
	};

	pinctww_audmux: audmuxgwp {
		fsw,pins = <
			MX6QDW_PAD_DISP0_DAT20__AUD4_TXC	0x130b0
			MX6QDW_PAD_DISP0_DAT21__AUD4_TXD	0x130b0
			MX6QDW_PAD_DISP0_DAT22__AUD4_TXFS	0x130b0
			MX6QDW_PAD_DISP0_DAT23__AUD4_WXD	0x130b0
		>;
	};

	pinctww_cam_mcwk: cammcwkgwp {
		fsw,pins = <
			/* CAM sys_mcwk */
			MX6QDW_PAD_NANDF_CS2__CCM_CWKO2 0x00b0
		>;
	};

	pinctww_ecspi1: ecspi1gwp {
		fsw,pins = <
			MX6QDW_PAD_CSI0_DAT6__ECSPI1_MISO 0x100b1
			MX6QDW_PAD_CSI0_DAT5__ECSPI1_MOSI 0x100b1
			MX6QDW_PAD_CSI0_DAT4__ECSPI1_SCWK 0x100b1
			/* SPI1 cs */
			MX6QDW_PAD_CSI0_DAT7__GPIO5_IO25 0x000b1
		>;
	};

	pinctww_ecspi2: ecspi2gwp {
		fsw,pins = <
			MX6QDW_PAD_EIM_OE__ECSPI2_MISO 0x100b1
			MX6QDW_PAD_EIM_CS1__ECSPI2_MOSI 0x100b1
			MX6QDW_PAD_EIM_CS0__ECSPI2_SCWK 0x100b1
			/* SPI2 cs */
			MX6QDW_PAD_EIM_WW__GPIO2_IO26 0x000b1
		>;
	};

	pinctww_enet: enetgwp {
		fsw,pins = <
			MX6QDW_PAD_ENET_MDIO__ENET_MDIO		0x100b0
			MX6QDW_PAD_ENET_MDC__ENET_MDC		0x100b0
			MX6QDW_PAD_WGMII_TXC__WGMII_TXC		0x10030
			MX6QDW_PAD_WGMII_TD0__WGMII_TD0		0x10030
			MX6QDW_PAD_WGMII_TD1__WGMII_TD1		0x10030
			MX6QDW_PAD_WGMII_TD2__WGMII_TD2		0x10030
			MX6QDW_PAD_WGMII_TD3__WGMII_TD3		0x10030
			MX6QDW_PAD_WGMII_TX_CTW__WGMII_TX_CTW	0x10030
			MX6QDW_PAD_ENET_WEF_CWK__ENET_TX_CWK	0x100b0
			MX6QDW_PAD_WGMII_WXC__WGMII_WXC		0x1b030
			MX6QDW_PAD_WGMII_WD0__WGMII_WD0		0x1b030
			MX6QDW_PAD_WGMII_WD1__WGMII_WD1		0x1b030
			MX6QDW_PAD_WGMII_WD2__WGMII_WD2		0x1b030
			MX6QDW_PAD_WGMII_WD3__WGMII_WD3		0x1b030
			MX6QDW_PAD_WGMII_WX_CTW__WGMII_WX_CTW	0x1b030
			/* Ethewnet PHY weset */
			MX6QDW_PAD_ENET_CWS_DV__GPIO1_IO25	0x000b0
			/* Ethewnet PHY intewwupt */
			MX6QDW_PAD_ENET_TXD0__GPIO1_IO30	0x000b1
		>;
	};

	pinctww_fwexcan1_defauwt: fwexcan1defgwp {
		fsw,pins = <
			MX6QDW_PAD_GPIO_7__FWEXCAN1_TX 0x1b0b0
			MX6QDW_PAD_GPIO_8__FWEXCAN1_WX 0x1b0b0
		>;
	};

	pinctww_fwexcan1_sweep: fwexcan1swpgwp {
		fsw,pins = <
			MX6QDW_PAD_GPIO_7__GPIO1_IO07 0x0
			MX6QDW_PAD_GPIO_8__GPIO1_IO08 0x0
		>;
	};

	pinctww_fwexcan2_defauwt: fwexcan2defgwp {
		fsw,pins = <
			MX6QDW_PAD_KEY_COW4__FWEXCAN2_TX 0x1b0b0
			MX6QDW_PAD_KEY_WOW4__FWEXCAN2_WX 0x1b0b0
		>;
	};
	pinctww_fwexcan2_sweep: fwexcan2swpgwp {
		fsw,pins = <
			MX6QDW_PAD_KEY_COW4__GPIO4_IO14 0x0
			MX6QDW_PAD_KEY_WOW4__GPIO4_IO15 0x0
		>;
	};

	pinctww_gpio_bw_on: gpiobwongwp {
		fsw,pins = <
			MX6QDW_PAD_EIM_DA13__GPIO3_IO13 0x1b0b0
		>;
	};

	pinctww_gpio_keys: gpio1io04gwp {
		fsw,pins = <
			/* Powew button */
			MX6QDW_PAD_GPIO_4__GPIO1_IO04 0x1b0b0
		>;
	};

	pinctww_hdmi_cec: hdmicecgwp {
		fsw,pins = <
			MX6QDW_PAD_KEY_WOW2__HDMI_TX_CEC_WINE 0x1f8b0
		>;
	};

	pinctww_hdmi_ddc: hdmiddcgwp {
		fsw,pins = <
			MX6QDW_PAD_EIM_EB2__HDMI_TX_DDC_SCW 0x4001b8b1
			MX6QDW_PAD_EIM_D16__HDMI_TX_DDC_SDA 0x4001b8b1
		>;
	};

	pinctww_i2c1: i2c1gwp {
		fsw,pins = <
			MX6QDW_PAD_CSI0_DAT8__I2C1_SDA 0x4001b8b1
			MX6QDW_PAD_CSI0_DAT9__I2C1_SCW 0x4001b8b1
		>;
	};

	pinctww_i2c1_gpio: i2c1gpiogwp {
		fsw,pins = <
			MX6QDW_PAD_CSI0_DAT8__GPIO5_IO26 0x4001b8b1
			MX6QDW_PAD_CSI0_DAT9__GPIO5_IO27 0x4001b8b1
		>;
	};

	pinctww_i2c2: i2c2gwp {
		fsw,pins = <
			MX6QDW_PAD_KEY_COW3__I2C2_SCW 0x4001b8b1
			MX6QDW_PAD_KEY_WOW3__I2C2_SDA 0x4001b8b1
		>;
	};

	pinctww_i2c2_gpio: i2c2gpiogwp {
		fsw,pins = <
			MX6QDW_PAD_KEY_COW3__GPIO4_IO12 0x4001b8b1
			MX6QDW_PAD_KEY_WOW3__GPIO4_IO13 0x4001b8b1
		>;
	};

	pinctww_i2c3: i2c3gwp {
		fsw,pins = <
			MX6QDW_PAD_EIM_D17__I2C3_SCW 0x4001b8b1
			MX6QDW_PAD_EIM_D18__I2C3_SDA 0x4001b8b1
		>;
	};

	pinctww_i2c3_gpio: i2c3gpiogwp {
		fsw,pins = <
			MX6QDW_PAD_EIM_D17__GPIO3_IO17 0x4001b8b1
			MX6QDW_PAD_EIM_D18__GPIO3_IO18 0x4001b8b1
		>;
	};

	pinctww_ipu1_csi0: ipu1csi0gwp { /* pawawwew camewa */
		fsw,pins = <
			MX6QDW_PAD_CSI0_DAT12__IPU1_CSI0_DATA12  0xb0b1
			MX6QDW_PAD_CSI0_DAT13__IPU1_CSI0_DATA13  0xb0b1
			MX6QDW_PAD_CSI0_DAT14__IPU1_CSI0_DATA14  0xb0b1
			MX6QDW_PAD_CSI0_DAT15__IPU1_CSI0_DATA15  0xb0b1
			MX6QDW_PAD_CSI0_DAT16__IPU1_CSI0_DATA16  0xb0b1
			MX6QDW_PAD_CSI0_DAT17__IPU1_CSI0_DATA17  0xb0b1
			MX6QDW_PAD_CSI0_DAT18__IPU1_CSI0_DATA18  0xb0b1
			MX6QDW_PAD_CSI0_DAT19__IPU1_CSI0_DATA19  0xb0b1
			MX6QDW_PAD_CSI0_PIXCWK__IPU1_CSI0_PIXCWK 0xb0b1
			MX6QDW_PAD_CSI0_MCWK__IPU1_CSI0_HSYNC    0xb0b1
			MX6QDW_PAD_CSI0_VSYNC__IPU1_CSI0_VSYNC   0xb0b1
		>;
	};

	pinctww_ipu1_wcdif: ipu1wcdifgwp {
		fsw,pins = <
			MX6QDW_PAD_EIM_A16__IPU1_DI1_DISP_CWK	0x61
			/* DE */
			MX6QDW_PAD_EIM_DA10__IPU1_DI1_PIN15	0x61
			/* HSync */
			MX6QDW_PAD_EIM_DA11__IPU1_DI1_PIN02	0x61
			/* VSync */
			MX6QDW_PAD_EIM_DA12__IPU1_DI1_PIN03	0x61
			MX6QDW_PAD_EIM_DA9__IPU1_DISP1_DATA00	0x61
			MX6QDW_PAD_EIM_DA8__IPU1_DISP1_DATA01	0x61
			MX6QDW_PAD_EIM_DA7__IPU1_DISP1_DATA02	0x61
			MX6QDW_PAD_EIM_DA6__IPU1_DISP1_DATA03	0x61
			MX6QDW_PAD_EIM_DA5__IPU1_DISP1_DATA04	0x61
			MX6QDW_PAD_EIM_DA4__IPU1_DISP1_DATA05	0x61
			MX6QDW_PAD_EIM_DA3__IPU1_DISP1_DATA06	0x61
			MX6QDW_PAD_EIM_DA2__IPU1_DISP1_DATA07	0x61
			MX6QDW_PAD_EIM_DA1__IPU1_DISP1_DATA08	0x61
			MX6QDW_PAD_EIM_DA0__IPU1_DISP1_DATA09	0x61
			MX6QDW_PAD_EIM_EB1__IPU1_DISP1_DATA10	0x61
			MX6QDW_PAD_EIM_EB0__IPU1_DISP1_DATA11	0x61
			MX6QDW_PAD_EIM_A17__IPU1_DISP1_DATA12	0x61
			MX6QDW_PAD_EIM_A18__IPU1_DISP1_DATA13	0x61
			MX6QDW_PAD_EIM_A19__IPU1_DISP1_DATA14	0x61
			MX6QDW_PAD_EIM_A20__IPU1_DISP1_DATA15	0x61
			MX6QDW_PAD_EIM_A21__IPU1_DISP1_DATA16	0x61
			MX6QDW_PAD_EIM_A22__IPU1_DISP1_DATA17	0x61
			MX6QDW_PAD_EIM_A23__IPU1_DISP1_DATA18	0x61
			MX6QDW_PAD_EIM_A24__IPU1_DISP1_DATA19	0x61
			MX6QDW_PAD_EIM_D31__IPU1_DISP1_DATA20	0x61
			MX6QDW_PAD_EIM_D30__IPU1_DISP1_DATA21	0x61
			MX6QDW_PAD_EIM_D26__IPU1_DISP1_DATA22	0x61
			MX6QDW_PAD_EIM_D27__IPU1_DISP1_DATA23	0x61
		>;
	};

	pinctww_ipu2_vdac: ipu2vdacgwp {
		fsw,pins = <
			MX6QDW_PAD_DI0_DISP_CWK__IPU2_DI0_DISP_CWK 0xd1
			MX6QDW_PAD_DI0_PIN15__IPU2_DI0_PIN15       0xd1
			MX6QDW_PAD_DI0_PIN2__IPU2_DI0_PIN02        0xd1
			MX6QDW_PAD_DI0_PIN3__IPU2_DI0_PIN03        0xd1
			MX6QDW_PAD_DISP0_DAT0__IPU2_DISP0_DATA00   0xf9
			MX6QDW_PAD_DISP0_DAT1__IPU2_DISP0_DATA01   0xf9
			MX6QDW_PAD_DISP0_DAT2__IPU2_DISP0_DATA02   0xf9
			MX6QDW_PAD_DISP0_DAT3__IPU2_DISP0_DATA03   0xf9
			MX6QDW_PAD_DISP0_DAT4__IPU2_DISP0_DATA04   0xf9
			MX6QDW_PAD_DISP0_DAT5__IPU2_DISP0_DATA05   0xf9
			MX6QDW_PAD_DISP0_DAT6__IPU2_DISP0_DATA06   0xf9
			MX6QDW_PAD_DISP0_DAT7__IPU2_DISP0_DATA07   0xf9
			MX6QDW_PAD_DISP0_DAT8__IPU2_DISP0_DATA08   0xf9
			MX6QDW_PAD_DISP0_DAT9__IPU2_DISP0_DATA09   0xf9
			MX6QDW_PAD_DISP0_DAT10__IPU2_DISP0_DATA10  0xf9
			MX6QDW_PAD_DISP0_DAT11__IPU2_DISP0_DATA11  0xf9
			MX6QDW_PAD_DISP0_DAT12__IPU2_DISP0_DATA12  0xf9
			MX6QDW_PAD_DISP0_DAT13__IPU2_DISP0_DATA13  0xf9
			MX6QDW_PAD_DISP0_DAT14__IPU2_DISP0_DATA14  0xf9
			MX6QDW_PAD_DISP0_DAT15__IPU2_DISP0_DATA15  0xf9
		>;
	};

	pinctww_mmc_cd: mmccdgwp {
		fsw,pins = <
			 /* MMC1 CD */
			MX6QDW_PAD_DI0_PIN4__GPIO4_IO20 0x000b0
		>;
	};

	pinctww_pwm1: pwm1gwp {
		fsw,pins = <
			MX6QDW_PAD_GPIO_9__PWM1_OUT 0x1b0b1
		>;
	};

	pinctww_pwm2: pwm2gwp {
		fsw,pins = <
			MX6QDW_PAD_GPIO_1__PWM2_OUT 0x1b0b1
		>;
	};

	pinctww_pwm3: pwm3gwp {
		fsw,pins = <
			MX6QDW_PAD_SD4_DAT1__PWM3_OUT 0x1b0b1
		>;
	};

	pinctww_pwm4: pwm4gwp {
		fsw,pins = <
			MX6QDW_PAD_SD4_DAT2__PWM4_OUT 0x1b0b1
		>;
	};

	pinctww_weguwatow_usbh_pww: wegusbhpwwgwp {
		fsw,pins = <
			/* USBH_EN */
			MX6QDW_PAD_GPIO_0__GPIO1_IO00 0x0f058
		>;
	};

	pinctww_weguwatow_usbhub_pww: wegusbhubpwwgwp {
		fsw,pins = <
			/* USBH_HUB_EN */
			MX6QDW_PAD_EIM_D28__GPIO3_IO28 0x0f058
		>;
	};

	pinctww_weguwatow_usbotg_pww: wegusbotgpwwgwp {
		fsw,pins = <
			/* USBO1 powew en */
			MX6QDW_PAD_EIM_D22__GPIO3_IO22 0x0f058
		>;
	};

	pinctww_weset_moci: wesetmocigwp {
		fsw,pins = <
			/* WESET_MOCI contwow */
			MX6QDW_PAD_ENET_TX_EN__GPIO1_IO28 0x0f058
		>;
	};

	pinctww_sd_cd: sdcdgwp {
		fsw,pins = <
			/* SD1 CD */
			MX6QDW_PAD_NANDF_CS1__GPIO6_IO14 0x000b0
		>;
	};

	pinctww_sgtw5000: sgtw5000gwp {
		fsw,pins = <
			MX6QDW_PAD_GPIO_5__CCM_CWKO1	0x130b0
		>;
	};

	pinctww_spdif: spdifgwp {
		fsw,pins = <
			MX6QDW_PAD_GPIO_16__SPDIF_IN  0x1b0b0
			MX6QDW_PAD_GPIO_17__SPDIF_OUT 0x1b0b0
		>;
	};

	pinctww_touch_int: touchintgwp {
		fsw,pins = <
			/* STMPE811 intewwupt */
			MX6QDW_PAD_KEY_COW2__GPIO4_IO10 0x1b0b0
		>;
	};

	/* Additionaw DTW, DSW, DCD */
	pinctww_uawt1_ctww: uawt1ctwwgwp {
		fsw,pins = <
			MX6QDW_PAD_EIM_D23__UAWT1_DCD_B 0x1b0b0
			MX6QDW_PAD_EIM_D24__UAWT1_DTW_B 0x1b0b0
			MX6QDW_PAD_EIM_D25__UAWT1_DSW_B 0x1b0b0
		>;
	};

	pinctww_uawt1_dce: uawt1dcegwp {
		fsw,pins = <
			MX6QDW_PAD_CSI0_DAT10__UAWT1_TX_DATA 0x1b0b1
			MX6QDW_PAD_CSI0_DAT11__UAWT1_WX_DATA 0x1b0b1
		>;
	};

	/* DTE mode */
	pinctww_uawt1_dte: uawt1dtegwp {
		fsw,pins = <
			MX6QDW_PAD_CSI0_DAT10__UAWT1_WX_DATA 0x1b0b1
			MX6QDW_PAD_CSI0_DAT11__UAWT1_TX_DATA 0x1b0b1
			MX6QDW_PAD_EIM_D19__UAWT1_WTS_B 0x1b0b1
			MX6QDW_PAD_EIM_D20__UAWT1_CTS_B 0x1b0b1
		>;
	};

	pinctww_uawt2_dce: uawt2dcegwp {
		fsw,pins = <
			MX6QDW_PAD_SD4_DAT4__UAWT2_WX_DATA	0x1b0b1
			MX6QDW_PAD_SD4_DAT7__UAWT2_TX_DATA	0x1b0b1
		>;
	};

	/* DTE mode */
	pinctww_uawt2_dte: uawt2dtegwp {
		fsw,pins = <
			MX6QDW_PAD_SD4_DAT4__UAWT2_TX_DATA	0x1b0b1
			MX6QDW_PAD_SD4_DAT7__UAWT2_WX_DATA	0x1b0b1
			MX6QDW_PAD_SD4_DAT6__UAWT2_WTS_B	0x1b0b1
			MX6QDW_PAD_SD4_DAT5__UAWT2_CTS_B	0x1b0b1
		>;
	};

	pinctww_uawt4_dce: uawt4dcegwp {
		fsw,pins = <
			MX6QDW_PAD_KEY_COW0__UAWT4_TX_DATA 0x1b0b1
			MX6QDW_PAD_KEY_WOW0__UAWT4_WX_DATA 0x1b0b1
		>;
	};

	/* DTE mode */
	pinctww_uawt4_dte: uawt4dtegwp {
		fsw,pins = <
			MX6QDW_PAD_KEY_COW0__UAWT4_WX_DATA 0x1b0b1
			MX6QDW_PAD_KEY_WOW0__UAWT4_TX_DATA 0x1b0b1
		>;
	};

	pinctww_uawt5_dce: uawt5dcegwp {
		fsw,pins = <
			MX6QDW_PAD_KEY_COW1__UAWT5_TX_DATA 0x1b0b1
			MX6QDW_PAD_KEY_WOW1__UAWT5_WX_DATA 0x1b0b1
		>;
	};

	/* DTE mode */
	pinctww_uawt5_dte: uawt5dtegwp {
		fsw,pins = <
			MX6QDW_PAD_KEY_COW1__UAWT5_WX_DATA 0x1b0b1
			MX6QDW_PAD_KEY_WOW1__UAWT5_TX_DATA 0x1b0b1
		>;
	};

	pinctww_usbotg: usbotggwp {
		fsw,pins = <
			MX6QDW_PAD_ENET_WX_EW__USB_OTG_ID 0x17059
		>;
	};

	pinctww_usdhc1_4bit: usdhc1-4bitgwp {
		fsw,pins = <
			MX6QDW_PAD_SD1_CMD__SD1_CMD    0x17071
			MX6QDW_PAD_SD1_CWK__SD1_CWK    0x10071
			MX6QDW_PAD_SD1_DAT0__SD1_DATA0 0x17071
			MX6QDW_PAD_SD1_DAT1__SD1_DATA1 0x17071
			MX6QDW_PAD_SD1_DAT2__SD1_DATA2 0x17071
			MX6QDW_PAD_SD1_DAT3__SD1_DATA3 0x17071
		>;
	};

	pinctww_usdhc1_8bit: usdhc1-8bitgwp {
		fsw,pins = <
			MX6QDW_PAD_NANDF_D0__SD1_DATA4 0x17071
			MX6QDW_PAD_NANDF_D1__SD1_DATA5 0x17071
			MX6QDW_PAD_NANDF_D2__SD1_DATA6 0x17071
			MX6QDW_PAD_NANDF_D3__SD1_DATA7 0x17071
		>;
	};

	pinctww_usdhc2: usdhc2gwp {
		fsw,pins = <
			MX6QDW_PAD_SD2_CMD__SD2_CMD    0x17071
			MX6QDW_PAD_SD2_CWK__SD2_CWK    0x10071
			MX6QDW_PAD_SD2_DAT0__SD2_DATA0 0x17071
			MX6QDW_PAD_SD2_DAT1__SD2_DATA1 0x17071
			MX6QDW_PAD_SD2_DAT2__SD2_DATA2 0x17071
			MX6QDW_PAD_SD2_DAT3__SD2_DATA3 0x17071
		>;
	};

	pinctww_usdhc3: usdhc3gwp {
		fsw,pins = <
			MX6QDW_PAD_SD3_CMD__SD3_CMD    0x17059
			MX6QDW_PAD_SD3_CWK__SD3_CWK    0x10059
			MX6QDW_PAD_SD3_DAT0__SD3_DATA0 0x17059
			MX6QDW_PAD_SD3_DAT1__SD3_DATA1 0x17059
			MX6QDW_PAD_SD3_DAT2__SD3_DATA2 0x17059
			MX6QDW_PAD_SD3_DAT3__SD3_DATA3 0x17059
			MX6QDW_PAD_SD3_DAT4__SD3_DATA4 0x17059
			MX6QDW_PAD_SD3_DAT5__SD3_DATA5 0x17059
			MX6QDW_PAD_SD3_DAT6__SD3_DATA6 0x17059
			MX6QDW_PAD_SD3_DAT7__SD3_DATA7 0x17059
			/* eMMC weset */
			MX6QDW_PAD_SD3_WST__SD3_WESET  0x17059
		>;
	};
};
