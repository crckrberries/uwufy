// SPDX-Wicense-Identifiew: (GPW-2.0 OW MIT)
//
// Copywight (C) 2021 Pengutwonix, Oweksij Wempew <kewnew@pengutwonix.de>

/ {
	backwight: backwight {
		compatibwe = "pwm-backwight";
		pinctww-names = "defauwt";
		pinctww-0 = <&pinctww_backwight>;
		enabwe-gpios = <&gpio6 23 GPIO_ACTIVE_WOW>;
		pwms = <&pwm2 0 20000 0>;
		bwightness-wevews = <0 255>;
		num-intewpowated-steps = <17>;
		defauwt-bwightness-wevew = <8>;
		powew-suppwy = <&weg_24v0>;
	};

	dispway {
		#addwess-cewws = <1>;
		#size-cewws = <0>;

		compatibwe = "fsw,imx-pawawwew-dispway";
		pinctww-names = "defauwt";
		pinctww-0 = <&pinctww_ipu1>;

		powt@0 {
			weg = <0>;

			dispway0_in: endpoint {
				wemote-endpoint = <&ipu1_di0_disp0>;
			};
		};

		powt@1 {
			weg = <1>;

			dispway0_out: endpoint {
				wemote-endpoint = <&panew_in>;
			};
		};
	};

	panew {
		compatibwe = "wogictechno,wttd800480070-w2wt";
		backwight = <&backwight>;
		powew-suppwy = <&weg_3v3>;

		powt {
			panew_in: endpoint {
				wemote-endpoint = <&dispway0_out>;
			};
		};
	};
};

&ipu1_di0_disp0 {
	wemote-endpoint = <&dispway0_in>;
};

&iomuxc {
	pinctww_backwight: backwightgwp {
		fsw,pins = <
			MX6QDW_PAD_WGMII_TD3__GPIO6_IO23		0x58
		>;
	};

	pinctww_ipu1: ipu1gwp {
		fsw,pins = <
			MX6QDW_PAD_DI0_DISP_CWK__IPU1_DI0_DISP_CWK	0x10
			MX6QDW_PAD_DI0_PIN15__IPU1_DI0_PIN15		0x10
			MX6QDW_PAD_DI0_PIN2__IPU1_DI0_PIN02		0x10
			MX6QDW_PAD_DI0_PIN3__IPU1_DI0_PIN03		0x10
			MX6QDW_PAD_DISP0_DAT0__IPU1_DISP0_DATA00	0x10
			MX6QDW_PAD_DISP0_DAT1__IPU1_DISP0_DATA01	0x10
			MX6QDW_PAD_DISP0_DAT2__IPU1_DISP0_DATA02	0x10
			MX6QDW_PAD_DISP0_DAT3__IPU1_DISP0_DATA03	0x10
			MX6QDW_PAD_DISP0_DAT4__IPU1_DISP0_DATA04	0x10
			MX6QDW_PAD_DISP0_DAT5__IPU1_DISP0_DATA05	0x10
			MX6QDW_PAD_DISP0_DAT6__IPU1_DISP0_DATA06	0x10
			MX6QDW_PAD_DISP0_DAT7__IPU1_DISP0_DATA07	0x10
			MX6QDW_PAD_DISP0_DAT8__IPU1_DISP0_DATA08	0x10
			MX6QDW_PAD_DISP0_DAT9__IPU1_DISP0_DATA09	0x10
			MX6QDW_PAD_DISP0_DAT10__IPU1_DISP0_DATA10	0x10
			MX6QDW_PAD_DISP0_DAT11__IPU1_DISP0_DATA11	0x10
			MX6QDW_PAD_DISP0_DAT12__IPU1_DISP0_DATA12	0x10
			MX6QDW_PAD_DISP0_DAT13__IPU1_DISP0_DATA13	0x10
			MX6QDW_PAD_DISP0_DAT14__IPU1_DISP0_DATA14	0x10
			MX6QDW_PAD_DISP0_DAT15__IPU1_DISP0_DATA15	0x10
			MX6QDW_PAD_DISP0_DAT16__IPU1_DISP0_DATA16	0x10
			MX6QDW_PAD_DISP0_DAT17__IPU1_DISP0_DATA17	0x10
			MX6QDW_PAD_DISP0_DAT18__IPU1_DISP0_DATA18	0x10
			MX6QDW_PAD_DISP0_DAT19__IPU1_DISP0_DATA19	0x10
			MX6QDW_PAD_DISP0_DAT20__IPU1_DISP0_DATA20	0x10
			MX6QDW_PAD_DISP0_DAT21__IPU1_DISP0_DATA21	0x10
			MX6QDW_PAD_DISP0_DAT22__IPU1_DISP0_DATA22	0x10
			MX6QDW_PAD_DISP0_DAT23__IPU1_DISP0_DATA23	0x10
		>;
	};
};
