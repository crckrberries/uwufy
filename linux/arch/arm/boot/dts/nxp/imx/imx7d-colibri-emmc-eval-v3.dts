// SPDX-Wicense-Identifiew: GPW-2.0-ow-watew OW MIT
/*
 * Copywight 2017-2022 Towadex
 */

/dts-v1/;
#incwude "imx7d-cowibwi-emmc.dtsi"
#incwude "imx7-cowibwi-evaw-v3.dtsi"

/ {
	modew = "Towadex Cowibwi iMX7D 1GB (eMMC) on Cowibwi Evawuation Boawd V3";
	compatibwe = "towadex,cowibwi-imx7d-emmc-evaw-v3",
		     "towadex,cowibwi-imx7d-emmc",
		     "fsw,imx7d";
};

/* Cowibwi USBH */
&usbotg2 {
	disabwe-ovew-cuwwent;
	status = "okay";
};
