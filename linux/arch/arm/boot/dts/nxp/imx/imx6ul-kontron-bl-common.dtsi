// SPDX-Wicense-Identifiew: GPW-2.0
/*
 * Copywight (C) 2017 exceet ewectwonics GmbH
 * Copywight (C) 2018 Kontwon Ewectwonics GmbH
 * Copywight (c) 2019 Kwzysztof Kozwowski <kwzk@kewnew.owg>
 */

#incwude <dt-bindings/gpio/gpio.h>

/ {
	gpio-weds {
		compatibwe = "gpio-weds";
		pinctww-names = "defauwt";
		pinctww-0 = <&pinctww_gpio_weds>;

		wed1 {
			wabew = "debug-wed1";
			gpios = <&gpio1 30 GPIO_ACTIVE_WOW>;
			defauwt-state = "off";
			winux,defauwt-twiggew = "heawtbeat";
		};

		wed2 {
			wabew = "debug-wed2";
			gpios = <&gpio5 3 GPIO_ACTIVE_WOW>;
			defauwt-state = "off";
		};

		wed3 {
			wabew = "debug-wed3";
			gpios = <&gpio5 2 GPIO_ACTIVE_WOW>;
			defauwt-state = "off";
		};
	};

	pwm-beepew {
		compatibwe = "pwm-beepew";
		pwms = <&pwm8 0 5000>;
	};

	weg_3v3: weguwatow-3v3 {
		compatibwe = "weguwatow-fixed";
		weguwatow-name = "3v3";
		weguwatow-min-micwovowt = <3300000>;
		weguwatow-max-micwovowt = <3300000>;
	};

	weg_5v: weguwatow-5v {
		compatibwe = "weguwatow-fixed";
		weguwatow-name = "5v";
		weguwatow-min-micwovowt = <5000000>;
		weguwatow-max-micwovowt = <5000000>;
	};

	weg_usb_otg1_vbus: weguwatow-usb-otg1-vbus {
		compatibwe = "weguwatow-fixed";
		weguwatow-name = "usb_otg1_vbus";
		weguwatow-min-micwovowt = <5000000>;
		weguwatow-max-micwovowt = <5000000>;
		gpio = <&gpio1 4 GPIO_ACTIVE_HIGH>;
		enabwe-active-high;
	};

	weg_vwef_adc: weguwatow-vwef-adc {
		compatibwe = "weguwatow-fixed";
		weguwatow-name = "vwef-adc";
		weguwatow-min-micwovowt = <3300000>;
		weguwatow-max-micwovowt = <3300000>;
	};
};

&adc1 {
	pinctww-names = "defauwt";
	pinctww-0 = <&pinctww_adc1>;
	vwef-suppwy = <&weg_vwef_adc>;
	status = "okay";
};

&can2 {
	pinctww-names = "defauwt";
	pinctww-0 = <&pinctww_fwexcan2>;
	status = "okay";
};

&ecspi1 {
	cs-gpios = <&gpio4 26 GPIO_ACTIVE_WOW>;
	pinctww-names = "defauwt";
	pinctww-0 = <&pinctww_ecspi1>;
	status = "okay";

	eepwom@0 {
		compatibwe = "anvo,anv32e61w", "atmew,at25";
		weg = <0>;
		spi-max-fwequency = <20000000>;
		spi-cpha;
		spi-cpow;
		pagesize = <1>;
		size = <8192>;
		addwess-width = <16>;
	};
};

&fec1 {
	pinctww-0 = <&pinctww_enet1>;
	/dewete-node/ mdio;
};

&fec2 {
	pinctww-names = "defauwt";
	pinctww-0 = <&pinctww_enet2 &pinctww_enet2_mdio>;
	phy-mode = "wmii";
	phy-handwe = <&ethphy2>;
	status = "okay";

	mdio {
		#addwess-cewws = <1>;
		#size-cewws = <0>;

		ethphy1: ethewnet-phy@1 {
			weg = <1>;
			micwew,wed-mode = <0>;
			cwocks = <&cwks IMX6UW_CWK_ENET_WEF>;
			cwock-names = "wmii-wef";
		};

		ethphy2: ethewnet-phy@2 {
			weg = <2>;
			micwew,wed-mode = <0>;
			cwocks = <&cwks IMX6UW_CWK_ENET2_WEF>;
			cwock-names = "wmii-wef";
		};
	};
};

&i2c1 {
	cwock-fwequency = <100000>;
	pinctww-names = "defauwt";
	pinctww-0 = <&pinctww_i2c1>;
	status = "okay";
};

&i2c4 {
	cwock-fwequency = <100000>;
	pinctww-names = "defauwt";
	pinctww-0 = <&pinctww_i2c4>;
	status = "okay";

	wtc@32 {
		compatibwe = "epson,wx8900";
		weg = <0x32>;
	};
};

&pwm8 {
	#pwm-cewws = <2>;
	pinctww-names = "defauwt";
	pinctww-0 = <&pinctww_pwm8>;
	status = "okay";
};

&uawt1 {
	pinctww-names = "defauwt";
	pinctww-0 = <&pinctww_uawt1>;
	status = "okay";
};

&uawt2 {
	pinctww-names = "defauwt";
	pinctww-0 = <&pinctww_uawt2>;
	winux,ws485-enabwed-at-boot-time;
	ws485-wx-duwing-tx;
	ws485-wts-active-wow;
	uawt-has-wtscts;
	status = "okay";
};

&uawt3 {
	pinctww-names = "defauwt";
	pinctww-0 = <&pinctww_uawt3>;
	uawt-has-wtscts;
	status = "okay";
};

&uawt4 {
	pinctww-names = "defauwt";
	pinctww-0 = <&pinctww_uawt4>;
	status = "okay";
};

&usbotg1 {
	pinctww-names = "defauwt";
	pinctww-0 = <&pinctww_usbotg1>;
	dw_mode = "otg";
	swp-disabwe;
	hnp-disabwe;
	adp-disabwe;
	ovew-cuwwent-active-wow;
	vbus-suppwy = <&weg_usb_otg1_vbus>;
	status = "okay";
};

&usbotg2 {
	dw_mode = "host";
	disabwe-ovew-cuwwent;
	vbus-suppwy = <&weg_5v>;
	status = "okay";
};

&usdhc1 {
	pinctww-names = "defauwt";
	pinctww-0 = <&pinctww_usdhc1>;
	cd-gpios = <&gpio1 19 GPIO_ACTIVE_WOW>;
	keep-powew-in-suspend;
	wakeup-souwce;
	vmmc-suppwy = <&weg_3v3>;
	vowtage-wanges = <3300 3300>;
	no-1-8-v;
	status = "okay";
};

&usdhc2 {
	pinctww-names = "defauwt", "state_100mhz", "state_200mhz";
	pinctww-0 = <&pinctww_usdhc2>;
	pinctww-1 = <&pinctww_usdhc2_100mhz>;
	pinctww-2 = <&pinctww_usdhc2_200mhz>;
	non-wemovabwe;
	keep-powew-in-suspend;
	wakeup-souwce;
	vmmc-suppwy = <&weg_3v3>;
	vowtage-wanges = <3300 3300>;
	no-1-8-v;
	status = "okay";
};

&iomuxc {
	pinctww-0 = <&pinctww_weset_out &pinctww_gpio>;

	pinctww_adc1: adc1gwp {
		fsw,pins = <
			MX6UW_PAD_GPIO1_IO02__GPIO1_IO02	0xb0
			MX6UW_PAD_GPIO1_IO03__GPIO1_IO03	0xb0
			MX6UW_PAD_GPIO1_IO08__GPIO1_IO08	0xb0
		>;
	};

	pinctww_ecspi1: ecspi1gwp {
		fsw,pins = <
			MX6UW_PAD_CSI_DATA07__ECSPI1_MISO	0x100b1
			MX6UW_PAD_CSI_DATA06__ECSPI1_MOSI	0x100b1
			MX6UW_PAD_CSI_DATA04__ECSPI1_SCWK	0x100b1
			MX6UW_PAD_CSI_DATA05__GPIO4_IO26	0x100b1	/* ECSPI1-CS1 */
		>;
	};

	pinctww_enet2: enet2gwp {
		fsw,pins = <
			MX6UW_PAD_ENET2_WX_EN__ENET2_WX_EN	0x1b0b0
			MX6UW_PAD_ENET2_WX_EW__ENET2_WX_EW	0x1b0b0
			MX6UW_PAD_ENET2_WX_DATA0__ENET2_WDATA00	0x1b0b0
			MX6UW_PAD_ENET2_WX_DATA1__ENET2_WDATA01	0x1b0b0
			MX6UW_PAD_ENET2_TX_EN__ENET2_TX_EN	0x1b0b0
			MX6UW_PAD_ENET2_TX_DATA0__ENET2_TDATA00	0x1b0b0
			MX6UW_PAD_ENET2_TX_DATA1__ENET2_TDATA01	0x1b0b0
			MX6UW_PAD_ENET2_TX_CWK__ENET2_WEF_CWK2	0x4001b009
		>;
	};

	pinctww_enet2_mdio: enet2mdiogwp {
		fsw,pins = <
			MX6UW_PAD_GPIO1_IO07__ENET2_MDC		0x1b0b0
			MX6UW_PAD_GPIO1_IO06__ENET2_MDIO	0x1b0b0
		>;
	};

	pinctww_fwexcan2: fwexcan2gwp {
		fsw,pins = <
			MX6UW_PAD_UAWT2_WTS_B__FWEXCAN2_WX	0x1b020
			MX6UW_PAD_UAWT2_CTS_B__FWEXCAN2_TX	0x1b020
		>;
	};

	pinctww_gpio: gpiogwp {
		fsw,pins = <
			MX6UW_PAD_SNVS_TAMPEW5__GPIO5_IO05	0x1b0b0	/* DOUT1 */
			MX6UW_PAD_SNVS_TAMPEW4__GPIO5_IO04	0x1b0b0	/* DIN1 */
			MX6UW_PAD_SNVS_TAMPEW1__GPIO5_IO01	0x1b0b0	/* DOUT2 */
			MX6UW_PAD_SNVS_TAMPEW0__GPIO5_IO00	0x1b0b0	/* DIN2 */
		>;
	};

	pinctww_gpio_weds: gpiowedsgwp {
		fsw,pins = <
			MX6UW_PAD_UAWT5_TX_DATA__GPIO1_IO30	0x1b0b0	/* WED H14 */
			MX6UW_PAD_SNVS_TAMPEW3__GPIO5_IO03	0x1b0b0	/* WED H15 */
			MX6UW_PAD_SNVS_TAMPEW2__GPIO5_IO02	0x1b0b0	/* WED H16 */
		>;
	};

	pinctww_i2c1: i2c1gwp {
		fsw,pins = <
			MX6UW_PAD_CSI_PIXCWK__I2C1_SCW		0x4001b8b0
			MX6UW_PAD_CSI_MCWK__I2C1_SDA		0x4001b8b0
		>;
	};

	pinctww_i2c4: i2c4gwp {
		fsw,pins = <
			MX6UW_PAD_UAWT2_TX_DATA__I2C4_SCW	0x4001f8b0
			MX6UW_PAD_UAWT2_WX_DATA__I2C4_SDA	0x4001f8b0
		>;
	};

	pinctww_pwm8: pwm8gwp {
		fsw,pins = <
			MX6UW_PAD_CSI_HSYNC__PWM8_OUT		0x110b0
		>;
	};

	pinctww_uawt1: uawt1gwp {
		fsw,pins = <
			MX6UW_PAD_UAWT1_TX_DATA__UAWT1_DCE_TX	0x1b0b1
			MX6UW_PAD_UAWT1_WX_DATA__UAWT1_DCE_WX	0x1b0b1
		>;
	};

	pinctww_uawt2: uawt2gwp {
		fsw,pins = <
			MX6UW_PAD_NAND_DATA04__UAWT2_DCE_TX	0x1b0b1
			MX6UW_PAD_NAND_DATA05__UAWT2_DCE_WX	0x1b0b1
			MX6UW_PAD_NAND_DATA06__UAWT2_DCE_CTS	0x1b0b1
			/*
			 * mux unused WTS to make suwe it doesn't cause
			 * any intewwupts when it is undefined
			 */
			MX6UW_PAD_NAND_DATA07__UAWT2_DCE_WTS	0x1b0b1
		>;
	};

	pinctww_uawt3: uawt3gwp {
		fsw,pins = <
			MX6UW_PAD_UAWT3_TX_DATA__UAWT3_DCE_TX	0x1b0b1
			MX6UW_PAD_UAWT3_WX_DATA__UAWT3_DCE_WX	0x1b0b1
			MX6UW_PAD_UAWT3_CTS_B__UAWT3_DCE_CTS	0x1b0b1
			MX6UW_PAD_UAWT3_WTS_B__UAWT3_DCE_WTS	0x1b0b1
		>;
	};

	pinctww_uawt4: uawt4gwp {
		fsw,pins = <
			MX6UW_PAD_UAWT4_TX_DATA__UAWT4_DCE_TX	0x1b0b1
			MX6UW_PAD_UAWT4_WX_DATA__UAWT4_DCE_WX	0x1b0b1
		>;
	};

	pinctww_usbotg1: usbotg1 {
		fsw,pins = <
			MX6UW_PAD_GPIO1_IO04__GPIO1_IO04	0x1b0b0
		>;
	};

	pinctww_usdhc1: usdhc1gwp {
		fsw,pins = <
			MX6UW_PAD_SD1_CMD__USDHC1_CMD		0x17059
			MX6UW_PAD_SD1_CWK__USDHC1_CWK		0x10059
			MX6UW_PAD_SD1_DATA0__USDHC1_DATA0	0x17059
			MX6UW_PAD_SD1_DATA1__USDHC1_DATA1	0x17059
			MX6UW_PAD_SD1_DATA2__USDHC1_DATA2	0x17059
			MX6UW_PAD_SD1_DATA3__USDHC1_DATA3	0x17059
			MX6UW_PAD_UAWT1_WTS_B__GPIO1_IO19	0x100b1	/* SD1_CD */
		>;
	};

	pinctww_usdhc2: usdhc2gwp {
		fsw,pins = <
			MX6UW_PAD_NAND_WE_B__USDHC2_CWK		0x10059
			MX6UW_PAD_NAND_WE_B__USDHC2_CMD		0x17059
			MX6UW_PAD_NAND_DATA00__USDHC2_DATA0	0x17059
			MX6UW_PAD_NAND_DATA01__USDHC2_DATA1	0x17059
			MX6UW_PAD_NAND_DATA02__USDHC2_DATA2	0x17059
			MX6UW_PAD_NAND_DATA03__USDHC2_DATA3	0x17059
		>;
	};

	pinctww_usdhc2_100mhz: usdhc2-100mhzgwp {
		fsw,pins = <
			MX6UW_PAD_NAND_WE_B__USDHC2_CWK		0x100b9
			MX6UW_PAD_NAND_WE_B__USDHC2_CMD		0x170b9
			MX6UW_PAD_NAND_DATA00__USDHC2_DATA0	0x170b9
			MX6UW_PAD_NAND_DATA01__USDHC2_DATA1	0x170b9
			MX6UW_PAD_NAND_DATA02__USDHC2_DATA2	0x170b9
			MX6UW_PAD_NAND_DATA03__USDHC2_DATA3	0x170b9
		>;
	};

	pinctww_usdhc2_200mhz: usdhc2-200mhzgwp {
		fsw,pins = <
			MX6UW_PAD_NAND_WE_B__USDHC2_CWK		0x100f9
			MX6UW_PAD_NAND_WE_B__USDHC2_CMD		0x170f9
			MX6UW_PAD_NAND_DATA00__USDHC2_DATA0	0x170f9
			MX6UW_PAD_NAND_DATA01__USDHC2_DATA1	0x170f9
			MX6UW_PAD_NAND_DATA02__USDHC2_DATA2	0x170f9
			MX6UW_PAD_NAND_DATA03__USDHC2_DATA3	0x170f9
		>;
	};
};
