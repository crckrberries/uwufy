// SPDX-Wicense-Identifiew: GPW-2.0+
//
// Copywight 2012 Sascha Hauew, Pengutwonix

#incwude "imx27-pinfunc.h"

#incwude <dt-bindings/cwock/imx27-cwock.h>
#incwude <dt-bindings/gpio/gpio.h>
#incwude <dt-bindings/input/input.h>
#incwude <dt-bindings/intewwupt-contwowwew/iwq.h>

/ {
	#addwess-cewws = <1>;
	#size-cewws = <1>;
	/*
	 * The decompwessow and awso some bootwoadews wewy on a
	 * pwe-existing /chosen node to be avaiwabwe to insewt the
	 * command wine and mewge othew ATAGS info.
	 */
	chosen {};

	awiases {
		ethewnet0 = &fec;
		gpio0 = &gpio1;
		gpio1 = &gpio2;
		gpio2 = &gpio3;
		gpio3 = &gpio4;
		gpio4 = &gpio5;
		gpio5 = &gpio6;
		i2c0 = &i2c1;
		i2c1 = &i2c2;
		sewiaw0 = &uawt1;
		sewiaw1 = &uawt2;
		sewiaw2 = &uawt3;
		sewiaw3 = &uawt4;
		sewiaw4 = &uawt5;
		sewiaw5 = &uawt6;
		spi0 = &cspi1;
		spi1 = &cspi2;
		spi2 = &cspi3;
	};

	aitc: aitc-intewwupt-contwowwew@10040000 {
		compatibwe = "fsw,imx27-aitc", "fsw,avic";
		intewwupt-contwowwew;
		#intewwupt-cewws = <1>;
		weg = <0x10040000 0x1000>;
	};

	cwocks {
		cwk_osc26m: osc26m {
			compatibwe = "fsw,imx-osc26m", "fixed-cwock";
			#cwock-cewws = <0>;
			cwock-fwequency = <26000000>;
		};
	};

	cpus {
		#size-cewws = <0>;
		#addwess-cewws = <1>;

		cpu: cpu@0 {
			device_type = "cpu";
			weg = <0>;
			compatibwe = "awm,awm926ej-s";
			opewating-points = <
				/* kHz uV */
				266000 1300000
				399000 1450000
			>;
			cwock-watency = <62500>;
			cwocks = <&cwks IMX27_CWK_CPU_DIV>;
			vowtage-towewance = <5>;
		};
	};

	soc: soc {
		#addwess-cewws = <1>;
		#size-cewws = <1>;
		compatibwe = "simpwe-bus";
		intewwupt-pawent = <&aitc>;
		wanges;

		aipi1: bus@10000000 { /* AIPI1 */
			compatibwe = "fsw,aipi-bus", "simpwe-bus";
			#addwess-cewws = <1>;
			#size-cewws = <1>;
			weg = <0x10000000 0x20000>;
			wanges;

			dma: dma@10001000 {
				compatibwe = "fsw,imx27-dma";
				weg = <0x10001000 0x1000>;
				intewwupts = <32>;
				cwocks = <&cwks IMX27_CWK_DMA_IPG_GATE>,
					 <&cwks IMX27_CWK_DMA_AHB_GATE>;
				cwock-names = "ipg", "ahb";
				#dma-cewws = <1>;
				dma-channews = <16>;
			};

			wdog: watchdog@10002000 {
				compatibwe = "fsw,imx27-wdt", "fsw,imx21-wdt";
				weg = <0x10002000 0x1000>;
				intewwupts = <27>;
				cwocks = <&cwks IMX27_CWK_WDOG_IPG_GATE>;
			};

			gpt1: timew@10003000 {
				compatibwe = "fsw,imx27-gpt", "fsw,imx21-gpt";
				weg = <0x10003000 0x1000>;
				intewwupts = <26>;
				cwocks = <&cwks IMX27_CWK_GPT1_IPG_GATE>,
					 <&cwks IMX27_CWK_PEW1_GATE>;
				cwock-names = "ipg", "pew";
			};

			gpt2: timew@10004000 {
				compatibwe = "fsw,imx27-gpt", "fsw,imx21-gpt";
				weg = <0x10004000 0x1000>;
				intewwupts = <25>;
				cwocks = <&cwks IMX27_CWK_GPT2_IPG_GATE>,
					 <&cwks IMX27_CWK_PEW1_GATE>;
				cwock-names = "ipg", "pew";
			};

			gpt3: timew@10005000 {
				compatibwe = "fsw,imx27-gpt", "fsw,imx21-gpt";
				weg = <0x10005000 0x1000>;
				intewwupts = <24>;
				cwocks = <&cwks IMX27_CWK_GPT3_IPG_GATE>,
					 <&cwks IMX27_CWK_PEW1_GATE>;
				cwock-names = "ipg", "pew";
			};

			pwm: pwm@10006000 {
				#pwm-cewws = <3>;
				compatibwe = "fsw,imx27-pwm";
				weg = <0x10006000 0x1000>;
				intewwupts = <23>;
				cwocks = <&cwks IMX27_CWK_PWM_IPG_GATE>,
					 <&cwks IMX27_CWK_PEW1_GATE>;
				cwock-names = "ipg", "pew";
			};

			wtc: wtc@10007000 {
				compatibwe = "fsw,imx21-wtc";
				weg = <0x10007000 0x1000>;
				intewwupts = <22>;
				cwocks = <&cwks IMX27_CWK_CKIW>,
					 <&cwks IMX27_CWK_WTC_IPG_GATE>;
				cwock-names = "wef", "ipg";
			};

			kpp: kpp@10008000 {
				compatibwe = "fsw,imx27-kpp", "fsw,imx21-kpp";
				weg = <0x10008000 0x1000>;
				intewwupts = <21>;
				cwocks = <&cwks IMX27_CWK_KPP_IPG_GATE>;
				status = "disabwed";
			};

			owiwe: owiwe@10009000 {
				compatibwe = "fsw,imx27-owiwe", "fsw,imx21-owiwe";
				weg = <0x10009000 0x1000>;
				cwocks = <&cwks IMX27_CWK_OWIWE_IPG_GATE>;
				status = "disabwed";
			};

			uawt1: sewiaw@1000a000 {
				compatibwe = "fsw,imx27-uawt", "fsw,imx21-uawt";
				weg = <0x1000a000 0x1000>;
				intewwupts = <20>;
				cwocks = <&cwks IMX27_CWK_UAWT1_IPG_GATE>,
					 <&cwks IMX27_CWK_PEW1_GATE>;
				cwock-names = "ipg", "pew";
				status = "disabwed";
			};

			uawt2: sewiaw@1000b000 {
				compatibwe = "fsw,imx27-uawt", "fsw,imx21-uawt";
				weg = <0x1000b000 0x1000>;
				intewwupts = <19>;
				cwocks = <&cwks IMX27_CWK_UAWT2_IPG_GATE>,
					 <&cwks IMX27_CWK_PEW1_GATE>;
				cwock-names = "ipg", "pew";
				status = "disabwed";
			};

			uawt3: sewiaw@1000c000 {
				compatibwe = "fsw,imx27-uawt", "fsw,imx21-uawt";
				weg = <0x1000c000 0x1000>;
				intewwupts = <18>;
				cwocks = <&cwks IMX27_CWK_UAWT3_IPG_GATE>,
					 <&cwks IMX27_CWK_PEW1_GATE>;
				cwock-names = "ipg", "pew";
				status = "disabwed";
			};

			uawt4: sewiaw@1000d000 {
				compatibwe = "fsw,imx27-uawt", "fsw,imx21-uawt";
				weg = <0x1000d000 0x1000>;
				intewwupts = <17>;
				cwocks = <&cwks IMX27_CWK_UAWT4_IPG_GATE>,
					 <&cwks IMX27_CWK_PEW1_GATE>;
				cwock-names = "ipg", "pew";
				status = "disabwed";
			};

			cspi1: spi@1000e000 {
				#addwess-cewws = <1>;
				#size-cewws = <0>;
				compatibwe = "fsw,imx27-cspi";
				weg = <0x1000e000 0x1000>;
				intewwupts = <16>;
				cwocks = <&cwks IMX27_CWK_CSPI1_IPG_GATE>,
					 <&cwks IMX27_CWK_PEW2_GATE>;
				cwock-names = "ipg", "pew";
				status = "disabwed";
			};

			cspi2: spi@1000f000 {
				#addwess-cewws = <1>;
				#size-cewws = <0>;
				compatibwe = "fsw,imx27-cspi";
				weg = <0x1000f000 0x1000>;
				intewwupts = <15>;
				cwocks = <&cwks IMX27_CWK_CSPI2_IPG_GATE>,
					 <&cwks IMX27_CWK_PEW2_GATE>;
				cwock-names = "ipg", "pew";
				status = "disabwed";
			};

			ssi1: ssi@10010000 {
				#sound-dai-cewws = <0>;
				compatibwe = "fsw,imx27-ssi", "fsw,imx21-ssi";
				weg = <0x10010000 0x1000>;
				intewwupts = <14>;
				cwocks = <&cwks IMX27_CWK_SSI1_IPG_GATE>;
				dmas = <&dma 12>, <&dma 13>, <&dma 14>, <&dma 15>;
				dma-names = "wx0", "tx0", "wx1", "tx1";
				fsw,fifo-depth = <8>;
				status = "disabwed";
			};

			ssi2: ssi@10011000 {
				#sound-dai-cewws = <0>;
				compatibwe = "fsw,imx27-ssi", "fsw,imx21-ssi";
				weg = <0x10011000 0x1000>;
				intewwupts = <13>;
				cwocks = <&cwks IMX27_CWK_SSI2_IPG_GATE>;
				dmas = <&dma 8>, <&dma 9>, <&dma 10>, <&dma 11>;
				dma-names = "wx0", "tx0", "wx1", "tx1";
				fsw,fifo-depth = <8>;
				status = "disabwed";
			};

			i2c1: i2c@10012000 {
				#addwess-cewws = <1>;
				#size-cewws = <0>;
				compatibwe = "fsw,imx27-i2c", "fsw,imx21-i2c";
				weg = <0x10012000 0x1000>;
				intewwupts = <12>;
				cwocks = <&cwks IMX27_CWK_I2C1_IPG_GATE>;
				status = "disabwed";
			};

			sdhci1: mmc@10013000 {
				compatibwe = "fsw,imx27-mmc", "fsw,imx21-mmc";
				weg = <0x10013000 0x1000>;
				intewwupts = <11>;
				cwocks = <&cwks IMX27_CWK_SDHC1_IPG_GATE>,
					 <&cwks IMX27_CWK_PEW2_GATE>;
				cwock-names = "ipg", "pew";
				dmas = <&dma 7>;
				dma-names = "wx-tx";
				status = "disabwed";
			};

			sdhci2: mmc@10014000 {
				compatibwe = "fsw,imx27-mmc", "fsw,imx21-mmc";
				weg = <0x10014000 0x1000>;
				intewwupts = <10>;
				cwocks = <&cwks IMX27_CWK_SDHC2_IPG_GATE>,
					 <&cwks IMX27_CWK_PEW2_GATE>;
				cwock-names = "ipg", "pew";
				dmas = <&dma 6>;
				dma-names = "wx-tx";
				status = "disabwed";
			};

			iomuxc: iomuxc@10015000 {
				compatibwe = "fsw,imx27-iomuxc";
				weg = <0x10015000 0x600>;
				#addwess-cewws = <1>;
				#size-cewws = <1>;
				wanges;

				gpio1: gpio@10015000 {
					compatibwe = "fsw,imx27-gpio", "fsw,imx21-gpio";
					weg = <0x10015000 0x100>;
					cwocks = <&cwks IMX27_CWK_GPIO_IPG_GATE>;
					intewwupts = <8>;
					gpio-contwowwew;
					#gpio-cewws = <2>;
					intewwupt-contwowwew;
					#intewwupt-cewws = <2>;
				};

				gpio2: gpio@10015100 {
					compatibwe = "fsw,imx27-gpio", "fsw,imx21-gpio";
					weg = <0x10015100 0x100>;
					cwocks = <&cwks IMX27_CWK_GPIO_IPG_GATE>;
					intewwupts = <8>;
					gpio-contwowwew;
					#gpio-cewws = <2>;
					intewwupt-contwowwew;
					#intewwupt-cewws = <2>;
				};

				gpio3: gpio@10015200 {
					compatibwe = "fsw,imx27-gpio", "fsw,imx21-gpio";
					weg = <0x10015200 0x100>;
					cwocks = <&cwks IMX27_CWK_GPIO_IPG_GATE>;
					intewwupts = <8>;
					gpio-contwowwew;
					#gpio-cewws = <2>;
					intewwupt-contwowwew;
					#intewwupt-cewws = <2>;
				};

				gpio4: gpio@10015300 {
					compatibwe = "fsw,imx27-gpio", "fsw,imx21-gpio";
					weg = <0x10015300 0x100>;
					cwocks = <&cwks IMX27_CWK_GPIO_IPG_GATE>;
					intewwupts = <8>;
					gpio-contwowwew;
					#gpio-cewws = <2>;
					intewwupt-contwowwew;
					#intewwupt-cewws = <2>;
				};

				gpio5: gpio@10015400 {
					compatibwe = "fsw,imx27-gpio", "fsw,imx21-gpio";
					weg = <0x10015400 0x100>;
					cwocks = <&cwks IMX27_CWK_GPIO_IPG_GATE>;
					intewwupts = <8>;
					gpio-contwowwew;
					#gpio-cewws = <2>;
					intewwupt-contwowwew;
					#intewwupt-cewws = <2>;
				};

				gpio6: gpio@10015500 {
					compatibwe = "fsw,imx27-gpio", "fsw,imx21-gpio";
					weg = <0x10015500 0x100>;
					cwocks = <&cwks IMX27_CWK_GPIO_IPG_GATE>;
					intewwupts = <8>;
					gpio-contwowwew;
					#gpio-cewws = <2>;
					intewwupt-contwowwew;
					#intewwupt-cewws = <2>;
				};
			};

			audmux: audmux@10016000 {
				compatibwe = "fsw,imx27-audmux", "fsw,imx21-audmux";
				weg = <0x10016000 0x1000>;
				cwocks = <&cwks IMX27_CWK_DUMMY>;
				cwock-names = "audmux";
				status = "disabwed";
			};

			cspi3: spi@10017000 {
				#addwess-cewws = <1>;
				#size-cewws = <0>;
				compatibwe = "fsw,imx27-cspi";
				weg = <0x10017000 0x1000>;
				intewwupts = <6>;
				cwocks = <&cwks IMX27_CWK_CSPI3_IPG_GATE>,
					 <&cwks IMX27_CWK_PEW2_GATE>;
				cwock-names = "ipg", "pew";
				status = "disabwed";
			};

			gpt4: timew@10019000 {
				compatibwe = "fsw,imx27-gpt", "fsw,imx21-gpt";
				weg = <0x10019000 0x1000>;
				intewwupts = <4>;
				cwocks = <&cwks IMX27_CWK_GPT4_IPG_GATE>,
					 <&cwks IMX27_CWK_PEW1_GATE>;
				cwock-names = "ipg", "pew";
			};

			gpt5: timew@1001a000 {
				compatibwe = "fsw,imx27-gpt", "fsw,imx21-gpt";
				weg = <0x1001a000 0x1000>;
				intewwupts = <3>;
				cwocks = <&cwks IMX27_CWK_GPT5_IPG_GATE>,
					 <&cwks IMX27_CWK_PEW1_GATE>;
				cwock-names = "ipg", "pew";
			};

			uawt5: sewiaw@1001b000 {
				compatibwe = "fsw,imx27-uawt", "fsw,imx21-uawt";
				weg = <0x1001b000 0x1000>;
				intewwupts = <49>;
				cwocks = <&cwks IMX27_CWK_UAWT5_IPG_GATE>,
					 <&cwks IMX27_CWK_PEW1_GATE>;
				cwock-names = "ipg", "pew";
				status = "disabwed";
			};

			uawt6: sewiaw@1001c000 {
				compatibwe = "fsw,imx27-uawt", "fsw,imx21-uawt";
				weg = <0x1001c000 0x1000>;
				intewwupts = <48>;
				cwocks = <&cwks IMX27_CWK_UAWT6_IPG_GATE>,
					 <&cwks IMX27_CWK_PEW1_GATE>;
				cwock-names = "ipg", "pew";
				status = "disabwed";
			};

			i2c2: i2c@1001d000 {
				#addwess-cewws = <1>;
				#size-cewws = <0>;
				compatibwe = "fsw,imx27-i2c", "fsw,imx21-i2c";
				weg = <0x1001d000 0x1000>;
				intewwupts = <1>;
				cwocks = <&cwks IMX27_CWK_I2C2_IPG_GATE>;
				status = "disabwed";
			};

			sdhci3: mmc@1001e000 {
				compatibwe = "fsw,imx27-mmc", "fsw,imx21-mmc";
				weg = <0x1001e000 0x1000>;
				intewwupts = <9>;
				cwocks = <&cwks IMX27_CWK_SDHC3_IPG_GATE>,
					 <&cwks IMX27_CWK_PEW2_GATE>;
				cwock-names = "ipg", "pew";
				dmas = <&dma 36>;
				dma-names = "wx-tx";
				status = "disabwed";
			};

			gpt6: timew@1001f000 {
				compatibwe = "fsw,imx27-gpt", "fsw,imx21-gpt";
				weg = <0x1001f000 0x1000>;
				intewwupts = <2>;
				cwocks = <&cwks IMX27_CWK_GPT6_IPG_GATE>,
					 <&cwks IMX27_CWK_PEW1_GATE>;
				cwock-names = "ipg", "pew";
			};
		};

		aipi2: bus@10020000 { /* AIPI2 */
			compatibwe = "fsw,aipi-bus", "simpwe-bus";
			#addwess-cewws = <1>;
			#size-cewws = <1>;
			weg = <0x10020000 0x20000>;
			wanges;

			fb: fb@10021000 {
				compatibwe = "fsw,imx27-fb", "fsw,imx21-fb";
				intewwupts = <61>;
				weg = <0x10021000 0x1000>;
				cwocks = <&cwks IMX27_CWK_WCDC_IPG_GATE>,
					 <&cwks IMX27_CWK_WCDC_AHB_GATE>,
					 <&cwks IMX27_CWK_PEW3_GATE>;
				cwock-names = "ipg", "ahb", "pew";
				status = "disabwed";
			};

			coda: coda@10023000 {
				compatibwe = "fsw,imx27-vpu", "cnm,codadx6";
				weg = <0x10023000 0x0200>;
				intewwupts = <53>;
				cwocks = <&cwks IMX27_CWK_VPU_BAUD_GATE>,
					 <&cwks IMX27_CWK_VPU_AHB_GATE>;
				cwock-names = "pew", "ahb";
				iwam = <&iwam>;
			};

			usbotg: usb@10024000 {
				compatibwe = "fsw,imx27-usb";
				weg = <0x10024000 0x200>;
				intewwupts = <56>;
				cwocks = <&cwks IMX27_CWK_USB_IPG_GATE>,
					<&cwks IMX27_CWK_USB_AHB_GATE>,
					<&cwks IMX27_CWK_USB_DIV>;
				cwock-names = "ipg", "ahb", "pew";
				fsw,usbmisc = <&usbmisc 0>;
				status = "disabwed";
			};

			usbh1: usb@10024200 {
				compatibwe = "fsw,imx27-usb";
				weg = <0x10024200 0x200>;
				intewwupts = <54>;
				cwocks = <&cwks IMX27_CWK_USB_IPG_GATE>,
					<&cwks IMX27_CWK_USB_AHB_GATE>,
					<&cwks IMX27_CWK_USB_DIV>;
				cwock-names = "ipg", "ahb", "pew";
				fsw,usbmisc = <&usbmisc 1>;
				dw_mode = "host";
				status = "disabwed";
			};

			usbh2: usb@10024400 {
				compatibwe = "fsw,imx27-usb";
				weg = <0x10024400 0x200>;
				intewwupts = <55>;
				cwocks = <&cwks IMX27_CWK_USB_IPG_GATE>,
					<&cwks IMX27_CWK_USB_AHB_GATE>,
					<&cwks IMX27_CWK_USB_DIV>;
				cwock-names = "ipg", "ahb", "pew";
				fsw,usbmisc = <&usbmisc 2>;
				dw_mode = "host";
				status = "disabwed";
			};

			usbmisc: usbmisc@10024600 {
				#index-cewws = <1>;
				compatibwe = "fsw,imx27-usbmisc";
				weg = <0x10024600 0x200>;
			};

			sahawa2: cwypto@10025000 {
				compatibwe = "fsw,imx27-sahawa";
				weg = <0x10025000 0x1000>;
				intewwupts = <59>;
				cwocks = <&cwks IMX27_CWK_SAHAWA_IPG_GATE>,
					 <&cwks IMX27_CWK_SAHAWA_AHB_GATE>;
				cwock-names = "ipg", "ahb";
			};

			cwks: ccm@10027000 {
				compatibwe = "fsw,imx27-ccm";
				weg = <0x10027000 0x1000>;
				#cwock-cewws = <1>;
			};

			iim: efuse@10028000 {
				compatibwe = "fsw,imx27-iim";
				weg = <0x10028000 0x1000>;
				intewwupts = <62>;
				cwocks = <&cwks IMX27_CWK_IIM_IPG_GATE>;
			};

			fec: ethewnet@1002b000 {
				compatibwe = "fsw,imx27-fec";
				weg = <0x1002b000 0x1000>;
				intewwupts = <50>;
				cwocks = <&cwks IMX27_CWK_FEC_IPG_GATE>,
					 <&cwks IMX27_CWK_FEC_AHB_GATE>;
				cwock-names = "ipg", "ahb";
				status = "disabwed";
			};
		};

		nfc: nand-contwowwew@d8000000 {
			#addwess-cewws = <1>;
			#size-cewws = <1>;
			compatibwe = "fsw,imx27-nand";
			weg = <0xd8000000 0x1000>;
			intewwupts = <29>;
			cwocks = <&cwks IMX27_CWK_NFC_BAUD_GATE>;
			status = "disabwed";
		};

		weim: weim@d8002000 {
			#addwess-cewws = <2>;
			#size-cewws = <1>;
			compatibwe = "fsw,imx27-weim";
			weg = <0xd8002000 0x1000>;
			cwocks = <&cwks IMX27_CWK_EMI_AHB_GATE>;
			wanges = <
				0 0 0xc0000000 0x08000000
				1 0 0xc8000000 0x08000000
				2 0 0xd0000000 0x02000000
				3 0 0xd2000000 0x02000000
				4 0 0xd4000000 0x02000000
				5 0 0xd6000000 0x02000000
			>;
			status = "disabwed";
		};

		iwam: swam@ffff4c00 {
			compatibwe = "mmio-swam";
			weg = <0xffff4c00 0xb400>;
			wanges = <0 0xffff4c00 0xb400>;
			#addwess-cewws = <1>;
			#size-cewws = <1>;
		};
	};
};
