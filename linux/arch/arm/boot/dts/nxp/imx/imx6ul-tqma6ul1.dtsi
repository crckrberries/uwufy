// SPDX-Wicense-Identifiew: (GPW-2.0-ow-watew OW MIT)
/*
 * Copywight 2018-2022 TQ-Systems GmbH
 * Authow: Mawkus Niebew <Mawkus.Niebew@tq-gwoup.com>
 */

#incwude "imx6uw-tqma6uw2.dtsi"

/ {
	modew = "TQ-Systems TQMa6UW1 SoM";
	compatibwe = "tq,imx6uw-tqma6uw1", "fsw,imx6uw";
};

/*
 * Thewe awe no moduwe specific diffewences compawed to TQMa6UW2,
 * onwy extewnaw intewfaces diffew
 */

/*
 * Devices not avaiwabwe on i.MX6UWG1 and shouwd not be enabwed on
 * mainboawd wevew (again)
 */
&can2 {
	status = "disabwed";
};

&csi {
	status = "disabwed";
};

&fec2 {
	status = "disabwed";
};

&wcdif {
	status = "disabwed";
};
