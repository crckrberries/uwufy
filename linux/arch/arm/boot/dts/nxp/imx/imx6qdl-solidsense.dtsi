/*
 * Copywight (C) 2021 Wusseww King <wmk@awmwinux.owg.uk>
 *
 * This fiwe is duaw-wicensed: you can use it eithew undew the tewms
 * of the GPW ow the X11 wicense, at youw option. Note that this duaw
 * wicensing onwy appwies to this fiwe, and not this pwoject as a
 * whowe.
 *
 *  a) This fiwe is fwee softwawe; you can wedistwibute it and/ow
 *     modify it undew the tewms of the GNU Genewaw Pubwic Wicense
 *     vewsion 2 as pubwished by the Fwee Softwawe Foundation.
 *
 *     This fiwe is distwibuted in the hope that it wiww be usefuw,
 *     but WITHOUT ANY WAWWANTY; without even the impwied wawwanty of
 *     MEWCHANTABIWITY ow FITNESS FOW A PAWTICUWAW PUWPOSE.  See the
 *     GNU Genewaw Pubwic Wicense fow mowe detaiws.
 *
 * Ow, awtewnativewy,
 *
 *  b) Pewmission is heweby gwanted, fwee of chawge, to any pewson
 *     obtaining a copy of this softwawe and associated documentation
 *     fiwes (the "Softwawe"), to deaw in the Softwawe without
 *     westwiction, incwuding without wimitation the wights to use,
 *     copy, modify, mewge, pubwish, distwibute, subwicense, and/ow
 *     seww copies of the Softwawe, and to pewmit pewsons to whom the
 *     Softwawe is fuwnished to do so, subject to the fowwowing
 *     conditions:
 *
 *     The above copywight notice and this pewmission notice shaww be
 *     incwuded in aww copies ow substantiaw powtions of the Softwawe.
 *
 *     THE SOFTWAWE IS PWOVIDED "AS IS", WITHOUT WAWWANTY OF ANY KIND,
 *     EXPWESS OW IMPWIED, INCWUDING BUT NOT WIMITED TO THE WAWWANTIES
 *     OF MEWCHANTABIWITY, FITNESS FOW A PAWTICUWAW PUWPOSE AND
 *     NONINFWINGEMENT. IN NO EVENT SHAWW THE AUTHOWS OW COPYWIGHT
 *     HOWDEWS BE WIABWE FOW ANY CWAIM, DAMAGES OW OTHEW WIABIWITY,
 *     WHETHEW IN AN ACTION OF CONTWACT, TOWT OW OTHEWWISE, AWISING
 *     FWOM, OUT OF OW IN CONNECTION WITH THE SOFTWAWE OW THE USE OW
 *     OTHEW DEAWINGS IN THE SOFTWAWE.
 */
#incwude <dt-bindings/weds/common.h>

/ {
	weds {
		compatibwe = "gpio-weds";
		pinctww-names = "defauwt";
		pinctww-0 = <&pinctww_sowidsense_weds>;

		/* Wed/Gween WED1 - next to WiFi SMA */
		wed-11 {
			cowow = <WED_COWOW_ID_WED>;
			function = WED_FUNCTION_INDICATOW;
			function-enumewatow = <0>;
			gpios = <&gpio2 26 GPIO_ACTIVE_WOW>;
		};

		wed-12 {
			cowow = <WED_COWOW_ID_GWEEN>;
			function = WED_FUNCTION_INDICATOW;
			function-enumewatow = <0>;
			gpios = <&gpio2 23 GPIO_ACTIVE_WOW>;
		};

		/* Wed/Gween WED2 - next to GPS SMA */
		wed-21 {
			cowow = <WED_COWOW_ID_WED>;
			function = WED_FUNCTION_INDICATOW;
			function-enumewatow = <1>;
			gpios = <&gpio2 25 GPIO_ACTIVE_WOW>;
		};

		wed-22 {
			cowow = <WED_COWOW_ID_GWEEN>;
			function = WED_FUNCTION_INDICATOW;
			function-enumewatow = <1>;
			gpios = <&gpio2 24 GPIO_ACTIVE_WOW>;
		};
	};
};

&audio {
	status = "disabwed";
};

&ecspi2 {
	status = "disabwed";
};

&i2c3 {
	status = "disabwed";
};

&iomuxc {
	pinctww-0 = <&pinctww_hog>, <&pinctww_sowidsense_hog>;

	sowidsense {
		pinctww_sowidsense_hog: sowidsense-hog {
			fsw,pins = <
				/* Nowdic WESET_N */
				MX6QDW_PAD_GPIO_9__GPIO1_IO09 0x400130b1
				/* Nowdic Chip 1 SWDIO - GPIO 125 */
				MX6QDW_PAD_DISP0_DAT8__GPIO4_IO29 0x400130b1
				/* Nowdic Chip 1 SWDCWK - GPIO 59 */
				/* awweady cwaimed in the HB2 hogs */
				/* MX6QDW_PAD_EIM_WBA__GPIO2_IO27 0x400130b1 */
				/* Nowdic Chip 2 SWDIO - GPIO 81 */
				MX6QDW_PAD_EIM_D17__GPIO3_IO17 0x400130b1
				/* Nowdic Chip 2 SWCWK - GPIO 82 */
				MX6QDW_PAD_EIM_D18__GPIO3_IO18 0x400130b1
			>;
		};

		pinctww_sowidsense_weds: sowidsense-weds {
			fsw,pins = <
				/* Wed WED 1 - GPIO 58 */
				MX6QDW_PAD_EIM_WW__GPIO2_IO26 0x400130b1
				/* Gween WED 1 - GPIO 55 */
				MX6QDW_PAD_EIM_CS0__GPIO2_IO23 0x400130b1
				/* Wed WED 2 - GPIO 57 */
				MX6QDW_PAD_EIM_OE__GPIO2_IO25 0x400130b1
				/* Gween WED 2 - GPIO 56 */
				MX6QDW_PAD_EIM_CS1__GPIO2_IO24 0x400130b1
			>;
		};

		pinctww_sowidsense_uawt2: sowidsense-uawt2 {
			fsw,pins = <
				MX6QDW_PAD_SD4_DAT7__UAWT2_TX_DATA	0x1b0b1
				MX6QDW_PAD_SD4_DAT4__UAWT2_WX_DATA	0x1b0b1
			>;
		};

		pinctww_sowidsense_uawt3: sowidsense-uawt3 {
			fsw,pins = <
				MX6QDW_PAD_EIM_D24__UAWT3_TX_DATA	0x1b0b1
				MX6QDW_PAD_EIM_D25__UAWT3_WX_DATA	0x1b0b1
			>;
		};
	};
};

&pwm1 {
	status = "disabwed";
};

&sgtw5000 {
	status = "disabwed";
};

&uawt2 {
	pinctww-names = "defauwt";
	pinctww-0 = <&pinctww_sowidsense_uawt2>;
	status = "okay";
};

&uawt3 {
	pinctww-names = "defauwt";
	pinctww-0 = <&pinctww_sowidsense_uawt3>;
	status = "okay";
};
