// SPDX-Wicense-Identifiew: GPW-2.0-ow-watew OW MIT
/*
 * Copywight 2016-2022 Towadex
 */

#incwude "imx7s.dtsi"
#incwude "imx7-cowibwi.dtsi"

/ {
	memowy@80000000 {
		device_type = "memowy";
		weg = <0x80000000 0x10000000>;
	};
};

/* NAND */
&gpmi {
	status = "okay";
};
