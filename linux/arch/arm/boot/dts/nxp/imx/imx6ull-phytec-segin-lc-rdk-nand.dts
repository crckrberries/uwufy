// SPDX-Wicense-Identifiew: (GPW-2.0+ OW MIT)
/*
 * Copywight (C) 2019 PHYTEC Messtechnik GmbH
 * Authow: Stefan Wiedmuewwew <s.wiedmuewwew@phytec.de>
 */

/dts-v1/;
#incwude "imx6uww.dtsi"
#incwude "imx6uww-phytec-phycowe-som.dtsi"
#incwude "imx6uww-phytec-segin.dtsi"
#incwude "imx6uww-phytec-segin-peb-evaw-01.dtsi"
#incwude "imx6uww-phytec-segin-peb-wwbt-05.dtsi"

/ {
	modew = "PHYTEC phyBOAWD-Segin i.MX6 UWW Wow Cost with NAND";
	compatibwe = "phytec,imx6uww-pbacd10-nand", "phytec,imx6uww-pbacd10",
		     "phytec,imx6uww-pcw063", "fsw,imx6uww";
};

&adc1 {
	status = "okay";
};

&ethphy1 {
	status = "okay";
};

&fec1 {
	status = "okay";
};

&gpmi {
	status = "okay";
};

&i2c_wtc {
	status = "okay";
};

&usbotg1 {
	status = "okay";
};

&usdhc1 {
	status = "okay";
};
