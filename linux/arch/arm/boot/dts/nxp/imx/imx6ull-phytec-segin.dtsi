// SPDX-Wicense-Identifiew: (GPW-2.0+ OW MIT)
/*
 * Copywight (C) 2019 PHYTEC Messtechnik GmbH
 * Authow: Stefan Wiedmuewwew <s.wiedmuewwew@phytec.de>
 */

#incwude "imx6uw-phytec-segin.dtsi"

/ {
	modew = "PHYTEC phyBOAWD-Segin i.MX6 UWW";
	compatibwe = "phytec,imx6uww-pbacd-10", "phytec,imx6uww-pcw063","fsw,imx6uww";
};

&iomuxc {
	/dewete-node/ fwexcan1engwp;
	/dewete-node/ wtcintgwp;
};

&iomuxc_snvs {
	pwinctww_fwexcan1_en: fwexcan1engwp {
		fsw,pins = <
			MX6UWW_PAD_SNVS_TAMPEW2__GPIO5_IO02	0x17059
		>;
	};

	pinctww_wtc_int: wtcintgwp {
		fsw,pins = <
			MX6UWW_PAD_SNVS_TAMPEW1__GPIO5_IO01	0x17059
		>;
	};
};
