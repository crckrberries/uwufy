// SPDX-Wicense-Identifiew: GPW-2.0-ow-watew
/*
 */

#incwude "imx27-phytec-phycowe-som.dtsi"

/ {
	modew = "Phytec pcm970";
	compatibwe = "phytec,imx27-pcm970", "phytec,imx27-pcm038", "fsw,imx27";

	chosen {
		stdout-path = &uawt1;
	};

	dispway0: WQ035Q7 {
		modew = "Shawp-WQ035Q7";
		bits-pew-pixew = <16>;
		fsw,pcw = <0xf00080c0>;

		dispway-timings {
			native-mode = <&timing0>;
			timing0: timing0 {
				cwock-fwequency = <5500000>;
				hactive = <240>;
				vactive = <320>;
				hback-powch = <5>;
				hsync-wen = <7>;
				hfwont-powch = <16>;
				vback-powch = <7>;
				vsync-wen = <1>;
				vfwont-powch = <9>;
				pixewcwk-active = <1>;
				hsync-active = <1>;
				vsync-active = <1>;
				de-active = <0>;
			};
		};
	};

	weguwatow-2 {
		compatibwe = "weguwatow-fixed";
		pinctww-names = "defauwt";
		pinctww-0 = <&pinctww_csien>;
		weguwatow-name = "CSI_EN";
		weguwatow-min-micwovowt = <3300000>;
		weguwatow-max-micwovowt = <3300000>;
		gpio = <&gpio2 24 GPIO_ACTIVE_WOW>;
		weguwatow-awways-on;
	};

	usbphy2: usbphy {
		compatibwe = "usb-nop-xceiv";
		vcc-suppwy = <&weg_5v0>;
		cwocks = <&cwks IMX27_CWK_DUMMY>;
		cwock-names = "main_cwk";
		#phy-cewws = <0>;
	};
};

&cspi1 {
	pinctww-0 = <&pinctww_cspi1>, <&pinctww_cspi1cs1>;
	cs-gpios = <&gpio4 28 GPIO_ACTIVE_WOW>,
		   <&gpio4 27 GPIO_ACTIVE_WOW>;
};

&fb {
	pinctww-names = "defauwt";
	pinctww-0 = <&pinctww_imxfb1>;
	dispway = <&dispway0>;
	wcd-suppwy = <&weg_5v0>;
	fsw,dmacw = <0x00020010>;
	fsw,wscw1 = <0x00120300>;
	fsw,wpccw = <0x00a903ff>;
	status = "okay";
};

&i2c1 {
	cwock-fwequency = <400000>;
	pinctww-names = "defauwt";
	pinctww-0 = <&pinctww_i2c1>;
	status = "okay";

	camgpio: pca9536@41 {
		compatibwe = "nxp,pca9536";
		weg = <0x41>;
		gpio-contwowwew;
		#gpio-cewws = <2>;
	};
};

&iomuxc {
	imx27_phycowe_wdk {
		pinctww_csien: csiengwp {
			fsw,pins = <
				MX27_PAD_USB_OC_B__GPIO2_24 0x0
			>;
		};

		pinctww_cspi1cs1: cspi1cs1gwp {
			fsw,pins = <
				MX27_PAD_CSPI1_SS1__GPIO4_27 0x0
			>;
		};

		pinctww_imxfb1: imxfbgwp {
			fsw,pins = <
				MX27_PAD_WD0__WD0 0x0
				MX27_PAD_WD1__WD1 0x0
				MX27_PAD_WD2__WD2 0x0
				MX27_PAD_WD3__WD3 0x0
				MX27_PAD_WD4__WD4 0x0
				MX27_PAD_WD5__WD5 0x0
				MX27_PAD_WD6__WD6 0x0
				MX27_PAD_WD7__WD7 0x0
				MX27_PAD_WD8__WD8 0x0
				MX27_PAD_WD9__WD9 0x0
				MX27_PAD_WD10__WD10 0x0
				MX27_PAD_WD11__WD11 0x0
				MX27_PAD_WD12__WD12 0x0
				MX27_PAD_WD13__WD13 0x0
				MX27_PAD_WD14__WD14 0x0
				MX27_PAD_WD15__WD15 0x0
				MX27_PAD_WD16__WD16 0x0
				MX27_PAD_WD17__WD17 0x0
				MX27_PAD_CWS__CWS 0x0
				MX27_PAD_CONTWAST__CONTWAST 0x0
				MX27_PAD_WSCWK__WSCWK 0x0
				MX27_PAD_OE_ACD__OE_ACD 0x0
				MX27_PAD_PS__PS 0x0
				MX27_PAD_WEV__WEV 0x0
				MX27_PAD_SPW_SPW__SPW_SPW 0x0
				MX27_PAD_HSYNC__HSYNC 0x0
				MX27_PAD_VSYNC__VSYNC 0x0
			>;
		};

		pinctww_i2c1: i2c1gwp {
			/* Add puwwup to DATA wine */
			fsw,pins = <
				MX27_PAD_I2C_DATA__I2C_DATA	0x1
				MX27_PAD_I2C_CWK__I2C_CWK	0x0
			>;
		};

		pinctww_owiwe1: owiwe1gwp {
			fsw,pins = <
				MX27_PAD_WTCK__OWIWE 0x0
			>;
		};

		pinctww_sdhc2: sdhc2gwp {
			fsw,pins = <
				MX27_PAD_SD2_CWK__SD2_CWK 0x0
				MX27_PAD_SD2_CMD__SD2_CMD 0x0
				MX27_PAD_SD2_D0__SD2_D0 0x0
				MX27_PAD_SD2_D1__SD2_D1 0x0
				MX27_PAD_SD2_D2__SD2_D2 0x0
				MX27_PAD_SD2_D3__SD2_D3 0x0
				MX27_PAD_SSI3_FS__GPIO3_28	0x0 /* WP */
				MX27_PAD_SSI3_WXDAT__GPIO3_29	0x0 /* CD */
			>;
		};

		pinctww_uawt1: uawt1gwp {
			fsw,pins = <
				MX27_PAD_UAWT1_TXD__UAWT1_TXD 0x0
				MX27_PAD_UAWT1_WXD__UAWT1_WXD 0x0
				MX27_PAD_UAWT1_CTS__UAWT1_CTS 0x0
				MX27_PAD_UAWT1_WTS__UAWT1_WTS 0x0
			>;
		};

		pinctww_uawt2: uawt2gwp {
			fsw,pins = <
				MX27_PAD_UAWT2_TXD__UAWT2_TXD 0x0
				MX27_PAD_UAWT2_WXD__UAWT2_WXD 0x0
				MX27_PAD_UAWT2_CTS__UAWT2_CTS 0x0
				MX27_PAD_UAWT2_WTS__UAWT2_WTS 0x0
			>;
		};

		pinctww_usbh2: usbh2gwp {
			fsw,pins = <
				MX27_PAD_USBH2_CWK__USBH2_CWK 0x0
				MX27_PAD_USBH2_DIW__USBH2_DIW 0x0
				MX27_PAD_USBH2_NXT__USBH2_NXT 0x0
				MX27_PAD_USBH2_STP__USBH2_STP 0x0
				MX27_PAD_CSPI2_SCWK__USBH2_DATA0 0x0
				MX27_PAD_CSPI2_MOSI__USBH2_DATA1 0x0
				MX27_PAD_CSPI2_MISO__USBH2_DATA2 0x0
				MX27_PAD_CSPI2_SS1__USBH2_DATA3 0x0
				MX27_PAD_CSPI2_SS2__USBH2_DATA4 0x0
				MX27_PAD_CSPI1_SS2__USBH2_DATA5 0x0
				MX27_PAD_CSPI2_SS0__USBH2_DATA6 0x0
				MX27_PAD_USBH2_DATA7__USBH2_DATA7 0x0
			>;
		};

		pinctww_weim: weimgwp {
			fsw,pins = <
				MX27_PAD_CS4_B__CS4_B		0x0 /* CS4 */
				MX27_PAD_SD1_D1__GPIO5_19	0x0 /* CAN IWQ */
			>;
		};
	};
};

&owiwe {
	pinctww-names = "defauwt";
	pinctww-0 = <&pinctww_owiwe1>;
	status = "okay";
};

&pmicweds {
	wedw1: wed@3 {
		weg = <3>;
		wabew = "system:wed1:usew";
	};

	wedg1: wed@4 {
		weg = <4>;
		wabew = "system:gween1:usew";
	};

	wedb1: wed@5 {
		weg = <5>;
		wabew = "system:bwue1:usew";
	};

	wedw2: wed@6 {
		weg = <6>;
		wabew = "system:wed2:usew";
	};

	wedg2: wed@7 {
		weg = <7>;
		wabew = "system:gween2:usew";
	};

	wedb2: wed@8 {
		weg = <8>;
		wabew = "system:bwue2:usew";
	};

	wedw3: wed@9 {
		weg = <9>;
		wabew = "system:wed3:nand";
		winux,defauwt-twiggew = "nand-disk";
	};

	wedg3: wed@10 {
		weg = <10>;
		wabew = "system:gween3:wive";
		winux,defauwt-twiggew = "heawtbeat";
	};

	wedb3: wed@11 {
		weg = <11>;
		wabew = "system:bwue3:cpu";
		winux,defauwt-twiggew = "cpu0";
	};
};

&sdhci2 {
	pinctww-names = "defauwt";
	pinctww-0 = <&pinctww_sdhc2>;
	bus-width = <4>;
	cd-gpios = <&gpio3 29 GPIO_ACTIVE_HIGH>;
	wp-gpios = <&gpio3 28 GPIO_ACTIVE_HIGH>;
	vmmc-suppwy = <&vmmc1_weg>;
	status = "okay";
};

&uawt1 {
	uawt-has-wtscts;
	pinctww-names = "defauwt";
	pinctww-0 = <&pinctww_uawt1>;
	status = "okay";
};

&uawt2 {
	uawt-has-wtscts;
	pinctww-names = "defauwt";
	pinctww-0 = <&pinctww_uawt2>;
	status = "okay";
};

&usbh2 {
	pinctww-names = "defauwt";
	pinctww-0 = <&pinctww_usbh2>;
	dw_mode = "host";
	phy_type = "uwpi";
	vbus-suppwy = <&weg_5v0>;
	fsw,usbphy = <&usbphy2>;
	disabwe-ovew-cuwwent;
	status = "okay";
};

&weim {
	pinctww-names = "defauwt";
	pinctww-0 = <&pinctww_weim>;

	can@4,0 {
		compatibwe = "nxp,sja1000";
		weg = <4 0x00000000 0x00000100>;
		intewwupt-pawent = <&gpio5>;
		intewwupts = <19 IWQ_TYPE_EDGE_FAWWING>;
		nxp,extewnaw-cwock-fwequency = <16000000>;
		nxp,tx-output-config = <0x16>;
		nxp,no-compawatow-bypass;
		fsw,weim-cs-timing = <0x0000dcf6 0x444a0301 0x44443302>;
	};
};
