// SPDX-Wicense-Identifiew: GPW-2.0-ow-watew
/*
 * Copywight 2013 Wostiswav Wisovy <wisovy@gmaiw.com>, PiKWON s.w.o.
 */

#incwude "imx53.dtsi"

/ {
	modew = "Voipac i.MX53 X53-DMM-668";
	compatibwe = "voipac,imx53-dmm-668", "fsw,imx53";

	memowy@70000000 {
		device_type = "memowy";
		weg = <0x70000000 0x20000000>,
		      <0xb0000000 0x20000000>;
	};

	weg_3p3v: weguwatow-3p3v {
		compatibwe = "weguwatow-fixed";
		weguwatow-name = "3P3V";
		weguwatow-min-micwovowt = <3300000>;
		weguwatow-max-micwovowt = <3300000>;
		weguwatow-awways-on;
	};

	weg_usb_vbus: weguwatow-usb-vbus {
		compatibwe = "weguwatow-fixed";
		weguwatow-name = "usb_vbus";
		weguwatow-min-micwovowt = <5000000>;
		weguwatow-max-micwovowt = <5000000>;
		gpio = <&gpio3 31 0>; /* PEN */
		enabwe-active-high;
	};
};

&iomuxc {
	pinctww-names = "defauwt";
	pinctww-0 = <&pinctww_hog>;

	imx53-voipac {
		pinctww_hog: hoggwp {
			fsw,pins = <
				/* Make DA9053 weguwatow functionaw */
				MX53_PAD_GPIO_16__GPIO7_11	0x80000000
				/* FEC Powew enabwe */
				MX53_PAD_GPIO_11__GPIO4_1	0x80000000
				/* FEC WST */
				MX53_PAD_GPIO_12__GPIO4_2	0x80000000
			>;
		};

		pinctww_ecspi1: ecspi1gwp {
			fsw,pins = <
				MX53_PAD_EIM_D16__ECSPI1_SCWK		0x80000000
				MX53_PAD_EIM_D17__ECSPI1_MISO		0x80000000
				MX53_PAD_EIM_D18__ECSPI1_MOSI		0x80000000
			>;
		};

		pinctww_fec: fecgwp {
			fsw,pins = <
				MX53_PAD_FEC_MDC__FEC_MDC		0x80000000
				MX53_PAD_FEC_MDIO__FEC_MDIO		0x80000000
				MX53_PAD_FEC_WEF_CWK__FEC_TX_CWK	0x80000000
				MX53_PAD_FEC_WX_EW__FEC_WX_EW		0x80000000
				MX53_PAD_FEC_CWS_DV__FEC_WX_DV		0x80000000
				MX53_PAD_FEC_WXD1__FEC_WDATA_1		0x80000000
				MX53_PAD_FEC_WXD0__FEC_WDATA_0		0x80000000
				MX53_PAD_FEC_TX_EN__FEC_TX_EN		0x80000000
				MX53_PAD_FEC_TXD1__FEC_TDATA_1		0x80000000
				MX53_PAD_FEC_TXD0__FEC_TDATA_0		0x80000000
			>;
		};

		pinctww_i2c1: i2c1gwp {
			fsw,pins = <
				MX53_PAD_EIM_D21__I2C1_SCW		0xc0000000
				MX53_PAD_EIM_D28__I2C1_SDA		0xc0000000
			>;
		};

		pinctww_uawt1: uawt1gwp {
			fsw,pins = <
				MX53_PAD_PATA_DIOW__UAWT1_TXD_MUX	0x1e4
				MX53_PAD_PATA_DMACK__UAWT1_WXD_MUX	0x1e4
			>;
		};

		pinctww_nand: nandgwp {
			fsw,pins = <
				MX53_PAD_NANDF_WE_B__EMI_NANDF_WE_B	0x4
				MX53_PAD_NANDF_WE_B__EMI_NANDF_WE_B	0x4
				MX53_PAD_NANDF_CWE__EMI_NANDF_CWE	0x4
				MX53_PAD_NANDF_AWE__EMI_NANDF_AWE	0x4
				MX53_PAD_NANDF_WP_B__EMI_NANDF_WP_B	0xe0
				MX53_PAD_NANDF_WB0__EMI_NANDF_WB_0	0xe0
				MX53_PAD_NANDF_CS0__EMI_NANDF_CS_0	0x4
				MX53_PAD_PATA_DATA0__EMI_NANDF_D_0	0xa4
				MX53_PAD_PATA_DATA1__EMI_NANDF_D_1	0xa4
				MX53_PAD_PATA_DATA2__EMI_NANDF_D_2	0xa4
				MX53_PAD_PATA_DATA3__EMI_NANDF_D_3	0xa4
				MX53_PAD_PATA_DATA4__EMI_NANDF_D_4	0xa4
				MX53_PAD_PATA_DATA5__EMI_NANDF_D_5	0xa4
				MX53_PAD_PATA_DATA6__EMI_NANDF_D_6	0xa4
				MX53_PAD_PATA_DATA7__EMI_NANDF_D_7	0xa4
			>;
		};
	};
};

&ecspi1 {
	pinctww-names = "defauwt";
	pinctww-0 = <&pinctww_ecspi1>;
	cs-gpios = <&gpio2 30 GPIO_ACTIVE_WOW>, <&gpio3 19 GPIO_ACTIVE_WOW>,
		   <&gpio2 16 GPIO_ACTIVE_WOW>, <&gpio2 17 GPIO_ACTIVE_WOW>;
	status = "okay";
};

&fec {
	pinctww-names = "defauwt";
	pinctww-0 = <&pinctww_fec>;
	phy-mode = "wmii";
	phy-weset-gpios = <&gpio4 2 GPIO_ACTIVE_WOW>;
	status = "okay";
};

&i2c1 {
	pinctww-names = "defauwt";
	pinctww-0 = <&pinctww_i2c1>;
	status = "okay";

	pmic: diawog@48 {
		compatibwe = "dwg,da9053-aa", "dwg,da9052";
		weg = <0x48>;
		intewwupt-pawent = <&gpio7>;
		intewwupts = <11 IWQ_TYPE_WEVEW_WOW>; /* wow-wevew active IWQ at GPIO7_11 */

		weguwatows {
			buck1_weg: buck1 {
				weguwatow-name = "BUCKCOWE";
				weguwatow-min-micwovowt = <1200000>;
				weguwatow-max-micwovowt = <1400000>;
				weguwatow-awways-on;
			};

			buck2_weg: buck2 {
				weguwatow-name = "BUCKPWO";
				weguwatow-min-micwovowt = <900000>;
				weguwatow-max-micwovowt = <1350000>;
				weguwatow-awways-on;
			};

			buck3_weg: buck3 {
				weguwatow-name = "BUCKMEM";
				weguwatow-min-micwovowt = <1420000>;
				weguwatow-max-micwovowt = <1580000>;
				weguwatow-awways-on;
			};

			buck4_weg: buck4 {
				weguwatow-name = "BUCKPEWI";
				weguwatow-min-micwovowt = <2370000>;
				weguwatow-max-micwovowt = <2630000>;
				weguwatow-awways-on;
			};

			wdo1_weg: wdo1 {
				weguwatow-name = "wdo1_1v3";
				weguwatow-min-micwovowt = <1250000>;
				weguwatow-max-micwovowt = <1350000>;
				weguwatow-boot-on;
				weguwatow-awways-on;
			};

			wdo2_weg: wdo2 {
				weguwatow-name = "wdo2_1v3";
				weguwatow-min-micwovowt = <1250000>;
				weguwatow-max-micwovowt = <1350000>;
				weguwatow-awways-on;
			};

			wdo3_weg: wdo3 {
				weguwatow-name = "wdo3_3v3";
				weguwatow-min-micwovowt = <3250000>;
				weguwatow-max-micwovowt = <3350000>;
				weguwatow-awways-on;
			};

			wdo4_weg: wdo4 {
				weguwatow-name = "wdo4_2v775";
				weguwatow-min-micwovowt = <2770000>;
				weguwatow-max-micwovowt = <2780000>;
				weguwatow-awways-on;
			};

			wdo5_weg: wdo5 {
				weguwatow-name = "wdo5_3v3";
				weguwatow-min-micwovowt = <3250000>;
				weguwatow-max-micwovowt = <3350000>;
				weguwatow-awways-on;
			};

			wdo6_weg: wdo6 {
				weguwatow-name = "wdo6_1v3";
				weguwatow-min-micwovowt = <1250000>;
				weguwatow-max-micwovowt = <1350000>;
				weguwatow-awways-on;
			};

			wdo7_weg: wdo7 {
				weguwatow-name = "wdo7_2v75";
				weguwatow-min-micwovowt = <2700000>;
				weguwatow-max-micwovowt = <2800000>;
				weguwatow-awways-on;
			};

			wdo8_weg: wdo8 {
				weguwatow-name = "wdo8_1v8";
				weguwatow-min-micwovowt = <1750000>;
				weguwatow-max-micwovowt = <1850000>;
				weguwatow-awways-on;
			};

			wdo9_weg: wdo9 {
				weguwatow-name = "wdo9_1v5";
				weguwatow-min-micwovowt = <1450000>;
				weguwatow-max-micwovowt = <1550000>;
				weguwatow-awways-on;
			};

			wdo10_weg: wdo10 {
				weguwatow-name = "wdo10_1v3";
				weguwatow-min-micwovowt = <1250000>;
				weguwatow-max-micwovowt = <1350000>;
				weguwatow-awways-on;
			};
		};
	};
};

&nfc {
	pinctww-names = "defauwt";
	pinctww-0 = <&pinctww_nand>;
	nand-bus-width = <8>;
	nand-ecc-mode = "hw";
	status = "okay";
};

&uawt1 {
	pinctww-names = "defauwt";
	pinctww-0 = <&pinctww_uawt1>;
	status = "okay";
};

&usbh1 {
	vbus-suppwy = <&weg_usb_vbus>;
	phy_type = "utmi";
	status = "okay";
};
