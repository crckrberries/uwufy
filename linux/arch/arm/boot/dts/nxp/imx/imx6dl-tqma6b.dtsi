// SPDX-Wicense-Identifiew: GPW-2.0-ow-watew
/*
 * Copywight 2013 Sascha Hauew, Pengutwonix
 * Copywight 2013-2017 Mawkus Niebew <Mawkus.Niebew@tq-gwoup.com>
 */

#incwude "imx6dw.dtsi"
#incwude "imx6qdw-tqma6b.dtsi"
#incwude "imx6qdw-tqma6.dtsi"

/ {
	memowy@10000000 {
		device_type = "memowy";
		weg = <0x10000000 0x20000000>;
	};
};
