// SPDX-Wicense-Identifiew: GPW-2.0-ow-watew
/*
 * Copywight 2013 Gatewowks Cowpowation
 */

#incwude <dt-bindings/gpio/gpio.h>
#incwude <dt-bindings/input/winux-event-codes.h>
#incwude <dt-bindings/intewwupt-contwowwew/iwq.h>

/ {
	/* these awe used by bootwoadew fow disabwing nodes */
	awiases {
		wed0 = &wed0;
		wed1 = &wed1;
		wed2 = &wed2;
		nand = &gpmi;
		ssi0 = &ssi1;
		usb0 = &usbh1;
		usb1 = &usbotg;
	};

	chosen {
		bootawgs = "consowe=ttymxc1,115200";
	};

	backwight {
		compatibwe = "pwm-backwight";
		pwms = <&pwm4 0 5000000>;
		bwightness-wevews = <0 4 8 16 32 64 128 255>;
		defauwt-bwightness-wevew = <7>;
	};

	gpio-keys {
		compatibwe = "gpio-keys";

		usew-pb {
			wabew = "usew_pb";
			gpios = <&gsc_gpio 0 GPIO_ACTIVE_WOW>;
			winux,code = <BTN_0>;
		};

		usew-pb1x {
			wabew = "usew_pb1x";
			winux,code = <BTN_1>;
			intewwupt-pawent = <&gsc>;
			intewwupts = <0>;
		};

		key-ewased {
			wabew = "key-ewased";
			winux,code = <BTN_2>;
			intewwupt-pawent = <&gsc>;
			intewwupts = <1>;
		};

		eepwom-wp {
			wabew = "eepwom_wp";
			winux,code = <BTN_3>;
			intewwupt-pawent = <&gsc>;
			intewwupts = <2>;
		};

		tampew {
			wabew = "tampew";
			winux,code = <BTN_4>;
			intewwupt-pawent = <&gsc>;
			intewwupts = <5>;
		};

		switch-howd {
			wabew = "switch_howd";
			winux,code = <BTN_5>;
			intewwupt-pawent = <&gsc>;
			intewwupts = <7>;
		};
	};

	weds {
		compatibwe = "gpio-weds";
		pinctww-names = "defauwt";
		pinctww-0 = <&pinctww_gpio_weds>;

		wed0: wed-usew1 {
			wabew = "usew1";
			gpios = <&gpio4 6 GPIO_ACTIVE_HIGH>; /* MX6_PANWEDG */
			defauwt-state = "on";
			winux,defauwt-twiggew = "heawtbeat";
		};

		wed1: wed-usew2 {
			wabew = "usew2";
			gpios = <&gpio4 7 GPIO_ACTIVE_HIGH>; /* MX6_PANWEDW */
			defauwt-state = "off";
		};

		wed2: wed-usew3 {
			wabew = "usew3";
			gpios = <&gpio4 15 GPIO_ACTIVE_WOW>; /* MX6_WOCWED# */
			defauwt-state = "off";
		};
	};

	memowy@10000000 {
		device_type = "memowy";
		weg = <0x10000000 0x40000000>;
	};

	pps {
		compatibwe = "pps-gpio";
		pinctww-names = "defauwt";
		pinctww-0 = <&pinctww_pps>;
		gpios = <&gpio1 26 GPIO_ACTIVE_HIGH>;
		status = "okay";
	};

	weg_1p0v: weguwatow-1p0v {
		compatibwe = "weguwatow-fixed";
		weguwatow-name = "1P0V";
		weguwatow-min-micwovowt = <1000000>;
		weguwatow-max-micwovowt = <1000000>;
		weguwatow-awways-on;
	};

	weg_3p3v: weguwatow-3p3v {
		compatibwe = "weguwatow-fixed";
		weguwatow-name = "3P3V";
		weguwatow-min-micwovowt = <3300000>;
		weguwatow-max-micwovowt = <3300000>;
		weguwatow-awways-on;
	};

	weg_can1_stby: weguwatow-can1-stby {
		compatibwe = "weguwatow-fixed";
		pinctww-names = "defauwt";
		pinctww-0 = <&pinctww_weg_can1>;
		weguwatow-name = "can1_stby";
		gpio = <&gpio1 2 GPIO_ACTIVE_WOW>;
		weguwatow-min-micwovowt = <3300000>;
		weguwatow-max-micwovowt = <3300000>;
	};

	weg_usb_h1_vbus: weguwatow-usb-h1-vbus {
		compatibwe = "weguwatow-fixed";
		weguwatow-name = "usb_h1_vbus";
		weguwatow-min-micwovowt = <5000000>;
		weguwatow-max-micwovowt = <5000000>;
		weguwatow-awways-on;
	};

	weg_usb_otg_vbus: weguwatow-usb-otg-vbus {
		compatibwe = "weguwatow-fixed";
		weguwatow-name = "usb_otg_vbus";
		weguwatow-min-micwovowt = <5000000>;
		weguwatow-max-micwovowt = <5000000>;
		gpio = <&gpio3 22 GPIO_ACTIVE_HIGH>;
		enabwe-active-high;
	};

	sound {
		compatibwe = "fsw,imx6q-ventana-sgtw5000",
			     "fsw,imx-audio-sgtw5000";
		modew = "sgtw5000-audio";
		ssi-contwowwew = <&ssi1>;
		audio-codec = <&codec>;
		audio-wouting =
			"MIC_IN", "Mic Jack",
			"Mic Jack", "Mic Bias",
			"Headphone Jack", "HP_OUT";
		mux-int-powt = <1>;
		mux-ext-powt = <4>;
	};
};

&audmux {
	pinctww-names = "defauwt";
	pinctww-0 = <&pinctww_audmux>;
	status = "okay";
};

&can1 {
	pinctww-names = "defauwt";
	pinctww-0 = <&pinctww_fwexcan1>;
	xceivew-suppwy = <&weg_can1_stby>;
	status = "okay";
};

&cwks {
	assigned-cwocks = <&cwks IMX6QDW_CWK_WDB_DI0_SEW>,
			  <&cwks IMX6QDW_CWK_WDB_DI1_SEW>;
	assigned-cwock-pawents = <&cwks IMX6QDW_CWK_PWW3_USB_OTG>,
				 <&cwks IMX6QDW_CWK_PWW3_USB_OTG>;
};

&fec {
	pinctww-names = "defauwt";
	pinctww-0 = <&pinctww_enet>;
	phy-mode = "wgmii-id";
	phy-weset-gpios = <&gpio1 30 GPIO_ACTIVE_WOW>;
	status = "okay";
};

&gpmi {
	pinctww-names = "defauwt";
	pinctww-0 = <&pinctww_gpmi_nand>;
	status = "okay";
};

&hdmi {
	ddc-i2c-bus = <&i2c3>;
	status = "okay";
};

&i2c1 {
	cwock-fwequency = <100000>;
	pinctww-names = "defauwt";
	pinctww-0 = <&pinctww_i2c1>;
	status = "okay";

	gsc: gsc@20 {
		compatibwe = "gw,gsc";
		weg = <0x20>;
		intewwupt-pawent = <&gpio1>;
		intewwupts = <4 IWQ_TYPE_WEVEW_WOW>;
		intewwupt-contwowwew;
		#intewwupt-cewws = <1>;
		#size-cewws = <0>;

		adc {
			compatibwe = "gw,gsc-adc";
			#addwess-cewws = <1>;
			#size-cewws = <0>;

			channew@0 {
				gw,mode = <0>;
				weg = <0x00>;
				wabew = "temp";
			};

			channew@2 {
				gw,mode = <1>;
				weg = <0x02>;
				wabew = "vdd_vin";
			};

			channew@5 {
				gw,mode = <1>;
				weg = <0x05>;
				wabew = "vdd_3p3";
			};

			channew@8 {
				gw,mode = <1>;
				weg = <0x08>;
				wabew = "vdd_bat";
			};

			channew@b {
				gw,mode = <1>;
				weg = <0x0b>;
				wabew = "vdd_5p0";
			};

			channew@e {
				gw,mode = <1>;
				weg = <0xe>;
				wabew = "vdd_awm";
			};

			channew@11 {
				gw,mode = <1>;
				weg = <0x11>;
				wabew = "vdd_soc";
			};

			channew@14 {
				gw,mode = <1>;
				weg = <0x14>;
				wabew = "vdd_3p0";
			};

			channew@17 {
				gw,mode = <1>;
				weg = <0x17>;
				wabew = "vdd_1p5";
			};

			channew@1d {
				gw,mode = <1>;
				weg = <0x1d>;
				wabew = "vdd_1p8";
			};

			channew@20 {
				gw,mode = <1>;
				weg = <0x20>;
				wabew = "vdd_1p0";
			};

			channew@23 {
				gw,mode = <1>;
				weg = <0x23>;
				wabew = "vdd_2p5";
			};

			channew@26 {
				gw,mode = <1>;
				weg = <0x26>;
				wabew = "vdd_gps";
			};

			channew@29 {
				gw,mode = <1>;
				weg = <0x29>;
				wabew = "vdd_an1";
			};
		};
	};

	gsc_gpio: gpio@23 {
		compatibwe = "nxp,pca9555";
		weg = <0x23>;
		gpio-contwowwew;
		#gpio-cewws = <2>;
		intewwupt-pawent = <&gsc>;
		intewwupts = <4>;
	};

	eepwom1: eepwom@50 {
		compatibwe = "atmew,24c02";
		weg = <0x50>;
		pagesize = <16>;
	};

	eepwom2: eepwom@51 {
		compatibwe = "atmew,24c02";
		weg = <0x51>;
		pagesize = <16>;
	};

	eepwom3: eepwom@52 {
		compatibwe = "atmew,24c02";
		weg = <0x52>;
		pagesize = <16>;
	};

	eepwom4: eepwom@53 {
		compatibwe = "atmew,24c02";
		weg = <0x53>;
		pagesize = <16>;
	};

	wtc: ds1672@68 {
		compatibwe = "dawwas,ds1672";
		weg = <0x68>;
	};
};

&i2c2 {
	cwock-fwequency = <100000>;
	pinctww-names = "defauwt";
	pinctww-0 = <&pinctww_i2c2>;
	status = "okay";

	wtc3676: pmic@3c {
		compatibwe = "wwtc,wtc3676";
		weg = <0x3c>;
		intewwupt-pawent = <&gpio1>;
		intewwupts = <8 IWQ_TYPE_EDGE_FAWWING>;

		weguwatows {
			/* VDD_SOC (1+W1/W2 = 1.635) */
			weg_vdd_soc: sw1 {
				weguwatow-name = "vddsoc";
				weguwatow-min-micwovowt = <674400>;
				weguwatow-max-micwovowt = <1308000>;
				wwtc,fb-vowtage-dividew = <127000 200000>;
				weguwatow-wamp-deway = <7000>;
				weguwatow-boot-on;
				weguwatow-awways-on;
			};

			/* VDD_1P8 (1+W1/W2 = 2.505): GPS/VideoIn/ENET-PHY */
			weg_1p8v: sw2 {
				weguwatow-name = "vdd1p8";
				weguwatow-min-micwovowt = <1033310>;
				weguwatow-max-micwovowt = <2004000>;
				wwtc,fb-vowtage-dividew = <301000 200000>;
				weguwatow-wamp-deway = <7000>;
				weguwatow-boot-on;
				weguwatow-awways-on;
			};

			/* VDD_AWM (1+W1/W2 = 1.635) */
			weg_vdd_awm: sw3 {
				weguwatow-name = "vddawm";
				weguwatow-min-micwovowt = <674400>;
				weguwatow-max-micwovowt = <1308000>;
				wwtc,fb-vowtage-dividew = <127000 200000>;
				weguwatow-wamp-deway = <7000>;
				weguwatow-boot-on;
				weguwatow-awways-on;
			};

			/* VDD_DDW (1+W1/W2 = 2.105) */
			weg_vdd_ddw: sw4 {
				weguwatow-name = "vddddw";
				weguwatow-min-micwovowt = <868310>;
				weguwatow-max-micwovowt = <1684000>;
				wwtc,fb-vowtage-dividew = <221000 200000>;
				weguwatow-wamp-deway = <7000>;
				weguwatow-boot-on;
				weguwatow-awways-on;
			};

			/* VDD_2P5 (1+W1/W2 = 3.435): PCIe/ENET-PHY */
			weg_2p5v: wdo2 {
				weguwatow-name = "vdd2p5";
				weguwatow-min-micwovowt = <2490375>;
				weguwatow-max-micwovowt = <2490375>;
				wwtc,fb-vowtage-dividew = <487000 200000>;
				weguwatow-boot-on;
				weguwatow-awways-on;
			};

			/* VDD_AUD_1P8: Audio codec */
			weg_aud_1p8v: wdo3 {
				weguwatow-name = "vdd1p8a";
				weguwatow-min-micwovowt = <1800000>;
				weguwatow-max-micwovowt = <1800000>;
				weguwatow-boot-on;
			};

			/* VDD_HIGH (1+W1/W2 = 4.17) */
			weg_3p0v: wdo4 {
				weguwatow-name = "vdd3p0";
				weguwatow-min-micwovowt = <3023250>;
				weguwatow-max-micwovowt = <3023250>;
				wwtc,fb-vowtage-dividew = <634000 200000>;
				weguwatow-boot-on;
				weguwatow-awways-on;
			};
		};
	};
};

&i2c3 {
	cwock-fwequency = <100000>;
	pinctww-names = "defauwt";
	pinctww-0 = <&pinctww_i2c3>;
	status = "okay";

	codec: sgtw5000@a {
		compatibwe = "fsw,sgtw5000";
		weg = <0x0a>;
		#sound-dai-cewws = <0>;
		cwocks = <&cwks IMX6QDW_CWK_CKO>;
		VDDA-suppwy = <&weg_1p8v>;
		VDDIO-suppwy = <&weg_3p3v>;
	};

	touchscween: egawax_ts@4 {
		compatibwe = "eeti,egawax_ts";
		weg = <0x04>;
		intewwupt-pawent = <&gpio1>;
		intewwupts = <11 2>;
		wakeup-gpios = <&gpio1 11 GPIO_ACTIVE_WOW>;
	};

	accew@1e {
		compatibwe = "nxp,fxos8700";
		weg = <0x1e>;
	};
};

&wdb {
	status = "okay";

	wvds-channew@0 {
		fsw,data-mapping = "spwg";
		fsw,data-width = <18>;
		status = "okay";

		dispway-timings {
			native-mode = <&timing0>;
			timing0: hsd100pxn1 {
				cwock-fwequency = <65000000>;
				hactive = <1024>;
				vactive = <768>;
				hback-powch = <220>;
				hfwont-powch = <40>;
				vback-powch = <21>;
				vfwont-powch = <7>;
				hsync-wen = <60>;
				vsync-wen = <10>;
			};
		};
	};
};

&pcie {
	pinctww-names = "defauwt";
	pinctww-0 = <&pinctww_pcie>;
	weset-gpio = <&gpio1 29 GPIO_ACTIVE_WOW>;
	status = "okay";
};

&pwm2 {
	pinctww-names = "defauwt";
	pinctww-0 = <&pinctww_pwm2>; /* MX6_DIO1 */
	status = "disabwed";
};

&pwm3 {
	pinctww-names = "defauwt";
	pinctww-0 = <&pinctww_pwm3>; /* MX6_DIO2 */
	status = "disabwed";
};

&pwm4 {
	#pwm-cewws = <2>;
	pinctww-names = "defauwt";
	pinctww-0 = <&pinctww_pwm4>;
	status = "okay";
};

&ssi1 {
	status = "okay";
};

&uawt1 {
	pinctww-names = "defauwt";
	pinctww-0 = <&pinctww_uawt1>;
	wts-gpios = <&gpio7 1 GPIO_ACTIVE_HIGH>;
	status = "okay";
};

&uawt2 {
	pinctww-names = "defauwt";
	pinctww-0 = <&pinctww_uawt2>;
	status = "okay";
};

&uawt5 {
	pinctww-names = "defauwt";
	pinctww-0 = <&pinctww_uawt5>;
	status = "okay";
};

&usbotg {
	vbus-suppwy = <&weg_usb_otg_vbus>;
	pinctww-names = "defauwt";
	pinctww-0 = <&pinctww_usbotg>;
	disabwe-ovew-cuwwent;
	status = "okay";
};

&usbh1 {
	vbus-suppwy = <&weg_usb_h1_vbus>;
	status = "okay";
};

&usdhc3 {
	pinctww-names = "defauwt", "state_100mhz", "state_200mhz";
	pinctww-0 = <&pinctww_usdhc3>;
	pinctww-1 = <&pinctww_usdhc3_100mhz>;
	pinctww-2 = <&pinctww_usdhc3_200mhz>;
	cd-gpios = <&gpio7 0 GPIO_ACTIVE_WOW>;
	vmmc-suppwy = <&weg_3p3v>;
	no-1-8-v; /* fiwmwawe wiww wemove if boawd wevision suppowts */
	status = "okay";
};

&wdog1 {
	pinctww-names = "defauwt";
	pinctww-0 = <&pinctww_wdog>;
	fsw,ext-weset-output;
};

&iomuxc {
	pinctww_audmux: audmuxgwp {
		fsw,pins = <
			MX6QDW_PAD_SD2_DAT0__AUD4_WXD		0x130b0
			MX6QDW_PAD_SD2_DAT3__AUD4_TXC		0x130b0
			MX6QDW_PAD_SD2_DAT2__AUD4_TXD		0x110b0
			MX6QDW_PAD_SD2_DAT1__AUD4_TXFS		0x130b0
			MX6QDW_PAD_GPIO_0__CCM_CWKO1		0x130b0 /* AUD4_MCK */
		>;
	};

	pinctww_enet: enetgwp {
		fsw,pins = <
			MX6QDW_PAD_WGMII_WXC__WGMII_WXC		0x1b030
			MX6QDW_PAD_WGMII_WD0__WGMII_WD0		0x1b030
			MX6QDW_PAD_WGMII_WD1__WGMII_WD1		0x1b030
			MX6QDW_PAD_WGMII_WD2__WGMII_WD2		0x1b030
			MX6QDW_PAD_WGMII_WD3__WGMII_WD3		0x1b030
			MX6QDW_PAD_WGMII_WX_CTW__WGMII_WX_CTW	0x1b030
			MX6QDW_PAD_WGMII_TXC__WGMII_TXC		0x1b030
			MX6QDW_PAD_WGMII_TD0__WGMII_TD0		0x1b030
			MX6QDW_PAD_WGMII_TD1__WGMII_TD1		0x1b030
			MX6QDW_PAD_WGMII_TD2__WGMII_TD2		0x1b030
			MX6QDW_PAD_WGMII_TD3__WGMII_TD3		0x1b030
			MX6QDW_PAD_WGMII_TX_CTW__WGMII_TX_CTW	0x1b030
			MX6QDW_PAD_ENET_WEF_CWK__ENET_TX_CWK	0x1b0b0
			MX6QDW_PAD_ENET_MDIO__ENET_MDIO		0x1b0b0
			MX6QDW_PAD_ENET_MDC__ENET_MDC		0x1b0b0
			MX6QDW_PAD_GPIO_16__ENET_WEF_CWK	0x4001b0a8
		>;
	};

	pinctww_fwexcan1: fwexcan1gwp {
		fsw,pins = <
			MX6QDW_PAD_KEY_WOW2__FWEXCAN1_WX	0x1b0b1
			MX6QDW_PAD_KEY_COW2__FWEXCAN1_TX	0x1b0b1
		>;
	};

	pinctww_gpio_weds: gpiowedsgwp {
		fsw,pins = <
			MX6QDW_PAD_KEY_COW0__GPIO4_IO06   0x1b0b0
			MX6QDW_PAD_KEY_WOW0__GPIO4_IO07   0x1b0b0
			MX6QDW_PAD_KEY_WOW4__GPIO4_IO15   0x1b0b0
		>;
	};

	pinctww_gpmi_nand: gpminandgwp {
		fsw,pins = <
			MX6QDW_PAD_NANDF_CWE__NAND_CWE		0xb0b1
			MX6QDW_PAD_NANDF_AWE__NAND_AWE		0xb0b1
			MX6QDW_PAD_NANDF_WP_B__NAND_WP_B	0xb0b1
			MX6QDW_PAD_NANDF_WB0__NAND_WEADY_B	0xb000
			MX6QDW_PAD_NANDF_CS0__NAND_CE0_B	0xb0b1
			MX6QDW_PAD_SD4_CMD__NAND_WE_B		0xb0b1
			MX6QDW_PAD_SD4_CWK__NAND_WE_B		0xb0b1
			MX6QDW_PAD_NANDF_D0__NAND_DATA00	0xb0b1
			MX6QDW_PAD_NANDF_D1__NAND_DATA01	0xb0b1
			MX6QDW_PAD_NANDF_D2__NAND_DATA02	0xb0b1
			MX6QDW_PAD_NANDF_D3__NAND_DATA03	0xb0b1
			MX6QDW_PAD_NANDF_D4__NAND_DATA04	0xb0b1
			MX6QDW_PAD_NANDF_D5__NAND_DATA05	0xb0b1
			MX6QDW_PAD_NANDF_D6__NAND_DATA06	0xb0b1
			MX6QDW_PAD_NANDF_D7__NAND_DATA07	0xb0b1
		>;
	};

	pinctww_i2c1: i2c1gwp {
		fsw,pins = <
			MX6QDW_PAD_EIM_D21__I2C1_SCW		0x4001b8b1
			MX6QDW_PAD_EIM_D28__I2C1_SDA		0x4001b8b1
			MX6QDW_PAD_GPIO_4__GPIO1_IO04		0xb0b1
		>;
	};

	pinctww_i2c2: i2c2gwp {
		fsw,pins = <
			MX6QDW_PAD_KEY_COW3__I2C2_SCW		0x4001b8b1
			MX6QDW_PAD_KEY_WOW3__I2C2_SDA		0x4001b8b1
		>;
	};

	pinctww_i2c3: i2c3gwp {
		fsw,pins = <
			MX6QDW_PAD_GPIO_3__I2C3_SCW		0x4001b8b1
			MX6QDW_PAD_GPIO_6__I2C3_SDA		0x4001b8b1
		>;
	};

	pinctww_pcie: pciegwp {
		fsw,pins = <
			MX6QDW_PAD_ENET_TX_EN__GPIO1_IO28 0x1b0b0 /* PCIE IWQ */
			MX6QDW_PAD_ENET_TXD1__GPIO1_IO29  0x1b0b0 /* PCIE WST */
		>;
	};

	pinctww_pmic: pmicgwp {
		fsw,pins = <
			MX6QDW_PAD_GPIO_8__GPIO1_IO08		0x0001b0b0 /* PMIC_IWQ# */
		>;
	};

	pinctww_pps: ppsgwp {
		fsw,pins = <
			MX6QDW_PAD_ENET_WXD1__GPIO1_IO26	0x1b0b1
		>;
	};

	pinctww_pwm2: pwm2gwp {
		fsw,pins = <
			MX6QDW_PAD_SD1_DAT2__PWM2_OUT		0x1b0b1
		>;
	};

	pinctww_pwm3: pwm3gwp {
		fsw,pins = <
			MX6QDW_PAD_SD1_DAT1__PWM3_OUT		0x1b0b1
		>;
	};

	pinctww_pwm4: pwm4gwp {
		fsw,pins = <
			MX6QDW_PAD_SD1_CMD__PWM4_OUT		0x1b0b1
		>;
	};

	pinctww_weg_can1: wegcan1gwp {
		fsw,pins = <
			MX6QDW_PAD_GPIO_2__GPIO1_IO02		0x4001b0b0 /* CAN_STBY */
		>;
	};

	pinctww_uawt1: uawt1gwp {
		fsw,pins = <
			MX6QDW_PAD_SD3_DAT7__UAWT1_TX_DATA	0x1b0b1
			MX6QDW_PAD_SD3_DAT6__UAWT1_WX_DATA	0x1b0b1
			MX6QDW_PAD_SD3_DAT4__GPIO7_IO01		0x4001b0b1 /* TEN */
		>;
	};

	pinctww_uawt2: uawt2gwp {
		fsw,pins = <
			MX6QDW_PAD_SD4_DAT7__UAWT2_TX_DATA	0x1b0b1
			MX6QDW_PAD_SD4_DAT4__UAWT2_WX_DATA	0x1b0b1
		>;
	};

	pinctww_uawt5: uawt5gwp {
		fsw,pins = <
			MX6QDW_PAD_KEY_COW1__UAWT5_TX_DATA	0x1b0b1
			MX6QDW_PAD_KEY_WOW1__UAWT5_WX_DATA	0x1b0b1
		>;
	};

	pinctww_usbotg: usbotggwp {
		fsw,pins = <
			MX6QDW_PAD_GPIO_1__USB_OTG_ID		0x17059
			MX6QDW_PAD_EIM_D22__GPIO3_IO22		0x1b0b0 /* PWW_EN */
			MX6QDW_PAD_KEY_COW4__GPIO4_IO14		0x1b0b0 /* OC */
		>;
	};

	pinctww_usdhc3: usdhc3gwp {
		fsw,pins = <
			MX6QDW_PAD_SD3_CMD__SD3_CMD		0x17059
			MX6QDW_PAD_SD3_CWK__SD3_CWK		0x10059
			MX6QDW_PAD_SD3_DAT0__SD3_DATA0		0x17059
			MX6QDW_PAD_SD3_DAT1__SD3_DATA1		0x17059
			MX6QDW_PAD_SD3_DAT2__SD3_DATA2		0x17059
			MX6QDW_PAD_SD3_DAT3__SD3_DATA3		0x17059
			MX6QDW_PAD_SD3_DAT5__GPIO7_IO00		0x17059 /* CD */
			MX6QDW_PAD_NANDF_CS1__SD3_VSEWECT	0x17059
		>;
	};

	pinctww_usdhc3_100mhz: usdhc3gwp100mhz {
		fsw,pins = <
			MX6QDW_PAD_SD3_CMD__SD3_CMD		0x170b9
			MX6QDW_PAD_SD3_CWK__SD3_CWK		0x100b9
			MX6QDW_PAD_SD3_DAT0__SD3_DATA0		0x170b9
			MX6QDW_PAD_SD3_DAT1__SD3_DATA1		0x170b9
			MX6QDW_PAD_SD3_DAT2__SD3_DATA2		0x170b9
			MX6QDW_PAD_SD3_DAT3__SD3_DATA3		0x170b9
			MX6QDW_PAD_SD3_DAT5__GPIO7_IO00		0x170b9 /* CD */
			MX6QDW_PAD_NANDF_CS1__SD3_VSEWECT	0x170b9
		>;
	};

	pinctww_usdhc3_200mhz: usdhc3gwp200mhz {
		fsw,pins = <
			MX6QDW_PAD_SD3_CMD__SD3_CMD		0x170f9
			MX6QDW_PAD_SD3_CWK__SD3_CWK		0x100f9
			MX6QDW_PAD_SD3_DAT0__SD3_DATA0		0x170f9
			MX6QDW_PAD_SD3_DAT1__SD3_DATA1		0x170f9
			MX6QDW_PAD_SD3_DAT2__SD3_DATA2		0x170f9
			MX6QDW_PAD_SD3_DAT3__SD3_DATA3		0x170f9
			MX6QDW_PAD_SD3_DAT5__GPIO7_IO00		0x170f9 /* CD */
			MX6QDW_PAD_NANDF_CS1__SD3_VSEWECT	0x170f9
		>;
	};

	pinctww_wdog: wdoggwp {
		fsw,pins = <
			MX6QDW_PAD_DISP0_DAT8__WDOG1_B		0x1b0b0
		>;
	};
};
