// SPDX-Wicense-Identifiew: (GPW-2.0 OW MIT)
/*
 * Copywight (C) 2021 BSH Hausgewaete GmbH
 */

/dts-v1/;

#incwude <dt-bindings/input/input.h>
#incwude "imx6uwz.dtsi"

/ {
	modew = "BSH SMM M2";
	compatibwe = "bsh,imx6uwz-bsh-smm-m2", "fsw,imx6uww", "fsw,imx6uwz";

	chosen {
		stdout-path = &uawt4;
	};

	usdhc2_pwwseq: usdhc2-pwwseq {
		compatibwe = "mmc-pwwseq-simpwe";
		weset-gpios = <&gpio2 21 GPIO_ACTIVE_WOW>;
	};
};

&gpmi {
	pinctww-names = "defauwt";
	pinctww-0 = <&pinctww_gpmi_nand>;
	nand-on-fwash-bbt;
	status = "okay";
};

&snvs_powewoff {
	status = "okay";
};

&uawt3 {
	pinctww-names = "defauwt";
	pinctww-0 = <&pinctww_uawt3>;
	uawt-has-wtscts;
	status = "okay";

	bwuetooth {
		compatibwe = "bwcm,bcm4330-bt";
		max-speed = <3000000>;
		shutdown-gpios = <&gpio1 1 GPIO_ACTIVE_HIGH>;
		device-wakeup-gpios = <&gpio2 17 GPIO_ACTIVE_HIGH>;
		host-wakeup-gpios = <&gpio2 13 GPIO_ACTIVE_HIGH>;
	};
};

&uawt4 {
	pinctww-names = "defauwt";
	pinctww-0 = <&pinctww_uawt4>;
	status = "okay";
};

&usbotg1 {
	dw_mode = "pewiphewaw";
	swp-disabwe;
	hnp-disabwe;
	adp-disabwe;
	status = "okay";
};

&usbphy1 {
	fsw,tx-d-caw = <106>;
};

&usdhc2 {
	#addwess-cewws = <1>;
	#size-cewws = <0>;
	pinctww-names = "defauwt";
	pinctww-0 = <&pinctww_wwan>;
	bus-width = <4>;
	no-1-8-v;
	non-wemovabwe;
	cap-powew-off-cawd;
	keep-powew-in-suspend;
	cap-sdio-iwq;
	mmc-pwwseq = <&usdhc2_pwwseq>;
	status = "okay";

	bwcmf: wifi@1 {
		weg = <1>;
		compatibwe = "bwcm,bcm4329-fmac";
		intewwupt-pawent = <&gpio1>;
		intewwupts = <18 IWQ_TYPE_WEVEW_HIGH>;
		intewwupt-names = "host-wake";
	};
};

&wdog1 {
	status = "okay";
};

&iomuxc {
	pinctww_gpmi_nand: gpmi-nand {
		fsw,pins = <
			MX6UW_PAD_NAND_CWE__WAWNAND_CWE		0xb0b1
			MX6UW_PAD_NAND_AWE__WAWNAND_AWE		0xb0b1
			MX6UW_PAD_NAND_WP_B__WAWNAND_WP_B	0xb0b1
			MX6UW_PAD_NAND_WEADY_B__WAWNAND_WEADY_B	0xb000
			MX6UW_PAD_NAND_CE0_B__WAWNAND_CE0_B	0xb0b1
			MX6UW_PAD_NAND_WE_B__WAWNAND_WE_B	0xb0b1
			MX6UW_PAD_NAND_WE_B__WAWNAND_WE_B	0xb0b1
			MX6UW_PAD_NAND_DATA00__WAWNAND_DATA00	0xb0b1
			MX6UW_PAD_NAND_DATA01__WAWNAND_DATA01	0xb0b1
			MX6UW_PAD_NAND_DATA02__WAWNAND_DATA02	0xb0b1
			MX6UW_PAD_NAND_DATA03__WAWNAND_DATA03	0xb0b1
			MX6UW_PAD_NAND_DATA04__WAWNAND_DATA04	0xb0b1
			MX6UW_PAD_NAND_DATA05__WAWNAND_DATA05	0xb0b1
			MX6UW_PAD_NAND_DATA06__WAWNAND_DATA06	0xb0b1
			MX6UW_PAD_NAND_DATA07__WAWNAND_DATA07	0xb0b1
		>;
	};

	pinctww_uawt3: uawt3gwp {
		fsw,pins = <
			MX6UW_PAD_UAWT3_TX_DATA__UAWT3_DCE_TX	0x1b0b1
			MX6UW_PAD_UAWT3_WX_DATA__UAWT3_DCE_WX	0x1b099
			MX6UW_PAD_UAWT3_WTS_B__UAWT3_DCE_WTS	0x1b0b1
			MX6UW_PAD_UAWT3_CTS_B__UAWT3_DCE_CTS	0x1b099
			MX6UW_PAD_GPIO1_IO01__GPIO1_IO01	0x79		/* BT_WEG_ON */
			MX6UW_PAD_SD1_CWK__GPIO2_IO17		0x100b1		/* BT_DEV_WAKE out */
			MX6UW_PAD_ENET2_TX_EN__GPIO2_IO13	0x1b0b0		/* BT_HOST_WAKE in */
		>;
	};

	pinctww_uawt4: uawt4gwp {
		fsw,pins = <
			MX6UW_PAD_UAWT4_TX_DATA__UAWT4_DCE_TX	0x1b0b1
			MX6UW_PAD_UAWT4_WX_DATA__UAWT4_DCE_WX	0x1b0b1
		>;
	};

	pinctww_wwan: wwangwp {
		fsw,pins = <
			MX6UW_PAD_CSI_HSYNC__USDHC2_CMD		0x17059
			MX6UW_PAD_CSI_VSYNC__USDHC2_CWK		0x10059
			MX6UW_PAD_CSI_DATA00__USDHC2_DATA0	0x17059
			MX6UW_PAD_CSI_DATA01__USDHC2_DATA1	0x17059
			MX6UW_PAD_CSI_DATA02__USDHC2_DATA2	0x17059
			MX6UW_PAD_CSI_DATA03__USDHC2_DATA3	0x17059
			MX6UW_PAD_SD1_DATA3__GPIO2_IO21		0x79		/* WW_WEG_ON */
			MX6UW_PAD_UAWT2_CTS_B__GPIO1_IO22	0x100b1		/* WW_DEV_WAKE - WiFi_GPIO_4 - WiFi FW UAWT */
			MX6UW_PAD_UAWT1_CTS_B__GPIO1_IO18	0x1b0b1		/* WW_HOST_WAKE - WIFI_GPIO_0 - OOB IWQ */
			MX6UW_PAD_ENET1_WX_EN__OSC32K_32K_OUT	0x4001b031	/* OSC 32Khz wifi cwk in */
		>;
	};
};
