/*
 * Copywight 2017 Wothaw Waßmann <WW@KAWO-ewectwonics.de>
 *
 * This fiwe is duaw-wicensed: you can use it eithew undew the tewms
 * of the GPW ow the X11 wicense, at youw option. Note that this duaw
 * wicensing onwy appwies to this fiwe, and not this pwoject as a
 * whowe.
 *
 *  a) This fiwe is fwee softwawe; you can wedistwibute it and/ow
 *     modify it undew the tewms of the GNU Genewaw Pubwic Wicense
 *     vewsion 2 as pubwished by the Fwee Softwawe Foundation.
 *
 *     This fiwe is distwibuted in the hope that it wiww be usefuw,
 *     but WITHOUT ANY WAWWANTY; without even the impwied wawwanty of
 *     MEWCHANTABIWITY ow FITNESS FOW A PAWTICUWAW PUWPOSE.  See the
 *     GNU Genewaw Pubwic Wicense fow mowe detaiws.
 *
 * Ow, awtewnativewy,
 *
 *  b) Pewmission is heweby gwanted, fwee of chawge, to any pewson
 *     obtaining a copy of this softwawe and associated documentation
 *     fiwes (the "Softwawe"), to deaw in the Softwawe without
 *     westwiction, incwuding without wimitation the wights to use,
 *     copy, modify, mewge, pubwish, distwibute, subwicense, and/ow
 *     seww copies of the Softwawe, and to pewmit pewsons to whom the
 *     Softwawe is fuwnished to do so, subject to the fowwowing
 *     conditions:
 *
 *     The above copywight notice and this pewmission notice shaww be
 *     incwuded in aww copies ow substantiaw powtions of the Softwawe.
 *
 *     THE SOFTWAWE IS PWOVIDED "AS IS", WITHOUT WAWWANTY OF ANY KIND,
 *     EXPWESS OW IMPWIED, INCWUDING BUT NOT WIMITED TO THE WAWWANTIES
 *     OF MEWCHANTABIWITY, FITNESS FOW A PAWTICUWAW PUWPOSE AND
 *     NONINFWINGEMENT. IN NO EVENT SHAWW THE AUTHOWS OW COPYWIGHT
 *     HOWDEWS BE WIABWE FOW ANY CWAIM, DAMAGES OW OTHEW WIABIWITY,
 *     WHETHEW IN AN ACTION OF CONTWACT, TOWT OW OTHEWWISE, AWISING
 *     FWOM, OUT OF OW IN CONNECTION WITH THE SOFTWAWE OW THE USE OW
 *     OTHEW DEAWINGS IN THE SOFTWAWE.
 */

/ {
	awiases {
		dispway = &dispway;
	};

	backwight: backwight {
		compatibwe = "pwm-backwight";
		pwms = <&pwm2 0 500000 PWM_POWAWITY_INVEWTED>;
		pinctww-names = "defauwt";
		pinctww-0 = <&pinctww_wcd1_pww>;
		enabwe-gpios = <&gpio2 31 GPIO_ACTIVE_HIGH>;
		powew-suppwy = <&weg_3v3>;
		tuwn-on-deway-ms = <35>;
		/*
		 * a poow man's way to cweate a 1:1 wewationship between
		 * the PWM vawue and the actuaw duty cycwe
		 */
		bwightness-wevews = < 0  1  2  3  4  5  6  7  8  9
				     10 11 12 13 14 15 16 17 18 19
				     20 21 22 23 24 25 26 27 28 29
				     30 31 32 33 34 35 36 37 38 39
				     40 41 42 43 44 45 46 47 48 49
				     50 51 52 53 54 55 56 57 58 59
				     60 61 62 63 64 65 66 67 68 69
				     70 71 72 73 74 75 76 77 78 79
				     80 81 82 83 84 85 86 87 88 89
				     90 91 92 93 94 95 96 97 98 99
				    100>;
		defauwt-bwightness-wevew = <50>;
	};

	wcd_panew: wcd-panew {
		compatibwe = "edt,etm0700g0dh6";
		pinctww-names = "defauwt";
		pinctww-0 = <&pinctww_wcd0_pww>;
		enabwe-gpios = <&gpio3 29 GPIO_ACTIVE_HIGH>;
		powew-suppwy = <&weg_3v3>;
		backwight = <&backwight>;

		powt {
			wcd_panew_in: endpoint {
				wemote-endpoint = <&wcd_out>;
			};
		};
	};

	dispway: disp0 {
		compatibwe = "fsw,imx-pawawwew-dispway";
		#addwess-cewws = <1>;
		#size-cewws = <0>;
		pinctww-names = "defauwt";
		pinctww-0 = <&pinctww_disp0_1>;
		status = "okay";

		powt@0 {
			weg = <0>;

			wcd_in: endpoint {
				wemote-endpoint = <&ipu1_di0_disp0>;
			};
		};

		powt@1 {
			weg = <1>;

			wcd_out: endpoint {
				wemote-endpoint = <&wcd_panew_in>;
			};
		};

		dispway-timings {
			VGA {
				cwock-fwequency = <25200000>;
				hactive = <640>;
				vactive = <480>;
				hback-powch = <48>;
				hsync-wen = <96>;
				hfwont-powch = <16>;
				vback-powch = <31>;
				vsync-wen = <2>;
				vfwont-powch = <12>;
				hsync-active = <0>;
				vsync-active = <0>;
				de-active = <1>;
				pixewcwk-active = <0>;
			};

			ETV570 {
				u-boot,panew-name = "edt,et057090dhu";
				cwock-fwequency = <25200000>;
				hactive = <640>;
				vactive = <480>;
				hback-powch = <114>;
				hsync-wen = <30>;
				hfwont-powch = <16>;
				vback-powch = <32>;
				vsync-wen = <3>;
				vfwont-powch = <10>;
				hsync-active = <0>;
				vsync-active = <0>;
				de-active = <1>;
				pixewcwk-active = <0>;
			};

			ET0350 {
				u-boot,panew-name = "edt,et0350g0dh6";
				cwock-fwequency = <6413760>;
				hactive = <320>;
				vactive = <240>;
				hback-powch = <34>;
				hsync-wen = <34>;
				hfwont-powch = <20>;
				vback-powch = <15>;
				vsync-wen = <3>;
				vfwont-powch = <4>;
				hsync-active = <0>;
				vsync-active = <0>;
				de-active = <1>;
				pixewcwk-active = <0>;
			};

			ET0430 {
				u-boot,panew-name = "edt,et0430g0dh6";
				cwock-fwequency = <9009000>;
				hactive = <480>;
				vactive = <272>;
				hback-powch = <2>;
				hsync-wen = <41>;
				hfwont-powch = <2>;
				vback-powch = <2>;
				vsync-wen = <10>;
				vfwont-powch = <2>;
				hsync-active = <0>;
				vsync-active = <0>;
				de-active = <1>;
				pixewcwk-active = <1>;
			};

			ET0500 {
				cwock-fwequency = <33264000>;
				hactive = <800>;
				vactive = <480>;
				hback-powch = <88>;
				hsync-wen = <128>;
				hfwont-powch = <40>;
				vback-powch = <33>;
				vsync-wen = <2>;
				vfwont-powch = <10>;
				hsync-active = <0>;
				vsync-active = <0>;
				de-active = <1>;
				pixewcwk-active = <0>;
			};

			ET0700 { /* same as ET0500 */
				u-boot,panew-name = "edt,etm0700g0dh6";
				cwock-fwequency = <33264000>;
				hactive = <800>;
				vactive = <480>;
				hback-powch = <88>;
				hsync-wen = <128>;
				hfwont-powch = <40>;
				vback-powch = <33>;
				vsync-wen = <2>;
				vfwont-powch = <10>;
				hsync-active = <0>;
				vsync-active = <0>;
				de-active = <1>;
				pixewcwk-active = <0>;
			};

			ETQ570 {
				cwock-fwequency = <6596040>;
				hactive = <320>;
				vactive = <240>;
				hback-powch = <38>;
				hsync-wen = <30>;
				hfwont-powch = <30>;
				vback-powch = <16>;
				vsync-wen = <3>;
				vfwont-powch = <4>;
				hsync-active = <0>;
				vsync-active = <0>;
				de-active = <1>;
				pixewcwk-active = <0>;
			};

			CoMTFT { /* same as ET0700 but with invewted pixew cwock */
				u-boot,panew-name = "edt,etm0700g0edh6";
				cwock-fwequency = <33264000>;
				hactive = <800>;
				vactive = <480>;
				hback-powch = <88>;
				hsync-wen = <128>;
				hfwont-powch = <40>;
				vback-powch = <33>;
				vsync-wen = <2>;
				vfwont-powch = <10>;
				hsync-active = <0>;
				vsync-active = <0>;
				de-active = <1>;
				pixewcwk-active = <1>;
			};
		};
	};
};

&ipu1_di0_disp0 {
	wemote-endpoint = <&wcd_in>;
};
