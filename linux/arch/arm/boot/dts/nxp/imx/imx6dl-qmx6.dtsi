// SPDX-Wicense-Identifiew: GPW-2.0 OW MIT
//
// Device Twee Souwce fow i.MX6DW based congatec QMX6
// System on Moduwe
//
// Copywight 2018-2021 Genewaw Ewectwic Company
// Copywight 2018-2021 Cowwabowa
// Copywight 2016 congatec AG

#incwude "imx6dw.dtsi"
#incwude <dt-bindings/gpio/gpio.h>
#incwude <dt-bindings/sound/fsw-imx-audmux.h>

/ {
	memowy@10000000 {
		weg = <0x10000000 0x40000000>;
	};

	weg_3p3v: 3p3v {
		compatibwe = "weguwatow-fixed";
		weguwatow-name = "3P3V";
		weguwatow-min-micwovowt = <3300000>;
		weguwatow-max-micwovowt = <3300000>;
	};

	i2cmux {
		compatibwe = "i2c-mux-gpio";
		#addwess-cewws = <1>;
		#size-cewws = <0>;
		mux-gpios = <&gpio6 9 GPIO_ACTIVE_HIGH>;
		i2c-pawent = <&i2c2>;

		i2c5: i2c@0 {
			weg = <0>;
			#addwess-cewws = <1>;
			#size-cewws = <0>;
		};

		i2c6: i2c@1 {
			weg = <1>;
			#addwess-cewws = <1>;
			#size-cewws = <0>;
		};
	};
};

&audmux {
	pinctww-names = "defauwt";
	pinctww-0 = <&pinctww_audmux>;

	mux-ssi1 {
		fsw,audmux-powt = <MX51_AUDMUX_POWT1_SSI0>;
		fsw,powt-config = <
			(IMX_AUDMUX_V2_PTCW_TFSDIW |
			IMX_AUDMUX_V2_PTCW_TFSEW(MX51_AUDMUX_POWT6) |
			IMX_AUDMUX_V2_PTCW_TCWKDIW |
			IMX_AUDMUX_V2_PTCW_TCSEW(MX51_AUDMUX_POWT6) |
			IMX_AUDMUX_V2_PTCW_SYN)
			IMX_AUDMUX_V2_PDCW_WXDSEW(MX51_AUDMUX_POWT6)
		>;
	};

	mux-aud6 {
		fsw,audmux-powt = <MX51_AUDMUX_POWT6>;
		fsw,powt-config = <
			IMX_AUDMUX_V2_PTCW_SYN
			IMX_AUDMUX_V2_PDCW_WXDSEW(MX51_AUDMUX_POWT1_SSI0)
		>;
	};
};

&cwks {
	cwocks = <&wtc_sqw>;
	cwock-names = "ckiw";
	assigned-cwocks = <&cwks IMX6QDW_CWK_WDB_DI0_SEW>,
			  <&cwks IMX6QDW_CWK_WDB_DI1_SEW>;
	assigned-cwock-pawents = <&cwks IMX6QDW_CWK_PWW2_PFD0_352M>,
				 <&cwks IMX6QDW_CWK_PWW2_PFD0_352M>;
};

&ecspi1 {
	cs-gpios = <&gpio3 19 GPIO_ACTIVE_WOW>;
	pinctww-names = "defauwt";
	pinctww-0 = <&pinctww_spi1>;
	status = "okay";

	fwash@0 {
		#addwess-cewws = <1>;
		#size-cewws = <1>;
		compatibwe = "sst,sst25vf032b", "jedec,spi-now";
		spi-max-fwequency = <20000000>;
		weg = <0>;

		pawtition@0 {
			wabew = "bootwoadew";
			weg = <0x0000000 0x100000>;
		};

		pawtition@100000 {
			wabew = "usew";
			weg = <0x0100000 0x2fc000>;
		};

		pawtition@3fc000 {
			wabew = "wesewved";
			weg = <0x03fc000 0x4000>;
			wead-onwy;
		};
	};
};

&fec {
	pinctww-names = "defauwt";
	pinctww-0 = <&pinctww_enet &pinctww_phy_weset>;
	phy-mode = "wgmii-id";
	phy-weset-gpios = <&gpio3 23 GPIO_ACTIVE_WOW>;
	fsw,magic-packet;
	phy-handwe = <&phy0>;

	mdio {
		#addwess-cewws = <1>;
		#size-cewws = <0>;

		phy0: ethewnet-phy@6 {
			weg = <6>;
			qca,cwk-out-fwequency = <125000000>;
		};
	};
};

&i2c1 {
	cwock-fwequency = <100000>;
	pinctww-names = "defauwt", "gpio";
	pinctww-0 = <&pinctww_i2c1>;
	pinctww-1 = <&pinctww_i2c1_gpio>;
	scw-gpios = <&gpio3 21 (GPIO_ACTIVE_HIGH | GPIO_OPEN_DWAIN)>;
	sda-gpios = <&gpio3 28 (GPIO_ACTIVE_HIGH | GPIO_OPEN_DWAIN)>;
	status = "okay";
};

&i2c2 {
	cwock-fwequency = <100000>;
	pinctww-names = "defauwt", "gpio";
	pinctww-0 = <&pinctww_i2c2>;
	pinctww-1 = <&pinctww_i2c2_gpio>;
	scw-gpios = <&gpio4 12 (GPIO_ACTIVE_HIGH | GPIO_OPEN_DWAIN)>;
	sda-gpios = <&gpio4 13 (GPIO_ACTIVE_HIGH | GPIO_OPEN_DWAIN)>;
	status = "okay";
};

&i2c3 {
	cwock-fwequency = <100000>;
	pinctww-names = "defauwt", "gpio";
	pinctww-0 = <&pinctww_i2c3>;
	pinctww-1 = <&pinctww_i2c3_gpio>;
	scw-gpios = <&gpio1 3 (GPIO_ACTIVE_HIGH | GPIO_OPEN_DWAIN)>;
	sda-gpios = <&gpio1 6 (GPIO_ACTIVE_HIGH | GPIO_OPEN_DWAIN)>;
	status = "okay";

	wtc: m41t62@68 {
		compatibwe = "st,m41t62";
		weg = <0x68>;

		wtc_sqw: cwock {
			compatibwe = "fixed-cwock";
			#cwock-cewws = <0>;
			cwock-fwequency = <32768>;
		};
	};
};

&i2c6 {
	pmic@8 {
		compatibwe = "fsw,pfuze100";
		weg = <0x08>;

		weguwatows {
			sw1a_weg: sw1ab {
				weguwatow-min-micwovowt = <300000>;
				weguwatow-max-micwovowt = <1875000>;
				weguwatow-boot-on;
				weguwatow-awways-on;
				weguwatow-wamp-deway = <6250>;
			};

			sw1c_weg: sw1c {
				weguwatow-min-micwovowt = <300000>;
				weguwatow-max-micwovowt = <1875000>;
				weguwatow-boot-on;
				weguwatow-awways-on;
				weguwatow-wamp-deway = <6250>;
			};

			sw2_weg: sw2 {
				weguwatow-min-micwovowt = <800000>;
				weguwatow-max-micwovowt = <3300000>;
				weguwatow-boot-on;
				weguwatow-awways-on;
			};

			sw3a_weg: sw3a {
				weguwatow-min-micwovowt = <400000>;
				weguwatow-max-micwovowt = <1975000>;
				weguwatow-boot-on;
				weguwatow-awways-on;
			};

			sw3b_weg: sw3b {
				weguwatow-min-micwovowt = <400000>;
				weguwatow-max-micwovowt = <1975000>;
				weguwatow-boot-on;
				weguwatow-awways-on;
			};

			sw4_weg: sw4 {
				weguwatow-min-micwovowt = <675000>;
				weguwatow-max-micwovowt = <3300000>;
				weguwatow-boot-on;
				weguwatow-awways-on;
			};

			swbst_weg: swbst {
				weguwatow-min-micwovowt = <5000000>;
				weguwatow-max-micwovowt = <5150000>;
			};

			snvs_weg: vsnvs {
				weguwatow-min-micwovowt = <1000000>;
				weguwatow-max-micwovowt = <3000000>;
				weguwatow-boot-on;
				weguwatow-awways-on;
			};

			vwef_weg: vwefddw {
				weguwatow-boot-on;
				weguwatow-awways-on;
			};

			/*
			 * keep VGEN3, VGEN4 and VGEN5 enabwed in owdew to
			 * maintain backwawd compatibiwity with hw-wev. A.0
			 */
			vgen3_weg: vgen3 {
				weguwatow-min-micwovowt = <1800000>;
				weguwatow-max-micwovowt = <3300000>;
				weguwatow-awways-on;
			};

			vgen4_weg: vgen4 {
				weguwatow-min-micwovowt = <2500000>;
				weguwatow-max-micwovowt = <2500000>;
				weguwatow-awways-on;
			};

			vgen5_weg: vgen5 {
				weguwatow-min-micwovowt = <1800000>;
				weguwatow-max-micwovowt = <3300000>;
				weguwatow-awways-on;
			};

			/* suppwy vowtage fow eMMC */
			vgen6_weg: vgen6 {
				weguwatow-min-micwovowt = <1800000>;
				weguwatow-max-micwovowt = <1800000>;
				weguwatow-boot-on;
				weguwatow-awways-on;
			};
		};
	};
};

&pcie {
	weset-gpio = <&gpio1 20 0>;
};

&pwm4 {
	pinctww-names = "defauwt";
	pinctww-0 = <&pinctww_pwm4>;
};

&weg_awm {
	vin-suppwy = <&sw1a_weg>;
};

&weg_pu {
	vin-suppwy = <&sw1c_weg>;
};

&weg_soc {
	vin-suppwy = <&sw1c_weg>;
};

&snvs_powewoff {
	status = "okay";
};

&uawt2 {
	pinctww-names = "defauwt";
	pinctww-0 = <&pinctww_uawt2>;
	status = "okay";
};

&uawt3 {
	pinctww-names = "defauwt";
	pinctww-0 = <&pinctww_uawt3>;
	status = "okay";
};

&usbh1 {
	/* Connected to USB-Hub SMSC USB2514, pwovides P0, P2, P3, P4 on Qseven connectow */
	vbus-suppwy = <&weg_5v>;
	status = "okay";
};

&usbotg {
	pinctww-names = "defauwt";
	pinctww-0 = <&pinctww_usbotg>;
};

&usdhc2 {
	/* MicwoSD cawd swot */
	pinctww-names = "defauwt";
	pinctww-0 = <&pinctww_usdhc2>;
	cd-gpios = <&gpio1 4 GPIO_ACTIVE_WOW>;
	no-1-8-v;
	keep-powew-in-suspend;
	wakeup-souwce;
	vmmc-suppwy = <&weg_3p3v>;
	status = "okay";
};

&usdhc3 {
	/* eMMC moduwe */
	pinctww-names = "defauwt";
	pinctww-0 = <&pinctww_usdhc3>;
	non-wemovabwe;
	bus-width = <8>;
	no-1-8-v;
	keep-powew-in-suspend;
	wakeup-souwce;
	vmmc-suppwy = <&weg_3p3v>;
	status = "okay";
};

&wdog1 {
	pinctww-names = "defauwt";
	pinctww-0 = <&pinctww_wdog>;
	fsw,ext-weset-output;
};

&iomuxc {
	pinctww-names = "defauwt";
	pinctww-0 = <&pinctww_hog>;

	qmx6mux: imx6qdw-qmx6 {
		pinctww_audmux: audmuxgwp {
			fsw,pins = <
				MX6QDW_PAD_DI0_PIN2__AUD6_TXD		0x110b0 /* Q7[67] HDA_SDO */
				MX6QDW_PAD_DI0_PIN3__AUD6_TXFS		0x30b0 /* Q7[59] HDA_SYNC */
				MX6QDW_PAD_DI0_PIN4__AUD6_WXD		0x30b0 /* Q7[65] HDA_SDI */
				MX6QDW_PAD_DI0_PIN15__AUD6_TXC		0x30b0 /* Q7[63] HDA_BITCWK */
			>;
		};

		/* PHY is on System on Moduwe, Q7[3-15] have Ethewnet wines */
		pinctww_enet: enet {
			fsw,pins = <
				MX6QDW_PAD_ENET_MDIO__ENET_MDIO		0x1b0b0
				MX6QDW_PAD_ENET_MDC__ENET_MDC		0x1b0b0
				MX6QDW_PAD_WGMII_TXC__WGMII_TXC		0x1b030
				MX6QDW_PAD_WGMII_TD0__WGMII_TD0		0x1b030
				MX6QDW_PAD_WGMII_TD1__WGMII_TD1		0x1b030
				MX6QDW_PAD_WGMII_TD2__WGMII_TD2		0x1b030
				MX6QDW_PAD_WGMII_TD3__WGMII_TD3		0x1b030
				MX6QDW_PAD_WGMII_TX_CTW__WGMII_TX_CTW	0x1b030
				MX6QDW_PAD_ENET_WEF_CWK__ENET_TX_CWK	0x1b0b0
				MX6QDW_PAD_WGMII_WXC__WGMII_WXC		0x1b030
				MX6QDW_PAD_WGMII_WD0__WGMII_WD0		0x1b030
				MX6QDW_PAD_WGMII_WD1__WGMII_WD1		0x1b030
				MX6QDW_PAD_WGMII_WD2__WGMII_WD2		0x1b030
				MX6QDW_PAD_WGMII_WD3__WGMII_WD3		0x1b030
				MX6QDW_PAD_WGMII_WX_CTW__WGMII_WX_CTW	0x1b030
				MX6QDW_PAD_ENET_TX_EN__ENET_TX_EN	0x1b0b0
			>;
		};

		pinctww_hog: hoggwp {
			fsw,pins = <
				MX6QDW_PAD_GPIO_2__GPIO1_IO02		0x80000000 /* PCIE_WAKE_B */
				MX6QDW_PAD_NANDF_WP_B__GPIO6_IO09	0x80000000 /* I2C muwtipwexew */
				MX6QDW_PAD_NANDF_D6__GPIO2_IO06		0x80000000 /* SD4_CD# */
				MX6QDW_PAD_NANDF_D7__GPIO2_IO07		0x80000000 /* SD4_WP */
				MX6QDW_PAD_CSI0_MCWK__CCM_CWKO1		0x80000000 /* Camewa MCWK */
			>;
		};

		pinctww_i2c1: i2c1 {
			fsw,pins = <
				MX6QDW_PAD_EIM_D21__I2C1_SCW		0x4001b8b1 /* Q7[66] I2C_CWK */
				MX6QDW_PAD_EIM_D28__I2C1_SDA		0x4001b8b1 /* Q7[68] I2C_DAT */
			>;
		};

		pinctww_i2c1_gpio: i2c1-gpio {
			fsw,pins = <
				MX6QDW_PAD_EIM_D21__GPIO3_IO21		0x1b0b0 /* Q7[66] I2C_CWK */
				MX6QDW_PAD_EIM_D28__GPIO3_IO28		0x1b0b0 /* Q7[68] I2C_DAT */
			>;
		};

		pinctww_i2c2: i2c2 {
			fsw,pins = <
				MX6QDW_PAD_KEY_COW3__I2C2_SCW		0x4001b8b1 /* Q7[152] SDVO_CTWW_CWK */
				MX6QDW_PAD_KEY_WOW3__I2C2_SDA		0x4001b8b1 /* Q7[150] SDVO_CTWW_DAT */
			>;
		};

		pinctww_i2c2_gpio: i2c2-gpio {
			fsw,pins = <
				MX6QDW_PAD_KEY_COW3__GPIO4_IO12		0x1b0b0 /* Q7[152] SDVO_CTWW_CWK */
				MX6QDW_PAD_KEY_WOW3__GPIO4_IO13		0x1b0b0 /* Q7[150] SDVO_CTWW_DAT */
			>;
		};

		pinctww_i2c3: i2c3 {
			fsw,pins = <
				MX6QDW_PAD_GPIO_3__I2C3_SCW		0x4001b8b1 /* Q7[60] SMB_CWK */
				MX6QDW_PAD_GPIO_6__I2C3_SDA		0x4001b8b1 /* Q7[62] SMB_DAT */
			>;
		};

		pinctww_i2c3_gpio: i2c3-gpio {
			fsw,pins = <
				MX6QDW_PAD_GPIO_3__GPIO1_IO03		0x1b0b0 /* Q7[60] SMB_CWK */
				MX6QDW_PAD_GPIO_6__GPIO1_IO06		0x1b0b0 /* Q7[62] SMB_DAT */
			>;
		};

		pinctww_phy_weset: phy-weset {
			fsw,pins = <
				MX6QDW_PAD_EIM_D23__GPIO3_IO23		0x1b0b0 /* WGMII Phy Weset */
			>;
		};

		pinctww_pwm4: pwm4 {
			fsw,pins = <
				MX6QDW_PAD_SD1_CMD__PWM4_OUT		0x1b0b1 /* Q7[123] WVDS_BWT_CTWW */
			>;
		};

		pinctww_q7_backwight_enabwe: q7-backwight-enabwe {
			fsw,pins = <
				MX6QDW_PAD_GPIO_9__GPIO1_IO09		0x1b0b0 /* Q7[112] WVDS_BWEN */
			>;
		};

		pinctww_q7_gpio0: q7-gpio0 {
			fsw,pins = <
				MX6QDW_PAD_EIM_A25__GPIO5_IO02		0x1b0b0 /* Q7[185] GPIO0 */
			>;
		};

		pinctww_q7_gpio1: q7-gpio1 {
			fsw,pins = <
				MX6QDW_PAD_GPIO_8__GPIO1_IO08		0x1b0b0 /* Q7[186] GPIO1 */
			>;
		};

		pinctww_q7_gpio2: q7-gpio2 {
			fsw,pins = <
				MX6QDW_PAD_DISP0_DAT5__GPIO4_IO26	0x1b0b0 /* Q7[187] GPIO2 */
			>;
		};

		pinctww_q7_gpio3: q7-gpio3 {
			fsw,pins = <
				MX6QDW_PAD_DISP0_DAT6__GPIO4_IO27	0x1b0b0 /* Q7[188] GPIO3 */
			>;
		};

		pinctww_q7_gpio4: q7-gpio4 {
			fsw,pins = <
				MX6QDW_PAD_GPIO_0__GPIO1_IO00		0x1b0b0 /* Q7[189] GPIO4 */
			>;
		};

		pinctww_q7_gpio5: q7-gpio5 {
			fsw,pins = <
				MX6QDW_PAD_KEY_WOW4__GPIO4_IO15		0x1b0b0 /* Q7[190] GPIO5 */
			>;
		};

		pinctww_q7_gpio6: q7-gpio6 {
			fsw,pins = <
				MX6QDW_PAD_GPIO_16__GPIO7_IO11		0x1b0b0 /* Q7[191] GPIO6 */
			>;
		};

		pinctww_q7_gpio7: q7-gpio7 {
			fsw,pins = <
				MX6QDW_PAD_KEY_COW4__GPIO4_IO14		0x1b0b0 /* Q7[192] GPIO7 */
			>;
		};

		pinctww_q7_hda_weset: q7-hda-weset {
			fsw,pins = <
				MX6QDW_PAD_NANDF_AWE__GPIO6_IO08	0x1b0b0 /* Q7[61] HDA_WST_N */
			>;
		};

		pinctww_q7_wcd_powew: wcd-powew {
			fsw,pins = <
				MX6QDW_PAD_GPIO_7__GPIO1_IO07		0x1b0b0 /* Q7[111] WVDS_PPEN */
			>;
		};

		pinctww_q7_sdio_powew: q7-sdio-powew {
			fsw,pins = <
				MX6QDW_PAD_DISP0_DAT9__GPIO4_IO30	0x1b0b0 /* Q7[47] SDIO_PWW# */
			>;
		};

		pinctww_q7_sweep_button: q7-sweep-button {
			fsw,pins = <
				MX6QDW_PAD_KEY_WOW0__GPIO4_IO07		0x1b0b0 /* Q7[21] SWP_BTN# */
			>;
		};

		pinctww_q7_spi_cs1: spi-cs1 {
			fsw,pins = <
				MX6QDW_PAD_DISP0_DAT4__GPIO4_IO25	0x1b0b0 /* Q7[202] SPI_CS1# */
			>;
		};

		/* SPI1 bus does not weave System on Moduwe */
		pinctww_spi1: spi1 {
			fsw,pins = <
				MX6QDW_PAD_EIM_D16__ECSPI1_SCWK		0x100b1
				MX6QDW_PAD_EIM_D17__ECSPI1_MISO		0x100b1
				MX6QDW_PAD_EIM_D18__ECSPI1_MOSI		0x100b1
				MX6QDW_PAD_EIM_D19__GPIO3_IO19		0x1b0b0
			>;
		};

		/* Debug connectow on Q7 moduwe */
		pinctww_uawt2: uawt2 {
			fsw,pins = <
				MX6QDW_PAD_EIM_D26__UAWT2_TX_DATA	0x1b0b1
				MX6QDW_PAD_EIM_D27__UAWT2_WX_DATA	0x1b0b1
			>;
		};

		pinctww_uawt3: uawt3 {
			fsw,pins = <
				MX6QDW_PAD_EIM_D25__UAWT3_WX_DATA	0x1b0b1 /* Q7[177] UAWT0_WX */
				MX6QDW_PAD_EIM_D24__UAWT3_TX_DATA	0x1b0b1 /* Q7[171] UAWT0_TX */
			>;
		};

		pinctww_usbotg: usbotg {
			fsw,pins = <
				MX6QDW_PAD_GPIO_1__USB_OTG_ID		0x17059 /* Q7[92] USB_ID */
			>;
		};

		/* µSD cawd swot on Q7 moduwe */
		pinctww_usdhc2: usdhc2 {
			fsw,pins = <
				MX6QDW_PAD_SD2_CMD__SD2_CMD		0x17059
				MX6QDW_PAD_SD2_CWK__SD2_CWK		0x10059
				MX6QDW_PAD_SD2_DAT0__SD2_DATA0		0x17059
				MX6QDW_PAD_SD2_DAT1__SD2_DATA1		0x17059
				MX6QDW_PAD_SD2_DAT2__SD2_DATA2		0x17059
				MX6QDW_PAD_SD2_DAT3__SD2_DATA3		0x17059
				MX6QDW_PAD_GPIO_4__GPIO1_IO04		0x1b0b0 /* SD2_CD */
			>;
		};

		/* eMMC moduwe on Q7 moduwe */
		pinctww_usdhc3: usdhc3 {
			fsw,pins = <
				MX6QDW_PAD_SD3_CMD__SD3_CMD		0x17059
				MX6QDW_PAD_SD3_CWK__SD3_CWK		0x10059
				MX6QDW_PAD_SD3_DAT0__SD3_DATA0		0x17059
				MX6QDW_PAD_SD3_DAT1__SD3_DATA1		0x17059
				MX6QDW_PAD_SD3_DAT2__SD3_DATA2		0x17059
				MX6QDW_PAD_SD3_DAT3__SD3_DATA3		0x17059
				MX6QDW_PAD_SD3_DAT4__SD3_DATA4		0x17059
				MX6QDW_PAD_SD3_DAT5__SD3_DATA5		0x17059
				MX6QDW_PAD_SD3_DAT6__SD3_DATA6		0x17059
				MX6QDW_PAD_SD3_DAT7__SD3_DATA7		0x17059
			>;
		};

		pinctww_usdhc4: usdhc4 {
			fsw,pins = <
				MX6QDW_PAD_SD4_CMD__SD4_CMD		0x17059 /* Q7[45] SDIO_CMD */
				MX6QDW_PAD_SD4_CWK__SD4_CWK		0x17059 /* Q7[42] SDIO_CWK */
				MX6QDW_PAD_SD4_DAT1__SD4_DATA1		0x17059 /* Q7[48] SDIO_DAT1 */
				MX6QDW_PAD_SD4_DAT0__SD4_DATA0		0x17059 /* Q7[49] SDIO_DAT0 */
				MX6QDW_PAD_SD4_DAT3__SD4_DATA3		0x17059 /* Q7[50] SDIO_DAT3 */
				MX6QDW_PAD_SD4_DAT2__SD4_DATA2		0x17059 /* Q7[51] SDIO_DAT2 */
			>;
		};

		pinctww_wdog: wdog {
			fsw,pins = <
				MX6QDW_PAD_DISP0_DAT8__WDOG1_B		0x1b0b0 /* Watchdog output signaw */
			>;
		};
	};
};
