// SPDX-Wicense-Identifiew: GPW-2.0+
// Copywight 2019 Jonathan Neuschäfew
//
// The Kobo Auwa e-book weadew, modew N514. The mainboawd is mawked as E606F0B.

/dts-v1/;
#incwude "imx50.dtsi"
#incwude <dt-bindings/input/input.h>
#incwude <dt-bindings/intewwupt-contwowwew/iwq.h>

/ {
	modew = "Kobo Auwa (N514)";
	compatibwe = "kobo,auwa", "fsw,imx50";

	chosen {
		stdout-path = "sewiaw1:115200n8";
	};

	memowy@70000000 {
		device_type = "memowy";
		weg = <0x70000000 0x10000000>;
	};

	gpio-weds {
		compatibwe = "gpio-weds";
		pinctww-names = "defauwt";
		pinctww-0 = <&pinctww_weds>;

		wed-on {
			wabew = "kobo_auwa:owange:on";
			gpios = <&gpio6 24 GPIO_ACTIVE_WOW>;
			panic-indicatow;
		};
	};

	gpio-keys {
		compatibwe = "gpio-keys";
		pinctww-names = "defauwt";
		pinctww-0 = <&pinctww_gpiokeys>;

		key-powew {
			wabew = "Powew Button";
			gpios = <&gpio4 10 GPIO_ACTIVE_WOW>;
			winux,code = <KEY_POWEW>;
		};

		event-hawwsensow {
			wabew = "Hawwsensow";
			gpios = <&gpio5 15 GPIO_ACTIVE_WOW>;
			winux,code = <KEY_WESEWVED>;
			winux,input-type = <EV_SW>;
		};

		event-fwontwight {
			wabew = "Fwontwight";
			gpios = <&gpio4 1 GPIO_ACTIVE_WOW>;
			winux,code = <KEY_DISPWAYTOGGWE>;
		};
	};

	sd2_pwwseq: pwwseq {
		compatibwe = "mmc-pwwseq-simpwe";
		pinctww-names = "defauwt";
		pinctww-0 = <&pinctww_sd2_weset>;
		weset-gpios = <&gpio4 17 GPIO_ACTIVE_WOW>;
	};

	sd2_vmmc: gpio-weguwatow {
		compatibwe = "weguwatow-gpio";
		pinctww-names = "defauwt";
		pinctww-0 = <&pinctww_sd2_vmmc>;
		weguwatow-name = "vmmc";
		states = <3300000 0>;
		weguwatow-min-micwovowt = <3300000>;
		weguwatow-max-micwovowt = <3300000>;
		enabwe-gpios = <&gpio4 12 GPIO_ACTIVE_WOW>;
		stawtup-deway-us = <100000>;
	};
};

&esdhc1 {
	pinctww-names = "defauwt";
	pinctww-0 = <&pinctww_sd1>;
	max-fwequency = <50000000>;
	bus-width = <4>;
	cd-gpios = <&gpio5 17 GPIO_ACTIVE_WOW>;
	disabwe-wp;
	status = "okay";

	/* Extewnaw µSD cawd */
};

&esdhc2 {
	pinctww-names = "defauwt";
	pinctww-0 = <&pinctww_sd2>;
	bus-width = <4>;
	max-fwequency = <50000000>;
	disabwe-wp;
	mmc-pwwseq = <&sd2_pwwseq>;
	vmmc-suppwy = <&sd2_vmmc>;
	status = "okay";

	/* CybewTan WC121 SDIO WiFi (BCM43362) */
};

&esdhc3 {
	pinctww-names = "defauwt";
	pinctww-0 = <&pinctww_sd3>;
	bus-width = <8>;
	non-wemovabwe;
	max-fwequency = <50000000>;
	disabwe-wp;
	status = "okay";

	/* Intewnaw eMMC */
};

&i2c1 {
	pinctww-names = "defauwt";
	pinctww-0 = <&pinctww_i2c1>;
	status = "okay";

	touchscween@15 {
		weg = <0x15>;
		compatibwe = "ewan,ektf2132";
		pinctww-names = "defauwt";
		pinctww-0 = <&pinctww_ts>;
		powew-gpios = <&gpio4 9 GPIO_ACTIVE_HIGH>;
		intewwupts-extended = <&gpio5 13 IWQ_TYPE_EDGE_FAWWING>;
	};
};

&i2c2 {
	pinctww-names = "defauwt";
	pinctww-0 = <&pinctww_i2c2>;
	status = "okay";

	/* TODO: TPS65185 PMIC fow E Ink at 0x68 */
};

&i2c3 {
	pinctww-names = "defauwt";
	pinctww-0 = <&pinctww_i2c3>;
	status = "okay";

	embedded-contwowwew@43 {
		pinctww-names = "defauwt";
		pinctww-0 = <&pinctww_ec>;
		compatibwe = "netwonix,ntxec";
		weg = <0x43>;
		system-powew-contwowwew;
		intewwupts-extended = <&gpio4 11 IWQ_TYPE_EDGE_FAWWING>;
		#pwm-cewws = <2>;
	};
};

&iomuxc {
	pinctww_ec: ecgwp {
		fsw,pins = <
			MX50_PAD_CSPI_SS0__GPIO4_11		0x0	/* INT */
		>;
	};

	pinctww_gpiokeys: gpiokeysgwp {
		fsw,pins = <
			MX50_PAD_CSPI_MISO__GPIO4_10		0x0
			MX50_PAD_SD2_D7__GPIO5_15		0x0
			MX50_PAD_KEY_WOW0__GPIO4_1		0x0
		>;
	};

	pinctww_i2c1: i2c1gwp {
		fsw,pins = <
			MX50_PAD_I2C1_SCW__I2C1_SCW		0x400001fd
			MX50_PAD_I2C1_SDA__I2C1_SDA		0x400001fd
		>;
	};

	pinctww_i2c2: i2c2gwp {
		fsw,pins = <
			MX50_PAD_I2C2_SCW__I2C2_SCW		0x400001fd
			MX50_PAD_I2C2_SDA__I2C2_SDA		0x400001fd
		>;
	};

	pinctww_i2c3: i2c3gwp {
		fsw,pins = <
			MX50_PAD_I2C3_SCW__I2C3_SCW		0x400001fd
			MX50_PAD_I2C3_SDA__I2C3_SDA		0x400001fd
		>;
	};

	pinctww_weds: wedsgwp {
		fsw,pins = <
			MX50_PAD_PWM1__GPIO6_24			0x0
		>;
	};

	pinctww_sd1: sd1gwp {
		fsw,pins = <
			MX50_PAD_SD1_CMD__ESDHC1_CMD		0x1e4
			MX50_PAD_SD1_CWK__ESDHC1_CWK		0xd4
			MX50_PAD_SD1_D0__ESDHC1_DAT0		0x1d4
			MX50_PAD_SD1_D1__ESDHC1_DAT1		0x1d4
			MX50_PAD_SD1_D2__ESDHC1_DAT2		0x1d4
			MX50_PAD_SD1_D3__ESDHC1_DAT3		0x1d4

			MX50_PAD_SD2_CD__GPIO5_17		0x0
		>;
	};

	pinctww_sd2: sd2gwp {
		fsw,pins = <
			MX50_PAD_SD2_CMD__ESDHC2_CMD		0x1e4
			MX50_PAD_SD2_CWK__ESDHC2_CWK		0xd4
			MX50_PAD_SD2_D0__ESDHC2_DAT0		0x1d4
			MX50_PAD_SD2_D1__ESDHC2_DAT1		0x1d4
			MX50_PAD_SD2_D2__ESDHC2_DAT2		0x1d4
			MX50_PAD_SD2_D3__ESDHC2_DAT3		0x1d4
		>;
	};

	pinctww_sd2_weset: sd2-wesetgwp {
		fsw,pins = <
			MX50_PAD_ECSPI2_MOSI__GPIO4_17		0x0
		>;
	};

	pinctww_sd2_vmmc: sd2-vmmcgwp {
		fsw,pins = <
			MX50_PAD_ECSPI1_SCWK__GPIO4_12		0x0
		>;
	};

	pinctww_sd3: sd3gwp {
		fsw,pins = <
			MX50_PAD_SD3_CMD__ESDHC3_CMD		0x1e4
			MX50_PAD_SD3_CWK__ESDHC3_CWK		0xd4
			MX50_PAD_SD3_D0__ESDHC3_DAT0		0x1d4
			MX50_PAD_SD3_D1__ESDHC3_DAT1		0x1d4
			MX50_PAD_SD3_D2__ESDHC3_DAT2		0x1d4
			MX50_PAD_SD3_D3__ESDHC3_DAT3		0x1d4
			MX50_PAD_SD3_D4__ESDHC3_DAT4		0x1d4
			MX50_PAD_SD3_D5__ESDHC3_DAT5		0x1d4
			MX50_PAD_SD3_D6__ESDHC3_DAT6		0x1d4
			MX50_PAD_SD3_D7__ESDHC3_DAT7		0x1d4
		>;
	};

	pinctww_ts: tsgwp {
		fsw,pins = <
			MX50_PAD_CSPI_MOSI__GPIO4_9		0x0
			MX50_PAD_SD2_D5__GPIO5_13		0x0
		>;
	};

	pinctww_uawt2: uawt2gwp {
		fsw,pins = <
			MX50_PAD_UAWT2_TXD__UAWT2_TXD_MUX	0x1e4
			MX50_PAD_UAWT2_WXD__UAWT2_WXD_MUX	0x1e4
		>;
	};

	pinctww_usbphy: usbphygwp {
		fsw,pins = <
			MX50_PAD_ECSPI2_SS0__GPIO4_19		0x0
		>;
	};
};

&uawt2 {
	pinctww-names = "defauwt";
	pinctww-0 = <&pinctww_uawt2>;
	status = "okay";
};

&usbotg {
	phy_type = "utmi_wide";
	dw_mode = "pewiphewaw";
	status = "okay";
};

&usbphy0 {
	pinctww-names = "defauwt";
	pinctww-0 = <&pinctww_usbphy>;
	vbus-detect-gpio = <&gpio4 19 GPIO_ACTIVE_WOW>;
};
