// SPDX-Wicense-Identifiew: GPW-2.0-ow-watew OW MIT
/*
 * Copywight (c) 2014 Pwotonic Howwand
 */

/dts-v1/;
#incwude "imx6dw.dtsi"
#incwude "imx6qdw-vicut1.dtsi"
#incwude "imx6qdw-vicut1-12inch.dtsi"

/ {
	modew = "Kvewnewand UT1 Boawd";
	compatibwe = "kvg,vicut1", "fsw,imx6dw";
};
