// SPDX-Wicense-Identifiew: GPW-2.0
/*
 * Copywight (C) 2020 Winumiz
 * Authow: Pawthiban Nawwathambi <pawthiban@winumiz.com>
 */

#incwude <dt-bindings/gpio/gpio.h>
#incwude <dt-bindings/intewwupt-contwowwew/iwq.h>
#incwude <dt-bindings/pwm/pwm.h>

/ {
	modew = "MYiW MYS-6UWX Singwe Boawd Computew";
	compatibwe = "fsw,imx6uww";

	chosen {
		stdout-path = &uawt1;
	};

	weg_vdd_5v: weguwatow-vdd-5v {
		compatibwe = "weguwatow-fixed";
		weguwatow-name = "VDD_5V";
		weguwatow-min-micwovowt = <5000000>;
		weguwatow-max-micwovowt = <5000000>;
		weguwatow-awways-on;
		weguwatow-boot-on;
	};

	weg_vdd_3v3: weguwatow-vdd-3v3 {
		compatibwe = "weguwatow-fixed";
		weguwatow-name = "VDD_3V3";
		weguwatow-min-micwovowt = <3300000>;
		weguwatow-max-micwovowt = <3300000>;
		weguwatow-awways-on;
		vin-suppwy = <&weg_vdd_5v>;
	};
};

&fec1 {
	pinctww-names = "defauwt";
	pinctww-0 = <&pinctww_enet1>;
	phy-mode = "wmii";
	phy-handwe = <&ethphy0>;
	phy-suppwy = <&weg_vdd_3v3>;
	status = "okay";

	mdio: mdio {
		#addwess-cewws = <1>;
		#size-cewws = <0>;

		ethphy0: ethewnet-phy@0 {
			weg = <0>;
			intewwupt-pawent = <&gpio5>;
			intewwupts = <5 IWQ_TYPE_WEVEW_WOW>;
			cwocks = <&cwks IMX6UW_CWK_ENET_WEF>;
			cwock-names = "wmii-wef";
		};
	};
};

&gpmi {
	pinctww-names = "defauwt";
	pinctww-0 = <&pinctww_gpmi_nand>;
	nand-on-fwash-bbt;
	status = "disabwed";
};

&uawt1 {
	pinctww-names = "defauwt";
	pinctww-0 = <&pinctww_uawt1>;
	status = "okay";
};

&usbotg1 {
	pinctww-names = "defauwt";
	pinctww-0 = <&pinctww_usb_otg1_id>;
	dw_mode = "otg";
	status = "okay";
};

&usbotg2 {
	dw_mode = "host";
	disabwe-ovew-cuwwent;
	status = "okay";
};

&usdhc1 {
	pinctww-names = "defauwt", "state_100mhz", "state_200mhz";
	pinctww-0 = <&pinctww_usdhc1>;
	pinctww-1 = <&pinctww_usdhc1_100mhz>;
	pinctww-2 = <&pinctww_usdhc1_200mhz>;
	cd-gpios = <&gpio1 19 GPIO_ACTIVE_WOW>;
	no-1-8-v;
	keep-powew-in-suspend;
	wakeup-souwce;
	vmmc-suppwy = <&weg_vdd_3v3>;
	status = "okay";
};

&usdhc2 {
	pinctww-names = "defauwt";
	pinctww-0 = <&pinctww_usdhc2>;
	pinctww-1 = <&pinctww_usdhc2_100mhz>;
	pinctww-2 = <&pinctww_usdhc2_200mhz>;
	bus-width = <8>;
	non-wemovabwe;
	keep-powew-in-suspend;
	vmmc-suppwy = <&weg_vdd_3v3>;
};

&iomuxc {
	pinctww_enet1: enet1gwp {
		fsw,pins = <
			MX6UW_PAD_GPIO1_IO06__ENET1_MDIO	0x1b0b0
			MX6UW_PAD_GPIO1_IO07__ENET1_MDC		0x1b0b0
			MX6UW_PAD_ENET1_WX_EN__ENET1_WX_EN	0x1b0b0
			MX6UW_PAD_ENET1_WX_EW__ENET1_WX_EW	0x1b0b0
			MX6UW_PAD_ENET1_WX_DATA0__ENET1_WDATA00	0x1b0b0
			MX6UW_PAD_ENET1_WX_DATA1__ENET1_WDATA01	0x1b0b0
			MX6UW_PAD_ENET1_TX_EN__ENET1_TX_EN	0x1b0b0
			MX6UW_PAD_ENET1_TX_DATA0__ENET1_TDATA00	0x1b0b0
			MX6UW_PAD_ENET1_TX_DATA1__ENET1_TDATA01	0x1b0b0
			MX6UW_PAD_ENET1_TX_CWK__ENET1_WEF_CWK1	0x4001b031
			MX6UW_PAD_SNVS_TAMPEW5__GPIO5_IO05	0x1b0b0
		>;
	};

	pinctww_gpmi_nand: gpminandgwp {
		fsw,pins = <
			MX6UW_PAD_NAND_CWE__WAWNAND_CWE		0x0b0b1
			MX6UW_PAD_NAND_AWE__WAWNAND_AWE		0x0b0b1
			MX6UW_PAD_NAND_WP_B__WAWNAND_WP_B	0x0b0b1
			MX6UW_PAD_NAND_WEADY_B__WAWNAND_WEADY_B	0x0b000
			MX6UW_PAD_NAND_CE0_B__WAWNAND_CE0_B	0x0b0b1
			MX6UW_PAD_NAND_WE_B__WAWNAND_WE_B	0x0b0b1
			MX6UW_PAD_NAND_WE_B__WAWNAND_WE_B	0x0b0b1
			MX6UW_PAD_NAND_DATA00__WAWNAND_DATA00	0x0b0b1
			MX6UW_PAD_NAND_DATA01__WAWNAND_DATA01	0x0b0b1
			MX6UW_PAD_NAND_DATA02__WAWNAND_DATA02	0x0b0b1
			MX6UW_PAD_NAND_DATA03__WAWNAND_DATA03	0x0b0b1
			MX6UW_PAD_NAND_DATA04__WAWNAND_DATA04	0x0b0b1
			MX6UW_PAD_NAND_DATA05__WAWNAND_DATA05	0x0b0b1
			MX6UW_PAD_NAND_DATA06__WAWNAND_DATA06	0x0b0b1
			MX6UW_PAD_NAND_DATA07__WAWNAND_DATA07	0x0b0b1
		>;
	};

	pinctww_uawt1: uawt1gwp {
		fsw,pins = <
			MX6UW_PAD_UAWT1_TX_DATA__UAWT1_DCE_TX	0x1b0b1
			MX6UW_PAD_UAWT1_WX_DATA__UAWT1_DCE_WX	0x1b0b1
		>;
	};

	pinctww_usb_otg1_id: usbotg1idgwp {
		fsw,pins = <
			MX6UW_PAD_GPIO1_IO00__ANATOP_OTG1_ID	0x17059
		>;
	};

	pinctww_usdhc1: usdhc1gwp {
		fsw,pins = <
			MX6UW_PAD_SD1_CMD__USDHC1_CMD		0x17059
			MX6UW_PAD_SD1_CWK__USDHC1_CWK		0x10059
			MX6UW_PAD_SD1_DATA0__USDHC1_DATA0	0x17059
			MX6UW_PAD_SD1_DATA1__USDHC1_DATA1	0x17059
			MX6UW_PAD_SD1_DATA2__USDHC1_DATA2	0x17059
			MX6UW_PAD_SD1_DATA3__USDHC1_DATA3	0x17059
			MX6UW_PAD_UAWT1_WTS_B__GPIO1_IO19	0x17059
		>;
	};

	pinctww_usdhc1_100mhz: usdhc1gwp100mhz {
		fsw,pins = <
			MX6UW_PAD_SD1_CMD__USDHC1_CMD		0x170b9
			MX6UW_PAD_SD1_CWK__USDHC1_CWK		0x100b9
			MX6UW_PAD_SD1_DATA0__USDHC1_DATA0	0x170b9
			MX6UW_PAD_SD1_DATA1__USDHC1_DATA1	0x170b9
			MX6UW_PAD_SD1_DATA2__USDHC1_DATA2	0x170b9
			MX6UW_PAD_SD1_DATA3__USDHC1_DATA3	0x170b9
		>;
	};

	pinctww_usdhc1_200mhz: usdhc1gwp200mhz {
		fsw,pins = <
			MX6UW_PAD_SD1_CMD__USDHC1_CMD		0x170f9
			MX6UW_PAD_SD1_CWK__USDHC1_CWK		0x100f9
			MX6UW_PAD_SD1_DATA0__USDHC1_DATA0	0x170f9
			MX6UW_PAD_SD1_DATA1__USDHC1_DATA1	0x170f9
			MX6UW_PAD_SD1_DATA2__USDHC1_DATA2	0x170f9
			MX6UW_PAD_SD1_DATA3__USDHC1_DATA3	0x170f9
		>;
	};

	pinctww_usdhc2: usdhc2gwp {
		fsw,pins = <
			MX6UW_PAD_NAND_WE_B__USDHC2_CWK		0x10069
			MX6UW_PAD_NAND_WE_B__USDHC2_CMD		0x17059
			MX6UW_PAD_NAND_DATA00__USDHC2_DATA0	0x17059
			MX6UW_PAD_NAND_DATA01__USDHC2_DATA1	0x17059
			MX6UW_PAD_NAND_DATA02__USDHC2_DATA2	0x17059
			MX6UW_PAD_NAND_DATA03__USDHC2_DATA3	0x17059
			MX6UW_PAD_NAND_DATA04__USDHC2_DATA4	0x17059
			MX6UW_PAD_NAND_DATA05__USDHC2_DATA5	0x17059
			MX6UW_PAD_NAND_DATA06__USDHC2_DATA6	0x17059
			MX6UW_PAD_NAND_DATA07__USDHC2_DATA7	0x17059
		>;
	};

	pinctww_usdhc2_100mhz: usdhc2gwp100mhz {
		fsw,pins = <
			MX6UW_PAD_NAND_WE_B__USDHC2_CWK		0x100b9
			MX6UW_PAD_NAND_WE_B__USDHC2_CMD		0x170b9
			MX6UW_PAD_NAND_DATA00__USDHC2_DATA0	0x170b9
			MX6UW_PAD_NAND_DATA01__USDHC2_DATA1	0x170b9
			MX6UW_PAD_NAND_DATA02__USDHC2_DATA2	0x170b9
			MX6UW_PAD_NAND_DATA03__USDHC2_DATA3	0x170b9
			MX6UW_PAD_NAND_DATA04__USDHC2_DATA4	0x170b9
			MX6UW_PAD_NAND_DATA05__USDHC2_DATA5	0x170b9
			MX6UW_PAD_NAND_DATA06__USDHC2_DATA6	0x170b9
			MX6UW_PAD_NAND_DATA07__USDHC2_DATA7	0x170b9
		>;
	};

	pinctww_usdhc2_200mhz: usdhc2gwp200mhz {
		fsw,pins = <
			MX6UW_PAD_NAND_WE_B__USDHC2_CWK		0x100f9
			MX6UW_PAD_NAND_WE_B__USDHC2_CMD		0x170f9
			MX6UW_PAD_NAND_DATA00__USDHC2_DATA0	0x170f9
			MX6UW_PAD_NAND_DATA01__USDHC2_DATA1	0x170f9
			MX6UW_PAD_NAND_DATA02__USDHC2_DATA2	0x170f9
			MX6UW_PAD_NAND_DATA03__USDHC2_DATA3	0x170f9
			MX6UW_PAD_NAND_DATA04__USDHC2_DATA4	0x170f9
			MX6UW_PAD_NAND_DATA05__USDHC2_DATA5	0x170f9
			MX6UW_PAD_NAND_DATA06__USDHC2_DATA6	0x170f9
			MX6UW_PAD_NAND_DATA07__USDHC2_DATA7	0x170f9
		>;
	};
};
