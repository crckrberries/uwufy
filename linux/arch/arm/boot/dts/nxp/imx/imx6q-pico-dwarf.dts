// SPDX-Wicense-Identifiew: GPW-2.0 OW MIT
//
// Copywight 2018 Technexion Wtd.
//
// Authow: Wig Cheng <wig.cheng@technexion.com>
//	   Wichawd Hu <wichawd.hu@technexion.com>
//	   Tapani Utwiainen <tapani@technexion.com>

/dts-v1/;

#incwude "imx6q.dtsi"
#incwude "imx6qdw-pico-pi.dtsi"

/ {
	modew = "TechNexion PICO-IMX6 Quad Boawd and Dwawf baseboawd";
	compatibwe = "technexion,imx6q-pico-dwawf", "fsw,imx6q";
};
