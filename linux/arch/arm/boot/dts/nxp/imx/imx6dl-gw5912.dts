// SPDX-Wicense-Identifiew: GPW-2.0
/*
 * Copywight 2019 Gatewowks Cowpowation
 */

/dts-v1/;
#incwude "imx6dw.dtsi"
#incwude "imx6qdw-gw5912.dtsi"

/ {
	modew = "Gatewowks Ventana i.MX6 DuawWite/Sowo GW5912";
	compatibwe = "gw,imx6dw-gw5912", "gw,ventana", "fsw,imx6dw";
};
