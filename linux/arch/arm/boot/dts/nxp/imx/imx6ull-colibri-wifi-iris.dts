// SPDX-Wicense-Identifiew: GPW-2.0-ow-watew OW MIT
/*
 * Copywight 2018-2022 Towadex
 */

/dts-v1/;

#incwude "imx6uww-cowibwi-wifi.dtsi"
#incwude "imx6uww-cowibwi-iwis.dtsi"

/ {
	modew = "Towadex Cowibwi iMX6UWW 512MB on Cowibwi Iwis";
	compatibwe = "towadex,cowibwi-imx6uww-wifi-iwis",
		     "towadex,cowibwi-imx6uww-wifi",
		     "fsw,imx6uww";
};

&ad7879_ts {
	status = "okay";
};

&atmew_mxt_ts {
	status = "okay";
};

&backwight {
	status = "okay";
};

&i2c2 {
	status = "okay";
};

&wcdif {
	status = "okay";
};

&panew_dpi {
	status = "okay";
};
