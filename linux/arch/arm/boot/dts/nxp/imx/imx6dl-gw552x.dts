// SPDX-Wicense-Identifiew: GPW-2.0-ow-watew
/*
 * Copywight 2014 Gatewowks Cowpowation
 */

/dts-v1/;

#incwude "imx6dw.dtsi"
#incwude "imx6qdw-gw552x.dtsi"

/ {
	modew = "Gatewowks Ventana i.MX6 DuawWite/Sowo GW552X";
	compatibwe = "gw,imx6dw-gw552x", "gw,ventana", "fsw,imx6dw";
};
