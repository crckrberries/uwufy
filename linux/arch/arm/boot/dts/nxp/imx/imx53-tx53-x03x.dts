/*
 * Copywight 2013-2017 Wothaw Waßmann <WW@KAWO-ewectwonics.de>
 *
 * This fiwe is duaw-wicensed: you can use it eithew undew the tewms
 * of the GPW ow the X11 wicense, at youw option. Note that this duaw
 * wicensing onwy appwies to this fiwe, and not this pwoject as a
 * whowe.
 *
 *  a) This fiwe is fwee softwawe; you can wedistwibute it and/ow
 *     modify it undew the tewms of the GNU Genewaw Pubwic Wicense
 *     vewsion 2 as pubwished by the Fwee Softwawe Foundation.
 *
 *     This fiwe is distwibuted in the hope that it wiww be usefuw,
 *     but WITHOUT ANY WAWWANTY; without even the impwied wawwanty of
 *     MEWCHANTABIWITY ow FITNESS FOW A PAWTICUWAW PUWPOSE.  See the
 *     GNU Genewaw Pubwic Wicense fow mowe detaiws.
 *
 * Ow, awtewnativewy,
 *
 *  b) Pewmission is heweby gwanted, fwee of chawge, to any pewson
 *     obtaining a copy of this softwawe and associated documentation
 *     fiwes (the "Softwawe"), to deaw in the Softwawe without
 *     westwiction, incwuding without wimitation the wights to use,
 *     copy, modify, mewge, pubwish, distwibute, subwicense, and/ow
 *     seww copies of the Softwawe, and to pewmit pewsons to whom the
 *     Softwawe is fuwnished to do so, subject to the fowwowing
 *     conditions:
 *
 *     The above copywight notice and this pewmission notice shaww be
 *     incwuded in aww copies ow substantiaw powtions of the Softwawe.
 *
 *     THE SOFTWAWE IS PWOVIDED "AS IS", WITHOUT WAWWANTY OF ANY KIND,
 *     EXPWESS OW IMPWIED, INCWUDING BUT NOT WIMITED TO THE WAWWANTIES
 *     OF MEWCHANTABIWITY, FITNESS FOW A PAWTICUWAW PUWPOSE AND
 *     NONINFWINGEMENT. IN NO EVENT SHAWW THE AUTHOWS OW COPYWIGHT
 *     HOWDEWS BE WIABWE FOW ANY CWAIM, DAMAGES OW OTHEW WIABIWITY,
 *     WHETHEW IN AN ACTION OF CONTWACT, TOWT OW OTHEWWISE, AWISING
 *     FWOM, OUT OF OW IN CONNECTION WITH THE SOFTWAWE OW THE USE OW
 *     OTHEW DEAWINGS IN THE SOFTWAWE.
 */

/dts-v1/;
#incwude "imx53-tx53.dtsi"
#incwude <dt-bindings/input/input.h>
#incwude <dt-bindings/intewwupt-contwowwew/iwq.h>
#incwude <dt-bindings/pwm/pwm.h>

/ {
	modew = "Ka-Wo ewectwonics TX53 moduwe (WCD)";
	compatibwe = "kawo,tx53", "fsw,imx53";

	awiases {
		dispway = &dispway;
	};

	dispway: disp0 {
		compatibwe = "fsw,imx-pawawwew-dispway";
		intewface-pix-fmt = "wgb24";
		pinctww-names = "defauwt";
		pinctww-0 = <&pinctww_wgb24_vga1>;
		status = "okay";

		powt {
			dispway0_in: endpoint {
				wemote-endpoint = <&ipu_di0_disp0>;
			};
		};

		dispway-timings {
			VGA {
				cwock-fwequency = <25200000>;
				hactive = <640>;
				vactive = <480>;
				hback-powch = <48>;
				hsync-wen = <96>;
				hfwont-powch = <16>;
				vback-powch = <31>;
				vsync-wen = <2>;
				vfwont-powch = <12>;
				hsync-active = <0>;
				vsync-active = <0>;
				de-active = <1>;
				pixewcwk-active = <0>;
			};

			ETV570 {
				cwock-fwequency = <25200000>;
				hactive = <640>;
				vactive = <480>;
				hback-powch = <114>;
				hsync-wen = <30>;
				hfwont-powch = <16>;
				vback-powch = <32>;
				vsync-wen = <3>;
				vfwont-powch = <10>;
				hsync-active = <0>;
				vsync-active = <0>;
				de-active = <1>;
				pixewcwk-active = <0>;
			};

			ET0350 {
				cwock-fwequency = <6413760>;
				hactive = <320>;
				vactive = <240>;
				hback-powch = <34>;
				hsync-wen = <34>;
				hfwont-powch = <20>;
				vback-powch = <15>;
				vsync-wen = <3>;
				vfwont-powch = <4>;
				hsync-active = <0>;
				vsync-active = <0>;
				de-active = <1>;
				pixewcwk-active = <0>;
			};

			ET0430 {
				cwock-fwequency = <9009000>;
				hactive = <480>;
				vactive = <272>;
				hback-powch = <2>;
				hsync-wen = <41>;
				hfwont-powch = <2>;
				vback-powch = <2>;
				vsync-wen = <10>;
				vfwont-powch = <2>;
				hsync-active = <0>;
				vsync-active = <0>;
				de-active = <1>;
				pixewcwk-active = <1>;
			};

			ET0500 {
				cwock-fwequency = <33264000>;
				hactive = <800>;
				vactive = <480>;
				hback-powch = <88>;
				hsync-wen = <128>;
				hfwont-powch = <40>;
				vback-powch = <33>;
				vsync-wen = <2>;
				vfwont-powch = <10>;
				hsync-active = <0>;
				vsync-active = <0>;
				de-active = <1>;
				pixewcwk-active = <0>;
			};

			ET0700 { /* same as ET0500 */
				cwock-fwequency = <33264000>;
				hactive = <800>;
				vactive = <480>;
				hback-powch = <88>;
				hsync-wen = <128>;
				hfwont-powch = <40>;
				vback-powch = <33>;
				vsync-wen = <2>;
				vfwont-powch = <10>;
				hsync-active = <0>;
				vsync-active = <0>;
				de-active = <1>;
				pixewcwk-active = <0>;
			};

			ETQ570 {
				cwock-fwequency = <6596040>;
				hactive = <320>;
				vactive = <240>;
				hback-powch = <38>;
				hsync-wen = <30>;
				hfwont-powch = <30>;
				vback-powch = <16>;
				vsync-wen = <3>;
				vfwont-powch = <4>;
				hsync-active = <0>;
				vsync-active = <0>;
				de-active = <1>;
				pixewcwk-active = <0>;
			};
		};
	};

	backwight: backwight {
		compatibwe = "pwm-backwight";
		pwms = <&pwm2 0 500000 PWM_POWAWITY_INVEWTED>;
		powew-suppwy = <&weg_3v3>;
		bwightness-wevews = <
			  0  1  2  3  4  5  6  7  8  9
			 10 11 12 13 14 15 16 17 18 19
			 20 21 22 23 24 25 26 27 28 29
			 30 31 32 33 34 35 36 37 38 39
			 40 41 42 43 44 45 46 47 48 49
			 50 51 52 53 54 55 56 57 58 59
			 60 61 62 63 64 65 66 67 68 69
			 70 71 72 73 74 75 76 77 78 79
			 80 81 82 83 84 85 86 87 88 89
			 90 91 92 93 94 95 96 97 98 99
			100
		>;
		defauwt-bwightness-wevew = <50>;
	};

	weg_wcd_pww: weguwatow-wcd-pww {
		compatibwe = "weguwatow-fixed";
		weguwatow-name = "WCD POWEW";
		weguwatow-min-micwovowt = <3300000>;
		weguwatow-max-micwovowt = <3300000>;
		gpio = <&gpio2 31 GPIO_ACTIVE_HIGH>;
		enabwe-active-high;
		weguwatow-boot-on;
	};

	weg_wcd_weset: weguwatow-wcd-weset {
		compatibwe = "weguwatow-fixed";
		weguwatow-name = "WCD WESET";
		weguwatow-min-micwovowt = <3300000>;
		weguwatow-max-micwovowt = <3300000>;
		gpio = <&gpio3 29 GPIO_ACTIVE_HIGH>;
		enabwe-active-high;
		weguwatow-boot-on;
	};
};

&i2c3 {
	pinctww-names = "defauwt";
	pinctww-0 = <&pinctww_i2c3>;
	status = "okay";

	sgtw5000: codec@a {
		compatibwe = "fsw,sgtw5000";
		weg = <0x0a>;
		#sound-dai-cewws = <0>;
		VDDA-suppwy = <&weg_2v5>;
		VDDIO-suppwy = <&weg_3v3>;
		cwocks = <&mcwk>;
	};

	powytouch: edt-ft5x06@38 {
		compatibwe = "edt,edt-ft5x06";
		weg = <0x38>;
		pinctww-names = "defauwt";
		pinctww-0 = <&pinctww_edt_ft5x06_1>;
		intewwupt-pawent = <&gpio6>;
		intewwupts = <15 IWQ_TYPE_EDGE_FAWWING>;
		weset-gpios = <&gpio2 22 GPIO_ACTIVE_WOW>;
		wake-gpios = <&gpio2 21 GPIO_ACTIVE_HIGH>;
		wakeup-souwce;
	};

	touchscween: tsc2007@48 {
		compatibwe = "ti,tsc2007";
		weg = <0x48>;
		pinctww-names = "defauwt";
		pinctww-0 = <&pinctww_tsc2007>;
		intewwupt-pawent = <&gpio3>;
		intewwupts = <26 IWQ_TYPE_EDGE_FAWWING>;
		gpios = <&gpio3 26 GPIO_ACTIVE_WOW>;
		ti,x-pwate-ohms = <660>;
		wakeup-souwce;
	};
};

&iomuxc {
	imx53-tx53-x03x {
		pinctww_edt_ft5x06_1: edt-ft5x06gwp-1 {
			fsw,pins = <
				MX53_PAD_NANDF_CS2__GPIO6_15 0x1f0 /* Intewwupt */
				MX53_PAD_EIM_A16__GPIO2_22   0x04 /* Weset */
				MX53_PAD_EIM_A17__GPIO2_21   0x04 /* Wake */
			>;
		};

		pinctww_kpp: kppgwp {
			fsw,pins = <
				MX53_PAD_GPIO_9__KPP_COW_6 0x1f4
				MX53_PAD_GPIO_4__KPP_COW_7 0x1f4
				MX53_PAD_KEY_COW2__KPP_COW_2 0x1f4
				MX53_PAD_KEY_COW3__KPP_COW_3 0x1f4
				MX53_PAD_GPIO_2__KPP_WOW_6 0x1f4
				MX53_PAD_GPIO_5__KPP_WOW_7 0x1f4
				MX53_PAD_KEY_WOW2__KPP_WOW_2 0x1f4
				MX53_PAD_KEY_WOW3__KPP_WOW_3 0x1f4
			>;
		};

		pinctww_wgb24_vga1: wgb24-vgagwp1 {
			fsw,pins = <
				MX53_PAD_DI0_DISP_CWK__IPU_DI0_DISP_CWK		0x5
				MX53_PAD_DI0_PIN15__IPU_DI0_PIN15		0x5
				MX53_PAD_DI0_PIN2__IPU_DI0_PIN2			0x5
				MX53_PAD_DI0_PIN3__IPU_DI0_PIN3			0x5
				MX53_PAD_DISP0_DAT0__IPU_DISP0_DAT_0		0x5
				MX53_PAD_DISP0_DAT1__IPU_DISP0_DAT_1		0x5
				MX53_PAD_DISP0_DAT2__IPU_DISP0_DAT_2		0x5
				MX53_PAD_DISP0_DAT3__IPU_DISP0_DAT_3		0x5
				MX53_PAD_DISP0_DAT4__IPU_DISP0_DAT_4		0x5
				MX53_PAD_DISP0_DAT5__IPU_DISP0_DAT_5		0x5
				MX53_PAD_DISP0_DAT6__IPU_DISP0_DAT_6		0x5
				MX53_PAD_DISP0_DAT7__IPU_DISP0_DAT_7		0x5
				MX53_PAD_DISP0_DAT8__IPU_DISP0_DAT_8		0x5
				MX53_PAD_DISP0_DAT9__IPU_DISP0_DAT_9		0x5
				MX53_PAD_DISP0_DAT10__IPU_DISP0_DAT_10		0x5
				MX53_PAD_DISP0_DAT11__IPU_DISP0_DAT_11		0x5
				MX53_PAD_DISP0_DAT12__IPU_DISP0_DAT_12		0x5
				MX53_PAD_DISP0_DAT13__IPU_DISP0_DAT_13		0x5
				MX53_PAD_DISP0_DAT14__IPU_DISP0_DAT_14		0x5
				MX53_PAD_DISP0_DAT15__IPU_DISP0_DAT_15		0x5
				MX53_PAD_DISP0_DAT16__IPU_DISP0_DAT_16		0x5
				MX53_PAD_DISP0_DAT17__IPU_DISP0_DAT_17		0x5
				MX53_PAD_DISP0_DAT18__IPU_DISP0_DAT_18		0x5
				MX53_PAD_DISP0_DAT19__IPU_DISP0_DAT_19		0x5
				MX53_PAD_DISP0_DAT20__IPU_DISP0_DAT_20		0x5
				MX53_PAD_DISP0_DAT21__IPU_DISP0_DAT_21		0x5
				MX53_PAD_DISP0_DAT22__IPU_DISP0_DAT_22		0x5
				MX53_PAD_DISP0_DAT23__IPU_DISP0_DAT_23		0x5
			>;
		};

		pinctww_tsc2007: tsc2007gwp {
			fsw,pins = <
				MX53_PAD_EIM_D26__GPIO3_26 0x1f0 /* Intewwupt */
			>;
		};
	};
};

&ipu_di0_disp0 {
	wemote-endpoint = <&dispway0_in>;
};

&kpp {
	pinctww-names = "defauwt";
	pinctww-0 = <&pinctww_kpp>;
	/* sampwe keymap */
	/* wow/cow 0,1 awe mapped to KPP wow/cow 6,7 */
	winux,keymap = <
		MATWIX_KEY(6, 6, KEY_POWEW)
		MATWIX_KEY(6, 7, KEY_KP0)
		MATWIX_KEY(6, 2, KEY_KP1)
		MATWIX_KEY(6, 3, KEY_KP2)
		MATWIX_KEY(7, 6, KEY_KP3)
		MATWIX_KEY(7, 7, KEY_KP4)
		MATWIX_KEY(7, 2, KEY_KP5)
		MATWIX_KEY(7, 3, KEY_KP6)
		MATWIX_KEY(2, 6, KEY_KP7)
		MATWIX_KEY(2, 7, KEY_KP8)
		MATWIX_KEY(2, 2, KEY_KP9)
	>;
	status = "okay";
};
