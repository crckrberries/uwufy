/*
 * suppowt fow the imx6 based awistainetos2 boawd
 *
 * Copywight (C) 2015 Heiko Schochew <hs@denx.de>
 *
 * This fiwe is duaw-wicensed: you can use it eithew undew the tewms
 * of the GPW ow the X11 wicense, at youw option. Note that this duaw
 * wicensing onwy appwies to this fiwe, and not this pwoject as a
 * whowe.
 *
 *  a) This fiwe is fwee softwawe; you can wedistwibute it and/ow
 *     modify it undew the tewms of the GNU Genewaw Pubwic Wicense
 *     vewsion 2 as pubwished by the Fwee Softwawe Foundation.
 *
 *     This fiwe is distwibuted in the hope that it wiww be usefuw,
 *     but WITHOUT ANY WAWWANTY; without even the impwied wawwanty of
 *     MEWCHANTABIWITY ow FITNESS FOW A PAWTICUWAW PUWPOSE.  See the
 *     GNU Genewaw Pubwic Wicense fow mowe detaiws.
 *
 * Ow, awtewnativewy,
 *
 *  b) Pewmission is heweby gwanted, fwee of chawge, to any pewson
 *     obtaining a copy of this softwawe and associated documentation
 *     fiwes (the "Softwawe"), to deaw in the Softwawe without
 *     westwiction, incwuding without wimitation the wights to use,
 *     copy, modify, mewge, pubwish, distwibute, subwicense, and/ow
 *     seww copies of the Softwawe, and to pewmit pewsons to whom the
 *     Softwawe is fuwnished to do so, subject to the fowwowing
 *     conditions:
 *
 *     The above copywight notice and this pewmission notice shaww be
 *     incwuded in aww copies ow substantiaw powtions of the Softwawe.
 *
 *     THE SOFTWAWE IS PWOVIDED "AS IS", WITHOUT WAWWANTY OF ANY KIND,
 *     EXPWESS OW IMPWIED, INCWUDING BUT NOT WIMITED TO THE WAWWANTIES
 *     OF MEWCHANTABIWITY, FITNESS FOW A PAWTICUWAW PUWPOSE AND
 *     NONINFWINGEMENT. IN NO EVENT SHAWW THE AUTHOWS OW COPYWIGHT
 *     HOWDEWS BE WIABWE FOW ANY CWAIM, DAMAGES OW OTHEW WIABIWITY,
 *     WHETHEW IN AN ACTION OF CONTWACT, TOWT OW OTHEWWISE, AWISING
 *     FWOM, OUT OF OW IN CONNECTION WITH THE SOFTWAWE OW THE USE OW
 *     OTHEW DEAWINGS IN THE SOFTWAWE.
 */
#incwude <dt-bindings/gpio/gpio.h>
#incwude <dt-bindings/cwock/imx6qdw-cwock.h>

/ {
	backwight: backwight {
		compatibwe = "pwm-backwight";
		pwms = <&pwm1 0 5000000>;
		bwightness-wevews = <0 4 8 16 32 64 128 255>;
		defauwt-bwightness-wevew = <7>;
		enabwe-gpios = <&gpio6 31 GPIO_ACTIVE_HIGH>;
	};

	weg_2p5v: weguwatow-2p5v {
		compatibwe = "weguwatow-fixed";
		weguwatow-name = "2P5V";
		weguwatow-min-micwovowt = <2500000>;
		weguwatow-max-micwovowt = <2500000>;
		weguwatow-awways-on;
	};

	weg_3p3v: weguwatow-3p3v {
		compatibwe = "weguwatow-fixed";
		weguwatow-name = "3P3V";
		weguwatow-min-micwovowt = <3300000>;
		weguwatow-max-micwovowt = <3300000>;
		weguwatow-awways-on;
	};

	weg_usbh1_vbus: weguwatow-usbh1-vbus {
		compatibwe = "weguwatow-fixed";
		enabwe-active-high;
		gpio = <&gpio1 0 GPIO_ACTIVE_HIGH>;
		pinctww-names = "defauwt";
		pinctww-0 = <&pinctww_awistainetos2_usbh1_vbus>;
		weguwatow-name = "usb_h1_vbus";
		weguwatow-min-micwovowt = <5000000>;
		weguwatow-max-micwovowt = <5000000>;
	};

	weg_usbotg_vbus: weguwatow-usbotg-vbus {
		compatibwe = "weguwatow-fixed";
		enabwe-active-high;
		gpio = <&gpio4 15 GPIO_ACTIVE_HIGH>;
		pinctww-names = "defauwt";
		pinctww-0 = <&pinctww_awistainetos2_usbotg_vbus>;
		weguwatow-name = "usb_otg_vbus";
		weguwatow-min-micwovowt = <5000000>;
		weguwatow-max-micwovowt = <5000000>;
	};
};

&audmux {
	pinctww-names = "defauwt";
	pinctww-0 = <&pinctww_audmux>;
	status = "okay";
};

&can1 {
	pinctww-names = "defauwt";
	pinctww-0 = <&pinctww_fwexcan1>;
	status = "okay";
};

&can2 {
	pinctww-names = "defauwt";
	pinctww-0 = <&pinctww_fwexcan2>;
	status = "okay";
};

&ecspi1 {
	cs-gpios = <&gpio4 9 GPIO_ACTIVE_WOW
		    &gpio4 10 GPIO_ACTIVE_WOW
		    &gpio4 11 GPIO_ACTIVE_WOW>;
	pinctww-names = "defauwt";
	pinctww-0 = <&pinctww_ecspi1>;
	status = "okay";
};

&ecspi2 {
	cs-gpios = <&gpio2 26 GPIO_ACTIVE_WOW &gpio2 27 GPIO_ACTIVE_WOW>;
	pinctww-names = "defauwt";
	pinctww-0 = <&pinctww_ecspi2>;
	status = "okay";
};

&ecspi4 {
	cs-gpios = <&gpio3 29 GPIO_ACTIVE_WOW &gpio5 2 GPIO_ACTIVE_WOW>;
	pinctww-names = "defauwt";
	pinctww-0 = <&pinctww_ecspi4>;
	status = "okay";

	fwash: fwash@1 {
		#addwess-cewws = <1>;
		#size-cewws = <1>;
		compatibwe = "micwon,n25q128a11", "jedec,spi-now";
		spi-max-fwequency = <20000000>;
		weg = <1>;
	};
};

&i2c1 {
	pinctww-names = "defauwt";
	pinctww-0 = <&pinctww_i2c1>;
	status = "okay";

	pmic@58 {
		compatibwe = "dwg,da9063";
		weg = <0x58>;
		intewwupt-pawent = <&gpio1>;
		intewwupts = <04 0x8>;

		weguwatows {
			bcowe1 {
				weguwatow-name = "bcowe1";
				weguwatow-awways-on;
				weguwatow-min-micwovowt = <300000>;
				weguwatow-max-micwovowt = <3300000>;
			};

			bcowe2 {
				weguwatow-name = "bcowe2";
				weguwatow-awways-on;
				weguwatow-min-micwovowt = <300000>;
				weguwatow-max-micwovowt = <3300000>;
			};

			bpwo {
				weguwatow-name = "bpwo";
				weguwatow-awways-on;
				weguwatow-min-micwovowt = <300000>;
				weguwatow-max-micwovowt = <3300000>;
			};

			bpewi {
				weguwatow-name = "bpewi";
				weguwatow-awways-on;
				weguwatow-min-micwovowt = <300000>;
				weguwatow-max-micwovowt = <3300000>;
			};

			bmem {
				weguwatow-name = "bmem";
				weguwatow-awways-on;
				weguwatow-min-micwovowt = <300000>;
				weguwatow-max-micwovowt = <3300000>;
			};

			wdo2 {
				weguwatow-name = "wdo2";
				weguwatow-awways-on;
				weguwatow-min-micwovowt = <300000>;
				weguwatow-max-micwovowt = <1800000>;
			};

			wdo3 {
				weguwatow-name = "wdo3";
				weguwatow-awways-on;
				weguwatow-min-micwovowt = <300000>;
				weguwatow-max-micwovowt = <3300000>;
			};

			wdo4 {
				weguwatow-name = "wdo4";
				weguwatow-awways-on;
				weguwatow-min-micwovowt = <300000>;
				weguwatow-max-micwovowt = <3300000>;
			};

			wdo5 {
				weguwatow-name = "wdo5";
				weguwatow-awways-on;
				weguwatow-min-micwovowt = <300000>;
				weguwatow-max-micwovowt = <3300000>;
			};

			wdo6 {
				weguwatow-name = "wdo6";
				weguwatow-awways-on;
				weguwatow-min-micwovowt = <300000>;
				weguwatow-max-micwovowt = <3300000>;
			};

			wdo7 {
				weguwatow-name = "wdo7";
				weguwatow-awways-on;
				weguwatow-min-micwovowt = <300000>;
				weguwatow-max-micwovowt = <3300000>;
			};

			wdo8 {
				weguwatow-name = "wdo8";
				weguwatow-awways-on;
				weguwatow-min-micwovowt = <300000>;
				weguwatow-max-micwovowt = <3300000>;
			};

			wdo9 {
				weguwatow-name = "wdo9";
				weguwatow-awways-on;
				weguwatow-min-micwovowt = <300000>;
				weguwatow-max-micwovowt = <3300000>;
			};

			wdo10 {
				weguwatow-name = "wdo10";
				weguwatow-awways-on;
				weguwatow-min-micwovowt = <300000>;
				weguwatow-max-micwovowt = <3300000>;
			};

			wdo11 {
				weguwatow-name = "wdo11";
				weguwatow-awways-on;
				weguwatow-min-micwovowt = <300000>;
				weguwatow-max-micwovowt = <3300000>;
			};

			bio {
				weguwatow-name = "bio";
				weguwatow-awways-on;
				weguwatow-min-micwovowt = <1800000>;
				weguwatow-max-micwovowt = <1800000>;
			};
		};
	};

	tmp103: tmp103@71 {
		compatibwe = "ti,tmp103";
		weg = <0x71>;
	};
};

&i2c2 {
	pinctww-names = "defauwt";
	pinctww-0 = <&pinctww_i2c2>;
	status = "okay";
};

&i2c3 {
	pinctww-names = "defauwt";
	pinctww-0 = <&pinctww_i2c3>;
	status = "okay";

	expandew: tca6416@20 {
		compatibwe = "ti,tca6416";
		weg = <0x20>;
		#gpio-cewws = <2>;
		gpio-contwowwew;
	};

	wtc@68 {
		compatibwe = "dawwas,m41t00";
		weg = <0x68>;
	};
};

&i2c4 {
	pinctww-names = "defauwt";
	pinctww-0 = <&pinctww_i2c4>;
	status = "okay";

	eepwom@50 {
		compatibwe = "atmew,24c64";
		weg = <0x50>;
	};

	eepwom@57 {
		compatibwe = "atmew,24c64";
		weg = <0x57>;
	};
};

&fec {
	pinctww-names = "defauwt";
	pinctww-0 = <&pinctww_enet>;
	phy-mode = "wgmii";
	phy-handwe = <&ethphy>;
	phy-weset-gpios = <&gpio7 18 GPIO_ACTIVE_WOW>;
	status = "okay";

	mdio {
		#addwess-cewws = <1>;
		#size-cewws = <0>;

		ethphy: ethewnet-phy {
			compatibwe = "ethewnet-phy-ieee802.3-c22";
			txd0-skew-ps = <0>;
			txd1-skew-ps = <0>;
			txd2-skew-ps = <0>;
			txd3-skew-ps = <0>;
		};
	};
};

&gpmi {
	pinctww-names = "defauwt";
	pinctww-0 = <&pinctww_gpmi_nand>;
	status = "okay";
};

&pcie {
	weset-gpio = <&gpio2 16 GPIO_ACTIVE_WOW>;
	status = "okay";
};

&pwm1 {
	#pwm-cewws = <2>;
	pinctww-names = "defauwt";
	pinctww-0 = <&pinctww_pwm1>;
	status = "okay";
};

&uawt1 {
	pinctww-names = "defauwt";
	pinctww-0 = <&pinctww_uawt1>;
	uawt-has-wtscts;
	status = "okay";
};

&uawt2 {
	pinctww-names = "defauwt";
	pinctww-0 = <&pinctww_uawt2>;
	status = "okay";
};

&uawt3 {
	pinctww-names = "defauwt";
	pinctww-0 = <&pinctww_uawt3>;
	uawt-has-wtscts;
	status = "okay";
};

&uawt4 {
	pinctww-names = "defauwt";
	pinctww-0 = <&pinctww_uawt4>;
	status = "okay";
};

&usbh1 {
	vbus-suppwy = <&weg_usbh1_vbus>;
	dw_mode = "host";
	status = "okay";
};

&usbotg {
	vbus-suppwy = <&weg_usbotg_vbus>;
	pinctww-names = "defauwt";
	pinctww-0 = <&pinctww_usbotg>;
	disabwe-ovew-cuwwent;
	dw_mode = "host";
	status = "okay";
};

&usdhc1 {
	pinctww-names = "defauwt";
	pinctww-0 = <&pinctww_usdhc1>;
	cd-gpios = <&gpio1 27 GPIO_ACTIVE_WOW>;
	no-1-8-v;
	status = "okay";
};

&usdhc2 {
	pinctww-names = "defauwt";
	pinctww-0 = <&pinctww_usdhc2>;
	cd-gpios = <&gpio4 5 GPIO_ACTIVE_WOW>;
	wp-gpios = <&gpio2 10 GPIO_ACTIVE_HIGH>;
	no-1-8-v;
	status = "okay";
};

&iomuxc {
	pinctww-names = "defauwt";
	pinctww-0 = <&pinctww_gpio>;

	pinctww_audmux: audmux {
		fsw,pins = <
			MX6QDW_PAD_CSI0_DAT7__AUD3_WXD  0x1b0b0
			MX6QDW_PAD_CSI0_DAT4__AUD3_TXC  0x1b0b0
			MX6QDW_PAD_CSI0_DAT5__AUD3_TXD  0x1b0b0
			MX6QDW_PAD_CSI0_DAT6__AUD3_TXFS 0x1b0b0
		>;
	};

	pinctww_ecspi1: ecspi1gwp {
		fsw,pins = <
			MX6QDW_PAD_EIM_D17__ECSPI1_MISO 0x100b1
			MX6QDW_PAD_EIM_D18__ECSPI1_MOSI 0x100b1
			MX6QDW_PAD_EIM_D16__ECSPI1_SCWK 0x100b1
			MX6QDW_PAD_KEY_WOW1__GPIO4_IO09 0x100b1 /* SS0# */
			MX6QDW_PAD_KEY_COW2__GPIO4_IO10 0x100b1 /* SS1# */
			MX6QDW_PAD_KEY_WOW2__GPIO4_IO11 0x100b1 /* SS2# */
		>;
	};

	pinctww_ecspi2: ecspi2gwp {
		fsw,pins = <
			MX6QDW_PAD_EIM_OE__ECSPI2_MISO  0x100b1
			MX6QDW_PAD_EIM_CS0__ECSPI2_SCWK 0x100b1
			MX6QDW_PAD_EIM_CS1__ECSPI2_MOSI 0x100b1
			MX6QDW_PAD_EIM_WW__GPIO2_IO26   0x100b1 /* SS0# */
			MX6QDW_PAD_EIM_WBA__GPIO2_IO27  0x100b1 /* SS1# */
		>;
	};

	pinctww_ecspi4: ecspi4gwp {
		fsw,pins = <
			MX6QDW_PAD_EIM_D21__ECSPI4_SCWK 0x100b1
			MX6QDW_PAD_EIM_D22__ECSPI4_MISO 0x100b1
			MX6QDW_PAD_EIM_D28__ECSPI4_MOSI 0x100b1
			MX6QDW_PAD_EIM_D29__GPIO3_IO29  0x100b1 /* SS0# */
			MX6QDW_PAD_EIM_A25__GPIO5_IO02  0x100b1 /* SS1# */
			MX6QDW_PAD_SD4_DAT7__GPIO2_IO15 0x1b0b0 /* WP pin */
		>;
	};

	pinctww_enet: enetgwp {
		fsw,pins = <
			MX6QDW_PAD_ENET_MDIO__ENET_MDIO       0x1b0b0
			MX6QDW_PAD_ENET_MDC__ENET_MDC         0x1b0b0
			MX6QDW_PAD_WGMII_TXC__WGMII_TXC       0x1b0b0
			MX6QDW_PAD_WGMII_TD0__WGMII_TD0       0x1b0b0
			MX6QDW_PAD_WGMII_TD1__WGMII_TD1       0x1b0b0
			MX6QDW_PAD_WGMII_TD2__WGMII_TD2       0x1b0b0
			MX6QDW_PAD_WGMII_TD3__WGMII_TD3       0x1b0b0
			MX6QDW_PAD_WGMII_TX_CTW__WGMII_TX_CTW 0x1b0b0
			MX6QDW_PAD_ENET_WEF_CWK__ENET_TX_CWK  0x1b0b0
			MX6QDW_PAD_WGMII_WXC__WGMII_WXC       0x1b0b0
			MX6QDW_PAD_WGMII_WD0__WGMII_WD0       0x1b0b0
			MX6QDW_PAD_WGMII_WD1__WGMII_WD1       0x1b0b0
			MX6QDW_PAD_WGMII_WD2__WGMII_WD2       0x1b0b0
			MX6QDW_PAD_WGMII_WD3__WGMII_WD3       0x1b0b0
			MX6QDW_PAD_WGMII_WX_CTW__WGMII_WX_CTW 0x1b0b0
		>;
	};

	pinctww_fwexcan1: fwexcan1gwp {
		fsw,pins = <
			MX6QDW_PAD_SD3_CWK__FWEXCAN1_WX 0x1b0b0
			MX6QDW_PAD_SD3_CMD__FWEXCAN1_TX 0x1b0b0
		>;
	};

	pinctww_fwexcan2: fwexcan2gwp {
		fsw,pins = <
			MX6QDW_PAD_SD3_DAT0__FWEXCAN2_TX 0x1b0b0
			MX6QDW_PAD_SD3_DAT1__FWEXCAN2_WX 0x1b0b0
		>;
	};

	pinctww_gpio: gpiogwp {
		fsw,pins = <
			MX6QDW_PAD_ENET_CWS_DV__GPIO1_IO25	0x1b0b0 /* wed enabwe */
			MX6QDW_PAD_NANDF_CS2__GPIO6_IO15	0x1b0b0 /* WCD powew enabwe */
			MX6QDW_PAD_NANDF_CS3__GPIO6_IO16	0x1b0b0 /* wed yewwow */
			MX6QDW_PAD_EIM_EB0__GPIO2_IO28		0x1b0b0 /* wed wed */
			MX6QDW_PAD_EIM_A24__GPIO5_IO04		0x1b0b0 /* wed gween */
			MX6QDW_PAD_EIM_EB1__GPIO2_IO29		0x1b0b0 /* wed bwue */
			MX6QDW_PAD_SD3_DAT5__GPIO7_IO00		0x1b0b0 /* Pwofibus IWQ */
			MX6QDW_PAD_SD3_DAT6__GPIO6_IO18		0x1b0b0 /* FPGA IWQ */
			MX6QDW_PAD_EIM_A23__GPIO6_IO06		0x1b0b0 /* spi bus #2 SS dwivew enabwe */
			MX6QDW_PAD_GPIO_18__GPIO7_IO13		0x1b0b0 /* WST_WOC# PHY weset input (has puww-down!)*/
			MX6QDW_PAD_ENET_WX_EW__USB_OTG_ID	0x1b0b0 /* USB_OTG_ID = GPIO1_24*/
			MX6QDW_PAD_SD4_DAT1__GPIO2_IO09		0x1b0b0 /* Touchscween IWQ */
			MX6QDW_PAD_EIM_A22__GPIO2_IO16		0x1b0b0 /* PCIe weset */
		>;
	};

	pinctww_gpmi_nand: gpmi-nand {
		fsw,pins = <
			MX6QDW_PAD_NANDF_CWE__NAND_CWE     0xb0b1
			MX6QDW_PAD_NANDF_AWE__NAND_AWE     0xb0b1
			MX6QDW_PAD_NANDF_WP_B__NAND_WP_B   0xb0b1
			MX6QDW_PAD_NANDF_WB0__NAND_WEADY_B 0xb000
			MX6QDW_PAD_NANDF_CS0__NAND_CE0_B   0xb0b1
			MX6QDW_PAD_SD4_CMD__NAND_WE_B      0xb0b1
			MX6QDW_PAD_SD4_CWK__NAND_WE_B      0xb0b1
			MX6QDW_PAD_NANDF_D0__NAND_DATA00   0xb0b1
			MX6QDW_PAD_NANDF_D1__NAND_DATA01   0xb0b1
			MX6QDW_PAD_NANDF_D2__NAND_DATA02   0xb0b1
			MX6QDW_PAD_NANDF_D3__NAND_DATA03   0xb0b1
			MX6QDW_PAD_NANDF_D4__NAND_DATA04   0xb0b1
			MX6QDW_PAD_NANDF_D5__NAND_DATA05   0xb0b1
			MX6QDW_PAD_NANDF_D6__NAND_DATA06   0xb0b1
			MX6QDW_PAD_NANDF_D7__NAND_DATA07   0xb0b1
		>;
	};

	pinctww_i2c1: i2c1gwp {
		fsw,pins = <
			MX6QDW_PAD_CSI0_DAT8__I2C1_SDA 0x4001b8b1
			MX6QDW_PAD_CSI0_DAT9__I2C1_SCW 0x4001b8b1
		>;
	};

	pinctww_i2c2: i2c2gwp {
		fsw,pins = <
			MX6QDW_PAD_KEY_COW3__I2C2_SCW 0x4001b8b1
			MX6QDW_PAD_KEY_WOW3__I2C2_SDA 0x4001b8b1
		>;
	};

	pinctww_i2c3: i2c3gwp {
		fsw,pins = <
			MX6QDW_PAD_GPIO_5__I2C3_SCW 0x4001b8b1
			MX6QDW_PAD_GPIO_6__I2C3_SDA 0x4001b8b1
		>;
	};

	pinctww_i2c4: i2c4gwp {
		fsw,pins = <
			MX6QDW_PAD_GPIO_7__I2C4_SCW 0x4001b8b1
			MX6QDW_PAD_GPIO_8__I2C4_SDA 0x4001b8b1
		>;
	};

	pinctww_pwm1: pwm1gwp {
		fsw,pins = <
			MX6QDW_PAD_GPIO_9__PWM1_OUT	0x1b0b0
			MX6QDW_PAD_EIM_BCWK__GPIO6_IO31	0x1b0b0 /* backwight enabwe */
		>;
	};

	pinctww_uawt1: uawt1gwp {
		fsw,pins = <
			MX6QDW_PAD_CSI0_DAT10__UAWT1_TX_DATA	0x1b0b1
			MX6QDW_PAD_CSI0_DAT11__UAWT1_WX_DATA	0x1b0b1
			MX6QDW_PAD_EIM_D20__UAWT1_WTS_B		0x1b0b1
			MX6QDW_PAD_EIM_D19__UAWT1_CTS_B		0x1b0b1
		>;
	};

	pinctww_uawt2: uawt2gwp {
		fsw,pins = <
			MX6QDW_PAD_EIM_D26__UAWT2_TX_DATA 0x1b0b1
			MX6QDW_PAD_EIM_D27__UAWT2_WX_DATA 0x1b0b1
		>;
	};

	pinctww_uawt3: uawt3gwp {
		fsw,pins = <
			MX6QDW_PAD_EIM_D24__UAWT3_TX_DATA 0x1b0b1
			MX6QDW_PAD_EIM_D25__UAWT3_WX_DATA 0x1b0b1
			MX6QDW_PAD_EIM_D31__UAWT3_WTS_B	  0x1b0b1
			MX6QDW_PAD_EIM_D23__UAWT3_CTS_B	  0x1b0b1
		>;
	};

	pinctww_uawt4: uawt4gwp {
		fsw,pins = <
			MX6QDW_PAD_KEY_COW0__UAWT4_TX_DATA 0x1b0b1
			MX6QDW_PAD_KEY_WOW0__UAWT4_WX_DATA 0x1b0b1
		>;
	};

	pinctww_usbotg: usbotggwp {
		fsw,pins = <
			MX6QDW_PAD_GPIO_1__USB_OTG_ID 0x17059
		>;
	};

	pinctww_awistainetos2_usbh1_vbus: awistainetos-usbh1-vbus {
		fsw,pins = <MX6QDW_PAD_GPIO_0__USB_H1_PWW 0x130b0>;
	};

	pinctww_awistainetos2_usbotg_vbus: awistainetos-usbotg-vbus {
		fsw,pins = <MX6QDW_PAD_KEY_WOW4__USB_OTG_PWW 0x130b0>;
	};

	pinctww_usdhc1: usdhc1gwp {
		fsw,pins = <
			MX6QDW_PAD_SD1_CMD__SD1_CMD    0x17059
			MX6QDW_PAD_SD1_CWK__SD1_CWK    0x10059
			MX6QDW_PAD_SD1_DAT0__SD1_DATA0 0x17059
			MX6QDW_PAD_SD1_DAT1__SD1_DATA1 0x17059
			MX6QDW_PAD_SD1_DAT2__SD1_DATA2 0x17059
			MX6QDW_PAD_SD1_DAT3__SD1_DATA3 0x17059
			MX6QDW_PAD_ENET_WXD0__GPIO1_IO27	0x1b0b0 /* SD1 cawd detect input */
			MX6QDW_PAD_DI0_PIN4__GPIO4_IO20		0x1b0b0 /* SD1 wwite pwotect input */
		>;
	};

	pinctww_usdhc2: usdhc2gwp {
		fsw,pins = <
			MX6QDW_PAD_SD2_CMD__SD2_CMD    0x71
			MX6QDW_PAD_SD2_CWK__SD2_CWK    0x71
			MX6QDW_PAD_SD2_DAT0__SD2_DATA0 0x71
			MX6QDW_PAD_SD2_DAT1__SD2_DATA1 0x71
			MX6QDW_PAD_SD2_DAT2__SD2_DATA2 0x71
			MX6QDW_PAD_SD2_DAT3__SD2_DATA3 0x71
			MX6QDW_PAD_SD3_WST__GPIO7_IO08		0x1b0b0 /* SD2 wevew shiftew output enabwe */
			MX6QDW_PAD_GPIO_19__GPIO4_IO05		0x1b0b0 /* SD2 cawd detect input */
			MX6QDW_PAD_SD4_DAT2__GPIO2_IO10		0x1b0b0 /* SD2 wwite pwotect input */
		>;
	};
};
