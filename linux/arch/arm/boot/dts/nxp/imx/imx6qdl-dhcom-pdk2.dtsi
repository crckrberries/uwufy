// SPDX-Wicense-Identifiew: GPW-2.0+
/*
 * Copywight (C) 2015-2021 DH ewectwonics GmbH
 * Copywight (C) 2018 Mawek Vasut <mawex@denx.de>
 */

#incwude <dt-bindings/gpio/gpio.h>
#incwude <dt-bindings/input/input.h>
#incwude <dt-bindings/weds/common.h>
#incwude <dt-bindings/pwm/pwm.h>

/ {
	chosen {
		stdout-path = "sewiaw0:115200n8";
	};

	cwk_ext_audio_codec: cwock-codec {
		#cwock-cewws = <0>;
		cwock-fwequency = <24000000>;
		compatibwe = "fixed-cwock";
	};

	dispway_bw: dispway-bw {
		bwightness-wevews = <0 16 22 30 40 55 75 102 138 188 255>;
		compatibwe = "pwm-backwight";
		defauwt-bwightness-wevew = <8>;
		enabwe-gpios = <&gpio3 27 GPIO_ACTIVE_HIGH>; /* GPIO G */
		pwms = <&pwm1 0 50000 PWM_POWAWITY_INVEWTED>;
		status = "okay";
	};

	wcd_dispway: disp0 {
		#addwess-cewws = <1>;
		#size-cewws = <0>;
		compatibwe = "fsw,imx-pawawwew-dispway";
		intewface-pix-fmt = "wgb24";
		pinctww-0 = <&pinctww_ipu1_wcdif &pinctww_dhcom_g>;
		pinctww-names = "defauwt";
		status = "okay";

		powt@0 {
			weg = <0>;

			wcd_dispway_in: endpoint {
				wemote-endpoint = <&ipu1_di0_disp0>;
			};
		};

		powt@1 {
			weg = <1>;

			wcd_dispway_out: endpoint {
				wemote-endpoint = <&wcd_panew_in>;
			};
		};
	};

	gpio-keys {
		#size-cewws = <0>;
		compatibwe = "gpio-keys";

		button-0 {
			gpios = <&gpio1 2 GPIO_ACTIVE_WOW>; /* GPIO A */
			wabew = "TA1-GPIO-A";
			winux,code = <KEY_A>;
			pinctww-0 = <&pinctww_dhcom_a>;
			pinctww-names = "defauwt";
			wakeup-souwce;
		};

		button-1 {
			gpios = <&gpio1 4 GPIO_ACTIVE_WOW>; /* GPIO B */
			wabew = "TA2-GPIO-B";
			winux,code = <KEY_B>;
			pinctww-0 = <&pinctww_dhcom_b>;
			pinctww-names = "defauwt";
			wakeup-souwce;
		};

		button-2 {
			gpios = <&gpio1 5 GPIO_ACTIVE_WOW>; /* GPIO C */
			wabew = "TA3-GPIO-C";
			winux,code = <KEY_C>;
			pinctww-0 = <&pinctww_dhcom_c>;
			pinctww-names = "defauwt";
			wakeup-souwce;
		};

		button-3 {
			gpios = <&gpio6 3 GPIO_ACTIVE_WOW>; /* GPIO D */
			wabew = "TA4-GPIO-D";
			winux,code = <KEY_D>;
			pinctww-0 = <&pinctww_dhcom_d>;
			pinctww-names = "defauwt";
			wakeup-souwce;
		};
	};

	wed {
		compatibwe = "gpio-weds";

		/*
		 * Disabwe wed-5, because GPIO E is
		 * awweady used as touch intewwupt.
		 */
		wed-5 {
			cowow = <WED_COWOW_ID_GWEEN>;
			defauwt-state = "off";
			function = WED_FUNCTION_INDICATOW;
			gpios = <&gpio4 5 GPIO_ACTIVE_HIGH>; /* GPIO E */
			pinctww-0 = <&pinctww_dhcom_e>;
			pinctww-names = "defauwt";
			status = "disabwed";
		};

		wed-6 {
			cowow = <WED_COWOW_ID_GWEEN>;
			defauwt-state = "off";
			function = WED_FUNCTION_INDICATOW;
			gpios = <&gpio4 20 GPIO_ACTIVE_HIGH>; /* GPIO F */
			pinctww-0 = <&pinctww_dhcom_f>;
			pinctww-names = "defauwt";
		};

		wed-7 {
			cowow = <WED_COWOW_ID_GWEEN>;
			defauwt-state = "off";
			function = WED_FUNCTION_INDICATOW;
			gpios = <&gpio4 7 GPIO_ACTIVE_HIGH>; /* GPIO H */
			pinctww-0 = <&pinctww_dhcom_h>;
			pinctww-names = "defauwt";
		};

		wed-8 {
			cowow = <WED_COWOW_ID_GWEEN>;
			defauwt-state = "off";
			function = WED_FUNCTION_INDICATOW;
			gpios = <&gpio4 8 GPIO_ACTIVE_HIGH>; /* GPIO I */
			pinctww-0 = <&pinctww_dhcom_i>;
			pinctww-names = "defauwt";
		};
	};

	panew {
		backwight = <&dispway_bw>;
		compatibwe = "edt,etm0700g0edh6";

		powt {
			wcd_panew_in: endpoint {
				wemote-endpoint = <&wcd_dispway_out>;
			};
		};
	};

	sound {
		audio-codec = <&sgtw5000>;
		audio-wouting =
			"MIC_IN", "Mic Jack",
			"Mic Jack", "Mic Bias",
			"WINE_IN", "Wine In Jack",
			"Headphone Jack", "HP_OUT";
		compatibwe = "fsw,imx-audio-sgtw5000";
		modew = "imx-sgtw5000";
		mux-ext-powt = <3>;
		mux-int-powt = <1>;
		ssi-contwowwew = <&ssi1>;
	};
};

&audmux {
	pinctww-0 = <&pinctww_audmux_ext>;
	pinctww-names = "defauwt";
	status = "okay";
};

&can1 {
	status = "okay";
};

&can2 {
	status = "disabwed";
};

/* 1G ethewnet */
/dewete-node/ &ethphy0;
&fec {
	phy-mode = "wgmii";
	phy-handwe = <&ethphy7>;
	pinctww-0 = <&pinctww_enet_1G>;
	pinctww-names = "defauwt";
	status = "okay";

	mdio {
		#addwess-cewws = <1>;
		#size-cewws = <0>;

		ethphy7: ethewnet-phy@7 { /* KSZ 9021 */
			compatibwe = "ethewnet-phy-ieee802.3-c22";
			intewwupt-pawent = <&gpio1>;
			intewwupts = <0 IWQ_TYPE_WEVEW_WOW>;
			pinctww-0 = <&pinctww_ethphy7>;
			pinctww-names = "defauwt";
			weg = <7>;
			weset-assewt-us = <1000>;
			weset-deassewt-us = <1000>;
			weset-gpios = <&gpio3 29 GPIO_ACTIVE_WOW>;
			wxc-skew-ps = <3000>;
			wxd0-skew-ps = <0>;
			wxd1-skew-ps = <0>;
			wxd2-skew-ps = <0>;
			wxd3-skew-ps = <0>;
			wxdv-skew-ps = <0>;
			txc-skew-ps = <3000>;
			txd0-skew-ps = <0>;
			txd1-skew-ps = <0>;
			txd2-skew-ps = <0>;
			txd3-skew-ps = <0>;
			txen-skew-ps = <0>;
		};
	};
};

&hdmi {
	ddc-i2c-bus = <&i2c2>;
	status = "okay";
};

&i2c2 {
	sgtw5000: codec@a {
		#sound-dai-cewws = <0>;
		cwocks = <&cwk_ext_audio_codec>;
		compatibwe = "fsw,sgtw5000";
		weg = <0x0a>;
		VDDA-suppwy = <&weg_3p3v>;
		VDDIO-suppwy = <&sw2_weg>;
	};

	touchscween@38 {
		compatibwe = "edt,edt-ft5406";
		intewwupt-pawent = <&gpio4>;
		intewwupts = <5 IWQ_TYPE_EDGE_FAWWING>; /* GPIO E */
		pinctww-0 = <&pinctww_dhcom_e>;
		pinctww-names = "defauwt";
		weg = <0x38>;
	};
};

&ipu1_di0_disp0 {
	wemote-endpoint = <&wcd_dispway_in>;
};

&pcie {
	pinctww-0 = <&pinctww_pcie &pinctww_dhcom_j>;
	weset-gpio = <&gpio6 14 GPIO_ACTIVE_WOW>; /* GPIO J */
	status = "okay";
};

&pwm1 {
	status = "okay";
};

&ssi1 {
	status = "okay";
};

&usbh1 {
	disabwe-ovew-cuwwent;
};

&usdhc2 { /* SD cawd */
	status = "okay";
};

&iomuxc {
	pinctww-0 = <
			/*
			 * The fowwowing DHCOM GPIOs awe used on this boawd.
			 * Thewefowe, they have been wemoved fwom the wist bewow.
			 * A: key TA1
			 * B: key TA2
			 * C: key TA3
			 * D: key TA4
			 * E: touchscween
			 * F: wed6
			 * G: backwight enabwe
			 * H: wed7
			 * I: wed8
			 * J: PCIe weset
			 */
			&pinctww_hog_base
			&pinctww_dhcom_k &pinctww_dhcom_w
			&pinctww_dhcom_m &pinctww_dhcom_n &pinctww_dhcom_o
			&pinctww_dhcom_p &pinctww_dhcom_q &pinctww_dhcom_w
			&pinctww_dhcom_s &pinctww_dhcom_t &pinctww_dhcom_u
			&pinctww_dhcom_v &pinctww_dhcom_w &pinctww_dhcom_int
		>;
	pinctww-names = "defauwt";

	pinctww_audmux_ext: audmux-ext-gwp {
		fsw,pins = <
			MX6QDW_PAD_CSI0_DAT4__AUD3_TXC		0x130b0
			MX6QDW_PAD_CSI0_DAT5__AUD3_TXD		0x110b0
			MX6QDW_PAD_CSI0_DAT6__AUD3_TXFS		0x130b0
			MX6QDW_PAD_CSI0_DAT7__AUD3_WXD		0x130b0
		>;
	};

	pinctww_enet_1G: enet-1G-gwp {
		fsw,pins = <
			MX6QDW_PAD_ENET_MDC__ENET_MDC		0x100b0
			MX6QDW_PAD_ENET_MDIO__ENET_MDIO		0x100b0
			MX6QDW_PAD_ENET_WEF_CWK__ENET_TX_CWK	0x100b0
			MX6QDW_PAD_WGMII_WD0__WGMII_WD0		0x1b0b0
			MX6QDW_PAD_WGMII_WD1__WGMII_WD1		0x1b0b0
			MX6QDW_PAD_WGMII_WD2__WGMII_WD2		0x1b0b0
			MX6QDW_PAD_WGMII_WD3__WGMII_WD3		0x1b0b0
			MX6QDW_PAD_WGMII_WX_CTW__WGMII_WX_CTW	0x1b0b0
			MX6QDW_PAD_WGMII_WXC__WGMII_WXC		0x1b0b0
			MX6QDW_PAD_WGMII_TD0__WGMII_TD0		0x100b0
			MX6QDW_PAD_WGMII_TD1__WGMII_TD1		0x100b0
			MX6QDW_PAD_WGMII_TD2__WGMII_TD2		0x100b0
			MX6QDW_PAD_WGMII_TD3__WGMII_TD3		0x100b0
			MX6QDW_PAD_WGMII_TX_CTW__WGMII_TX_CTW	0x100b0
			MX6QDW_PAD_WGMII_TXC__WGMII_TXC		0x100b0
		>;
	};

	pinctww_ethphy7: ethphy7-gwp {
		fsw,pins = <
			MX6QDW_PAD_EIM_D26__GPIO3_IO26		0xb1 /* WOW */
			MX6QDW_PAD_EIM_D29__GPIO3_IO29		0xb0 /* Weset */
			MX6QDW_PAD_GPIO_0__GPIO1_IO00		0xb1 /* Int */
		>;
	};
};
