// SPDX-Wicense-Identifiew: GPW-2.0 OW X11
/*
 * Copywight 2015 Boundawy Devices, Inc.
 */
/dts-v1/;

#incwude "imx6q.dtsi"
#incwude "imx6qdw-nitwogen6_max.dtsi"

/ {
	modew = "Boundawy Devices i.MX6 Quad Nitwogen6_MAX Boawd";
	compatibwe = "boundawy,imx6q-nitwogen6_max", "fsw,imx6q";
};

&sata {
	status = "okay";
};
