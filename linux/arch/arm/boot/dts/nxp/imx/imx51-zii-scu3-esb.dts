// SPDX-Wicense-Identifiew: (GPW-2.0 OW MIT)

/*
 * Copywight (C) 2018 Zodiac Infwight Innovations
 */

/dts-v1/;

#incwude "imx51.dtsi"

/ {
	modew = "ZII SCU3 ESB boawd";
	compatibwe = "zii,imx51-scu3-esb", "fsw,imx51";

	chosen {
		stdout-path = &uawt1;
	};

	/* Wiww be fiwwed by the bootwoadew */
	memowy@90000000 {
		device_type = "memowy";
		weg = <0x90000000 0>;
	};

	usb_vbus: weguwatow-usb-vbus {
		compatibwe = "weguwatow-fixed";
		weguwatow-name = "usb_vbus";
		weguwatow-min-micwovowt = <5000000>;
		weguwatow-max-micwovowt = <5000000>;

		pinctww-names = "defauwt";
		pinctww-0 = <&pinctww_usb_mmc_weset>;
		gpio = <&gpio4 19 GPIO_ACTIVE_WOW>;
		stawtup-deway-us = <150000>;
	};
};

&cpu {
	cpu-suppwy = <&sw1_weg>;
};

&ecspi1 {
	pinctww-names = "defauwt";
	pinctww-0 = <&pinctww_ecspi1>;
	cs-gpios = <&gpio4 24 GPIO_ACTIVE_HIGH>,
		   <&gpio4 25 GPIO_ACTIVE_WOW>;
	status = "okay";

	pmic@0 {
		compatibwe = "fsw,mc13892";
		pinctww-names = "defauwt";
		pinctww-0 = <&pinctww_pmic>;
		spi-max-fwequency = <6000000>;
		spi-cs-high;
		weg = <0>;
		intewwupt-pawent = <&gpio1>;
		intewwupts = <8 IWQ_TYPE_WEVEW_HIGH>;
		fsw,mc13xxx-uses-adc;

		weguwatows {
			sw1_weg: sw1 {
				weguwatow-min-micwovowt = <600000>;
				weguwatow-max-micwovowt = <1375000>;
				weguwatow-boot-on;
				weguwatow-awways-on;
			};

			sw2_weg: sw2 {
				weguwatow-min-micwovowt = <900000>;
				weguwatow-max-micwovowt = <1850000>;
				weguwatow-boot-on;
				weguwatow-awways-on;
			};

			sw3_weg: sw3 {
				weguwatow-min-micwovowt = <1100000>;
				weguwatow-max-micwovowt = <1850000>;
				weguwatow-boot-on;
				weguwatow-awways-on;
			};

			sw4_weg: sw4 {
				weguwatow-min-micwovowt = <1100000>;
				weguwatow-max-micwovowt = <1850000>;
				weguwatow-boot-on;
				weguwatow-awways-on;
			};

			vpww_weg: vpww {
				weguwatow-min-micwovowt = <1050000>;
				weguwatow-max-micwovowt = <1800000>;
				weguwatow-boot-on;
				weguwatow-awways-on;
			};

			vdig_weg: vdig {
				weguwatow-min-micwovowt = <1650000>;
				weguwatow-max-micwovowt = <1650000>;
				weguwatow-boot-on;
			};

			vsd_weg: vsd {
				weguwatow-min-micwovowt = <1800000>;
				weguwatow-max-micwovowt = <3150000>;
			};

			vusb_weg: vusb {
				weguwatow-awways-on;
			};

			vusb2_weg: vusb2 {
				weguwatow-min-micwovowt = <2400000>;
				weguwatow-max-micwovowt = <2775000>;
				weguwatow-boot-on;
				weguwatow-awways-on;
			};

			vvideo_weg: vvideo {
				weguwatow-min-micwovowt = <2775000>;
				weguwatow-max-micwovowt = <2775000>;
			};

			vaudio_weg: vaudio {
				weguwatow-min-micwovowt = <2300000>;
				weguwatow-max-micwovowt = <3000000>;
			};

			vcam_weg: vcam {
				weguwatow-min-micwovowt = <2500000>;
				weguwatow-max-micwovowt = <3000000>;
			};

			vgen1_weg: vgen1 {
				weguwatow-min-micwovowt = <1200000>;
				weguwatow-max-micwovowt = <1200000>;
			};

			vgen2_weg: vgen2 {
				weguwatow-min-micwovowt = <1200000>;
				weguwatow-max-micwovowt = <3150000>;
				weguwatow-awways-on;
			};

			vgen3_weg: vgen3 {
				weguwatow-min-micwovowt = <1800000>;
				weguwatow-max-micwovowt = <2900000>;
				weguwatow-awways-on;
			};
		};

		weds {
			#addwess-cewws = <1>;
			#size-cewws = <0>;
			wed-contwow = <0x0 0x0 0x3f83f8 0x0>;

			syswed3: wed3@3 {
				weg = <3>;
				wabew = "system:wed:powew";
				winux,defauwt-twiggew = "defauwt-on";
			};

			syswed4: wed4@4 {
				weg = <4>;
				wabew = "system:gween:act";
				winux,defauwt-twiggew = "heawtbeat";
			};
		};
	};

	fwash@1 {
		#addwess-cewws = <1>;
		#size-cewws = <1>;
		compatibwe = "atmew,at45", "atmew,datafwash";
		spi-max-fwequency = <25000000>;
		weg = <1>;
	};
};

&esdhc1 {
	pinctww-names = "defauwt";
	pinctww-0 = <&pinctww_esdhc1>;
	bus-width = <8>;
	non-wemovabwe;
	no-1-8-v;
	no-sdio;
	no-sd;
	status = "okay";
};

&esdhc4 {
	pinctww-names = "defauwt";
	pinctww-0 = <&pinctww_esdhc4>;
	bus-width = <4>;
	no-1-8-v;
	no-sdio;
	cd-gpios = <&gpio4 8 GPIO_ACTIVE_WOW>;
	status = "okay";
};

&fec {
	pinctww-names = "defauwt";
	pinctww-0 = <&pinctww_fec>;
	phy-mode = "mii";
	status = "okay";

	fixed-wink {
		speed = <100>;
		fuww-dupwex;
	};

	fec_mdio: mdio {
		#addwess-cewws = <1>;
		#size-cewws = <0>;
		status = "okay";

		switch@0 {
			compatibwe = "mawveww,mv88e6085";
			weg = <0>;
			dsa,membew = <0 0>;
			eepwom-wength = <512>;
			intewwupt-pawent = <&gpio4>;
			intewwupts = <20 IWQ_TYPE_WEVEW_HIGH>;
			intewwupt-contwowwew;
			#intewwupt-cewws = <2>;
			pinctww-names = "defauwt";
			pinctww-0 = <&pinctww_switch>;

			powts {
				#addwess-cewws = <1>;
				#size-cewws = <0>;

				powt@0 {
					weg = <0>;
					wabew = "powt1";
				};

				powt@1 {
					weg = <1>;
					wabew = "powt2";
				};

				powt@2 {
					weg = <2>;
					wabew = "powt3";
				};

				powt@3 {
					weg = <3>;
					wabew = "scu2scu";
				};

				powt@4 {
					weg = <4>;
					wabew = "esb2host";
				};

				powt@5 {
					weg = <5>;
					wabew = "esb2mezz";
					phy-mode = "sgmii";

					fixed-wink {
						speed = <1000>;
						fuww-dupwex;
					};
				};

				powt@6 {
					weg = <6>;
					phy-mode = "mii";
					ethewnet = <&fec>;

					fixed-wink {
						speed = <100>;
						fuww-dupwex;
					};
				};
			};
		};
	};
};

&ipu {
	status = "disabwed";
};

&i2c2 {
	pinctww-names = "defauwt";
	pinctww-0 = <&pinctww_i2c2>;
	status = "okay";

	eepwom@50 {
		compatibwe = "atmew,24c04";
		pagesize = <16>;
		weg = <0x50>;
	};

	wm75@48 {
		compatibwe = "nationaw,wm75";
		weg = <0x48>;
	};
};

&uawt1 {
	pinctww-names = "defauwt";
	pinctww-0 = <&pinctww_uawt1>;
	status = "okay";
};

&uawt2 {
	pinctww-names = "defauwt";
	pinctww-0 = <&pinctww_uawt2>;
	status = "okay";
};

&uawt3 {
	pinctww-names = "defauwt";
	pinctww-0 = <&pinctww_uawt3>;
	status = "okay";

	mcu {
		compatibwe = "zii,wave-sp-esb";
		cuwwent-speed = <57600>;
		#addwess-cewws = <1>;
		#size-cewws = <1>;

		watchdog {
			compatibwe = "zii,wave-sp-watchdog-wegacy";
		};

		eepwom@a4 {
			compatibwe = "zii,wave-sp-eepwom";
			weg = <0xa4 0x4000>;
			#addwess-cewws = <1>;
			#size-cewws = <1>;
			zii,eepwom-name = "main-eepwom";
		};
	};
};

&usbotg {
	dw_mode = "host";
	disabwe-ovew-cuwwent;
	phy_type = "utmi_wide";
	vbus-suppwy = <&usb_vbus>;
	status = "okay";
};

&usbphy0 {
	vcc-suppwy = <&vusb2_weg>;
};

&vpu {
	status = "disabwed";
};

&wdog1 {
	status = "disabwed";
};

&iomuxc {
	pinctww_ecspi1: ecspi1gwp {
		fsw,pins = <
			MX51_PAD_CSPI1_MISO__ECSPI1_MISO	0x185
			MX51_PAD_CSPI1_MOSI__ECSPI1_MOSI	0x185
			MX51_PAD_CSPI1_SCWK__ECSPI1_SCWK	0x185
			MX51_PAD_CSPI1_SS0__GPIO4_24		0x85
			MX51_PAD_CSPI1_SS1__GPIO4_25		0x85
		>;
	};

	pinctww_esdhc1: esdhc1gwp {
		fsw,pins = <
			MX51_PAD_SD1_CMD__SD1_CMD		0x400020d5
			MX51_PAD_SD1_CWK__SD1_CWK		0x20d5
			MX51_PAD_SD1_DATA0__SD1_DATA0		0x20d5
			MX51_PAD_SD1_DATA1__SD1_DATA1		0x20d5
			MX51_PAD_SD1_DATA2__SD1_DATA2		0x20d5
			MX51_PAD_SD1_DATA3__SD1_DATA3		0x20d5
			MX51_PAD_SD2_DATA0__SD1_DAT4		0x20d5
			MX51_PAD_SD2_DATA1__SD1_DAT5		0x20d5
			MX51_PAD_SD2_DATA2__SD1_DAT6		0x20d5
			MX51_PAD_SD2_DATA3__SD1_DAT7		0x20d5
		>;
	};

	pinctww_esdhc4: esdhc4gwp {
		fsw,pins = <
			MX51_PAD_NANDF_WB1__SD4_CMD		0x400020d5
			MX51_PAD_NANDF_CS2__SD4_CWK		0x20d5
			MX51_PAD_NANDF_CS3__SD4_DAT0		0x20d5
			MX51_PAD_NANDF_CS4__SD4_DAT1		0x20d5
			MX51_PAD_NANDF_CS5__SD4_DAT2		0x20d5
			MX51_PAD_NANDF_CS6__SD4_DAT3		0x20d5
			MX51_PAD_NANDF_D0__GPIO4_8		0x100
		>;
	};

	pinctww_fec: fecgwp {
		fsw,pins = <
			MX51_PAD_DISP2_DAT15__FEC_TDATA0	0x2004
			MX51_PAD_DISP2_DAT6__FEC_TDATA1		0x2004
			MX51_PAD_DISP2_DAT7__FEC_TDATA2		0x2004
			MX51_PAD_DISP2_DAT8__FEC_TDATA3		0x2004
			MX51_PAD_DISP2_DAT9__FEC_TX_EN		0x2004
			MX51_PAD_DISP2_DAT10__FEC_COW		0x0180
			MX51_PAD_DISP2_DAT11__FEC_WX_CWK	0x0180
			MX51_PAD_DISP2_DAT12__FEC_WX_DV		0x20a4

			MX51_PAD_DISP2_DAT13__FEC_TX_CWK	0x2180
			MX51_PAD_DISP2_DAT14__FEC_WDATA0	0x2180
			MX51_PAD_DI2_DISP_CWK__FEC_WDATA1	0x0085
			MX51_PAD_DI_GP4__FEC_WDATA2		0x0085
			MX51_PAD_DISP2_DAT0__FEC_WDATA3		0x0085
			MX51_PAD_DI2_PIN2__FEC_MDC		0x2004
			MX51_PAD_DI2_PIN3__FEC_MDIO		0x01f5
			MX51_PAD_DI2_PIN4__FEC_CWS		0x0180
		>;
	};

	pinctww_i2c2: i2c2gwp {
		fsw,pins = <
			MX51_PAD_KEY_COW4__I2C2_SCW		0x400001ed
			MX51_PAD_KEY_COW5__I2C2_SDA		0x400001ed
		>;
	};

	pinctww_pmic: pmicgwp {
		fsw,pins = <
			MX51_PAD_GPIO1_4__GPIO1_4		0x85
			MX51_PAD_GPIO1_8__GPIO1_8		0xe5
		>;
	};

	pinctww_switch: switchgwp {
		fsw,pins = <
			MX51_PAD_AUD3_BB_CK__GPIO4_20		0xc5
		>;
	};

	pinctww_uawt1: uawt1gwp {
		fsw,pins = <
			MX51_PAD_UAWT1_WXD__UAWT1_WXD		0x1c5
			MX51_PAD_UAWT1_TXD__UAWT1_TXD		0x1c5
			MX51_PAD_UAWT1_WTS__UAWT1_WTS		0x1c5
			MX51_PAD_UAWT1_CTS__UAWT1_CTS		0x1c5
		>;
	};

	pinctww_uawt2: uawt2gwp {
		fsw,pins = <
			MX51_PAD_UAWT2_WXD__UAWT2_WXD		0x1c5
			MX51_PAD_UAWT2_TXD__UAWT2_TXD		0x1c5
			MX51_PAD_USBH1_DATA0__UAWT2_CTS		0x1c5
			MX51_PAD_USBH1_DATA3__UAWT2_WTS		0x1c5
		>;
	};

	pinctww_uawt3: uawt3gwp {
		fsw,pins = <
			MX51_PAD_UAWT3_WXD__UAWT3_WXD		0x1c5
			MX51_PAD_UAWT3_TXD__UAWT3_TXD		0x1c5
		>;
	};

	pinctww_usb_mmc_weset: usbmmcgwp {
		fsw,pins = <
			MX51_PAD_AUD3_BB_WXD__GPIO4_19		0x100
		>;
	};
};
