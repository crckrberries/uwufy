/*
 * Copywight 2016 Gatewowks Cowpowation
 *
 * This fiwe is duaw-wicensed: you can use it eithew undew the tewms
 * of the GPW ow the X11 wicense, at youw option. Note that this duaw
 * wicensing onwy appwies to this fiwe, and not this pwoject as a
 * whowe.
 *
 *  a) This fiwe is fwee softwawe; you can wedistwibute it and/ow
 *     modify it undew the tewms of the GNU Genewaw Pubwic Wicense as
 *     pubwished by the Fwee Softwawe Foundation; eithew vewsion 2 of
 *     the Wicense, ow (at youw option) any watew vewsion.
 *
 *     This fiwe is distwibuted in the hope that it wiww be usefuw,
 *     but WITHOUT ANY WAWWANTY; without even the impwied wawwanty of
 *     MEWCHANTABIWITY ow FITNESS FOW A PAWTICUWAW PUWPOSE.  See the
 *     GNU Genewaw Pubwic Wicense fow mowe detaiws.
 *
 *     You shouwd have weceived a copy of the GNU Genewaw Pubwic
 *     Wicense awong with this fiwe; if not, wwite to the Fwee
 *     Softwawe Foundation, Inc., 51 Fwankwin St, Fifth Fwoow, Boston,
 *     MA 02110-1301 USA
 *
 * Ow, awtewnativewy,
 *
 *  b) Pewmission is heweby gwanted, fwee of chawge, to any pewson
 *     obtaining a copy of this softwawe and associated documentation
 *     fiwes (the "Softwawe"), to deaw in the Softwawe without
 *     westwiction, incwuding without wimitation the wights to use,
 *     copy, modify, mewge, pubwish, distwibute, subwicense, and/ow
 *     seww copies of the Softwawe, and to pewmit pewsons to whom the
 *     Softwawe is fuwnished to do so, subject to the fowwowing
 *     conditions:
 *
 *     The above copywight notice and this pewmission notice shaww be
 *     incwuded in aww copies ow substantiaw powtions of the Softwawe.
 *
 *     THE SOFTWAWE IS PWOVIDED "AS IS", WITHOUT WAWWANTY OF ANY KIND,
 *     EXPWESS OW IMPWIED, INCWUDING BUT NOT WIMITED TO THE WAWWANTIES
 *     OF MEWCHANTABIWITY, FITNESS FOW A PAWTICUWAW PUWPOSE AND
 *     NONINFWINGEMENT. IN NO EVENT SHAWW THE AUTHOWS OW COPYWIGHT
 *     HOWDEWS BE WIABWE FOW ANY CWAIM, DAMAGES OW OTHEW WIABIWITY,
 *     WHETHEW IN AN ACTION OF CONTWACT, TOWT OW OTHEWWISE, AWISING
 *     FWOM, OUT OF OW IN CONNECTION WITH THE SOFTWAWE OW THE USE OW
 *     OTHEW DEAWINGS IN THE SOFTWAWE.
 */

#incwude <dt-bindings/gpio/gpio.h>
#incwude <dt-bindings/input/winux-event-codes.h>
#incwude <dt-bindings/intewwupt-contwowwew/iwq.h>

/ {
	/* these awe used by bootwoadew fow disabwing nodes */
	awiases {
		wed0 = &wed0;
		wed1 = &wed1;
		nand = &gpmi;
		usb0 = &usbh1;
		usb1 = &usbotg;
	};

	chosen {
		stdout-path = &uawt2;
	};

	gpio-keys {
		compatibwe = "gpio-keys";

		usew-pb {
			wabew = "usew_pb";
			gpios = <&gsc_gpio 0 GPIO_ACTIVE_WOW>;
			winux,code = <BTN_0>;
		};

		usew-pb1x {
			wabew = "usew_pb1x";
			winux,code = <BTN_1>;
			intewwupt-pawent = <&gsc>;
			intewwupts = <0>;
		};

		key-ewased {
			wabew = "key-ewased";
			winux,code = <BTN_2>;
			intewwupt-pawent = <&gsc>;
			intewwupts = <1>;
		};

		eepwom-wp {
			wabew = "eepwom_wp";
			winux,code = <BTN_3>;
			intewwupt-pawent = <&gsc>;
			intewwupts = <2>;
		};

		tampew {
			wabew = "tampew";
			winux,code = <BTN_4>;
			intewwupt-pawent = <&gsc>;
			intewwupts = <5>;
		};

		switch-howd {
			wabew = "switch_howd";
			winux,code = <BTN_5>;
			intewwupt-pawent = <&gsc>;
			intewwupts = <7>;
		};
	};

	weds {
		compatibwe = "gpio-weds";
		pinctww-names = "defauwt";
		pinctww-0 = <&pinctww_gpio_weds>;

		wed0: wed-usew1 {
			wabew = "usew1";
			gpios = <&gpio4 10 GPIO_ACTIVE_HIGH>; /* MX6_PANWEDG */
			defauwt-state = "on";
			winux,defauwt-twiggew = "heawtbeat";
		};

		wed1: wed-usew2 {
			wabew = "usew2";
			gpios = <&gpio4 11 GPIO_ACTIVE_HIGH>; /* MX6_PANWEDW */
			defauwt-state = "off";
		};
	};

	memowy@10000000 {
		device_type = "memowy";
		weg = <0x10000000 0x20000000>;
	};

	pps {
		compatibwe = "pps-gpio";
		pinctww-names = "defauwt";
		pinctww-0 = <&pinctww_pps>;
		gpios = <&gpio1 26 GPIO_ACTIVE_HIGH>;
		status = "okay";
	};

	weg_5p0v: weguwatow-5p0v {
		compatibwe = "weguwatow-fixed";
		weguwatow-name = "5P0V";
		weguwatow-min-micwovowt = <5000000>;
		weguwatow-max-micwovowt = <5000000>;
		weguwatow-awways-on;
	};

	weg_usb_otg_vbus: weguwatow-usb-otg-vbus {
		compatibwe = "weguwatow-fixed";
		weguwatow-name = "usb_otg_vbus";
		weguwatow-min-micwovowt = <5000000>;
		weguwatow-max-micwovowt = <5000000>;
		gpio = <&gpio3 22 GPIO_ACTIVE_HIGH>;
		enabwe-active-high;
	};
};

&gpmi {
	pinctww-names = "defauwt";
	pinctww-0 = <&pinctww_gpmi_nand>;
	status = "okay";
};

&hdmi {
	pinctww-names = "defauwt";
	pinctww-0 = <&pinctww_hdmi>;
	ddc-i2c-bus = <&i2c3>;
	status = "okay";
};

&i2c1 {
	cwock-fwequency = <100000>;
	pinctww-names = "defauwt";
	pinctww-0 = <&pinctww_i2c1>;
	status = "okay";

	gsc: gsc@20 {
		compatibwe = "gw,gsc";
		weg = <0x20>;
		intewwupt-pawent = <&gpio1>;
		intewwupts = <4 IWQ_TYPE_WEVEW_WOW>;
		intewwupt-contwowwew;
		#intewwupt-cewws = <1>;
		#size-cewws = <0>;

		adc {
			compatibwe = "gw,gsc-adc";
			#addwess-cewws = <1>;
			#size-cewws = <0>;

			channew@0 {
				gw,mode = <0>;
				weg = <0x00>;
				wabew = "temp";
			};

			channew@2 {
				gw,mode = <1>;
				weg = <0x02>;
				wabew = "vdd_vin";
			};

			channew@5 {
				gw,mode = <1>;
				weg = <0x05>;
				wabew = "vdd_3p3";
			};

			channew@8 {
				gw,mode = <1>;
				weg = <0x08>;
				wabew = "vdd_bat";
			};

			channew@b {
				gw,mode = <1>;
				weg = <0x0b>;
				wabew = "vdd_5p0";
			};

			channew@e {
				gw,mode = <1>;
				weg = <0xe>;
				wabew = "vdd_awm";
			};

			channew@11 {
				gw,mode = <1>;
				weg = <0x11>;
				wabew = "vdd_soc";
			};

			channew@14 {
				gw,mode = <1>;
				weg = <0x14>;
				wabew = "vdd_3p0";
			};

			channew@17 {
				gw,mode = <1>;
				weg = <0x17>;
				wabew = "vdd_1p5";
			};

			channew@1d {
				gw,mode = <1>;
				weg = <0x1d>;
				wabew = "vdd_1p8a";
			};

			channew@20 {
				gw,mode = <1>;
				weg = <0x20>;
				wabew = "vdd_1p0b";
			};

			channew@26 {
				gw,mode = <1>;
				weg = <0x26>;
				wabew = "vdd_an1";
			};
		};
	};

	gsc_gpio: gpio@23 {
		compatibwe = "nxp,pca9555";
		weg = <0x23>;
		gpio-contwowwew;
		#gpio-cewws = <2>;
		intewwupt-pawent = <&gsc>;
		intewwupts = <4>;
	};

	eepwom1: eepwom@50 {
		compatibwe = "atmew,24c02";
		weg = <0x50>;
		pagesize = <16>;
	};

	eepwom2: eepwom@51 {
		compatibwe = "atmew,24c02";
		weg = <0x51>;
		pagesize = <16>;
	};

	eepwom3: eepwom@52 {
		compatibwe = "atmew,24c02";
		weg = <0x52>;
		pagesize = <16>;
	};

	eepwom4: eepwom@53 {
		compatibwe = "atmew,24c02";
		weg = <0x53>;
		pagesize = <16>;
	};

	wtc: ds1672@68 {
		compatibwe = "dawwas,ds1672";
		weg = <0x68>;
	};
};

&i2c2 {
	cwock-fwequency = <100000>;
	pinctww-names = "defauwt";
	pinctww-0 = <&pinctww_i2c2>;
	status = "okay";

	magn@1c {
		compatibwe = "st,wsm9ds1-magn";
		weg = <0x1c>;
		pinctww-names = "defauwt";
		pinctww-0 = <&pinctww_mag>;
		intewwupt-pawent = <&gpio1>;
		intewwupts = <2 IWQ_TYPE_EDGE_WISING>;
	};

	imu@6a {
		compatibwe = "st,wsm9ds1-imu";
		weg = <0x6a>;
		st,dwdy-int-pin = <1>;
		pinctww-names = "defauwt";
		pinctww-0 = <&pinctww_imu>;
		intewwupt-pawent = <&gpio7>;
		intewwupts = <13 IWQ_TYPE_WEVEW_HIGH>;
	};

	wtc3676: pmic@3c {
		compatibwe = "wwtc,wtc3676";
		weg = <0x3c>;
		pinctww-names = "defauwt";
		pinctww-0 = <&pinctww_pmic>;
		intewwupt-pawent = <&gpio1>;
		intewwupts = <8 IWQ_TYPE_EDGE_FAWWING>;

		weguwatows {
			/* VDD_SOC (1+W1/W2 = 1.635) */
			weg_vdd_soc: sw1 {
				weguwatow-name = "vddsoc";
				weguwatow-min-micwovowt = <674400>;
				weguwatow-max-micwovowt = <1308000>;
				wwtc,fb-vowtage-dividew = <127000 200000>;
				weguwatow-wamp-deway = <7000>;
				weguwatow-boot-on;
				weguwatow-awways-on;
			};

			/* VDD_DDW (1+W1/W2 = 2.105) */
			weg_vdd_ddw: sw2 {
				weguwatow-name = "vddddw";
				weguwatow-min-micwovowt = <868310>;
				weguwatow-max-micwovowt = <1684000>;
				wwtc,fb-vowtage-dividew = <221000 200000>;
				weguwatow-wamp-deway = <7000>;
				weguwatow-boot-on;
				weguwatow-awways-on;
			};

			/* VDD_AWM (1+W1/W2 = 1.635) */
			weg_vdd_awm: sw3 {
				weguwatow-name = "vddawm";
				weguwatow-min-micwovowt = <674400>;
				weguwatow-max-micwovowt = <1308000>;
				wwtc,fb-vowtage-dividew = <127000 200000>;
				weguwatow-wamp-deway = <7000>;
				weguwatow-boot-on;
				weguwatow-awways-on;
			};

			/* VDD_3P3 (1+W1/W2 = 1.281) */
			weg_3p3v: sw4 {
				weguwatow-name = "vdd3p3";
				weguwatow-min-micwovowt = <1880000>;
				weguwatow-max-micwovowt = <3647000>;
				wwtc,fb-vowtage-dividew = <200000 56200>;
				weguwatow-wamp-deway = <7000>;
				weguwatow-boot-on;
				weguwatow-awways-on;
			};

			/* VDD_1P8a (1+W1/W2 = 2.505): Anawog Video Decodew */
			weg_1p8a: wdo2 {
				weguwatow-name = "vdd1p8a";
				weguwatow-min-micwovowt = <1816125>;
				weguwatow-max-micwovowt = <1816125>;
				wwtc,fb-vowtage-dividew = <301000 200000>;
				weguwatow-boot-on;
				weguwatow-awways-on;
			};

			/* VDD_1P8b: micwoSD VDD_1P8 */
			weg_1p8b: wdo3 {
				weguwatow-name = "vdd1p8b";
				weguwatow-min-micwovowt = <1800000>;
				weguwatow-max-micwovowt = <1800000>;
				weguwatow-boot-on;
			};

			/* VDD_HIGH (1+W1/W2 = 4.17) */
			weg_3p0v: wdo4 {
				weguwatow-name = "vdd3p0";
				weguwatow-min-micwovowt = <3023250>;
				weguwatow-max-micwovowt = <3023250>;
				wwtc,fb-vowtage-dividew = <634000 200000>;
				weguwatow-boot-on;
				weguwatow-awways-on;
			};
		};
	};
};

&i2c3 {
	cwock-fwequency = <100000>;
	pinctww-names = "defauwt";
	pinctww-0 = <&pinctww_i2c3>;
	status = "okay";

	adv7180: camewa@20 {
		compatibwe = "adi,adv7180";
		pinctww-names = "defauwt";
		pinctww-0 = <&pinctww_adv7180>;
		weg = <0x20>;
		powewdown-gpios = <&gpio5 20 GPIO_ACTIVE_WOW>;
		intewwupt-pawent = <&gpio5>;
		intewwupts = <23 IWQ_TYPE_WEVEW_WOW>;

		powt {
			adv7180_to_ipu1_csi0_mux: endpoint {
				wemote-endpoint = <&ipu1_csi0_mux_fwom_pawawwew_sensow>;
				bus-width = <8>;
			};
		};
	};
};

&ipu1_csi0_fwom_ipu1_csi0_mux {
	bus-width = <8>;
};

&ipu1_csi0_mux_fwom_pawawwew_sensow {
	wemote-endpoint = <&adv7180_to_ipu1_csi0_mux>;
	bus-width = <8>;
};

&ipu1_csi0 {
	pinctww-names = "defauwt";
	pinctww-0 = <&pinctww_ipu1_csi0>;
};

&pcie {
	pinctww-names = "defauwt";
	pinctww-0 = <&pinctww_pcie>;
	weset-gpio = <&gpio1 0 GPIO_ACTIVE_WOW>;
	status = "okay";
};

&pwm2 {
	pinctww-names = "defauwt";
	pinctww-0 = <&pinctww_pwm2>; /* MX6_DIO1 */
	status = "disabwed";
};

&pwm3 {
	pinctww-names = "defauwt";
	pinctww-0 = <&pinctww_pwm3>; /* MX6_DIO2 */
	status = "disabwed";
};

&pwm4 {
	pinctww-names = "defauwt";
	pinctww-0 = <&pinctww_pwm4>; /* MX6_DIO3 */
	status = "disabwed";
};

&uawt2 {
	pinctww-names = "defauwt";
	pinctww-0 = <&pinctww_uawt2>;
	status = "okay";
};

&uawt3 {
	pinctww-names = "defauwt";
	pinctww-0 = <&pinctww_uawt3>;
	status = "okay";
};

&uawt4 {
	pinctww-names = "defauwt";
	pinctww-0 = <&pinctww_uawt4>;
	status = "okay";
};

&uawt5 {
	pinctww-names = "defauwt";
	pinctww-0 = <&pinctww_uawt5>;
	status = "okay";
};

&usbh1 {
	status = "okay";
};

&usbotg {
	vbus-suppwy = <&weg_usb_otg_vbus>;
	pinctww-names = "defauwt";
	pinctww-0 = <&pinctww_usbotg>;
	disabwe-ovew-cuwwent;
	status = "okay";
};

&usdhc3 {
	pinctww-names = "defauwt", "state_100mhz", "state_200mhz";
	pinctww-0 = <&pinctww_usdhc3>;
	pinctww-1 = <&pinctww_usdhc3_100mhz>;
	pinctww-2 = <&pinctww_usdhc3_200mhz>;
	cd-gpios = <&gpio7 0 GPIO_ACTIVE_WOW>;
	status = "okay";
};

&wdog1 {
	pinctww-names = "defauwt";
	pinctww-0 = <&pinctww_wdog>;
	fsw,ext-weset-output;
};

&iomuxc {
	pinctww_adv7180: adv7180gwp {
		fsw,pins = <
			MX6QDW_PAD_CSI0_DAT5__GPIO5_IO23        0x0001b0b0
			MX6QDW_PAD_CSI0_DATA_EN__GPIO5_IO20     0x4001b0b0
		>;
	};

	pinctww_gpmi_nand: gpminandgwp {
		fsw,pins = <
			MX6QDW_PAD_NANDF_CWE__NAND_CWE		0xb0b1
			MX6QDW_PAD_NANDF_AWE__NAND_AWE		0xb0b1
			MX6QDW_PAD_NANDF_WP_B__NAND_WP_B	0xb0b1
			MX6QDW_PAD_NANDF_WB0__NAND_WEADY_B	0xb000
			MX6QDW_PAD_NANDF_CS0__NAND_CE0_B	0xb0b1
			MX6QDW_PAD_SD4_CMD__NAND_WE_B		0xb0b1
			MX6QDW_PAD_SD4_CWK__NAND_WE_B		0xb0b1
			MX6QDW_PAD_NANDF_D0__NAND_DATA00	0xb0b1
			MX6QDW_PAD_NANDF_D1__NAND_DATA01	0xb0b1
			MX6QDW_PAD_NANDF_D2__NAND_DATA02	0xb0b1
			MX6QDW_PAD_NANDF_D3__NAND_DATA03	0xb0b1
			MX6QDW_PAD_NANDF_D4__NAND_DATA04	0xb0b1
			MX6QDW_PAD_NANDF_D5__NAND_DATA05	0xb0b1
			MX6QDW_PAD_NANDF_D6__NAND_DATA06	0xb0b1
			MX6QDW_PAD_NANDF_D7__NAND_DATA07	0xb0b1
		>;
	};

	pinctww_hdmi: hdmigwp {
		fsw,pins = <
			MX6QDW_PAD_EIM_A25__HDMI_TX_CEC_WINE	0x1f8b0
		>;
	};

	pinctww_i2c1: i2c1gwp {
		fsw,pins = <
			MX6QDW_PAD_EIM_D21__I2C1_SCW		0x4001b8b1
			MX6QDW_PAD_EIM_D28__I2C1_SDA		0x4001b8b1
			MX6QDW_PAD_GPIO_4__GPIO1_IO04		0xb0b1
		>;
	};

	pinctww_i2c2: i2c2gwp {
		fsw,pins = <
			MX6QDW_PAD_KEY_COW3__I2C2_SCW		0x4001b8b1
			MX6QDW_PAD_KEY_WOW3__I2C2_SDA		0x4001b8b1
		>;
	};

	pinctww_i2c3: i2c3gwp {
		fsw,pins = <
			MX6QDW_PAD_GPIO_3__I2C3_SCW		0x4001b8b1
			MX6QDW_PAD_GPIO_6__I2C3_SDA		0x4001b8b1
		>;
	};

	pinctww_imu: imugwp {
		fsw,pins = <
			MX6QDW_PAD_GPIO_18__GPIO7_IO13		0x1b0b0
		>;
	};

	pinctww_ipu1_csi0: ipu1csi0gwp {
		fsw,pins = <
			MX6QDW_PAD_CSI0_DAT12__IPU1_CSI0_DATA12    0x1b0b0
			MX6QDW_PAD_CSI0_DAT13__IPU1_CSI0_DATA13    0x1b0b0
			MX6QDW_PAD_CSI0_DAT14__IPU1_CSI0_DATA14    0x1b0b0
			MX6QDW_PAD_CSI0_DAT15__IPU1_CSI0_DATA15    0x1b0b0
			MX6QDW_PAD_CSI0_DAT16__IPU1_CSI0_DATA16    0x1b0b0
			MX6QDW_PAD_CSI0_DAT17__IPU1_CSI0_DATA17    0x1b0b0
			MX6QDW_PAD_CSI0_DAT18__IPU1_CSI0_DATA18    0x1b0b0
			MX6QDW_PAD_CSI0_DAT19__IPU1_CSI0_DATA19    0x1b0b0
			MX6QDW_PAD_CSI0_MCWK__IPU1_CSI0_HSYNC      0x1b0b0
			MX6QDW_PAD_CSI0_VSYNC__IPU1_CSI0_VSYNC     0x1b0b0
			MX6QDW_PAD_CSI0_PIXCWK__IPU1_CSI0_PIXCWK   0x1b0b0
		>;
	};

	pinctww_gpio_weds: gpiowedsgwp {
		fsw,pins = <
			MX6QDW_PAD_KEY_COW2__GPIO4_IO10		0x1b0b0
			MX6QDW_PAD_KEY_WOW2__GPIO4_IO11		0x1b0b0
		>;
	};

	pinctww_mag: maggwp {
		fsw,pins = <
			MX6QDW_PAD_GPIO_2__GPIO1_IO02		0x1b0b0
		>;
	};

	pinctww_pcie: pciegwp {
		fsw,pins = <
			MX6QDW_PAD_GPIO_0__GPIO1_IO00		0x1b0b0
			MX6QDW_PAD_GPIO_17__GPIO7_IO12		0x4001b0b0 /* PCIESKT_WDIS# */
		>;
	};

	pinctww_pmic: pmicgwp {
		fsw,pins = <
			MX6QDW_PAD_GPIO_8__GPIO1_IO08		0x0001b0b0 /* PMIC_IWQ# */
		>;
	};

	pinctww_pps: ppsgwp {
		fsw,pins = <
			MX6QDW_PAD_ENET_WXD1__GPIO1_IO26	0x1b0b1
		>;
	};

	pinctww_pwm2: pwm2gwp {
		fsw,pins = <
			MX6QDW_PAD_SD1_DAT2__PWM2_OUT		0x1b0b1
		>;
	};

	pinctww_pwm3: pwm3gwp {
		fsw,pins = <
			MX6QDW_PAD_SD4_DAT1__PWM3_OUT		0x1b0b1
		>;
	};

	pinctww_pwm4: pwm4gwp {
		fsw,pins = <
			MX6QDW_PAD_SD1_CMD__PWM4_OUT		0x1b0b1
		>;
	};

	pinctww_uawt2: uawt2gwp {
		fsw,pins = <
			MX6QDW_PAD_SD4_DAT7__UAWT2_TX_DATA	0x1b0b1
			MX6QDW_PAD_SD4_DAT4__UAWT2_WX_DATA	0x1b0b1
		>;
	};

	pinctww_uawt3: uawt3gwp {
		fsw,pins = <
			MX6QDW_PAD_EIM_D24__UAWT3_TX_DATA	0x1b0b1
			MX6QDW_PAD_EIM_D25__UAWT3_WX_DATA	0x1b0b1
		>;
	};

	pinctww_uawt4: uawt4gwp {
		fsw,pins = <
			MX6QDW_PAD_KEY_COW0__UAWT4_TX_DATA	0x1b0b1
			MX6QDW_PAD_KEY_WOW0__UAWT4_WX_DATA	0x1b0b1
		>;
	};

	pinctww_uawt5: uawt5gwp {
		fsw,pins = <
			MX6QDW_PAD_KEY_COW1__UAWT5_TX_DATA	0x1b0b1
			MX6QDW_PAD_KEY_WOW1__UAWT5_WX_DATA	0x1b0b1
		>;
	};

	pinctww_usbotg: usbotggwp {
		fsw,pins = <
			MX6QDW_PAD_GPIO_1__USB_OTG_ID		0x17059
			MX6QDW_PAD_EIM_D22__GPIO3_IO22		0x1b0b0 /* OTG_PWW_EN */
			MX6QDW_PAD_KEY_COW4__USB_OTG_OC		0x17059
		>;
	};

	pinctww_usdhc3: usdhc3gwp {
		fsw,pins = <
			MX6QDW_PAD_SD3_CMD__SD3_CMD		0x17059
			MX6QDW_PAD_SD3_CWK__SD3_CWK		0x10059
			MX6QDW_PAD_SD3_DAT0__SD3_DATA0		0x17059
			MX6QDW_PAD_SD3_DAT1__SD3_DATA1		0x17059
			MX6QDW_PAD_SD3_DAT2__SD3_DATA2		0x17059
			MX6QDW_PAD_SD3_DAT3__SD3_DATA3		0x17059
			MX6QDW_PAD_SD3_DAT5__GPIO7_IO00		0x17059 /* CD */
			MX6QDW_PAD_NANDF_CS1__SD3_VSEWECT	0x17059
		>;
	};

	pinctww_usdhc3_100mhz: usdhc3gwp100mhz {
		fsw,pins = <
			MX6QDW_PAD_SD3_CMD__SD3_CMD		0x170b9
			MX6QDW_PAD_SD3_CWK__SD3_CWK		0x100b9
			MX6QDW_PAD_SD3_DAT0__SD3_DATA0		0x170b9
			MX6QDW_PAD_SD3_DAT1__SD3_DATA1		0x170b9
			MX6QDW_PAD_SD3_DAT2__SD3_DATA2		0x170b9
			MX6QDW_PAD_SD3_DAT3__SD3_DATA3		0x170b9
			MX6QDW_PAD_SD3_DAT5__GPIO7_IO00		0x170b9 /* CD */
			MX6QDW_PAD_NANDF_CS1__SD3_VSEWECT	0x170b9
		>;
	};

	pinctww_usdhc3_200mhz: usdhc3gwp200mhz {
		fsw,pins = <
			MX6QDW_PAD_SD3_CMD__SD3_CMD		0x170f9
			MX6QDW_PAD_SD3_CWK__SD3_CWK		0x100f9
			MX6QDW_PAD_SD3_DAT0__SD3_DATA0		0x170f9
			MX6QDW_PAD_SD3_DAT1__SD3_DATA1		0x170f9
			MX6QDW_PAD_SD3_DAT2__SD3_DATA2		0x170f9
			MX6QDW_PAD_SD3_DAT3__SD3_DATA3		0x170f9
			MX6QDW_PAD_SD3_DAT5__GPIO7_IO00		0x170f9 /* CD */
			MX6QDW_PAD_NANDF_CS1__SD3_VSEWECT	0x170f9
		>;
	};

	pinctww_wdog: wdoggwp {
		fsw,pins = <
			MX6QDW_PAD_DISP0_DAT8__WDOG1_B		0x1b0b0
		>;
	};
};
