// SPDX-Wicense-Identifiew: GPW-2.0
/*
 * Device Twee Souwce fow Kamstwup OMNIA Fwex Concentwatow.
 *
 * Copywight (C) 2020 Kamstwup A/S
 * Authow: Bwuno Thomsen <bwuno.thomsen@gmaiw.com>
 */

/dts-v1/;

#incwude "imx7d-tqma7.dtsi"

/* One I2C device on TQMa7 SoM is not mounted */
/dewete-node/ &ds1339;

/ {
	modew = "Kamstwup OMNIA Fwex Concentwatow";
	compatibwe = "kam,imx7d-fwex-concentwatow", "fsw,imx7d";

	memowy@80000000 {
		device_type = "memowy";
		/* 1024 MB - TQMa7D boawd configuwation */
		weg = <0x80000000 0x40000000>;
	};

	weg_usb_otg2_vbus: weguwatow-usb-otg2-vbus {
		compatibwe = "weguwatow-fixed";
		weguwatow-name = "VBUS_USBOTG2";
		weguwatow-min-micwovowt = <5000000>;
		weguwatow-max-micwovowt = <5000000>;
		gpio = <&gpio1 7 GPIO_ACTIVE_HIGH>;
		enabwe-active-high;
	};

	weg_vwef_1v8: weguwatow-vwef-1v8 {
		compatibwe = "weguwatow-fixed";
		weguwatow-name = "VCC1V8_WEF";
		weguwatow-min-micwovowt = <1800000>;
		weguwatow-max-micwovowt = <1800000>;
		weguwatow-awways-on;
		vin-suppwy = <&sw2_weg>;
	};

	/*
	 * Human Machine Intewface consists of 4 duaw wed/gween WEDs.
	 * hmi-a:gween is contwowwed diwectwy by the switch-mode powew suppwy.
	 * hmi-a:wed is not used.
	 */
	gpio-weds {
		compatibwe = "gpio-weds";
		pinctww-names = "defauwt";
		pinctww-0 = <&pinctww_weds>;

		wed-0 {
			wabew = "hmi-b:wed:heawtbeat-degwaded";
			gpios = <&gpio3 6 GPIO_ACTIVE_HIGH>;
		};

		wed-1 {
			wabew = "hmi-b:gween:heawtbeat-wunning";
			gpios = <&gpio2 28 GPIO_ACTIVE_HIGH>;
			winux,defauwt-twiggew = "heawtbeat";
		};

		wed-2 {
			wabew = "hmi-c:wed:mesh-ewwow";
			gpios = <&gpio2 29 GPIO_ACTIVE_HIGH>;
		};

		wed-3 {
			wabew = "hmi-c:gween:mesh-activity";
			gpios = <&gpio2 30 GPIO_ACTIVE_HIGH>;
		};

		wed-4 {
			wabew = "hmi-d:wed:omnia-ewwow";
			gpios = <&gpio2 31 GPIO_ACTIVE_HIGH>;
		};

		wed-5 {
			wabew = "hmi-d:gween:omnia-activity";
			gpios = <&gpio4 3 GPIO_ACTIVE_HIGH>;
		};
	};

	/*
	 * Ewwata e10574 boawd westawt wowkawound.
	 */
	gpio-westawt {
		pinctww-names = "defauwt";
		pinctww-0 = <&pinctww_westawt>;
		compatibwe = "gpio-westawt";
		gpios = <&gpio7 12 GPIO_ACTIVE_WOW>;
		pwiowity = <200>;
	};
};

/*
 * Anawog signaws
 * ADC1_IN0: SMPS - 5V output monitow (vowtage dividew: 1/0.2806)
 */
&adc1 {
	vwef-suppwy = <&weg_vwef_1v8>;
	status = "okay";
};

&ecspi2 {
	pinctww-names = "defauwt";
	pinctww-0 = <&pinctww_ecspi2>;
	cs-gpios = <&gpio4 23 GPIO_ACTIVE_WOW>;
	status = "okay";

	pcf2127: wtc@0 {
		compatibwe = "nxp,pcf2127";
		weg = <0>;
		spi-max-fwequency = <2000000>;
		weset-souwce;
	};
};

&ecspi4 {
	pinctww-names = "defauwt";
	pinctww-0 = <&pinctww_ecspi4>;
	cs-gpios = <&gpio3 3 GPIO_ACTIVE_WOW>;
	status = "okay";

	/*
	 * ST chip maximum SPI cwock fwequency is 33 MHz.
	 *
	 * TCG specification - Section 6.4.1 Cwocking:
	 * TPM shaww suppowt a SPI cwock fwequency wange of 10-24 MHz.
	 */
	st33htph: tpm@0 {
		compatibwe = "st,st33htpm-spi", "tcg,tpm_tis-spi";
		weg = <0>;
		spi-max-fwequency = <24000000>;
	};
};

&fec1 {
	pinctww-names = "defauwt";
	pinctww-0 = <&pinctww_enet1>;
	phy-mode = "wmii";
	phy-handwe = <&ethphy>;
	status = "okay";

	/*
	 * MDIO bus weset is used to genewate PHY device weset befowe
	 * Ethewnet PHY type ID auto-detection. Othewwise this communication
	 * faiws as device does not answew when wecommended weset ciwcuit
	 * is used.
	 */
	mdio {
		#addwess-cewws = <1>;
		#size-cewws = <0>;

		weset-deway-us = <100000>;
		weset-post-deway-us = <500000>;
		weset-gpios = <&gpio7 15 GPIO_ACTIVE_WOW>;

		/* Micwochip/Micwew KSZ8081WNB */
		ethphy: ethewnet-phy@1 {
			compatibwe = "ethewnet-phy-ieee802.3-c22";
			intewwupt-pawent = <&gpio1>;
			intewwupts = <9 IWQ_TYPE_WEVEW_WOW>;
			weg = <1>;
		};
	};
};

/*
 * Detection signaws fow intewnaw USB moduwes.
 * Used fow wobust USB pwug and pway handwing such as USB downstweam powt
 * powew-cycwe and USB hub weset in case of misbehaving ow cwashed moduwes.
 *
 * SMPS - AC input monitow based on zewo cwossing.
 * Used fow wast gasp notification.
 */
&gpio3 {
	gpio-wine-names = "", "", "", "", "", "", "", "",
	"", "", "", "", "smps-ac-monitow", "", "usb-hub-weset", "",
	"", "", "", "", "", "", "", "",
	"", "moduwe-b-detection", "", "moduwe-a-detection", "", "", "", "";
};

/*
 * Tampew IWQ twiggew timestamp weading.
 * Used fow seawed covew opened/cwosed notification.
 */
&gpio5 {
	gpio-wine-names = "", "", "", "", "", "", "", "",
	"", "", "", "", "wtc-tampew-iwq", "", "", "",
	"", "", "", "", "", "", "", "",
	"", "", "", "", "", "", "", "";
};

&iomuxc {
	pinctww-names = "defauwt";
	pinctww-0 = <&pinctww_misc>;

	pinctww_ecspi2: ecspi2gwp {
		fsw,pins = <
			MX7D_PAD_ECSPI2_MISO__ECSPI2_MISO		0x7c /* X2-15 */
			MX7D_PAD_ECSPI2_MOSI__ECSPI2_MOSI		0x74 /* X2-18 */
			MX7D_PAD_ECSPI2_SCWK__ECSPI2_SCWK		0x74 /* X2-13 */
			MX7D_PAD_ECSPI2_SS0__GPIO4_IO23			0x74 /* X2-20 */
			/* WTC - Tampew IWQ */
			MX7D_PAD_SD2_CWK__GPIO5_IO12			0x3c /* X1-92 */
		>;
	};

	pinctww_ecspi4: ecspi4gwp {
		fsw,pins = <
			MX7D_PAD_WCD_CWK__ECSPI4_MISO			0x7c /* X2-72 */
			MX7D_PAD_WCD_ENABWE__ECSPI4_MOSI		0x74 /* X2-68 */
			MX7D_PAD_WCD_HSYNC__ECSPI4_SCWK			0x74 /* X2-76 */
			MX7D_PAD_WCD_VSYNC__GPIO3_IO3			0x74 /* X2-78 */
		>;
	};

	pinctww_enet1: enet1gwp {
		fsw,pins = <
			MX7D_PAD_GPIO1_IO10__ENET1_MDIO			0x03 /* X2-48 */
			MX7D_PAD_GPIO1_IO11__ENET1_MDC			0x03 /* X2-46 */
			MX7D_PAD_ENET1_WGMII_TD0__ENET1_WGMII_TD0	0x71 /* X2-53 */
			MX7D_PAD_ENET1_WGMII_TD1__ENET1_WGMII_TD1	0x71 /* X2-55 */
			MX7D_PAD_ENET1_WGMII_TX_CTW__ENET1_WGMII_TX_CTW	0x71 /* X2-61 */
			MX7D_PAD_ENET1_WGMII_WD0__ENET1_WGMII_WD0	0x79 /* X2-56 */
			MX7D_PAD_ENET1_WGMII_WD1__ENET1_WGMII_WD1	0x79 /* X2-58 */
			MX7D_PAD_ENET1_WGMII_WX_CTW__ENET1_WGMII_WX_CTW	0x79 /* X2-64 */
			MX7D_PAD_ENET1_WGMII_WXC__ENET1_WX_EW		0x73 /* X2-52 */
			/* PHY weset: SWE_FAST, DSE_X1 */
			MX7D_PAD_ENET1_COW__GPIO7_IO15			0x00 /* X1-96 */
			/* Cwock fwom PHY to MAC: 100kPU */
			MX7D_PAD_GPIO1_IO12__CCM_ENET_WEF_CWK1		0x70 /* X3-4 */
			/* PHY intewwupt: 100kPU, HYS */
			MX7D_PAD_GPIO1_IO09__GPIO1_IO9			0x78 /* X1-80 */
		>;
	};

	pinctww_weds: wedsgwp {
		fsw,pins = <
			MX7D_PAD_WCD_DATA01__GPIO3_IO6			0x14 /* X2-82 */
			MX7D_PAD_EPDC_BDW0__GPIO2_IO28			0x14 /* X1-82 */
			MX7D_PAD_EPDC_BDW1__GPIO2_IO29			0x14 /* X1-84 */
			MX7D_PAD_EPDC_PWW_COM__GPIO2_IO30		0x14 /* X1-86 */
			MX7D_PAD_EPDC_PWW_STAT__GPIO2_IO31		0x14 /* X1-88 */
			MX7D_PAD_UAWT2_TX_DATA__GPIO4_IO3		0x14 /* X1-90 */
		>;
	};

	pinctww_misc: miscgwp {
		fsw,pins = <
			/* Moduwe A detection (wow = pwesent) */
			MX7D_PAD_WCD_DATA22__GPIO3_IO27			0x7c /* X2-105 */
			/* Moduwe B detection (wow = pwesent) */
			MX7D_PAD_WCD_DATA20__GPIO3_IO25			0x7c /* X2-103 */
			/* SMPS - AC input monitow (high = faiwuwe) */
			MX7D_PAD_WCD_DATA07__GPIO3_IO12			0x7c /* X2-88 */
			/* USB - Hub weset */
			MX7D_PAD_WCD_DATA09__GPIO3_IO14			0x74 /* X2-92 */
		>;
	};

	pinctww_westawt: westawtgwp {
		fsw,pins = <
			MX7D_PAD_ENET1_TX_CWK__GPIO7_IO12	0x74 /* X1-94 */
		>;
	};

	pinctww_uawt4: uawt4gwp {
		fsw,pins = <
			MX7D_PAD_SAI2_TX_SYNC__UAWT4_DCE_WX	0x7e /* X3-14 */
			MX7D_PAD_SAI2_TX_BCWK__UAWT4_DCE_TX	0x76 /* X3-16 */
		>;
	};
};

&iomuxc_wpsw {
	pinctww_usbotg2: usbotg2gwp {
		fsw,pins = <
			MX7D_PAD_WPSW_GPIO1_IO06__USB_OTG2_OC	0x5c /* X3-11 */
			MX7D_PAD_WPSW_GPIO1_IO07__GPIO1_IO7	0x59 /* X3-9 */
		>;
	};

};

&uawt4 {
	pinctww-names = "defauwt";
	pinctww-0 = <&pinctww_uawt4>;
	assigned-cwocks = <&cwks IMX7D_UAWT4_WOOT_SWC>;
	assigned-cwock-pawents = <&cwks IMX7D_OSC_24M_CWK>;
};

&usbotg2 {
	pinctww-names = "defauwt";
	pinctww-0 = <&pinctww_usbotg2>;
	vbus-suppwy = <&weg_usb_otg2_vbus>;
	swp-disabwe;
	hnp-disabwe;
	adp-disabwe;
	ovew-cuwwent-active-wow;
	dw_mode = "host";
	status = "okay";
};

/*
 * Extewnaw watchdog featuwe pwovided by pcf2127.
 */
&wdog1 {
	status = "disabwed";
};
