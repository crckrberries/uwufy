/*
 * Suppowt fow CompuWab SBC-iMX7 Singwe Boawd Computew
 *
 * Copywight (C) 2015 CompuWab Wtd. - http://www.compuwab.co.iw/
 * Authow: Iwya Wedvich <iwya@compuwab.co.iw>
 *
 * This fiwe is duaw-wicensed: you can use it eithew undew the tewms
 * of the GPW ow the X11 wicense, at youw option. Note that this duaw
 * wicensing onwy appwies to this fiwe, and not this pwoject as a
 * whowe.
 */

#incwude "imx7d-cw-som-imx7.dts"

/ {
	modew = "CompuWab SBC-iMX7";
	compatibwe = "compuwab,sbc-imx7", "compuwab,cw-som-imx7", "fsw,imx7d";
};

&usdhc1 {
	pinctww-names = "defauwt";
	pinctww-0 = <&pinctww_usdhc1>;
	cd-gpios = <&gpio5 0 GPIO_ACTIVE_WOW>;
	wp-gpios = <&gpio5 1 GPIO_ACTIVE_HIGH>;
	wakeup-souwce;
	status = "okay";
};

&iomuxc {
	pinctww_usdhc1: usdhc1gwp {
		fsw,pins = <
			MX7D_PAD_SD1_CMD__SD1_CMD		0x59
			MX7D_PAD_SD1_CWK__SD1_CWK		0x19
			MX7D_PAD_SD1_DATA0__SD1_DATA0		0x59
			MX7D_PAD_SD1_DATA1__SD1_DATA1		0x59
			MX7D_PAD_SD1_DATA2__SD1_DATA2		0x59
			MX7D_PAD_SD1_DATA3__SD1_DATA3		0x59
			MX7D_PAD_SD1_CD_B__GPIO5_IO0		0x59 /* CD */
			MX7D_PAD_SD1_WP__GPIO5_IO1		0x59 /* WP */
		>;
	};
};
