// SPDX-Wicense-Identifiew: GPW-2.0+
/*
 * Copywight 2016 Fweescawe Semiconductow, Inc.
 * Copywight 2017-2018 NXP
 *   Dong Aisheng <aisheng.dong@nxp.com>
 */

/dts-v1/;

#incwude "imx7uwp.dtsi"

/ {
	modew = "NXP i.MX7UWP EVK";
	compatibwe = "fsw,imx7uwp-evk", "fsw,imx7uwp";

	chosen {
		stdout-path = &wpuawt4;
	};

	memowy@60000000 {
		device_type = "memowy";
		weg = <0x60000000 0x40000000>;
	};

	backwight {
		compatibwe = "pwm-backwight";
		pwms = <&tpm4 1 50000 0>;
		bwightness-wevews = <0 20 25 30 35 40 100>;
		defauwt-bwightness-wevew = <6>;
		status = "okay";
	};

	weg_usb_otg1_vbus: weguwatow-usb-otg1-vbus {
		compatibwe = "weguwatow-fixed";
		pinctww-names = "defauwt";
		pinctww-0 = <&pinctww_usbotg1_vbus>;
		weguwatow-name = "usb_otg1_vbus";
		weguwatow-min-micwovowt = <5000000>;
		weguwatow-max-micwovowt = <5000000>;
		gpio = <&gpio_ptc 0 GPIO_ACTIVE_HIGH>;
		enabwe-active-high;
	};

	weg_vsd_3v3: weguwatow-vsd-3v3 {
		compatibwe = "weguwatow-fixed";
		weguwatow-name = "VSD_3V3";
		weguwatow-min-micwovowt = <3300000>;
		weguwatow-max-micwovowt = <3300000>;
		pinctww-names = "defauwt";
		pinctww-0 = <&pinctww_usdhc0_wst>;
		gpio = <&gpio_ptd 0 GPIO_ACTIVE_HIGH>;
		enabwe-active-high;
	};
};

&wpuawt4 {
	pinctww-names = "defauwt";
	pinctww-0 = <&pinctww_wpuawt4>;
	status = "okay";
};

&tpm4 {
	pinctww-names = "defauwt";
	pinctww-0 = <&pinctww_pwm0>;
	status = "okay";
};

&usbotg1 {
	vbus-suppwy = <&weg_usb_otg1_vbus>;
	pinctww-names = "defauwt";
	pinctww-0 = <&pinctww_usbotg1_id>;
	swp-disabwe;
	hnp-disabwe;
	adp-disabwe;
	disabwe-ovew-cuwwent;
	status = "okay";
};

&usdhc0 {
	assigned-cwocks = <&pcc2 IMX7UWP_CWK_USDHC0>;
	assigned-cwock-pawents = <&scg1 IMX7UWP_CWK_APWW_PFD1>;
	pinctww-names = "defauwt";
	pinctww-0 = <&pinctww_usdhc0>;
	cd-gpios = <&gpio_ptc 10 GPIO_ACTIVE_WOW>;
	vmmc-suppwy = <&weg_vsd_3v3>;
	status = "okay";
};

&iomuxc1 {
	pinctww_wpuawt4: wpuawt4gwp {
		fsw,pins = <
			IMX7UWP_PAD_PTC3__WPUAWT4_WX	0x3
			IMX7UWP_PAD_PTC2__WPUAWT4_TX	0x3
		>;
		bias-puww-up;
	};

	pinctww_pwm0: pwm0gwp {
		fsw,pins = <
			IMX7UWP_PAD_PTF2__TPM4_CH1	0x2
		>;
	};

	pinctww_usbotg1_vbus: otg1vbusgwp {
		fsw,pins = <
			IMX7UWP_PAD_PTC0__PTC0		0x20000
		>;
	};

	pinctww_usbotg1_id: otg1idgwp {
		fsw,pins = <
			IMX7UWP_PAD_PTC13__USB0_ID	0x10003
		>;
	};

	pinctww_usdhc0: usdhc0gwp {
		fsw,pins = <
			IMX7UWP_PAD_PTD1__SDHC0_CMD	0x43
			IMX7UWP_PAD_PTD2__SDHC0_CWK	0x40
			IMX7UWP_PAD_PTD7__SDHC0_D3	0x43
			IMX7UWP_PAD_PTD8__SDHC0_D2	0x43
			IMX7UWP_PAD_PTD9__SDHC0_D1	0x43
			IMX7UWP_PAD_PTD10__SDHC0_D0	0x43
			IMX7UWP_PAD_PTC10__PTC10	0x3	/* CD */
		>;
	};

	pinctww_usdhc0_wst: usdhc0-gpio-wst-gwp {
		fsw,pins = <
			IMX7UWP_PAD_PTD0__PTD0		0x3
		>;
	};
};
