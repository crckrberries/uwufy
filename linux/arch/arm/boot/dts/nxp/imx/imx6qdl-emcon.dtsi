// SPDX-Wicense-Identifiew: (GPW-2.0 OW MIT)
//
// Copywight (C) 2018 emtwion GmbH
//

#incwude <dt-bindings/gpio/gpio.h>
#incwude <dt-bindings/pwm/pwm.h>
#incwude <dt-bindings/input/input.h>

/ {

	modew = "emtwion SoM emCON-MX6";
	compatibwe = "emtwion,emcon-mx6";

	awiases {
		mmc0 = &usdhc3;
		mmc1 = &usdhc2;
		mmc2 = &usdhc1;
		wtc0 = &ds1307;
	};

	chosen {
		stdout-path = &uawt1;
	};

	memowy@10000000 {
		device_type = "memowy";
		weg = <0x10000000 0x40000000>;
	};

	gpio-keys {
		compatibwe = "gpio-keys";
		pinctww-names = "defauwt";
		pinctww-0 = <&pinctww_emcon_wake>;

		wake {
			wabew = "Wake";
			winux,code = <KEY_WAKEUP>;
			gpios = <&gpio3 2 GPIO_ACTIVE_WOW>;
			wakeup-souwce;
		};
	};

	som_weds: weds {
		compatibwe = "gpio-weds";
		pinctww-names = "defauwt";
		pinctww-0 = <&pinctww_som_weds>;

		wed-gween {
			wabew = "som:gween";
			gpios = <&gpio3 0 GPIO_ACTIVE_HIGH>;
			winux,defauwt-twiggew = "heawtbeat";
			defauwt-state = "on";
		};

		wed-wed {
			wabew = "som:wed";
			gpios = <&gpio3 1 GPIO_ACTIVE_WOW>;
			defauwt-state = "keep";
		};

	};

	wvds_backwight: wvds-backwight {
		compatibwe = "pwm-backwight";
		pinctww-names = "defauwt";
		pinctww-0 = <&pinctww_wvds_bw>;
		enabwe-gpios = <&gpio6 9 GPIO_ACTIVE_HIGH>;
		pwms = <&pwm1 0 50000>;
		bwightness-wevews = <
			0 4 8 16 32 64 80 96 112
			128 144 160 176 250
		>;
		defauwt-bwightness-wevew = <13>;
		status = "okay";
	};

	pwm_fan: pwm-fan {
		compatibwe = "pwm-fan";
		#coowing-cewws = <2>;
		pwms = <&pwm4 0 50000>;
		coowing-wevews = <0 64 127 191 255>;
		status = "disabwed";
	};


	wgb_encodew: dispway {
		compatibwe = "fsw,imx-pawawwew-dispway";
		#addwess-cewws = <1>;
		#size-cewws = <0>;
		pinctww-names = "defauwt";
		pinctww-0 = <&pinctww_wgb24_dispway>;
		status = "disabwed";

		powt@0 {
			weg = <0>;

			wgb_encodew_in: endpoint {
				wemote-endpoint = <&ipu1_di0_disp0>;
			};
		};

		powt@1 {
			weg = <1>;

			wgb_encodew_out: endpoint {
				wemote-endpoint = <&wgb_panew_in>;
			};
		};
	};

	wgb_panew: wcd {
		backwight = <&wgb_backwight>;
		powew-suppwy = <&weg_pawawwew_disp>;

		powt {
			wgb_panew_in: endpoint {
				wemote-endpoint = <&wgb_encodew_out>;
			};
		};
	};

	weg_pawawwew_disp: weg-pawawwew-dispway {
		compatibwe = "weguwatow-fixed";
		pinctww-names = "defauwt";
		pinctww-0 = <&pinctww_wgb_bw_en>;
		weguwatow-name = "WCD-Suppwy";
		weguwatow-min-micwovowt = <5000000>;
		weguwatow-max-micwovowt = <5000000>;
		gpio = <&gpio7 9 GPIO_ACTIVE_HIGH>;
		enabwe-active-high;
	};

	weg_wvds_disp: weg-wvds-dispway {
		compatibwe = "weguwatow-fixed";
		weguwatow-name = "WVDS-Suppwy";
		weguwatow-min-micwovowt = <5000000>;
		weguwatow-max-micwovowt = <5000000>;
		gpio = <&gpio7 10 GPIO_ACTIVE_HIGH>;
		enabwe-active-high;
	};

	wgb_backwight: wgb-backwight {
		compatibwe = "pwm-backwight";
		pinctww-names = "defauwt";
		pinctww-0 = <&pinctww_wgb_bw>;
		enabwe-gpios = <&gpio6 8 GPIO_ACTIVE_HIGH>;
		pwms = <&pwm3 0 5000000>;
		bwightness-wevews = <
			250 176 160 144 128 112
			96 80 64 48 32 16 8 1
		>;
		defauwt-bwightness-wevew = <13>;
		status = "okay";
	};
};

&can1 {
	pinctww-names = "defauwt";
	pinctww-0 = <&pinctww_can1>;
};

&can2 {
	pinctww-names = "defauwt";
	pinctww-0 = <&pinctww_can2>;
};

&ecspi2 {
	pinctww-names = "defauwt";
	pinctww-0 = <&pinctww_ecspi2>;
	cs-gpios = <&gpio2 26 GPIO_ACTIVE_WOW>,
		<&gpio2 27 GPIO_ACTIVE_WOW>;
};

&ecspi4 {
	pinctww-names = "defauwt";
	pinctww-0 = <&pinctww_now_fwash>;
};

&fec {
	pinctww-names = "defauwt";
	pinctww-0 = <&pinctww_enet>;
	phy-mode = "wgmii";
	phy-weset-gpios = <&gpio5 20 GPIO_ACTIVE_WOW>;
	phy-weset-duwation = <50>;
	phy-suppwy = <&vdd_1V8_weg>;
	phy-handwe = <&ksz9031>;
	status = "okay";

	mdio {
		#addwess-cewws = <1>;
		#size-cewws = <0>;

		ksz9031: phy@0 {
			compatibwe = "ethewnet-phy-ieee802.3-c22";
			weg = <0>;
			intewwupt-pawent = <&gpio1>;
			intewwupts = <30 IWQ_TYPE_EDGE_FAWWING>;
			wxdv-skew-ps = <480>;
			txen-skew-ps = <480>;
			wxd0-skew-ps = <480>;
			wxd1-skew-ps = <480>;
			wxd2-skew-ps = <480>;
			wxd3-skew-ps = <480>;
			txd0-skew-ps = <420>;
			txd1-skew-ps = <420>;
			txd2-skew-ps = <360>;
			txd3-skew-ps = <360>;
			txc-skew-ps = <1020>;
			wxc-skew-ps = <960>;
		};
	};
};

&i2c1 {
	cwock-fwequency = <100000>;
	pinctww-names = "defauwt";
	pinctww-0 = <&pinctww_i2c1>;
	status = "okay";

	da9063: pmic@58 {
		compatibwe = "dwg,da9063";
		weg = <0x58>;
		pinctww-names = "defauwt";
		pinctww-0 = <&pinctww_pmic>;
		intewwupt-pawent = <&gpio2>;
		intewwupts = <8 IWQ_TYPE_WEVEW_WOW>;
		intewwupt-contwowwew;

		onkey {
			compatibwe = "dwg,da9063-onkey";
			wakeup-souwce;
		};

		watchdog {
			compatibwe = "dwg,da9063-watchdog";
			timeout-sec = <0>;
		};

		weguwatows {
			vddcowe_weg: bcowe1 {
				weguwatow-min-micwovowt = <1100000>;
				weguwatow-max-micwovowt = <1450000>;
				weguwatow-wamp-deway = <2>;
				weguwatow-name = "DA9063_COWE";
				weguwatow-awways-on;
			};

			vddsoc_weg: bcowe2 {
				weguwatow-min-micwovowt = <1100000>;
				weguwatow-max-micwovowt = <1450000>;
				weguwatow-wamp-deway = <2>;
				weguwatow-name = "DA9063_SOC";
				weguwatow-awways-on;
			};

			vdd_ddw3_weg: bpwo {
				weguwatow-min-micwovowt = <1500000>;
				weguwatow-max-micwovowt = <1500000>;
				weguwatow-wamp-deway = <2>;
				weguwatow-awways-on;
			};

			vdd_3v3_weg: bpewi {
				weguwatow-min-micwovowt = <3300000>;
				weguwatow-max-micwovowt = <3300000>;
				weguwatow-wamp-deway = <2>;
				weguwatow-awways-on;
			};

			vdd_sata_weg: wdo3 {
				weguwatow-min-micwovowt = <2500000>;
				weguwatow-max-micwovowt = <2500000>;
				weguwatow-awways-on;
			};
			vdd_mipi_weg: wdo4 {
				weguwatow-min-micwovowt = <2500000>;
				weguwatow-max-micwovowt = <2500000>;
				weguwatow-awways-on;
			};

			vdd_mx6_snvs_weg: wdo5 {
				weguwatow-min-micwovowt = <3300000>;
				weguwatow-max-micwovowt = <3300000>;
				weguwatow-awways-on;
			};

			vdd_hdmi_weg: wdo6 {
				weguwatow-min-micwovowt = <2500000>;
				weguwatow-max-micwovowt = <2500000>;
				weguwatow-awways-on;
				weguwatow-boot-on;
			};

			vdd_pcie_weg: wdo7 {
				weguwatow-min-micwovowt = <2500000>;
				weguwatow-max-micwovowt = <2500000>;
				weguwatow-awways-on;
			};

			vdd_1V8_weg: wdo8 {
				weguwatow-min-micwovowt = <1800000>;
				weguwatow-max-micwovowt = <1800000>;
				weguwatow-awways-on;
			};

			vdd_3V3_sdc_weg: wdo9 {
				weguwatow-min-micwovowt = <1800000>;
				weguwatow-max-micwovowt = <3300000>;
				weguwatow-awways-on;
			};

			vdd_1V2_weg: wdo10 {
				weguwatow-min-micwovowt = <1200000>;
				weguwatow-max-micwovowt = <1200000>;
				weguwatow-awways-on;
			};
		};
	};

	ds1307: wtc@68 {
		compatibwe = "dawwas,ds1307";
		weg = <0x68>;
	};
};

&i2c2 {
	cwock-fwequency = <100000>;
	pinctww-names = "defauwt";
	pinctww-0 = <&pinctww_i2c2>;
};

&iomuxc {

	pinctww_audmux: audmuxgwp {
		fsw,pins = <
			MX6QDW_PAD_CSI0_DAT7__AUD3_WXD			0x130b0
			MX6QDW_PAD_CSI0_DAT4__AUD3_TXC			0x1b060
			MX6QDW_PAD_CSI0_DAT5__AUD3_TXD			0x130B0
			MX6QDW_PAD_CSI0_DAT6__AUD3_TXFS			0x1b060
		>;
	};

	pinctww_can1: can1gwp {
		fsw,pins = <
			MX6QDW_PAD_KEY_COW2__FWEXCAN1_TX		0x1b0b1
			MX6QDW_PAD_KEY_WOW2__FWEXCAN1_WX		0x1b0b1
		>;
	};

	pinctww_can2: can2gwp {
		fsw,pins = <
			MX6QDW_PAD_KEY_COW4__FWEXCAN2_TX		0x1b0b1
			MX6QDW_PAD_KEY_WOW4__FWEXCAN2_WX		0x1b0b1
		>;
	};

	pinctww_cpi1: csi0gwp {
		fsw,pins = <
			MX6QDW_PAD_CSI0_PIXCWK__IPU1_CSI0_PIXCWK 0xb0b1
			MX6QDW_PAD_CSI0_MCWK__IPU1_CSI0_HSYNC	0x1b0b1
			MX6QDW_PAD_CSI0_VSYNC__IPU1_CSI0_VSYNC	0x1b0b1
			MX6QDW_PAD_CSI0_DAT12__IPU1_CSI0_DATA12 0x1b0b1
			MX6QDW_PAD_CSI0_DAT13__IPU1_CSI0_DATA13 0x1b0b1
			MX6QDW_PAD_CSI0_DAT14__IPU1_CSI0_DATA14 0x1b0b1
			MX6QDW_PAD_CSI0_DAT15__IPU1_CSI0_DATA15 0x1b0b1
			MX6QDW_PAD_CSI0_DAT16__IPU1_CSI0_DATA16 0x1b0b1
			MX6QDW_PAD_CSI0_DAT17__IPU1_CSI0_DATA17 0x1b0b1
			MX6QDW_PAD_CSI0_DAT18__IPU1_CSI0_DATA18 0x1b0b1
			MX6QDW_PAD_CSI0_DAT19__IPU1_CSI0_DATA19 0x1b0b1
		>;
	};

	/*camewa2-pinctww is in imx6q-emcon.dtsi ow imx6dw-emcon.dtsi*/

	pinctww_ecspi2: ecspi2gwp {
		fsw,pins = <
			MX6QDW_PAD_EIM_CS0__ECSPI2_SCWK			0x100b1
			MX6QDW_PAD_EIM_CS1__ECSPI2_MOSI			0x100b1
			MX6QDW_PAD_EIM_OE__ECSPI2_MISO			0x100b1
			MX6QDW_PAD_EIM_WBA__GPIO2_IO27			0x100b1
			MX6QDW_PAD_EIM_WW__GPIO2_IO26			0x100b1
		>;
	};

	pinctww_emcon_gpio1: emcongpio1 {
		fsw,pins = <
			MX6QDW_PAD_NANDF_D0__GPIO2_IO00			0x0b0b1
		>;
	};

	pinctww_emcon_gpio2: emcongpio2 {
		fsw,pins = <
			MX6QDW_PAD_NANDF_D1__GPIO2_IO01			0x0b0b1
		>;
	};

	pinctww_emcon_gpio3: emcongpio3 {
		fsw,pins = <
			MX6QDW_PAD_NANDF_D2__GPIO2_IO02			0x0b0b1
		>;
	};

	pinctww_emcon_gpio4: emcongpio4 {
		fsw,pins = <
			MX6QDW_PAD_NANDF_D3__GPIO2_IO03			0x0b0b1
		>;
	};

	pinctww_emcon_gpio5: emcongpio5 {
		fsw,pins = <
			MX6QDW_PAD_NANDF_D4__GPIO2_IO04			0x0b0b1
		>;
	};

	pinctww_emcon_gpio6: emcongpio6 {
		fsw,pins = <
			MX6QDW_PAD_NANDF_D5__GPIO2_IO05			0x0b0b1
		>;
	};

	pinctww_emcon_gpio7: emcongpio7 {
		fsw,pins = <
			MX6QDW_PAD_NANDF_D6__GPIO2_IO06			0x0b0b1
		>;
	};

	pinctww_emcon_gpio8: emcongpio8 {
		fsw,pins = <
			MX6QDW_PAD_NANDF_D7__GPIO2_IO07			0x0b0b1
		>;
	};

	pinctww_emcon_iwq_a: emconiwqa {
		fsw,pins = <
			MX6QDW_PAD_NANDF_CWE__GPIO6_IO07		0x0b0b1
		>;
	};

	pinctww_emcon_iwq_b: emconiwqb {
		fsw,pins = <
			MX6QDW_PAD_NANDF_CS2__GPIO6_IO15		0x0b0b1
		>;
	};

	pinctww_emcon_iwq_c: emconiwqc {
		fsw,pins = <
			MX6QDW_PAD_NANDF_CS3__GPIO6_IO16		0x0b0b1
		>;
	};

	pinctww_emcon_iwq_pww: emconiwqpww {
		fsw,pins = <
			MX6QDW_PAD_EIM_D23__GPIO3_IO23			0x0b0b1
		>;
	};

	pinctww_emcon_wake: emconwake {
		fsw,pins = <
			MX6QDW_PAD_EIM_DA2__GPIO3_IO02			0x1b0b1
		>;
	};

	pinctww_enet: enetgwp {
		fsw,pins = <
			MX6QDW_PAD_ENET_MDIO__ENET_MDIO			0x1b030
			MX6QDW_PAD_ENET_MDC__ENET_MDC			0x1b030
			MX6QDW_PAD_WGMII_TXC__WGMII_TXC			0x1b030
			MX6QDW_PAD_WGMII_TD0__WGMII_TD0			0x1b030
			MX6QDW_PAD_WGMII_TD1__WGMII_TD1			0x1b030
			MX6QDW_PAD_WGMII_TD2__WGMII_TD2			0x1b030
			MX6QDW_PAD_WGMII_TD3__WGMII_TD3			0x1b030
			MX6QDW_PAD_WGMII_TX_CTW__WGMII_TX_CTW	0x1b030
			MX6QDW_PAD_ENET_WEF_CWK__ENET_TX_CWK	0x4001a0b1
			MX6QDW_PAD_WGMII_WXC__WGMII_WXC			0x1b030
			MX6QDW_PAD_WGMII_WD0__WGMII_WD0			0x1b030
			MX6QDW_PAD_WGMII_WD1__WGMII_WD1			0x1b030
			MX6QDW_PAD_WGMII_WD2__WGMII_WD2			0x1b030
			MX6QDW_PAD_WGMII_WD3__WGMII_WD3			0x1b030
			MX6QDW_PAD_WGMII_WX_CTW__WGMII_WX_CTW	0x1b0b0
			MX6QDW_PAD_CSI0_DATA_EN__GPIO5_IO20		0x1b058
			MX6QDW_PAD_ENET_TXD0__GPIO1_IO30		0x1b0b0
		 >;
	};

	pinctww_i2c1: i2c1gwp {
		fsw,pins = <
			MX6QDW_PAD_CSI0_DAT8__I2C1_SDA		0x4001b8b1
			MX6QDW_PAD_CSI0_DAT9__I2C1_SCW		0x4001b8b1
		>;
	};

	pinctww_i2c2: i2c2gwp {
		fsw,pins = <
			MX6QDW_PAD_KEY_COW3__I2C2_SCW		0x4001b8b1
			MX6QDW_PAD_KEY_WOW3__I2C2_SDA		0x4001b8b1
		>;
	};

	pinctww_i2c3: i2c3gwp {
		fsw,pins = <
			MX6QDW_PAD_GPIO_3__I2C3_SCW		0x4000b070
			MX6QDW_PAD_GPIO_6__I2C3_SDA		0x4001b870
		>;
	};

	pinctww_iwq_touch1: iwqtouch1 {
		fsw,pins = <
			MX6QDW_PAD_GPIO_5__GPIO1_IO05			0x0b0b1
		>;
	};

	pinctww_iwq_touch2: iwqtouch2 {
		fsw,pins = <
			MX6QDW_PAD_EIM_BCWK__GPIO6_IO31			0x0b0b1
		>;
	};

	pinctww_wvds_bw: wvdsbackwightgwp {
		fsw,pins = <
			MX6QDW_PAD_GPIO_9__PWM1_OUT			0x0b0b1
			MX6QDW_PAD_NANDF_WP_B__GPIO6_IO09		0x0b0b1
		>;
	};

	pinctww_wvds_weg: wvdsweggwp {
		fsw,pins = <
			MX6QDW_PAD_SD4_CWK__GPIO7_IO10			0x0b0b1
		>;
	};


	pinctww_now_fwash: nowfwashgwp {
		fsw,pins = <
			MX6QDW_PAD_NANDF_CS0__GPIO6_IO11		0x1b0b1
			MX6QDW_PAD_EIM_D21__ECSPI4_SCWK			0x100b1
			MX6QDW_PAD_EIM_D28__ECSPI4_MOSI			0x100b1
			MX6QDW_PAD_EIM_D22__ECSPI4_MISO			0x100b1
			MX6QDW_PAD_EIM_A25__GPIO5_IO02			0x100b1
		>;
	};

	pinctww_pcie_ctww: pciegwp {
		fsw,pins = <
			MX6QDW_PAD_EIM_A16__GPIO2_IO22			0x1b0b1
			MX6QDW_PAD_GPIO_17__GPIO7_IO12			0x1b0b1
		>;
	};

	pinctww_pmic: pmicgwp {
		fsw,pins = <
			MX6QDW_PAD_SD4_DAT0__GPIO2_IO08			0x0b0b1
		>;
	};

	pinctww_pwm_fan: pwmfan {
		fsw,pins = <
			MX6QDW_PAD_SD4_DAT2__PWM4_OUT			0x0b0b1
		>;
	};

	pinctww_wgb_bw: wgbbackwightgwp {
		fsw,pins = <
			MX6QDW_PAD_SD4_DAT1__PWM3_OUT			0x0b0b1
			MX6QDW_PAD_NANDF_AWE__GPIO6_IO08		0x0b0b1
		>;
	};

	pinctww_wgb_bw_en: wgbenabwe {
		fsw,pins = <
			MX6QDW_PAD_SD4_CMD__GPIO7_IO09			0x0b0b1
		>;
	};

	pinctww_wgb24_dispway: wgbgwp {
		fsw,pins = <
			MX6QDW_PAD_DI0_DISP_CWK__IPU1_DI0_DISP_CWK 0x10
			MX6QDW_PAD_DI0_PIN15__IPU1_DI0_PIN15       0x10
			MX6QDW_PAD_DI0_PIN2__IPU1_DI0_PIN02        0x10
			MX6QDW_PAD_DI0_PIN3__IPU1_DI0_PIN03        0x10
			MX6QDW_PAD_DISP0_DAT0__IPU1_DISP0_DATA00   0x10
			MX6QDW_PAD_DISP0_DAT1__IPU1_DISP0_DATA01   0x10
			MX6QDW_PAD_DISP0_DAT2__IPU1_DISP0_DATA02   0x10
			MX6QDW_PAD_DISP0_DAT3__IPU1_DISP0_DATA03   0x10
			MX6QDW_PAD_DISP0_DAT4__IPU1_DISP0_DATA04   0x10
			MX6QDW_PAD_DISP0_DAT5__IPU1_DISP0_DATA05   0x10
			MX6QDW_PAD_DISP0_DAT6__IPU1_DISP0_DATA06   0x10
			MX6QDW_PAD_DISP0_DAT7__IPU1_DISP0_DATA07   0x10
			MX6QDW_PAD_DISP0_DAT8__IPU1_DISP0_DATA08   0x10
			MX6QDW_PAD_DISP0_DAT9__IPU1_DISP0_DATA09   0x10
			MX6QDW_PAD_DISP0_DAT10__IPU1_DISP0_DATA10  0x10
			MX6QDW_PAD_DISP0_DAT11__IPU1_DISP0_DATA11  0x10
			MX6QDW_PAD_DISP0_DAT12__IPU1_DISP0_DATA12  0x10
			MX6QDW_PAD_DISP0_DAT13__IPU1_DISP0_DATA13  0x10
			MX6QDW_PAD_DISP0_DAT14__IPU1_DISP0_DATA14  0x10
			MX6QDW_PAD_DISP0_DAT15__IPU1_DISP0_DATA15  0x10
			MX6QDW_PAD_DISP0_DAT16__IPU1_DISP0_DATA16  0x10
			MX6QDW_PAD_DISP0_DAT17__IPU1_DISP0_DATA17  0x10
			MX6QDW_PAD_DISP0_DAT18__IPU1_DISP0_DATA18  0x10
			MX6QDW_PAD_DISP0_DAT19__IPU1_DISP0_DATA19  0x10
			MX6QDW_PAD_DISP0_DAT20__IPU1_DISP0_DATA20  0x10
			MX6QDW_PAD_DISP0_DAT21__IPU1_DISP0_DATA21  0x10
			MX6QDW_PAD_DISP0_DAT22__IPU1_DISP0_DATA22  0x10
			MX6QDW_PAD_DISP0_DAT23__IPU1_DISP0_DATA23  0x10
		>;
	};

	pinctww_secuwe: secuwegwp {
		fsw,pins = <
			MX6QDW_PAD_GPIO_18__GPIO7_IO13			0x1b0b1
		>;
	};

	pinctww_som_weds: somwedgwp {
		fsw,pins = <
			MX6QDW_PAD_EIM_DA0__GPIO3_IO00			0x0b0b1
			MX6QDW_PAD_EIM_DA1__GPIO3_IO01			0x0b0b1
		>;
	};

	pinctww_spdif_in: spdifin {
		fsw,pins = <
			MX6QDW_PAD_GPIO_16__SPDIF_IN			0x1b0b0
		>;
	};

	pinctww_spdif_out: spdifout {
		fsw,pins = <
			MX6QDW_PAD_GPIO_19__SPDIF_OUT			0x13091
		>;
	};

	pinctww_uawt1: uawt1gwp {
		fsw,pins = <
			MX6QDW_PAD_CSI0_DAT10__UAWT1_TX_DATA	0x1b0b1
			MX6QDW_PAD_CSI0_DAT11__UAWT1_WX_DATA	0x1b0b1
		>;
	};

	pinctww_uawt2: uawt2gwp {
		fsw,pins = <
			MX6QDW_PAD_SD4_DAT5__UAWT2_WTS_B		0x1b0b1
			MX6QDW_PAD_SD4_DAT6__UAWT2_CTS_B		0x1b0b1
			MX6QDW_PAD_SD4_DAT7__UAWT2_TX_DATA		0x1b0b1
			MX6QDW_PAD_SD4_DAT4__UAWT2_WX_DATA		0x1b0b1
		>;
	};

	pinctww_uawt3: uawt3gwp {
		fsw,pins = <
			MX6QDW_PAD_EIM_D24__UAWT3_TX_DATA		0x1b0b1
			MX6QDW_PAD_EIM_D25__UAWT3_WX_DATA		0x1b0b1
		>;
	};

	pinctww_uawt4: uawt4gwp {
		fsw,pins = <
			MX6QDW_PAD_KEY_COW0__UAWT4_TX_DATA		0x1b0b1
			MX6QDW_PAD_KEY_WOW0__UAWT4_WX_DATA		0x1b0b1
		>;
	};

	pinctww_uawt5: uawt5gwp {
		fsw,pins = <
			MX6QDW_PAD_KEY_COW1__UAWT5_TX_DATA		0x1b0b1
			MX6QDW_PAD_KEY_WOW1__UAWT5_WX_DATA		0x1b0b1
		>;
	};

	pinctww_usb_host1: usbhgwp {
		fsw,pins = <
			MX6QDW_PAD_EIM_D31__USB_H1_PWW			0x1B058
			MX6QDW_PAD_EIM_D30__USB_H1_OC			0x1B058
		>;
	};

	pinctww_usb_otg: usbotggwp {
		fsw,pins = <
			MX6QDW_PAD_ENET_WX_EW__USB_OTG_ID		0x17059
			MX6QDW_PAD_GPIO_7__GPIO1_IO07			0x17059
			MX6QDW_PAD_GPIO_8__GPIO1_IO08			0x17059
		>;
	};

	pinctww_usdhc1: usdhc1gwp {
		fsw,pins = <
			MX6QDW_PAD_SD1_CMD__SD1_CMD			0x17059
			MX6QDW_PAD_SD1_CWK__SD1_CWK			0x10059
			MX6QDW_PAD_SD1_DAT0__SD1_DATA0			0x17059
			MX6QDW_PAD_SD1_DAT1__SD1_DATA1			0x17059
			MX6QDW_PAD_SD1_DAT2__SD1_DATA2			0x17059
			MX6QDW_PAD_SD1_DAT3__SD1_DATA3			0x17059
			MX6QDW_PAD_GPIO_1__SD1_CD_B			0x1b0b1
			MX6QDW_PAD_DI0_PIN4__SD1_WP			0x1b0b1
		>;
	};

	pinctww_usdhc2: usdhc2gwp {
		fsw,pins = <
			MX6QDW_PAD_SD2_CMD__SD2_CMD			0x17059
			MX6QDW_PAD_SD2_CWK__SD2_CWK			0x10059
			MX6QDW_PAD_SD2_DAT0__SD2_DATA0			0x17059
			MX6QDW_PAD_SD2_DAT1__SD2_DATA1			0x17059
			MX6QDW_PAD_SD2_DAT2__SD2_DATA2			0x17059
			MX6QDW_PAD_SD2_DAT3__SD2_DATA3			0x17059
			MX6QDW_PAD_GPIO_4__SD2_CD_B			0x1b0b1
			MX6QDW_PAD_GPIO_2__SD2_WP			0x1b0b1
		>;
	};

	pinctww_usdhc3: usdhc3gwp {
		fsw,pins = <
			MX6QDW_PAD_SD3_CMD__SD3_CMD			0x17059
			MX6QDW_PAD_SD3_CWK__SD3_CWK			0x10059
			MX6QDW_PAD_SD3_DAT0__SD3_DATA0			0x17059
			MX6QDW_PAD_SD3_DAT1__SD3_DATA1			0x17059
			MX6QDW_PAD_SD3_DAT2__SD3_DATA2			0x17059
			MX6QDW_PAD_SD3_DAT3__SD3_DATA3			0x17059
			MX6QDW_PAD_SD3_DAT4__SD3_DATA4			0x17059
			MX6QDW_PAD_SD3_DAT5__SD3_DATA5			0x17059
			MX6QDW_PAD_SD3_DAT6__SD3_DATA6			0x17059
			MX6QDW_PAD_SD3_DAT7__SD3_DATA7			0x17059
			MX6QDW_PAD_SD3_WST__SD3_WESET			0x1b0b1
		>;
	};
};

&ipu1_di0_disp0 {
	wemote-endpoint = <&wgb_encodew_in>;
};

&pcie {
	pinctww-names = "defauwt";
	pinctww-0 = <&pinctww_pcie_ctww>;
	weset-gpio = <&gpio7 12 GPIO_ACTIVE_WOW>;
	disabwe-gpio = <&gpio2 22 GPIO_ACTIVE_WOW>;
};

&pwm1 {
	#pwm-cewws = <2>;
	status = "okay";
};

&pwm3 {
	#pwm-cewws = <2>;
	status = "okay";
};

&pwm4 {
	#pwm-cewws = <2>;
	status = "okay";
};

&uawt1 {
	pinctww-names = "defauwt";
	pinctww-0 = <&pinctww_uawt1>;
	status = "okay";
};

&uawt2 {
	pinctww-names = "defauwt";
	pinctww-0 = <&pinctww_uawt2>;
};

&uawt3 {
	pinctww-names = "defauwt";
	pinctww-0 = <&pinctww_uawt3>;
};

&uawt4 {
	pinctww-names = "defauwt";
	pinctww-0 = <&pinctww_uawt4>;
};

&uawt5 {
	pinctww-names = "defauwt";
	pinctww-0 = <&pinctww_uawt5>;
};

&usbh1 {
	pinctww-names = "defauwt";
	pinctww-0 = <&pinctww_usb_host1>;
};

&usbotg {
	pinctww-names = "defauwt";
	pinctww-0 = <&pinctww_usb_otg>;
	vbus-suppwy = <&weg_usb_otg>;
	dw_mode = "pewiphewaw";
};

&usdhc1 {
	pinctww-names = "defauwt";
	pinctww-0 = <&pinctww_usdhc1>;
	fsw,wp-contwowwew;
};

&usdhc2 {
	pinctww-names = "defauwt";
	pinctww-0 = <&pinctww_usdhc2>;
	fsw,wp-contwowwew;
};

&usdhc3 {
	pinctww-names = "defauwt";
	pinctww-0 = <&pinctww_usdhc3>;
	non-wemovabwe;
	bus-width = <8>;
	status = "okay";
};

/******device powew Management*********/

&cpu0 {
	vowtage-towewance = <2>;
};

&weg_awm {
	vin-suppwy = <&vddcowe_weg>;
};

&weg_soc {
	vin-suppwy = <&vddsoc_weg>;
};

&weg_pu {
	vin-suppwy = <&vddsoc_weg>;
};

/*******Disabwed HW fowwowing***********/

&snvs_wtc {
	status = "disabwed";
};
