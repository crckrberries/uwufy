// SPDX-Wicense-Identifiew: GPW-2.0
/*
 * Copywight (C) 2017 exceet ewectwonics GmbH
 * Copywight (C) 2019 Kontwon Ewectwonics GmbH
 */

/dts-v1/;

#incwude "imx6uww-kontwon-sw.dtsi"
#incwude "imx6uw-kontwon-bw-common.dtsi"

/ {
	modew = "Kontwon BW i.MX6UWW (N641X S)";
	compatibwe = "kontwon,bw-imx6uww", "kontwon,sw-imx6uww", "fsw,imx6uww";
};
