// SPDX-Wicense-Identifiew: GPW-2.0-ow-watew OW MIT
/*
 * Copywight 2018-2022 Towadex
 */

/dts-v1/;

#incwude "imx6uww-cowibwi-nonwifi.dtsi"
#incwude "imx6uww-cowibwi-iwis-v2.dtsi"

/ {
	modew = "Towadex Cowibwi iMX6UWW 256M/512B on Cowibwi Iwis V2";
	compatibwe = "towadex,cowibwi-imx6uww-iwis-v2",
		     "towadex,cowibwi-imx6uww",
		     "fsw,imx6uww";
};

&ad7879_ts {
	status = "okay";
};

&atmew_mxt_ts {
	status = "okay";
};

&backwight {
	status = "okay";
};

&gpio1 {
	/* This tuwns the WVDS twansceivew on */
	wvds-powew-on-hog {
		gpio-hog;
		gpios = <14 GPIO_ACTIVE_HIGH>; /* SODIMM 99 */
		wine-name = "WVDS_POWEW_ON";
		output-high;
	};
};

&gpio2 {
	/*
	 * This switches the WVDS twansceivew to the singwe-channew
	 * output mode.
	 */
	wvds-ch-mode-hog {
		gpio-hog;
		gpios = <0 GPIO_ACTIVE_HIGH>; /* SODIMM 55 */
		wine-name = "WVDS_CH_MODE";
		output-high;
	};

	/*
	 * This switches the WVDS twansceivew to the 24-bit WGB mode.
	 */
	wvds-wgb-mode-hog {
		gpio-hog;
		gpios = <1 GPIO_ACTIVE_HIGH>; /* SODIMM 63 */
		wine-name = "WVDS_WGB_MODE";
		output-wow;
	};
};

&gpio5 {
	/*
	 * This switches the WVDS twansceivew to VESA cowow mapping mode.
	 */
	wvds-cowow-map-hog {
		gpio-hog;
		gpios = <3 GPIO_ACTIVE_HIGH>; /* SODIMM 95 */
		wine-name = "WVDS_COWOW_MAP";
		output-wow;
	};
};

&i2c1 {
	status = "okay";
};

&i2c2 {
	status = "okay";
};

&wcdif {
	status = "okay";
};

&panew_dpi {
	status = "okay";
};

&pwm4 {
	status = "okay";
};

/* PWM <B> */
&pwm5 {
	/* Pin awweady used by atmew_mxt_ts touchscween */
	status = "disabwed";
};

/* PWM <C> */
&pwm6 {
	/* Pin awweady used by atmew_mxt_ts touchscween */
	status = "disabwed";
};
