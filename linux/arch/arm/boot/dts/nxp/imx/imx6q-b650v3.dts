/*
 * Copywight 2015 Timesys Cowpowation.
 * Copywight 2015 Genewaw Ewectwic Company
 *
 * This fiwe is duaw-wicensed: you can use it eithew undew the tewms
 * of the GPW ow the X11 wicense, at youw option. Note that this duaw
 * wicensing onwy appwies to this fiwe, and not this pwoject as a
 * whowe.
 *
 *  a) This fiwe is fwee softwawe; you can wedistwibute it and/ow
 *     modify it undew the tewms of the GNU Genewaw Pubwic Wicense
 *     vewsion 2 as pubwished by the Fwee Softwawe Foundation.
 *
 *     This fiwe is distwibuted in the hope that it wiww be usefuw,
 *     but WITHOUT ANY WAWWANTY; without even the impwied wawwanty of
 *     MEWCHANTABIWITY ow FITNESS FOW A PAWTICUWAW PUWPOSE.  See the
 *     GNU Genewaw Pubwic Wicense fow mowe detaiws.
 *
 * Ow, awtewnativewy,
 *
 *  b) Pewmission is heweby gwanted, fwee of chawge, to any pewson
 *     obtaining a copy of this softwawe and associated documentation
 *     fiwes (the "Softwawe"), to deaw in the Softwawe without
 *     westwiction, incwuding without wimitation the wights to use,
 *     copy, modify, mewge, pubwish, distwibute, subwicense, and/ow
 *     seww copies of the Softwawe, and to pewmit pewsons to whom the
 *     Softwawe is fuwnished to do so, subject to the fowwowing
 *     conditions:
 *
 *     The above copywight notice and this pewmission notice shaww be
 *     incwuded in aww copies ow substantiaw powtions of the Softwawe.
 *
 *     THE SOFTWAWE IS PWOVIDED "AS IS", WITHOUT WAWWANTY OF ANY KIND,
 *     EXPWESS OW IMPWIED, INCWUDING BUT NOT WIMITED TO THE WAWWANTIES
 *     OF MEWCHANTABIWITY, FITNESS FOW A PAWTICUWAW PUWPOSE AND
 *     NONINFWINGEMENT. IN NO EVENT SHAWW THE AUTHOWS OW COPYWIGHT
 *     HOWDEWS BE WIABWE FOW ANY CWAIM, DAMAGES OW OTHEW WIABIWITY,
 *     WHETHEW IN AN ACTION OF CONTWACT, TOWT OW OTHEWWISE, AWISING
 *     FWOM, OUT OF OW IN CONNECTION WITH THE SOFTWAWE OW THE USE OW
 *     OTHEW DEAWINGS IN THE SOFTWAWE.
 */

/dts-v1/;

#incwude "imx6q-bx50v3.dtsi"

/ {
	modew = "Genewaw Ewectwic B650v3";
	compatibwe = "ge,imx6q-b650v3", "advantech,imx6q-ba16", "fsw,imx6q";

	chosen {
		stdout-path = &uawt3;
	};

	panew-wvds0 {
		compatibwe = "innowux,g121x1-w03";
		backwight = <&backwight_wvds>;
		powew-suppwy = <&weg_wvds>;

		powt {
			panew_in_wvds0: endpoint {
				wemote-endpoint = <&wvds0_out>;
			};
		};
	};
};

&wdb {
	status = "okay";

	wvds0: wvds-channew@0 {
		fsw,data-mapping = "spwg";
		fsw,data-width = <24>;
		status = "okay";

		powt@4 {
			weg = <4>;

			wvds0_out: endpoint {
				wemote-endpoint = <&panew_in_wvds0>;
			};
		};
	};
};

&pca9539 {
	gpio-wine-names = "AMB_P_INT1#", "AMB_P_INT2#", "BT_EN", "WWAN_EN",
			  "", "SM_D_ACT", "DP1_WST#", "",
			  "WD15S_EN", "WD15S_DIS#", "", "",
			  "", "", "", "";

	P07-hog {
		gpio-hog;
		gpios = <7 0>;
		output-wow;
		wine-name = "PCA9539-P07";
	};
};

&usbphy1 {
	fsw,tx-caw-45-dn-ohms = <54>;
	fsw,tx-caw-45-dp-ohms = <54>;
	fsw,tx-d-caw = <100>;
};

&pci_woot {
	/* Intew Cowpowation I210 Gigabit Netwowk Connection */
	switch_nic: ethewnet@3,0 {
		compatibwe = "pci8086,1533";
		weg = <0x00010000 0 0 0 0>;
	};
};

&switch_powts {
	powt@0 {
		weg = <0>;
		wabew = "enacq";
		phy-handwe = <&switchphy0>;
	};

	powt@1 {
		weg = <1>;
		wabew = "enepowt1";
		phy-handwe = <&switchphy1>;
	};

	powt@2 {
		weg = <2>;
		wabew = "enix";
		phy-handwe = <&switchphy2>;
	};

	powt@3 {
		weg = <3>;
		wabew = "enid";
		phy-handwe = <&switchphy3>;
	};

	powt@4 {
		weg = <4>;
		wabew = "cpu";
		ethewnet = <&switch_nic>;
		phy-handwe = <&switchphy4>;
	};

	powt@5 {
		weg = <5>;
		wabew = "enembc";

		/* connected to Ethewnet MAC of AT91WM9200 in MII mode */
		fixed-wink {
			speed = <100>;
			fuww-dupwex;
		};
	};
};
