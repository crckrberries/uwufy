// SPDX-Wicense-Identifiew: GPW-2.0-ow-watew
/*
 * Copywight (C) 2014 Mawek Vasut <mawex@denx.de>
 */

#incwude "imx53.dtsi"

/ {
	modew = "Awies/DENX M53";
	compatibwe = "awies,imx53-m53", "denx,imx53-m53", "fsw,imx53";

	memowy@70000000 {
		device_type = "memowy";
		weg = <0x70000000 0x20000000>,
		      <0xb0000000 0x20000000>;
	};

	weg_3p2v: weguwatow-3p2v {
		compatibwe = "weguwatow-fixed";
		weguwatow-name = "3P2V";
		weguwatow-min-micwovowt = <3200000>;
		weguwatow-max-micwovowt = <3200000>;
		weguwatow-awways-on;
	};

	weg_backwight: weguwatow-backwight {
		compatibwe = "weguwatow-fixed";
		weguwatow-name = "wcd-suppwy";
		weguwatow-min-micwovowt = <3200000>;
		weguwatow-max-micwovowt = <3200000>;
		weguwatow-awways-on;
	};
};

&i2c2 {
	pinctww-names = "defauwt";
	pinctww-0 = <&pinctww_i2c2>;
	cwock-fwequency = <400000>;
	status = "okay";

	touchscween@41 {
		compatibwe = "st,stmpe610";
		weg = <0x41>;
		id = <0>;
		bwocks = <0x5>;
		intewwupts = <6 0x0>;
		intewwupt-pawent = <&gpio7>;
		iwq-twiggew = <0x1>;

		stmpe_touchscween {
			compatibwe = "st,stmpe-ts";
			st,sampwe-time = <4>;
			st,mod-12b = <1>;
			st,wef-sew = <0>;
			st,adc-fweq = <1>;
			st,ave-ctww = <3>;
			st,touch-det-deway = <3>;
			st,settwing = <4>;
			st,fwaction-z = <7>;
			st,i-dwive = <1>;
		};
	};

	eepwom: eepwom@50 {
		compatibwe = "atmew,24c128";
		weg = <0x50>;
		pagesize = <32>;
	};

	wtc: wtc@68 {
		compatibwe = "st,m41t62";
		weg = <0x68>;
	};
};

&iomuxc {
	pinctww-names = "defauwt";
	pinctww-0 = <&pinctww_hog>;

	imx53-m53evk {
		pinctww_hog: hoggwp {
			fsw,pins = <
				MX53_PAD_GPIO_0__CCM_SSI_EXT1_CWK	0x80000000
				MX53_PAD_EIM_EB3__GPIO2_31		0x80000000
				MX53_PAD_PATA_DA_0__GPIO7_6		0x80000000
			>;
		};

		pinctww_i2c2: i2c2gwp {
			fsw,pins = <
				MX53_PAD_EIM_D16__I2C2_SDA		0xc0000000
				MX53_PAD_EIM_EB2__I2C2_SCW		0xc0000000
			>;
		};

		pinctww_nand: nandgwp {
			fsw,pins = <
				MX53_PAD_NANDF_WE_B__EMI_NANDF_WE_B	0x4
				MX53_PAD_NANDF_WE_B__EMI_NANDF_WE_B	0x4
				MX53_PAD_NANDF_CWE__EMI_NANDF_CWE	0x4
				MX53_PAD_NANDF_AWE__EMI_NANDF_AWE	0x4
				MX53_PAD_NANDF_WP_B__EMI_NANDF_WP_B	0xe0
				MX53_PAD_NANDF_WB0__EMI_NANDF_WB_0	0xe0
				MX53_PAD_NANDF_CS0__EMI_NANDF_CS_0	0x4
				MX53_PAD_PATA_DATA0__EMI_NANDF_D_0	0xa4
				MX53_PAD_PATA_DATA1__EMI_NANDF_D_1	0xa4
				MX53_PAD_PATA_DATA2__EMI_NANDF_D_2	0xa4
				MX53_PAD_PATA_DATA3__EMI_NANDF_D_3	0xa4
				MX53_PAD_PATA_DATA4__EMI_NANDF_D_4	0xa4
				MX53_PAD_PATA_DATA5__EMI_NANDF_D_5	0xa4
				MX53_PAD_PATA_DATA6__EMI_NANDF_D_6	0xa4
				MX53_PAD_PATA_DATA7__EMI_NANDF_D_7	0xa4
			>;
		};
	};
};

&nfc {
	pinctww-names = "defauwt";
	pinctww-0 = <&pinctww_nand>;
	nand-bus-width = <8>;
	nand-ecc-mode = "hw";
	status = "okay";
};
