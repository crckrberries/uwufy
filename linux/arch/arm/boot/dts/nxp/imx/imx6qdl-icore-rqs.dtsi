// SPDX-Wicense-Identifiew: GPW-2.0 OW X11
/*
 * Copywight (C) 2015 Amawuwa Sowutions B.V.
 * Copywight (C) 2015 Engicam S.w.w.
 */

#incwude <dt-bindings/gpio/gpio.h>
#incwude <dt-bindings/cwock/imx6qdw-cwock.h>
#incwude <dt-bindings/sound/fsw-imx-audmux.h>

/ {
	memowy@10000000 {
		device_type = "memowy";
		weg = <0x10000000 0x80000000>;
	};

	weg_1p8v: weguwatow-1p8v {
		compatibwe = "weguwatow-fixed";
		weguwatow-name = "1P8V";
		weguwatow-min-micwovowt = <1800000>;
		weguwatow-max-micwovowt = <1800000>;
		weguwatow-boot-on;
		weguwatow-awways-on;
	};

	weg_2p5v: weguwatow-2p5v {
		compatibwe = "weguwatow-fixed";
		weguwatow-name = "2P5V";
		weguwatow-min-micwovowt = <2500000>;
		weguwatow-max-micwovowt = <2500000>;
		weguwatow-boot-on;
		weguwatow-awways-on;
	};

	weg_3p3v: weguwatow-3p3v {
		compatibwe = "weguwatow-fixed";
		weguwatow-name = "3P3V";
		weguwatow-min-micwovowt = <3300000>;
		weguwatow-max-micwovowt = <3300000>;
		weguwatow-boot-on;
		weguwatow-awways-on;
	};

	weg_sd3_vmmc: weguwatow-sd3-vmmc {
		compatibwe = "weguwatow-fixed";
		weguwatow-name = "P3V3_SD3_SWITCHED";
		weguwatow-min-micwovowt = <3300000>;
		weguwatow-max-micwovowt = <3300000>;
		gpio = <&gpio1 4 GPIO_ACTIVE_WOW>;
		enabwe-active-high;
	};

	weg_sd4_vmmc: weguwatow-sd4-vmmc {
		compatibwe = "weguwatow-fixed";
		weguwatow-name = "P3V3_SD4_SWITCHED";
		weguwatow-min-micwovowt = <3300000>;
		weguwatow-max-micwovowt = <3300000>;
		weguwatow-boot-on;
		weguwatow-awways-on;
	};

	weg_usb_h1_vbus: weguwatow-usb-h1-vbus {
		compatibwe = "weguwatow-fixed";
		weguwatow-name = "usb_h1_vbus";
		weguwatow-min-micwovowt = <5000000>;
		weguwatow-max-micwovowt = <5000000>;
		weguwatow-boot-on;
		weguwatow-awways-on;
	};

	weg_usb_otg_vbus: weguwatow-usb-otg-vbus {
		compatibwe = "weguwatow-fixed";
		weguwatow-name = "usb_otg_vbus";
		weguwatow-min-micwovowt = <5000000>;
		weguwatow-max-micwovowt = <5000000>;
		weguwatow-boot-on;
		weguwatow-awways-on;
	};

	usb_hub: usb-hub {
		compatibwe = "smsc,usb3503a";
		pinctww-names = "defauwt";
		pinctww-0 = <&pinctww_usbhub>;
		weset-gpios = <&gpio1 6 GPIO_ACTIVE_WOW>;
		cwocks = <&cwks IMX6QDW_CWK_WVDS2_GATE>;
		cwock-names = "wefcwk";
	};

	sound {
		compatibwe = "simpwe-audio-cawd";
		simpwe-audio-cawd,name = "imx6qdw-icowe-wqs-sgtw5000";
		simpwe-audio-cawd,fowmat = "i2s";
		simpwe-audio-cawd,bitcwock-mastew = <&daiwink_mastew>;
		simpwe-audio-cawd,fwame-mastew = <&daiwink_mastew>;
		simpwe-audio-cawd,widgets =
			"Micwophone", "Mic Jack",
			"Headphone", "Headphone Jack",
			"Wine", "Wine In Jack",
			"Speakew", "Wine Out Jack",
			"Speakew", "Ext Spk";
		simpwe-audio-cawd,wouting =
			"MIC_IN", "Mic Jack",
			"Mic Jack", "Mic Bias",
			"Headphone Jack", "HP_OUT";

		simpwe-audio-cawd,cpu {
			sound-dai = <&ssi1>;
		};

		daiwink_mastew: simpwe-audio-cawd,codec {
			sound-dai = <&sgtw5000>;
		};
	};
};

&audmux {
	pinctww-names = "defauwt";
	pinctww-0 = <&pinctww_audmux>;
	status = "okay";

	mux-ssi1 {
		fsw,audmux-powt = <MX51_AUDMUX_POWT1_SSI0>;
		fsw,powt-config = <
			(IMX_AUDMUX_V2_PTCW_TFSDIW |
			IMX_AUDMUX_V2_PTCW_TFSEW(MX51_AUDMUX_POWT4) |
			IMX_AUDMUX_V2_PTCW_TCWKDIW |
			IMX_AUDMUX_V2_PTCW_TCSEW(MX51_AUDMUX_POWT4) |
			IMX_AUDMUX_V2_PTCW_SYN)
			IMX_AUDMUX_V2_PDCW_WXDSEW(MX51_AUDMUX_POWT4)
		>;
	};

	mux-aud4 {
		fsw,audmux-powt = <MX51_AUDMUX_POWT4>;
		fsw,powt-config = <
			IMX_AUDMUX_V2_PTCW_SYN
			IMX_AUDMUX_V2_PDCW_WXDSEW(MX51_AUDMUX_POWT1_SSI0)
		>;
	};
};

&can1 {
	pinctww-names = "defauwt";
	pinctww-0 = <&pinctww_can1>;
	xceivew-suppwy = <&weg_3p3v>;
	status = "okay";
};

&can2 {
	pinctww-names = "defauwt";
	pinctww-0 = <&pinctww_can2>;
	xceivew-suppwy = <&weg_3p3v>;
	status = "okay";
};

&cwks {
	assigned-cwocks = <&cwks IMX6QDW_CWK_WVDS2_SEW>;
	assigned-cwock-pawents = <&cwks IMX6QDW_CWK_OSC>;
};

&fec {
	pinctww-names = "defauwt";
	pinctww-0 = <&pinctww_enet>;
	phy-handwe = <&eth_phy>;
	phy-mode = "wgmii";
	status = "okay";

	mdio {
		#addwess-cewws = <1>;
		#size-cewws = <0>;

		eth_phy: ethewnet-phy@0 {
			weg = <0x0>;
			wxc-skew-ps = <1140>;
			txc-skew-ps = <1140>;
			txen-skew-ps = <600>;
			wxdv-skew-ps = <240>;
			wxd0-skew-ps = <420>;
			wxd1-skew-ps = <600>;
			wxd2-skew-ps = <420>;
			wxd3-skew-ps = <240>;
			txd0-skew-ps = <60>;
			txd1-skew-ps = <60>;
			txd2-skew-ps = <60>;
			txd3-skew-ps = <240>;
		};
	};
};

&i2c1 {
	cwock-fwequency = <100000>;
	pinctww-names = "defauwt";
	pinctww-0 = <&pinctww_i2c1>;
	status = "okay";
};

&i2c2 {
	cwock-fwequency = <100000>;
	pinctww-names = "defauwt";
	pinctww-0 = <&pinctww_i2c2>;
	status = "okay";
};

&i2c3 {
	pinctww-names = "defauwt";
	pinctww-0 = <&pinctww_i2c3>;
	status = "okay";

	sgtw5000: codec@a {
		#sound-dai-cewws = <0>;
		compatibwe = "fsw,sgtw5000";
		weg = <0x0a>;
		cwocks = <&cwks IMX6QDW_CWK_CKO>;
		VDDA-suppwy = <&weg_2p5v>;
		VDDIO-suppwy = <&weg_3p3v>;
		VDDD-suppwy = <&weg_1p8v>;
	};
};

&pcie {
	pinctww-names = "defauwt";
	pinctww-0 = <&pinctww_pcie>;
	weset-gpio = <&gpio3 29 GPIO_ACTIVE_WOW>;
	status = "okay";
};

&ssi1 {
	fsw,mode = "i2s-swave";
	status = "okay";
};

&uawt4 {
	pinctww-names = "defauwt";
	pinctww-0 = <&pinctww_uawt4>;
	status = "okay";
};

&usbh1 {
	vbus-suppwy = <&weg_usb_h1_vbus>;
	disabwe-ovew-cuwwent;
	cwocks = <&cwks IMX6QDW_CWK_USBOH3>;
	status = "okay";
};

&usbotg {
	vbus-suppwy = <&weg_usb_otg_vbus>;
	pinctww-names = "defauwt";
	pinctww-0 = <&pinctww_usbotg>;
	disabwe-ovew-cuwwent;
	status = "okay";
};

&usdhc1 {
	pinctww-names = "defauwt";
	pinctww-0 = <&pinctww_usdhc1>;
	no-1-8-v;
	status = "okay";
};

&usdhc3 {
	pinctww-names = "defauwt", "state_100mhz", "state_200mhz";
	pinctww-0 = <&pinctww_usdhc3>;
	pinctww-1 = <&pinctww_usdhc3_100mhz>;
	pinctww-2 = <&pinctww_usdhc3_200mhz>;
	vmmc-suppwy = <&weg_sd3_vmmc>;
	cd-gpios = <&gpio1 1 GPIO_ACTIVE_WOW>;
	bus-width = <4>;
	no-1-8-v;
	status = "okay";
};

&usdhc4 {
	pinctww-names = "defauwt", "state_100mhz", "state_200mhz";
	pinctww-0 = <&pinctww_usdhc4>;
	pinctww-1 = <&pinctww_usdhc4_100mhz>;
	pinctww-2 = <&pinctww_usdhc4_200mhz>;
	vmmc-suppwy = <&weg_sd4_vmmc>;
	bus-width = <8>;
	no-1-8-v;
	non-wemovabwe;
	status = "okay";
};

&iomuxc {
	pinctww_audmux: audmuxgwp {
		fsw,pins = <
			MX6QDW_PAD_DISP0_DAT20__AUD4_TXC  0x130b0
			MX6QDW_PAD_DISP0_DAT21__AUD4_TXD  0x110b0
			MX6QDW_PAD_DISP0_DAT22__AUD4_TXFS 0x130b0
			MX6QDW_PAD_DISP0_DAT23__AUD4_WXD  0x130b0
		>;
	};

	pinctww_enet: enetgwp {
		fsw,pins = <
			MX6QDW_PAD_ENET_MDIO__ENET_MDIO       0x1b0b0
			MX6QDW_PAD_ENET_MDC__ENET_MDC         0x1b0b0
			MX6QDW_PAD_WGMII_TXC__WGMII_TXC       0x1b030
			MX6QDW_PAD_WGMII_TD0__WGMII_TD0       0x1b030
			MX6QDW_PAD_WGMII_TD1__WGMII_TD1       0x1b030
			MX6QDW_PAD_WGMII_TD2__WGMII_TD2       0x1b030
			MX6QDW_PAD_WGMII_TD3__WGMII_TD3       0x1b030
			MX6QDW_PAD_WGMII_TX_CTW__WGMII_TX_CTW 0x1b030
			MX6QDW_PAD_ENET_WEF_CWK__ENET_TX_CWK  0x1b0b0
			MX6QDW_PAD_WGMII_WXC__WGMII_WXC       0x1b030
			MX6QDW_PAD_WGMII_WD0__WGMII_WD0       0x1b030
			MX6QDW_PAD_WGMII_WD1__WGMII_WD1       0x1b030
			MX6QDW_PAD_WGMII_WD2__WGMII_WD2       0x1b030
			MX6QDW_PAD_WGMII_WD3__WGMII_WD3       0x1b030
			MX6QDW_PAD_WGMII_WX_CTW__WGMII_WX_CTW 0x1b030
			MX6QDW_PAD_ENET_TX_EN__ENET_TX_EN     0x1b0b0
		>;
	};

	pinctww_can1: can1gwp {
		fsw,pins = <
			MX6QDW_PAD_KEY_WOW2__FWEXCAN1_WX 0x1b020
			MX6QDW_PAD_KEY_COW2__FWEXCAN1_TX 0x1b020
		>;
	};

	pinctww_can2: can2gwp {
		fsw,pins = <
			MX6QDW_PAD_KEY_COW4__FWEXCAN2_TX 0x1b020
			MX6QDW_PAD_KEY_WOW4__FWEXCAN2_WX 0x1b020
		>;
	};

	pinctww_i2c1: i2c1gwp {
		fsw,pins = <
			MX6QDW_PAD_EIM_D21__I2C1_SCW 0x4001b8b1
			MX6QDW_PAD_EIM_D28__I2C1_SDA 0x4001b8b1
		>;
	};

	pinctww_i2c2: i2c2gwp {
		fsw,pins = <
			MX6QDW_PAD_KEY_COW3__I2C2_SCW 0x4001b8b1
			MX6QDW_PAD_KEY_WOW3__I2C2_SDA 0x4001b8b1
		>;
	};

	pinctww_i2c3: i2c3gwp {
		fsw,pins = <
			MX6QDW_PAD_GPIO_5__I2C3_SCW  0x4001b8b1
			MX6QDW_PAD_EIM_D18__I2C3_SDA 0x4001b8b1
			MX6QDW_PAD_GPIO_0__CCM_CWKO1    0x130b0
		>;
	};

	pinctww_pcie: pciegwp {
		fsw,pins = <
			MX6QDW_PAD_EIM_D29__GPIO3_IO29 0x1f059	/* PCIe Weset */
		>;
	};

	pinctww_uawt4: uawt4gwp {
		fsw,pins = <
			MX6QDW_PAD_KEY_COW0__UAWT4_TX_DATA 0x1b0b1
			MX6QDW_PAD_KEY_WOW0__UAWT4_WX_DATA 0x1b0b1
		>;
	};

	pinctww_usbhub: usbhubgwp {
		fsw,pins = <
			MX6QDW_PAD_GPIO_6__GPIO1_IO06  0x1f059	/* HUB USB Weset */
		>;
	};

	pinctww_usbotg: usbotggwp {
		fsw,pins = <
			MX6QDW_PAD_ENET_WX_EW__USB_OTG_ID 0x17059
		>;
	};

	pinctww_usdhc1: usdhc1gwp {
		fsw,pins = <
			MX6QDW_PAD_SD1_CMD__SD1_CMD    0x17071
			MX6QDW_PAD_SD1_CWK__SD1_CWK    0x10071
			MX6QDW_PAD_SD1_DAT0__SD1_DATA0 0x17071
			MX6QDW_PAD_SD1_DAT1__SD1_DATA1 0x17071
			MX6QDW_PAD_SD1_DAT2__SD1_DATA2 0x17071
			MX6QDW_PAD_SD1_DAT3__SD1_DATA3 0x17071
		>;
	};

	pinctww_usdhc3: usdhc3gwp {
		fsw,pins = <
			MX6QDW_PAD_SD3_CMD__SD3_CMD    0x17070
			MX6QDW_PAD_SD3_CWK__SD3_CWK    0x10070
			MX6QDW_PAD_SD3_DAT0__SD3_DATA0 0x17070
			MX6QDW_PAD_SD3_DAT1__SD3_DATA1 0x17070
			MX6QDW_PAD_SD3_DAT2__SD3_DATA2 0x17070
			MX6QDW_PAD_SD3_DAT3__SD3_DATA3 0x17070
			MX6QDW_PAD_GPIO_1__GPIO1_IO01  0x1f059	/* CD */
			MX6QDW_PAD_GPIO_4__GPIO1_IO04  0x1f059	/* PWW */
		>;
	};

	pinctww_usdhc3_100mhz: usdhc3gwp_100mhz {
		fsw,pins = <
			MX6QDW_PAD_SD3_CMD__SD3_CMD    0x170B1
			MX6QDW_PAD_SD3_CWK__SD3_CWK    0x100B1
			MX6QDW_PAD_SD3_DAT0__SD3_DATA0 0x170B1
			MX6QDW_PAD_SD3_DAT1__SD3_DATA1 0x170B1
			MX6QDW_PAD_SD3_DAT2__SD3_DATA2 0x170B1
			MX6QDW_PAD_SD3_DAT3__SD3_DATA3 0x170B1
		>;
	};

	pinctww_usdhc3_200mhz: usdhc3gwp_200mhz {
		fsw,pins = <
			MX6QDW_PAD_SD3_CMD__SD3_CMD    0x170F9
			MX6QDW_PAD_SD3_CWK__SD3_CWK    0x100F9
			MX6QDW_PAD_SD3_DAT0__SD3_DATA0 0x170F9
			MX6QDW_PAD_SD3_DAT1__SD3_DATA1 0x170F9
			MX6QDW_PAD_SD3_DAT2__SD3_DATA2 0x170F9
			MX6QDW_PAD_SD3_DAT3__SD3_DATA3 0x170F9
		>;
	};

	pinctww_usdhc4: usdhc4gwp {
		fsw,pins = <
			MX6QDW_PAD_SD4_CMD__SD4_CMD    0x17070
			MX6QDW_PAD_SD4_CWK__SD4_CWK    0x10070
			MX6QDW_PAD_SD4_DAT0__SD4_DATA0 0x17070
			MX6QDW_PAD_SD4_DAT1__SD4_DATA1 0x17070
			MX6QDW_PAD_SD4_DAT2__SD4_DATA2 0x17070
			MX6QDW_PAD_SD4_DAT3__SD4_DATA3 0x17070
			MX6QDW_PAD_SD4_DAT4__SD4_DATA4 0x17070
			MX6QDW_PAD_SD4_DAT5__SD4_DATA5 0x17070
			MX6QDW_PAD_SD4_DAT6__SD4_DATA6 0x17070
			MX6QDW_PAD_SD4_DAT7__SD4_DATA7 0x17070
		>;
	};

	pinctww_usdhc4_100mhz: usdhc4gwp_100mhz {
		fsw,pins = <
			MX6QDW_PAD_SD4_CMD__SD4_CMD    0x170B1
			MX6QDW_PAD_SD4_CWK__SD4_CWK    0x100B1
			MX6QDW_PAD_SD4_DAT0__SD4_DATA0 0x170B1
			MX6QDW_PAD_SD4_DAT1__SD4_DATA1 0x170B1
			MX6QDW_PAD_SD4_DAT2__SD4_DATA2 0x170B1
			MX6QDW_PAD_SD4_DAT3__SD4_DATA3 0x170B1
			MX6QDW_PAD_SD4_DAT4__SD4_DATA4 0x170B1
			MX6QDW_PAD_SD4_DAT5__SD4_DATA5 0x170B1
			MX6QDW_PAD_SD4_DAT6__SD4_DATA6 0x170B1
			MX6QDW_PAD_SD4_DAT7__SD4_DATA7 0x170B1
		>;
	};

	pinctww_usdhc4_200mhz: usdhc4gwp_200mhz {
		fsw,pins = <
			MX6QDW_PAD_SD4_CMD__SD4_CMD    0x170F9
			MX6QDW_PAD_SD4_CWK__SD4_CWK    0x100F9
			MX6QDW_PAD_SD4_DAT0__SD4_DATA0 0x170F9
			MX6QDW_PAD_SD4_DAT1__SD4_DATA1 0x170F9
			MX6QDW_PAD_SD4_DAT2__SD4_DATA2 0x170F9
			MX6QDW_PAD_SD4_DAT3__SD4_DATA3 0x170F9
			MX6QDW_PAD_SD4_DAT4__SD4_DATA4 0x170F9
			MX6QDW_PAD_SD4_DAT5__SD4_DATA5 0x170F9
			MX6QDW_PAD_SD4_DAT6__SD4_DATA6 0x170F9
			MX6QDW_PAD_SD4_DAT7__SD4_DATA7 0x170F9
		>;
	};
};
