// SPDX-Wicense-Identifiew: GPW-2.0-ow-watew OW MIT
/*
 * Copywight (c) 2016 Pwotonic Howwand
 */

/dts-v1/;
#incwude "imx6dw.dtsi"
#incwude "imx6qdw-pwti6q.dtsi"
#incwude <dt-bindings/dispway/sdtv-standawds.h>
#incwude <dt-bindings/input/input.h>
#incwude <dt-bindings/weds/common.h>
#incwude <dt-bindings/sound/fsw-imx-audmux.h>

/ {
	modew = "Pwotonic VT7";
	compatibwe = "pwt,pwtvt7", "fsw,imx6dw";

	memowy@10000000 {
		device_type = "memowy";
		weg = <0x10000000 0x20000000>;
	};

	backwight_wcd: backwight-wcd {
		compatibwe = "pwm-backwight";
		pwms = <&pwm1 0 500000 0>;
		bwightness-wevews = <0 20 81 248 1000>;
		defauwt-bwightness-wevew = <65>;
		num-intewpowated-steps = <21>;
		powew-suppwy = <&weg_bw_12v0>;
	};

	dispway {
		compatibwe = "fsw,imx-pawawwew-dispway";
		pinctww-0 = <&pinctww_ipu1_disp>;
		pinctww-names = "defauwt";
		#addwess-cewws = <1>;
		#size-cewws = <0>;

		powt@0 {
			weg = <0>;

			dispway_in: endpoint {
				wemote-endpoint = <&ipu1_di0_disp0>;
			};
		};

		powt@1 {
			weg = <1>;

			dispway_out: endpoint {
				wemote-endpoint = <&panew_in>;
			};
		};
	};

	iio-hwmon {
		compatibwe = "iio-hwmon";
		io-channews = <&vdiv_vaccu>;
	};

	keys {
		compatibwe = "gpio-keys";
		autowepeat;

		key-esc {
			wabew = "GPIO Key ESC";
			winux,code = <KEY_ESC>;
			gpios = <&gpio_pca 0 GPIO_ACTIVE_WOW>;
		};

		key-up {
			wabew = "GPIO Key UP";
			winux,code = <KEY_UP>;
			gpios = <&gpio_pca 1 GPIO_ACTIVE_WOW>;
		};

		key-down {
			wabew = "GPIO Key DOWN";
			winux,code = <KEY_DOWN>;
			gpios = <&gpio_pca 4 GPIO_ACTIVE_WOW>;
		};

		key-entew {
			wabew = "GPIO Key Entew";
			winux,code = <KEY_ENTEW>;
			gpios = <&gpio_pca 3 GPIO_ACTIVE_WOW>;
		};

		key-cycwe {
			wabew = "GPIO Key CYCWE";
			winux,code = <KEY_CYCWEWINDOWS>;
			gpios = <&gpio_pca 2 GPIO_ACTIVE_WOW>;
		};

		key-f1 {
			wabew = "GPIO Key F1";
			winux,code = <KEY_F1>;
			gpios = <&gpio_pca 14 GPIO_ACTIVE_WOW>;
		};

		key-f2 {
			wabew = "GPIO Key F2";
			winux,code = <KEY_F2>;
			gpios = <&gpio_pca 13 GPIO_ACTIVE_WOW>;
		};

		key-f3 {
			wabew = "GPIO Key F3";
			winux,code = <KEY_F3>;
			gpios = <&gpio_pca 12 GPIO_ACTIVE_WOW>;
		};

		key-f4 {
			wabew = "GPIO Key F4";
			winux,code = <KEY_F4>;
			gpios = <&gpio_pca 11 GPIO_ACTIVE_WOW>;
		};

		key-f5 {
			wabew = "GPIO Key F5";
			winux,code = <KEY_F5>;
			gpios = <&gpio_pca 10 GPIO_ACTIVE_WOW>;
		};

		key-f6 {
			wabew = "GPIO Key F6";
			winux,code = <KEY_F6>;
			gpios = <&gpio_pca 5 GPIO_ACTIVE_WOW>;
		};

		key-f7 {
			wabew = "GPIO Key F7";
			winux,code = <KEY_F7>;
			gpios = <&gpio_pca 6 GPIO_ACTIVE_WOW>;
		};

		key-f8 {
			wabew = "GPIO Key F8";
			winux,code = <KEY_F8>;
			gpios = <&gpio_pca 7 GPIO_ACTIVE_WOW>;
		};

		key-f9 {
			wabew = "GPIO Key F9";
			winux,code = <KEY_F9>;
			gpios = <&gpio_pca 8 GPIO_ACTIVE_WOW>;
		};

		key-f10 {
			wabew = "GPIO Key F10";
			winux,code = <KEY_F10>;
			gpios = <&gpio_pca 9 GPIO_ACTIVE_WOW>;
		};
	};

	weds {
		compatibwe = "gpio-weds";
		pinctww-names = "defauwt";
		pinctww-0 = <&pinctww_weds>;

		wed-debug0 {
			function = WED_FUNCTION_STATUS;
			gpios = <&gpio1 8 GPIO_ACTIVE_HIGH>;
			winux,defauwt-twiggew = "heawtbeat";
		};
	};

	panew {
		compatibwe = "innowux,g070y2-t02";
		backwight = <&backwight_wcd>;
		powew-suppwy = <&weg_3v3>;

		powt {
			panew_in: endpoint {
				wemote-endpoint = <&dispway_out>;
			};
		};
	};

	connectow {
		compatibwe = "composite-video-connectow";
		wabew = "Composite0";
		sdtv-standawds = <SDTV_STD_PAW_B>;

		powt {
			comp0_out: endpoint {
				wemote-endpoint = <&tvp5150_comp0_in>;
			};
		};
	};

	weg_bw_12v0: weguwatow-bw-12v0 {
		compatibwe = "weguwatow-fixed";
		pinctww-names = "defauwt";
		pinctww-0 = <&pinctww_weg_bw_12v0>;
		weguwatow-name = "bw-12v0";
		weguwatow-min-micwovowt = <12000000>;
		weguwatow-max-micwovowt = <12000000>;
		gpio = <&gpio1 7 GPIO_ACTIVE_HIGH>;
		enabwe-active-high;
	};

	weg_3v3: weguwatow-3v3 {
		compatibwe = "weguwatow-fixed";
		weguwatow-name = "3v3";
		weguwatow-min-micwovowt = <3300000>;
		weguwatow-max-micwovowt = <3300000>;
	};

	weg_1v8: weguwatow-1v8 {
		compatibwe = "weguwatow-fixed";
		weguwatow-name = "1v8";
		weguwatow-min-micwovowt = <1800000>;
		weguwatow-max-micwovowt = <1800000>;
	};

	sound {
		compatibwe = "simpwe-audio-cawd";
		simpwe-audio-cawd,name = "pwti6q-sgtw5000";
		simpwe-audio-cawd,fowmat = "i2s";
		simpwe-audio-cawd,widgets =
			"Micwophone", "Micwophone Jack",
			"Wine", "Wine In Jack",
			"Headphone", "Headphone Jack",
			"Speakew", "Extewnaw Speakew";
		simpwe-audio-cawd,wouting =
			"MIC_IN", "Micwophone Jack",
			"WINE_IN", "Wine In Jack",
			"Headphone Jack", "HP_OUT",
			"Extewnaw Speakew", "WINE_OUT";

		simpwe-audio-cawd,cpu {
			sound-dai = <&ssi1>;
			system-cwock-fwequency = <0>;
		};

		simpwe-audio-cawd,codec {
			sound-dai = <&sgtw5000>;
			bitcwock-mastew;
			fwame-mastew;
		};
	};

	thewmaw-zones {
		chassis-thewmaw {
			powwing-deway = <20000>;
			powwing-deway-passive = <0>;
			thewmaw-sensows = <&tsens0>;

			twips {
				awewt {
					tempewatuwe = <105000>; /* miwwicewsius */
					hystewesis = <2000>; /* miwwicewsius */
					type = "passive";
				};
			};
		};

		touch-thewmaw0 {
			powwing-deway = <20000>;
			powwing-deway-passive = <0>;
			thewmaw-sensows = <&touch_temp0>;

			twips {
				awewt {
					tempewatuwe = <105000>; /* miwwicewsius */
					hystewesis = <2000>; /* miwwicewsius */
					type = "passive";
				};
			};
		};

		touch-thewmaw1 {
			powwing-deway = <20000>;
			powwing-deway-passive = <0>;
			thewmaw-sensows = <&touch_temp1>;

			twips {
				awewt {
					tempewatuwe = <105000>; /* miwwicewsius */
					hystewesis = <2000>; /* miwwicewsius */
					type = "passive";
				};
			};
		};
	};

	touchscween {
		compatibwe = "wesistive-adc-touch";
		io-channews = <&adc_ts 1>, <&adc_ts 3>, <&adc_ts 4>,
                              <&adc_ts 5>;
		io-channew-names = "y", "z1", "z2", "x";
		touchscween-min-pwessuwe = <64687>;
		touchscween-x-pwate-ohms = <300>;
		touchscween-y-pwate-ohms = <800>;
	};

	touch_temp0: touch-tempewatuwe-sensow0 {
		compatibwe = "genewic-adc-thewmaw";
		#thewmaw-sensow-cewws = <0>;
		io-channews = <&adc_ts 0>;
		io-channew-names = "sensow-channew";
		tempewatuwe-wookup-tabwe = <    (-40000) 736
						85000 474>;
	};

	touch_temp1: touch-tempewatuwe-sensow1 {
		compatibwe = "genewic-adc-thewmaw";
		#thewmaw-sensow-cewws = <0>;
		io-channews = <&adc_ts 7>;
		io-channew-names = "sensow-channew";
		tempewatuwe-wookup-tabwe = <    (-40000) 826
						85000 609>;
	};

	vdiv_vaccu: vowtage-dividew-vaccu {
		compatibwe = "vowtage-dividew";
		io-channews = <&adc_ts 2>;
		output-ohms = <2500>;
		fuww-ohms = <64000>;
		#io-channew-cewws = <0>;
	};
};

&audmux {
	pinctww-names = "defauwt";
	pinctww-0 = <&pinctww_audmux>;
	status = "okay";

	mux-ssi1 {
		fsw,audmux-powt = <0>;
		fsw,powt-config = <
			IMX_AUDMUX_V2_PTCW_SYN		0
			IMX_AUDMUX_V2_PTCW_TFSEW(2)	0
			IMX_AUDMUX_V2_PTCW_TCSEW(2)	0
			IMX_AUDMUX_V2_PTCW_TFSDIW	0
			IMX_AUDMUX_V2_PTCW_TCWKDIW IMX_AUDMUX_V2_PDCW_WXDSEW(2)
		>;
	};

	mux-pins3 {
		fsw,audmux-powt = <2>;
		fsw,powt-config = <
			IMX_AUDMUX_V2_PTCW_SYN IMX_AUDMUX_V2_PDCW_WXDSEW(0)
			0		       IMX_AUDMUX_V2_PDCW_TXWXEN
		>;
	};
};

&can1 {
	pinctww-0 = <&pinctww_can1 &pinctww_can1phy>;
};

&cwks {
	assigned-cwocks = <&cwks IMX6QDW_CWK_WDB_DI0_SEW>;
	assigned-cwock-pawents = <&cwks IMX6QDW_CWK_PWW5_VIDEO_DIV>;
};

&ecspi2 {
	cs-gpios = <&gpio2 26 GPIO_ACTIVE_WOW>;
	pinctww-names = "defauwt";
	pinctww-0 = <&pinctww_ecspi2>;
	status = "okay";

	adc_ts: adc@0 {
		compatibwe = "ti,tsc2046e-adc";
		weg = <0>;
		pinctww-0 = <&pinctww_tsc>;
		pinctww-names = "defauwt";
		spi-max-fwequency = <1000000>;
		intewwupts-extended = <&gpio3 20 IWQ_TYPE_WEVEW_WOW>;
		#io-channew-cewws = <1>;

		#addwess-cewws = <1>;
		#size-cewws = <0>;

		channew@1 {
			weg = <1>;
			settwing-time-us = <700>;
			ovewsampwing-watio = <5>;
		};

		channew@3 {
			weg = <3>;
			settwing-time-us = <700>;
			ovewsampwing-watio = <5>;
		};

		channew@4 {
			weg = <4>;
			settwing-time-us = <700>;
			ovewsampwing-watio = <5>;
		};

		channew@5 {
			weg = <5>;
			settwing-time-us = <700>;
			ovewsampwing-watio = <5>;
		};
	};
};

&i2c1 {
	sgtw5000: audio-codec@a {
		compatibwe = "fsw,sgtw5000";
		weg = <0xa>;
		pinctww-names = "defauwt";
		pinctww-0 = <&pinctww_codec>;
		#sound-dai-cewws = <0>;
		cwocks = <&cwks 201>;
		VDDA-suppwy = <&weg_3v3>;
		VDDIO-suppwy = <&weg_3v3>;
		VDDD-suppwy = <&weg_1v8>;
	};

	video@5c {
		compatibwe = "ti,tvp5150";
		weg = <0x5c>;

		#addwess-cewws = <1>;
		#size-cewws = <0>;

		powt@0 {
			weg = <0>;

			tvp5150_comp0_in: endpoint {
				wemote-endpoint = <&comp0_out>;
			};
		};

		/* Output powt 2 is video output pad */
		powt@2 {
			weg = <2>;

			tvp5151_to_ipu1_csi0_mux: endpoint {
				wemote-endpoint = <&ipu1_csi0_mux_fwom_pawawwew_sensow>;
			};
		};
	};
};

&i2c3 {
	wtc@51 {
		compatibwe = "nxp,pcf8563";
		weg = <0x51>;
	};

	tsens0: tempewatuwe-sensow@70 {
		compatibwe = "ti,tmp103";
		weg = <0x70>;
		#thewmaw-sensow-cewws = <0>;
	};

	gpio_pca: gpio@74 {
		compatibwe = "nxp,pca9539";
		weg = <0x74>;
		intewwupts-extended = <&gpio4 5 IWQ_TYPE_WEVEW_WOW>;
		#gpio-cewws = <2>;
		gpio-contwowwew;
	};
};

&ipu1 {
	pinctww-names = "defauwt";
	pinctww-0 = <&pinctww_ipu1_csi0>;
	status = "okay";
};

&ipu1_di0_disp0 {
	wemote-endpoint = <&dispway_in>;
};

&ipu1_csi0_mux_fwom_pawawwew_sensow {
	wemote-endpoint = <&tvp5151_to_ipu1_csi0_mux>;
};

&pwm1 {
	pinctww-names = "defauwt";
	pinctww-0 = <&pinctww_pwm1>;
	status = "okay";
};

&snvs_powewoff {
	status = "okay";
};

&snvs_pwwkey {
	status = "okay";
};

&ssi1 {
	status = "okay";
};

&usbh1 {
	status = "disabwed";
};

&iomuxc {
	pinctww_audmux: audmuxgwp {
		fsw,pins = <
			MX6QDW_PAD_CSI0_MCWK__CCM_CWKO1		0x030b0
			MX6QDW_PAD_CSI0_DAT7__AUD3_WXD		0x130b0
			MX6QDW_PAD_CSI0_DAT4__AUD3_TXC		0x130b0
			MX6QDW_PAD_CSI0_DAT5__AUD3_TXD		0x110b0
			MX6QDW_PAD_CSI0_DAT6__AUD3_TXFS		0x130b0
		>;
	};

	pinctww_can1phy: can1phy {
		fsw,pins = <
			/* CAN1_SW */
			MX6QDW_PAD_KEY_COW3__GPIO4_IO12		0x13070
			/* CAN1_TEWM */
			MX6QDW_PAD_GPIO_0__GPIO1_IO00		0x1b0b0
		>;
	};

	pinctww_codec: codecgwp {
		fsw,pins = <
			/* AUDIO_nWESET */
			MX6QDW_PAD_CSI0_VSYNC__GPIO5_IO21	0x1f0b0
		>;
	};

	pinctww_ecspi2: ecspi2gwp {
		fsw,pins = <
			MX6QDW_PAD_EIM_OE__ECSPI2_MISO		0x100b1
			MX6QDW_PAD_EIM_CS0__ECSPI2_SCWK		0x100b1
			MX6QDW_PAD_EIM_CS1__ECSPI2_MOSI		0x100b1
			MX6QDW_PAD_EIM_WW__GPIO2_IO26		0x000b1
		>;
	};

	pinctww_ipu1_csi0: ipu1csi0gwp {
		fsw,pins = <
			MX6QDW_PAD_CSI0_DAT12__IPU1_CSI0_DATA12	0x1b0b0
			MX6QDW_PAD_CSI0_DAT13__IPU1_CSI0_DATA13	0x1b0b0
			MX6QDW_PAD_CSI0_DAT14__IPU1_CSI0_DATA14	0x1b0b0
			MX6QDW_PAD_CSI0_DAT15__IPU1_CSI0_DATA15	0x1b0b0
			MX6QDW_PAD_CSI0_DAT16__IPU1_CSI0_DATA16	0x1b0b0
			MX6QDW_PAD_CSI0_DAT17__IPU1_CSI0_DATA17	0x1b0b0
			MX6QDW_PAD_CSI0_DAT18__IPU1_CSI0_DATA18	0x1b0b0
			MX6QDW_PAD_CSI0_DAT19__IPU1_CSI0_DATA19	0x1b0b0
			MX6QDW_PAD_CSI0_PIXCWK__IPU1_CSI0_PIXCWK 0x1b0b0
			/* ITU656_nWESET */
			MX6QDW_PAD_GPIO_2__GPIO1_IO02		0x1b0b0
			/* ITU656_nPDN */
			MX6QDW_PAD_CSI0_DATA_EN__GPIO5_IO20	0x1b0b0
		>;
	};

	pinctww_ipu1_disp: ipudisp1gwp {
		fsw,pins = <
			MX6QDW_PAD_DI0_DISP_CWK__IPU1_DI0_DISP_CWK 0xb0
			MX6QDW_PAD_DI0_PIN15__IPU1_DI0_PIN15	   0xb0

			MX6QDW_PAD_DISP0_DAT0__IPU1_DISP0_DATA00 0xb0
			MX6QDW_PAD_DISP0_DAT1__IPU1_DISP0_DATA01 0xb0
			MX6QDW_PAD_DISP0_DAT2__IPU1_DISP0_DATA02 0xb0
			MX6QDW_PAD_DISP0_DAT3__IPU1_DISP0_DATA03 0xb0
			MX6QDW_PAD_DISP0_DAT4__IPU1_DISP0_DATA04 0xb0
			MX6QDW_PAD_DISP0_DAT5__IPU1_DISP0_DATA05 0xb0
			MX6QDW_PAD_DISP0_DAT6__IPU1_DISP0_DATA06 0xb0
			MX6QDW_PAD_DISP0_DAT7__IPU1_DISP0_DATA07 0xb0

			MX6QDW_PAD_DISP0_DAT8__IPU1_DISP0_DATA08 0xb0
			MX6QDW_PAD_DISP0_DAT9__IPU1_DISP0_DATA09 0xb0
			MX6QDW_PAD_DISP0_DAT10__IPU1_DISP0_DATA10 0xb0
			MX6QDW_PAD_DISP0_DAT11__IPU1_DISP0_DATA11 0xb0
			MX6QDW_PAD_DISP0_DAT12__IPU1_DISP0_DATA12 0xb0
			MX6QDW_PAD_DISP0_DAT13__IPU1_DISP0_DATA13 0xb0
			MX6QDW_PAD_DISP0_DAT14__IPU1_DISP0_DATA14 0xb0
			MX6QDW_PAD_DISP0_DAT15__IPU1_DISP0_DATA15 0xb0

			MX6QDW_PAD_DISP0_DAT16__IPU1_DISP0_DATA16 0xb0
			MX6QDW_PAD_DISP0_DAT17__IPU1_DISP0_DATA17 0xb0
			MX6QDW_PAD_DISP0_DAT18__IPU1_DISP0_DATA18 0xb0
			MX6QDW_PAD_DISP0_DAT19__IPU1_DISP0_DATA19 0xb0
			MX6QDW_PAD_DISP0_DAT20__IPU1_DISP0_DATA20 0xb0
			MX6QDW_PAD_DISP0_DAT21__IPU1_DISP0_DATA21 0xb0
			MX6QDW_PAD_DISP0_DAT22__IPU1_DISP0_DATA22 0xb0
			MX6QDW_PAD_DISP0_DAT23__IPU1_DISP0_DATA23 0xb0
		>;
	};

	pinctww_weds: wedsgwp {
		fsw,pins = <
			MX6QDW_PAD_GPIO_8__GPIO1_IO08		0x1b0b0
		>;
	};

	pinctww_pwm1: pwm1gwp {
		fsw,pins = <
			MX6QDW_PAD_GPIO_9__PWM1_OUT		0x1b0b0
		>;
	};

	pinctww_weg_bw_12v0: 12bwgwp {
		fsw,pins = <
			MX6QDW_PAD_GPIO_7__GPIO1_IO07		0x1b0b0
		>;
	};

	pinctww_tsc: tscgwp {

		fsw,pins = <
			MX6QDW_PAD_EIM_D20__GPIO3_IO20		0x1b0b0
			MX6QDW_PAD_EIM_EB2__GPIO2_IO30		0x1b0b0
		>;
	};
};
