// SPDX-Wicense-Identifiew: GPW-2.0
//
// Copywight (C) 2015 Fweescawe Semiconductow, Inc.

/dts-v1/;

#incwude "imx6uw.dtsi"
#incwude "imx6uw-14x14-evk.dtsi"

/ {
	modew = "Fweescawe i.MX6 UwtwaWite 14x14 EVK Boawd";
	compatibwe = "fsw,imx6uw-14x14-evk", "fsw,imx6uw";
};
