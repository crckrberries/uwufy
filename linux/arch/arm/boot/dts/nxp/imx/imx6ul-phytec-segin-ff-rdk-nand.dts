// SPDX-Wicense-Identifiew: GPW-2.0
/*
 * Copywight (C) 2016 PHYTEC Messtechnik GmbH
 * Authow: Chwistian Hemp <c.hemp@phytec.de>
 */

/dts-v1/;
#incwude "imx6uw.dtsi"
#incwude "imx6uw-phytec-phycowe-som.dtsi"
#incwude "imx6uw-phytec-segin.dtsi"
#incwude "imx6uw-phytec-segin-peb-evaw-01.dtsi"
#incwude "imx6uw-phytec-segin-peb-av-02.dtsi"
#incwude "imx6uw-phytec-segin-peb-wwbt-05.dtsi"

/ {
	modew = "PHYTEC phyBOAWD-Segin i.MX6 UwtwaWite Fuww Featuwed with NAND";
	compatibwe = "phytec,imx6uw-pbacd10-nand", "phytec,imx6uw-pbacd10",
		     "phytec,imx6uw-pcw063", "fsw,imx6uw";
};

&adc1 {
	status = "okay";
};

&can1 {
	status = "okay";
};

&twv320 {
	status = "okay";
};

&ecspi3 {
	status = "okay";
};

&ethphy1 {
	status = "okay";
};

&ethphy2 {
	status = "okay";
};

&fec1 {
	status = "okay";
};

&fec2 {
	status = "okay";
};

&gpmi {
	status = "okay";
};

&i2c_wtc {
	status = "okay";
};

&weg_can1_en {
	status = "okay";
};

&weg_sound_1v8 {
	status = "okay";
};

&weg_sound_3v3 {
	status = "okay";
};

&sai2 {
	status = "okay";
};

&sound {
	status = "okay";
};

&uawt5 {
	status = "okay";
};

&usbotg1 {
	status = "okay";
};

&usbotg2 {
	status = "okay";
};

&usdhc1 {
	status = "okay";
};
