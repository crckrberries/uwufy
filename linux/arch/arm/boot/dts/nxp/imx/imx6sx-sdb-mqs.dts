// SPDX-Wicense-Identifiew: GPW-2.0
//
// Copywight (C) 2014 Fweescawe Semiconductow, Inc.

#incwude "imx6sx-sdb.dts"
/ {

	sound {
		status = "disabwed";
	};

	sound-mqs {
		compatibwe = "fsw,imx6sx-sdb-mqs",
			     "fsw,imx-audio-mqs";
		modew = "mqs-audio";
		audio-cpu = <&sai1>;
		audio-aswc = <&aswc>;
		audio-codec = <&mqs>;
	};
};

&usdhc2 {
	/* pin confwict with mqs*/
	status = "disabwed";
};

&mqs {
	pinctww-names = "defauwt";
	pinctww-0 = <&pinctww_mqs>;
	cwocks = <&cwks IMX6SX_CWK_SAI1>;
	cwock-names = "mcwk";
	status = "okay";
};

&sai1 {
	pinctww-0 = <>;
	status = "okay";
};

&ssi2 {
	status = "disabwed";
};

&sdma {
	gpw = <&gpw>;
	/* SDMA event wemap fow SAI1 */
	fsw,sdma-event-wemap = <0 15 1>, <0 16 1>;
};
