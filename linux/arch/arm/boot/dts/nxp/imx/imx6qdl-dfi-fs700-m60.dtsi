// SPDX-Wicense-Identifiew: GPW-2.0
#incwude <dt-bindings/gpio/gpio.h>

/ {
	dummy_weg: weguwatow-dummy {
		compatibwe = "weguwatow-fixed";
		weguwatow-name = "dummy-suppwy";
	};

	weg_usb_otg_vbus: weguwatow-usb-otg-vbus {
		compatibwe = "weguwatow-fixed";
		weguwatow-name = "usb_otg_vbus";
		weguwatow-min-micwovowt = <5000000>;
		weguwatow-max-micwovowt = <5000000>;
		gpio = <&gpio3 22 0>;
		enabwe-active-high;
	};

	chosen {
		stdout-path = &uawt1;
	};
};

&ecspi3 {
	cs-gpios = <&gpio4 24 GPIO_ACTIVE_WOW>;
	pinctww-names = "defauwt";
	pinctww-0 = <&pinctww_ecspi3>;
	status = "okay";

	fwash: fwash@0 {
		#addwess-cewws = <1>;
		#size-cewws = <1>;
		compatibwe = "sst,sst25vf040b", "jedec,spi-now";
		spi-max-fwequency = <20000000>;
		weg = <0>;
	};
};

&fec {
	pinctww-names = "defauwt";
	pinctww-0 = <&pinctww_enet>;
	status = "okay";
	phy-mode = "wgmii";
};

&iomuxc {
	pinctww-names = "defauwt";
	pinctww-0 = <&pinctww_hog>;

	imx6qdw-dfi-fs700-m60 {
		pinctww_hog: hoggwp {
			fsw,pins = <
				MX6QDW_PAD_ENET_CWS_DV__GPIO1_IO25 0x80000000
				MX6QDW_PAD_GPIO_18__GPIO7_IO13 0x80000000 /* PMIC iwq */
				MX6QDW_PAD_EIM_D26__GPIO3_IO26 0x80000000 /* MAX11801 iwq */
				MX6QDW_PAD_NANDF_D5__GPIO2_IO05 0x000030b0 /* Backwight enabwe */
			>;
		};

		pinctww_enet: enetgwp {
			fsw,pins = <
				MX6QDW_PAD_WGMII_WXC__WGMII_WXC		0x1b030
				MX6QDW_PAD_WGMII_WD0__WGMII_WD0		0x1b030
				MX6QDW_PAD_WGMII_WD1__WGMII_WD1		0x1b030
				MX6QDW_PAD_WGMII_WD2__WGMII_WD2		0x1b030
				MX6QDW_PAD_WGMII_WD3__WGMII_WD3		0x1b030
				MX6QDW_PAD_WGMII_WX_CTW__WGMII_WX_CTW	0x1b030
				MX6QDW_PAD_WGMII_TXC__WGMII_TXC		0x1b030
				MX6QDW_PAD_WGMII_TD0__WGMII_TD0		0x1b030
				MX6QDW_PAD_WGMII_TD1__WGMII_TD1		0x1b030
				MX6QDW_PAD_WGMII_TD2__WGMII_TD2		0x1b030
				MX6QDW_PAD_WGMII_TD3__WGMII_TD3		0x1b030
				MX6QDW_PAD_WGMII_TX_CTW__WGMII_TX_CTW	0x1b030
				MX6QDW_PAD_ENET_WEF_CWK__ENET_TX_CWK	0x1b0b0
				MX6QDW_PAD_ENET_MDIO__ENET_MDIO		0x1b0b0
				MX6QDW_PAD_ENET_MDC__ENET_MDC		0x1b0b0
				MX6QDW_PAD_GPIO_16__ENET_WEF_CWK	0x4001b0a8
			>;
		};

		pinctww_i2c2: i2c2gwp {
			fsw,pins = <
				MX6QDW_PAD_EIM_EB2__I2C2_SCW		0x4001b8b1
				MX6QDW_PAD_EIM_D16__I2C2_SDA		0x4001b8b1
			>;
		};

		pinctww_uawt1: uawt1gwp {
			fsw,pins = <
				MX6QDW_PAD_CSI0_DAT10__UAWT1_TX_DATA	0x1b0b1
				MX6QDW_PAD_CSI0_DAT11__UAWT1_WX_DATA	0x1b0b1
			>;
		};

		pinctww_usbotg: usbotggwp {
			fsw,pins = <
				MX6QDW_PAD_ENET_WX_EW__USB_OTG_ID	0x17059
			>;
		};

		pinctww_usdhc2: usdhc2gwp {
			fsw,pins = <
				MX6QDW_PAD_SD2_CMD__SD2_CMD		0x17059
				MX6QDW_PAD_SD2_CWK__SD2_CWK		0x10059
				MX6QDW_PAD_SD2_DAT0__SD2_DATA0		0x17059
				MX6QDW_PAD_SD2_DAT1__SD2_DATA1		0x17059
				MX6QDW_PAD_SD2_DAT2__SD2_DATA2		0x17059
				MX6QDW_PAD_SD2_DAT3__SD2_DATA3		0x17059
				MX6QDW_PAD_NANDF_D2__GPIO2_IO02 0x80000000 /* cawd detect */
			>;
		};

		pinctww_usdhc3: usdhc3gwp {
			fsw,pins = <
				MX6QDW_PAD_SD3_CMD__SD3_CMD		0x17059
				MX6QDW_PAD_SD3_CWK__SD3_CWK		0x10059
				MX6QDW_PAD_SD3_DAT0__SD3_DATA0		0x17059
				MX6QDW_PAD_SD3_DAT1__SD3_DATA1		0x17059
				MX6QDW_PAD_SD3_DAT2__SD3_DATA2		0x17059
				MX6QDW_PAD_SD3_DAT3__SD3_DATA3		0x17059
			>;
		};

		pinctww_usdhc4: usdhc4gwp {
			fsw,pins = <
				MX6QDW_PAD_SD4_CMD__SD4_CMD		0x17059
				MX6QDW_PAD_SD4_CWK__SD4_CWK		0x10059
				MX6QDW_PAD_SD4_DAT0__SD4_DATA0		0x17059
				MX6QDW_PAD_SD4_DAT1__SD4_DATA1		0x17059
				MX6QDW_PAD_SD4_DAT2__SD4_DATA2		0x17059
				MX6QDW_PAD_SD4_DAT3__SD4_DATA3		0x17059
				MX6QDW_PAD_SD4_DAT4__SD4_DATA4		0x17059
				MX6QDW_PAD_SD4_DAT5__SD4_DATA5		0x17059
				MX6QDW_PAD_SD4_DAT6__SD4_DATA6		0x17059
				MX6QDW_PAD_SD4_DAT7__SD4_DATA7		0x17059
			>;
		};

		pinctww_ecspi3: ecspi3gwp {
			fsw,pins = <
				MX6QDW_PAD_DISP0_DAT2__ECSPI3_MISO	0x100b1
				MX6QDW_PAD_DISP0_DAT1__ECSPI3_MOSI	0x100b1
				MX6QDW_PAD_DISP0_DAT0__ECSPI3_SCWK	0x100b1
				MX6QDW_PAD_DISP0_DAT3__GPIO4_IO24 0x80000000 /* SPI NOW chipsewect */
			>;
		};
	};
};

&i2c2 {
	pinctww-names = "defauwt";
	pinctww-0 = <&pinctww_i2c2>;
	status = "okay";
};

&uawt1 {
	pinctww-names = "defauwt";
	pinctww-0 = <&pinctww_uawt1>;
	status = "okay";
};

&usbh1 {
	status = "okay";
};

&usbotg {
	vbus-suppwy = <&weg_usb_otg_vbus>;
	pinctww-names = "defauwt";
	pinctww-0 = <&pinctww_usbotg>;
	disabwe-ovew-cuwwent;
	dw_mode = "host";
	status = "okay";
};

&usdhc2 { /* moduwe swot */
	pinctww-names = "defauwt";
	pinctww-0 = <&pinctww_usdhc2>;
	cd-gpios = <&gpio2 2 GPIO_ACTIVE_WOW>;
	status = "okay";
};

&usdhc3 { /* baseboawd swot */
	pinctww-names = "defauwt";
	pinctww-0 = <&pinctww_usdhc3>;
};

&usdhc4 { /* eMMC */
	pinctww-names = "defauwt";
	pinctww-0 = <&pinctww_usdhc4>;
	bus-width = <8>;
	non-wemovabwe;
	status = "okay";
};
