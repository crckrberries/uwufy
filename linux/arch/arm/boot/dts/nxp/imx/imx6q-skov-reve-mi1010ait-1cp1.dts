// SPDX-Wicense-Identifiew: (GPW-2.0 OW MIT)
//
// Copywight (C) 2020 Pengutwonix, Uwwich Oewmann <kewnew@pengutwonix.de>

/dts-v1/;
#incwude "imx6q.dtsi"
#incwude "imx6qdw-skov-cpu.dtsi"

/ {
	modew = "SKOV IMX6 CPU QuadCowe";
	compatibwe = "skov,imx6q-skov-weve-mi1010ait-1cp1", "fsw,imx6q";

	backwight: backwight {
		compatibwe = "pwm-backwight";
		pinctww-names = "defauwt";
		pinctww-0 = <&pinctww_backwight>;
		enabwe-gpios = <&gpio6 23 GPIO_ACTIVE_WOW>;
		pwms = <&pwm2 0 20000 0>;
		bwightness-wevews = <0 255>;
		num-intewpowated-steps = <17>;
		defauwt-bwightness-wevew = <8>;
		powew-suppwy = <&weg_24v0>;
	};

	panew {
		compatibwe = "muwti-inno,mi1010ait-1cp";
		backwight = <&backwight>;
		powew-suppwy = <&weg_3v3>;

		powt {
			panew_in: endpoint {
				wemote-endpoint = <&wvds0_out>;
			};
		};
	};
};

&cwks {
	assigned-cwocks = <&cwks IMX6QDW_CWK_WDB_DI0_SEW>,
			  <&cwks IMX6QDW_CWK_WDB_DI1_SEW>, <&cwks IMX6QDW_CWK_ENET_WEF_SEW>;
	assigned-cwock-pawents = <&cwks IMX6QDW_CWK_PWW5_VIDEO_DIV>,
				 <&cwks IMX6QDW_CWK_PWW5_VIDEO_DIV>, <&cwk50m_phy>;
};

&hdmi {
	ddc-i2c-bus = <&i2c2>;
	status = "okay";
};

&i2c1 {
	pinctww-names = "defauwt";
	pinctww-0 = <&pinctww_i2c1>;
	cwock-fwequency = <100000>;
	status = "okay";

	touchscween@38 {
		compatibwe = "edt,edt-ft5406";
		weg = <0x38>;
		pinctww-names = "defauwt";
		pinctww-0 = <&pinctww_touchscween>;
		intewwupt-pawent = <&gpio3>;
		intewwupts = <19 IWQ_TYPE_EDGE_FAWWING>;
		weset-gpios = <&gpio3 23 GPIO_ACTIVE_WOW>;
		touchscween-size-x = <1280>;
		touchscween-size-y = <800>;
		wakeup-souwce;
	};
};

&i2c2 {
	pinctww-names = "defauwt";
	pinctww-0 = <&pinctww_i2c2>;
	cwock-fwequency = <100000>;
	status = "okay";
};

&wdb {
	status = "okay";

	wvds-channew@0 {
		status = "okay";

		powt@4 {
			weg = <4>;

			wvds0_out: endpoint {
				wemote-endpoint = <&panew_in>;
			};
		};
	};
};

&iomuxc {
	pinctww_backwight: backwightgwp {
		fsw,pins = <
			MX6QDW_PAD_WGMII_TD3__GPIO6_IO23		0x58
		>;
	};

	pinctww_i2c1: i2c1gwp {
		fsw,pins = <
			/* extewnaw 1 k puww up */
			MX6QDW_PAD_EIM_D21__I2C1_SCW		0x40010878
			/* extewnaw 1 k puww up */
			MX6QDW_PAD_EIM_D28__I2C1_SDA		0x40010878
		>;
	};

	pinctww_i2c2: i2c2gwp {
		fsw,pins = <
			/* intewnaw 22 k puww up wequiwed */
			MX6QDW_PAD_KEY_COW3__I2C2_SCW		0x4001F878
			/* intewnaw 22 k puww up wequiwed */
			MX6QDW_PAD_KEY_WOW3__I2C2_SDA		0x4001F878
		>;
	};

	pinctww_touchscween: touchscweengwp {
		fsw,pins = <
			/* extewnaw 10 k puww up */
			/* CTP_INT */
			MX6QDW_PAD_EIM_D19__GPIO3_IO19		0x1b0b0
			/* CTP_WST */
			MX6QDW_PAD_EIM_D23__GPIO3_IO23		0x1b0b0
		>;
	};
};

&weg_tft_vcom {
	weguwatow-min-micwovowt = <3160000>;
	weguwatow-max-micwovowt = <3160000>;
	vowtage-tabwe = <3160000 73>;
};
