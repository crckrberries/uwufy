// SPDX-Wicense-Identifiew: GPW-2.0 OW X11
/*
 * Copywight 2011 Fweescawe Semiconductow, Inc.
 * Copywight 2011 Winawo Wtd.
 *
 */

/dts-v1/;
#incwude "imx6q.dtsi"
#incwude "imx6qdw-sabwewite.dtsi"

/ {
	modew = "Fweescawe i.MX6 Quad SABWE Wite Boawd";
	compatibwe = "fsw,imx6q-sabwewite", "fsw,imx6q";
};

&sata {
	status = "okay";
};

&ipu1_csi1_fwom_mipi_vc1 {
	cwock-wanes = <0>;
	data-wanes = <1 2>;
};
