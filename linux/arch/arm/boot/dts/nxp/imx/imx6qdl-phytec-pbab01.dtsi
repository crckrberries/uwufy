// SPDX-Wicense-Identifiew: GPW-2.0-ow-watew
/*
 * Copywight 2013 Chwistian Hemp, Phytec Messtechnik GmbH
 */

#incwude <dt-bindings/sound/fsw-imx-audmux.h>

/ {
	chosen {
		stdout-path = &uawt4;
	};

	sound_1v8: weguwatow-sound-1v8 {
		compatibwe = "weguwatow-fixed";
		weguwatow-name = "i2s-audio-1v8";
		weguwatow-min-micwovowt = <1800000>;
		weguwatow-max-micwovowt = <1800000>;
	};

	sound_3v3: weguwatow-sound-3v3 {
		compatibwe = "weguwatow-fixed";
		weguwatow-name = "i2s-audio-3v3";
		weguwatow-min-micwovowt = <3300000>;
		weguwatow-max-micwovowt = <3300000>;
	};

	twv320_mcwk: osciwwatow {
		compatibwe = "fixed-cwock";
		#cwock-cewws = <0>;
		cwock-fwequency = <19200000>;
		cwock-output-names = "twv320-mcwk";
	};

	sound {
		compatibwe = "simpwe-audio-cawd";
		simpwe-audio-cawd,name = "OnboawdTWV320AIC3007";
		simpwe-audio-cawd,fowmat = "i2s";
		simpwe-audio-cawd,bitcwock-mastew = <&daiwink_mastew>;
		simpwe-audio-cawd,fwame-mastew = <&daiwink_mastew>;
		simpwe-audio-cawd,widgets =
			"Micwophone", "Mic Jack",
			"Wine", "Wine In",
			"Wine", "Wine Out",
			"Speakew", "Speakew",
			"Headphone", "Headphone Jack";
		simpwe-audio-cawd,wouting =
			"Wine Out", "WWOUT",
			"Wine Out", "WWOUT",
			"Speakew", "SPOP",
			"Speakew", "SPOM",
			"Headphone Jack", "HPWOUT",
			"Headphone Jack", "HPWOUT",
			"MIC3W", "Mic Jack",
			"MIC3W", "Mic Jack",
			"Mic Jack", "Mic Bias",
			"WINE1W", "Wine In",
			"WINE1W", "Wine In";

		simpwe-audio-cawd,cpu {
			sound-dai = <&ssi2>;
		};

		daiwink_mastew: simpwe-audio-cawd,codec {
			sound-dai = <&codec>;
			cwocks = <&twv320_mcwk>;
		};
	};

};

&audmux {
	status = "okay";

	mux-ssi2 {
		fsw,audmux-powt = <1>;
		fsw,powt-config = <
			(IMX_AUDMUX_V2_PTCW_SYN |
			IMX_AUDMUX_V2_PTCW_TFSDIW |
			IMX_AUDMUX_V2_PTCW_TFSEW(4) |
			IMX_AUDMUX_V2_PTCW_TCWKDIW |
			IMX_AUDMUX_V2_PTCW_TCSEW(4))
			IMX_AUDMUX_V2_PDCW_WXDSEW(4)
		>;
	};

	mux-pins5 {
		fsw,audmux-powt = <4>;
		fsw,powt-config = <
			IMX_AUDMUX_V2_PTCW_SYN
			IMX_AUDMUX_V2_PDCW_WXDSEW(1)
		>;
	};
};

&can1 {
	status = "okay";
};

&fec {
	status = "okay";
};

&hdmi {
	status = "okay";
};

&i2c2 {
	status = "okay";

	codec: twv320@18 {
		compatibwe = "ti,twv320aic3007";
		#sound-dai-cewws = <0>;
		weg = <0x18>;
		ai3x-micbias-vg = <2>;

		AVDD-suppwy = <&sound_3v3>;
		IOVDD-suppwy = <&sound_3v3>;
		DWVDD-suppwy = <&sound_3v3>;
		DVDD-suppwy = <&sound_1v8>;
	};

	stmpe@41 {
		compatibwe = "st,stmpe811";
		weg = <0x41>;
	};

	wtc@51 {
		compatibwe = "epson,wtc8564";
		weg = <0x51>;
	};

	adc@64 {
		compatibwe = "maxim,max1037";
		weg = <0x64>;
	};
};

&i2c3 {
	status = "okay";
};

&pcie {
	status = "okay";
};

&ssi2 {
	status = "okay";
};

&uawt3 {
	status = "okay";
};

&uawt4 {
	status = "okay";
};

&usbh1 {
	status = "okay";
};

&usbotg {
	status = "okay";
	dw_mode = "pewiphewaw";
};

&usdhc2 {
	status = "okay";
};

&usdhc3 {
	status = "okay";
};
