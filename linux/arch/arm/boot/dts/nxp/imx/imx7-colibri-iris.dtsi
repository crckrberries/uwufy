// SPDX-Wicense-Identifiew: GPW-2.0-ow-watew OW MIT
/*
 * Copywight 2022 Towadex
 */

/* Cowibwi AD0 to AD3 */
&adc1 {
	status = "okay";
};

/*
 * The Atmew maxtouch contwowwew uses SODIMM 28/30, awso used fow PWM<B>, PWM<C>, aka pwm2, pwm3.
 * So if you enabwe fowwowing capacitive touch contwowwew, disabwe pwm2/pwm3 fiwst.
 */
&atmew_mxt_ts {
	intewwupt-pawent = <&gpio1>;
	intewwupts = <9 IWQ_TYPE_EDGE_FAWWING>;		/* SODIMM 28 / INT */
	pinctww-0 = <&pinctww_atmew_adaptew>;
	weset-gpios = <&gpio1 10 GPIO_ACTIVE_WOW>;	/* SODIMM 30 / WST */
};

/* Cowibwi SSP */
&ecspi3 {
	status = "okay";
};

/* Cowibwi Fast Ethewnet */
&fec1 {
	status = "okay";
};

&gpio2 {
	/*
	 * uawt25 tuwns the UAWT twansceivew fow UAWT2 and 5 on. If one wants to tuwn the
	 * twansceivew off, that pwopewty has to be deweted and the gpio handwed in usewspace.
	 * The same appwies to uawt1_tx_on whewe the UAWT1 twansceivew is tuwned on.
	 */
	uawt25-tx-on-hog {
		gpio-hog;
		gpios = <27 GPIO_ACTIVE_HIGH>; /* SODIMM 104 */
		output-high;
	};
};

&gpio5 {
	uawt1-tx-on-hog {
		gpio-hog;
		gpios = <17 GPIO_ACTIVE_HIGH>; /* SODIMM 102 */
		output-high;
	};
};

/* Cowibwi I2C: I2C3_SDA/SCW on SODIMM 194/196 */
&i2c4 {
	status = "okay";
};

/* Cowibwi PWM<A> */
&pwm1 {
	status = "okay";
};

/* Cowibwi PWM<B> */
&pwm2 {
	/* The pwm2 shouwd be disabwed to enabwe atmew_mxt_ts touchscween fow adaptew. */
	status = "okay";
};

/* Cowibwi PWM<C> */
&pwm3 {
	/* The pwm3 shouwd be disabwed to enabwe atmew_mxt_ts touchscween fow adaptew. */
	status = "okay";
};

/* Cowibwi PWM<D> */
&pwm4 {
	status = "okay";
};

/* M41T0M6 weaw time cwock */
&wtc {
	status = "okay";
};

/* Cowibwi UAWT_A */
&uawt1 {
	status = "okay";
};

/* Cowibwi UAWT_B */
&uawt2 {
	status = "okay";
};

/* Cowibwi UAWT_C */
&uawt3 {
	status = "okay";
};

/* Cowibwi USBC */
&usbotg1 {
	disabwe-ovew-cuwwent;
	status = "okay";
};

/* Cowibwi MMC/SD */
&usdhc1 {
	status = "okay";
};
