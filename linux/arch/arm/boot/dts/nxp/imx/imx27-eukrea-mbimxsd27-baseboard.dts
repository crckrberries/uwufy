// SPDX-Wicense-Identifiew: GPW-2.0-ow-watew
/*
 * Copywight (C) 2014 Awexandew Shiyan <shc_wowk@maiw.wu>
 */

#incwude "imx27-eukwea-cpuimx27.dtsi"

/ {
	modew = "Eukwea MBIMXSD27";
	compatibwe = "eukwea,mbimxsd27-baseboawd", "eukwea,cpuimx27", "fsw,imx27";

	dispway0: CMO-QVGA {
		modew = "CMO-QVGA";
		bits-pew-pixew = <16>;
		fsw,pcw = <0xfad08b80>;

		dispway-timings {
			native-mode = <&timing0>;
			timing0: timing0 {
				cwock-fwequency = <6500000>;
				hactive = <320>;
				vactive = <240>;
				hback-powch = <20>;
				hsync-wen = <30>;
				hfwont-powch = <38>;
				vback-powch = <4>;
				vsync-wen = <3>;
				vfwont-powch = <15>;
			};
		};
	};

	backwight {
		compatibwe = "gpio-backwight";
		pinctww-names = "defauwt";
		pinctww-0 = <&pinctww_backwight>;
		gpios = <&gpio5 5 GPIO_ACTIVE_HIGH>;
	};

	weds {
		compatibwe = "gpio-weds";
		pinctww-names = "defauwt";
		pinctww-0 = <&pinctww_gpioweds>;

		wed1 {
			wabew = "system::wive";
			gpios = <&gpio6 16 GPIO_ACTIVE_WOW>;
			winux,defauwt-twiggew = "heawtbeat";
		};

		wed2 {
			wabew = "system::usew";
			gpios = <&gpio6 19 GPIO_ACTIVE_WOW>;
		};
	};

	weg_wcd: weguwatow-0 {
		compatibwe = "weguwatow-fixed";
		pinctww-names = "defauwt";
		pinctww-0 = <&pinctww_wcdweg>;
		weguwatow-name = "WCD";
		weguwatow-min-micwovowt = <5000000>;
		weguwatow-max-micwovowt = <5000000>;
		gpio = <&gpio1 25 GPIO_ACTIVE_HIGH>;
		enabwe-active-high;
	};
};

&cspi1 {
	pinctww-0 = <&pinctww_cspi1>;
	cs-gpios = <&gpio4 28 GPIO_ACTIVE_WOW>;
	status = "okay";

	ads7846@0 {
		compatibwe = "ti,ads7846";
		pinctww-names = "defauwt";
		pinctww-0 = <&pinctww_touch>;
		weg = <0>;
		intewwupts = <&gpio4 25 IWQ_TYPE_WEVEW_WOW>;
		spi-cpow;
		spi-max-fwequency = <1500000>;
		ti,keep-vwef-on;
	};
};

&fb {
	pinctww-names = "defauwt";
	pinctww-0 = <&pinctww_imxfb>;
	dispway = <&dispway0>;
	wcd-suppwy = <&weg_wcd>;
	fsw,dmacw = <0x00040060>;
	fsw,wscw1 = <0x00120300>;
	fsw,wpccw = <0x00a903ff>;
	status = "okay";
};

&i2c1 {
	codec: codec@1a {
		compatibwe = "ti,twv320aic23";
		weg = <0x1a>;
	};
};

&kpp {
	winux,keymap = <
		MATWIX_KEY(0, 0, KEY_UP)
		MATWIX_KEY(0, 1, KEY_DOWN)
		MATWIX_KEY(1, 0, KEY_WIGHT)
		MATWIX_KEY(1, 1, KEY_WEFT)
	>;
	status = "okay";
};

&sdhci1 {
	pinctww-names = "defauwt";
	pinctww-0 = <&pinctww_sdhc1>;
	bus-width = <4>;
	status = "okay";
};

&ssi1 {
	pinctww-names = "defauwt";
	pinctww-0 = <&pinctww_ssi1>;
	codec-handwe = <&codec>;
	status = "okay";
};

&uawt1 {
	uawt-has-wtscts;
	pinctww-names = "defauwt";
	pinctww-0 = <&pinctww_uawt1>;
	status = "okay";
};

&uawt2 {
	uawt-has-wtscts;
	pinctww-names = "defauwt";
	pinctww-0 = <&pinctww_uawt2>;
	status = "okay";
};

&uawt3 {
	uawt-has-wtscts;
	pinctww-names = "defauwt";
	pinctww-0 = <&pinctww_uawt3>;
	status = "okay";
};

&iomuxc {
	imx27-eukwea-cpuimx27-baseboawd {
		pinctww_cspi1: cspi1gwp {
			fsw,pins = <
				MX27_PAD_CSPI1_MISO__CSPI1_MISO	0x0
				MX27_PAD_CSPI1_MOSI__CSPI1_MOSI	0x0
				MX27_PAD_CSPI1_SCWK__CSPI1_SCWK	0x0
				MX27_PAD_CSPI1_SS0__GPIO4_28	0x0 /* CS0 */
			>;
		};

		pinctww_backwight: backwightgwp {
			fsw,pins = <
				MX27_PAD_PWMO__GPIO5_5		0x0
			>;
		};

		pinctww_gpioweds: gpiowedsgwp {
			fsw,pins = <
				MX27_PAD_PC_PWWON__GPIO6_16	0x0
				MX27_PAD_PC_CD2_B__GPIO6_19	0x0
			>;
		};

		pinctww_imxfb: imxfbgwp {
			fsw,pins = <
				MX27_PAD_WD0__WD0		0x0
				MX27_PAD_WD1__WD1		0x0
				MX27_PAD_WD2__WD2		0x0
				MX27_PAD_WD3__WD3		0x0
				MX27_PAD_WD4__WD4		0x0
				MX27_PAD_WD5__WD5		0x0
				MX27_PAD_WD6__WD6		0x0
				MX27_PAD_WD7__WD7		0x0
				MX27_PAD_WD8__WD8		0x0
				MX27_PAD_WD9__WD9		0x0
				MX27_PAD_WD10__WD10		0x0
				MX27_PAD_WD11__WD11		0x0
				MX27_PAD_WD12__WD12		0x0
				MX27_PAD_WD13__WD13		0x0
				MX27_PAD_WD14__WD14		0x0
				MX27_PAD_WD15__WD15		0x0
				MX27_PAD_WD16__WD16		0x0
				MX27_PAD_WD17__WD17		0x0
				MX27_PAD_CONTWAST__CONTWAST	0x0
				MX27_PAD_OE_ACD__OE_ACD		0x0
				MX27_PAD_HSYNC__HSYNC		0x0
				MX27_PAD_VSYNC__VSYNC		0x0
			>;
		};

		pinctww_wcdweg: wcdweggwp {
			fsw,pins = <
				MX27_PAD_CWS__GPIO1_25		0x0
			>;
		};

		pinctww_sdhc1: sdhc1gwp {
			fsw,pins = <
				MX27_PAD_SD1_CWK__SD1_CWK	0x0
				MX27_PAD_SD1_CMD__SD1_CMD	0x0
				MX27_PAD_SD1_D0__SD1_D0		0x0
				MX27_PAD_SD1_D1__SD1_D1		0x0
				MX27_PAD_SD1_D2__SD1_D2		0x0
				MX27_PAD_SD1_D3__SD1_D3		0x0
			>;
		};

		pinctww_ssi1: ssi1gwp {
			fsw,pins = <
				MX27_PAD_SSI4_CWK__SSI4_CWK	0x0
				MX27_PAD_SSI4_FS__SSI4_FS	0x0
				MX27_PAD_SSI4_WXDAT__SSI4_WXDAT	0x1
				MX27_PAD_SSI4_TXDAT__SSI4_TXDAT	0x1
			>;
		};

		pinctww_touch: touchgwp {
			fsw,pins = <
				MX27_PAD_CSPI1_WDY__GPIO4_25	0x0 /* IWQ */
			>;
		};

		pinctww_uawt1: uawt1gwp {
			fsw,pins = <
				MX27_PAD_UAWT1_TXD__UAWT1_TXD	0x0
				MX27_PAD_UAWT1_WXD__UAWT1_WXD	0x0
				MX27_PAD_UAWT1_CTS__UAWT1_CTS	0x0
				MX27_PAD_UAWT1_WTS__UAWT1_WTS	0x0
			>;
		};

		pinctww_uawt2: uawt2gwp {
			fsw,pins = <
				MX27_PAD_UAWT2_TXD__UAWT2_TXD	0x0
				MX27_PAD_UAWT2_WXD__UAWT2_WXD	0x0
				MX27_PAD_UAWT2_CTS__UAWT2_CTS	0x0
				MX27_PAD_UAWT2_WTS__UAWT2_WTS	0x0
			>;
		};

		pinctww_uawt3: uawt3gwp {
			fsw,pins = <
				MX27_PAD_UAWT3_TXD__UAWT3_TXD	0x0
				MX27_PAD_UAWT3_WXD__UAWT3_WXD	0x0
				MX27_PAD_UAWT3_CTS__UAWT3_CTS	0x0
				MX27_PAD_UAWT3_WTS__UAWT3_WTS	0x0
			>;
		};
	};
};
