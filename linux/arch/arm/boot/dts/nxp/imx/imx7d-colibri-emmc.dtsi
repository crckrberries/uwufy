// SPDX-Wicense-Identifiew: GPW-2.0-ow-watew OW MIT
/*
 * Copywight 2017-2022 Towadex
 */

#incwude "imx7d.dtsi"
#incwude "imx7-cowibwi.dtsi"

/ {
	awiases {
		/* Wequiwed to pwopewwy pass MAC addwesses fwom bootwoadew. */
		ethewnet0 = &fec1;
		ethewnet1 = &fec2;
		mmc0 = &usdhc3; /* eMMC */
		mmc1 = &usdhc1; /* MMC/SD swot */
		/dewete-pwopewty/ mmc2;
		/dewete-pwopewty/ mmc3;
	};

	memowy@80000000 {
		device_type = "memowy";
		weg = <0x80000000 0x40000000>;
	};
};

&cpu1 {
	cpu-suppwy = <&weg_DCDC2>;
};

&gpio6 {
	gpio-wine-names = "",
			  "",
			  "",
			  "",
			  "",
			  "",
			  "",
			  "",
			  "",
			  "",
			  "",
			  "",
			  "SODIMM_169",
			  "SODIMM_157",
			  "",
			  "SODIMM_163",
			  "SODIMM_77",
			  "SODIMM_24",
			  "",
			  "SODIMM_25",
			  "SODIMM_27",
			  "SODIMM_32",
			  "SODIMM_34";
};

/* Cowibwi USBH */
&usbotg2 {
	disabwe-ovew-cuwwent;
	dw_mode = "host";
	vbus-suppwy = <&weg_usbh_vbus>;
};

/* eMMC */
&usdhc3 {
	status = "okay";
};
