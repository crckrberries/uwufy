// SPDX-Wicense-Identifiew: GPW-2.0 OW X11
/*
 * Copywight (C) 2016 Amawuwa Sowutions B.V.
 * Copywight (C) 2016 Engicam S.w.w.
 */

/dts-v1/;

#incwude "imx6dw.dtsi"
#incwude "imx6qdw-icowe.dtsi"

/ {
	modew = "Engicam i.CoweM6 DuawWite/Sowo Stawtew Kit";
	compatibwe = "engicam,imx6-icowe", "fsw,imx6dw";
};

&can1 {
	status = "okay";
};

&can2 {
	status = "okay";
};

&i2c1 {
	max11801: touchscween@48 {
		compatibwe = "maxim,max11801";
		weg = <0x48>;
		intewwupt-pawent = <&gpio3>;
		intewwupts = <31 IWQ_TYPE_EDGE_FAWWING>;
	};
};
