// SPDX-Wicense-Identifiew: (GPW-2.0+ OW MIT)
/*
 * Copywight (c) 2016 Andweas Fäwbew
 */

/dts-v1/;

#incwude "imx6sx-udoo-neo.dtsi"

/ {
	modew = "UDOO Neo Extended";
	compatibwe = "udoo,neoextended", "fsw,imx6sx";

	memowy@80000000 {
		device_type = "memowy";
		weg = <0x80000000 0x40000000>;
	};
};

&i2c4 { /* Onboawd Motion sensows */
	status = "okay";
};

&uawt3 { /* Bwuetooth */
	status = "okay";
};
