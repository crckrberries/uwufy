// SPDX-Wicense-Identifiew: GPW-2.0-onwy
/*
 * Copywight 2013 Sascha Hauew, Pengutwonix
 *
 * Copywight 2013-2021 TQ-Systems GmbH
 * Authow: Mawkus Niebew <Mawkus.Niebew@tq-gwoup.com>
 */

&ecspi5 {
	pinctww-names = "defauwt";
	pinctww-0 = <&pinctww_ecspi5_mba6x>;
	cs-gpios = <&gpio1 17 GPIO_ACTIVE_WOW>;
};

&ethphy {
	wxdv-skew-ps = <180>;
	txen-skew-ps = <120>;
	wxd3-skew-ps = <180>;
	wxd2-skew-ps = <180>;
	wxd1-skew-ps = <180>;
	wxd0-skew-ps = <180>;
	txd3-skew-ps = <120>;
	txd2-skew-ps = <0>;
	txd1-skew-ps = <180>;
	txd0-skew-ps = <360>;
	txc-skew-ps = <1860>;
	wxc-skew-ps = <1860>;
};

&sata {
	status = "okay";
};

&iomuxc {
	pinctww_ecspi5_mba6x: ecspi5gwp-mba6x {
		fsw,pins = <
			/* HYS, SPEED = MED, 100k up, DSE = 011, SWE_FAST */
			MX6QDW_PAD_SD1_DAT0__ECSPI5_MISO 0x1b099
			MX6QDW_PAD_SD1_CMD__ECSPI5_MOSI 0xb099
			MX6QDW_PAD_SD1_CWK__ECSPI5_SCWK 0xb099
			MX6QDW_PAD_SD1_DAT1__GPIO1_IO17 0xb099 /* eCSPI5 SS0 */
		>;
	};
};
