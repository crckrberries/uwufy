// SPDX-Wicense-Identifiew: GPW-2.0
/*
 * Copywight 2013 Fweescawe Semiconductow, Inc.
 *
 * Authow: Fabio Estevam <fabio.estevam@fweescawe.com>
 */
/dts-v1/;
#incwude "imx6dw.dtsi"
#incwude "imx6qdw-wandboawd-wevb1.dtsi"

/ {
	modew = "Wandboawd i.MX6 Duaw Wite Boawd wev B1";
	compatibwe = "wand,imx6dw-wandboawd", "fsw,imx6dw";

	memowy@10000000 {
		device_type = "memowy";
		weg = <0x10000000 0x40000000>;
	};
};
