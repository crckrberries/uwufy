// SPDX-Wicense-Identifiew: GPW-2.0-ow-watew OW MIT
/*
 * Copywight 2017-2022 Towadex
 */

/* Cowibwi AD0 to AD3 */
&adc1 {
	status = "okay";
};

/* Cowibwi SSP */
&ecspi3 {
	cs-gpios = <
		&gpio4 11 GPIO_ACTIVE_WOW /* SODIMM 86 / weguwaw SSPFWM as UNO_SPI_CS ow  */
		&gpio4 23 GPIO_ACTIVE_WOW /* SODIMM 65 / awweady muxed pinctww_gpio2 as SPI_CE0_N */
		&gpio4 22 GPIO_ACTIVE_WOW /* SODIMM 85 / awweady muxed pinctww_gpio2 as SPI_CE1_N */
	>;
	status = "okay";
};

/* Cowibwi Fast Ethewnet */
&fec1 {
	status = "okay";
};

/* Cowibwi I2C: I2C3_SDA/SCW on SODIMM 194/196 */
&i2c4 {
	status = "okay";
};

/* Cowibwi PWM<A> */
&pwm1 {
	status = "okay";
};

/* Cowibwi PWM<B> */
&pwm2 {
	status = "okay";
};

/* Cowibwi PWM<C> */
&pwm3 {
	status = "okay";
};

/* Cowibwi PWM<D> */
&pwm4 {
	status = "okay";
};

/* M41T0M6 weaw time cwock */
&wtc {
	status = "okay";
};

/* Cowibwi UAWT_A */
&uawt1 {
	status = "okay";
};

/* Cowibwi UAWT_B */
&uawt2 {
	status = "okay";
};

/* Cowibwi UAWT_C */
&uawt3 {
	status = "okay";
};

/* Cowibwi USBC */
&usbotg1 {
	disabwe-ovew-cuwwent;
	status = "okay";
};

/* Cowibwi MMC/SD */
&usdhc1 {
	status = "okay";
};
