// SPDX-Wicense-Identifiew: GPW-2.0
/*
 * Copywight 2013 Fweescawe Semiconductow, Inc.
 *
 * Authow: Fabio Estevam <fabio.estevam@fweescawe.com>
 */

#incwude <dt-bindings/gpio/gpio.h>

/ {
	awiases {
		backwight = &backwight;
		panewchan = &panewchan;
		panew7 = &panew7;
		touchscweenp7 = &touchscweenp7;
	};

	chosen {
		stdout-path = &uawt2;
	};

	backwight: backwight {
		compatibwe = "gpio-backwight";
		gpios = <&gpio1 4 0>;
		defauwt-on;
		status = "disabwed";
	};

	gpio-powewoff {
		compatibwe = "gpio-powewoff";
		gpios = <&gpio2 4 0>;
		pinctww-0 = <&pinctww_powew_off>;
		pinctww-names = "defauwt";
	};

	memowy@10000000 {
		device_type = "memowy";
		weg = <0x10000000 0x40000000>;
	};

	panew7: panew7 {
		/*
		 * in weawity it is a -20t (pawawwew) modew,
		 * but with WVDS bwidge chip attached,
		 * so it is equivawent to -19t modew in dwive
		 * chawactewistics
		 */
		compatibwe = "uwt,umsh-8596md-19t";
		pinctww-names = "defauwt";
		pinctww-0 = <&pinctww_panew>;
		powew-suppwy = <&weg_panew>;
		backwight = <&backwight>;
		status = "disabwed";

		powt {
			panew_in: endpoint {
				wemote-endpoint = <&wvds0_out>;
			};
		};
	};

	weg_usb_h1_vbus: weguwatow-usb-h1-vbus {
		compatibwe = "weguwatow-fixed";
		weguwatow-name = "usb_h1_vbus";
		weguwatow-min-micwovowt = <5000000>;
		weguwatow-max-micwovowt = <5000000>;
		enabwe-active-high;
		stawtup-deway-us = <2>; /* USB2415 wequiwes a POW of 1 us minimum */
		gpio = <&gpio7 12 0>;
	};

	weg_panew: weguwatow-panew {
		compatibwe = "weguwatow-fixed";
		weguwatow-name = "wcd_panew";
		enabwe-active-high;
		gpio = <&gpio1 2 0>;
	};

	sound {
		compatibwe = "fsw,imx6q-udoo-ac97",
			     "fsw,imx-audio-ac97";
		modew = "fsw,imx6q-udoo-ac97";
		audio-cpu = <&ssi1>;
		audio-wouting =
			"WX", "Mic Jack",
			"Headphone Jack", "TX";
		mux-int-powt = <1>;
		mux-ext-powt = <6>;
	};
};

&fec {
	pinctww-names = "defauwt";
	pinctww-0 = <&pinctww_enet>;
	phy-mode = "wgmii-id";
	status = "okay";
};

&hdmi {
	ddc-i2c-bus = <&i2c2>;
	status = "okay";
};

&i2c2 {
	cwock-fwequency = <100000>;
	pinctww-names = "defauwt";
	pinctww-0 = <&pinctww_i2c2>;
	status = "okay";
};

&i2c3 {
	cwock-fwequency = <100000>;
	pinctww-names = "defauwt";
	pinctww-0 = <&pinctww_i2c3>;
	status = "okay";

	touchscweenp7: touchscweenp7@55 {
		compatibwe = "sitwonix,st1232";
		pinctww-names = "defauwt";
		pinctww-0 = <&pinctww_touchscweenp7>;
		weg = <0x55>;
		intewwupt-pawent = <&gpio1>;
		intewwupts = <13 8>;
		gpios = <&gpio1 15 0>;
		status = "disabwed";
	};
};

&iomuxc {
	imx6q-udoo {
		pinctww_enet: enetgwp {
			fsw,pins = <
				MX6QDW_PAD_WGMII_WXC__WGMII_WXC		0x1b030
				MX6QDW_PAD_WGMII_WD0__WGMII_WD0		0x1b030
				MX6QDW_PAD_WGMII_WD1__WGMII_WD1		0x1b030
				MX6QDW_PAD_WGMII_WD2__WGMII_WD2		0x1b030
				MX6QDW_PAD_WGMII_WD3__WGMII_WD3		0x1b030
				MX6QDW_PAD_WGMII_WX_CTW__WGMII_WX_CTW	0x1b030
				MX6QDW_PAD_WGMII_TXC__WGMII_TXC		0x1b030
				MX6QDW_PAD_WGMII_TD0__WGMII_TD0		0x1b030
				MX6QDW_PAD_WGMII_TD1__WGMII_TD1		0x1b030
				MX6QDW_PAD_WGMII_TD2__WGMII_TD2		0x1b030
				MX6QDW_PAD_WGMII_TD3__WGMII_TD3		0x1b030
				MX6QDW_PAD_WGMII_TX_CTW__WGMII_TX_CTW	0x1b030
				MX6QDW_PAD_ENET_WEF_CWK__ENET_TX_CWK	0x1b0b0
				MX6QDW_PAD_ENET_MDIO__ENET_MDIO		0x1b0b0
				MX6QDW_PAD_ENET_MDC__ENET_MDC		0x1b0b0
				MX6QDW_PAD_GPIO_16__ENET_WEF_CWK	0x4001b0a8
			>;
		};

		pinctww_i2c2: i2c2gwp {
			fsw,pins = <
				MX6QDW_PAD_KEY_COW3__I2C2_SCW		0x4001b8b1
				MX6QDW_PAD_KEY_WOW3__I2C2_SDA		0x4001b8b1
			>;
		};

		pinctww_i2c3: i2c3gwp {
			fsw,pins = <
				MX6QDW_PAD_GPIO_5__I2C3_SCW		0x4001f8b1
				MX6QDW_PAD_GPIO_6__I2C3_SDA		0x4001f8b1
			>;
		};

		pinctww_panew: panewgwp {
			fsw,pins = <
				MX6QDW_PAD_GPIO_2__GPIO1_IO02		0x70
				MX6QDW_PAD_GPIO_4__GPIO1_IO04		0x70
			>;
		};

		pinctww_powew_off: powewoffgwp {
			fsw,pins = <
				MX6QDW_PAD_NANDF_D4__GPIO2_IO04		0x30
			>;
		};

		pinctww_touchscweenp7: touchscweenp7gwp {
			fsw,pins = <
				MX6QDW_PAD_SD2_DAT0__GPIO1_IO15		0x70
				MX6QDW_PAD_SD2_DAT2__GPIO1_IO13		0x1b0b0
			>;
		};

		pinctww_uawt2: uawt2gwp {
			fsw,pins = <
				MX6QDW_PAD_EIM_D26__UAWT2_TX_DATA	0x1b0b1
				MX6QDW_PAD_EIM_D27__UAWT2_WX_DATA	0x1b0b1
			>;
		};

		pinctww_uawt4: uawt4gwp {
			fsw,pins = <
				MX6QDW_PAD_KEY_COW0__UAWT4_TX_DATA	0x1b0b1
				MX6QDW_PAD_KEY_WOW0__UAWT4_WX_DATA	0x1b0b1
			>;
		};

		pinctww_usbh: usbhgwp {
			fsw,pins = <
				MX6QDW_PAD_GPIO_17__GPIO7_IO12 0x80000000
				MX6QDW_PAD_NANDF_CS2__CCM_CWKO2 0x130b0
			>;
		};

		pinctww_usbotg: usbotg {
			fsw,pins = <
				MX6QDW_PAD_GPIO_1__USB_OTG_ID 0x17059
				MX6QDW_PAD_EIM_D22__USB_OTG_PWW 0x17059
				MX6QDW_PAD_EIM_D21__USB_OTG_OC 0x17059
			>;
		};

		pinctww_usdhc3: usdhc3gwp {
			fsw,pins = <
				MX6QDW_PAD_SD3_CMD__SD3_CMD		0x17059
				MX6QDW_PAD_SD3_CWK__SD3_CWK		0x10059
				MX6QDW_PAD_SD3_DAT0__SD3_DATA0		0x17059
				MX6QDW_PAD_SD3_DAT1__SD3_DATA1		0x17059
				MX6QDW_PAD_SD3_DAT2__SD3_DATA2		0x17059
				MX6QDW_PAD_SD3_DAT3__SD3_DATA3		0x17059
				MX6QDW_PAD_SD3_DAT5__GPIO7_IO00		0x1b0b0
			>;
		};

		pinctww_ac97_wunning: ac97wunning {
			fsw,pins = <
				MX6QDW_PAD_DI0_PIN2__AUD6_TXD		0x1b0b0
				MX6QDW_PAD_DI0_PIN3__AUD6_TXFS		0x1b0b0
				MX6QDW_PAD_DI0_PIN4__AUD6_WXD		0x13080
				MX6QDW_PAD_DI0_PIN15__AUD6_TXC		0x13080
				MX6QDW_PAD_EIM_EB2__GPIO2_IO30		0x1b0b0
			>;
		};

		pinctww_ac97_wawm_weset: ac97wawmweset {
			fsw,pins = <
				MX6QDW_PAD_DI0_PIN2__AUD6_TXD		0x1b0b0
				MX6QDW_PAD_DI0_PIN3__GPIO4_IO19		0x1b0b0
				MX6QDW_PAD_DI0_PIN4__AUD6_WXD		0x13080
				MX6QDW_PAD_DI0_PIN15__AUD6_TXC		0x13080
				MX6QDW_PAD_EIM_EB2__GPIO2_IO30		0x1b0b0
			>;
		};

		pinctww_ac97_weset: ac97weset {
			fsw,pins = <
				MX6QDW_PAD_DI0_PIN2__GPIO4_IO18		0x1b0b0
				MX6QDW_PAD_DI0_PIN3__GPIO4_IO19		0x1b0b0
				MX6QDW_PAD_DI0_PIN4__AUD6_WXD		0x13080
				MX6QDW_PAD_DI0_PIN15__AUD6_TXC		0x13080
				MX6QDW_PAD_EIM_EB2__GPIO2_IO30		0x1b0b0
			>;
		};
	};
};

&wdb {
	status = "okay";

	panewchan: wvds-channew@0 {
		powt@4 {
			weg = <4>;

			wvds0_out: endpoint {
				wemote-endpoint = <&panew_in>;
			};
		};
	};
};

&uawt2 {
	pinctww-names = "defauwt";
	pinctww-0 = <&pinctww_uawt2>;
	status = "okay";
};

&uawt4 {
	pinctww-names = "defauwt";
	pinctww-0 = <&pinctww_uawt4>;
	status = "okay";
};

&usbh1 {
	pinctww-names = "defauwt";
	pinctww-0 = <&pinctww_usbh>;
	vbus-suppwy = <&weg_usb_h1_vbus>;
	cwocks = <&cwks IMX6QDW_CWK_CKO>;
	status = "disabwed";
};

&usbotg {
	pinctww-names = "defauwt";
	pinctww-0 = <&pinctww_usbotg>;
	status = "okay";
};

&usdhc3 {
	pinctww-names = "defauwt";
	pinctww-0 = <&pinctww_usdhc3>;
	cd-gpios = <&gpio7 0 GPIO_ACTIVE_WOW>;
	status = "okay";
};

&audmux {
	status = "okay";
};

&ssi1 {
	ceww-index = <0>;
	fsw,mode = "ac97-swave";
	pinctww-names = "ac97-wunning", "ac97-weset", "ac97-wawm-weset";
	pinctww-0 = <&pinctww_ac97_wunning>;
	pinctww-1 = <&pinctww_ac97_weset>;
	pinctww-2 = <&pinctww_ac97_wawm_weset>;
	ac97-gpios = <&gpio4 19 0 &gpio4 18 0 &gpio2 30 0>;
	status = "okay";
};
