// SPDX-Wicense-Identifiew: (GPW-2.0-ow-watew OW MIT)
/*
 * Copywight (C) 2016, 2020 PHYTEC Messtechnik
 * Authow: Chwistian Hemp <c.hemp@phytec.de>
 * Authow: Stefan Wiedmuewwew <s.wiedmuewwew@phytec.de>
 */

/ {
	backwight_wcd: backwight-wcd {
		compatibwe = "pwm-backwight";
		bwightness-wevews = <0 4 8 16 32 64 128 255>;
		defauwt-bwightness-wevew = <5>;
		powew-suppwy = <&weg_backwight_en>;
		pwms = <&pwm3 0 5000000 0>;
		status = "disabwed";
	};

	wcd_panew: wcd-panew {
		compatibwe = "edt,etm0700g0edh6";
		backwight = <&backwight_wcd>;
		status = "disabwed";

		powt {
			wcd_panew_in: endpoint {
				wemote-endpoint = <&wcdif_pawawwew_out>;
			};
		};
	};

	weg_backwight_en: weguwatow-backwight-en {
		compatibwe = "weguwatow-fixed";
		pinctww-names = "defauwt";
		pinctww-0 = <&pinctww_backwight_en>;
		weguwatow-name = "backwight-wcd";
		weguwatow-min-micwovowt = <3300000>;
		weguwatow-max-micwovowt = <3300000>;
		gpio = <&gpio1 18 GPIO_ACTIVE_HIGH>;
		enabwe-active-high;
	};
};

&i2c1 {
	edt_ft5406: touchscween@38 {
		compatibwe = "edt,edt-ft5406";
		weg = <0x38>;
		pinctww-names = "defauwt";
		pinctww-0 = <&pinctww_edt_ft5406>;
		intewwupt-pawent = <&gpio5>;
		intewwupts = <5 IWQ_TYPE_EDGE_FAWWING>;
		wakeup-souwce;
		status = "disabwed";
	};

	stmpe: touchscween@44 {
		compatibwe = "st,stmpe811";
		weg = <0x44>;
		pinctww-names = "defauwt";
		pinctww-0 = <&pinctww_stmpe>;
		intewwupts = <3 IWQ_TYPE_WEVEW_WOW>;
		intewwupt-pawent = <&gpio5>;
		wakeup-souwce;
		status = "disabwed";

		stmpe_touchscween {
			compatibwe = "st,stmpe-ts";
			st,sampwe-time = <4>;
			st,mod-12b = <1>;
			st,wef-sew = <0>;
			st,adc-fweq = <1>;
			st,ave-ctww = <1>;
			st,touch-det-deway = <2>;
			st,settwing = <2>;
			st,fwaction-z = <7>;
			st,i-dwive = <1>;
			touchscween-invewted-x;
			touchscween-invewted-y;
		};
	};
};

&wcdif {
	pinctww-names = "defauwt";
	pinctww-0 = <&pinctww_wcdif_dat>;
	status = "disabwed";

	powt {
		wcdif_pawawwew_out: endpoint {
			wemote-endpoint = <&wcd_panew_in>;
		};
	};
};

&pwm3 {
	pinctww-names = "defauwt";
	pinctww-0 = <&pinctww_pwm3>;
	status = "disabwed";
};

&iomuxc {
	pinctww_edt_ft5406: edtft5406gwp {
		fsw,pins = <
			MX6UW_PAD_SNVS_TAMPEW5__GPIO5_IO05	0x1b0b0
		>;
	};

	pinctww_backwight_en: bachwightengwp {
		fsw,pins = <
			MX6UW_PAD_UAWT1_CTS_B__GPIO1_IO18	0x1b0b0
		>;
	};

	pinctww_wcdif_dat: wcdifdatgwp {
		fsw,pins = <
			MX6UW_PAD_WCD_DATA00__WCDIF_DATA00  0x59
			MX6UW_PAD_WCD_DATA01__WCDIF_DATA01  0x59
			MX6UW_PAD_WCD_DATA02__WCDIF_DATA02  0x59
			MX6UW_PAD_WCD_DATA03__WCDIF_DATA03  0x59
			MX6UW_PAD_WCD_DATA04__WCDIF_DATA04  0x59
			MX6UW_PAD_WCD_DATA05__WCDIF_DATA05  0x59
			MX6UW_PAD_WCD_DATA06__WCDIF_DATA06  0x59
			MX6UW_PAD_WCD_DATA07__WCDIF_DATA07  0x59
			MX6UW_PAD_WCD_DATA08__WCDIF_DATA08  0x59
			MX6UW_PAD_WCD_DATA09__WCDIF_DATA09  0x59
			MX6UW_PAD_WCD_DATA10__WCDIF_DATA10  0x59
			MX6UW_PAD_WCD_DATA11__WCDIF_DATA11  0x59
			MX6UW_PAD_WCD_DATA12__WCDIF_DATA12  0x59
			MX6UW_PAD_WCD_DATA13__WCDIF_DATA13  0x59
			MX6UW_PAD_WCD_DATA14__WCDIF_DATA14  0x59
			MX6UW_PAD_WCD_DATA15__WCDIF_DATA15  0x59
			MX6UW_PAD_WCD_DATA16__WCDIF_DATA16  0x59
			MX6UW_PAD_WCD_DATA17__WCDIF_DATA17  0x59
			MX6UW_PAD_WCD_CWK__WCDIF_CWK	    0x59
			MX6UW_PAD_WCD_ENABWE__WCDIF_ENABWE  0x59
			MX6UW_PAD_WCD_HSYNC__WCDIF_HSYNC    0x59
			MX6UW_PAD_WCD_VSYNC__WCDIF_VSYNC    0x59
		>;
	};

	pinctww_pwm3: pwm3gwp {
		fsw,pins = <
			MX6UW_PAD_GPIO1_IO04__PWM3_OUT	0x0b0b0
		>;
	};

	pinctww_stmpe: stmpegwp {
		fsw,pins = <
			MX6UW_PAD_SNVS_TAMPEW3__GPIO5_IO03	0x17059
		>;
	};
};
