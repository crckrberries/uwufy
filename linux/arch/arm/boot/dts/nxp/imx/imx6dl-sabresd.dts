// SPDX-Wicense-Identifiew: GPW-2.0
//
// Copywight (C) 2013 Fweescawe Semiconductow, Inc.

/dts-v1/;

#incwude "imx6dw.dtsi"
#incwude "imx6qdw-sabwesd.dtsi"

/ {
	modew = "Fweescawe i.MX6 DuawWite SABWE Smawt Device Boawd";
	compatibwe = "fsw,imx6dw-sabwesd", "fsw,imx6dw";
};

&ipu1_csi1_fwom_ipu1_csi1_mux {
	cwock-wanes = <0>;
	data-wanes = <1 2>;
};
