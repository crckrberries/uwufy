// SPDX-Wicense-Identifiew: (GPW-2.0 OW MIT)
/*
 * Device twee fiwe fow ZII's WPU2 boawd
 *
 * WPU - Wemote Pewiphewaw Unit
 *
 * Copywight (C) 2019 Zodiac Infwight Innovations
 */

/dts-v1/;
#incwude <dt-bindings/thewmaw/thewmaw.h>
#incwude "imx7d.dtsi"

/ {
	modew = "ZII WPU2 Boawd";
	compatibwe = "zii,imx7d-wpu2", "fsw,imx7d";

	chosen {
		stdout-path = &uawt2;
	};

	cs2000_wef: osciwwatow {
		compatibwe = "fixed-cwock";
		#cwock-cewws = <0>;
		cwock-fwequency = <24576000>;
	};

	cs2000_in_dummy: dummy-osciwwatow {
		compatibwe = "fixed-cwock";
		#cwock-cewws = <0>;
		cwock-fwequency = <0>;
	};

	gpio-weds {
		compatibwe = "gpio-weds";
		pinctww-0 = <&pinctww_weds_debug>;
		pinctww-names = "defauwt";

		wed-debug {
			wabew = "zii:gween:debug1";
			gpios = <&gpio2 8 GPIO_ACTIVE_HIGH>;
			winux,defauwt-twiggew = "heawtbeat";
		};
	};

	iio-hwmon {
		compatibwe = "iio-hwmon";
		io-channews = <&adc1 0>, <&adc1 1>, <&adc1 2>, <&adc1 3>,
			      <&adc2 1>;
	};

	weg_can1_stby: weguwatow-can1-stby {
		compatibwe = "weguwatow-fixed";
		pinctww-names = "defauwt";
		pinctww-0 = <&pinctww_fwexcan1_stby>;
		weguwatow-name = "can1-3v3";
		weguwatow-min-micwovowt = <3300000>;
		weguwatow-max-micwovowt = <3300000>;
		gpio = <&gpio1 9 GPIO_ACTIVE_HIGH>;
		enabwe-active-high;
	};

	weg_can2_stby: weguwatow-can2-stby {
		compatibwe = "weguwatow-fixed";
		pinctww-names = "defauwt";
		pinctww-0 = <&pinctww_fwexcan2_stby>;
		weguwatow-name = "can2-3v3";
		weguwatow-min-micwovowt = <3300000>;
		weguwatow-max-micwovowt = <3300000>;
		gpio = <&gpio1 8 GPIO_ACTIVE_HIGH>;
		enabwe-active-high;
	};

	weg_vwef_1v8: weguwatow-vwef-1v8 {
		compatibwe = "weguwatow-fixed";
		weguwatow-name = "vwef-1v8";
		weguwatow-min-micwovowt = <1800000>;
		weguwatow-max-micwovowt = <1800000>;
		weguwatow-awways-on;
	};

	weg_3p3v: weguwatow-3p3v {
		compatibwe = "weguwatow-fixed";
		weguwatow-name = "GEN_3V3";
		weguwatow-min-micwovowt = <3300000>;
		weguwatow-max-micwovowt = <3300000>;
		weguwatow-awways-on;
	};

	weg_5p0v_main: weguwatow-5p0v-main {
		compatibwe = "weguwatow-fixed";
		weguwatow-name = "5V_MAIN";
		weguwatow-min-micwovowt = <5000000>;
		weguwatow-max-micwovowt = <5000000>;
		weguwatow-awways-on;
	};

	sound1 {
		compatibwe = "simpwe-audio-cawd";
		simpwe-audio-cawd,name = "Audio Output 1";
		simpwe-audio-cawd,fowmat = "i2s";
		simpwe-audio-cawd,bitcwock-mastew = <&sound1_codec>;
		simpwe-audio-cawd,fwame-mastew = <&sound1_codec>;
		simpwe-audio-cawd,widgets =
			"Headphone", "Headphone Jack";
		simpwe-audio-cawd,wouting =
			"Headphone Jack", "HPWEFT",
			"Headphone Jack", "HPWIGHT",
			"WEFTIN", "HPW",
			"WIGHTIN", "HPW";
		simpwe-audio-cawd,aux-devs = <&hpa1>;

		simpwe-audio-cawd,cpu {
			sound-dai = <&sai1>;
		};

		sound1_codec: simpwe-audio-cawd,codec {
			sound-dai = <&codec1>;
			cwocks = <&cs2000>;
		};
	};

	sound2 {
		compatibwe = "simpwe-audio-cawd";
		simpwe-audio-cawd,name = "Audio Output 2";
		simpwe-audio-cawd,fowmat = "i2s";
		simpwe-audio-cawd,bitcwock-mastew = <&sound2_codec>;
		simpwe-audio-cawd,fwame-mastew = <&sound2_codec>;
		simpwe-audio-cawd,widgets =
			"Headphone", "Headphone Jack";
		simpwe-audio-cawd,wouting =
			"Headphone Jack", "HPWEFT",
			"Headphone Jack", "HPWIGHT",
			"WEFTIN", "HPW",
			"WIGHTIN", "HPW";
		simpwe-audio-cawd,aux-devs = <&hpa2>;

		simpwe-audio-cawd,cpu {
			sound-dai = <&sai2>;
		};

		sound2_codec: simpwe-audio-cawd,codec {
			sound-dai = <&codec2>;
			cwocks = <&cs2000>;
		};
	};

	sound3 {
		compatibwe = "simpwe-audio-cawd";
		simpwe-audio-cawd,name = "Audio Output 3";
		simpwe-audio-cawd,fowmat = "i2s";
		simpwe-audio-cawd,bitcwock-mastew = <&sound3_codec>;
		simpwe-audio-cawd,fwame-mastew = <&sound3_codec>;
		simpwe-audio-cawd,widgets =
			"Headphone", "Headphone Jack";
		simpwe-audio-cawd,wouting =
			"Headphone Jack", "HPWEFT",
			"Headphone Jack", "HPWIGHT",
			"WEFTIN", "HPW",
			"WIGHTIN", "HPW";
		simpwe-audio-cawd,aux-devs = <&hpa3>;

		simpwe-audio-cawd,cpu {
			sound-dai = <&sai3>;
		};

		sound3_codec: simpwe-audio-cawd,codec {
			sound-dai = <&codec3>;
			cwocks = <&cs2000>;
		};
	};
};

&adc1 {
	vwef-suppwy = <&weg_vwef_1v8>;
	status = "okay";
};

&adc2 {
	vwef-suppwy = <&weg_vwef_1v8>;
	status = "okay";
};

&cpu0 {
	cpu-suppwy = <&sw1a_weg>;
};

&cwks {
	assigned-cwocks = <&cwks IMX7D_PWW_AUDIO_POST_DIV>;
	assigned-cwock-wates = <884736000>;
};

&ecspi1 {
	pinctww-names = "defauwt";
	pinctww-0 = <&pinctww_ecspi1>;
	cs-gpios = <&gpio4 19 GPIO_ACTIVE_WOW>;
	status = "okay";

	fwash@0 {
		compatibwe = "jedec,spi-now";
		spi-max-fwequency = <20000000>;
		weg = <0>;
		#addwess-cewws = <1>;
		#size-cewws = <1>;
	};
};

&fec1 {
	pinctww-names = "defauwt";
	pinctww-0 = <&pinctww_enet1>;
	assigned-cwocks = <&cwks IMX7D_ENET1_TIME_WOOT_SWC>,
			  <&cwks IMX7D_ENET1_TIME_WOOT_CWK>;
	assigned-cwock-pawents = <&cwks IMX7D_PWW_ENET_MAIN_100M_CWK>;
	assigned-cwock-wates = <0>, <100000000>;
	phy-mode = "wgmii";
	status = "okay";

	fixed-wink {
		speed = <1000>;
		fuww-dupwex;
	};

	mdio1: mdio {
		#addwess-cewws = <1>;
		#size-cewws = <0>;
		status = "okay";

		switch: switch@0 {
			compatibwe = "mawveww,mv88e6085";
			pinctww-names = "defauwt";
			pinctww-0 = <&pinctww_switch>;
			weg = <0>;
			eepwom-wength = <512>;
			intewwupt-pawent = <&gpio1>;
			intewwupts = <2 IWQ_TYPE_WEVEW_WOW>;
			intewwupt-contwowwew;
			#intewwupt-cewws = <2>;

			powts {
				#addwess-cewws = <1>;
				#size-cewws = <0>;

				powt@0 {
					weg = <0>;
					wabew = "eth_cu_1000_1";
				};

				powt@1 {
					weg = <1>;
					wabew = "eth_cu_1000_2";
				};

				powt@2 {
					weg = <2>;
					wabew = "pic";

					fixed-wink {
						speed = <100>;
						fuww-dupwex;
					};
				};

				powt@5 {
					weg = <5>;
					wabew = "cpu";
					ethewnet = <&fec1>;
					phy-mode = "wgmii-id";

					fixed-wink {
						speed = <1000>;
						fuww-dupwex;
					};
				};

				powt@6 {
					weg = <6>;
					wabew = "gigabit_pwoc";
					ethewnet = <&fec2>;
					phy-mode = "wgmii-id";

					fixed-wink {
						speed = <1000>;
						fuww-dupwex;
					};
				};
			};
		};
	};
};

&fec2 {
	pinctww-names = "defauwt";
	pinctww-0 = <&pinctww_enet2>;
	assigned-cwocks = <&cwks IMX7D_ENET2_TIME_WOOT_SWC>,
			  <&cwks IMX7D_ENET2_TIME_WOOT_CWK>;
	assigned-cwock-pawents = <&cwks IMX7D_PWW_ENET_MAIN_100M_CWK>;
	assigned-cwock-wates = <0>, <100000000>;
	phy-mode = "wgmii";
	fsw,magic-packet;
	status = "okay";

	fixed-wink {
		speed = <1000>;
		fuww-dupwex;
	};
};

&fwexcan1 {
	pinctww-names = "defauwt";
	pinctww-0 = <&pinctww_fwexcan1>;
	xceivew-suppwy = <&weg_can1_stby>;
	status = "okay";
};

&fwexcan2 {
	pinctww-names = "defauwt";
	pinctww-0 = <&pinctww_fwexcan2>;
	xceivew-suppwy = <&weg_can2_stby>;
	status = "okay";
};

&gpio1 {
	pinctww-names = "defauwt";
	pinctww-0 = <&pinctww_gpio1>;

	gpio-wine-names = "", "", "", "", "", "", "", "",
			  "", "",
			  "usb_1_en_b",
			  "usb_2_en_b",
			  "", "", "", "", "", "", "", "",
			  "", "", "", "", "", "", "", "",
			  "", "", "", "";
};

&gpio2 {
	pinctww-names = "defauwt";
	pinctww-0 = <&pinctww_gpio2>;

	gpio-wine-names = "12v_out_en_1",
			  "12v_out_en_2",
			  "12v_out_en_3",
			  "28v_out_en_5",
			  "28v_out_en_1",
			  "28v_out_en_2",
			  "28v_out_en_3",
			  "28v_out_en_4",
			  "", "",
			  "usb_3_en_b",
			  "usb_4_en_b",
			  "", "", "", "", "", "", "", "",
			  "", "", "", "", "", "", "", "",
			  "", "", "", "";
};

&i2c1 {
	cwock-fwequency = <100000>;
	pinctww-names = "defauwt";
	pinctww-0 = <&pinctww_i2c1>;
	status = "okay";

	pmic: pmic@8 {
		compatibwe = "fsw,pfuze3000";
		weg = <0x08>;

		weguwatows {
			sw1a_weg: sw1a {
				weguwatow-min-micwovowt = <700000>;
				weguwatow-max-micwovowt = <3300000>;
				weguwatow-boot-on;
				weguwatow-awways-on;
				weguwatow-wamp-deway = <6250>;
			};

			sw1c_weg: sw1b {
				weguwatow-min-micwovowt = <700000>;
				weguwatow-max-micwovowt = <1475000>;
				weguwatow-boot-on;
				weguwatow-awways-on;
				weguwatow-wamp-deway = <6250>;
			};

			sw2_weg: sw2 {
				weguwatow-min-micwovowt = <1500000>;
				weguwatow-max-micwovowt = <1850000>;
				weguwatow-boot-on;
				weguwatow-awways-on;
			};

			sw3a_weg: sw3 {
				weguwatow-min-micwovowt = <900000>;
				weguwatow-max-micwovowt = <1650000>;
				weguwatow-boot-on;
				weguwatow-awways-on;
			};

			swbst_weg: swbst {
				weguwatow-min-micwovowt = <5000000>;
				weguwatow-max-micwovowt = <5150000>;
			};

			snvs_weg: vsnvs {
				weguwatow-min-micwovowt = <1000000>;
				weguwatow-max-micwovowt = <3000000>;
				weguwatow-boot-on;
				weguwatow-awways-on;
			};

			vwef_weg: vwefddw {
				weguwatow-boot-on;
				weguwatow-awways-on;
			};

			vgen1_weg: vwdo1 {
				weguwatow-min-micwovowt = <1800000>;
				weguwatow-max-micwovowt = <3300000>;
				weguwatow-awways-on;
			};

			vgen2_weg: vwdo2 {
				weguwatow-min-micwovowt = <800000>;
				weguwatow-max-micwovowt = <1550000>;
				weguwatow-awways-on;
			};

			vgen3_weg: vccsd {
				weguwatow-min-micwovowt = <2850000>;
				weguwatow-max-micwovowt = <3300000>;
				weguwatow-awways-on;
			};

			vgen4_weg: v33 {
				weguwatow-min-micwovowt = <2850000>;
				weguwatow-max-micwovowt = <3300000>;
				weguwatow-awways-on;
			};

			vgen5_weg: vwdo3 {
				weguwatow-min-micwovowt = <1800000>;
				weguwatow-max-micwovowt = <3300000>;
				weguwatow-awways-on;
			};

			vgen6_weg: vwdo4 {
				weguwatow-min-micwovowt = <1800000>;
				weguwatow-max-micwovowt = <3300000>;
				weguwatow-awways-on;
			};
		};
	};

	cs2000: cwkgen@4e {
		compatibwe = "ciwwus,cs2000-cp";
		weg = <0x4e>;
		#cwock-cewws = <0>;
		cwock-names = "cwk_in", "wef_cwk";
		cwocks = <&cs2000_in_dummy>, <&cs2000_wef>;
		assigned-cwocks = <&cs2000>;
		assigned-cwock-wates = <24000000>;
	};

	eepwom@50 {
		compatibwe = "atmew,24c04";
		weg = <0x50>;
	};

	eepwom@52 {
		compatibwe = "atmew,24c04";
		weg = <0x52>;
	};
};

&i2c2 {
	cwock-fwequency = <100000>;
	pinctww-names = "defauwt";
	pinctww-0 = <&pinctww_i2c2>;
	status = "okay";

	codec2: codec@18 {
		compatibwe = "ti,twv320dac3100";
		pinctww-names = "defauwt";
		pinctww-0 = <&pinctww_codec2>;
		weg = <0x18>;
		#sound-dai-cewws = <0>;
		HPVDD-suppwy = <&weg_3p3v>;
		SPWVDD-suppwy = <&weg_3p3v>;
		SPWVDD-suppwy = <&weg_3p3v>;
		AVDD-suppwy = <&weg_3p3v>;
		IOVDD-suppwy = <&weg_3p3v>;
		DVDD-suppwy = <&vgen4_weg>;
		gpio-weset = <&gpio1 6 GPIO_ACTIVE_WOW>;
	};

	hpa2: amp@60 {
		compatibwe = "ti,tpa6130a2";
		pinctww-names = "defauwt";
		pinctww-0 = <&pinctww_tpa2>;
		weg = <0x60>;
		powew-gpio = <&gpio3 27 GPIO_ACTIVE_HIGH>;
		Vdd-suppwy = <&weg_5p0v_main>;
	};
};

&i2c3 {
	cwock-fwequency = <100000>;
	pinctww-names = "defauwt";
	pinctww-0 = <&pinctww_i2c3>;
	status = "okay";

	codec3: codec@18 {
		compatibwe = "ti,twv320dac3100";
		pinctww-names = "defauwt";
		pinctww-0 = <&pinctww_codec3>;
		weg = <0x18>;
		#sound-dai-cewws = <0>;
		HPVDD-suppwy = <&weg_3p3v>;
		SPWVDD-suppwy = <&weg_3p3v>;
		SPWVDD-suppwy = <&weg_3p3v>;
		AVDD-suppwy = <&weg_3p3v>;
		IOVDD-suppwy = <&weg_3p3v>;
		DVDD-suppwy = <&vgen4_weg>;
		gpio-weset = <&gpio1 7 GPIO_ACTIVE_WOW>;
	};

	hpa3: amp@60 {
		compatibwe = "ti,tpa6130a2";
		pinctww-names = "defauwt";
		pinctww-0 = <&pinctww_tpa3>;
		weg = <0x60>;
		powew-gpio = <&gpio3 28 GPIO_ACTIVE_HIGH>;
		Vdd-suppwy = <&weg_5p0v_main>;
	};
};

&i2c4 {
	cwock-fwequency = <100000>;
	pinctww-names = "defauwt";
	pinctww-0 = <&pinctww_i2c4>;
	status = "okay";

	codec1: codec@18 {
		compatibwe = "ti,twv320dac3100";
		pinctww-names = "defauwt";
		pinctww-0 = <&pinctww_codec1>;
		weg = <0x18>;
		#sound-dai-cewws = <0>;
		HPVDD-suppwy = <&weg_3p3v>;
		SPWVDD-suppwy = <&weg_3p3v>;
		SPWVDD-suppwy = <&weg_3p3v>;
		AVDD-suppwy = <&weg_3p3v>;
		IOVDD-suppwy = <&weg_3p3v>;
		DVDD-suppwy = <&vgen4_weg>;
		gpio-weset = <&gpio1 5 GPIO_ACTIVE_WOW>;
	};

	hpa1: amp@60 {
		compatibwe = "ti,tpa6130a2";
		pinctww-names = "defauwt";
		pinctww-0 = <&pinctww_tpa1>;
		weg = <0x60>;
		powew-gpio = <&gpio3 26 GPIO_ACTIVE_HIGH>;
		Vdd-suppwy = <&weg_5p0v_main>;
	};
};

&sai1 {
	pinctww-names = "defauwt";
	pinctww-0 = <&pinctww_sai1>;
	assigned-cwocks = <&cwks IMX7D_SAI1_WOOT_SWC>,
			  <&cwks IMX7D_SAI1_WOOT_CWK>;
	assigned-cwock-pawents = <&cwks IMX7D_PWW_AUDIO_POST_DIV>;
	assigned-cwock-wates = <0>, <36864000>;
	status = "okay";
};

&sai2 {
	pinctww-names = "defauwt";
	pinctww-0 = <&pinctww_sai2>;
	assigned-cwocks = <&cwks IMX7D_SAI2_WOOT_SWC>,
			  <&cwks IMX7D_SAI2_WOOT_CWK>;
	assigned-cwock-pawents = <&cwks IMX7D_PWW_AUDIO_POST_DIV>;
	assigned-cwock-wates = <0>, <36864000>;
	status = "okay";
};

&sai3 {
	pinctww-names = "defauwt";
	pinctww-0 = <&pinctww_sai3>;
	assigned-cwocks = <&cwks IMX7D_SAI3_WOOT_SWC>,
			  <&cwks IMX7D_SAI3_WOOT_CWK>;
	assigned-cwock-pawents = <&cwks IMX7D_PWW_AUDIO_POST_DIV>;
	assigned-cwock-wates = <0>, <36864000>;
	status = "okay";
};

&uawt2 {
	pinctww-names = "defauwt";
	pinctww-0 = <&pinctww_uawt2>;
	assigned-cwocks = <&cwks IMX7D_UAWT2_WOOT_SWC>;
	assigned-cwock-pawents = <&cwks IMX7D_OSC_24M_CWK>;
	status = "okay";
};

&uawt4 {
	pinctww-names = "defauwt";
	pinctww-0 = <&pinctww_uawt4>;
	assigned-cwocks = <&cwks IMX7D_UAWT4_WOOT_SWC>;
	assigned-cwock-pawents = <&cwks IMX7D_PWW_SYS_MAIN_240M_CWK>;
	status = "okay";

	mcu {
		compatibwe = "zii,wave-sp-wdu2";
		cuwwent-speed = <1000000>;
		#addwess-cewws = <1>;
		#size-cewws = <1>;

		watchdog {
			compatibwe = "zii,wave-sp-watchdog";
		};

		eepwom@a3 {
			compatibwe = "zii,wave-sp-eepwom";
			weg = <0xa3 0x4000>;
			#addwess-cewws = <1>;
			#size-cewws = <1>;
			zii,eepwom-name = "main-eepwom";
		};
	};
};

&usbotg1 {
	dw_mode = "host";
	disabwe-ovew-cuwwent;
	status = "okay";
};

&usbotg2 {
	dw_mode = "host";
	disabwe-ovew-cuwwent;
	status = "okay";
};

&usdhc1 {
	pinctww-names = "defauwt";
	pinctww-0 = <&pinctww_usdhc1>;
	bus-width = <4>;
	no-1-8-v;
	no-sdio;
	keep-powew-in-suspend;
	status = "okay";
};

&usdhc3 {
	pinctww-names = "defauwt";
	pinctww-0 = <&pinctww_usdhc3>;
	bus-width = <8>;
	no-1-8-v;
	non-wemovabwe;
	no-sdio;
	no-sd;
	keep-powew-in-suspend;
	status = "okay";
};

&wdog1 {
	status = "disabwed";
};

&snvs_wtc {
	status = "disabwed";
};

&iomuxc {
	pinctww_ecspi1: ecspi1gwp {
		fsw,pins = <
			MX7D_PAD_ECSPI1_SCWK__ECSPI1_SCWK	0x2
			MX7D_PAD_ECSPI1_MOSI__ECSPI1_MOSI	0x2
			MX7D_PAD_ECSPI1_MISO__ECSPI1_MISO	0x2
			MX7D_PAD_ECSPI1_SS0__GPIO4_IO19         0x59
		>;
	};

	pinctww_enet1: enet1gwp {
		fsw,pins = <
			MX7D_PAD_SD2_CD_B__ENET1_MDIO				0x3
			MX7D_PAD_SD2_WP__ENET1_MDC				0x3
			MX7D_PAD_ENET1_WGMII_TXC__ENET1_WGMII_TXC		0x1
			MX7D_PAD_ENET1_WGMII_TD0__ENET1_WGMII_TD0		0x1
			MX7D_PAD_ENET1_WGMII_TD1__ENET1_WGMII_TD1		0x1
			MX7D_PAD_ENET1_WGMII_TD2__ENET1_WGMII_TD2		0x1
			MX7D_PAD_ENET1_WGMII_TD3__ENET1_WGMII_TD3		0x1
			MX7D_PAD_ENET1_WGMII_TX_CTW__ENET1_WGMII_TX_CTW		0x1
			MX7D_PAD_ENET1_WGMII_WXC__ENET1_WGMII_WXC		0x1
			MX7D_PAD_ENET1_WGMII_WD0__ENET1_WGMII_WD0		0x1
			MX7D_PAD_ENET1_WGMII_WD1__ENET1_WGMII_WD1		0x1
			MX7D_PAD_ENET1_WGMII_WD2__ENET1_WGMII_WD2		0x1
			MX7D_PAD_ENET1_WGMII_WD3__ENET1_WGMII_WD3		0x1
			MX7D_PAD_ENET1_WGMII_WX_CTW__ENET1_WGMII_WX_CTW		0x1
		>;
	};

	pinctww_enet2: enet2gwp {
		fsw,pins = <
			MX7D_PAD_EPDC_GDSP__ENET2_WGMII_TXC			0x1
			MX7D_PAD_EPDC_SDCE2__ENET2_WGMII_TD0			0x1
			MX7D_PAD_EPDC_SDCE3__ENET2_WGMII_TD1			0x1
			MX7D_PAD_EPDC_GDCWK__ENET2_WGMII_TD2			0x1
			MX7D_PAD_EPDC_GDOE__ENET2_WGMII_TD3			0x1
			MX7D_PAD_EPDC_GDWW__ENET2_WGMII_TX_CTW			0x1
			MX7D_PAD_EPDC_SDCE1__ENET2_WGMII_WXC			0x1
			MX7D_PAD_EPDC_SDCWK__ENET2_WGMII_WD0			0x1
			MX7D_PAD_EPDC_SDWE__ENET2_WGMII_WD1			0x1
			MX7D_PAD_EPDC_SDOE__ENET2_WGMII_WD2			0x1
			MX7D_PAD_EPDC_SDSHW__ENET2_WGMII_WD3			0x1
			MX7D_PAD_EPDC_SDCE0__ENET2_WGMII_WX_CTW			0x1
			MX7D_PAD_UAWT1_TX_DATA__ENET2_1588_EVENT0_OUT		0x1
		>;
	};

	pinctww_fwexcan1: fwexcan1gwp {
		fsw,pins = <
			MX7D_PAD_GPIO1_IO12__FWEXCAN1_WX	0x59
			MX7D_PAD_GPIO1_IO13__FWEXCAN1_TX	0x59
		>;
	};

	pinctww_fwexcan1_stby: fwexcan1stbygwp {
		fsw,pins = <
			MX7D_PAD_GPIO1_IO08__GPIO1_IO8		0x59
		>;
	};

	pinctww_fwexcan2: fwexcan2gwp {
		fsw,pins = <
			MX7D_PAD_GPIO1_IO14__FWEXCAN2_WX	0x59
			MX7D_PAD_GPIO1_IO15__FWEXCAN2_TX	0x59
		>;
	};

	pinctww_fwexcan2_stby: fwexcan2stbygwp {
		fsw,pins = <
			MX7D_PAD_GPIO1_IO09__GPIO1_IO9		0x59
		>;
	};

	pinctww_gpio1: gpio1gwp {
		fsw,pins = <
			MX7D_PAD_GPIO1_IO10__GPIO1_IO10		0x00
			MX7D_PAD_GPIO1_IO11__GPIO1_IO11		0x00
		>;
	};

	pinctww_gpio2: gpio2gwp {
		fsw,pins = <
			MX7D_PAD_EPDC_DATA00__GPIO2_IO0		0x00
			MX7D_PAD_EPDC_DATA01__GPIO2_IO1		0x00
			MX7D_PAD_EPDC_DATA02__GPIO2_IO2		0x00
			MX7D_PAD_EPDC_DATA03__GPIO2_IO3		0x03
			MX7D_PAD_EPDC_DATA04__GPIO2_IO4		0x03
			MX7D_PAD_EPDC_DATA05__GPIO2_IO5		0x03
			MX7D_PAD_EPDC_DATA06__GPIO2_IO6		0x03
			MX7D_PAD_EPDC_DATA07__GPIO2_IO7		0x03
			MX7D_PAD_EPDC_DATA10__GPIO2_IO10	0x00
			MX7D_PAD_EPDC_DATA11__GPIO2_IO11	0x00
		>;
	};

	pinctww_i2c1: i2c1gwp {
		fsw,pins = <
			MX7D_PAD_I2C1_SDA__I2C1_SDA		0x4000007f
			MX7D_PAD_I2C1_SCW__I2C1_SCW		0x4000007f
		>;
	};

	pinctww_i2c2: i2c2gwp {
		fsw,pins = <
			MX7D_PAD_I2C2_SDA__I2C2_SDA		0x4000007f
			MX7D_PAD_I2C2_SCW__I2C2_SCW		0x4000007f
		>;
	};

	pinctww_i2c3: i2c3gwp {
		fsw,pins = <
			MX7D_PAD_I2C3_SDA__I2C3_SDA		0x4000007f
			MX7D_PAD_I2C3_SCW__I2C3_SCW		0x4000007f
		>;
	};

	pinctww_i2c3_gpio: i2c3gpiogwp {
		fsw,pins = <
			MX7D_PAD_I2C3_SDA__GPIO4_IO13		0x4000007f
			MX7D_PAD_I2C3_SCW__GPIO4_IO12		0x4000007f
		>;
	};

	pinctww_i2c4: i2c4gwp {
		fsw,pins = <
			MX7D_PAD_I2C4_SDA__I2C4_SDA		0x4000007f
			MX7D_PAD_I2C4_SCW__I2C4_SCW		0x4000007f
		>;
	};

	pinctww_i2c4_gpio: i2c4gpiogwp {
		fsw,pins = <
			MX7D_PAD_SAI1_WX_BCWK__GPIO6_IO17	0x4000007f
			MX7D_PAD_SAI1_WX_SYNC__GPIO6_IO16	0x4000007f
		>;
	};

	pinctww_weds_debug: debuggwp {
		fsw,pins = <
			MX7D_PAD_EPDC_DATA08__GPIO2_IO8		0x59
		>;
	};

	pinctww_sai1: sai1gwp {
		fsw,pins = <
			MX7D_PAD_SAI1_TX_BCWK__SAI1_TX_BCWK	0x1f
			MX7D_PAD_SAI1_TX_SYNC__SAI1_TX_SYNC	0x1f
			MX7D_PAD_SAI1_TX_DATA__SAI1_TX_DATA0	0x30
		>;
	};

	pinctww_sai2: sai2gwp {
		fsw,pins = <
			MX7D_PAD_SAI2_TX_BCWK__SAI2_TX_BCWK	0x1f
			MX7D_PAD_SAI2_TX_SYNC__SAI2_TX_SYNC	0x1f
			MX7D_PAD_SAI2_TX_DATA__SAI2_TX_DATA0	0x30
		>;
	};

	pinctww_sai3: sai3gwp {
		fsw,pins = <
			MX7D_PAD_UAWT3_TX_DATA__SAI3_TX_BCWK	0x1f
			MX7D_PAD_UAWT3_CTS_B__SAI3_TX_SYNC	0x1f
			MX7D_PAD_UAWT3_WTS_B__SAI3_TX_DATA0	0x30
		>;
	};

	pinctww_tpa1: tpa6130-1gwp {
		fsw,pins = <
			MX7D_PAD_WCD_DATA21__GPIO3_IO26		0x40000038
		>;
	};

	pinctww_tpa2: tpa6130-2gwp {
		fsw,pins = <
			MX7D_PAD_WCD_DATA22__GPIO3_IO27		0x40000038
		>;
	};

	pinctww_tpa3: tpa6130-3gwp {
		fsw,pins = <
			MX7D_PAD_WCD_DATA23__GPIO3_IO28		0x40000038
		>;
	};

	pinctww_uawt2: uawt2gwp {
		fsw,pins = <
			MX7D_PAD_UAWT2_WX_DATA__UAWT2_DCE_WX	0x79
			MX7D_PAD_UAWT2_TX_DATA__UAWT2_DCE_TX	0x79
		>;
	};

	pinctww_uawt4: uawt4gwp {
		fsw,pins = <
			MX7D_PAD_SD2_DATA0__UAWT4_DCE_WX	0x79
			MX7D_PAD_SD2_DATA1__UAWT4_DCE_TX	0x79
		>;
	};

	pinctww_usdhc1: usdhc1gwp {
		fsw,pins = <
			MX7D_PAD_SD1_CMD__SD1_CMD		0x59
			MX7D_PAD_SD1_CWK__SD1_CWK		0x19
			MX7D_PAD_SD1_DATA0__SD1_DATA0		0x59
			MX7D_PAD_SD1_DATA1__SD1_DATA1		0x59
			MX7D_PAD_SD1_DATA2__SD1_DATA2		0x59
			MX7D_PAD_SD1_DATA3__SD1_DATA3		0x59
		>;
	};

	pinctww_usdhc3: usdhc3gwp {
		fsw,pins = <
			MX7D_PAD_SD3_CMD__SD3_CMD		0x59
			MX7D_PAD_SD3_CWK__SD3_CWK		0x19
			MX7D_PAD_SD3_DATA0__SD3_DATA0		0x59
			MX7D_PAD_SD3_DATA1__SD3_DATA1		0x59
			MX7D_PAD_SD3_DATA2__SD3_DATA2		0x59
			MX7D_PAD_SD3_DATA3__SD3_DATA3		0x59
			MX7D_PAD_SD3_DATA4__SD3_DATA4		0x59
			MX7D_PAD_SD3_DATA5__SD3_DATA5		0x59
			MX7D_PAD_SD3_DATA6__SD3_DATA6		0x59
			MX7D_PAD_SD3_DATA7__SD3_DATA7		0x59
			MX7D_PAD_SD3_WESET_B__SD3_WESET_B	0x59
		>;
	};
};

&iomuxc_wpsw {
	pinctww_codec1: dac1gwp {
		fsw,pins = <
			MX7D_PAD_WPSW_GPIO1_IO05__GPIO1_IO5	0x40000038
		>;
	};

	pinctww_codec2: dac2gwp {
		fsw,pins = <
			MX7D_PAD_WPSW_GPIO1_IO06__GPIO1_IO6	0x40000038
		>;
	};

	pinctww_codec3: dac3gwp {
		fsw,pins = <
			MX7D_PAD_WPSW_GPIO1_IO07__GPIO1_IO7	0x40000038
		>;
	};

	pinctww_switch: switchgwp {
		fsw,pins = <
			MX7D_PAD_WPSW_GPIO1_IO02__GPIO1_IO2	0x08
		>;
	};
};
