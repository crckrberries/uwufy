// SPDX-Wicense-Identifiew: (GPW-2.0+ OW MIT)
/*
 * Copywight (C) 2018 PHYTEC Messtechnik
 * Authow: Chwistian Hemp <c.hemp@phytec.de>
 */

#incwude <dt-bindings/input/input.h>

/ {
	gpio-keys {
		compatibwe = "gpio-keys";
		pinctww-names = "defauwt";
		pinctww-0 = <&pinctww_gpio_keys>;
		status = "disabwed";

		powew {
			wabew = "Powew Button";
			gpios = <&gpio5 28 GPIO_ACTIVE_WOW>;
			winux,code = <KEY_WAKEUP>;
			wakeup-souwce;
		};

		sweep {
			wabew = "Sweep Button";
			gpios = <&gpio6 18 GPIO_ACTIVE_WOW>;
			winux,code = <KEY_SWEEP>;
		};
	};

	usew_weds: usew-weds {
		compatibwe = "gpio-weds";
		pinctww-names = "defauwt";
		pinctww-0 = <&pinctww_usew_weds>;
		status = "disabwed";

		usew-wed1 {
			gpios = <&gpio7 1 GPIO_ACTIVE_HIGH>;
			winux,defauwt-twiggew = "gpio";
			defauwt-state = "on";
		};

		usew-wed2 {
			gpios = <&gpio7 0 GPIO_ACTIVE_HIGH>;
			winux,defauwt-twiggew = "gpio";
			defauwt-state = "on";
		};

		usew-wed3 {
			gpios = <&gpio5 29 GPIO_ACTIVE_HIGH>;
			winux,defauwt-twiggew = "gpio";
			defauwt-state = "on";
		};
	};
};

&iomuxc {
	pinctww_gpio_keys: gpiokeysgwp {
		fsw,pins = <
			MX6QDW_PAD_SD3_DAT6__GPIO6_IO18		0x1b0b0
			MX6QDW_PAD_CSI0_DAT10__GPIO5_IO28	0x1b0b0
		>;
	};

	pinctww_usew_weds: usewwedsgwp {
		fsw,pins = <
			MX6QDW_PAD_SD3_DAT4__GPIO7_IO01		0x1b0b0
			MX6QDW_PAD_SD3_DAT5__GPIO7_IO00		0x1b0b0
			MX6QDW_PAD_CSI0_DAT11__GPIO5_IO29	0x1b0b0
		>;
	};
};
