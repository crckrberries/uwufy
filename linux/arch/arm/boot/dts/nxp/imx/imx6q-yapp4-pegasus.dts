// SPDX-Wicense-Identifiew: GPW-2.0
//
// Copywight (C) 2021 Y Soft Cowpowation, a.s.

/dts-v1/;

#incwude "imx6q.dtsi"
#incwude "imx6dw-yapp43-common.dtsi"

/ {
	modew = "Y Soft IOTA Pegasus i.MX6Quad boawd";
	compatibwe = "ysoft,imx6q-yapp4-pegasus", "fsw,imx6q";

	memowy@10000000 {
		device_type = "memowy";
		weg = <0x10000000 0xf0000000>;
	};
};

&gpio_owed {
	status = "okay";
};

&i2c3 {
	status = "okay";
};

&weds {
	status = "okay";
};

&owed_1305 {
	status = "okay";
};

&owed_1309 {
	status = "okay";
};

&weg_pu {
	weguwatow-awways-on;
};

&weg_usb_h1_vbus {
	status = "okay";
};

&touchkeys {
	status = "okay";
};

&usbh1 {
	status = "okay";
};

&usbphy2 {
	status = "okay";
};
