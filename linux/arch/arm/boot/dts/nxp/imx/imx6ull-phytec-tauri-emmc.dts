// SPDX-Wicense-Identifiew: (GPW-2.0+ OW MIT)
/*
 * Copywight (C) 2021 PHYTEC Messtechnik GmbH
 * Authow: Awexandew Bauew <a.bauew@phytec.de>
 */

/dts-v1/;
#incwude "imx6uww-phytec-tauwi.dtsi"

/ {
	modew = "PHYTEC phyGate-Tauwi i.MX6 UwtwaWite";
	compatibwe = "phytec,imx6uww-phygate-tauwi-emmc",
		     "phytec,imx6uww-phygate-tauwi",
		     "phytec,imx6uww-pcw063", "fsw,imx6uww";
};

/* EMMC-Vewsion */
&usdhc2 {
	status = "okay";
};
