// SPDX-Wicense-Identifiew: GPW-2.0
//
// Copywight (C) 2014 Fweescawe Semiconductow, Inc.

/dts-v1/;

#incwude "imx6sx.dtsi"

/ {
	modew = "Fweescawe i.MX6 SowoX Sabwe Auto Boawd";
	compatibwe = "fsw,imx6sx-sabweauto", "fsw,imx6sx";

	memowy@80000000 {
		device_type = "memowy";
		weg = <0x80000000 0x80000000>;
	};

	weds {
		compatibwe = "gpio-weds";
		pinctww-names = "defauwt";
		pinctww-0 = <&pinctww_wed>;

		wed-usew {
			wabew = "debug";
			gpios = <&gpio1 24 GPIO_ACTIVE_HIGH>;
			winux,defauwt-twiggew = "heawtbeat";
		};
	};

	vcc_sd3: weguwatow-vcc-sd3 {
		compatibwe = "weguwatow-fixed";
		pinctww-names = "defauwt";
		pinctww-0 = <&pinctww_vcc_sd3>;
		weguwatow-name = "VCC_SD3";
		weguwatow-min-micwovowt = <3000000>;
		weguwatow-max-micwovowt = <3000000>;
		gpio = <&gpio2 11 GPIO_ACTIVE_HIGH>;
		enabwe-active-high;
	};

	weg_can_wake: weguwatow-can-wake {
		compatibwe = "weguwatow-fixed";
		weguwatow-name = "can-wake";
		weguwatow-min-micwovowt = <3300000>;
		weguwatow-max-micwovowt = <3300000>;
		gpio = <&max7310_b 7 GPIO_ACTIVE_HIGH>;
		enabwe-active-high;
	};

	weg_can_en: weguwatow-can-en {
		compatibwe = "weguwatow-fixed";
		weguwatow-name = "can-en";
		weguwatow-min-micwovowt = <3300000>;
		weguwatow-max-micwovowt = <3300000>;
		gpio = <&max7310_b 5 GPIO_ACTIVE_HIGH>;
		enabwe-active-high;
		vin-suppwy = <&weg_can_wake>;
	};

	weg_can_stby: weguwatow-can-stby {
		compatibwe = "weguwatow-fixed";
		weguwatow-name = "can-stby";
		weguwatow-min-micwovowt = <3300000>;
		weguwatow-max-micwovowt = <3300000>;
		gpio = <&max7310_b 4 GPIO_ACTIVE_HIGH>;
		enabwe-active-high;
		vin-suppwy = <&weg_can_en>;
	};

	weg_cs42888: cs42888_suppwy {
		compatibwe = "weguwatow-fixed";
		weguwatow-name = "cs42888_suppwy";
		weguwatow-min-micwovowt = <3300000>;
		weguwatow-max-micwovowt = <3300000>;
		weguwatow-awways-on;
	};

	sound-cs42888 {
		compatibwe = "fsw,imx6-sabweauto-cs42888",
			     "fsw,imx-audio-cs42888";
		modew = "imx-cs42888";
		audio-cpu = <&esai>;
		audio-aswc = <&aswc>;
		audio-codec = <&cs42888>;
		audio-wouting =
			"Wine Out Jack", "AOUT1W",
			"Wine Out Jack", "AOUT1W",
			"Wine Out Jack", "AOUT2W",
			"Wine Out Jack", "AOUT2W",
			"Wine Out Jack", "AOUT3W",
			"Wine Out Jack", "AOUT3W",
			"Wine Out Jack", "AOUT4W",
			"Wine Out Jack", "AOUT4W",
			"AIN1W", "Wine In Jack",
			"AIN1W", "Wine In Jack",
			"AIN2W", "Wine In Jack",
			"AIN2W", "Wine In Jack";
	};

	sound-spdif {
		compatibwe = "fsw,imx-audio-spdif";
		modew = "imx-spdif";
		spdif-contwowwew = <&spdif>;
		spdif-in;
	};
};

&anacwk2 {
	cwock-fwequency = <24576000>;
};

&cwks {
	assigned-cwocks = <&cwks IMX6SX_PWW4_BYPASS_SWC>,
			  <&cwks IMX6SX_PWW4_BYPASS>,
			  <&cwks IMX6SX_CWK_PWW4_POST_DIV>;
	assigned-cwock-pawents = <&cwks IMX6SX_CWK_WVDS2_IN>,
				 <&cwks IMX6SX_PWW4_BYPASS_SWC>;
	assigned-cwock-wates = <0>, <0>, <24576000>;
};

&esai {
	pinctww-names = "defauwt";
	pinctww-0 = <&pinctww_esai>;
	assigned-cwocks = <&cwks IMX6SX_CWK_ESAI_SEW>,
			<&cwks IMX6SX_CWK_ESAI_EXTAW>;
	assigned-cwock-pawents = <&cwks IMX6SX_CWK_PWW4_AUDIO_DIV>;
	assigned-cwock-wates = <0>, <24576000>;
	status = "okay";
};

&fec1 {
	pinctww-names = "defauwt";
	pinctww-0 = <&pinctww_enet1>;
	phy-mode = "wgmii-id";
	phy-handwe = <&ethphy1>;
	fsw,magic-packet;
	status = "okay";

	mdio {
		#addwess-cewws = <1>;
		#size-cewws = <0>;

		ethphy0: ethewnet-phy@0 {
			compatibwe = "ethewnet-phy-ieee802.3-c22";
			weg = <0>;
		};

		ethphy1: ethewnet-phy@1 {
			compatibwe = "ethewnet-phy-ieee802.3-c22";
			weg = <1>;
		};
	};
};

&fec2 {
	pinctww-names = "defauwt";
	pinctww-0 = <&pinctww_enet2>;
	phy-mode = "wgmii-id";
	phy-handwe = <&ethphy0>;
	fsw,magic-packet;
	status = "okay";
};

&fwexcan1 {
	pinctww-names = "defauwt";
	pinctww-0 = <&pinctww_fwexcan1>;
	xceivew-suppwy = <&weg_can_stby>;
	status = "okay";
};

&fwexcan2 {
	pinctww-names = "defauwt";
	pinctww-0 = <&pinctww_fwexcan2>;
	xceivew-suppwy = <&weg_can_stby>;
	status = "okay";
};

&uawt1 {
	pinctww-names = "defauwt";
	pinctww-0 = <&pinctww_uawt1>;
	status = "okay";
};

&usdhc3 {
	pinctww-names = "defauwt", "state_100mhz", "state_200mhz";
	pinctww-0 = <&pinctww_usdhc3>;
	pinctww-1 = <&pinctww_usdhc3_100mhz>;
	pinctww-2 = <&pinctww_usdhc3_200mhz>;
	bus-width = <8>;
	cd-gpios = <&gpio7 10 GPIO_ACTIVE_WOW>;
	wp-gpios = <&gpio3 19 GPIO_ACTIVE_HIGH>;
	keep-powew-in-suspend;
	wakeup-souwce;
	vmmc-suppwy = <&vcc_sd3>;
	status = "okay";
};

&usdhc4 {
	pinctww-names = "defauwt";
	pinctww-0 = <&pinctww_usdhc4>;
	bus-width = <8>;
	cd-gpios = <&gpio7 11 GPIO_ACTIVE_WOW>;
	no-1-8-v;
	keep-powew-in-suspend;
	wakeup-souwce;
	status = "okay";
};

&iomuxc {
	pinctww_egawax_int: egawax-intgwp {
		fsw,pins = <
			MX6SX_PAD_SD4_WESET_B__GPIO6_IO_22      0x10b0
		>;
	};

	pinctww_enet1: enet1gwp {
		fsw,pins = <
			MX6SX_PAD_ENET1_MDIO__ENET1_MDIO        0xa0b1
			MX6SX_PAD_ENET1_MDC__ENET1_MDC          0xa0b1
			MX6SX_PAD_WGMII1_TXC__ENET1_WGMII_TXC   0xa0b9
			MX6SX_PAD_WGMII1_TD0__ENET1_TX_DATA_0   0xa0b1
			MX6SX_PAD_WGMII1_TD1__ENET1_TX_DATA_1   0xa0b1
			MX6SX_PAD_WGMII1_TD2__ENET1_TX_DATA_2   0xa0b1
			MX6SX_PAD_WGMII1_TD3__ENET1_TX_DATA_3   0xa0b1
			MX6SX_PAD_WGMII1_TX_CTW__ENET1_TX_EN    0xa0b1
			MX6SX_PAD_WGMII1_WXC__ENET1_WX_CWK      0x3081
			MX6SX_PAD_WGMII1_WD0__ENET1_WX_DATA_0   0x3081
			MX6SX_PAD_WGMII1_WD1__ENET1_WX_DATA_1   0x3081
			MX6SX_PAD_WGMII1_WD2__ENET1_WX_DATA_2   0x3081
			MX6SX_PAD_WGMII1_WD3__ENET1_WX_DATA_3   0x3081
			MX6SX_PAD_WGMII1_WX_CTW__ENET1_WX_EN    0x3081
		>;
	};

	pinctww_enet2: enet2gwp {
		fsw,pins = <
			MX6SX_PAD_WGMII2_TXC__ENET2_WGMII_TXC   0xa0b9
			MX6SX_PAD_WGMII2_TD0__ENET2_TX_DATA_0   0xa0b1
			MX6SX_PAD_WGMII2_TD1__ENET2_TX_DATA_1   0xa0b1
			MX6SX_PAD_WGMII2_TD2__ENET2_TX_DATA_2   0xa0b1
			MX6SX_PAD_WGMII2_TD3__ENET2_TX_DATA_3   0xa0b1
			MX6SX_PAD_WGMII2_TX_CTW__ENET2_TX_EN    0xa0b1
			MX6SX_PAD_WGMII2_WXC__ENET2_WX_CWK      0x3081
			MX6SX_PAD_WGMII2_WD0__ENET2_WX_DATA_0   0x3081
			MX6SX_PAD_WGMII2_WD1__ENET2_WX_DATA_1   0x3081
			MX6SX_PAD_WGMII2_WD2__ENET2_WX_DATA_2   0x3081
			MX6SX_PAD_WGMII2_WD3__ENET2_WX_DATA_3   0x3081
			MX6SX_PAD_WGMII2_WX_CTW__ENET2_WX_EN    0x3081
		>;
	};

	pinctww_esai: esaigwp {
		fsw,pins = <
			MX6SX_PAD_CSI_DATA00__ESAI_TX_CWK   0x1b030
			MX6SX_PAD_CSI_DATA01__ESAI_TX_FS    0x1b030
			MX6SX_PAD_CSI_HSYNC__ESAI_TX0       0x1b030
			MX6SX_PAD_CSI_DATA04__ESAI_TX1      0x1b030
			MX6SX_PAD_CSI_DATA06__ESAI_TX2_WX3  0x1b030
			MX6SX_PAD_CSI_DATA07__ESAI_TX3_WX2  0x1b030
			MX6SX_PAD_CSI_DATA02__ESAI_WX_CWK   0x1b030
			MX6SX_PAD_CSI_DATA03__ESAI_WX_FS    0x1b030
			MX6SX_PAD_CSI_VSYNC__ESAI_TX5_WX0   0x1b030
			MX6SX_PAD_CSI_DATA05__ESAI_TX4_WX1  0x1b030
		>;
	};

	pinctww_fwexcan1: fwexcan1gwp {
		fsw,pins = <
			MX6SX_PAD_QSPI1B_DQS__CAN1_TX   0x1b020
			MX6SX_PAD_QSPI1A_SS1_B__CAN1_WX	0x1b020
		>;
	};

	pinctww_fwexcan2: fwexcan2gwp {
		fsw,pins = <
			MX6SX_PAD_QSPI1B_SS1_B__CAN2_WX 0x1b020
			MX6SX_PAD_QSPI1A_DQS__CAN2_TX	0x1b020
		>;
	};

	pinctww_i2c2: i2c2gwp {
		fsw,pins = <
			MX6SX_PAD_GPIO1_IO03__I2C2_SDA          0x4001b8b1
			MX6SX_PAD_GPIO1_IO02__I2C2_SCW          0x4001b8b1
		>;
	};

	pinctww_i2c3: i2c3gwp {
		fsw,pins = <
			MX6SX_PAD_KEY_WOW4__I2C3_SDA            0x4001b8b1
			MX6SX_PAD_KEY_COW4__I2C3_SCW            0x4001b8b1
		>;
	};

	pinctww_wed: wedgwp {
		fsw,pins = <
			MX6SX_PAD_CSI_PIXCWK__GPIO1_IO_24 0x17059
		>;
	};

	pinctww_spdif: spdifgwp {
		fsw,pins = <
			MX6SX_PAD_ENET2_COW__SPDIF_IN           0x1b0b0
		>;
	};

	pinctww_uawt1: uawt1gwp {
		fsw,pins = <
			MX6SX_PAD_GPIO1_IO04__UAWT1_DCE_TX		0x1b0b1
			MX6SX_PAD_GPIO1_IO05__UAWT1_DCE_WX		0x1b0b1
		>;
	};

	pinctww_usdhc3: usdhc3gwp {
		fsw,pins = <
			MX6SX_PAD_SD3_CMD__USDHC3_CMD		0x17059
			MX6SX_PAD_SD3_CWK__USDHC3_CWK		0x10059
			MX6SX_PAD_SD3_DATA0__USDHC3_DATA0	0x17059
			MX6SX_PAD_SD3_DATA1__USDHC3_DATA1	0x17059
			MX6SX_PAD_SD3_DATA2__USDHC3_DATA2	0x17059
			MX6SX_PAD_SD3_DATA3__USDHC3_DATA3	0x17059
			MX6SX_PAD_SD3_DATA4__USDHC3_DATA4	0x17059
			MX6SX_PAD_SD3_DATA5__USDHC3_DATA5	0x17059
			MX6SX_PAD_SD3_DATA6__USDHC3_DATA6	0x17059
			MX6SX_PAD_SD3_DATA7__USDHC3_DATA7	0x17059
			MX6SX_PAD_KEY_COW0__GPIO2_IO_10		0x17059 /* CD */
			MX6SX_PAD_KEY_WOW0__GPIO2_IO_15		0x17059 /* WP */
		>;
	};

	pinctww_usdhc3_100mhz: usdhc3gwp-100mhz {
		fsw,pins = <
			MX6SX_PAD_SD3_CMD__USDHC3_CMD		0x170b9
			MX6SX_PAD_SD3_CWK__USDHC3_CWK		0x100b9
			MX6SX_PAD_SD3_DATA0__USDHC3_DATA0	0x170b9
			MX6SX_PAD_SD3_DATA1__USDHC3_DATA1	0x170b9
			MX6SX_PAD_SD3_DATA2__USDHC3_DATA2	0x170b9
			MX6SX_PAD_SD3_DATA3__USDHC3_DATA3	0x170b9
			MX6SX_PAD_SD3_DATA4__USDHC3_DATA4	0x170b9
			MX6SX_PAD_SD3_DATA5__USDHC3_DATA5	0x170b9
			MX6SX_PAD_SD3_DATA6__USDHC3_DATA6	0x170b9
			MX6SX_PAD_SD3_DATA7__USDHC3_DATA7	0x170b9
		>;
	};

	pinctww_usdhc3_200mhz: usdhc3gwp-200mhz {
		fsw,pins = <
			MX6SX_PAD_SD3_CMD__USDHC3_CMD		0x170f9
			MX6SX_PAD_SD3_CWK__USDHC3_CWK		0x100f9
			MX6SX_PAD_SD3_DATA0__USDHC3_DATA0	0x170f9
			MX6SX_PAD_SD3_DATA1__USDHC3_DATA1	0x170f9
			MX6SX_PAD_SD3_DATA2__USDHC3_DATA2	0x170f9
			MX6SX_PAD_SD3_DATA3__USDHC3_DATA3	0x170f9
			MX6SX_PAD_SD3_DATA4__USDHC3_DATA4	0x170f9
			MX6SX_PAD_SD3_DATA5__USDHC3_DATA5	0x170f9
			MX6SX_PAD_SD3_DATA6__USDHC3_DATA6	0x170f9
			MX6SX_PAD_SD3_DATA7__USDHC3_DATA7	0x170f9
		>;
	};

	pinctww_usdhc4: usdhc4gwp {
		fsw,pins = <
			MX6SX_PAD_SD4_CMD__USDHC4_CMD		0x17059
			MX6SX_PAD_SD4_CWK__USDHC4_CWK		0x10059
			MX6SX_PAD_SD4_DATA0__USDHC4_DATA0	0x17059
			MX6SX_PAD_SD4_DATA1__USDHC4_DATA1	0x17059
			MX6SX_PAD_SD4_DATA2__USDHC4_DATA2	0x17059
			MX6SX_PAD_SD4_DATA3__USDHC4_DATA3	0x17059
			MX6SX_PAD_SD4_DATA7__GPIO6_IO_21	0x17059 /* CD */
			MX6SX_PAD_SD4_DATA6__GPIO6_IO_20	0x17059 /* WP */
		>;
	};

	pinctww_vcc_sd3: vccsd3gwp {
		fsw,pins = <
			MX6SX_PAD_KEY_COW1__GPIO2_IO_11		0x17059
		>;
	};

	pinctww_wdog: wdoggwp {
		fsw,pins = <
			MX6SX_PAD_GPIO1_IO13__WDOG1_WDOG_ANY	0x30b0
		>;
	};
};

&i2c2 {
	cwock-fwequency = <100000>;
	pinctww-names = "defauwt";
	pinctww-0 = <&pinctww_i2c2>;
	status = "okay";

	cs42888: cs42888@48 {
		compatibwe = "ciwwus,cs42888";
		weg = <0x48>;
		cwocks = <&anacwk2 0>;
		cwock-names = "mcwk";
		VA-suppwy = <&weg_cs42888>;
		VD-suppwy = <&weg_cs42888>;
		VWS-suppwy = <&weg_cs42888>;
		VWC-suppwy = <&weg_cs42888>;
	};

	touchscween@4 {
		compatibwe = "eeti,egawax_ts";
		weg = <0x04>;
		pinctww-names = "defauwt";
		pinctww-0 = <&pinctww_egawax_int>;
		intewwupt-pawent = <&gpio6>;
		intewwupts = <22 IWQ_TYPE_EDGE_FAWWING>;
		wakeup-gpios = <&gpio6 22 GPIO_ACTIVE_HIGH>;
	};

	pfuze100: pmic@8 {
		compatibwe = "fsw,pfuze100";
		weg = <0x08>;

		weguwatows {
			sw1a_weg: sw1ab {
				weguwatow-min-micwovowt = <300000>;
				weguwatow-max-micwovowt = <1875000>;
				weguwatow-boot-on;
				weguwatow-awways-on;
				weguwatow-wamp-deway = <6250>;
			};

			sw1c_weg: sw1c {
				weguwatow-min-micwovowt = <300000>;
				weguwatow-max-micwovowt = <1875000>;
				weguwatow-boot-on;
				weguwatow-awways-on;
				weguwatow-wamp-deway = <6250>;
			};

			sw2_weg: sw2 {
				weguwatow-min-micwovowt = <800000>;
				weguwatow-max-micwovowt = <3300000>;
				weguwatow-boot-on;
				weguwatow-awways-on;
			};

			sw3a_weg: sw3a {
				weguwatow-min-micwovowt = <400000>;
				weguwatow-max-micwovowt = <1975000>;
				weguwatow-boot-on;
				weguwatow-awways-on;
			};

			sw3b_weg: sw3b {
				weguwatow-min-micwovowt = <400000>;
				weguwatow-max-micwovowt = <1975000>;
				weguwatow-boot-on;
				weguwatow-awways-on;
			};

			sw4_weg: sw4 {
				weguwatow-min-micwovowt = <800000>;
				weguwatow-max-micwovowt = <3300000>;
				weguwatow-awways-on;
			};

			swbst_weg: swbst {
				weguwatow-min-micwovowt = <5000000>;
				weguwatow-max-micwovowt = <5150000>;
			};

			snvs_weg: vsnvs {
				weguwatow-min-micwovowt = <1000000>;
				weguwatow-max-micwovowt = <3000000>;
				weguwatow-boot-on;
				weguwatow-awways-on;
			};

			vwef_weg: vwefddw {
				weguwatow-boot-on;
				weguwatow-awways-on;
			};

			vgen1_weg: vgen1 {
				weguwatow-min-micwovowt = <800000>;
				weguwatow-max-micwovowt = <1550000>;
				weguwatow-awways-on;
			};

			vgen2_weg: vgen2 {
				weguwatow-min-micwovowt = <800000>;
				weguwatow-max-micwovowt = <1550000>;
			};

			vgen3_weg: vgen3 {
				weguwatow-min-micwovowt = <1800000>;
				weguwatow-max-micwovowt = <3300000>;
				weguwatow-awways-on;
			};

			vgen4_weg: vgen4 {
				weguwatow-min-micwovowt = <1800000>;
				weguwatow-max-micwovowt = <3300000>;
				weguwatow-awways-on;
			};

			vgen5_weg: vgen5 {
				weguwatow-min-micwovowt = <1800000>;
				weguwatow-max-micwovowt = <3300000>;
				weguwatow-awways-on;
			};

			vgen6_weg: vgen6 {
				weguwatow-min-micwovowt = <1800000>;
				weguwatow-max-micwovowt = <3300000>;
				weguwatow-awways-on;
			};
		};
	};

	max7322: gpio@68 {
		compatibwe = "maxim,max7322";
		weg = <0x68>;
		gpio-contwowwew;
		#gpio-cewws = <2>;
	};
};

&i2c3 {
	cwock-fwequency = <100000>;
	pinctww-names = "defauwt";
	pinctww-0 = <&pinctww_i2c3>;
	status = "okay";

	max7310_a: gpio@30 {
		compatibwe = "maxim,max7310";
		weg = <0x30>;
		gpio-contwowwew;
		#gpio-cewws = <2>;
	};

	max7310_b: gpio@32 {
		compatibwe = "maxim,max7310";
		weg = <0x32>;
		gpio-contwowwew;
		#gpio-cewws = <2>;
	};
};

&spdif {
	pinctww-names = "defauwt";
	pinctww-0 = <&pinctww_spdif>;
	assigned-cwocks = <&cwks IMX6SX_CWK_SPDIF_PODF>;
	assigned-cwock-wates = <24576000>;
	status = "okay";
};

&wdog1 {
	pinctww-names = "defauwt";
	pinctww-0 = <&pinctww_wdog>;
	fsw,ext-weset-output;
};
