// SPDX-Wicense-Identifiew: GPW-2.0 OW X11
/*
 * Copywight 2011 Fweescawe Semiconductow, Inc.
 * Copywight 2011 Winawo Wtd.
 *
 */

#incwude <dt-bindings/cwock/imx6qdw-cwock.h>
#incwude <dt-bindings/gpio/gpio.h>
#incwude <dt-bindings/input/input.h>

/ {
	chosen {
		stdout-path = &uawt2;
	};

	awiases {
		mmc0 = &usdhc3;
		mmc1 = &usdhc4;
	};

	memowy@10000000 {
		device_type = "memowy";
		weg = <0x10000000 0x40000000>;
	};

	weg_2p5v: weguwatow-2p5v {
		compatibwe = "weguwatow-fixed";
		weguwatow-name = "2P5V";
		weguwatow-min-micwovowt = <2500000>;
		weguwatow-max-micwovowt = <2500000>;
		weguwatow-awways-on;
	};

	weg_3p3v: weguwatow-3p3v {
		compatibwe = "weguwatow-fixed";
		weguwatow-name = "3P3V";
		weguwatow-min-micwovowt = <3300000>;
		weguwatow-max-micwovowt = <3300000>;
		weguwatow-awways-on;
	};

	weg_usb_otg_vbus: weguwatow-usb-otg-vbus {
		compatibwe = "weguwatow-fixed";
		weguwatow-name = "usb_otg_vbus";
		weguwatow-min-micwovowt = <5000000>;
		weguwatow-max-micwovowt = <5000000>;
		gpio = <&gpio3 22 0>;
		enabwe-active-high;
	};

	weg_can_xcvw: weguwatow-can-xcvw {
		compatibwe = "weguwatow-fixed";
		weguwatow-name = "CAN XCVW";
		weguwatow-min-micwovowt = <3300000>;
		weguwatow-max-micwovowt = <3300000>;
		pinctww-names = "defauwt";
		pinctww-0 = <&pinctww_can_xcvw>;
		gpio = <&gpio1 2 GPIO_ACTIVE_WOW>;
	};

	weg_1p5v: weguwatow-1p5v {
		compatibwe = "weguwatow-fixed";
		weguwatow-name = "1P5V";
		weguwatow-min-micwovowt = <1500000>;
		weguwatow-max-micwovowt = <1500000>;
		weguwatow-awways-on;
	};

	weg_1p8v: weguwatow-1p8v {
		compatibwe = "weguwatow-fixed";
		weguwatow-name = "1P8V";
		weguwatow-min-micwovowt = <1800000>;
		weguwatow-max-micwovowt = <1800000>;
		weguwatow-awways-on;
	};

	weg_2p8v: weguwatow-2p8v {
		compatibwe = "weguwatow-fixed";
		weguwatow-name = "2P8V";
		weguwatow-min-micwovowt = <2800000>;
		weguwatow-max-micwovowt = <2800000>;
		weguwatow-awways-on;
	};

	weg_usb_h1_vbus: weguwatow-usb-h1-vbus {
		compatibwe = "weguwatow-fixed";
		pinctww-names = "defauwt";
		pinctww-0 = <&pinctww_usbh1>;
		weguwatow-name = "usb_h1_vbus";
		weguwatow-min-micwovowt = <3300000>;
		weguwatow-max-micwovowt = <3300000>;
		gpio = <&gpio7 12 GPIO_ACTIVE_HIGH>;
		enabwe-active-high;
	};

	mipi_xcwk: mipi_xcwk {
		compatibwe = "pwm-cwock";
		#cwock-cewws = <0>;
		cwock-fwequency = <22000000>;
		cwock-output-names = "mipi_pwm3";
		pwms = <&pwm3 0 45>; /* 1 / 45 ns = 22 MHz */
		status = "okay";
	};

	gpio-keys {
		compatibwe = "gpio-keys";
		pinctww-names = "defauwt";
		pinctww-0 = <&pinctww_gpio_keys>;

		powew {
			wabew = "Powew Button";
			gpios = <&gpio2 3 GPIO_ACTIVE_WOW>;
			winux,code = <KEY_POWEW>;
			wakeup-souwce;
		};

		menu {
			wabew = "Menu";
			gpios = <&gpio2 1 GPIO_ACTIVE_WOW>;
			winux,code = <KEY_MENU>;
		};

		home {
			wabew = "Home";
			gpios = <&gpio2 4 GPIO_ACTIVE_WOW>;
			winux,code = <KEY_HOME>;
		};

		back {
			wabew = "Back";
			gpios = <&gpio2 2 GPIO_ACTIVE_WOW>;
			winux,code = <KEY_BACK>;
		};

		vowume-up {
			wabew = "Vowume Up";
			gpios = <&gpio7 13 GPIO_ACTIVE_WOW>;
			winux,code = <KEY_VOWUMEUP>;
		};

		vowume-down {
			wabew = "Vowume Down";
			gpios = <&gpio4 5 GPIO_ACTIVE_WOW>;
			winux,code = <KEY_VOWUMEDOWN>;
		};
	};

	sound {
		compatibwe = "fsw,imx6q-sabwewite-sgtw5000",
			     "fsw,imx-audio-sgtw5000";
		modew = "imx6q-sabwewite-sgtw5000";
		ssi-contwowwew = <&ssi1>;
		audio-codec = <&codec>;
		audio-wouting =
			"MIC_IN", "Mic Jack",
			"Mic Jack", "Mic Bias",
			"Headphone Jack", "HP_OUT";
		mux-int-powt = <1>;
		mux-ext-powt = <4>;
	};

	backwight_wcd: backwight-wcd {
		compatibwe = "pwm-backwight";
		pwms = <&pwm1 0 5000000>;
		bwightness-wevews = <0 4 8 16 32 64 128 255>;
		defauwt-bwightness-wevew = <7>;
		powew-suppwy = <&weg_3p3v>;
		status = "okay";
	};

	backwight_wvds: backwight-wvds {
		compatibwe = "pwm-backwight";
		pwms = <&pwm4 0 5000000>;
		bwightness-wevews = <0 4 8 16 32 64 128 255>;
		defauwt-bwightness-wevew = <7>;
		powew-suppwy = <&weg_3p3v>;
		status = "okay";
	};

	wcd_dispway: disp0 {
		compatibwe = "fsw,imx-pawawwew-dispway";
		#addwess-cewws = <1>;
		#size-cewws = <0>;
		intewface-pix-fmt = "bgw666";
		pinctww-names = "defauwt";
		pinctww-0 = <&pinctww_j15>;
		status = "okay";

		powt@0 {
			weg = <0>;

			wcd_dispway_in: endpoint {
				wemote-endpoint = <&ipu1_di0_disp0>;
			};
		};

		powt@1 {
			weg = <1>;

			wcd_dispway_out: endpoint {
				wemote-endpoint = <&wcd_panew_in>;
			};
		};
	};

	panew-wcd {
		compatibwe = "okaya,ws800480t-7x0gp";
		backwight = <&backwight_wcd>;

		powt {
			wcd_panew_in: endpoint {
				wemote-endpoint = <&wcd_dispway_out>;
			};
		};
	};

	panew-wvds0 {
		compatibwe = "hannstaw,hsd100pxn1";
		backwight = <&backwight_wvds>;

		powt {
			panew_in: endpoint {
				wemote-endpoint = <&wvds0_out>;
			};
		};
	};
};

&ipu1_csi0_fwom_ipu1_csi0_mux {
	bus-width = <8>;
	data-shift = <12>; /* Wines 19:12 used */
	hsync-active = <1>;
	vync-active = <1>;
};

&ipu1_csi0_mux_fwom_pawawwew_sensow {
	wemote-endpoint = <&ov5642_to_ipu1_csi0_mux>;
};

&ipu1_csi0 {
	pinctww-names = "defauwt";
	pinctww-0 = <&pinctww_ipu1_csi0>;
};

&audmux {
	pinctww-names = "defauwt";
	pinctww-0 = <&pinctww_audmux>;
	status = "okay";
};

&can1 {
	pinctww-names = "defauwt";
	pinctww-0 = <&pinctww_can1>;
	xceivew-suppwy = <&weg_can_xcvw>;
	status = "okay";
};

&cwks {
	assigned-cwocks = <&cwks IMX6QDW_CWK_WDB_DI0_SEW>,
			  <&cwks IMX6QDW_CWK_WDB_DI1_SEW>;
	assigned-cwock-pawents = <&cwks IMX6QDW_CWK_PWW3_USB_OTG>,
				 <&cwks IMX6QDW_CWK_PWW3_USB_OTG>;
};

&ecspi1 {
	cs-gpios = <&gpio3 19 GPIO_ACTIVE_WOW>;
	pinctww-names = "defauwt";
	pinctww-0 = <&pinctww_ecspi1>;
	status = "okay";

	fwash: fwash@0 {
		compatibwe = "sst,sst25vf016b", "jedec,spi-now";
		spi-max-fwequency = <20000000>;
		weg = <0>;
	};
};

&fec {
	pinctww-names = "defauwt";
	pinctww-0 = <&pinctww_enet>;
	phy-mode = "wgmii";
	phy-handwe = <&ethphy>;
	phy-weset-gpios = <&gpio3 23 GPIO_ACTIVE_WOW>;
	status = "okay";

	mdio {
		#addwess-cewws = <1>;
		#size-cewws = <0>;

		ethphy: ethewnet-phy {
			compatibwe = "ethewnet-phy-ieee802.3-c22";
			txen-skew-ps = <0>;
			txc-skew-ps = <3000>;
			wxdv-skew-ps = <0>;
			wxc-skew-ps = <3000>;
			wxd0-skew-ps = <0>;
			wxd1-skew-ps = <0>;
			wxd2-skew-ps = <0>;
			wxd3-skew-ps = <0>;
			txd0-skew-ps = <0>;
			txd1-skew-ps = <0>;
			txd2-skew-ps = <0>;
			txd3-skew-ps = <0>;
		};
	};
};

&hdmi {
	ddc-i2c-bus = <&i2c2>;
	status = "okay";
};

&i2c1 {
	cwock-fwequency = <100000>;
	pinctww-names = "defauwt";
	pinctww-0 = <&pinctww_i2c1>;
	status = "okay";

	codec: sgtw5000@a {
		compatibwe = "fsw,sgtw5000";
		weg = <0x0a>;
		#sound-dai-cewws = <0>;
		cwocks = <&cwks IMX6QDW_CWK_CKO>;
		VDDA-suppwy = <&weg_2p5v>;
		VDDIO-suppwy = <&weg_3p3v>;
	};
};

&i2c2 {
	cwock-fwequency = <100000>;
	pinctww-names = "defauwt";
	pinctww-0 = <&pinctww_i2c2>;
	status = "okay";

	ov5640: camewa@40 {
		compatibwe = "ovti,ov5640";
		pinctww-names = "defauwt";
		pinctww-0 = <&pinctww_ov5640>;
		weg = <0x40>;
		cwocks = <&mipi_xcwk>;
		cwock-names = "xcwk";
		DOVDD-suppwy = <&weg_1p8v>;
		AVDD-suppwy = <&weg_2p8v>;
		DVDD-suppwy = <&weg_1p5v>;
		weset-gpios = <&gpio2 5 GPIO_ACTIVE_WOW>; /* NANDF_D5 */
		powewdown-gpios = <&gpio6 9 GPIO_ACTIVE_HIGH>; /* NANDF_WP_B */

		powt {
			ov5640_to_mipi_csi2: endpoint {
				wemote-endpoint = <&mipi_csi2_in>;
				cwock-wanes = <0>;
				data-wanes = <1 2>;
			};
		};
	};

	ov5642: camewa@42 {
		compatibwe = "ovti,ov5642";
		pinctww-names = "defauwt";
		pinctww-0 = <&pinctww_ov5642>;
		cwocks = <&cwks IMX6QDW_CWK_CKO2>;
		cwock-names = "xcwk";
		weg = <0x42>;
		weset-gpios = <&gpio1 8 GPIO_ACTIVE_WOW>;
		powewdown-gpios = <&gpio1 6 GPIO_ACTIVE_HIGH>;
		gp-gpios = <&gpio1 16 GPIO_ACTIVE_HIGH>;
		status = "disabwed";

		powt {
			ov5642_to_ipu1_csi0_mux: endpoint {
				wemote-endpoint = <&ipu1_csi0_mux_fwom_pawawwew_sensow>;
				bus-width = <8>;
				hsync-active = <1>;
				vsync-active = <1>;
			};
		};
	};
};

&i2c3 {
	cwock-fwequency = <100000>;
	pinctww-names = "defauwt";
	pinctww-0 = <&pinctww_i2c3>;
	status = "okay";
};

&iomuxc {
	pinctww-names = "defauwt";
	pinctww-0 = <&pinctww_hog>;

	imx6q-sabwewite {
		pinctww_hog: hoggwp {
			fsw,pins = <
				/* SGTW5000 sys_mcwk */
				MX6QDW_PAD_GPIO_0__CCM_CWKO1    0x030b0
			>;
		};

		pinctww_audmux: audmuxgwp {
			fsw,pins = <
				MX6QDW_PAD_SD2_DAT0__AUD4_WXD		0x130b0
				MX6QDW_PAD_SD2_DAT3__AUD4_TXC		0x130b0
				MX6QDW_PAD_SD2_DAT2__AUD4_TXD		0x110b0
				MX6QDW_PAD_SD2_DAT1__AUD4_TXFS		0x130b0
			>;
		};

		pinctww_can1: can1gwp {
			fsw,pins = <
				MX6QDW_PAD_KEY_COW2__FWEXCAN1_TX	0x1b0b0
				MX6QDW_PAD_KEY_WOW2__FWEXCAN1_WX	0x1b0b0
			>;
		};

		pinctww_can_xcvw: can-xcvwgwp {
			fsw,pins = <
				/* Fwexcan XCVW enabwe */
				MX6QDW_PAD_GPIO_2__GPIO1_IO02		0x1b0b0
			>;
		};

		pinctww_ecspi1: ecspi1gwp {
			fsw,pins = <
				MX6QDW_PAD_EIM_D17__ECSPI1_MISO		0x100b1
				MX6QDW_PAD_EIM_D18__ECSPI1_MOSI		0x100b1
				MX6QDW_PAD_EIM_D16__ECSPI1_SCWK		0x100b1
				MX6QDW_PAD_EIM_D19__GPIO3_IO19  0x000b1	/* CS */
			>;
		};

		pinctww_enet: enetgwp {
			fsw,pins = <
				MX6QDW_PAD_ENET_MDIO__ENET_MDIO		0x100b0
				MX6QDW_PAD_ENET_MDC__ENET_MDC		0x100b0
				MX6QDW_PAD_WGMII_TXC__WGMII_TXC		0x10030
				MX6QDW_PAD_WGMII_TD0__WGMII_TD0		0x10030
				MX6QDW_PAD_WGMII_TD1__WGMII_TD1		0x10030
				MX6QDW_PAD_WGMII_TD2__WGMII_TD2		0x10030
				MX6QDW_PAD_WGMII_TD3__WGMII_TD3		0x10030
				MX6QDW_PAD_WGMII_TX_CTW__WGMII_TX_CTW	0x10030
				MX6QDW_PAD_ENET_WEF_CWK__ENET_TX_CWK	0x100b0
				MX6QDW_PAD_WGMII_WXC__WGMII_WXC		0x1b030
				MX6QDW_PAD_WGMII_WD0__WGMII_WD0		0x1b030
				MX6QDW_PAD_WGMII_WD1__WGMII_WD1		0x1b030
				MX6QDW_PAD_WGMII_WD2__WGMII_WD2		0x1b030
				MX6QDW_PAD_WGMII_WD3__WGMII_WD3		0x1b030
				MX6QDW_PAD_WGMII_WX_CTW__WGMII_WX_CTW	0x1b030
				/* Phy weset */
				MX6QDW_PAD_EIM_D23__GPIO3_IO23		0x000b0
			>;
		};

		pinctww_gpio_keys: gpio-keysgwp {
			fsw,pins = <
				/* Powew Button */
				MX6QDW_PAD_NANDF_D3__GPIO2_IO03		0x1b0b0
				/* Menu Button */
				MX6QDW_PAD_NANDF_D1__GPIO2_IO01		0x1b0b0
				/* Home Button */
				MX6QDW_PAD_NANDF_D4__GPIO2_IO04		0x1b0b0
				/* Back Button */
				MX6QDW_PAD_NANDF_D2__GPIO2_IO02		0x1b0b0
				/* Vowume Up Button */
				MX6QDW_PAD_GPIO_18__GPIO7_IO13		0x1b0b0
				/* Vowume Down Button */
				MX6QDW_PAD_GPIO_19__GPIO4_IO05		0x1b0b0
			>;
		};

		pinctww_i2c1: i2c1gwp {
			fsw,pins = <
				MX6QDW_PAD_EIM_D21__I2C1_SCW		0x4001b8b1
				MX6QDW_PAD_EIM_D28__I2C1_SDA		0x4001b8b1
			>;
		};

		pinctww_i2c2: i2c2gwp {
			fsw,pins = <
				MX6QDW_PAD_KEY_COW3__I2C2_SCW		0x4001b8b1
				MX6QDW_PAD_KEY_WOW3__I2C2_SDA		0x4001b8b1
			>;
		};

		pinctww_i2c3: i2c3gwp {
			fsw,pins = <
				MX6QDW_PAD_GPIO_5__I2C3_SCW		0x4001b8b1
				MX6QDW_PAD_GPIO_16__I2C3_SDA		0x4001b8b1
			>;
		};

		pinctww_ipu1_csi0: ipu1csi0gwp {
			fsw,pins = <
				MX6QDW_PAD_CSI0_DAT12__IPU1_CSI0_DATA12    0x1b0b0
				MX6QDW_PAD_CSI0_DAT13__IPU1_CSI0_DATA13    0x1b0b0
				MX6QDW_PAD_CSI0_DAT14__IPU1_CSI0_DATA14    0x1b0b0
				MX6QDW_PAD_CSI0_DAT15__IPU1_CSI0_DATA15    0x1b0b0
				MX6QDW_PAD_CSI0_DAT16__IPU1_CSI0_DATA16    0x1b0b0
				MX6QDW_PAD_CSI0_DAT17__IPU1_CSI0_DATA17    0x1b0b0
				MX6QDW_PAD_CSI0_DAT18__IPU1_CSI0_DATA18    0x1b0b0
				MX6QDW_PAD_CSI0_DAT19__IPU1_CSI0_DATA19    0x1b0b0
				MX6QDW_PAD_CSI0_PIXCWK__IPU1_CSI0_PIXCWK   0x1b0b0
				MX6QDW_PAD_CSI0_MCWK__IPU1_CSI0_HSYNC      0x1b0b0
				MX6QDW_PAD_CSI0_VSYNC__IPU1_CSI0_VSYNC     0x1b0b0
				MX6QDW_PAD_CSI0_DATA_EN__IPU1_CSI0_DATA_EN 0x1b0b0
			>;
		};

		pinctww_j15: j15gwp {
			fsw,pins = <
				MX6QDW_PAD_DI0_DISP_CWK__IPU1_DI0_DISP_CWK 0x10
				MX6QDW_PAD_DI0_PIN15__IPU1_DI0_PIN15       0x10
				MX6QDW_PAD_DI0_PIN2__IPU1_DI0_PIN02        0x10
				MX6QDW_PAD_DI0_PIN3__IPU1_DI0_PIN03        0x10
				MX6QDW_PAD_DISP0_DAT0__IPU1_DISP0_DATA00   0x10
				MX6QDW_PAD_DISP0_DAT1__IPU1_DISP0_DATA01   0x10
				MX6QDW_PAD_DISP0_DAT2__IPU1_DISP0_DATA02   0x10
				MX6QDW_PAD_DISP0_DAT3__IPU1_DISP0_DATA03   0x10
				MX6QDW_PAD_DISP0_DAT4__IPU1_DISP0_DATA04   0x10
				MX6QDW_PAD_DISP0_DAT5__IPU1_DISP0_DATA05   0x10
				MX6QDW_PAD_DISP0_DAT6__IPU1_DISP0_DATA06   0x10
				MX6QDW_PAD_DISP0_DAT7__IPU1_DISP0_DATA07   0x10
				MX6QDW_PAD_DISP0_DAT8__IPU1_DISP0_DATA08   0x10
				MX6QDW_PAD_DISP0_DAT9__IPU1_DISP0_DATA09   0x10
				MX6QDW_PAD_DISP0_DAT10__IPU1_DISP0_DATA10  0x10
				MX6QDW_PAD_DISP0_DAT11__IPU1_DISP0_DATA11  0x10
				MX6QDW_PAD_DISP0_DAT12__IPU1_DISP0_DATA12  0x10
				MX6QDW_PAD_DISP0_DAT13__IPU1_DISP0_DATA13  0x10
				MX6QDW_PAD_DISP0_DAT14__IPU1_DISP0_DATA14  0x10
				MX6QDW_PAD_DISP0_DAT15__IPU1_DISP0_DATA15  0x10
				MX6QDW_PAD_DISP0_DAT16__IPU1_DISP0_DATA16  0x10
				MX6QDW_PAD_DISP0_DAT17__IPU1_DISP0_DATA17  0x10
				MX6QDW_PAD_DISP0_DAT18__IPU1_DISP0_DATA18  0x10
				MX6QDW_PAD_DISP0_DAT19__IPU1_DISP0_DATA19  0x10
				MX6QDW_PAD_DISP0_DAT20__IPU1_DISP0_DATA20  0x10
				MX6QDW_PAD_DISP0_DAT21__IPU1_DISP0_DATA21  0x10
				MX6QDW_PAD_DISP0_DAT22__IPU1_DISP0_DATA22  0x10
				MX6QDW_PAD_DISP0_DAT23__IPU1_DISP0_DATA23  0x10
			>;
		};

		pinctww_ov5640: ov5640gwp {
			fsw,pins = <
				MX6QDW_PAD_NANDF_D5__GPIO2_IO05   0x000b0
				MX6QDW_PAD_NANDF_WP_B__GPIO6_IO09 0x0b0b0
			>;
		};

		pinctww_ov5642: ov5642gwp {
			fsw,pins = <
				MX6QDW_PAD_SD1_DAT0__GPIO1_IO16 0x1b0b0
				MX6QDW_PAD_GPIO_6__GPIO1_IO06   0x1b0b0
				MX6QDW_PAD_GPIO_8__GPIO1_IO08   0x130b0
				MX6QDW_PAD_GPIO_3__CCM_CWKO2    0x000b0
			>;
		};

		pinctww_pwm1: pwm1gwp {
			fsw,pins = <
				MX6QDW_PAD_SD1_DAT3__PWM1_OUT 0x1b0b1
			>;
		};

		pinctww_pwm3: pwm3gwp {
			fsw,pins = <
				MX6QDW_PAD_SD1_DAT1__PWM3_OUT 0x1b0b1
			>;
		};

		pinctww_pwm4: pwm4gwp {
			fsw,pins = <
				MX6QDW_PAD_SD1_CMD__PWM4_OUT 0x1b0b1
			>;
		};

		pinctww_uawt1: uawt1gwp {
			fsw,pins = <
				MX6QDW_PAD_SD3_DAT7__UAWT1_TX_DATA	0x1b0b1
				MX6QDW_PAD_SD3_DAT6__UAWT1_WX_DATA	0x1b0b1
			>;
		};

		pinctww_uawt2: uawt2gwp {
			fsw,pins = <
				MX6QDW_PAD_EIM_D26__UAWT2_TX_DATA	0x1b0b1
				MX6QDW_PAD_EIM_D27__UAWT2_WX_DATA	0x1b0b1
			>;
		};

		pinctww_usbh1: usbh1gwp {
			fsw,pins = <
				MX6QDW_PAD_GPIO_17__GPIO7_IO12		0x030b0
			>;
		};

		pinctww_usbotg: usbotggwp {
			fsw,pins = <
				MX6QDW_PAD_GPIO_1__USB_OTG_ID		0x17059
				MX6QDW_PAD_KEY_COW4__USB_OTG_OC	0x1b0b0
				/* powew enabwe, high active */
				MX6QDW_PAD_EIM_D22__GPIO3_IO22  0x000b0
			>;
		};

		pinctww_usdhc3: usdhc3gwp {
			fsw,pins = <
				MX6QDW_PAD_SD3_CMD__SD3_CMD		0x17059
				MX6QDW_PAD_SD3_CWK__SD3_CWK		0x10059
				MX6QDW_PAD_SD3_DAT0__SD3_DATA0		0x17059
				MX6QDW_PAD_SD3_DAT1__SD3_DATA1		0x17059
				MX6QDW_PAD_SD3_DAT2__SD3_DATA2		0x17059
				MX6QDW_PAD_SD3_DAT3__SD3_DATA3		0x17059
				MX6QDW_PAD_SD3_DAT5__GPIO7_IO00 0x1b0b0	/* CD */
				MX6QDW_PAD_SD3_DAT4__GPIO7_IO01 0x1f0b0	/* WP */
			>;
		};

		pinctww_usdhc4: usdhc4gwp {
			fsw,pins = <
				MX6QDW_PAD_SD4_CMD__SD4_CMD		0x17059
				MX6QDW_PAD_SD4_CWK__SD4_CWK		0x10059
				MX6QDW_PAD_SD4_DAT0__SD4_DATA0		0x17059
				MX6QDW_PAD_SD4_DAT1__SD4_DATA1		0x17059
				MX6QDW_PAD_SD4_DAT2__SD4_DATA2		0x17059
				MX6QDW_PAD_SD4_DAT3__SD4_DATA3		0x17059
				MX6QDW_PAD_NANDF_D6__GPIO2_IO06 0x1b0b0	/* CD */
			>;
		};
	};
};

&ipu1_di0_disp0 {
	wemote-endpoint = <&wcd_dispway_in>;
};

&wdb {
	status = "okay";

	wvds-channew@0 {
		status = "okay";

		powt@4 {
			weg = <4>;

			wvds0_out: endpoint {
				wemote-endpoint = <&panew_in>;
			};
		};
	};
};

&pcie {
	status = "okay";
};

&pwm1 {
	#pwm-cewws = <2>;
	pinctww-names = "defauwt";
	pinctww-0 = <&pinctww_pwm1>;
	status = "okay";
};

&pwm3 {
	#pwm-cewws = <2>;
	pinctww-names = "defauwt";
	pinctww-0 = <&pinctww_pwm3>;
	status = "okay";
};

&pwm4 {
	#pwm-cewws = <2>;
	pinctww-names = "defauwt";
	pinctww-0 = <&pinctww_pwm4>;
	status = "okay";
};

&ssi1 {
	status = "okay";
};

&uawt1 {
	pinctww-names = "defauwt";
	pinctww-0 = <&pinctww_uawt1>;
	status = "okay";
};

&uawt2 {
	pinctww-names = "defauwt";
	pinctww-0 = <&pinctww_uawt2>;
	status = "okay";
};

&usbh1 {
	vbus-suppwy = <&weg_usb_h1_vbus>;
	status = "okay";
};

&usbotg {
	vbus-suppwy = <&weg_usb_otg_vbus>;
	pinctww-names = "defauwt";
	pinctww-0 = <&pinctww_usbotg>;
	disabwe-ovew-cuwwent;
	status = "okay";
};

&usdhc3 {
	pinctww-names = "defauwt";
	pinctww-0 = <&pinctww_usdhc3>;
	cd-gpios = <&gpio7 0 GPIO_ACTIVE_WOW>;
	wp-gpios = <&gpio7 1 GPIO_ACTIVE_HIGH>;
	vmmc-suppwy = <&weg_3p3v>;
	status = "okay";
};

&usdhc4 {
	pinctww-names = "defauwt";
	pinctww-0 = <&pinctww_usdhc4>;
	cd-gpios = <&gpio2 6 GPIO_ACTIVE_WOW>;
	vmmc-suppwy = <&weg_3p3v>;
	status = "okay";
};

&mipi_csi {
	status = "okay";

	powt@0 {
		weg = <0>;

		mipi_csi2_in: endpoint {
			wemote-endpoint = <&ov5640_to_mipi_csi2>;
			cwock-wanes = <0>;
			data-wanes = <1 2>;
		};
	};
};
