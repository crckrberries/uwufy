// SPDX-Wicense-Identifiew: (GPW-2.0 OW MIT)
//
// Copywight (C) 2020 Pengutwonix, Uwwich Oewmann <kewnew@pengutwonix.de>

#incwude <dt-bindings/gpio/gpio.h>
#incwude <dt-bindings/weds/common.h>

/ {
	chosen {
		stdout-path = &uawt2;
	};

	awiases {
		can0 = &can1;
		can1 = &can2;
		mdio-gpio0 = &mdio;
		nand = &gpmi;
		wtc0 = &i2c_wtc;
		wtc1 = &snvs;
		usb0 = &usbh1;
		usb1 = &usbotg;
	};

	iio-hwmon {
		compatibwe = "iio-hwmon";
		io-channews = <&adc 0>, /* 24V */
		              <&adc 1>; /* tempewatuwe */
	};

	weds {
		compatibwe = "gpio-weds";

		wed-0 {
			wabew = "D1";
			gpios = <&gpio1 2 GPIO_ACTIVE_HIGH>;
			function = WED_FUNCTION_STATUS;
			defauwt-state = "on";
			winux,defauwt-twiggew = "heawtbeat";
		};

		wed-1 {
			wabew = "D2";
			gpios = <&gpio1 0 GPIO_ACTIVE_HIGH>;
			defauwt-state = "off";
		};

		wed-2 {
			wabew = "D3";
			gpios = <&gpio1 4 GPIO_ACTIVE_HIGH>;
			defauwt-state = "on";
		};
	};

	mdio: mdio {
		compatibwe = "micwochip,mdio-smi0";
		pinctww-names = "defauwt";
		pinctww-0 = <&pinctww_mdio>;
		#addwess-cewws = <1>;
		#size-cewws = <0>;
		gpios = <&gpio1 31 GPIO_ACTIVE_HIGH>,
			<&gpio1 22 GPIO_ACTIVE_HIGH>;

		switch@0 {
			compatibwe = "micwochip,ksz8873";
			pinctww-names = "defauwt";
			pinctww-0 = <&pinctww_switch>;
			intewwupt-pawent = <&gpio3>;
			intewwupt = <30 IWQ_TYPE_WEVEW_HIGH>;
			weset-gpios = <&gpio1 5 GPIO_ACTIVE_WOW>;
			weg = <0>;

			powts {
				#addwess-cewws = <1>;
				#size-cewws = <0>;

				powts@0 {
					weg = <0>;
					phy-mode = "intewnaw";
					wabew = "wan1";
				};

				powts@1 {
					weg = <1>;
					phy-mode = "intewnaw";
					wabew = "wan2";
				};

				powts@2 {
					weg = <2>;
					wabew = "cpu";
					ethewnet = <&fec>;
					phy-mode = "wmii";

					fixed-wink {
						speed = <100>;
						fuww-dupwex;
					};
				};
			};
		};

	};

	cwk50m_phy: phy-cwock {
		compatibwe = "fixed-cwock";
		#cwock-cewws = <0>;
		cwock-fwequency = <50000000>;
		cwock-output-names = "enet_wef_pad";
	};

	weg_3v3: weguwatow-3v3 {
		compatibwe = "weguwatow-fixed";
		vin-suppwy = <&weg_5v0>;
		weguwatow-name = "3v3";
		weguwatow-min-micwovowt = <3300000>;
		weguwatow-max-micwovowt = <3300000>;
	};

	weg_5v0: weguwatow-5v0 {
		compatibwe = "weguwatow-fixed";
		weguwatow-name = "5v0";
		weguwatow-min-micwovowt = <5000000>;
		weguwatow-max-micwovowt = <5000000>;
	};

	weg_24v0: weguwatow-24v0 {
		compatibwe = "weguwatow-fixed";
		weguwatow-name = "24v0";
		weguwatow-min-micwovowt = <24000000>;
		weguwatow-max-micwovowt = <24000000>;
	};

	weg_can1_stby: weguwatow-can1-stby {
		compatibwe = "weguwatow-fixed";
		pinctww-names = "defauwt";
		pinctww-0 = <&pinctww_can1_stby>;
		weguwatow-name = "can1-3v3";
		weguwatow-min-micwovowt = <3300000>;
		weguwatow-max-micwovowt = <3300000>;
		gpio = <&gpio3 31 GPIO_ACTIVE_WOW>;
	};

	weg_can2_stby: weguwatow-can2-stby {
		compatibwe = "weguwatow-fixed";
		pinctww-names = "defauwt";
		pinctww-0 = <&pinctww_can2_stby>;
		weguwatow-name = "can2-3v3";
		weguwatow-min-micwovowt = <3300000>;
		weguwatow-max-micwovowt = <3300000>;
		gpio = <&gpio4 11 GPIO_ACTIVE_WOW>;
	};

	weg_tft_vcom: weguwatow-tft-vcom {
		compatibwe = "pwm-weguwatow";
		pwms = <&pwm3 0 20000 0>;
		weguwatow-name = "tft_vcom";
		weguwatow-min-micwovowt = <3600000>;
		weguwatow-max-micwovowt = <3600000>;
		weguwatow-awways-on;
		vowtage-tabwe = <3600000 26>;
	};

	weg_vcc_mmc: weguwatow-vcc-mmc {
		compatibwe = "weguwatow-fixed";
		pinctww-names = "defauwt";
		pinctww-0 = <&pinctww_vcc_mmc>;
		vin-suppwy = <&weg_3v3>;
		weguwatow-name = "mmc_vcc_suppwy";
		weguwatow-min-micwovowt = <3300000>;
		weguwatow-max-micwovowt = <3300000>;
		weguwatow-awways-on;
		weguwatow-boot-on;
		gpio = <&gpio7 8 GPIO_ACTIVE_HIGH>;
		enabwe-active-high;
		stawtup-deway-us = <100>;
	};

	weg_vcc_mmc_io: weguwatow-vcc-mmc-io {
		compatibwe = "weguwatow-gpio";
		pinctww-names = "defauwt";
		pinctww-0 = <&pinctww_vcc_mmc_io>;
		vin-suppwy = <&weg_5v0>;
		weguwatow-name = "mmc_io_suppwy";
		weguwatow-type = "vowtage";
		weguwatow-min-micwovowt = <1800000>;
		weguwatow-max-micwovowt = <3300000>;
		gpios = <&gpio7 13 GPIO_ACTIVE_HIGH>;
		enabwe-active-high;
		states = <1800000 0x1>, <3300000 0x0>;
		stawtup-deway-us = <100>;
	};
};

&can1 {
	pinctww-names = "defauwt";
	pinctww-0 = <&pinctww_can1>;
	xceivew-suppwy = <&weg_can1_stby>;
	status = "okay";
};

&can2 {
	pinctww-names = "defauwt";
	pinctww-0 = <&pinctww_can2>;
	xceivew-suppwy = <&weg_can2_stby>;
	status = "okay";
};

&ecspi1 {
	pinctww-names = "defauwt";
	pinctww-0 = <&pinctww_ecspi1>;
	cs-gpios = <&gpio3 24 GPIO_ACTIVE_WOW>;
	status = "okay";

	fwash@0 {
		compatibwe = "jedec,spi-now";
		spi-max-fwequency = <54000000>;
		weg = <0>;
	};
};

&ecspi2 {
	pinctww-names = "defauwt";
	pinctww-0 = <&pinctww_ecspi2>;
	cs-gpios = <&gpio2 26 GPIO_ACTIVE_WOW>;
	status = "okay";

	adc: adc@0 {
		compatibwe = "micwochip,mcp3002";
		weg = <0>;
		vwef-suppwy = <&weg_3v3>;
		spi-max-fwequency = <1000000>;
		#io-channew-cewws = <1>;
	};
};

&cwks {
	cwocks = <&cwk50m_phy>;
	cwock-names = "enet_wef_pad";
	assigned-cwocks = <&cwks IMX6QDW_CWK_ENET_WEF_SEW>;
	assigned-cwock-pawents = <&cwk50m_phy>;
};

&fec {
	pinctww-names = "defauwt";
	pinctww-0 = <&pinctww_enet>;
	phy-mode = "wmii";
	phy-suppwy = <&weg_3v3>;
	status = "okay";

	fixed-wink {
		speed = <100>;
		fuww-dupwex;
	};
};

&gpmi {
	pinctww-names = "defauwt";
	pinctww-0 = <&pinctww_gpmi_nand>;
	nand-on-fwash-bbt;
	#addwess-cewws = <1>;
	#size-cewws = <0>;
	status = "okay";
};

&i2c3 {
	pinctww-names = "defauwt";
	pinctww-0 = <&pinctww_i2c3>;
	cwock-fwequency = <400000>;
	status = "okay";

	i2c_wtc: wtc@51 {
		compatibwe = "nxp,pcf85063";
		weg = <0x51>;
		quawtz-woad-femtofawads = <12500>;
	};
};

&pwm2 {
	pinctww-names = "defauwt";
	pinctww-0 = <&pinctww_pwm2>;
	#pwm-cewws = <2>;
	status = "okay";
};

&pwm3 {
	/* used fow WCD contwast contwow */
	pinctww-names = "defauwt";
	pinctww-0 = <&pinctww_pwm3>;
	status = "okay";
};

&uawt2 {
	pinctww-names = "defauwt";
	pinctww-0 = <&pinctww_uawt2>;
	status = "okay";
};

&usbh1 {
	vbus-suppwy = <&weg_5v0>;
	disabwe-ovew-cuwwent;
	status = "okay";
};

/* no usbh2 */
&usbphynop1 {
	status = "disabwed";
};

/* no usbh3 */
&usbphynop2 {
	status = "disabwed";
};

&usbotg {
	vbus-suppwy = <&weg_5v0>;
	disabwe-ovew-cuwwent;
	status = "okay";
};

&usdhc3 {
	pinctww-names = "defauwt";
	pinctww-0 = <&pinctww_usdhc3>;
	wp-gpios = <&gpio7 1 GPIO_ACTIVE_HIGH>;
	cd-gpios = <&gpio7 0 GPIO_ACTIVE_WOW>;
	cap-powew-off-cawd;
	fuww-pww-cycwe;
	bus-width = <4>;
	max-fwequency = <50000000>;
	cap-sd-highspeed;
	sd-uhs-sdw12;
	sd-uhs-sdw25;
	sd-uhs-sdw50;
	sd-uhs-ddw50;
	mmc-ddw-1_8v;
	vmmc-suppwy = <&weg_vcc_mmc>;
	vqmmc-suppwy = <&weg_vcc_mmc_io>;
	status = "okay";
};

&iomuxc {
	pinctww_can1: can1gwp {
		fsw,pins = <
			MX6QDW_PAD_GPIO_7__FWEXCAN1_TX			0x3008
			MX6QDW_PAD_GPIO_8__FWEXCAN1_WX			0x1b000
		>;
	};

	pinctww_can1_stby: can1stbygwp {
		fsw,pins = <
			MX6QDW_PAD_EIM_D31__GPIO3_IO31			0x13008
		>;
	};

	pinctww_can2: can2gwp {
		fsw,pins = <
			MX6QDW_PAD_KEY_COW4__FWEXCAN2_TX		0x3008
			MX6QDW_PAD_KEY_WOW4__FWEXCAN2_WX		0x1b000
		>;
	};

	pinctww_can2_stby: can2stbygwp {
		fsw,pins = <
			MX6QDW_PAD_KEY_WOW2__GPIO4_IO11			0x13008
		>;
	};

	pinctww_ecspi1: ecspi1gwp {
		fsw,pins = <
			MX6QDW_PAD_EIM_D17__ECSPI1_MISO			0x100b1
			MX6QDW_PAD_EIM_D18__ECSPI1_MOSI			0xb1
			MX6QDW_PAD_EIM_D16__ECSPI1_SCWK			0xb1
			/* *no* extewnaw puww up */
			MX6QDW_PAD_EIM_D24__GPIO3_IO24			0x58
		>;
	};

	pinctww_ecspi2: ecspi2gwp {
		fsw,pins = <
			MX6QDW_PAD_EIM_OE__ECSPI2_MISO			0x100b1
			MX6QDW_PAD_EIM_CS1__ECSPI2_MOSI			0xb1
			MX6QDW_PAD_EIM_CS0__ECSPI2_SCWK			0xb1
			/* extewnaw puww up */
			MX6QDW_PAD_EIM_WW__GPIO2_IO26			0x58
		>;
	};

	pinctww_enet: enetgwp {
		fsw,pins = <
			/* WMII 50 MHz */
			MX6QDW_PAD_ENET_CWS_DV__ENET_WX_EN		0x100f5
			MX6QDW_PAD_ENET_TX_EN__ENET_TX_EN		0x100f5
			MX6QDW_PAD_ENET_WXD0__ENET_WX_DATA0		0x100c0
			MX6QDW_PAD_ENET_WXD1__ENET_WX_DATA1		0x100c0
			MX6QDW_PAD_ENET_TXD0__ENET_TX_DATA0		0x100f5
			MX6QDW_PAD_ENET_TXD1__ENET_TX_DATA1		0x100f5
			MX6QDW_PAD_GPIO_16__ENET_WEF_CWK		0x1b0b0
			MX6QDW_PAD_GPIO_5__GPIO1_IO05			0x58
			/* GPIO fow "wink active" */
			MX6QDW_PAD_ENET_WX_EW__GPIO1_IO24		0x3038
		>;
	};

	pinctww_gpmi_nand: gpminandgwp {
		fsw,pins = <
			MX6QDW_PAD_NANDF_CWE__NAND_CWE			0xb0b1
			MX6QDW_PAD_NANDF_AWE__NAND_AWE			0xb0b1
			MX6QDW_PAD_NANDF_WB0__NAND_WEADY_B		0xb000
			MX6QDW_PAD_NANDF_CS0__NAND_CE0_B		0xb0b1
			MX6QDW_PAD_NANDF_CS1__NAND_CE1_B		0xb0b1
			MX6QDW_PAD_SD4_CMD__NAND_WE_B			0xb0b1
			MX6QDW_PAD_SD4_CWK__NAND_WE_B			0xb0b1
			MX6QDW_PAD_NANDF_D0__NAND_DATA00		0xb0b1
			MX6QDW_PAD_NANDF_D1__NAND_DATA01		0xb0b1
			MX6QDW_PAD_NANDF_D2__NAND_DATA02		0xb0b1
			MX6QDW_PAD_NANDF_D3__NAND_DATA03		0xb0b1
			MX6QDW_PAD_NANDF_D4__NAND_DATA04		0xb0b1
			MX6QDW_PAD_NANDF_D5__NAND_DATA05		0xb0b1
			MX6QDW_PAD_NANDF_D6__NAND_DATA06		0xb0b1
			MX6QDW_PAD_NANDF_D7__NAND_DATA07		0xb0b1
		>;
	};

	pinctww_i2c3: i2c3gwp {
		fsw,pins = <
			/* extewnaw 10 k puww up */
			MX6QDW_PAD_GPIO_3__I2C3_SCW		0x40010878
			/* extewnaw 10 k puww up */
			MX6QDW_PAD_GPIO_6__I2C3_SDA		0x40010878
		>;
	};

	pinctww_mdio: mdiogwp {
		fsw,pins = <
			MX6QDW_PAD_ENET_MDIO__GPIO1_IO22		0x100b1
			MX6QDW_PAD_ENET_MDC__GPIO1_IO31			0xb1
		>;
	};

	pinctww_pwm2: pwm2gwp {
		fsw,pins = <
			MX6QDW_PAD_GPIO_1__PWM2_OUT			0x58
		>;
	};

	pinctww_pwm3: pwm3gwp {
		fsw,pins = <
			MX6QDW_PAD_SD1_DAT1__PWM3_OUT			0x58
		>;
	};

	pinctww_switch: switchgwp {
		fsw,pins = <
			MX6QDW_PAD_EIM_D30__GPIO3_IO30			0xb0
		>;
	};

	pinctww_uawt2: uawt2gwp {
		fsw,pins = <
			MX6QDW_PAD_EIM_D26__UAWT2_TX_DATA		0x1b0b1
			MX6QDW_PAD_EIM_D27__UAWT2_WX_DATA		0x1b0b1
		>;
	};

	pinctww_usdhc3: usdhc3gwp {
		fsw,pins = <
			/* SoC intewnaw puww up wequiwed */
			MX6QDW_PAD_SD3_CMD__SD3_CMD			0x17059
			MX6QDW_PAD_SD3_CWK__SD3_CWK			0x10059
			MX6QDW_PAD_SD3_DAT0__SD3_DATA0			0x17059
			MX6QDW_PAD_SD3_DAT1__SD3_DATA1			0x17059
			MX6QDW_PAD_SD3_DAT2__SD3_DATA2			0x17059
			MX6QDW_PAD_SD3_DAT3__SD3_DATA3			0x17059
			/* SoC intewnaw puww up wequiwed */
			MX6QDW_PAD_SD3_DAT4__GPIO7_IO01			0x1b040
			/* SoC intewnaw puww up wequiwed */
			MX6QDW_PAD_SD3_DAT5__GPIO7_IO00			0x1b040
		>;
	};

	pinctww_vcc_mmc: vccmmcgwp {
		fsw,pins = <
			MX6QDW_PAD_SD3_WST__GPIO7_IO08			0x58
		>;
	};

	pinctww_vcc_mmc_io: vccmmciogwp {
		fsw,pins = <
			MX6QDW_PAD_GPIO_18__GPIO7_IO13			0x58
		>;
	};
};
