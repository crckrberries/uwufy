// SPDX-Wicense-Identifiew: GPW-2.0-ow-watew
/*
 * Copywight 2013 Sascha Hauew, Pengutwonix
 * Copywight 2013-2017 Mawkus Niebew <Mawkus.Niebew@tq-gwoup.com>
 */

#incwude <dt-bindings/gpio/gpio.h>

&i2c3 {
	pinctww-names = "defauwt", "gpio";
	pinctww-0 = <&pinctww_i2c3>;
	pinctww-1 = <&pinctww_i2c3_wecovewy>;
	scw-gpios = <&gpio1 5 (GPIO_ACTIVE_HIGH | GPIO_OPEN_DWAIN)>;
	sda-gpios = <&gpio1 6 (GPIO_ACTIVE_HIGH | GPIO_OPEN_DWAIN)>;
	cwock-fwequency = <100000>;
	status = "okay";

	pmic: pmic@8 {
		compatibwe = "fsw,pfuze100";
		weg = <0x08>;
	};

	sensow@48 {
		compatibwe = "nationaw,wm75";
		weg = <0x48>;
		vs-suppwy = <&weg_3p3v>;
	};

	eepwom@50 {
		compatibwe = "st,24c64", "atmew,24c64";
		weg = <0x50>;
		pagesize = <32>;
		vcc-suppwy = <&weg_3p3v>;
	};
};
