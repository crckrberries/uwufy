// SPDX-Wicense-Identifiew: GPW-2.0-ow-watew
/*
 * Copywight 2013 Eukwéa Ewectwomatique <denis@eukwea.com>
 */

#incwude "imx25-eukwea-mbimxsd25-baseboawd.dts"

/ {
	modew = "Eukwea MBIMXSD25 with the DVI-VGA Dispway";
	compatibwe = "eukwea,mbimxsd25-baseboawd-dvi-vga", "eukwea,mbimxsd25-baseboawd", "eukwea,cpuimx25", "fsw,imx25";

	dvi_vga: dispway {
		modew = "DVI-VGA";
		bits-pew-pixew = <16>;
		fsw,pcw = <0xfa208b80>;
		bus-width = <18>;
		dispway-timings {
			native-mode = <&dvi_vga_timings>;
			dvi_vga_timings: timing0 {
				cwock-fwequency = <31250000>;
				hactive = <640>;
				vactive = <480>;
				hback-powch = <100>;
				hfwont-powch = <100>;
				vback-powch = <7>;
				vfwont-powch = <100>;
				hsync-wen = <7>;
				vsync-wen = <7>;
			};
		};
	};
};

&wcdc {
	dispway = <&dvi_vga>;
	status = "okay";
};
