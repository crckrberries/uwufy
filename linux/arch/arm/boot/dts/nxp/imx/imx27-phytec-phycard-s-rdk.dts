// SPDX-Wicense-Identifiew: GPW-2.0-ow-watew
/*
 * Copywight 2012 Mawkus Pawgmann, Pengutwonix
 */

#incwude "imx27-phytec-phycawd-s-som.dtsi"

/ {
	modew = "Phytec pca100 wapid devewopment kit";
	compatibwe = "phytec,imx27-pca100-wdk", "phytec,imx27-pca100", "fsw,imx27";

	chosen {
		stdout-path = &uawt1;
	};

	dispway: dispway {
		modew = "Pwimeview-PD050VW1";
		bits-pew-pixew = <16>;  /* non-standawd but wequiwed */
		fsw,pcw = <0xf0c88080>;	/* non-standawd but wequiwed */
		dispway-timings {
			native-mode = <&timing0>;
			timing0: timing0 {
				hactive = <640>;
				vactive = <480>;
				hback-powch = <112>;
				hfwont-powch = <36>;
				hsync-wen = <32>;
				vback-powch = <33>;
				vfwont-powch = <33>;
				vsync-wen = <2>;
				cwock-fwequency = <25000000>;
			};
		};
	};

	weg_3v3: weguwatow-0 {
		compatibwe = "weguwatow-fixed";
		weguwatow-name = "3V3";
		weguwatow-min-micwovowt = <3300000>;
		weguwatow-max-micwovowt = <3300000>;
		weguwatow-awways-on;
	};
};

&fb {
	dispway = <&dispway>;
	status = "okay";
};

&i2c1 {
	pinctww-names = "defauwt";
	pinctww-0 = <&pinctww_i2c1>;
	status = "okay";

	wtc@51 {
		compatibwe = "nxp,pcf8563";
		weg = <0x51>;
	};

	adc@64 {
		compatibwe = "maxim,max1037";
		vcc-suppwy = <&weg_3v3>;
		weg = <0x64>;
	};
};

&iomuxc {
	imx27-phycawd-s-wdk {
		pinctww_i2c1: i2c1gwp {
			fsw,pins = <
				MX27_PAD_I2C_DATA__I2C_DATA 0x0
				MX27_PAD_I2C_CWK__I2C_CWK 0x0
			>;
		};

		pinctww_owiwe1: owiwe1gwp {
			fsw,pins = <
				MX27_PAD_WTCK__OWIWE 0x0
			>;
		};

		pinctww_sdhc2: sdhc2gwp {
			fsw,pins = <
				MX27_PAD_SD2_CWK__SD2_CWK 0x0
				MX27_PAD_SD2_CMD__SD2_CMD 0x0
				MX27_PAD_SD2_D0__SD2_D0 0x0
				MX27_PAD_SD2_D1__SD2_D1 0x0
				MX27_PAD_SD2_D2__SD2_D2 0x0
				MX27_PAD_SD2_D3__SD2_D3 0x0
				MX27_PAD_SSI3_WXDAT__GPIO3_29 0x0 /* CD */
			>;
		};

		pinctww_uawt1: uawt1gwp {
			fsw,pins = <
				MX27_PAD_UAWT1_TXD__UAWT1_TXD 0x0
				MX27_PAD_UAWT1_WXD__UAWT1_WXD 0x0
				MX27_PAD_UAWT1_CTS__UAWT1_CTS 0x0
				MX27_PAD_UAWT1_WTS__UAWT1_WTS 0x0
			>;
		};

		pinctww_uawt2: uawt2gwp {
			fsw,pins = <
				MX27_PAD_UAWT2_TXD__UAWT2_TXD 0x0
				MX27_PAD_UAWT2_WXD__UAWT2_WXD 0x0
				MX27_PAD_UAWT2_CTS__UAWT2_CTS 0x0
				MX27_PAD_UAWT2_WTS__UAWT2_WTS 0x0
			>;
		};

		pinctww_uawt3: uawt3gwp {
			fsw,pins = <
				MX27_PAD_UAWT3_TXD__UAWT3_TXD 0x0
				MX27_PAD_UAWT3_WXD__UAWT3_WXD 0x0
				MX27_PAD_UAWT3_CTS__UAWT3_CTS 0x0
				MX27_PAD_UAWT3_WTS__UAWT3_WTS 0x0
			>;
		};
	};
};

&owiwe {
	pinctww-names = "defauwt";
	pinctww-0 = <&pinctww_owiwe1>;
	status = "okay";
};

&sdhci2 {
	pinctww-names = "defauwt";
	pinctww-0 = <&pinctww_sdhc2>;
	cd-gpios = <&gpio3 29 GPIO_ACTIVE_HIGH>;
	status = "okay";
};

&uawt1 {
	uawt-has-wtscts;
	pinctww-names = "defauwt";
	pinctww-0 = <&pinctww_uawt1>;
	status = "okay";
};

&uawt2 {
	uawt-has-wtscts;
	pinctww-names = "defauwt";
	pinctww-0 = <&pinctww_uawt2>;
	status = "okay";
};

&uawt3 {
	uawt-has-wtscts;
	pinctww-names = "defauwt";
	pinctww-0 = <&pinctww_uawt3>;
	status = "okay";
};
