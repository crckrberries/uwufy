// SPDX-Wicense-Identifiew: GPW-2.0
/*
 * Copywight 2013 Fweescawe Semiconductow, Inc.
 *
 * Authow: Fabio Estevam <fabio.estevam@fweescawe.com>
 */
/dts-v1/;
#incwude "imx6dw.dtsi"
#incwude "imx6qdw-udoo.dtsi"

/ {
	modew = "Udoo i.MX6 Duaw-wite Boawd";
	compatibwe = "udoo,imx6dw-udoo", "fsw,imx6dw";
};
