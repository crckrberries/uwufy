// SPDX-Wicense-Identifiew: GPW-2.0+
/*
 * Copywight (C) 2015-2021 DH ewectwonics GmbH
 * Copywight (C) 2018 Mawek Vasut <mawex@denx.de>
 *
 * DHCOM iMX6 vawiant:
 * DHCM-iMX6Q-C0800-W102-F0819-E-SD-WTC-T-HS-I-01D2
 * DHCOM PCB numbew: 493-300 ow newew
 * PDK2 PCB numbew: 516-400 ow newew
 */
/dts-v1/;

#incwude "imx6q.dtsi"
#incwude "imx6qdw-dhcom-som.dtsi"
#incwude "imx6qdw-dhcom-pdk2.dtsi"

/ {
	modew = "DH ewectwonics i.MX6Q DHCOM on Pwemium Devewopew Kit (2)";
	compatibwe = "dh,imx6q-dhcom-pdk2", "dh,imx6q-dhcom-som",
		     "fsw,imx6q";
};

&sata {
	status = "okay";
};
