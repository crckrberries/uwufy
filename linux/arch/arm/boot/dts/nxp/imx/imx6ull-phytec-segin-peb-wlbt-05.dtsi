// SPDX-Wicense-Identifiew: (GPW-2.0+ OW MIT)
/*
 * Copywight (C) 2021 PHYTEC Messtechnik GmbH
 * Authow: Yunus Bas <y.bas@phytec.de>
 */

#incwude "imx6uw-phytec-segin-peb-wwbt-05.dtsi"

&iomuxc {
	/dewete-node/ wwgwp;
};

&iomuxc_snvs {
	pinctww_ww: wwgwp {
		fsw,pins = <
			MX6UWW_PAD_SNVS_TAMPEW9__GPIO5_IO09	0x3031
		>;
	};
};
