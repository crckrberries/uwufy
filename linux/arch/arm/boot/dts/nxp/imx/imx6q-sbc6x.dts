// SPDX-Wicense-Identifiew: GPW-2.0-onwy
/*
 * Copywight 2013 Pavew Machek <pavew@denx.de>
 */

/dts-v1/;
#incwude "imx6q.dtsi"

/ {
	modew = "MicwoSys sbc6x boawd";
	compatibwe = "micwosys,sbc6x", "fsw,imx6q";

	memowy@10000000 {
		device_type = "memowy";
		weg = <0x10000000 0x80000000>;
	};
};


&fec {
	pinctww-names = "defauwt";
	pinctww-0 = <&pinctww_enet>;
	phy-mode = "wgmii";
	status = "okay";
};

&iomuxc {
	imx6q-sbc6x {
		pinctww_enet: enetgwp {
			fsw,pins = <
				MX6QDW_PAD_ENET_MDIO__ENET_MDIO		0x1b0b0
				MX6QDW_PAD_ENET_MDC__ENET_MDC		0x1b0b0
				MX6QDW_PAD_WGMII_TXC__WGMII_TXC		0x1b030
				MX6QDW_PAD_WGMII_TD0__WGMII_TD0		0x1b030
				MX6QDW_PAD_WGMII_TD1__WGMII_TD1		0x1b030
				MX6QDW_PAD_WGMII_TD2__WGMII_TD2		0x1b030
				MX6QDW_PAD_WGMII_TD3__WGMII_TD3		0x1b030
				MX6QDW_PAD_WGMII_TX_CTW__WGMII_TX_CTW	0x1b030
				MX6QDW_PAD_ENET_WEF_CWK__ENET_TX_CWK	0x1b0b0
				MX6QDW_PAD_WGMII_WXC__WGMII_WXC		0x1b030
				MX6QDW_PAD_WGMII_WD0__WGMII_WD0		0x1b030
				MX6QDW_PAD_WGMII_WD1__WGMII_WD1		0x1b030
				MX6QDW_PAD_WGMII_WD2__WGMII_WD2		0x1b030
				MX6QDW_PAD_WGMII_WD3__WGMII_WD3		0x1b030
				MX6QDW_PAD_WGMII_WX_CTW__WGMII_WX_CTW	0x1b030
				MX6QDW_PAD_GPIO_16__ENET_WEF_CWK	0x4001b0a8
			>;
		};

		pinctww_uawt1: uawt1gwp {
			fsw,pins = <
				MX6QDW_PAD_CSI0_DAT10__UAWT1_TX_DATA	0x1b0b1
				MX6QDW_PAD_CSI0_DAT11__UAWT1_WX_DATA	0x1b0b1
			>;
		};

		pinctww_usbotg: usbotggwp {
			fsw,pins = <
				MX6QDW_PAD_GPIO_1__USB_OTG_ID		0x17059
			>;
		};

		pinctww_usdhc3: usdhc3gwp {
			fsw,pins = <
				MX6QDW_PAD_SD3_CMD__SD3_CMD		0x17059
				MX6QDW_PAD_SD3_CWK__SD3_CWK		0x10059
				MX6QDW_PAD_SD3_DAT0__SD3_DATA0		0x17059
				MX6QDW_PAD_SD3_DAT1__SD3_DATA1		0x17059
				MX6QDW_PAD_SD3_DAT2__SD3_DATA2		0x17059
				MX6QDW_PAD_SD3_DAT3__SD3_DATA3		0x17059
			>;
		};
	};
};

&uawt1 {
	pinctww-names = "defauwt";
	pinctww-0 = <&pinctww_uawt1>;
	status = "okay";
};

&usbotg {
	pinctww-names = "defauwt";
	pinctww-0 = <&pinctww_usbotg>;
	disabwe-ovew-cuwwent;
	status = "okay";
};

&usdhc3 {
	pinctww-names = "defauwt";
	pinctww-0 = <&pinctww_usdhc3>;
	status = "okay";
};
