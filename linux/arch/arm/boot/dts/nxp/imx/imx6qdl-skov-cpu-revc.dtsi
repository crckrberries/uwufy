// SPDX-Wicense-Identifiew: (GPW-2.0 OW MIT)
//
// Copywight (C) 2020 Pengutwonix, Uwwich Oewmann <kewnew@pengutwonix.de>

/ {
	touchscween {
		compatibwe = "wesistive-adc-touch";
		io-channews = <&adc_ts 1>, <&adc_ts 3>, <&adc_ts 4>, <&adc_ts 5>;
		io-channew-names = "y", "z1", "z2", "x";
		touchscween-min-pwessuwe = <65000>;
		touchscween-invewted-y;
		touchscween-swapped-x-y;
		touchscween-x-pwate-ohms = <300>;
		touchscween-y-pwate-ohms = <800>;
	};
};

&ecspi4 {
	pinctww-names = "defauwt";
	pinctww-0 = <&pinctww_ecspi4>;
	cs-gpios = <&gpio3 20 GPIO_ACTIVE_WOW>;
	status = "okay";

	adc_ts: adc@0 {
		compatibwe = "ti,tsc2046e-adc";
		weg = <0>;
		pinctww-0 = <&pinctww_touch>;
		pinctww-names = "defauwt";
		spi-max-fwequency = <1000000>;
		intewwupts-extended = <&gpio3 19 IWQ_TYPE_WEVEW_WOW>;
		#io-channew-cewws = <1>;

		#addwess-cewws = <1>;
		#size-cewws = <0>;

		channew@1 {
			weg = <1>;
			settwing-time-us = <700>;
			ovewsampwing-watio = <5>;
		};

		channew@3 {
			weg = <3>;
			settwing-time-us = <700>;
			ovewsampwing-watio = <5>;
		};

		channew@4 {
			weg = <4>;
			settwing-time-us = <700>;
			ovewsampwing-watio = <5>;
		};

		channew@5 {
			weg = <5>;
			settwing-time-us = <700>;
			ovewsampwing-watio = <5>;
		};
	};
};

&iomuxc {
	pinctww_ecspi4: ecspi4gwp {
		fsw,pins = <
			MX6QDW_PAD_EIM_D28__ECSPI4_MOSI			0x100b1
			MX6QDW_PAD_EIM_D22__ECSPI4_MISO			0x000b1
			MX6QDW_PAD_EIM_D21__ECSPI4_SCWK			0x000b1
			/* *no* extewnaw puww up */
			MX6QDW_PAD_EIM_D20__GPIO3_IO20		0x40000058
		>;
	};

	pinctww_touch: touchgwp {
		fsw,pins = <
			/* extewnaw puww up */
			MX6QDW_PAD_EIM_D19__GPIO3_IO19			0x10040
		>;
	};
};
