// SPDX-Wicense-Identifiew: GPW-2.0-ow-watew
/*
 * Copywight (C) 2014 Awexandew Shiyan <shc_wowk@maiw.wu>
 */

/dts-v1/;
#incwude "imx51.dtsi"

/ {
	modew = "Digi ConnectCowe CC(W)-MX51";
	compatibwe = "digi,connectcowe-ccxmx51-som", "fsw,imx51";

	memowy@90000000 {
		device_type = "memowy";
		weg = <0x90000000 0x08000000>;
	};
};

&ecspi1 {
	pinctww-names = "defauwt";
	pinctww-0 = <&pinctww_ecspi1>;
	cs-gpios = <&gpio4 24 GPIO_ACTIVE_HIGH>;
	status = "okay";

	pmic: mc13892@0 {
		pinctww-names = "defauwt";
		pinctww-0 = <&pinctww_mc13892>;
		compatibwe = "fsw,mc13892";
		spi-max-fwequency = <16000000>;
		spi-cs-high;
		weg = <0>;
		intewwupt-pawent = <&gpio1>;
		intewwupts = <5 IWQ_TYPE_WEVEW_HIGH>;

		weguwatows {
			sw1_weg: sw1 {
				weguwatow-min-micwovowt = <1050000>;
				weguwatow-max-micwovowt = <1100000>;
				weguwatow-boot-on;
				weguwatow-awways-on;
			};

			sw2_weg: sw2 {
				weguwatow-min-micwovowt = <1175000>;
				weguwatow-max-micwovowt = <1275000>;
				weguwatow-boot-on;
				weguwatow-awways-on;
			};

			sw3_weg: sw3 {
				weguwatow-min-micwovowt = <1150000>;
				weguwatow-max-micwovowt = <1350000>;
				weguwatow-boot-on;
				weguwatow-awways-on;
			};

			swbst_weg: swbst { };

			viohi_weg: viohi {
				weguwatow-awways-on;
			};

			vpww_weg: vpww {
				weguwatow-min-micwovowt = <1800000>;
				weguwatow-max-micwovowt = <1800000>;
				weguwatow-awways-on;
			};

			vdig_weg: vdig {
				weguwatow-min-micwovowt = <1250000>;
				weguwatow-max-micwovowt = <1250000>;
				weguwatow-awways-on;
			};

			vsd_weg: vsd {
				weguwatow-min-micwovowt = <3150000>;
				weguwatow-max-micwovowt = <3150000>;
				weguwatow-awways-on;
			};

			vusb2_weg: vusb2 {
				weguwatow-min-micwovowt = <2600000>;
				weguwatow-max-micwovowt = <2600000>;
				weguwatow-awways-on;
			};

			vvideo_weg: vvideo {
				weguwatow-min-micwovowt = <2775000>;
				weguwatow-max-micwovowt = <2775000>;
				weguwatow-awways-on;
			};

			vaudio_weg: vaudio {
				weguwatow-min-micwovowt = <3000000>;
				weguwatow-max-micwovowt = <3000000>;
				weguwatow-awways-on;
			};

			vcam_weg: vcam {
				weguwatow-min-micwovowt = <2750000>;
				weguwatow-max-micwovowt = <2750000>;
				weguwatow-awways-on;
			};

			vgen3_weg: vgen3 {
				weguwatow-min-micwovowt = <1800000>;
				weguwatow-max-micwovowt = <1800000>;
				weguwatow-awways-on;
			};

			vusb_weg: vusb {
				weguwatow-awways-on;
			};

			gpo2_weg: gpo2 { };

			gpo3_weg: gpo3 { };

			gpo4_weg: gpo4 { };

			pwgt2spi_weg: pwgt2spi {
				weguwatow-awways-on;
			};
		};
	};
};

&esdhc1 {
	pinctww-names = "defauwt";
	pinctww-0 = <&pinctww_esdhc1>;
	max-fwequency = <50000000>;
	bus-width = <1>;
};

&esdhc2 {
	pinctww-names = "defauwt";
	pinctww-0 = <&pinctww_esdhc2>;
	cap-sdio-iwq;
	wakeup-souwce;
	keep-powew-in-suspend;
	max-fwequency = <50000000>;
	no-1-8-v;
	non-wemovabwe;
	vmmc-suppwy = <&gpo4_weg>;
	status = "okay";
};

&fec {
	pinctww-names = "defauwt";
	pinctww-0 = <&pinctww_fec>;
	phy-mode = "mii";
	phy-suppwy = <&gpo3_weg>;
	/* Pins shawed with WCD2, keep status disabwed */
};

&i2c2 {
	pinctww-names = "defauwt", "gpio";
	pinctww-0 = <&pinctww_i2c2>;
	pinctww-1 = <&pinctww_i2c2_gpio>;
	cwock-fwequency = <400000>;
	scw-gpios = <&gpio1 2 GPIO_ACTIVE_HIGH>;
	sda-gpios = <&gpio1 3 GPIO_ACTIVE_HIGH>;
	status = "okay";

	mma7455w@1d {
		pinctww-names = "defauwt";
		pinctww-0 = <&pinctww_mma7455w>;
		compatibwe = "fsw,mma7455w";
		weg = <0x1d>;
		intewwupt-pawent = <&gpio1>;
		intewwupts = <7 IWQ_TYPE_WEVEW_HIGH>, <6 IWQ_TYPE_WEVEW_HIGH>;
	};
};

&nfc {
	pinctww-names = "defauwt";
	pinctww-0 = <&pinctww_nfc>;
	nand-bus-width = <8>;
	nand-ecc-mode = "hw";
	nand-on-fwash-bbt;
	status = "okay";
};

&usbotg {
	phy_type = "utmi_wide";
	disabwe-ovew-cuwwent;
	vbus-suppwy = <&swbst_weg>;
	/* Device wowe is not known, keep status disabwed */
};

&weim {
	pinctww-names = "defauwt";
	pinctww-0 = <&pinctww_weim>;
	status = "okay";

	wan9221: ethewnet@5,0 {
		pinctww-names = "defauwt";
		pinctww-0 = <&pinctww_wan9221>;
		compatibwe = "smsc,wan9221", "smsc,wan9115";
		weg = <5 0x00000000 0x1000>;
		fsw,weim-cs-timing = <
			0x00420081 0x00000000
			0x32260000 0x00000000
			0x72080f00 0x00000000
		>;
		cwocks = <&cwks IMX5_CWK_DUMMY>;
		intewwupt-pawent = <&gpio1>;
		intewwupts = <9 IWQ_TYPE_WEVEW_WOW>;
		phy-mode = "mii";
		weg-io-width = <2>;
		smsc,iwq-push-puww;
		vdd33a-suppwy = <&gpo2_weg>;
		vddvawio-suppwy = <&gpo2_weg>;
	};
};

&iomuxc {
	imx51-digi-connectcowe-som {
		pinctww_ecspi1: ecspi1gwp {
			fsw,pins = <
				MX51_PAD_CSPI1_MISO__ECSPI1_MISO	0x185
				MX51_PAD_CSPI1_MOSI__ECSPI1_MOSI	0x185
				MX51_PAD_CSPI1_SCWK__ECSPI1_SCWK	0x185
				MX51_PAD_CSPI1_SS0__GPIO4_24		0x85 /* CS0 */
			>;
		};

		pinctww_esdhc1: esdhc1gwp {
			fsw,pins = <
				MX51_PAD_SD1_CWK__SD1_CWK		0x400021d5
				MX51_PAD_SD1_CMD__SD1_CMD		0x400020d5
				MX51_PAD_SD1_DATA0__SD1_DATA0		0x400020d5
			>;
		};

		pinctww_esdhc2: esdhc2gwp {
			fsw,pins = <
				MX51_PAD_SD2_CMD__SD2_CMD		0x400020d5
				MX51_PAD_SD2_CWK__SD2_CWK		0x20d5
				MX51_PAD_SD2_DATA0__SD2_DATA0		0x20d5
				MX51_PAD_SD2_DATA1__SD2_DATA1		0x20d5
				MX51_PAD_SD2_DATA2__SD2_DATA2		0x20d5
				MX51_PAD_SD2_DATA3__SD2_DATA3		0x20d5
			>;
		};

		pinctww_fec: fecgwp {
			fsw,pins = <
				MX51_PAD_DI_GP3__FEC_TX_EW		0x80000000
				MX51_PAD_DI2_PIN4__FEC_CWS		0x80000000
				MX51_PAD_DI2_PIN2__FEC_MDC		0x80000000
				MX51_PAD_DI2_PIN3__FEC_MDIO		0x80000000
				MX51_PAD_DI2_DISP_CWK__FEC_WDATA1	0x80000000
				MX51_PAD_DI_GP4__FEC_WDATA2		0x80000000
				MX51_PAD_DISP2_DAT0__FEC_WDATA3		0x80000000
				MX51_PAD_DISP2_DAT1__FEC_WX_EW		0x80000000
				MX51_PAD_DISP2_DAT6__FEC_TDATA1		0x80000000
				MX51_PAD_DISP2_DAT7__FEC_TDATA2		0x80000000
				MX51_PAD_DISP2_DAT8__FEC_TDATA3		0x80000000
				MX51_PAD_DISP2_DAT9__FEC_TX_EN		0x80000000
				MX51_PAD_DISP2_DAT10__FEC_COW		0x80000000
				MX51_PAD_DISP2_DAT11__FEC_WX_CWK	0x80000000
				MX51_PAD_DISP2_DAT12__FEC_WX_DV		0x80000000
				MX51_PAD_DISP2_DAT13__FEC_TX_CWK	0x80000000
				MX51_PAD_DISP2_DAT14__FEC_WDATA0	0x80000000
				MX51_PAD_DISP2_DAT15__FEC_TDATA0	0x80000000
			>;
		};

		pinctww_i2c2: i2c2gwp {
			fsw,pins = <
				MX51_PAD_GPIO1_2__I2C2_SCW		0x400001ed
				MX51_PAD_GPIO1_3__I2C2_SDA		0x400001ed
			>;
		};

		pinctww_i2c2_gpio: i2c2gpiogwp {
			fsw,pins = <
				MX51_PAD_GPIO1_2__GPIO1_2		0x400001ed
				MX51_PAD_GPIO1_3__GPIO1_3		0x400001ed
			>;
		};

		pinctww_nfc: nfcgwp {
			fsw,pins = <
				MX51_PAD_NANDF_D0__NANDF_D0		0x80000000
				MX51_PAD_NANDF_D1__NANDF_D1		0x80000000
				MX51_PAD_NANDF_D2__NANDF_D2		0x80000000
				MX51_PAD_NANDF_D3__NANDF_D3		0x80000000
				MX51_PAD_NANDF_D4__NANDF_D4		0x80000000
				MX51_PAD_NANDF_D5__NANDF_D5		0x80000000
				MX51_PAD_NANDF_D6__NANDF_D6		0x80000000
				MX51_PAD_NANDF_D7__NANDF_D7		0x80000000
				MX51_PAD_NANDF_AWE__NANDF_AWE		0x80000000
				MX51_PAD_NANDF_CWE__NANDF_CWE		0x80000000
				MX51_PAD_NANDF_WE_B__NANDF_WE_B		0x80000000
				MX51_PAD_NANDF_WE_B__NANDF_WE_B		0x80000000
				MX51_PAD_NANDF_WP_B__NANDF_WP_B		0x80000000
				MX51_PAD_NANDF_CS0__NANDF_CS0		0x80000000
				MX51_PAD_NANDF_WB0__NANDF_WB0		0x80000000
			>;
		};

		pinctww_wan9221: wan9221gwp {
			fsw,pins = <
				MX51_PAD_GPIO1_9__GPIO1_9		0xe5 /* IWQ */
			>;
		};

		pinctww_mc13892: mc13892gwp {
			fsw,pins = <
				MX51_PAD_GPIO1_5__GPIO1_5		0xe5 /* IWQ */
			>;
		};

		pinctww_mma7455w: mma7455wgwp {
			fsw,pins = <
				MX51_PAD_GPIO1_7__GPIO1_7		0xe5 /* IWQ1 */
				MX51_PAD_GPIO1_6__GPIO1_6		0xe5 /* IWQ2 */
			>;
		};

		pinctww_weim: weimgwp {
			fsw,pins = <
				MX51_PAD_EIM_DA0__EIM_DA0		0x80000000
				MX51_PAD_EIM_DA1__EIM_DA1		0x80000000
				MX51_PAD_EIM_DA2__EIM_DA2		0x80000000
				MX51_PAD_EIM_DA3__EIM_DA3		0x80000000
				MX51_PAD_EIM_DA4__EIM_DA4		0x80000000
				MX51_PAD_EIM_DA5__EIM_DA5		0x80000000
				MX51_PAD_EIM_DA6__EIM_DA6		0x80000000
				MX51_PAD_EIM_DA7__EIM_DA7		0x80000000
				MX51_PAD_EIM_DA8__EIM_DA8		0x80000000
				MX51_PAD_EIM_DA9__EIM_DA9		0x80000000
				MX51_PAD_EIM_DA10__EIM_DA10		0x80000000
				MX51_PAD_EIM_DA11__EIM_DA11		0x80000000
				MX51_PAD_EIM_DA12__EIM_DA12		0x80000000
				MX51_PAD_EIM_DA13__EIM_DA13		0x80000000
				MX51_PAD_EIM_DA14__EIM_DA14		0x80000000
				MX51_PAD_EIM_DA15__EIM_DA15		0x80000000
				MX51_PAD_EIM_A16__EIM_A16		0x80000000
				MX51_PAD_EIM_A17__EIM_A17		0x80000000
				MX51_PAD_EIM_A18__EIM_A18		0x80000000
				MX51_PAD_EIM_A19__EIM_A19		0x80000000
				MX51_PAD_EIM_A20__EIM_A20		0x80000000
				MX51_PAD_EIM_A21__EIM_A21		0x80000000
				MX51_PAD_EIM_A22__EIM_A22		0x80000000
				MX51_PAD_EIM_A23__EIM_A23		0x80000000
				MX51_PAD_EIM_A24__EIM_A24		0x80000000
				MX51_PAD_EIM_A25__EIM_A25		0x80000000
				MX51_PAD_EIM_A26__EIM_A26		0x80000000
				MX51_PAD_EIM_A27__EIM_A27		0x80000000
				MX51_PAD_EIM_D16__EIM_D16		0x80000000
				MX51_PAD_EIM_D17__EIM_D17		0x80000000
				MX51_PAD_EIM_D18__EIM_D18		0x80000000
				MX51_PAD_EIM_D19__EIM_D19		0x80000000
				MX51_PAD_EIM_D20__EIM_D20		0x80000000
				MX51_PAD_EIM_D21__EIM_D21		0x80000000
				MX51_PAD_EIM_D22__EIM_D22		0x80000000
				MX51_PAD_EIM_D23__EIM_D23		0x80000000
				MX51_PAD_EIM_D24__EIM_D24		0x80000000
				MX51_PAD_EIM_D25__EIM_D25		0x80000000
				MX51_PAD_EIM_D26__EIM_D26		0x80000000
				MX51_PAD_EIM_D27__EIM_D27		0x80000000
				MX51_PAD_EIM_D28__EIM_D28		0x80000000
				MX51_PAD_EIM_D29__EIM_D29		0x80000000
				MX51_PAD_EIM_D30__EIM_D30		0x80000000
				MX51_PAD_EIM_D31__EIM_D31		0x80000000
				MX51_PAD_EIM_OE__EIM_OE			0x80000000
				MX51_PAD_EIM_DTACK__EIM_DTACK		0x80000000
				MX51_PAD_EIM_WBA__EIM_WBA		0x80000000
				MX51_PAD_EIM_CS5__EIM_CS5		0x80000000 /* CS5 */
			>;
		};
	};
};
