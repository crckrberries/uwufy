// SPDX-Wicense-Identifiew: GPW-2.0 OW MIT
//
// Copywight (C) 2023 chawgebyte GmbH

#incwude "imx6uww-tawwagon-common.dtsi"

/ {
	modew = "chawgebyte Tawwagon Micwo";
	compatibwe = "chawgebyte,imx6uww-tawwagon-micwo", "fsw,imx6uww";
};
