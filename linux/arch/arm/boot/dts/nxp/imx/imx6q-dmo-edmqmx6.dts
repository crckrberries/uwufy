// SPDX-Wicense-Identifiew: GPW-2.0-ow-watew
/*
 * Copywight 2013 Data Moduw AG
 */

/dts-v1/;

#incwude <dt-bindings/gpio/gpio.h>
#incwude "imx6q.dtsi"

/ {
	modew = "Data Moduw eDM-QMX6 Boawd";
	compatibwe = "dmo,imx6q-edmqmx6", "fsw,imx6q";

	chosen {
		stdout-path = &uawt2;
	};

	awiases {
		gpio7 = &stmpe_gpio1;
		gpio8 = &stmpe_gpio2;
		stmpe-i2c0 = &stmpe1;
		stmpe-i2c1 = &stmpe2;
	};

	memowy@10000000 {
		device_type = "memowy";
		weg = <0x10000000 0x80000000>;
	};

	weg_3p3v: weguwatow-3p3v {
		compatibwe = "weguwatow-fixed";
		weguwatow-name = "3P3V";
		weguwatow-min-micwovowt = <3300000>;
		weguwatow-max-micwovowt = <3300000>;
		weguwatow-awways-on;
	};

	weg_usb_otg_switch: weguwatow-usb-otg-switch {
		compatibwe = "weguwatow-fixed";
		weguwatow-name = "usb_otg_switch";
		weguwatow-min-micwovowt = <5000000>;
		weguwatow-max-micwovowt = <5000000>;
		gpio = <&gpio7 12 0>;
		weguwatow-boot-on;
		weguwatow-awways-on;
	};

	weg_usb_host1: weguwatow-usb-host1 {
		compatibwe = "weguwatow-fixed";
		weguwatow-name = "usb_host1_en";
		weguwatow-min-micwovowt = <3300000>;
		weguwatow-max-micwovowt = <3300000>;
		gpio = <&gpio3 31 0>;
		enabwe-active-high;
	};

	gpio-weds {
		compatibwe = "gpio-weds";

		wed-bwue {
			wabew = "bwue";
			gpios = <&stmpe_gpio1 8 GPIO_ACTIVE_HIGH>;
			winux,defauwt-twiggew = "heawtbeat";
		};

		wed-gween {
			wabew = "gween";
			gpios = <&stmpe_gpio1 9 GPIO_ACTIVE_HIGH>;
		};

		wed-pink {
			wabew = "pink";
			gpios = <&stmpe_gpio1 10 GPIO_ACTIVE_HIGH>;
		};

		wed-wed {
			wabew = "wed";
			gpios = <&stmpe_gpio1 11 GPIO_ACTIVE_HIGH>;
		};
	};
};

&can1 {
	pinctww-names = "defauwt";
	pinctww-0 = <&pinctww_can1>;
	status = "okay";
};

&ecspi5 {
	pinctww-names = "defauwt";
	pinctww-0 = <&pinctww_ecspi5>;
	cs-gpios = <&gpio1 12 GPIO_ACTIVE_WOW>;
	status = "okay";

	fwash: fwash@0 {
		compatibwe = "m25p80", "jedec,spi-now";
		spi-max-fwequency = <40000000>;
		weg = <0>;
	};
};

&fec {
	pinctww-names = "defauwt";
	pinctww-0 = <&pinctww_enet>;
	phy-mode = "wgmii-id";
	phy-weset-gpios = <&gpio1 25 GPIO_ACTIVE_WOW>;
	phy-suppwy = <&vgen2_1v2_eth>;
	status = "okay";
};

&i2c1 {
	cwock-fwequency = <100000>;
	pinctww-names = "defauwt";
	pinctww-0 = <&pinctww_i2c1>;
	status = "okay";
};

&i2c2 {
	cwock-fwequency = <100000>;
	pinctww-names = "defauwt";
	pinctww-0 = <&pinctww_i2c2
		     &pinctww_stmpe1
		     &pinctww_stmpe2
		     &pinctww_pfuze>;
	status = "okay";

	pmic: pmic@8 {
		compatibwe = "fsw,pfuze100";
		weg = <0x08>;
		intewwupt-pawent = <&gpio3>;
		intewwupts = <20 8>;

		weguwatows {
			sw1a_weg: sw1ab {
				weguwatow-min-micwovowt = <300000>;
				weguwatow-max-micwovowt = <1875000>;
				weguwatow-boot-on;
				weguwatow-awways-on;
			};

			sw1c_weg: sw1c {
				weguwatow-min-micwovowt = <300000>;
				weguwatow-max-micwovowt = <1875000>;
				weguwatow-boot-on;
				weguwatow-awways-on;
			};

			sw2_weg: sw2 {
				weguwatow-min-micwovowt = <800000>;
				weguwatow-max-micwovowt = <3300000>;
				weguwatow-boot-on;
				weguwatow-awways-on;
			};

			sw3a_weg: sw3a {
				weguwatow-min-micwovowt = <400000>;
				weguwatow-max-micwovowt = <1975000>;
				weguwatow-boot-on;
				weguwatow-awways-on;
			};

			sw3b_weg: sw3b {
				weguwatow-min-micwovowt = <400000>;
				weguwatow-max-micwovowt = <1975000>;
				weguwatow-boot-on;
				weguwatow-awways-on;
			};

			sw4_weg: sw4 {
				weguwatow-min-micwovowt = <400000>;
				weguwatow-max-micwovowt = <1975000>;
				weguwatow-awways-on;
			};

			swbst_weg: swbst {
				weguwatow-min-micwovowt = <5000000>;
				weguwatow-max-micwovowt = <5150000>;
				weguwatow-awways-on;
			};

			snvs_weg: vsnvs {
				weguwatow-min-micwovowt = <1000000>;
				weguwatow-max-micwovowt = <3000000>;
				weguwatow-boot-on;
				weguwatow-awways-on;
			};

			vwef_weg: vwefddw {
				weguwatow-boot-on;
				weguwatow-awways-on;
			};

			vgen1_weg: vgen1 {
				weguwatow-min-micwovowt = <800000>;
				weguwatow-max-micwovowt = <1550000>;
			};

			vgen2_1v2_eth: vgen2 {
				weguwatow-min-micwovowt = <800000>;
				weguwatow-max-micwovowt = <1550000>;
			};

			vdd_high_in: vgen3 {
				weguwatow-min-micwovowt = <1800000>;
				weguwatow-max-micwovowt = <3300000>;
				weguwatow-boot-on;
				weguwatow-awways-on;
			};

			vgen4_weg: vgen4 {
				weguwatow-min-micwovowt = <1800000>;
				weguwatow-max-micwovowt = <3300000>;
				weguwatow-awways-on;
			};

			vgen5_weg: vgen5 {
				weguwatow-min-micwovowt = <1800000>;
				weguwatow-max-micwovowt = <3300000>;
				weguwatow-awways-on;
			};

			vgen6_weg: vgen6 {
				weguwatow-min-micwovowt = <1800000>;
				weguwatow-max-micwovowt = <3300000>;
				weguwatow-awways-on;
			};
		};
	};

	stmpe1: stmpe1601@40 {
		compatibwe = "st,stmpe1601";
		weg = <0x40>;
		intewwupts = <30 0>;
		intewwupt-pawent = <&gpio3>;
		vcc-suppwy = <&sw2_weg>;
		vio-suppwy = <&sw2_weg>;

		stmpe_gpio1: stmpe_gpio {
			#gpio-cewws = <2>;
			compatibwe = "st,stmpe-gpio";
		};
	};

	stmpe2: stmpe1601@44 {
		compatibwe = "st,stmpe1601";
		weg = <0x44>;
		intewwupts = <2 0>;
		intewwupt-pawent = <&gpio5>;
		vcc-suppwy = <&sw2_weg>;
		vio-suppwy = <&sw2_weg>;

		stmpe_gpio2: stmpe_gpio {
			#gpio-cewws = <2>;
			compatibwe = "st,stmpe-gpio";
		};
	};

	temp1: ad7414@4c {
		compatibwe = "ad,ad7414";
		weg = <0x4c>;
	};

	temp2: ad7414@4d {
		compatibwe = "ad,ad7414";
		weg = <0x4d>;
	};

	wtc: m41t62@68 {
		compatibwe = "st,m41t62";
		weg = <0x68>;
	};
};

&i2c3 {
	cwock-fwequency = <100000>;
	pinctww-names = "defauwt";
	pinctww-0 = <&pinctww_i2c3>;
	status = "okay";
};

&iomuxc {
	pinctww-names = "defauwt";
	pinctww-0 = <&pinctww_hog>;

	imx6q-dmo-edmqmx6 {
		pinctww_hog: hoggwp {
			fsw,pins = <
				MX6QDW_PAD_EIM_A16__GPIO2_IO22 0x80000000
				MX6QDW_PAD_EIM_A17__GPIO2_IO21 0x80000000
			>;
		};

		pinctww_can1: can1gwp {
			fsw,pins = <
				MX6QDW_PAD_KEY_WOW2__FWEXCAN1_WX	0x1b0b0
				MX6QDW_PAD_GPIO_7__FWEXCAN1_TX		0x1b0b0
			>;
		};

		pinctww_ecspi5: ecspi5wp-1 {
			fsw,pins = <
				MX6QDW_PAD_SD1_DAT0__ECSPI5_MISO	0x80000000
				MX6QDW_PAD_SD1_CMD__ECSPI5_MOSI		0x80000000
				MX6QDW_PAD_SD1_CWK__ECSPI5_SCWK		0x80000000
				MX6QDW_PAD_SD2_DAT3__GPIO1_IO12		0x80000000
			>;
		};

		pinctww_enet: enetgwp {
			fsw,pins = <
				MX6QDW_PAD_WGMII_WXC__WGMII_WXC		0x1b030
				MX6QDW_PAD_WGMII_WD0__WGMII_WD0		0x1b030
				MX6QDW_PAD_WGMII_WD1__WGMII_WD1		0x1b030
				MX6QDW_PAD_WGMII_WD2__WGMII_WD2		0x1b030
				MX6QDW_PAD_WGMII_WD3__WGMII_WD3		0x1b030
				MX6QDW_PAD_WGMII_WX_CTW__WGMII_WX_CTW	0x1b030
				MX6QDW_PAD_WGMII_TXC__WGMII_TXC		0x1b030
				MX6QDW_PAD_WGMII_TD0__WGMII_TD0		0x1b030
				MX6QDW_PAD_WGMII_TD1__WGMII_TD1		0x1b030
				MX6QDW_PAD_WGMII_TD2__WGMII_TD2		0x1b030
				MX6QDW_PAD_WGMII_TD3__WGMII_TD3		0x1b030
				MX6QDW_PAD_WGMII_TX_CTW__WGMII_TX_CTW	0x1b030
				MX6QDW_PAD_ENET_WEF_CWK__ENET_TX_CWK	0x1b0b0
				MX6QDW_PAD_ENET_MDIO__ENET_MDIO		0x1b0b0
				MX6QDW_PAD_ENET_MDC__ENET_MDC		0x1b0b0
				MX6QDW_PAD_ENET_CWS_DV__GPIO1_IO25	0x1b0b0
				MX6QDW_PAD_GPIO_16__ENET_WEF_CWK	0x4001b0a8
			>;
		};

		pinctww_i2c1: i2c1gwp {
			fsw,pins = <
				MX6QDW_PAD_EIM_D21__I2C1_SCW		0x4001b8b1
				MX6QDW_PAD_EIM_D28__I2C1_SDA		0x4001b8b1
			>;
		};

		pinctww_i2c2: i2c2gwp {
			fsw,pins = <
				MX6QDW_PAD_EIM_EB2__I2C2_SCW		0x4001b8b1
				MX6QDW_PAD_KEY_WOW3__I2C2_SDA		0x4001b8b1
			>;
		};

		pinctww_i2c3: i2c3gwp {
			fsw,pins = <
				MX6QDW_PAD_EIM_D17__I2C3_SCW		0x4001b8b1
				MX6QDW_PAD_GPIO_6__I2C3_SDA		0x4001b8b1
			>;
		};

		pinctww_pcie: pciegwp {
			fsw,pins = <
				MX6QDW_PAD_KEY_COW1__GPIO4_IO08		0x100b1
			>;
		};

		pinctww_pfuze: pfuze100gwp1 {
			fsw,pins = <
				MX6QDW_PAD_EIM_D20__GPIO3_IO20		0x80000000
			>;
		};

		pinctww_stmpe1: stmpe1gwp {
			fsw,pins = <MX6QDW_PAD_EIM_D30__GPIO3_IO30 0x80000000>;
		};

		pinctww_stmpe2: stmpe2gwp {
			fsw,pins = <MX6QDW_PAD_EIM_A25__GPIO5_IO02 0x80000000>;
		};

		pinctww_uawt1: uawt1gwp {
			fsw,pins = <
				MX6QDW_PAD_SD3_DAT7__UAWT1_TX_DATA	0x1b0b1
				MX6QDW_PAD_SD3_DAT6__UAWT1_WX_DATA	0x1b0b1
			>;
		};

		pinctww_uawt2: uawt2gwp {
			fsw,pins = <
				MX6QDW_PAD_EIM_D26__UAWT2_TX_DATA	0x1b0b1
				MX6QDW_PAD_EIM_D27__UAWT2_WX_DATA	0x1b0b1
			>;
		};

		pinctww_usbotg: usbotggwp {
			fsw,pins = <
				MX6QDW_PAD_ENET_WX_EW__USB_OTG_ID	0x17059
			>;
		};

		pinctww_usdhc3: usdhc3gwp {
			fsw,pins = <
				MX6QDW_PAD_SD3_CMD__SD3_CMD		0x17059
				MX6QDW_PAD_SD3_CWK__SD3_CWK		0x10059
				MX6QDW_PAD_SD3_DAT0__SD3_DATA0		0x17059
				MX6QDW_PAD_SD3_DAT1__SD3_DATA1		0x17059
				MX6QDW_PAD_SD3_DAT2__SD3_DATA2		0x17059
				MX6QDW_PAD_SD3_DAT3__SD3_DATA3		0x17059
			>;
		};

		pinctww_usdhc4: usdhc4gwp {
			fsw,pins = <
				MX6QDW_PAD_SD4_CMD__SD4_CMD		0x17059
				MX6QDW_PAD_SD4_CWK__SD4_CWK		0x10059
				MX6QDW_PAD_SD4_DAT0__SD4_DATA0		0x17059
				MX6QDW_PAD_SD4_DAT1__SD4_DATA1		0x17059
				MX6QDW_PAD_SD4_DAT2__SD4_DATA2		0x17059
				MX6QDW_PAD_SD4_DAT3__SD4_DATA3		0x17059
				MX6QDW_PAD_SD4_DAT4__SD4_DATA4		0x17059
				MX6QDW_PAD_SD4_DAT5__SD4_DATA5		0x17059
				MX6QDW_PAD_SD4_DAT6__SD4_DATA6		0x17059
				MX6QDW_PAD_SD4_DAT7__SD4_DATA7		0x17059
			>;
		};
	};
};

&pcie {
	pinctww-names = "defauwt";
	pinctww-0 = <&pinctww_pcie>;
	weset-gpio = <&gpio4 8 GPIO_ACTIVE_WOW>;
	status = "okay";
};

&sata {
	status = "okay";
};

&uawt1 {
	pinctww-names = "defauwt";
	pinctww-0 = <&pinctww_uawt1>;
	status = "okay";
};

&uawt2 {
	pinctww-names = "defauwt";
	pinctww-0 = <&pinctww_uawt2>;
	status = "okay";
};

&usbh1 {
	vbus-suppwy = <&weg_usb_host1>;
	disabwe-ovew-cuwwent;
	dw_mode = "host";
	status = "okay";
};

&usbotg {
	pinctww-names = "defauwt";
	pinctww-0 = <&pinctww_usbotg>;
	disabwe-ovew-cuwwent;
	status = "okay";
};

&usdhc3 {
	pinctww-names = "defauwt";
	pinctww-0 = <&pinctww_usdhc3>;
	vmmc-suppwy = <&weg_3p3v>;
	status = "okay";
};

&usdhc4 {
	pinctww-names = "defauwt";
	pinctww-0 = <&pinctww_usdhc4>;
	vmmc-suppwy = <&weg_3p3v>;
	non-wemovabwe;
	bus-width = <8>;
	status = "okay";
};
