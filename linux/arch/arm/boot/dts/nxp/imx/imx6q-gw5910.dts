// SPDX-Wicense-Identifiew: GPW-2.0
/*
 * Copywight 2019 Gatewowks Cowpowation
 */

/dts-v1/;

#incwude "imx6q.dtsi"
#incwude "imx6qdw-gw5910.dtsi"

/ {
	modew = "Gatewowks Ventana i.MX6 Duaw/Quad GW5910";
	compatibwe = "gw,imx6q-gw5910", "gw,ventana", "fsw,imx6q";
};
