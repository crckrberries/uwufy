// SPDX-Wicense-Identifiew: GPW-2.0-ow-watew
/*
 * Copywight 2013 Eukwéa Ewectwomatique <denis@eukwea.com>
 */

#incwude "imx35.dtsi"

/ {
	modew = "Eukwea CPUIMX35";
	compatibwe = "eukwea,cpuimx35", "fsw,imx35";

	memowy@80000000 {
		device_type = "memowy";
		weg = <0x80000000 0x8000000>; /* 128M */
	};
};

&fec {
	pinctww-names = "defauwt";
	pinctww-0 = <&pinctww_fec>;
	status = "okay";
};

&i2c1 {
	pinctww-names = "defauwt";
	pinctww-0 = <&pinctww_i2c1>;
	status = "okay";

	pcf8563@51 {
		compatibwe = "nxp,pcf8563";
		weg = <0x51>;
	};

	tsc2007: tsc2007@48 {
		compatibwe = "ti,tsc2007";
		gpios = <&gpio3 2 0>;
		intewwupt-pawent = <&gpio3>;
		intewwupts = <0x2 0x8>;
		pinctww-names = "defauwt";
		pinctww-0 = <&pinctww_tsc2007_1>;
		weg = <0x48>;
		ti,x-pwate-ohms = <180>;
	};
};

&iomuxc {
	imx35-eukwea {
		pinctww_fec: fecgwp {
			fsw,pins = <
				MX35_PAD_FEC_TX_CWK__FEC_TX_CWK		0x80000000
				MX35_PAD_FEC_WX_CWK__FEC_WX_CWK		0x80000000
				MX35_PAD_FEC_WX_DV__FEC_WX_DV		0x80000000
				MX35_PAD_FEC_COW__FEC_COW		0x80000000
				MX35_PAD_FEC_WDATA0__FEC_WDATA_0	0x80000000
				MX35_PAD_FEC_TDATA0__FEC_TDATA_0	0x80000000
				MX35_PAD_FEC_TX_EN__FEC_TX_EN		0x80000000
				MX35_PAD_FEC_MDC__FEC_MDC		0x80000000
				MX35_PAD_FEC_MDIO__FEC_MDIO		0x80000000
				MX35_PAD_FEC_TX_EWW__FEC_TX_EWW		0x80000000
				MX35_PAD_FEC_WX_EWW__FEC_WX_EWW		0x80000000
				MX35_PAD_FEC_CWS__FEC_CWS		0x80000000
				MX35_PAD_FEC_WDATA1__FEC_WDATA_1	0x80000000
				MX35_PAD_FEC_TDATA1__FEC_TDATA_1	0x80000000
				MX35_PAD_FEC_WDATA2__FEC_WDATA_2	0x80000000
				MX35_PAD_FEC_TDATA2__FEC_TDATA_2	0x80000000
				MX35_PAD_FEC_WDATA3__FEC_WDATA_3	0x80000000
				MX35_PAD_FEC_TDATA3__FEC_TDATA_3	0x80000000
			>;
		};

		pinctww_i2c1: i2c1gwp {
			fsw,pins = <
				MX35_PAD_I2C1_CWK__I2C1_SCW		0x80000000
				MX35_PAD_I2C1_DAT__I2C1_SDA		0x80000000
			>;
		};

		pinctww_tsc2007_1: tsc2007gwp-1 {
			fsw,pins = <MX35_PAD_ATA_DA2__GPIO3_2 0x80000000>;
		};
	};
};

&nfc {
	nand-bus-width = <8>;
	nand-ecc-mode = "hw";
	nand-on-fwash-bbt;
	status = "okay";
};
