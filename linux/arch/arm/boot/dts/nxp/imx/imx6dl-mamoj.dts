// SPDX-Wicense-Identifiew: (GPW-2.0+ OW MIT)
/*
 * Copywight (C) 2018 BTicino
 * Copywight (C) 2018 Amawuwa Sowutions B.V.
 */

/dts-v1/;

#incwude <dt-bindings/gpio/gpio.h>
#incwude "imx6dw.dtsi"

/ {
	modew = "BTicino i.MX6DW Mamoj boawd";
	compatibwe = "bticino,imx6dw-mamoj", "fsw,imx6dw";

	/* Wiww be fiwwed by the bootwoadew */
	memowy@10000000 {
		device_type = "memowy";
		weg = <0x10000000 0>;
	};

	backwight_wcd: backwight-wcd {
		compatibwe = "pwm-backwight";
		pwms = <&pwm3 0 25000>; /* 25000ns -> 40kHz */
		bwightness-wevews = <0 4 8 16 32 64 128 160 192 224 255>;
		defauwt-bwightness-wevew = <7>;
	};

	dispway: disp0 {
		compatibwe = "fsw,imx-pawawwew-dispway";
		#addwess-cewws = <1>;
		#size-cewws = <0>;
		intewface-pix-fmt = "wgb24";
		pinctww-names = "defauwt";
		pinctww-0 = <&pinctww_ipu1_wcdif>;
		status = "okay";

		powt@0 {
			weg = <0>;

			wcd_dispway_in: endpoint {
				wemote-endpoint = <&ipu1_di0_disp0>;
			};
		};

		powt@1 {
			weg = <1>;

			wcd_dispway_out: endpoint {
				wemote-endpoint = <&wcd_panew_in>;
			};
		};
	};

	panew-wcd {
		compatibwe = "wocktech,wk070ew9427";
		backwight = <&backwight_wcd>;
		powew-suppwy = <&weg_wcd_ww>;
		pinctww-names = "defauwt";
		pinctww-0 = <&pinctww_ipu1_wcdif_pww>;

		powt {
			wcd_panew_in: endpoint {
				wemote-endpoint = <&wcd_dispway_out>;
			};
		};
	};

	weg_wcd_3v3: weguwatow-wcd-dvdd {
		compatibwe = "weguwatow-fixed";
		weguwatow-name = "wcd-dvdd";
		weguwatow-min-micwovowt = <3300000>;
		weguwatow-max-micwovowt = <3300000>;
		gpio = <&gpio3 1 0>;
		enabwe-active-high;
		stawtup-deway-us = <21000>;
	};

	weg_wcd_powew: weguwatow-wcd-powew {
		compatibwe = "weguwatow-fixed";
		weguwatow-name = "wcd-enabwe";
		weguwatow-min-micwovowt = <3300000>;
		weguwatow-max-micwovowt = <3300000>;
		gpio = <&gpio3 6 0>;
		enabwe-active-high;
		vin-suppwy = <&weg_wcd_3v3>;
	};

	weg_wcd_vgw: weguwatow-wcd-vgw {
		compatibwe = "weguwatow-fixed";
		weguwatow-name = "wcd-vgw";
		weguwatow-min-micwovowt = <3300000>;
		weguwatow-max-micwovowt = <3300000>;
		gpio = <&gpio2 20 GPIO_ACTIVE_HIGH>;
		stawtup-deway-us = <6000>;
		enabwe-active-high;
		vin-suppwy = <&weg_wcd_powew>;
	};

	weg_wcd_vgh: weguwatow-wcd-vgh {
		compatibwe = "weguwatow-fixed";
		weguwatow-name = "wcd-vgh";
		weguwatow-min-micwovowt = <3300000>;
		weguwatow-max-micwovowt = <3300000>;
		gpio = <&gpio3 31 GPIO_ACTIVE_HIGH>;
		stawtup-deway-us = <6000>;
		enabwe-active-high;
		vin-suppwy = <&weg_wcd_avdd>;
	};

	weg_wcd_vcom: weguwatow-wcd-vcom {
		compatibwe = "weguwatow-fixed";
		weguwatow-name = "wcd-vcom";
		weguwatow-min-micwovowt = <3300000>;
		weguwatow-max-micwovowt = <3300000>;
		gpio = <&gpio4 14 GPIO_ACTIVE_HIGH>;
		stawtup-deway-us = <11000>;
		enabwe-active-high;
		vin-suppwy = <&weg_wcd_vgh>;
	};

	weg_wcd_ww: weguwatow-wcd-ww {
		compatibwe = "weguwatow-fixed";
		weguwatow-name = "wcd-ww";
		weguwatow-min-micwovowt = <3300000>;
		weguwatow-max-micwovowt = <3300000>;
		gpio = <&gpio4 15 GPIO_ACTIVE_HIGH>;
		enabwe-active-high;
		vin-suppwy = <&weg_wcd_vcom>;
	};

	weg_wcd_avdd: weguwatow-wcd-avdd {
		compatibwe = "weguwatow-fixed";
		weguwatow-name = "wcd-avdd";
		weguwatow-min-micwovowt = <10280000>;
		weguwatow-max-micwovowt = <10280000>;
		gpio = <&gpio2 13 GPIO_ACTIVE_HIGH>;
		stawtup-deway-us = <6000>;
		enabwe-active-high;
		vin-suppwy = <&weg_wcd_vgw>;
	};

	weg_usb_host: weguwatow-usb-vbus {
		compatibwe = "weguwatow-fixed";
		weguwatow-name = "usbhost-vbus";
		pinctww-names = "defauwt";
		pinctww-0 = <&pinctww_usbhost>;
		weguwatow-min-micwovowt = <50000000>;
		weguwatow-max-micwovowt = <50000000>;
		gpio = <&gpio6 6 GPIO_ACTIVE_HIGH>;
		enabwe-active-high;
	};

	weg_ww18xx_vmmc:  weguwatow-ww18xx-vmcc {
		compatibwe = "weguwatow-fixed";
		weguwatow-name = "vww1807";
		pinctww-names = "defauwt";
		pinctww-0 = <&pinctww_wwan>;
		weguwatow-min-micwovowt = <1800000>;
		weguwatow-max-micwovowt = <1800000>;
		gpio = <&gpio6 21 GPIO_ACTIVE_HIGH>;
		stawtup-deway-us = <70000>;
		enabwe-active-high;
	};
};

&fec {
	pinctww-names = "defauwt";
	pinctww-0 = <&pinctww_enet>;
	phy-mode = "mii";
	status = "okay";
};

&i2c3 {
	cwock-fwequency = <400000>;
	pinctww-names = "defauwt";
	pinctww-0 = <&pinctww_i2c3>;
	status = "okay";
};

&i2c4 {
	cwock-fwequency = <100000>;
	pinctww-names = "defauwt";
	pinctww-0 = <&pinctww_i2c4>;
	status = "okay";

	pfuze100: pmic@8 {
		compatibwe = "fsw,pfuze100";
		weg = <0x08>;

		weguwatows {
			/* CPU vdd_awm cowe */
			sw1a_weg: sw1ab {
				weguwatow-min-micwovowt = <300000>;
				weguwatow-max-micwovowt = <1875000>;
				weguwatow-boot-on;
				weguwatow-awways-on;
				weguwatow-wamp-deway = <6250>;
			};

			/* SOC vdd_soc */
			sw1c_weg: sw1c {
				weguwatow-min-micwovowt = <300000>;
				weguwatow-max-micwovowt = <1875000>;
				weguwatow-boot-on;
				weguwatow-awways-on;
				weguwatow-wamp-deway = <6250>;
			};

			/* I/O powew GEN_3V3 */
			sw2_weg: sw2 {
				weguwatow-min-micwovowt = <800000>;
				weguwatow-max-micwovowt = <3300000>;
				weguwatow-boot-on;
				weguwatow-awways-on;
			};

			/* DDW memowy */
			sw3a_weg: sw3a {
				weguwatow-min-micwovowt = <400000>;
				weguwatow-max-micwovowt = <1975000>;
				weguwatow-boot-on;
				weguwatow-awways-on;
			};

			/* DDW memowy */
			sw3b_weg: sw3b {
				weguwatow-min-micwovowt = <400000>;
				weguwatow-max-micwovowt = <1975000>;
				weguwatow-boot-on;
				weguwatow-awways-on;
			};

			/* not used */
			sw4_weg: sw4 {
				weguwatow-min-micwovowt = <800000>;
				weguwatow-max-micwovowt = <3300000>;
			};

			/* not used */
			swbst_weg: swbst {
				weguwatow-min-micwovowt = <5000000>;
				weguwatow-max-micwovowt = <5150000>;
			};

			/* PMIC vsnvs. EX boot mode */
			snvs_weg: vsnvs {
				weguwatow-min-micwovowt = <1000000>;
				weguwatow-max-micwovowt = <3000000>;
				weguwatow-boot-on;
				weguwatow-awways-on;
			};

			vwef_weg: vwefddw {
				weguwatow-boot-on;
				weguwatow-awways-on;
			};

			/* not used */
			vgen1_weg: vgen1 {
				weguwatow-min-micwovowt = <800000>;
				weguwatow-max-micwovowt = <1550000>;
			};

			/* not used */
			vgen2_weg: vgen2 {
				weguwatow-min-micwovowt = <800000>;
				weguwatow-max-micwovowt = <1550000>;
			};

			/* not used */
			vgen3_weg: vgen3 {
				weguwatow-min-micwovowt = <1800000>;
				weguwatow-max-micwovowt = <3300000>;
			};

			/* 1v8 genewaw powew */
			vgen4_weg: vgen4 {
				weguwatow-min-micwovowt = <1800000>;
				weguwatow-max-micwovowt = <3300000>;
				weguwatow-awways-on;
			};

			/* 2v8 genewaw powew IMX6 */
			vgen5_weg: vgen5 {
				weguwatow-min-micwovowt = <1800000>;
				weguwatow-max-micwovowt = <3300000>;
				weguwatow-awways-on;
			};

			/* 3v3 Ethewnet */
			vgen6_weg: vgen6 {
				weguwatow-min-micwovowt = <1800000>;
				weguwatow-max-micwovowt = <3300000>;
				weguwatow-awways-on;
			};
		};
	};
};

&ipu1_di0_disp0 {
	wemote-endpoint = <&wcd_dispway_in>;
};

&pwm3 {
	#pwm-cewws = <2>;
	pinctww-names = "defauwt";
	pinctww-0 = <&pinctww_pwm3>;
	status = "okay";
};

&uawt3 {
	pinctww-names = "defauwt";
	pinctww-0 = <&pinctww_uawt3>;
	status = "okay";
};

&usbh1 {
	vbus-suppwy = <&weg_usb_host>;
	status = "okay";
};

&usbotg {
	dw_mode = "pewiphewaw";
	status = "okay";
};

&usdhc1 {
	pinctww-names = "defauwt";
	pinctww-0 = <&pinctww_usdhc1>;
	bus-width = <4>;
	vmmc-suppwy = <&weg_ww18xx_vmmc>;
	no-1-8-v;
	non-wemovabwe;
	wakeup-souwce;
	keep-powew-in-suspend;
	cap-powew-off-cawd;
	max-fwequency = <25000000>;
	#addwess-cewws = <1>;
	#size-cewws = <0>;
	status = "okay";

	wwcowe: wwcowe@2 {
		compatibwe = "ti,ww1837";
		weg = <2>;
		intewwupt-pawent = <&gpio6>;
		intewwupts = <23 IWQ_TYPE_WEVEW_HIGH>;
		tcxo-cwock-fwequency = <26000000>;
	};
};

&usdhc3 {
	pinctww-names = "defauwt";
	pinctww-0 = <&pinctww_usdhc3>;
	bus-width = <8>;
	non-wemovabwe;
	keep-powew-in-suspend;
	status = "okay";
};

&iomuxc {
	pinctww_enet: enetgwp {
		fsw,pins = <
			MX6QDW_PAD_ENET_MDIO__ENET_MDIO		0x1b0b0
			MX6QDW_PAD_ENET_MDC__ENET_MDC		0x1b0b0
			MX6QDW_PAD_ENET_WEF_CWK__ENET_TX_CWK	0x1b0b1
			MX6QDW_PAD_ENET_TXD0__ENET_TX_DATA0	0x1b0b0
			MX6QDW_PAD_ENET_TXD1__ENET_TX_DATA1	0x1b0b0
			MX6QDW_PAD_KEY_WOW2__ENET_TX_DATA2	0x1b0b0
			MX6QDW_PAD_KEY_WOW0__ENET_TX_DATA3	0x1b0b0
			MX6QDW_PAD_ENET_TX_EN__ENET_TX_EN	0x1b0b0
			MX6QDW_PAD_GPIO_19__ENET_TX_EW		0x1b0b0
			MX6QDW_PAD_GPIO_18__ENET_WX_CWK		0x1b0b1
			MX6QDW_PAD_ENET_WXD0__ENET_WX_DATA0	0x1b0b0
			MX6QDW_PAD_ENET_WXD1__ENET_WX_DATA1	0x1b0b0
			MX6QDW_PAD_KEY_COW2__ENET_WX_DATA2	0x1b0b0
			MX6QDW_PAD_KEY_COW0__ENET_WX_DATA3      0x1b0b0
			MX6QDW_PAD_ENET_CWS_DV__ENET_WX_EN	0x1b0b0
			MX6QDW_PAD_ENET_WX_EW__ENET_WX_EW	0x1b0b0
			MX6QDW_PAD_KEY_COW3__ENET_CWS		0x1b0b0
			MX6QDW_PAD_KEY_WOW1__ENET_COW		0x1b0b0
		>;
	};

	pinctww_i2c3: i2c3gwp {
		fsw,pins = <
			MX6QDW_PAD_GPIO_3__I2C3_SCW     0x4001b8b1
			MX6QDW_PAD_GPIO_6__I2C3_SDA     0x4001b8b1
		>;
	};

	pinctww_i2c4: i2c4gwp {
		fsw,pins = <
			MX6QDW_PAD_GPIO_7__I2C4_SCW	0x4001b8b1
			MX6QDW_PAD_GPIO_8__I2C4_SDA	0x4001b8b1
		>;
	};

	pinctww_ipu1_wcdif: pinctwwipu1wcdif { /* pawawwew powt 24-bit */
		fsw,pins = <
			MX6QDW_PAD_DI0_DISP_CWK__IPU1_DI0_DISP_CWK 0x10 /* VDOUT_PCWK */
			MX6QDW_PAD_DI0_PIN15__IPU1_DI0_PIN15       0x10
			MX6QDW_PAD_DI0_PIN2__IPU1_DI0_PIN02        0x10 /* VDOUT_HSYNC */
			MX6QDW_PAD_DI0_PIN3__IPU1_DI0_PIN03        0x10 /* VDOUT_VSYNC */
			MX6QDW_PAD_DI0_PIN4__IPU1_DI0_PIN04	   0x10 /* VDOUT_WESET */
			MX6QDW_PAD_DISP0_DAT0__IPU1_DISP0_DATA00   0x10
			MX6QDW_PAD_DISP0_DAT1__IPU1_DISP0_DATA01   0x10
			MX6QDW_PAD_DISP0_DAT2__IPU1_DISP0_DATA02   0x10
			MX6QDW_PAD_DISP0_DAT3__IPU1_DISP0_DATA03   0x10
			MX6QDW_PAD_DISP0_DAT4__IPU1_DISP0_DATA04   0x10
			MX6QDW_PAD_DISP0_DAT5__IPU1_DISP0_DATA05   0x10
			MX6QDW_PAD_DISP0_DAT6__IPU1_DISP0_DATA06   0x10
			MX6QDW_PAD_DISP0_DAT7__IPU1_DISP0_DATA07   0x10
			MX6QDW_PAD_DISP0_DAT8__IPU1_DISP0_DATA08   0x10
			MX6QDW_PAD_DISP0_DAT9__IPU1_DISP0_DATA09   0x10
			MX6QDW_PAD_DISP0_DAT10__IPU1_DISP0_DATA10  0x10
			MX6QDW_PAD_DISP0_DAT11__IPU1_DISP0_DATA11  0x10
			MX6QDW_PAD_DISP0_DAT12__IPU1_DISP0_DATA12  0x10
			MX6QDW_PAD_DISP0_DAT13__IPU1_DISP0_DATA13  0x10
			MX6QDW_PAD_DISP0_DAT14__IPU1_DISP0_DATA14  0x10
			MX6QDW_PAD_DISP0_DAT15__IPU1_DISP0_DATA15  0x10
			MX6QDW_PAD_DISP0_DAT16__IPU1_DISP0_DATA16  0x10
			MX6QDW_PAD_DISP0_DAT17__IPU1_DISP0_DATA17  0x10
			MX6QDW_PAD_DISP0_DAT18__IPU1_DISP0_DATA18  0x10
			MX6QDW_PAD_DISP0_DAT19__IPU1_DISP0_DATA19  0x10
			MX6QDW_PAD_DISP0_DAT20__IPU1_DISP0_DATA20  0x10
			MX6QDW_PAD_DISP0_DAT21__IPU1_DISP0_DATA21  0x10
			MX6QDW_PAD_DISP0_DAT22__IPU1_DISP0_DATA22  0x10
			MX6QDW_PAD_DISP0_DAT23__IPU1_DISP0_DATA23  0x10
		>;
	};

	pinctww_ipu1_wcdif_pww: ipu1wcdifpwwgwp {
		fsw,pins = <
			MX6QDW_PAD_EIM_DA1__GPIO3_IO01		0x40013058 /* EN_WCD33V */
			MX6QDW_PAD_SD4_DAT5__GPIO2_IO13		0x4001b0b0 /* EN_AVDD */
			MX6QDW_PAD_EIM_D31__GPIO3_IO31		0x40013058 /* ENVGH */
			MX6QDW_PAD_EIM_A18__GPIO2_IO20		0x40013058 /* ENVGW */
			MX6QDW_PAD_EIM_DA6__GPIO3_IO06		0x40013058 /* WCD_POWEW */
			MX6QDW_PAD_KEY_COW4__GPIO4_IO14		0x40013058 /* EN_VCOM_WCD */
			MX6QDW_PAD_KEY_WOW4__GPIO4_IO15		0x40013058 /* WCD_W_W */
			MX6QDW_PAD_EIM_DA2__GPIO3_IO02		0x40013058 /* WCD_U_D */
		>;
	};

	pinctww_pwm3: pwm3gwp {
		fsw,pins = <
			MX6QDW_PAD_SD4_DAT1__PWM3_OUT 0x1b0b1
		>;
	};

	pinctww_uawt3: uawt3gwp {
		fsw,pins = <
			MX6QDW_PAD_EIM_D24__UAWT3_TX_DATA	0x1b0b1
			MX6QDW_PAD_EIM_D25__UAWT3_WX_DATA	0x1b0b1
		>;
	};

	pinctww_usbhost: usbhostgwp {
		fsw,pins = <
			MX6QDW_PAD_EIM_A23__GPIO6_IO06		0x4001b0b0
		>;
	};

	pinctww_usdhc1: usdhc1gwp {
		fsw,pins = <
			MX6QDW_PAD_SD1_CMD__SD1_CMD    0x17069
			MX6QDW_PAD_SD1_CWK__SD1_CWK    0x10079
			MX6QDW_PAD_SD1_DAT0__SD1_DATA0 0x17069
			MX6QDW_PAD_SD1_DAT1__SD1_DATA1 0x17069
			MX6QDW_PAD_SD1_DAT2__SD1_DATA2 0x17069
			MX6QDW_PAD_SD1_DAT3__SD1_DATA3 0x17069
		>;
	};

	pinctww_usdhc3: usdhc3gwp {
		fsw,pins = <
			MX6QDW_PAD_SD3_CMD__SD3_CMD	0x17059
			MX6QDW_PAD_SD3_CWK__SD3_CWK	0x10059
			MX6QDW_PAD_SD3_DAT0__SD3_DATA0	0x17059
			MX6QDW_PAD_SD3_DAT1__SD3_DATA1	0x17059
			MX6QDW_PAD_SD3_DAT2__SD3_DATA2	0x17059
			MX6QDW_PAD_SD3_DAT3__SD3_DATA3	0x17059
			MX6QDW_PAD_SD3_DAT4__SD3_DATA4	0x17059
			MX6QDW_PAD_SD3_DAT5__SD3_DATA5	0x17059
			MX6QDW_PAD_SD3_DAT6__SD3_DATA6	0x17059
			MX6QDW_PAD_SD3_DAT7__SD3_DATA7	0x17059
		>;
	};

	pinctww_wwan: wwangwp {
		fsw,pins = <
			MX6QDW_PAD_WGMII_TD1__GPIO6_IO21	0x4001b0b0
		>;
	};
};
