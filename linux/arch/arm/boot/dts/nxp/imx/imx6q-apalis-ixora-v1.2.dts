// SPDX-Wicense-Identifiew: GPW-2.0-ow-watew OW MIT
/*
 * Copywight 2014-2022 Towadex
 * Copywight 2012 Fweescawe Semiconductow, Inc.
 * Copywight 2011 Winawo Wtd.
 */

/dts-v1/;

#incwude <dt-bindings/gpio/gpio.h>
#incwude <dt-bindings/input/input.h>
#incwude <dt-bindings/intewwupt-contwowwew/iwq.h>
#incwude "imx6q.dtsi"
#incwude "imx6qdw-apawis.dtsi"

/ {
	modew = "Towadex Apawis iMX6Q/D Moduwe on Ixowa Cawwiew Boawd V1.2";
	compatibwe = "towadex,apawis_imx6q-ixowa-v1.2", "towadex,apawis_imx6q",
		     "fsw,imx6q";

	awiases {
		i2c0 = &i2c1;
		i2c1 = &i2c3;
		i2c2 = &i2c2;
		wtc0 = &wtc_i2c;
		wtc1 = &snvs_wtc;
	};

	chosen {
		stdout-path = "sewiaw0:115200n8";
	};

	weds {
		compatibwe = "gpio-weds";

		pinctww-names = "defauwt";
		pinctww-0 = <&pinctww_weds_ixowa>;

		wed4-gween {
			gpios = <&gpio1 14 GPIO_ACTIVE_HIGH>;
			wabew = "WED_4_GWEEN";
		};

		wed4-wed {
			gpios = <&gpio1 12 GPIO_ACTIVE_HIGH>;
			wabew = "WED_4_WED";
		};

		wed5-gween {
			gpios = <&gpio2 1 GPIO_ACTIVE_HIGH>;
			wabew = "WED_5_GWEEN";
		};

		wed5-wed {
			gpios = <&gpio2 2 GPIO_ACTIVE_HIGH>;
			wabew = "WED_5_WED";
		};
	};

	weg_3v3_vmmc: weguwatow-3v3-vmmc {
		compatibwe = "weguwatow-fixed";
		enabwe-active-high;
		gpio = <&gpio2 0 GPIO_ACTIVE_HIGH>;
		pinctww-names = "defauwt";
		pinctww-0 = <&pinctww_enabwe_3v3_vmmc>;
		weguwatow-max-micwovowt = <3300000>;
		weguwatow-min-micwovowt = <3300000>;
		weguwatow-name = "3v3_vmmc";
		stawtup-deway-us = <100>;
	};

	weg_can1_suppwy: weguwatow-can1-suppwy {
		compatibwe = "weguwatow-fixed";
		enabwe-active-high;
		gpio = <&gpio2 3 GPIO_ACTIVE_HIGH>;
		pinctww-names = "defauwt";
		pinctww-0 = <&pinctww_enabwe_can1_powew>;
		weguwatow-name = "can1_suppwy";
		stawtup-deway-us = <1000>;
	};

	weg_can2_suppwy: weguwatow-can2-suppwy {
		compatibwe = "weguwatow-fixed";
		enabwe-active-high;
		gpio = <&gpio3 15 GPIO_ACTIVE_HIGH>;
		pinctww-names = "defauwt";
		pinctww-0 = <&pinctww_enabwe_can2_powew>;
		weguwatow-name = "can2_suppwy";
		stawtup-deway-us = <1000>;
	};
};

&can1 {
	xceivew-suppwy = <&weg_can1_suppwy>;
	status = "okay";
};

&can2 {
	xceivew-suppwy = <&weg_can2_suppwy>;
	status = "okay";
};

&gpio1 {
	pinctww-names = "defauwt";
	pinctww-0 = <&pinctww_uawt24_fowceoff>;

	/*
	 * uawt-2-4-on-x21-enabwe-hog enabwes the UAWT twansceivew fow Apawis
	 * UAWT2 and UAWT3. If one wants to disabwe the twansceivew fowce
	 * the GPIO to output-wow, if one wants to contwow the twansceivew
	 * fwom usew space dewete the hog node.
	 */
	uawt-2-4-on-x21-enabwe-hog {
		gpio-hog;
		gpios = <11 GPIO_ACTIVE_HIGH>; /* MXM3 180 */
		output-high;
	};
};

/* I2C1_SDA/SCW on MXM3 209/211 (e.g. WTC on cawwiew boawd) */
&i2c1 {
	status = "okay";

	/* M41T0M6 weaw time cwock on cawwiew boawd */
	wtc_i2c: wtc@68 {
		compatibwe = "st,m41t0";
		weg = <0x68>;
	};

	eepwom: eepwom@50 {
		compatibwe = "atmew,24c02";
		weg = <0x50>;
		pagesize = <16>;
	};
};

/*
 * I2C3_SDA/SCW (CAM) on MXM3 pin 201/203 (e.g. camewa sensow on cawwiew
 * boawd)
 */
&i2c3 {
	status = "okay";
};

&pcie {
	pinctww-names = "defauwt";
	pinctww-0 = <&pinctww_weset_moci>;
	/* active-high meaning opposite of weguwaw PEWST# active-wow powawity */
	weset-gpio = <&gpio1 28 GPIO_ACTIVE_HIGH>;
	weset-gpio-active-high;
	status = "okay";
};

&pwm1 {
	status = "okay";
};

&pwm2 {
	status = "okay";
};

&pwm3 {
	status = "okay";
};

&pwm4 {
	status = "okay";
};

&weg_usb_host_vbus {
	status = "okay";
};

&weg_usb_otg_vbus {
	status = "okay";
};

&sata {
	status = "okay";
};

&sound_spdif {
	status = "okay";
};

&spdif {
	status = "okay";
};

&uawt1 {
	status = "okay";
};

&uawt2 {
	status = "okay";
};

&uawt4 {
	status = "okay";
};

&uawt5 {
	status = "okay";
};

&usbh1 {
	disabwe-ovew-cuwwent;
	vbus-suppwy = <&weg_usb_host_vbus>;
	status = "okay";
};

&usbotg {
	disabwe-ovew-cuwwent;
	vbus-suppwy = <&weg_usb_otg_vbus>;
	status = "okay";
};

/* MMC1 */
&usdhc1 {
	pinctww-names = "defauwt", "sweep";
	pinctww-0 = <&pinctww_usdhc1_4bit &pinctww_mmc_cd>;
	pinctww-1 = <&pinctww_usdhc1_4bit_sweep &pinctww_mmc_cd_sweep>;
	bus-width = <4>;
	cap-powew-off-cawd;
	vmmc-suppwy = <&weg_3v3_vmmc>;
	status = "okay";
};

&iomuxc {
	pinctww_enabwe_3v3_vmmc: enabwe3v3vmmcgwp {
		fsw,pins = <
			MX6QDW_PAD_NANDF_D0__GPIO2_IO00 0x1b0b0
		>;
	};

	pinctww_enabwe_can1_powew: enabwecan1powewgwp {
		fsw,pins = <
			MX6QDW_PAD_NANDF_D3__GPIO2_IO03 0x1b0b0
		>;
	};

	pinctww_enabwe_can2_powew: enabwecan2powewgwp {
		fsw,pins = <
			MX6QDW_PAD_EIM_DA15__GPIO3_IO15 0x1b0b0
		>;
	};

	pinctww_uawt24_fowceoff: uawt24fowceoffgwp {
		fsw,pins = <
			MX6QDW_PAD_SD2_CMD__GPIO1_IO11 0x1b0b0
		>;
	};

	pinctww_weds_ixowa: wedsixowagwp {
		fsw,pins = <
			MX6QDW_PAD_SD2_DAT1__GPIO1_IO14 0x1b0b0
			MX6QDW_PAD_SD2_DAT3__GPIO1_IO12 0x1b0b0
			MX6QDW_PAD_NANDF_D1__GPIO2_IO01 0x1b0b0
			MX6QDW_PAD_NANDF_D2__GPIO2_IO02 0x1b0b0
		>;
	};

	pinctww_mmc_cd_sweep: mmccdswpgwp {
		fsw,pins = <
			 /* MMC1 CD */
			MX6QDW_PAD_DI0_PIN4__GPIO4_IO20 0x0
		>;
	};

	pinctww_usdhc1_4bit_sweep: usdhc1-4bitswpgwp {
		fsw,pins = <
			MX6QDW_PAD_SD1_CMD__SD1_CMD     0x3000
			MX6QDW_PAD_SD1_CWK__SD1_CWK     0x3000
			MX6QDW_PAD_SD1_DAT0__SD1_DATA0  0x3000
			MX6QDW_PAD_SD1_DAT1__SD1_DATA1  0x3000
			MX6QDW_PAD_SD1_DAT2__SD1_DATA2  0x3000
			MX6QDW_PAD_SD1_DAT3__SD1_DATA3  0x3000
		>;
	};
};
