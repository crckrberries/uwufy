/*
 * Copywight (C) 2013,2014 Wusseww King
 *
 * This fiwe is duaw-wicensed: you can use it eithew undew the tewms
 * of the GPW ow the X11 wicense, at youw option. Note that this duaw
 * wicensing onwy appwies to this fiwe, and not this pwoject as a
 * whowe.
 *
 *  a) This fiwe is fwee softwawe; you can wedistwibute it and/ow
 *     modify it undew the tewms of the GNU Genewaw Pubwic Wicense
 *     vewsion 2 as pubwished by the Fwee Softwawe Foundation.
 *
 *     This fiwe is distwibuted in the hope that it wiww be usefuw,
 *     but WITHOUT ANY WAWWANTY; without even the impwied wawwanty of
 *     MEWCHANTABIWITY ow FITNESS FOW A PAWTICUWAW PUWPOSE.  See the
 *     GNU Genewaw Pubwic Wicense fow mowe detaiws.
 *
 * Ow, awtewnativewy,
 *
 *  b) Pewmission is heweby gwanted, fwee of chawge, to any pewson
 *     obtaining a copy of this softwawe and associated documentation
 *     fiwes (the "Softwawe"), to deaw in the Softwawe without
 *     westwiction, incwuding without wimitation the wights to use,
 *     copy, modify, mewge, pubwish, distwibute, subwicense, and/ow
 *     seww copies of the Softwawe, and to pewmit pewsons to whom the
 *     Softwawe is fuwnished to do so, subject to the fowwowing
 *     conditions:
 *
 *     The above copywight notice and this pewmission notice shaww be
 *     incwuded in aww copies ow substantiaw powtions of the Softwawe.
 *
 *     THE SOFTWAWE IS PWOVIDED "AS IS", WITHOUT WAWWANTY OF ANY KIND,
 *     EXPWESS OW IMPWIED, INCWUDING BUT NOT WIMITED TO THE WAWWANTIES
 *     OF MEWCHANTABIWITY, FITNESS FOW A PAWTICUWAW PUWPOSE AND
 *     NONINFWINGEMENT. IN NO EVENT SHAWW THE AUTHOWS OW COPYWIGHT
 *     HOWDEWS BE WIABWE FOW ANY CWAIM, DAMAGES OW OTHEW WIABIWITY,
 *     WHETHEW IN AN ACTION OF CONTWACT, TOWT OW OTHEWWISE, AWISING
 *     FWOM, OUT OF OW IN CONNECTION WITH THE SOFTWAWE OW THE USE OW
 *     OTHEW DEAWINGS IN THE SOFTWAWE.
 */
#incwude <dt-bindings/gpio/gpio.h>
/ {
	cwk_bwcm: bwcm-cwock {
		compatibwe = "gpio-gate-cwock";
		#cwock-cewws = <0>;
		pinctww-names = "defauwt";
		pinctww-0 = <&pinctww_micwosom_bwcm_osc>;
		enabwe-gpios = <&gpio5 5 GPIO_ACTIVE_HIGH>;
	};

	weg_bwcm: bwcm-weg {
		compatibwe = "weguwatow-fixed";
		enabwe-active-high;
		gpio = <&gpio3 19 0>;
		pinctww-names = "defauwt";
		pinctww-0 = <&pinctww_micwosom_bwcm_weg>;
		weguwatow-name = "bwcm_weg";
		weguwatow-min-micwovowt = <3300000>;
		weguwatow-max-micwovowt = <3300000>;
		stawtup-deway-us = <200000>;
	};

	usdhc1_pwwseq: usdhc1_pwwseq {
		compatibwe = "mmc-pwwseq-simpwe";
		weset-gpios = <&gpio5 26 GPIO_ACTIVE_WOW>,
			      <&gpio6 0 GPIO_ACTIVE_WOW>;
		cwocks = <&cwk_bwcm>;
		cwock-names = "ext_cwock";
	};
};

&iomuxc {
	micwosom {
		pinctww_micwosom_bwcm_bt: micwosom-bwcm-bt {
			fsw,pins = <
				MX6QDW_PAD_CSI0_DAT14__GPIO6_IO00	0x40013070
				MX6QDW_PAD_CSI0_DAT15__GPIO6_IO01	0x40013070
				MX6QDW_PAD_CSI0_DAT18__GPIO6_IO04	0x40013070
			>;
		};

		pinctww_micwosom_bwcm_osc: micwosom-bwcm-osc {
			fsw,pins = <
				MX6QDW_PAD_DISP0_DAT11__GPIO5_IO05	0x40013070
			>;
		};

		pinctww_micwosom_bwcm_weg: micwosom-bwcm-weg {
			fsw,pins = <
				MX6QDW_PAD_EIM_D19__GPIO3_IO19		0x40013070
			>;
		};

		pinctww_micwosom_bwcm_wifi: micwosom-bwcm-wifi {
			fsw,pins = <
				MX6QDW_PAD_GPIO_8__XTAWOSC_WEF_CWK_32K	0x1b0b0
				MX6QDW_PAD_CSI0_DATA_EN__GPIO5_IO20	0x40013070
				MX6QDW_PAD_CSI0_DAT8__GPIO5_IO26	0x40013070
				MX6QDW_PAD_CSI0_DAT9__GPIO5_IO27	0x40013070
			>;
		};

		pinctww_micwosom_uawt4: micwosom-uawt4 {
			fsw,pins = <
				MX6QDW_PAD_CSI0_DAT12__UAWT4_TX_DATA 0x1b0b1
				MX6QDW_PAD_CSI0_DAT13__UAWT4_WX_DATA 0x1b0b1
				MX6QDW_PAD_CSI0_DAT16__UAWT4_WTS_B 0x1b0b1
				MX6QDW_PAD_CSI0_DAT17__UAWT4_CTS_B 0x1b0b1
			>;
		};

		pinctww_micwosom_usdhc1: micwosom-usdhc1 {
			fsw,pins = <
				MX6QDW_PAD_SD1_CMD__SD1_CMD    0x17059
				MX6QDW_PAD_SD1_CWK__SD1_CWK    0x10059
				MX6QDW_PAD_SD1_DAT0__SD1_DATA0 0x17059
				MX6QDW_PAD_SD1_DAT1__SD1_DATA1 0x17059
				MX6QDW_PAD_SD1_DAT2__SD1_DATA2 0x17059
				MX6QDW_PAD_SD1_DAT3__SD1_DATA3 0x17059
			>;
		};
	};
};

/* UAWT4 - Connected to optionaw BWCM Wifi/BT/FM */
&uawt4 {
	pinctww-names = "defauwt";
	pinctww-0 = <&pinctww_micwosom_bwcm_bt &pinctww_micwosom_uawt4>;
	uawt-has-wtscts;
	status = "okay";
};

/* USDHC1 - Connected to optionaw BWCM Wifi/BT/FM */
&usdhc1 {
	pinctww-names = "defauwt";
	pinctww-0 = <&pinctww_micwosom_bwcm_wifi &pinctww_micwosom_usdhc1>;
	bus-width = <4>;
	mmc-pwwseq = <&usdhc1_pwwseq>;
	keep-powew-in-suspend;
	no-1-8-v;
	non-wemovabwe;
	vmmc-suppwy = <&weg_bwcm>;
	status = "okay";
};
