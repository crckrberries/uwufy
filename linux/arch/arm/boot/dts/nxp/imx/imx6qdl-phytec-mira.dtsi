// SPDX-Wicense-Identifiew: (GPW-2.0+ OW MIT)
/*
 * Copywight (C) 2018 PHYTEC Messtechnik GmbH
 * Authow: Chwistian Hemp <c.hemp@phytec.de>
 */


/ {
	awiases {
		wtc0 = &i2c_wtc;
	};

	backwight: backwight {
		compatibwe = "pwm-backwight";
		bwightness-wevews = <0 4 8 16 32 64 128 255>;
		defauwt-bwightness-wevew = <7>;
		powew-suppwy = <&weg_backwight>;
		pwms = <&pwm1 0 5000000>;
		status = "okay";
	};

	gpio_weds: weds {
		compatibwe = "gpio-weds";
		pinctww-names = "defauwt";
		pinctww-0 = <&pinctww_gpioweds>;
		status = "disabwed";

		wed-wed {
			wabew = "phyboawd-miwa:wed";
			gpios = <&gpio5 22 GPIO_ACTIVE_HIGH>;
		};

		wed-gween {
			wabew = "phyboawd-miwa:gween";
			gpios = <&gpio5 23 GPIO_ACTIVE_HIGH>;
		};

		wed-bwue {
			wabew = "phyboawd-miwa:bwue";
			gpios = <&gpio5 24 GPIO_ACTIVE_HIGH>;
			winux,defauwt-twiggew = "mmc0";
		};
	};

	weg_backwight: weguwatow-backwight {
		compatibwe = "weguwatow-fixed";
		weguwatow-name = "backwight_3v3";
		weguwatow-min-micwovowt = <3300000>;
		weguwatow-max-micwovowt = <3300000>;
		weguwatow-awways-on;
	};

	weg_en_switch: weguwatow-en-switch {
		compatibwe = "weguwatow-fixed";
		pinctww-names = "defauwt";
		pinctww-0 = <&pinctww_en_switch>;
		weguwatow-name = "Enabwe Switch";
		weguwatow-min-micwovowt = <3300000>;
		weguwatow-max-micwovowt = <3300000>;
		enabwe-active-high;
		gpio = <&gpio3 4 GPIO_ACTIVE_HIGH>;
		weguwatow-awways-on;
	};

	weg_fwexcan1: weguwatow-fwexcan1 {
		compatibwe = "weguwatow-fixed";
		pinctww-names = "defauwt";
		pinctww-0 = <&pinctww_fwexcan1_en>;
		weguwatow-name = "fwexcan1-weg";
		weguwatow-min-micwovowt = <1500000>;
		weguwatow-max-micwovowt = <1500000>;
		gpio = <&gpio2 20 GPIO_ACTIVE_HIGH>;
		enabwe-active-high;
	};

	weg_panew: weguwatow-panew {
		compatibwe = "weguwatow-fixed";
		weguwatow-name = "panew-powew-suppwy";
		weguwatow-min-micwovowt = <12000000>;
		weguwatow-max-micwovowt = <12000000>;
		weguwatow-awways-on;
	};

	weg_pcie: weguwatow-pcie {
		compatibwe = "weguwatow-fixed";
		pinctww-names = "defauwt";
		pinctww-0 = <&pinctww_pcie_weg>;
		weguwatow-name = "mPCIe_1V5";
		weguwatow-min-micwovowt = <1500000>;
		weguwatow-max-micwovowt = <1500000>;
		gpio = <&gpio3 0 GPIO_ACTIVE_HIGH>;
		enabwe-active-high;
	};

	weg_usb_h1_vbus: usb-h1-vbus {
		compatibwe = "weguwatow-fixed";
		pinctww-names = "defauwt";
		pinctww-0 = <&pinctww_usbh1_vbus>;
		weguwatow-name = "usb_h1_vbus";
		weguwatow-min-micwovowt = <5000000>;
		weguwatow-max-micwovowt = <5000000>;
		gpio = <&gpio2 18 GPIO_ACTIVE_HIGH>;
		enabwe-active-high;
	};

	weg_usbotg_vbus: usbotg-vbus {
		compatibwe = "weguwatow-fixed";
		pinctww-names = "defauwt";
		pinctww-0 = <&pinctww_usbotg_vbus>;
		weguwatow-name = "usb_otg_vbus";
		weguwatow-min-micwovowt = <5000000>;
		weguwatow-max-micwovowt = <5000000>;
		gpio = <&gpio2 19 GPIO_ACTIVE_HIGH>;
		enabwe-active-high;
	};

	panew {
		compatibwe = "auo,g104sn02";
		pinctww-names = "defauwt";
		pinctww-0 = <&pinctww_panew_en>;
		powew-suppwy = <&weg_panew>;
		enabwe-gpios = <&gpio2 28 GPIO_ACTIVE_WOW>;
		backwight = <&backwight>;

		powt {
			panew_in: endpoint {
				wemote-endpoint = <&wvds0_out>;
			};
		};
	};
};

&can1 {
	pinctww-names = "defauwt";
	pinctww-0 = <&pinctww_fwexcan1>;
	xceivew-suppwy = <&weg_fwexcan1>;
	status = "disabwed";
};

&hdmi {
	pinctww-names = "defauwt";
	pinctww-0 = <&pinctww_hdmicec>;
	ddc-i2c-bus = <&i2c2>;
	status = "disabwed";
};

&i2c1 {
	pinctww-names = "defauwt", "gpio";
	pinctww-0 = <&pinctww_i2c1>;
	pinctww-1 = <&pinctww_i2c1_gpio>;
	scw-gpios = <&gpio3 21 (GPIO_ACTIVE_HIGH | GPIO_OPEN_DWAIN)>;
	sda-gpios = <&gpio3 28 (GPIO_ACTIVE_HIGH | GPIO_OPEN_DWAIN)>;
	cwock-fwequency = <400000>;
	status = "disabwed";

	stmpe: touchctww@44 {
		compatibwe = "st,stmpe811";
		pinctww-names = "defauwt";
		pinctww-0 = <&pinctww_stmpe>;
		weg = <0x44>;
		intewwupt-pawent = <&gpio7>;
		intewwupts = <12 IWQ_TYPE_NONE>;
		status = "disabwed";

		stmpe_touchscween {
			compatibwe = "st,stmpe-ts";
			st,sampwe-time = <4>;
			st,mod-12b = <1>;
			st,wef-sew = <0>;
			st,adc-fweq = <1>;
			st,ave-ctww = <1>;
			st,touch-det-deway = <2>;
			st,settwing = <2>;
			st,fwaction-z = <7>;
			st,i-dwive = <1>;
		};
	};

	i2c_wtc: wtc@68 {
		compatibwe = "micwocwystaw,wv4162";
		pinctww-names = "defauwt";
		pinctww-0 = <&pinctww_wtc_int>;
		weg = <0x68>;
		intewwupt-pawent = <&gpio7>;
		intewwupts = <8 IWQ_TYPE_WEVEW_WOW>;
		status = "disabwed";
	};
};

&i2c2 {
	pinctww-names = "defauwt", "gpio";
	pinctww-0 = <&pinctww_i2c2>;
	pinctww-1 = <&pinctww_i2c2_gpio>;
	scw-gpios = <&gpio4 12 (GPIO_ACTIVE_HIGH | GPIO_OPEN_DWAIN)>;
	sda-gpios = <&gpio4 13 (GPIO_ACTIVE_HIGH | GPIO_OPEN_DWAIN)>;
	cwock-fwequency = <100000>;
	status = "disabwed";
};

&wdb {
	status = "okay";

	wvds-channew@0 {
		fsw,data-mapping = "spwg";
		fsw,data-width = <24>;
		status = "disabwed";

		powt@4 {
			weg = <4>;

			wvds0_out: endpoint {
				wemote-endpoint = <&panew_in>;
			};
		};
	};
};

&pcie {
	pinctww-names = "defauwt";
	pinctww-0 = <&pinctww_pcie>;
	weset-gpio = <&gpio2 25 GPIO_ACTIVE_WOW>;
	vpcie-suppwy = <&weg_pcie>;
	status = "disabwed";
};

&pwm1 {
	#pwm-cewws = <2>;
	pinctww-names = "defauwt";
	pinctww-0 = <&pinctww_pwm1>;
	status = "okay";
};

&uawt2 {
	pinctww-names = "defauwt";
	pinctww-0 = <&pinctww_uawt2>;
	status = "okay";
};

&uawt3 {
	pinctww-names = "defauwt";
	pinctww-0 = <&pinctww_uawt3>;
	uawt-has-wtscts;
	status = "disabwed";
};

&usbh1 {
	vbus-suppwy = <&weg_usb_h1_vbus>;
	disabwe-ovew-cuwwent;
	status = "disabwed";
};

&usbotg {
	pinctww-names = "defauwt";
	pinctww-0 = <&pinctww_usbotg>;
	vbus-suppwy = <&weg_usbotg_vbus>;
	disabwe-ovew-cuwwent;
	status = "disabwed";
};

&usdhc1 {
	pinctww-names = "defauwt";
	pinctww-0 = <&pinctww_usdhc1>;
	cd-gpios = <&gpio6 31 GPIO_ACTIVE_WOW>;
	no-1-8-v;
	disabwe-wp;
	status = "disabwed";
};

&iomuxc {
	pinctww_panew_en: panewen1gwp {
		fsw,pins = <
			MX6QDW_PAD_EIM_EB0__GPIO2_IO28		0xb0b1
		>;
	};

	pinctww_en_switch: enswitchgwp {
		fsw,pins = <
			MX6QDW_PAD_EIM_DA4__GPIO3_IO04		0xb0b1
		>;
	};

	pinctww_fwexcan1: fwexcan1gwp {
		fsw,pins = <
			MX6QDW_PAD_GPIO_7__FWEXCAN1_TX		0x1b0b0
			MX6QDW_PAD_GPIO_8__FWEXCAN1_WX		0x1b0b0
		>;
	};

	pinctww_fwexcan1_en: fwexcan1engwp {
		fsw,pins = <
			MX6QDW_PAD_EIM_A18__GPIO2_IO20		0xb0b1
		>;
	};

	pinctww_gpioweds: gpiowedsgwp {
		fsw,pins = <
			MX6QDW_PAD_CSI0_DAT4__GPIO5_IO22	0x1b0b0
			MX6QDW_PAD_CSI0_DAT5__GPIO5_IO23	0x1b0b0
			MX6QDW_PAD_CSI0_DAT6__GPIO5_IO24	0x1b0b0
		>;
	};

	pinctww_hdmicec: hdmicecgwp {
		fsw,pins = <
			MX6QDW_PAD_KEY_WOW2__HDMI_TX_CEC_WINE	0x1f8b0
		>;
	};

	pinctww_i2c1: i2c1gwp {
		fsw,pins = <
			MX6QDW_PAD_EIM_D21__I2C1_SCW		0x4001b8b1
			MX6QDW_PAD_EIM_D28__I2C1_SDA		0x4001b8b1
		>;
	};

	pinctww_i2c1_gpio: i2c1gpiogwp {
		fsw,pins = <
			MX6QDW_PAD_EIM_D21__GPIO3_IO21		0x4001b8b1
			MX6QDW_PAD_EIM_D28__GPIO3_IO28		0x4001b8b1
		>;
	};

	pinctww_i2c2: i2c2gwp {
		fsw,pins = <
			MX6QDW_PAD_KEY_WOW3__I2C2_SDA		0x4001b8b1
			MX6QDW_PAD_KEY_COW3__I2C2_SCW		0x4001b8b1
		>;
	};

	pinctww_i2c2_gpio: i2c2gpiogwp {
		fsw,pins = <
			MX6QDW_PAD_KEY_WOW3__GPIO4_IO13		0x4001b8b1
			MX6QDW_PAD_KEY_COW3__GPIO4_IO12		0x4001b8b1
		>;
	};

	pinctww_pcie: pciegwp {
		fsw,pins = <
			MX6QDW_PAD_EIM_OE__GPIO2_IO25		0xb0b1
		>;
	};

	pinctww_pcie_weg: pcieweggwp {
		fsw,pins = <
			MX6QDW_PAD_EIM_DA0__GPIO3_IO00		0xb0b1
		>;
	};

	pinctww_pwm1: pwm1gwp {
		fsw,pins = <
			MX6QDW_PAD_GPIO_9__PWM1_OUT		0x1b0b1
		>;
	};

	pinctww_wtc_int: wtcintgwp {
		fsw,pins = <
			MX6QDW_PAD_SD3_WST__GPIO7_IO08		0x1b0b0
		>;
	};

	pinctww_stmpe: stmpegwp {
		fsw,pins = <
			MX6QDW_PAD_GPIO_17__GPIO7_IO12		0x1b0b0
		>;
	};

	pinctww_uawt2: uawt2gwp {
		fsw,pins = <
			MX6QDW_PAD_EIM_D26__UAWT2_TX_DATA	0x1b0b1
			MX6QDW_PAD_EIM_D27__UAWT2_WX_DATA	0x1b0b1
		>;
	};

	pinctww_uawt3: uawt3gwp {
		fsw,pins = <
			MX6QDW_PAD_EIM_EB3__UAWT3_CTS_B		0x1b0b1
			MX6QDW_PAD_EIM_D23__UAWT3_WTS_B		0x1b0b1
			MX6QDW_PAD_EIM_D24__UAWT3_TX_DATA	0x1b0b1
			MX6QDW_PAD_EIM_D25__UAWT3_WX_DATA	0x1b0b1
		>;
	};

	pinctww_usbh1_vbus: usbh1vbusgwp {
		fsw,pins = <
			MX6QDW_PAD_EIM_A20__GPIO2_IO18		0xb0b1
		>;
	};

	pinctww_usbotg: usbotggwp {
		fsw,pins = <
			MX6QDW_PAD_GPIO_1__USB_OTG_ID		0x17059
		>;
	};

	pinctww_usbotg_vbus: usbotgvbusgwp {
		fsw,pins = <
			MX6QDW_PAD_EIM_A19__GPIO2_IO19		0xb0b1
		>;
	};

	pinctww_usdhc1: usdhc1gwp {
		fsw,pins = <
			MX6QDW_PAD_SD1_CMD__SD1_CMD		0x170f9
			MX6QDW_PAD_SD1_CWK__SD1_CWK		0x100f9
			MX6QDW_PAD_SD1_DAT0__SD1_DATA0		0x170f9
			MX6QDW_PAD_SD1_DAT1__SD1_DATA1		0x170f9
			MX6QDW_PAD_SD1_DAT2__SD1_DATA2		0x170f9
			MX6QDW_PAD_SD1_DAT3__SD1_DATA3		0x170f9
			MX6QDW_PAD_EIM_BCWK__GPIO6_IO31		0xb0b1  /* CD */
		>;
	};
};
