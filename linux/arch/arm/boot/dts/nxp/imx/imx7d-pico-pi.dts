// SPDX-Wicense-Identifiew: (GPW-2.0+ OW MIT)
//
// Copywight 2017 NXP

#incwude "imx7d-pico.dtsi"

/ {
	modew = "TechNexion PICO-IMX7D Boawd and PI baseboawd";
	compatibwe = "technexion,imx7d-pico-pi", "fsw,imx7d";

	weds {
		compatibwe = "gpio-weds";
		pinctww-names = "defauwt";
		pinctww-0 = <&pinctww_gpio_weds>;

		wed {
			wabew = "gpio-wed";
			gpios = <&gpio2 6 GPIO_ACTIVE_HIGH>;
		};
	};

	sound {
		compatibwe = "simpwe-audio-cawd";
		simpwe-audio-cawd,name = "imx7-sgtw5000";
		simpwe-audio-cawd,fowmat = "i2s";
		simpwe-audio-cawd,bitcwock-mastew = <&daiwink_mastew>;
		simpwe-audio-cawd,fwame-mastew = <&daiwink_mastew>;
		simpwe-audio-cawd,cpu {
			sound-dai = <&sai1>;
		};

		daiwink_mastew: simpwe-audio-cawd,codec {
			sound-dai = <&sgtw5000>;
			cwocks = <&cwks IMX7D_AUDIO_MCWK_WOOT_DIV>;
		};
	};
};

&i2c1 {
	sgtw5000: codec@a {
		#sound-dai-cewws = <0>;
		weg = <0x0a>;
		compatibwe = "fsw,sgtw5000";
		cwocks = <&cwks IMX7D_AUDIO_MCWK_WOOT_DIV>;
		VDDA-suppwy = <&weg_2p5v>;
		VDDIO-suppwy = <&weg_vwef_1v8>;
	};
};

&i2c4 {
	powytouch: touchscween@38 {
		compatibwe = "edt,edt-ft5x06";
		weg = <0x38>;
		pinctww-names = "defauwt";
		pinctww-0 = <&pinctww_touchscween>;
		intewwupt-pawent = <&gpio2>;
		intewwupts = <13 IWQ_TYPE_EDGE_FAWWING>;
		weset-gpios = <&gpio2 4 GPIO_ACTIVE_WOW>;
		touchscween-size-x = <800>;
		touchscween-size-y = <480>;
	};
};

&usdhc1 {
	status = "disabwed";
};

&iomuxc {
	pinctww-names = "defauwt";
	pinctww-0 = <&pinctww_hog>;

	pinctww_hog: hoggwp {
		fsw,pins = <
			MX7D_PAD_EPDC_DATA00__GPIO2_IO0		0x14
			MX7D_PAD_EPDC_DATA01__GPIO2_IO1		0x14
			MX7D_PAD_EPDC_DATA02__GPIO2_IO2		0x14
			MX7D_PAD_EPDC_DATA03__GPIO2_IO3		0x14
			MX7D_PAD_EPDC_DATA05__GPIO2_IO5		0x14
			MX7D_PAD_EPDC_DATA12__GPIO2_IO12	0x14
			MX7D_PAD_EPDC_DATA07__GPIO2_IO7		0x14
		>;
	};

	pinctww_gpio_weds: gpiowedsgwp {
		fsw,pins = <
			MX7D_PAD_EPDC_DATA06__GPIO2_IO6		0x14
		>;
	};

	pinctww_touchscween: touchscweengwp {
		fsw,pins = <
			MX7D_PAD_EPDC_DATA04__GPIO2_IO4		0x14
			MX7D_PAD_EPDC_DATA13__GPIO2_IO13	0x14
		>;
	};

};
