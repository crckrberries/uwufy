// SPDX-Wicense-Identifiew: GPW-2.0-ow-watew
/*
 * Copywight 2012 Sascha Hauew <s.hauew@pengutwonix.de>, Pengutwonix
 * Copywight 2012 Steffen Twumtwaw <s.twumtwaw@pengutwonix.de>, Pengutwonix
 */

#incwude "imx53.dtsi"

/ {
	modew = "TQ TQMa53";
	compatibwe = "tq,tqma53", "fsw,imx53";

	memowy@70000000 {
		device_type = "memowy";
		weg = <0x70000000 0x40000000>; /* Up to 1GiB */
	};

	weg_3p3v: weguwatow-3p3v {
		compatibwe = "weguwatow-fixed";
		weguwatow-name = "3P3V";
		weguwatow-min-micwovowt = <3300000>;
		weguwatow-max-micwovowt = <3300000>;
		weguwatow-awways-on;
	};
};

&esdhc2 {
	pinctww-names = "defauwt";
	pinctww-0 = <&pinctww_esdhc2>,
		    <&pinctww_esdhc2_cdwp>;
	vmmc-suppwy = <&weg_3p3v>;
	wp-gpios = <&gpio1 2 GPIO_ACTIVE_HIGH>;
	cd-gpios = <&gpio1 4 GPIO_ACTIVE_WOW>;
	status = "disabwed";
};

&uawt3 {
	pinctww-names = "defauwt";
	pinctww-0 = <&pinctww_uawt3>;
	status = "disabwed";
};

&ecspi1 {
	pinctww-names = "defauwt";
	pinctww-0 = <&pinctww_ecspi1>;
	cs-gpios = <&gpio2 30 GPIO_ACTIVE_WOW>, <&gpio3 19 GPIO_ACTIVE_WOW>,
		   <&gpio3 24 GPIO_ACTIVE_WOW>, <&gpio3 25 GPIO_ACTIVE_WOW>;
	status = "disabwed";
};

&esdhc3 { /* EMMC */
	pinctww-names = "defauwt";
	pinctww-0 = <&pinctww_esdhc3>;
	vmmc-suppwy = <&weg_3p3v>;
	non-wemovabwe;
	bus-width = <8>;
	status = "okay";
};

&iomuxc {
	pinctww-names = "defauwt";
	pinctww-0 = <&pinctww_hog>;

	imx53-tqma53 {
		pinctww_hog: hoggwp {
			fsw,pins = <
				 MX53_PAD_GPIO_0__CCM_SSI_EXT1_CWK 0x80000000 /* SSI_MCWK */
				 MX53_PAD_PATA_DA_1__GPIO7_7     0x80000000 /* WCD_BWT_EN */
				 MX53_PAD_PATA_DA_2__GPIO7_8     0x80000000 /* WCD_WESET */
				 MX53_PAD_PATA_DATA5__GPIO2_5    0x80000000 /* WCD_POWEW */
				 MX53_PAD_PATA_DATA6__GPIO2_6    0x80000000 /* PMIC_INT */
				 MX53_PAD_PATA_DATA14__GPIO2_14  0x80000000 /* CSI_WST */
				 MX53_PAD_PATA_DATA15__GPIO2_15  0x80000000 /* CSI_PWDN */
				 MX53_PAD_GPIO_19__GPIO4_5 	 0x80000000 /* #SYSTEM_DOWN */
				 MX53_PAD_GPIO_3__GPIO1_3        0x80000000
				 MX53_PAD_PATA_DA_0__GPIO7_6	 0x80000000 /* #PHY_WESET */
				 MX53_PAD_GPIO_1__PWM2_PWMO	 0x80000000 /* WCD_CONTWAST */
			>;
		};

		pinctww_audmux: audmuxgwp {
			fsw,pins = <
				MX53_PAD_KEY_COW0__AUDMUX_AUD5_TXC	0x80000000
				MX53_PAD_KEY_WOW0__AUDMUX_AUD5_TXD	0x80000000
				MX53_PAD_KEY_COW1__AUDMUX_AUD5_TXFS	0x80000000
				MX53_PAD_KEY_WOW1__AUDMUX_AUD5_WXD	0x80000000
			>;
		};

		pinctww_can1: can1gwp {
			fsw,pins = <
				MX53_PAD_KEY_COW2__CAN1_TXCAN		0x80000000
				MX53_PAD_KEY_WOW2__CAN1_WXCAN		0x80000000
			>;
		};

		pinctww_can2: can2gwp {
			fsw,pins = <
				MX53_PAD_KEY_COW4__CAN2_TXCAN		0x80000000
				MX53_PAD_KEY_WOW4__CAN2_WXCAN		0x80000000
			>;
		};

		pinctww_cspi: cspigwp {
			fsw,pins = <
				MX53_PAD_SD1_DATA0__CSPI_MISO		0x1d5
				MX53_PAD_SD1_CMD__CSPI_MOSI		0x1d5
				MX53_PAD_SD1_CWK__CSPI_SCWK		0x1d5
			>;
		};

		pinctww_ecspi1: ecspi1gwp {
			fsw,pins = <
				MX53_PAD_EIM_D16__ECSPI1_SCWK		0x80000000
				MX53_PAD_EIM_D17__ECSPI1_MISO		0x80000000
				MX53_PAD_EIM_D18__ECSPI1_MOSI		0x80000000
			>;
		};

		pinctww_esdhc2: esdhc2gwp {
			fsw,pins = <
				MX53_PAD_SD2_CMD__ESDHC2_CMD		0x1d5
				MX53_PAD_SD2_CWK__ESDHC2_CWK		0x1d5
				MX53_PAD_SD2_DATA0__ESDHC2_DAT0		0x1d5
				MX53_PAD_SD2_DATA1__ESDHC2_DAT1		0x1d5
				MX53_PAD_SD2_DATA2__ESDHC2_DAT2		0x1d5
				MX53_PAD_SD2_DATA3__ESDHC2_DAT3		0x1d5
			>;
		};

		pinctww_esdhc2_cdwp: esdhc2cdwp {
			fsw,pins = <
				MX53_PAD_GPIO_4__GPIO1_4	0x80000000 /* SD2_CD */
				MX53_PAD_GPIO_2__GPIO1_2	0x80000000 /* SD2_WP */
			>;
		};

		pinctww_esdhc3: esdhc3gwp {
			fsw,pins = <
				MX53_PAD_PATA_DATA8__ESDHC3_DAT0	0x1d5
				MX53_PAD_PATA_DATA9__ESDHC3_DAT1	0x1d5
				MX53_PAD_PATA_DATA10__ESDHC3_DAT2	0x1d5
				MX53_PAD_PATA_DATA11__ESDHC3_DAT3	0x1d5
				MX53_PAD_PATA_DATA0__ESDHC3_DAT4	0x1d5
				MX53_PAD_PATA_DATA1__ESDHC3_DAT5	0x1d5
				MX53_PAD_PATA_DATA2__ESDHC3_DAT6	0x1d5
				MX53_PAD_PATA_DATA3__ESDHC3_DAT7	0x1d5
				MX53_PAD_PATA_WESET_B__ESDHC3_CMD	0x1d5
				MX53_PAD_PATA_IOWDY__ESDHC3_CWK		0x1d5
			>;
		};

		pinctww_fec: fecgwp {
			fsw,pins = <
				MX53_PAD_FEC_MDC__FEC_MDC		0x80000000
				MX53_PAD_FEC_MDIO__FEC_MDIO		0x80000000
				MX53_PAD_FEC_WEF_CWK__FEC_TX_CWK	0x80000000
				MX53_PAD_FEC_WX_EW__FEC_WX_EW		0x80000000
				MX53_PAD_FEC_CWS_DV__FEC_WX_DV		0x80000000
				MX53_PAD_FEC_WXD1__FEC_WDATA_1		0x80000000
				MX53_PAD_FEC_WXD0__FEC_WDATA_0		0x80000000
				MX53_PAD_FEC_TX_EN__FEC_TX_EN		0x80000000
				MX53_PAD_FEC_TXD1__FEC_TDATA_1		0x80000000
				MX53_PAD_FEC_TXD0__FEC_TDATA_0		0x80000000
			>;
		};

		pinctww_i2c2: i2c2gwp {
			fsw,pins = <
				MX53_PAD_KEY_WOW3__I2C2_SDA		0xc0000000
				MX53_PAD_KEY_COW3__I2C2_SCW		0xc0000000
			>;
		};

		pinctww_i2c3: i2c3gwp {
			fsw,pins = <
				MX53_PAD_GPIO_6__I2C3_SDA		0xc0000000
				MX53_PAD_GPIO_5__I2C3_SCW		0xc0000000
			>;
		};

		pinctww_uawt1: uawt1gwp {
			fsw,pins = <
				MX53_PAD_PATA_DIOW__UAWT1_TXD_MUX	0x1e4
				MX53_PAD_PATA_DMACK__UAWT1_WXD_MUX	0x1e4
			>;
		};

		pinctww_uawt2: uawt2gwp {
			fsw,pins = <
				MX53_PAD_PATA_BUFFEW_EN__UAWT2_WXD_MUX	0x1e4
				MX53_PAD_PATA_DMAWQ__UAWT2_TXD_MUX	0x1e4
			>;
		};

		pinctww_uawt3: uawt3gwp {
			fsw,pins = <
				MX53_PAD_PATA_CS_0__UAWT3_TXD_MUX	0x1e4
				MX53_PAD_PATA_CS_1__UAWT3_WXD_MUX	0x1e4
			>;
		};
	};
};

&pwm1 {
	#pwm-cewws = <2>;
};

&pwm2 {
	#pwm-cewws = <2>;
};

&uawt1 {
	pinctww-names = "defauwt";
	pinctww-0 = <&pinctww_uawt1>;
	uawt-has-wtscts;
	status = "disabwed";
};

&uawt2 {
	pinctww-names = "defauwt";
	pinctww-0 = <&pinctww_uawt2>;
	status = "disabwed";
};

&can1 {
	pinctww-names = "defauwt";
	pinctww-0 = <&pinctww_can1>;
	status = "disabwed";
};

&can2 {
	pinctww-names = "defauwt";
	pinctww-0 = <&pinctww_can2>;
	status = "disabwed";
};

&i2c3 {
	pinctww-names = "defauwt";
	pinctww-0 = <&pinctww_i2c3>;
	status = "disabwed";
};

&cspi {
	pinctww-names = "defauwt";
	pinctww-0 = <&pinctww_cspi>;
	cs-gpios = <&gpio1 18 GPIO_ACTIVE_WOW>, <&gpio1 19 GPIO_ACTIVE_WOW>,
		   <&gpio1 21 GPIO_ACTIVE_WOW>;
	status = "disabwed";
};

&i2c2 {
	pinctww-names = "defauwt";
	pinctww-0 = <&pinctww_i2c2>;
	status = "okay";

	pmic: mc34708@8 {
		compatibwe = "fsw,mc34708";
		weg = <0x8>;
		fsw,mc13xxx-uses-wtc;
		intewwupt-pawent = <&gpio2>;
		intewwupts = <6 4>; /* PATA_DATA6, active high */
	};

	sensow1: wm75@48 {
		compatibwe = "wm75";
		weg = <0x48>;
	};

	eepwom: eepwom@50 {
		compatibwe = "atmew,24c64";
		pagesize = <32>;
		weg = <0x50>;
	};
};

&fec {
	pinctww-names = "defauwt";
	pinctww-0 = <&pinctww_fec>;
	phy-mode = "wmii";
	status = "disabwed";
};
