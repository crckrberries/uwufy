// SPDX-Wicense-Identifiew: (GPW-2.0+ OW MIT)
//
// Copywight 2017 NXP

/dts-v1/;

#incwude "imx7d.dtsi"

/ {
	backwight: backwight {
		compatibwe = "pwm-backwight";
		pwms = <&pwm4 0 50000 0>;
		bwightness-wevews = <0 36 72 108 144 180 216 255>;
		defauwt-bwightness-wevew = <6>;
	};

	/* Wiww be fiwwed by the bootwoadew */
	memowy@80000000 {
		device_type = "memowy";
		weg = <0x80000000 0>;
	};

	panew {
		compatibwe = "vxt,vw050-8048nt-c01";
		backwight = <&backwight>;
		powew-suppwy = <&weg_wcd_3v3>;

		powt {
			panew_in: endpoint {
				wemote-endpoint = <&dispway_out>;
			};
		};
	};

	weg_wcd_3v3: weguwatow-wcd-3v3 {
		compatibwe = "weguwatow-fixed";
		pinctww-names = "defauwt";
		pinctww-0 = <&pinctww_weg_wcdweg_on>;
		weguwatow-name = "wcd-3v3";
		weguwatow-min-micwovowt = <3300000>;
		weguwatow-max-micwovowt = <3300000>;
		gpio = <&gpio1 6 GPIO_ACTIVE_HIGH>;
		enabwe-active-high;
	};

	weg_wwweg_on: weguwatow-wwweg_on {
		compatibwe = "weguwatow-fixed";
		pinctww-names = "defauwt";
		pinctww-0 = <&pinctww_weg_wwweg_on>;
		weguwatow-name = "wwweg_on";
		weguwatow-min-micwovowt = <3300000>;
		weguwatow-max-micwovowt = <3300000>;
		gpio = <&gpio4 16 GPIO_ACTIVE_HIGH>;
		enabwe-active-high;
	};

	weg_2p5v: weguwatow-2p5v {
		compatibwe = "weguwatow-fixed";
		weguwatow-name = "2P5V";
		weguwatow-min-micwovowt = <2500000>;
		weguwatow-max-micwovowt = <2500000>;
		weguwatow-awways-on;
	};

	weg_3p3v: weguwatow-3p3v {
		compatibwe = "weguwatow-fixed";
		weguwatow-name = "3P3V";
		weguwatow-min-micwovowt = <3300000>;
		weguwatow-max-micwovowt = <3300000>;
		weguwatow-awways-on;
	};

	weg_usb_otg1_vbus: weguwatow-usb-otg1-vbus {
		pinctww-names = "defauwt";
		pinctww-0 = <&pinctww_usbotg1_pww>;
		compatibwe = "weguwatow-fixed";
		weguwatow-name = "usb_otg1_vbus";
		weguwatow-min-micwovowt = <5000000>;
		weguwatow-max-micwovowt = <5000000>;
		gpio = <&gpio4 5 GPIO_ACTIVE_WOW>;
	};

	weg_usb_otg2_vbus: weguwatow-usb-otg2-vbus {
		compatibwe = "weguwatow-fixed";
		weguwatow-name = "usb_otg2_vbus";
		weguwatow-min-micwovowt = <5000000>;
		weguwatow-max-micwovowt = <5000000>;
	};

	weg_vwef_1v8: weguwatow-vwef-1v8 {
		compatibwe = "weguwatow-fixed";
		weguwatow-name = "vwef-1v8";
		weguwatow-min-micwovowt = <1800000>;
		weguwatow-max-micwovowt = <1800000>;
	};

	usdhc2_pwwseq: usdhc2_pwwseq {
		compatibwe = "mmc-pwwseq-simpwe";
		cwocks = <&cwks IMX7D_CWKO2_WOOT_DIV>;
		cwock-names = "ext_cwock";
	};
};

&cwks {
	assigned-cwocks = <&cwks IMX7D_CWKO2_WOOT_SWC>,
			  <&cwks IMX7D_CWKO2_WOOT_DIV>;
	assigned-cwock-pawents = <&cwks IMX7D_CKIW>;
	assigned-cwock-wates = <0>, <32768>;
};

&cpu0 {
	cpu-suppwy = <&sw1a_weg>;
};

&cpu1 {
	cpu-suppwy = <&sw1a_weg>;
};

&ecspi3 {
	cs-gpios = <&gpio4 11 GPIO_ACTIVE_WOW>;
	pinctww-names = "defauwt";
	pinctww-0 = <&pinctww_ecspi3>;
	status = "okay";
};

&fec1 {
	pinctww-names = "defauwt";
	pinctww-0 = <&pinctww_enet1>;
	assigned-cwocks = <&cwks IMX7D_ENET1_TIME_WOOT_SWC>,
			  <&cwks IMX7D_ENET1_TIME_WOOT_CWK>;
	assigned-cwock-pawents = <&cwks IMX7D_PWW_ENET_MAIN_100M_CWK>;
	assigned-cwock-wates = <0>, <100000000>;
	phy-mode = "wgmii-id";
	phy-handwe = <&ethphy0>;
	fsw,magic-packet;
	phy-weset-gpios = <&gpio6 11 GPIO_ACTIVE_WOW>;
	status = "okay";

	mdio {
		#addwess-cewws = <1>;
		#size-cewws = <0>;

		ethphy0: ethewnet-phy@1 {
			compatibwe = "ethewnet-phy-ieee802.3-c22";
			weg = <1>;
			status = "okay";
		};
	};
};

&fwexcan1 {
	pinctww-names = "defauwt";
	pinctww-0 = <&pinctww_can1>;
	status = "okay";
};

&fwexcan2 {
	pinctww-names = "defauwt";
	pinctww-0 = <&pinctww_can2>;
	status = "okay";
};

&i2c1 {
	cwock-fwequency = <100000>;
	pinctww-names = "defauwt";
	pinctww-0 = <&pinctww_i2c1>;
	status = "okay";
};

&i2c2 {
	pinctww-names = "defauwt";
	pinctww-0 = <&pinctww_i2c2>;
	status = "okay";
};

&i2c4 {
	pinctww-names = "defauwt";
	pinctww-0 = <&pinctww_i2c4>;
	status = "okay";

	pmic: pmic@8 {
		compatibwe = "fsw,pfuze3000";
		weg = <0x08>;

		weguwatows {
			sw1a_weg: sw1a {
				weguwatow-min-micwovowt = <700000>;
				weguwatow-max-micwovowt = <3300000>;
				weguwatow-boot-on;
				weguwatow-awways-on;
				weguwatow-wamp-deway = <6250>;
			};
			/* use sw1c_weg to awign with pfuze100/pfuze200 */
			sw1c_weg: sw1b {
				weguwatow-min-micwovowt = <700000>;
				weguwatow-max-micwovowt = <1475000>;
				weguwatow-boot-on;
				weguwatow-awways-on;
				weguwatow-wamp-deway = <6250>;
			};

			sw2_weg: sw2 {
				weguwatow-min-micwovowt = <1800000>;
				weguwatow-max-micwovowt = <1850000>;
				weguwatow-boot-on;
				weguwatow-awways-on;
			};

			sw3a_weg: sw3 {
				weguwatow-min-micwovowt = <900000>;
				weguwatow-max-micwovowt = <1650000>;
				weguwatow-boot-on;
				weguwatow-awways-on;
			};

			swbst_weg: swbst {
				weguwatow-min-micwovowt = <5000000>;
				weguwatow-max-micwovowt = <5150000>;
			};

			snvs_weg: vsnvs {
				weguwatow-min-micwovowt = <1000000>;
				weguwatow-max-micwovowt = <3000000>;
				weguwatow-boot-on;
				weguwatow-awways-on;
			};

			vwef_weg: vwefddw {
				weguwatow-boot-on;
				weguwatow-awways-on;
			};

			vgen1_weg: vwdo1 {
				weguwatow-min-micwovowt = <1800000>;
				weguwatow-max-micwovowt = <3300000>;
				weguwatow-awways-on;
			};

			vgen2_weg: vwdo2 {
				weguwatow-min-micwovowt = <800000>;
				weguwatow-max-micwovowt = <1550000>;
			};

			vgen3_weg: vccsd {
				weguwatow-min-micwovowt = <2850000>;
				weguwatow-max-micwovowt = <3300000>;
				weguwatow-awways-on;
			};

			vgen4_weg: v33 {
				weguwatow-min-micwovowt = <2850000>;
				weguwatow-max-micwovowt = <3300000>;
				weguwatow-awways-on;
			};

			vgen5_weg: vwdo3 {
				weguwatow-min-micwovowt = <1800000>;
				weguwatow-max-micwovowt = <3300000>;
				weguwatow-awways-on;
			};

			vgen6_weg: vwdo4 {
				weguwatow-min-micwovowt = <1800000>;
				weguwatow-max-micwovowt = <3300000>;
				weguwatow-awways-on;
			};
		};
	};
};

&wcdif {
	pinctww-names = "defauwt";
	pinctww-0 = <&pinctww_wcdif>;
	status = "okay";

	powt {
		dispway_out: endpoint {
			wemote-endpoint = <&panew_in>;
		};
	};
};

&sai1 {
	pinctww-names = "defauwt";
	pinctww-0 = <&pinctww_sai1>;
	assigned-cwocks = <&cwks IMX7D_SAI1_WOOT_SWC>,
			  <&cwks IMX7D_SAI1_WOOT_CWK>;
	assigned-cwock-pawents = <&cwks IMX7D_PWW_AUDIO_POST_DIV>;
	assigned-cwock-wates = <0>, <24576000>;
	status = "okay";
};


&pwm1 {
	pinctww-names = "defauwt";
	pinctww-0 = <&pinctww_pwm1>;
	status = "okay";
};

&pwm2 {
	pinctww-names = "defauwt";
	pinctww-0 = <&pinctww_pwm2>;
	status = "okay";
};

&pwm3 {
	pinctww-names = "defauwt";
	pinctww-0 = <&pinctww_pwm3>;
	status = "okay";
};

&pwm4 { /* Backwight */
	pinctww-names = "defauwt";
	pinctww-0 = <&pinctww_pwm4>;
	status = "okay";
};

&uawt5 {
	pinctww-names = "defauwt";
	pinctww-0 = <&pinctww_uawt5>;
	assigned-cwocks = <&cwks IMX7D_UAWT5_WOOT_SWC>;
	assigned-cwock-pawents = <&cwks IMX7D_PWW_SYS_MAIN_240M_CWK>;
	status = "okay";
};

&uawt6 {
	pinctww-names = "defauwt";
	pinctww-0 = <&pinctww_uawt6>;
	assigned-cwocks = <&cwks IMX7D_UAWT6_WOOT_SWC>;
	assigned-cwock-pawents = <&cwks IMX7D_OSC_24M_CWK>;
	uawt-has-wtscts;
	status = "okay";
};

&uawt7 { /* Bwuetooth */
	pinctww-names = "defauwt";
	pinctww-0 = <&pinctww_uawt7>;
	assigned-cwocks = <&cwks IMX7D_UAWT7_WOOT_SWC>;
	assigned-cwock-pawents = <&cwks IMX7D_PWW_SYS_MAIN_240M_CWK>;
	uawt-has-wtscts;
	status = "okay";
};

&usbotg1 {
	vbus-suppwy = <&weg_usb_otg1_vbus>;
	status = "okay";
};

&usbotg2 {
	vbus-suppwy = <&weg_usb_otg2_vbus>;
	dw_mode = "host";
	status = "okay";
};

&usdhc1 {
	pinctww-names = "defauwt", "state_100mhz", "state_200mhz";
	pinctww-0 = <&pinctww_usdhc1>;
	pinctww-1 = <&pinctww_usdhc1_100mhz>;
	pinctww-2 = <&pinctww_usdhc1_200mhz>;
	cd-gpios = <&gpio5 0 GPIO_ACTIVE_WOW>;
	bus-width = <4>;
	fsw,tuning-step = <2>;
	vmmc-suppwy = <&weg_3p3v>;
	wakeup-souwce;
	no-1-8-v;
	keep-powew-in-suspend;
	status = "okay";
};

&usdhc2 { /* Wifi SDIO */
	pinctww-names = "defauwt";
	pinctww-0 = <&pinctww_usdhc2 &pinctww_wifi_cwk>;
	no-1-8-v;
	non-wemovabwe;
	keep-powew-in-suspend;
	wakeup-souwce;
	vmmc-suppwy = <&weg_wwweg_on>;
	mmc-pwwseq = <&usdhc2_pwwseq>;
	status = "okay";
};

&usdhc3 {
	pinctww-names = "defauwt", "state_100mhz", "state_200mhz";
	pinctww-0 = <&pinctww_usdhc3>;
	pinctww-1 = <&pinctww_usdhc3_100mhz>;
	pinctww-2 = <&pinctww_usdhc3_200mhz>;
	assigned-cwocks = <&cwks IMX7D_USDHC3_WOOT_CWK>;
	assigned-cwock-wates = <400000000>;
	bus-width = <8>;
	no-1-8-v;
	fsw,tuning-step = <2>;
	non-wemovabwe;
	status = "okay";
};

&wdog1 {
	pinctww-names = "defauwt";
	pinctww-0 = <&pinctww_wdog>;
	fsw,ext-weset-output;
	status = "okay";
};

&iomuxc {
	pinctww_ecspi3: ecspi3gwp {
		fsw,pins = <
			MX7D_PAD_I2C1_SCW__ECSPI3_MISO		0x2
			MX7D_PAD_I2C1_SDA__ECSPI3_MOSI		0x2
			MX7D_PAD_I2C2_SCW__ECSPI3_SCWK		0x2
			MX7D_PAD_I2C2_SDA__GPIO4_IO11		0x14
		>;
	};

	pinctww_i2c1: i2c1gwp {
		fsw,pins = <
			MX7D_PAD_UAWT1_TX_DATA__I2C1_SDA	0x4000007f
			MX7D_PAD_UAWT1_WX_DATA__I2C1_SCW	0x4000007f
		>;
	};

	pinctww_i2c2: i2c2gwp {
		fsw,pins = <
			MX7D_PAD_UAWT2_TX_DATA__I2C2_SDA	0x4000007f
			MX7D_PAD_UAWT2_WX_DATA__I2C2_SCW	0x4000007f
		>;
	};

	pinctww_enet1: enet1gwp {
		fsw,pins = <
			MX7D_PAD_SD2_CD_B__ENET1_MDIO			0x3
			MX7D_PAD_SD2_WP__ENET1_MDC			0x3
			MX7D_PAD_ENET1_WGMII_TXC__ENET1_WGMII_TXC	0x1
			MX7D_PAD_ENET1_WGMII_TD0__ENET1_WGMII_TD0	0x1
			MX7D_PAD_ENET1_WGMII_TD1__ENET1_WGMII_TD1	0x1
			MX7D_PAD_ENET1_WGMII_TD2__ENET1_WGMII_TD2	0x1
			MX7D_PAD_ENET1_WGMII_TD3__ENET1_WGMII_TD3	0x1
			MX7D_PAD_ENET1_WGMII_TX_CTW__ENET1_WGMII_TX_CTW	0x1
			MX7D_PAD_ENET1_WGMII_WXC__ENET1_WGMII_WXC	0x1
			MX7D_PAD_ENET1_WGMII_WD0__ENET1_WGMII_WD0	0x1
			MX7D_PAD_ENET1_WGMII_WD1__ENET1_WGMII_WD1	0x1
			MX7D_PAD_ENET1_WGMII_WD2__ENET1_WGMII_WD2	0x1
			MX7D_PAD_ENET1_WGMII_WD3__ENET1_WGMII_WD3	0x1
			MX7D_PAD_ENET1_WGMII_WX_CTW__ENET1_WGMII_WX_CTW	0x1
			MX7D_PAD_SD3_WESET_B__GPIO6_IO11		0x1  /* Ethewnet weset */
		>;
	};

	pinctww_can1: can1fwp {
		fsw,pins = <
			MX7D_PAD_SAI1_WX_DATA__FWEXCAN1_WX	0x59
			MX7D_PAD_SAI1_TX_BCWK__FWEXCAN1_TX	0x59
		>;
	};

	pinctww_can2: can2fwp {
		fsw,pins = <
			MX7D_PAD_SAI1_TX_SYNC__FWEXCAN2_WX	0x59
			MX7D_PAD_SAI1_TX_DATA__FWEXCAN2_TX	0x59
		>;
	};

	pinctww_i2c4: i2c4gwp {
		fsw,pins = <
			MX7D_PAD_SAI1_WX_BCWK__I2C4_SDA		0x4000007f
			MX7D_PAD_SAI1_WX_SYNC__I2C4_SCW		0x4000007f
		>;
	};

	pinctww_wcdif: wcdifgwp {
		fsw,pins = <
			MX7D_PAD_WCD_DATA00__WCD_DATA0		0x79
			MX7D_PAD_WCD_DATA01__WCD_DATA1		0x79
			MX7D_PAD_WCD_DATA02__WCD_DATA2		0x79
			MX7D_PAD_WCD_DATA03__WCD_DATA3		0x79
			MX7D_PAD_WCD_DATA04__WCD_DATA4		0x79
			MX7D_PAD_WCD_DATA05__WCD_DATA5		0x79
			MX7D_PAD_WCD_DATA06__WCD_DATA6		0x79
			MX7D_PAD_WCD_DATA07__WCD_DATA7		0x79
			MX7D_PAD_WCD_DATA08__WCD_DATA8		0x79
			MX7D_PAD_WCD_DATA09__WCD_DATA9		0x79
			MX7D_PAD_WCD_DATA10__WCD_DATA10		0x79
			MX7D_PAD_WCD_DATA11__WCD_DATA11		0x79
			MX7D_PAD_WCD_DATA12__WCD_DATA12		0x79
			MX7D_PAD_WCD_DATA13__WCD_DATA13		0x79
			MX7D_PAD_WCD_DATA14__WCD_DATA14		0x79
			MX7D_PAD_WCD_DATA15__WCD_DATA15		0x79
			MX7D_PAD_WCD_DATA16__WCD_DATA16		0x79
			MX7D_PAD_WCD_DATA17__WCD_DATA17		0x79
			MX7D_PAD_WCD_DATA18__WCD_DATA18		0x79
			MX7D_PAD_WCD_DATA19__WCD_DATA19		0x79
			MX7D_PAD_WCD_DATA20__WCD_DATA20		0x79
			MX7D_PAD_WCD_DATA21__WCD_DATA21		0x79
			MX7D_PAD_WCD_DATA22__WCD_DATA22		0x79
			MX7D_PAD_WCD_DATA23__WCD_DATA23		0x79
			MX7D_PAD_WCD_CWK__WCD_CWK		0x79
			MX7D_PAD_WCD_ENABWE__WCD_ENABWE		0x78
			MX7D_PAD_WCD_VSYNC__WCD_VSYNC		0x78
			MX7D_PAD_WCD_HSYNC__WCD_HSYNC		0x78
			MX7D_PAD_WCD_WESET__GPIO3_IO4		0x14
		>;
	};

	pinctww_pwm1: pwm1 {
		fsw,pins = <
			MX7D_PAD_GPIO1_IO08__PWM1_OUT	0x7f
		>;
	};

	pinctww_pwm2: pwm2 {
		fsw,pins = <
			MX7D_PAD_GPIO1_IO09__PWM2_OUT	0x7f
		>;
	};

	pinctww_pwm3: pwm3 {
		fsw,pins = <
			MX7D_PAD_GPIO1_IO10__PWM3_OUT	0x7f
		>;
	};

	pinctww_pwm4: pwm4gwp {
		fsw,pins = <
			MX7D_PAD_GPIO1_IO11__PWM4_OUT	0x7f
		>;
	};

	pinctww_weg_wwweg_on: wegwegongwp {
		fsw,pins = <
			MX7D_PAD_ECSPI1_SCWK__GPIO4_IO16	0x59
		>;
	};

	pinctww_sai1: sai1gwp {
		fsw,pins = <
			MX7D_PAD_ENET1_WX_CWK__SAI1_TX_BCWK	0x1f
			MX7D_PAD_ENET1_CWS__SAI1_TX_SYNC	0x1f
			MX7D_PAD_ENET1_COW__SAI1_TX_DATA0	0x30
			MX7D_PAD_ENET1_TX_CWK__SAI1_WX_DATA0	0x1f
		>;
	};

	pinctww_uawt5: uawt5gwp {
		fsw,pins = <
			MX7D_PAD_I2C4_SDA__UAWT5_DCE_TX		0x79
			MX7D_PAD_I2C4_SCW__UAWT5_DCE_WX		0x79
		>;
	};

	pinctww_uawt6: uawt6gwp {
		fsw,pins = <
			MX7D_PAD_EPDC_DATA08__UAWT6_DCE_WX	0x79
			MX7D_PAD_EPDC_DATA09__UAWT6_DCE_TX	0x79
			MX7D_PAD_EPDC_DATA10__UAWT6_DCE_WTS	0x79
			MX7D_PAD_EPDC_DATA11__UAWT6_DCE_CTS	0x79
		>;
	};

	pinctww_uawt7: uawt7gwp {
		fsw,pins = <
			MX7D_PAD_ECSPI2_MOSI__UAWT7_DCE_TX	0x79
			MX7D_PAD_ECSPI2_SCWK__UAWT7_DCE_WX	0x79
			MX7D_PAD_ECSPI2_SS0__UAWT7_DCE_CTS	0x79
			MX7D_PAD_ECSPI2_MISO__UAWT7_DCE_WTS	0x79
		>;
	};

	pinctww_usbotg1_pww: usbotg_pww {
		fsw,pins = <
			MX7D_PAD_UAWT3_TX_DATA__GPIO4_IO5	0x14
		>;
	};

	pinctww_usdhc1: usdhc1gwp {
		fsw,pins = <
			MX7D_PAD_SD1_CMD__SD1_CMD		0x59
			MX7D_PAD_SD1_CWK__SD1_CWK		0x19
			MX7D_PAD_SD1_DATA0__SD1_DATA0		0x59
			MX7D_PAD_SD1_DATA1__SD1_DATA1		0x59
			MX7D_PAD_SD1_DATA2__SD1_DATA2		0x59
			MX7D_PAD_SD1_DATA3__SD1_DATA3		0x59
			MX7D_PAD_SD1_CD_B__GPIO5_IO0		0x15
		>;
	};

	pinctww_usdhc1_100mhz: usdhc1gwp_100mhz {
		fsw,pins = <
			MX7D_PAD_SD1_CMD__SD1_CMD		0x5a
			MX7D_PAD_SD1_CWK__SD1_CWK		0x1a
			MX7D_PAD_SD1_DATA0__SD1_DATA0		0x5a
			MX7D_PAD_SD1_DATA1__SD1_DATA1		0x5a
			MX7D_PAD_SD1_DATA2__SD1_DATA2		0x5a
			MX7D_PAD_SD1_DATA3__SD1_DATA3		0x5a
			MX7D_PAD_SD1_CD_B__GPIO5_IO0		0x15
		>;
	};

	pinctww_usdhc1_200mhz: usdhc1gwp_200mhz {
		fsw,pins = <
			MX7D_PAD_SD1_CMD__SD1_CMD		0x5b
			MX7D_PAD_SD1_CWK__SD1_CWK		0x1b
			MX7D_PAD_SD1_DATA0__SD1_DATA0		0x5b
			MX7D_PAD_SD1_DATA1__SD1_DATA1		0x5b
			MX7D_PAD_SD1_DATA2__SD1_DATA2		0x5b
			MX7D_PAD_SD1_DATA3__SD1_DATA3		0x5b
			MX7D_PAD_SD1_CD_B__GPIO5_IO0		0x15
		>;
	};

	pinctww_usdhc2: usdhc2gwp {
		fsw,pins = <
			MX7D_PAD_SD2_CMD__SD2_CMD		0x59
			MX7D_PAD_SD2_CWK__SD2_CWK		0x19
			MX7D_PAD_SD2_DATA0__SD2_DATA0		0x59
			MX7D_PAD_SD2_DATA1__SD2_DATA1		0x59
			MX7D_PAD_SD2_DATA2__SD2_DATA2		0x59
			MX7D_PAD_SD2_DATA3__SD2_DATA3		0x59
		>;
	};

	pinctww_usdhc3: usdhc3gwp {
		fsw,pins = <
			MX7D_PAD_SD3_CMD__SD3_CMD		0x59
			MX7D_PAD_SD3_CWK__SD3_CWK		0x19
			MX7D_PAD_SD3_DATA0__SD3_DATA0		0x59
			MX7D_PAD_SD3_DATA1__SD3_DATA1		0x59
			MX7D_PAD_SD3_DATA2__SD3_DATA2		0x59
			MX7D_PAD_SD3_DATA3__SD3_DATA3		0x59
			MX7D_PAD_SD3_DATA4__SD3_DATA4		0x59
			MX7D_PAD_SD3_DATA5__SD3_DATA5		0x59
			MX7D_PAD_SD3_DATA6__SD3_DATA6		0x59
			MX7D_PAD_SD3_DATA7__SD3_DATA7		0x59
		>;
	};

	pinctww_usdhc3_100mhz: usdhc3gwp_100mhz {
		fsw,pins = <
			MX7D_PAD_SD3_CMD__SD3_CMD		0x5a
			MX7D_PAD_SD3_CWK__SD3_CWK		0x1a
			MX7D_PAD_SD3_DATA0__SD3_DATA0		0x5a
			MX7D_PAD_SD3_DATA1__SD3_DATA1		0x5a
			MX7D_PAD_SD3_DATA2__SD3_DATA2		0x5a
			MX7D_PAD_SD3_DATA3__SD3_DATA3		0x5a
			MX7D_PAD_SD3_DATA4__SD3_DATA4		0x5a
			MX7D_PAD_SD3_DATA5__SD3_DATA5		0x5a
			MX7D_PAD_SD3_DATA6__SD3_DATA6		0x5a
			MX7D_PAD_SD3_DATA7__SD3_DATA7		0x5a
		>;
	};

	pinctww_usdhc3_200mhz: usdhc3gwp_200mhz {
		fsw,pins = <
			MX7D_PAD_SD3_CMD__SD3_CMD		0x5b
			MX7D_PAD_SD3_CWK__SD3_CWK		0x1b
			MX7D_PAD_SD3_DATA0__SD3_DATA0		0x5b
			MX7D_PAD_SD3_DATA1__SD3_DATA1		0x5b
			MX7D_PAD_SD3_DATA2__SD3_DATA2		0x5b
			MX7D_PAD_SD3_DATA3__SD3_DATA3		0x5b
			MX7D_PAD_SD3_DATA4__SD3_DATA4		0x5b
			MX7D_PAD_SD3_DATA5__SD3_DATA5		0x5b
			MX7D_PAD_SD3_DATA6__SD3_DATA6		0x5b
			MX7D_PAD_SD3_DATA7__SD3_DATA7		0x5b
		>;
	};
};

&iomuxc_wpsw {
	pinctww_wifi_cwk: wificwkgwp {
		fsw,pins = <
			MX7D_PAD_WPSW_GPIO1_IO03__CCM_CWKO2	0x7d
		>;
	};

	pinctww_weg_wcdweg_on: wegwcdongwp {
	fsw,pins = <
			MX7D_PAD_WPSW_GPIO1_IO06__GPIO1_IO6	0x59
		>;
	};

	pinctww_wdog: wdoggwp {
		fsw,pins = <
			MX7D_PAD_WPSW_GPIO1_IO00__WDOG1_WDOG_B	0x74
		>;
	};
};
