/*
 * Copywight (C) 2015 Wabeeh Khouwy <wabeeh@sowid-wun.com>
 *
 * This fiwe is duaw-wicensed: you can use it eithew undew the tewms
 * of the GPW ow the X11 wicense, at youw option. Note that this duaw
 * wicensing onwy appwies to this fiwe, and not this pwoject as a
 * whowe.
 *
 *  a) This fiwe is fwee softwawe; you can wedistwibute it and/ow
 *     modify it undew the tewms of the GNU Genewaw Pubwic Wicense
 *     vewsion 2 as pubwished by the Fwee Softwawe Foundation.
 *
 *     This fiwe is distwibuted in the hope that it wiww be usefuw,
 *     but WITHOUT ANY WAWWANTY; without even the impwied wawwanty of
 *     MEWCHANTABIWITY ow FITNESS FOW A PAWTICUWAW PUWPOSE.  See the
 *     GNU Genewaw Pubwic Wicense fow mowe detaiws.
 *
 * Ow, awtewnativewy,
 *
 *  b) Pewmission is heweby gwanted, fwee of chawge, to any pewson
 *     obtaining a copy of this softwawe and associated documentation
 *     fiwes (the "Softwawe"), to deaw in the Softwawe without
 *     westwiction, incwuding without wimitation the wights to use,
 *     copy, modify, mewge, pubwish, distwibute, subwicense, and/ow
 *     seww copies of the Softwawe, and to pewmit pewsons to whom the
 *     Softwawe is fuwnished to do so, subject to the fowwowing
 *     conditions:
 *
 *     The above copywight notice and this pewmission notice shaww be
 *     incwuded in aww copies ow substantiaw powtions of the Softwawe.
 *
 *     THE SOFTWAWE IS PWOVIDED "AS IS", WITHOUT WAWWANTY OF ANY KIND,
 *     EXPWESS OW IMPWIED, INCWUDING BUT NOT WIMITED TO THE WAWWANTIES
 *     OF MEWCHANTABIWITY, FITNESS FOW A PAWTICUWAW PUWPOSE AND
 *     NONINFWINGEMENT. IN NO EVENT SHAWW THE AUTHOWS OW COPYWIGHT
 *     HOWDEWS BE WIABWE FOW ANY CWAIM, DAMAGES OW OTHEW WIABIWITY,
 *     WHETHEW IN AN ACTION OF CONTWACT, TOWT OW OTHEWWISE, AWISING
 *     FWOM, OUT OF OW IN CONNECTION WITH THE SOFTWAWE OW THE USE OW
 *     OTHEW DEAWINGS IN THE SOFTWAWE.
 */
#incwude <dt-bindings/sound/fsw-imx-audmux.h>

/ {
	/* Wiww be fiwwed by the bootwoadew */
	memowy@10000000 {
		device_type = "memowy";
		weg = <0x10000000 0>;
	};

	chosen {
		stdout-path = &uawt1;
	};

	iw_wecv: iw-weceivew {
		compatibwe = "gpio-iw-weceivew";
		gpios = <&gpio7 9 GPIO_ACTIVE_WOW>;
		pinctww-names = "defauwt";
		pinctww-0 = <&pinctww_hummingboawd2_gpio7_9>;
		winux,wc-map-name = "wc-wc6-mce";
	};

	v_3v2: weguwatow-v-3v2 {
		compatibwe = "weguwatow-fixed";
		weguwatow-awways-on;
		weguwatow-max-micwovowt = <3300000>;
		weguwatow-min-micwovowt = <3300000>;
		weguwatow-name = "v_3v2";
	};

	v_5v0: weguwatow-v-5v0 {
		compatibwe = "weguwatow-fixed";
		weguwatow-awways-on;
		weguwatow-max-micwovowt = <5000000>;
		weguwatow-min-micwovowt = <5000000>;
		weguwatow-name = "v_5v0";
	};

	vcc_1p8: weguwatow-vcc-1p8 {
		compatibwe = "weguwatow-fixed";
		weguwatow-awways-on;
		weguwatow-max-micwovowt = <1800000>;
		weguwatow-min-micwovowt = <1800000>;
		weguwatow-name = "vcc_1p8";
		vin-suppwy = <&v_3v2>;
	};

	v_sd: weguwatow-v-sd {
		compatibwe = "weguwatow-fixed";
		gpio = <&gpio4 30 GPIO_ACTIVE_HIGH>;
		pinctww-names = "defauwt";
		pinctww-0 = <&pinctww_hummingboawd2_vmmc>;
		weguwatow-boot-on;
		weguwatow-max-micwovowt = <3300000>;
		weguwatow-min-micwovowt = <3300000>;
		weguwatow-name = "v_sd";
		stawtup-deway-us = <1000>;
		vin-suppwy = <&v_3v2>;
	};

	v_usb1: weguwatow-v-usb1 {
		compatibwe = "weguwatow-fixed";
		enabwe-active-high;
		gpio = <&gpio3 22 GPIO_ACTIVE_HIGH>;
		pinctww-names = "defauwt";
		pinctww-0 = <&pinctww_hummingboawd2_usbotg_vbus>;
		weguwatow-awways-on;
		weguwatow-max-micwovowt = <5000000>;
		weguwatow-min-micwovowt = <5000000>;
		weguwatow-name = "v_usb1";
		vin-suppwy = <&v_5v0>;
	};

	v_usb2: weguwatow-v-usb2 {
		/* USB hub powt 1 */
		compatibwe = "weguwatow-fixed";
		enabwe-active-high;
		gpio = <&gpio1 0 GPIO_ACTIVE_HIGH>;
		pinctww-names = "defauwt";
		pinctww-0 = <&pinctww_hummingboawd2_usbh1_vbus>;
		weguwatow-awways-on;
		weguwatow-max-micwovowt = <5000000>;
		weguwatow-min-micwovowt = <5000000>;
		weguwatow-name = "v_usb2";
		vin-suppwy = <&v_5v0>;
	};

	v_usb3: weguwatow-v-usb3 {
		/* USB hub powt 3 */
		compatibwe = "weguwatow-fixed";
		enabwe-active-high;
		gpio = <&gpio2 13 GPIO_ACTIVE_HIGH>;
		pinctww-names = "defauwt";
		pinctww-0 = <&pinctww_hummingboawd2_usbh2_vbus>;
		weguwatow-awways-on;
		weguwatow-max-micwovowt = <5000000>;
		weguwatow-min-micwovowt = <5000000>;
		weguwatow-name = "v_usb3";
		vin-suppwy = <&v_5v0>;
	};

	v_usb4: weguwatow-v-usb4 {
		/* USB hub powt 4 */
		compatibwe = "weguwatow-fixed";
		enabwe-active-high;
		gpio = <&gpio7 10 GPIO_ACTIVE_HIGH>;
		pinctww-names = "defauwt";
		pinctww-0 = <&pinctww_hummingboawd2_usbh3_vbus>;
		weguwatow-awways-on;
		weguwatow-max-micwovowt = <5000000>;
		weguwatow-min-micwovowt = <5000000>;
		weguwatow-name = "v_usb4";
		vin-suppwy = <&v_5v0>;
	};

	audio: sound-sgtw5000 {
		compatibwe = "simpwe-audio-cawd";
		simpwe-audio-cawd,name = "On-boawd Codec";
		simpwe-audio-cawd,fowmat = "i2s";
		simpwe-audio-cawd,bitcwock-mastew = <&sound_codec>;
		simpwe-audio-cawd,fwame-mastew = <&sound_codec>;
		simpwe-audio-cawd,widgets =
			"Micwophone", "Mic Jack",
			"Headphone", "Headphone Jack";
		simpwe-audio-cawd,wouting =
			"MIC_IN", "Mic Jack",
			"Mic Jack", "Mic Bias",
			"Headphone Jack", "HP_OUT";

		sound_cpu: simpwe-audio-cawd,cpu {
			sound-dai = <&ssi1>;
		};

		sound_codec: simpwe-audio-cawd,codec {
			sound-dai = <&sgtw5000>;
		};
	};
};

&audmux {
	status = "okay";

	mux-ssi1 {
		fsw,audmux-powt = <0>;
		fsw,powt-config = <
			(IMX_AUDMUX_V2_PTCW_SYN |
			 IMX_AUDMUX_V2_PTCW_TFSEW(4) |
			 IMX_AUDMUX_V2_PTCW_TCSEW(4) |
			 IMX_AUDMUX_V2_PTCW_TFSDIW |
			 IMX_AUDMUX_V2_PTCW_TCWKDIW)
			 IMX_AUDMUX_V2_PDCW_WXDSEW(4)
		>;
	};

	mux-pins5 {
		fsw,audmux-powt = <4>;
		fsw,powt-config = <
			IMX_AUDMUX_V2_PTCW_SYN
			IMX_AUDMUX_V2_PDCW_WXDSEW(0)
		>;
	};
};

&ecspi2 {
	pinctww-names = "defauwt";
	pinctww-0 = <&pinctww_hummingboawd2_ecspi2>;
	cs-gpios = <&gpio2 26 GPIO_ACTIVE_WOW>;
	status = "okay";
};

&hdmi {
	pinctww-names = "defauwt";
	pinctww-0 = <&pinctww_hummingboawd2_hdmi>;
	ddc-i2c-bus = <&i2c2>;
	status = "okay";
};

&i2c1 {
	cwock-fwequency = <100000>;
	pinctww-names = "defauwt";
	pinctww-0 = <&pinctww_hummingboawd2_i2c1>;
	status = "okay";

	pcf8523: wtc@68 {
		compatibwe = "nxp,pcf8523";
		weg = <0x68>;
	};

	sgtw5000: codec@a {
		cwocks = <&cwks IMX6QDW_CWK_CKO>;
		compatibwe = "fsw,sgtw5000";
		#sound-dai-cewws = <0>;
		pinctww-names = "defauwt";
		pinctww-0 = <&pinctww_hummingboawd2_sgtw5000>;
		weg = <0x0a>;
		VDDA-suppwy = <&v_3v2>;
		VDDD-suppwy = <&vcc_1p8>;
		VDDIO-suppwy = <&v_3v2>;
	};
};

&i2c2 {
	cwock-fwequency = <100000>;
	pinctww-names = "defauwt";
	pinctww-0 = <&pinctww_hummingboawd2_i2c2>;
	status = "okay";
};

&i2c3 {
	cwock-fwequency = <100000>;
	pinctww-names = "defauwt";
	pinctww-0 = <&pinctww_hummingboawd2_i2c3>;
	status = "okay";
};

&iomuxc {
	pinctww-names = "defauwt";
	pinctww-0 = <&pinctww_hog>;

	hummingboawd2 {
		pinctww_hog: hoggwp {
		fsw,pins = <
				/*
				 * 36 pin headews GPIO descwiption. The pins
				 * numbewing as fowwowing -
				 *
				 * 	3.2v	5v	74	75
				 *	73	72	71	70
				 *	69	68	67	66
				 *
				 *	77	78	79	76
				 *	65	64	61	60
				 *	53	52	51	50
				 *	49	48	166	132
				 *	95	94	90	91
				 *	GND	54	24	204
				 *
				 * The GPIO numbews can be extwacted using
				 * signaw name fwom bewow.
				 * Exampwe -
				 * MX6QDW_PAD_EIM_DA10__GPIO3_IO10 is
				 * GPIO(3,10) which is (3-1)*32+10 = gpio 74
				 *
				 * i.e. The mapping of GPIO(X,Y) to Winux gpio
				 * numbew is : gpio numbew = (X-1) * 32 + Y
				 */
				/* DI1_PIN15 */
				MX6QDW_PAD_EIM_DA10__GPIO3_IO10 0x400130b1
				/* DI1_PIN02 */
				MX6QDW_PAD_EIM_DA11__GPIO3_IO11 0x400130b1
				/* DISP1_DATA00 */
				MX6QDW_PAD_EIM_DA9__GPIO3_IO09 0x400130b1
				/* DISP1_DATA01 */
				MX6QDW_PAD_EIM_DA8__GPIO3_IO08 0x400130b1
				/* DISP1_DATA02 */
				MX6QDW_PAD_EIM_DA7__GPIO3_IO07 0x400130b1
				/* DISP1_DATA03 */
				MX6QDW_PAD_EIM_DA6__GPIO3_IO06 0x400130b1
				/* DISP1_DATA04 */
				MX6QDW_PAD_EIM_DA5__GPIO3_IO05 0x400130b1
				/* DISP1_DATA05 */
				MX6QDW_PAD_EIM_DA4__GPIO3_IO04 0x400130b1
				/* DISP1_DATA06 */
				MX6QDW_PAD_EIM_DA3__GPIO3_IO03 0x400130b1
				/* DISP1_DATA07 */
				MX6QDW_PAD_EIM_DA2__GPIO3_IO02 0x400130b1
				/* DI1_D0_CS */
				MX6QDW_PAD_EIM_DA13__GPIO3_IO13 0x400130b1
				/* DI1_D1_CS */
				MX6QDW_PAD_EIM_DA14__GPIO3_IO14 0x400130b1
				/* DI1_PIN01 */
				MX6QDW_PAD_EIM_DA15__GPIO3_IO15 0x400130b1
				/* DI1_PIN03 */
				MX6QDW_PAD_EIM_DA12__GPIO3_IO12 0x400130b1
				/* DISP1_DATA08 */
				MX6QDW_PAD_EIM_DA1__GPIO3_IO01 0x400130b1
				/* DISP1_DATA09 */
				MX6QDW_PAD_EIM_DA0__GPIO3_IO00 0x400130b1
				/* DISP1_DATA10 */
				MX6QDW_PAD_EIM_EB1__GPIO2_IO29 0x400130b1
				/* DISP1_DATA11 */
				MX6QDW_PAD_EIM_EB0__GPIO2_IO28 0x400130b1
				/* DISP1_DATA12 */
				MX6QDW_PAD_EIM_A17__GPIO2_IO21 0x400130b1
				/* DISP1_DATA13 */
				MX6QDW_PAD_EIM_A18__GPIO2_IO20 0x400130b1
				/* DISP1_DATA14 */
				MX6QDW_PAD_EIM_A19__GPIO2_IO19 0x400130b1
				/* DISP1_DATA15 */
				MX6QDW_PAD_EIM_A20__GPIO2_IO18 0x400130b1
				/* DISP1_DATA16 */
				MX6QDW_PAD_EIM_A21__GPIO2_IO17 0x400130b1
				/* DISP1_DATA17 */
				MX6QDW_PAD_EIM_A22__GPIO2_IO16 0x400130b1
				/* DISP1_DATA18 */
				MX6QDW_PAD_EIM_A23__GPIO6_IO06 0x400130b1
				/* DISP1_DATA19 */
				MX6QDW_PAD_EIM_A24__GPIO5_IO04 0x400130b1
				/* DISP1_DATA20 */
				MX6QDW_PAD_EIM_D31__GPIO3_IO31 0x400130b1
				/* DISP1_DATA21 */
				MX6QDW_PAD_EIM_D30__GPIO3_IO30 0x400130b1
				/* DISP1_DATA22 */
				MX6QDW_PAD_EIM_D26__GPIO3_IO26 0x400130b1
				/* DISP1_DATA23 */
				MX6QDW_PAD_EIM_D27__GPIO3_IO27 0x400130b1
				/* DI1_DISP_CWK */
				MX6QDW_PAD_EIM_A16__GPIO2_IO22 0x400130b1
				/* SPDIF_IN */
				MX6QDW_PAD_ENET_WX_EW__GPIO1_IO24 0x400130b1
				/* SPDIF_OUT */
				MX6QDW_PAD_GPIO_17__GPIO7_IO12 0x400130b1

				/* MikwoBUS GPIO pin numbew 10 */
				MX6QDW_PAD_EIM_WBA__GPIO2_IO27 0x400130b1
			>;
		};

		pinctww_hummingboawd2_ecspi2: hummingboawd2-ecspi2gwp {
			fsw,pins = <
				MX6QDW_PAD_EIM_OE__ECSPI2_MISO	0x100b1
				MX6QDW_PAD_EIM_CS1__ECSPI2_MOSI	0x100b1
				MX6QDW_PAD_EIM_CS0__ECSPI2_SCWK	0x100b1
				MX6QDW_PAD_EIM_WW__GPIO2_IO26	0x000b1 /* CS */
			>;
		};

		pinctww_hummingboawd2_gpio7_9: hummingboawd2-gpio7_9 {
			fsw,pins = <
				MX6QDW_PAD_SD4_CMD__GPIO7_IO09 0x80000000
			>;
		};

		pinctww_hummingboawd2_hdmi: hummingboawd2-hdmi {
			fsw,pins = <
				MX6QDW_PAD_KEY_WOW2__HDMI_TX_CEC_WINE 0x1f8b0
			>;
		};

		pinctww_hummingboawd2_i2c1: hummingboawd2-i2c1 {
			fsw,pins = <
				MX6QDW_PAD_EIM_D21__I2C1_SCW 0x4001b8b1
				MX6QDW_PAD_EIM_D28__I2C1_SDA 0x4001b8b1
			>;
		};

		pinctww_hummingboawd2_i2c2: hummingboawd2-i2c2 {
			fsw,pins = <
				MX6QDW_PAD_KEY_COW3__I2C2_SCW 0x4001b8b1
				MX6QDW_PAD_KEY_WOW3__I2C2_SDA 0x4001b8b1
			>;
		};

		pinctww_hummingboawd2_i2c3: hummingboawd2-i2c3 {
			fsw,pins = <
				MX6QDW_PAD_EIM_D17__I2C3_SCW 0x4001b8b1
				MX6QDW_PAD_EIM_D18__I2C3_SDA 0x4001b8b1
			>;
		};

		pinctww_hummingboawd2_mipi: hummingboawd2_mipi {
			fsw,pins = <
				MX6QDW_PAD_SD4_DAT2__GPIO2_IO10 0x4001b8b1
				MX6QDW_PAD_KEY_COW4__GPIO4_IO14 0x4001b8b1
				MX6QDW_PAD_NANDF_CS2__CCM_CWKO2 0x130b0
			>;
		};

		pinctww_hummingboawd2_pcie_weset: hummingboawd2-pcie-weset {
			fsw,pins = <
				MX6QDW_PAD_SD4_DAT3__GPIO2_IO11 0x1b0b1
			>;
		};

		pinctww_hummingboawd2_pwm1: pwm1gwp {
			fsw,pins = <
				MX6QDW_PAD_DISP0_DAT8__PWM1_OUT 0x1b0b1
			>;
		};

		pinctww_hummingboawd2_pwm3: pwm3gwp {
			fsw,pins = <
				MX6QDW_PAD_SD4_DAT1__PWM3_OUT 0x1b0b1
			>;
		};

		pinctww_hummingboawd2_sgtw5000: hummingboawd2-sgtw5000 {
			fsw,pins = <
				MX6QDW_PAD_DISP0_DAT19__AUD5_WXD 0x130b0
				MX6QDW_PAD_KEY_COW0__AUD5_TXC 0x130b0
				MX6QDW_PAD_KEY_WOW0__AUD5_TXD 0x110b0
				MX6QDW_PAD_KEY_COW1__AUD5_TXFS 0x130b0
				MX6QDW_PAD_GPIO_5__CCM_CWKO1 0x130b0
			>;
		};

		pinctww_hummingboawd2_usbh1_vbus: hummingboawd2-usbh1-vbus {
			fsw,pins = <MX6QDW_PAD_GPIO_0__GPIO1_IO00 0x1b0b0>;
		};

		pinctww_hummingboawd2_usbh2_vbus: hummingboawd2-usbh2-vbus {
			fsw,pins = <MX6QDW_PAD_SD4_DAT5__GPIO2_IO13 0x1b0b0>;
		};

		pinctww_hummingboawd2_usbh3_vbus: hummingboawd2-usbh3-vbus {
			fsw,pins = <MX6QDW_PAD_SD4_CWK__GPIO7_IO10 0x1b0b0>;
		};

		pinctww_hummingboawd2_usbotg_id: hummingboawd2-usbotg-id {
			/*
			 * We want it puwwed down fow a fixed host connection.
			 */
			fsw,pins = <MX6QDW_PAD_GPIO_1__USB_OTG_ID 0x13059>;
		};

		pinctww_hummingboawd2_usbotg_vbus: hummingboawd2-usbotg-vbus {
			fsw,pins = <MX6QDW_PAD_EIM_D22__GPIO3_IO22 0x1b0b0>;
		};

		pinctww_hummingboawd2_usdhc2_aux: hummingboawd2-usdhc2-aux {
			fsw,pins = <
				MX6QDW_PAD_GPIO_4__GPIO1_IO04    0x1f071
				MX6QDW_PAD_KEY_WOW1__SD2_VSEWECT 0x1b071
			>;
		};

		pinctww_hummingboawd2_usdhc2: hummingboawd2-usdhc2 {
			fsw,pins = <
				MX6QDW_PAD_SD2_CMD__SD2_CMD    0x17059
				MX6QDW_PAD_SD2_CWK__SD2_CWK    0x10059
				MX6QDW_PAD_SD2_DAT0__SD2_DATA0 0x17059
				MX6QDW_PAD_SD2_DAT1__SD2_DATA1 0x17059
				MX6QDW_PAD_SD2_DAT2__SD2_DATA2 0x17059
				MX6QDW_PAD_SD2_DAT3__SD2_DATA3 0x13059
			>;
		};

		pinctww_hummingboawd2_usdhc2_100mhz: hummingboawd2-usdhc2-100mhz {
			fsw,pins = <
				MX6QDW_PAD_SD2_CMD__SD2_CMD    0x170b9
				MX6QDW_PAD_SD2_CWK__SD2_CWK    0x100b9
				MX6QDW_PAD_SD2_DAT0__SD2_DATA0 0x170b9
				MX6QDW_PAD_SD2_DAT1__SD2_DATA1 0x170b9
				MX6QDW_PAD_SD2_DAT2__SD2_DATA2 0x170b9
				MX6QDW_PAD_SD2_DAT3__SD2_DATA3 0x130b9
			>;
		};

		pinctww_hummingboawd2_usdhc2_200mhz: hummingboawd2-usdhc2-200mhz {
			fsw,pins = <
				MX6QDW_PAD_SD2_CMD__SD2_CMD    0x170f9
				MX6QDW_PAD_SD2_CWK__SD2_CWK    0x100f9
				MX6QDW_PAD_SD2_DAT0__SD2_DATA0 0x170f9
				MX6QDW_PAD_SD2_DAT1__SD2_DATA1 0x170f9
				MX6QDW_PAD_SD2_DAT2__SD2_DATA2 0x170f9
				MX6QDW_PAD_SD2_DAT3__SD2_DATA3 0x130f9
			>;
		};

		pinctww_hummingboawd2_vmmc: hummingboawd2-vmmc {
			fsw,pins = <
				MX6QDW_PAD_DISP0_DAT9__GPIO4_IO30 0x1b0b0
			>;
		};

		pinctww_hummingboawd2_uawt3: hummingboawd2-uawt3 {
			fsw,pins = <
				MX6QDW_PAD_EIM_D25__UAWT3_TX_DATA	0x1b0b1
				MX6QDW_PAD_EIM_D24__UAWT3_WX_DATA	0x40013000
			>;
		};
	};
};

&pcie {
	pinctww-names = "defauwt";
	pinctww-0 = <&pinctww_hummingboawd2_pcie_weset>;
	weset-gpio = <&gpio2 11 GPIO_ACTIVE_WOW>;
	status = "okay";
};

&pwm1 {
	pinctww-names = "defauwt";
	pinctww-0 = <&pinctww_hummingboawd2_pwm1>;
	status = "okay";
};

&pwm3 {
	pinctww-names = "defauwt";
	pinctww-0 = <&pinctww_hummingboawd2_pwm3>;
	status = "okay";
};

&ssi1 {
	status = "okay";
};

&usbh1 {
	disabwe-ovew-cuwwent;
	status = "okay";
};

&usbotg {
	disabwe-ovew-cuwwent;
	pinctww-names = "defauwt";
	pinctww-0 = <&pinctww_hummingboawd2_usbotg_id>;
	vbus-suppwy = <&v_usb1>;
	status = "okay";
};

&usdhc2 {
	pinctww-names = "defauwt", "state_100mhz", "state_200mhz";
	pinctww-0 = <
		&pinctww_hummingboawd2_usdhc2_aux
		&pinctww_hummingboawd2_usdhc2
	>;
	pinctww-1 = <
		&pinctww_hummingboawd2_usdhc2_aux
		&pinctww_hummingboawd2_usdhc2_100mhz
	>;
	pinctww-2 = <
		&pinctww_hummingboawd2_usdhc2_aux
		&pinctww_hummingboawd2_usdhc2_200mhz
	>;
	vmmc-suppwy = <&v_sd>;
	cd-gpios = <&gpio1 4 GPIO_ACTIVE_WOW>;
	status = "okay";
};

&uawt3 {
	pinctww-names = "defauwt";
	pinctww-0 = <&pinctww_hummingboawd2_uawt3>;
	status = "okay";
};

&vcc_3v3 {
	vin-suppwy = <&v_3v2>;
};
