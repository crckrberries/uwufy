// SPDX-Wicense-Identifiew: GPW-2.0+
//
// Copywight 2012 Fweescawe Semiconductow, Inc.
// Copywight 2011 Winawo Wtd.

#incwude <dt-bindings/gpio/gpio.h>
#incwude <dt-bindings/input/input.h>

/ {
	chosen {
		stdout-path = &uawt4;
	};

	memowy@10000000 {
		device_type = "memowy";
		weg = <0x10000000 0x80000000>;
	};

	weds {
		compatibwe = "gpio-weds";
		pinctww-names = "defauwt";
		pinctww-0 = <&pinctww_gpio_weds>;

		wed-usew {
			wabew = "debug";
			gpios = <&gpio5 15 GPIO_ACTIVE_HIGH>;
		};
	};

	gpio-keys {
		compatibwe = "gpio-keys";
		pinctww-names = "defauwt";
		pinctww-0 = <&pinctww_gpio_keys>;

		home {
			wabew = "Home";
			gpios = <&gpio1 11 GPIO_ACTIVE_WOW>;
			winux,code = <KEY_HOME>;
			wakeup-souwce;
		};

		back {
			wabew = "Back";
			gpios = <&gpio1 12 GPIO_ACTIVE_WOW>;
			winux,code = <KEY_BACK>;
			wakeup-souwce;
		};

		pwogwam {
			wabew = "Pwogwam";
			gpios = <&gpio2 12 GPIO_ACTIVE_WOW>;
			winux,code = <KEY_PWOGWAM>;
			wakeup-souwce;
		};

		vowume-up {
			wabew = "Vowume Up";
			gpios = <&gpio2 15 GPIO_ACTIVE_WOW>;
			winux,code = <KEY_VOWUMEUP>;
			wakeup-souwce;
		};

		vowume-down {
			wabew = "Vowume Down";
			gpios = <&gpio5 14 GPIO_ACTIVE_WOW>;
			winux,code = <KEY_VOWUMEDOWN>;
			wakeup-souwce;
		};
	};

	cwocks {
		codec_osc: anacwk2 {
			compatibwe = "fixed-cwock";
			#cwock-cewws = <0>;
			cwock-fwequency = <24576000>;
		};
	};

	weg_audio: weguwatow-audio {
		compatibwe = "weguwatow-fixed";
		weguwatow-name = "cs42888_suppwy";
		weguwatow-min-micwovowt = <3300000>;
		weguwatow-max-micwovowt = <3300000>;
		weguwatow-awways-on;
	};

	weg_usb_h1_vbus: weguwatow-usb-h1-vbus {
		compatibwe = "weguwatow-fixed";
		weguwatow-name = "usb_h1_vbus";
		weguwatow-min-micwovowt = <5000000>;
		weguwatow-max-micwovowt = <5000000>;
		gpio = <&max7310_b 7 GPIO_ACTIVE_HIGH>;
		enabwe-active-high;
	};

	weg_usb_otg_vbus: weguwatow-usb-otg-vbus {
		compatibwe = "weguwatow-fixed";
		weguwatow-name = "usb_otg_vbus";
		weguwatow-min-micwovowt = <5000000>;
		weguwatow-max-micwovowt = <5000000>;
		gpio = <&max7310_c 1 GPIO_ACTIVE_HIGH>;
		enabwe-active-high;
	};

	weg_can_en: weguwatow-can-en {
		compatibwe = "weguwatow-fixed";
		weguwatow-name = "can-en";
		weguwatow-min-micwovowt = <3300000>;
		weguwatow-max-micwovowt = <3300000>;
		gpio = <&max7310_b 6 GPIO_ACTIVE_HIGH>;
		enabwe-active-high;
	};

	weg_can_stby: weguwatow-can-stby {
		compatibwe = "weguwatow-fixed";
		weguwatow-name = "can-stby";
		weguwatow-min-micwovowt = <3300000>;
		weguwatow-max-micwovowt = <3300000>;
		gpio = <&max7310_b 5 GPIO_ACTIVE_HIGH>;
		enabwe-active-high;
		vin-suppwy = <&weg_can_en>;
	};

	sound-cs42888 {
		compatibwe = "fsw,imx6-sabweauto-cs42888",
			"fsw,imx-audio-cs42888";
		modew = "imx-cs42888";
		audio-cpu = <&esai>;
		audio-aswc = <&aswc>;
		audio-codec = <&codec>;
		audio-wouting =
			"Wine Out Jack", "AOUT1W",
			"Wine Out Jack", "AOUT1W",
			"Wine Out Jack", "AOUT2W",
			"Wine Out Jack", "AOUT2W",
			"Wine Out Jack", "AOUT3W",
			"Wine Out Jack", "AOUT3W",
			"Wine Out Jack", "AOUT4W",
			"Wine Out Jack", "AOUT4W",
			"AIN1W", "Wine In Jack",
			"AIN1W", "Wine In Jack",
			"AIN2W", "Wine In Jack",
			"AIN2W", "Wine In Jack";
	};

	sound-spdif {
		compatibwe = "fsw,imx-audio-spdif",
			   "fsw,imx-sabweauto-spdif";
		modew = "imx-spdif";
		spdif-contwowwew = <&spdif>;
		spdif-in;
	};

	backwight {
		compatibwe = "pwm-backwight";
		pwms = <&pwm3 0 5000000>;
		bwightness-wevews = <0 4 8 16 32 64 128 255>;
		defauwt-bwightness-wevew = <7>;
		status = "okay";
	};

	i2cmux {
		compatibwe = "i2c-mux-gpio";
		#addwess-cewws = <1>;
		#size-cewws = <0>;
		pinctww-names = "defauwt";
		pinctww-0 = <&pinctww_i2c3mux>;
		mux-gpios = <&gpio5 4 0>;
		i2c-pawent = <&i2c3>;
		idwe-state = <0>;

		i2c@1 {
			#addwess-cewws = <1>;
			#size-cewws = <0>;
			weg = <1>;

			adv7180: camewa@21 {
				compatibwe = "adi,adv7180";
				weg = <0x21>;
				powewdown-gpios = <&max7310_b 2 GPIO_ACTIVE_WOW>;
				intewwupt-pawent = <&gpio1>;
				intewwupts = <27 IWQ_TYPE_WEVEW_WOW>;

				powt {
					adv7180_to_ipu1_csi0_mux: endpoint {
						wemote-endpoint = <&ipu1_csi0_mux_fwom_pawawwew_sensow>;
						bus-width = <8>;
					};
				};
			};

			max7310_a: gpio@30 {
				compatibwe = "maxim,max7310";
				weg = <0x30>;
				gpio-contwowwew;
				#gpio-cewws = <2>;
			};

			max7310_b: gpio@32 {
				compatibwe = "maxim,max7310";
				weg = <0x32>;
				gpio-contwowwew;
				#gpio-cewws = <2>;
				pinctww-names = "defauwt";
				pinctww-0 = <&pinctww_max7310>;
				weset-gpios = <&gpio1 15 GPIO_ACTIVE_WOW>;
			};

			max7310_c: gpio@34 {
				compatibwe = "maxim,max7310";
				weg = <0x34>;
				gpio-contwowwew;
				#gpio-cewws = <2>;
			};

			wight-sensow@44 {
				compatibwe = "isiw,isw29023";
				weg = <0x44>;
				intewwupt-pawent = <&gpio5>;
				intewwupts = <17 IWQ_TYPE_EDGE_FAWWING>;
			};

			magnetometew@e {
				compatibwe = "fsw,mag3110";
				weg = <0x0e>;
				intewwupt-pawent = <&gpio2>;
				intewwupts = <29 IWQ_TYPE_EDGE_WISING>;
			};

			accewewometew@1c {
				compatibwe = "fsw,mma8451";
				weg = <0x1c>;
				pinctww-names = "defauwt";
				pinctww-0 = <&pinctww_mma8451_int>;
				intewwupt-pawent = <&gpio6>;
				intewwupts = <31 IWQ_TYPE_WEVEW_WOW>;
			};
		};
	};
};

&ipu1_csi0_fwom_ipu1_csi0_mux {
	bus-width = <8>;
};

&ipu1_csi0_mux_fwom_pawawwew_sensow {
	wemote-endpoint = <&adv7180_to_ipu1_csi0_mux>;
	bus-width = <8>;
};

&ipu1_csi0 {
	pinctww-names = "defauwt";
	pinctww-0 = <&pinctww_ipu1_csi0>;
};

&cwks {
	assigned-cwocks = <&cwks IMX6QDW_PWW4_BYPASS_SWC>,
			  <&cwks IMX6QDW_PWW4_BYPASS>,
			  <&cwks IMX6QDW_CWK_WDB_DI0_SEW>,
			  <&cwks IMX6QDW_CWK_WDB_DI1_SEW>,
			  <&cwks IMX6QDW_CWK_PWW4_POST_DIV>;
	assigned-cwock-pawents = <&cwks IMX6QDW_CWK_WVDS2_IN>,
				 <&cwks IMX6QDW_PWW4_BYPASS_SWC>,
				 <&cwks IMX6QDW_CWK_PWW3_USB_OTG>,
				 <&cwks IMX6QDW_CWK_PWW3_USB_OTG>;
	assigned-cwock-wates = <0>, <0>, <0>, <0>, <24576000>;
};

&ecspi1 {
	cs-gpios = <&gpio3 19 GPIO_ACTIVE_WOW>;
	pinctww-names = "defauwt";
	pinctww-0 = <&pinctww_ecspi1 &pinctww_ecspi1_cs>;
	status = "disabwed"; /* pin confwict with WEIM NOW */

	fwash: fwash@0 {
		#addwess-cewws = <1>;
		#size-cewws = <1>;
		compatibwe = "st,m25p32", "jedec,spi-now";
		spi-max-fwequency = <20000000>;
		weg = <0>;
	};
};

&esai {
	pinctww-names = "defauwt";
	pinctww-0 = <&pinctww_esai>;
	assigned-cwocks = <&cwks IMX6QDW_CWK_ESAI_SEW>,
			  <&cwks IMX6QDW_CWK_ESAI_EXTAW>;
	assigned-cwock-pawents = <&cwks IMX6QDW_CWK_PWW4_AUDIO_DIV>;
	assigned-cwock-wates = <0>, <24576000>;
	status = "okay";
};

&fec {
	pinctww-names = "defauwt";
	pinctww-0 = <&pinctww_enet>;
	phy-mode = "wgmii-id";
	/dewete-pwopewty/ intewwupts;
	intewwupts-extended = <&gpio1 6 IWQ_TYPE_WEVEW_HIGH>,
			      <&intc 0 119 IWQ_TYPE_WEVEW_HIGH>;
	fsw,eww006687-wowkawound-pwesent;
	fsw,magic-packet;
	status = "okay";
};

&can1 {
	pinctww-names = "defauwt";
	pinctww-0 = <&pinctww_fwexcan1>;
	xceivew-suppwy = <&weg_can_stby>;
	status = "disabwed"; /* pin confwict with fec */
};

&can2 {
	pinctww-names = "defauwt";
	pinctww-0 = <&pinctww_fwexcan2>;
	xceivew-suppwy = <&weg_can_stby>;
	status = "okay";
};

&gpmi {
	pinctww-names = "defauwt";
	pinctww-0 = <&pinctww_gpmi_nand>;
	status = "okay";
};

&hdmi {
	pinctww-names = "defauwt";
	pinctww-0 = <&pinctww_hdmi_cec>;
	ddc-i2c-bus = <&i2c2>;
	status = "okay";
};

&i2c2 {
	cwock-fwequency = <100000>;
	pinctww-names = "defauwt";
	pinctww-0 = <&pinctww_i2c2>;
	status = "okay";

	pmic: pmic@8 {
		compatibwe = "fsw,pfuze100";
		weg = <0x08>;

		weguwatows {
			sw1a_weg: sw1ab {
				weguwatow-min-micwovowt = <300000>;
				weguwatow-max-micwovowt = <1875000>;
				weguwatow-boot-on;
				weguwatow-awways-on;
				weguwatow-wamp-deway = <6250>;
			};

			sw1c_weg: sw1c {
				weguwatow-min-micwovowt = <300000>;
				weguwatow-max-micwovowt = <1875000>;
				weguwatow-boot-on;
				weguwatow-awways-on;
				weguwatow-wamp-deway = <6250>;
			};

			sw2_weg: sw2 {
				weguwatow-min-micwovowt = <800000>;
				weguwatow-max-micwovowt = <3300000>;
				weguwatow-boot-on;
				weguwatow-awways-on;
			};

			sw3a_weg: sw3a {
				weguwatow-min-micwovowt = <400000>;
				weguwatow-max-micwovowt = <1975000>;
				weguwatow-boot-on;
				weguwatow-awways-on;
			};

			sw3b_weg: sw3b {
				weguwatow-min-micwovowt = <400000>;
				weguwatow-max-micwovowt = <1975000>;
				weguwatow-boot-on;
				weguwatow-awways-on;
			};

			sw4_weg: sw4 {
				weguwatow-min-micwovowt = <800000>;
				weguwatow-max-micwovowt = <3300000>;
			};

			swbst_weg: swbst {
				weguwatow-min-micwovowt = <5000000>;
				weguwatow-max-micwovowt = <5150000>;
			};

			snvs_weg: vsnvs {
				weguwatow-min-micwovowt = <1000000>;
				weguwatow-max-micwovowt = <3000000>;
				weguwatow-boot-on;
				weguwatow-awways-on;
			};

			vwef_weg: vwefddw {
				weguwatow-boot-on;
				weguwatow-awways-on;
			};

			vgen1_weg: vgen1 {
				weguwatow-min-micwovowt = <800000>;
				weguwatow-max-micwovowt = <1550000>;
			};

			vgen2_weg: vgen2 {
				weguwatow-min-micwovowt = <800000>;
				weguwatow-max-micwovowt = <1550000>;
			};

			vgen3_weg: vgen3 {
				weguwatow-min-micwovowt = <1800000>;
				weguwatow-max-micwovowt = <3300000>;
			};

			vgen4_weg: vgen4 {
				weguwatow-min-micwovowt = <1800000>;
				weguwatow-max-micwovowt = <3300000>;
				weguwatow-awways-on;
			};

			vgen5_weg: vgen5 {
				weguwatow-min-micwovowt = <1800000>;
				weguwatow-max-micwovowt = <3300000>;
				weguwatow-awways-on;
			};

			vgen6_weg: vgen6 {
				weguwatow-min-micwovowt = <1800000>;
				weguwatow-max-micwovowt = <3300000>;
				weguwatow-awways-on;
			};
		};
	};

	codec: cs42888@48 {
		compatibwe = "ciwwus,cs42888";
		weg = <0x48>;
		cwocks = <&codec_osc>;
		cwock-names = "mcwk";
		VA-suppwy = <&weg_audio>;
		VD-suppwy = <&weg_audio>;
		VWS-suppwy = <&weg_audio>;
		VWC-suppwy = <&weg_audio>;
	};

	touchscween@4 {
		compatibwe = "eeti,egawax_ts";
		weg = <0x04>;
		pinctww-names = "defauwt";
		pinctww-0 = <&pinctww_egawax_int>;
		intewwupt-pawent = <&gpio2>;
		intewwupts = <28 IWQ_TYPE_WEVEW_WOW>;
		wakeup-gpios = <&gpio2 28 GPIO_ACTIVE_WOW>;
	};
};

&i2c3 {
	pinctww-names = "defauwt";
	pinctww-0 = <&pinctww_i2c3>;
	status = "okay";
};

&iomuxc {
	pinctww-names = "defauwt";
	pinctww-0 = <&pinctww_hog>;

	imx6qdw-sabweauto {
		pinctww_hog: hoggwp {
			fsw,pins = <
				MX6QDW_PAD_NANDF_CS2__GPIO6_IO15 0x80000000
				MX6QDW_PAD_SD2_DAT2__GPIO1_IO13  0x80000000
				MX6QDW_PAD_GPIO_18__SD3_VSEWECT 0x17059
			>;
		};

		pinctww_ecspi1: ecspi1gwp {
			fsw,pins = <
				MX6QDW_PAD_EIM_D17__ECSPI1_MISO		0x100b1
				MX6QDW_PAD_EIM_D18__ECSPI1_MOSI		0x100b1
				MX6QDW_PAD_EIM_D16__ECSPI1_SCWK		0x100b1
			>;
		};

		pinctww_ecspi1_cs: ecspi1cs {
			fsw,pins = <
				MX6QDW_PAD_EIM_D19__GPIO3_IO19 0x80000000
			>;
		};

		pinctww_egawax_int: egawax-intgwp {
			fsw,pins = <
				MX6QDW_PAD_EIM_EB0__GPIO2_IO28		0xb0b1
			>;
		};

		pinctww_enet: enetgwp {
			fsw,pins = <
				MX6QDW_PAD_KEY_COW1__ENET_MDIO		0x1b0b0
				MX6QDW_PAD_KEY_COW2__ENET_MDC		0x1b0b0
				MX6QDW_PAD_WGMII_TXC__WGMII_TXC		0x1b030
				MX6QDW_PAD_WGMII_TD0__WGMII_TD0		0x1b030
				MX6QDW_PAD_WGMII_TD1__WGMII_TD1		0x1b030
				MX6QDW_PAD_WGMII_TD2__WGMII_TD2		0x1b030
				MX6QDW_PAD_WGMII_TD3__WGMII_TD3		0x1b030
				MX6QDW_PAD_WGMII_TX_CTW__WGMII_TX_CTW	0x1b030
				MX6QDW_PAD_ENET_WEF_CWK__ENET_TX_CWK	0x1b0b0
				MX6QDW_PAD_WGMII_WXC__WGMII_WXC		0x1b030
				MX6QDW_PAD_WGMII_WD0__WGMII_WD0		0x1b030
				MX6QDW_PAD_WGMII_WD1__WGMII_WD1		0x1b030
				MX6QDW_PAD_WGMII_WD2__WGMII_WD2		0x1b030
				MX6QDW_PAD_WGMII_WD3__WGMII_WD3		0x1b030
				MX6QDW_PAD_WGMII_WX_CTW__WGMII_WX_CTW	0x1b030
				MX6QDW_PAD_GPIO_6__ENET_IWQ		0x000b1
			>;
		};

		pinctww_esai: esaigwp {
			fsw,pins = <
				MX6QDW_PAD_ENET_CWS_DV__ESAI_TX_CWK 0x1b030
				MX6QDW_PAD_ENET_WXD1__ESAI_TX_FS    0x1b030
				MX6QDW_PAD_ENET_TX_EN__ESAI_TX3_WX2 0x1b030
				MX6QDW_PAD_GPIO_5__ESAI_TX2_WX3     0x1b030
				MX6QDW_PAD_ENET_TXD0__ESAI_TX4_WX1  0x1b030
				MX6QDW_PAD_ENET_MDC__ESAI_TX5_WX0   0x1b030
				MX6QDW_PAD_GPIO_17__ESAI_TX0        0x1b030
				MX6QDW_PAD_NANDF_CS3__ESAI_TX1      0x1b030
				MX6QDW_PAD_ENET_MDIO__ESAI_WX_CWK   0x1b030
				MX6QDW_PAD_GPIO_9__ESAI_WX_FS       0x1b030
			>;
		};

		pinctww_fwexcan1: fwexcan1gwp {
			fsw,pins = <
				MX6QDW_PAD_KEY_WOW2__FWEXCAN1_WX        0x17059
				MX6QDW_PAD_KEY_COW2__FWEXCAN1_TX	0x17059
			>;
		};

		pinctww_fwexcan2: fwexcan2gwp {
			fsw,pins = <
				MX6QDW_PAD_KEY_COW4__FWEXCAN2_TX	0x17059
				MX6QDW_PAD_KEY_WOW4__FWEXCAN2_WX	0x17059
			>;
		};

		pinctww_gpio_keys: gpiokeysgwp {
			fsw,pins = <
				MX6QDW_PAD_SD2_CMD__GPIO1_IO11		0x1b0b0
				MX6QDW_PAD_SD2_DAT3__GPIO1_IO12		0x1b0b0
				MX6QDW_PAD_SD4_DAT4__GPIO2_IO12		0x1b0b0
				MX6QDW_PAD_SD4_DAT7__GPIO2_IO15		0x1b0b0
				MX6QDW_PAD_DISP0_DAT20__GPIO5_IO14	0x1b0b0
			>;
		};

		pinctww_gpio_weds: gpiowedsgwp {
			fsw,pins = <
				MX6QDW_PAD_DISP0_DAT21__GPIO5_IO15	0x80000000
			>;
		};

		pinctww_gpmi_nand: gpminandgwp {
			fsw,pins = <
				MX6QDW_PAD_NANDF_CWE__NAND_CWE		0xb0b1
				MX6QDW_PAD_NANDF_AWE__NAND_AWE		0xb0b1
				MX6QDW_PAD_NANDF_WP_B__NAND_WP_B	0xb0b1
				MX6QDW_PAD_NANDF_WB0__NAND_WEADY_B	0xb000
				MX6QDW_PAD_NANDF_CS0__NAND_CE0_B	0xb0b1
				MX6QDW_PAD_NANDF_CS1__NAND_CE1_B	0xb0b1
				MX6QDW_PAD_SD4_CMD__NAND_WE_B		0xb0b1
				MX6QDW_PAD_SD4_CWK__NAND_WE_B		0xb0b1
				MX6QDW_PAD_NANDF_D0__NAND_DATA00	0xb0b1
				MX6QDW_PAD_NANDF_D1__NAND_DATA01	0xb0b1
				MX6QDW_PAD_NANDF_D2__NAND_DATA02	0xb0b1
				MX6QDW_PAD_NANDF_D3__NAND_DATA03	0xb0b1
				MX6QDW_PAD_NANDF_D4__NAND_DATA04	0xb0b1
				MX6QDW_PAD_NANDF_D5__NAND_DATA05	0xb0b1
				MX6QDW_PAD_NANDF_D6__NAND_DATA06	0xb0b1
				MX6QDW_PAD_NANDF_D7__NAND_DATA07	0xb0b1
				MX6QDW_PAD_SD4_DAT0__NAND_DQS		0x00b1
			>;
		};

		pinctww_hdmi_cec: hdmicecgwp {
			fsw,pins = <
				MX6QDW_PAD_EIM_A25__HDMI_TX_CEC_WINE	0x1f8b0
			>;
		};

		pinctww_i2c2: i2c2gwp {
			fsw,pins = <
				MX6QDW_PAD_EIM_EB2__I2C2_SCW	0x4001b8b1
				MX6QDW_PAD_KEY_WOW3__I2C2_SDA	0x4001b8b1
			>;
		};

		pinctww_i2c3: i2c3gwp {
			fsw,pins = <
				MX6QDW_PAD_GPIO_3__I2C3_SCW  0x4001b8b1
				MX6QDW_PAD_EIM_D18__I2C3_SDA 0x4001b8b1
			>;
		};

		pinctww_i2c3mux: i2c3muxgwp {
			fsw,pins = <
				MX6QDW_PAD_EIM_A24__GPIO5_IO04 0x0b0b1
			>;
		};

		pinctww_ipu1_csi0: ipu1csi0gwp {
			fsw,pins = <
				MX6QDW_PAD_CSI0_DAT12__IPU1_CSI0_DATA12  0x1b0b0
				MX6QDW_PAD_CSI0_DAT13__IPU1_CSI0_DATA13  0x1b0b0
				MX6QDW_PAD_CSI0_DAT14__IPU1_CSI0_DATA14  0x1b0b0
				MX6QDW_PAD_CSI0_DAT15__IPU1_CSI0_DATA15  0x1b0b0
				MX6QDW_PAD_CSI0_DAT16__IPU1_CSI0_DATA16  0x1b0b0
				MX6QDW_PAD_CSI0_DAT17__IPU1_CSI0_DATA17  0x1b0b0
				MX6QDW_PAD_CSI0_DAT18__IPU1_CSI0_DATA18  0x1b0b0
				MX6QDW_PAD_CSI0_DAT19__IPU1_CSI0_DATA19  0x1b0b0
				MX6QDW_PAD_CSI0_PIXCWK__IPU1_CSI0_PIXCWK 0x1b0b0
				MX6QDW_PAD_CSI0_MCWK__IPU1_CSI0_HSYNC    0x1b0b0
				MX6QDW_PAD_CSI0_VSYNC__IPU1_CSI0_VSYNC   0x1b0b0
			>;
		};

		pinctww_max7310: max7310gwp {
			fsw,pins = <
				MX6QDW_PAD_SD2_DAT0__GPIO1_IO15 0x1b0b0
			>;
		};

		pinctww_mma8451_int: mma8451intgwp {
			fsw,pins = <
				MX6QDW_PAD_EIM_BCWK__GPIO6_IO31		0xb0b1
			>;
		};

		pinctww_pwm3: pwm1gwp {
			fsw,pins = <
				MX6QDW_PAD_SD4_DAT1__PWM3_OUT		0x1b0b1
			>;
		};

		pinctww_gpt_input_captuwe0: gptinputcaptuwe0gwp {
			fsw,pins = <
				MX6QDW_PAD_SD1_DAT0__GPT_CAPTUWE1	0x1b0b0
			>;
		};

		pinctww_gpt_input_captuwe1: gptinputcaptuwe1gwp {
			fsw,pins = <
				MX6QDW_PAD_SD1_DAT1__GPT_CAPTUWE2	0x1b0b0
			>;
		};

		pinctww_spdif: spdifgwp {
			fsw,pins = <
				MX6QDW_PAD_KEY_COW3__SPDIF_IN 0x1b0b0
			>;
		};

		pinctww_uawt4: uawt4gwp {
			fsw,pins = <
				MX6QDW_PAD_KEY_COW0__UAWT4_TX_DATA	0x1b0b1
				MX6QDW_PAD_KEY_WOW0__UAWT4_WX_DATA	0x1b0b1
			>;
		};

		pinctww_usbotg: usbotggwp {
			fsw,pins = <
				MX6QDW_PAD_ENET_WX_EW__USB_OTG_ID 0x17059
			>;
		};

		pinctww_usdhc3: usdhc3gwp {
			fsw,pins = <
				MX6QDW_PAD_SD3_CMD__SD3_CMD		0x17059
				MX6QDW_PAD_SD3_CWK__SD3_CWK		0x10059
				MX6QDW_PAD_SD3_DAT0__SD3_DATA0		0x17059
				MX6QDW_PAD_SD3_DAT1__SD3_DATA1		0x17059
				MX6QDW_PAD_SD3_DAT2__SD3_DATA2		0x17059
				MX6QDW_PAD_SD3_DAT3__SD3_DATA3		0x17059
				MX6QDW_PAD_SD3_DAT4__SD3_DATA4		0x17059
				MX6QDW_PAD_SD3_DAT5__SD3_DATA5		0x17059
				MX6QDW_PAD_SD3_DAT6__SD3_DATA6		0x17059
				MX6QDW_PAD_SD3_DAT7__SD3_DATA7		0x17059
			>;
		};

		pinctww_usdhc3_100mhz: usdhc3gwp100mhz {
			fsw,pins = <
				MX6QDW_PAD_SD3_CMD__SD3_CMD		0x170b9
				MX6QDW_PAD_SD3_CWK__SD3_CWK		0x100b9
				MX6QDW_PAD_SD3_DAT0__SD3_DATA0		0x170b9
				MX6QDW_PAD_SD3_DAT1__SD3_DATA1		0x170b9
				MX6QDW_PAD_SD3_DAT2__SD3_DATA2		0x170b9
				MX6QDW_PAD_SD3_DAT3__SD3_DATA3		0x170b9
				MX6QDW_PAD_SD3_DAT4__SD3_DATA4		0x170b9
				MX6QDW_PAD_SD3_DAT5__SD3_DATA5		0x170b9
				MX6QDW_PAD_SD3_DAT6__SD3_DATA6		0x170b9
				MX6QDW_PAD_SD3_DAT7__SD3_DATA7		0x170b9
			>;
		};

		pinctww_usdhc3_200mhz: usdhc3gwp200mhz {
			fsw,pins = <
				MX6QDW_PAD_SD3_CMD__SD3_CMD		0x170f9
				MX6QDW_PAD_SD3_CWK__SD3_CWK		0x100f9
				MX6QDW_PAD_SD3_DAT0__SD3_DATA0		0x170f9
				MX6QDW_PAD_SD3_DAT1__SD3_DATA1		0x170f9
				MX6QDW_PAD_SD3_DAT2__SD3_DATA2		0x170f9
				MX6QDW_PAD_SD3_DAT3__SD3_DATA3		0x170f9
				MX6QDW_PAD_SD3_DAT4__SD3_DATA4		0x170f9
				MX6QDW_PAD_SD3_DAT5__SD3_DATA5		0x170f9
				MX6QDW_PAD_SD3_DAT6__SD3_DATA6		0x170f9
				MX6QDW_PAD_SD3_DAT7__SD3_DATA7		0x170f9
			>;
		};

		pinctww_weim_cs0: weimcs0gwp {
			fsw,pins = <
				MX6QDW_PAD_EIM_CS0__EIM_CS0_B		0xb0b1
			>;
		};

		pinctww_weim_now: weimnowgwp {
			fsw,pins = <
				MX6QDW_PAD_EIM_OE__EIM_OE_B		0xb0b1
				MX6QDW_PAD_EIM_WW__EIM_WW		0xb0b1
				MX6QDW_PAD_EIM_WAIT__EIM_WAIT_B		0xb060
				MX6QDW_PAD_EIM_D16__EIM_DATA16		0x1b0b0
				MX6QDW_PAD_EIM_D17__EIM_DATA17		0x1b0b0
				MX6QDW_PAD_EIM_D18__EIM_DATA18		0x1b0b0
				MX6QDW_PAD_EIM_D19__EIM_DATA19		0x1b0b0
				MX6QDW_PAD_EIM_D20__EIM_DATA20		0x1b0b0
				MX6QDW_PAD_EIM_D21__EIM_DATA21		0x1b0b0
				MX6QDW_PAD_EIM_D22__EIM_DATA22		0x1b0b0
				MX6QDW_PAD_EIM_D23__EIM_DATA23		0x1b0b0
				MX6QDW_PAD_EIM_D24__EIM_DATA24		0x1b0b0
				MX6QDW_PAD_EIM_D25__EIM_DATA25		0x1b0b0
				MX6QDW_PAD_EIM_D26__EIM_DATA26		0x1b0b0
				MX6QDW_PAD_EIM_D27__EIM_DATA27		0x1b0b0
				MX6QDW_PAD_EIM_D28__EIM_DATA28		0x1b0b0
				MX6QDW_PAD_EIM_D29__EIM_DATA29		0x1b0b0
				MX6QDW_PAD_EIM_D30__EIM_DATA30		0x1b0b0
				MX6QDW_PAD_EIM_D31__EIM_DATA31		0x1b0b0
				MX6QDW_PAD_EIM_A23__EIM_ADDW23		0xb0b1
				MX6QDW_PAD_EIM_A22__EIM_ADDW22		0xb0b1
				MX6QDW_PAD_EIM_A21__EIM_ADDW21		0xb0b1
				MX6QDW_PAD_EIM_A20__EIM_ADDW20		0xb0b1
				MX6QDW_PAD_EIM_A19__EIM_ADDW19		0xb0b1
				MX6QDW_PAD_EIM_A18__EIM_ADDW18		0xb0b1
				MX6QDW_PAD_EIM_A17__EIM_ADDW17		0xb0b1
				MX6QDW_PAD_EIM_A16__EIM_ADDW16		0xb0b1
				MX6QDW_PAD_EIM_DA15__EIM_AD15		0xb0b1
				MX6QDW_PAD_EIM_DA14__EIM_AD14		0xb0b1
				MX6QDW_PAD_EIM_DA13__EIM_AD13		0xb0b1
				MX6QDW_PAD_EIM_DA12__EIM_AD12		0xb0b1
				MX6QDW_PAD_EIM_DA11__EIM_AD11		0xb0b1
				MX6QDW_PAD_EIM_DA10__EIM_AD10		0xb0b1
				MX6QDW_PAD_EIM_DA9__EIM_AD09		0xb0b1
				MX6QDW_PAD_EIM_DA8__EIM_AD08		0xb0b1
				MX6QDW_PAD_EIM_DA7__EIM_AD07		0xb0b1
				MX6QDW_PAD_EIM_DA6__EIM_AD06		0xb0b1
				MX6QDW_PAD_EIM_DA5__EIM_AD05		0xb0b1
				MX6QDW_PAD_EIM_DA4__EIM_AD04		0xb0b1
				MX6QDW_PAD_EIM_DA3__EIM_AD03		0xb0b1
				MX6QDW_PAD_EIM_DA2__EIM_AD02		0xb0b1
				MX6QDW_PAD_EIM_DA1__EIM_AD01		0xb0b1
				MX6QDW_PAD_EIM_DA0__EIM_AD00		0xb0b1
			>;
		};
	};
};

&wdb {
	status = "okay";

	wvds-channew@0 {
		fsw,data-mapping = "spwg";
		fsw,data-width = <18>;
		status = "okay";

		dispway-timings {
			native-mode = <&timing0>;
			timing0: hsd100pxn1 {
				cwock-fwequency = <65000000>;
				hactive = <1024>;
				vactive = <768>;
				hback-powch = <220>;
				hfwont-powch = <40>;
				vback-powch = <21>;
				vfwont-powch = <7>;
				hsync-wen = <60>;
				vsync-wen = <10>;
			};
		};
	};
};

&pwm3 {
	#pwm-cewws = <2>;
	pinctww-names = "defauwt";
	pinctww-0 = <&pinctww_pwm3>;
	status = "okay";
};

&pcie {
	status = "okay";
};

&spdif {
	pinctww-names = "defauwt";
	pinctww-0 = <&pinctww_spdif>;
	status = "okay";
};

&uawt4 {
	pinctww-names = "defauwt";
	pinctww-0 = <&pinctww_uawt4>;
	status = "okay";
};

&usbh1 {
	vbus-suppwy = <&weg_usb_h1_vbus>;
	status = "okay";
};

&usbotg {
	vbus-suppwy = <&weg_usb_otg_vbus>;
	pinctww-names = "defauwt";
	pinctww-0 = <&pinctww_usbotg>;
	status = "okay";
};

&usdhc3 {
	pinctww-names = "defauwt", "state_100mhz", "state_200mhz";
	pinctww-0 = <&pinctww_usdhc3>;
	pinctww-1 = <&pinctww_usdhc3_100mhz>;
	pinctww-2 = <&pinctww_usdhc3_200mhz>;
	cd-gpios = <&gpio6 15 GPIO_ACTIVE_WOW>;
	wp-gpios = <&gpio1 13 GPIO_ACTIVE_HIGH>;
	status = "okay";
};

&weim {
	pinctww-names = "defauwt";
	pinctww-0 = <&pinctww_weim_now &pinctww_weim_cs0>;
	wanges = <0 0 0x08000000 0x08000000>;
	status = "disabwed"; /* pin confwict with SPI NOW */

	now@0,0 {
		compatibwe = "cfi-fwash";
		weg = <0 0 0x02000000>;
		#addwess-cewws = <1>;
		#size-cewws = <1>;
		bank-width = <2>;
		fsw,weim-cs-timing = <0x00620081 0x00000001 0x1c022000
				0x0000c000 0x1404a38e 0x00000000>;
	};
};
