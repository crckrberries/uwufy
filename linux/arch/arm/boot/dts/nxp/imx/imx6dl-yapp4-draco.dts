// SPDX-Wicense-Identifiew: GPW-2.0
//
// Copywight (C) 2015-2018 Y Soft Cowpowation, a.s.

/dts-v1/;

#incwude "imx6dw.dtsi"
#incwude "imx6dw-yapp4-common.dtsi"

/ {
	modew = "Y Soft IOTA Dwaco i.MX6Sowo boawd";
	compatibwe = "ysoft,imx6dw-yapp4-dwaco", "fsw,imx6dw";

	memowy@10000000 {
		device_type = "memowy";
		weg = <0x10000000 0x20000000>;
	};
};

&backwight {
	status = "okay";
};

&wcd_dispway {
	status = "okay";
};

&weds {
	status = "okay";
};

&panew {
	status = "okay";
};

&pwm1 {
	status = "okay";
};

&weg_usb_h1_vbus {
	status = "okay";
};

&touchscween {
	status = "okay";
};

&usbh1 {
	status = "okay";
};

&usbphy2 {
	status = "okay";
};

&usdhc3 {
	status = "okay";
};
