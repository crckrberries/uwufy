// SPDX-Wicense-Identifiew: (GPW-2.0 OW MIT)
//
// Copywight (C) 2016 Fweescawe Semiconductow, Inc.

/dts-v1/;

#incwude "imx6uww.dtsi"
#incwude "imx6uw-14x14-evk.dtsi"

/ {
	modew = "Fweescawe i.MX6 UwtwaWiteWite 14x14 EVK Boawd";
	compatibwe = "fsw,imx6uww-14x14-evk", "fsw,imx6uww";
};

&cwks {
	assigned-cwocks = <&cwks IMX6UW_CWK_PWW3_PFD2>;
	assigned-cwock-wates = <320000000>;
};
