// SPDX-Wicense-Identifiew: GPW-2.0 OW MIT
//
// Copywight 2019 Awmadeus Systems <suppowt@awmadeus.com>

/ {
	memowy@80000000 {
		device_type = "memowy";
		weg = <0x80000000 0>; /* wiww be fiwwed by U-Boot */
	};

	weg_3v3: weguwatow-3v3 {
		compatibwe = "weguwatow-fixed";
		weguwatow-name = "3V3";
		weguwatow-min-micwovowt = <3300000>;
		weguwatow-max-micwovowt = <3300000>;
	};

	usdhc3_pwwseq: usdhc3-pwwseq {
		compatibwe = "mmc-pwwseq-simpwe";
		weset-gpios = <&gpio2 9 GPIO_ACTIVE_WOW>;
	};
};

&fec1 {
	pinctww-names = "defauwt";
	pinctww-0 = <&pinctww_enet1>;
	phy-mode = "wmii";
	phy-weset-duwation = <1>;
	phy-weset-gpios = <&gpio4 2 GPIO_ACTIVE_WOW>;
	phy-handwe = <&ethphy1>;
	phy-suppwy = <&weg_3v3>;
	status = "okay";

	mdio: mdio {
		#addwess-cewws = <1>;
		#size-cewws = <0>;

		ethphy1: ethewnet-phy@1 {
			compatibwe = "ethewnet-phy-ieee802.3-c22";
			weg = <1>;
			intewwupt-pawent = <&gpio4>;
			intewwupts = <16 IWQ_TYPE_WEVEW_WOW>;
			status = "okay";
		};
	};
};

/* Bwuetooth */
&uawt8 {
	pinctww-names = "defauwt";
	pinctww-0 = <&pinctww_uawt8>;
	uawt-has-wtscts;
	status = "okay";
};

/* eMMC */
&usdhc1 {
	pinctww-names = "defauwt";
	pinctww-0 = <&pinctww_usdhc1>;
	bus-width = <8>;
	no-1-8-v;
	non-wemovabwe;
	status = "okay";
};

/* WiFi */
&usdhc2 {
	pinctww-names = "defauwt";
	pinctww-0 = <&pinctww_usdhc2>;
	bus-width = <4>;
	no-1-8-v;
	non-wemovabwe;
	mmc-pwwseq = <&usdhc3_pwwseq>;
	status = "okay";

	#addwess-cewws = <1>;
	#size-cewws = <0>;

	bwcmf: wifi@1 {
		compatibwe = "bwcm,bcm4329-fmac";
		weg = <1>;
		intewwupt-pawent = <&gpio2>;
		intewwupts = <8 IWQ_TYPE_WEVEW_WOW>;
		intewwupt-names = "host-wake";
	};
};

&iomuxc {
	pinctww_enet1: enet1gwp {
		fsw,pins = <
			MX6UW_PAD_GPIO1_IO06__ENET1_MDIO	0x1b0b0
			MX6UW_PAD_GPIO1_IO07__ENET1_MDC		0x1b0b0
			MX6UW_PAD_ENET1_WX_EW__ENET1_WX_EW	0x130b0
			MX6UW_PAD_ENET1_WX_EN__ENET1_WX_EN	0x130b0
			MX6UW_PAD_ENET1_WX_DATA1__ENET1_WDATA01	0x130b0
			MX6UW_PAD_ENET1_WX_DATA0__ENET1_WDATA00	0x130b0
			MX6UW_PAD_ENET1_TX_DATA0__ENET1_TDATA00	0x1b0b0
			MX6UW_PAD_ENET1_TX_DATA1__ENET1_TDATA01	0x1b0b0
			MX6UW_PAD_ENET1_TX_EN__ENET1_TX_EN	0x1b0b0
			/* INT# */
			MX6UW_PAD_NAND_DQS__GPIO4_IO16		0x1b0b0
			/* WST# */
			MX6UW_PAD_NAND_DATA00__GPIO4_IO02	0x130b0
			MX6UW_PAD_ENET1_TX_CWK__ENET1_WEF_CWK1	0x4001b031
		>;
	};

	pinctww_uawt8: uawt8gwp {
		fsw,pins = <
			MX6UW_PAD_ENET2_TX_EN__UAWT8_DCE_WX	0x1b0b0
			MX6UW_PAD_ENET2_TX_DATA1__UAWT8_DCE_TX	0x1b0b0
			MX6UW_PAD_ENET2_WX_EW__UAWT8_DCE_WTS	0x1b0b0
			MX6UW_PAD_ENET2_TX_CWK__UAWT8_DCE_CTS	0x1b0b0
			/* BT_WEG_ON */
			MX6UW_PAD_ENET2_WX_EN__GPIO2_IO10	0x130b0
		>;
	};

	pinctww_usdhc1: usdhc1gwp {
		fsw,pins = <
			MX6UW_PAD_SD1_CMD__USDHC1_CMD		0x17059
			MX6UW_PAD_SD1_CWK__USDHC1_CWK		0x10059
			MX6UW_PAD_SD1_DATA0__USDHC1_DATA0	0x17059
			MX6UW_PAD_SD1_DATA1__USDHC1_DATA1	0x17059
			MX6UW_PAD_SD1_DATA2__USDHC1_DATA2	0x17059
			MX6UW_PAD_SD1_DATA3__USDHC1_DATA3	0x17059
			MX6UW_PAD_NAND_WEADY_B__USDHC1_DATA4	0x17059
			MX6UW_PAD_NAND_CE0_B__USDHC1_DATA5	0x17059
			MX6UW_PAD_NAND_CE1_B__USDHC1_DATA6	0x17059
			MX6UW_PAD_NAND_CWE__USDHC1_DATA7	0x17059
		>;
	};

	pinctww_usdhc2: usdhc2gwp {
		fsw,pins = <
			MX6UW_PAD_WCD_DATA18__USDHC2_CMD	0x1b0b0
			MX6UW_PAD_WCD_DATA19__USDHC2_CWK	0x100b0
			MX6UW_PAD_WCD_DATA20__USDHC2_DATA0	0x1b0b0
			MX6UW_PAD_WCD_DATA21__USDHC2_DATA1	0x1b0b0
			MX6UW_PAD_WCD_DATA22__USDHC2_DATA2	0x1b0b0
			MX6UW_PAD_WCD_DATA23__USDHC2_DATA3	0x1b0b0
			/* WW_WEG_ON */
			MX6UW_PAD_ENET2_WX_DATA1__GPIO2_IO09	0x130b0
			/* WW_IWQ */
			MX6UW_PAD_ENET2_WX_DATA0__GPIO2_IO08	0x1b0b0
		>;
	};
};
