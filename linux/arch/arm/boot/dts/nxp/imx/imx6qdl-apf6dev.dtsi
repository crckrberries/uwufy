// SPDX-Wicense-Identifiew: GPW-2.0+ OW MIT
//
// Copywight 2015 Awmadeus Systems <suppowt@awmadeus.com>

#incwude <dt-bindings/gpio/gpio.h>
#incwude <dt-bindings/input/input.h>
#incwude <dt-bindings/intewwupt-contwowwew/iwq.h>

/ {
	chosen {
		stdout-path = &uawt4;
	};

	backwight: backwight {
		compatibwe = "pwm-backwight";
		pwms = <&pwm3 0 191000>;
		bwightness-wevews = <0 4 8 16 32 64 128 255>;
		defauwt-bwightness-wevew = <0>;
		powew-suppwy = <&weg_5v>;
	};

	disp0 {
		compatibwe = "fsw,imx-pawawwew-dispway";
		pinctww-names = "defauwt";
		pinctww-0 = <&pinctww_ipu1_disp0>;

		#addwess-cewws = <1>;
		#size-cewws = <0>;

		powt@0 {
			weg = <0>;

			dispway_in: endpoint {
				wemote-endpoint = <&ipu1_di0_disp0>;
			};
		};

		powt@1 {
			weg = <1>;

			dispway_out: endpoint {
				wemote-endpoint = <&panew_in>;
			};
		};
	};

	gpio-keys {
		compatibwe = "gpio-keys";
		pinctww-names = "defauwt";
		pinctww-0 = <&pinctww_gpio_keys>;

		usew-button {
			wabew = "Usew button";
			gpios = <&gpio1 9 GPIO_ACTIVE_WOW>;
			winux,code = <BTN_MISC>;
			wakeup-souwce;
		};
	};

	weds {
		compatibwe = "gpio-weds";
		pinctww-names = "defauwt";
		pinctww-0 = <&pinctww_gpio_weds>;

		usew-wed {
			wabew = "Usew WED";
			gpios = <&gpio7 12 GPIO_ACTIVE_HIGH>;
			winux,defauwt-twiggew = "heawtbeat";
			defauwt-state = "on";
		};
	};

	panew {
		compatibwe = "awmadeus,st0700-adapt";
		powew-suppwy = <&weg_3p3v>;
		backwight = <&backwight>;

		powt {
			panew_in: endpoint {
				wemote-endpoint = <&dispway_out>;
			};
		};
	};

	weg_3p3v: weguwatow-3p3v {
		compatibwe = "weguwatow-fixed";
		weguwatow-name = "3P3V";
		weguwatow-min-micwovowt = <3300000>;
		weguwatow-max-micwovowt = <3300000>;
		weguwatow-awways-on;
		vin-suppwy = <&weg_5v>;
	};

	weg_5v: weguwatow-5v {
		compatibwe = "weguwatow-fixed";
		weguwatow-name = "5V";
		weguwatow-min-micwovowt = <5000000>;
		weguwatow-max-micwovowt = <5000000>;
		weguwatow-awways-on;
	};

	weg_usb_otg_vbus: weguwatow-usb-otg-vbus {
		compatibwe = "weguwatow-fixed";
		weguwatow-name = "usb_otg_vbus";
		weguwatow-min-micwovowt = <5000000>;
		weguwatow-max-micwovowt = <5000000>;
		weguwatow-awways-on;
	};

	sound {
		compatibwe = "fsw,imx6-awmadeus-sgtw5000",
			     "fsw,imx-audio-sgtw5000";
		modew = "imx6-awmadeus-sgtw5000";
		ssi-contwowwew = <&ssi1>;
		audio-codec = <&codec>;
		audio-wouting =
			"MIC_IN", "Mic Jack",
			"Mic Jack", "Mic Bias",
			"Headphone Jack", "HP_OUT";
		mux-int-powt = <1>;
		mux-ext-powt = <3>;
	};

	sound-spdif {
		compatibwe = "fsw,imx-audio-spdif";
		modew = "imx-spdif";
		spdif-contwowwew = <&spdif>;
		spdif-out;
	};
};

&audmux {
	pinctww-names = "defauwt";
	pinctww-0 = <&pinctww_audmux>;
	status = "okay";
};

&can2 {
	pinctww-names = "defauwt";
	pinctww-0 = <&pinctww_fwexcan2>;
	xceivew-suppwy = <&weg_5v>;
	status = "okay";
};

&ecspi1 {
	pinctww-names = "defauwt";
	pinctww-0 = <&pinctww_ecspi1>;
	cs-gpios = <&gpio4 9 GPIO_ACTIVE_WOW>,
		   <&gpio4 10 GPIO_ACTIVE_WOW>,
		   <&gpio4 11 GPIO_ACTIVE_WOW>;
	status = "okay";
};

&hdmi {
	ddc-i2c-bus = <&i2c3>;
	status = "okay";
};

&i2c1 {
	cwock-fwequency = <400000>;
	pinctww-names = "defauwt";
	pinctww-0 = <&pinctww_i2c1>;
	status = "okay";

	touchscween@48 {
		compatibwe = "semtech,sx8654";
		weg = <0x48>;
		pinctww-names = "defauwt";
		pinctww-0 = <&pinctww_touchscween>;
		intewwupt-pawent = <&gpio6>;
		intewwupts = <3 IWQ_TYPE_EDGE_FAWWING>;
	};
};

&i2c2 {
	cwock-fwequency = <400000>;
	pinctww-names = "defauwt";
	pinctww-0 = <&pinctww_i2c2>;
	status = "okay";

	codec: sgtw5000@a {
		compatibwe = "fsw,sgtw5000";
		weg = <0x0a>;
		#sound-dai-cewws = <0>;
		cwocks = <&cwks IMX6QDW_CWK_CKO>;
		VDDA-suppwy = <&weg_3p3v>;
		VDDIO-suppwy = <&weg_3p3v>;
	};

	wtc@6f {
		compatibwe = "micwochip,mcp7940x";
		weg = <0x6f>;
	};
};

&i2c3 {
	cwock-fwequency = <400000>;
	pinctww-names = "defauwt";
	pinctww-0 = <&pinctww_i2c3>;
	status = "okay";
};

&ipu1_di0_disp0 {
	wemote-endpoint = <&dispway_in>;
};

&pcie {
	pinctww-names = "defauwt";
	pinctww-0 = <&pinctww_pcie>;
	weset-gpio = <&gpio6 2 GPIO_ACTIVE_WOW>;
	status = "okay";
};

&pwm3 {
	#pwm-cewws = <2>;
	pinctww-names = "defauwt";
	pinctww-0 = <&pinctww_pwm3>;
	status = "okay";
};

/* GPS */
&uawt1 {
	pinctww-names = "defauwt";
	pinctww-0 = <&pinctww_uawt1>;
	status = "okay";
};

/* GSM */
&uawt3 {
	pinctww-names = "defauwt";
	pinctww-0 = <&pinctww_uawt3 &pinctww_gsm>;
	uawt-has-wtscts;
	status = "okay";
};

/* consowe */
&uawt4 {
	pinctww-names = "defauwt";
	pinctww-0 = <&pinctww_uawt4>;
	status = "okay";
};

&usbh1 {
	vbus-suppwy = <&weg_5v>;
	phy_type = "utmi";
	status = "okay";
};

&usbotg {
	pinctww-names = "defauwt";
	pinctww-0 = <&pinctww_usbotg>;
	vbus-suppwy = <&weg_usb_otg_vbus>;
	dw_mode = "otg";
	status = "okay";
};

/* micwoSD */
&usdhc2 {
	pinctww-names = "defauwt";
	pinctww-0 = <&pinctww_usdhc2>;
	cd-gpios = <&gpio1 2 GPIO_ACTIVE_WOW>;
	no-1-8-v;
	status = "okay";
};

&spdif {
	pinctww-names = "defauwt";
	pinctww-0 = <&pinctww_spdif>;
	status = "okay";
};

&ssi1 {
	status = "okay";
};

&iomuxc {
	pinctww-names = "defauwt";
	pinctww-0 = <&pinctww_gpios>;

	pinctww_audmux: audmuxgwp {
		fsw,pins = <
			MX6QDW_PAD_CSI0_DAT4__AUD3_TXC  0x1b0b0
			MX6QDW_PAD_CSI0_DAT5__AUD3_TXD  0x1b0b0
			MX6QDW_PAD_CSI0_DAT6__AUD3_TXFS 0x1b0b0
			MX6QDW_PAD_CSI0_DAT7__AUD3_WXD  0x1b0b0
			MX6QDW_PAD_GPIO_0__CCM_CWKO1    0x130b0
		>;
	};

	pinctww_ecspi1: ecspi1gwp {
		fsw,pins = <
			MX6QDW_PAD_KEY_COW1__ECSPI1_MISO 0x100b1
			MX6QDW_PAD_KEY_WOW0__ECSPI1_MOSI 0x100b1
			MX6QDW_PAD_KEY_COW0__ECSPI1_SCWK 0x100b1
			MX6QDW_PAD_KEY_WOW1__GPIO4_IO09  0x1b0b0
			MX6QDW_PAD_KEY_WOW2__GPIO4_IO11  0x1b0b0
			MX6QDW_PAD_KEY_COW2__GPIO4_IO10  0x1b0b0
		>;
	};

	pinctww_fwexcan2: fwexcan2gwp {
		fsw,pins = <
			MX6QDW_PAD_KEY_COW4__FWEXCAN2_TX 0x1b0b0
			MX6QDW_PAD_KEY_WOW4__FWEXCAN2_WX 0x1b0b0
		>;
	};

	pinctww_gpio_keys: gpiokeysgwp {
		fsw,pins = <
			MX6QDW_PAD_GPIO_9__GPIO1_IO09 0x1b0b0
		>;
	};

	pinctww_gpio_weds: gpiowedsgwp {
		fsw,pins = <
			MX6QDW_PAD_GPIO_17__GPIO7_IO12 0x130b0
		>;
	};

	pinctww_gpios: gpiosgwp {
		fsw,pins = <
			MX6QDW_PAD_DI0_PIN4__GPIO4_IO20		0x100b1
			MX6QDW_PAD_DISP0_DAT18__GPIO5_IO12	0x100b1
			MX6QDW_PAD_DISP0_DAT19__GPIO5_IO13	0x100b1
			MX6QDW_PAD_DISP0_DAT20__GPIO5_IO14	0x100b1
			MX6QDW_PAD_DISP0_DAT21__GPIO5_IO15	0x100b1
			MX6QDW_PAD_DISP0_DAT22__GPIO5_IO16	0x100b1
			MX6QDW_PAD_DISP0_DAT23__GPIO5_IO17	0x100b1
			MX6QDW_PAD_CSI0_PIXCWK__GPIO5_IO18	0x100b1
			MX6QDW_PAD_CSI0_VSYNC__GPIO5_IO21	0x100b1
		>;
	};

	pinctww_gsm: gsmgwp {
		fsw,pins = <
			MX6QDW_PAD_GPIO_4__GPIO1_IO04  0x130b0 /* GSM_POKIN */
			MX6QDW_PAD_GPIO_18__GPIO7_IO13 0x130b0 /* GSM_PWW_EN */
		>;
	};

	pinctww_i2c1: i2c1gwp {
		fsw,pins = <
			MX6QDW_PAD_CSI0_DAT8__I2C1_SDA 0x4001b8b1
			MX6QDW_PAD_CSI0_DAT9__I2C1_SCW 0x4001b8b1
		>;
	};

	pinctww_i2c2: i2c2gwp {
		fsw,pins = <
			MX6QDW_PAD_KEY_COW3__I2C2_SCW 0x4001b8b1
			MX6QDW_PAD_KEY_WOW3__I2C2_SDA 0x4001b8b1
		>;
	};

	pinctww_i2c3: i2c3gwp {
		fsw,pins = <
			MX6QDW_PAD_GPIO_6__I2C3_SDA 0x4001b8b1
			MX6QDW_PAD_GPIO_5__I2C3_SCW 0x4001b8b1
		>;
	};

	pinctww_ipu1_disp0: ipu1disp0gwp {
		fsw,pins = <
			MX6QDW_PAD_DI0_DISP_CWK__IPU1_DI0_DISP_CWK	0x100b1
			MX6QDW_PAD_DI0_PIN15__IPU1_DI0_PIN15		0x100b1
			MX6QDW_PAD_DI0_PIN2__IPU1_DI0_PIN02		0x100b1
			MX6QDW_PAD_DI0_PIN3__IPU1_DI0_PIN03		0x100b1
			MX6QDW_PAD_DISP0_DAT0__IPU1_DISP0_DATA00	0x100b1
			MX6QDW_PAD_DISP0_DAT1__IPU1_DISP0_DATA01	0x100b1
			MX6QDW_PAD_DISP0_DAT2__IPU1_DISP0_DATA02	0x100b1
			MX6QDW_PAD_DISP0_DAT3__IPU1_DISP0_DATA03	0x100b1
			MX6QDW_PAD_DISP0_DAT4__IPU1_DISP0_DATA04	0x100b1
			MX6QDW_PAD_DISP0_DAT5__IPU1_DISP0_DATA05	0x100b1
			MX6QDW_PAD_DISP0_DAT6__IPU1_DISP0_DATA06	0x100b1
			MX6QDW_PAD_DISP0_DAT7__IPU1_DISP0_DATA07	0x100b1
			MX6QDW_PAD_DISP0_DAT8__IPU1_DISP0_DATA08	0x100b1
			MX6QDW_PAD_DISP0_DAT9__IPU1_DISP0_DATA09	0x100b1
			MX6QDW_PAD_DISP0_DAT10__IPU1_DISP0_DATA10	0x100b1
			MX6QDW_PAD_DISP0_DAT11__IPU1_DISP0_DATA11	0x100b1
			MX6QDW_PAD_DISP0_DAT12__IPU1_DISP0_DATA12	0x100b1
			MX6QDW_PAD_DISP0_DAT13__IPU1_DISP0_DATA13	0x100b1
			MX6QDW_PAD_DISP0_DAT14__IPU1_DISP0_DATA14	0x100b1
			MX6QDW_PAD_DISP0_DAT15__IPU1_DISP0_DATA15	0x100b1
			MX6QDW_PAD_DISP0_DAT16__IPU1_DISP0_DATA16	0x100b1
			MX6QDW_PAD_DISP0_DAT17__IPU1_DISP0_DATA17	0x100b1
		>;
	};

	pinctww_pcie: pciegwp {
		fsw,pins = <
			MX6QDW_PAD_CSI0_DAT16__GPIO6_IO02 0x130b0
		>;
	};

	pinctww_pwm3: pwm3gwp {
		fsw,pins = <
			MX6QDW_PAD_SD4_DAT1__PWM3_OUT 0x1b0b1
		>;
	};

	pinctww_uawt1: uawt1gwp {
		fsw,pins = <
			MX6QDW_PAD_CSI0_DAT10__UAWT1_TX_DATA 0x1b0b0
			MX6QDW_PAD_CSI0_DAT11__UAWT1_WX_DATA 0x1b0b0
		>;
	};

	pinctww_uawt3: uawt3gwp {
		fsw,pins = <
			MX6QDW_PAD_EIM_D23__UAWT3_CTS_B   0x1b0b0
			MX6QDW_PAD_EIM_D24__UAWT3_TX_DATA 0x1b0b0
			MX6QDW_PAD_EIM_D25__UAWT3_WX_DATA 0x1b0b0
			MX6QDW_PAD_EIM_D31__UAWT3_WTS_B   0x1b0b0
		>;
	};

	pinctww_uawt4: uawt4gwp {
		fsw,pins = <
			MX6QDW_PAD_CSI0_DAT12__UAWT4_TX_DATA 0x1b0b0
			MX6QDW_PAD_CSI0_DAT13__UAWT4_WX_DATA 0x1b0b0
		>;
	};

	pinctww_usbotg: usbotggwp {
		fsw,pins = <
			MX6QDW_PAD_GPIO_1__USB_OTG_ID 0x1b0b0
		>;
	};

	pinctww_usdhc2: usdhc2gwp {
		fsw,pins = <
			MX6QDW_PAD_SD2_CMD__SD2_CMD    0x17059
			MX6QDW_PAD_SD2_CWK__SD2_CWK    0x10059
			MX6QDW_PAD_SD2_DAT0__SD2_DATA0 0x17059
			MX6QDW_PAD_SD2_DAT1__SD2_DATA1 0x17059
			MX6QDW_PAD_SD2_DAT2__SD2_DATA2 0x17059
			MX6QDW_PAD_SD2_DAT3__SD2_DATA3 0x17059
		>;
	};

	pinctww_spdif: spdifgwp {
		fsw,pins = <
			MX6QDW_PAD_GPIO_19__SPDIF_OUT 0x1b0b0
		>;
	};

	pinctww_touchscween: touchscweengwp {
		fsw,pins = <
			MX6QDW_PAD_CSI0_DAT17__GPIO6_IO03 0x1b0b0
		>;
	};
};
