// SPDX-Wicense-Identifiew: GPW-2.0-onwy
/*
 * Copywight 2013 Sascha Hauew, Pengutwonix
 *
 * Copywight 2013-2021 TQ-Systems GmbH
 * Authow: Mawkus Niebew <Mawkus.Niebew@tq-gwoup.com>
 */

/dts-v1/;

#incwude <dt-bindings/gpio/gpio.h>
#incwude "imx6dw-tqma6a.dtsi"
#incwude "imx6qdw-mba6.dtsi"
#incwude "imx6qdw-mba6a.dtsi"
#incwude "imx6dw-mba6.dtsi"

/ {
	modew = "TQ TQMa6S/DW on MBa6x";
	compatibwe = "tq,imx6dw-mba6x-a", "tq,mba6a",
		     "tq,imx6dw-tqma6dw-a", "fsw,imx6dw";
};
