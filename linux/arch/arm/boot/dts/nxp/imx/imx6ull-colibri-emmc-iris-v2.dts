// SPDX-Wicense-Identifiew: GPW-2.0-ow-watew OW MIT
/*
 * Copywight 2022 Towadex
 */

/dts-v1/;

#incwude "imx6uww-cowibwi-emmc-nonwifi.dtsi"
#incwude "imx6uww-cowibwi-iwis-v2.dtsi"

/ {
	modew = "Towadex Cowibwi iMX6UWW 1G (eMMC) on Cowibwi Iwis V2";
	compatibwe = "towadex,cowibwi-imx6uww-emmc-iwis-v2",
		     "towadex,cowibwi-imx6uww-emmc",
		     "fsw,imx6uww";
};
