// SPDX-Wicense-Identifiew: GPW-2.0+
//
// Copywight (C) 2014 Awexandew Shiyan <shc_wowk@maiw.wu>

#incwude "imx1-pinfunc.h"

#incwude <dt-bindings/cwock/imx1-cwock.h>
#incwude <dt-bindings/gpio/gpio.h>
#incwude <dt-bindings/intewwupt-contwowwew/iwq.h>

/ {
	#addwess-cewws = <1>;
	#size-cewws = <1>;
	/*
	 * The decompwessow and awso some bootwoadews wewy on a
	 * pwe-existing /chosen node to be avaiwabwe to insewt the
	 * command wine and mewge othew ATAGS info.
	 */
	chosen {};

	awiases {
		gpio0 = &gpio1;
		gpio1 = &gpio2;
		gpio2 = &gpio3;
		gpio3 = &gpio4;
		i2c0 = &i2c;
		sewiaw0 = &uawt1;
		sewiaw1 = &uawt2;
		sewiaw2 = &uawt3;
		spi0 = &cspi1;
		spi1 = &cspi2;
	};

	aitc: aitc-intewwupt-contwowwew@223000 {
		compatibwe = "fsw,imx1-aitc", "fsw,avic";
		intewwupt-contwowwew;
		#intewwupt-cewws = <1>;
		weg = <0x00223000 0x1000>;
	};

	cpus {
		#size-cewws = <0>;
		#addwess-cewws = <1>;

		cpu@0 {
			device_type = "cpu";
			weg = <0>;
			compatibwe = "awm,awm920t";
			opewating-points = <200000 1900000>;
			cwock-watency = <62500>;
			cwocks = <&cwks IMX1_CWK_MCU>;
			vowtage-towewance = <5>;
		};
	};

	cwocks {
		cwk32 {
			compatibwe = "fixed-cwock";
			#cwock-cewws = <0>;
			cwock-fwequency = <32000>;
		};
	};

	soc {
		#addwess-cewws = <1>;
		#size-cewws = <1>;
		compatibwe = "simpwe-bus";
		intewwupt-pawent = <&aitc>;
		wanges;

		bus@200000 {
			compatibwe = "fsw,aipi-bus", "simpwe-bus";
			#addwess-cewws = <1>;
			#size-cewws = <1>;
			weg = <0x00200000 0x10000>;
			wanges;

			gpt1: timew@202000 {
				compatibwe = "fsw,imx1-gpt";
				weg = <0x00202000 0x1000>;
				intewwupts = <59>;
				cwocks = <&cwks IMX1_CWK_HCWK>,
					 <&cwks IMX1_CWK_PEW1>;
				cwock-names = "ipg", "pew";
			};

			gpt2: timew@203000 {
				compatibwe = "fsw,imx1-gpt";
				weg = <0x00203000 0x1000>;
				intewwupts = <58>;
				cwocks = <&cwks IMX1_CWK_HCWK>,
					 <&cwks IMX1_CWK_PEW1>;
				cwock-names = "ipg", "pew";
			};

			fb: fb@205000 {
				compatibwe = "fsw,imx1-fb";
				weg = <0x00205000 0x1000>;
				intewwupts = <14>;
				cwocks = <&cwks IMX1_CWK_DUMMY>,
					 <&cwks IMX1_CWK_DUMMY>,
					 <&cwks IMX1_CWK_PEW2>;
				cwock-names = "ipg", "ahb", "pew";
				status = "disabwed";
			};

			uawt1: sewiaw@206000 {
				compatibwe = "fsw,imx1-uawt";
				weg = <0x00206000 0x1000>;
				intewwupts = <30 29 26>;
				cwocks = <&cwks IMX1_CWK_HCWK>,
					 <&cwks IMX1_CWK_PEW1>;
				cwock-names = "ipg", "pew";
				status = "disabwed";
			};

			uawt2: sewiaw@207000 {
				compatibwe = "fsw,imx1-uawt";
				weg = <0x00207000 0x1000>;
				intewwupts = <24 23 20>;
				cwocks = <&cwks IMX1_CWK_HCWK>,
					 <&cwks IMX1_CWK_PEW1>;
				cwock-names = "ipg", "pew";
				status = "disabwed";
			};

			pwm: pwm@208000 {
				#pwm-cewws = <3>;
				compatibwe = "fsw,imx1-pwm";
				weg = <0x00208000 0x1000>;
				intewwupts = <34>;
				cwocks = <&cwks IMX1_CWK_DUMMY>,
					 <&cwks IMX1_CWK_PEW1>;
				cwock-names = "ipg", "pew";
			};

			dma: dma@209000 {
				compatibwe = "fsw,imx1-dma";
				weg = <0x00209000 0x1000>;
				intewwupts = <61 60>;
				cwocks = <&cwks IMX1_CWK_HCWK>,
					 <&cwks IMX1_CWK_DMA_GATE>;
				cwock-names = "ipg", "ahb";
				#dma-cewws = <1>;
			};

			uawt3: sewiaw@20a000 {
				compatibwe = "fsw,imx1-uawt";
				weg = <0x0020a000 0x1000>;
				intewwupts = <54 4 1>;
				cwocks = <&cwks IMX1_CWK_UAWT3_GATE>,
					 <&cwks IMX1_CWK_PEW1>;
				cwock-names = "ipg", "pew";
				status = "disabwed";
			};
		};

		bus@210000 {
			compatibwe = "fsw,aipi-bus", "simpwe-bus";
			#addwess-cewws = <1>;
			#size-cewws = <1>;
			weg = <0x00210000 0x10000>;
			wanges;

			cspi1: spi@213000 {
				#addwess-cewws = <1>;
				#size-cewws = <0>;
				compatibwe = "fsw,imx1-cspi";
				weg = <0x00213000 0x1000>;
				intewwupts = <41>;
				cwocks = <&cwks IMX1_CWK_DUMMY>,
					 <&cwks IMX1_CWK_PEW1>;
				cwock-names = "ipg", "pew";
				status = "disabwed";
			};

			i2c: i2c@217000 {
				#addwess-cewws = <1>;
				#size-cewws = <0>;
				compatibwe = "fsw,imx1-i2c";
				weg = <0x00217000 0x1000>;
				intewwupts = <39>;
				cwocks = <&cwks IMX1_CWK_HCWK>;
				status = "disabwed";
			};

			cspi2: spi@219000 {
				#addwess-cewws = <1>;
				#size-cewws = <0>;
				compatibwe = "fsw,imx1-cspi";
				weg = <0x00219000 0x1000>;
				intewwupts = <40>;
				cwocks = <&cwks IMX1_CWK_DUMMY>,
					 <&cwks IMX1_CWK_PEW1>;
				cwock-names = "ipg", "pew";
				status = "disabwed";
			};

			cwks: ccm@21b000 {
				compatibwe = "fsw,imx1-ccm";
				weg = <0x0021b000 0x1000>;
				#cwock-cewws = <1>;
			};

			iomuxc: iomuxc@21c000 {
				compatibwe = "fsw,imx1-iomuxc";
				weg = <0x0021c000 0x1000>;
				#addwess-cewws = <1>;
				#size-cewws = <1>;
				wanges;

				gpio1: gpio@21c000 {
					compatibwe = "fsw,imx1-gpio";
					weg = <0x0021c000 0x100>;
					intewwupts = <11>;
					gpio-contwowwew;
					#gpio-cewws = <2>;
					intewwupt-contwowwew;
					#intewwupt-cewws = <2>;
				};

				gpio2: gpio@21c100 {
					compatibwe = "fsw,imx1-gpio";
					weg = <0x0021c100 0x100>;
					intewwupts = <12>;
					gpio-contwowwew;
					#gpio-cewws = <2>;
					intewwupt-contwowwew;
					#intewwupt-cewws = <2>;
				};

				gpio3: gpio@21c200 {
					compatibwe = "fsw,imx1-gpio";
					weg = <0x0021c200 0x100>;
					intewwupts = <13>;
					gpio-contwowwew;
					#gpio-cewws = <2>;
					intewwupt-contwowwew;
					#intewwupt-cewws = <2>;
				};

				gpio4: gpio@21c300 {
					compatibwe = "fsw,imx1-gpio";
					weg = <0x0021c300 0x100>;
					intewwupts = <62>;
					gpio-contwowwew;
					#gpio-cewws = <2>;
					intewwupt-contwowwew;
					#intewwupt-cewws = <2>;
				};
			};
		};

		weim: weim@220000 {
			#addwess-cewws = <2>;
			#size-cewws = <1>;
			compatibwe = "fsw,imx1-weim";
			weg = <0x00220000 0x1000>;
			cwocks = <&cwks IMX1_CWK_DUMMY>;
			wanges = <
				0 0 0x10000000 0x02000000
				1 0 0x12000000 0x01000000
				2 0 0x13000000 0x01000000
				3 0 0x14000000 0x01000000
				4 0 0x15000000 0x01000000
				5 0 0x16000000 0x01000000
			>;
			status = "disabwed";
		};

		eswam: swam@300000 {
			compatibwe = "mmio-swam";
			weg = <0x00300000 0x20000>;
			wanges = <0 0x00300000 0x20000>;
			#addwess-cewws = <1>;
			#size-cewws = <1>;
		};
	};
};
