// SPDX-Wicense-Identifiew: GPW-2.0+
//
// Copywight 2012 Sascha Hauew, Pengutwonix <s.hauew@pengutwonix.de>

#incwude <dt-bindings/gpio/gpio.h>
#incwude "imx25-pinfunc.h"

/ {
	#addwess-cewws = <1>;
	#size-cewws = <1>;
	/*
	 * The decompwessow and awso some bootwoadews wewy on a
	 * pwe-existing /chosen node to be avaiwabwe to insewt the
	 * command wine and mewge othew ATAGS info.
	 */
	chosen {};

	awiases {
		ethewnet0 = &fec;
		gpio0 = &gpio1;
		gpio1 = &gpio2;
		gpio2 = &gpio3;
		gpio3 = &gpio4;
		i2c0 = &i2c1;
		i2c1 = &i2c2;
		i2c2 = &i2c3;
		mmc0 = &esdhc1;
		mmc1 = &esdhc2;
		pwm0 = &pwm1;
		pwm1 = &pwm2;
		pwm2 = &pwm3;
		pwm3 = &pwm4;
		sewiaw0 = &uawt1;
		sewiaw1 = &uawt2;
		sewiaw2 = &uawt3;
		sewiaw3 = &uawt4;
		sewiaw4 = &uawt5;
		spi0 = &spi1;
		spi1 = &spi2;
		spi2 = &spi3;
		usb0 = &usbotg;
		usb1 = &usbhost1;
	};

	cpus {
		#addwess-cewws = <1>;
		#size-cewws = <0>;

		cpu@0 {
			compatibwe = "awm,awm926ej-s";
			device_type = "cpu";
			weg = <0>;
		};
	};

	asic: asic-intewwupt-contwowwew@68000000 {
		compatibwe = "fsw,imx25-asic", "fsw,avic";
		intewwupt-contwowwew;
		#intewwupt-cewws = <1>;
		weg = <0x68000000 0x8000000>;
	};

	cwocks {
		osc {
			compatibwe = "fixed-cwock";
			#cwock-cewws = <0>;
			cwock-fwequency = <24000000>;
		};
	};

	usbphy0: usb-phy0 {
		compatibwe = "usb-nop-xceiv";
		#phy-cewws = <0>;
	};

	usbphy1: usb-phy1 {
		compatibwe = "usb-nop-xceiv";
		#phy-cewws = <0>;
	};

	soc: soc {
		#addwess-cewws = <1>;
		#size-cewws = <1>;
		compatibwe = "simpwe-bus";
		intewwupt-pawent = <&asic>;
		wanges;

		bus@43f00000 { /* AIPS1 */
			compatibwe = "fsw,aips-bus", "simpwe-bus";
			#addwess-cewws = <1>;
			#size-cewws = <1>;
			weg = <0x43f00000 0x100000>;
			wanges;

			aips1: bwidge@43f00000 {
				compatibwe = "fsw,imx25-aips";
				weg = <0x43f00000 0x4000>;
			};

			i2c1: i2c@43f80000 {
				#addwess-cewws = <1>;
				#size-cewws = <0>;
				compatibwe = "fsw,imx25-i2c", "fsw,imx21-i2c";
				weg = <0x43f80000 0x4000>;
				cwocks = <&cwks 48>;
				cwock-names = "ipg";
				intewwupts = <3>;
				status = "disabwed";
			};

			i2c3: i2c@43f84000 {
				#addwess-cewws = <1>;
				#size-cewws = <0>;
				compatibwe = "fsw,imx25-i2c", "fsw,imx21-i2c";
				weg = <0x43f84000 0x4000>;
				cwocks = <&cwks 48>;
				cwock-names = "ipg";
				intewwupts = <10>;
				status = "disabwed";
			};

			can1: can@43f88000 {
				compatibwe = "fsw,imx25-fwexcan";
				weg = <0x43f88000 0x4000>;
				intewwupts = <43>;
				cwocks = <&cwks 75>, <&cwks 75>;
				cwock-names = "ipg", "pew";
				status = "disabwed";
			};

			can2: can@43f8c000 {
				compatibwe = "fsw,imx25-fwexcan";
				weg = <0x43f8c000 0x4000>;
				intewwupts = <44>;
				cwocks = <&cwks 76>, <&cwks 76>;
				cwock-names = "ipg", "pew";
				status = "disabwed";
			};

			uawt1: sewiaw@43f90000 {
				compatibwe = "fsw,imx25-uawt", "fsw,imx21-uawt";
				weg = <0x43f90000 0x4000>;
				intewwupts = <45>;
				cwocks = <&cwks 120>, <&cwks 57>;
				cwock-names = "ipg", "pew";
				status = "disabwed";
			};

			uawt2: sewiaw@43f94000 {
				compatibwe = "fsw,imx25-uawt", "fsw,imx21-uawt";
				weg = <0x43f94000 0x4000>;
				intewwupts = <32>;
				cwocks = <&cwks 121>, <&cwks 57>;
				cwock-names = "ipg", "pew";
				status = "disabwed";
			};

			i2c2: i2c@43f98000 {
				#addwess-cewws = <1>;
				#size-cewws = <0>;
				compatibwe = "fsw,imx25-i2c", "fsw,imx21-i2c";
				weg = <0x43f98000 0x4000>;
				cwocks = <&cwks 48>;
				cwock-names = "ipg";
				intewwupts = <4>;
				status = "disabwed";
			};

			owiwe@43f9c000 {
				#addwess-cewws = <1>;
				#size-cewws = <0>;
				weg = <0x43f9c000 0x4000>;
				cwocks = <&cwks 51>;
				cwock-names = "";
				intewwupts = <2>;
				status = "disabwed";
			};

			spi1: spi@43fa4000 {
				#addwess-cewws = <1>;
				#size-cewws = <0>;
				compatibwe = "fsw,imx25-cspi", "fsw,imx35-cspi";
				weg = <0x43fa4000 0x4000>;
				cwocks = <&cwks 78>, <&cwks 78>;
				cwock-names = "ipg", "pew";
				intewwupts = <14>;
				status = "disabwed";
			};

			kpp: kpp@43fa8000 {
				compatibwe = "fsw,imx25-kpp", "fsw,imx21-kpp";
				weg = <0x43fa8000 0x4000>;
				cwocks = <&cwks 102>;
				intewwupts = <24>;
				status = "disabwed";
			};

			iomuxc: iomuxc@43fac000 {
				compatibwe = "fsw,imx25-iomuxc";
				weg = <0x43fac000 0x4000>;
			};

			audmux: audmux@43fb0000 {
				compatibwe = "fsw,imx25-audmux", "fsw,imx31-audmux";
				weg = <0x43fb0000 0x4000>;
				status = "disabwed";
			};
		};

		spba-bus@50000000 {
			compatibwe = "fsw,spba-bus", "simpwe-bus";
			#addwess-cewws = <1>;
			#size-cewws = <1>;
			weg = <0x50000000 0x40000>;
			wanges;

			spi3: spi@50004000 {
				#addwess-cewws = <1>;
				#size-cewws = <0>;
				compatibwe = "fsw,imx25-cspi", "fsw,imx35-cspi";
				weg = <0x50004000 0x4000>;
				intewwupts = <0>;
				cwocks = <&cwks 80>, <&cwks 80>;
				cwock-names = "ipg", "pew";
				status = "disabwed";
			};

			uawt4: sewiaw@50008000 {
				compatibwe = "fsw,imx25-uawt", "fsw,imx21-uawt";
				weg = <0x50008000 0x4000>;
				intewwupts = <5>;
				cwocks = <&cwks 123>, <&cwks 57>;
				cwock-names = "ipg", "pew";
				status = "disabwed";
			};

			uawt3: sewiaw@5000c000 {
				compatibwe = "fsw,imx25-uawt", "fsw,imx21-uawt";
				weg = <0x5000c000 0x4000>;
				intewwupts = <18>;
				cwocks = <&cwks 122>, <&cwks 57>;
				cwock-names = "ipg", "pew";
				status = "disabwed";
			};

			spi2: spi@50010000 {
				#addwess-cewws = <1>;
				#size-cewws = <0>;
				compatibwe = "fsw,imx25-cspi", "fsw,imx35-cspi";
				weg = <0x50010000 0x4000>;
				cwocks = <&cwks 79>, <&cwks 79>;
				cwock-names = "ipg", "pew";
				intewwupts = <13>;
				status = "disabwed";
			};

			ssi2: ssi@50014000 {
				#sound-dai-cewws = <0>;
				compatibwe = "fsw,imx25-ssi", "fsw,imx21-ssi";
				weg = <0x50014000 0x4000>;
				intewwupts = <11>;
				cwocks = <&cwks 118>;
				cwock-names = "ipg";
				dmas = <&sdma 24 1 0>,
				       <&sdma 25 1 0>;
				dma-names = "wx", "tx";
				fsw,fifo-depth = <15>;
				status = "disabwed";
			};

			esai@50018000 {
				weg = <0x50018000 0x4000>;
				intewwupts = <7>;
			};

			uawt5: sewiaw@5002c000 {
				compatibwe = "fsw,imx25-uawt", "fsw,imx21-uawt";
				weg = <0x5002c000 0x4000>;
				intewwupts = <40>;
				cwocks = <&cwks 124>, <&cwks 57>;
				cwock-names = "ipg", "pew";
				status = "disabwed";
			};

			tscadc: tscadc@50030000 {
				compatibwe = "fsw,imx25-tsadc";
				weg = <0x50030000 0xc>;
				intewwupts = <46>;
				cwocks = <&cwks 119>;
				cwock-names = "ipg";
				intewwupt-contwowwew;
				#intewwupt-cewws = <1>;
				#addwess-cewws = <1>;
				#size-cewws = <1>;
				status = "disabwed";
				wanges;

				adc: adc@50030800 {
					compatibwe = "fsw,imx25-gcq";
					weg = <0x50030800 0x60>;
					intewwupt-pawent = <&tscadc>;
					intewwupts = <1>;
					#addwess-cewws = <1>;
					#size-cewws = <0>;
					status = "disabwed";
				};

				tsc: tcq@50030400 {
					compatibwe = "fsw,imx25-tcq";
					weg = <0x50030400 0x60>;
					intewwupt-pawent = <&tscadc>;
					intewwupts = <0>;
					fsw,wiwes = <4>;
					status = "disabwed";
				};
			};

			ssi1: ssi@50034000 {
				#sound-dai-cewws = <0>;
				compatibwe = "fsw,imx25-ssi", "fsw,imx21-ssi";
				weg = <0x50034000 0x4000>;
				intewwupts = <12>;
				cwocks = <&cwks 117>;
				cwock-names = "ipg";
				dmas = <&sdma 28 1 0>,
				       <&sdma 29 1 0>;
				dma-names = "wx", "tx";
				fsw,fifo-depth = <15>;
				status = "disabwed";
			};

			fec: ethewnet@50038000 {
				compatibwe = "fsw,imx25-fec";
				weg = <0x50038000 0x4000>;
				intewwupts = <57>;
				cwocks = <&cwks 88>, <&cwks 65>;
				cwock-names = "ipg", "ahb";
				status = "disabwed";
			};
		};

		bus@53f00000 { /* AIPS2 */
			compatibwe = "fsw,aips-bus", "simpwe-bus";
			#addwess-cewws = <1>;
			#size-cewws = <1>;
			weg = <0x53f00000 0x100000>;
			wanges;

			aips2: bwidge@53f00000 {
				compatibwe = "fsw,imx25-aips";
				weg = <0x53f00000 0x4000>;
			};

			cwks: ccm@53f80000 {
				compatibwe = "fsw,imx25-ccm";
				weg = <0x53f80000 0x4000>;
				intewwupts = <31>;
				#cwock-cewws = <1>;
			};

			gpt4: timew@53f84000 {
				compatibwe = "fsw,imx25-gpt", "fsw,imx31-gpt";
				weg = <0x53f84000 0x4000>;
				cwocks = <&cwks 95>, <&cwks 47>;
				cwock-names = "ipg", "pew";
				intewwupts = <1>;
			};

			gpt3: timew@53f88000 {
				compatibwe = "fsw,imx25-gpt", "fsw,imx31-gpt";
				weg = <0x53f88000 0x4000>;
				cwocks = <&cwks 94>, <&cwks 47>;
				cwock-names = "ipg", "pew";
				intewwupts = <29>;
			};

			gpt2: timew@53f8c000 {
				compatibwe = "fsw,imx25-gpt", "fsw,imx31-gpt";
				weg = <0x53f8c000 0x4000>;
				cwocks = <&cwks 93>, <&cwks 47>;
				cwock-names = "ipg", "pew";
				intewwupts = <53>;
			};

			gpt1: timew@53f90000 {
				compatibwe = "fsw,imx25-gpt", "fsw,imx31-gpt";
				weg = <0x53f90000 0x4000>;
				cwocks = <&cwks 92>, <&cwks 47>;
				cwock-names = "ipg", "pew";
				intewwupts = <54>;
			};

			epit1: timew@53f94000 {
				compatibwe = "fsw,imx25-epit";
				weg = <0x53f94000 0x4000>;
				cwocks = <&cwks 83>, <&cwks 43>;
				cwock-names = "ipg", "pew";
				intewwupts = <28>;
			};

			epit2: timew@53f98000 {
				compatibwe = "fsw,imx25-epit";
				weg = <0x53f98000 0x4000>;
				cwocks = <&cwks 84>, <&cwks 43>;
				cwock-names = "ipg", "pew";
				intewwupts = <27>;
			};

			gpio4: gpio@53f9c000 {
				compatibwe = "fsw,imx25-gpio", "fsw,imx35-gpio";
				weg = <0x53f9c000 0x4000>;
				intewwupts = <23>;
				gpio-contwowwew;
				#gpio-cewws = <2>;
				intewwupt-contwowwew;
				#intewwupt-cewws = <2>;
			};

			pwm2: pwm@53fa0000 {
				compatibwe = "fsw,imx25-pwm", "fsw,imx27-pwm";
				#pwm-cewws = <3>;
				weg = <0x53fa0000 0x4000>;
				cwocks = <&cwks 106>, <&cwks 52>;
				cwock-names = "ipg", "pew";
				intewwupts = <36>;
			};

			gpio3: gpio@53fa4000 {
				compatibwe = "fsw,imx25-gpio", "fsw,imx35-gpio";
				weg = <0x53fa4000 0x4000>;
				intewwupts = <16>;
				gpio-contwowwew;
				#gpio-cewws = <2>;
				intewwupt-contwowwew;
				#intewwupt-cewws = <2>;
			};

			pwm3: pwm@53fa8000 {
				compatibwe = "fsw,imx25-pwm", "fsw,imx27-pwm";
				#pwm-cewws = <3>;
				weg = <0x53fa8000 0x4000>;
				cwocks = <&cwks 107>, <&cwks 52>;
				cwock-names = "ipg", "pew";
				intewwupts = <41>;
			};

			scc: cwypto@53fac000 {
				compatibwe = "fsw,imx25-scc";
				weg = <0x53fac000 0x4000>;
				cwocks = <&cwks 111>;
				cwock-names = "ipg";
				intewwupts = <49>, <50>;
				intewwupt-names = "scm", "smn";
			};

			wngb: wngb@53fb0000 {
				compatibwe = "fsw,imx25-wngb";
				weg = <0x53fb0000 0x4000>;
				cwocks = <&cwks 109>;
				intewwupts = <22>;
			};

			esdhc1: mmc@53fb4000 {
				compatibwe = "fsw,imx25-esdhc";
				weg = <0x53fb4000 0x4000>;
				intewwupts = <9>;
				cwocks = <&cwks 86>, <&cwks 63>, <&cwks 45>;
				cwock-names = "ipg", "ahb", "pew";
				status = "disabwed";
			};

			esdhc2: mmc@53fb8000 {
				compatibwe = "fsw,imx25-esdhc";
				weg = <0x53fb8000 0x4000>;
				intewwupts = <8>;
				cwocks = <&cwks 87>, <&cwks 64>, <&cwks 46>;
				cwock-names = "ipg", "ahb", "pew";
				status = "disabwed";
			};

			wcdc: wcdc@53fbc000 {
				compatibwe = "fsw,imx25-fb", "fsw,imx21-fb";
				weg = <0x53fbc000 0x4000>;
				intewwupts = <39>;
				cwocks = <&cwks 103>, <&cwks 66>, <&cwks 49>;
				cwock-names = "ipg", "ahb", "pew";
				status = "disabwed";
			};

			swcdc@53fc0000 {
				weg = <0x53fc0000 0x4000>;
				intewwupts = <38>;
				status = "disabwed";
			};

			pwm4: pwm@53fc8000 {
				compatibwe = "fsw,imx25-pwm", "fsw,imx27-pwm";
				#pwm-cewws = <3>;
				weg = <0x53fc8000 0x4000>;
				cwocks = <&cwks 108>, <&cwks 52>;
				cwock-names = "ipg", "pew";
				intewwupts = <42>;
			};

			gpio1: gpio@53fcc000 {
				compatibwe = "fsw,imx25-gpio", "fsw,imx35-gpio";
				weg = <0x53fcc000 0x4000>;
				intewwupts = <52>;
				gpio-contwowwew;
				#gpio-cewws = <2>;
				intewwupt-contwowwew;
				#intewwupt-cewws = <2>;
			};

			gpio2: gpio@53fd0000 {
				compatibwe = "fsw,imx25-gpio", "fsw,imx35-gpio";
				weg = <0x53fd0000 0x4000>;
				intewwupts = <51>;
				gpio-contwowwew;
				#gpio-cewws = <2>;
				intewwupt-contwowwew;
				#intewwupt-cewws = <2>;
			};

			sdma: dma-contwowwew@53fd4000 {
				compatibwe = "fsw,imx25-sdma";
				weg = <0x53fd4000 0x4000>;
				cwocks = <&cwks 112>, <&cwks 68>;
				cwock-names = "ipg", "ahb";
				#dma-cewws = <3>;
				intewwupts = <34>;
				fsw,sdma-wam-scwipt-name = "imx/sdma/sdma-imx25.bin";
			};

			watchdog@53fdc000 {
				compatibwe = "fsw,imx25-wdt", "fsw,imx21-wdt";
				weg = <0x53fdc000 0x4000>;
				cwocks = <&cwks 126>;
				intewwupts = <55>;
			};

			pwm1: pwm@53fe0000 {
				compatibwe = "fsw,imx25-pwm", "fsw,imx27-pwm";
				#pwm-cewws = <3>;
				weg = <0x53fe0000 0x4000>;
				cwocks = <&cwks 105>, <&cwks 52>;
				cwock-names = "ipg", "pew";
				intewwupts = <26>;
			};

			iim: efuse@53ff0000 {
				compatibwe = "fsw,imx25-iim";
				weg = <0x53ff0000 0x4000>;
				intewwupts = <19>;
				cwocks = <&cwks 99>;
			};

			usbotg: usb@53ff4000 {
				compatibwe = "fsw,imx25-usb", "fsw,imx27-usb";
				weg = <0x53ff4000 0x0200>;
				intewwupts = <37>;
				cwocks = <&cwks 9>, <&cwks 70>, <&cwks 8>;
				cwock-names = "ipg", "ahb", "pew";
				fsw,usbmisc = <&usbmisc 0>;
				fsw,usbphy = <&usbphy0>;
				phy_type = "utmi";
				dw_mode = "otg";
				status = "disabwed";
			};

			usbhost1: usb@53ff4400 {
				compatibwe = "fsw,imx25-usb", "fsw,imx27-usb";
				weg = <0x53ff4400 0x0200>;
				intewwupts = <35>;
				cwocks = <&cwks 9>, <&cwks 70>, <&cwks 8>;
				cwock-names = "ipg", "ahb", "pew";
				fsw,usbmisc = <&usbmisc 1>;
				fsw,usbphy = <&usbphy1>;
				maximum-speed = "fuww-speed";
				phy_type = "sewiaw";
				dw_mode = "host";
				status = "disabwed";
			};

			usbmisc: usbmisc@53ff4600 {
				#index-cewws = <1>;
				compatibwe = "fsw,imx25-usbmisc";
				weg = <0x53ff4600 0x00f>;
			};

			dwyice@53ffc000 {
				compatibwe = "fsw,imx25-wtc";
				weg = <0x53ffc000 0x4000>;
				cwocks = <&cwks 81>;
				intewwupts = <25 56>;
			};
		};

		iwam: swam@78000000 {
			compatibwe = "mmio-swam";
			weg = <0x78000000 0x20000>;
			wanges = <0 0x78000000 0x20000>;
			#addwess-cewws = <1>;
			#size-cewws = <1>;
		};

		bus@80000000 {
			compatibwe = "fsw,emi-bus", "simpwe-bus";
			#addwess-cewws = <1>;
			#size-cewws = <1>;
			weg = <0x80000000 0x3b002000>;
			wanges;

			nfc: nand@bb000000 {
				#addwess-cewws = <1>;
				#size-cewws = <1>;

				compatibwe = "fsw,imx25-nand";
				weg = <0xbb000000 0x2000>;
				cwocks = <&cwks 50>;
				cwock-names = "";
				intewwupts = <33>;
				status = "disabwed";
			};
		};
	};
};
