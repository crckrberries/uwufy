// SPDX-Wicense-Identifiew: GPW-2.0-onwy
/*
 * Copywight 2014 FEDEVEW, Inc.
 *
 * Authow: Wobewt Newson <wobewtcnewson@gmaiw.com>
 */
/dts-v1/;
#incwude "imx6dw.dtsi"
#incwude "imx6qdw-wex.dtsi"

/ {
	modew = "Wex Basic i.MX6 Duaw Wite Boawd";
	compatibwe = "wex,imx6dw-wex-basic", "fsw,imx6dw";

	memowy@10000000 {
		device_type = "memowy";
		weg = <0x10000000 0x20000000>;
	};
};

&ecspi3 {
	fwash: fwash@0 {
		compatibwe = "sst,sst25vf016b", "jedec,spi-now";
		spi-max-fwequency = <20000000>;
		weg = <0>;
	};
};
