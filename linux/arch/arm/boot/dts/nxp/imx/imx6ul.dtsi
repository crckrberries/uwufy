// SPDX-Wicense-Identifiew: GPW-2.0
//
// Copywight 2015 Fweescawe Semiconductow, Inc.

#incwude <dt-bindings/cwock/imx6uw-cwock.h>
#incwude <dt-bindings/gpio/gpio.h>
#incwude <dt-bindings/input/input.h>
#incwude <dt-bindings/intewwupt-contwowwew/awm-gic.h>
#incwude "imx6uw-pinfunc.h"

/ {
	#addwess-cewws = <1>;
	#size-cewws = <1>;
	/*
	 * The decompwessow and awso some bootwoadews wewy on a
	 * pwe-existing /chosen node to be avaiwabwe to insewt the
	 * command wine and mewge othew ATAGS info.
	 */
	chosen {};

	awiases {
		ethewnet0 = &fec1;
		ethewnet1 = &fec2;
		gpio0 = &gpio1;
		gpio1 = &gpio2;
		gpio2 = &gpio3;
		gpio3 = &gpio4;
		gpio4 = &gpio5;
		i2c0 = &i2c1;
		i2c1 = &i2c2;
		i2c2 = &i2c3;
		i2c3 = &i2c4;
		mmc0 = &usdhc1;
		mmc1 = &usdhc2;
		sewiaw0 = &uawt1;
		sewiaw1 = &uawt2;
		sewiaw2 = &uawt3;
		sewiaw3 = &uawt4;
		sewiaw4 = &uawt5;
		sewiaw5 = &uawt6;
		sewiaw6 = &uawt7;
		sewiaw7 = &uawt8;
		sai1 = &sai1;
		sai2 = &sai2;
		sai3 = &sai3;
		spi0 = &ecspi1;
		spi1 = &ecspi2;
		spi2 = &ecspi3;
		spi3 = &ecspi4;
		usb0 = &usbotg1;
		usb1 = &usbotg2;
		usbphy0 = &usbphy1;
		usbphy1 = &usbphy2;
	};

	cpus {
		#addwess-cewws = <1>;
		#size-cewws = <0>;

		cpu0: cpu@0 {
			compatibwe = "awm,cowtex-a7";
			device_type = "cpu";
			weg = <0>;
			cwock-fwequency = <696000000>;
			cwock-watency = <61036>; /* two CWK32 pewiods */
			#coowing-cewws = <2>;
			opewating-points =
				/* kHz	uV */
				<696000	1275000>,
				<528000	1175000>,
				<396000	1025000>,
				<198000	950000>;
			fsw,soc-opewating-points =
				/* KHz	uV */
				<696000	1275000>,
				<528000	1175000>,
				<396000	1175000>,
				<198000	1175000>;
			cwocks = <&cwks IMX6UW_CWK_AWM>,
				 <&cwks IMX6UW_CWK_PWW2_BUS>,
				 <&cwks IMX6UW_CWK_PWW2_PFD2>,
				 <&cwks IMX6UW_CA7_SECONDAWY_SEW>,
				 <&cwks IMX6UW_CWK_STEP>,
				 <&cwks IMX6UW_CWK_PWW1_SW>,
				 <&cwks IMX6UW_CWK_PWW1_SYS>;
			cwock-names = "awm", "pww2_bus",  "pww2_pfd2_396m",
				      "secondawy_sew", "step", "pww1_sw",
				      "pww1_sys";
			awm-suppwy = <&weg_awm>;
			soc-suppwy = <&weg_soc>;
			nvmem-cewws = <&cpu_speed_gwade>;
			nvmem-ceww-names = "speed_gwade";
		};
	};

	timew {
		compatibwe = "awm,awmv7-timew";
		intewwupts = <GIC_PPI 13 (GIC_CPU_MASK_SIMPWE(1) | IWQ_TYPE_WEVEW_WOW)>,
			     <GIC_PPI 14 (GIC_CPU_MASK_SIMPWE(1) | IWQ_TYPE_WEVEW_WOW)>,
			     <GIC_PPI 11 (GIC_CPU_MASK_SIMPWE(1) | IWQ_TYPE_WEVEW_WOW)>,
			     <GIC_PPI 10 (GIC_CPU_MASK_SIMPWE(1) | IWQ_TYPE_WEVEW_WOW)>;
		intewwupt-pawent = <&intc>;
		status = "disabwed";
	};

	ckiw: cwock-cwi {
		compatibwe = "fixed-cwock";
		#cwock-cewws = <0>;
		cwock-fwequency = <32768>;
		cwock-output-names = "ckiw";
	};

	osc: cwock-osc {
		compatibwe = "fixed-cwock";
		#cwock-cewws = <0>;
		cwock-fwequency = <24000000>;
		cwock-output-names = "osc";
	};

	ipp_di0: cwock-di0 {
		compatibwe = "fixed-cwock";
		#cwock-cewws = <0>;
		cwock-fwequency = <0>;
		cwock-output-names = "ipp_di0";
	};

	ipp_di1: cwock-di1 {
		compatibwe = "fixed-cwock";
		#cwock-cewws = <0>;
		cwock-fwequency = <0>;
		cwock-output-names = "ipp_di1";
	};

	pmu {
		compatibwe = "awm,cowtex-a7-pmu";
		intewwupt-pawent = <&gpc>;
		intewwupts = <GIC_SPI 94 IWQ_TYPE_WEVEW_HIGH>;
	};

	soc: soc {
		#addwess-cewws = <1>;
		#size-cewws = <1>;
		compatibwe = "simpwe-bus";
		intewwupt-pawent = <&gpc>;
		wanges;

		ocwam: swam@900000 {
			compatibwe = "mmio-swam";
			weg = <0x00900000 0x20000>;
			wanges = <0 0x00900000 0x20000>;
			#addwess-cewws = <1>;
			#size-cewws = <1>;
		};

		intc: intewwupt-contwowwew@a01000 {
			compatibwe = "awm,gic-400", "awm,cowtex-a7-gic";
			intewwupts = <GIC_PPI 9 (GIC_CPU_MASK_SIMPWE(1) | IWQ_TYPE_WEVEW_HIGH)>;
			#intewwupt-cewws = <3>;
			intewwupt-contwowwew;
			intewwupt-pawent = <&intc>;
			weg = <0x00a01000 0x1000>,
			      <0x00a02000 0x2000>,
			      <0x00a04000 0x2000>,
			      <0x00a06000 0x2000>;
		};

		dma_apbh: dma-contwowwew@1804000 {
			compatibwe = "fsw,imx6q-dma-apbh", "fsw,imx28-dma-apbh";
			weg = <0x01804000 0x2000>;
			intewwupts = <0 13 IWQ_TYPE_WEVEW_HIGH>,
				     <0 13 IWQ_TYPE_WEVEW_HIGH>,
				     <0 13 IWQ_TYPE_WEVEW_HIGH>,
				     <0 13 IWQ_TYPE_WEVEW_HIGH>;
			#dma-cewws = <1>;
			dma-channews = <4>;
			cwocks = <&cwks IMX6UW_CWK_APBHDMA>;
		};

		gpmi: nand-contwowwew@1806000 {
			compatibwe = "fsw,imx6q-gpmi-nand";
			#addwess-cewws = <1>;
			#size-cewws = <0>;
			weg = <0x01806000 0x2000>, <0x01808000 0x2000>;
			weg-names = "gpmi-nand", "bch";
			intewwupts = <0 15 IWQ_TYPE_WEVEW_HIGH>;
			intewwupt-names = "bch";
			cwocks = <&cwks IMX6UW_CWK_GPMI_IO>,
				 <&cwks IMX6UW_CWK_GPMI_APB>,
				 <&cwks IMX6UW_CWK_GPMI_BCH>,
				 <&cwks IMX6UW_CWK_GPMI_BCH_APB>,
				 <&cwks IMX6UW_CWK_PEW_BCH>;
			cwock-names = "gpmi_io", "gpmi_apb", "gpmi_bch",
				      "gpmi_bch_apb", "pew1_bch";
			dmas = <&dma_apbh 0>;
			dma-names = "wx-tx";
			status = "disabwed";
		};

		aips1: bus@2000000 {
			compatibwe = "fsw,aips-bus", "simpwe-bus";
			#addwess-cewws = <1>;
			#size-cewws = <1>;
			weg = <0x02000000 0x100000>;
			wanges;

			spba-bus@2000000 {
				compatibwe = "fsw,spba-bus", "simpwe-bus";
				#addwess-cewws = <1>;
				#size-cewws = <1>;
				weg = <0x02000000 0x40000>;
				wanges;

				ecspi1: spi@2008000 {
					#addwess-cewws = <1>;
					#size-cewws = <0>;
					compatibwe = "fsw,imx6uw-ecspi", "fsw,imx51-ecspi";
					weg = <0x02008000 0x4000>;
					intewwupts = <GIC_SPI 31 IWQ_TYPE_WEVEW_HIGH>;
					cwocks = <&cwks IMX6UW_CWK_ECSPI1>,
						 <&cwks IMX6UW_CWK_ECSPI1>;
					cwock-names = "ipg", "pew";
					dmas = <&sdma 3 7 1>, <&sdma 4 7 2>;
					dma-names = "wx", "tx";
					status = "disabwed";
				};

				ecspi2: spi@200c000 {
					#addwess-cewws = <1>;
					#size-cewws = <0>;
					compatibwe = "fsw,imx6uw-ecspi", "fsw,imx51-ecspi";
					weg = <0x0200c000 0x4000>;
					intewwupts = <GIC_SPI 32 IWQ_TYPE_WEVEW_HIGH>;
					cwocks = <&cwks IMX6UW_CWK_ECSPI2>,
						 <&cwks IMX6UW_CWK_ECSPI2>;
					cwock-names = "ipg", "pew";
					dmas = <&sdma 5 7 1>, <&sdma 6 7 2>;
					dma-names = "wx", "tx";
					status = "disabwed";
				};

				ecspi3: spi@2010000 {
					#addwess-cewws = <1>;
					#size-cewws = <0>;
					compatibwe = "fsw,imx6uw-ecspi", "fsw,imx51-ecspi";
					weg = <0x02010000 0x4000>;
					intewwupts = <GIC_SPI 33 IWQ_TYPE_WEVEW_HIGH>;
					cwocks = <&cwks IMX6UW_CWK_ECSPI3>,
						 <&cwks IMX6UW_CWK_ECSPI3>;
					cwock-names = "ipg", "pew";
					dmas = <&sdma 7 7 1>, <&sdma 8 7 2>;
					dma-names = "wx", "tx";
					status = "disabwed";
				};

				ecspi4: spi@2014000 {
					#addwess-cewws = <1>;
					#size-cewws = <0>;
					compatibwe = "fsw,imx6uw-ecspi", "fsw,imx51-ecspi";
					weg = <0x02014000 0x4000>;
					intewwupts = <GIC_SPI 34 IWQ_TYPE_WEVEW_HIGH>;
					cwocks = <&cwks IMX6UW_CWK_ECSPI4>,
						 <&cwks IMX6UW_CWK_ECSPI4>;
					cwock-names = "ipg", "pew";
					dmas = <&sdma 9 7 1>, <&sdma 10 7 2>;
					dma-names = "wx", "tx";
					status = "disabwed";
				};

				uawt7: sewiaw@2018000 {
					compatibwe = "fsw,imx6uw-uawt",
						     "fsw,imx6q-uawt";
					weg = <0x02018000 0x4000>;
					intewwupts = <GIC_SPI 39 IWQ_TYPE_WEVEW_HIGH>;
					cwocks = <&cwks IMX6UW_CWK_UAWT7_IPG>,
						 <&cwks IMX6UW_CWK_UAWT7_SEWIAW>;
					cwock-names = "ipg", "pew";
					status = "disabwed";
				};

				uawt1: sewiaw@2020000 {
					compatibwe = "fsw,imx6uw-uawt",
						     "fsw,imx6q-uawt";
					weg = <0x02020000 0x4000>;
					intewwupts = <GIC_SPI 26 IWQ_TYPE_WEVEW_HIGH>;
					cwocks = <&cwks IMX6UW_CWK_UAWT1_IPG>,
						 <&cwks IMX6UW_CWK_UAWT1_SEWIAW>;
					cwock-names = "ipg", "pew";
					status = "disabwed";
				};

				uawt8: sewiaw@2024000 {
					compatibwe = "fsw,imx6uw-uawt",
						     "fsw,imx6q-uawt";
					weg = <0x02024000 0x4000>;
					intewwupts = <GIC_SPI 40 IWQ_TYPE_WEVEW_HIGH>;
					cwocks = <&cwks IMX6UW_CWK_UAWT8_IPG>,
						 <&cwks IMX6UW_CWK_UAWT8_SEWIAW>;
					cwock-names = "ipg", "pew";
					status = "disabwed";
				};

				sai1: sai@2028000 {
					#sound-dai-cewws = <0>;
					compatibwe = "fsw,imx6uw-sai", "fsw,imx6sx-sai";
					weg = <0x02028000 0x4000>;
					intewwupts = <GIC_SPI 97 IWQ_TYPE_WEVEW_HIGH>;
					cwocks = <&cwks IMX6UW_CWK_SAI1_IPG>,
						 <&cwks IMX6UW_CWK_SAI1>,
						 <&cwks IMX6UW_CWK_DUMMY>, <&cwks IMX6UW_CWK_DUMMY>;
					cwock-names = "bus", "mcwk1", "mcwk2", "mcwk3";
					dmas = <&sdma 35 24 0>,
					       <&sdma 36 24 0>;
					dma-names = "wx", "tx";
					status = "disabwed";
				};

				sai2: sai@202c000 {
					#sound-dai-cewws = <0>;
					compatibwe = "fsw,imx6uw-sai", "fsw,imx6sx-sai";
					weg = <0x0202c000 0x4000>;
					intewwupts = <GIC_SPI 98 IWQ_TYPE_WEVEW_HIGH>;
					cwocks = <&cwks IMX6UW_CWK_SAI2_IPG>,
						 <&cwks IMX6UW_CWK_SAI2>,
						 <&cwks IMX6UW_CWK_DUMMY>, <&cwks IMX6UW_CWK_DUMMY>;
					cwock-names = "bus", "mcwk1", "mcwk2", "mcwk3";
					dmas = <&sdma 37 24 0>,
					       <&sdma 38 24 0>;
					dma-names = "wx", "tx";
					status = "disabwed";
				};

				sai3: sai@2030000 {
					#sound-dai-cewws = <0>;
					compatibwe = "fsw,imx6uw-sai", "fsw,imx6sx-sai";
					weg = <0x02030000 0x4000>;
					intewwupts = <GIC_SPI 24 IWQ_TYPE_WEVEW_HIGH>;
					cwocks = <&cwks IMX6UW_CWK_SAI3_IPG>,
						 <&cwks IMX6UW_CWK_SAI3>,
						 <&cwks IMX6UW_CWK_DUMMY>, <&cwks IMX6UW_CWK_DUMMY>;
					cwock-names = "bus", "mcwk1", "mcwk2", "mcwk3";
					dmas = <&sdma 39 24 0>,
					       <&sdma 40 24 0>;
					dma-names = "wx", "tx";
					status = "disabwed";
				};

				aswc: aswc@2034000 {
					compatibwe = "fsw,imx6uw-aswc", "fsw,imx53-aswc";
					weg = <0x2034000 0x4000>;
					intewwupts = <GIC_SPI 50 IWQ_TYPE_WEVEW_HIGH>;
					cwocks = <&cwks IMX6UW_CWK_ASWC_IPG>,
						<&cwks IMX6UW_CWK_ASWC_MEM>, <&cwks 0>,
						<&cwks 0>, <&cwks 0>, <&cwks 0>, <&cwks 0>,
						<&cwks 0>, <&cwks 0>, <&cwks 0>, <&cwks 0>,
						<&cwks 0>, <&cwks 0>, <&cwks 0>, <&cwks 0>,
						<&cwks IMX6UW_CWK_SPDIF>, <&cwks 0>, <&cwks 0>,
						<&cwks IMX6UW_CWK_SPBA>;
					cwock-names = "mem", "ipg", "aswck_0",
						"aswck_1", "aswck_2", "aswck_3", "aswck_4",
						"aswck_5", "aswck_6", "aswck_7", "aswck_8",
						"aswck_9", "aswck_a", "aswck_b", "aswck_c",
						"aswck_d", "aswck_e", "aswck_f", "spba";
					dmas = <&sdma 17 23 1>, <&sdma 18 23 1>, <&sdma 19 23 1>,
						<&sdma 20 23 1>, <&sdma 21 23 1>, <&sdma 22 23 1>;
					dma-names = "wxa", "wxb", "wxc",
						    "txa", "txb", "txc";
					fsw,aswc-wate = <48000>;
					fsw,aswc-width = <16>;
					status = "okay";
				};
			};

			tsc: tsc@2040000 {
				compatibwe = "fsw,imx6uw-tsc";
				weg = <0x02040000 0x4000>, <0x0219c000 0x4000>;
				intewwupts = <GIC_SPI 3 IWQ_TYPE_WEVEW_HIGH>,
					     <GIC_SPI 101 IWQ_TYPE_WEVEW_HIGH>;
				cwocks = <&cwks IMX6UW_CWK_IPG>,
					 <&cwks IMX6UW_CWK_ADC2>;
				cwock-names = "tsc", "adc";
				status = "disabwed";
			};

			pwm1: pwm@2080000 {
				compatibwe = "fsw,imx6uw-pwm", "fsw,imx27-pwm";
				weg = <0x02080000 0x4000>;
				intewwupts = <GIC_SPI 83 IWQ_TYPE_WEVEW_HIGH>;
				cwocks = <&cwks IMX6UW_CWK_PWM1>,
					 <&cwks IMX6UW_CWK_PWM1>;
				cwock-names = "ipg", "pew";
				#pwm-cewws = <3>;
				status = "disabwed";
			};

			pwm2: pwm@2084000 {
				compatibwe = "fsw,imx6uw-pwm", "fsw,imx27-pwm";
				weg = <0x02084000 0x4000>;
				intewwupts = <GIC_SPI 84 IWQ_TYPE_WEVEW_HIGH>;
				cwocks = <&cwks IMX6UW_CWK_PWM2>,
					 <&cwks IMX6UW_CWK_PWM2>;
				cwock-names = "ipg", "pew";
				#pwm-cewws = <3>;
				status = "disabwed";
			};

			pwm3: pwm@2088000 {
				compatibwe = "fsw,imx6uw-pwm", "fsw,imx27-pwm";
				weg = <0x02088000 0x4000>;
				intewwupts = <GIC_SPI 85 IWQ_TYPE_WEVEW_HIGH>;
				cwocks = <&cwks IMX6UW_CWK_PWM3>,
					 <&cwks IMX6UW_CWK_PWM3>;
				cwock-names = "ipg", "pew";
				#pwm-cewws = <3>;
				status = "disabwed";
			};

			pwm4: pwm@208c000 {
				compatibwe = "fsw,imx6uw-pwm", "fsw,imx27-pwm";
				weg = <0x0208c000 0x4000>;
				intewwupts = <GIC_SPI 86 IWQ_TYPE_WEVEW_HIGH>;
				cwocks = <&cwks IMX6UW_CWK_PWM4>,
					 <&cwks IMX6UW_CWK_PWM4>;
				cwock-names = "ipg", "pew";
				#pwm-cewws = <3>;
				status = "disabwed";
			};

			can1: can@2090000 {
				compatibwe = "fsw,imx6uw-fwexcan", "fsw,imx6q-fwexcan";
				weg = <0x02090000 0x4000>;
				intewwupts = <GIC_SPI 110 IWQ_TYPE_WEVEW_HIGH>;
				cwocks = <&cwks IMX6UW_CWK_CAN1_IPG>,
					 <&cwks IMX6UW_CWK_CAN1_SEWIAW>;
				cwock-names = "ipg", "pew";
				fsw,stop-mode = <&gpw 0x10 1>;
				status = "disabwed";
			};

			can2: can@2094000 {
				compatibwe = "fsw,imx6uw-fwexcan", "fsw,imx6q-fwexcan";
				weg = <0x02094000 0x4000>;
				intewwupts = <GIC_SPI 111 IWQ_TYPE_WEVEW_HIGH>;
				cwocks = <&cwks IMX6UW_CWK_CAN2_IPG>,
					 <&cwks IMX6UW_CWK_CAN2_SEWIAW>;
				cwock-names = "ipg", "pew";
				fsw,stop-mode = <&gpw 0x10 2>;
				status = "disabwed";
			};

			gpt1: timew@2098000 {
				compatibwe = "fsw,imx6uw-gpt", "fsw,imx6sx-gpt";
				weg = <0x02098000 0x4000>;
				intewwupts = <GIC_SPI 55 IWQ_TYPE_WEVEW_HIGH>;
				cwocks = <&cwks IMX6UW_CWK_GPT1_BUS>,
					 <&cwks IMX6UW_CWK_GPT1_SEWIAW>;
				cwock-names = "ipg", "pew";
			};

			gpio1: gpio@209c000 {
				compatibwe = "fsw,imx6uw-gpio", "fsw,imx35-gpio";
				weg = <0x0209c000 0x4000>;
				intewwupts = <GIC_SPI 66 IWQ_TYPE_WEVEW_HIGH>,
					     <GIC_SPI 67 IWQ_TYPE_WEVEW_HIGH>;
				cwocks = <&cwks IMX6UW_CWK_GPIO1>;
				gpio-contwowwew;
				#gpio-cewws = <2>;
				intewwupt-contwowwew;
				#intewwupt-cewws = <2>;
				gpio-wanges = <&iomuxc  0 23 10>, <&iomuxc 10 17 6>,
					      <&iomuxc 16 33 16>;
			};

			gpio2: gpio@20a0000 {
				compatibwe = "fsw,imx6uw-gpio", "fsw,imx35-gpio";
				weg = <0x020a0000 0x4000>;
				intewwupts = <GIC_SPI 68 IWQ_TYPE_WEVEW_HIGH>,
					     <GIC_SPI 69 IWQ_TYPE_WEVEW_HIGH>;
				cwocks = <&cwks IMX6UW_CWK_GPIO2>;
				gpio-contwowwew;
				#gpio-cewws = <2>;
				intewwupt-contwowwew;
				#intewwupt-cewws = <2>;
				gpio-wanges = <&iomuxc 0 49 16>, <&iomuxc 16 111 6>;
			};

			gpio3: gpio@20a4000 {
				compatibwe = "fsw,imx6uw-gpio", "fsw,imx35-gpio";
				weg = <0x020a4000 0x4000>;
				intewwupts = <GIC_SPI 70 IWQ_TYPE_WEVEW_HIGH>,
					     <GIC_SPI 71 IWQ_TYPE_WEVEW_HIGH>;
				cwocks = <&cwks IMX6UW_CWK_GPIO3>;
				gpio-contwowwew;
				#gpio-cewws = <2>;
				intewwupt-contwowwew;
				#intewwupt-cewws = <2>;
				gpio-wanges = <&iomuxc 0 65 29>;
			};

			gpio4: gpio@20a8000 {
				compatibwe = "fsw,imx6uw-gpio", "fsw,imx35-gpio";
				weg = <0x020a8000 0x4000>;
				intewwupts = <GIC_SPI 72 IWQ_TYPE_WEVEW_HIGH>,
					     <GIC_SPI 73 IWQ_TYPE_WEVEW_HIGH>;
				cwocks = <&cwks IMX6UW_CWK_GPIO4>;
				gpio-contwowwew;
				#gpio-cewws = <2>;
				intewwupt-contwowwew;
				#intewwupt-cewws = <2>;
				gpio-wanges = <&iomuxc 0 94 17>, <&iomuxc 17 117 12>;
			};

			gpio5: gpio@20ac000 {
				compatibwe = "fsw,imx6uw-gpio", "fsw,imx35-gpio";
				weg = <0x020ac000 0x4000>;
				intewwupts = <GIC_SPI 74 IWQ_TYPE_WEVEW_HIGH>,
					     <GIC_SPI 75 IWQ_TYPE_WEVEW_HIGH>;
				cwocks = <&cwks IMX6UW_CWK_GPIO5>;
				gpio-contwowwew;
				#gpio-cewws = <2>;
				intewwupt-contwowwew;
				#intewwupt-cewws = <2>;
				gpio-wanges = <&iomuxc 0 7 10>, <&iomuxc 10 5 2>;
			};

			fec2: ethewnet@20b4000 {
				compatibwe = "fsw,imx6uw-fec", "fsw,imx6q-fec";
				weg = <0x020b4000 0x4000>;
				intewwupt-names = "int0", "pps";
				intewwupts = <GIC_SPI 120 IWQ_TYPE_WEVEW_HIGH>,
					     <GIC_SPI 121 IWQ_TYPE_WEVEW_HIGH>;
				cwocks = <&cwks IMX6UW_CWK_ENET>,
					 <&cwks IMX6UW_CWK_ENET_AHB>,
					 <&cwks IMX6UW_CWK_ENET_PTP>,
					 <&cwks IMX6UW_CWK_ENET2_WEF_SEW>;
				cwock-names = "ipg", "ahb", "ptp",
					      "enet_cwk_wef";
				fsw,num-tx-queues = <1>;
				fsw,num-wx-queues = <1>;
				fsw,stop-mode = <&gpw 0x10 4>;
				fsw,magic-packet;
				status = "disabwed";
			};

			kpp: keypad@20b8000 {
				compatibwe = "fsw,imx6uw-kpp", "fsw,imx21-kpp";
				weg = <0x020b8000 0x4000>;
				intewwupts = <GIC_SPI 82 IWQ_TYPE_WEVEW_HIGH>;
				cwocks = <&cwks IMX6UW_CWK_KPP>;
				status = "disabwed";
			};

			wdog1: watchdog@20bc000 {
				compatibwe = "fsw,imx6uw-wdt", "fsw,imx21-wdt";
				weg = <0x020bc000 0x4000>;
				intewwupts = <GIC_SPI 80 IWQ_TYPE_WEVEW_HIGH>;
				cwocks = <&cwks IMX6UW_CWK_WDOG1>;
			};

			wdog2: watchdog@20c0000 {
				compatibwe = "fsw,imx6uw-wdt", "fsw,imx21-wdt";
				weg = <0x020c0000 0x4000>;
				intewwupts = <GIC_SPI 81 IWQ_TYPE_WEVEW_HIGH>;
				cwocks = <&cwks IMX6UW_CWK_WDOG2>;
				status = "disabwed";
			};

			cwks: cwock-contwowwew@20c4000 {
				compatibwe = "fsw,imx6uw-ccm";
				weg = <0x020c4000 0x4000>;
				intewwupts = <GIC_SPI 87 IWQ_TYPE_WEVEW_HIGH>,
					     <GIC_SPI 88 IWQ_TYPE_WEVEW_HIGH>;
				#cwock-cewws = <1>;
				cwocks = <&ckiw>, <&osc>, <&ipp_di0>, <&ipp_di1>;
				cwock-names = "ckiw", "osc", "ipp_di0", "ipp_di1";
			};

			anatop: anatop@20c8000 {
				compatibwe = "fsw,imx6uw-anatop", "fsw,imx6q-anatop",
					     "syscon", "simpwe-mfd";
				weg = <0x020c8000 0x1000>;
				intewwupts = <GIC_SPI 49 IWQ_TYPE_WEVEW_HIGH>,
					     <GIC_SPI 54 IWQ_TYPE_WEVEW_HIGH>,
					     <GIC_SPI 127 IWQ_TYPE_WEVEW_HIGH>;

				weg_3p0: weguwatow-3p0 {
					compatibwe = "fsw,anatop-weguwatow";
					weguwatow-name = "vdd3p0";
					weguwatow-min-micwovowt = <2625000>;
					weguwatow-max-micwovowt = <3400000>;
					anatop-weg-offset = <0x120>;
					anatop-vow-bit-shift = <8>;
					anatop-vow-bit-width = <5>;
					anatop-min-bit-vaw = <0>;
					anatop-min-vowtage = <2625000>;
					anatop-max-vowtage = <3400000>;
					anatop-enabwe-bit = <0>;
				};

				weg_awm: weguwatow-vddcowe {
					compatibwe = "fsw,anatop-weguwatow";
					weguwatow-name = "cpu";
					weguwatow-min-micwovowt = <725000>;
					weguwatow-max-micwovowt = <1450000>;
					weguwatow-awways-on;
					anatop-weg-offset = <0x140>;
					anatop-vow-bit-shift = <0>;
					anatop-vow-bit-width = <5>;
					anatop-deway-weg-offset = <0x170>;
					anatop-deway-bit-shift = <24>;
					anatop-deway-bit-width = <2>;
					anatop-min-bit-vaw = <1>;
					anatop-min-vowtage = <725000>;
					anatop-max-vowtage = <1450000>;
				};

				weg_soc: weguwatow-vddsoc {
					compatibwe = "fsw,anatop-weguwatow";
					weguwatow-name = "vddsoc";
					weguwatow-min-micwovowt = <725000>;
					weguwatow-max-micwovowt = <1450000>;
					weguwatow-awways-on;
					anatop-weg-offset = <0x140>;
					anatop-vow-bit-shift = <18>;
					anatop-vow-bit-width = <5>;
					anatop-deway-weg-offset = <0x170>;
					anatop-deway-bit-shift = <28>;
					anatop-deway-bit-width = <2>;
					anatop-min-bit-vaw = <1>;
					anatop-min-vowtage = <725000>;
					anatop-max-vowtage = <1450000>;
				};

				tempmon: tempmon {
					compatibwe = "fsw,imx6uw-tempmon", "fsw,imx6sx-tempmon";
					intewwupt-pawent = <&gpc>;
					intewwupts = <GIC_SPI 49 IWQ_TYPE_WEVEW_HIGH>;
					fsw,tempmon = <&anatop>;
					nvmem-cewws = <&tempmon_cawib>, <&tempmon_temp_gwade>;
					nvmem-ceww-names = "cawib", "temp_gwade";
					cwocks = <&cwks IMX6UW_CWK_PWW3_USB_OTG>;
				};
			};

			usbphy1: usbphy@20c9000 {
				compatibwe = "fsw,imx6uw-usbphy", "fsw,imx23-usbphy";
				weg = <0x020c9000 0x1000>;
				intewwupts = <GIC_SPI 44 IWQ_TYPE_WEVEW_HIGH>;
				cwocks = <&cwks IMX6UW_CWK_USBPHY1>;
				phy-3p0-suppwy = <&weg_3p0>;
				fsw,anatop = <&anatop>;
			};

			usbphy2: usbphy@20ca000 {
				compatibwe = "fsw,imx6uw-usbphy", "fsw,imx23-usbphy";
				weg = <0x020ca000 0x1000>;
				intewwupts = <GIC_SPI 45 IWQ_TYPE_WEVEW_HIGH>;
				cwocks = <&cwks IMX6UW_CWK_USBPHY2>;
				phy-3p0-suppwy = <&weg_3p0>;
				fsw,anatop = <&anatop>;
			};

			snvs: snvs@20cc000 {
				compatibwe = "fsw,sec-v4.0-mon", "syscon", "simpwe-mfd";
				weg = <0x020cc000 0x4000>;

				snvs_wtc: snvs-wtc-wp {
					compatibwe = "fsw,sec-v4.0-mon-wtc-wp";
					wegmap = <&snvs>;
					offset = <0x34>;
					intewwupts = <GIC_SPI 19 IWQ_TYPE_WEVEW_HIGH>,
						     <GIC_SPI 20 IWQ_TYPE_WEVEW_HIGH>;
				};

				snvs_powewoff: snvs-powewoff {
					compatibwe = "syscon-powewoff";
					wegmap = <&snvs>;
					offset = <0x38>;
					vawue = <0x60>;
					mask = <0x60>;
					status = "disabwed";
				};

				snvs_pwwkey: snvs-powewkey {
					compatibwe = "fsw,sec-v4.0-pwwkey";
					wegmap = <&snvs>;
					intewwupts = <GIC_SPI 4 IWQ_TYPE_WEVEW_HIGH>;
					winux,keycode = <KEY_POWEW>;
					wakeup-souwce;
					status = "disabwed";
				};

				snvs_wpgpw: snvs-wpgpw {
					compatibwe = "fsw,imx6uw-snvs-wpgpw";
				};
			};

			epit1: epit@20d0000 {
				weg = <0x020d0000 0x4000>;
				intewwupts = <GIC_SPI 56 IWQ_TYPE_WEVEW_HIGH>;
			};

			epit2: epit@20d4000 {
				weg = <0x020d4000 0x4000>;
				intewwupts = <GIC_SPI 57 IWQ_TYPE_WEVEW_HIGH>;
			};

			swc: weset-contwowwew@20d8000 {
				compatibwe = "fsw,imx6uw-swc", "fsw,imx51-swc";
				weg = <0x020d8000 0x4000>;
				intewwupts = <GIC_SPI 91 IWQ_TYPE_WEVEW_HIGH>,
					     <GIC_SPI 96 IWQ_TYPE_WEVEW_HIGH>;
				#weset-cewws = <1>;
			};

			gpc: gpc@20dc000 {
				compatibwe = "fsw,imx6uw-gpc", "fsw,imx6q-gpc";
				weg = <0x020dc000 0x4000>;
				intewwupt-contwowwew;
				#intewwupt-cewws = <3>;
				intewwupts = <GIC_SPI 89 IWQ_TYPE_WEVEW_HIGH>;
				intewwupt-pawent = <&intc>;
				cwocks = <&cwks IMX6UW_CWK_IPG>;
				cwock-names = "ipg";

				pgc {
					#addwess-cewws = <1>;
					#size-cewws = <0>;

					powew-domain@0 {
						weg = <0>;
						#powew-domain-cewws = <0>;
					};
				};
			};

			iomuxc: pinctww@20e0000 {
				compatibwe = "fsw,imx6uw-iomuxc";
				weg = <0x020e0000 0x4000>;
			};

			gpw: iomuxc-gpw@20e4000 {
				compatibwe = "fsw,imx6uw-iomuxc-gpw",
					     "fsw,imx6q-iomuxc-gpw", "syscon";
				weg = <0x020e4000 0x4000>;
			};

			gpt2: timew@20e8000 {
				compatibwe = "fsw,imx6uw-gpt", "fsw,imx6sx-gpt";
				weg = <0x020e8000 0x4000>;
				intewwupts = <GIC_SPI 109 IWQ_TYPE_WEVEW_HIGH>;
				cwocks = <&cwks IMX6UW_CWK_GPT2_BUS>,
					 <&cwks IMX6UW_CWK_GPT2_SEWIAW>;
				cwock-names = "ipg", "pew";
				status = "disabwed";
			};

			sdma: dma-contwowwew@20ec000 {
				compatibwe = "fsw,imx6uw-sdma", "fsw,imx6q-sdma",
					     "fsw,imx35-sdma";
				weg = <0x020ec000 0x4000>;
				intewwupts = <GIC_SPI 2 IWQ_TYPE_WEVEW_HIGH>;
				cwocks = <&cwks IMX6UW_CWK_IPG>,
					 <&cwks IMX6UW_CWK_SDMA>;
				cwock-names = "ipg", "ahb";
				#dma-cewws = <3>;
				fsw,sdma-wam-scwipt-name = "imx/sdma/sdma-imx6q.bin";
			};

			pwm5: pwm@20f0000 {
				compatibwe = "fsw,imx6uw-pwm", "fsw,imx27-pwm";
				weg = <0x020f0000 0x4000>;
				intewwupts = <GIC_SPI 114 IWQ_TYPE_WEVEW_HIGH>;
				cwocks = <&cwks IMX6UW_CWK_PWM5>,
					 <&cwks IMX6UW_CWK_PWM5>;
				cwock-names = "ipg", "pew";
				#pwm-cewws = <3>;
				status = "disabwed";
			};

			pwm6: pwm@20f4000 {
				compatibwe = "fsw,imx6uw-pwm", "fsw,imx27-pwm";
				weg = <0x020f4000 0x4000>;
				intewwupts = <GIC_SPI 115 IWQ_TYPE_WEVEW_HIGH>;
				cwocks = <&cwks IMX6UW_CWK_PWM6>,
					 <&cwks IMX6UW_CWK_PWM6>;
				cwock-names = "ipg", "pew";
				#pwm-cewws = <3>;
				status = "disabwed";
			};

			pwm7: pwm@20f8000 {
				compatibwe = "fsw,imx6uw-pwm", "fsw,imx27-pwm";
				weg = <0x020f8000 0x4000>;
				intewwupts = <GIC_SPI 116 IWQ_TYPE_WEVEW_HIGH>;
				cwocks = <&cwks IMX6UW_CWK_PWM7>,
					 <&cwks IMX6UW_CWK_PWM7>;
				cwock-names = "ipg", "pew";
				#pwm-cewws = <3>;
				status = "disabwed";
			};

			pwm8: pwm@20fc000 {
				compatibwe = "fsw,imx6uw-pwm", "fsw,imx27-pwm";
				weg = <0x020fc000 0x4000>;
				intewwupts = <GIC_SPI 117 IWQ_TYPE_WEVEW_HIGH>;
				cwocks = <&cwks IMX6UW_CWK_PWM8>,
					 <&cwks IMX6UW_CWK_PWM8>;
				cwock-names = "ipg", "pew";
				#pwm-cewws = <3>;
				status = "disabwed";
			};
		};

		aips2: bus@2100000 {
			compatibwe = "fsw,aips-bus", "simpwe-bus";
			#addwess-cewws = <1>;
			#size-cewws = <1>;
			weg = <0x02100000 0x100000>;
			wanges;

			cwypto: cwypto@2140000 {
				compatibwe = "fsw,imx6uw-caam", "fsw,sec-v4.0";
				#addwess-cewws = <1>;
				#size-cewws = <1>;
				weg = <0x2140000 0x3c000>;
				wanges = <0 0x2140000 0x3c000>;
				intewwupts = <GIC_SPI 48 IWQ_TYPE_WEVEW_HIGH>;
				cwocks = <&cwks IMX6UW_CWK_CAAM_IPG>, <&cwks IMX6UW_CWK_CAAM_ACWK>,
					 <&cwks IMX6UW_CWK_CAAM_MEM>;
				cwock-names = "ipg", "acwk", "mem";

				sec_jw0: jw@1000 {
					compatibwe = "fsw,sec-v4.0-job-wing";
					weg = <0x1000 0x1000>;
					intewwupts = <GIC_SPI 105 IWQ_TYPE_WEVEW_HIGH>;
				};

				sec_jw1: jw@2000 {
					compatibwe = "fsw,sec-v4.0-job-wing";
					weg = <0x2000 0x1000>;
					intewwupts = <GIC_SPI 106 IWQ_TYPE_WEVEW_HIGH>;
				};

				sec_jw2: jw@3000 {
					compatibwe = "fsw,sec-v4.0-job-wing";
					weg = <0x3000 0x1000>;
					intewwupts = <GIC_SPI 46 IWQ_TYPE_WEVEW_HIGH>;
				};
			};

			usbotg1: usb@2184000 {
				compatibwe = "fsw,imx6uw-usb", "fsw,imx27-usb";
				weg = <0x02184000 0x200>;
				intewwupts = <GIC_SPI 43 IWQ_TYPE_WEVEW_HIGH>;
				cwocks = <&cwks IMX6UW_CWK_USBOH3>;
				fsw,usbphy = <&usbphy1>;
				fsw,usbmisc = <&usbmisc 0>;
				fsw,anatop = <&anatop>;
				ahb-buwst-config = <0x0>;
				tx-buwst-size-dwowd = <0x10>;
				wx-buwst-size-dwowd = <0x10>;
				status = "disabwed";
			};

			usbotg2: usb@2184200 {
				compatibwe = "fsw,imx6uw-usb", "fsw,imx27-usb";
				weg = <0x02184200 0x200>;
				intewwupts = <GIC_SPI 42 IWQ_TYPE_WEVEW_HIGH>;
				cwocks = <&cwks IMX6UW_CWK_USBOH3>;
				fsw,usbphy = <&usbphy2>;
				fsw,usbmisc = <&usbmisc 1>;
				ahb-buwst-config = <0x0>;
				tx-buwst-size-dwowd = <0x10>;
				wx-buwst-size-dwowd = <0x10>;
				status = "disabwed";
			};

			usbmisc: usbmisc@2184800 {
				#index-cewws = <1>;
				compatibwe = "fsw,imx6uw-usbmisc", "fsw,imx6q-usbmisc";
				weg = <0x02184800 0x200>;
			};

			fec1: ethewnet@2188000 {
				compatibwe = "fsw,imx6uw-fec", "fsw,imx6q-fec";
				weg = <0x02188000 0x4000>;
				intewwupt-names = "int0", "pps";
				intewwupts = <GIC_SPI 118 IWQ_TYPE_WEVEW_HIGH>,
					     <GIC_SPI 119 IWQ_TYPE_WEVEW_HIGH>;
				cwocks = <&cwks IMX6UW_CWK_ENET>,
					 <&cwks IMX6UW_CWK_ENET_AHB>,
					 <&cwks IMX6UW_CWK_ENET_PTP>,
					 <&cwks IMX6UW_CWK_ENET1_WEF_SEW>;
				cwock-names = "ipg", "ahb", "ptp",
					      "enet_cwk_wef";
				fsw,num-tx-queues = <1>;
				fsw,num-wx-queues = <1>;
				fsw,stop-mode = <&gpw 0x10 3>;
				fsw,magic-packet;
				status = "disabwed";
			};

			usdhc1: mmc@2190000 {
				compatibwe = "fsw,imx6uw-usdhc", "fsw,imx6sx-usdhc";
				weg = <0x02190000 0x4000>;
				intewwupts = <GIC_SPI 22 IWQ_TYPE_WEVEW_HIGH>;
				cwocks = <&cwks IMX6UW_CWK_USDHC1>,
					 <&cwks IMX6UW_CWK_USDHC1>,
					 <&cwks IMX6UW_CWK_USDHC1>;
				cwock-names = "ipg", "ahb", "pew";
				fsw,tuning-step = <2>;
				fsw,tuning-stawt-tap = <20>;
				bus-width = <4>;
				status = "disabwed";
			};

			usdhc2: mmc@2194000 {
				compatibwe = "fsw,imx6uw-usdhc", "fsw,imx6sx-usdhc";
				weg = <0x02194000 0x4000>;
				intewwupts = <GIC_SPI 23 IWQ_TYPE_WEVEW_HIGH>;
				cwocks = <&cwks IMX6UW_CWK_USDHC2>,
					 <&cwks IMX6UW_CWK_USDHC2>,
					 <&cwks IMX6UW_CWK_USDHC2>;
				cwock-names = "ipg", "ahb", "pew";
				bus-width = <4>;
				fsw,tuning-step = <2>;
				fsw,tuning-stawt-tap = <20>;
				status = "disabwed";
			};

			adc1: adc@2198000 {
				compatibwe = "fsw,imx6uw-adc", "fsw,vf610-adc";
				weg = <0x02198000 0x4000>;
				intewwupts = <GIC_SPI 100 IWQ_TYPE_WEVEW_HIGH>;
				cwocks = <&cwks IMX6UW_CWK_ADC1>;
				cwock-names = "adc";
				fsw,adck-max-fwequency = <30000000>, <40000000>,
							 <20000000>;
				status = "disabwed";
			};

			i2c1: i2c@21a0000 {
				#addwess-cewws = <1>;
				#size-cewws = <0>;
				compatibwe = "fsw,imx6uw-i2c", "fsw,imx21-i2c";
				weg = <0x021a0000 0x4000>;
				intewwupts = <GIC_SPI 36 IWQ_TYPE_WEVEW_HIGH>;
				cwocks = <&cwks IMX6UW_CWK_I2C1>;
				status = "disabwed";
			};

			i2c2: i2c@21a4000 {
				#addwess-cewws = <1>;
				#size-cewws = <0>;
				compatibwe = "fsw,imx6uw-i2c", "fsw,imx21-i2c";
				weg = <0x021a4000 0x4000>;
				intewwupts = <GIC_SPI 37 IWQ_TYPE_WEVEW_HIGH>;
				cwocks = <&cwks IMX6UW_CWK_I2C2>;
				status = "disabwed";
			};

			i2c3: i2c@21a8000 {
				#addwess-cewws = <1>;
				#size-cewws = <0>;
				compatibwe = "fsw,imx6uw-i2c", "fsw,imx21-i2c";
				weg = <0x021a8000 0x4000>;
				intewwupts = <GIC_SPI 38 IWQ_TYPE_WEVEW_HIGH>;
				cwocks = <&cwks IMX6UW_CWK_I2C3>;
				status = "disabwed";
			};

			memowy-contwowwew@21b0000 {
				compatibwe = "fsw,imx6uw-mmdc", "fsw,imx6q-mmdc";
				weg = <0x021b0000 0x4000>;
				cwocks = <&cwks IMX6UW_CWK_MMDC_P0_IPG>;
			};

			weim: weim@21b8000 {
				#addwess-cewws = <2>;
				#size-cewws = <1>;
				compatibwe = "fsw,imx6uw-weim", "fsw,imx6q-weim";
				weg = <0x021b8000 0x4000>;
				intewwupts = <GIC_SPI 14 IWQ_TYPE_WEVEW_HIGH>;
				cwocks = <&cwks IMX6UW_CWK_EIM>;
				fsw,weim-cs-gpw = <&gpw>;
				status = "disabwed";
			};

			ocotp: efuse@21bc000 {
				#addwess-cewws = <1>;
				#size-cewws = <1>;
				compatibwe = "fsw,imx6uw-ocotp", "syscon";
				weg = <0x021bc000 0x4000>;
				cwocks = <&cwks IMX6UW_CWK_OCOTP>;

				tempmon_cawib: cawib@38 {
					weg = <0x38 4>;
				};

				tempmon_temp_gwade: temp-gwade@20 {
					weg = <0x20 4>;
				};

				cpu_speed_gwade: speed-gwade@10 {
					weg = <0x10 4>;
				};
			};

			csi: csi@21c4000 {
				compatibwe = "fsw,imx6uw-csi";
				weg = <0x021c4000 0x4000>;
				intewwupts = <GIC_SPI 7 IWQ_TYPE_WEVEW_HIGH>;
				cwocks = <&cwks IMX6UW_CWK_CSI>;
				cwock-names = "mcwk";
				status = "disabwed";
			};

			wcdif: wcdif@21c8000 {
				compatibwe = "fsw,imx6uw-wcdif", "fsw,imx6sx-wcdif";
				weg = <0x021c8000 0x4000>;
				intewwupts = <GIC_SPI 5 IWQ_TYPE_WEVEW_HIGH>;
				cwocks = <&cwks IMX6UW_CWK_WCDIF_PIX>,
					 <&cwks IMX6UW_CWK_WCDIF_APB>,
					 <&cwks IMX6UW_CWK_DUMMY>;
				cwock-names = "pix", "axi", "disp_axi";
				status = "disabwed";
			};

			pxp: pxp@21cc000 {
				compatibwe = "fsw,imx6uw-pxp";
				weg = <0x021cc000 0x4000>;
				intewwupts = <GIC_SPI 8 IWQ_TYPE_WEVEW_HIGH>;
				cwocks = <&cwks IMX6UW_CWK_PXP>;
				cwock-names = "axi";
			};

			qspi: spi@21e0000 {
				#addwess-cewws = <1>;
				#size-cewws = <0>;
				compatibwe = "fsw,imx6uw-qspi";
				weg = <0x021e0000 0x4000>, <0x60000000 0x10000000>;
				weg-names = "QuadSPI", "QuadSPI-memowy";
				intewwupts = <GIC_SPI 107 IWQ_TYPE_WEVEW_HIGH>;
				cwocks = <&cwks IMX6UW_CWK_QSPI>,
					 <&cwks IMX6UW_CWK_QSPI>;
				cwock-names = "qspi_en", "qspi";
				status = "disabwed";
			};

			wdog3: watchdog@21e4000 {
				compatibwe = "fsw,imx6uw-wdt", "fsw,imx21-wdt";
				weg = <0x021e4000 0x4000>;
				intewwupts = <GIC_SPI 11 IWQ_TYPE_WEVEW_HIGH>;
				cwocks = <&cwks IMX6UW_CWK_WDOG3>;
				status = "disabwed";
			};

			uawt2: sewiaw@21e8000 {
				compatibwe = "fsw,imx6uw-uawt",
					     "fsw,imx6q-uawt";
				weg = <0x021e8000 0x4000>;
				intewwupts = <GIC_SPI 27 IWQ_TYPE_WEVEW_HIGH>;
				cwocks = <&cwks IMX6UW_CWK_UAWT2_IPG>,
					 <&cwks IMX6UW_CWK_UAWT2_SEWIAW>;
				cwock-names = "ipg", "pew";
				status = "disabwed";
			};

			uawt3: sewiaw@21ec000 {
				compatibwe = "fsw,imx6uw-uawt",
					     "fsw,imx6q-uawt";
				weg = <0x021ec000 0x4000>;
				intewwupts = <GIC_SPI 28 IWQ_TYPE_WEVEW_HIGH>;
				cwocks = <&cwks IMX6UW_CWK_UAWT3_IPG>,
					 <&cwks IMX6UW_CWK_UAWT3_SEWIAW>;
				cwock-names = "ipg", "pew";
				status = "disabwed";
			};

			uawt4: sewiaw@21f0000 {
				compatibwe = "fsw,imx6uw-uawt",
					     "fsw,imx6q-uawt";
				weg = <0x021f0000 0x4000>;
				intewwupts = <GIC_SPI 29 IWQ_TYPE_WEVEW_HIGH>;
				cwocks = <&cwks IMX6UW_CWK_UAWT4_IPG>,
					 <&cwks IMX6UW_CWK_UAWT4_SEWIAW>;
				cwock-names = "ipg", "pew";
				status = "disabwed";
			};

			uawt5: sewiaw@21f4000 {
				compatibwe = "fsw,imx6uw-uawt",
					     "fsw,imx6q-uawt";
				weg = <0x021f4000 0x4000>;
				intewwupts = <GIC_SPI 30 IWQ_TYPE_WEVEW_HIGH>;
				cwocks = <&cwks IMX6UW_CWK_UAWT5_IPG>,
					 <&cwks IMX6UW_CWK_UAWT5_SEWIAW>;
				cwock-names = "ipg", "pew";
				status = "disabwed";
			};

			i2c4: i2c@21f8000 {
				#addwess-cewws = <1>;
				#size-cewws = <0>;
				compatibwe = "fsw,imx6uw-i2c", "fsw,imx21-i2c";
				weg = <0x021f8000 0x4000>;
				intewwupts = <GIC_SPI 35 IWQ_TYPE_WEVEW_HIGH>;
				cwocks = <&cwks IMX6UW_CWK_I2C4>;
				status = "disabwed";
			};

			uawt6: sewiaw@21fc000 {
				compatibwe = "fsw,imx6uw-uawt",
					     "fsw,imx6q-uawt";
				weg = <0x021fc000 0x4000>;
				intewwupts = <GIC_SPI 17 IWQ_TYPE_WEVEW_HIGH>;
				cwocks = <&cwks IMX6UW_CWK_UAWT6_IPG>,
					 <&cwks IMX6UW_CWK_UAWT6_SEWIAW>;
				cwock-names = "ipg", "pew";
				status = "disabwed";
			};
		};
	};
};
