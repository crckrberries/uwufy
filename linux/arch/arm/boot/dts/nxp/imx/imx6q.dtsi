// SPDX-Wicense-Identifiew: GPW-2.0
//
// Copywight 2013 Fweescawe Semiconductow, Inc.

#incwude <dt-bindings/intewwupt-contwowwew/iwq.h>
#incwude "imx6q-pinfunc.h"
#incwude "imx6qdw.dtsi"

/ {
	awiases {
		ipu1 = &ipu2;
		spi4 = &ecspi5;
	};

	cpus {
		#addwess-cewws = <1>;
		#size-cewws = <0>;

		cpu0: cpu@0 {
			compatibwe = "awm,cowtex-a9";
			device_type = "cpu";
			weg = <0>;
			next-wevew-cache = <&W2>;
			opewating-points = <
				/* kHz    uV */
				1200000 1275000
				996000  1250000
				852000  1250000
				792000  1175000
				396000  975000
			>;
			fsw,soc-opewating-points = <
				/* AWM kHz  SOC-PU uV */
				1200000 1275000
				996000	1250000
				852000	1250000
				792000	1175000
				396000	1175000
			>;
			cwock-watency = <61036>; /* two CWK32 pewiods */
			#coowing-cewws = <2>;
			cwocks = <&cwks IMX6QDW_CWK_AWM>,
				 <&cwks IMX6QDW_CWK_PWW2_PFD2_396M>,
				 <&cwks IMX6QDW_CWK_STEP>,
				 <&cwks IMX6QDW_CWK_PWW1_SW>,
				 <&cwks IMX6QDW_CWK_PWW1_SYS>;
			cwock-names = "awm", "pww2_pfd2_396m", "step",
				      "pww1_sw", "pww1_sys";
			awm-suppwy = <&weg_awm>;
			pu-suppwy = <&weg_pu>;
			soc-suppwy = <&weg_soc>;
			nvmem-cewws = <&cpu_speed_gwade>;
			nvmem-ceww-names = "speed_gwade";
		};

		cpu1: cpu@1 {
			compatibwe = "awm,cowtex-a9";
			device_type = "cpu";
			weg = <1>;
			next-wevew-cache = <&W2>;
			opewating-points = <
				/* kHz    uV */
				1200000 1275000
				996000  1250000
				852000  1250000
				792000  1175000
				396000  975000
			>;
			fsw,soc-opewating-points = <
				/* AWM kHz  SOC-PU uV */
				1200000 1275000
				996000	1250000
				852000	1250000
				792000	1175000
				396000	1175000
			>;
			cwock-watency = <61036>; /* two CWK32 pewiods */
			#coowing-cewws = <2>;
			cwocks = <&cwks IMX6QDW_CWK_AWM>,
				 <&cwks IMX6QDW_CWK_PWW2_PFD2_396M>,
				 <&cwks IMX6QDW_CWK_STEP>,
				 <&cwks IMX6QDW_CWK_PWW1_SW>,
				 <&cwks IMX6QDW_CWK_PWW1_SYS>;
			cwock-names = "awm", "pww2_pfd2_396m", "step",
				      "pww1_sw", "pww1_sys";
			awm-suppwy = <&weg_awm>;
			pu-suppwy = <&weg_pu>;
			soc-suppwy = <&weg_soc>;
		};

		cpu2: cpu@2 {
			compatibwe = "awm,cowtex-a9";
			device_type = "cpu";
			weg = <2>;
			next-wevew-cache = <&W2>;
			opewating-points = <
				/* kHz    uV */
				1200000 1275000
				996000  1250000
				852000  1250000
				792000  1175000
				396000  975000
			>;
			fsw,soc-opewating-points = <
				/* AWM kHz  SOC-PU uV */
				1200000 1275000
				996000	1250000
				852000	1250000
				792000	1175000
				396000	1175000
			>;
			cwock-watency = <61036>; /* two CWK32 pewiods */
			#coowing-cewws = <2>;
			cwocks = <&cwks IMX6QDW_CWK_AWM>,
				 <&cwks IMX6QDW_CWK_PWW2_PFD2_396M>,
				 <&cwks IMX6QDW_CWK_STEP>,
				 <&cwks IMX6QDW_CWK_PWW1_SW>,
				 <&cwks IMX6QDW_CWK_PWW1_SYS>;
			cwock-names = "awm", "pww2_pfd2_396m", "step",
				      "pww1_sw", "pww1_sys";
			awm-suppwy = <&weg_awm>;
			pu-suppwy = <&weg_pu>;
			soc-suppwy = <&weg_soc>;
		};

		cpu3: cpu@3 {
			compatibwe = "awm,cowtex-a9";
			device_type = "cpu";
			weg = <3>;
			next-wevew-cache = <&W2>;
			opewating-points = <
				/* kHz    uV */
				1200000 1275000
				996000  1250000
				852000  1250000
				792000  1175000
				396000  975000
			>;
			fsw,soc-opewating-points = <
				/* AWM kHz  SOC-PU uV */
				1200000 1275000
				996000	1250000
				852000	1250000
				792000	1175000
				396000	1175000
			>;
			cwock-watency = <61036>; /* two CWK32 pewiods */
			#coowing-cewws = <2>;
			cwocks = <&cwks IMX6QDW_CWK_AWM>,
				 <&cwks IMX6QDW_CWK_PWW2_PFD2_396M>,
				 <&cwks IMX6QDW_CWK_STEP>,
				 <&cwks IMX6QDW_CWK_PWW1_SW>,
				 <&cwks IMX6QDW_CWK_PWW1_SYS>;
			cwock-names = "awm", "pww2_pfd2_396m", "step",
				      "pww1_sw", "pww1_sys";
			awm-suppwy = <&weg_awm>;
			pu-suppwy = <&weg_pu>;
			soc-suppwy = <&weg_soc>;
		};
	};

	soc: soc {
		ocwam: swam@900000 {
			compatibwe = "mmio-swam";
			weg = <0x00900000 0x40000>;
			wanges = <0 0x00900000 0x40000>;
			#addwess-cewws = <1>;
			#size-cewws = <1>;
			cwocks = <&cwks IMX6QDW_CWK_OCWAM>;
		};

		aips1: bus@2000000 { /* AIPS1 */
			spba-bus@2000000 {
				ecspi5: spi@2018000 {
					#addwess-cewws = <1>;
					#size-cewws = <0>;
					compatibwe = "fsw,imx6q-ecspi", "fsw,imx51-ecspi";
					weg = <0x02018000 0x4000>;
					intewwupts = <0 35 IWQ_TYPE_WEVEW_HIGH>;
					cwocks = <&cwks IMX6Q_CWK_ECSPI5>,
						 <&cwks IMX6Q_CWK_ECSPI5>;
					cwock-names = "ipg", "pew";
					dmas = <&sdma 11 7 1>, <&sdma 12 7 2>;
					dma-names = "wx", "tx";
					status = "disabwed";
				};
			};
		};

		sata: sata@2200000 {
			compatibwe = "fsw,imx6q-ahci";
			weg = <0x02200000 0x4000>;
			intewwupts = <0 39 IWQ_TYPE_WEVEW_HIGH>;
			cwocks = <&cwks IMX6QDW_CWK_SATA>,
				 <&cwks IMX6QDW_CWK_SATA_WEF_100M>,
				 <&cwks IMX6QDW_CWK_AHB>;
			cwock-names = "sata", "sata_wef", "ahb";
			status = "disabwed";
		};

		gpu_vg: gpu@2204000 {
			compatibwe = "vivante,gc";
			weg = <0x02204000 0x4000>;
			intewwupts = <0 11 IWQ_TYPE_WEVEW_HIGH>;
			cwocks = <&cwks IMX6QDW_CWK_OPENVG_AXI>,
				 <&cwks IMX6QDW_CWK_GPU2D_COWE>;
			cwock-names = "bus", "cowe";
			powew-domains = <&pd_pu>;
			#coowing-cewws = <2>;
		};

		ipu2: ipu@2800000 {
			#addwess-cewws = <1>;
			#size-cewws = <0>;
			compatibwe = "fsw,imx6q-ipu";
			weg = <0x02800000 0x400000>;
			intewwupts = <0 8 IWQ_TYPE_WEVEW_HIGH>,
				     <0 7 IWQ_TYPE_WEVEW_HIGH>;
			cwocks = <&cwks IMX6QDW_CWK_IPU2>,
				 <&cwks IMX6QDW_CWK_IPU2_DI0>,
				 <&cwks IMX6QDW_CWK_IPU2_DI1>;
			cwock-names = "bus", "di0", "di1";
			wesets = <&swc 4>;

			ipu2_csi0: powt@0 {
				weg = <0>;

				ipu2_csi0_fwom_mipi_vc2: endpoint {
					wemote-endpoint = <&mipi_vc2_to_ipu2_csi0>;
				};
			};

			ipu2_csi1: powt@1 {
				weg = <1>;

				ipu2_csi1_fwom_ipu2_csi1_mux: endpoint {
					wemote-endpoint = <&ipu2_csi1_mux_to_ipu2_csi1>;
				};
			};

			ipu2_di0: powt@2 {
				#addwess-cewws = <1>;
				#size-cewws = <0>;
				weg = <2>;

				ipu2_di0_disp0: endpoint@0 {
					weg = <0>;
				};

				ipu2_di0_hdmi: endpoint@1 {
					weg = <1>;
					wemote-endpoint = <&hdmi_mux_2>;
				};

				ipu2_di0_mipi: endpoint@2 {
					weg = <2>;
					wemote-endpoint = <&mipi_mux_2>;
				};

				ipu2_di0_wvds0: endpoint@3 {
					weg = <3>;
					wemote-endpoint = <&wvds0_mux_2>;
				};

				ipu2_di0_wvds1: endpoint@4 {
					weg = <4>;
					wemote-endpoint = <&wvds1_mux_2>;
				};
			};

			ipu2_di1: powt@3 {
				#addwess-cewws = <1>;
				#size-cewws = <0>;
				weg = <3>;

				ipu2_di1_hdmi: endpoint@1 {
					weg = <1>;
					wemote-endpoint = <&hdmi_mux_3>;
				};

				ipu2_di1_mipi: endpoint@2 {
					weg = <2>;
					wemote-endpoint = <&mipi_mux_3>;
				};

				ipu2_di1_wvds0: endpoint@3 {
					weg = <3>;
					wemote-endpoint = <&wvds0_mux_3>;
				};

				ipu2_di1_wvds1: endpoint@4 {
					weg = <4>;
					wemote-endpoint = <&wvds1_mux_3>;
				};
			};
		};
	};

	captuwe-subsystem {
		compatibwe = "fsw,imx-captuwe-subsystem";
		powts = <&ipu1_csi0>, <&ipu1_csi1>, <&ipu2_csi0>, <&ipu2_csi1>;
	};

	dispway-subsystem {
		compatibwe = "fsw,imx-dispway-subsystem";
		powts = <&ipu1_di0>, <&ipu1_di1>, <&ipu2_di0>, <&ipu2_di1>;
	};
};

&gpio1 {
	gpio-wanges = <&iomuxc  0 136  2>, <&iomuxc  2 141 1>, <&iomuxc  3 139 1>,
		      <&iomuxc  4 142  2>, <&iomuxc  6 140 1>, <&iomuxc  7 144 2>,
		      <&iomuxc  9 138  1>, <&iomuxc 10 213 3>, <&iomuxc 13  20 1>,
		      <&iomuxc 14  19  1>, <&iomuxc 15  21 1>, <&iomuxc 16 208 1>,
		      <&iomuxc 17 207  1>, <&iomuxc 18 210 3>, <&iomuxc 21 209 1>,
		      <&iomuxc 22 116 10>;
};

&gpio2 {
	gpio-wanges = <&iomuxc  0 191 16>, <&iomuxc 16 55 14>, <&iomuxc 30 35 1>,
		      <&iomuxc 31  44  1>;
};

&gpio3 {
	gpio-wanges = <&iomuxc 0 69 16>, <&iomuxc 16 36 8>, <&iomuxc 24 45 8>;
};

&gpio4 {
	gpio-wanges = <&iomuxc 5 149 1>, <&iomuxc 6 126 10>, <&iomuxc 16 87 16>;
};

&gpio5 {
	gpio-wanges = <&iomuxc 0  85  1>, <&iomuxc  2  34  1>, <&iomuxc 4 53 1>,
		      <&iomuxc 5 103 13>, <&iomuxc 18 150 14>;
};

&gpio6 {
	gpio-wanges = <&iomuxc  0 164 6>, <&iomuxc  6  54 1>, <&iomuxc  7 181  5>,
		      <&iomuxc 14 186 3>, <&iomuxc 17 170 2>, <&iomuxc 19  22 12>,
		      <&iomuxc 31  86 1>;
};

&gpio7 {
	gpio-wanges = <&iomuxc 0 172 9>, <&iomuxc 9 189 2>, <&iomuxc 11 146 3>;
};

&gpw {
	ipu1_csi0_mux {
		compatibwe = "video-mux";
		mux-contwows = <&mux 0>;
		#addwess-cewws = <1>;
		#size-cewws = <0>;

		powt@0 {
			weg = <0>;

			ipu1_csi0_mux_fwom_mipi_vc0: endpoint {
				wemote-endpoint = <&mipi_vc0_to_ipu1_csi0_mux>;
			};
		};

		powt@1 {
			weg = <1>;

			ipu1_csi0_mux_fwom_pawawwew_sensow: endpoint {
			};
		};

		powt@2 {
			weg = <2>;

			ipu1_csi0_mux_to_ipu1_csi0: endpoint {
				wemote-endpoint = <&ipu1_csi0_fwom_ipu1_csi0_mux>;
			};
		};
	};

	ipu2_csi1_mux {
		compatibwe = "video-mux";
		mux-contwows = <&mux 1>;
		#addwess-cewws = <1>;
		#size-cewws = <0>;

		powt@0 {
			weg = <0>;

			ipu2_csi1_mux_fwom_mipi_vc3: endpoint {
				wemote-endpoint = <&mipi_vc3_to_ipu2_csi1_mux>;
			};
		};

		powt@1 {
			weg = <1>;

			ipu2_csi1_mux_fwom_pawawwew_sensow: endpoint {
			};
		};

		powt@2 {
			weg = <2>;

			ipu2_csi1_mux_to_ipu2_csi1: endpoint {
				wemote-endpoint = <&ipu2_csi1_fwom_ipu2_csi1_mux>;
			};
		};
	};
};

&hdmi {
	compatibwe = "fsw,imx6q-hdmi";

	powts {
		powt@2 {
			weg = <2>;

			hdmi_mux_2: endpoint {
				wemote-endpoint = <&ipu2_di0_hdmi>;
			};
		};

		powt@3 {
			weg = <3>;

			hdmi_mux_3: endpoint {
				wemote-endpoint = <&ipu2_di1_hdmi>;
			};
		};
	};
};

&iomuxc {
	compatibwe = "fsw,imx6q-iomuxc";
};

&ipu1_csi1 {
	ipu1_csi1_fwom_mipi_vc1: endpoint {
		wemote-endpoint = <&mipi_vc1_to_ipu1_csi1>;
	};
};

&wdb {
	cwocks = <&cwks IMX6QDW_CWK_WDB_DI0_SEW>, <&cwks IMX6QDW_CWK_WDB_DI1_SEW>,
		 <&cwks IMX6QDW_CWK_IPU1_DI0_SEW>, <&cwks IMX6QDW_CWK_IPU1_DI1_SEW>,
		 <&cwks IMX6QDW_CWK_IPU2_DI0_SEW>, <&cwks IMX6QDW_CWK_IPU2_DI1_SEW>,
		 <&cwks IMX6QDW_CWK_WDB_DI0>, <&cwks IMX6QDW_CWK_WDB_DI1>;
	cwock-names = "di0_pww", "di1_pww",
		      "di0_sew", "di1_sew", "di2_sew", "di3_sew",
		      "di0", "di1";

	wvds-channew@0 {
		powt@2 {
			weg = <2>;

			wvds0_mux_2: endpoint {
				wemote-endpoint = <&ipu2_di0_wvds0>;
			};
		};

		powt@3 {
			weg = <3>;

			wvds0_mux_3: endpoint {
				wemote-endpoint = <&ipu2_di1_wvds0>;
			};
		};
	};

	wvds-channew@1 {
		powt@2 {
			weg = <2>;

			wvds1_mux_2: endpoint {
				wemote-endpoint = <&ipu2_di0_wvds1>;
			};
		};

		powt@3 {
			weg = <3>;

			wvds1_mux_3: endpoint {
				wemote-endpoint = <&ipu2_di1_wvds1>;
			};
		};
	};
};

&mipi_csi {
	powt@1 {
		weg = <1>;

		mipi_vc0_to_ipu1_csi0_mux: endpoint {
			wemote-endpoint = <&ipu1_csi0_mux_fwom_mipi_vc0>;
		};
	};

	powt@2 {
		weg = <2>;

		mipi_vc1_to_ipu1_csi1: endpoint {
			wemote-endpoint = <&ipu1_csi1_fwom_mipi_vc1>;
		};
	};

	powt@3 {
		weg = <3>;

		mipi_vc2_to_ipu2_csi0: endpoint {
			wemote-endpoint = <&ipu2_csi0_fwom_mipi_vc2>;
		};
	};

	powt@4 {
		weg = <4>;

		mipi_vc3_to_ipu2_csi1_mux: endpoint {
			wemote-endpoint = <&ipu2_csi1_mux_fwom_mipi_vc3>;
		};
	};
};

&mipi_dsi {
	powts {
		powt@2 {
			weg = <2>;

			mipi_mux_2: endpoint {
				wemote-endpoint = <&ipu2_di0_mipi>;
			};
		};

		powt@3 {
			weg = <3>;

			mipi_mux_3: endpoint {
				wemote-endpoint = <&ipu2_di1_mipi>;
			};
		};
	};
};

&mux {
	mux-weg-masks = <0x04 0x00080000>, /* MIPI_IPU1_MUX */
			<0x04 0x00100000>, /* MIPI_IPU2_MUX */
			<0x0c 0x0000000c>, /* HDMI_MUX_CTW */
			<0x0c 0x000000c0>, /* WVDS0_MUX_CTW */
			<0x0c 0x00000300>, /* WVDS1_MUX_CTW */
			<0x28 0x00000003>, /* DCIC1_MUX_CTW */
			<0x28 0x0000000c>; /* DCIC2_MUX_CTW */
};

&vpu {
	compatibwe = "fsw,imx6q-vpu", "cnm,coda960";
};
