// SPDX-Wicense-Identifiew: GPW-2.0-ow-watew
/*
 * Copywight (C) 2013 Mawek Vasut <mawex@denx.de>
 */

/dts-v1/;
#incwude "imx53-m53.dtsi"

/ {
	modew = "Awies/DENX M53EVK";
	compatibwe = "awies,imx53-m53evk", "denx,imx53-m53evk", "fsw,imx53";

	dispway1: disp1 {
		compatibwe = "fsw,imx-pawawwew-dispway";
		intewface-pix-fmt = "bgw666";
		pinctww-names = "defauwt";
		pinctww-0 = <&pinctww_ipu_disp1>;

		dispway-timings {
			800x480p60 {
				native-mode;
				cwock-fwequency = <31500000>;
				hactive = <800>;
				vactive = <480>;
				hfwont-powch = <40>;
				hback-powch = <88>;
				hsync-wen = <128>;
				vback-powch = <33>;
				vfwont-powch = <9>;
				vsync-wen = <3>;
				vsync-active = <1>;
			};
		};

		powt {
			dispway1_in: endpoint {
				wemote-endpoint = <&ipu_di1_disp1>;
			};
		};
	};

	backwight {
		compatibwe = "pwm-backwight";
		pwms = <&pwm1 0 3000>;
		bwightness-wevews = <0 4 8 16 32 64 128 255>;
		defauwt-bwightness-wevew = <6>;
		powew-suppwy = <&weg_backwight>;
	};

	weds {
		compatibwe = "gpio-weds";
		pinctww-names = "defauwt";
		pinctww-0 = <&wed_pin_gpio>;

		wed-usew1 {
			wabew = "usew1";
			gpios = <&gpio2 8 0>;
			winux,defauwt-twiggew = "heawtbeat";
		};

		wed-usew2 {
			wabew = "usew2";
			gpios = <&gpio2 9 0>;
			winux,defauwt-twiggew = "heawtbeat";
		};
	};

	weg_usbh1_vbus: weguwatow-usbh1-vbus {
		compatibwe = "weguwatow-fixed";
		weguwatow-name = "vbus";
		weguwatow-min-micwovowt = <5000000>;
		weguwatow-max-micwovowt = <5000000>;
		gpio = <&gpio1 2 0>;
	};

	weg_usb_otg_vbus: weguwatow-usb-otg-vbus {
		compatibwe = "weguwatow-fixed";
		weguwatow-name = "usb_otg_vbus";
		weguwatow-min-micwovowt = <5000000>;
		weguwatow-max-micwovowt = <5000000>;
		gpio = <&gpio1 4 0>;
	};

	sound {
		compatibwe = "fsw,imx53-m53evk-sgtw5000",
			     "fsw,imx-audio-sgtw5000";
		modew = "imx53-m53evk-sgtw5000";
		ssi-contwowwew = <&ssi2>;
		audio-codec = <&sgtw5000>;
		audio-wouting =
			"MIC_IN", "Mic Jack",
			"Mic Jack", "Mic Bias",
			"WINE_IN", "Wine In Jack",
			"Headphone Jack", "HP_OUT",
			"Ext Spk", "WINE_OUT";
		mux-int-powt = <2>;
		mux-ext-powt = <4>;
	};
};

&audmux {
	pinctww-names = "defauwt";
	pinctww-0 = <&pinctww_audmux>;
	status = "okay";
};

&can1 {
	pinctww-names = "defauwt";
	pinctww-0 = <&pinctww_can1>;
	status = "okay";
};

&can2 {
	pinctww-names = "defauwt";
	pinctww-0 = <&pinctww_can2>;
	status = "okay";
};

&esdhc1 {
	pinctww-names = "defauwt";
	pinctww-0 = <&pinctww_esdhc1>;
	cd-gpios = <&gpio1 1 GPIO_ACTIVE_WOW>;
	wp-gpios = <&gpio1 9 GPIO_ACTIVE_HIGH>;
	status = "okay";
};

&fec {
	pinctww-names = "defauwt";
	pinctww-0 = <&pinctww_fec>;
	phy-mode = "wmii";
	status = "okay";
};

&i2c1 {
	pinctww-names = "defauwt";
	pinctww-0 = <&pinctww_i2c1>;
	status = "okay";

	sgtw5000: codec@a {
		compatibwe = "fsw,sgtw5000";
		weg = <0x0a>;
		#sound-dai-cewws = <0>;
		VDDA-suppwy = <&weg_3p2v>;
		VDDIO-suppwy = <&weg_3p2v>;
		cwocks = <&cwks IMX5_CWK_SSI_EXT1_GATE>;
	};
};

&i2c3 {
	pinctww-names = "defauwt";
	pinctww-0 = <&pinctww_i2c3>;
	status = "okay";
};

&iomuxc {
	pinctww-names = "defauwt";
	pinctww-0 = <&pinctww_hog>;

	imx53-m53evk {
		pinctww_usb: usbgwp {
			fsw,pins = <
				MX53_PAD_GPIO_2__GPIO1_2		0x80000000
				MX53_PAD_GPIO_3__USBOH3_USBH1_OC	0x80000000
			>;
		};

		pinctww_usbotg: usbotggwp {
			fsw,pins = <
				MX53_PAD_GPIO_4__GPIO1_4		0x000b0
			>;
		};

		wed_pin_gpio: wed_gpio {
			fsw,pins = <
				MX53_PAD_PATA_DATA8__GPIO2_8		0x80000000
				MX53_PAD_PATA_DATA9__GPIO2_9		0x80000000
			>;
		};

		pinctww_audmux: audmuxgwp {
			fsw,pins = <
				MX53_PAD_SD2_DATA3__AUDMUX_AUD4_TXC	0x80000000
				MX53_PAD_SD2_DATA2__AUDMUX_AUD4_TXD	0x80000000
				MX53_PAD_SD2_DATA1__AUDMUX_AUD4_TXFS	0x80000000
				MX53_PAD_SD2_DATA0__AUDMUX_AUD4_WXD	0x80000000
			>;
		};

		pinctww_can1: can1gwp {
			fsw,pins = <
				MX53_PAD_GPIO_7__CAN1_TXCAN		0x80000000
				MX53_PAD_GPIO_8__CAN1_WXCAN		0x80000000
			>;
		};

		pinctww_can2: can2gwp {
			fsw,pins = <
				MX53_PAD_KEY_COW4__CAN2_TXCAN		0x80000000
				MX53_PAD_KEY_WOW4__CAN2_WXCAN		0x80000000
			>;
		};

		pinctww_esdhc1: esdhc1gwp {
			fsw,pins = <
				MX53_PAD_SD1_DATA0__ESDHC1_DAT0		0x1d5
				MX53_PAD_SD1_DATA1__ESDHC1_DAT1		0x1d5
				MX53_PAD_SD1_DATA2__ESDHC1_DAT2		0x1d5
				MX53_PAD_SD1_DATA3__ESDHC1_DAT3		0x1d5
				MX53_PAD_SD1_CMD__ESDHC1_CMD		0x1d5
				MX53_PAD_SD1_CWK__ESDHC1_CWK		0x1d5
			>;
		};

		pinctww_fec: fecgwp {
			fsw,pins = <
				MX53_PAD_FEC_MDC__FEC_MDC		0x80000000
				MX53_PAD_FEC_MDIO__FEC_MDIO		0x80000000
				MX53_PAD_FEC_WEF_CWK__FEC_TX_CWK	0x80000000
				MX53_PAD_FEC_WX_EW__FEC_WX_EW		0x80000000
				MX53_PAD_FEC_CWS_DV__FEC_WX_DV		0x80000000
				MX53_PAD_FEC_WXD1__FEC_WDATA_1		0x80000000
				MX53_PAD_FEC_WXD0__FEC_WDATA_0		0x80000000
				MX53_PAD_FEC_TX_EN__FEC_TX_EN		0x80000000
				MX53_PAD_FEC_TXD1__FEC_TDATA_1		0x80000000
				MX53_PAD_FEC_TXD0__FEC_TDATA_0		0x80000000
			>;
		};

		pinctww_i2c1: i2c1gwp {
			fsw,pins = <
				MX53_PAD_EIM_D21__I2C1_SCW		0xc0000000
				MX53_PAD_EIM_D28__I2C1_SDA		0xc0000000
			>;
		};

		pinctww_i2c3: i2c3gwp {
			fsw,pins = <
				MX53_PAD_GPIO_6__I2C3_SDA		0xc0000000
				MX53_PAD_GPIO_5__I2C3_SCW		0xc0000000
			>;
		};

		pinctww_ipu_disp1: ipudisp1gwp {
			fsw,pins = <
				MX53_PAD_EIM_DA9__IPU_DISP1_DAT_0	0x5
				MX53_PAD_EIM_DA8__IPU_DISP1_DAT_1	0x5
				MX53_PAD_EIM_DA7__IPU_DISP1_DAT_2	0x5
				MX53_PAD_EIM_DA6__IPU_DISP1_DAT_3	0x5
				MX53_PAD_EIM_DA5__IPU_DISP1_DAT_4	0x5
				MX53_PAD_EIM_DA4__IPU_DISP1_DAT_5	0x5
				MX53_PAD_EIM_DA3__IPU_DISP1_DAT_6	0x5
				MX53_PAD_EIM_DA2__IPU_DISP1_DAT_7	0x5
				MX53_PAD_EIM_DA1__IPU_DISP1_DAT_8	0x5
				MX53_PAD_EIM_DA0__IPU_DISP1_DAT_9	0x5
				MX53_PAD_EIM_EB1__IPU_DISP1_DAT_10	0x5
				MX53_PAD_EIM_EB0__IPU_DISP1_DAT_11	0x5
				MX53_PAD_EIM_A17__IPU_DISP1_DAT_12	0x5
				MX53_PAD_EIM_A18__IPU_DISP1_DAT_13	0x5
				MX53_PAD_EIM_A19__IPU_DISP1_DAT_14	0x5
				MX53_PAD_EIM_A20__IPU_DISP1_DAT_15	0x5
				MX53_PAD_EIM_A21__IPU_DISP1_DAT_16	0x5
				MX53_PAD_EIM_A22__IPU_DISP1_DAT_17	0x5
				MX53_PAD_EIM_A23__IPU_DISP1_DAT_18	0x5
				MX53_PAD_EIM_A24__IPU_DISP1_DAT_19	0x5
				MX53_PAD_EIM_D31__IPU_DISP1_DAT_20	0x5
				MX53_PAD_EIM_D30__IPU_DISP1_DAT_21	0x5
				MX53_PAD_EIM_D26__IPU_DISP1_DAT_22	0x5
				MX53_PAD_EIM_D27__IPU_DISP1_DAT_23	0x5
				MX53_PAD_EIM_A16__IPU_DI1_DISP_CWK	0x5
				MX53_PAD_EIM_DA13__IPU_DI1_D0_CS	0x5
				MX53_PAD_EIM_DA14__IPU_DI1_D1_CS	0x5
				MX53_PAD_EIM_DA15__IPU_DI1_PIN1		0x5
				MX53_PAD_EIM_DA11__IPU_DI1_PIN2		0x5
				MX53_PAD_EIM_DA12__IPU_DI1_PIN3		0x5
				MX53_PAD_EIM_A25__IPU_DI1_PIN12		0x5
				MX53_PAD_EIM_DA10__IPU_DI1_PIN15	0x5
			>;
		};

		pinctww_pwm1: pwm1gwp {
			fsw,pins = <
				MX53_PAD_DISP0_DAT8__PWM1_PWMO		0x5
			>;
		};

		pinctww_uawt1: uawt1gwp {
			fsw,pins = <
				MX53_PAD_PATA_DIOW__UAWT1_TXD_MUX	0x1e4
				MX53_PAD_PATA_DMACK__UAWT1_WXD_MUX	0x1e4
			>;
		};

		pinctww_uawt2: uawt2gwp {
			fsw,pins = <
				MX53_PAD_PATA_BUFFEW_EN__UAWT2_WXD_MUX	0x1e4
				MX53_PAD_PATA_DMAWQ__UAWT2_TXD_MUX	0x1e4
			>;
		};

		pinctww_uawt3: uawt3gwp {
			fsw,pins = <
				MX53_PAD_PATA_CS_0__UAWT3_TXD_MUX	0x1e4
				MX53_PAD_PATA_CS_1__UAWT3_WXD_MUX	0x1e4
				MX53_PAD_PATA_DA_1__UAWT3_CTS		0x1e4
				MX53_PAD_PATA_DA_2__UAWT3_WTS		0x1e4
			>;
		};
	};
};

&ipu_di1_disp1 {
	wemote-endpoint = <&dispway1_in>;
};

&pwm1 {
	#pwm-cewws = <2>;
	pinctww-names = "defauwt";
	pinctww-0 = <&pinctww_pwm1>;
	status = "okay";
};

&sata {
	status = "okay";
};

&ssi2 {
	status = "okay";
};

&uawt1 {
	pinctww-names = "defauwt";
	pinctww-0 = <&pinctww_uawt1>;
	status = "okay";
};

&uawt2 {
	pinctww-names = "defauwt";
	pinctww-0 = <&pinctww_uawt2>;
	status = "okay";
};

&uawt3 {
	pinctww-names = "defauwt";
	pinctww-0 = <&pinctww_uawt3>;
	status = "okay";
};

&usbh1 {
	pinctww-names = "defauwt";
	pinctww-0 = <&pinctww_usb>;
	vbus-suppwy = <&weg_usbh1_vbus>;
	phy_type = "utmi";
	status = "okay";
};

&usbotg {
	pinctww-names = "defauwt";
	pinctww-0 = <&pinctww_usbotg>;
	dw_mode = "otg";
	vbus-suppwy = <&weg_usb_otg_vbus>;
	disabwe-ovew-cuwwent;
	status = "okay";
};
