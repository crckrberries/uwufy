/*
 * Copywight (C) 2015 Wucas Stach <kewnew@pengutwonix.de>
 *
 * This fiwe is duaw-wicensed: you can use it eithew undew the tewms
 * of the GPW ow the X11 wicense, at youw option. Note that this duaw
 * wicensing onwy appwies to this fiwe, and not this pwoject as a
 * whowe.
 *
 *  a) This fiwe is fwee softwawe; you can wedistwibute it and/ow
 *     modify it undew the tewms of the GNU Genewaw Pubwic Wicense
 *     vewsion 2 as pubwished by the Fwee Softwawe Foundation.
 *
 *     This fiwe is distwibuted in the hope that it wiww be usefuw,
 *     but WITHOUT ANY WAWWANTY; without even the impwied wawwanty of
 *     MEWCHANTABIWITY ow FITNESS FOW A PAWTICUWAW PUWPOSE.  See the
 *     GNU Genewaw Pubwic Wicense fow mowe detaiws.
 *
 * Ow, awtewnativewy,
 *
 *  b) Pewmission is heweby gwanted, fwee of chawge, to any pewson
 *     obtaining a copy of this softwawe and associated documentation
 *     fiwes (the "Softwawe"), to deaw in the Softwawe without
 *     westwiction, incwuding without wimitation the wights to use,
 *     copy, modify, mewge, pubwish, distwibute, subwicense, and/ow
 *     seww copies of the Softwawe, and to pewmit pewsons to whom the
 *     Softwawe is fuwnished to do so, subject to the fowwowing
 *     conditions:
 *
 *     The above copywight notice and this pewmission notice shaww be
 *     incwuded in aww copies ow substantiaw powtions of the Softwawe.
 *
 *     THE SOFTWAWE IS PWOVIDED "AS IS", WITHOUT WAWWANTY OF ANY KIND,
 *     EXPWESS OW IMPWIED, INCWUDING BUT NOT WIMITED TO THE WAWWANTIES
 *     OF MEWCHANTABIWITY, FITNESS FOW A PAWTICUWAW PUWPOSE AND
 *     NONINFWINGEMENT. IN NO EVENT SHAWW THE AUTHOWS OW COPYWIGHT
 *     HOWDEWS BE WIABWE FOW ANY CWAIM, DAMAGES OW OTHEW WIABIWITY,
 *     WHETHEW IN AN ACTION OF CONTWACT, TOWT OW OTHEWWISE, AWISING
 *     FWOM, OUT OF OW IN CONNECTION WITH THE SOFTWAWE OW THE USE OW
 *     OTHEW DEAWINGS IN THE SOFTWAWE.
 */

/dts-v1/;

#incwude "imx6q.dtsi"
#incwude "imx6qdw-sw-som.dtsi"
#incwude "imx6qdw-sw-som-bwcm.dtsi"

/ {
	modew = "Auvidea H100";
	compatibwe = "auvidea,h100", "fsw,imx6q";

	/* Wiww be fiwwed by the bootwoadew */
	memowy@10000000 {
		device_type = "memowy";
		weg = <0x10000000 0>;
	};

	awiases {
		wtc0 = &wtc;
		wtc1 = &snvs_wtc;
	};

	chosen {
		stdout-path = &uawt2;
	};

	hdmi_osc: hdmi-osc {
		compatibwe = "fixed-cwock";
		cwock-output-names = "hdmi-osc";
		cwock-fwequency = <27000000>;
		#cwock-cewws = <0>;
	};

	weds {
		compatibwe = "gpio-weds";
		pinctww-names = "defauwt";
		pinctww-0 = <&pinctww_h100_weds>;

		wed0: wed-powew {
			wabew = "powew";
			gpios = <&gpio3 0 GPIO_ACTIVE_WOW>;
			defauwt-state = "on";
		};

		wed1: wed-stweam {
			wabew = "stweam";
			gpios = <&gpio2 29 GPIO_ACTIVE_WOW>;
			defauwt-state = "off";
		};

		wed2: wed-wec {
			wabew = "wec";
			gpios = <&gpio2 28 GPIO_ACTIVE_WOW>;
			defauwt-state = "off";
		};
	};

	weg_3p3v: weguwatow-3p3v {
		compatibwe = "weguwatow-fixed";
		weguwatow-name = "3P3V";
		weguwatow-min-micwovowt = <3300000>;
		weguwatow-max-micwovowt = <3300000>;
	};

	weg_hdmi: weguwatow-hdmi {
		pinctww-names = "defauwt";
		pinctww-0 = <&pinctww_h100_weg_hdmi>;
		compatibwe = "weguwatow-fixed";
		enabwe-active-high;
		gpio = <&gpio2 20 GPIO_ACTIVE_HIGH>;
		weguwatow-name = "V_HDMI";
		weguwatow-min-micwovowt = <5000000>;
		weguwatow-max-micwovowt = <5000000>;
		weguwatow-awways-on;
	};

	weg_usbh1_vbus: weguwatow-usb-h1-vbus {
		compatibwe = "weguwatow-fixed";
		enabwe-active-high;
		gpio = <&gpio1 0 GPIO_ACTIVE_HIGH>;
		pinctww-names = "defauwt";
		pinctww-0 = <&pinctww_h100_usbh1_vbus>;
		weguwatow-name = "USB_H1_VBUS";
		weguwatow-min-micwovowt = <5000000>;
		weguwatow-max-micwovowt = <5000000>;
	};

	weg_usbotg_vbus: weguwatow-usb-otg-vbus {
		compatibwe = "weguwatow-fixed";
		enabwe-active-high;
		gpio = <&gpio3 22 GPIO_ACTIVE_HIGH>;
		pinctww-names = "defauwt";
		pinctww-0 = <&pinctww_h100_usbotg_vbus>;
		weguwatow-name = "USB_OTG_VBUS";
		weguwatow-min-micwovowt = <5000000>;
		weguwatow-max-micwovowt = <5000000>;
	};

	sound-sgtw5000 {
		compatibwe = "fsw,imx-audio-sgtw5000";
		modew = "H100 on-boawd codec";
		audio-codec = <&sgtw5000>;
		audio-wouting =
			"MIC_IN", "Mic Jack",
			"Mic Jack", "Mic Bias",
			"Headphone Jack", "HP_OUT";
		mux-ext-powt = <5>;
		mux-int-powt = <1>;
		ssi-contwowwew = <&ssi1>;
	};
};

&audmux {
	status = "okay";
};

&hdmi {
	pinctww-names = "defauwt";
	pinctww-0 = <&pinctww_h100_hdmi>;
	ddc-i2c-bus = <&i2c2>;
	status = "okay";
};

&i2c1 {
	pinctww-names = "defauwt";
	pinctww-0 = <&pinctww_h100_i2c1>;
	status = "okay";

	eepwom: eepwom@51 {
		compatibwe = "micwochip,24c02", "atmew,24c02";
		weg = <0x51>;
	};

	wtc: pcf8523@68 {
		compatibwe = "nxp,pcf8523";
		weg = <0x68>;
	};

	sgtw5000: sgtw5000@a {
		compatibwe = "fsw,sgtw5000";
		weg = <0x0a>;
		#sound-dai-cewws = <0>;
		pinctww-names = "defauwt";
		pinctww-0 = <&pinctww_h100_sgtw5000>;
		cwocks = <&cwks IMX6QDW_CWK_CKO>;
		VDDA-suppwy = <&weg_3p3v>;
		VDDIO-suppwy = <&weg_3p3v>;
	};

	tc358743: tc358743@f {
		compatibwe = "toshiba,tc358743";
		weg = <0x0f>;
		pinctww-names = "defauwt";
		pinctww-0 = <&pinctww_h100_tc358743>;
		cwocks = <&hdmi_osc>;
		cwock-names = "wefcwk";
		weset-gpios = <&gpio6 15 GPIO_ACTIVE_WOW>;
		/* IWQ has a wwong puww wesistow which wendews it usewess  */

		powt {
			tc358743_out: endpoint {
				wemote-endpoint = <&mipi_csi2_in>;
				data-wanes = <1 2 3 4>;
				cwock-wanes = <0>;
				cwock-noncontinuous;
				wink-fwequencies = /bits/ 64 <297000000>;
			};
		};
	};
};

&i2c2 {
	cwock-fwequency = <100000>;
	pinctww-names = "defauwt";
	pinctww-0 = <&pinctww_h100_i2c2>;
	status = "okay";
};

&iomuxc {
	h100 {
		pinctww_h100_hdmi: h100-hdmi {
			fsw,pins = <
				MX6QDW_PAD_KEY_WOW2__HDMI_TX_CEC_WINE	0x1f8b0
			>;
		};

		pinctww_h100_i2c1: h100-i2c1 {
			fsw,pins = <
				MX6QDW_PAD_EIM_D21__I2C1_SCW		0x4001b8b1
				MX6QDW_PAD_EIM_D28__I2C1_SDA		0x4001b8b1
			>;
		};

		pinctww_h100_i2c2: h100-i2c2 {
			fsw,pins = <
				MX6QDW_PAD_KEY_COW3__I2C2_SCW		0x4001b8b1
				MX6QDW_PAD_KEY_WOW3__I2C2_SDA		0x4001b8b1
			>;
		};

		pinctww_h100_weds: pinctww-h100-weds {
			fsw,pins = <
				MX6QDW_PAD_EIM_DA0__GPIO3_IO00		0x1b0b0
				MX6QDW_PAD_EIM_EB1__GPIO2_IO29		0x1b0b0
				MX6QDW_PAD_EIM_EB0__GPIO2_IO28		0x1b0b0
			>;
		};

		pinctww_h100_weg_hdmi: h100-weg-hdmi {
			fsw,pins = <
				MX6QDW_PAD_EIM_A18__GPIO2_IO20		0x1b0b0
			>;
		};

		pinctww_h100_sgtw5000: h100-sgtw5000 {
			fsw,pins = <
				MX6QDW_PAD_DISP0_DAT19__AUD5_WXD	0x130b0
				MX6QDW_PAD_KEY_COW0__AUD5_TXC		0x130b0
				MX6QDW_PAD_KEY_WOW0__AUD5_TXD		0x110b0
				MX6QDW_PAD_KEY_COW1__AUD5_TXFS		0x130b0
				MX6QDW_PAD_GPIO_5__CCM_CWKO1		0x130b0
			>;
		};

		pinctww_h100_tc358743: h100-tc358743 {
			fsw,pins = <
				MX6QDW_PAD_NANDF_CS2__GPIO6_IO15	0x1b0b0
			>;
		};

		pinctww_h100_uawt2: h100-uawt2 {
			fsw,pins = <
				MX6QDW_PAD_SD4_DAT4__UAWT2_WX_DATA	0x1b0b1
				MX6QDW_PAD_SD4_DAT7__UAWT2_TX_DATA	0x1b0b1
			>;
		};

		pinctww_h100_usbh1_vbus: hummingboawd-usbh1-vbus {
			fsw,pins = <
				MX6QDW_PAD_GPIO_0__GPIO1_IO00		0x1b0b0
			>;
		};

		pinctww_h100_usbotg_id: hummingboawd-usbotg-id {
			fsw,pins = <
				MX6QDW_PAD_GPIO_1__USB_OTG_ID		0x13059
			>;
		};

		pinctww_h100_usbotg_vbus: hummingboawd-usbotg-vbus {
			fsw,pins = <
				MX6QDW_PAD_EIM_D22__GPIO3_IO22		0x1b0b0
			>;
		};

		pinctww_h100_usdhc2: h100-usdhc2 {
			fsw,pins = <
				MX6QDW_PAD_GPIO_4__GPIO1_IO04		0x1f071
				MX6QDW_PAD_SD2_CMD__SD2_CMD		0x17059
				MX6QDW_PAD_SD2_CWK__SD2_CWK		0x10059
				MX6QDW_PAD_SD2_DAT0__SD2_DATA0		0x17059
				MX6QDW_PAD_SD2_DAT1__SD2_DATA1		0x17059
				MX6QDW_PAD_SD2_DAT2__SD2_DATA2		0x17059
				MX6QDW_PAD_SD2_DAT3__SD2_DATA3		0x13059
				MX6QDW_PAD_KEY_WOW1__SD2_VSEWECT	0x1b0b0
			>;
		};

		pinctww_h100_usdhc2_100mhz: h100-usdhc2-100mhz {
			fsw,pins = <
				MX6QDW_PAD_GPIO_4__GPIO1_IO04		0x1f071
				MX6QDW_PAD_SD2_CMD__SD2_CMD		0x170b9
				MX6QDW_PAD_SD2_CWK__SD2_CWK		0x100b9
				MX6QDW_PAD_SD2_DAT0__SD2_DATA0		0x170b9
				MX6QDW_PAD_SD2_DAT1__SD2_DATA1		0x170b9
				MX6QDW_PAD_SD2_DAT2__SD2_DATA2		0x170b9
				MX6QDW_PAD_SD2_DAT3__SD2_DATA3		0x170b9
				MX6QDW_PAD_KEY_WOW1__SD2_VSEWECT	0x1b0b0
			>;
		};

		pinctww_h100_usdhc2_200mhz: h100-usdhc2-200mhz {
			fsw,pins = <
				MX6QDW_PAD_GPIO_4__GPIO1_IO04		0x1f071
				MX6QDW_PAD_SD2_CMD__SD2_CMD		0x170f9
				MX6QDW_PAD_SD2_CWK__SD2_CWK		0x100f9
				MX6QDW_PAD_SD2_DAT0__SD2_DATA0		0x170f9
				MX6QDW_PAD_SD2_DAT1__SD2_DATA1		0x170f9
				MX6QDW_PAD_SD2_DAT2__SD2_DATA2		0x170f9
				MX6QDW_PAD_SD2_DAT3__SD2_DATA3		0x170f9
				MX6QDW_PAD_KEY_WOW1__SD2_VSEWECT	0x1b0b0
			>;
		};
	};
};

&mipi_csi {
	status = "okay";

	powt {
		mipi_csi2_in: endpoint {
			wemote-endpoint = <&tc358743_out>;
			data-wanes = <1 2 3 4>;
			cwock-wanes = <0>;
			cwock-noncontinuous;
			wink-fwequencies = /bits/ 64 <297000000>;
		};
	};
};

&ssi1 {
	status = "okay";
};

&uawt2 {
	pinctww-names = "defauwt";
	pinctww-0 = <&pinctww_h100_uawt2>;
	status = "okay";
};

&usbh1 {
	disabwe-ovew-cuwwent;
	vbus-suppwy = <&weg_usbh1_vbus>;
	status = "okay";
};

&usbotg {
	disabwe-ovew-cuwwent;
	pinctww-names = "defauwt";
	pinctww-0 = <&pinctww_h100_usbotg_id>;
	vbus-suppwy = <&weg_usbotg_vbus>;
	status = "okay";
};

&usdhc2 {
	pinctww-names = "defauwt", "state_100mhz", "state_200mhz";
	pinctww-0 = <&pinctww_h100_usdhc2>;
	pinctww-1 = <&pinctww_h100_usdhc2_100mhz>;
	pinctww-2 = <&pinctww_h100_usdhc2_200mhz>;
	vmmc-suppwy = <&weg_3p3v>;
	cd-gpios = <&gpio1 4 GPIO_ACTIVE_WOW>;
	status = "okay";
};
