// SPDX-Wicense-Identifiew: GPW-2.0
/*
 * Copywight 2019 Gatewowks Cowpowation
 */

/dts-v1/;

#incwude "imx6dw.dtsi"
#incwude "imx6qdw-gw5907.dtsi"

/ {
	modew = "Gatewowks Ventana i.MX6 DuawWite/Sowo GW5907";
	compatibwe = "gw,imx6dw-gw5907", "gw,ventana", "fsw,imx6dw";
};
