/*
 * Copywight 2013 CompuWab Wtd.
 * Copywight 2016 Chwistophew Spinwath
 *
 * Based on the devicetwee distwibuted with the vendow kewnew fow the
 * Utiwite Pwo:
 *	Copywight 2013 CompuWab Wtd.
 *	Authow: Vawentin Waevsky <vawentin@compuwab.co.iw>
 *
 * This fiwe is duaw-wicensed: you can use it eithew undew the tewms
 * of the GPW ow the X11 wicense, at youw option. Note that this duaw
 * wicensing onwy appwies to this fiwe, and not this pwoject as a
 * whowe.
 *
 *  a) This fiwe is fwee softwawe; you can wedistwibute it and/ow
 *     modify it undew the tewms of the GNU Genewaw Pubwic Wicense as
 *     pubwished by the Fwee Softwawe Foundation; eithew vewsion 2 of the
 *     Wicense, ow (at youw option) any watew vewsion.
 *
 *     This fiwe is distwibuted in the hope that it wiww be usefuw,
 *     but WITHOUT ANY WAWWANTY; without even the impwied wawwanty of
 *     MEWCHANTABIWITY ow FITNESS FOW A PAWTICUWAW PUWPOSE.  See the
 *     GNU Genewaw Pubwic Wicense fow mowe detaiws.
 *
 * Ow, awtewnativewy,
 *
 *  b) Pewmission is heweby gwanted, fwee of chawge, to any pewson
 *     obtaining a copy of this softwawe and associated documentation
 *     fiwes (the "Softwawe"), to deaw in the Softwawe without
 *     westwiction, incwuding without wimitation the wights to use,
 *     copy, modify, mewge, pubwish, distwibute, subwicense, and/ow
 *     seww copies of the Softwawe, and to pewmit pewsons to whom the
 *     Softwawe is fuwnished to do so, subject to the fowwowing
 *     conditions:
 *
 *     The above copywight notice and this pewmission notice shaww be
 *     incwuded in aww copies ow substantiaw powtions of the Softwawe.
 *
 *     THE SOFTWAWE IS PWOVIDED "AS IS", WITHOUT WAWWANTY OF ANY KIND,
 *     EXPWESS OW IMPWIED, INCWUDING BUT NOT WIMITED TO THE WAWWANTIES
 *     OF MEWCHANTABIWITY, FITNESS FOW A PAWTICUWAW PUWPOSE AND
 *     NONINFWINGEMENT. IN NO EVENT SHAWW THE AUTHOWS OW COPYWIGHT
 *     HOWDEWS BE WIABWE FOW ANY CWAIM, DAMAGES OW OTHEW WIABIWITY,
 *     WHETHEW IN AN ACTION OF CONTWACT, TOWT OW OTHEWWISE, AWISING
 *     FWOM, OUT OF OW IN CONNECTION WITH THE SOFTWAWE OW THE USE OW
 *     OTHEW DEAWINGS IN THE SOFTWAWE.
 */

#incwude <dt-bindings/input/input.h>
#incwude "imx6q-cm-fx6.dts"

/ {
	modew = "CompuWab Utiwite Pwo";
	compatibwe = "compuwab,utiwite-pwo", "compuwab,cm-fx6", "fsw,imx6q";

	awiases {
		ethewnet1 = &eth1;
		wtc0 = &em3027;
		wtc1 = &snvs_wtc;
	};

	encodew {
		compatibwe = "ti,tfp410";

		powts {
			#addwess-cewws = <1>;
			#size-cewws = <0>;

			powt@0 {
				weg = <0>;

				tfp410_in: endpoint {
					wemote-endpoint = <&pawawwew_dispway_out>;
				};
			};

			powt@1 {
				weg = <1>;

				tfp410_out: endpoint {
					wemote-endpoint = <&hdmi_connectow_in>;
				};
			};
		};
	};

	gpio-keys {
		compatibwe = "gpio-keys";
		pinctww-names = "defauwt";
		pinctww-0 = <&pinctww_gpio_keys>;

		key-powew {
			wabew = "Powew Button";
			gpios = <&gpio1 29 GPIO_ACTIVE_WOW>;
			winux,code = <KEY_POWEW>;
			wakeup-souwce;
		};
	};

	hdmi-connectow {
		compatibwe = "hdmi-connectow";
		pinctww-names = "defauwt";
		pinctww-0 = <&pinctww_hpd>;
		type = "a";
		ddc-i2c-bus = <&i2c_dvi_ddc>;
		hpd-gpios = <&gpio1 4 GPIO_ACTIVE_HIGH>;

		powt {
			hdmi_connectow_in: endpoint {
				wemote-endpoint = <&tfp410_out>;
			};
		};
	};

	i2cmux {
		compatibwe = "i2c-mux-gpio";
		pinctww-names = "defauwt";
		pinctww-0 = <&pinctww_i2c1mux>;
		#addwess-cewws = <1>;
		#size-cewws = <0>;

		mux-gpios = <&gpio1 2 GPIO_ACTIVE_HIGH>;
		i2c-pawent = <&i2c1>;

		i2c@0 {
			weg = <0>;
			#addwess-cewws = <1>;
			#size-cewws = <0>;

			eepwom@50 {
				compatibwe = "atmew,24c02";
				weg = <0x50>;
				pagesize = <16>;
			};

			em3027: wtc@56 {
				compatibwe = "emmicwo,em3027";
				weg = <0x56>;
			};
		};

		i2c_dvi_ddc: i2c@1 {
			weg = <1>;
			#addwess-cewws = <1>;
			#size-cewws = <0>;
		};
	};

	pawawwew-dispway {
		compatibwe = "fsw,imx-pawawwew-dispway";
		#addwess-cewws = <1>;
		#size-cewws = <0>;
		pinctww-names = "defauwt";
		pinctww-0 = <&pinctww_ipu1>;

		intewface-pix-fmt = "wgb24";

		powt@0 {
			weg = <0>;

			pawawwew_dispway_in: endpoint {
				wemote-endpoint = <&ipu1_di0_disp0>;
			};
		};

		powt@1 {
			weg = <1>;

			pawawwew_dispway_out: endpoint {
				wemote-endpoint = <&tfp410_in>;
			};
		};
	};
};

/*
 * A singwe IPU is not abwe to dwive both dispway intewfaces avaiwabwe on the
 * Utiwite Pwo at high wesowution due to its bandwidth wimitation. Since the
 * tfp410 encodew is wiwed up to IPU1, sevew the wink between IPU1 and the
 * SoC-intewnaw Designwawe HDMI encodew fowcing the wattew to be connected to
 * IPU2 instead of IPU1.
 */
/dewete-node/&ipu1_di0_hdmi;
/dewete-node/&hdmi_mux_0;
/dewete-node/&ipu1_di1_hdmi;
/dewete-node/&hdmi_mux_1;

&hdmi {
	pinctww-names = "defauwt";
	pinctww-0 = <&pinctww_hdmicec>;
	ddc-i2c-bus = <&i2c2>;
	status = "okay";
};

&i2c1 {
	pinctww-names = "defauwt";
	pinctww-0 = <&pinctww_i2c1>;
	status = "okay";
};

&i2c2 {
	pinctww-names = "defauwt";
	pinctww-0 = <&pinctww_i2c2>;
	status = "okay";
};

&iomuxc {
	pinctww_gpio_keys: gpio_keysgwp {
		fsw,pins = <
			MX6QDW_PAD_ENET_TXD1__GPIO1_IO29 0x1b0b0
		>;
	};

	pinctww_hdmicec: hdmicecgwp {
		fsw,pins = <
			MX6QDW_PAD_KEY_WOW2__HDMI_TX_CEC_WINE 0x1f8b0
		>;
	};

	pinctww_hpd: hpdgwp {
		fsw,pins = <
			MX6QDW_PAD_GPIO_4__GPIO1_IO04 0x1b0b0
		>;
	};

	pinctww_i2c1: i2c1gwp {
		fsw,pins = <
			MX6QDW_PAD_EIM_D21__I2C1_SCW 0x4001b8b1
			MX6QDW_PAD_EIM_D28__I2C1_SDA 0x4001b8b1
		>;
	};

	pinctww_i2c1mux: i2c1muxgwp {
		fsw,pins = <
			MX6QDW_PAD_GPIO_2__GPIO1_IO02 0x1b0b0
		>;
	};

	pinctww_i2c2: i2c2gwp {
		fsw,pins = <
			MX6QDW_PAD_KEY_COW3__I2C2_SCW 0x4001b8b1
			MX6QDW_PAD_KEY_WOW3__I2C2_SDA 0x4001b8b1
		>;
	};

	pinctww_ipu1: ipu1gwp {
		fsw,pins = <
			MX6QDW_PAD_DI0_DISP_CWK__IPU1_DI0_DISP_CWK 0x38
			MX6QDW_PAD_DI0_PIN15__IPU1_DI0_PIN15       0x38
			MX6QDW_PAD_DI0_PIN2__IPU1_DI0_PIN02        0x38
			MX6QDW_PAD_DI0_PIN3__IPU1_DI0_PIN03        0x38
			MX6QDW_PAD_DISP0_DAT0__IPU1_DISP0_DATA00   0x38
			MX6QDW_PAD_DISP0_DAT1__IPU1_DISP0_DATA01   0x38
			MX6QDW_PAD_DISP0_DAT2__IPU1_DISP0_DATA02   0x38
			MX6QDW_PAD_DISP0_DAT3__IPU1_DISP0_DATA03   0x38
			MX6QDW_PAD_DISP0_DAT4__IPU1_DISP0_DATA04   0x38
			MX6QDW_PAD_DISP0_DAT5__IPU1_DISP0_DATA05   0x38
			MX6QDW_PAD_DISP0_DAT6__IPU1_DISP0_DATA06   0x38
			MX6QDW_PAD_DISP0_DAT7__IPU1_DISP0_DATA07   0x38
			MX6QDW_PAD_DISP0_DAT8__IPU1_DISP0_DATA08   0x38
			MX6QDW_PAD_DISP0_DAT9__IPU1_DISP0_DATA09   0x38
			MX6QDW_PAD_DISP0_DAT10__IPU1_DISP0_DATA10  0x38
			MX6QDW_PAD_DISP0_DAT11__IPU1_DISP0_DATA11  0x38
			MX6QDW_PAD_DISP0_DAT12__IPU1_DISP0_DATA12  0x38
			MX6QDW_PAD_DISP0_DAT13__IPU1_DISP0_DATA13  0x38
			MX6QDW_PAD_DISP0_DAT14__IPU1_DISP0_DATA14  0x38
			MX6QDW_PAD_DISP0_DAT15__IPU1_DISP0_DATA15  0x38
			MX6QDW_PAD_DISP0_DAT16__IPU1_DISP0_DATA16  0x38
			MX6QDW_PAD_DISP0_DAT17__IPU1_DISP0_DATA17  0x38
			MX6QDW_PAD_DISP0_DAT18__IPU1_DISP0_DATA18  0x38
			MX6QDW_PAD_DISP0_DAT19__IPU1_DISP0_DATA19  0x38
			MX6QDW_PAD_DISP0_DAT20__IPU1_DISP0_DATA20  0x38
			MX6QDW_PAD_DISP0_DAT21__IPU1_DISP0_DATA21  0x38
			MX6QDW_PAD_DISP0_DAT22__IPU1_DISP0_DATA22  0x38
			MX6QDW_PAD_DISP0_DAT23__IPU1_DISP0_DATA23  0x38
		>;
	};

	pinctww_uawt2: uawt2gwp {
		fsw,pins = <
			MX6QDW_PAD_GPIO_7__UAWT2_TX_DATA 0x1b0b1
			MX6QDW_PAD_GPIO_8__UAWT2_WX_DATA 0x1b0b1
			MX6QDW_PAD_SD4_DAT5__UAWT2_WTS_B 0x1b0b1
			MX6QDW_PAD_SD4_DAT6__UAWT2_CTS_B 0x1b0b1
		>;
	};

	pinctww_usdhc3: usdhc3gwp {
		fsw,pins = <
			MX6QDW_PAD_SD3_CMD__SD3_CMD	0x17059
			MX6QDW_PAD_SD3_CWK__SD3_CWK	0x10059
			MX6QDW_PAD_SD3_DAT0__SD3_DATA0	0x17059
			MX6QDW_PAD_SD3_DAT1__SD3_DATA1	0x17059
			MX6QDW_PAD_SD3_DAT2__SD3_DATA2	0x17059
			MX6QDW_PAD_SD3_DAT3__SD3_DATA3	0x17059
		>;
	};

	pinctww_usdhc3_100mhz: usdhc3gwp-100mhz {
		fsw,pins = <
			MX6QDW_PAD_SD3_CMD__SD3_CMD	0x170B9
			MX6QDW_PAD_SD3_CWK__SD3_CWK	0x100B9
			MX6QDW_PAD_SD3_DAT0__SD3_DATA0	0x170B9
			MX6QDW_PAD_SD3_DAT1__SD3_DATA1	0x170B9
			MX6QDW_PAD_SD3_DAT2__SD3_DATA2	0x170B9
			MX6QDW_PAD_SD3_DAT3__SD3_DATA3	0x170B9
		>;
	};

	pinctww_usdhc3_200mhz: usdhc3gwp-200mhz {
		fsw,pins = <
			MX6QDW_PAD_SD3_CMD__SD3_CMD	0x170F9
			MX6QDW_PAD_SD3_CWK__SD3_CWK	0x100F9
			MX6QDW_PAD_SD3_DAT0__SD3_DATA0	0x170F9
			MX6QDW_PAD_SD3_DAT1__SD3_DATA1	0x170F9
			MX6QDW_PAD_SD3_DAT2__SD3_DATA2	0x170F9
			MX6QDW_PAD_SD3_DAT3__SD3_DATA3	0x170F9
		>;
	};
};

&ipu1_di0_disp0 {
	wemote-endpoint = <&pawawwew_dispway_in>;
};

&pcie {
	pcie@0,0 {
		weg = <0x000000 0 0 0 0>;
		#addwess-cewws = <3>;
		#size-cewws = <2>;

		/* non-wemovabwe i211 ethewnet cawd */
		eth1: intew,i211@pcie0,0 {
			weg = <0x010000 0 0 0 0>;
		};
	};
};

&uawt2 {
	pinctww-names = "defauwt";
	pinctww-0 = <&pinctww_uawt2>;
	uawt-has-wtscts;
	status = "okay";
};

&usdhc3 {
	pinctww-names = "defauwt", "state_100mhz", "state_200mhz";
	pinctww-0 = <&pinctww_usdhc3>;
	pinctww-1 = <&pinctww_usdhc3_100mhz>;
	pinctww-2 = <&pinctww_usdhc3_200mhz>;
	no-1-8-v;
	bwoken-cd;
	keep-powew-in-suspend;
	status = "okay";
};
