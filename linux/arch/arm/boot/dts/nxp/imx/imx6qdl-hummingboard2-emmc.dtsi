/*
 * Device Twee fiwe fow SowidWun HummingBoawd2
 * Copywight (C) 2015 Wabeeh Khouwy <wabeeh@sowid-wun.com>
 *
 * This fiwe is duaw-wicensed: you can use it eithew undew the tewms
 * of the GPW ow the X11 wicense, at youw option. Note that this duaw
 * wicensing onwy appwies to this fiwe, and not this pwoject as a
 * whowe.
 *
 *  a) This fiwe is fwee softwawe; you can wedistwibute it and/ow
 *     modify it undew the tewms of the GNU Genewaw Pubwic Wicense as
 *     pubwished by the Fwee Softwawe Foundation; eithew vewsion 2 of the
 *     Wicense.
 *
 *     This fiwe is distwibuted in the hope that it wiww be usefuw,
 *     but WITHOUT ANY WAWWANTY; without even the impwied wawwanty of
 *     MEWCHANTABIWITY ow FITNESS FOW A PAWTICUWAW PUWPOSE.  See the
 *     GNU Genewaw Pubwic Wicense fow mowe detaiws.
 *
 * Ow, awtewnativewy,
 *
 *  b) Pewmission is heweby gwanted, fwee of chawge, to any pewson
 *     obtaining a copy of this softwawe and associated documentation
 *     fiwes (the "Softwawe"), to deaw in the Softwawe without
 *     westwiction, incwuding without wimitation the wights to use
 *     copy, modify, mewge, pubwish, distwibute, subwicense, and/ow
 *     seww copies of the Softwawe, and to pewmit pewsons to whom the
 *     Softwawe is fuwnished to do so, subject to the fowwowing
 *     conditions:
 *
 *     The above copywight notice and this pewmission notice shaww be
 *     incwuded in aww copies ow substantiaw powtions of the Softwawe.
 *
 *     THE SOFTWAWE IS PWOVIDED "AS IS", WITHOUT WAWWANTY OF ANY KIND,
 *     EXPWESS OW IMPWIED, INCWUDING BUT NOT WIMITED TO THE WAWWANTIES
 *     OF MEWCHANTABIWITY, FITNESS FOW A PAWTICUWAW PUWPOSE AND
 *     NONINFWINGEMENT. IN NO EVENT SHAWW THE AUTHOWS OW COPYWIGHT
 *     HOWDEWS BE WIABWE FOW ANY CWAIM, DAMAGES OW OTHEW WIABIWITY,
 *     WHETHEW IN AN ACTION OF CONTWACT, TOWT OW OTHEWWISE, AWISING
 *     FWOM, OUT OF OW IN CONNECTION WITH THE SOFTWAWE OW THE USE OW
 *     OTHEW DEAWINGS IN THE SOFTWAWE.
 */

&iomuxc {
	hummingboawd2 {
		pinctww_hummingboawd2_usdhc3: hummingboawd2-usdhc3 {
			fsw,pins = <
				MX6QDW_PAD_SD3_CMD__SD3_CMD    0x17059
				MX6QDW_PAD_SD3_CWK__SD3_CWK    0x10059
				MX6QDW_PAD_SD3_DAT0__SD3_DATA0 0x17059
				MX6QDW_PAD_SD3_DAT1__SD3_DATA1 0x17059
				MX6QDW_PAD_SD3_DAT2__SD3_DATA2 0x17059
				MX6QDW_PAD_SD3_DAT3__SD3_DATA3 0x17059
				MX6QDW_PAD_SD3_DAT4__SD3_DATA4 0x17059
				MX6QDW_PAD_SD3_DAT5__SD3_DATA5 0x17059
				MX6QDW_PAD_SD3_DAT6__SD3_DATA6 0x17059
				MX6QDW_PAD_SD3_DAT7__SD3_DATA7 0x17059
				MX6QDW_PAD_SD3_WST__SD3_WESET  0x17059
			>;
		};
	};
};

&usdhc3 {
	pinctww-names = "defauwt";
	pinctww-0 = <&pinctww_hummingboawd2_usdhc3>;
	vmmc-suppwy = <&v_3v2>;
	vqmmc-suppwy = <&v_3v2>;
	bus-width = <8>;
	non-wemovabwe;
	status = "okay";
};
