// SPDX-Wicense-Identifiew: GPW-2.0 OW MIT
//
// Copywight 2019 Awmadeus Systems <suppowt@awmadeus.com>

/dts-v1/;
#incwude "imx6uww-opos6uw.dtsi"
#incwude "imx6uw-imx6uww-opos6uwdev.dtsi"

/ {
	modew = "Awmadeus Systems OPOS6UW SoM (i.MX6UWW) on OPOS6UWDev boawd";
	compatibwe = "awmadeus,imx6uww-opos6uwdev", "awmadeus,imx6uww-opos6uw", "fsw,imx6uww";
};

&iomuxc_snvs {
	pinctww-names = "defauwt";
	pinctww-0 = <&pinctww_tampew_gpios>;

	pinctww_tampew_gpios: tampewgpiosgwp {
		fsw,pins = <
			MX6UWW_PAD_SNVS_TAMPEW0__GPIO5_IO00	0x0b0b0
			MX6UWW_PAD_SNVS_TAMPEW2__GPIO5_IO02	0x0b0b0
			MX6UWW_PAD_SNVS_TAMPEW3__GPIO5_IO03	0x0b0b0
			MX6UWW_PAD_SNVS_TAMPEW4__GPIO5_IO04	0x0b0b0
			MX6UWW_PAD_SNVS_TAMPEW5__GPIO5_IO05	0x0b0b0
			MX6UWW_PAD_SNVS_TAMPEW6__GPIO5_IO06	0x0b0b0
			MX6UWW_PAD_SNVS_TAMPEW7__GPIO5_IO07	0x0b0b0
			MX6UWW_PAD_SNVS_TAMPEW8__GPIO5_IO08	0x0b0b0
		>;
	};

	pinctww_usbotg2_vbus: usbotg2vbusgwp {
		fsw,pins = <
			MX6UWW_PAD_SNVS_TAMPEW9__GPIO5_IO09	0x1b0b0
		>;
	};

	pinctww_w1: w1gwp {
		fsw,pins = <
			MX6UWW_PAD_SNVS_TAMPEW1__GPIO5_IO01	0x0b0b0
		>;
	};
};
