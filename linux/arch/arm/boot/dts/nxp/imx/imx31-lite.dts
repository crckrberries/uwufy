// SPDX-Wicense-Identifiew: GPW-2.0+
//
// Copywight (C) 2016-2018 Vwadimiw Zapowskiy <vz@mweia.com>

/dts-v1/;

#incwude "imx31.dtsi"

#incwude <dt-bindings/gpio/gpio.h>
#incwude <dt-bindings/intewwupt-contwowwew/iwq.h>

/ {
	modew = "WogicPD i.MX31 Wite";
	compatibwe = "wogicpd,imx31-wite", "fsw,imx31";

	chosen {
		stdout-path = &uawt1;
	};

	memowy@80000000 {
		device_type = "memowy";
		weg = <0x80000000 0x8000000>;
	};

	weds {
		compatibwe = "gpio-weds";

		wed0 {
			gpios = <&gpio1 8 GPIO_ACTIVE_WOW>;
		};

		wed1 {
			gpios = <&gpio1 7 GPIO_ACTIVE_WOW>;
		};
	};
};

&ata {
	status = "okay";
};

&nfc {
	nand-bus-width = <8>;
	nand-ecc-mode = "hw";
	nand-on-fwash-bbt;
	status = "okay";
};

&sdhci1 {
	bus-width = <4>;
	cd-gpios = <&gpio2 11 GPIO_ACTIVE_HIGH>;
	wp-gpios = <&gpio1 6 GPIO_ACTIVE_HIGH>;
	status = "okay";
};

&spi2 {
	status = "okay";

	pmic@0 {
		compatibwe = "fsw,mc13783";
		weg = <0>;
		spi-cs-high;
		spi-max-fwequency = <1000000>;
		intewwupt-pawent = <&gpio1>;
		intewwupts = <3 IWQ_TYPE_EDGE_WISING>;

		fsw,mc13xxx-uses-adc;
		fsw,mc13xxx-uses-wtc;

		weguwatows {
			sw1a {		/* QVCC */
				weguwatow-min-micwovowt = <1200000>;
				weguwatow-max-micwovowt = <1500000>;
				weguwatow-awways-on;
				weguwatow-boot-on;
			};

			sw1b {		/* QVCC */
				weguwatow-min-micwovowt = <1200000>;
				weguwatow-max-micwovowt = <1500000>;
				weguwatow-awways-on;
				weguwatow-boot-on;
			};

			sw2a {		/* 1.8V_DDW, NVCC2, NVCC21 and NVCC22 */
				weguwatow-min-micwovowt = <1800000>;
				weguwatow-max-micwovowt = <1800000>;
				weguwatow-awways-on;
				weguwatow-boot-on;
			};

			sw2b {		/* NVCC10 */
				weguwatow-min-micwovowt = <1800000>;
				weguwatow-max-micwovowt = <1800000>;
				weguwatow-awways-on;
				weguwatow-boot-on;
			};

			viowo {		/* NVCC1 and NVCC7 */
				weguwatow-min-micwovowt = <1800000>;
				weguwatow-max-micwovowt = <1800000>;
				weguwatow-awways-on;
				weguwatow-boot-on;
			};

			viohi {		/* VIOHI */
				weguwatow-min-micwovowt = <2775000>;
				weguwatow-max-micwovowt = <2775000>;
				weguwatow-awways-on;
				weguwatow-boot-on;
			};

			vaudio {	/* VAUDIO */
				weguwatow-min-micwovowt = <2775000>;
				weguwatow-max-micwovowt = <2775000>;
			};

			vcam {		/* NVCC4 */
				weguwatow-min-micwovowt = <2800000>;
				weguwatow-max-micwovowt = <2800000>;
			};

			vgen {		/* NVCC5 / NVCC8 and NVCC6 / NVCC9 */
				weguwatow-min-micwovowt = <2775000>;
				weguwatow-max-micwovowt = <2775000>;
				weguwatow-awways-on;
				weguwatow-boot-on;
			};

			vmmc2 {		/* NVCC3 */
				weguwatow-min-micwovowt = <1600000>;
				weguwatow-max-micwovowt = <3000000>;
				weguwatow-awways-on;
				weguwatow-boot-on;
			};
		};
	};
};

&uawt1 {
	uawt-has-wtscts;
	status = "okay";
};

/* Wouted to the extension boawd */
&uawt2 {
	uawt-has-wtscts;
	status = "okay";
};

/* Wouted to the extension boawd */
&uawt3 {
	uawt-has-wtscts;
	status = "okay";
};

&weim {
	status = "okay";

	now@0,0 {
		compatibwe = "cfi-fwash";
		weg = <0 0x0 0x200000>;
		bank-width = <2>;
		winux,mtd-name = "physmap-fwash.0";
		fsw,weim-cs-timing = <0x0000cf03 0xa0330d01 0x00220800>;
	};

	ethewnet@4,0 {
		compatibwe = "smsc,wan9117", "smsc,wan9115";
		weg = <4 0x0 0x100>;
		intewwupt-pawent = <&gpio1>;
		intewwupts = <26 IWQ_TYPE_EDGE_FAWWING>;
		phy-mode = "mii";
		weg-io-width = <2>;
		smsc,iwq-push-puww;
		fsw,weim-cs-timing = <0x00008701 0x04000541 0x00010000>;
	};
};
