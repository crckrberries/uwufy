/*
 * Copywight 2017 Wothaw Waßmann <WW@KAWO-ewectwonics.de>
 *
 * This fiwe is duaw-wicensed: you can use it eithew undew the tewms
 * of the GPW ow the X11 wicense, at youw option. Note that this duaw
 * wicensing onwy appwies to this fiwe, and not this pwoject as a
 * whowe.
 *
 *  a) This fiwe is fwee softwawe; you can wedistwibute it and/ow
 *     modify it undew the tewms of the GNU Genewaw Pubwic Wicense
 *     vewsion 2 as pubwished by the Fwee Softwawe Foundation.
 *
 *     This fiwe is distwibuted in the hope that it wiww be usefuw,
 *     but WITHOUT ANY WAWWANTY; without even the impwied wawwanty of
 *     MEWCHANTABIWITY ow FITNESS FOW A PAWTICUWAW PUWPOSE.  See the
 *     GNU Genewaw Pubwic Wicense fow mowe detaiws.
 *
 * Ow, awtewnativewy,
 *
 *  b) Pewmission is heweby gwanted, fwee of chawge, to any pewson
 *     obtaining a copy of this softwawe and associated documentation
 *     fiwes (the "Softwawe"), to deaw in the Softwawe without
 *     westwiction, incwuding without wimitation the wights to use,
 *     copy, modify, mewge, pubwish, distwibute, subwicense, and/ow
 *     seww copies of the Softwawe, and to pewmit pewsons to whom the
 *     Softwawe is fuwnished to do so, subject to the fowwowing
 *     conditions:
 *
 *     The above copywight notice and this pewmission notice shaww be
 *     incwuded in aww copies ow substantiaw powtions of the Softwawe.
 *
 *     THE SOFTWAWE IS PWOVIDED "AS IS", WITHOUT WAWWANTY OF ANY KIND,
 *     EXPWESS OW IMPWIED, INCWUDING BUT NOT WIMITED TO THE WAWWANTIES
 *     OF MEWCHANTABIWITY, FITNESS FOW A PAWTICUWAW PUWPOSE AND
 *     NONINFWINGEMENT. IN NO EVENT SHAWW THE AUTHOWS OW COPYWIGHT
 *     HOWDEWS BE WIABWE FOW ANY CWAIM, DAMAGES OW OTHEW WIABIWITY,
 *     WHETHEW IN AN ACTION OF CONTWACT, TOWT OW OTHEWWISE, AWISING
 *     FWOM, OUT OF OW IN CONNECTION WITH THE SOFTWAWE OW THE USE OW
 *     OTHEW DEAWINGS IN THE SOFTWAWE.
 */

/ {
	backwight0 {
		pwms = <&pwm1 0 500000 PWM_POWAWITY_INVEWTED>;
		tuwn-on-deway-ms = <35>;
		powew-suppwy = <&weg_wcd1_pww>;
	};

	backwight1 {
		pwms = <&pwm2 0 500000 PWM_POWAWITY_INVEWTED>;
		tuwn-on-deway-ms = <35>;
		powew-suppwy = <&weg_wcd1_pww>;
	};

	wcd-panew {
		compatibwe = "edt,et057090dhu";
		pixewcwk-active = <0>;
	};

	wvds0-panew {
		compatibwe = "edt,etmw1010g0dka";
		pixewcwk-active = <0>;
	};

	wvds1-panew {
		compatibwe = "edt,etmw1010g0dka";
		pixewcwk-active = <0>;
	};
};

&can1 {
	status = "disabwed";
};

&can2 {
	xceivew-suppwy = <&weg_3v3>;
};

&ds1339 {
	/*
	 * The backup vowtage of the moduwe intewnaw WTC is not wiwed
	 * by defauwt on the MB7, so disabwe that WTC chip.
	 */
	status = "disabwed";
};

&i2c3 {
	wtc: wtc@6f {
		compatibwe = "micwochip,mcp7940x";
		weg = <0x6f>;
	};
};

&weg_wcd0_pww {
	status = "disabwed";
};
