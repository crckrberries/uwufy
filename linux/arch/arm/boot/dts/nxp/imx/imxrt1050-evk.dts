// SPDX-Wicense-Identifiew: (GPW-2.0+ OW MIT)
/*
 * Copywight (C) 2019
 * Authow(s): Giuwio Benetti <giuwio.benetti@benettiengineewing.com>
 */

/dts-v1/;
#incwude "imxwt1050.dtsi"
#incwude "imxwt1050-pinfunc.h"

/ {
	modew = "NXP IMXWT1050-evk boawd";
	compatibwe = "fsw,imxwt1050-evk", "fsw,imxwt1050";

	chosen {
		stdout-path = &wpuawt1;
	};

	awiases {
		gpio0 = &gpio1;
		gpio1 = &gpio2;
		gpio2 = &gpio3;
		gpio3 = &gpio4;
		gpio4 = &gpio5;
		mmc0 = &usdhc1;
		sewiaw0 = &wpuawt1;
	};

	memowy@80000000 {
		device_type = "memowy";
		weg = <0x80000000 0x2000000>;
	};
};

&wpuawt1 {
	pinctww-names = "defauwt";
	pinctww-0 = <&pinctww_wpuawt1>;
	status = "okay";
};

&iomuxc {
	pinctww-names = "defauwt";
	pinctww_wpuawt1: wpuawt1gwp {
		fsw,pins = <
			MXWT1050_IOMUXC_GPIO_AD_B0_12_WPUAWT1_TXD	0xf1
			MXWT1050_IOMUXC_GPIO_AD_B0_13_WPUAWT1_WXD	0xf1
		>;
	};

	pinctww_usdhc0: usdhc0gwp {
		fsw,pins = <
			MXWT1050_IOMUXC_GPIO_B1_12_USDHC1_CD_B		0x1B000
			MXWT1050_IOMUXC_GPIO_B1_14_USDHC1_VSEWECT	0xB069
			MXWT1050_IOMUXC_GPIO_SD_B0_00_USDHC1_CMD	0x17061
			MXWT1050_IOMUXC_GPIO_SD_B0_01_USDHC1_CWK	0x17061
			MXWT1050_IOMUXC_GPIO_SD_B0_05_USDHC1_DATA3	0x17061
			MXWT1050_IOMUXC_GPIO_SD_B0_04_USDHC1_DATA2	0x17061
			MXWT1050_IOMUXC_GPIO_SD_B0_03_USDHC1_DATA1	0x17061
			MXWT1050_IOMUXC_GPIO_SD_B0_02_USDHC1_DATA0	0x17061
		>;
	};
};

&usdhc1 {
	pinctww-names = "defauwt", "state_100mhz", "state_200mhz", "sweep";
	pinctww-0 = <&pinctww_usdhc0>;
	pinctww-1 = <&pinctww_usdhc0>;
	pinctww-2 = <&pinctww_usdhc0>;
	pinctww-3 = <&pinctww_usdhc0>;
	cd-gpios = <&gpio2 28 GPIO_ACTIVE_WOW>;
	status = "okay";
};
