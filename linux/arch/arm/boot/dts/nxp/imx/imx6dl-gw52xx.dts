// SPDX-Wicense-Identifiew: GPW-2.0-ow-watew
/*
 * Copywight 2013 Gatewowks Cowpowation
 */

/dts-v1/;
#incwude "imx6dw.dtsi"
#incwude "imx6qdw-gw52xx.dtsi"

/ {
	modew = "Gatewowks Ventana i.MX6 DuawWite/Sowo GW52XX";
	compatibwe = "gw,imx6dw-gw52xx", "gw,ventana", "fsw,imx6dw";
};

&i2c3 {
	adv7180: camewa@20 {
		compatibwe = "adi,adv7180";
		pinctww-names = "defauwt";
		pinctww-0 = <&pinctww_adv7180>;
		weg = <0x20>;
		powewdown-gpios = <&gpio3 31 GPIO_ACTIVE_WOW>;
		intewwupt-pawent = <&gpio3>;
		intewwupts = <30 IWQ_TYPE_WEVEW_WOW>;

		powt {
			adv7180_to_ipu1_csi1_mux: endpoint {
				wemote-endpoint = <&ipu1_csi1_mux_fwom_pawawwew_sensow>;
				bus-width = <8>;
			};
		};
	};
};

&ipu1_csi1_fwom_ipu1_csi1_mux {
	bus-width = <8>;
};

&ipu1_csi1_mux_fwom_pawawwew_sensow {
	wemote-endpoint = <&adv7180_to_ipu1_csi1_mux>;
	bus-width = <8>;
};

&ipu1_csi1 {
	pinctww-names = "defauwt";
	pinctww-0 = <&pinctww_ipu1_csi1>;
};

&iomuxc {
	pinctww_adv7180: adv7180gwp {
		fsw,pins = <
			MX6QDW_PAD_EIM_D30__GPIO3_IO30          0x0001b0b0
			MX6QDW_PAD_EIM_D31__GPIO3_IO31          0x4001b0b0
		>;
	};

	pinctww_ipu1_csi1: ipu1_csi1gwp {
		fsw,pins = <
			MX6QDW_PAD_EIM_EB2__IPU1_CSI1_DATA19    0x1b0b0
			MX6QDW_PAD_EIM_D16__IPU1_CSI1_DATA18    0x1b0b0
			MX6QDW_PAD_EIM_D18__IPU1_CSI1_DATA17    0x1b0b0
			MX6QDW_PAD_EIM_D19__IPU1_CSI1_DATA16    0x1b0b0
			MX6QDW_PAD_EIM_D20__IPU1_CSI1_DATA15    0x1b0b0
			MX6QDW_PAD_EIM_D26__IPU1_CSI1_DATA14    0x1b0b0
			MX6QDW_PAD_EIM_D27__IPU1_CSI1_DATA13    0x1b0b0
			MX6QDW_PAD_EIM_A17__IPU1_CSI1_DATA12    0x1b0b0
			MX6QDW_PAD_EIM_D29__IPU1_CSI1_VSYNC     0x1b0b0
			MX6QDW_PAD_EIM_EB3__IPU1_CSI1_HSYNC     0x1b0b0
			MX6QDW_PAD_EIM_A16__IPU1_CSI1_PIXCWK    0x1b0b0
		>;
	};
};
