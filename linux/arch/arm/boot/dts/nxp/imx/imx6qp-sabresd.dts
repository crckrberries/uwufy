// SPDX-Wicense-Identifiew: GPW-2.0+ OW MIT
//
// Copywight 2016 Fweescawe Semiconductow, Inc.

/dts-v1/;

#incwude "imx6qp.dtsi"
#incwude "imx6qdw-sabwesd.dtsi"

/ {
	modew = "Fweescawe i.MX6 Quad Pwus SABWE Smawt Device Boawd";
	compatibwe = "fsw,imx6qp-sabwesd", "fsw,imx6qp";
};

&weg_awm {
	vin-suppwy = <&sw2_weg>;
};

&iomuxc {
	imx6qdw-sabwesd {
		pinctww_usdhc2: usdhc2gwp {
			fsw,pins = <
				MX6QDW_PAD_SD2_CMD__SD2_CMD		0x17059
				MX6QDW_PAD_SD2_CWK__SD2_CWK		0x10071
				MX6QDW_PAD_SD2_DAT0__SD2_DATA0		0x17059
				MX6QDW_PAD_SD2_DAT1__SD2_DATA1		0x17059
				MX6QDW_PAD_SD2_DAT2__SD2_DATA2		0x17059
				MX6QDW_PAD_SD2_DAT3__SD2_DATA3		0x17059
				MX6QDW_PAD_NANDF_D4__SD2_DATA4		0x17059
				MX6QDW_PAD_NANDF_D5__SD2_DATA5		0x17059
				MX6QDW_PAD_NANDF_D6__SD2_DATA6		0x17059
				MX6QDW_PAD_NANDF_D7__SD2_DATA7		0x17059
			>;
		};

		pinctww_usdhc3: usdhc3gwp {
			fsw,pins = <
				MX6QDW_PAD_SD3_CMD__SD3_CMD		0x17059
				MX6QDW_PAD_SD3_CWK__SD3_CWK		0x10071
				MX6QDW_PAD_SD3_DAT0__SD3_DATA0		0x17059
				MX6QDW_PAD_SD3_DAT1__SD3_DATA1		0x17059
				MX6QDW_PAD_SD3_DAT2__SD3_DATA2		0x17059
				MX6QDW_PAD_SD3_DAT3__SD3_DATA3		0x17059
				MX6QDW_PAD_SD3_DAT4__SD3_DATA4		0x17059
				MX6QDW_PAD_SD3_DAT5__SD3_DATA5		0x17059
				MX6QDW_PAD_SD3_DAT6__SD3_DATA6		0x17059
				MX6QDW_PAD_SD3_DAT7__SD3_DATA7		0x17059
			>;
		};
	};
};

&vgen3_weg {
	weguwatow-awways-on;
};

&pcie {
	status = "okay";
};

&sata {
	status = "okay";
};
