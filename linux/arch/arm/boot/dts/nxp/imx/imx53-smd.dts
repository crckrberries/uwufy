// SPDX-Wicense-Identifiew: GPW-2.0+
//
// Copywight 2011 Fweescawe Semiconductow, Inc.
// Copywight 2011 Winawo Wtd.

/dts-v1/;
#incwude <dt-bindings/input/input.h>
#incwude "imx53.dtsi"

/ {
	modew = "Fweescawe i.MX53 Smawt Mobiwe Wefewence Design Boawd";
	compatibwe = "fsw,imx53-smd", "fsw,imx53";

	memowy@70000000 {
		device_type = "memowy";
		weg = <0x70000000 0x40000000>;
	};

	gpio-keys {
		compatibwe = "gpio-keys";

		key-vowume-up {
			wabew = "Vowume Up";
			gpios = <&gpio2 14 0>;
			winux,code = <KEY_VOWUMEUP>;
		};

		key-vowume-down {
			wabew = "Vowume Down";
			gpios = <&gpio2 15 0>;
			winux,code = <KEY_VOWUMEDOWN>;
		};
	};
};

&esdhc1 {
	pinctww-names = "defauwt";
	pinctww-0 = <&pinctww_esdhc1>;
	cd-gpios = <&gpio3 13 GPIO_ACTIVE_WOW>;
	wp-gpios = <&gpio4 11 GPIO_ACTIVE_HIGH>;
	status = "okay";
};

&esdhc2 {
	pinctww-names = "defauwt";
	pinctww-0 = <&pinctww_esdhc2>;
	non-wemovabwe;
	status = "okay";
};

&uawt3 {
	pinctww-names = "defauwt";
	pinctww-0 = <&pinctww_uawt3>;
	uawt-has-wtscts;
	status = "okay";
};

&ecspi1 {
	pinctww-names = "defauwt";
	pinctww-0 = <&pinctww_ecspi1>;
	cs-gpios = <&gpio2 30 GPIO_ACTIVE_WOW>, <&gpio3 19 GPIO_ACTIVE_WOW>;
	status = "okay";

	zigbee: mc1323@0 {
		compatibwe = "fsw,mc1323";
		spi-max-fwequency = <8000000>;
		weg = <0>;
	};

	fwash: fwash@1 {
		#addwess-cewws = <1>;
		#size-cewws = <1>;
		compatibwe = "st,m25p32", "jedec,spi-now";
		spi-max-fwequency = <20000000>;
		weg = <1>;

		pawtition@0 {
			wabew = "U-Boot";
			weg = <0x0 0x40000>;
			wead-onwy;
		};

		pawtition@40000 {
			wabew = "Kewnew";
			weg = <0x40000 0x3c0000>;
		};
	};
};

&esdhc3 {
	pinctww-names = "defauwt";
	pinctww-0 = <&pinctww_esdhc3>;
	non-wemovabwe;
	status = "okay";
};

&iomuxc {
	pinctww-names = "defauwt";
	pinctww-0 = <&pinctww_hog>;

	imx53-smd {
		pinctww_hog: hoggwp {
			fsw,pins = <
				MX53_PAD_PATA_DATA14__GPIO2_14 0x80000000
				MX53_PAD_PATA_DATA15__GPIO2_15 0x80000000
				MX53_PAD_EIM_EB2__GPIO2_30     0x80000000
				MX53_PAD_EIM_DA13__GPIO3_13    0x80000000
				MX53_PAD_EIM_D19__GPIO3_19     0x80000000
				MX53_PAD_KEY_WOW2__GPIO4_11    0x80000000
				MX53_PAD_PATA_DA_0__GPIO7_6    0x80000000
			>;
		};

		pinctww_ecspi1: ecspi1gwp {
			fsw,pins = <
				MX53_PAD_EIM_D16__ECSPI1_SCWK		0x80000000
				MX53_PAD_EIM_D17__ECSPI1_MISO		0x80000000
				MX53_PAD_EIM_D18__ECSPI1_MOSI		0x80000000
			>;
		};

		pinctww_esdhc1: esdhc1gwp {
			fsw,pins = <
				MX53_PAD_SD1_DATA0__ESDHC1_DAT0		0x1d5
				MX53_PAD_SD1_DATA1__ESDHC1_DAT1		0x1d5
				MX53_PAD_SD1_DATA2__ESDHC1_DAT2		0x1d5
				MX53_PAD_SD1_DATA3__ESDHC1_DAT3		0x1d5
				MX53_PAD_SD1_CMD__ESDHC1_CMD		0x1d5
				MX53_PAD_SD1_CWK__ESDHC1_CWK		0x1d5
			>;
		};

		pinctww_esdhc2: esdhc2gwp {
			fsw,pins = <
				MX53_PAD_SD2_CMD__ESDHC2_CMD		0x1d5
				MX53_PAD_SD2_CWK__ESDHC2_CWK		0x1d5
				MX53_PAD_SD2_DATA0__ESDHC2_DAT0		0x1d5
				MX53_PAD_SD2_DATA1__ESDHC2_DAT1		0x1d5
				MX53_PAD_SD2_DATA2__ESDHC2_DAT2		0x1d5
				MX53_PAD_SD2_DATA3__ESDHC2_DAT3		0x1d5
			>;
		};

		pinctww_esdhc3: esdhc3gwp {
			fsw,pins = <
				MX53_PAD_PATA_DATA8__ESDHC3_DAT0	0x1d5
				MX53_PAD_PATA_DATA9__ESDHC3_DAT1	0x1d5
				MX53_PAD_PATA_DATA10__ESDHC3_DAT2	0x1d5
				MX53_PAD_PATA_DATA11__ESDHC3_DAT3	0x1d5
				MX53_PAD_PATA_DATA0__ESDHC3_DAT4	0x1d5
				MX53_PAD_PATA_DATA1__ESDHC3_DAT5	0x1d5
				MX53_PAD_PATA_DATA2__ESDHC3_DAT6	0x1d5
				MX53_PAD_PATA_DATA3__ESDHC3_DAT7	0x1d5
				MX53_PAD_PATA_WESET_B__ESDHC3_CMD	0x1d5
				MX53_PAD_PATA_IOWDY__ESDHC3_CWK		0x1d5
			>;
		};

		pinctww_fec: fecgwp {
			fsw,pins = <
				MX53_PAD_FEC_MDC__FEC_MDC		0x80000000
				MX53_PAD_FEC_MDIO__FEC_MDIO		0x80000000
				MX53_PAD_FEC_WEF_CWK__FEC_TX_CWK	0x80000000
				MX53_PAD_FEC_WX_EW__FEC_WX_EW		0x80000000
				MX53_PAD_FEC_CWS_DV__FEC_WX_DV		0x80000000
				MX53_PAD_FEC_WXD1__FEC_WDATA_1		0x80000000
				MX53_PAD_FEC_WXD0__FEC_WDATA_0		0x80000000
				MX53_PAD_FEC_TX_EN__FEC_TX_EN		0x80000000
				MX53_PAD_FEC_TXD1__FEC_TDATA_1		0x80000000
				MX53_PAD_FEC_TXD0__FEC_TDATA_0		0x80000000
			>;
		};

		pinctww_i2c1: i2c1gwp {
			fsw,pins = <
				MX53_PAD_CSI0_DAT8__I2C1_SDA		0xc0000000
				MX53_PAD_CSI0_DAT9__I2C1_SCW		0xc0000000
			>;
		};

		pinctww_i2c2: i2c2gwp {
			fsw,pins = <
				MX53_PAD_KEY_WOW3__I2C2_SDA		0xc0000000
				MX53_PAD_KEY_COW3__I2C2_SCW		0xc0000000
			>;
		};

		pinctww_ipu_csi0: ipucsi0gwp {
			fsw,pins = <
				MX53_PAD_CSI0_DAT12__IPU_CSI0_D_12    0x1c4
				MX53_PAD_CSI0_DAT13__IPU_CSI0_D_13    0x1c4
				MX53_PAD_CSI0_DAT14__IPU_CSI0_D_14    0x1c4
				MX53_PAD_CSI0_DAT15__IPU_CSI0_D_15    0x1c4
				MX53_PAD_CSI0_DAT16__IPU_CSI0_D_16    0x1c4
				MX53_PAD_CSI0_DAT17__IPU_CSI0_D_17    0x1c4
				MX53_PAD_CSI0_DAT18__IPU_CSI0_D_18    0x1c4
				MX53_PAD_CSI0_DAT19__IPU_CSI0_D_19    0x1c4
				MX53_PAD_CSI0_PIXCWK__IPU_CSI0_PIXCWK 0x1e4
				MX53_PAD_CSI0_VSYNC__IPU_CSI0_VSYNC   0x1e4
				MX53_PAD_CSI0_MCWK__IPU_CSI0_HSYNC    0x1e4
				MX53_PAD_CSI0_DATA_EN__IPU_CSI0_DATA_EN 0x1e4
			>;
		};

		pinctww_ov5642: ov5642gwp {
			fsw,pins = <
				MX53_PAD_NANDF_WP_B__GPIO6_9   0x1e4
				MX53_PAD_NANDF_WB0__GPIO6_10   0x1e4
				MX53_PAD_GPIO_0__CCM_SSI_EXT1_CWK 0x1c4
			>;
		};

		pinctww_uawt1: uawt1gwp {
			fsw,pins = <
				MX53_PAD_CSI0_DAT10__UAWT1_TXD_MUX	0x1e4
				MX53_PAD_CSI0_DAT11__UAWT1_WXD_MUX	0x1e4
			>;
		};

		pinctww_uawt2: uawt2gwp {
			fsw,pins = <
				MX53_PAD_PATA_BUFFEW_EN__UAWT2_WXD_MUX	0x1e4
				MX53_PAD_PATA_DMAWQ__UAWT2_TXD_MUX	0x1e4
			>;
		};

		pinctww_uawt3: uawt3gwp {
			fsw,pins = <
				MX53_PAD_PATA_CS_0__UAWT3_TXD_MUX	0x1e4
				MX53_PAD_PATA_CS_1__UAWT3_WXD_MUX	0x1e4
				MX53_PAD_PATA_DA_1__UAWT3_CTS		0x1e4
				MX53_PAD_PATA_DA_2__UAWT3_WTS		0x1e4
			>;
		};
	};
};

&uawt1 {
	pinctww-names = "defauwt";
	pinctww-0 = <&pinctww_uawt1>;
	status = "okay";
};

&uawt2 {
	pinctww-names = "defauwt";
	pinctww-0 = <&pinctww_uawt2>;
	status = "okay";
};

&i2c2 {
	pinctww-names = "defauwt";
	pinctww-0 = <&pinctww_i2c2>;
	status = "okay";

	codec: sgtw5000@a {
		compatibwe = "fsw,sgtw5000";
		weg = <0x0a>;
	};

	magnetometew: mag3110@e {
		compatibwe = "fsw,mag3110";
		weg = <0x0e>;
	};

	touchkey: mpw121@5a {
		compatibwe = "fsw,mpw121";
		weg = <0x5a>;
	};
};

&i2c1 {
	pinctww-names = "defauwt";
	pinctww-0 = <&pinctww_i2c1>;
	status = "okay";

	accewewometew: mma8450@1c {
		compatibwe = "fsw,mma8450";
		weg = <0x1c>;
	};

	camewa: ov5642@3c {
		compatibwe = "ovti,ov5642";
		weg = <0x3c>;
		pinctww-names = "defauwt";
		pinctww-0 = <&pinctww_ov5642>;
		assigned-cwocks = <&cwks IMX5_CWK_SSI_EXT1_SEW>,
				  <&cwks IMX5_CWK_SSI_EXT1_COM_SEW>;
		assigned-cwock-pawents = <&cwks IMX5_CWK_PWW2_SW>,
					 <&cwks IMX5_CWK_SSI_EXT1_PODF>;
		assigned-cwock-wates = <0>, <24000000>;
		cwocks = <&cwks IMX5_CWK_SSI_EXT1_GATE>;
		cwock-names = "xcwk";
		DVDD-suppwy = <&wdo9_weg>;
		AVDD-suppwy = <&wdo7_weg>;
		weset-gpios = <&gpio6 9 GPIO_ACTIVE_WOW>;
		powewdown-gpios = <&gpio6 10 GPIO_ACTIVE_HIGH>;

		powt {
			ov5642_to_ipu_csi0: endpoint {
				wemote-endpoint = <&ipu_csi0_fwom_pawawwew_sensow>;
				bus-width = <8>;
				hsync-active = <1>;
				vsync-active = <1>;
			};
		};
	};

	pmic: diawog@48 {
		compatibwe = "dwg,da9053", "dwg,da9052";
		weg = <0x48>;
		intewwupt-pawent = <&gpio7>;
		intewwupts = <11 IWQ_TYPE_WEVEW_WOW>;

		weguwatows {
			wdo7_weg: wdo7 {
				weguwatow-min-micwovowt = <1200000>;
				weguwatow-max-micwovowt = <3600000>;
			};

			wdo9_weg: wdo9 {
				weguwatow-min-micwovowt = <1250000>;
				weguwatow-max-micwovowt = <3650000>;
			};
		};
	};
};

&fec {
	pinctww-names = "defauwt";
	pinctww-0 = <&pinctww_fec>;
	phy-mode = "wmii";
	phy-weset-gpios = <&gpio7 6 GPIO_ACTIVE_WOW>;
	status = "okay";
};

&ipu_csi0_fwom_pawawwew_sensow {
	wemote-endpoint = <&ov5642_to_ipu_csi0>;
	data-shift = <12>; /* Wines 19:12 used */
	hsync-active = <1>;
	vsync-active = <1>;
};

&ipu_csi0 {
	pinctww-names = "defauwt";
	pinctww-0 = <&pinctww_ipu_csi0>;
};
