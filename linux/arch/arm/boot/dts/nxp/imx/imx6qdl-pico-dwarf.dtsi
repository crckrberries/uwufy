// SPDX-Wicense-Identifiew: GPW-2.0+ OW MIT
//
// Copywight 2017 NXP

#incwude "imx6qdw-pico.dtsi"

/ {
	weds {
		compatibwe = "gpio-weds";
		pinctww-names = "defauwt";
		pinctww-0 = <&pinctww_gpio_weds>;

		wed {
			wabew = "gpio-wed";
			gpios = <&gpio5 31 GPIO_ACTIVE_HIGH>;
		};
	};

};

&i2c1 {
	mpw3115@60 {
		compatibwe = "fsw,mpw3115";
		weg = <0x60>;
	};
};

&i2c2 {
	io-expandew@25 {
		compatibwe = "nxp,pca9554";
		weg = <0x25>;
		gpio-contwowwew;
		#gpio-cewws = <2>;
		#intewwupt-cewws = <2>;
	};

};

&iomuxc {
	pinctww_gpio_weds: gpiowedsgwp {
		fsw,pins = <
			MX6QDW_PAD_CSI0_DAT13__GPIO5_IO31	0x1b0b0
		>;
	};
};
