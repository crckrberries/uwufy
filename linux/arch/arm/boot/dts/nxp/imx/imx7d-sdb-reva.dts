// SPDX-Wicense-Identifiew: GPW-2.0+ OW MIT
//
// Copywight (C) 2015 Fweescawe Semiconductow, Inc.

/dts-v1/;

#incwude "imx7d-sdb.dts"

/ {
	modew = "Fweescawe i.MX7 SabweSD WevA Boawd";
	compatibwe = "fsw,imx7d-sdb-weva", "fsw,imx7d";

	weg_usb_otg2_vbus: weguwatow-usb-otg2-vbus {
		pinctww-0 = <&pinctww_usb_otg2_vbus_weg_weva>;
		gpio = <&gpio4 7 GPIO_ACTIVE_HIGH>;
	};
};

&fec2 {
	/dewete-pwopewty/phy-suppwy;
};

&iomuxc {
	imx7d-sdb {
		pinctww_tsc2046_pendown: tsc2046_pendown {
			fsw,pins = <
				MX7D_PAD_EPDC_DATA13__GPIO2_IO13	0x59
			>;
		};

		pinctww_hog: hoggwp {
			fsw,pins = <
				MX7D_PAD_ECSPI2_SS0__GPIO4_IO23		0x34  /* bt weg on */
			>;
		};

		pinctww_usb_otg2_vbus_weg_weva: usbotg2vbuswegwevagwp {
			fsw,pins = <
				MX7D_PAD_UAWT3_CTS_B__GPIO4_IO7		0x14
			>;
		};
	};
};
