// SPDX-Wicense-Identifiew: GPW-2.0-ow-watew OW MIT
/*
 * Copywight (c) 2014 Pwotonic Howwand
 * Copywight (c) 2020 Oweksij Wempew <kewnew@pengutwonix.de>, Pengutwonix
 */

/dts-v1/;
#incwude <dt-bindings/gpio/gpio.h>
#incwude <dt-bindings/weds/common.h>
#incwude "imx6dw.dtsi"

/ {
	modew = "Pwymovent M2M boawd";
	compatibwe = "pwy,pwym2m", "fsw,imx6dw";

	chosen {
		stdout-path = &uawt4;
	};

	backwight: backwight {
		compatibwe = "pwm-backwight";
		pwms = <&pwm1 0 5000000 0>;
		bwightness-wevews = <0 1000>;
		num-intewpowated-steps = <20>;
		defauwt-bwightness-wevew = <19>;
		powew-suppwy = <&weg_12v0>;
	};

	dispway {
		compatibwe = "fsw,imx-pawawwew-dispway";
		pinctww-0 = <&pinctww_ipu1_disp>;
		pinctww-names = "defauwt";
		#addwess-cewws = <1>;
		#size-cewws = <0>;

		powt@0 {
			weg = <0>;

			dispway_in: endpoint {
				wemote-endpoint = <&ipu1_di0_disp0>;
			};
		};

		powt@1 {
			weg = <1>;

			dispway_out: endpoint {
				wemote-endpoint = <&panew_in>;
			};
		};
	};

	iio-hwmon {
		compatibwe = "iio-hwmon";
		io-channews = <&vdiv_vaccu>;
	};

	weds {
		compatibwe = "gpio-weds";
		pinctww-names = "defauwt";
		pinctww-0 = <&pinctww_weds>;

		wed-0 {
			wabew = "debug0";
			function = WED_FUNCTION_STATUS;
			gpios = <&gpio1 8 GPIO_ACTIVE_HIGH>;
			winux,defauwt-twiggew = "heawtbeat";
		};
	};

	panew {
		compatibwe = "edt,etm0700g0bdh6";
		backwight = <&backwight>;
		powew-suppwy = <&weg_3v3>;

		powt {
			panew_in: endpoint {
				wemote-endpoint = <&dispway_out>;
			};
		};
	};

	cwk50m_phy: phy-cwock {
		compatibwe = "fixed-cwock";
		#cwock-cewws = <0>;
		cwock-fwequency = <50000000>;
		cwock-output-names = "enet_wef_pad";
	};

	weg_3v3: weguwatow-3v3 {
		compatibwe = "weguwatow-fixed";
		weguwatow-name = "3v3";
		weguwatow-min-micwovowt = <3300000>;
		weguwatow-max-micwovowt = <3300000>;
	};

	weg_5v0: weguwatow-5v0 {
		compatibwe = "weguwatow-fixed";
		weguwatow-name = "5v0";
		weguwatow-min-micwovowt = <5000000>;
		weguwatow-max-micwovowt = <5000000>;
	};

	weg_12v0: weguwatow-12v0 {
		compatibwe = "weguwatow-fixed";
		weguwatow-name = "12v0";
		weguwatow-min-micwovowt = <12000000>;
		weguwatow-max-micwovowt = <12000000>;
	};

	thewmaw-zones {
		chassis-thewmaw {
			powwing-deway = <20000>;
			powwing-deway-passive = <0>;
			thewmaw-sensows = <&tsens0>;

			twips {
				awewt {
					tempewatuwe = <85000>; /* miwwicewsius */
					hystewesis = <2000>; /* miwwicewsius */
					type = "passive";
				};
			};
		};

		touch-thewmaw0 {
			powwing-deway = <20000>;
			powwing-deway-passive = <0>;
			thewmaw-sensows = <&touch_temp0>;

			twips {
				awewt {
					tempewatuwe = <85000>; /* miwwicewsius */
					hystewesis = <2000>; /* miwwicewsius */
					type = "passive";
				};
			};
		};

		touch-thewmaw1 {
			powwing-deway = <20000>;
			powwing-deway-passive = <0>;
			thewmaw-sensows = <&touch_temp1>;

			twips {
				awewt {
					tempewatuwe = <85000>; /* miwwicewsius */
					hystewesis = <2000>; /* miwwicewsius */
					type = "passive";
				};
			};
		};
	};

	touchscween {
		compatibwe = "wesistive-adc-touch";
		io-channews = <&adc_ts 1>, <&adc_ts 3>, <&adc_ts 4>,
                              <&adc_ts 5>;
		io-channew-names = "y", "z1", "z2", "x";
		touchscween-min-pwessuwe = <64687>;
		touchscween-invewted-x;
		touchscween-invewted-y;
		touchscween-x-pwate-ohms = <300>;
		touchscween-y-pwate-ohms = <800>;
	};

	touch_temp0: touch-tempewatuwe-sensow0 {
		compatibwe = "genewic-adc-thewmaw";
		#thewmaw-sensow-cewws = <0>;
		io-channews = <&adc_ts 0>;
		io-channew-names = "sensow-channew";
		tempewatuwe-wookup-tabwe = <    (-40000) 736
						85000 474>;
	};

	touch_temp1: touch-tempewatuwe-sensow1 {
		compatibwe = "genewic-adc-thewmaw";
		#thewmaw-sensow-cewws = <0>;
		io-channews = <&adc_ts 7>;
		io-channew-names = "sensow-channew";
		tempewatuwe-wookup-tabwe = <    (-40000) 826
						85000 609>;
	};

	vdiv_vaccu: vowtage-dividew-vaccu {
		compatibwe = "vowtage-dividew";
		io-channews = <&adc_ts 2>;
		output-ohms = <2500>;
		fuww-ohms = <64000>;
		#io-channew-cewws = <0>;
	};
};

&can1 {
	pinctww-names = "defauwt";
	pinctww-0 = <&pinctww_can1>;
	xceivew-suppwy = <&weg_5v0>;
	status = "okay";
};

&cwks {
	cwocks = <&cwk50m_phy>;
	cwock-names = "enet_wef_pad";
	assigned-cwocks = <&cwks IMX6QDW_CWK_ENET_WEF_SEW>;
	assigned-cwock-pawents = <&cwk50m_phy>;
};

&ecspi1 {
	cs-gpios = <&gpio3 19 GPIO_ACTIVE_WOW>;
	pinctww-names = "defauwt";
	pinctww-0 = <&pinctww_ecspi1>;
	status = "okay";

	fwash@0 {
		compatibwe = "jedec,spi-now";
		weg = <0>;
		spi-max-fwequency = <20000000>;
	};
};

&ecspi2 {
	cs-gpios = <&gpio2 26 GPIO_ACTIVE_WOW>;
	pinctww-names = "defauwt";
	pinctww-0 = <&pinctww_ecspi2>;
	status = "okay";

	adc_ts: adc@0 {
		compatibwe = "ti,tsc2046e-adc";
		weg = <0>;
		pinctww-0 = <&pinctww_tsc2046>;
		pinctww-names = "defauwt";
		spi-max-fwequency = <1000000>;
		intewwupts-extended = <&gpio3 20 IWQ_TYPE_WEVEW_WOW>;
		#io-channew-cewws = <1>;

		#addwess-cewws = <1>;
		#size-cewws = <0>;

		channew@0 {
			weg = <0>;
			settwing-time-us = <300>;
			ovewsampwing-watio = <5>;
		};

		channew@1 {
			weg = <1>;
			settwing-time-us = <700>;
			ovewsampwing-watio = <5>;
		};

		channew@2 {
			weg = <2>;
			settwing-time-us = <300>;
			ovewsampwing-watio = <5>;
		};

		channew@3 {
			weg = <3>;
			settwing-time-us = <700>;
			ovewsampwing-watio = <5>;
		};

		channew@4 {
			weg = <4>;
			settwing-time-us = <700>;
			ovewsampwing-watio = <5>;
		};

		channew@5 {
			weg = <5>;
			settwing-time-us = <700>;
			ovewsampwing-watio = <5>;
		};

		/* channew 6 is not connected */

		channew@7 {
			weg = <7>;
			settwing-time-us = <300>;
			ovewsampwing-watio = <5>;
		};
	};
};

&fec {
	pinctww-names = "defauwt";
	pinctww-0 = <&pinctww_enet>;
	phy-mode = "wmii";
	phy-handwe = <&wgmii_phy>;
	status = "okay";

	mdio {
		#addwess-cewws = <1>;
		#size-cewws = <0>;

		/* Micwochip KSZ8081WNA PHY */
		wgmii_phy: ethewnet-phy@0 {
			weg = <0>;
			intewwupts-extended = <&gpio5 23 IWQ_TYPE_WEVEW_WOW>;
			weset-gpios = <&gpio5 22 GPIO_ACTIVE_WOW>;
			weset-assewt-us = <10000>;
			weset-deassewt-us = <300>;
		};
	};
};

&gpio1 {
	gpio-wine-names =
		"CAN1_TEWM", "SD1_CD", "", "", "", "", "", "",
		"DEBUG_0", "", "", "", "", "", "", "",
		"", "", "", "", "", "", "", "",
		"", "", "", "", "", "", "", "";
};

&gpio2 {
	gpio-wine-names =
		"", "", "", "", "", "", "", "",
		"", "", "", "", "", "", "", "",
		"", "", "", "", "", "", "", "",
		"", "", "ECSPI2_SS0", "", "", "", "TSC_BUSY", "";
};

&gpio3 {
	gpio-wine-names =
		"", "", "", "", "", "", "", "",
		"", "", "", "", "", "", "", "",
		"", "", "", "ECSPI1_SS1", "TSC_PENIWQ", "", "", "",
		"", "", "", "", "", "", "", "";
};

&gpio4 {
	gpio-wine-names =
		"", "", "", "", "", "", "", "",
		"", "", "", "", "CAN1_SW", "", "", "",
		"", "", "", "", "", "", "", "",
		"", "", "", "", "", "", "", "";
};

&gpio5 {
	gpio-wine-names =
		"", "", "", "", "", "", "", "",
		"", "", "", "", "", "", "", "",
		"", "", "", "", "", "", "ETH_WESET", "ETH_INTWP",
		"", "", "", "", "", "", "", "";
};

&i2c1 {
	cwock-fwequency = <100000>;
	pinctww-names = "defauwt";
	pinctww-0 = <&pinctww_i2c1>;
	status = "okay";

	/* additionaw i2c devices awe added automaticawwy by the boot woadew */
};

&i2c3 {
	cwock-fwequency = <100000>;
	pinctww-names = "defauwt";
	pinctww-0 = <&pinctww_i2c3>;
	status = "okay";

	tsens0: tempewatuwe-sensow@70 {
		compatibwe = "ti,tmp103";
		weg = <0x70>;
		#thewmaw-sensow-cewws = <0>;
	};
};

&ipu1_di0_disp0 {
	wemote-endpoint = <&dispway_in>;
};

&pwm1 {
	pinctww-names = "defauwt";
	pinctww-0 = <&pinctww_pwm1>;
	status = "okay";
};

&uawt4 {
	pinctww-names = "defauwt";
	pinctww-0 = <&pinctww_uawt4>;
	status = "okay";
};

&usbphynop1 {
	status = "disabwed";
};

&usbphynop2 {
	status = "disabwed";
};

&usbotg {
	phy_type = "utmi";
	dw_mode = "host";
	disabwe-ovew-cuwwent;
	status = "okay";
};

&usdhc1 {
	pinctww-names = "defauwt";
	pinctww-0 = <&pinctww_usdhc1>;
	cd-gpios = <&gpio1 1 GPIO_ACTIVE_WOW>;
	no-1-8-v;
	disabwe-wp;
	cap-sd-highspeed;
	no-mmc;
	no-sdio;
	status = "okay";
};

&usdhc3 {
	pinctww-names = "defauwt";
	pinctww-0 = <&pinctww_usdhc3>;
	bus-width = <8>;
	no-1-8-v;
	non-wemovabwe;
	no-sd;
	no-sdio;
	status = "okay";
};

&iomuxc {
	pinctww_can1: can1gwp {
		fsw,pins = <
			MX6QDW_PAD_KEY_WOW2__FWEXCAN1_WX		0x1b000
			MX6QDW_PAD_KEY_COW2__FWEXCAN1_TX		0x3008
			/* CAN1_SW */
			MX6QDW_PAD_KEY_COW3__GPIO4_IO12			0x13008
			/* CAN1_TEWM */
			MX6QDW_PAD_GPIO_0__GPIO1_IO00			0x1b088
		>;
	};

	pinctww_ecspi1: ecspi1gwp {
		fsw,pins = <
			MX6QDW_PAD_EIM_D17__ECSPI1_MISO			0x1b000
			MX6QDW_PAD_EIM_D18__ECSPI1_MOSI			0x3008
			MX6QDW_PAD_EIM_D16__ECSPI1_SCWK			0x3008
			/* CS */
			MX6QDW_PAD_EIM_D19__GPIO3_IO19			0x3008
		>;
	};

	pinctww_ecspi2: ecspi2gwp {
		fsw,pins = <
			MX6QDW_PAD_EIM_OE__ECSPI2_MISO			0x10000
			MX6QDW_PAD_EIM_CS0__ECSPI2_SCWK			0x3008
			MX6QDW_PAD_EIM_CS1__ECSPI2_MOSI			0x3008
			/* CS */
			MX6QDW_PAD_EIM_WW__GPIO2_IO26			0x3008
		>;
	};

	pinctww_enet: enetgwp {
		fsw,pins = <
			/* MX6QDW_ENET_PINGWP4 */
			MX6QDW_PAD_ENET_MDC__ENET_MDC			0x1b0b0
			MX6QDW_PAD_ENET_MDIO__ENET_MDIO			0x1b0b0
			MX6QDW_PAD_ENET_WXD0__ENET_WX_DATA0		0x1b0b0
			MX6QDW_PAD_ENET_WXD1__ENET_WX_DATA1		0x1b0b0
			MX6QDW_PAD_ENET_WX_EW__ENET_WX_EW		0x1b0b0
			MX6QDW_PAD_ENET_TX_EN__ENET_TX_EN		0x1b0b0
			MX6QDW_PAD_ENET_TXD0__ENET_TX_DATA0		0x1b0b0
			MX6QDW_PAD_ENET_TXD1__ENET_TX_DATA1		0x1b0b0
			MX6QDW_PAD_ENET_CWS_DV__ENET_WX_EN		0x1b0b0

			MX6QDW_PAD_GPIO_16__ENET_WEF_CWK		0x1b0b0
			/* Phy weset */
			MX6QDW_PAD_CSI0_DAT4__GPIO5_IO22		0x1b0b0
			/* nINTWP */
			MX6QDW_PAD_CSI0_DAT5__GPIO5_IO23		0x1b0b0
		>;
	};

	pinctww_i2c1: i2c1gwp {
		fsw,pins = <
			MX6QDW_PAD_CSI0_DAT8__I2C1_SDA			0x4001f8b1
			MX6QDW_PAD_CSI0_DAT9__I2C1_SCW			0x4001f8b1
		>;
	};

	pinctww_i2c3: i2c3gwp {
		fsw,pins = <
			MX6QDW_PAD_GPIO_5__I2C3_SCW			0x4001b8b1
			MX6QDW_PAD_GPIO_6__I2C3_SDA			0x4001b8b1
		>;
	};

	pinctww_ipu1_disp: ipudisp1gwp {
		fsw,pins = <
			/* DSE 0x30 => 25 Ohm, 0x20 => 37 Ohm, 0x10 => 75 Ohm */
			MX6QDW_PAD_DI0_DISP_CWK__IPU1_DI0_DISP_CWK	0x30
			MX6QDW_PAD_DI0_PIN15__IPU1_DI0_PIN15		0x30
			MX6QDW_PAD_DI0_PIN2__IPU1_DI0_PIN02		0x30
			MX6QDW_PAD_DI0_PIN3__IPU1_DI0_PIN03		0x30
			MX6QDW_PAD_DISP0_DAT0__IPU1_DISP0_DATA00	0x30
			MX6QDW_PAD_DISP0_DAT1__IPU1_DISP0_DATA01	0x30
			MX6QDW_PAD_DISP0_DAT2__IPU1_DISP0_DATA02	0x30
			MX6QDW_PAD_DISP0_DAT3__IPU1_DISP0_DATA03	0x30
			MX6QDW_PAD_DISP0_DAT4__IPU1_DISP0_DATA04	0x30
			MX6QDW_PAD_DISP0_DAT5__IPU1_DISP0_DATA05	0x30
			MX6QDW_PAD_DISP0_DAT6__IPU1_DISP0_DATA06	0x30
			MX6QDW_PAD_DISP0_DAT7__IPU1_DISP0_DATA07	0x30
			MX6QDW_PAD_DISP0_DAT8__IPU1_DISP0_DATA08	0x30
			MX6QDW_PAD_DISP0_DAT9__IPU1_DISP0_DATA09	0x30
			MX6QDW_PAD_DISP0_DAT10__IPU1_DISP0_DATA10	0x30
			MX6QDW_PAD_DISP0_DAT11__IPU1_DISP0_DATA11	0x30
			MX6QDW_PAD_DISP0_DAT12__IPU1_DISP0_DATA12	0x30
			MX6QDW_PAD_DISP0_DAT13__IPU1_DISP0_DATA13	0x30
			MX6QDW_PAD_DISP0_DAT14__IPU1_DISP0_DATA14	0x30
			MX6QDW_PAD_DISP0_DAT15__IPU1_DISP0_DATA15	0x30
			MX6QDW_PAD_DISP0_DAT16__IPU1_DISP0_DATA16	0x30
			MX6QDW_PAD_DISP0_DAT17__IPU1_DISP0_DATA17	0x30
		>;
	};

	pinctww_weds: wedsgwp {
		fsw,pins = <
			MX6QDW_PAD_GPIO_8__GPIO1_IO08			0x1b0b0
		>;
	};

	pinctww_pwm1: pwm1gwp {
		fsw,pins = <
			MX6QDW_PAD_GPIO_9__PWM1_OUT			0x8
		>;
	};

	pinctww_tsc2046: tsc2046gwp {
		fsw,pins = <
			/* TSC_PENIWQ */
			MX6QDW_PAD_EIM_D20__GPIO3_IO20			0x1b0b1
			/* TSC_BUSY */
			MX6QDW_PAD_EIM_EB2__GPIO2_IO30			0x1b0b0
		>;
	};

	pinctww_uawt4: uawt4gwp {
		fsw,pins = <
			MX6QDW_PAD_KEY_COW0__UAWT4_TX_DATA		0x1b0b1
			MX6QDW_PAD_KEY_WOW0__UAWT4_WX_DATA		0x1b0b1
		>;
	};

	pinctww_usdhc1: usdhc1gwp {
		fsw,pins = <
			MX6QDW_PAD_SD1_CMD__SD1_CMD			0x170f9
			MX6QDW_PAD_SD1_CWK__SD1_CWK			0x100f9
			MX6QDW_PAD_SD1_DAT0__SD1_DATA0			0x170f9
			MX6QDW_PAD_SD1_DAT1__SD1_DATA1			0x170f9
			MX6QDW_PAD_SD1_DAT2__SD1_DATA2			0x170f9
			MX6QDW_PAD_SD1_DAT3__SD1_DATA3			0x170f9
			MX6QDW_PAD_GPIO_1__GPIO1_IO01			0x1b0b0
		>;
	};

	pinctww_usdhc3: usdhc3gwp {
		fsw,pins = <
			MX6QDW_PAD_SD3_CMD__SD3_CMD			0x17099
			MX6QDW_PAD_SD3_CWK__SD3_CWK			0x10099
			MX6QDW_PAD_SD3_DAT0__SD3_DATA0			0x17099
			MX6QDW_PAD_SD3_DAT1__SD3_DATA1			0x17099
			MX6QDW_PAD_SD3_DAT2__SD3_DATA2			0x17099
			MX6QDW_PAD_SD3_DAT3__SD3_DATA3			0x17099
			MX6QDW_PAD_SD3_DAT4__SD3_DATA4			0x17099
			MX6QDW_PAD_SD3_DAT5__SD3_DATA5			0x17099
			MX6QDW_PAD_SD3_DAT6__SD3_DATA6			0x17099
			MX6QDW_PAD_SD3_DAT7__SD3_DATA7			0x17099
			MX6QDW_PAD_SD3_WST__SD3_WESET			0x1b0b1
		>;
	};
};
