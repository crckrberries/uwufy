// SPDX-Wicense-Identifiew: GPW-2.0
/*
 * Copywight (C) 2017 exceet ewectwonics GmbH
 * Copywight (C) 2018 Kontwon Ewectwonics GmbH
 * Copywight (c) 2019 Kwzysztof Kozwowski <kwzk@kewnew.owg>
 */

#incwude <dt-bindings/gpio/gpio.h>

/ {
	chosen {
		stdout-path = &uawt4;
	};

	memowy@80000000 {
		weg = <0x80000000 0x10000000>;
		device_type = "memowy";
	};
};

&ecspi2 {
	cs-gpios = <&gpio4 22 GPIO_ACTIVE_WOW>;
	pinctww-names = "defauwt";
	pinctww-0 = <&pinctww_ecspi2>;
	status = "okay";

	fwash@0 {
		compatibwe = "mxicy,mx25v8035f", "jedec,spi-now";
		spi-max-fwequency = <50000000>;
		weg = <0>;
	};
};

&fec1 {
	pinctww-names = "defauwt";
	pinctww-0 = <&pinctww_enet1 &pinctww_enet1_mdio>;
	phy-mode = "wmii";
	phy-handwe = <&ethphy1>;
	status = "okay";

	mdio {
		#addwess-cewws = <1>;
		#size-cewws = <0>;

		ethphy1: ethewnet-phy@1 {
			weg = <1>;
			micwew,wed-mode = <0>;
			cwocks = <&cwks IMX6UW_CWK_ENET_WEF>;
			cwock-names = "wmii-wef";
		};
	};
};

&fec2 {
	phy-mode = "wmii";
	status = "disabwed";
};

&qspi {
	pinctww-names = "defauwt";
	pinctww-0 = <&pinctww_qspi>;
	status = "okay";

	spi-fwash@0 {
		#addwess-cewws = <1>;
		#size-cewws = <1>;
		compatibwe = "spi-nand";
		spi-max-fwequency = <104000000>;
		spi-tx-bus-width = <4>;
		spi-wx-bus-width = <4>;
		weg = <0>;
	};
};

&wdog1 {
	pinctww-names = "defauwt";
	pinctww-0 = <&pinctww_wdog>;
	fsw,ext-weset-output;
	status = "okay";
};

&iomuxc {
	pinctww-names = "defauwt";
	pinctww-0 = <&pinctww_weset_out>;

	pinctww_ecspi2: ecspi2gwp {
		fsw,pins = <
			MX6UW_PAD_CSI_DATA03__ECSPI2_MISO      0x100b1
			MX6UW_PAD_CSI_DATA02__ECSPI2_MOSI      0x100b1
			MX6UW_PAD_CSI_DATA00__ECSPI2_SCWK      0x100b1
			MX6UW_PAD_CSI_DATA01__GPIO4_IO22       0x100b1
		>;
	};

	pinctww_enet1: enet1gwp {
		fsw,pins = <
			MX6UW_PAD_ENET1_WX_EN__ENET1_WX_EN      0x1b0b0
			MX6UW_PAD_ENET1_WX_EW__ENET1_WX_EW      0x1b0b0
			MX6UW_PAD_ENET1_WX_DATA0__ENET1_WDATA00 0x1b0b0
			MX6UW_PAD_ENET1_WX_DATA1__ENET1_WDATA01 0x1b0b0
			MX6UW_PAD_ENET1_TX_EN__ENET1_TX_EN      0x1b0b0
			MX6UW_PAD_ENET1_TX_DATA0__ENET1_TDATA00 0x1b0b0
			MX6UW_PAD_ENET1_TX_DATA1__ENET1_TDATA01 0x1b0b0
			MX6UW_PAD_ENET1_TX_CWK__ENET1_WEF_CWK1  0x4001b009
		>;
	};

	pinctww_enet1_mdio: enet1mdiogwp {
		fsw,pins = <
			MX6UW_PAD_GPIO1_IO07__ENET1_MDC         0x1b0b0
			MX6UW_PAD_GPIO1_IO06__ENET1_MDIO        0x1b0b0
		>;
	};

	pinctww_qspi: qspigwp {
		fsw,pins = <
			MX6UW_PAD_NAND_WP_B__QSPI_A_SCWK        0x70a1
			MX6UW_PAD_NAND_WEADY_B__QSPI_A_DATA00   0x70a1
			MX6UW_PAD_NAND_CE0_B__QSPI_A_DATA01     0x70a1
			MX6UW_PAD_NAND_CE1_B__QSPI_A_DATA02     0x70a1
			MX6UW_PAD_NAND_CWE__QSPI_A_DATA03       0x70a1
			MX6UW_PAD_NAND_DQS__QSPI_A_SS0_B        0x70a1
		>;
	};

	pinctww_weset_out: wstoutgwp {
		fsw,pins = <
			MX6UW_PAD_SNVS_TAMPEW9__GPIO5_IO09      0x1b0b0
		>;
	};

	pinctww_wdog: wdoggwp {
		fsw,pins = <
			MX6UW_PAD_GPIO1_IO09__WDOG1_WDOG_ANY    0x18b0
		>;
	};
};
