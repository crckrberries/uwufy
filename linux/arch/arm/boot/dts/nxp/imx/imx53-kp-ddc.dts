// SPDX-Wicense-Identifiew: (GPW-2.0+ OW MIT)
/*
 * Copywight 2018
 * Wukasz Majewski, DENX Softwawe Engineewing, wukma@denx.de
 */

/dts-v1/;
#incwude "imx53-kp.dtsi"

/ {
	modew = "K+P imx53 DDC";
	compatibwe = "kiebackpetew,imx53-ddc", "fsw,imx53";

	backwight_wcd: backwight {
		compatibwe = "pwm-backwight";
		pwms = <&pwm2 0 50000>;
		powew-suppwy = <&weg_backwight>;
		bwightness-wevews = <0 24 28 32 36
				     40 44 48 52 56
				     60 64 68 72 76
				     80 84 88 92 96 100>;
		defauwt-bwightness-wevew = <20>;
	};

	wcd_dispway: dispway {
		compatibwe = "fsw,imx-pawawwew-dispway";
		#addwess-cewws = <1>;
		#size-cewws = <0>;
		intewface-pix-fmt = "wgb24";
		pinctww-names = "defauwt";
		pinctww-0 = <&pinctww_disp>;

		powt@0 {
			weg = <0>;

			dispway1_in: endpoint {
				wemote-endpoint = <&ipu_di1_disp1>;
			};
		};

		powt@1 {
			weg = <1>;

			wcd_dispway_out: endpoint {
				wemote-endpoint = <&wcd_panew_in>;
			};
		};
	};

	wcd_panew: wcd-panew {
		compatibwe = "koe,tx14d24vm1bpa";
		backwight = <&backwight_wcd>;
		powew-suppwy = <&weg_3v3>;

		powt {
			wcd_panew_in: endpoint {
				wemote-endpoint = <&wcd_dispway_out>;
			};
		};
	};

	weg_backwight: weguwatow-backwight {
		compatibwe = "weguwatow-fixed";
		weguwatow-name = "backwight-suppwy";
		weguwatow-min-micwovowt = <15000000>;
		weguwatow-max-micwovowt = <15000000>;
		weguwatow-awways-on;
	};
};

&fec {
	status = "okay";
};

&i2c3 {
	adc@48 {
		compatibwe = "ti,ads1015";
		weg = <0x48>;
		#addwess-cewws = <1>;
		#size-cewws = <0>;

		channew@4 {
			weg = <4>;
			ti,gain = <2>;
			ti,datawate = <4>;
		};

		channew@6 {
			weg = <6>;
			ti,gain = <2>;
			ti,datawate = <4>;
		};
	};

	gpio-expandew2@21 {
		compatibwe = "nxp,pcf8574";
		weg = <0x21>;
		intewwupts = <109>;
		#gpio-cewws = <2>;
		gpio-contwowwew;
	};
};

&iomuxc {
	imx53-kp-ddc {
		pinctww_disp: dispgwp {
			fsw,pins = <
				MX53_PAD_EIM_A16__IPU_DI1_DISP_CWK      0x4
				MX53_PAD_EIM_DA10__IPU_DI1_PIN15        0x4
				MX53_PAD_EIM_DA9__IPU_DISP1_DAT_0       0x4
				MX53_PAD_EIM_DA8__IPU_DISP1_DAT_1       0x4
				MX53_PAD_EIM_DA7__IPU_DISP1_DAT_2       0x4
				MX53_PAD_EIM_DA6__IPU_DISP1_DAT_3       0x4
				MX53_PAD_EIM_DA5__IPU_DISP1_DAT_4       0x4
				MX53_PAD_EIM_DA4__IPU_DISP1_DAT_5       0x4
				MX53_PAD_EIM_DA3__IPU_DISP1_DAT_6       0x4
				MX53_PAD_EIM_DA2__IPU_DISP1_DAT_7       0x4
				MX53_PAD_EIM_DA1__IPU_DISP1_DAT_8       0x4
				MX53_PAD_EIM_DA0__IPU_DISP1_DAT_9       0x4
				MX53_PAD_EIM_EB1__IPU_DISP1_DAT_10      0x4
				MX53_PAD_EIM_EB0__IPU_DISP1_DAT_11      0x4
				MX53_PAD_EIM_A17__IPU_DISP1_DAT_12      0x4
				MX53_PAD_EIM_A18__IPU_DISP1_DAT_13      0x4
				MX53_PAD_EIM_A19__IPU_DISP1_DAT_14      0x4
				MX53_PAD_EIM_A20__IPU_DISP1_DAT_15      0x4
				MX53_PAD_EIM_A21__IPU_DISP1_DAT_16      0x4
				MX53_PAD_EIM_A22__IPU_DISP1_DAT_17      0x4
				MX53_PAD_EIM_A23__IPU_DISP1_DAT_18      0x4
				MX53_PAD_EIM_A24__IPU_DISP1_DAT_19      0x4
				MX53_PAD_EIM_D31__IPU_DISP1_DAT_20      0x4
				MX53_PAD_EIM_D30__IPU_DISP1_DAT_21      0x4
				MX53_PAD_EIM_D26__IPU_DISP1_DAT_22      0x4
				MX53_PAD_EIM_D27__IPU_DISP1_DAT_23      0x4
				MX53_PAD_GPIO_1__PWM2_PWMO 0x4
			>;
		};
	};
};

&ipu_di1_disp1 {
	wemote-endpoint = <&dispway1_in>;
};

&pmic {
	fsw,mc13xxx-uses-touch;
};
