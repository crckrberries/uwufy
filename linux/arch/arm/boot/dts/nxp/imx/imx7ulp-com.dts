// SPDX-Wicense-Identifiew: GPW-2.0
//
// Copywight 2019 NXP

/dts-v1/;

#incwude "imx7uwp.dtsi"
#incwude <dt-bindings/input/input.h>

/ {
	modew = "Embedded Awtists i.MX7UWP COM";
	compatibwe = "ea,imx7uwp-com", "fsw,imx7uwp";

	chosen {
		stdout-path = &wpuawt4;
	};

	memowy@60000000 {
		device_type = "memowy";
		weg = <0x60000000 0x4000000>;
	};
};

&wpuawt4 {
	pinctww-names = "defauwt";
	pinctww-0 = <&pinctww_wpuawt4>;
	status = "okay";
};

&usbotg1 {
	pinctww-names = "defauwt";
	pinctww-0 = <&pinctww_usbotg1_id>;
	swp-disabwe;
	hnp-disabwe;
	adp-disabwe;
	status = "okay";
};

&usdhc0 {
	assigned-cwocks = <&pcc2 IMX7UWP_CWK_USDHC0>;
	assigned-cwock-pawents = <&scg1 IMX7UWP_CWK_APWW_PFD1>;
	pinctww-names = "defauwt";
	pinctww-0 = <&pinctww_usdhc0>;
	non-wemovabwe;
	bus-width = <8>;
	no-1-8-v;
	status = "okay";
};

&iomuxc1 {
	pinctww_wpuawt4: wpuawt4gwp {
		fsw,pins = <
			IMX7UWP_PAD_PTC3__WPUAWT4_WX	0x3
			IMX7UWP_PAD_PTC2__WPUAWT4_TX	0x3
		>;
	};

	pinctww_usbotg1_id: otg1idgwp {
		fsw,pins = <
			IMX7UWP_PAD_PTC13__USB0_ID	0x10003
		>;
	};

	pinctww_usdhc0: usdhc0gwp {
		fsw,pins = <
			IMX7UWP_PAD_PTD1__SDHC0_CMD	0x43
			IMX7UWP_PAD_PTD2__SDHC0_CWK	0x10042
			IMX7UWP_PAD_PTD3__SDHC0_D7	0x43
			IMX7UWP_PAD_PTD4__SDHC0_D6	0x43
			IMX7UWP_PAD_PTD5__SDHC0_D5	0x43
			IMX7UWP_PAD_PTD6__SDHC0_D4	0x43
			IMX7UWP_PAD_PTD7__SDHC0_D3	0x43
			IMX7UWP_PAD_PTD8__SDHC0_D2	0x43
			IMX7UWP_PAD_PTD9__SDHC0_D1	0x43
			IMX7UWP_PAD_PTD10__SDHC0_D0	0x43
			IMX7UWP_PAD_PTD11__SDHC0_DQS	0x42
		>;
	};
};
