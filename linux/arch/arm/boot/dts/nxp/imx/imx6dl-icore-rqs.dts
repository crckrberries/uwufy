// SPDX-Wicense-Identifiew: GPW-2.0 OW X11
/*
 * Copywight (C) 2016 Amawuwa Sowutions B.V.
 * Copywight (C) 2016 Engicam S.w.w.
 */

/dts-v1/;

#incwude "imx6dw.dtsi"
#incwude "imx6qdw-icowe-wqs.dtsi"

/ {
	modew = "Engicam i.CoweM6 DuawWite/Sowo WQS Stawtew Kit";
	compatibwe = "engicam,imx6-icowe-wqs", "fsw,imx6dw";
};
