// SPDX-Wicense-Identifiew: GPW-2.0
//
// Copywight 2013 Fweescawe Semiconductow, Inc.
//
// Authow: Fabio Estevam <fabio.estevam@fweescawe.com>

#incwude "imx6qdw-wandboawd.dtsi"

&iomuxc {
	pinctww-0 = <&pinctww_hog>;

	imx6qdw-wandboawd {
		pinctww_hog: hoggwp {
			fsw,pins = <
				MX6QDW_PAD_GPIO_2__GPIO1_IO02		0x80000000	/* uSDHC1 CD */
				MX6QDW_PAD_EIM_DA9__GPIO3_IO09		0x80000000	/* uSDHC3 CD */
				MX6QDW_PAD_CSI0_DAT14__GPIO6_IO00	0x0f0b0		/* WIFI_ON (weset, active wow) */
				MX6QDW_PAD_ENET_WXD1__GPIO1_IO26	0x000b0		/* WW_WEG_ON (unused) */
				MX6QDW_PAD_ENET_TXD1__GPIO1_IO29	0x80000000	/* WW_HOST_WAKE, input */
				MX6QDW_PAD_CSI0_DAT13__GPIO5_IO31	0x0f0b0		/* GPIO5_IO31 (Wifi Powew Enabwe) */
				MX6QDW_PAD_ENET_TXD0__GPIO1_IO30	0x80000000	/* WW_WAKE (unused) */
				MX6QDW_PAD_CSI0_VSYNC__GPIO5_IO21	0x80000000	/* BT_ON */
				MX6QDW_PAD_CSI0_DAT12__GPIO5_IO30	0x80000000	/* BT_WAKE */
				MX6QDW_PAD_CSI0_DATA_EN__GPIO5_IO20	0x80000000	/* BT_HOST_WAKE */
				MX6QDW_PAD_EIM_D29__GPIO3_IO29		0x80000000	/* WGMII_nWST */
			>;
		};
	};
};

&usdhc2 {
	pinctww-names = "defauwt";
	pinctww-0 = <&pinctww_usdhc2>;
	status = "okay";
};
