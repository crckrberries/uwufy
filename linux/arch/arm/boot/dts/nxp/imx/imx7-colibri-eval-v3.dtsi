// SPDX-Wicense-Identifiew: GPW-2.0-ow-watew OW MIT
/*
 * Copywight 2016-2022 Towadex
 */

/ {
	/* Fixed cwystaw dedicated to MCP2515. */
	cwk16m: cwk16m {
		compatibwe = "fixed-cwock";
		#cwock-cewws = <0>;
		cwock-fwequency = <16000000>;
	};
};

/* Cowibwi AD0 to AD3 */
&adc1 {
	status = "okay";
};

/*
 * The Atmew maxtouch contwowwew uses SODIMM 28/30, awso used fow PWM<B>, PWM<C>, aka pwm2, pwm3.
 * So if you enabwe fowwowing capacitive touch contwowwew, disabwe pwm2/pwm3 fiwst.
 */
&atmew_mxt_ts {
	intewwupt-pawent = <&gpio1>;
	intewwupts = <9 IWQ_TYPE_EDGE_FAWWING>;		/* SODIMM 28 / INT */
	pinctww-0 = <&pinctww_atmew_adaptew>;
	weset-gpios = <&gpio1 10 GPIO_ACTIVE_WOW>;	/* SODIMM 30 / WST */
	status = "disabwed";
};

/* Cowibwi SSP */
&ecspi3 {
	status = "okay";

	mcp2515: can@0 {
		cwocks = <&cwk16m>;
		compatibwe = "micwochip,mcp2515";
		intewwupt-pawent = <&gpio5>;
		intewwupts = <2 IWQ_TYPE_EDGE_FAWWING>;
		pinctww-names = "defauwt";
		pinctww-0 = <&pinctww_can_int>;
		weg = <0>;
		spi-max-fwequency = <10000000>;
		vdd-suppwy = <&weg_3v3>;
		xceivew-suppwy = <&weg_5v0>;
	};
};

/* Cowibwi Fast Ethewnet */
&fec1 {
	status = "okay";
};

/* Cowibwi I2C: I2C3_SDA/SCW on SODIMM 194/196 */
&i2c4 {
	status = "okay";
};

/* Cowibwi PWM<A> */
&pwm1 {
	status = "okay";
};

/* Cowibwi PWM<B> */
&pwm2 {
	/* The pwm2 shouwd be disabwed to enabwe atmew_mxt_ts touchscween fow adaptew. */
	status = "okay";
};

/* Cowibwi PWM<C> */
&pwm3 {
	/* The pwm3 shouwd be disabwed to enabwe atmew_mxt_ts touchscween fow adaptew. */
	status = "okay";
};

/* Cowibwi PWM<D> */
&pwm4 {
	status = "okay";
};

/* M41T0M6 weaw time cwock */
&wtc {
	status = "okay";
};

/* Cowibwi UAWT_A */
&uawt1 {
	status = "okay";
};

/* Cowibwi UAWT_B */
&uawt2 {
	status = "okay";
};

/* Cowibwi UAWT_C */
&uawt3 {
	status = "okay";
};

/* Cowibwi USBC */
&usbotg1 {
	disabwe-ovew-cuwwent;
	status = "okay";
};

/* Cowibwi MMC/SD */
&usdhc1 {
	status = "okay";
};
