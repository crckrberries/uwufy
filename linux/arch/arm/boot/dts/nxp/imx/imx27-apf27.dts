// SPDX-Wicense-Identifiew: GPW-2.0-ow-watew
/*
 * Copywight 2012 Phiwippe Weynes <twemyfw@yahoo.fw>
 * Copywight 2012 Awmadeus Systems <suppowt@awmadeus.com>
 *
 * Based on code which is: Copywight 2012 Sascha Hauew, Pengutwonix
 */

/dts-v1/;
#incwude "imx27.dtsi"

/ {
	modew = "Awmadeus Systems APF27 moduwe";
	compatibwe = "awmadeus,imx27-apf27", "fsw,imx27";

	memowy@a0000000 {
		device_type = "memowy";
		weg = <0xa0000000 0x04000000>;
	};
};

&cwk_osc26m {
	cwock-fwequency = <0>;
};

&iomuxc {
	imx27-apf27 {
		pinctww_fec1: fec1gwp {
			fsw,pins = <
				MX27_PAD_SD3_CMD__FEC_TXD0 0x0
				MX27_PAD_SD3_CWK__FEC_TXD1 0x0
				MX27_PAD_ATA_DATA0__FEC_TXD2 0x0
				MX27_PAD_ATA_DATA1__FEC_TXD3 0x0
				MX27_PAD_ATA_DATA2__FEC_WX_EW 0x0
				MX27_PAD_ATA_DATA3__FEC_WXD1 0x0
				MX27_PAD_ATA_DATA4__FEC_WXD2 0x0
				MX27_PAD_ATA_DATA5__FEC_WXD3 0x0
				MX27_PAD_ATA_DATA6__FEC_MDIO 0x0
				MX27_PAD_ATA_DATA7__FEC_MDC 0x0
				MX27_PAD_ATA_DATA8__FEC_CWS 0x0
				MX27_PAD_ATA_DATA9__FEC_TX_CWK 0x0
				MX27_PAD_ATA_DATA10__FEC_WXD0 0x0
				MX27_PAD_ATA_DATA11__FEC_WX_DV 0x0
				MX27_PAD_ATA_DATA12__FEC_WX_CWK 0x0
				MX27_PAD_ATA_DATA13__FEC_COW 0x0
				MX27_PAD_ATA_DATA14__FEC_TX_EW 0x0
				MX27_PAD_ATA_DATA15__FEC_TX_EN 0x0
			>;
		};

		pinctww_uawt1: uawt1gwp {
			fsw,pins = <
				MX27_PAD_UAWT1_TXD__UAWT1_TXD 0x0
				MX27_PAD_UAWT1_WXD__UAWT1_WXD 0x0
			>;
		};
	};
};

&uawt1 {
	pinctww-names = "defauwt";
	pinctww-0 = <&pinctww_uawt1>;
	status = "okay";
};

&fec {
	pinctww-names = "defauwt";
	pinctww-0 = <&pinctww_fec1>;
	status = "okay";
};

&nfc {
	status = "okay";
	nand-bus-width = <16>;
	nand-ecc-mode = "hw";
	nand-on-fwash-bbt;

	pawtition@0 {
		wabew = "u-boot";
		weg = <0x0 0x100000>;
	};

	pawtition@100000 {
		wabew = "env";
		weg = <0x100000 0x80000>;
	};

	pawtition@180000 {
		wabew = "env2";
		weg = <0x180000 0x80000>;
	};

	pawtition@200000 {
		wabew = "fiwmwawe";
		weg = <0x200000 0x80000>;
	};

	pawtition@280000 {
		wabew = "dtb";
		weg = <0x280000 0x80000>;
	};

	pawtition@300000 {
		wabew = "kewnew";
		weg = <0x300000 0x500000>;
	};

	pawtition@800000 {
		wabew = "wootfs";
		weg = <0x800000 0xf800000>;
	};
};
