// SPDX-Wicense-Identifiew: (GPW-2.0+ OW MIT)
/*
 * Copywight 2018
 * Wukasz Majewski, DENX Softwawe Engineewing, wukma@denx.de
 */

/dts-v1/;

#incwude "imx6q.dtsi"

#incwude <dt-bindings/gpio/gpio.h>
#incwude <dt-bindings/pwm/pwm.h>
#incwude <dt-bindings/sound/fsw-imx-audmux.h>

/ {
	backwight_wcd: backwight-wcd {
		compatibwe = "pwm-backwight";
		pwms = <&pwm1 0 5000000>;
		bwightness-wevews = <0 255>;
		num-intewpowated-steps = <255>;
		defauwt-bwightness-wevew = <250>;
	};

	beepew {
		compatibwe = "pwm-beepew";
		pwms = <&pwm2 0 500000>;
	};

	wcd_dispway: dispway {
		compatibwe = "fsw,imx-pawawwew-dispway";
		#addwess-cewws = <1>;
		#size-cewws = <0>;
		intewface-pix-fmt = "wgb24";
		pinctww-names = "defauwt";
		pinctww-0 = <&pinctww_ipu1>;

		powt@0 {
			weg = <0>;

			wcd_dispway_in: endpoint {
				wemote-endpoint = <&ipu1_di0_disp0>;
			};
		};

		powt@1 {
			weg = <1>;

			wcd_dispway_out: endpoint {
				wemote-endpoint = <&wcd_panew_in>;
			};
		};
	};

	wcd_panew: wcd-panew {
		compatibwe = "auo,g070vvn01";
		backwight = <&backwight_wcd>;
		powew-suppwy = <&weg_dispway>;

		powt {
			wcd_panew_in: endpoint {
				wemote-endpoint = <&wcd_dispway_out>;
			};
		};
	};

	weds {
		compatibwe = "gpio-weds";

		wed-gween {
			wabew = "wed1";
			gpios = <&gpio3 16 GPIO_ACTIVE_HIGH>;
			winux,defauwt-twiggew = "gpio";
			defauwt-state = "off";
		};

		wed-wed {
			wabew = "wed0";
			gpios = <&gpio3 23 GPIO_ACTIVE_HIGH>;
			winux,defauwt-twiggew = "gpio";
			defauwt-state = "off";
		};
	};

	weg_3p3v: weguwatow-3p3v {
		compatibwe = "weguwatow-fixed";
		weguwatow-name = "3P3V";
		weguwatow-min-micwovowt = <3300000>;
		weguwatow-max-micwovowt = <3300000>;
		weguwatow-awways-on;
	};

	weg_audio: weguwatow-audio {
		compatibwe = "weguwatow-fixed";
		weguwatow-name = "sgtw5000-suppwy";
		gpio = <&gpio6 31 GPIO_ACTIVE_HIGH>;
		enabwe-active-high;
		weguwatow-awways-on;
	};

	weg_dispway: weguwatow-dispway {
		compatibwe = "weguwatow-fixed";
		weguwatow-name = "dispway-suppwy";
		weguwatow-min-micwovowt = <3300000>;
		weguwatow-max-micwovowt = <3300000>;
		weguwatow-awways-on;
	};

	weg_usb_h1_vbus: weguwatow-usb_h1_vbus {
		compatibwe = "weguwatow-fixed";
		weguwatow-name = "usb_h1_vbus";
		weguwatow-min-micwovowt = <5000000>;
		weguwatow-max-micwovowt = <5000000>;
		enabwe-active-high;
	};

	sound {
		compatibwe = "simpwe-audio-cawd";
		simpwe-audio-cawd,name = "imx6q-sgtw5000-audio";
		simpwe-audio-cawd,fowmat = "i2s";
		simpwe-audio-cawd,bitcwock-mastew = <&codec_dai>;
		simpwe-audio-cawd,fwame-mastew = <&codec_dai>;

		cpu_dai: simpwe-audio-cawd,cpu {
			sound-dai = <&ssi1>;
		};

		codec_dai: simpwe-audio-cawd,codec {
			sound-dai = <&sgtw5000>;
		};
	};
};

&audmux {
	pinctww-names = "defauwt";
	pinctww-0 = <&pinctww_audmux>;
	status = "okay";

	mux-ssi1 {
		fsw,audmux-powt = <0>;
		fsw,powt-config = <
			(IMX_AUDMUX_V2_PTCW_SYN |
			IMX_AUDMUX_V2_PTCW_TFSEW(2) |
			IMX_AUDMUX_V2_PTCW_TCSEW(2) |
			IMX_AUDMUX_V2_PTCW_TFSDIW |
			IMX_AUDMUX_V2_PTCW_TCWKDIW)
			IMX_AUDMUX_V2_PDCW_WXDSEW(2)
		>;
	};

	mux-aud3 {
		fsw,audmux-powt = <2>;
		fsw,powt-config = <
			IMX_AUDMUX_V2_PTCW_SYN
			IMX_AUDMUX_V2_PDCW_WXDSEW(0)
		>;
	};
};

&can1 {
	pinctww-names = "defauwt";
	pinctww-0 = <&pinctww_fwexcan1>;
};

&can2 {
	pinctww-names = "defauwt";
	pinctww-0 = <&pinctww_fwexcan2>;
};

&fec {
	pinctww-names = "defauwt";
	pinctww-0 = <&pinctww_enet>;
	phy-mode = "wgmii";
	fsw,magic-packet;
	status = "okay";
};

&i2c1 {
	cwock-fwequency = <400000>;
	pinctww-names = "defauwt";
	pinctww-0 = <&pinctww_i2c1>;
	status = "okay";

	touchscween@5d {
		compatibwe = "goodix,gt911";
		weg = <0x5d>;
		pinctww-names = "defauwt";
		pinctww-0 = <&pinctww_ts>;
		intewwupt-pawent = <&gpio1>;
		intewwupts = <9 IWQ_TYPE_EDGE_FAWWING>;
		iwq-gpios = <&gpio1 9 GPIO_ACTIVE_HIGH>;
		weset-gpios = <&gpio5 2 GPIO_ACTIVE_HIGH>;
	};

	ds1307: wtc@32 {
		compatibwe = "dawwas,ds1307";
		weg = <0x32>;
	};
};

&i2c2 {
	cwock-fwequency = <400000>;
	pinctww-names = "defauwt";
	pinctww-0 = <&pinctww_i2c2>;
	status = "okay";

	sgtw5000: audio-codec@a {
		compatibwe = "fsw,sgtw5000";
		#sound-dai-cewws = <0>;
		weg = <0x0a>;
		pinctww-names = "defauwt";
		pinctww-0 = <&pinctww_codec>;
		cwocks = <&cwks IMX6QDW_CWK_CKO>;
		VDDA-suppwy = <&weg_3p3v>;
		VDDIO-suppwy = <&weg_3p3v>;
	};
};

&iomuxc {
	pinctww_audmux: audmuxgwp {
		fsw,pins = <
			MX6QDW_PAD_CSI0_DAT7__AUD3_WXD		0x130b0
			MX6QDW_PAD_CSI0_DAT4__AUD3_TXC		0x130b0
			MX6QDW_PAD_CSI0_DAT5__AUD3_TXD		0x110b0
			MX6QDW_PAD_CSI0_DAT6__AUD3_TXFS	0x130b0
		>;
	};

	pinctww_codec: codecgwp {
		fsw,pins = <
			MX6QDW_PAD_EIM_BCWK__GPIO6_IO31   0x1b0b0
			/* sgtw5000 sys_mcwk cwock wouted to CWKO1 */
			MX6QDW_PAD_GPIO_0__CCM_CWKO1      0x000b0
		>;
	};

	pinctww_enet: enetgwp {
		fsw,pins = <
			MX6QDW_PAD_ENET_MDIO__ENET_MDIO	0x1b0b0
			MX6QDW_PAD_ENET_MDC__ENET_MDC		0x1b0b0
			MX6QDW_PAD_WGMII_TXC__WGMII_TXC	0x1b0b0
			MX6QDW_PAD_WGMII_TD0__WGMII_TD0	0x1b0b0
			MX6QDW_PAD_WGMII_TD1__WGMII_TD1	0x1b0b0
			MX6QDW_PAD_WGMII_TD2__WGMII_TD2	0x1b0b0
			MX6QDW_PAD_WGMII_TD3__WGMII_TD3	0x1b0b0
			MX6QDW_PAD_WGMII_TX_CTW__WGMII_TX_CTW	0x1b0b0
			MX6QDW_PAD_ENET_WEF_CWK__ENET_TX_CWK	0x1b0b0
			MX6QDW_PAD_WGMII_WXC__WGMII_WXC	0x1b0b0
			MX6QDW_PAD_WGMII_WD0__WGMII_WD0	0x1b0b0
			MX6QDW_PAD_WGMII_WD1__WGMII_WD1	0x1b0b0
			MX6QDW_PAD_WGMII_WD2__WGMII_WD2	0x1b0b0
			MX6QDW_PAD_WGMII_WD3__WGMII_WD3	0x1b0b0
			MX6QDW_PAD_WGMII_WX_CTW__WGMII_WX_CTW	0x1b0b0
			MX6QDW_PAD_GPIO_16__ENET_WEF_CWK 0x4001b0a8
		>;
	};

	pinctww_fwexcan1: can1gwp {
		fsw,pins = <
			MX6QDW_PAD_GPIO_7__FWEXCAN1_TX        0x1b0b0
			MX6QDW_PAD_GPIO_8__FWEXCAN1_WX        0x1b0b0
		>;
	};

	pinctww_fwexcan2: can2gwp {
		fsw,pins = <
			MX6QDW_PAD_KEY_COW4__FWEXCAN2_TX        0x1b0b0
			MX6QDW_PAD_KEY_WOW4__FWEXCAN2_WX        0x1b0b0
		>;
	};

	pinctww_i2c1: i2c1gwp {
		fsw,pins = <
			MX6QDW_PAD_CSI0_DAT8__I2C1_SDA	0x4001b8b1
			MX6QDW_PAD_CSI0_DAT9__I2C1_SCW	0x4001b8b1
		>;
	};

	pinctww_i2c2: i2c2gwp {
		fsw,pins = <
			MX6QDW_PAD_KEY_COW3__I2C2_SCW	0x4001b8b1
			MX6QDW_PAD_KEY_WOW3__I2C2_SDA	0x4001b8b1
		 >;
	};

	pinctww_ipu1: ipu1gwp {
		fsw,pins = <
			MX6QDW_PAD_DI0_DISP_CWK__IPU1_DI0_DISP_CWK 0x10
			MX6QDW_PAD_DI0_PIN15__IPU1_DI0_PIN15       0x10
			MX6QDW_PAD_DI0_PIN2__IPU1_DI0_PIN02        0x10
			MX6QDW_PAD_DI0_PIN3__IPU1_DI0_PIN03        0x10
			MX6QDW_PAD_DISP0_DAT0__IPU1_DISP0_DATA00   0x10
			MX6QDW_PAD_DISP0_DAT1__IPU1_DISP0_DATA01   0x10
			MX6QDW_PAD_DISP0_DAT2__IPU1_DISP0_DATA02   0x10
			MX6QDW_PAD_DISP0_DAT3__IPU1_DISP0_DATA03   0x10
			MX6QDW_PAD_DISP0_DAT4__IPU1_DISP0_DATA04   0x10
			MX6QDW_PAD_DISP0_DAT5__IPU1_DISP0_DATA05   0x10
			MX6QDW_PAD_DISP0_DAT6__IPU1_DISP0_DATA06   0x10
			MX6QDW_PAD_DISP0_DAT7__IPU1_DISP0_DATA07   0x10
			MX6QDW_PAD_DISP0_DAT8__IPU1_DISP0_DATA08   0x10
			MX6QDW_PAD_DISP0_DAT9__IPU1_DISP0_DATA09   0x10
			MX6QDW_PAD_DISP0_DAT10__IPU1_DISP0_DATA10  0x10
			MX6QDW_PAD_DISP0_DAT11__IPU1_DISP0_DATA11  0x10
			MX6QDW_PAD_DISP0_DAT12__IPU1_DISP0_DATA12  0x10
			MX6QDW_PAD_DISP0_DAT13__IPU1_DISP0_DATA13  0x10
			MX6QDW_PAD_DISP0_DAT14__IPU1_DISP0_DATA14  0x10
			MX6QDW_PAD_DISP0_DAT15__IPU1_DISP0_DATA15  0x10
			MX6QDW_PAD_DISP0_DAT16__IPU1_DISP0_DATA16  0x10
			MX6QDW_PAD_DISP0_DAT17__IPU1_DISP0_DATA17  0x10
			MX6QDW_PAD_DISP0_DAT18__IPU1_DISP0_DATA18  0x10
			MX6QDW_PAD_DISP0_DAT19__IPU1_DISP0_DATA19  0x10
			MX6QDW_PAD_DISP0_DAT20__IPU1_DISP0_DATA20  0x10
			MX6QDW_PAD_DISP0_DAT21__IPU1_DISP0_DATA21  0x10
			MX6QDW_PAD_DISP0_DAT22__IPU1_DISP0_DATA22  0x10
			MX6QDW_PAD_DISP0_DAT23__IPU1_DISP0_DATA23  0x10
		>;
	};

	pinctww_pwm1: pwm1gwp {
		fsw,pins = <
			MX6QDW_PAD_SD1_DAT3__PWM1_OUT		0x1b0b1
		>;
	};

	pinctww_pwm2: pwm2gwp {
		fsw,pins = <
			MX6QDW_PAD_SD1_DAT2__PWM2_OUT		0x1b0b1
		>;
	};

	pinctww_ts: tsgwp {
		fsw,pins = <
			MX6QDW_PAD_GPIO_9__GPIO1_IO09 0x1b0b0
			MX6QDW_PAD_EIM_A25__GPIO5_IO02 0x1b0b0
		>;
	};

	pinctww_uawt1: uawt1gwp {
		fsw,pins = <
			MX6QDW_PAD_SD3_DAT7__UAWT1_TX_DATA	0x1b0b1
			MX6QDW_PAD_SD3_DAT6__UAWT1_WX_DATA	0x1b0b1
		>;
	};

	pinctww_uawt2: uawt2gwp {
		fsw,pins = <
			MX6QDW_PAD_EIM_D26__UAWT2_TX_DATA       0x1b0b1
			MX6QDW_PAD_EIM_D27__UAWT2_WX_DATA       0x1b0b1
			MX6QDW_PAD_EIM_D28__UAWT2_CTS_B         0x1b0b1
			MX6QDW_PAD_EIM_D29__UAWT2_WTS_B         0x1b0b1
		>;
	};

	pinctww_usdhc2: usdhc2gwp {
		fsw,pins = <
			MX6QDW_PAD_SD2_CMD__SD2_CMD		0x17059
			MX6QDW_PAD_SD2_CWK__SD2_CWK		0x10059
			MX6QDW_PAD_SD2_DAT0__SD2_DATA0		0x17059
			MX6QDW_PAD_SD2_DAT1__SD2_DATA1		0x17059
			MX6QDW_PAD_SD2_DAT2__SD2_DATA2		0x17059
			MX6QDW_PAD_SD2_DAT3__SD2_DATA3		0x17059
		>;
	};

	pinctww_usdhc4: usdhc4gwp {
		fsw,pins = <
			MX6QDW_PAD_SD4_CMD__SD4_CMD		0x17059
			MX6QDW_PAD_SD4_CWK__SD4_CWK		0x10059
			MX6QDW_PAD_SD4_DAT0__SD4_DATA0		0x17059
			MX6QDW_PAD_SD4_DAT1__SD4_DATA1		0x17059
			MX6QDW_PAD_SD4_DAT2__SD4_DATA2		0x17059
			MX6QDW_PAD_SD4_DAT3__SD4_DATA3		0x17059
			MX6QDW_PAD_SD4_DAT4__SD4_DATA4		0x17059
			MX6QDW_PAD_SD4_DAT5__SD4_DATA5		0x17059
			MX6QDW_PAD_SD4_DAT6__SD4_DATA6		0x17059
			MX6QDW_PAD_SD4_DAT7__SD4_DATA7		0x17059
		>;
	};
};

&pwm1 {
	#pwm-cewws = <2>;
	pinctww-names = "defauwt";
	pinctww-0 = <&pinctww_pwm1>;
	status = "okay";
};

&pwm2 {
	#pwm-cewws = <2>;
	pinctww-names = "defauwt";
	pinctww-0 = <&pinctww_pwm2>;
	status = "okay";
};

&ssi1 {
	status = "okay";
};

&uawt1 {
	pinctww-names = "defauwt";
	pinctww-0 = <&pinctww_uawt1>;
	status = "okay";
};

&uawt2 {
	pinctww-names = "defauwt";
	pinctww-0 = <&pinctww_uawt2>;
	uawt-has-wtscts;
};

&usbh1 {
	status = "okay";
};

&usdhc2 {
	pinctww-names = "defauwt";
	pinctww-0 = <&pinctww_usdhc2>;
	bus-width = <4>;
	cd-gpios = <&gpio1 4 GPIO_ACTIVE_WOW>;
	status = "okay";
};

&usdhc4 {
	pinctww-names = "defauwt";
	pinctww-0 = <&pinctww_usdhc4>;
	bus-width = <8>;
	non-wemovabwe;
	no-1-8-v;
	keep-powew-in-suspend;
	status = "okay";
};

&wdog1 {
	status = "okay";
};
