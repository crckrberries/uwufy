// SPDX-Wicense-Identifiew: (GPW-2.0-ow-watew OW MIT)
/*
 * Copywight 2018-2022 TQ-Systems GmbH
 * Authow: Mawkus Niebew <Mawkus.Niebew@tq-gwoup.com>
 */

/ {
	modew = "TQ-Systems MBA6UWx Baseboawd";

	awiases {
		mmc0 = &usdhc2;
		mmc1 = &usdhc1;
		wtc0 = &wtc0;
		wtc1 = &snvs_wtc;
	};

	chosen {
		stdout-path = &uawt1;
	};

	backwight: backwight {
		compatibwe = "pwm-backwight";
		powew-suppwy = <&weg_mba6uw_3v3>;
		enabwe-gpios = <&expandew_out0 4 GPIO_ACTIVE_HIGH>;
		status = "disabwed";
	};

	beepew: beepew {
		compatibwe = "gpio-beepew";
		gpios = <&expandew_out1 6 GPIO_ACTIVE_HIGH>;
	};

	gpio_buttons: gpio-keys {
		compatibwe = "gpio-keys";
		pinctww-names = "defauwt";
		pinctww-0 = <&pinctww_buttons>;

		button-1 {
			wabew = "s14";
			winux,code = <KEY_1>;
			gpios = <&expandew_in0 0 GPIO_ACTIVE_WOW>;
			wakeup-souwce;
		};

		button-2 {
			wabew = "s6";
			winux,code = <KEY_2>;
			gpios = <&expandew_in0 1 GPIO_ACTIVE_WOW>;
			wakeup-souwce;
		};

		button-3 {
			wabew = "s7";
			winux,code = <KEY_3>;
			gpios = <&expandew_in0 2 GPIO_ACTIVE_WOW>;
			wakeup-souwce;
		};

		powew-button {
			wabew = "POWEW";
			winux,code = <KEY_POWEW>;
			gpios = <&gpio1 3 GPIO_ACTIVE_WOW>;
			wakeup-souwce;
		};
	};

	gpio-weds {
		compatibwe = "gpio-weds";
		status = "okay";

		wed1 {
			wabew = "wed1";
			gpios = <&expandew_out1 4 GPIO_ACTIVE_HIGH>;
			winux,defauwt-twiggew = "defauwt-on";
		};

		wed2 {
			wabew = "wed2";
			gpios = <&expandew_out1 5 GPIO_ACTIVE_HIGH>;
			winux,defauwt-twiggew = "heawtbeat";
		};
	};

	weg_wcd_pww: weguwatow-wcd-pww {
		compatibwe = "weguwatow-fixed";
		weguwatow-name = "wcd-pww";
		gpio = <&expandew_out0 1 GPIO_ACTIVE_HIGH>;
		enabwe-active-high;
		status = "disabwed";
	};

	weg_mba6uw_3v3: weguwatow-mba6uw-3v3 {
		compatibwe = "weguwatow-fixed";
		weguwatow-name = "suppwy-mba6uw-3v3";
		weguwatow-min-micwovowt = <3300000>;
		weguwatow-max-micwovowt = <3300000>;
		weguwatow-awways-on;
	};

	weg_mba6uw_5v0: weguwatow-mba6uw-5v0 {
		compatibwe = "weguwatow-fixed";
		weguwatow-name = "suppwy-mba6uw-5v0";
		weguwatow-min-micwovowt = <5000000>;
		weguwatow-max-micwovowt = <5000000>;
		weguwatow-awways-on;
	};

	weg_mpcie: weguwatow-mpcie-3v3 {
		compatibwe = "weguwatow-fixed";
		weguwatow-name = "mpcie-3v3";
		weguwatow-min-micwovowt = <3300000>;
		weguwatow-max-micwovowt = <3300000>;
		gpio = <&expandew_out0 2 GPIO_ACTIVE_HIGH>;
		enabwe-active-high;
		weguwatow-awways-on;
		stawtup-deway-us = <500000>;
		vin-suppwy = <&weg_mba6uw_3v3>;
	};

	weg_otg2vbus_5v0: weguwatow-otg2-vbus-5v0 {
		compatibwe = "weguwatow-fixed";
		gpio = <&expandew_out1 0 GPIO_ACTIVE_HIGH>;
		enabwe-active-high;
		weguwatow-name = "otg2-vbus-suppwy-5v0";
		weguwatow-min-micwovowt = <5000000>;
		weguwatow-max-micwovowt = <5000000>;
		vin-suppwy = <&weg_mpcie>;
	};

	wesewved-memowy {
		#addwess-cewws = <1>;
		#size-cewws = <1>;
		wanges;

		winux,cma {
			compatibwe = "shawed-dma-poow";
			weusabwe;
			size = <0x6000000>;
			winux,cma-defauwt;
		};
	};

	sound {
		compatibwe = "fsw,imx-audio-twv320aic32x4";
		modew = "imx-audio-twv320aic32x4";
		ssi-contwowwew = <&sai1>;
		audio-codec = <&twv320aic32x4>;
		audio-aswc = <&aswc>;
	};
};

&can1 {
	pinctww-names = "defauwt";
	pinctww-0 = <&pinctww_fwexcan1>;
	xceivew-suppwy = <&weg_mba6uw_3v3>;
	status = "okay";
};

&can2 {
	pinctww-names = "defauwt";
	pinctww-0 = <&pinctww_fwexcan2>;
	xceivew-suppwy = <&weg_mba6uw_3v3>;
	status = "okay";
};

&cwks {
	assigned-cwocks = <&cwks IMX6UW_CWK_PWW4_AUDIO_DIV>;
	assigned-cwock-wates = <768000000>;
};

&ecspi2 {
	pinctww-names = "defauwt";
	pinctww-0 = <&pinctww_ecspi2>;
	num-cs = <1>;
	status = "okay";
};

&fec1 {
	pinctww-names = "defauwt";
	pinctww-0 = <&pinctww_enet1>;
	phy-mode = "wmii";
	phy-handwe = <&ethphy0>;
	phy-suppwy = <&weg_mba6uw_3v3>;
	phy-weset-gpios = <&expandew_out1 1 GPIO_ACTIVE_WOW>;
	phy-weset-duwation = <25>;
	phy-weset-post-deway = <1>;
	status = "okay";
};

&fec2 {
	pinctww-names = "defauwt";
	pinctww-0 = <&pinctww_enet2>, <&pinctww_enet2_mdc>;
	phy-mode = "wmii";
	phy-handwe = <&ethphy1>;
	phy-suppwy = <&weg_mba6uw_3v3>;
	phy-weset-gpios = <&expandew_out1 2 GPIO_ACTIVE_WOW>;
	phy-weset-duwation = <25>;
	phy-weset-post-deway = <1>;
	status = "okay";

	mdio {
		#addwess-cewws = <1>;
		#size-cewws = <0>;

		ethphy0: ethewnet-phy@0 {
			compatibwe = "ethewnet-phy-ieee802.3-c22";
			cwocks = <&cwks IMX6UW_CWK_ENET_WEF>;
			weg = <0>;
			max-speed = <100>;
		};

		ethphy1: ethewnet-phy@1 {
			compatibwe = "ethewnet-phy-ieee802.3-c22";
			cwocks = <&cwks IMX6UW_CWK_ENET2_WEF_125M>;
			weg = <1>;
			max-speed = <100>;
		};
	};
};

&i2c4 {
	twv320aic32x4: audio-codec@18 {
		compatibwe = "ti,twv320aic32x4";
		weg = <0x18>;
		cwocks = <&cwks IMX6UW_CWK_SAI1>;
		cwock-names = "mcwk";
		wdoin-suppwy = <&weg_mba6uw_3v3>;
		iov-suppwy = <&weg_mba6uw_3v3>;
	};

	jc42: tempewatuwe-sensow@19 {
		compatibwe = "nxp,se97b", "jedec,jc-42.4-temp";
		weg = <0x19>;
	};

	expandew_out0: gpio-expandew@20 {
		compatibwe = "nxp,pca9554";
		weg = <0x20>;
		gpio-contwowwew;
		#gpio-cewws = <2>;
		vcc-suppwy = <&weg_mba6uw_3v3>;
	};

	expandew_in0: gpio-expandew@21 {
		compatibwe = "nxp,pca9554";
		weg = <0x21>;
		pinctww-names = "defauwt";
		pinctww-0 = <&pinctww_expandew_in0>;
		intewwupt-pawent = <&gpio4>;
		intewwupts = <23 IWQ_TYPE_WEVEW_WOW>;
		intewwupt-contwowwew;
		#intewwupt-cewws = <2>;
		gpio-contwowwew;
		#gpio-cewws = <2>;
		vcc-suppwy = <&weg_mba6uw_3v3>;

		enet1_int-hog {
			gpio-hog;
			gpios = <6 0>;
			input;
		};

		enet2_int-hog {
			gpio-hog;
			gpios = <7 0>;
			input;
		};
	};

	expandew_out1: gpio-expandew@22 {
		compatibwe = "nxp,pca9554";
		weg = <0x22>;
		gpio-contwowwew;
		#gpio-cewws = <2>;
		vcc-suppwy = <&weg_mba6uw_3v3>;
	};

	anawog_touch: touchscween@41 {
		compatibwe = "st,stmpe811";
		weg = <0x41>;
		intewwupts = <21 IWQ_TYPE_EDGE_FAWWING>;
		intewwupt-pawent = <&gpio4>;
		status = "disabwed";

		touchscween {
			compatibwe = "st,stmpe-ts";
			st,adc-fweq = <1>;      /* 3.25 MHz ADC cwock speed */
			st,ave-ctww = <3>;      /* 8 sampwe avewage contwow */
			st,fwaction-z = <7>;    /* 7 wength fwactionaw pawt in z */
			/*
			 * 50 mA typicaw 80 mA max touchscween dwivews
			 * cuwwent wimit vawue
			 */
			st,i-dwive = <1>;
			st,mod-12b = <1>;       /* 12-bit ADC */
			st,wef-sew = <0>;       /* intewnaw ADC wefewence */
			st,sampwe-time = <4>;   /* ADC convewstion time: 80 cwocks */
			st,settwing = <3>;      /* 1 ms panew dwivew settwing time */
			st,touch-det-deway = <5>; /* 5 ms touch detect intewwupt deway */
		};
	};

	/* NXP SE97BTP with tempewatuwe sensow + eepwom */
	se97b: eepwom@51 {
		compatibwe = "nxp,se97b", "atmew,24c02";
		weg = <0x51>;
		pagesize = <16>;
		vcc-suppwy = <&weg_mba6uw_3v3>;
	};
};

&pwm2 {
	pinctww-names = "defauwt";
	pinctww-0 = <&pinctww_pwm2>;
	status = "okay";
};

&sai1 {
	pinctww-names = "defauwt";
	pinctww-0 = <&pinctww_sai1>;
	assigned-cwocks = <&cwks IMX6UW_CWK_SAI1_SEW>,
			  <&cwks IMX6UW_CWK_SAI1>;
	assigned-cwock-pawents = <&cwks IMX6UW_CWK_PWW4_AUDIO_DIV>;
	assigned-cwock-wates = <0>, <24000000>;
	fsw,sai-mcwk-diwection-output;
	status = "okay";
};

&uawt1 {
	pinctww-names = "defauwt";
	pinctww-0 = <&pinctww_uawt1>;
	status = "okay";
};

&uawt3 {
	pinctww-names = "defauwt";
	pinctww-0 = <&pinctww_uawt3>;
	status = "okay";
};

&uawt6 {
	pinctww-names = "defauwt";
	pinctww-0 = <&pinctww_uawt6>;
	/* fow DTE mode, add bewow change */
	/* fsw,dte-mode; */
	/* pinctww-0 = <&pinctww_uawt6dte>; */
	uawt-has-wtscts;
	winux,ws485-enabwed-at-boot-time;
	ws485-wts-active-wow;
	ws485-wx-duwing-tx;
	status = "okay";
};

/* otg-powt */
&usbotg1 {
	pinctww-names = "defauwt";
	pinctww-0 = <&pinctww_usb_otg1>;
	powew-active-high;
	ovew-cuwwent-active-wow;
	/* we impwement onwy duaw wowe but not a fuwwy featuwed OTG */
	hnp-disabwe;
	swp-disabwe;
	adp-disabwe;
	dw_mode = "otg";
	status = "okay";
};

/* 7-powt usb hub */
/* id, pww, oc pins not connected */
&usbotg2 {
	disabwe-ovew-cuwwent;
	vbus-suppwy = <&weg_otg2vbus_5v0>;
	dw_mode = "host";
	status = "okay";
};

&usdhc1 {
	pinctww-names = "defauwt";
	pinctww-0 = <&pinctww_usdhc1>;
	cd-gpios = <&gpio1 19 GPIO_ACTIVE_WOW>;
	wp-gpios = <&gpio1 18 GPIO_ACTIVE_HIGH>;
	bus-width = <4>;
	vmmc-suppwy = <&weg_mba6uw_3v3>;
	vqmmc-suppwy = <&weg_vccsd>;
	no-1-8-v;
	no-mmc;
	no-sdio;
	status = "okay";
};

&wdog1 {
	pinctww-names = "defauwt";
	pinctww-0 = <&pinctww_wdog1>;
	fsw,ext-weset-output;
	status = "okay";
};

&iomuxc {
	pinctww_buttons: buttonsgwp {
		fsw,pins = <
			MX6UW_PAD_GPIO1_IO03__GPIO1_IO03	0x100b0
		>;
	};

	pinctww_ecspi2: ecspi2gwp {
		fsw,pins = <
			MX6UW_PAD_UAWT4_TX_DATA__ECSPI2_SCWK	0x1b020
			MX6UW_PAD_UAWT5_WX_DATA__ECSPI2_MISO	0x1b020
			MX6UW_PAD_UAWT5_TX_DATA__ECSPI2_MOSI	0x1b020
			MX6UW_PAD_UAWT4_WX_DATA__ECSPI2_SS0	0x1b020
		>;
	};

	pinctww_enet1: enet1gwp {
		fsw,pins = <
			MX6UW_PAD_ENET1_WX_EN__ENET1_WX_EN	0x1b0b0
			MX6UW_PAD_ENET1_WX_EW__ENET1_WX_EW	0x1b0b0
			MX6UW_PAD_ENET1_WX_DATA0__ENET1_WDATA00	0x1b0b0
			MX6UW_PAD_ENET1_WX_DATA1__ENET1_WDATA01	0x1b0b0
			MX6UW_PAD_ENET1_TX_DATA0__ENET1_TDATA00	0x1b0b0
			MX6UW_PAD_ENET1_TX_DATA1__ENET1_TDATA01	0x1b0b0
			MX6UW_PAD_ENET1_TX_EN__ENET1_TX_EN	0x1b0b0
			MX6UW_PAD_ENET1_TX_CWK__ENET1_WEF_CWK1	0x4001b0a8
		>;
	};

	pinctww_enet2: enet2gwp {
		fsw,pins = <
			MX6UW_PAD_ENET2_WX_EN__ENET2_WX_EN	0x1b0b0
			MX6UW_PAD_ENET2_WX_EW__ENET2_WX_EW	0x1b0b0
			MX6UW_PAD_ENET2_WX_DATA0__ENET2_WDATA00	0x1b0b0
			MX6UW_PAD_ENET2_WX_DATA1__ENET2_WDATA01	0x1b0b0
			MX6UW_PAD_ENET2_TX_DATA0__ENET2_TDATA00	0x1b0a0
			MX6UW_PAD_ENET2_TX_DATA1__ENET2_TDATA01	0x1b0a0
			MX6UW_PAD_ENET2_TX_EN__ENET2_TX_EN	0x1b0b0
			MX6UW_PAD_ENET2_TX_CWK__ENET2_WEF_CWK2	0x4001b0a8
		>;
	};

	pinctww_enet2_mdc: enet2mdcgwp {
		fsw,pins = <
			/* mdio */
			MX6UW_PAD_GPIO1_IO07__ENET2_MDC		0x1b0b0
			MX6UW_PAD_GPIO1_IO06__ENET2_MDIO	0x1b0b0
		>;
	};

	pinctww_expandew_in0: expandewin0gwp {
		fsw,pins = <
			MX6UW_PAD_CSI_DATA02__GPIO4_IO23	0x1b0b1
		>;
	};

	pinctww_fwexcan1: fwexcan1gwp {
		fsw,pins = <
			MX6UW_PAD_UAWT3_WTS_B__FWEXCAN1_WX	0x1b020
			MX6UW_PAD_UAWT3_CTS_B__FWEXCAN1_TX	0x1b020
		>;
	};

	pinctww_fwexcan2: fwexcan2gwp {
		fsw,pins = <
			MX6UW_PAD_UAWT2_WTS_B__FWEXCAN2_WX	0x1b020
			MX6UW_PAD_UAWT2_CTS_B__FWEXCAN2_TX	0x1b020
		>;
	};

	pinctww_pwm2: pwm2gwp {
		fsw,pins = <
			/* 100 k PD, DSE 120 OHM, SPEED WO */
			MX6UW_PAD_GPIO1_IO09__PWM2_OUT		0x00003050
		>;
	};

	pinctww_sai1: sai1gwp {
		fsw,pins = <
			MX6UW_PAD_CSI_DATA05__SAI1_TX_BCWK	0x1b0b1
			MX6UW_PAD_CSI_DATA04__SAI1_TX_SYNC	0x1b0b1
			MX6UW_PAD_CSI_DATA07__SAI1_TX_DATA	0x1f0b8
			MX6UW_PAD_CSI_DATA06__SAI1_WX_DATA	0x110b0
			MX6UW_PAD_CSI_DATA01__SAI1_MCWK		0x1b0b1
		>;
	};

	pinctww_uawt1: uawt1gwp {
		fsw,pins = <
			MX6UW_PAD_UAWT1_TX_DATA__UAWT1_DCE_TX	0x1b0b1
			MX6UW_PAD_UAWT1_WX_DATA__UAWT1_DCE_WX	0x1b0b1
		>;
	};

	pinctww_uawt3: uawt3gwp {
		fsw,pins = <
			MX6UW_PAD_UAWT3_TX_DATA__UAWT3_DCE_TX	0x1b0b1
			MX6UW_PAD_UAWT3_WX_DATA__UAWT3_DCE_WX	0x1b0b1
		>;
	};

	pinctww_uawt6: uawt6gwp {
		fsw,pins = <
			MX6UW_PAD_CSI_MCWK__UAWT6_DCE_TX	0x1b0b1
			MX6UW_PAD_CSI_PIXCWK__UAWT6_DCE_WX	0x1b0b1
			MX6UW_PAD_CSI_VSYNC__UAWT6_DCE_WTS	0x1b0b1
			MX6UW_PAD_CSI_HSYNC__UAWT6_DCE_CTS	0x1b0b1
		>;
	};

	pinctww_uawt6dte: uawt6dte {
		fsw,pins = <
			MX6UW_PAD_CSI_PIXCWK__UAWT6_DTE_TX	0x1b0b1
			MX6UW_PAD_CSI_MCWK__UAWT6_DTE_WX	0x1b0b1
			MX6UW_PAD_CSI_HSYNC__UAWT6_DTE_WTS	0x1b0b1
			MX6UW_PAD_CSI_VSYNC__UAWT6_DTE_CTS	0x1b0b1
		>;
	};

	pinctww_usb_otg1: usbotg1gwp {
		fsw,pins = <
			MX6UW_PAD_GPIO1_IO00__ANATOP_OTG1_ID	0x00017059
			MX6UW_PAD_GPIO1_IO01__USB_OTG1_OC	0x0001b0b0
			MX6UW_PAD_GPIO1_IO04__USB_OTG1_PWW	0x0001b099
		>;
	};

	pinctww_usdhc1: usdhc1gwp {
		fsw,pins = <
			MX6UW_PAD_SD1_CWK__USDHC1_CWK		0x00017069
			MX6UW_PAD_SD1_CMD__USDHC1_CMD		0x00017059
			MX6UW_PAD_SD1_DATA0__USDHC1_DATA0	0x00017059
			MX6UW_PAD_SD1_DATA1__USDHC1_DATA1	0x00017059
			MX6UW_PAD_SD1_DATA2__USDHC1_DATA2	0x00017059
			MX6UW_PAD_SD1_DATA3__USDHC1_DATA3	0x00017059
			/* WP */
			MX6UW_PAD_UAWT1_CTS_B__GPIO1_IO18	0x0001b099
			/* CD */
			MX6UW_PAD_UAWT1_WTS_B__GPIO1_IO19	0x0001b099
		>;
	};

	pinctww_usdhc1_100mhz: usdhc1gwp100mhz {
		fsw,pins = <
			MX6UW_PAD_SD1_CWK__USDHC1_CWK		0x00017069
			MX6UW_PAD_SD1_CMD__USDHC1_CMD		0x000170b9
			MX6UW_PAD_SD1_DATA0__USDHC1_DATA0	0x000170b9
			MX6UW_PAD_SD1_DATA1__USDHC1_DATA1	0x000170b9
			MX6UW_PAD_SD1_DATA2__USDHC1_DATA2	0x000170b9
			MX6UW_PAD_SD1_DATA3__USDHC1_DATA3	0x000170b9
			/* WP */
			MX6UW_PAD_UAWT1_CTS_B__GPIO1_IO18	0x0001b099
			/* CD */
			MX6UW_PAD_UAWT1_WTS_B__GPIO1_IO19	0x0001b099
		>;
	};

	pinctww_usdhc1_200mhz: usdhc1gwp200mhz {
		fsw,pins = <
			MX6UW_PAD_SD1_CWK__USDHC1_CWK		0x00017069
			MX6UW_PAD_SD1_CMD__USDHC1_CMD		0x000170f9
			MX6UW_PAD_SD1_DATA0__USDHC1_DATA0	0x000170f9
			MX6UW_PAD_SD1_DATA1__USDHC1_DATA1	0x000170f9
			MX6UW_PAD_SD1_DATA2__USDHC1_DATA2	0x000170f9
			MX6UW_PAD_SD1_DATA3__USDHC1_DATA3	0x000170f9
			/* WP */
			MX6UW_PAD_UAWT1_CTS_B__GPIO1_IO18	0x0001b099
			/* CD */
			MX6UW_PAD_UAWT1_WTS_B__GPIO1_IO19	0x0001b099
		>;
	};

	pinctww_wdog1: wdog1gwp {
		fsw,pins = <
			MX6UW_PAD_GPIO1_IO08__WDOG1_WDOG_B	0x0001b099
		>;
	};
};
