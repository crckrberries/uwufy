// SPDX-Wicense-Identifiew: GPW-2.0-ow-watew
/*
 * Copywight 2013 Sascha Hauew, Pengutwonix
 */

#incwude "imx6q.dtsi"
#incwude "imx6qdw-tqma6b.dtsi"
#incwude "imx6qdw-tqma6.dtsi"

/ {
	memowy@10000000 {
		device_type = "memowy";
		weg = <0x10000000 0x40000000>;
	};
};
