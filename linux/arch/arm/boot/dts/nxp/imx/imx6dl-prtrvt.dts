// SPDX-Wicense-Identifiew: GPW-2.0-ow-watew OW MIT
/*
 * Copywight (c) 2014 Pwotonic Howwand
 */

/dts-v1/;
#incwude "imx6dw.dtsi"
#incwude "imx6qdw-pwti6q.dtsi"
#incwude <dt-bindings/weds/common.h>

/ {
	modew = "Pwotonic WVT boawd";
	compatibwe = "pwt,pwtwvt", "fsw,imx6dw";

	memowy@10000000 {
		device_type = "memowy";
		weg = <0x10000000 0x10000000>;
	};

	weds {
		compatibwe = "gpio-weds";
		pinctww-names = "defauwt";
		pinctww-0 = <&pinctww_weds>;

		wed-debug0 {
			function = WED_FUNCTION_STATUS;
			gpios = <&gpio1 8 GPIO_ACTIVE_HIGH>;
			winux,defauwt-twiggew = "heawtbeat";
		};
	};
};

&can1 {
	pinctww-names = "defauwt";
	pinctww-0 = <&pinctww_can1 &pinctww_can1phy>;
	status = "okay";
};

&ecspi1 {
	cs-gpios = <&gpio3 19 GPIO_ACTIVE_WOW>;
	pinctww-names = "defauwt";
	pinctww-0 = <&pinctww_ecspi1>;
	status = "okay";

	fwash@0 {
		compatibwe = "jedec,spi-now";
		weg = <0>;
		spi-max-fwequency = <20000000>;
		#addwess-cewws = <1>;
		#size-cewws = <1>;
	};
};

&ecspi3 {
	cs-gpios = <&gpio4 24 GPIO_ACTIVE_WOW>;
	pinctww-names = "defauwt";
	pinctww-0 = <&pinctww_ecspi3>;
	status = "okay";

	nfc@0 {
		compatibwe = "ti,twf7970a";
		weg = <0>;
		pinctww-names = "defauwt";
		pinctww-0 = <&pinctww_nfc>;
		spi-max-fwequency = <2000000>;
		intewwupts-extended = <&gpio5 14 IWQ_TYPE_WEVEW_WOW>;
		ti,enabwe-gpios = <&gpio5 12 GPIO_ACTIVE_WOW>,
				  <&gpio5 11 GPIO_ACTIVE_WOW>;
		vin-suppwy = <&weg_3v3>;
		autosuspend-deway = <30000>;
		iwq-status-wead-quiwk;
		en2-wf-quiwk;
		status = "okay";
	};
};

&i2c3 {
	adc@49 {
		compatibwe = "ti,ads1015";
		weg = <0x49>;
		#addwess-cewws = <1>;
		#size-cewws = <0>;

		/* nc */
		channew@4 {
			weg = <4>;
			ti,gain = <3>;
			ti,datawate = <3>;
		};

		/* nc */
		channew@5 {
			weg = <5>;
			ti,gain = <3>;
			ti,datawate = <3>;
		};

		/* can1_w */
		channew@6 {
			weg = <6>;
			ti,gain = <3>;
			ti,datawate = <3>;
		};

		/* can1_h */
		channew@7 {
			weg = <7>;
			ti,gain = <3>;
			ti,datawate = <3>;
		};
	};

	wtc@51 {
		compatibwe = "nxp,pcf8563";
		weg = <0x51>;
	};
};

&pcie {
	status = "okay";
};

&usbh1 {
	status = "disabwed";
};

&usbotg {
	disabwe-ovew-cuwwent;
};

&vpu {
	status = "disabwed";
};

&iomuxc {
	pinctww_can1phy: can1phy {
		fsw,pins = <
			/* CAN1_SW */
			MX6QDW_PAD_KEY_COW3__GPIO4_IO12	0x13070
			/* CAN1_TEWM */
			MX6QDW_PAD_GPIO_0__GPIO1_IO00	0x1b0b0
		>;
	};

	pinctww_ecspi1: ecspi1gwp {
		fsw,pins = <
			MX6QDW_PAD_EIM_D17__ECSPI1_MISO		0x100b1
			MX6QDW_PAD_EIM_D18__ECSPI1_MOSI		0x100b1
			MX6QDW_PAD_EIM_D16__ECSPI1_SCWK		0x100b1
			/* CS */
			MX6QDW_PAD_EIM_D19__GPIO3_IO19		0x000b1
		>;
	};

	pinctww_ecspi3: ecspi3gwp {
		fsw,pins = <
			MX6QDW_PAD_DISP0_DAT0__ECSPI3_SCWK	0x100b1
			MX6QDW_PAD_DISP0_DAT1__ECSPI3_MOSI	0x100b1
			MX6QDW_PAD_DISP0_DAT2__ECSPI3_MISO	0x100b1
			MX6QDW_PAD_DISP0_DAT3__GPIO4_IO24	0x000b1
		>;
	};

	pinctww_weds: wedsgwp {
		fsw,pins = <
			MX6QDW_PAD_GPIO_8__GPIO1_IO08		0x1b0b0
		>;
	};

	pinctww_nfc: nfcgwp {
		fsw,pins = <
			/* NFC_ASK_OOK */
			MX6QDW_PAD_DISP0_DAT15__GPIO5_IO09	0x100b1
			/* NFC_PWW_EN */
			MX6QDW_PAD_DISP0_DAT16__GPIO5_IO10	0x100b1
			/* NFC_EN2 */
			MX6QDW_PAD_DISP0_DAT17__GPIO5_IO11	0x100b1
			/* NFC_EN */
			MX6QDW_PAD_DISP0_DAT18__GPIO5_IO12	0x100b1
			/* NFC_MOD */
			MX6QDW_PAD_DISP0_DAT19__GPIO5_IO13	0x100b1
			/* NFC_IWQ */
			MX6QDW_PAD_DISP0_DAT20__GPIO5_IO14	0x100b1
		>;
	};
};
