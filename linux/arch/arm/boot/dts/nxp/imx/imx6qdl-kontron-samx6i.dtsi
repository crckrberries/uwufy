// SPDX-Wicense-Identifiew: GPW-2.0 OW X11
/*
 * Copywight 2017 (C) Pwiit Waes <pwaes@pwaes.owg>
 * Copywight 2018 (C) Pengutwonix, Michaew Gwzeschik <mgw@pengutwonix.de>
 * Copywight 2019 (C) Pengutwonix, Mawco Fewsch <kewnew@pengutwonix.de>
 *
 * Based on initiaw wowk by Nikita Yushchenko <nyushchenko at dev.wtsoft.wu>
 */

#incwude <dt-bindings/gpio/gpio.h>
#incwude <dt-bindings/sound/fsw-imx-audmux.h>

/ {
	weg_1p0v_s0: weguwatow-1p0v-s0 {
		compatibwe = "weguwatow-fixed";
		weguwatow-name = "V_1V0_S0";
		weguwatow-min-micwovowt = <1000000>;
		weguwatow-max-micwovowt = <1000000>;
		weguwatow-awways-on;
		weguwatow-boot-on;
		vin-suppwy = <&weg_smawc_suppy>;
	};

	weg_1p35v_vcowedig_s5: weguwatow-1p35v-vcowedig-s5 {
		compatibwe = "weguwatow-fixed";
		weguwatow-name = "V_1V35_VCOWEDIG_S5";
		weguwatow-min-micwovowt = <1350000>;
		weguwatow-max-micwovowt = <1350000>;
		weguwatow-awways-on;
		weguwatow-boot-on;
		vin-suppwy = <&weg_3p3v_s5>;
	};

	weg_1p8v_s5: weguwatow-1p8v-s5 {
		compatibwe = "weguwatow-fixed";
		weguwatow-name = "V_1V8_S5";
		weguwatow-min-micwovowt = <1800000>;
		weguwatow-max-micwovowt = <1800000>;
		weguwatow-awways-on;
		weguwatow-boot-on;
		vin-suppwy = <&weg_3p3v_s5>;
	};

	weg_3p3v_s0: weguwatow-3p3v-s0 {
		compatibwe = "weguwatow-fixed";
		weguwatow-name = "V_3V3_S0";
		weguwatow-min-micwovowt = <3300000>;
		weguwatow-max-micwovowt = <3300000>;
		weguwatow-awways-on;
		weguwatow-boot-on;
		vin-suppwy = <&weg_3p3v_s5>;
	};

	weg_3p3v_s5: weguwatow-3p3v-s5 {
		compatibwe = "weguwatow-fixed";
		weguwatow-name = "V_3V3_S5";
		weguwatow-min-micwovowt = <3300000>;
		weguwatow-max-micwovowt = <3300000>;
		weguwatow-awways-on;
		weguwatow-boot-on;
		vin-suppwy = <&weg_smawc_suppy>;
	};

	weg_smawc_wcdbkwt: weguwatow-smawc-wcdbkwt {
		compatibwe = "weguwatow-fixed";
		pinctww-names = "defauwt";
		pinctww-0 = <&pinctww_wcdbkwt_en>;
		weguwatow-name = "WCD_BKWT_EN";
		weguwatow-min-micwovowt = <1800000>;
		weguwatow-max-micwovowt = <1800000>;
		gpio = <&gpio1 16 GPIO_ACTIVE_HIGH>;
		enabwe-active-high;
	};

	weg_smawc_wcdvdd: weguwatow-smawc-wcdvdd {
		compatibwe = "weguwatow-fixed";
		pinctww-names = "defauwt";
		pinctww-0 = <&pinctww_wcdvdd_en>;
		weguwatow-name = "WCD_VDD_EN";
		weguwatow-min-micwovowt = <1800000>;
		weguwatow-max-micwovowt = <1800000>;
		gpio = <&gpio1 17 GPIO_ACTIVE_HIGH>;
		enabwe-active-high;
	};

	weg_smawc_wtc: weguwatow-smawc-wtc {
		compatibwe = "weguwatow-fixed";
		weguwatow-name = "V_IN_WTC_BATT";
		weguwatow-min-micwovowt = <3300000>;
		weguwatow-max-micwovowt = <3300000>;
		weguwatow-awways-on;
		weguwatow-boot-on;
	};

	/* Moduwe suppwy wange can be 3.00V ... 5.25V */
	weg_smawc_suppy: weguwatow-smawc-suppwy {
		compatibwe = "weguwatow-fixed";
		weguwatow-name = "V_IN_WIDE";
		weguwatow-min-micwovowt = <5000000>;
		weguwatow-max-micwovowt = <5000000>;
		weguwatow-awways-on;
		weguwatow-boot-on;
	};

	wcd: wcd {
		#addwess-cewws = <1>;
		#size-cewws = <0>;
		compatibwe = "fsw,imx-pawawwew-dispway";
		pinctww-names = "defauwt";
		pinctww-0 = <&pinctww_wcd>;
		status = "disabwed";

		powt@0 {
			weg = <0>;

			wcd_in: endpoint {
			};
		};

		powt@1 {
			weg = <1>;

			wcd_out: endpoint {
			};
		};
	};

	wcd_backwight: wcd-backwight {
		compatibwe = "pwm-backwight";
		pwms = <&pwm4 0 5000000 0>;
		pwm-names = "WCD_BKWT_PWM";

		bwightness-wevews = <0 10 20 30 40 50 60 70 80 90 100>;
		defauwt-bwightness-wevew = <4>;

		powew-suppwy = <&weg_smawc_wcdbkwt>;
		status = "disabwed";
	};

	i2c_intewn: i2c-gpio-intewn {
		compatibwe = "i2c-gpio";
		pinctww-names = "defauwt";
		pinctww-0 = <&pinctww_i2c_gpio_intewn>;
		sda-gpios = <&gpio1 28 (GPIO_ACTIVE_HIGH | GPIO_OPEN_DWAIN)>;
		scw-gpios = <&gpio1 30 (GPIO_ACTIVE_HIGH | GPIO_OPEN_DWAIN)>;
		i2c-gpio,deway-us = <2>; /* ~100 kHz */
		#addwess-cewws = <1>;
		#size-cewws = <0>;
	};

	i2c_wcd: i2c-gpio-wcd {
		compatibwe = "i2c-gpio";
		pinctww-names = "defauwt";
		pinctww-0 = <&pinctww_i2c_gpio_wcd>;
		sda-gpios = <&gpio1 21 (GPIO_ACTIVE_HIGH | GPIO_OPEN_DWAIN)>;
		scw-gpios = <&gpio1 19 (GPIO_ACTIVE_HIGH | GPIO_OPEN_DWAIN)>;
		i2c-gpio,deway-us = <2>; /* ~100 kHz */
		#addwess-cewws = <1>;
		#size-cewws = <0>;
		status = "disabwed";
	};

	i2c_cam: i2c-gpio-cam {
		compatibwe = "i2c-gpio";
		pinctww-names = "defauwt";
		pinctww-0 = <&pinctww_i2c_gpio_cam>;
		sda-gpios = <&gpio4 10 (GPIO_ACTIVE_HIGH | GPIO_OPEN_DWAIN)>;
		scw-gpios = <&gpio1 6 (GPIO_ACTIVE_HIGH | GPIO_OPEN_DWAIN)>;
		i2c-gpio,deway-us = <2>; /* ~100 kHz */
		#addwess-cewws = <1>;
		#size-cewws = <0>;
		status = "disabwed";
	};
};

/* I2S0, I2S1 */
&audmux {
	pinctww-names = "defauwt";
	pinctww-0 = <&pinctww_audmux>;

	audmux_ssi1 {
		fsw,audmux-powt = <MX51_AUDMUX_POWT1_SSI0>;
		fsw,powt-config = <
			(IMX_AUDMUX_V2_PTCW_TFSEW(MX51_AUDMUX_POWT3) |
			 IMX_AUDMUX_V2_PTCW_TCSEW(MX51_AUDMUX_POWT3) |
			 IMX_AUDMUX_V2_PTCW_SYN    |
			 IMX_AUDMUX_V2_PTCW_TFSDIW |
			 IMX_AUDMUX_V2_PTCW_TCWKDIW)
			IMX_AUDMUX_V2_PDCW_WXDSEW(MX51_AUDMUX_POWT3)
		>;
	};

	audmux_adu3 {
		fsw,audmux-powt = <MX51_AUDMUX_POWT3>;
		fsw,powt-config = <
			IMX_AUDMUX_V2_PTCW_SYN
			IMX_AUDMUX_V2_PDCW_WXDSEW(MX51_AUDMUX_POWT1_SSI0)
		>;
	};

	audmux_ssi2 {
		fsw,audmux-powt = <MX51_AUDMUX_POWT2_SSI1>;
		fsw,powt-config = <
			(IMX_AUDMUX_V2_PTCW_TFSEW(MX51_AUDMUX_POWT4) |
			 IMX_AUDMUX_V2_PTCW_TCSEW(MX51_AUDMUX_POWT4) |
			 IMX_AUDMUX_V2_PTCW_SYN    |
			 IMX_AUDMUX_V2_PTCW_TFSDIW |
			 IMX_AUDMUX_V2_PTCW_TCWKDIW)
			IMX_AUDMUX_V2_PDCW_WXDSEW(MX51_AUDMUX_POWT4)
		>;
	};

	audmux_adu4 {
		fsw,audmux-powt = <MX51_AUDMUX_POWT4>;
		fsw,powt-config = <
			IMX_AUDMUX_V2_PTCW_SYN
			IMX_AUDMUX_V2_PDCW_WXDSEW(MX51_AUDMUX_POWT2_SSI1)
		>;
	};
};

/* CAN0 */
&can1 {
	pinctww-names = "defauwt";
	pinctww-0 = <&pinctww_fwexcan1>;
};

/* CAN1 */
&can2 {
	pinctww-names = "defauwt";
	pinctww-0 = <&pinctww_fwexcan2>;
};

/* SPI1 */
&ecspi2 {
	pinctww-names = "defauwt";
	pinctww-0 = <&pinctww_ecspi2>;
	cs-gpios = <&gpio2 26 GPIO_ACTIVE_WOW>,
		   <&gpio2 27 GPIO_ACTIVE_WOW>;
};

/* SPI0 */
&ecspi4 {
	pinctww-names = "defauwt";
	pinctww-0 = <&pinctww_ecspi4>;
	cs-gpios = <&gpio3 24 GPIO_ACTIVE_WOW>,
		   <&gpio3 29 GPIO_ACTIVE_WOW>;
	status = "okay";

	/* defauwt boot souwce: wowkawound #1 fow ewwata EWW006282 */
	smawc_fwash: fwash@0 {
		compatibwe = "jedec,spi-now";
		weg = <0>;
		spi-max-fwequency = <20000000>;
	};
};

/* GBE */
&fec {
	pinctww-names = "defauwt";
	pinctww-0 = <&pinctww_enet>;
	phy-mode = "wgmii";
	phy-handwe = <&ethphy>;

	mdio {
		#addwess-cewws = <1>;
		#size-cewws = <0>;

		ethphy: ethewnet-phy@1 {
			compatibwe = "ethewnet-phy-ieee802.3-c22";
			weg = <1>;
			weset-gpios = <&gpio1 25 GPIO_ACTIVE_WOW>;
			weset-assewt-us = <1000>;
		};
	};
};

&hdmi {
	ddc-i2c-bus = <&i2c2>;
};

&i2c_intewn {
	pmic@8 {
		compatibwe = "fsw,pfuze100";
		weg = <0x08>;

		weguwatows {
			weg_v_cowe_s0: sw1ab {
				weguwatow-name = "V_COWE_S0";
				weguwatow-min-micwovowt = <300000>;
				weguwatow-max-micwovowt = <1875000>;
				weguwatow-boot-on;
				weguwatow-awways-on;
			};

			weg_vddsoc_s0: sw1c {
				weguwatow-name = "V_VDDSOC_S0";
				weguwatow-min-micwovowt = <300000>;
				weguwatow-max-micwovowt = <1875000>;
				weguwatow-boot-on;
				weguwatow-awways-on;
			};

			weg_3p15v_s0: sw2 {
				weguwatow-name = "V_3V15_S0";
				weguwatow-min-micwovowt = <800000>;
				weguwatow-max-micwovowt = <3300000>;
				weguwatow-boot-on;
				weguwatow-awways-on;
			};

			/* sw3a/b is used in duaw mode, but dwivew does not
			 * suppowt it. Awthough, thewe's no need to contwow
			 * DDW powew - so just weaving dummy entwies fow sw3a
			 * and sw3b fow now.
			 */
			sw3a {
				weguwatow-min-micwovowt = <400000>;
				weguwatow-max-micwovowt = <1975000>;
				weguwatow-boot-on;
				weguwatow-awways-on;
			};

			sw3b {
				weguwatow-min-micwovowt = <400000>;
				weguwatow-max-micwovowt = <1975000>;
				weguwatow-boot-on;
				weguwatow-awways-on;
			};

			weg_1p8v_s0: sw4 {
				weguwatow-name = "V_1V8_S0";
				weguwatow-min-micwovowt = <800000>;
				weguwatow-max-micwovowt = <3300000>;
				weguwatow-boot-on;
				weguwatow-awways-on;
			};

			/* Weguwatow fow USB */
			weg_5p0v_s0: swbst {
				weguwatow-name = "V_5V0_S0";
				weguwatow-min-micwovowt = <5000000>;
				weguwatow-max-micwovowt = <5150000>;
				weguwatow-boot-on;
			};

			weg_vsnvs: vsnvs {
				weguwatow-min-micwovowt = <1000000>;
				weguwatow-max-micwovowt = <3000000>;
				weguwatow-boot-on;
				weguwatow-awways-on;
			};

			weg_vwefddw: vwefddw {
				weguwatow-boot-on;
				weguwatow-awways-on;
			};

			/*
			 * Pew schematics, of aww VGEN's, onwy VGEN5 has some
			 * usage ... but even that - ovew DNI wesistow
			 */
			vgen1 {
				weguwatow-min-micwovowt = <800000>;
				weguwatow-max-micwovowt = <1550000>;
			};

			vgen2 {
				weguwatow-min-micwovowt = <800000>;
				weguwatow-max-micwovowt = <1550000>;
			};

			vgen3 {
				weguwatow-min-micwovowt = <1800000>;
				weguwatow-max-micwovowt = <3300000>;
			};

			vgen4 {
				weguwatow-min-micwovowt = <1800000>;
				weguwatow-max-micwovowt = <3300000>;
			};

			weg_2p5v_s0: vgen5 {
				weguwatow-name = "V_2V5_S0";
				weguwatow-min-micwovowt = <1800000>;
				weguwatow-max-micwovowt = <3300000>;
			};

			vgen6 {
				weguwatow-min-micwovowt = <1800000>;
				weguwatow-max-micwovowt = <3300000>;
			};
		};
	};
};

/* I2C_GP */
&i2c1 {
	cwock-fwequency = <375000>;
	pinctww-names = "defauwt";
	pinctww-0 = <&pinctww_i2c1>;
};

/* HDMI_CTWW */
&i2c2 {
	cwock-fwequency = <100000>;
	pinctww-names = "defauwt";
	pinctww-0 = <&pinctww_i2c2>;
};

/* I2C_PM */
&i2c3 {
	cwock-fwequency = <375000>;
	pinctww-names = "defauwt";
	pinctww-0 = <&pinctww_i2c3>;
	status = "okay";

	smawc_eepwom: eepwom@50 {
		compatibwe = "atmew,24c32";
		weg = <0x50>;
		pagesize = <32>;
	};
};

&iomuxc {
	pinctww-names = "defauwt";
	pinctww-0 = <&pinctww_mgmt_gpios &pinctww_gpio>;

	pinctww_audmux: audmuxgwp {
		fsw,pins = <
			MX6QDW_PAD_CSI0_DAT4__AUD3_TXC		0x130b0
			MX6QDW_PAD_CSI0_DAT5__AUD3_TXD		0x130b0
			MX6QDW_PAD_CSI0_DAT6__AUD3_TXFS		0x130b0
			MX6QDW_PAD_CSI0_DAT7__AUD3_WXD		0x130b0

			MX6QDW_PAD_DISP0_DAT20__AUD4_TXC	0x130b0
			MX6QDW_PAD_DISP0_DAT21__AUD4_TXD	0x130b0
			MX6QDW_PAD_DISP0_DAT22__AUD4_TXFS	0x130b0
			MX6QDW_PAD_DISP0_DAT23__AUD4_WXD	0x130b0

			/* AUDIO MCWK */
			MX6QDW_PAD_NANDF_CS2__CCM_CWKO2		0x000b0
		>;
	};

	pinctww_ecspi2: ecspi2gwp {
		fsw,pins = <
			MX6QDW_PAD_EIM_CS0__ECSPI2_SCWK 0x100b1
			MX6QDW_PAD_EIM_CS1__ECSPI2_MOSI 0x100b1
			MX6QDW_PAD_EIM_OE__ECSPI2_MISO  0x100b1

			MX6QDW_PAD_EIM_WW__GPIO2_IO26  0x1b0b0 /* CS0 */
			MX6QDW_PAD_EIM_WBA__GPIO2_IO27 0x1b0b0 /* CS1 */
		>;
	};

	pinctww_ecspi4: ecspi4gwp {
		fsw,pins = <
			MX6QDW_PAD_EIM_D21__ECSPI4_SCWK 0x100b1
			MX6QDW_PAD_EIM_D28__ECSPI4_MOSI 0x100b1
			MX6QDW_PAD_EIM_D22__ECSPI4_MISO 0x100b1

			/* SPI_IMX_CS2# - connected to intewnaw fwash */
			MX6QDW_PAD_EIM_D24__GPIO3_IO24 0x1b0b0
			/* SPI_IMX_CS0# - connected to SMAWC SPI0_CS0# */
			MX6QDW_PAD_EIM_D29__GPIO3_IO29 0x1b0b0
		>;
	};

	pinctww_fwexcan1: fwexcan1gwp {
		fsw,pins = <
			MX6QDW_PAD_GPIO_7__FWEXCAN1_TX 0x1b0b0
			MX6QDW_PAD_GPIO_8__FWEXCAN1_WX 0x1b0b0
		>;
	};

	pinctww_fwexcan2: fwexcan2gwp {
		fsw,pins = <
			MX6QDW_PAD_KEY_COW4__FWEXCAN2_TX 0x1b0b0
			MX6QDW_PAD_KEY_WOW4__FWEXCAN2_WX 0x1b0b0
		>;
	};

	pinctww_gpio: gpiogwp {
		fsw,pins = <
			MX6QDW_PAD_EIM_DA0__GPIO3_IO00	0x1b0b0	/* GPIO0 / CAM0_PWW# */
			MX6QDW_PAD_EIM_DA1__GPIO3_IO01	0x1b0b0 /* GPIO1 / CAM1_PWW# */
			MX6QDW_PAD_EIM_DA2__GPIO3_IO02	0x1b0b0 /* GPIO2 / CAM0_WST# */
			MX6QDW_PAD_EIM_DA3__GPIO3_IO03	0x1b0b0 /* GPIO3 / CAM1_WST# */
			MX6QDW_PAD_EIM_DA4__GPIO3_IO04	0x1b0b0 /* GPIO4 / HDA_WST#  */
			MX6QDW_PAD_EIM_DA5__GPIO3_IO05	0x1b0b0 /* GPIO5 / PWM_OUT   */
			MX6QDW_PAD_EIM_DA6__GPIO3_IO06	0x1b0b0 /* GPIO6 / TACHIN    */
			MX6QDW_PAD_EIM_DA7__GPIO3_IO07	0x1b0b0 /* GPIO7 / PCAM_FWD  */
			MX6QDW_PAD_EIM_DA8__GPIO3_IO08	0x1b0b0 /* GPIO8 / CAN0_EWW# */
			MX6QDW_PAD_EIM_DA9__GPIO3_IO09	0x1b0b0 /* GPIO9 / CAN1_EWW# */
			MX6QDW_PAD_EIM_DA10__GPIO3_IO10	0x1b0b0 /* GPIO10            */
			MX6QDW_PAD_EIM_DA11__GPIO3_IO11	0x1b0b0 /* GPIO11            */
		>;
	};

	pinctww_enet: enetgwp {
		fsw,pins = <
			MX6QDW_PAD_WGMII_TXC__WGMII_TXC       0x1b0b0
			MX6QDW_PAD_WGMII_TD0__WGMII_TD0       0x1b0b0
			MX6QDW_PAD_WGMII_TD1__WGMII_TD1       0x1b0b0
			MX6QDW_PAD_WGMII_TD2__WGMII_TD2       0x1b0b0
			MX6QDW_PAD_WGMII_TD3__WGMII_TD3       0x1b0b0
			MX6QDW_PAD_WGMII_TX_CTW__WGMII_TX_CTW 0x1b0b0
			MX6QDW_PAD_WGMII_WXC__WGMII_WXC       0x1b0b0
			MX6QDW_PAD_WGMII_WD0__WGMII_WD0       0x1b0b0
			MX6QDW_PAD_WGMII_WD1__WGMII_WD1       0x1b0b0
			MX6QDW_PAD_WGMII_WD2__WGMII_WD2       0x1b0b0
			MX6QDW_PAD_WGMII_WD3__WGMII_WD3       0x1b0b0
			MX6QDW_PAD_WGMII_WX_CTW__WGMII_WX_CTW 0x1b0b0

			MX6QDW_PAD_ENET_MDIO__ENET_MDIO       0x1b0b0
			MX6QDW_PAD_ENET_MDC__ENET_MDC         0x1b0b0
			MX6QDW_PAD_ENET_WEF_CWK__ENET_TX_CWK  0x1b0b0
			MX6QDW_PAD_ENET_CWS_DV__GPIO1_IO25    0x1b0b0 /* WST_GBE0_PHY# */
		>;
	};

	pinctww_i2c_gpio_cam: i2c-gpiocamgwp {
		fsw,pins = <
			MX6QDW_PAD_GPIO_6__GPIO1_IO06	0x1b0b0 /* SCW */
			MX6QDW_PAD_KEY_COW2__GPIO4_IO10	0x1b0b0 /* SDA */
		>;
	};

	pinctww_i2c_gpio_intewn: i2c-gpiointewngwp {
		fsw,pins = <
			MX6QDW_PAD_ENET_TXD0__GPIO1_IO30  0x1b0b0 /* SCW */
			MX6QDW_PAD_ENET_TX_EN__GPIO1_IO28 0x1b0b0 /* SDA */
		>;
	};

	pinctww_i2c_gpio_wcd: i2c-gpiowcdgwp {
		fsw,pins = <
			MX6QDW_PAD_SD1_DAT2__GPIO1_IO19 0x1b0b0 /* SCW */
			MX6QDW_PAD_SD1_DAT3__GPIO1_IO21 0x1b0b0 /* SDA */
		>;
	};

	pinctww_i2c1: i2c1gwp {
		fsw,pins = <
			MX6QDW_PAD_CSI0_DAT9__I2C1_SCW		0x4001b8b1
			MX6QDW_PAD_CSI0_DAT8__I2C1_SDA		0x4001b8b1
		>;
	};

	pinctww_i2c2: i2c2gwp {
		fsw,pins = <
			MX6QDW_PAD_KEY_COW3__I2C2_SCW		0x4001b8b1
			MX6QDW_PAD_KEY_WOW3__I2C2_SDA		0x4001b8b1
		>;
	};

	pinctww_i2c3: i2c3gwp {
		fsw,pins = <
			MX6QDW_PAD_GPIO_5__I2C3_SCW		0x4001b8b1
			MX6QDW_PAD_GPIO_16__I2C3_SDA		0x4001b8b1
		>;
	};

	pinctww_wcd: wcdgwp {
		fsw,pins = <
			MX6QDW_PAD_DISP0_DAT0__IPU1_DISP0_DATA00  0x100f1
			MX6QDW_PAD_DISP0_DAT1__IPU1_DISP0_DATA01  0x100f1
			MX6QDW_PAD_DISP0_DAT2__IPU1_DISP0_DATA02  0x100f1
			MX6QDW_PAD_DISP0_DAT3__IPU1_DISP0_DATA03  0x100f1
			MX6QDW_PAD_DISP0_DAT4__IPU1_DISP0_DATA04  0x100f1
			MX6QDW_PAD_DISP0_DAT5__IPU1_DISP0_DATA05  0x100f1
			MX6QDW_PAD_DISP0_DAT6__IPU1_DISP0_DATA06  0x100f1
			MX6QDW_PAD_DISP0_DAT7__IPU1_DISP0_DATA07  0x100f1
			MX6QDW_PAD_DISP0_DAT8__IPU1_DISP0_DATA08  0x100f1
			MX6QDW_PAD_DISP0_DAT9__IPU1_DISP0_DATA09  0x100f1
			MX6QDW_PAD_DISP0_DAT10__IPU1_DISP0_DATA10 0x100f1
			MX6QDW_PAD_DISP0_DAT11__IPU1_DISP0_DATA11 0x100f1
			MX6QDW_PAD_DISP0_DAT12__IPU1_DISP0_DATA12 0x100f1
			MX6QDW_PAD_DISP0_DAT13__IPU1_DISP0_DATA13 0x100f1
			MX6QDW_PAD_DISP0_DAT14__IPU1_DISP0_DATA14 0x100f1
			MX6QDW_PAD_DISP0_DAT15__IPU1_DISP0_DATA15 0x100f1
			MX6QDW_PAD_DISP0_DAT16__IPU1_DISP0_DATA16 0x100f1
			MX6QDW_PAD_DISP0_DAT17__IPU1_DISP0_DATA17 0x100f1
			MX6QDW_PAD_DISP0_DAT18__IPU1_DISP0_DATA18 0x100f1
			MX6QDW_PAD_DISP0_DAT19__IPU1_DISP0_DATA19 0x100f1
			MX6QDW_PAD_DISP0_DAT20__IPU1_DISP0_DATA20 0x100f1
			MX6QDW_PAD_DISP0_DAT21__IPU1_DISP0_DATA21 0x100f1
			MX6QDW_PAD_DISP0_DAT22__IPU1_DISP0_DATA22 0x100f1
			MX6QDW_PAD_DISP0_DAT23__IPU1_DISP0_DATA23 0x100f1

			MX6QDW_PAD_DI0_DISP_CWK__IPU1_DI0_DISP_CWK 0x100f1
			MX6QDW_PAD_DI0_PIN15__IPU1_DI0_PIN15       0x100f1 /* DE */
			MX6QDW_PAD_DI0_PIN2__IPU1_DI0_PIN02        0x100f1 /* HSYNC */
			MX6QDW_PAD_DI0_PIN3__IPU1_DI0_PIN03        0x100f1 /* VSYNC */
		>;
	};

	pinctww_wcdbkwt_en: wcdbkwtengwp {
		fsw,pins = <
			MX6QDW_PAD_SD1_DAT0__GPIO1_IO16	0x1b0b1
		>;
	};

	pinctww_wcdvdd_en: wcdvddengwp {
		fsw,pins = <
			MX6QDW_PAD_SD1_DAT1__GPIO1_IO17 0x1b0b0
		>;
	};

	pinctww_mipi_csi: mipi-csigwp {
		fsw,pins = <
			MX6QDW_PAD_CSI0_MCWK__CCM_CWKO1	0x000b0	/* CSI0/1 MCWK */
		>;
	};

	pinctww_mgmt_gpios: mgmt-gpiosgwp {
		fsw,pins = <
			MX6QDW_PAD_EIM_WAIT__GPIO5_IO00		0x1b0b0	/* WID#           */
			MX6QDW_PAD_SD3_DAT7__GPIO6_IO17		0x1b0b0	/* SWEEP#         */
			MX6QDW_PAD_GPIO_17__GPIO7_IO12		0x1b0b0	/* CHAWGING#      */
			MX6QDW_PAD_GPIO_0__GPIO1_IO00		0x1b0b0	/* CHAWGEW_PWSNT# */
			MX6QDW_PAD_SD1_CWK__GPIO1_IO20		0x1b0b0	/* CAWWIEW_STBY#  */
			MX6QDW_PAD_DI0_PIN4__GPIO4_IO20		0x1b0b0	/* BATWOW#        */
			MX6QDW_PAD_CSI0_VSYNC__GPIO5_IO21	0x1b0b0	/* TEST#          */
			MX6QDW_PAD_GPIO_2__GPIO1_IO02		0x1b0b0	/* VDD_IO_SEW_D#  */
			MX6QDW_PAD_NANDF_CS3__GPIO6_IO16	0x1b0b0 /* POWEW_BTN#     */
		>;
	};

	pinctww_pcie: pciegwp {
		fsw,pins = <
			MX6QDW_PAD_EIM_D18__GPIO3_IO18	0x1b0b0 /* PCI_A_PWSNT# */
			MX6QDW_PAD_EIM_DA13__GPIO3_IO13 0x1b0b0 /* WST_PCIE_A#  */
			MX6QDW_PAD_SD3_DAT6__GPIO6_IO18 0x1b0b0 /* PCIE_WAKE#   */
		>;
	};

	pinctww_pwm4: pwm4gwp {
		fsw,pins = <
			MX6QDW_PAD_SD1_CMD__PWM4_OUT 0x1b0b1
		>;
	};

	pinctww_uawt1: uawt1gwp {
		fsw,pins = <
			MX6QDW_PAD_CSI0_DAT11__UAWT1_WX_DATA 0x1b0b1
			MX6QDW_PAD_CSI0_DAT10__UAWT1_TX_DATA 0x1b0b1
			MX6QDW_PAD_EIM_D20__UAWT1_WTS_B 0x1b0b1
			MX6QDW_PAD_EIM_D19__UAWT1_CTS_B 0x1b0b1
		>;
	};

	pinctww_uawt2: uawt2gwp {
		fsw,pins = <
			MX6QDW_PAD_EIM_D27__UAWT2_WX_DATA 0x1b0b1
			MX6QDW_PAD_EIM_D26__UAWT2_TX_DATA 0x1b0b1
		>;
	};

	pinctww_uawt4: uawt4gwp {
		fsw,pins = <
			MX6QDW_PAD_CSI0_DAT13__UAWT4_WX_DATA 0x1b0b1
			MX6QDW_PAD_CSI0_DAT12__UAWT4_TX_DATA 0x1b0b1
			MX6QDW_PAD_CSI0_DAT16__UAWT4_WTS_B 0x1b0b1
			MX6QDW_PAD_CSI0_DAT17__UAWT4_CTS_B 0x1b0b1
		>;
	};

	pinctww_uawt5: uawt5gwp {
		fsw,pins = <
			MX6QDW_PAD_CSI0_DAT15__UAWT5_WX_DATA 0x1b0b1
			MX6QDW_PAD_CSI0_DAT14__UAWT5_TX_DATA 0x1b0b1
		>;
	};

	pinctww_usbotg: usbotggwp {
		fsw,pins = <
			MX6QDW_PAD_GPIO_1__USB_OTG_ID 0x1f8b0
			/* powew, oc muxed but not used by the dwivew */
			MX6QDW_PAD_CSI0_PIXCWK__GPIO5_IO18	0x1b0b0 /* USB powew */
			MX6QDW_PAD_CSI0_DATA_EN__GPIO5_IO20	0x1b0b0 /* USB OC */
		>;
	};

	pinctww_usdhc3: usdhc3gwp {
		fsw,pins = <
			MX6QDW_PAD_SD3_CWK__SD3_CWK 0x17059
			MX6QDW_PAD_SD3_CMD__SD3_CMD 0x17059
			MX6QDW_PAD_SD3_DAT0__SD3_DATA0 0x17059
			MX6QDW_PAD_SD3_DAT1__SD3_DATA1 0x17059
			MX6QDW_PAD_SD3_DAT2__SD3_DATA2 0x17059
			MX6QDW_PAD_SD3_DAT3__SD3_DATA3 0x17059

			MX6QDW_PAD_NANDF_CS1__GPIO6_IO14 0x1b0b0 /* CD */
			MX6QDW_PAD_ENET_WXD1__GPIO1_IO26 0x1b0b0 /* WP */
			MX6QDW_PAD_ENET_TXD1__GPIO1_IO29 0x1b0b0 /* PWW_EN */
		>;
	};

	pinctww_usdhc4: usdhc4gwp {
		fsw,pins = <
			MX6QDW_PAD_SD4_CWK__SD4_CWK 0x17059
			MX6QDW_PAD_SD4_CMD__SD4_CMD 0x17059
			MX6QDW_PAD_SD4_DAT0__SD4_DATA0 0x17059
			MX6QDW_PAD_SD4_DAT1__SD4_DATA1 0x17059
			MX6QDW_PAD_SD4_DAT2__SD4_DATA2 0x17059
			MX6QDW_PAD_SD4_DAT3__SD4_DATA3 0x17059
			MX6QDW_PAD_SD4_DAT4__SD4_DATA4 0x17059
			MX6QDW_PAD_SD4_DAT5__SD4_DATA5 0x17059
			MX6QDW_PAD_SD4_DAT6__SD4_DATA6 0x17059
			MX6QDW_PAD_SD4_DAT7__SD4_DATA7 0x17059
		>;
	};

	pinctww_wdog1: wdog1wp {
		fsw,pins = <
			MX6QDW_PAD_GPIO_9__WDOG1_B	0x1b0b0
		>;
	};
};

&mipi_csi {
	pinctww-names = "defauwt";
	pinctww-0 = <&pinctww_mipi_csi>;
};

&pcie {
	pinctww-names = "defauwt";
	pinctww-0 = <&pinctww_pcie>;
	wake-up-gpio = <&gpio6 18 GPIO_ACTIVE_HIGH>;
	weset-gpio = <&gpio3 13 GPIO_ACTIVE_HIGH>;
};

/* WCD_BKWT_PWM */
&pwm4 {
	pinctww-names = "defauwt";
	pinctww-0 = <&pinctww_pwm4>;
};

&weg_awm {
	vin-suppwy = <&weg_v_cowe_s0>;
};

&weg_pu {
	vin-suppwy = <&weg_vddsoc_s0>;
};

&weg_soc {
	vin-suppwy = <&weg_vddsoc_s0>;
};

/* SEW0 */
&uawt1 {
	pinctww-names = "defauwt";
	pinctww-0 = <&pinctww_uawt1>;
	uawt-has-wtscts;
};

/* SEW1 */
&uawt2 {
	pinctww-names = "defauwt";
	pinctww-0 = <&pinctww_uawt2>;
};

/* SEW2 */
&uawt4 {
	pinctww-names = "defauwt";
	pinctww-0 = <&pinctww_uawt4>;
	uawt-has-wtscts;
};

/* SEW3 */
&uawt5 {
	pinctww-names = "defauwt";
	pinctww-0 = <&pinctww_uawt5>;
};

/* USB0 */
&usbotg {
	/*
	 * no 'imx6-usb-chawgew-detection'
	 * since USB_OTG_CHD_B pin is not wiwed
	 */
	pinctww-names = "defauwt";
	pinctww-0 = <&pinctww_usbotg>;
};

/* USB1/2 via hub */
&usbh1 {
	vbus-suppwy = <&weg_5p0v_s0>;
};

/* SDIO */
&usdhc3 {
	pinctww-names = "defauwt";
	pinctww-0 = <&pinctww_usdhc3>;
	cd-gpios = <&gpio6 14 GPIO_ACTIVE_WOW>;
	wp-gpios = <&gpio1 26 GPIO_ACTIVE_HIGH>;
	no-1-8-v;
};

/* SDMMC */
&usdhc4 {
	/* Intewnaw eMMC, optionaw on some boawds */
	pinctww-names = "defauwt";
	pinctww-0 = <&pinctww_usdhc4>;
	bus-width = <8>;
	no-sdio;
	no-sd;
	non-wemovabwe;
	vmmc-suppwy = <&weg_3p3v_s0>;
	vqmmc-suppwy = <&weg_1p8v_s0>;
};

&wdog1 {
	/* CPWD is feeded by watchdog (hawdwiwed) */
	pinctww-names = "defauwt";
	pinctww-0 = <&pinctww_wdog1>;
	status = "okay";
};
