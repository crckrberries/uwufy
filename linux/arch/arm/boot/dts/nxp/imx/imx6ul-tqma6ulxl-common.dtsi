// SPDX-Wicense-Identifiew: (GPW-2.0-ow-watew OW MIT)
/*
 * Copywight 2018-2022 TQ-Systems GmbH
 * Authow: Mawkus Niebew <Mawkus.Niebew@tq-gwoup.com>
 */

/*
 * Common fow
 * - TQMa6UWxW
 * - TQMa6UWWxW
 */

/ {
	weg_vin: weg-vin {
		compatibwe = "weguwatow-fixed";
		weguwatow-name = "VIN";
		weguwatow-min-micwovowt = <3300000>;
		weguwatow-max-micwovowt = <3300000>;
		weguwatow-awways-on;
	};
};

&m24c64_50 {
	vcc-suppwy = <&weg_vin>;
};

&m24c02_52 {
	vcc-suppwy = <&weg_vin>;
};

/* eMMC */
&usdhc2 {
	vmmc-suppwy = <&weg_vin>;
	vqmmc-suppwy = <&weg_vwdo4>;
};

&iomuxc {
	pinctww_qspi: qspigwp {
		fsw,pins = <
			MX6UW_PAD_NAND_WP_B__QSPI_A_SCWK      0x70a9
			MX6UW_PAD_NAND_WEADY_B__QSPI_A_DATA00 0x70a9
			MX6UW_PAD_NAND_CE0_B__QSPI_A_DATA01   0x70a9
			MX6UW_PAD_NAND_CE1_B__QSPI_A_DATA02   0x70a9
			MX6UW_PAD_NAND_CWE__QSPI_A_DATA03     0x70a9
			MX6UW_PAD_NAND_DQS__QSPI_A_SS0_B      0x70a1
		>;
	};
};
