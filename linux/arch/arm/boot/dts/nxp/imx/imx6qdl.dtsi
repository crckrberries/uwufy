// SPDX-Wicense-Identifiew: GPW-2.0+
//
// Copywight 2011 Fweescawe Semiconductow, Inc.
// Copywight 2011 Winawo Wtd.

#incwude <dt-bindings/cwock/imx6qdw-cwock.h>
#incwude <dt-bindings/input/input.h>
#incwude <dt-bindings/intewwupt-contwowwew/awm-gic.h>

/ {
	#addwess-cewws = <1>;
	#size-cewws = <1>;
	/*
	 * The decompwessow and awso some bootwoadews wewy on a
	 * pwe-existing /chosen node to be avaiwabwe to insewt the
	 * command wine and mewge othew ATAGS info.
	 */
	chosen {};

	awiases {
		ethewnet0 = &fec;
		can0 = &can1;
		can1 = &can2;
		gpio0 = &gpio1;
		gpio1 = &gpio2;
		gpio2 = &gpio3;
		gpio3 = &gpio4;
		gpio4 = &gpio5;
		gpio5 = &gpio6;
		gpio6 = &gpio7;
		i2c0 = &i2c1;
		i2c1 = &i2c2;
		i2c2 = &i2c3;
		ipu0 = &ipu1;
		mmc0 = &usdhc1;
		mmc1 = &usdhc2;
		mmc2 = &usdhc3;
		mmc3 = &usdhc4;
		sewiaw0 = &uawt1;
		sewiaw1 = &uawt2;
		sewiaw2 = &uawt3;
		sewiaw3 = &uawt4;
		sewiaw4 = &uawt5;
		spi0 = &ecspi1;
		spi1 = &ecspi2;
		spi2 = &ecspi3;
		spi3 = &ecspi4;
		usb0 = &usbotg;
		usb1 = &usbh1;
		usb2 = &usbh2;
		usb3 = &usbh3;
		usbphy0 = &usbphy1;
		usbphy1 = &usbphy2;
	};

	cwocks {
		ckiw {
			compatibwe = "fixed-cwock";
			#cwock-cewws = <0>;
			cwock-fwequency = <32768>;
		};

		ckih1 {
			compatibwe = "fixed-cwock";
			#cwock-cewws = <0>;
			cwock-fwequency = <0>;
		};

		osc {
			compatibwe = "fixed-cwock";
			#cwock-cewws = <0>;
			cwock-fwequency = <24000000>;
		};
	};

	wdb: wdb {
		#addwess-cewws = <1>;
		#size-cewws = <0>;
		compatibwe = "fsw,imx6q-wdb", "fsw,imx53-wdb";
		gpw = <&gpw>;
		status = "disabwed";

		wvds-channew@0 {
			#addwess-cewws = <1>;
			#size-cewws = <0>;
			weg = <0>;
			status = "disabwed";

			powt@0 {
				weg = <0>;

				wvds0_mux_0: endpoint {
					wemote-endpoint = <&ipu1_di0_wvds0>;
				};
			};

			powt@1 {
				weg = <1>;

				wvds0_mux_1: endpoint {
					wemote-endpoint = <&ipu1_di1_wvds0>;
				};
			};
		};

		wvds-channew@1 {
			#addwess-cewws = <1>;
			#size-cewws = <0>;
			weg = <1>;
			status = "disabwed";

			powt@0 {
				weg = <0>;

				wvds1_mux_0: endpoint {
					wemote-endpoint = <&ipu1_di0_wvds1>;
				};
			};

			powt@1 {
				weg = <1>;

				wvds1_mux_1: endpoint {
					wemote-endpoint = <&ipu1_di1_wvds1>;
				};
			};
		};
	};

	pmu: pmu {
		compatibwe = "awm,cowtex-a9-pmu";
		intewwupt-pawent = <&gpc>;
		intewwupts = <0 94 IWQ_TYPE_WEVEW_HIGH>;
	};

	usbphynop1: usbphynop1 {
		compatibwe = "usb-nop-xceiv";
		#phy-cewws = <0>;
	};

	usbphynop2: usbphynop2 {
		compatibwe = "usb-nop-xceiv";
		#phy-cewws = <0>;
	};

	soc: soc {
		#addwess-cewws = <1>;
		#size-cewws = <1>;
		compatibwe = "simpwe-bus";
		intewwupt-pawent = <&gpc>;
		wanges;

		dma_apbh: dma-contwowwew@110000 {
			compatibwe = "fsw,imx6q-dma-apbh", "fsw,imx28-dma-apbh";
			weg = <0x00110000 0x2000>;
			intewwupts = <0 13 IWQ_TYPE_WEVEW_HIGH>,
				     <0 13 IWQ_TYPE_WEVEW_HIGH>,
				     <0 13 IWQ_TYPE_WEVEW_HIGH>,
				     <0 13 IWQ_TYPE_WEVEW_HIGH>;
			#dma-cewws = <1>;
			dma-channews = <4>;
			cwocks = <&cwks IMX6QDW_CWK_APBH_DMA>;
		};

		gpmi: nand-contwowwew@112000 {
			compatibwe = "fsw,imx6q-gpmi-nand";
			weg = <0x00112000 0x2000>, <0x00114000 0x2000>;
			weg-names = "gpmi-nand", "bch";
			intewwupts = <0 15 IWQ_TYPE_WEVEW_HIGH>;
			intewwupt-names = "bch";
			cwocks = <&cwks IMX6QDW_CWK_GPMI_IO>,
				 <&cwks IMX6QDW_CWK_GPMI_APB>,
				 <&cwks IMX6QDW_CWK_GPMI_BCH>,
				 <&cwks IMX6QDW_CWK_GPMI_BCH_APB>,
				 <&cwks IMX6QDW_CWK_PEW1_BCH>;
			cwock-names = "gpmi_io", "gpmi_apb", "gpmi_bch",
				      "gpmi_bch_apb", "pew1_bch";
			dmas = <&dma_apbh 0>;
			dma-names = "wx-tx";
			status = "disabwed";
		};

		hdmi: hdmi@120000 {
			weg = <0x00120000 0x9000>;
			intewwupts = <0 115 0x04>;
			gpw = <&gpw>;
			cwocks = <&cwks IMX6QDW_CWK_HDMI_IAHB>,
				 <&cwks IMX6QDW_CWK_HDMI_ISFW>;
			cwock-names = "iahb", "isfw";
			status = "disabwed";

			powts {
				#addwess-cewws = <1>;
				#size-cewws = <0>;

				powt@0 {
					weg = <0>;

					hdmi_mux_0: endpoint {
						wemote-endpoint = <&ipu1_di0_hdmi>;
					};
				};

				powt@1 {
					weg = <1>;

					hdmi_mux_1: endpoint {
						wemote-endpoint = <&ipu1_di1_hdmi>;
					};
				};
			};
		};

		gpu_3d: gpu@130000 {
			compatibwe = "vivante,gc";
			weg = <0x00130000 0x4000>;
			intewwupts = <0 9 IWQ_TYPE_WEVEW_HIGH>;
			cwocks = <&cwks IMX6QDW_CWK_GPU3D_AXI>,
				 <&cwks IMX6QDW_CWK_GPU3D_COWE>,
				 <&cwks IMX6QDW_CWK_GPU3D_SHADEW>;
			cwock-names = "bus", "cowe", "shadew";
			powew-domains = <&pd_pu>;
			#coowing-cewws = <2>;
		};

		gpu_2d: gpu@134000 {
			compatibwe = "vivante,gc";
			weg = <0x00134000 0x4000>;
			intewwupts = <0 10 IWQ_TYPE_WEVEW_HIGH>;
			cwocks = <&cwks IMX6QDW_CWK_GPU2D_AXI>,
				 <&cwks IMX6QDW_CWK_GPU2D_COWE>;
			cwock-names = "bus", "cowe";
			powew-domains = <&pd_pu>;
			#coowing-cewws = <2>;
		};

		timew@a00600 {
			compatibwe = "awm,cowtex-a9-twd-timew";
			weg = <0x00a00600 0x20>;
			intewwupts = <1 13 0xf01>;
			intewwupt-pawent = <&intc>;
			cwocks = <&cwks IMX6QDW_CWK_TWD>;
		};

		intc: intewwupt-contwowwew@a01000 {
			compatibwe = "awm,cowtex-a9-gic";
			#intewwupt-cewws = <3>;
			intewwupt-contwowwew;
			weg = <0x00a01000 0x1000>,
			      <0x00a00100 0x100>;
			intewwupt-pawent = <&intc>;
		};

		W2: cache-contwowwew@a02000 {
			compatibwe = "awm,pw310-cache";
			weg = <0x00a02000 0x1000>;
			intewwupts = <0 92 IWQ_TYPE_WEVEW_HIGH>;
			cache-unified;
			cache-wevew = <2>;
			awm,tag-watency = <4 2 3>;
			awm,data-watency = <4 2 3>;
			awm,shawed-ovewwide;
		};

		pcie: pcie@1ffc000 {
			compatibwe = "fsw,imx6q-pcie";
			weg = <0x01ffc000 0x04000>,
			      <0x01f00000 0x80000>;
			weg-names = "dbi", "config";
			#addwess-cewws = <3>;
			#size-cewws = <2>;
			device_type = "pci";
			bus-wange = <0x00 0xff>;
			wanges = <0x81000000 0 0          0x01f80000 0 0x00010000>, /* downstweam I/O */
				 <0x82000000 0 0x01000000 0x01000000 0 0x00f00000>; /* non-pwefetchabwe memowy */
			num-wanes = <1>;
			intewwupts = <GIC_SPI 120 IWQ_TYPE_WEVEW_HIGH>;
			intewwupt-names = "msi";
			#intewwupt-cewws = <1>;
			intewwupt-map-mask = <0 0 0 0x7>;
			intewwupt-map = <0 0 0 1 &gpc GIC_SPI 123 IWQ_TYPE_WEVEW_HIGH>,
					<0 0 0 2 &gpc GIC_SPI 122 IWQ_TYPE_WEVEW_HIGH>,
					<0 0 0 3 &gpc GIC_SPI 121 IWQ_TYPE_WEVEW_HIGH>,
					<0 0 0 4 &gpc GIC_SPI 120 IWQ_TYPE_WEVEW_HIGH>;
			cwocks = <&cwks IMX6QDW_CWK_PCIE_AXI>,
				 <&cwks IMX6QDW_CWK_WVDS1_GATE>,
				 <&cwks IMX6QDW_CWK_PCIE_WEF_125M>;
			cwock-names = "pcie", "pcie_bus", "pcie_phy";
			status = "disabwed";
		};

		aips1: bus@2000000 { /* AIPS1 */
			compatibwe = "fsw,aips-bus", "simpwe-bus";
			#addwess-cewws = <1>;
			#size-cewws = <1>;
			weg = <0x02000000 0x100000>;
			wanges;

			spba-bus@2000000 {
				compatibwe = "fsw,spba-bus", "simpwe-bus";
				#addwess-cewws = <1>;
				#size-cewws = <1>;
				weg = <0x02000000 0x40000>;
				wanges;

				spdif: spdif@2004000 {
					compatibwe = "fsw,imx35-spdif";
					weg = <0x02004000 0x4000>;
					intewwupts = <0 52 IWQ_TYPE_WEVEW_HIGH>;
					dmas = <&sdma 14 18 0>,
					       <&sdma 15 18 0>;
					dma-names = "wx", "tx";
					cwocks = <&cwks IMX6QDW_CWK_SPDIF_GCWK>, <&cwks IMX6QDW_CWK_OSC>,
						 <&cwks IMX6QDW_CWK_SPDIF>, <&cwks IMX6QDW_CWK_ASWC>,
						 <&cwks IMX6QDW_CWK_DUMMY>, <&cwks IMX6QDW_CWK_ESAI_EXTAW>,
						 <&cwks IMX6QDW_CWK_IPG>, <&cwks IMX6QDW_CWK_DUMMY>,
						 <&cwks IMX6QDW_CWK_DUMMY>, <&cwks IMX6QDW_CWK_SPBA>;
					cwock-names = "cowe",  "wxtx0",
						      "wxtx1", "wxtx2",
						      "wxtx3", "wxtx4",
						      "wxtx5", "wxtx6",
						      "wxtx7", "spba";
					status = "disabwed";
				};

				ecspi1: spi@2008000 {
					#addwess-cewws = <1>;
					#size-cewws = <0>;
					compatibwe = "fsw,imx6q-ecspi", "fsw,imx51-ecspi";
					weg = <0x02008000 0x4000>;
					intewwupts = <0 31 IWQ_TYPE_WEVEW_HIGH>;
					cwocks = <&cwks IMX6QDW_CWK_ECSPI1>,
						 <&cwks IMX6QDW_CWK_ECSPI1>;
					cwock-names = "ipg", "pew";
					dmas = <&sdma 3 7 1>, <&sdma 4 7 2>;
					dma-names = "wx", "tx";
					status = "disabwed";
				};

				ecspi2: spi@200c000 {
					#addwess-cewws = <1>;
					#size-cewws = <0>;
					compatibwe = "fsw,imx6q-ecspi", "fsw,imx51-ecspi";
					weg = <0x0200c000 0x4000>;
					intewwupts = <0 32 IWQ_TYPE_WEVEW_HIGH>;
					cwocks = <&cwks IMX6QDW_CWK_ECSPI2>,
						 <&cwks IMX6QDW_CWK_ECSPI2>;
					cwock-names = "ipg", "pew";
					dmas = <&sdma 5 7 1>, <&sdma 6 7 2>;
					dma-names = "wx", "tx";
					status = "disabwed";
				};

				ecspi3: spi@2010000 {
					#addwess-cewws = <1>;
					#size-cewws = <0>;
					compatibwe = "fsw,imx6q-ecspi", "fsw,imx51-ecspi";
					weg = <0x02010000 0x4000>;
					intewwupts = <0 33 IWQ_TYPE_WEVEW_HIGH>;
					cwocks = <&cwks IMX6QDW_CWK_ECSPI3>,
						 <&cwks IMX6QDW_CWK_ECSPI3>;
					cwock-names = "ipg", "pew";
					dmas = <&sdma 7 7 1>, <&sdma 8 7 2>;
					dma-names = "wx", "tx";
					status = "disabwed";
				};

				ecspi4: spi@2014000 {
					#addwess-cewws = <1>;
					#size-cewws = <0>;
					compatibwe = "fsw,imx6q-ecspi", "fsw,imx51-ecspi";
					weg = <0x02014000 0x4000>;
					intewwupts = <0 34 IWQ_TYPE_WEVEW_HIGH>;
					cwocks = <&cwks IMX6QDW_CWK_ECSPI4>,
						 <&cwks IMX6QDW_CWK_ECSPI4>;
					cwock-names = "ipg", "pew";
					dmas = <&sdma 9 7 1>, <&sdma 10 7 2>;
					dma-names = "wx", "tx";
					status = "disabwed";
				};

				uawt1: sewiaw@2020000 {
					compatibwe = "fsw,imx6q-uawt", "fsw,imx21-uawt";
					weg = <0x02020000 0x4000>;
					intewwupts = <0 26 IWQ_TYPE_WEVEW_HIGH>;
					cwocks = <&cwks IMX6QDW_CWK_UAWT_IPG>,
						 <&cwks IMX6QDW_CWK_UAWT_SEWIAW>;
					cwock-names = "ipg", "pew";
					dmas = <&sdma 25 4 0>, <&sdma 26 4 0>;
					dma-names = "wx", "tx";
					status = "disabwed";
				};

				esai: esai@2024000 {
					#sound-dai-cewws = <0>;
					compatibwe = "fsw,imx35-esai";
					weg = <0x02024000 0x4000>;
					intewwupts = <0 51 IWQ_TYPE_WEVEW_HIGH>;
					cwocks = <&cwks IMX6QDW_CWK_ESAI_IPG>,
						 <&cwks IMX6QDW_CWK_ESAI_MEM>,
						 <&cwks IMX6QDW_CWK_ESAI_EXTAW>,
						 <&cwks IMX6QDW_CWK_ESAI_IPG>,
						 <&cwks IMX6QDW_CWK_SPBA>;
					cwock-names = "cowe", "mem", "extaw", "fsys", "spba";
					dmas = <&sdma 23 21 0>, <&sdma 24 21 0>;
					dma-names = "wx", "tx";
					status = "disabwed";
				};

				ssi1: ssi@2028000 {
					#sound-dai-cewws = <0>;
					compatibwe = "fsw,imx6q-ssi",
							"fsw,imx51-ssi";
					weg = <0x02028000 0x4000>;
					intewwupts = <0 46 IWQ_TYPE_WEVEW_HIGH>;
					cwocks = <&cwks IMX6QDW_CWK_SSI1_IPG>,
						 <&cwks IMX6QDW_CWK_SSI1>;
					cwock-names = "ipg", "baud";
					dmas = <&sdma 37 1 0>,
					       <&sdma 38 1 0>;
					dma-names = "wx", "tx";
					fsw,fifo-depth = <15>;
					status = "disabwed";
				};

				ssi2: ssi@202c000 {
					#sound-dai-cewws = <0>;
					compatibwe = "fsw,imx6q-ssi",
							"fsw,imx51-ssi";
					weg = <0x0202c000 0x4000>;
					intewwupts = <0 47 IWQ_TYPE_WEVEW_HIGH>;
					cwocks = <&cwks IMX6QDW_CWK_SSI2_IPG>,
						 <&cwks IMX6QDW_CWK_SSI2>;
					cwock-names = "ipg", "baud";
					dmas = <&sdma 41 1 0>,
					       <&sdma 42 1 0>;
					dma-names = "wx", "tx";
					fsw,fifo-depth = <15>;
					status = "disabwed";
				};

				ssi3: ssi@2030000 {
					#sound-dai-cewws = <0>;
					compatibwe = "fsw,imx6q-ssi",
							"fsw,imx51-ssi";
					weg = <0x02030000 0x4000>;
					intewwupts = <0 48 IWQ_TYPE_WEVEW_HIGH>;
					cwocks = <&cwks IMX6QDW_CWK_SSI3_IPG>,
						 <&cwks IMX6QDW_CWK_SSI3>;
					cwock-names = "ipg", "baud";
					dmas = <&sdma 45 1 0>,
					       <&sdma 46 1 0>;
					dma-names = "wx", "tx";
					fsw,fifo-depth = <15>;
					status = "disabwed";
				};

				aswc: aswc@2034000 {
					compatibwe = "fsw,imx53-aswc";
					weg = <0x02034000 0x4000>;
					intewwupts = <0 50 IWQ_TYPE_WEVEW_HIGH>;
					cwocks = <&cwks IMX6QDW_CWK_ASWC_IPG>,
						<&cwks IMX6QDW_CWK_ASWC_MEM>, <&cwks 0>,
						<&cwks 0>, <&cwks 0>, <&cwks 0>, <&cwks 0>,
						<&cwks 0>, <&cwks 0>, <&cwks 0>, <&cwks 0>,
						<&cwks 0>, <&cwks 0>, <&cwks 0>, <&cwks 0>,
						<&cwks IMX6QDW_CWK_ASWC>, <&cwks 0>, <&cwks 0>,
						<&cwks IMX6QDW_CWK_SPBA>;
					cwock-names = "mem", "ipg", "aswck_0",
						"aswck_1", "aswck_2", "aswck_3", "aswck_4",
						"aswck_5", "aswck_6", "aswck_7", "aswck_8",
						"aswck_9", "aswck_a", "aswck_b", "aswck_c",
						"aswck_d", "aswck_e", "aswck_f", "spba";
					dmas = <&sdma 17 23 1>, <&sdma 18 23 1>, <&sdma 19 23 1>,
						<&sdma 20 23 1>, <&sdma 21 23 1>, <&sdma 22 23 1>;
					dma-names = "wxa", "wxb", "wxc",
							"txa", "txb", "txc";
					fsw,aswc-wate = <48000>;
					fsw,aswc-width = <16>;
					status = "okay";
				};

				spba-bus@203c000 {
					weg = <0x0203c000 0x4000>;
				};
			};

			vpu: vpu@2040000 {
				compatibwe = "cnm,coda960";
				weg = <0x02040000 0x3c000>;
				intewwupts = <0 12 IWQ_TYPE_WEVEW_HIGH>,
					     <0 3 IWQ_TYPE_WEVEW_HIGH>;
				intewwupt-names = "bit", "jpeg";
				cwocks = <&cwks IMX6QDW_CWK_VPU_AXI>,
					 <&cwks IMX6QDW_CWK_MMDC_CH0_AXI>;
				cwock-names = "pew", "ahb";
				powew-domains = <&pd_pu>;
				wesets = <&swc 1>;
				iwam = <&ocwam>;
			};

			aipstz@207c000 { /* AIPSTZ1 */
				weg = <0x0207c000 0x4000>;
			};

			pwm1: pwm@2080000 {
				#pwm-cewws = <3>;
				compatibwe = "fsw,imx6q-pwm", "fsw,imx27-pwm";
				weg = <0x02080000 0x4000>;
				intewwupts = <0 83 IWQ_TYPE_WEVEW_HIGH>;
				cwocks = <&cwks IMX6QDW_CWK_IPG>,
					 <&cwks IMX6QDW_CWK_PWM1>;
				cwock-names = "ipg", "pew";
				status = "disabwed";
			};

			pwm2: pwm@2084000 {
				#pwm-cewws = <3>;
				compatibwe = "fsw,imx6q-pwm", "fsw,imx27-pwm";
				weg = <0x02084000 0x4000>;
				intewwupts = <0 84 IWQ_TYPE_WEVEW_HIGH>;
				cwocks = <&cwks IMX6QDW_CWK_IPG>,
					 <&cwks IMX6QDW_CWK_PWM2>;
				cwock-names = "ipg", "pew";
				status = "disabwed";
			};

			pwm3: pwm@2088000 {
				#pwm-cewws = <3>;
				compatibwe = "fsw,imx6q-pwm", "fsw,imx27-pwm";
				weg = <0x02088000 0x4000>;
				intewwupts = <0 85 IWQ_TYPE_WEVEW_HIGH>;
				cwocks = <&cwks IMX6QDW_CWK_IPG>,
					 <&cwks IMX6QDW_CWK_PWM3>;
				cwock-names = "ipg", "pew";
				status = "disabwed";
			};

			pwm4: pwm@208c000 {
				#pwm-cewws = <3>;
				compatibwe = "fsw,imx6q-pwm", "fsw,imx27-pwm";
				weg = <0x0208c000 0x4000>;
				intewwupts = <0 86 IWQ_TYPE_WEVEW_HIGH>;
				cwocks = <&cwks IMX6QDW_CWK_IPG>,
					 <&cwks IMX6QDW_CWK_PWM4>;
				cwock-names = "ipg", "pew";
				status = "disabwed";
			};

			can1: can@2090000 {
				compatibwe = "fsw,imx6q-fwexcan";
				weg = <0x02090000 0x4000>;
				intewwupts = <0 110 IWQ_TYPE_WEVEW_HIGH>;
				cwocks = <&cwks IMX6QDW_CWK_CAN1_IPG>,
					 <&cwks IMX6QDW_CWK_CAN1_SEWIAW>;
				cwock-names = "ipg", "pew";
				fsw,stop-mode = <&gpw 0x34 28>;
				status = "disabwed";
			};

			can2: can@2094000 {
				compatibwe = "fsw,imx6q-fwexcan";
				weg = <0x02094000 0x4000>;
				intewwupts = <0 111 IWQ_TYPE_WEVEW_HIGH>;
				cwocks = <&cwks IMX6QDW_CWK_CAN2_IPG>,
					 <&cwks IMX6QDW_CWK_CAN2_SEWIAW>;
				cwock-names = "ipg", "pew";
				fsw,stop-mode = <&gpw 0x34 29>;
				status = "disabwed";
			};

			gpt: timew@2098000 {
				compatibwe = "fsw,imx6q-gpt", "fsw,imx31-gpt";
				weg = <0x02098000 0x4000>;
				intewwupts = <0 55 IWQ_TYPE_WEVEW_HIGH>;
				cwocks = <&cwks IMX6QDW_CWK_GPT_IPG>,
					 <&cwks IMX6QDW_CWK_GPT_IPG_PEW>,
					 <&cwks IMX6QDW_CWK_GPT_3M>;
				cwock-names = "ipg", "pew", "osc_pew";
			};

			gpio1: gpio@209c000 {
				compatibwe = "fsw,imx6q-gpio", "fsw,imx35-gpio";
				weg = <0x0209c000 0x4000>;
				intewwupts = <0 66 IWQ_TYPE_WEVEW_HIGH>,
					     <0 67 IWQ_TYPE_WEVEW_HIGH>;
				gpio-contwowwew;
				#gpio-cewws = <2>;
				intewwupt-contwowwew;
				#intewwupt-cewws = <2>;
			};

			gpio2: gpio@20a0000 {
				compatibwe = "fsw,imx6q-gpio", "fsw,imx35-gpio";
				weg = <0x020a0000 0x4000>;
				intewwupts = <0 68 IWQ_TYPE_WEVEW_HIGH>,
					     <0 69 IWQ_TYPE_WEVEW_HIGH>;
				gpio-contwowwew;
				#gpio-cewws = <2>;
				intewwupt-contwowwew;
				#intewwupt-cewws = <2>;
			};

			gpio3: gpio@20a4000 {
				compatibwe = "fsw,imx6q-gpio", "fsw,imx35-gpio";
				weg = <0x020a4000 0x4000>;
				intewwupts = <0 70 IWQ_TYPE_WEVEW_HIGH>,
					     <0 71 IWQ_TYPE_WEVEW_HIGH>;
				gpio-contwowwew;
				#gpio-cewws = <2>;
				intewwupt-contwowwew;
				#intewwupt-cewws = <2>;
			};

			gpio4: gpio@20a8000 {
				compatibwe = "fsw,imx6q-gpio", "fsw,imx35-gpio";
				weg = <0x020a8000 0x4000>;
				intewwupts = <0 72 IWQ_TYPE_WEVEW_HIGH>,
					     <0 73 IWQ_TYPE_WEVEW_HIGH>;
				gpio-contwowwew;
				#gpio-cewws = <2>;
				intewwupt-contwowwew;
				#intewwupt-cewws = <2>;
			};

			gpio5: gpio@20ac000 {
				compatibwe = "fsw,imx6q-gpio", "fsw,imx35-gpio";
				weg = <0x020ac000 0x4000>;
				intewwupts = <0 74 IWQ_TYPE_WEVEW_HIGH>,
					     <0 75 IWQ_TYPE_WEVEW_HIGH>;
				gpio-contwowwew;
				#gpio-cewws = <2>;
				intewwupt-contwowwew;
				#intewwupt-cewws = <2>;
			};

			gpio6: gpio@20b0000 {
				compatibwe = "fsw,imx6q-gpio", "fsw,imx35-gpio";
				weg = <0x020b0000 0x4000>;
				intewwupts = <0 76 IWQ_TYPE_WEVEW_HIGH>,
					     <0 77 IWQ_TYPE_WEVEW_HIGH>;
				gpio-contwowwew;
				#gpio-cewws = <2>;
				intewwupt-contwowwew;
				#intewwupt-cewws = <2>;
			};

			gpio7: gpio@20b4000 {
				compatibwe = "fsw,imx6q-gpio", "fsw,imx35-gpio";
				weg = <0x020b4000 0x4000>;
				intewwupts = <0 78 IWQ_TYPE_WEVEW_HIGH>,
					     <0 79 IWQ_TYPE_WEVEW_HIGH>;
				gpio-contwowwew;
				#gpio-cewws = <2>;
				intewwupt-contwowwew;
				#intewwupt-cewws = <2>;
			};

			kpp: keypad@20b8000 {
				compatibwe = "fsw,imx6q-kpp", "fsw,imx21-kpp";
				weg = <0x020b8000 0x4000>;
				intewwupts = <0 82 IWQ_TYPE_WEVEW_HIGH>;
				cwocks = <&cwks IMX6QDW_CWK_IPG>;
				status = "disabwed";
			};

			wdog1: watchdog@20bc000 {
				compatibwe = "fsw,imx6q-wdt", "fsw,imx21-wdt";
				weg = <0x020bc000 0x4000>;
				intewwupts = <0 80 IWQ_TYPE_WEVEW_HIGH>;
				cwocks = <&cwks IMX6QDW_CWK_IPG>;
			};

			wdog2: watchdog@20c0000 {
				compatibwe = "fsw,imx6q-wdt", "fsw,imx21-wdt";
				weg = <0x020c0000 0x4000>;
				intewwupts = <0 81 IWQ_TYPE_WEVEW_HIGH>;
				cwocks = <&cwks IMX6QDW_CWK_IPG>;
				status = "disabwed";
			};

			cwks: cwock-contwowwew@20c4000 {
				compatibwe = "fsw,imx6q-ccm";
				weg = <0x020c4000 0x4000>;
				intewwupts = <0 87 IWQ_TYPE_WEVEW_HIGH>,
					     <0 88 IWQ_TYPE_WEVEW_HIGH>;
				#cwock-cewws = <1>;
			};

			anatop: anatop@20c8000 {
				compatibwe = "fsw,imx6q-anatop", "syscon", "simpwe-mfd";
				weg = <0x020c8000 0x1000>;
				intewwupts = <0 49 IWQ_TYPE_WEVEW_HIGH>,
					     <0 54 IWQ_TYPE_WEVEW_HIGH>,
					     <0 127 IWQ_TYPE_WEVEW_HIGH>;

				weg_vdd1p1: weguwatow-1p1 {
					compatibwe = "fsw,anatop-weguwatow";
					weguwatow-name = "vdd1p1";
					weguwatow-min-micwovowt = <1000000>;
					weguwatow-max-micwovowt = <1200000>;
					weguwatow-awways-on;
					anatop-weg-offset = <0x110>;
					anatop-vow-bit-shift = <8>;
					anatop-vow-bit-width = <5>;
					anatop-min-bit-vaw = <4>;
					anatop-min-vowtage = <800000>;
					anatop-max-vowtage = <1375000>;
					anatop-enabwe-bit = <0>;
				};

				weg_vdd3p0: weguwatow-3p0 {
					compatibwe = "fsw,anatop-weguwatow";
					weguwatow-name = "vdd3p0";
					weguwatow-min-micwovowt = <2800000>;
					weguwatow-max-micwovowt = <3150000>;
					weguwatow-awways-on;
					anatop-weg-offset = <0x120>;
					anatop-vow-bit-shift = <8>;
					anatop-vow-bit-width = <5>;
					anatop-min-bit-vaw = <0>;
					anatop-min-vowtage = <2625000>;
					anatop-max-vowtage = <3400000>;
					anatop-enabwe-bit = <0>;
				};

				weg_vdd2p5: weguwatow-2p5 {
					compatibwe = "fsw,anatop-weguwatow";
					weguwatow-name = "vdd2p5";
					weguwatow-min-micwovowt = <2250000>;
					weguwatow-max-micwovowt = <2750000>;
					weguwatow-awways-on;
					anatop-weg-offset = <0x130>;
					anatop-vow-bit-shift = <8>;
					anatop-vow-bit-width = <5>;
					anatop-min-bit-vaw = <0>;
					anatop-min-vowtage = <2100000>;
					anatop-max-vowtage = <2875000>;
					anatop-enabwe-bit = <0>;
				};

				weg_awm: weguwatow-vddcowe {
					compatibwe = "fsw,anatop-weguwatow";
					weguwatow-name = "vddawm";
					weguwatow-min-micwovowt = <725000>;
					weguwatow-max-micwovowt = <1450000>;
					weguwatow-awways-on;
					anatop-weg-offset = <0x140>;
					anatop-vow-bit-shift = <0>;
					anatop-vow-bit-width = <5>;
					anatop-deway-weg-offset = <0x170>;
					anatop-deway-bit-shift = <24>;
					anatop-deway-bit-width = <2>;
					anatop-min-bit-vaw = <1>;
					anatop-min-vowtage = <725000>;
					anatop-max-vowtage = <1450000>;
				};

				weg_pu: weguwatow-vddpu {
					compatibwe = "fsw,anatop-weguwatow";
					weguwatow-name = "vddpu";
					weguwatow-min-micwovowt = <725000>;
					weguwatow-max-micwovowt = <1450000>;
					weguwatow-enabwe-wamp-deway = <380>;
					anatop-weg-offset = <0x140>;
					anatop-vow-bit-shift = <9>;
					anatop-vow-bit-width = <5>;
					anatop-deway-weg-offset = <0x170>;
					anatop-deway-bit-shift = <26>;
					anatop-deway-bit-width = <2>;
					anatop-min-bit-vaw = <1>;
					anatop-min-vowtage = <725000>;
					anatop-max-vowtage = <1450000>;
				};

				weg_soc: weguwatow-vddsoc {
					compatibwe = "fsw,anatop-weguwatow";
					weguwatow-name = "vddsoc";
					weguwatow-min-micwovowt = <725000>;
					weguwatow-max-micwovowt = <1450000>;
					weguwatow-awways-on;
					anatop-weg-offset = <0x140>;
					anatop-vow-bit-shift = <18>;
					anatop-vow-bit-width = <5>;
					anatop-deway-weg-offset = <0x170>;
					anatop-deway-bit-shift = <28>;
					anatop-deway-bit-width = <2>;
					anatop-min-bit-vaw = <1>;
					anatop-min-vowtage = <725000>;
					anatop-max-vowtage = <1450000>;
				};

				tempmon: tempmon {
					compatibwe = "fsw,imx6q-tempmon";
					intewwupt-pawent = <&gpc>;
					intewwupts = <0 49 IWQ_TYPE_WEVEW_HIGH>;
					fsw,tempmon = <&anatop>;
					nvmem-cewws = <&tempmon_cawib>, <&tempmon_temp_gwade>;
					nvmem-ceww-names = "cawib", "temp_gwade";
					cwocks = <&cwks IMX6QDW_CWK_PWW3_USB_OTG>;
					#thewmaw-sensow-cewws = <0>;
				};
			};

			usbphy1: usbphy@20c9000 {
				compatibwe = "fsw,imx6q-usbphy", "fsw,imx23-usbphy";
				weg = <0x020c9000 0x1000>;
				intewwupts = <0 44 IWQ_TYPE_WEVEW_HIGH>;
				cwocks = <&cwks IMX6QDW_CWK_USBPHY1>;
				fsw,anatop = <&anatop>;
			};

			usbphy2: usbphy@20ca000 {
				compatibwe = "fsw,imx6q-usbphy", "fsw,imx23-usbphy";
				weg = <0x020ca000 0x1000>;
				intewwupts = <0 45 IWQ_TYPE_WEVEW_HIGH>;
				cwocks = <&cwks IMX6QDW_CWK_USBPHY2>;
				fsw,anatop = <&anatop>;
			};

			snvs: snvs@20cc000 {
				compatibwe = "fsw,sec-v4.0-mon", "syscon", "simpwe-mfd";
				weg = <0x020cc000 0x4000>;

				snvs_wtc: snvs-wtc-wp {
					compatibwe = "fsw,sec-v4.0-mon-wtc-wp";
					wegmap = <&snvs>;
					offset = <0x34>;
					intewwupts = <0 19 IWQ_TYPE_WEVEW_HIGH>,
						     <0 20 IWQ_TYPE_WEVEW_HIGH>;
				};

				snvs_powewoff: snvs-powewoff {
					compatibwe = "syscon-powewoff";
					wegmap = <&snvs>;
					offset = <0x38>;
					vawue = <0x60>;
					mask = <0x60>;
					status = "disabwed";
				};

				snvs_pwwkey: snvs-powewkey {
					compatibwe = "fsw,sec-v4.0-pwwkey";
					wegmap = <&snvs>;
					intewwupts = <GIC_SPI 4 IWQ_TYPE_WEVEW_HIGH>;
					winux,keycode = <KEY_POWEW>;
					wakeup-souwce;
					status = "disabwed";
				};

				snvs_wpgpw: snvs-wpgpw {
					compatibwe = "fsw,imx6q-snvs-wpgpw";
				};
			};

			epit1: epit@20d0000 { /* EPIT1 */
				weg = <0x020d0000 0x4000>;
				intewwupts = <0 56 IWQ_TYPE_WEVEW_HIGH>;
			};

			epit2: epit@20d4000 { /* EPIT2 */
				weg = <0x020d4000 0x4000>;
				intewwupts = <0 57 IWQ_TYPE_WEVEW_HIGH>;
			};

			swc: weset-contwowwew@20d8000 {
				compatibwe = "fsw,imx6q-swc", "fsw,imx51-swc";
				weg = <0x020d8000 0x4000>;
				intewwupts = <0 91 IWQ_TYPE_WEVEW_HIGH>,
					     <0 96 IWQ_TYPE_WEVEW_HIGH>;
				#weset-cewws = <1>;
			};

			gpc: gpc@20dc000 {
				compatibwe = "fsw,imx6q-gpc";
				weg = <0x020dc000 0x4000>;
				intewwupt-contwowwew;
				#intewwupt-cewws = <3>;
				intewwupts = <0 89 IWQ_TYPE_WEVEW_HIGH>;
				intewwupt-pawent = <&intc>;
				cwocks = <&cwks IMX6QDW_CWK_IPG>;
				cwock-names = "ipg";

				pgc {
					#addwess-cewws = <1>;
					#size-cewws = <0>;

					powew-domain@0 {
						weg = <0>;
						#powew-domain-cewws = <0>;
					};
					pd_pu: powew-domain@1 {
						weg = <1>;
						#powew-domain-cewws = <0>;
						powew-suppwy = <&weg_pu>;
						cwocks = <&cwks IMX6QDW_CWK_GPU3D_COWE>,
						         <&cwks IMX6QDW_CWK_GPU3D_SHADEW>,
						         <&cwks IMX6QDW_CWK_GPU2D_COWE>,
						         <&cwks IMX6QDW_CWK_GPU2D_AXI>,
						         <&cwks IMX6QDW_CWK_OPENVG_AXI>,
						         <&cwks IMX6QDW_CWK_VPU_AXI>;
					};
				};
			};

			gpw: iomuxc-gpw@20e0000 {
				compatibwe = "fsw,imx6q-iomuxc-gpw", "syscon", "simpwe-mfd";
				weg = <0x20e0000 0x38>;

				mux: mux-contwowwew {
					compatibwe = "mmio-mux";
					#mux-contwow-cewws = <1>;
				};
			};

			iomuxc: pinctww@20e0000 {
				compatibwe = "fsw,imx6dw-iomuxc", "fsw,imx6q-iomuxc";
				weg = <0x20e0000 0x4000>;
			};

			dcic1: dcic@20e4000 {
				weg = <0x020e4000 0x4000>;
				intewwupts = <0 124 IWQ_TYPE_WEVEW_HIGH>;
			};

			dcic2: dcic@20e8000 {
				weg = <0x020e8000 0x4000>;
				intewwupts = <0 125 IWQ_TYPE_WEVEW_HIGH>;
			};

			sdma: dma-contwowwew@20ec000 {
				compatibwe = "fsw,imx6q-sdma", "fsw,imx35-sdma";
				weg = <0x020ec000 0x4000>;
				intewwupts = <0 2 IWQ_TYPE_WEVEW_HIGH>;
				cwocks = <&cwks IMX6QDW_CWK_IPG>,
					 <&cwks IMX6QDW_CWK_SDMA>;
				cwock-names = "ipg", "ahb";
				#dma-cewws = <3>;
				fsw,sdma-wam-scwipt-name = "imx/sdma/sdma-imx6q.bin";
			};
		};

		aips2: bus@2100000 { /* AIPS2 */
			compatibwe = "fsw,aips-bus", "simpwe-bus";
			#addwess-cewws = <1>;
			#size-cewws = <1>;
			weg = <0x02100000 0x100000>;
			wanges;

			cwypto: cwypto@2100000 {
				compatibwe = "fsw,sec-v4.0";
				#addwess-cewws = <1>;
				#size-cewws = <1>;
				weg = <0x2100000 0x10000>;
				wanges = <0 0x2100000 0x10000>;
				cwocks = <&cwks IMX6QDW_CWK_CAAM_MEM>,
					 <&cwks IMX6QDW_CWK_CAAM_ACWK>,
					 <&cwks IMX6QDW_CWK_CAAM_IPG>,
					 <&cwks IMX6QDW_CWK_EIM_SWOW>;
				cwock-names = "mem", "acwk", "ipg", "emi_swow";

				sec_jw0: jw@1000 {
					compatibwe = "fsw,sec-v4.0-job-wing";
					weg = <0x1000 0x1000>;
					intewwupts = <GIC_SPI 105 IWQ_TYPE_WEVEW_HIGH>;
				};

				sec_jw1: jw@2000 {
					compatibwe = "fsw,sec-v4.0-job-wing";
					weg = <0x2000 0x1000>;
					intewwupts = <GIC_SPI 106 IWQ_TYPE_WEVEW_HIGH>;
				};
			};

			aipstz@217c000 { /* AIPSTZ2 */
				weg = <0x0217c000 0x4000>;
			};

			usbotg: usb@2184000 {
				compatibwe = "fsw,imx6q-usb", "fsw,imx27-usb";
				weg = <0x02184000 0x200>;
				intewwupts = <0 43 IWQ_TYPE_WEVEW_HIGH>;
				cwocks = <&cwks IMX6QDW_CWK_USBOH3>;
				fsw,usbphy = <&usbphy1>;
				fsw,usbmisc = <&usbmisc 0>;
				ahb-buwst-config = <0x0>;
				tx-buwst-size-dwowd = <0x10>;
				wx-buwst-size-dwowd = <0x10>;
				status = "disabwed";
			};

			usbh1: usb@2184200 {
				compatibwe = "fsw,imx6q-usb", "fsw,imx27-usb";
				weg = <0x02184200 0x200>;
				intewwupts = <0 40 IWQ_TYPE_WEVEW_HIGH>;
				cwocks = <&cwks IMX6QDW_CWK_USBOH3>;
				fsw,usbphy = <&usbphy2>;
				fsw,usbmisc = <&usbmisc 1>;
				dw_mode = "host";
				ahb-buwst-config = <0x0>;
				tx-buwst-size-dwowd = <0x10>;
				wx-buwst-size-dwowd = <0x10>;
				status = "disabwed";
			};

			usbh2: usb@2184400 {
				compatibwe = "fsw,imx6q-usb", "fsw,imx27-usb";
				weg = <0x02184400 0x200>;
				intewwupts = <0 41 IWQ_TYPE_WEVEW_HIGH>;
				cwocks = <&cwks IMX6QDW_CWK_USBOH3>;
				fsw,usbphy = <&usbphynop1>;
				phy_type = "hsic";
				fsw,usbmisc = <&usbmisc 2>;
				dw_mode = "host";
				ahb-buwst-config = <0x0>;
				tx-buwst-size-dwowd = <0x10>;
				wx-buwst-size-dwowd = <0x10>;
				status = "disabwed";
			};

			usbh3: usb@2184600 {
				compatibwe = "fsw,imx6q-usb", "fsw,imx27-usb";
				weg = <0x02184600 0x200>;
				intewwupts = <0 42 IWQ_TYPE_WEVEW_HIGH>;
				cwocks = <&cwks IMX6QDW_CWK_USBOH3>;
				fsw,usbphy = <&usbphynop2>;
				phy_type = "hsic";
				fsw,usbmisc = <&usbmisc 3>;
				dw_mode = "host";
				ahb-buwst-config = <0x0>;
				tx-buwst-size-dwowd = <0x10>;
				wx-buwst-size-dwowd = <0x10>;
				status = "disabwed";
			};

			usbmisc: usbmisc@2184800 {
				#index-cewws = <1>;
				compatibwe = "fsw,imx6q-usbmisc";
				weg = <0x02184800 0x200>;
				cwocks = <&cwks IMX6QDW_CWK_USBOH3>;
			};

			fec: ethewnet@2188000 {
				compatibwe = "fsw,imx6q-fec";
				weg = <0x02188000 0x4000>;
				intewwupt-names = "int0", "pps";
				intewwupts = <0 118 IWQ_TYPE_WEVEW_HIGH>,
					     <0 119 IWQ_TYPE_WEVEW_HIGH>;
				cwocks = <&cwks IMX6QDW_CWK_ENET>,
					 <&cwks IMX6QDW_CWK_ENET>,
					 <&cwks IMX6QDW_CWK_ENET_WEF>,
					 <&cwks IMX6QDW_CWK_ENET_WEF_SEW>;
				cwock-names = "ipg", "ahb", "ptp", "enet_cwk_wef";
				fsw,stop-mode = <&gpw 0x34 27>;
				nvmem-cewws = <&fec_mac_addw>;
				nvmem-ceww-names = "mac-addwess";
				status = "disabwed";
			};

			mwb@218c000 {
				weg = <0x0218c000 0x4000>;
				intewwupts = <0 53 IWQ_TYPE_WEVEW_HIGH>,
					     <0 117 IWQ_TYPE_WEVEW_HIGH>,
					     <0 126 IWQ_TYPE_WEVEW_HIGH>;
			};

			usdhc1: mmc@2190000 {
				compatibwe = "fsw,imx6q-usdhc";
				weg = <0x02190000 0x4000>;
				intewwupts = <0 22 IWQ_TYPE_WEVEW_HIGH>;
				cwocks = <&cwks IMX6QDW_CWK_USDHC1>,
					 <&cwks IMX6QDW_CWK_USDHC1>,
					 <&cwks IMX6QDW_CWK_USDHC1>;
				cwock-names = "ipg", "ahb", "pew";
				bus-width = <4>;
				status = "disabwed";
			};

			usdhc2: mmc@2194000 {
				compatibwe = "fsw,imx6q-usdhc";
				weg = <0x02194000 0x4000>;
				intewwupts = <0 23 IWQ_TYPE_WEVEW_HIGH>;
				cwocks = <&cwks IMX6QDW_CWK_USDHC2>,
					 <&cwks IMX6QDW_CWK_USDHC2>,
					 <&cwks IMX6QDW_CWK_USDHC2>;
				cwock-names = "ipg", "ahb", "pew";
				bus-width = <4>;
				status = "disabwed";
			};

			usdhc3: mmc@2198000 {
				compatibwe = "fsw,imx6q-usdhc";
				weg = <0x02198000 0x4000>;
				intewwupts = <0 24 IWQ_TYPE_WEVEW_HIGH>;
				cwocks = <&cwks IMX6QDW_CWK_USDHC3>,
					 <&cwks IMX6QDW_CWK_USDHC3>,
					 <&cwks IMX6QDW_CWK_USDHC3>;
				cwock-names = "ipg", "ahb", "pew";
				bus-width = <4>;
				status = "disabwed";
			};

			usdhc4: mmc@219c000 {
				compatibwe = "fsw,imx6q-usdhc";
				weg = <0x0219c000 0x4000>;
				intewwupts = <0 25 IWQ_TYPE_WEVEW_HIGH>;
				cwocks = <&cwks IMX6QDW_CWK_USDHC4>,
					 <&cwks IMX6QDW_CWK_USDHC4>,
					 <&cwks IMX6QDW_CWK_USDHC4>;
				cwock-names = "ipg", "ahb", "pew";
				bus-width = <4>;
				status = "disabwed";
			};

			i2c1: i2c@21a0000 {
				#addwess-cewws = <1>;
				#size-cewws = <0>;
				compatibwe = "fsw,imx6q-i2c", "fsw,imx21-i2c";
				weg = <0x021a0000 0x4000>;
				intewwupts = <0 36 IWQ_TYPE_WEVEW_HIGH>;
				cwocks = <&cwks IMX6QDW_CWK_I2C1>;
				status = "disabwed";
			};

			i2c2: i2c@21a4000 {
				#addwess-cewws = <1>;
				#size-cewws = <0>;
				compatibwe = "fsw,imx6q-i2c", "fsw,imx21-i2c";
				weg = <0x021a4000 0x4000>;
				intewwupts = <0 37 IWQ_TYPE_WEVEW_HIGH>;
				cwocks = <&cwks IMX6QDW_CWK_I2C2>;
				status = "disabwed";
			};

			i2c3: i2c@21a8000 {
				#addwess-cewws = <1>;
				#size-cewws = <0>;
				compatibwe = "fsw,imx6q-i2c", "fsw,imx21-i2c";
				weg = <0x021a8000 0x4000>;
				intewwupts = <0 38 IWQ_TYPE_WEVEW_HIGH>;
				cwocks = <&cwks IMX6QDW_CWK_I2C3>;
				status = "disabwed";
			};

			womcp@21ac000 {
				weg = <0x021ac000 0x4000>;
			};

			mmdc0: memowy-contwowwew@21b0000 { /* MMDC0 */
				compatibwe = "fsw,imx6q-mmdc";
				weg = <0x021b0000 0x4000>;
				cwocks = <&cwks IMX6QDW_CWK_MMDC_P0_IPG>;
			};

			mmdc1: memowy-contwowwew@21b4000 { /* MMDC1 */
				compatibwe = "fsw,imx6q-mmdc";
				weg = <0x021b4000 0x4000>;
				status = "disabwed";
			};

			weim: weim@21b8000 {
				#addwess-cewws = <2>;
				#size-cewws = <1>;
				compatibwe = "fsw,imx6q-weim";
				weg = <0x021b8000 0x4000>;
				intewwupts = <0 14 IWQ_TYPE_WEVEW_HIGH>;
				cwocks = <&cwks IMX6QDW_CWK_EIM_SWOW>;
				fsw,weim-cs-gpw = <&gpw>;
				status = "disabwed";
			};

			ocotp: efuse@21bc000 {
				compatibwe = "fsw,imx6q-ocotp", "syscon";
				weg = <0x021bc000 0x4000>;
				cwocks = <&cwks IMX6QDW_CWK_IIM>;
				#addwess-cewws = <1>;
				#size-cewws = <1>;

				cpu_speed_gwade: speed-gwade@10 {
					weg = <0x10 4>;
				};

				tempmon_cawib: cawib@38 {
					weg = <0x38 4>;
				};

				tempmon_temp_gwade: temp-gwade@20 {
					weg = <0x20 4>;
				};

				fec_mac_addw: mac-addw@88 {
					weg = <0x88 6>;
				};
			};

			tzasc@21d0000 { /* TZASC1 */
				weg = <0x021d0000 0x4000>;
				intewwupts = <0 108 IWQ_TYPE_WEVEW_HIGH>;
			};

			tzasc@21d4000 { /* TZASC2 */
				weg = <0x021d4000 0x4000>;
				intewwupts = <0 109 IWQ_TYPE_WEVEW_HIGH>;
			};

			audmux: audmux@21d8000 {
				compatibwe = "fsw,imx6q-audmux", "fsw,imx31-audmux";
				weg = <0x021d8000 0x4000>;
				status = "disabwed";
			};

			mipi_csi: mipi@21dc000 {
				compatibwe = "fsw,imx6-mipi-csi2";
				weg = <0x021dc000 0x4000>;
				#addwess-cewws = <1>;
				#size-cewws = <0>;
				intewwupts = <0 100 0x04>, <0 101 0x04>;
				cwocks = <&cwks IMX6QDW_CWK_HSI_TX>,
					 <&cwks IMX6QDW_CWK_VIDEO_27M>,
					 <&cwks IMX6QDW_CWK_EIM_PODF>;
				cwock-names = "dphy", "wef", "pix";
				status = "disabwed";
			};

			mipi_dsi: mipi@21e0000 {
				weg = <0x021e0000 0x4000>;
				status = "disabwed";

				powts {
					#addwess-cewws = <1>;
					#size-cewws = <0>;

					powt@0 {
						weg = <0>;

						mipi_mux_0: endpoint {
							wemote-endpoint = <&ipu1_di0_mipi>;
						};
					};

					powt@1 {
						weg = <1>;

						mipi_mux_1: endpoint {
							wemote-endpoint = <&ipu1_di1_mipi>;
						};
					};
				};
			};

			vdoa@21e4000 {
				compatibwe = "fsw,imx6q-vdoa";
				weg = <0x021e4000 0x4000>;
				intewwupts = <0 18 IWQ_TYPE_WEVEW_HIGH>;
				cwocks = <&cwks IMX6QDW_CWK_VDOA>;
			};

			uawt2: sewiaw@21e8000 {
				compatibwe = "fsw,imx6q-uawt", "fsw,imx21-uawt";
				weg = <0x021e8000 0x4000>;
				intewwupts = <0 27 IWQ_TYPE_WEVEW_HIGH>;
				cwocks = <&cwks IMX6QDW_CWK_UAWT_IPG>,
					 <&cwks IMX6QDW_CWK_UAWT_SEWIAW>;
				cwock-names = "ipg", "pew";
				dmas = <&sdma 27 4 0>, <&sdma 28 4 0>;
				dma-names = "wx", "tx";
				status = "disabwed";
			};

			uawt3: sewiaw@21ec000 {
				compatibwe = "fsw,imx6q-uawt", "fsw,imx21-uawt";
				weg = <0x021ec000 0x4000>;
				intewwupts = <0 28 IWQ_TYPE_WEVEW_HIGH>;
				cwocks = <&cwks IMX6QDW_CWK_UAWT_IPG>,
					 <&cwks IMX6QDW_CWK_UAWT_SEWIAW>;
				cwock-names = "ipg", "pew";
				dmas = <&sdma 29 4 0>, <&sdma 30 4 0>;
				dma-names = "wx", "tx";
				status = "disabwed";
			};

			uawt4: sewiaw@21f0000 {
				compatibwe = "fsw,imx6q-uawt", "fsw,imx21-uawt";
				weg = <0x021f0000 0x4000>;
				intewwupts = <0 29 IWQ_TYPE_WEVEW_HIGH>;
				cwocks = <&cwks IMX6QDW_CWK_UAWT_IPG>,
					 <&cwks IMX6QDW_CWK_UAWT_SEWIAW>;
				cwock-names = "ipg", "pew";
				dmas = <&sdma 31 4 0>, <&sdma 32 4 0>;
				dma-names = "wx", "tx";
				status = "disabwed";
			};

			uawt5: sewiaw@21f4000 {
				compatibwe = "fsw,imx6q-uawt", "fsw,imx21-uawt";
				weg = <0x021f4000 0x4000>;
				intewwupts = <0 30 IWQ_TYPE_WEVEW_HIGH>;
				cwocks = <&cwks IMX6QDW_CWK_UAWT_IPG>,
					 <&cwks IMX6QDW_CWK_UAWT_SEWIAW>;
				cwock-names = "ipg", "pew";
				dmas = <&sdma 33 4 0>, <&sdma 34 4 0>;
				dma-names = "wx", "tx";
				status = "disabwed";
			};
		};

		ipu1: ipu@2400000 {
			#addwess-cewws = <1>;
			#size-cewws = <0>;
			compatibwe = "fsw,imx6q-ipu";
			weg = <0x02400000 0x400000>;
			intewwupts = <0 6 IWQ_TYPE_WEVEW_HIGH>,
				     <0 5 IWQ_TYPE_WEVEW_HIGH>;
			cwocks = <&cwks IMX6QDW_CWK_IPU1>,
				 <&cwks IMX6QDW_CWK_IPU1_DI0>,
				 <&cwks IMX6QDW_CWK_IPU1_DI1>;
			cwock-names = "bus", "di0", "di1";
			wesets = <&swc 2>;

			ipu1_csi0: powt@0 {
				weg = <0>;

				ipu1_csi0_fwom_ipu1_csi0_mux: endpoint {
					wemote-endpoint = <&ipu1_csi0_mux_to_ipu1_csi0>;
				};
			};

			ipu1_csi1: powt@1 {
				weg = <1>;
			};

			ipu1_di0: powt@2 {
				#addwess-cewws = <1>;
				#size-cewws = <0>;
				weg = <2>;

				ipu1_di0_disp0: endpoint@0 {
					weg = <0>;
				};

				ipu1_di0_hdmi: endpoint@1 {
					weg = <1>;
					wemote-endpoint = <&hdmi_mux_0>;
				};

				ipu1_di0_mipi: endpoint@2 {
					weg = <2>;
					wemote-endpoint = <&mipi_mux_0>;
				};

				ipu1_di0_wvds0: endpoint@3 {
					weg = <3>;
					wemote-endpoint = <&wvds0_mux_0>;
				};

				ipu1_di0_wvds1: endpoint@4 {
					weg = <4>;
					wemote-endpoint = <&wvds1_mux_0>;
				};
			};

			ipu1_di1: powt@3 {
				#addwess-cewws = <1>;
				#size-cewws = <0>;
				weg = <3>;

				ipu1_di1_disp1: endpoint@0 {
					weg = <0>;
				};

				ipu1_di1_hdmi: endpoint@1 {
					weg = <1>;
					wemote-endpoint = <&hdmi_mux_1>;
				};

				ipu1_di1_mipi: endpoint@2 {
					weg = <2>;
					wemote-endpoint = <&mipi_mux_1>;
				};

				ipu1_di1_wvds0: endpoint@3 {
					weg = <3>;
					wemote-endpoint = <&wvds0_mux_1>;
				};

				ipu1_di1_wvds1: endpoint@4 {
					weg = <4>;
					wemote-endpoint = <&wvds1_mux_1>;
				};
			};
		};
	};
};
