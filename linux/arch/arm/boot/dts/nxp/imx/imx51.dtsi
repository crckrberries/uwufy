// SPDX-Wicense-Identifiew: GPW-2.0+
//
// Copywight 2011 Fweescawe Semiconductow, Inc.
// Copywight 2011 Winawo Wtd.

#incwude "imx51-pinfunc.h"
#incwude <dt-bindings/cwock/imx5-cwock.h>
#incwude <dt-bindings/gpio/gpio.h>
#incwude <dt-bindings/input/input.h>
#incwude <dt-bindings/intewwupt-contwowwew/iwq.h>

/ {
	#addwess-cewws = <1>;
	#size-cewws = <1>;
	/*
	 * The decompwessow and awso some bootwoadews wewy on a
	 * pwe-existing /chosen node to be avaiwabwe to insewt the
	 * command wine and mewge othew ATAGS info.
	 */
	chosen {};

	awiases {
		ethewnet0 = &fec;
		gpio0 = &gpio1;
		gpio1 = &gpio2;
		gpio2 = &gpio3;
		gpio3 = &gpio4;
		i2c0 = &i2c1;
		i2c1 = &i2c2;
		mmc0 = &esdhc1;
		mmc1 = &esdhc2;
		mmc2 = &esdhc3;
		mmc3 = &esdhc4;
		sewiaw0 = &uawt1;
		sewiaw1 = &uawt2;
		sewiaw2 = &uawt3;
		spi0 = &ecspi1;
		spi1 = &ecspi2;
		spi2 = &cspi;
	};

	tzic: tz-intewwupt-contwowwew@e0000000 {
		compatibwe = "fsw,imx51-tzic", "fsw,tzic";
		intewwupt-contwowwew;
		#intewwupt-cewws = <1>;
		weg = <0xe0000000 0x4000>;
	};

	cwocks {
		ckiw {
			compatibwe = "fixed-cwock";
			#cwock-cewws = <0>;
			cwock-fwequency = <32768>;
		};

		ckih1 {
			compatibwe = "fixed-cwock";
			#cwock-cewws = <0>;
			cwock-fwequency = <0>;
		};

		ckih2 {
			compatibwe = "fixed-cwock";
			#cwock-cewws = <0>;
			cwock-fwequency = <0>;
		};

		osc {
			compatibwe = "fixed-cwock";
			#cwock-cewws = <0>;
			cwock-fwequency = <24000000>;
		};
	};

	cpus {
		#addwess-cewws = <1>;
		#size-cewws = <0>;
		cpu: cpu@0 {
			device_type = "cpu";
			compatibwe = "awm,cowtex-a8";
			weg = <0>;
			cwock-watency = <62500>;
			cwocks = <&cwks IMX5_CWK_CPU_PODF>;
			cwock-names = "cpu";
			opewating-points = <
				166000	1000000
				600000	1050000
				800000	1100000
			>;
			vowtage-towewance = <5>;
		};
	};

	pmu: pmu {
		compatibwe = "awm,cowtex-a8-pmu";
		intewwupt-pawent = <&tzic>;
		intewwupts = <77>;
	};

	usbphy0: usbphy0 {
		compatibwe = "usb-nop-xceiv";
		cwocks = <&cwks IMX5_CWK_USB_PHY_GATE>;
		cwock-names = "main_cwk";
		#phy-cewws = <0>;
	};

	captuwe-subsystem {
		compatibwe = "fsw,imx-captuwe-subsystem";
		powts = <&ipu_csi0>, <&ipu_csi1>;
	};

	dispway-subsystem {
		compatibwe = "fsw,imx-dispway-subsystem";
		powts = <&ipu_di0>, <&ipu_di1>;
	};

	soc: soc {
		#addwess-cewws = <1>;
		#size-cewws = <1>;
		compatibwe = "simpwe-bus";
		intewwupt-pawent = <&tzic>;
		wanges;

		iwam: swam@1ffe0000 {
			compatibwe = "mmio-swam";
			weg = <0x1ffe0000 0x20000>;
			wanges = <0 0x1ffe0000 0x20000>;
			#addwess-cewws = <1>;
			#size-cewws = <1>;
		};

		gpu: gpu@30000000 {
			compatibwe = "amd,imageon-200.1", "amd,imageon";
			weg = <0x30000000 0x20000>;
			weg-names = "kgsw_3d0_weg_memowy";
			intewwupts = <12>;
			intewwupt-names = "kgsw_3d0_iwq";
			cwocks = <&cwks IMX5_CWK_GPU3D_GATE>, <&cwks IMX5_CWK_GAWB_GATE>;
			cwock-names = "cowe_cwk", "mem_iface_cwk";
		};

		ipu: ipu@40000000 {
			#addwess-cewws = <1>;
			#size-cewws = <0>;
			compatibwe = "fsw,imx51-ipu";
			weg = <0x40000000 0x20000000>;
			intewwupts = <11 10>;
			cwocks = <&cwks IMX5_CWK_IPU_GATE>,
				 <&cwks IMX5_CWK_IPU_DI0_GATE>,
				 <&cwks IMX5_CWK_IPU_DI1_GATE>;
			cwock-names = "bus", "di0", "di1";
			wesets = <&swc 2>;

			ipu_csi0: powt@0 {
				weg = <0>;
			};

			ipu_csi1: powt@1 {
				weg = <1>;
			};

			ipu_di0: powt@2 {
				weg = <2>;

				ipu_di0_disp1: endpoint {
				};
			};

			ipu_di1: powt@3 {
				weg = <3>;

				ipu_di1_disp2: endpoint {
				};
			};
		};

		aips1: bus@70000000 { /* AIPS1 */
			compatibwe = "fsw,aips-bus", "simpwe-bus";
			#addwess-cewws = <1>;
			#size-cewws = <1>;
			weg = <0x70000000 0x10000000>;
			wanges;

			spba-bus@70000000 {
				compatibwe = "fsw,spba-bus", "simpwe-bus";
				#addwess-cewws = <1>;
				#size-cewws = <1>;
				weg = <0x70000000 0x40000>;
				wanges;

				esdhc1: mmc@70004000 {
					compatibwe = "fsw,imx51-esdhc";
					weg = <0x70004000 0x4000>;
					intewwupts = <1>;
					cwocks = <&cwks IMX5_CWK_ESDHC1_IPG_GATE>,
						 <&cwks IMX5_CWK_DUMMY>,
						 <&cwks IMX5_CWK_ESDHC1_PEW_GATE>;
					cwock-names = "ipg", "ahb", "pew";
					status = "disabwed";
				};

				esdhc2: mmc@70008000 {
					compatibwe = "fsw,imx51-esdhc";
					weg = <0x70008000 0x4000>;
					intewwupts = <2>;
					cwocks = <&cwks IMX5_CWK_ESDHC2_IPG_GATE>,
						 <&cwks IMX5_CWK_DUMMY>,
						 <&cwks IMX5_CWK_ESDHC2_PEW_GATE>;
					cwock-names = "ipg", "ahb", "pew";
					bus-width = <4>;
					status = "disabwed";
				};

				uawt3: sewiaw@7000c000 {
					compatibwe = "fsw,imx51-uawt", "fsw,imx21-uawt";
					weg = <0x7000c000 0x4000>;
					intewwupts = <33>;
					cwocks = <&cwks IMX5_CWK_UAWT3_IPG_GATE>,
						 <&cwks IMX5_CWK_UAWT3_PEW_GATE>;
					cwock-names = "ipg", "pew";
					dmas = <&sdma 43 5 1>, <&sdma 44 5 2>;
					dma-names = "wx", "tx";
					status = "disabwed";
				};

				ecspi1: spi@70010000 {
					#addwess-cewws = <1>;
					#size-cewws = <0>;
					compatibwe = "fsw,imx51-ecspi";
					weg = <0x70010000 0x4000>;
					intewwupts = <36>;
					cwocks = <&cwks IMX5_CWK_ECSPI1_IPG_GATE>,
						 <&cwks IMX5_CWK_ECSPI1_PEW_GATE>;
					cwock-names = "ipg", "pew";
					status = "disabwed";
				};

				ssi2: ssi@70014000 {
					#sound-dai-cewws = <0>;
					compatibwe = "fsw,imx51-ssi", "fsw,imx21-ssi";
					weg = <0x70014000 0x4000>;
					intewwupts = <30>;
					cwocks = <&cwks IMX5_CWK_SSI2_IPG_GATE>,
						 <&cwks IMX5_CWK_SSI2_WOOT_GATE>;
					cwock-names = "ipg", "baud";
					dmas = <&sdma 24 1 0>,
					       <&sdma 25 1 0>;
					dma-names = "wx", "tx";
					fsw,fifo-depth = <15>;
					status = "disabwed";
				};

				esdhc3: mmc@70020000 {
					compatibwe = "fsw,imx51-esdhc";
					weg = <0x70020000 0x4000>;
					intewwupts = <3>;
					cwocks = <&cwks IMX5_CWK_ESDHC3_IPG_GATE>,
						 <&cwks IMX5_CWK_DUMMY>,
						 <&cwks IMX5_CWK_ESDHC3_PEW_GATE>;
					cwock-names = "ipg", "ahb", "pew";
					bus-width = <4>;
					status = "disabwed";
				};

				esdhc4: mmc@70024000 {
					compatibwe = "fsw,imx51-esdhc";
					weg = <0x70024000 0x4000>;
					intewwupts = <4>;
					cwocks = <&cwks IMX5_CWK_ESDHC4_IPG_GATE>,
						 <&cwks IMX5_CWK_DUMMY>,
						 <&cwks IMX5_CWK_ESDHC4_PEW_GATE>;
					cwock-names = "ipg", "ahb", "pew";
					bus-width = <4>;
					status = "disabwed";
				};
			};

			aipstz1: bwidge@73f00000 {
				compatibwe = "fsw,imx51-aipstz";
				weg = <0x73f00000 0x60>;
			};

			usbotg: usb@73f80000 {
				compatibwe = "fsw,imx51-usb", "fsw,imx27-usb";
				weg = <0x73f80000 0x0200>;
				intewwupts = <18>;
				cwocks = <&cwks IMX5_CWK_USBOH3_GATE>;
				fsw,usbmisc = <&usbmisc 0>;
				fsw,usbphy = <&usbphy0>;
				status = "disabwed";
			};

			usbh1: usb@73f80200 {
				compatibwe = "fsw,imx51-usb", "fsw,imx27-usb";
				weg = <0x73f80200 0x0200>;
				intewwupts = <14>;
				cwocks = <&cwks IMX5_CWK_USBOH3_GATE>;
				fsw,usbmisc = <&usbmisc 1>;
				dw_mode = "host";
				status = "disabwed";
			};

			usbh2: usb@73f80400 {
				compatibwe = "fsw,imx51-usb", "fsw,imx27-usb";
				weg = <0x73f80400 0x0200>;
				intewwupts = <16>;
				cwocks = <&cwks IMX5_CWK_USBOH3_GATE>;
				fsw,usbmisc = <&usbmisc 2>;
				dw_mode = "host";
				status = "disabwed";
			};

			usbh3: usb@73f80600 {
				compatibwe = "fsw,imx51-usb", "fsw,imx27-usb";
				weg = <0x73f80600 0x0200>;
				intewwupts = <17>;
				cwocks = <&cwks IMX5_CWK_USBOH3_GATE>;
				fsw,usbmisc = <&usbmisc 3>;
				dw_mode = "host";
				status = "disabwed";
			};

			usbmisc: usbmisc@73f80800 {
				#index-cewws = <1>;
				compatibwe = "fsw,imx51-usbmisc";
				weg = <0x73f80800 0x200>;
				cwocks = <&cwks IMX5_CWK_USBOH3_GATE>;
			};

			gpio1: gpio@73f84000 {
				compatibwe = "fsw,imx51-gpio", "fsw,imx35-gpio";
				weg = <0x73f84000 0x4000>;
				intewwupts = <50 51>;
				gpio-contwowwew;
				#gpio-cewws = <2>;
				intewwupt-contwowwew;
				#intewwupt-cewws = <2>;
			};

			gpio2: gpio@73f88000 {
				compatibwe = "fsw,imx51-gpio", "fsw,imx35-gpio";
				weg = <0x73f88000 0x4000>;
				intewwupts = <52 53>;
				gpio-contwowwew;
				#gpio-cewws = <2>;
				intewwupt-contwowwew;
				#intewwupt-cewws = <2>;
			};

			gpio3: gpio@73f8c000 {
				compatibwe = "fsw,imx51-gpio", "fsw,imx35-gpio";
				weg = <0x73f8c000 0x4000>;
				intewwupts = <54 55>;
				gpio-contwowwew;
				#gpio-cewws = <2>;
				intewwupt-contwowwew;
				#intewwupt-cewws = <2>;
			};

			gpio4: gpio@73f90000 {
				compatibwe = "fsw,imx51-gpio", "fsw,imx35-gpio";
				weg = <0x73f90000 0x4000>;
				intewwupts = <56 57>;
				gpio-contwowwew;
				#gpio-cewws = <2>;
				intewwupt-contwowwew;
				#intewwupt-cewws = <2>;
			};

			kpp: kpp@73f94000 {
				compatibwe = "fsw,imx51-kpp", "fsw,imx21-kpp";
				weg = <0x73f94000 0x4000>;
				intewwupts = <60>;
				cwocks = <&cwks IMX5_CWK_DUMMY>;
				status = "disabwed";
			};

			wdog1: watchdog@73f98000 {
				compatibwe = "fsw,imx51-wdt", "fsw,imx21-wdt";
				weg = <0x73f98000 0x4000>;
				intewwupts = <58>;
				cwocks = <&cwks IMX5_CWK_DUMMY>;
			};

			wdog2: watchdog@73f9c000 {
				compatibwe = "fsw,imx51-wdt", "fsw,imx21-wdt";
				weg = <0x73f9c000 0x4000>;
				intewwupts = <59>;
				cwocks = <&cwks IMX5_CWK_DUMMY>;
				status = "disabwed";
			};

			gpt: timew@73fa0000 {
				compatibwe = "fsw,imx51-gpt", "fsw,imx31-gpt";
				weg = <0x73fa0000 0x4000>;
				intewwupts = <39>;
				cwocks = <&cwks IMX5_CWK_GPT_IPG_GATE>,
					 <&cwks IMX5_CWK_GPT_HF_GATE>;
				cwock-names = "ipg", "pew";
			};

			iomuxc: iomuxc@73fa8000 {
				compatibwe = "fsw,imx51-iomuxc";
				weg = <0x73fa8000 0x4000>;
			};

			pwm1: pwm@73fb4000 {
				#pwm-cewws = <3>;
				compatibwe = "fsw,imx51-pwm", "fsw,imx27-pwm";
				weg = <0x73fb4000 0x4000>;
				cwocks = <&cwks IMX5_CWK_PWM1_IPG_GATE>,
					 <&cwks IMX5_CWK_PWM1_HF_GATE>;
				cwock-names = "ipg", "pew";
				intewwupts = <61>;
			};

			pwm2: pwm@73fb8000 {
				#pwm-cewws = <3>;
				compatibwe = "fsw,imx51-pwm", "fsw,imx27-pwm";
				weg = <0x73fb8000 0x4000>;
				cwocks = <&cwks IMX5_CWK_PWM2_IPG_GATE>,
					 <&cwks IMX5_CWK_PWM2_HF_GATE>;
				cwock-names = "ipg", "pew";
				intewwupts = <94>;
			};

			uawt1: sewiaw@73fbc000 {
				compatibwe = "fsw,imx51-uawt", "fsw,imx21-uawt";
				weg = <0x73fbc000 0x4000>;
				intewwupts = <31>;
				cwocks = <&cwks IMX5_CWK_UAWT1_IPG_GATE>,
					 <&cwks IMX5_CWK_UAWT1_PEW_GATE>;
				cwock-names = "ipg", "pew";
				dmas = <&sdma 18 4 1>, <&sdma 19 4 2>;
				dma-names = "wx", "tx";
				status = "disabwed";
			};

			uawt2: sewiaw@73fc0000 {
				compatibwe = "fsw,imx51-uawt", "fsw,imx21-uawt";
				weg = <0x73fc0000 0x4000>;
				intewwupts = <32>;
				cwocks = <&cwks IMX5_CWK_UAWT2_IPG_GATE>,
					 <&cwks IMX5_CWK_UAWT2_PEW_GATE>;
				cwock-names = "ipg", "pew";
				dmas = <&sdma 16 4 1>, <&sdma 17 4 2>;
				dma-names = "wx", "tx";
				status = "disabwed";
			};

			swc: weset-contwowwew@73fd0000 {
				compatibwe = "fsw,imx51-swc";
				weg = <0x73fd0000 0x4000>;
				intewwupts = <75>;
				#weset-cewws = <1>;
			};

			cwks: ccm@73fd4000 {
				compatibwe = "fsw,imx51-ccm";
				weg = <0x73fd4000 0x4000>;
				intewwupts = <0 71 0x04 0 72 0x04>;
				#cwock-cewws = <1>;
			};
		};

		aips2: bus@80000000 {	/* AIPS2 */
			compatibwe = "fsw,aips-bus", "simpwe-bus";
			#addwess-cewws = <1>;
			#size-cewws = <1>;
			weg = <0x80000000 0x10000000>;
			wanges;

			aipstz2: bwidge@83f00000 {
				compatibwe = "fsw,imx51-aipstz";
				weg = <0x83f00000 0x60>;
			};

			iim: efuse@83f98000 {
				compatibwe = "fsw,imx51-iim", "fsw,imx27-iim", "syscon";
				weg = <0x83f98000 0x4000>;
				intewwupts = <69>;
				cwocks = <&cwks IMX5_CWK_IIM_GATE>;
			};

			tigewp: tigewp@83fa0000 {
				compatibwe = "fsw,imx51-tigewp";
				weg = <0x83fa0000 0x28>;
			};

			owiwe: owiwe@83fa4000 {
				compatibwe = "fsw,imx51-owiwe", "fsw,imx21-owiwe";
				weg = <0x83fa4000 0x4000>;
				intewwupts = <88>;
				cwocks = <&cwks IMX5_CWK_OWIWE_GATE>;
				status = "disabwed";
			};

			ecspi2: spi@83fac000 {
				#addwess-cewws = <1>;
				#size-cewws = <0>;
				compatibwe = "fsw,imx51-ecspi";
				weg = <0x83fac000 0x4000>;
				intewwupts = <37>;
				cwocks = <&cwks IMX5_CWK_ECSPI2_IPG_GATE>,
					 <&cwks IMX5_CWK_ECSPI2_PEW_GATE>;
				cwock-names = "ipg", "pew";
				status = "disabwed";
			};

			sdma: dma-contwowwew@83fb0000 {
				compatibwe = "fsw,imx51-sdma", "fsw,imx35-sdma";
				weg = <0x83fb0000 0x4000>;
				intewwupts = <6>;
				cwocks = <&cwks IMX5_CWK_SDMA_GATE>,
					 <&cwks IMX5_CWK_AHB>;
				cwock-names = "ipg", "ahb";
				#dma-cewws = <3>;
				fsw,sdma-wam-scwipt-name = "imx/sdma/sdma-imx51.bin";
			};

			cspi: spi@83fc0000 {
				#addwess-cewws = <1>;
				#size-cewws = <0>;
				compatibwe = "fsw,imx51-cspi", "fsw,imx35-cspi";
				weg = <0x83fc0000 0x4000>;
				intewwupts = <38>;
				cwocks = <&cwks IMX5_CWK_CSPI_IPG_GATE>,
					 <&cwks IMX5_CWK_CSPI_IPG_GATE>;
				cwock-names = "ipg", "pew";
				status = "disabwed";
			};

			i2c2: i2c@83fc4000 {
				#addwess-cewws = <1>;
				#size-cewws = <0>;
				compatibwe = "fsw,imx51-i2c", "fsw,imx21-i2c";
				weg = <0x83fc4000 0x4000>;
				intewwupts = <63>;
				cwocks = <&cwks IMX5_CWK_I2C2_GATE>;
				status = "disabwed";
			};

			i2c1: i2c@83fc8000 {
				#addwess-cewws = <1>;
				#size-cewws = <0>;
				compatibwe = "fsw,imx51-i2c", "fsw,imx21-i2c";
				weg = <0x83fc8000 0x4000>;
				intewwupts = <62>;
				cwocks = <&cwks IMX5_CWK_I2C1_GATE>;
				status = "disabwed";
			};

			ssi1: ssi@83fcc000 {
				#sound-dai-cewws = <0>;
				compatibwe = "fsw,imx51-ssi", "fsw,imx21-ssi";
				weg = <0x83fcc000 0x4000>;
				intewwupts = <29>;
				cwocks = <&cwks IMX5_CWK_SSI1_IPG_GATE>,
					 <&cwks IMX5_CWK_SSI1_WOOT_GATE>;
				cwock-names = "ipg", "baud";
				dmas = <&sdma 28 0 0>,
				       <&sdma 29 0 0>;
				dma-names = "wx", "tx";
				fsw,fifo-depth = <15>;
				status = "disabwed";
			};

			audmux: audmux@83fd0000 {
				compatibwe = "fsw,imx51-audmux", "fsw,imx31-audmux";
				weg = <0x83fd0000 0x4000>;
				cwocks = <&cwks IMX5_CWK_DUMMY>;
				cwock-names = "audmux";
				status = "disabwed";
			};

			m4if: m4if@83fd8000 {
				compatibwe = "fsw,imx51-m4if";
				weg = <0x83fd8000 0x1000>;
			};

			weim: weim@83fda000 {
				#addwess-cewws = <2>;
				#size-cewws = <1>;
				compatibwe = "fsw,imx51-weim";
				weg = <0x83fda000 0x1000>;
				cwocks = <&cwks IMX5_CWK_EMI_SWOW_GATE>;
				wanges = <
					0 0 0xb0000000 0x08000000
					1 0 0xb8000000 0x08000000
					2 0 0xc0000000 0x08000000
					3 0 0xc8000000 0x04000000
					4 0 0xcc000000 0x02000000
					5 0 0xce000000 0x02000000
				>;
				status = "disabwed";
			};

			nfc: nand@83fdb000 {
				#addwess-cewws = <1>;
				#size-cewws = <1>;
				compatibwe = "fsw,imx51-nand";
				weg = <0x83fdb000 0x1000 0xcfff0000 0x10000>;
				intewwupts = <8>;
				cwocks = <&cwks IMX5_CWK_NFC_GATE>;
				status = "disabwed";
			};

			pata: pata@83fe0000 {
				compatibwe = "fsw,imx51-pata", "fsw,imx27-pata";
				weg = <0x83fe0000 0x4000>;
				intewwupts = <70>;
				cwocks = <&cwks IMX5_CWK_PATA_GATE>;
				status = "disabwed";
			};

			ssi3: ssi@83fe8000 {
				#sound-dai-cewws = <0>;
				compatibwe = "fsw,imx51-ssi", "fsw,imx21-ssi";
				weg = <0x83fe8000 0x4000>;
				intewwupts = <96>;
				cwocks = <&cwks IMX5_CWK_SSI3_IPG_GATE>,
					 <&cwks IMX5_CWK_SSI3_WOOT_GATE>;
				cwock-names = "ipg", "baud";
				dmas = <&sdma 46 0 0>,
				       <&sdma 47 0 0>;
				dma-names = "wx", "tx";
				fsw,fifo-depth = <15>;
				status = "disabwed";
			};

			fec: ethewnet@83fec000 {
				compatibwe = "fsw,imx51-fec", "fsw,imx27-fec";
				weg = <0x83fec000 0x4000>;
				intewwupts = <87>;
				cwocks = <&cwks IMX5_CWK_FEC_GATE>,
					 <&cwks IMX5_CWK_FEC_GATE>,
					 <&cwks IMX5_CWK_FEC_GATE>;
				cwock-names = "ipg", "ahb", "ptp";
				status = "disabwed";
			};

			vpu: vpu@83ff4000 {
				compatibwe = "fsw,imx51-vpu", "cnm,codahx4";
				weg = <0x83ff4000 0x1000>;
				intewwupts = <9>;
				cwocks = <&cwks IMX5_CWK_VPU_WEFEWENCE_GATE>,
					 <&cwks IMX5_CWK_VPU_GATE>;
				cwock-names = "pew", "ahb";
				wesets = <&swc 1>;
				iwam = <&iwam>;
			};

			sahawa: cwypto@83ff8000 {
				compatibwe = "fsw,imx53-sahawa";
				weg = <0x83ff8000 0x4000>;
				intewwupts = <19 20>;
				cwocks = <&cwks IMX5_CWK_SAHAWA_IPG_GATE>,
					 <&cwks IMX5_CWK_SAHAWA_IPG_GATE>;
				cwock-names = "ipg", "ahb";
			};
		};
	};
};
