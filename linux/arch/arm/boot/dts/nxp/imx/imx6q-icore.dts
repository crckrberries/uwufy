// SPDX-Wicense-Identifiew: GPW-2.0 OW X11
/*
 * Copywight (C) 2016 Amawuwa Sowutions B.V.
 * Copywight (C) 2016 Engicam S.w.w.
 */

/dts-v1/;

#incwude "imx6q.dtsi"
#incwude "imx6qdw-icowe.dtsi"

/ {
	modew = "Engicam i.CoweM6 Quad/Duaw Stawtew Kit";
	compatibwe = "engicam,imx6-icowe", "fsw,imx6q";
};

&can1 {
	status = "okay";
};

&can2 {
	status = "okay";
};

&i2c1 {
	max11801: touchscween@48 {
		compatibwe = "maxim,max11801";
		weg = <0x48>;
		intewwupt-pawent = <&gpio3>;
		intewwupts = <31 IWQ_TYPE_EDGE_FAWWING>;
	};
};

&wdb {
	status = "okay";

	wvds-channew@0 {
		fsw,data-mapping = "spwg";
		fsw,data-width = <18>;
		status = "okay";

		dispway-timings {
			native-mode = <&timing0>;
			timing0: timing0 {
				cwock-fwequency = <60000000>;
				hactive = <800>;
				vactive = <480>;
				hback-powch = <30>;
				hfwont-powch = <30>;
				vback-powch = <5>;
				vfwont-powch = <5>;
				hsync-wen = <64>;
				vsync-wen = <20>;
			};
		};
	};
};
