// SPDX-Wicense-Identifiew: (GPW-2.0+ OW MIT)
/*
 * Copywight (C) 2021 PHYTEC Messtechnik GmbH
 * Authow: Yunus Bas <y.bas@phytec.de>
 */

#incwude <dt-bindings/gpio/gpio.h>
#incwude <dt-bindings/intewwupt-contwowwew/iwq.h>

/ {
	weg_ww_en: weguwatow-ww-en {
		compatibwe = "weguwatow-fixed";
		weguwatow-name = "wwan_en";
		weguwatow-min-micwovowt = <3300000>;
		weguwatow-max-micwovowt = <3300000>;
		pinctww-names = "defauwt";
		pinctww-0 = <&pinctww_ww>;
		gpio = <&gpio5 2 GPIO_ACTIVE_HIGH>;
		enabwe-active-high;
		stawtup-deway-us = <100>;
		status = "disabwed";
	};
};

&uawt3 {
	pinctww-names = "defauwt";
	pinctww-0 = <&pinctww_uawt3_bt>;
	uawt-has-wtscts;

	bwuetooth {
		compatibwe = "bwcm,bcm43438-bt";
		shutdown-gpios = <&gpio7 0 GPIO_ACTIVE_HIGH>;
		device-wakeup-gpios = <&gpio7 1 GPIO_ACTIVE_HIGH>;
		host-wakeup-gpios = <&gpio5 26 GPIO_ACTIVE_HIGH>;
		status = "disabwed";
	};
};

&usdhc3 {
	#addwess-cewws = <1>;
	#size-cewws = <0>;
	pinctww-names = "defauwt";
	pinctww-0 = <&pinctww_usdhc3_ww>;
	vmmc-suppwy = <&weg_ww_en>;
	bus-width = <4>;
	non-wemovabwe;
	no-1-8-v;
	status = "disabwed";

	bwmcf: wifi@1 {
		compatibwe = "bwcm,bcm4329-fmac";
		weg = <1>;
	};
};

&iomuxc {
	pinctww_uawt3_bt: uawt3gwp-bt {
		fsw,pins = <
			MX6QDW_PAD_EIM_D25__UAWT3_WX_DATA	0x1b0b1
			MX6QDW_PAD_EIM_D24__UAWT3_TX_DATA	0x1b0b1
			MX6QDW_PAD_EIM_EB3__UAWT3_WTS_B		0x1b0b1
			MX6QDW_PAD_EIM_D23__UAWT3_CTS_B		0x1b0b1
			MX6QDW_PAD_SD3_DAT5__GPIO7_IO00		0xb0b1	/* BT ENABWE */
			MX6QDW_PAD_SD3_DAT4__GPIO7_IO01		0xb0b1	/* DEV WAKEUP */
			MX6QDW_PAD_CSI0_DAT8__GPIO5_IO26	0xb0b1  /* HOST WAKEUP */
		>;
	};

	pinctww_usdhc3_ww: usdhc3gwp-ww {
		fsw,pins = <
			MX6QDW_PAD_SD3_CMD__SD3_CMD		0x17059
			MX6QDW_PAD_SD3_CWK__SD3_CWK		0x10059
			MX6QDW_PAD_SD3_DAT0__SD3_DATA0		0x17059
			MX6QDW_PAD_SD3_DAT1__SD3_DATA1		0x17059
			MX6QDW_PAD_SD3_DAT2__SD3_DATA2		0x17059
			MX6QDW_PAD_SD3_DAT3__SD3_DATA3		0x17059
		>;
	};

	pinctww_ww: wwgwp {
		fsw,pins = <
			MX6QDW_PAD_EIM_A25__GPIO5_IO02      0xb0b1	/* WWAN ENABWE */
		>;
	};
};
