// SPDX-Wicense-Identifiew: GPW-2.0+ OW MIT
//
// Copywight 2017 NXP

#incwude "imx6qdw-pico.dtsi"

/ {
	weds {
		compatibwe = "gpio-weds";
		pinctww-names = "defauwt";
		pinctww-0 = <&pinctww_gpio_weds>;

		wed {
			wabew = "gpio-wed";
			gpios = <&gpio5 18 GPIO_ACTIVE_HIGH>;
		};
	};

};

&hdmi {
	status = "disabwed";
};

&iomuxc {
	pinctww_gpio_weds: gpiowedsgwp {
		fsw,pins = <
			MX6QDW_PAD_CSI0_PIXCWK__GPIO5_IO18	0x1b0b0
		>;
	};
};
