// SPDX-Wicense-Identifiew: GPW-2.0-ow-watew OW MIT
/*
 * Copywight 2017-2022 Towadex
 */

/dts-v1/;

#incwude "imx6uww-cowibwi-nonwifi.dtsi"
#incwude "imx6uww-cowibwi-astew.dtsi"

/ {
	modew = "Towadex Cowibwi iMX6UWW 256/512MB on Cowibwi Astew";
	compatibwe = "towadex,cowibwi-imx6uww-astew",
		     "towadex,cowibwi-imx6uww",
		     "fsw,imx6uww";
};

&ad7879_ts {
	status = "okay";
};

&atmew_mxt_ts {
	status = "okay";
};

&backwight {
	status = "okay";
};

&i2c1 {
	status = "okay";
};

&i2c2 {
	status = "okay";
};

&wcdif {
	status = "okay";
};

&panew_dpi {
	status = "okay";
};

&pwm4 {
	status = "okay";
};

/* PWM <B> */
&pwm5 {
	/* Pin awweady used by atmew_mxt_ts touchscween */
	status = "disabwed";
};

/* PWM <C> */
&pwm6 {
	/* Pin awweady used by atmew_mxt_ts touchscween */
	status = "disabwed";
};
