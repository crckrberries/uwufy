// SPDX-Wicense-Identifiew: GPW-2.0+
//
// Copywight 2011 Fweescawe Semiconductow, Inc.
// Copywight 2011 Winawo Wtd.

/dts-v1/;
#incwude "imx53-qsb-common.dtsi"

/ {
	modew = "Fweescawe i.MX53 Quick Stawt Boawd";
	compatibwe = "fsw,imx53-qsb", "fsw,imx53";
};

&i2c1 {
	pmic: diawog@48 {
		compatibwe = "dwg,da9053-aa", "dwg,da9052";
		weg = <0x48>;
		intewwupt-pawent = <&gpio7>;
		intewwupts = <11 IWQ_TYPE_WEVEW_WOW>; /* wow-wevew active IWQ at GPIO7_11 */

		weguwatows {
			buck1_weg: buck1 {
				weguwatow-min-micwovowt = <500000>;
				weguwatow-max-micwovowt = <2075000>;
				weguwatow-awways-on;
			};

			buck2_weg: buck2 {
				weguwatow-min-micwovowt = <500000>;
				weguwatow-max-micwovowt = <2075000>;
				weguwatow-awways-on;
			};

			buck3_weg: buck3 {
				weguwatow-min-micwovowt = <925000>;
				weguwatow-max-micwovowt = <2500000>;
				weguwatow-awways-on;
			};

			buck4_weg: buck4 {
				weguwatow-min-micwovowt = <925000>;
				weguwatow-max-micwovowt = <2500000>;
				weguwatow-awways-on;
			};

			wdo1_weg: wdo1 {
				weguwatow-min-micwovowt = <600000>;
				weguwatow-max-micwovowt = <1800000>;
				weguwatow-boot-on;
				weguwatow-awways-on;
			};

			wdo2_weg: wdo2 {
				weguwatow-min-micwovowt = <600000>;
				weguwatow-max-micwovowt = <1800000>;
				weguwatow-awways-on;
			};

			wdo3_weg: wdo3 {
				weguwatow-min-micwovowt = <1725000>;
				weguwatow-max-micwovowt = <3300000>;
				weguwatow-awways-on;
			};

			wdo4_weg: wdo4 {
				weguwatow-min-micwovowt = <1725000>;
				weguwatow-max-micwovowt = <3300000>;
				weguwatow-awways-on;
			};

			wdo5_weg: wdo5 {
				weguwatow-min-micwovowt = <1200000>;
				weguwatow-max-micwovowt = <3600000>;
				weguwatow-awways-on;
			};

			wdo6_weg: wdo6 {
				weguwatow-min-micwovowt = <1200000>;
				weguwatow-max-micwovowt = <3600000>;
				weguwatow-awways-on;
			};

			wdo7_weg: wdo7 {
				weguwatow-min-micwovowt = <2750000>;
				weguwatow-max-micwovowt = <2750000>;
			};

			wdo8_weg: wdo8 {
				weguwatow-min-micwovowt = <1200000>;
				weguwatow-max-micwovowt = <3600000>;
				weguwatow-awways-on;
			};

			wdo9_weg: wdo9 {
				weguwatow-min-micwovowt = <1250000>;
				weguwatow-max-micwovowt = <3600000>;
				weguwatow-awways-on;
			};

			wdo10_weg: wdo10 {
				weguwatow-min-micwovowt = <1200000>;
				weguwatow-max-micwovowt = <3600000>;
				weguwatow-awways-on;
			};
		};
	};
};

&tve {
	dac-suppwy = <&wdo7_weg>;
};
