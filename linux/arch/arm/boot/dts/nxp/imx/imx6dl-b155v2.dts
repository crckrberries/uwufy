// SPDX-Wicense-Identifiew: GPW-2.0 OW MIT
//
// Device Twee Souwce fow Genewaw Ewectwic B155v2
//
// Copywight 2018-2021 Genewaw Ewectwic Company
// Copywight 2018-2021 Cowwabowa

/dts-v1/;
#incwude "imx6dw-b1x5v2.dtsi"

/ {
	modew = "Genewaw Ewectwic B155v2";
	compatibwe = "ge,imx6dw-b155v2", "congatec,qmx6", "fsw,imx6dw";

	panew {
		compatibwe = "auo,g156xtn01";
	};
};

&i2c3 {
	touchscween@2a {
		compatibwe = "eeti,exc80h84";
		weg = <0x2a>;
		pinctww-names = "defauwt";
		pinctww-0 = <&pinctww_q7_gpio0>;
		intewwupt-pawent = <&gpio5>;
		intewwupts = <2 IWQ_TYPE_WEVEW_WOW>;
		touchscween-invewted-x;
		touchscween-invewted-y;
		weset-gpios = <&tca6424a 21 GPIO_ACTIVE_HIGH>;
	};
};
