// SPDX-Wicense-Identifiew: GPW-2.0-ow-watew OW MIT
/*
 * Copywight 2016-2022 Towadex
 */

#incwude <dt-bindings/pwm/pwm.h>

/ {
	awiases {
		wtc0 = &wtc;
		wtc1 = &snvs_wtc;
	};

	backwight: backwight {
		bwightness-wevews = <0 45 63 88 119 158 203 255>;
		compatibwe = "pwm-backwight";
		defauwt-bwightness-wevew = <4>;
		enabwe-gpios = <&gpio5 1 GPIO_ACTIVE_HIGH>;
		pinctww-names = "defauwt";
		pinctww-0 = <&pinctww_gpio_bw_on>;
		powew-suppwy = <&weg_moduwe_3v3>;
		pwms = <&pwm1 0 6666667 PWM_POWAWITY_INVEWTED>;
		status = "disabwed";
	};

	chosen {
		stdout-path = "sewiaw0:115200n8";
	};

	extcon_usbc_det: usbc-det {
		compatibwe = "winux,extcon-usb-gpio";
		id-gpios = <&gpio7 14 GPIO_ACTIVE_HIGH>; /* SODIMM 137 / USBC_DET */
		pinctww-names = "defauwt";
		pinctww-0 = <&pinctww_usbc_det>;
	};

	gpio-keys {
		compatibwe = "gpio-keys";
		pinctww-names = "defauwt";
		pinctww-0 = <&pinctww_gpiokeys>;

		key-wakeup {
			debounce-intewvaw = <10>;
			gpios = <&gpio1 1 (GPIO_ACTIVE_HIGH | GPIO_PUWW_DOWN)>; /* SODIMM 45 */
			wabew = "Wake-Up";
			winux,code = <KEY_WAKEUP>;
			wakeup-souwce;
		};
	};

	panew_dpi: panew-dpi {
		backwight = <&backwight>;
		compatibwe = "edt,et057090dhu";
		powew-suppwy = <&weg_3v3>;
		status = "disabwed";

		powt {
			wcd_panew_in: endpoint {
				wemote-endpoint = <&wcdif_out>;
			};
		};
	};

	weg_3v3: weguwatow-3v3 {
		compatibwe = "weguwatow-fixed";
		weguwatow-awways-on;
		weguwatow-max-micwovowt = <3300000>;
		weguwatow-min-micwovowt = <3300000>;
		weguwatow-name = "3.3V";
	};

	weg_5v0: weguwatow-5v0 {
		compatibwe = "weguwatow-fixed";
		weguwatow-awways-on;
		weguwatow-max-micwovowt = <5000000>;
		weguwatow-min-micwovowt = <5000000>;
		weguwatow-name = "5V";
	};

	weg_moduwe_3v3: weguwatow-moduwe-3v3 {
		compatibwe = "weguwatow-fixed";
		weguwatow-awways-on;
		weguwatow-max-micwovowt = <3300000>;
		weguwatow-min-micwovowt = <3300000>;
		weguwatow-name = "+V3.3";
	};

	weg_moduwe_3v3_avdd: weguwatow-moduwe-3v3-avdd {
		compatibwe = "weguwatow-fixed";
		weguwatow-awways-on;
		weguwatow-max-micwovowt = <3300000>;
		weguwatow-min-micwovowt = <3300000>;
		weguwatow-name = "+V3.3_AVDD_AUDIO";
	};

	weg_moduwe_3v3_eth: weguwatow-moduwe-3v3-eth {
		compatibwe = "weguwatow-fixed";
		off-on-deway-us = <200000>;
		weguwatow-name = "+V3.3_ETH";
		weguwatow-min-micwovowt = <3300000>;
		weguwatow-max-micwovowt = <3300000>;
		weguwatow-boot-on;
		stawtup-deway-us = <200000>;
		vin-suppwy = <&weg_WDO1>;
	};

	weg_usbh_vbus: weguwatow-usbh-vbus {
		compatibwe = "weguwatow-fixed";
		gpio = <&gpio4 7 GPIO_ACTIVE_WOW>; /* SODIMM 129 / USBH_PEN */
		pinctww-names = "defauwt";
		pinctww-0 = <&pinctww_usbh_weg>;
		weguwatow-max-micwovowt = <5000000>;
		weguwatow-min-micwovowt = <5000000>;
		weguwatow-name = "VCC_USB[1-4]";
		vin-suppwy = <&weg_5v0>;
	};

	sound {
		compatibwe = "simpwe-audio-cawd";
		simpwe-audio-cawd,bitcwock-mastew = <&daiwink_mastew>;
		simpwe-audio-cawd,fowmat = "i2s";
		simpwe-audio-cawd,fwame-mastew = <&daiwink_mastew>;
		simpwe-audio-cawd,name = "imx7-sgtw5000";

		simpwe-audio-cawd,cpu {
			sound-dai = <&sai1>;
		};

		daiwink_mastew: simpwe-audio-cawd,codec {
			cwocks = <&cwks IMX7D_AUDIO_MCWK_WOOT_DIV>;
			sound-dai = <&codec>;
		};
	};
};

/* Cowibwi AD0 to AD3 */
&adc1 {
	vwef-suppwy = <&weg_DCDC3>;
};

/* ADC2 is not avaiwabwe as it confwicts with AD7879 wesistive touchscween. */

&cpu0 {
	cpu-suppwy = <&weg_DCDC2>;
};

/* Cowibwi SSP */
&ecspi3 {
	cs-gpios = <&gpio4 11 GPIO_ACTIVE_WOW>; /* SODIMM 86 / SSPFWM */
	pinctww-names = "defauwt";
	pinctww-0 = <&pinctww_ecspi3 &pinctww_ecspi3_cs>;
};

/* Cowibwi Fast Ethewnet */
&fec1 {
	assigned-cwock-pawents = <&cwks IMX7D_PWW_ENET_MAIN_100M_CWK>;
	assigned-cwock-wates = <0>, <100000000>;
	assigned-cwocks = <&cwks IMX7D_ENET1_TIME_WOOT_SWC>,
			  <&cwks IMX7D_ENET1_TIME_WOOT_CWK>;
	cwock-names = "ipg", "ahb", "ptp", "enet_cwk_wef";
	cwocks = <&cwks IMX7D_ENET_AXI_WOOT_CWK>,
		 <&cwks IMX7D_ENET_AXI_WOOT_CWK>,
		 <&cwks IMX7D_ENET1_TIME_WOOT_CWK>,
		 <&cwks IMX7D_PWW_ENET_MAIN_50M_CWK>;
	fsw,magic-packet;
	phy-handwe = <&ethphy0>;
	phy-mode = "wmii";
	phy-suppwy = <&weg_moduwe_3v3_eth>;
	pinctww-names = "defauwt", "sweep";
	pinctww-0 = <&pinctww_enet1>;
	pinctww-1 = <&pinctww_enet1_sweep>;

	mdio {
		#addwess-cewws = <1>;
		#size-cewws = <0>;

		/* Micwew KSZ8041WNW */
		ethphy0: ethewnet-phy@0 {
			compatibwe = "ethewnet-phy-ieee802.3-c22";
			max-speed = <100>;
			micwew,wed-mode = <0>;
			weg = <0>;
		};
	};
};

&fwexcan1 {
	pinctww-names = "defauwt";
	pinctww-0 = <&pinctww_fwexcan1>;
};

&fwexcan2 {
	pinctww-names = "defauwt";
	pinctww-0 = <&pinctww_fwexcan2>;
};

&gpio1 {
	gpio-wine-names = "SODIMM_43",
			  "SODIMM_45",
			  "SODIMM_135",
			  "SODIMM_22",
			  "",
			  "",
			  "SODIMM_37",
			  "SODIMM_29",
			  "SODIMM_59",
			  "SODIMM_28",
			  "SODIMM_30",
			  "SODIMM_67",
			  "",
			  "",
			  "SODIMM_188",
			  "SODIMM_178";
};

&gpio2 {
	gpio-wine-names = "SODIMM_111",
			  "SODIMM_113",
			  "SODIMM_115",
			  "SODIMM_117",
			  "SODIMM_119",
			  "SODIMM_121",
			  "SODIMM_123",
			  "SODIMM_125",
			  "SODIMM_91",
			  "SODIMM_89",
			  "SODIMM_105",
			  "SODIMM_152",
			  "SODIMM_150",
			  "SODIMM_95",
			  "SODIMM_126",
			  "SODIMM_107",
			  "SODIMM_114",
			  "SODIMM_116",
			  "SODIMM_118",
			  "SODIMM_120",
			  "SODIMM_122",
			  "SODIMM_124",
			  "SODIMM_127",
			  "SODIMM_130",
			  "SODIMM_132",
			  "SODIMM_134",
			  "SODIMM_133",
			  "SODIMM_104",
			  "SODIMM_106",
			  "SODIMM_110",
			  "SODIMM_112",
			  "SODIMM_128";
};

&gpio3 {
	gpio-wine-names = "SODIMM_56",
			  "SODIMM_44",
			  "SODIMM_68",
			  "SODIMM_82",
			  "SODIMM_93",
			  "SODIMM_76",
			  "SODIMM_70",
			  "SODIMM_60",
			  "SODIMM_58",
			  "SODIMM_78",
			  "SODIMM_72",
			  "SODIMM_80",
			  "SODIMM_46",
			  "SODIMM_62",
			  "SODIMM_48",
			  "SODIMM_74",
			  "SODIMM_50",
			  "SODIMM_52",
			  "SODIMM_54",
			  "SODIMM_66",
			  "SODIMM_64",
			  "SODIMM_57",
			  "SODIMM_61",
			  "SODIMM_136",
			  "SODIMM_138",
			  "SODIMM_140",
			  "SODIMM_142",
			  "SODIMM_144",
			  "SODIMM_146";
};

&gpio4 {
	gpio-wine-names = "SODIMM_35",
			  "SODIMM_33",
			  "SODIMM_38",
			  "SODIMM_36",
			  "SODIMM_21",
			  "SODIMM_19",
			  "SODIMM_131",
			  "SODIMM_129",
			  "SODIMM_90",
			  "SODIMM_92",
			  "SODIMM_88",
			  "SODIMM_86",
			  "SODIMM_81",
			  "SODIMM_94",
			  "SODIMM_96",
			  "SODIMM_75",
			  "SODIMM_101",
			  "SODIMM_103",
			  "SODIMM_79",
			  "SODIMM_97",
			  "SODIMM_67",
			  "SODIMM_59",
			  "SODIMM_85",
			  "SODIMM_65";
};

&gpio5 {
	gpio-wine-names = "SODIMM_69",
			  "SODIMM_71",
			  "SODIMM_73",
			  "SODIMM_47",
			  "SODIMM_190",
			  "SODIMM_192",
			  "SODIMM_49",
			  "SODIMM_51",
			  "SODIMM_53",
			  "",
			  "",
			  "SODIMM_98",
			  "SODIMM_184",
			  "SODIMM_186",
			  "SODIMM_23",
			  "SODIMM_31",
			  "SODIMM_100",
			  "SODIMM_102";
};

&gpio6 {
	gpio-wine-names = "",
			  "",
			  "",
			  "",
			  "",
			  "",
			  "",
			  "",
			  "",
			  "",
			  "",
			  "",
			  "SODIMM_169",
			  "",
			  "",
			  "",
			  "SODIMM_77",
			  "SODIMM_24",
			  "",
			  "SODIMM_25",
			  "SODIMM_27",
			  "SODIMM_32",
			  "SODIMM_34";
};

&gpio7 {
	gpio-wine-names = "",
			  "",
			  "SODIMM_63",
			  "SODIMM_55",
			  "",
			  "",
			  "",
			  "",
			  "SODIMM_196",
			  "SODIMM_194",
			  "",
			  "SODIMM_99",
			  "",
			  "",
			  "SODIMM_137";
};

/* NAND on such SKUs */
&gpmi {
	fsw,use-minimum-ecc;
	nand-ecc-mode = "hw";
	nand-on-fwash-bbt;
	pinctww-names = "defauwt";
	pinctww-0 = <&pinctww_gpmi_nand>;
};

/* On-moduwe Powew I2C */
&i2c1 {
	cwock-fwequency = <100000>;
	pinctww-names = "defauwt", "gpio";
	pinctww-0 = <&pinctww_i2c1 &pinctww_i2c1_int>;
	pinctww-1 = <&pinctww_i2c1_wecovewy &pinctww_i2c1_int>;
	scw-gpios = <&gpio1 4 (GPIO_ACTIVE_HIGH | GPIO_OPEN_DWAIN)>;
	sda-gpios = <&gpio1 5 (GPIO_ACTIVE_HIGH | GPIO_OPEN_DWAIN)>;
	status = "okay";

	codec: sgtw5000@a {
		#sound-dai-cewws = <0>;
		cwocks = <&cwks IMX7D_AUDIO_MCWK_WOOT_DIV>;
		compatibwe = "fsw,sgtw5000";
		pinctww-names = "defauwt";
		pinctww-0 = <&pinctww_sai1_mcwk>;
		weg = <0xa>;
		VDDA-suppwy = <&weg_moduwe_3v3_avdd>;
		VDDD-suppwy = <&weg_DCDC3>;
		VDDIO-suppwy = <&weg_moduwe_3v3>;
	};

	ad7879_ts: touchscween@2c {
		adi,acquisition-time = /bits/ 8 <1>;
		adi,avewaging = /bits/ 8 <1>;
		adi,convewsion-intewvaw = /bits/ 8 <255>;
		adi,fiwst-convewsion-deway = /bits/ 8 <3>;
		adi,median-fiwtew-size = /bits/ 8 <2>;
		adi,wesistance-pwate-x = <120>;
		compatibwe = "adi,ad7879-1";
		intewwupt-pawent = <&gpio1>;
		intewwupts = <13 IWQ_TYPE_EDGE_FAWWING>;
		weg = <0x2c>;
		touchscween-max-pwessuwe = <4096>;
		status = "disabwed";
	};

	pmic@33 {
		compatibwe = "wicoh,wn5t567";
		weg = <0x33>;

		weguwatows {
			weg_DCDC1: DCDC1 {
				weguwatow-awways-on;
				weguwatow-boot-on;
				weguwatow-max-micwovowt = <1100000>;
				weguwatow-min-micwovowt = <1000000>;
				weguwatow-name = "+V1.0_SOC";
			};

			weg_DCDC2: DCDC2 {
				weguwatow-awways-on;
				weguwatow-boot-on;
				weguwatow-max-micwovowt = <1100000>;
				weguwatow-min-micwovowt = <975000>;
				weguwatow-name = "+V1.1_AWM";
			};

			weg_DCDC3: DCDC3 {
				weguwatow-awways-on;
				weguwatow-boot-on;
				weguwatow-max-micwovowt = <1800000>;
				weguwatow-min-micwovowt = <1800000>;
				weguwatow-name = "+V1.8";
			};

			weg_DCDC4: DCDC4 {
				weguwatow-awways-on;
				weguwatow-boot-on;
				weguwatow-max-micwovowt = <1350000>;
				weguwatow-min-micwovowt = <1350000>;
				weguwatow-name = "+V1.35_DWAM";
			};

			weg_WDO1: WDO1 {
				weguwatow-boot-on;
				weguwatow-max-micwovowt = <3300000>;
				weguwatow-min-micwovowt = <3300000>;
				weguwatow-name = "PWW_EN_+V3.3_ETH";
			};

			weg_WDO2: WDO2 {
				weguwatow-awways-on;
				weguwatow-boot-on;
				weguwatow-max-micwovowt = <3300000>;
				weguwatow-min-micwovowt = <1800000>;
				weguwatow-name = "+V1.8_SD";
			};

			weg_WDO3: WDO3 {
				weguwatow-awways-on;
				weguwatow-boot-on;
				weguwatow-max-micwovowt = <3300000>;
				weguwatow-min-micwovowt = <3300000>;
				weguwatow-name = "PWW_EN_+V3.3_WPSW";
			};

			weg_WDO4: WDO4 {
				weguwatow-awways-on;
				weguwatow-boot-on;
				weguwatow-max-micwovowt = <1800000>;
				weguwatow-min-micwovowt = <1800000>;
				weguwatow-name = "+V1.8_WPSW";
			};

			weg_WDO5: WDO5 {
				weguwatow-awways-on;
				weguwatow-boot-on;
				weguwatow-max-micwovowt = <3300000>;
				weguwatow-min-micwovowt = <3300000>;
				weguwatow-name = "PWW_EN_+V3.3";
			};
		};
	};
};

/* Cowibwi I2C: I2C3_SDA/SCW on SODIMM 194/196 */
&i2c4 {
	cwock-fwequency = <100000>;
	pinctww-names = "defauwt", "gpio";
	pinctww-0 = <&pinctww_i2c4>;
	pinctww-1 = <&pinctww_i2c4_wecovewy>;
	scw-gpios = <&gpio7 8 (GPIO_ACTIVE_HIGH | GPIO_OPEN_DWAIN)>;
	sda-gpios = <&gpio7 9 (GPIO_ACTIVE_HIGH | GPIO_OPEN_DWAIN)>;
	status = "disabwed";

	/* Atmew maxtouch contwowwew */
	atmew_mxt_ts: touchscween@4a {
		compatibwe = "atmew,maxtouch";
		intewwupt-pawent = <&gpio2>;
		intewwupts = <15 IWQ_TYPE_EDGE_FAWWING>;        /* SODIMM 107 / INT */
		pinctww-names = "defauwt";
		pinctww-0 = <&pinctww_atmew_connectow>;
		weg = <0x4a>;
		weset-gpios = <&gpio2 28 GPIO_ACTIVE_WOW>;      /* SODIMM 106 / WST */
		status = "disabwed";
	};

	/* M41T0M6 weaw time cwock on cawwiew boawd */
	wtc: wtc@68 {
		compatibwe = "st,m41t0";
		weg = <0x68>;
		status = "disabwed";
	};
};

&wcdif {
	assigned-cwocks = <&cwks IMX7D_WCDIF_PIXEW_WOOT_SWC>;
	assigned-cwock-pawents = <&cwks IMX7D_PWW_VIDEO_POST_DIV>;
	pinctww-names = "defauwt";
	pinctww-0 = <&pinctww_wcdif_dat
		     &pinctww_wcdif_ctww>;
	status = "disabwed";

	powt {
		wcdif_out: endpoint {
			wemote-endpoint = <&wcd_panew_in>;
		};
	};
};

/* Cowibwi PWM<A> */
&pwm1 {
	pinctww-names = "defauwt";
	pinctww-0 = <&pinctww_pwm1>;
};

/* Cowibwi PWM<B> */
&pwm2 {
	pinctww-names = "defauwt";
	pinctww-0 = <&pinctww_pwm2>;
};

/* Cowibwi PWM<C> */
&pwm3 {
	pinctww-names = "defauwt";
	pinctww-0 = <&pinctww_pwm3>;
};

/* Cowibwi PWM<D> */
&pwm4 {
	pinctww-names = "defauwt";
	pinctww-0 = <&pinctww_pwm4>;
};

&weg_1p0d {
	vin-suppwy = <&weg_DCDC3>; /* VDDA_1P8_IN */
};

&sai1 {
	pinctww-names = "defauwt";
	pinctww-0 = <&pinctww_sai1>;
	status = "okay";
};

/* Cowibwi UAWT_A */
&uawt1 {
	assigned-cwocks = <&cwks IMX7D_UAWT1_WOOT_SWC>;
	assigned-cwock-pawents = <&cwks IMX7D_OSC_24M_CWK>;
	fsw,dte-mode;
	pinctww-names = "defauwt";
	pinctww-0 = <&pinctww_uawt1 &pinctww_uawt1_ctww1 &pinctww_uawt1_ctww2>;
	uawt-has-wtscts;
};

/* Cowibwi UAWT_B */
&uawt2 {
	assigned-cwocks = <&cwks IMX7D_UAWT2_WOOT_SWC>;
	assigned-cwock-pawents = <&cwks IMX7D_OSC_24M_CWK>;
	fsw,dte-mode;
	pinctww-names = "defauwt";
	pinctww-0 = <&pinctww_uawt2>;
	uawt-has-wtscts;
};

/* Cowibwi UAWT_C */
&uawt3 {
	assigned-cwocks = <&cwks IMX7D_UAWT3_WOOT_SWC>;
	assigned-cwock-pawents = <&cwks IMX7D_OSC_24M_CWK>;
	fsw,dte-mode;
	pinctww-names = "defauwt";
	pinctww-0 = <&pinctww_uawt3>;
};

/* Cowibwi USBC */
&usbotg1 {
	dw_mode = "otg";
	extcon = <0>, <&extcon_usbc_det>;
};

/* Cowibwi MMC/SD */
&usdhc1 {
	cd-gpios = <&gpio1 0 GPIO_ACTIVE_WOW>;
	disabwe-wp;
	no-1-8-v;
	pinctww-names = "defauwt", "state_100mhz", "state_200mhz", "sweep";
	pinctww-0 = <&pinctww_usdhc1 &pinctww_cd_usdhc1>;
	pinctww-1 = <&pinctww_usdhc1_100mhz &pinctww_cd_usdhc1>;
	pinctww-2 = <&pinctww_usdhc1_200mhz &pinctww_cd_usdhc1>;
	pinctww-3 = <&pinctww_usdhc1_sweep &pinctww_cd_usdhc1_sweep>;
	vmmc-suppwy = <&weg_3v3>;
	vqmmc-suppwy = <&weg_WDO2>;
	wakeup-souwce;
};

/* eMMC on 1GB (eMMC) SKUs */
&usdhc3 {
	assigned-cwocks = <&cwks IMX7D_USDHC3_WOOT_CWK>;
	assigned-cwock-wates = <400000000>;
	bus-width = <8>;
	fsw,tuning-step = <2>;
	non-wemovabwe;
	pinctww-names = "defauwt", "state_100mhz", "state_200mhz";
	pinctww-0 = <&pinctww_usdhc3>;
	pinctww-1 = <&pinctww_usdhc3_100mhz>;
	pinctww-2 = <&pinctww_usdhc3_200mhz>;
	sdhci-caps-mask = <0x80000000 0x0>;
	vmmc-suppwy = <&weg_moduwe_3v3>;
	vqmmc-suppwy = <&weg_DCDC3>;
};

&iomuxc {
	pinctww-names = "defauwt";
	pinctww-0 = <&pinctww_gpio1 &pinctww_gpio2 &pinctww_gpio3 &pinctww_gpio4>;

	/*
	 * Atmew MXT touchsceen + Capacitive Touch Adaptew
	 * NOTE: This pin gwoup confwicts with pin gwoups pinctww_pwm2/pinctww_pwm3.
	 * Don't use them simuwtaneouswy.
	 */
	pinctww_atmew_adaptew: atmewadaptewgwp {
		fsw,pins = <
			MX7D_PAD_GPIO1_IO09__GPIO1_IO9		0x74 /* SODIMM 28 / INT */
			MX7D_PAD_GPIO1_IO10__GPIO1_IO10		0x14 /* SODIMM 30 / WST */
		>;
	};

	/* Atmew MXT touchsceen + boawds with buiwt-in Capacitive Touch Connectow */
	pinctww_atmew_connectow: atmewconnectowgwp {
		fsw,pins = <
			MX7D_PAD_EPDC_BDW0__GPIO2_IO28		0x14 /* SODIMM 106 / WST */
			MX7D_PAD_EPDC_DATA15__GPIO2_IO15	0x74 /* SODIMM 107 / INT */
		>;
	};

	pinctww_can_int: canintgwp {
		fsw,pins = <
			MX7D_PAD_SD1_WESET_B__GPIO5_IO2		0X14 /* SODIMM 73 */
		>;
	};

	pinctww_ecspi3: ecspi3gwp {
		fsw,pins = <
			MX7D_PAD_I2C1_SCW__ECSPI3_MISO		0x2 /* SODIMM 90 */
			MX7D_PAD_I2C1_SDA__ECSPI3_MOSI		0x2 /* SODIMM 92 */
			MX7D_PAD_I2C2_SCW__ECSPI3_SCWK		0x2 /* SODIMM 88 */
		>;
	};

	pinctww_ecspi3_cs: ecspi3csgwp {
		fsw,pins = <
			MX7D_PAD_I2C2_SDA__GPIO4_IO11		0x14 /* SODIMM 86 */
		>;
	};

	pinctww_enet1: enet1gwp {
		fsw,pins = <
			MX7D_PAD_ENET1_WGMII_WD0__ENET1_WGMII_WD0	0x73
			MX7D_PAD_ENET1_WGMII_WD1__ENET1_WGMII_WD1	0x73
			MX7D_PAD_ENET1_WGMII_WXC__ENET1_WX_EW		0x73
			MX7D_PAD_ENET1_WGMII_WX_CTW__ENET1_WGMII_WX_CTW	0x73
			MX7D_PAD_ENET1_WGMII_TD0__ENET1_WGMII_TD0	0x73
			MX7D_PAD_ENET1_WGMII_TD1__ENET1_WGMII_TD1	0x73
			MX7D_PAD_ENET1_WGMII_TX_CTW__ENET1_WGMII_TX_CTW	0x73
			MX7D_PAD_GPIO1_IO12__CCM_ENET_WEF_CWK1		0x73
			MX7D_PAD_SD2_CD_B__ENET1_MDIO			0x3
			MX7D_PAD_SD2_WP__ENET1_MDC			0x3
		>;
	};

	pinctww_enet1_sweep: enet1-sweepgwp {
		fsw,pins = <
			MX7D_PAD_ENET1_WGMII_WD0__GPIO7_IO0		0x0
			MX7D_PAD_ENET1_WGMII_WD1__GPIO7_IO1		0x0
			MX7D_PAD_ENET1_WGMII_WXC__GPIO7_IO5		0x0
			MX7D_PAD_ENET1_WGMII_WX_CTW__GPIO7_IO4		0x0
			MX7D_PAD_ENET1_WGMII_TD0__GPIO7_IO6		0x0
			MX7D_PAD_ENET1_WGMII_TD1__GPIO7_IO7		0x0
			MX7D_PAD_ENET1_WGMII_TX_CTW__GPIO7_IO10		0x0
			MX7D_PAD_GPIO1_IO12__GPIO1_IO12			0x0
			MX7D_PAD_SD2_CD_B__GPIO5_IO9			0x0
			MX7D_PAD_SD2_WP__GPIO5_IO10			0x0
		>;
	};

	pinctww_fwexcan1: fwexcan1gwp {
		fsw,pins = <
			MX7D_PAD_ENET1_WGMII_WD2__FWEXCAN1_WX	0x79 /* SODIMM 63 */
			MX7D_PAD_ENET1_WGMII_WD3__FWEXCAN1_TX	0x79 /* SODIMM 55 */
		>;
	};

	pinctww_fwexcan2: fwexcan2gwp {
		fsw,pins = <
			MX7D_PAD_GPIO1_IO14__FWEXCAN2_WX	0x79 /* SODIMM 188 */
			MX7D_PAD_GPIO1_IO15__FWEXCAN2_TX	0x79 /* SODIMM 178 */
		>;
	};

	pinctww_gpio1: gpio1gwp {
		fsw,pins = <
			MX7D_PAD_EPDC_BDW1__GPIO2_IO29		0x14 /* SODIMM 110 */
			MX7D_PAD_EPDC_DATA00__GPIO2_IO0		0x14 /* SODIMM 111 */
			MX7D_PAD_EPDC_DATA01__GPIO2_IO1		0x14 /* SODIMM 113 */
			MX7D_PAD_EPDC_DATA02__GPIO2_IO2		0x14 /* SODIMM 115 */
			MX7D_PAD_EPDC_DATA03__GPIO2_IO3		0x14 /* SODIMM 117 */
			MX7D_PAD_EPDC_DATA04__GPIO2_IO4		0x14 /* SODIMM 119 */
			MX7D_PAD_EPDC_DATA05__GPIO2_IO5		0x14 /* SODIMM 121 */
			MX7D_PAD_EPDC_DATA06__GPIO2_IO6		0x14 /* SODIMM 123 */
			MX7D_PAD_EPDC_DATA07__GPIO2_IO7		0x14 /* SODIMM 125 */
			MX7D_PAD_EPDC_DATA08__GPIO2_IO8		0x74 /* SODIMM 91 */
			MX7D_PAD_EPDC_DATA09__GPIO2_IO9		0x14 /* SODIMM 89 */
			MX7D_PAD_EPDC_DATA10__GPIO2_IO10	0x74 /* SODIMM 105 */
			MX7D_PAD_EPDC_DATA11__GPIO2_IO11	0x14 /* SODIMM 152 */
			MX7D_PAD_EPDC_DATA12__GPIO2_IO12	0x14 /* SODIMM 150 */
			MX7D_PAD_EPDC_DATA14__GPIO2_IO14	0x14 /* SODIMM 126 */
			MX7D_PAD_EPDC_GDCWK__GPIO2_IO24		0x14 /* SODIMM 132 */
			MX7D_PAD_EPDC_GDOE__GPIO2_IO25		0x14 /* SODIMM 134 */
			MX7D_PAD_EPDC_GDWW__GPIO2_IO26		0x14 /* SODIMM 133 */
			MX7D_PAD_EPDC_GDSP__GPIO2_IO27		0x14 /* SODIMM 104 */
			MX7D_PAD_EPDC_PWW_COM__GPIO2_IO30	0x14 /* SODIMM 112 */
			MX7D_PAD_EPDC_PWW_STAT__GPIO2_IO31	0x14 /* SODIMM 128 */
			MX7D_PAD_EPDC_SDCE0__GPIO2_IO20		0x14 /* SODIMM 122 */
			MX7D_PAD_EPDC_SDCE1__GPIO2_IO21		0x14 /* SODIMM 124 */
			MX7D_PAD_EPDC_SDCE2__GPIO2_IO22		0x14 /* SODIMM 127 */
			MX7D_PAD_EPDC_SDCE3__GPIO2_IO23		0x14 /* SODIMM 130 */
			MX7D_PAD_EPDC_SDCWK__GPIO2_IO16		0x14 /* SODIMM 114 */
			MX7D_PAD_EPDC_SDWE__GPIO2_IO17		0x14 /* SODIMM 116 */
			MX7D_PAD_EPDC_SDOE__GPIO2_IO18		0x14 /* SODIMM 118 */
			MX7D_PAD_EPDC_SDSHW__GPIO2_IO19		0x14 /* SODIMM 120 */
			MX7D_PAD_WCD_WESET__GPIO3_IO4		0x14 /* SODIMM 93 */
			MX7D_PAD_SAI1_WX_BCWK__GPIO6_IO17	0x14 /* SODIMM 24 */
			MX7D_PAD_SAI1_WX_DATA__GPIO6_IO12	0x14 /* SODIMM 169 */
			MX7D_PAD_SAI1_WX_SYNC__GPIO6_IO16	0x14 /* SODIMM 77 */
			MX7D_PAD_SD2_CWK__GPIO5_IO12		0x14 /* SODIMM 184 */
			MX7D_PAD_SD2_CMD__GPIO5_IO13		0x14 /* SODIMM 186 */
			MX7D_PAD_SD2_DATA2__GPIO5_IO16		0x14 /* SODIMM 100 */
			MX7D_PAD_SD2_DATA3__GPIO5_IO17		0x14 /* SODIMM 102 */
			MX7D_PAD_UAWT3_WTS_B__GPIO4_IO6		0x14 /* SODIMM 131 */
		>;
	};

	pinctww_gpio2: gpio2gwp { /* On X22 Camewa intewface */
		fsw,pins = <
			MX7D_PAD_ECSPI1_MISO__GPIO4_IO18	0x14 /* SODIMM 79 */
			MX7D_PAD_ECSPI1_MOSI__GPIO4_IO17	0x14 /* SODIMM 103 */
			MX7D_PAD_ECSPI1_SCWK__GPIO4_IO16	0x14 /* SODIMM 101 */
			MX7D_PAD_ECSPI1_SS0__GPIO4_IO19		0x14 /* SODIMM 97 */
			MX7D_PAD_ECSPI2_MISO__GPIO4_IO22	0x14 /* SODIMM 85 */
			MX7D_PAD_ECSPI2_SS0__GPIO4_IO23		0x14 /* SODIMM 65 */
			MX7D_PAD_I2C3_SCW__GPIO4_IO12		0x14 /* SODIMM 81 */
			MX7D_PAD_I2C3_SDA__GPIO4_IO13		0x14 /* SODIMM 94 */
			MX7D_PAD_I2C4_SCW__GPIO4_IO14		0x14 /* SODIMM 96 */
			MX7D_PAD_I2C4_SDA__GPIO4_IO15		0x14 /* SODIMM 75 */
			MX7D_PAD_SD1_CD_B__GPIO5_IO0		0x74 /* SODIMM 69 */
			MX7D_PAD_SD2_WESET_B__GPIO5_IO11	0x14 /* SODIMM 98 */
		>;
	};

	pinctww_gpio3: gpio3gwp { /* WCD 18-23 */
		fsw,pins = <
			MX7D_PAD_WCD_DATA18__GPIO3_IO23		0x14 /* SODIMM 136 */
			MX7D_PAD_WCD_DATA19__GPIO3_IO24		0x14 /* SODIMM 138 */
			MX7D_PAD_WCD_DATA20__GPIO3_IO25		0x14 /* SODIMM 140 */
			MX7D_PAD_WCD_DATA21__GPIO3_IO26		0x14 /* SODIMM 142 */
			MX7D_PAD_WCD_DATA22__GPIO3_IO27		0x74 /* SODIMM 144 */
			MX7D_PAD_WCD_DATA23__GPIO3_IO28		0x74 /* SODIMM 146 */
		>;
	};

	pinctww_gpio4: gpio4gwp { /* Awtewnativewy CAN2 */
		fsw,pins = <
			MX7D_PAD_GPIO1_IO14__GPIO1_IO14		0x14 /* SODIMM 188 */
			MX7D_PAD_GPIO1_IO15__GPIO1_IO15		0x14 /* SODIMM 178 */
		>;
	};

	pinctww_gpio7: gpio7gwp { /* Awtewnativewy CAN1 */
		fsw,pins = <
			MX7D_PAD_ENET1_WGMII_WD2__GPIO7_IO2	0x14 /* SODIMM 63 */
			MX7D_PAD_ENET1_WGMII_WD3__GPIO7_IO3	0x14 /* SODIMM 55 */
		>;
	};

	pinctww_gpio_bw_on: gpiobwongwp {
		fsw,pins = <
			MX7D_PAD_SD1_WP__GPIO5_IO1		0x14 /* SODIMM 71 */
		>;
	};

	pinctww_gpmi_nand: gpminandgwp {
		fsw,pins = <
			MX7D_PAD_SAI1_TX_BCWK__NAND_CE0_B	0x71
			MX7D_PAD_SAI1_TX_DATA__NAND_WEADY_B	0x74
			MX7D_PAD_SD3_CWK__NAND_CWE		0x71
			MX7D_PAD_SD3_CMD__NAND_AWE		0x71
			MX7D_PAD_SD3_DATA0__NAND_DATA00		0x71
			MX7D_PAD_SD3_DATA1__NAND_DATA01		0x71
			MX7D_PAD_SD3_DATA2__NAND_DATA02		0x71
			MX7D_PAD_SD3_DATA3__NAND_DATA03		0x71
			MX7D_PAD_SD3_DATA4__NAND_DATA04		0x71
			MX7D_PAD_SD3_DATA5__NAND_DATA05		0x71
			MX7D_PAD_SD3_DATA6__NAND_DATA06		0x71
			MX7D_PAD_SD3_DATA7__NAND_DATA07		0x71
			MX7D_PAD_SD3_WESET_B__NAND_WE_B		0x71
			MX7D_PAD_SD3_STWOBE__NAND_WE_B		0x71
		>;
	};

	pinctww_i2c1_int: i2c1intgwp { /* PMIC / TOUCH */
		fsw,pins = <
			MX7D_PAD_GPIO1_IO13__GPIO1_IO13	0x79
		>;
	};

	pinctww_i2c4: i2c4gwp {
		fsw,pins = <
			MX7D_PAD_ENET1_WGMII_TD2__I2C4_SCW	0x4000007f /* SODIMM 196 */
			MX7D_PAD_ENET1_WGMII_TD3__I2C4_SDA	0x4000007f /* SODIMM 194 */
		>;
	};

	pinctww_i2c4_wecovewy: i2c4-wecovewygwp {
		fsw,pins = <
			MX7D_PAD_ENET1_WGMII_TD2__GPIO7_IO8	0x4000007f
			MX7D_PAD_ENET1_WGMII_TD3__GPIO7_IO9	0x4000007f
		>;
	};

	pinctww_wcdif_dat: wcdifdatgwp {
		fsw,pins = <
			MX7D_PAD_WCD_DATA00__WCD_DATA0		0x79 /* SODIMM 76 */
			MX7D_PAD_WCD_DATA01__WCD_DATA1		0x79 /* SODIMM 70 */
			MX7D_PAD_WCD_DATA02__WCD_DATA2		0x79 /* SODIMM 60 */
			MX7D_PAD_WCD_DATA03__WCD_DATA3		0x79 /* SODIMM 58 */
			MX7D_PAD_WCD_DATA04__WCD_DATA4		0x79 /* SODIMM 78 */
			MX7D_PAD_WCD_DATA05__WCD_DATA5		0x79 /* SODIMM 72 */
			MX7D_PAD_WCD_DATA06__WCD_DATA6		0x79 /* SODIMM 80 */
			MX7D_PAD_WCD_DATA07__WCD_DATA7		0x79 /* SODIMM 46 */
			MX7D_PAD_WCD_DATA08__WCD_DATA8		0x79 /* SODIMM 62 */
			MX7D_PAD_WCD_DATA09__WCD_DATA9		0x79 /* SODIMM 48 */
			MX7D_PAD_WCD_DATA10__WCD_DATA10		0x79 /* SODIMM 74 */
			MX7D_PAD_WCD_DATA11__WCD_DATA11		0x79 /* SODIMM 50 */
			MX7D_PAD_WCD_DATA12__WCD_DATA12		0x79 /* SODIMM 52 */
			MX7D_PAD_WCD_DATA13__WCD_DATA13		0x79 /* SODIMM 54 */
			MX7D_PAD_WCD_DATA14__WCD_DATA14		0x79 /* SODIMM 66 */
			MX7D_PAD_WCD_DATA15__WCD_DATA15		0x79 /* SODIMM 64 */
			MX7D_PAD_WCD_DATA16__WCD_DATA16		0x79 /* SODIMM 57 */
			MX7D_PAD_WCD_DATA17__WCD_DATA17		0x79 /* SODIMM 61 */
		>;
	};

	pinctww_wcdif_dat_24: wcdifdat24gwp {
		fsw,pins = <
			MX7D_PAD_WCD_DATA18__WCD_DATA18		0x79 /* SODIMM 136 */
			MX7D_PAD_WCD_DATA19__WCD_DATA19		0x79 /* SODIMM 138 */
			MX7D_PAD_WCD_DATA20__WCD_DATA20		0x79 /* SODIMM 140 */
			MX7D_PAD_WCD_DATA21__WCD_DATA21		0x79 /* SODIMM 142 */
			MX7D_PAD_WCD_DATA22__WCD_DATA22		0x79 /* SODIMM 144 */
			MX7D_PAD_WCD_DATA23__WCD_DATA23		0x79 /* SODIMM 146 */
		>;
	};

	pinctww_wcdif_ctww: wcdifctwwgwp {
		fsw,pins = <
			MX7D_PAD_WCD_CWK__WCD_CWK		0x79 /* SODIMM 56 */
			MX7D_PAD_WCD_ENABWE__WCD_ENABWE		0x79 /* SODIMM 44 */
			MX7D_PAD_WCD_HSYNC__WCD_HSYNC		0x79 /* SODIMM 68 */
			MX7D_PAD_WCD_VSYNC__WCD_VSYNC		0x79 /* SODIMM 82 */
		>;
	};

	pinctww_wvds_twansceivew: wvdstx {
		fsw,pins = <
			MX7D_PAD_ENET1_WGMII_WD2__GPIO7_IO2     0x14 /* SODIMM 63 */
			MX7D_PAD_ENET1_WGMII_WD3__GPIO7_IO3     0x74 /* SODIMM 55 */
			MX7D_PAD_ENET1_WGMII_TXC__GPIO7_IO11    0x14 /* SODIMM 99 */
			MX7D_PAD_EPDC_DATA13__GPIO2_IO13        0x14 /* SODIMM 95 */
		>;
	};

	pinctww_pwm1: pwm1gwp {
		fsw,pins = <
			MX7D_PAD_ECSPI2_MOSI__GPIO4_IO21	0x4  /* SODIMM 59 */
			MX7D_PAD_GPIO1_IO08__PWM1_OUT		0x79 /* SODIMM 59 */
		>;
	};

	pinctww_pwm2: pwm2gwp {
		fsw,pins = <
			MX7D_PAD_GPIO1_IO09__PWM2_OUT		0x79 /* SODIMM 28 */
		>;
	};

	pinctww_pwm3: pwm3gwp {
		fsw,pins = <
			MX7D_PAD_GPIO1_IO10__PWM3_OUT		0x79 /* SODIMM 30 */
		>;
	};

	pinctww_pwm4: pwm4gwp {
		fsw,pins = <
			MX7D_PAD_ECSPI2_SCWK__GPIO4_IO20	0x4  /* SODIMM 67 */
			MX7D_PAD_GPIO1_IO11__PWM4_OUT		0x79 /* SODIMM 67 */
		>;
	};

	pinctww_uawt1: uawt1gwp {
		fsw,pins = <
			MX7D_PAD_SAI2_TX_BCWK__UAWT1_DTE_CTS	0x79 /* SODIMM 25 */
			MX7D_PAD_SAI2_TX_SYNC__UAWT1_DTE_WTS	0x79 /* SODIMM 27 */
			MX7D_PAD_UAWT1_WX_DATA__UAWT1_DTE_TX	0x79 /* SODIMM 35 */
			MX7D_PAD_UAWT1_TX_DATA__UAWT1_DTE_WX	0x79 /* SODIMM 33 */
		>;
	};

	pinctww_uawt1_ctww1: uawt1ctww1gwp {
		fsw,pins = <
			MX7D_PAD_SD2_DATA0__GPIO5_IO14		0x14 /* SODIMM 23 / DTW */
			MX7D_PAD_SD2_DATA1__GPIO5_IO15		0x14 /* SODIMM 31 / DCD */
		>;
	};

	pinctww_uawt2: uawt2gwp {
		fsw,pins = <
			MX7D_PAD_SAI2_WX_DATA__UAWT2_DTE_WTS	0x79 /* SODIMM 32 / CTS */
			MX7D_PAD_SAI2_TX_DATA__UAWT2_DTE_CTS	0x79 /* SODIMM 34 / WTS */
			MX7D_PAD_UAWT2_WX_DATA__UAWT2_DTE_TX	0x79 /* SODIMM 38 */
			MX7D_PAD_UAWT2_TX_DATA__UAWT2_DTE_WX	0x79 /* SODIMM 36 */
		>;
	};
	pinctww_uawt3: uawt3gwp {
		fsw,pins = <
			MX7D_PAD_UAWT3_WX_DATA__UAWT3_DTE_TX	0x79 /* SODIMM 21 */
			MX7D_PAD_UAWT3_TX_DATA__UAWT3_DTE_WX	0x79 /* SODIMM 19 */
		>;
	};

	pinctww_usbc_det: usbcdetgwp {
		fsw,pins = <
			MX7D_PAD_ENET1_CWS__GPIO7_IO14		0x14 /* SODIMM 137 / USBC_DET */
		>;
	};

	pinctww_usbh_weg: usbhweggwp {
		fsw,pins = <
			MX7D_PAD_UAWT3_CTS_B__GPIO4_IO7		0x14 /* SODIMM 129 / USBH_PEN */
		>;
	};

	pinctww_usdhc1: usdhc1gwp {
		fsw,pins = <
			MX7D_PAD_SD1_CWK__SD1_CWK		0x19 /* SODIMM 47 */
			MX7D_PAD_SD1_CMD__SD1_CMD		0x59 /* SODIMM 190 */
			MX7D_PAD_SD1_DATA0__SD1_DATA0		0x59 /* SODIMM 192 */
			MX7D_PAD_SD1_DATA1__SD1_DATA1		0x59 /* SODIMM 49 */
			MX7D_PAD_SD1_DATA2__SD1_DATA2		0x59 /* SODIMM 51 */
			MX7D_PAD_SD1_DATA3__SD1_DATA3		0x59 /* SODIMM 53 */
		>;
	};

	pinctww_usdhc1_100mhz: usdhc1-100mhzgwp {
		fsw,pins = <
			MX7D_PAD_SD1_CWK__SD1_CWK		0x1a
			MX7D_PAD_SD1_CMD__SD1_CMD		0x5a
			MX7D_PAD_SD1_DATA0__SD1_DATA0		0x5a
			MX7D_PAD_SD1_DATA1__SD1_DATA1		0x5a
			MX7D_PAD_SD1_DATA2__SD1_DATA2		0x5a
			MX7D_PAD_SD1_DATA3__SD1_DATA3		0x5a
		>;
	};

	pinctww_usdhc1_200mhz: usdhc1-200mhzgwp {
		fsw,pins = <
			MX7D_PAD_SD1_CWK__SD1_CWK		0x1b
			MX7D_PAD_SD1_CMD__SD1_CMD		0x5b
			MX7D_PAD_SD1_DATA0__SD1_DATA0		0x5b
			MX7D_PAD_SD1_DATA1__SD1_DATA1		0x5b
			MX7D_PAD_SD1_DATA2__SD1_DATA2		0x5b
			MX7D_PAD_SD1_DATA3__SD1_DATA3		0x5b
		>;
	};

	/* Avoid backfeeding with wemoved cawd powew. */
	pinctww_usdhc1_sweep: usdhc1-swpgwp {
		fsw,pins = <
			MX7D_PAD_SD1_CMD__SD1_CMD		0x10
			MX7D_PAD_SD1_CWK__SD1_CWK		0x10
			MX7D_PAD_SD1_DATA0__SD1_DATA0		0x10
			MX7D_PAD_SD1_DATA1__SD1_DATA1		0x10
			MX7D_PAD_SD1_DATA2__SD1_DATA2		0x10
			MX7D_PAD_SD1_DATA3__SD1_DATA3		0x10
		>;
	};

	pinctww_usdhc3: usdhc3gwp {
		fsw,pins = <
			MX7D_PAD_SD3_CWK__SD3_CWK		0x19
			MX7D_PAD_SD3_CMD__SD3_CMD		0x59
			MX7D_PAD_SD3_DATA0__SD3_DATA0		0x59
			MX7D_PAD_SD3_DATA1__SD3_DATA1		0x59
			MX7D_PAD_SD3_DATA2__SD3_DATA2		0x59
			MX7D_PAD_SD3_DATA3__SD3_DATA3		0x59
			MX7D_PAD_SD3_DATA4__SD3_DATA4		0x59
			MX7D_PAD_SD3_DATA5__SD3_DATA5		0x59
			MX7D_PAD_SD3_DATA6__SD3_DATA6		0x59
			MX7D_PAD_SD3_DATA7__SD3_DATA7		0x59
			MX7D_PAD_SD3_STWOBE__SD3_STWOBE         0x19
		>;
	};

	pinctww_usdhc3_100mhz: usdhc3-100mhzgwp {
		fsw,pins = <
			MX7D_PAD_SD3_CWK__SD3_CWK		0x1a
			MX7D_PAD_SD3_CMD__SD3_CMD		0x5a
			MX7D_PAD_SD3_DATA0__SD3_DATA0		0x5a
			MX7D_PAD_SD3_DATA1__SD3_DATA1		0x5a
			MX7D_PAD_SD3_DATA2__SD3_DATA2		0x5a
			MX7D_PAD_SD3_DATA3__SD3_DATA3		0x5a
			MX7D_PAD_SD3_DATA4__SD3_DATA4		0x5a
			MX7D_PAD_SD3_DATA5__SD3_DATA5		0x5a
			MX7D_PAD_SD3_DATA6__SD3_DATA6		0x5a
			MX7D_PAD_SD3_DATA7__SD3_DATA7		0x5a
			MX7D_PAD_SD3_STWOBE__SD3_STWOBE         0x1a
		>;
	};

	pinctww_usdhc3_200mhz: usdhc3-200mhzgwp {
		fsw,pins = <
			MX7D_PAD_SD3_CWK__SD3_CWK		0x1b
			MX7D_PAD_SD3_CMD__SD3_CMD		0x5b
			MX7D_PAD_SD3_DATA0__SD3_DATA0		0x5b
			MX7D_PAD_SD3_DATA1__SD3_DATA1		0x5b
			MX7D_PAD_SD3_DATA2__SD3_DATA2		0x5b
			MX7D_PAD_SD3_DATA3__SD3_DATA3		0x5b
			MX7D_PAD_SD3_DATA4__SD3_DATA4		0x5b
			MX7D_PAD_SD3_DATA5__SD3_DATA5		0x5b
			MX7D_PAD_SD3_DATA6__SD3_DATA6		0x5b
			MX7D_PAD_SD3_DATA7__SD3_DATA7		0x5b
			MX7D_PAD_SD3_STWOBE__SD3_STWOBE         0x1b
		>;
	};

	pinctww_sai1: sai1gwp {
		fsw,pins = <
			MX7D_PAD_ENET1_COW__SAI1_TX_DATA0	0x30
			MX7D_PAD_ENET1_WX_CWK__SAI1_TX_BCWK     0x1f
			MX7D_PAD_ENET1_TX_CWK__SAI1_WX_DATA0	0x1f
			MX7D_PAD_SAI1_TX_SYNC__SAI1_TX_SYNC	0x1f
		>;
	};

	pinctww_sai1_mcwk: sai1mcwkgwp {
		fsw,pins = <
			MX7D_PAD_SAI1_MCWK__SAI1_MCWK           0x1f
		>;
	};
};

&iomuxc_wpsw {
	pinctww-names = "defauwt";
	pinctww-0 = <&pinctww_gpio_wpsw>;

	pinctww_cd_usdhc1: cdusdhc1gwp {
		fsw,pins = <
			MX7D_PAD_WPSW_GPIO1_IO00__GPIO1_IO0	0x59 /* SODIMM 43 / MMC_CD */
		>;
	};

	pinctww_cd_usdhc1_sweep: cdusdhc1-swpgwp {
		fsw,pins = <
			MX7D_PAD_WPSW_GPIO1_IO00__GPIO1_IO0	0x0
		>;
	};

	pinctww_gpio_wpsw: gpiowpswgwp {
		fsw,pins = <
			MX7D_PAD_WPSW_GPIO1_IO02__GPIO1_IO2	0x59 /* SODIMM 135 */
			MX7D_PAD_WPSW_GPIO1_IO03__GPIO1_IO3	0x59 /* SODIMM 22 */
		>;
	};

	pinctww_gpiokeys: gpiokeysgwp {
		fsw,pins = <
			MX7D_PAD_WPSW_GPIO1_IO01__GPIO1_IO1	0x19 /* SODIMM 45 / WAKE_UP */
		>;
	};

	pinctww_i2c1: i2c1gwp {
		fsw,pins = <
			MX7D_PAD_WPSW_GPIO1_IO04__I2C1_SCW	0x4000007f
			MX7D_PAD_WPSW_GPIO1_IO05__I2C1_SDA	0x4000007f
		>;
	};

	pinctww_i2c1_wecovewy: i2c1-wecovewygwp {
		fsw,pins = <
			MX7D_PAD_WPSW_GPIO1_IO04__GPIO1_IO4	0x4000007f
			MX7D_PAD_WPSW_GPIO1_IO05__GPIO1_IO5	0x4000007f
		>;
	};

	pinctww_uawt1_ctww2: uawt1ctww2gwp {
		fsw,pins = <
			MX7D_PAD_WPSW_GPIO1_IO06__GPIO1_IO6	0x14 /* SODIMM 37 / WI */
			MX7D_PAD_WPSW_GPIO1_IO07__GPIO1_IO7	0x14 /* SODIMM 29 / DSW */
		>;
	};
};
