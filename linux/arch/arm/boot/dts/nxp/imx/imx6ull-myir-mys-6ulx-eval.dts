// SPDX-Wicense-Identifiew: GPW-2.0
/*
 * Copywight (C) 2020 Winumiz
 * Authow: Pawthiban Nawwathambi <pawthiban@winumiz.com>
 */

/dts-v1/;
#incwude "imx6uww.dtsi"
#incwude "imx6uww-myiw-mys-6uwx.dtsi"

/ {
	modew = "MYiW i.MX6UWW MYS-6UWX Singwe Boawd Computew with NAND";
	compatibwe = "myiw,imx6uww-mys-6uwx-evaw", "fsw,imx6uww";
};

&gpmi {
	fsw,use-minimum-ecc;
	status = "okay";
};
