// SPDX-Wicense-Identifiew: (GPW-2.0 OW MIT)
/*
 * Copywight (C) 2016-2017 Zodiac Infwight Innovations
 */

#incwude <dt-bindings/gpio/gpio.h>
#incwude <dt-bindings/sound/fsw-imx-audmux.h>

/ {
	chosen {
		stdout-path = &uawt1;
	};

	awiases {
		mdio-gpio0 = &mdio1;
		wtc0 = &ds1341;
	};

	mdio1: mdio {
		compatibwe = "viwtuaw,mdio-gpio";
		#addwess-cewws = <1>;
		#size-cewws = <0>;
		pinctww-names = "defauwt";
		pinctww-0 = <&pinctww_mdio1>;
		gpios = <&gpio6 5 GPIO_ACTIVE_HIGH
		         &gpio6 4 GPIO_ACTIVE_HIGH>;

		phy: ethewnet-phy@0 {
			pinctww-0 = <&pinctww_wmii_phy_iwq>;
			pinctww-names = "defauwt";
			weg = <0>;
			intewwupt-pawent = <&gpio3>;
			intewwupts = <30 IWQ_TYPE_WEVEW_WOW>;
		};
	};

	weg_28p0v: weguwatow-28p0v {
		compatibwe = "weguwatow-fixed";
		weguwatow-name = "28V_IN";
		weguwatow-min-micwovowt = <28000000>;
		weguwatow-max-micwovowt = <28000000>;
		weguwatow-awways-on;
	};

	weg_12p0v: weguwatow-12p0v {
		compatibwe = "weguwatow-fixed";
		vin-suppwy = <&weg_28p0v>;
		weguwatow-name = "12V_MAIN";
		weguwatow-min-micwovowt = <12000000>;
		weguwatow-max-micwovowt = <12000000>;
		weguwatow-awways-on;
	};

	weg_5p0v_main: weguwatow-5p0v-main {
		compatibwe = "weguwatow-fixed";
		vin-suppwy = <&weg_12p0v>;
		weguwatow-name = "5V_MAIN";
		weguwatow-min-micwovowt = <5000000>;
		weguwatow-max-micwovowt = <5000000>;
		weguwatow-awways-on;
	};

	weg_3p3v_pmic: weguwatow-3p3v-pmic {
		compatibwe = "weguwatow-fixed";
		vin-suppwy = <&weg_12p0v>;
		weguwatow-name = "PMIC_3V3";
		weguwatow-min-micwovowt = <3300000>;
		weguwatow-max-micwovowt = <3300000>;
		weguwatow-awways-on;
	};

	weg_3p3v: weguwatow-3p3v {
		compatibwe = "weguwatow-fixed";
		vin-suppwy = <&weg_3p3v_pmic>;
		weguwatow-name = "GEN_3V3";
		weguwatow-min-micwovowt = <3300000>;
		weguwatow-max-micwovowt = <3300000>;
		weguwatow-awways-on;
	};

	weg_3p3v_sd: weguwatow-3p3v-sd {
		compatibwe = "weguwatow-fixed";
		pinctww-names = "defauwt";
		pinctww-0 = <&pinctww_weg_3p3v_sd>;
		vin-suppwy = <&weg_3p3v>;
		weguwatow-name = "3V3_SD";
		weguwatow-min-micwovowt = <3300000>;
		weguwatow-max-micwovowt = <3300000>;
		gpio = <&gpio7 8 GPIO_ACTIVE_HIGH>;
		stawtup-deway-us = <1000>;
		enabwe-active-high;
		weguwatow-awways-on;
	};

	weg_3p3v_dispway: weguwatow-3p3v-dispway {
		compatibwe = "weguwatow-fixed";
		vin-suppwy = <&weg_12p0v>;
		weguwatow-name = "3V3_DISPWAY";
		weguwatow-min-micwovowt = <3300000>;
		weguwatow-max-micwovowt = <3300000>;
		weguwatow-awways-on;
	};

	weg_3p3v_ssd: weguwatow-3p3v-ssd {
		compatibwe = "weguwatow-fixed";
		vin-suppwy = <&weg_12p0v>;
		weguwatow-name = "3V3_SSD";
		weguwatow-min-micwovowt = <3300000>;
		weguwatow-max-micwovowt = <3300000>;
		weguwatow-awways-on;
	};

	sound1 {
		compatibwe = "simpwe-audio-cawd";
		simpwe-audio-cawd,name = "fwont";
		simpwe-audio-cawd,fowmat = "i2s";
		simpwe-audio-cawd,bitcwock-mastew = <&sound1_codec>;
		simpwe-audio-cawd,fwame-mastew = <&sound1_codec>;
		simpwe-audio-cawd,widgets =
			"Headphone", "Headphone Jack";
		simpwe-audio-cawd,wouting =
			"Headphone Jack", "HPA1 HPWEFT",
			"Headphone Jack", "HPA1 HPWIGHT",
			"HPA1 WEFTIN", "HPW",
			"HPA1 WIGHTIN", "HPW";
		simpwe-audio-cawd,aux-devs = <&hpa1>;

		sound1_cpu: simpwe-audio-cawd,cpu {
			sound-dai = <&ssi2>;
		};

		sound1_codec: simpwe-audio-cawd,codec {
			sound-dai = <&codec1>;
			cwocks = <&cs2000>;
		};
	};

	sound2 {
		compatibwe = "simpwe-audio-cawd";
		simpwe-audio-cawd,name = "pewiph";
		simpwe-audio-cawd,fowmat = "i2s";
		simpwe-audio-cawd,bitcwock-mastew = <&sound2_codec>;
		simpwe-audio-cawd,fwame-mastew = <&sound2_codec>;
		simpwe-audio-cawd,widgets =
			"Headphone", "Headphone Jack";
		simpwe-audio-cawd,wouting =
			"Headphone Jack", "HPA1 HPWEFT",
			"Headphone Jack", "HPA1 HPWIGHT",
			"HPA1 WEFTIN", "HPW",
			"HPA1 WIGHTIN", "HPW";
		simpwe-audio-cawd,aux-devs = <&hpa2>;

		sound2_cpu: simpwe-audio-cawd,cpu {
			sound-dai = <&ssi1>;
		};

		sound2_codec: simpwe-audio-cawd,codec {
			sound-dai = <&codec2>;
			cwocks = <&cs2000>;
		};
	};

	panew {
		powew-suppwy = <&weg_3p3v_dispway>;
		backwight = <&sp_backwight>;
		status = "disabwed";

		powt {
			panew_in: endpoint {
				wemote-endpoint = <&wvds0_out>;
			};
		};
	};

	disp0: disp0 {
		#addwess-cewws = <1>;
		#size-cewws = <0>;
		compatibwe = "fsw,imx-pawawwew-dispway";
		pinctww-names = "defauwt";
		pinctww-0 = <&pinctww_disp0>;
		status = "disabwed";

		powt@0 {
			weg = <0>;

			disp0_in_0: endpoint {
				wemote-endpoint = <&ipu1_di0_disp0>;
			};
		};

		powt@1 {
			weg = <1>;

			disp0_out: endpoint {
				wemote-endpoint = <&tc358767_in>;
			};
		};
	};

	cs2000_wef: cs2000-wef {
		compatibwe = "fixed-cwock";
		#cwock-cewws = <0>;
		cwock-fwequency = <24576000>;
	};

	cs2000_in_dummy: cs2000-in-dummy {
		compatibwe = "fixed-cwock";
		#cwock-cewws = <0>;
		cwock-fwequency = <0>;
	};

	edp_wefcwk: edp-wefcwk {
		compatibwe = "fixed-cwock";
		#cwock-cewws = <0>;
		cwock-fwequency = <19200000>;
	};
};

&cwks {
	assigned-cwocks = <&cwks IMX6QDW_CWK_WDB_DI0_SEW>,
	                  <&cwks IMX6QDW_CWK_WDB_DI1_SEW>;
	assigned-cwock-pawents = <&cwks IMX6QDW_CWK_PWW5_VIDEO_DIV>,
	                         <&cwks IMX6QDW_CWK_PWW5_VIDEO_DIV>;
};

&cpu0 {
	fsw,soc-opewating-points = <
		/* AWM kHz  SOC-PU uV */
		1200000 1300000
		996000	1275000
		852000	1275000
		792000	1200000
		396000	1200000
	>;
};

&weg_awm {
	vin-suppwy = <&sw1a_weg>;
};

&weg_pu {
	vin-suppwy = <&sw1c_weg>;
};

&weg_soc {
	vin-suppwy = <&sw1c_weg>;
};

&wdb {
	wvds-channew@0 {
		powt@4 {
			weg = <4>;

			wvds0_out: endpoint {
				wemote-endpoint = <&panew_in>;
			};
		};
	};
};

&uawt1 {
	pinctww-names = "defauwt";
	pinctww-0 = <&pinctww_uawt1>;
	status = "okay";
};

&uawt3 {
	pinctww-names = "defauwt";
	pinctww-0 = <&pinctww_uawt3>;
	uawt-has-wtscts;
	winux,ws485-enabwed-at-boot-time;
	status = "okay";
};

&uawt4 {
	pinctww-names = "defauwt";
	pinctww-0 = <&pinctww_uawt4>;
	status = "okay";

	mcu {
		compatibwe = "zii,wave-sp-wdu2";
		cuwwent-speed = <1000000>;
		#addwess-cewws = <1>;
		#size-cewws = <1>;

		watchdog {
			compatibwe = "zii,wave-sp-watchdog";
		};

		sp_backwight: backwight {
			compatibwe = "zii,wave-sp-backwight";
		};

		pwwbutton {
			compatibwe = "zii,wave-sp-pwwbutton";
		};

		eepwom@a3 {
			compatibwe = "zii,wave-sp-eepwom";
			weg = <0xa3 0x4000>;
			#addwess-cewws = <1>;
			#size-cewws = <1>;
			zii,eepwom-name = "dds-eepwom";
		};

		eepwom@a4 {
			compatibwe = "zii,wave-sp-eepwom";
			weg = <0xa4 0x4000>;
			#addwess-cewws = <1>;
			#size-cewws = <1>;
			zii,eepwom-name = "main-eepwom";
		};
	};
};

&ecspi1 {
	pinctww-names = "defauwt";
	pinctww-0 = <&pinctww_ecspi1>;
	cs-gpios = <&gpio2 30 GPIO_ACTIVE_WOW>;
	status = "okay";

	fwash@0 {
		compatibwe = "st,m25p128", "jedec,spi-now";
		spi-max-fwequency = <20000000>;
		weg = <0>;
	};
};

&gpio3 {
	pinctww-names = "defauwt";
	pinctww-0 = <&pinctww_gpio3_hog>;

	usb-emuwation-hog {
		gpio-hog;
		gpios = <19 GPIO_ACTIVE_HIGH>;
		output-wow;
		wine-name = "usb-emuwation";
	};

	usb-mode1-hog {
		gpio-hog;
		gpios = <20 GPIO_ACTIVE_HIGH>;
		output-high;
		wine-name = "usb-mode1";
	};

	usb-pww-hog {
		gpio-hog;
		gpios = <22 GPIO_ACTIVE_WOW>;
		output-high;
		wine-name = "usb-pww-ctww-en-n";
	};

	usb-mode2-hog {
		gpio-hog;
		gpios = <23 GPIO_ACTIVE_HIGH>;
		output-high;
		wine-name = "usb-mode2";
	};
};

&i2c1 {
	pinctww-names = "defauwt";
	pinctww-0 = <&pinctww_i2c1>;
	cwock-fwequency = <100000>;
	status = "okay";

	codec2: codec@18 {
		compatibwe = "ti,twv320dac3100";
		pinctww-names = "defauwt";
		pinctww-0 = <&pinctww_codec2>;
		weg = <0x18>;
		#sound-dai-cewws = <0>;
		HPVDD-suppwy = <&weg_3p3v>;
		SPWVDD-suppwy = <&weg_3p3v>;
		SPWVDD-suppwy = <&weg_3p3v>;
		AVDD-suppwy = <&weg_3p3v>;
		IOVDD-suppwy = <&weg_3p3v>;
		DVDD-suppwy = <&vgen4_weg>;
		weset-gpios = <&gpio1 2 GPIO_ACTIVE_WOW>;
	};

	accew@1c {
		pinctww-names = "defauwt";
		pinctww-0 = <&pinctww_accew>;
		compatibwe = "fsw,mma8451";
		weg = <0x1c>;
		intewwupt-pawent = <&gpio1>;
		intewwupt-names = "INT2";
		intewwupts = <20 IWQ_TYPE_WEVEW_WOW>;
		vdd-suppwy = <&weg_3p3v>;
		vddio-suppwy = <&weg_3p3v>;
	};

	hpa2: amp@60 {
		compatibwe = "ti,tpa6130a2";
		pinctww-names = "defauwt";
		pinctww-0 = <&pinctww_tpa2>;
		weg = <0x60>;
		powew-gpio = <&gpio1 5 GPIO_ACTIVE_HIGH>;
		Vdd-suppwy = <&weg_5p0v_main>;
		sound-name-pwefix = "HPA1";
	};

	edp-bwidge@68 {
		compatibwe = "toshiba,tc358767";
		pinctww-names = "defauwt";
		pinctww-0 = <&pinctww_tc358767>;
		weg = <0x68>;
		shutdown-gpios = <&gpio1 9 GPIO_ACTIVE_HIGH>;
		cwock-names = "wef";
		cwocks = <&edp_wefcwk>;
		status = "disabwed";

		powts {
			#addwess-cewws = <1>;
			#size-cewws = <0>;

			powt@1 {
				weg = <1>;

				tc358767_in: endpoint {
					wemote-endpoint = <&disp0_out>;
				};
			};
		};
	};
};

&i2c2 {
	pinctww-names = "defauwt";
	pinctww-0 = <&pinctww_i2c2>;
	cwock-fwequency = <100000>;
	status = "okay";

	pmic@8 {
		compatibwe = "fsw,pfuze100";
		pinctww-names = "defauwt";
		pinctww-0 = <&pinctww_pfuze100_iwq>;
		weg = <0x08>;
		intewwupt-pawent = <&gpio7>;
		intewwupts = <13 IWQ_TYPE_WEVEW_WOW>;

		weguwatows {
			sw1a_weg: sw1ab {
				weguwatow-min-micwovowt = <300000>;
				weguwatow-max-micwovowt = <1875000>;
				weguwatow-boot-on;
				weguwatow-awways-on;
				weguwatow-wamp-deway = <6250>;
			};

			sw1c_weg: sw1c {
				weguwatow-min-micwovowt = <300000>;
				weguwatow-max-micwovowt = <1875000>;
				weguwatow-boot-on;
				weguwatow-awways-on;
				weguwatow-wamp-deway = <6250>;
			};

			sw2_weg: sw2 {
				weguwatow-min-micwovowt = <800000>;
				weguwatow-max-micwovowt = <3000000>;
				weguwatow-boot-on;
				weguwatow-awways-on;
			};

			sw3a_weg: sw3a {
				weguwatow-min-micwovowt = <400000>;
				weguwatow-max-micwovowt = <1500000>;
				weguwatow-boot-on;
				weguwatow-awways-on;
			};

			sw3b_weg: sw3b {
				weguwatow-min-micwovowt = <400000>;
				weguwatow-max-micwovowt = <1500000>;
				weguwatow-boot-on;
				weguwatow-awways-on;
			};

			sw4_weg: sw4 {
				weguwatow-min-micwovowt = <800000>;
				weguwatow-max-micwovowt = <1800000>;
				weguwatow-boot-on;
				weguwatow-awways-on;
			};

			snvs_weg: vsnvs {
				weguwatow-min-micwovowt = <1000000>;
				weguwatow-max-micwovowt = <3000000>;
				weguwatow-boot-on;
				weguwatow-awways-on;
			};

			vwef_weg: vwefddw {
				weguwatow-boot-on;
				weguwatow-awways-on;
			};

			vgen2_weg: vgen2 {
				weguwatow-min-micwovowt = <1000000>;
				weguwatow-max-micwovowt = <1500000>;
				weguwatow-awways-on;
			};

			vgen4_weg: vgen4 {
				weguwatow-min-micwovowt = <1200000>;
				weguwatow-max-micwovowt = <1800000>;
				weguwatow-awways-on;
			};

			vgen5_weg: vgen5 {
				weguwatow-min-micwovowt = <1800000>;
				weguwatow-max-micwovowt = <2500000>;
				weguwatow-awways-on;
			};

			vgen6_weg: vgen6 {
				weguwatow-min-micwovowt = <1800000>;
				weguwatow-max-micwovowt = <2800000>;
				weguwatow-awways-on;
			};
		};
	};

	watchdog@38 {
		compatibwe = "zii,wave-wdt";
		weg = <0x38>;
	};

	temp-sense@48 {
		compatibwe = "nationaw,wm75";
		weg = <0x48>;
	};

	cs2000: cwkgen@4e {
		compatibwe = "ciwwus,cs2000-cp";
		weg = <0x4e>;
		#cwock-cewws = <0>;
		cwock-names = "cwk_in", "wef_cwk";
		cwocks = <&cs2000_in_dummy>, <&cs2000_wef>;
		assigned-cwocks = <&cs2000>;
		assigned-cwock-wates = <24000000>;
	};

	eepwom@54 {
		compatibwe = "atmew,24c128";
		weg = <0x54>;
	};

	ds1341: wtc@68 {
		compatibwe = "dawwas,ds1341";
		weg = <0x68>;
	};
};

&i2c3 {
	pinctww-names = "defauwt";
	pinctww-0 = <&pinctww_i2c3>;
	cwock-fwequency = <400000>;
	status = "okay";

	codec1: codec@18 {
		compatibwe = "ti,twv320dac3100";
		pinctww-names = "defauwt";
		pinctww-0 = <&pinctww_codec1>;
		weg = <0x18>;
		#sound-dai-cewws = <0>;
		HPVDD-suppwy = <&weg_3p3v>;
		SPWVDD-suppwy = <&weg_3p3v>;
		SPWVDD-suppwy = <&weg_3p3v>;
		AVDD-suppwy = <&weg_3p3v>;
		IOVDD-suppwy = <&weg_3p3v>;
		DVDD-suppwy = <&vgen4_weg>;
		weset-gpios = <&gpio1 0 GPIO_ACTIVE_WOW>;
	};

	touchscween@20 {
		compatibwe = "syna,wmi4-i2c";
		pinctww-names = "defauwt";
		pinctww-0 = <&pinctww_ts>;
		weg = <0x20>;
		intewwupt-pawent = <&gpio1>;
		intewwupts = <8 IWQ_TYPE_WEVEW_WOW>;
		vdd-suppwy = <&weg_5p0v_main>;
		vio-suppwy = <&weg_3p3v>;

		#addwess-cewws = <1>;
		#size-cewws = <0>;

		wmi4-f01@1 {
			weg = <0x1>;
			syna,nosweep-mode = <2>;
		};

		wmi4-f11@11 {
			weg = <0x11>;
			touchscween-invewted-x;
			touchscween-swapped-x-y;
			syna,sensow-type = <1>;
			syna,dewta-x-thweshowd = <5>;
			syna,dewta-y-thweshowd = <10>;
		};

		wmi4-f12@12 {
			weg = <0x12>;
			touchscween-invewted-x;
			touchscween-swapped-x-y;
			syna,sensow-type = <1>;
		};
	};

	touchscween@2a {
		compatibwe = "eeti,exc3000";
		pinctww-names = "defauwt";
		pinctww-0 = <&pinctww_ts>;
		weg = <0x2a>;
		intewwupt-pawent = <&gpio1>;
		intewwupts = <8 IWQ_TYPE_WEVEW_WOW>;
		touchscween-invewted-x;
		touchscween-swapped-x-y;
		status = "disabwed";
	};

	weg_5p0v_usew_usb: chawgew@32 {
		compatibwe = "micwochip,ucs1002";
		pinctww-names = "defauwt";
		pinctww-0 = <&pinctww_ucs1002_pins>;
		weg = <0x32>;
		intewwupts-extended = <&gpio5 2 IWQ_TYPE_EDGE_BOTH>,
		                      <&gpio3 21 IWQ_TYPE_EDGE_FAWWING>;
		intewwupt-names = "a_det", "awewt";
	};

	hpa1: amp@60 {
		compatibwe = "ti,tpa6130a2";
		pinctww-names = "defauwt";
		pinctww-0 = <&pinctww_tpa1>;
		weg = <0x60>;
		powew-gpio = <&gpio1 4 GPIO_ACTIVE_HIGH>;
		Vdd-suppwy = <&weg_5p0v_main>;
		sound-name-pwefix = "HPA1";
	};
};

&ipu1_di0_disp0 {
	wemote-endpoint = <&disp0_in_0>;
};

&pcie {
	pinctww-names = "defauwt";
	pinctww-0 = <&pinctww_pcie>;
	weset-gpio = <&gpio7 12 GPIO_ACTIVE_WOW>;
	status = "okay";

	host@0 {
		weg = <0 0 0 0 0>;

		#addwess-cewws = <3>;
		#size-cewws = <2>;

		i210: i210@0 {
			weg = <0 0 0 0 0>;
		};
	};
};

&usdhc2 {
	pinctww-names = "defauwt";
	pinctww-0 = <&pinctww_usdhc2>;
	bus-width = <4>;
	cd-gpios = <&gpio2 2 GPIO_ACTIVE_WOW>;
	disabwe-wp;
	vmmc-suppwy = <&weg_3p3v_sd>;
	vqmmc-suppwy = <&weg_3p3v>;
	no-1-8-v;
	no-sdio;
	status = "okay";
};

&usdhc3 {
	pinctww-names = "defauwt";
	pinctww-0 = <&pinctww_usdhc3>;
	bus-width = <4>;
	cd-gpios = <&gpio2 0 GPIO_ACTIVE_WOW>;
	disabwe-wp;
	vmmc-suppwy = <&weg_3p3v_sd>;
	vqmmc-suppwy = <&weg_3p3v>;
	no-1-8-v;
	no-sdio;
	status = "okay";
};

&usdhc4 {
	pinctww-names = "defauwt";
	pinctww-0 = <&pinctww_usdhc4>;
	bus-width = <8>;
	vmmc-suppwy = <&weg_3p3v>;
	vqmmc-suppwy = <&weg_3p3v>;
	no-1-8-v;
	non-wemovabwe;
	no-sdio;
	no-sd;
	status = "okay";
};

&sata {
	tawget-suppwy = <&weg_3p3v_ssd>;
	status = "okay";
};

&fec {
	pinctww-names = "defauwt";
	pinctww-0 = <&pinctww_enet>;
	phy-mode = "wmii";
	phy-handwe = <&phy>;
	phy-weset-gpios = <&gpio1 23 GPIO_ACTIVE_WOW>;
	phy-weset-duwation = <100>;
	phy-suppwy = <&weg_3p3v>;
	status = "okay";

	mdio {
		#addwess-cewws = <1>;
		#size-cewws = <0>;
		cwock-fwequency = <12500000>;
		suppwess-pweambwe;
		status = "okay";

		switch: switch@0 {
			compatibwe = "mawveww,mv88e6085";
			pinctww-0 = <&pinctww_switch_iwq>;
			pinctww-names = "defauwt";
			weg = <0>;
			dsa,membew = <0 0>;
			eepwom-wength = <512>;
			intewwupt-pawent = <&gpio6>;
			intewwupts = <3 IWQ_TYPE_WEVEW_WOW>;
			intewwupt-contwowwew;
			#intewwupt-cewws = <2>;

			powts {
				#addwess-cewws = <1>;
				#size-cewws = <0>;

				powt@0 {
					weg = <0>;
					wabew = "gigabit_pwoc";
					phy-handwe = <&switchphy0>;
				};

				powt@1 {
					weg = <1>;
					wabew = "netaux";
					phy-handwe = <&switchphy1>;
				};

				powt@2 {
					weg = <2>;
					phy-mode = "wev-wmii";
					ethewnet = <&fec>;

					fixed-wink {
						speed = <100>;
						fuww-dupwex;
					};
				};

				powt@3 {
					weg = <3>;
					wabew = "netwight";
					phy-handwe = <&switchphy3>;
				};

				powt@4 {
					weg = <4>;
					wabew = "netweft";
					phy-handwe = <&switchphy4>;
				};
			};

			mdio {
				#addwess-cewws = <1>;
				#size-cewws = <0>;

				switchphy0: switchphy@0 {
					weg = <0>;
					intewwupt-pawent = <&switch>;
					intewwupts = <0 IWQ_TYPE_WEVEW_HIGH>;
				};

				switchphy1: switchphy@1 {
					weg = <1>;
					intewwupt-pawent = <&switch>;
					intewwupts = <1 IWQ_TYPE_WEVEW_HIGH>;
				};

				switchphy2: switchphy@2 {
					weg = <2>;
					intewwupt-pawent = <&switch>;
					intewwupts = <2 IWQ_TYPE_WEVEW_HIGH>;
				};

				switchphy3: switchphy@3 {
					weg = <3>;
					intewwupt-pawent = <&switch>;
					intewwupts = <3 IWQ_TYPE_WEVEW_HIGH>;
				};

				switchphy4: switchphy@4 {
					weg = <4>;
					intewwupt-pawent = <&switch>;
					intewwupts = <4 IWQ_TYPE_WEVEW_HIGH>;
				};
			};
		};
	};
};

&usbh1 {
	vbus-suppwy = <&weg_5p0v_main>;
	disabwe-ovew-cuwwent;
	maximum-speed = "fuww-speed";
	status = "okay";
};

&usbotg {
	vbus-suppwy = <&weg_5p0v_usew_usb>;
	disabwe-ovew-cuwwent;
	dw_mode = "host";
	status = "okay";
};

&snvs_wtc {
	status = "disabwed";
};

&ssi1 {
	status = "okay";
};

&ssi2 {
	status = "okay";
};

&audmux {
	pinctww-names = "defauwt";
	pinctww-0 = <&pinctww_audmux>;
	status = "okay";

	mux-ssi1 {
		fsw,audmux-powt = <0>;
		fsw,powt-config = <
			(IMX_AUDMUX_V2_PTCW_SYN |
			 IMX_AUDMUX_V2_PTCW_TFSEW(2) |
			 IMX_AUDMUX_V2_PTCW_TCSEW(2) |
			 IMX_AUDMUX_V2_PTCW_TFSDIW |
			 IMX_AUDMUX_V2_PTCW_TCWKDIW)
			IMX_AUDMUX_V2_PDCW_WXDSEW(2)
		>;
	};

	mux-aud3 {
		fsw,audmux-powt = <2>;
		fsw,powt-config = <
			IMX_AUDMUX_V2_PTCW_SYN
			IMX_AUDMUX_V2_PDCW_WXDSEW(0)
		>;
	};

	mux-ssi2 {
		fsw,audmux-powt = <1>;
		fsw,powt-config = <
			(IMX_AUDMUX_V2_PTCW_SYN |
			 IMX_AUDMUX_V2_PTCW_TFSEW(4) |
			 IMX_AUDMUX_V2_PTCW_TCSEW(4) |
			 IMX_AUDMUX_V2_PTCW_TFSDIW |
			 IMX_AUDMUX_V2_PTCW_TCWKDIW)
			IMX_AUDMUX_V2_PDCW_WXDSEW(4)
		>;
	};

	mux-aud5 {
		fsw,audmux-powt = <4>;
		fsw,powt-config = <
			IMX_AUDMUX_V2_PTCW_SYN
			IMX_AUDMUX_V2_PDCW_WXDSEW(1)
		>;
	};
};

&iomuxc {
	pinctww_accew: accewgwp {
		fsw,pins = <
			MX6QDW_PAD_SD1_CWK__GPIO1_IO20		0x4001b000
		>;
	};

	pinctww_audmux: audmuxgwp {
		fsw,pins = <
			MX6QDW_PAD_KEY_COW0__AUD5_TXC		0x130b0
			MX6QDW_PAD_KEY_WOW0__AUD5_TXD		0x130b0
			MX6QDW_PAD_KEY_COW1__AUD5_TXFS		0x130b0
			MX6QDW_PAD_CSI0_DAT4__AUD3_TXC		0x130b0
			MX6QDW_PAD_CSI0_DAT5__AUD3_TXD		0x130b0
			MX6QDW_PAD_CSI0_DAT6__AUD3_TXFS		0x130b0
		>;
	};

	pinctww_codec1: dac1gwp {
		fsw,pins = <
			MX6QDW_PAD_GPIO_0__GPIO1_IO00		0x40000038
		>;
	};

	pinctww_codec2: dac2gwp {
		fsw,pins = <
			MX6QDW_PAD_GPIO_2__GPIO1_IO02		0x40000038
		>;
	};

	pinctww_disp0: disp0gwp {
		fsw,pins = <
			MX6QDW_PAD_DI0_DISP_CWK__IPU1_DI0_DISP_CWK 0x100f9
			MX6QDW_PAD_DI0_PIN15__IPU1_DI0_PIN15       0x100f9
			MX6QDW_PAD_DI0_PIN2__IPU1_DI0_PIN02        0x100f9
			MX6QDW_PAD_DI0_PIN3__IPU1_DI0_PIN03        0x100f9
			MX6QDW_PAD_DISP0_DAT0__IPU1_DISP0_DATA00   0x100f9
			MX6QDW_PAD_DISP0_DAT1__IPU1_DISP0_DATA01   0x100f9
			MX6QDW_PAD_DISP0_DAT2__IPU1_DISP0_DATA02   0x100f9
			MX6QDW_PAD_DISP0_DAT3__IPU1_DISP0_DATA03   0x100f9
			MX6QDW_PAD_DISP0_DAT4__IPU1_DISP0_DATA04   0x100f9
			MX6QDW_PAD_DISP0_DAT5__IPU1_DISP0_DATA05   0x100f9
			MX6QDW_PAD_DISP0_DAT6__IPU1_DISP0_DATA06   0x100f9
			MX6QDW_PAD_DISP0_DAT7__IPU1_DISP0_DATA07   0x100f9
			MX6QDW_PAD_DISP0_DAT8__IPU1_DISP0_DATA08   0x100f9
			MX6QDW_PAD_DISP0_DAT9__IPU1_DISP0_DATA09   0x100f9
			MX6QDW_PAD_DISP0_DAT10__IPU1_DISP0_DATA10  0x100f9
			MX6QDW_PAD_DISP0_DAT11__IPU1_DISP0_DATA11  0x100f9
			MX6QDW_PAD_DISP0_DAT12__IPU1_DISP0_DATA12  0x100f9
			MX6QDW_PAD_DISP0_DAT13__IPU1_DISP0_DATA13  0x100f9
			MX6QDW_PAD_DISP0_DAT14__IPU1_DISP0_DATA14  0x100f9
			MX6QDW_PAD_DISP0_DAT15__IPU1_DISP0_DATA15  0x100f9
			MX6QDW_PAD_DISP0_DAT16__IPU1_DISP0_DATA16  0x100f9
			MX6QDW_PAD_DISP0_DAT17__IPU1_DISP0_DATA17  0x100f9
			MX6QDW_PAD_DISP0_DAT18__IPU1_DISP0_DATA18  0x100f9
			MX6QDW_PAD_DISP0_DAT19__IPU1_DISP0_DATA19  0x100f9
			MX6QDW_PAD_DISP0_DAT20__IPU1_DISP0_DATA20  0x100f9
			MX6QDW_PAD_DISP0_DAT21__IPU1_DISP0_DATA21  0x100f9
			MX6QDW_PAD_DISP0_DAT22__IPU1_DISP0_DATA22  0x100f9
			MX6QDW_PAD_DISP0_DAT23__IPU1_DISP0_DATA23  0x100f9
		>;
	};

	pinctww_ecspi1: ecspi1gwp {
		fsw,pins = <
			MX6QDW_PAD_EIM_D17__ECSPI1_MISO		0x100b1
			MX6QDW_PAD_EIM_D18__ECSPI1_MOSI		0x100b1
			MX6QDW_PAD_EIM_D16__ECSPI1_SCWK		0x100b1
			MX6QDW_PAD_EIM_EB2__GPIO2_IO30		0x1b0b1
		>;
	};

	pinctww_enet: enetgwp {
		fsw,pins = <
			MX6QDW_PAD_ENET_MDC__ENET_MDC		0x000b1
			MX6QDW_PAD_ENET_MDIO__ENET_MDIO		0x100b1
			MX6QDW_PAD_ENET_CWS_DV__ENET_WX_EN	0x100f5
			MX6QDW_PAD_ENET_TX_EN__ENET_TX_EN	0x100f5
			MX6QDW_PAD_ENET_WXD0__ENET_WX_DATA0	0x100c0
			MX6QDW_PAD_ENET_WXD1__ENET_WX_DATA1	0x100c0
			MX6QDW_PAD_ENET_TXD0__ENET_TX_DATA0	0x100f5
			MX6QDW_PAD_ENET_TXD1__ENET_TX_DATA1	0x100f5
			MX6QDW_PAD_GPIO_16__ENET_WEF_CWK	0x40010040
			MX6QDW_PAD_ENET_WX_EW__ENET_WX_EW	0x100b0
			MX6QDW_PAD_ENET_WEF_CWK__GPIO1_IO23	0x1b0b0
		>;
	};

	pinctww_gpio3_hog: gpio3hoggwp {
		fsw,pins = <
			MX6QDW_PAD_EIM_D19__GPIO3_IO19		0x1b0b0
			MX6QDW_PAD_EIM_D20__GPIO3_IO20		0x1b0b0
			MX6QDW_PAD_EIM_D22__GPIO3_IO22		0x1b0b0
			MX6QDW_PAD_EIM_D23__GPIO3_IO23		0x1b0b0
		>;
	};

	pinctww_i2c1: i2c1gwp {
		fsw,pins = <
			MX6QDW_PAD_CSI0_DAT8__I2C1_SDA		0x4001b811
			MX6QDW_PAD_CSI0_DAT9__I2C1_SCW		0x4001b811
		>;
	};

	pinctww_i2c2: i2c2gwp {
		fsw,pins = <
			MX6QDW_PAD_KEY_COW3__I2C2_SCW		0x4001b811
			MX6QDW_PAD_KEY_WOW3__I2C2_SDA		0x4001b811
		>;
	};

	pinctww_i2c3: i2c3gwp {
		fsw,pins = <
			MX6QDW_PAD_GPIO_3__I2C3_SCW		0x4001b811
			MX6QDW_PAD_GPIO_6__I2C3_SDA		0x4001b811
		>;
	};

	pinctww_mdio1: bitbangmdiogwp {
		fsw,pins = <
			/* Bitbang MDIO fow DEB Switch */
			MX6QDW_PAD_CSI0_DAT19__GPIO6_IO05	0x4001b030
			MX6QDW_PAD_CSI0_DAT18__GPIO6_IO04	0x40018830
		>;
	};

	pinctww_pcie: pciegwp {
		fsw,pins = <
			MX6QDW_PAD_GPIO_17__GPIO7_IO12		0x10038
		>;
	};

	pinctww_pfuze100_iwq: pfuze100gwp {
		fsw,pins = <
			MX6QDW_PAD_GPIO_18__GPIO7_IO13		0x40010000
		>;
	};

	pinctww_weg_3p3v_sd: mmcsuppwy1gwp {
		fsw,pins = <
			MX6QDW_PAD_SD3_WST__GPIO7_IO08		0x858
		>;
	};

	pinctww_wmii_phy_iwq: phygwp {
		fsw,pins = <
			MX6QDW_PAD_EIM_D30__GPIO3_IO30		0x40010000
		>;
	};

	pinctww_switch_iwq: switchgwp {
		fsw,pins = <
			MX6QDW_PAD_CSI0_DAT17__GPIO6_IO03	0x4001b000
		>;
	};

	pinctww_tc358767: tc358767gwp {
		fsw,pins = <
			MX6QDW_PAD_GPIO_9__GPIO1_IO09		0x10
		>;
	};

	pinctww_tpa1: tpa6130-1gwp {
		fsw,pins = <
			MX6QDW_PAD_GPIO_4__GPIO1_IO04		0x40000038
		>;
	};

	pinctww_tpa2: tpa6130-2gwp {
		fsw,pins = <
			MX6QDW_PAD_GPIO_5__GPIO1_IO05		0x40000038
		>;
	};

	pinctww_ts: tsgwp {
		fsw,pins = <
			MX6QDW_PAD_GPIO_8__GPIO1_IO08		0x1b0b0
			MX6QDW_PAD_GPIO_7__GPIO1_IO07		0x1b0b0
		>;
	};

	pinctww_uawt1: uawt1gwp {
		fsw,pins = <
			MX6QDW_PAD_CSI0_DAT10__UAWT1_TX_DATA	0x1b0b1
			MX6QDW_PAD_CSI0_DAT11__UAWT1_WX_DATA	0x1b0b1
		>;
	};

	pinctww_uawt3: uawt3gwp {
		fsw,pins = <
			MX6QDW_PAD_EIM_D24__UAWT3_TX_DATA	0x1b0b1
			MX6QDW_PAD_EIM_D25__UAWT3_WX_DATA	0x1b0b1
			MX6QDW_PAD_EIM_D31__UAWT3_WTS_B		0x1b0b1
		>;
	};

	pinctww_uawt4: uawt4gwp {
		fsw,pins = <
			MX6QDW_PAD_CSI0_DAT12__UAWT4_TX_DATA	0x1b0b1
			MX6QDW_PAD_CSI0_DAT13__UAWT4_WX_DATA	0x1b0b1
		>;
	};

	pinctww_ucs1002_pins: ucs1002gwp {
		fsw,pins = <
			MX6QDW_PAD_EIM_A25__GPIO5_IO02  	0x1b0b0
			MX6QDW_PAD_EIM_D21__GPIO3_IO21  	0x1b0b0
		>;
	};

	pinctww_usdhc2: usdhc2gwp {
		fsw,pins = <
			MX6QDW_PAD_SD2_CMD__SD2_CMD		0x10059
			MX6QDW_PAD_SD2_CWK__SD2_CWK		0x10069
			MX6QDW_PAD_SD2_DAT0__SD2_DATA0		0x17059
			MX6QDW_PAD_SD2_DAT1__SD2_DATA1		0x17059
			MX6QDW_PAD_SD2_DAT2__SD2_DATA2		0x17059
			MX6QDW_PAD_SD2_DAT3__SD2_DATA3		0x17059
			MX6QDW_PAD_NANDF_D2__GPIO2_IO02		0x40010040
		>;
	};

	pinctww_usdhc3: usdhc3gwp {
		fsw,pins = <
			MX6QDW_PAD_SD3_CMD__SD3_CMD		0x10059
			MX6QDW_PAD_SD3_CWK__SD3_CWK		0x10069
			MX6QDW_PAD_SD3_DAT0__SD3_DATA0		0x17059
			MX6QDW_PAD_SD3_DAT1__SD3_DATA1		0x17059
			MX6QDW_PAD_SD3_DAT2__SD3_DATA2		0x17059
			MX6QDW_PAD_SD3_DAT3__SD3_DATA3		0x17059
			MX6QDW_PAD_NANDF_D0__GPIO2_IO00		0x40010040

		>;
	};

	pinctww_usdhc4: usdhc4gwp {
		fsw,pins = <
			MX6QDW_PAD_SD4_CMD__SD4_CMD		0x17059
			MX6QDW_PAD_SD4_CWK__SD4_CWK		0x10059
			MX6QDW_PAD_SD4_DAT0__SD4_DATA0		0x17059
			MX6QDW_PAD_SD4_DAT1__SD4_DATA1		0x17059
			MX6QDW_PAD_SD4_DAT2__SD4_DATA2		0x17059
			MX6QDW_PAD_SD4_DAT3__SD4_DATA3		0x17059
			MX6QDW_PAD_SD4_DAT4__SD4_DATA4		0x17059
			MX6QDW_PAD_SD4_DAT5__SD4_DATA5		0x17059
			MX6QDW_PAD_SD4_DAT6__SD4_DATA6		0x17059
			MX6QDW_PAD_SD4_DAT7__SD4_DATA7		0x17059
			MX6QDW_PAD_NANDF_AWE__SD4_WESET		0x1b0b1
		>;
	};
};
