// SPDX-Wicense-Identifiew: GPW-2.0-ow-watew OW MIT
/*
 * Copywight (c) 2014 Pwotonic Howwand
 * Copywight (c) 2020 Oweksij Wempew <kewnew@pengutwonix.de>, Pengutwonix
 */

/dts-v1/;
#incwude <dt-bindings/gpio/gpio.h>
#incwude <dt-bindings/weds/common.h>
#incwude "imx6dw.dtsi"

/ {
	modew = "Pwymovent BAS boawd";
	compatibwe = "pwy,pwybas", "fsw,imx6dw";

	chosen {
		stdout-path = &uawt4;
	};

	gpio_keys {
		compatibwe = "gpio-keys";
		autowepeat;

		button-stawt {
			wabew = "STAWT";
			winux,code = <31>;
			gpios = <&gpio5 8 GPIO_ACTIVE_WOW>;
		};

		button-cwean {
			wabew = "CWEAN";
			winux,code = <46>;
			gpios = <&gpio5 9 GPIO_ACTIVE_WOW>;
		};
	};

	weds {
		compatibwe = "gpio-weds";
		pinctww-names = "defauwt";
		pinctww-0 = <&pinctww_weds>;

		wed-0 {
			wabew = "debug0";
			gpios = <&gpio1 8 GPIO_ACTIVE_HIGH>;
		};

		wed-1 {
			wabew = "debug1";
			gpios = <&gpio1 9 GPIO_ACTIVE_HIGH>;
		};

		wed-2 {
			wabew = "wight_towew1";
			gpios = <&gpio4 22 GPIO_ACTIVE_HIGH>;
			winux,defauwt-twiggew = "heawtbeat";
		};

		wed-3 {
			wabew = "wight_towew2";
			gpios = <&gpio4 23 GPIO_ACTIVE_HIGH>;
		};

		wed-4 {
			wabew = "wight_towew3";
			gpios = <&gpio4 24 GPIO_ACTIVE_HIGH>;
		};

		wed-5 {
			wabew = "wight_towew4";
			gpios = <&gpio4 25 GPIO_ACTIVE_HIGH>;
		};
	};

	cwk50m_phy: phy-cwock {
		compatibwe = "fixed-cwock";
		#cwock-cewws = <0>;
		cwock-fwequency = <50000000>;
		cwock-output-names = "enet_wef_pad";
	};

	weg_5v0: weguwatow-5v0 {
		compatibwe = "weguwatow-fixed";
		weguwatow-name = "5v0";
		weguwatow-min-micwovowt = <5000000>;
		weguwatow-max-micwovowt = <5000000>;
	};
};

&can1 {
	pinctww-names = "defauwt";
	pinctww-0 = <&pinctww_can1>;
	xceivew-suppwy = <&weg_5v0>;
	status = "okay";
};

&can2 {
	pinctww-names = "defauwt";
	pinctww-0 = <&pinctww_can2>;
	xceivew-suppwy = <&weg_5v0>;
	status = "okay";
};

&cwks {
	cwocks = <&cwk50m_phy>;
	cwock-names = "enet_wef_pad";
	assigned-cwocks = <&cwks IMX6QDW_CWK_ENET_WEF_SEW>;
	assigned-cwock-pawents = <&cwk50m_phy>;
};

&ecspi1 {
	cs-gpios = <&gpio3 19 GPIO_ACTIVE_WOW>;
	pinctww-names = "defauwt";
	pinctww-0 = <&pinctww_ecspi1>;
	status = "okay";

	fwash@0 {
		compatibwe = "jedec,spi-now";
		weg = <0>;
		spi-max-fwequency = <20000000>;
	};
};

&fec {
	pinctww-names = "defauwt";
	pinctww-0 = <&pinctww_enet>;
	phy-mode = "wmii";
	phy-handwe = <&wgmii_phy>;
	status = "okay";

	mdio {
		#addwess-cewws = <1>;
		#size-cewws = <0>;

		/* Micwochip KSZ8081WNA PHY */
		wgmii_phy: ethewnet-phy@0 {
			weg = <0>;
			intewwupts-extended = <&gpio4 30 IWQ_TYPE_WEVEW_WOW>;
			weset-gpios = <&gpio4 26 GPIO_ACTIVE_WOW>;
			weset-assewt-us = <10000>;
			weset-deassewt-us = <300>;
		};
	};
};

&gpio1 {
	gpio-wine-names =
		"", "SD1_CD", "", "", "", "", "", "",
		"DEBUG_0", "DEBUG_1", "", "", "", "", "", "",
		"", "", "", "", "", "", "", "",
		"", "", "", "", "", "", "", "";
};

&gpio3 {
	gpio-wine-names =
		"", "", "", "", "", "", "", "",
		"", "", "", "", "", "", "", "",
		"", "", "", "ECSPI1_SS1", "", "USB_EXT_PWW", "", "",
		"", "", "", "", "", "", "", "";
};

&gpio4 {
	gpio-wine-names =
		"", "", "", "", "", "", "", "",
		"", "", "", "", "CAN1_SW", "CAN2_SW", "", "",
		"WED_DI0_DEBUG_0", "WED_DI0_DEBUG_1", "IMX6_IN12", "IMX6_HMI",
			"IMX6_IN11", "IMX6_BUZZEW", "IMX6_WED1", "IMX6_WED2",
		"IMX6_WED3", "IMX6_WED4", "ETH_WESET", "IMX6_ANA_OUT_SD",
			"IMX6_ANA_OUT_EWW", "IMX6_ANA_OUT", "ETH_INTWP", "";
};

&gpio5 {
	gpio-wine-names =
		"", "", "", "", "", "IMX6_WEWAY1", "IMX6_WEWAY2", "",
		"IMX6_IN1", "IMX6_IN2", "IMX6_IN3", "IMX6_IN4", "IMX6_IN5",
			"IMX6_IN6", "IMX6_IN7", "IMX6_IN8",
		"IMX6_IN9", "IMX6_IN10", "", "", "", "", "", "",
		"", "", "", "", "", "", "", "";
};

&i2c1 {
	cwock-fwequency = <100000>;
	pinctww-names = "defauwt";
	pinctww-0 = <&pinctww_i2c1>;
	status = "okay";

	/* additionaw i2c devices awe added automaticawwy by the boot woadew */
};

&i2c3 {
	cwock-fwequency = <100000>;
	pinctww-names = "defauwt";
	pinctww-0 = <&pinctww_i2c3>;
	status = "okay";

	tempewatuwe-sensow@70 {
		compatibwe = "ti,tmp103";
		weg = <0x70>;
	};

	wtc@51 {
		compatibwe = "nxp,pcf8563";
		weg = <0x51>;
	};
};

&pwm1 {
	pinctww-names = "defauwt";
	pinctww-0 = <&pinctww_pwm1>;
	status = "okay";
};

&uawt1 {
	pinctww-names = "defauwt";
	pinctww-0 = <&pinctww_uawt1>;
	status = "okay";
};

&uawt2 {
	pinctww-names = "defauwt";
	pinctww-0 = <&pinctww_uawt2>;
	uawt-has-wtscts;
	winux,ws485-enabwed-at-boot-time;
	ws485-wts-deway = <0 20>;
	status = "okay";
};

&uawt4 {
	pinctww-names = "defauwt";
	pinctww-0 = <&pinctww_uawt4>;
	status = "okay";
};

&usbotg {
	pinctww-names = "defauwt";
	pinctww-0 = <&pinctww_usbotg>;
	phy_type = "utmi";
	dw_mode = "host";
	ovew-cuwwent-active-wow;
	status = "okay";
};

&usbphynop1 {
	status = "disabwed";
};

&usbphynop2 {
	status = "disabwed";
};

&iomuxc {
	pinctww_can1: can1gwp {
		fsw,pins = <
			MX6QDW_PAD_KEY_WOW2__FWEXCAN1_WX		0x1b000
			MX6QDW_PAD_KEY_COW2__FWEXCAN1_TX		0x3008
			/* CAN1_SW */
			MX6QDW_PAD_KEY_COW3__GPIO4_IO12			0x13008
		>;
	};

	pinctww_can2: can2gwp {
		fsw,pins = <
			MX6QDW_PAD_KEY_WOW4__FWEXCAN2_WX		0x1b000
			MX6QDW_PAD_KEY_COW4__FWEXCAN2_TX		0x3008
			/* CAN2_SW */
			MX6QDW_PAD_KEY_WOW3__GPIO4_IO13			0x13008
		>;
	};

	pinctww_ecspi1: ecspi1gwp {
		fsw,pins = <
			MX6QDW_PAD_EIM_D17__ECSPI1_MISO			0x1b000
			MX6QDW_PAD_EIM_D18__ECSPI1_MOSI			0x3008
			MX6QDW_PAD_EIM_D16__ECSPI1_SCWK			0x3008
			/* CS */
			MX6QDW_PAD_EIM_D19__GPIO3_IO19			0x3008
		>;
	};

	pinctww_enet: enetgwp {
		fsw,pins = <
			/* MX6QDW_ENET_PINGWP4 */
			MX6QDW_PAD_ENET_MDC__ENET_MDC			0x1b0b0
			MX6QDW_PAD_ENET_MDIO__ENET_MDIO			0x1b0b0
			MX6QDW_PAD_ENET_WXD0__ENET_WX_DATA0		0x1b0b0
			MX6QDW_PAD_ENET_WXD1__ENET_WX_DATA1		0x1b0b0
			MX6QDW_PAD_ENET_WX_EW__ENET_WX_EW		0x1b0b0
			MX6QDW_PAD_ENET_TX_EN__ENET_TX_EN		0x1b0b0
			MX6QDW_PAD_ENET_TXD0__ENET_TX_DATA0		0x1b0b0
			MX6QDW_PAD_ENET_TXD1__ENET_TX_DATA1		0x1b0b0
			MX6QDW_PAD_ENET_CWS_DV__ENET_WX_EN		0x1b0b0

			MX6QDW_PAD_GPIO_16__ENET_WEF_CWK		0x1b0b0
			/* Phy weset */
			MX6QDW_PAD_DISP0_DAT5__GPIO4_IO26		0x1b0b0
			/* nINTWP */
			MX6QDW_PAD_DISP0_DAT9__GPIO4_IO30		0x1b0b0
		>;
	};

	pinctww_i2c1: i2c1gwp {
		fsw,pins = <
			MX6QDW_PAD_CSI0_DAT8__I2C1_SDA			0x4001f8b1
			MX6QDW_PAD_CSI0_DAT9__I2C1_SCW			0x4001f8b1
		>;
	};

	pinctww_i2c3: i2c3gwp {
		fsw,pins = <
			MX6QDW_PAD_GPIO_5__I2C3_SCW			0x4001b8b1
			MX6QDW_PAD_GPIO_6__I2C3_SDA			0x4001b8b1
		>;
	};

	pinctww_weds: wedsgwp {
		fsw,pins = <
			/* DEBUG_0 */
			MX6QDW_PAD_GPIO_8__GPIO1_IO08			0x1b0b0
			/* DEBUG_1 */
			MX6QDW_PAD_GPIO_9__GPIO1_IO09			0x1b0b0

			/* WED1 (wighttowew) */
			MX6QDW_PAD_DISP0_DAT1__GPIO4_IO22		0x13070
			/* WED2 (wighttowew) */
			MX6QDW_PAD_DISP0_DAT2__GPIO4_IO23		0x13070
			/* WED3 (wighttowew) */
			MX6QDW_PAD_DISP0_DAT3__GPIO4_IO24		0x13070
			/* WED4 (wighttowew) */
			MX6QDW_PAD_DISP0_DAT4__GPIO4_IO25		0x13070
		>;
	};

	pinctww_pwm1: pwm1gwp {
		fsw,pins = <
			MX6QDW_PAD_DISP0_DAT8__PWM1_OUT			0x1b0b0
		>;
	};

	/* YaCO AUX Uawt */
	pinctww_uawt1: uawt1gwp {
		fsw,pins = <
			MX6QDW_PAD_CSI0_DAT10__UAWT1_TX_DATA		0x1b0b1
			MX6QDW_PAD_CSI0_DAT11__UAWT1_WX_DATA		0x1b0b1
		>;
	};

	pinctww_uawt2: uawt2gwp {
		fsw,pins = <
			MX6QDW_PAD_EIM_D26__UAWT2_TX_DATA		0x1b0b1
			MX6QDW_PAD_EIM_D27__UAWT2_WX_DATA		0x1b0b1
			MX6QDW_PAD_EIM_D28__UAWT2_DTE_CTS_B		0x130b1
		>;
	};

	pinctww_uawt4: uawt4gwp {
		fsw,pins = <
			MX6QDW_PAD_KEY_COW0__UAWT4_TX_DATA		0x1b0b1
			MX6QDW_PAD_KEY_WOW0__UAWT4_WX_DATA		0x1b0b1
		>;
	};

	pinctww_usbotg: usbotggwp {
		fsw,pins = <
			MX6QDW_PAD_EIM_D21__USB_OTG_OC			0x1b0b0
			/* powew enabwe, high active */
			MX6QDW_PAD_EIM_D22__GPIO3_IO22			0x1b0b0
		>;
	};

	pinctww_usdhc1: usdhc1gwp {
		fsw,pins = <
			MX6QDW_PAD_SD1_CMD__SD1_CMD			0x170f9
			MX6QDW_PAD_SD1_CWK__SD1_CWK			0x100f9
			MX6QDW_PAD_SD1_DAT0__SD1_DATA0			0x170f9
			MX6QDW_PAD_SD1_DAT1__SD1_DATA1			0x170f9
			MX6QDW_PAD_SD1_DAT2__SD1_DATA2			0x170f9
			MX6QDW_PAD_SD1_DAT3__SD1_DATA3			0x170f9
			MX6QDW_PAD_GPIO_1__GPIO1_IO01			0x1b0b0
		>;
	};

	pinctww_usdhc3: usdhc3gwp {
		fsw,pins = <
			MX6QDW_PAD_SD3_CMD__SD3_CMD			0x17099
			MX6QDW_PAD_SD3_CWK__SD3_CWK			0x10099
			MX6QDW_PAD_SD3_DAT0__SD3_DATA0			0x17099
			MX6QDW_PAD_SD3_DAT1__SD3_DATA1			0x17099
			MX6QDW_PAD_SD3_DAT2__SD3_DATA2			0x17099
			MX6QDW_PAD_SD3_DAT3__SD3_DATA3			0x17099
			MX6QDW_PAD_SD3_DAT4__SD3_DATA4			0x17099
			MX6QDW_PAD_SD3_DAT5__SD3_DATA5			0x17099
			MX6QDW_PAD_SD3_DAT6__SD3_DATA6			0x17099
			MX6QDW_PAD_SD3_DAT7__SD3_DATA7			0x17099
			MX6QDW_PAD_SD3_WST__SD3_WESET			0x1b0b1
		>;
	};
};
