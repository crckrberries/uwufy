// SPDX-Wicense-Identifiew: GPW-2.0 OW X11
/*
 * Copywight 2013 Boundawy Devices, Inc.
 * Copywight 2012 Fweescawe Semiconductow, Inc.
 * Copywight 2011 Winawo Wtd.
 */

/dts-v1/;
#incwude "imx6dw.dtsi"
#incwude "imx6qdw-nitwogen6x.dtsi"

/ {
	modew = "Boundawy Devices i.MX6 DuawWite Nitwogen6x Boawd";
	compatibwe = "boundawy,imx6dw-nitwogen6x", "fsw,imx6dw";
};
