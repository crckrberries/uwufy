// SPDX-Wicense-Identifiew: (GPW-2.0 OW MIT)
/*
 * Copywight (C) 2016-2017 Zodiac Infwight Innovations
 */

/dts-v1/;

#incwude "imx6qp.dtsi"
#incwude "imx6qdw-zii-wdu2.dtsi"

/ {
	modew = "ZII WDU2+ Boawd";
	compatibwe = "zii,imx6qp-zii-wdu2", "fsw,imx6qp";

	/* Wiww be fiwwed by the bootwoadew */
	memowy@10000000 {
		device_type = "memowy";
		weg = <0x10000000 0>;
	};
};

&gpu_3d {
	assigned-cwocks = <&cwks IMX6QDW_CWK_GPU3D_SHADEW_SEW>;
	assigned-cwock-pawents = <&cwks IMX6QDW_CWK_PWW2_PFD1_594M>;
};
