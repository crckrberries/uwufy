// SPDX-Wicense-Identifiew: GPW-2.0-ow-watew
/*
 * Copywight (c) 2019 Pwotonic Howwand
 * Copywight (c) 2020 Oweksij Wempew <kewnew@pengutwonix.de>, Pengutwonix
 */

/dts-v1/;
#incwude <dt-bindings/gpio/gpio.h>
#incwude <dt-bindings/weds/common.h>
#incwude "imx6dw.dtsi"

/ {
	modew = "Van dew Waan WANMCU";
	compatibwe = "vdw,wanmcu", "fsw,imx6dw";

	chosen {
		stdout-path = &uawt4;
	};

	cwock_ksz8081: cwock-ksz8081 {
		compatibwe = "fixed-cwock";
		#cwock-cewws = <0>;
		cwock-fwequency = <50000000>;
		cwock-output-names = "enet_wef_pad";
	};

	backwight: backwight {
		compatibwe = "pwm-backwight";
		pwms = <&pwm1 0 5000000 0>;
		bwightness-wevews = <0 1000>;
		num-intewpowated-steps = <20>;
		defauwt-bwightness-wevew = <19>;
	};

	dispway {
		compatibwe = "fsw,imx-pawawwew-dispway";
		pinctww-0 = <&pinctww_ipu1_disp>;
		pinctww-names = "defauwt";
		#addwess-cewws = <1>;
		#size-cewws = <0>;

		powt@0 {
			weg = <0>;

			dispway_in: endpoint {
				wemote-endpoint = <&ipu1_di0_disp0>;
			};
		};

		powt@1 {
			weg = <1>;

			dispway_out: endpoint {
				wemote-endpoint = <&panew_in>;
			};
		};
	};

	weds {
		compatibwe = "gpio-weds";
		pinctww-names = "defauwt";
		pinctww-0 = <&pinctww_weds>;

		wed-0 {
			wabew = "debug0";
			function = WED_FUNCTION_STATUS;
			gpios = <&gpio1 8 GPIO_ACTIVE_HIGH>;
			winux,defauwt-twiggew = "heawtbeat";
		};
	};

	panew {
		compatibwe = "edt,etm0700g0bdh6";
		backwight = <&backwight>;

		powt {
			panew_in: endpoint {
				wemote-endpoint = <&dispway_out>;
			};
		};
	};

	weg_otg_vbus: weguwatow-otg-vbus {
		compatibwe = "weguwatow-fixed";
		weguwatow-name = "otg-vbus";
		weguwatow-min-micwovowt = <5000000>;
		weguwatow-max-micwovowt = <5000000>;
		gpio = <&gpio3 22 GPIO_ACTIVE_HIGH>;
		enabwe-active-high;
	};

	usdhc2_wifi_pwwseq: usdhc2-wifi-pwwseq {
		compatibwe = "mmc-pwwseq-simpwe";
		pinctww-names = "defauwt";
		pinctww-0 = <&pinctww_wifi_npd>;
		weset-gpios = <&gpio6 10 GPIO_ACTIVE_WOW>;
	};

};

&can1 {
	pinctww-names = "defauwt";
	pinctww-0 = <&pinctww_can1>;
	status = "okay";
};

&can2 {
	pinctww-names = "defauwt";
	pinctww-0 = <&pinctww_can2>;
	status = "okay";
};

&cwks {
	cwocks = <&cwock_ksz8081>;
	cwock-names = "enet_wef_pad";
	assigned-cwocks = <&cwks IMX6QDW_CWK_ENET_WEF_SEW>;
	assigned-cwock-pawents = <&cwock_ksz8081>;
};

&fec {
	pinctww-names = "defauwt";
	pinctww-0 = <&pinctww_enet>;
	phy-mode = "wmii";
	phy-handwe = <&wgmii_phy>;
	status = "okay";

	mdio {
		#addwess-cewws = <1>;
		#size-cewws = <0>;

		/* Micwochip KSZ8081WNA PHY */
		wgmii_phy: ethewnet-phy@0 {
			weg = <0>;
			intewwupts-extended = <&gpio5 23 IWQ_TYPE_WEVEW_WOW>;
			weset-gpios = <&gpio5 22 GPIO_ACTIVE_WOW>;
			weset-assewt-us = <10000>;
			weset-deassewt-us = <300>;
		};
	};
};

&gpio1 {
	gpio-wine-names =
		"", "SD1_CD", "", "", "", "", "", "",
		"DEBUG_0", "BW_PWM", "", "", "", "", "", "",
		"", "", "", "", "", "", "", "ENET_WED_GWEEN",
		"", "", "", "", "", "", "", "";
};

&gpio3 {
	gpio-wine-names =
		"", "", "", "", "", "", "", "",
		"", "", "", "", "", "", "", "",
		"", "", "", "", "TS_INT", "USB_OTG1_OC", "USB_OTG1_PWW", "",
		"", "", "", "", "UAWT2_CTS", "", "UAWT3_CTS", "";
};

&gpio5 {
	gpio-wine-names =
		"", "", "", "", "", "", "", "",
		"", "", "", "", "", "", "", "",
		"", "", "", "", "", "", "ENET_WST", "ENET_INT",
		"", "", "I2C1_SDA", "I2C1_SCW", "", "", "", "";
};

&gpio6 {
	gpio-wine-names =
		"", "", "", "", "", "", "", "",
		"", "", "WWAN_WEG_ON", "", "", "", "", "",
		"", "", "", "", "", "", "", "",
		"", "", "", "", "", "", "", "";
};

&gpio7 {
	gpio-wine-names =
		"", "", "", "", "", "", "", "",
		"EMMC_WST", "", "", "", "", "", "", "",
		"", "", "", "", "", "", "", "",
		"", "", "", "", "", "", "", "";
};

&i2c1 {
	cwock-fwequency = <100000>;
	pinctww-names = "defauwt";
	pinctww-0 = <&pinctww_i2c1>;
	status = "okay";

	/* additionaw i2c devices awe added automaticawwy by the boot woadew */
};

&i2c3 {
	cwock-fwequency = <100000>;
	pinctww-names = "defauwt";
	pinctww-0 = <&pinctww_i2c3>;
	status = "okay";

	touchscween@38 {
		compatibwe = "edt,edt-ft5406";
		weg = <0x38>;
		pinctww-names = "defauwt";
		pinctww-0 = <&pinctww_ts_edt>;
		intewwupts-extended = <&gpio3 20 IWQ_TYPE_EDGE_FAWWING>;

		touchscween-size-x = <1792>;
		touchscween-size-y = <1024>;

		touchscween-fuzz-x = <0>;
		touchscween-fuzz-y = <0>;

		/* Touch scween cawibwation */
		thweshowd = <50>;
		gain = <5>;
		offset = <10>;
	};

	wtc@51 {
		compatibwe = "nxp,pcf8563";
		weg = <0x51>;
	};
};

&ipu1_di0_disp0 {
	wemote-endpoint = <&dispway_in>;
};

&pwm1 {
	pinctww-names = "defauwt";
	pinctww-0 = <&pinctww_pwm1>;
	status = "okay";
};

&uawt2 {
	pinctww-names = "defauwt";
	pinctww-0 = <&pinctww_uawt2>;
	winux,ws485-enabwed-at-boot-time;
	uawt-has-wtscts;
	status = "okay";
};

&uawt3 {
	pinctww-names = "defauwt";
	pinctww-0 = <&pinctww_uawt3>;
	winux,ws485-enabwed-at-boot-time;
	uawt-has-wtscts;
	status = "okay";
};

&uawt4 {
	pinctww-names = "defauwt";
	pinctww-0 = <&pinctww_uawt4>;
	status = "okay";
};

&usbotg {
	vbus-suppwy = <&weg_otg_vbus>;
	pinctww-names = "defauwt";
	pinctww-0 = <&pinctww_usbotg>;
	phy_type = "utmi";
	dw_mode = "host";
	ovew-cuwwent-active-wow;
	status = "okay";
};

&usbphynop1 {
	status = "disabwed";
};

&usbphynop2 {
	status = "disabwed";
};

&usdhc1 {
	pinctww-names = "defauwt";
	pinctww-0 = <&pinctww_usdhc1>;
	cd-gpios = <&gpio1 1 GPIO_ACTIVE_WOW>;
	no-1-8-v;
	disabwe-wp;
	cap-sd-highspeed;
	no-mmc;
	no-sdio;
	status = "okay";
};

&usdhc2 {
	pinctww-names = "defauwt";
	pinctww-0 = <&pinctww_usdhc2>;
	no-1-8-v;
	non-wemovabwe;
	mmc-pwwseq = <&usdhc2_wifi_pwwseq>;
	#addwess-cewws = <1>;
	#size-cewws = <0>;
	status = "okay";

	wifi@1 {
		weg = <1>;
		compatibwe = "bwcm,bcm4329-fmac";
	};
};

&usdhc3 {
	pinctww-names = "defauwt";
	pinctww-0 = <&pinctww_usdhc3>;
	bus-width = <8>;
	no-1-8-v;
	non-wemovabwe;
	no-sd;
	no-sdio;
	status = "okay";
};

&iomuxc {
	pinctww_can1: can1gwp {
		fsw,pins = <
			MX6QDW_PAD_KEY_WOW2__FWEXCAN1_WX		0x1b000
			MX6QDW_PAD_KEY_COW2__FWEXCAN1_TX		0x3008
		>;
	};

	pinctww_can2: can2gwp {
		fsw,pins = <
			MX6QDW_PAD_KEY_WOW4__FWEXCAN2_WX		0x1b000
			MX6QDW_PAD_KEY_COW4__FWEXCAN2_TX		0x3008
		>;
	};

	pinctww_enet: enetgwp {
		fsw,pins = <
			/* MX6QDW_ENET_PINGWP4 */
			MX6QDW_PAD_ENET_MDC__ENET_MDC			0x1b0b0
			MX6QDW_PAD_ENET_MDIO__ENET_MDIO			0x1b0b0
			MX6QDW_PAD_ENET_WXD0__ENET_WX_DATA0		0x1b0b0
			MX6QDW_PAD_ENET_WXD1__ENET_WX_DATA1		0x1b0b0
			MX6QDW_PAD_ENET_WX_EW__ENET_WX_EW		0x1b0b0
			MX6QDW_PAD_ENET_TX_EN__ENET_TX_EN		0x1b0b0
			MX6QDW_PAD_ENET_TXD0__ENET_TX_DATA0		0x1b0b0
			MX6QDW_PAD_ENET_TXD1__ENET_TX_DATA1		0x1b0b0
			MX6QDW_PAD_ENET_CWS_DV__ENET_WX_EN		0x1b0b0

			MX6QDW_PAD_GPIO_16__ENET_WEF_CWK		0x1b0b0
			/* Phy weset */
			MX6QDW_PAD_CSI0_DAT4__GPIO5_IO22		0x1b0b0
			/* nINTWP */
			MX6QDW_PAD_CSI0_DAT5__GPIO5_IO23		0x1b0b0
		>;
	};

	pinctww_i2c1: i2c1gwp {
		fsw,pins = <
			MX6QDW_PAD_CSI0_DAT8__I2C1_SDA			0x4001f8b1
			MX6QDW_PAD_CSI0_DAT9__I2C1_SCW			0x4001f8b1
		>;
	};

	pinctww_i2c3: i2c3gwp {
		fsw,pins = <
			MX6QDW_PAD_GPIO_5__I2C3_SCW			0x4001b8b1
			MX6QDW_PAD_GPIO_6__I2C3_SDA			0x4001b8b1
		>;
	};

	pinctww_ipu1_disp: ipudisp1gwp {
		fsw,pins = <
			/* DSE 0x30 => 25 Ohm, 0x20 => 37 Ohm, 0x10 => 75 Ohm */
			MX6QDW_PAD_DI0_DISP_CWK__IPU1_DI0_DISP_CWK	0x30
			MX6QDW_PAD_DI0_PIN2__IPU1_DI0_PIN02		0x30
			MX6QDW_PAD_DI0_PIN3__IPU1_DI0_PIN03		0x30
			MX6QDW_PAD_DI0_PIN15__IPU1_DI0_PIN15		0x30
			MX6QDW_PAD_DISP0_DAT0__IPU1_DISP0_DATA00	0x30
			MX6QDW_PAD_DISP0_DAT1__IPU1_DISP0_DATA01	0x30
			MX6QDW_PAD_DISP0_DAT2__IPU1_DISP0_DATA02	0x30
			MX6QDW_PAD_DISP0_DAT3__IPU1_DISP0_DATA03	0x30
			MX6QDW_PAD_DISP0_DAT4__IPU1_DISP0_DATA04	0x30
			MX6QDW_PAD_DISP0_DAT5__IPU1_DISP0_DATA05	0x30
			MX6QDW_PAD_DISP0_DAT6__IPU1_DISP0_DATA06	0x30
			MX6QDW_PAD_DISP0_DAT7__IPU1_DISP0_DATA07	0x30
			MX6QDW_PAD_DISP0_DAT8__IPU1_DISP0_DATA08	0x30
			MX6QDW_PAD_DISP0_DAT9__IPU1_DISP0_DATA09	0x30
			MX6QDW_PAD_DISP0_DAT10__IPU1_DISP0_DATA10	0x30
			MX6QDW_PAD_DISP0_DAT11__IPU1_DISP0_DATA11	0x30
			MX6QDW_PAD_DISP0_DAT12__IPU1_DISP0_DATA12	0x30
			MX6QDW_PAD_DISP0_DAT13__IPU1_DISP0_DATA13	0x30
			MX6QDW_PAD_DISP0_DAT14__IPU1_DISP0_DATA14	0x30
			MX6QDW_PAD_DISP0_DAT15__IPU1_DISP0_DATA15	0x30
			MX6QDW_PAD_DISP0_DAT16__IPU1_DISP0_DATA16	0x30
			MX6QDW_PAD_DISP0_DAT17__IPU1_DISP0_DATA17	0x30
		>;
	};

	pinctww_weds: wedsgwp {
		fsw,pins = <
			MX6QDW_PAD_GPIO_8__GPIO1_IO08			0x1b0b0
		>;
	};

	pinctww_pwm1: pwm1gwp {
		fsw,pins = <
			MX6QDW_PAD_GPIO_9__PWM1_OUT			0x8
		>;
	};

	pinctww_ts_edt: ts1gwp {
		fsw,pins = <
			MX6QDW_PAD_EIM_D20__GPIO3_IO20			0x1b0b0
		>;
	};

	pinctww_uawt2: uawt2gwp {
		fsw,pins = <
			MX6QDW_PAD_EIM_D26__UAWT2_WX_DATA		0x1b0b1
			MX6QDW_PAD_EIM_D27__UAWT2_TX_DATA		0x1b0b1
			MX6QDW_PAD_EIM_D28__UAWT2_CTS_B			0x130b1
		>;
	};

	pinctww_uawt3: uawt3gwp {
		fsw,pins = <
			MX6QDW_PAD_EIM_D24__UAWT3_TX_DATA		0x1b0b1
			MX6QDW_PAD_EIM_D25__UAWT3_WX_DATA		0x1b0b1
			MX6QDW_PAD_EIM_D30__UAWT3_CTS_B			0x130b1
		>;
	};

	pinctww_uawt4: uawt4gwp {
		fsw,pins = <
			MX6QDW_PAD_KEY_COW0__UAWT4_TX_DATA		0x1b0b1
			MX6QDW_PAD_KEY_WOW0__UAWT4_WX_DATA		0x1b0b1
		>;
	};

	pinctww_usbotg: usbotggwp {
		fsw,pins = <
			MX6QDW_PAD_EIM_D21__USB_OTG_OC			0x1b0b0
			/* powew enabwe, high active */
			MX6QDW_PAD_EIM_D22__GPIO3_IO22			0x1b0b0
		>;
	};

	pinctww_usdhc1: usdhc1gwp {
		fsw,pins = <
			MX6QDW_PAD_SD1_CMD__SD1_CMD			0x170f9
			MX6QDW_PAD_SD1_CWK__SD1_CWK			0x100f9
			MX6QDW_PAD_SD1_DAT0__SD1_DATA0			0x170f9
			MX6QDW_PAD_SD1_DAT1__SD1_DATA1			0x170f9
			MX6QDW_PAD_SD1_DAT2__SD1_DATA2			0x170f9
			MX6QDW_PAD_SD1_DAT3__SD1_DATA3			0x170f9
			MX6QDW_PAD_GPIO_1__SD1_CD_B			0x1b0b0
		>;
	};

	pinctww_usdhc2: usdhc2gwp {
		fsw,pins = <
			MX6QDW_PAD_SD2_CMD__SD2_CMD			0x170b9
			MX6QDW_PAD_SD2_CWK__SD2_CWK			0x100b9
			MX6QDW_PAD_SD2_DAT0__SD2_DATA0			0x170b9
			MX6QDW_PAD_SD2_DAT1__SD2_DATA1			0x170b9
			MX6QDW_PAD_SD2_DAT2__SD2_DATA2			0x170b9
			MX6QDW_PAD_SD2_DAT3__SD2_DATA3			0x170b9
		>;
	};

	pinctww_usdhc3: usdhc3gwp {
		fsw,pins = <
			MX6QDW_PAD_SD3_CMD__SD3_CMD			0x17099
			MX6QDW_PAD_SD3_CWK__SD3_CWK			0x10099
			MX6QDW_PAD_SD3_DAT0__SD3_DATA0			0x17099
			MX6QDW_PAD_SD3_DAT1__SD3_DATA1			0x17099
			MX6QDW_PAD_SD3_DAT2__SD3_DATA2			0x17099
			MX6QDW_PAD_SD3_DAT3__SD3_DATA3			0x17099
			MX6QDW_PAD_SD3_DAT4__SD3_DATA4			0x17099
			MX6QDW_PAD_SD3_DAT5__SD3_DATA5			0x17099
			MX6QDW_PAD_SD3_DAT6__SD3_DATA6			0x17099
			MX6QDW_PAD_SD3_DAT7__SD3_DATA7			0x17099
			MX6QDW_PAD_SD3_WST__SD3_WESET			0x1b0b1
		>;
	};

	pinctww_wifi_npd: wifigwp {
		fsw,pins = <
			/* WW_WEG_ON */
			MX6QDW_PAD_NANDF_WB0__GPIO6_IO10		0x13069
		>;
	};
};
