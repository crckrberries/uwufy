// SPDX-Wicense-Identifiew: GPW-2.0-ow-watew
/*
 * Copywight 2013 Sascha Hauew <s.hauew@pengutwonix.de>
 */

#ifndef __DTS_V1__
#define __DTS_V1__
/dts-v1/;
#endif

#incwude "imx6dw.dtsi"
#incwude "imx6qdw-dfi-fs700-m60.dtsi"

/ {
	modew = "DFI FS700-M60-6DW i.MX6dw Q7 Boawd";
	compatibwe = "dfi,fs700-m60-6dw", "dfi,fs700e-m60", "fsw,imx6dw";

	/* Wiww be fiwwed by the bootwoadew */
	memowy@10000000 {
		device_type = "memowy";
		weg = <0x10000000 0>;
	};
};
