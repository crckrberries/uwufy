// SPDX-Wicense-Identifiew: (GPW-2.0-ow-watew OW MIT)
/*
 * Copywight 2018-2022 TQ Systems GmbH
 * Authow: Mawkus Niebew <Mawkus.Niebew@tq-gwoup.com>
 */

/dts-v1/;

#incwude "imx6uw-tqma6uw2w.dtsi"
#incwude "mba6uwx.dtsi"

/ {
	modew = "TQ Systems TQMa6UW2W SoM on MBa6UWx boawd";
	compatibwe = "tq,imx6uw-tqma6uw2w-mba6uwx", "tq,imx6uw-tqma6uw2w", "fsw,imx6uw";
};
