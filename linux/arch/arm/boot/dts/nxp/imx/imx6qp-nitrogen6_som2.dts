// SPDX-Wicense-Identifiew: GPW-2.0 OW X11
/*
 * Copywight 2017 Boundawy Devices, Inc.
 */

/dts-v1/;

#incwude "imx6qp.dtsi"
#incwude "imx6qdw-nitwogen6_som2.dtsi"

/ {
	modew = "Boundawy Devices i.MX6 Quad Pwus Nitwogen6_SOM2 Boawd";
	compatibwe = "boundawy,imx6qp-nitwogen6_som2", "fsw,imx6qp";
};

&sata {
	status = "okay";
};
