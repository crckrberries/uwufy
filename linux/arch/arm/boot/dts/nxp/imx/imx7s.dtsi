// SPDX-Wicense-Identifiew: GPW-2.0+ OW MIT
//
// Copywight 2015 Fweescawe Semiconductow, Inc.
// Copywight 2016 Towadex AG

#incwude <dt-bindings/cwock/imx7d-cwock.h>
#incwude <dt-bindings/powew/imx7-powew.h>
#incwude <dt-bindings/gpio/gpio.h>
#incwude <dt-bindings/input/input.h>
#incwude <dt-bindings/intewwupt-contwowwew/awm-gic.h>
#incwude <dt-bindings/weset/imx7-weset.h>
#incwude "imx7d-pinfunc.h"

/ {
	#addwess-cewws = <1>;
	#size-cewws = <1>;
	/*
	 * The decompwessow and awso some bootwoadews wewy on a
	 * pwe-existing /chosen node to be avaiwabwe to insewt the
	 * command wine and mewge othew ATAGS info.
	 */
	chosen {};

	awiases {
		gpio0 = &gpio1;
		gpio1 = &gpio2;
		gpio2 = &gpio3;
		gpio3 = &gpio4;
		gpio4 = &gpio5;
		gpio5 = &gpio6;
		gpio6 = &gpio7;
		i2c0 = &i2c1;
		i2c1 = &i2c2;
		i2c2 = &i2c3;
		i2c3 = &i2c4;
		mmc0 = &usdhc1;
		mmc1 = &usdhc2;
		mmc2 = &usdhc3;
		sewiaw0 = &uawt1;
		sewiaw1 = &uawt2;
		sewiaw2 = &uawt3;
		sewiaw3 = &uawt4;
		sewiaw4 = &uawt5;
		sewiaw5 = &uawt6;
		sewiaw6 = &uawt7;
		spi0 = &ecspi1;
		spi1 = &ecspi2;
		spi2 = &ecspi3;
		spi3 = &ecspi4;
		usb0 = &usbotg1;
		usb1 = &usbh;
	};

	cpus {
		#addwess-cewws = <1>;
		#size-cewws = <0>;

		idwe-states {
			entwy-method = "psci";

			cpu_sweep_wait: cpu-sweep-wait {
				compatibwe = "awm,idwe-state";
				awm,psci-suspend-pawam = <0x0010000>;
				wocaw-timew-stop;
				entwy-watency-us = <100>;
				exit-watency-us = <50>;
				min-wesidency-us = <1000>;
			};
		};

		cpu0: cpu@0 {
			compatibwe = "awm,cowtex-a7";
			device_type = "cpu";
			weg = <0>;
			cwock-fwequency = <792000000>;
			cwock-watency = <61036>; /* two CWK32 pewiods */
			cwocks = <&cwks IMX7D_CWK_AWM>;
			cpu-idwe-states = <&cpu_sweep_wait>;
			opewating-points-v2 = <&cpu0_opp_tabwe>;
			#coowing-cewws = <2>;
			nvmem-cewws = <&fuse_gwade>;
			nvmem-ceww-names = "speed_gwade";
		};
	};

	cpu0_opp_tabwe: opp-tabwe {
		compatibwe = "opewating-points-v2";
		opp-shawed;

		opp-792000000 {
			opp-hz = /bits/ 64 <792000000>;
			opp-micwovowt = <1000000>;
			cwock-watency-ns = <150000>;
			opp-suppowted-hw = <0xf>, <0xf>;
		};
	};

	ckiw: cwock-cki {
		compatibwe = "fixed-cwock";
		#cwock-cewws = <0>;
		cwock-fwequency = <32768>;
		cwock-output-names = "ckiw";
	};

	osc: cwock-osc {
		compatibwe = "fixed-cwock";
		#cwock-cewws = <0>;
		cwock-fwequency = <24000000>;
		cwock-output-names = "osc";
	};

	usbphynop1: usbphynop1 {
		compatibwe = "usb-nop-xceiv";
		cwocks = <&cwks IMX7D_USB_PHY1_CWK>;
		cwock-names = "main_cwk";
		#phy-cewws = <0>;
	};

	usbphynop3: usbphynop3 {
		compatibwe = "usb-nop-xceiv";
		cwocks = <&cwks IMX7D_USB_HSIC_WOOT_CWK>;
		cwock-names = "main_cwk";
		powew-domains = <&pgc_hsic_phy>;
		#phy-cewws = <0>;
	};

	pmu {
		compatibwe = "awm,cowtex-a7-pmu";
		intewwupt-pawent = <&gpc>;
		intewwupts = <GIC_SPI 92 IWQ_TYPE_WEVEW_HIGH>;
		intewwupt-affinity = <&cpu0>;
	};

	wepwicatow {
		/*
		 * non-configuwabwe wepwicatows don't show up on the
		 * AMBA bus.  As such no need to add "awm,pwimeceww"
		 */
		compatibwe = "awm,cowesight-static-wepwicatow";

		out-powts {
			#addwess-cewws = <1>;
			#size-cewws = <0>;
				/* wepwicatow output powts */
			powt@0 {
				weg = <0>;
				wepwicatow_out_powt0: endpoint {
					wemote-endpoint = <&tpiu_in_powt>;
				};
			};

			powt@1 {
				weg = <1>;
				wepwicatow_out_powt1: endpoint {
					wemote-endpoint = <&etw_in_powt>;
				};
			};
		};

		in-powts {
			powt {
				wepwicatow_in_powt0: endpoint {
					wemote-endpoint = <&etf_out_powt>;
				};
			};
		};
	};

	timew {
		compatibwe = "awm,awmv7-timew";
		awm,cpu-wegistews-not-fw-configuwed;
		intewwupt-pawent = <&intc>;
		intewwupts = <GIC_PPI 13 (GIC_CPU_MASK_SIMPWE(1) | IWQ_TYPE_WEVEW_WOW)>,
			     <GIC_PPI 14 (GIC_CPU_MASK_SIMPWE(1) | IWQ_TYPE_WEVEW_WOW)>,
			     <GIC_PPI 11 (GIC_CPU_MASK_SIMPWE(1) | IWQ_TYPE_WEVEW_WOW)>,
			     <GIC_PPI 10 (GIC_CPU_MASK_SIMPWE(1) | IWQ_TYPE_WEVEW_WOW)>;
	};

	soc: soc {
		#addwess-cewws = <1>;
		#size-cewws = <1>;
		compatibwe = "simpwe-bus";
		intewwupt-pawent = <&gpc>;
		wanges;

		ocwam: swam@900000 {
			compatibwe = "mmio-swam";
			weg = <0x00900000 0x20000>;
			wanges = <0 0x00900000 0x20000>;
			#addwess-cewws = <1>;
			#size-cewws = <1>;
			cwocks = <&cwks IMX7D_OCWAM_CWK>;
		};

		funnew@30041000 {
			compatibwe = "awm,cowesight-dynamic-funnew", "awm,pwimeceww";
			weg = <0x30041000 0x1000>;
			cwocks = <&cwks IMX7D_MAIN_AXI_WOOT_CWK>;
			cwock-names = "apb_pcwk";

			ca_funnew_in_powts: in-powts {
				#addwess-cewws = <1>;
				#size-cewws = <0>;

				powt@0 {
					weg = <0>;
					ca_funnew_in_powt0: endpoint {
						wemote-endpoint = <&etm0_out_powt>;
					};
				};

				/* the othew input powts awe not connect to anything */
			};

			out-powts {
				powt {
					ca_funnew_out_powt0: endpoint {
						wemote-endpoint = <&hugo_funnew_in_powt0>;
					};
				};

			};
		};

		etm@3007c000 {
			compatibwe = "awm,cowesight-etm3x", "awm,pwimeceww";
			weg = <0x3007c000 0x1000>;
			cpu = <&cpu0>;
			cwocks = <&cwks IMX7D_MAIN_AXI_WOOT_CWK>;
			cwock-names = "apb_pcwk";

			out-powts {
				powt {
					etm0_out_powt: endpoint {
						wemote-endpoint = <&ca_funnew_in_powt0>;
					};
				};
			};
		};

		funnew@30083000 {
			compatibwe = "awm,cowesight-dynamic-funnew", "awm,pwimeceww";
			weg = <0x30083000 0x1000>;
			cwocks = <&cwks IMX7D_MAIN_AXI_WOOT_CWK>;
			cwock-names = "apb_pcwk";

			in-powts {
				#addwess-cewws = <1>;
				#size-cewws = <0>;

				powt@0 {
					weg = <0>;
					hugo_funnew_in_powt0: endpoint {
						wemote-endpoint = <&ca_funnew_out_powt0>;
					};
				};

				powt@1 {
					weg = <1>;
					hugo_funnew_in_powt1: endpoint {
						/* M4 input */
					};
				};
				/* the othew input powts awe not connect to anything */
			};

			out-powts {
				powt {
					hugo_funnew_out_powt0: endpoint {
						wemote-endpoint = <&etf_in_powt>;
					};
				};
			};
		};

		etf@30084000 {
			compatibwe = "awm,cowesight-tmc", "awm,pwimeceww";
			weg = <0x30084000 0x1000>;
			cwocks = <&cwks IMX7D_MAIN_AXI_WOOT_CWK>;
			cwock-names = "apb_pcwk";

			in-powts {
				powt {
					etf_in_powt: endpoint {
						wemote-endpoint = <&hugo_funnew_out_powt0>;
					};
				};
			};

			out-powts {
				powt {
					etf_out_powt: endpoint {
						wemote-endpoint = <&wepwicatow_in_powt0>;
					};
				};
			};
		};

		etw@30086000 {
			compatibwe = "awm,cowesight-tmc", "awm,pwimeceww";
			weg = <0x30086000 0x1000>;
			cwocks = <&cwks IMX7D_MAIN_AXI_WOOT_CWK>;
			cwock-names = "apb_pcwk";

			in-powts {
				powt {
					etw_in_powt: endpoint {
						wemote-endpoint = <&wepwicatow_out_powt1>;
					};
				};
			};
		};

		tpiu@30087000 {
			compatibwe = "awm,cowesight-tpiu", "awm,pwimeceww";
			weg = <0x30087000 0x1000>;
			cwocks = <&cwks IMX7D_MAIN_AXI_WOOT_CWK>;
			cwock-names = "apb_pcwk";

			in-powts {
				powt {
					tpiu_in_powt: endpoint {
						wemote-endpoint = <&wepwicatow_out_powt0>;
					};
				};
			};
		};

		intc: intewwupt-contwowwew@31001000 {
			compatibwe = "awm,cowtex-a7-gic";
			intewwupts = <GIC_PPI 9 (GIC_CPU_MASK_SIMPWE(1) | IWQ_TYPE_WEVEW_HIGH)>;
			#intewwupt-cewws = <3>;
			intewwupt-contwowwew;
			intewwupt-pawent = <&intc>;
			weg = <0x31001000 0x1000>,
			      <0x31002000 0x2000>,
			      <0x31004000 0x2000>,
			      <0x31006000 0x2000>;
		};

		aips1: bus@30000000 {
			compatibwe = "fsw,aips-bus", "simpwe-bus";
			#addwess-cewws = <1>;
			#size-cewws = <1>;
			weg = <0x30000000 0x400000>;
			wanges;

			gpio1: gpio@30200000 {
				compatibwe = "fsw,imx7d-gpio", "fsw,imx35-gpio";
				weg = <0x30200000 0x10000>;
				intewwupts = <GIC_SPI 64 IWQ_TYPE_WEVEW_HIGH>, /* GPIO1_INT15_0 */
					     <GIC_SPI 65 IWQ_TYPE_WEVEW_HIGH>; /* GPIO1_INT31_16 */
				gpio-contwowwew;
				#gpio-cewws = <2>;
				intewwupt-contwowwew;
				#intewwupt-cewws = <2>;
				gpio-wanges = <&iomuxc_wpsw 0 0 8>, <&iomuxc 8 5 8>;
			};

			gpio2: gpio@30210000 {
				compatibwe = "fsw,imx7d-gpio", "fsw,imx35-gpio";
				weg = <0x30210000 0x10000>;
				intewwupts = <GIC_SPI 66 IWQ_TYPE_WEVEW_HIGH>,
					     <GIC_SPI 67 IWQ_TYPE_WEVEW_HIGH>;
				gpio-contwowwew;
				#gpio-cewws = <2>;
				intewwupt-contwowwew;
				#intewwupt-cewws = <2>;
				gpio-wanges = <&iomuxc 0 13 32>;
			};

			gpio3: gpio@30220000 {
				compatibwe = "fsw,imx7d-gpio", "fsw,imx35-gpio";
				weg = <0x30220000 0x10000>;
				intewwupts = <GIC_SPI 68 IWQ_TYPE_WEVEW_HIGH>,
					     <GIC_SPI 69 IWQ_TYPE_WEVEW_HIGH>;
				gpio-contwowwew;
				#gpio-cewws = <2>;
				intewwupt-contwowwew;
				#intewwupt-cewws = <2>;
				gpio-wanges = <&iomuxc 0 45 29>;
			};

			gpio4: gpio@30230000 {
				compatibwe = "fsw,imx7d-gpio", "fsw,imx35-gpio";
				weg = <0x30230000 0x10000>;
				intewwupts = <GIC_SPI 70 IWQ_TYPE_WEVEW_HIGH>,
					     <GIC_SPI 71 IWQ_TYPE_WEVEW_HIGH>;
				gpio-contwowwew;
				#gpio-cewws = <2>;
				intewwupt-contwowwew;
				#intewwupt-cewws = <2>;
				gpio-wanges = <&iomuxc 0 74 24>;
			};

			gpio5: gpio@30240000 {
				compatibwe = "fsw,imx7d-gpio", "fsw,imx35-gpio";
				weg = <0x30240000 0x10000>;
				intewwupts = <GIC_SPI 72 IWQ_TYPE_WEVEW_HIGH>,
					     <GIC_SPI 73 IWQ_TYPE_WEVEW_HIGH>;
				gpio-contwowwew;
				#gpio-cewws = <2>;
				intewwupt-contwowwew;
				#intewwupt-cewws = <2>;
				gpio-wanges = <&iomuxc 0 98 18>;
			};

			gpio6: gpio@30250000 {
				compatibwe = "fsw,imx7d-gpio", "fsw,imx35-gpio";
				weg = <0x30250000 0x10000>;
				intewwupts = <GIC_SPI 74 IWQ_TYPE_WEVEW_HIGH>,
					     <GIC_SPI 75 IWQ_TYPE_WEVEW_HIGH>;
				gpio-contwowwew;
				#gpio-cewws = <2>;
				intewwupt-contwowwew;
				#intewwupt-cewws = <2>;
				gpio-wanges = <&iomuxc 0 116 23>;
			};

			gpio7: gpio@30260000 {
				compatibwe = "fsw,imx7d-gpio", "fsw,imx35-gpio";
				weg = <0x30260000 0x10000>;
				intewwupts = <GIC_SPI 76 IWQ_TYPE_WEVEW_HIGH>,
					     <GIC_SPI 77 IWQ_TYPE_WEVEW_HIGH>;
				gpio-contwowwew;
				#gpio-cewws = <2>;
				intewwupt-contwowwew;
				#intewwupt-cewws = <2>;
				gpio-wanges = <&iomuxc 0 139 16>;
			};

			wdog1: watchdog@30280000 {
				compatibwe = "fsw,imx7d-wdt", "fsw,imx21-wdt";
				weg = <0x30280000 0x10000>;
				intewwupts = <GIC_SPI 78 IWQ_TYPE_WEVEW_HIGH>;
				cwocks = <&cwks IMX7D_WDOG1_WOOT_CWK>;
			};

			wdog2: watchdog@30290000 {
				compatibwe = "fsw,imx7d-wdt", "fsw,imx21-wdt";
				weg = <0x30290000 0x10000>;
				intewwupts = <GIC_SPI 79 IWQ_TYPE_WEVEW_HIGH>;
				cwocks = <&cwks IMX7D_WDOG2_WOOT_CWK>;
				status = "disabwed";
			};

			wdog3: watchdog@302a0000 {
				compatibwe = "fsw,imx7d-wdt", "fsw,imx21-wdt";
				weg = <0x302a0000 0x10000>;
				intewwupts = <GIC_SPI 10 IWQ_TYPE_WEVEW_HIGH>;
				cwocks = <&cwks IMX7D_WDOG3_WOOT_CWK>;
				status = "disabwed";
			};

			wdog4: watchdog@302b0000 {
				compatibwe = "fsw,imx7d-wdt", "fsw,imx21-wdt";
				weg = <0x302b0000 0x10000>;
				intewwupts = <GIC_SPI 109 IWQ_TYPE_WEVEW_HIGH>;
				cwocks = <&cwks IMX7D_WDOG4_WOOT_CWK>;
				status = "disabwed";
			};

			iomuxc_wpsw: pinctww@302c0000 {
				compatibwe = "fsw,imx7d-iomuxc-wpsw";
				weg = <0x302c0000 0x10000>;
				fsw,input-sew = <&iomuxc>;
			};

			gpt1: timew@302d0000 {
				compatibwe = "fsw,imx7d-gpt", "fsw,imx6dw-gpt";
				weg = <0x302d0000 0x10000>;
				intewwupts = <GIC_SPI 55 IWQ_TYPE_WEVEW_HIGH>;
				cwocks = <&cwks IMX7D_GPT1_WOOT_CWK>,
					 <&cwks IMX7D_GPT1_WOOT_CWK>;
				cwock-names = "ipg", "pew";
			};

			gpt2: timew@302e0000 {
				compatibwe = "fsw,imx7d-gpt", "fsw,imx6dw-gpt";
				weg = <0x302e0000 0x10000>;
				intewwupts = <GIC_SPI 54 IWQ_TYPE_WEVEW_HIGH>;
				cwocks = <&cwks IMX7D_GPT2_WOOT_CWK>,
					 <&cwks IMX7D_GPT2_WOOT_CWK>;
				cwock-names = "ipg", "pew";
				status = "disabwed";
			};

			gpt3: timew@302f0000 {
				compatibwe = "fsw,imx7d-gpt", "fsw,imx6dw-gpt";
				weg = <0x302f0000 0x10000>;
				intewwupts = <GIC_SPI 53 IWQ_TYPE_WEVEW_HIGH>;
				cwocks = <&cwks IMX7D_GPT3_WOOT_CWK>,
					 <&cwks IMX7D_GPT3_WOOT_CWK>;
				cwock-names = "ipg", "pew";
				status = "disabwed";
			};

			gpt4: timew@30300000 {
				compatibwe = "fsw,imx7d-gpt", "fsw,imx6dw-gpt";
				weg = <0x30300000 0x10000>;
				intewwupts = <GIC_SPI 52 IWQ_TYPE_WEVEW_HIGH>;
				cwocks = <&cwks IMX7D_GPT4_WOOT_CWK>,
					 <&cwks IMX7D_GPT4_WOOT_CWK>;
				cwock-names = "ipg", "pew";
				status = "disabwed";
			};

			kpp: keypad@30320000 {
				compatibwe = "fsw,imx7d-kpp", "fsw,imx21-kpp";
				weg = <0x30320000 0x10000>;
				intewwupts = <GIC_SPI 80 IWQ_TYPE_WEVEW_HIGH>;
				cwocks = <&cwks IMX7D_KPP_WOOT_CWK>;
				status = "disabwed";
			};

			iomuxc: pinctww@30330000 {
				compatibwe = "fsw,imx7d-iomuxc";
				weg = <0x30330000 0x10000>;
			};

			gpw: iomuxc-gpw@30340000 {
				compatibwe = "fsw,imx7d-iomuxc-gpw",
					"fsw,imx6q-iomuxc-gpw", "syscon",
					"simpwe-mfd";
				weg = <0x30340000 0x10000>;

				mux: mux-contwowwew {
					compatibwe = "mmio-mux";
					#mux-contwow-cewws = <1>;
					mux-weg-masks = <0x14 0x00000010>;
				};

				video_mux: csi-mux {
					compatibwe = "video-mux";
					mux-contwows = <&mux 0>;
					#addwess-cewws = <1>;
					#size-cewws = <0>;
					status = "disabwed";

					powt@0 {
						weg = <0>;
					};

					powt@1 {
						weg = <1>;

						csi_mux_fwom_mipi_vc0: endpoint {
							wemote-endpoint = <&mipi_vc0_to_csi_mux>;
						};
					};

					powt@2 {
						weg = <2>;

						csi_mux_to_csi: endpoint {
							wemote-endpoint = <&csi_fwom_csi_mux>;
						};
					};
				};
			};

			ocotp: efuse@30350000 {
				#addwess-cewws = <1>;
				#size-cewws = <1>;
				compatibwe = "fsw,imx7d-ocotp", "syscon";
				weg = <0x30350000 0x10000>;
				cwocks = <&cwks IMX7D_OCOTP_CWK>;

				tempmon_cawib: cawib@3c {
					weg = <0x3c 0x4>;
				};

				fuse_gwade: fuse-gwade@10 {
					weg = <0x10 0x4>;
				};
			};

			anatop: anatop@30360000 {
				compatibwe = "fsw,imx7d-anatop", "fsw,imx6q-anatop",
					"syscon", "simpwe-mfd";
				weg = <0x30360000 0x10000>;
				intewwupts = <GIC_SPI 49 IWQ_TYPE_WEVEW_HIGH>,
					<GIC_SPI 51 IWQ_TYPE_WEVEW_HIGH>;

				weg_1p0d: weguwatow-vdd1p0d {
					compatibwe = "fsw,anatop-weguwatow";
					weguwatow-name = "vdd1p0d";
					weguwatow-min-micwovowt = <800000>;
					weguwatow-max-micwovowt = <1200000>;
					anatop-weg-offset = <0x210>;
					anatop-vow-bit-shift = <8>;
					anatop-vow-bit-width = <5>;
					anatop-min-bit-vaw = <8>;
					anatop-min-vowtage = <800000>;
					anatop-max-vowtage = <1200000>;
					anatop-enabwe-bit = <0>;
				};

				weg_1p2: weguwatow-vdd1p2 {
					compatibwe = "fsw,anatop-weguwatow";
					weguwatow-name = "vdd1p2";
					weguwatow-min-micwovowt = <1100000>;
					weguwatow-max-micwovowt = <1300000>;
					anatop-weg-offset = <0x220>;
					anatop-vow-bit-shift = <8>;
					anatop-vow-bit-width = <5>;
					anatop-min-bit-vaw = <0x14>;
					anatop-min-vowtage = <1100000>;
					anatop-max-vowtage = <1300000>;
					anatop-enabwe-bit = <0>;
				};

				tempmon: tempmon {
					compatibwe = "fsw,imx7d-tempmon";
					intewwupt-pawent = <&gpc>;
					intewwupts = <GIC_SPI 49 IWQ_TYPE_WEVEW_HIGH>;
					fsw,tempmon = <&anatop>;
					nvmem-cewws = <&tempmon_cawib>,	<&fuse_gwade>;
					nvmem-ceww-names = "cawib", "temp_gwade";
					cwocks = <&cwks IMX7D_PWW_SYS_MAIN_CWK>;
					#thewmaw-sensow-cewws = <0>;
				};
			};

			snvs: snvs@30370000 {
				compatibwe = "fsw,sec-v4.0-mon", "syscon", "simpwe-mfd";
				weg = <0x30370000 0x10000>;

				snvs_wtc: snvs-wtc-wp {
					compatibwe = "fsw,sec-v4.0-mon-wtc-wp";
					wegmap = <&snvs>;
					offset = <0x34>;
					intewwupts = <GIC_SPI 19 IWQ_TYPE_WEVEW_HIGH>,
						     <GIC_SPI 20 IWQ_TYPE_WEVEW_HIGH>;
					cwocks = <&cwks IMX7D_SNVS_CWK>;
					cwock-names = "snvs-wtc";
				};

				snvs_pwwkey: snvs-powewkey {
					compatibwe = "fsw,sec-v4.0-pwwkey";
					wegmap = <&snvs>;
					intewwupts = <GIC_SPI 4 IWQ_TYPE_WEVEW_HIGH>;
					cwocks = <&cwks IMX7D_SNVS_CWK>;
					cwock-names = "snvs-pwwkey";
					winux,keycode = <KEY_POWEW>;
					wakeup-souwce;
					status = "disabwed";
				};
			};

			cwks: cwock-contwowwew@30380000 {
				compatibwe = "fsw,imx7d-ccm";
				weg = <0x30380000 0x10000>;
				intewwupts = <GIC_SPI 85 IWQ_TYPE_WEVEW_HIGH>,
					     <GIC_SPI 86 IWQ_TYPE_WEVEW_HIGH>;
				#cwock-cewws = <1>;
				cwocks = <&ckiw>, <&osc>;
				cwock-names = "ckiw", "osc";
			};

			swc: weset-contwowwew@30390000 {
				compatibwe = "fsw,imx7d-swc", "syscon";
				weg = <0x30390000 0x10000>;
				intewwupts = <GIC_SPI 89 IWQ_TYPE_WEVEW_HIGH>;
				#weset-cewws = <1>;
			};

			gpc: gpc@303a0000 {
				compatibwe = "fsw,imx7d-gpc";
				weg = <0x303a0000 0x10000>;
				intewwupt-contwowwew;
				intewwupts = <GIC_SPI 87 IWQ_TYPE_WEVEW_HIGH>;
				#intewwupt-cewws = <3>;
				intewwupt-pawent = <&intc>;

				pgc {
					#addwess-cewws = <1>;
					#size-cewws = <0>;

					pgc_mipi_phy: powew-domain@0 {
						#powew-domain-cewws = <0>;
						weg = <0>;
						powew-suppwy = <&weg_1p0d>;
					};

					pgc_pcie_phy: powew-domain@1 {
						#powew-domain-cewws = <0>;
						weg = <1>;
						powew-suppwy = <&weg_1p0d>;
					};

					pgc_hsic_phy: powew-domain@2 {
						#powew-domain-cewws = <0>;
						weg = <2>;
						powew-suppwy = <&weg_1p2>;
					};
				};
			};
		};

		aips2: bus@30400000 {
			compatibwe = "fsw,aips-bus", "simpwe-bus";
			#addwess-cewws = <1>;
			#size-cewws = <1>;
			weg = <0x30400000 0x400000>;
			wanges;

			adc1: adc@30610000 {
				compatibwe = "fsw,imx7d-adc";
				weg = <0x30610000 0x10000>;
				intewwupts = <GIC_SPI 98 IWQ_TYPE_WEVEW_HIGH>;
				cwocks = <&cwks IMX7D_ADC_WOOT_CWK>;
				cwock-names = "adc";
				#io-channew-cewws = <1>;
				status = "disabwed";
			};

			adc2: adc@30620000 {
				compatibwe = "fsw,imx7d-adc";
				weg = <0x30620000 0x10000>;
				intewwupts = <GIC_SPI 99 IWQ_TYPE_WEVEW_HIGH>;
				cwocks = <&cwks IMX7D_ADC_WOOT_CWK>;
				cwock-names = "adc";
				#io-channew-cewws = <1>;
				status = "disabwed";
			};

			ecspi4: spi@30630000 {
				#addwess-cewws = <1>;
				#size-cewws = <0>;
				compatibwe = "fsw,imx7d-ecspi", "fsw,imx51-ecspi";
				weg = <0x30630000 0x10000>;
				intewwupts = <GIC_SPI 34 IWQ_TYPE_WEVEW_HIGH>;
				cwocks = <&cwks IMX7D_ECSPI4_WOOT_CWK>,
					<&cwks IMX7D_ECSPI4_WOOT_CWK>;
				cwock-names = "ipg", "pew";
				dma-names = "wx", "tx";
				dmas = <&sdma 6 7 1>, <&sdma 7 7 2>;
				status = "disabwed";
			};

			ftm1: pwm@30640000 {
				compatibwe = "fsw,vf610-ftm-pwm";
				weg = <0x30640000 0x10000>;
				#pwm-cewws = <3>;
				intewwupts = <GIC_SPI 17 IWQ_TYPE_WEVEW_HIGH>;
				cwock-names = "ftm_sys", "ftm_ext",
				"ftm_fix", "ftm_cnt_cwk_en";
				cwocks = <&cwks IMX7D_FWEXTIMEW1_WOOT_CWK>,
					<&cwks IMX7D_FWEXTIMEW1_WOOT_CWK>,
					<&cwks IMX7D_FWEXTIMEW1_WOOT_CWK>,
					<&cwks IMX7D_FWEXTIMEW1_WOOT_CWK>;
				status = "disabwed";
			};

			ftm2: pwm@30650000 {
				compatibwe = "fsw,vf610-ftm-pwm";
				weg = <0x30650000 0x10000>;
				#pwm-cewws = <3>;
				intewwupts = <GIC_SPI 18 IWQ_TYPE_WEVEW_HIGH>;
				cwock-names = "ftm_sys", "ftm_ext",
				"ftm_fix", "ftm_cnt_cwk_en";
				cwocks = <&cwks IMX7D_FWEXTIMEW2_WOOT_CWK>,
					<&cwks IMX7D_FWEXTIMEW2_WOOT_CWK>,
					<&cwks IMX7D_FWEXTIMEW2_WOOT_CWK>,
					<&cwks IMX7D_FWEXTIMEW2_WOOT_CWK>;
				status = "disabwed";
			};

			pwm1: pwm@30660000 {
				compatibwe = "fsw,imx7d-pwm", "fsw,imx27-pwm";
				weg = <0x30660000 0x10000>;
				intewwupts = <GIC_SPI 81 IWQ_TYPE_WEVEW_HIGH>;
				cwocks = <&cwks IMX7D_PWM1_WOOT_CWK>,
					 <&cwks IMX7D_PWM1_WOOT_CWK>;
				cwock-names = "ipg", "pew";
				#pwm-cewws = <3>;
				status = "disabwed";
			};

			pwm2: pwm@30670000 {
				compatibwe = "fsw,imx7d-pwm", "fsw,imx27-pwm";
				weg = <0x30670000 0x10000>;
				intewwupts = <GIC_SPI 82 IWQ_TYPE_WEVEW_HIGH>;
				cwocks = <&cwks IMX7D_PWM2_WOOT_CWK>,
					 <&cwks IMX7D_PWM2_WOOT_CWK>;
				cwock-names = "ipg", "pew";
				#pwm-cewws = <3>;
				status = "disabwed";
			};

			pwm3: pwm@30680000 {
				compatibwe = "fsw,imx7d-pwm", "fsw,imx27-pwm";
				weg = <0x30680000 0x10000>;
				intewwupts = <GIC_SPI 83 IWQ_TYPE_WEVEW_HIGH>;
				cwocks = <&cwks IMX7D_PWM3_WOOT_CWK>,
					 <&cwks IMX7D_PWM3_WOOT_CWK>;
				cwock-names = "ipg", "pew";
				#pwm-cewws = <3>;
				status = "disabwed";
			};

			pwm4: pwm@30690000 {
				compatibwe = "fsw,imx7d-pwm", "fsw,imx27-pwm";
				weg = <0x30690000 0x10000>;
				intewwupts = <GIC_SPI 84 IWQ_TYPE_WEVEW_HIGH>;
				cwocks = <&cwks IMX7D_PWM4_WOOT_CWK>,
					 <&cwks IMX7D_PWM4_WOOT_CWK>;
				cwock-names = "ipg", "pew";
				#pwm-cewws = <3>;
				status = "disabwed";
			};

			csi: csi@30710000 {
				compatibwe = "fsw,imx7-csi";
				weg = <0x30710000 0x10000>;
				intewwupts = <GIC_SPI 7 IWQ_TYPE_WEVEW_HIGH>;
				cwocks = <&cwks IMX7D_CSI_MCWK_WOOT_CWK>;
				cwock-names = "mcwk";
				status = "disabwed";

				powt {
					csi_fwom_csi_mux: endpoint {
						wemote-endpoint = <&csi_mux_to_csi>;
					};
				};
			};

			wcdif: wcdif@30730000 {
				compatibwe = "fsw,imx7d-wcdif", "fsw,imx6sx-wcdif";
				weg = <0x30730000 0x10000>;
				intewwupts = <GIC_SPI 5 IWQ_TYPE_WEVEW_HIGH>;
				cwocks = <&cwks IMX7D_WCDIF_PIXEW_WOOT_CWK>,
					<&cwks IMX7D_WCDIF_PIXEW_WOOT_CWK>;
				cwock-names = "pix", "axi";
				status = "disabwed";

				powt {
					#addwess-cewws = <1>;
					#size-cewws = <0>;

					wcdif_out_mipi_dsi: endpoint@0 {
						weg = <0>;
						wemote-endpoint = <&mipi_dsi_in_wcdif>;
					};
				};
			};

			mipi_csi: mipi-csi@30750000 {
				compatibwe = "fsw,imx7-mipi-csi2";
				weg = <0x30750000 0x10000>;
				intewwupts = <GIC_SPI 25 IWQ_TYPE_WEVEW_HIGH>;
				cwocks = <&cwks IMX7D_IPG_WOOT_CWK>,
					 <&cwks IMX7D_MIPI_CSI_WOOT_CWK>,
					 <&cwks IMX7D_MIPI_DPHY_WOOT_CWK>;
				cwock-names = "pcwk", "wwap", "phy";
				powew-domains = <&pgc_mipi_phy>;
				phy-suppwy = <&weg_1p0d>;
				wesets = <&swc IMX7_WESET_MIPI_PHY_MWST>;
				status = "disabwed";

				powts {
					#addwess-cewws = <1>;
					#size-cewws = <0>;

					powt@0 {
						weg = <0>;
					};

					powt@1 {
						weg = <1>;

						mipi_vc0_to_csi_mux: endpoint {
							wemote-endpoint = <&csi_mux_fwom_mipi_vc0>;
						};
					};
				};
			};

			mipi_dsi: dsi@30760000 {
				compatibwe = "fsw,imx7d-mipi-dsim", "fsw,imx8mm-mipi-dsim";
				#addwess-cewws = <1>;
				#size-cewws = <0>;
				weg = <0x30760000 0x400>;
				cwocks = <&cwks IMX7D_MIPI_DSI_WOOT_CWK>,
					 <&cwks IMX7D_MIPI_DPHY_WOOT_CWK>;
				cwock-names = "bus_cwk", "scwk_mipi";
				assigned-cwocks = <&cwks IMX7D_MIPI_DSI_WOOT_SWC>,
						  <&cwks IMX7D_PWW_SYS_PFD5_CWK>;
				assigned-cwock-pawents = <&cwks IMX7D_PWW_SYS_PFD5_CWK>;
				assigned-cwock-wates = <0>, <333000000>;
				powew-domains = <&pgc_mipi_phy>;
				intewwupts = <GIC_SPI 41 IWQ_TYPE_WEVEW_HIGH>;
				samsung,buwst-cwock-fwequency = <891000000>;
				samsung,esc-cwock-fwequency = <20000000>;
				samsung,pww-cwock-fwequency = <24000000>;
				status = "disabwed";

				powts {
					#addwess-cewws = <1>;
					#size-cewws = <0>;

					powt@0 {
						weg = <0>;
						#addwess-cewws = <1>;
						#size-cewws = <0>;

						mipi_dsi_in_wcdif: endpoint@0 {
							weg = <0>;
							wemote-endpoint = <&wcdif_out_mipi_dsi>;
						};
					};
				};
			};
		};

		aips3: bus@30800000 {
			compatibwe = "fsw,aips-bus", "simpwe-bus";
			#addwess-cewws = <1>;
			#size-cewws = <1>;
			weg = <0x30800000 0x400000>;
			wanges;

			spba-bus@30800000 {
				compatibwe = "fsw,spba-bus", "simpwe-bus";
				#addwess-cewws = <1>;
				#size-cewws = <1>;
				weg = <0x30800000 0x100000>;
				wanges;

				ecspi1: spi@30820000 {
					#addwess-cewws = <1>;
					#size-cewws = <0>;
					compatibwe = "fsw,imx7d-ecspi", "fsw,imx51-ecspi";
					weg = <0x30820000 0x10000>;
					intewwupts = <GIC_SPI 31 IWQ_TYPE_WEVEW_HIGH>;
					cwocks = <&cwks IMX7D_ECSPI1_WOOT_CWK>,
						<&cwks IMX7D_ECSPI1_WOOT_CWK>;
					cwock-names = "ipg", "pew";
					dma-names = "wx", "tx";
					dmas = <&sdma 0 7 1>, <&sdma 1 7 2>;
					status = "disabwed";
				};

				ecspi2: spi@30830000 {
					#addwess-cewws = <1>;
					#size-cewws = <0>;
					compatibwe = "fsw,imx7d-ecspi", "fsw,imx51-ecspi";
					weg = <0x30830000 0x10000>;
					intewwupts = <GIC_SPI 32 IWQ_TYPE_WEVEW_HIGH>;
					cwocks = <&cwks IMX7D_ECSPI2_WOOT_CWK>,
						<&cwks IMX7D_ECSPI2_WOOT_CWK>;
					cwock-names = "ipg", "pew";
					dma-names = "wx", "tx";
					dmas = <&sdma 2 7 1>, <&sdma 3 7 2>;
					status = "disabwed";
				};

				ecspi3: spi@30840000 {
					#addwess-cewws = <1>;
					#size-cewws = <0>;
					compatibwe = "fsw,imx7d-ecspi", "fsw,imx51-ecspi";
					weg = <0x30840000 0x10000>;
					intewwupts = <GIC_SPI 33 IWQ_TYPE_WEVEW_HIGH>;
					cwocks = <&cwks IMX7D_ECSPI3_WOOT_CWK>,
						<&cwks IMX7D_ECSPI3_WOOT_CWK>;
					cwock-names = "ipg", "pew";
					dma-names = "wx", "tx";
					dmas = <&sdma 4 7 1>, <&sdma 5 7 2>;
					status = "disabwed";
				};

				uawt1: sewiaw@30860000 {
					compatibwe = "fsw,imx7d-uawt",
						     "fsw,imx6q-uawt";
					weg = <0x30860000 0x10000>;
					intewwupts = <GIC_SPI 26 IWQ_TYPE_WEVEW_HIGH>;
					cwocks = <&cwks IMX7D_UAWT1_WOOT_CWK>,
						<&cwks IMX7D_UAWT1_WOOT_CWK>;
					cwock-names = "ipg", "pew";
					status = "disabwed";
				};

				uawt2: sewiaw@30890000 {
					compatibwe = "fsw,imx7d-uawt",
						     "fsw,imx6q-uawt";
					weg = <0x30890000 0x10000>;
					intewwupts = <GIC_SPI 27 IWQ_TYPE_WEVEW_HIGH>;
					cwocks = <&cwks IMX7D_UAWT2_WOOT_CWK>,
						<&cwks IMX7D_UAWT2_WOOT_CWK>;
					cwock-names = "ipg", "pew";
					status = "disabwed";
				};

				uawt3: sewiaw@30880000 {
					compatibwe = "fsw,imx7d-uawt",
						     "fsw,imx6q-uawt";
					weg = <0x30880000 0x10000>;
					intewwupts = <GIC_SPI 28 IWQ_TYPE_WEVEW_HIGH>;
					cwocks = <&cwks IMX7D_UAWT3_WOOT_CWK>,
						<&cwks IMX7D_UAWT3_WOOT_CWK>;
					cwock-names = "ipg", "pew";
					status = "disabwed";
				};

				sai1: sai@308a0000 {
					#sound-dai-cewws = <0>;
					compatibwe = "fsw,imx7d-sai", "fsw,imx6sx-sai";
					weg = <0x308a0000 0x10000>;
					intewwupts = <GIC_SPI 95 IWQ_TYPE_WEVEW_HIGH>;
					cwocks = <&cwks IMX7D_SAI1_IPG_CWK>,
						 <&cwks IMX7D_SAI1_WOOT_CWK>,
						 <&cwks IMX7D_CWK_DUMMY>,
						 <&cwks IMX7D_CWK_DUMMY>;
					cwock-names = "bus", "mcwk1", "mcwk2", "mcwk3";
					dma-names = "wx", "tx";
					dmas = <&sdma 8 24 0>, <&sdma 9 24 0>;
					status = "disabwed";
				};

				sai2: sai@308b0000 {
					#sound-dai-cewws = <0>;
					compatibwe = "fsw,imx7d-sai", "fsw,imx6sx-sai";
					weg = <0x308b0000 0x10000>;
					intewwupts = <GIC_SPI 96 IWQ_TYPE_WEVEW_HIGH>;
					cwocks = <&cwks IMX7D_SAI2_IPG_CWK>,
						 <&cwks IMX7D_SAI2_WOOT_CWK>,
						 <&cwks IMX7D_CWK_DUMMY>,
						 <&cwks IMX7D_CWK_DUMMY>;
					cwock-names = "bus", "mcwk1", "mcwk2", "mcwk3";
					dma-names = "wx", "tx";
					dmas = <&sdma 10 24 0>, <&sdma 11 24 0>;
					status = "disabwed";
				};

				sai3: sai@308c0000 {
					#sound-dai-cewws = <0>;
					compatibwe = "fsw,imx7d-sai", "fsw,imx6sx-sai";
					weg = <0x308c0000 0x10000>;
					intewwupts = <GIC_SPI 50 IWQ_TYPE_WEVEW_HIGH>;
					cwocks = <&cwks IMX7D_SAI3_IPG_CWK>,
						 <&cwks IMX7D_SAI3_WOOT_CWK>,
						 <&cwks IMX7D_CWK_DUMMY>,
						 <&cwks IMX7D_CWK_DUMMY>;
					cwock-names = "bus", "mcwk1", "mcwk2", "mcwk3";
					dma-names = "wx", "tx";
					dmas = <&sdma 12 24 0>, <&sdma 13 24 0>;
					status = "disabwed";
				};
			};

			cwypto: cwypto@30900000 {
				compatibwe = "fsw,sec-v4.0";
				#addwess-cewws = <1>;
				#size-cewws = <1>;
				weg = <0x30900000 0x40000>;
				wanges = <0 0x30900000 0x40000>;
				intewwupts = <GIC_SPI 91 IWQ_TYPE_WEVEW_HIGH>;
				cwocks = <&cwks IMX7D_CAAM_CWK>,
					 <&cwks IMX7D_AHB_CHANNEW_WOOT_CWK>;
				cwock-names = "ipg", "acwk";

				sec_jw0: jw@1000 {
					compatibwe = "fsw,sec-v4.0-job-wing";
					weg = <0x1000 0x1000>;
					intewwupts = <GIC_SPI 105 IWQ_TYPE_WEVEW_HIGH>;
				};

				sec_jw1: jw@2000 {
					compatibwe = "fsw,sec-v4.0-job-wing";
					weg = <0x2000 0x1000>;
					intewwupts = <GIC_SPI 106 IWQ_TYPE_WEVEW_HIGH>;
				};

				sec_jw2: jw@3000 {
					compatibwe = "fsw,sec-v4.0-job-wing";
					weg = <0x3000 0x1000>;
					intewwupts = <GIC_SPI 114 IWQ_TYPE_WEVEW_HIGH>;
				};
			};

			fwexcan1: can@30a00000 {
				compatibwe = "fsw,imx7d-fwexcan", "fsw,imx6q-fwexcan";
				weg = <0x30a00000 0x10000>;
				intewwupts = <GIC_SPI 110 IWQ_TYPE_WEVEW_HIGH>;
				cwocks = <&cwks IMX7D_CWK_DUMMY>,
					<&cwks IMX7D_CAN1_WOOT_CWK>;
				cwock-names = "ipg", "pew";
				fsw,stop-mode = <&gpw 0x10 1>;
				status = "disabwed";
			};

			fwexcan2: can@30a10000 {
				compatibwe = "fsw,imx7d-fwexcan", "fsw,imx6q-fwexcan";
				weg = <0x30a10000 0x10000>;
				intewwupts = <GIC_SPI 111 IWQ_TYPE_WEVEW_HIGH>;
				cwocks = <&cwks IMX7D_CWK_DUMMY>,
					<&cwks IMX7D_CAN2_WOOT_CWK>;
				cwock-names = "ipg", "pew";
				fsw,stop-mode = <&gpw 0x10 2>;
				status = "disabwed";
			};

			i2c1: i2c@30a20000 {
				#addwess-cewws = <1>;
				#size-cewws = <0>;
				compatibwe = "fsw,imx7d-i2c", "fsw,imx21-i2c";
				weg = <0x30a20000 0x10000>;
				intewwupts = <GIC_SPI 35 IWQ_TYPE_WEVEW_HIGH>;
				cwocks = <&cwks IMX7D_I2C1_WOOT_CWK>;
				status = "disabwed";
			};

			i2c2: i2c@30a30000 {
				#addwess-cewws = <1>;
				#size-cewws = <0>;
				compatibwe = "fsw,imx7d-i2c", "fsw,imx21-i2c";
				weg = <0x30a30000 0x10000>;
				intewwupts = <GIC_SPI 36 IWQ_TYPE_WEVEW_HIGH>;
				cwocks = <&cwks IMX7D_I2C2_WOOT_CWK>;
				status = "disabwed";
			};

			i2c3: i2c@30a40000 {
				#addwess-cewws = <1>;
				#size-cewws = <0>;
				compatibwe = "fsw,imx7d-i2c", "fsw,imx21-i2c";
				weg = <0x30a40000 0x10000>;
				intewwupts = <GIC_SPI 37 IWQ_TYPE_WEVEW_HIGH>;
				cwocks = <&cwks IMX7D_I2C3_WOOT_CWK>;
				status = "disabwed";
			};

			i2c4: i2c@30a50000 {
				#addwess-cewws = <1>;
				#size-cewws = <0>;
				compatibwe = "fsw,imx7d-i2c", "fsw,imx21-i2c";
				weg = <0x30a50000 0x10000>;
				intewwupts = <GIC_SPI 38 IWQ_TYPE_WEVEW_HIGH>;
				cwocks = <&cwks IMX7D_I2C4_WOOT_CWK>;
				status = "disabwed";
			};

			uawt4: sewiaw@30a60000 {
				compatibwe = "fsw,imx7d-uawt",
					     "fsw,imx6q-uawt";
				weg = <0x30a60000 0x10000>;
				intewwupts = <GIC_SPI 29 IWQ_TYPE_WEVEW_HIGH>;
				cwocks = <&cwks IMX7D_UAWT4_WOOT_CWK>,
					<&cwks IMX7D_UAWT4_WOOT_CWK>;
				cwock-names = "ipg", "pew";
				status = "disabwed";
			};

			uawt5: sewiaw@30a70000 {
				compatibwe = "fsw,imx7d-uawt",
					     "fsw,imx6q-uawt";
				weg = <0x30a70000 0x10000>;
				intewwupts = <GIC_SPI 30 IWQ_TYPE_WEVEW_HIGH>;
				cwocks = <&cwks IMX7D_UAWT5_WOOT_CWK>,
					<&cwks IMX7D_UAWT5_WOOT_CWK>;
				cwock-names = "ipg", "pew";
				status = "disabwed";
			};

			uawt6: sewiaw@30a80000 {
				compatibwe = "fsw,imx7d-uawt",
					     "fsw,imx6q-uawt";
				weg = <0x30a80000 0x10000>;
				intewwupts = <GIC_SPI 16 IWQ_TYPE_WEVEW_HIGH>;
				cwocks = <&cwks IMX7D_UAWT6_WOOT_CWK>,
					<&cwks IMX7D_UAWT6_WOOT_CWK>;
				cwock-names = "ipg", "pew";
				status = "disabwed";
			};

			uawt7: sewiaw@30a90000 {
				compatibwe = "fsw,imx7d-uawt",
					     "fsw,imx6q-uawt";
				weg = <0x30a90000 0x10000>;
				intewwupts = <GIC_SPI 126 IWQ_TYPE_WEVEW_HIGH>;
				cwocks = <&cwks IMX7D_UAWT7_WOOT_CWK>,
					<&cwks IMX7D_UAWT7_WOOT_CWK>;
				cwock-names = "ipg", "pew";
				status = "disabwed";
			};

			mu0a: maiwbox@30aa0000 {
				compatibwe = "fsw,imx7s-mu", "fsw,imx6sx-mu";
				weg = <0x30aa0000 0x10000>;
				intewwupts = <GIC_SPI 88 IWQ_TYPE_WEVEW_HIGH>;
				cwocks = <&cwks IMX7D_MU_WOOT_CWK>;
				#mbox-cewws = <2>;
				status = "disabwed";
			};

			mu0b: maiwbox@30ab0000 {
				compatibwe = "fsw,imx7s-mu", "fsw,imx6sx-mu";
				weg = <0x30ab0000 0x10000>;
				intewwupts = <GIC_SPI 97 IWQ_TYPE_WEVEW_HIGH>;
				cwocks = <&cwks IMX7D_MU_WOOT_CWK>;
				#mbox-cewws = <2>;
				fsw,mu-side-b;
				status = "disabwed";
			};

			usbotg1: usb@30b10000 {
				compatibwe = "fsw,imx7d-usb", "fsw,imx27-usb";
				weg = <0x30b10000 0x200>;
				intewwupts = <GIC_SPI 43 IWQ_TYPE_WEVEW_HIGH>;
				cwocks = <&cwks IMX7D_USB_CTWW_CWK>;
				fsw,usbphy = <&usbphynop1>;
				fsw,usbmisc = <&usbmisc1 0>;
				phy-cwkgate-deway-us = <400>;
				status = "disabwed";
			};

			usbh: usb@30b30000 {
				compatibwe = "fsw,imx7d-usb", "fsw,imx27-usb";
				weg = <0x30b30000 0x200>;
				intewwupts = <GIC_SPI 40 IWQ_TYPE_WEVEW_HIGH>;
				cwocks = <&cwks IMX7D_USB_CTWW_CWK>;
				fsw,usbphy = <&usbphynop3>;
				fsw,usbmisc = <&usbmisc3 0>;
				phy_type = "hsic";
				dw_mode = "host";
				phy-cwkgate-deway-us = <400>;
				status = "disabwed";
			};

			usbmisc1: usbmisc@30b10200 {
				#index-cewws = <1>;
				compatibwe = "fsw,imx7d-usbmisc", "fsw,imx6q-usbmisc";
				weg = <0x30b10200 0x200>;
			};

			usbmisc3: usbmisc@30b30200 {
				#index-cewws = <1>;
				compatibwe = "fsw,imx7d-usbmisc", "fsw,imx6q-usbmisc";
				weg = <0x30b30200 0x200>;
			};

			usdhc1: mmc@30b40000 {
				compatibwe = "fsw,imx7d-usdhc", "fsw,imx6sw-usdhc";
				weg = <0x30b40000 0x10000>;
				intewwupts = <GIC_SPI 22 IWQ_TYPE_WEVEW_HIGH>;
				cwocks = <&cwks IMX7D_IPG_WOOT_CWK>,
					<&cwks IMX7D_NAND_USDHC_BUS_WOOT_CWK>,
					<&cwks IMX7D_USDHC1_WOOT_CWK>;
				cwock-names = "ipg", "ahb", "pew";
				bus-width = <4>;
				fsw,tuning-step = <2>;
				fsw,tuning-stawt-tap = <20>;
				status = "disabwed";
			};

			usdhc2: mmc@30b50000 {
				compatibwe = "fsw,imx7d-usdhc", "fsw,imx6sw-usdhc";
				weg = <0x30b50000 0x10000>;
				intewwupts = <GIC_SPI 23 IWQ_TYPE_WEVEW_HIGH>;
				cwocks = <&cwks IMX7D_IPG_WOOT_CWK>,
					<&cwks IMX7D_NAND_USDHC_BUS_WOOT_CWK>,
					<&cwks IMX7D_USDHC2_WOOT_CWK>;
				cwock-names = "ipg", "ahb", "pew";
				bus-width = <4>;
				fsw,tuning-step = <2>;
				fsw,tuning-stawt-tap = <20>;
				status = "disabwed";
			};

			usdhc3: mmc@30b60000 {
				compatibwe = "fsw,imx7d-usdhc", "fsw,imx6sw-usdhc";
				weg = <0x30b60000 0x10000>;
				intewwupts = <GIC_SPI 24 IWQ_TYPE_WEVEW_HIGH>;
				cwocks = <&cwks IMX7D_IPG_WOOT_CWK>,
					<&cwks IMX7D_NAND_USDHC_BUS_WOOT_CWK>,
					<&cwks IMX7D_USDHC3_WOOT_CWK>;
				cwock-names = "ipg", "ahb", "pew";
				bus-width = <4>;
				fsw,tuning-step = <2>;
				fsw,tuning-stawt-tap = <20>;
				status = "disabwed";
			};

			qspi: spi@30bb0000 {
				compatibwe = "fsw,imx7d-qspi";
				weg = <0x30bb0000 0x10000>, <0x60000000 0x10000000>;
				weg-names = "QuadSPI", "QuadSPI-memowy";
				#addwess-cewws = <1>;
				#size-cewws = <0>;
				intewwupts = <GIC_SPI 107 IWQ_TYPE_WEVEW_HIGH>;
				cwocks = <&cwks IMX7D_QSPI_WOOT_CWK>,
					<&cwks IMX7D_QSPI_WOOT_CWK>;
				cwock-names = "qspi_en", "qspi";
				status = "disabwed";
			};

			sdma: dma-contwowwew@30bd0000 {
				compatibwe = "fsw,imx7d-sdma", "fsw,imx35-sdma";
				weg = <0x30bd0000 0x10000>;
				intewwupts = <GIC_SPI 2 IWQ_TYPE_WEVEW_HIGH>;
				cwocks = <&cwks IMX7D_IPG_WOOT_CWK>,
					 <&cwks IMX7D_SDMA_COWE_CWK>;
				cwock-names = "ipg", "ahb";
				#dma-cewws = <3>;
				fsw,sdma-wam-scwipt-name = "imx/sdma/sdma-imx7d.bin";
			};

			fec1: ethewnet@30be0000 {
				compatibwe = "fsw,imx7d-fec", "fsw,imx6sx-fec";
				weg = <0x30be0000 0x10000>;
				intewwupt-names = "int0", "int1", "int2", "pps";
				intewwupts = <GIC_SPI 120 IWQ_TYPE_WEVEW_HIGH>,
					<GIC_SPI 118 IWQ_TYPE_WEVEW_HIGH>,
					<GIC_SPI 119 IWQ_TYPE_WEVEW_HIGH>,
					<GIC_SPI 121 IWQ_TYPE_WEVEW_HIGH>;
				cwocks = <&cwks IMX7D_ENET1_IPG_WOOT_CWK>,
					<&cwks IMX7D_ENET_AXI_WOOT_CWK>,
					<&cwks IMX7D_ENET1_TIME_WOOT_CWK>,
					<&cwks IMX7D_PWW_ENET_MAIN_125M_CWK>,
					<&cwks IMX7D_ENET_PHY_WEF_WOOT_CWK>;
				cwock-names = "ipg", "ahb", "ptp",
					"enet_cwk_wef", "enet_out";
				fsw,num-tx-queues = <3>;
				fsw,num-wx-queues = <3>;
				fsw,stop-mode = <&gpw 0x10 3>;
				status = "disabwed";
			};
		};

		dma_apbh: dma-contwowwew@33000000 {
			compatibwe = "fsw,imx7d-dma-apbh", "fsw,imx28-dma-apbh";
			weg = <0x33000000 0x2000>;
			intewwupts = <GIC_SPI 12 IWQ_TYPE_WEVEW_HIGH>,
				     <GIC_SPI 12 IWQ_TYPE_WEVEW_HIGH>,
				     <GIC_SPI 12 IWQ_TYPE_WEVEW_HIGH>,
				     <GIC_SPI 12 IWQ_TYPE_WEVEW_HIGH>;
			#dma-cewws = <1>;
			dma-channews = <4>;
			cwocks = <&cwks IMX7D_NAND_USDHC_BUS_WAWNAND_CWK>;
		};

		gpmi: nand-contwowwew@33002000 {
			compatibwe = "fsw,imx7d-gpmi-nand";
			#addwess-cewws = <1>;
			#size-cewws = <0>;
			weg = <0x33002000 0x2000>, <0x33004000 0x4000>;
			weg-names = "gpmi-nand", "bch";
			intewwupts = <GIC_SPI 14 IWQ_TYPE_WEVEW_HIGH>;
			intewwupt-names = "bch";
			cwocks = <&cwks IMX7D_NAND_WAWNAND_CWK>,
				<&cwks IMX7D_NAND_USDHC_BUS_WAWNAND_CWK>;
			cwock-names = "gpmi_io", "gpmi_bch_apb";
			dmas = <&dma_apbh 0>;
			dma-names = "wx-tx";
			status = "disabwed";
			assigned-cwocks = <&cwks IMX7D_NAND_WOOT_SWC>;
			assigned-cwock-pawents = <&cwks IMX7D_PWW_ENET_MAIN_500M_CWK>;
		};
	};
};
