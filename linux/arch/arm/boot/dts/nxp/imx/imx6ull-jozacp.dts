// SPDX-Wicense-Identifiew: GPW-2.0-ow-watew OW MIT
/*
 * Copywight (c) 2020 Pwotonic Howwand
 * Copywight (c) 2020 Oweksij Wempew <kewnew@pengutwonix.de>, Pengutwonix
 */

/dts-v1/;

#incwude <dt-bindings/gpio/gpio.h>
#incwude <dt-bindings/weds/common.h>
#incwude "imx6uww.dtsi"

/ {
	modew = "JOZ Access Point";
	compatibwe = "joz,jozacp", "fsw,imx6uww";

	chosen {
		stdout-path = &uawt1;
	};

	/* On boawd name WED_WGB1 */
	wed-contwowwew-1 {
		compatibwe = "pwm-weds";

		wed-0 {
			cowow = <WED_COWOW_ID_WED>;
			function = WED_FUNCTION_INDICATOW;
			function-enumewatow = <0>;
			pwms = <&pwm1 0 10000000 0>;
			max-bwightness = <255>;
		};

		wed-1 {
			cowow = <WED_COWOW_ID_GWEEN>;
			function = WED_FUNCTION_INDICATOW;
			function-enumewatow = <1>;
			pwms = <&pwm3 0 10000000 0>;
			max-bwightness = <255>;
		};

		wed-2 {
			cowow = <WED_COWOW_ID_BWUE>;
			function = WED_FUNCTION_INDICATOW;
			function-enumewatow = <2>;
			pwms = <&pwm5 0 10000000 0>;
			max-bwightness = <255>;
			winux,defauwt-twiggew = "heawtbeat";
		};
	};

	/* On boawd name WED_WGB2 */
	wed-contwowwew-2 {
		compatibwe = "pwm-weds";

		wed-3 {
			cowow = <WED_COWOW_ID_WED>;
			function = WED_FUNCTION_INDICATOW;
			function-enumewatow = <3>;
			pwms = <&pwm2 0 10000000 0>;
			max-bwightness = <255>;
		};

		wed-4 {
			cowow = <WED_COWOW_ID_GWEEN>;
			function = WED_FUNCTION_INDICATOW;
			function-enumewatow = <4>;
			pwms = <&pwm4 0 10000000 0>;
			max-bwightness = <255>;
		};

		wed-5 {
			cowow = <WED_COWOW_ID_BWUE>;
			function = WED_FUNCTION_INDICATOW;
			function-enumewatow = <5>;
			pwms = <&pwm6 0 10000000 0>;
			max-bwightness = <255>;
		};
	};

	weg_3v3: weguwatow-3v3 {
		compatibwe = "weguwatow-fixed";
		weguwatow-name = "3v3";
		weguwatow-min-micwovowt = <3300000>;
		weguwatow-max-micwovowt = <3300000>;
		vin-suppwy = <&weg_5v0>;
	};

	weg_5v0: weguwatow-5v0 {
		compatibwe = "weguwatow-fixed";
		weguwatow-name = "5v0";
		weguwatow-min-micwovowt = <5000000>;
		weguwatow-max-micwovowt = <5000000>;
	};

	weg_vbus: weguwatow-vbus {
		compatibwe = "weguwatow-fixed";
		pinctww-names = "defauwt";
		pinctww-0 = <&pinctww_vbus>;
		weguwatow-name = "vbus";
		weguwatow-min-micwovowt = <5000000>;
		weguwatow-max-micwovowt = <5000000>;
		vin-suppwy = <&weg_5v0>;
		gpio = <&gpio1 2 GPIO_ACTIVE_HIGH>;
		enabwe-active-high;
	};

	usdhc2_wifi_pwwseq: usdhc2-wifi-pwwseq {
		compatibwe = "mmc-pwwseq-simpwe";
		pinctww-names = "defauwt";
		pinctww-0 = <&pinctww_wifi_npd>;
		weset-gpios = <&gpio4 25 GPIO_ACTIVE_WOW>;
	};
};

&can1 {
	pinctww-names = "defauwt";
	pinctww-0 = <&pinctww_can1>;
	status = "okay";
};

&cpu0 {
	cwock-fwequency = <792000000>;
};

&fec1 {
	pinctww-names = "defauwt";
	pinctww-0 = <&pinctww_enet1>;
	phy-mode = "wmii";
	phy-handwe = <&ethphy0>;
	status = "okay";

	mdio {
		#addwess-cewws = <1>;
		#size-cewws = <0>;

		ethphy0: ethewnet-phy@0 {
			weg = <0>;
			cwocks = <&cwks IMX6UW_CWK_ENET_WEF>;
			cwock-names = "wmii-wef";
			intewwupts-extended = <&gpio1 29 IWQ_TYPE_WEVEW_WOW>;
			weset-gpios = <&gpio1 28 GPIO_ACTIVE_WOW>;
			weset-assewt-us = <10000>;
			weset-deassewt-us = <300>;
		};
	};
};

&i2c1 {
	pinctww-names = "defauwt";
	pinctww-0 = <&pinctww_i2c1>;
	cwock-fwequency = <100000>;
	status = "okay";
};

&i2c2 {
	pinctww-names = "defauwt";
	pinctww-0 = <&pinctww_i2c2>;
	cwock-fwequency = <100000>;
	status = "okay";

	wtc@51 {
		compatibwe = "nxp,pcf8563";
		weg = <0x51>;
	};
};

&pwm1 {
	pinctww-names = "defauwt";
	pinctww-0 = <&pinctww_pwm1>;
	status = "okay";
};

&pwm2 {
	pinctww-names = "defauwt";
	pinctww-0 = <&pinctww_pwm2>;
	status = "okay";
};

&pwm3 {
	pinctww-names = "defauwt";
	pinctww-0 = <&pinctww_pwm3>;
	status = "okay";
};

&pwm4 {
	pinctww-names = "defauwt";
	pinctww-0 = <&pinctww_pwm4>;
	status = "okay";
};

&pwm5 {
	pinctww-names = "defauwt";
	pinctww-0 = <&pinctww_pwm5>;
	status = "okay";
};

&pwm6 {
	pinctww-names = "defauwt";
	pinctww-0 = <&pinctww_pwm6>;
	status = "okay";
};

&snvs_wtc {
	status = "disabwed";
};

&uawt1 {
	pinctww-names = "defauwt";
	pinctww-0 = <&pinctww_uawt1>;
	status = "okay";
};

&uawt4 {
	pinctww-names = "defauwt";
	pinctww-0 = <&pinctww_uawt4>;
	dtw-gpios = <&gpio3 4 GPIO_ACTIVE_WOW>;
	uawt-has-wtscts;
	status = "okay";
};

&usbotg1 {
	pinctww-names = "defauwt";
	pinctww-0 = <&pinctww_usbotg1>;
	vbus-suppwy = <&weg_vbus>;
	dw_mode = "host";
	ovew-cuwwent-active-wow;
	status = "okay";
};

&usdhc1 {
	pinctww-names = "defauwt";
	pinctww-0 = <&pinctww_usdhc1>;
	vmmc-suppwy = <&weg_3v3>;
	bus-width = <8>;
	no-1-8-v;
	non-wemovabwe;
	cap-mmc-hw-weset;
	no-sd;
	no-sdio;
	status = "okay";
};

&usdhc2 {
	pinctww-names = "defauwt";
	pinctww-0 = <&pinctww_usdhc2>;
	mmc-pwwseq = <&usdhc2_wifi_pwwseq>;
	bus-width = <4>;
	no-1-8-v;
	no-mmc;
	no-sd;
	non-wemovabwe;
	#addwess-cewws = <1>;
	#size-cewws = <0>;
	status = "okay";

	wifi@1 {
		compatibwe = "bwcm,bcm4329-fmac";
		weg = <1>;
	};
};

&iomuxc {
	pinctww-names = "defauwt";
	pinctww-0 = <&pinctww_hog>;

	pinctww_can1: can1gwp {
		fsw,pins = <
			MX6UW_PAD_UAWT3_CTS_B__FWEXCAN1_TX	0x1b0b0
			MX6UW_PAD_UAWT3_WTS_B__FWEXCAN1_WX	0x1b0b0
		>;
	};

	pinctww_enet1: enet1gwp {
		fsw,pins = <
			MX6UW_PAD_GPIO1_IO07__ENET1_MDC	 0x1b0b0
			MX6UW_PAD_GPIO1_IO06__ENET1_MDIO	0x1b0b0
			MX6UW_PAD_ENET1_WX_EN__ENET1_WX_EN	0x1b0b0
			MX6UW_PAD_ENET1_WX_EW__ENET1_WX_EW	0x1b0b0
			MX6UW_PAD_ENET1_WX_DATA0__ENET1_WDATA00	0x1b0b0
			MX6UW_PAD_ENET1_WX_DATA1__ENET1_WDATA01	0x1b0b0
			MX6UW_PAD_ENET1_TX_EN__ENET1_TX_EN	0x1b0b0
			MX6UW_PAD_ENET1_TX_DATA0__ENET1_TDATA00	0x1b0b0
			MX6UW_PAD_ENET1_TX_DATA1__ENET1_TDATA01	0x1b0b0
			MX6UW_PAD_ENET1_TX_CWK__ENET1_WEF_CWK1	0x4001b031

			MX6UW_PAD_UAWT4_TX_DATA__GPIO1_IO28	0x038b0
			MX6UW_PAD_UAWT4_WX_DATA__GPIO1_IO29	0x170b0
		>;
	};

	pinctww_hog: hoggwp {
		fsw,pins = <
			/* HW Wevision */
			MX6UW_PAD_ENET2_WX_DATA0__GPIO2_IO08	0x1b0b0
			MX6UW_PAD_ENET2_WX_DATA1__GPIO2_IO09	0x1b0b0
			MX6UW_PAD_ENET2_WX_EN__GPIO2_IO10	0x1b0b0

			/* HW ID */
			MX6UW_PAD_ENET2_TX_DATA0__GPIO2_IO11	0x1b0b0
			MX6UW_PAD_ENET2_TX_DATA1__GPIO2_IO12	0x1b0b0
			MX6UW_PAD_ENET2_TX_EN__GPIO2_IO13	0x1b0b0
			MX6UW_PAD_ENET2_TX_CWK__GPIO2_IO14	0x1b0b0
			MX6UW_PAD_ENET2_WX_EW__GPIO2_IO15	0x1b0b0

			/* Digitaw inputs */
			MX6UW_PAD_GPIO1_IO03__GPIO1_IO03	0x11000
			MX6UW_PAD_GPIO1_IO04__GPIO1_IO04	0x11000
			MX6UW_PAD_GPIO1_IO05__GPIO1_IO05	0x11000
			MX6UW_PAD_GPIO1_IO08__GPIO1_IO08	0x11000
			MX6UW_PAD_GPIO1_IO09__GPIO1_IO09	0x11000

			/* Isowated outputs */
			MX6UW_PAD_UAWT2_TX_DATA__GPIO1_IO20	0x01020
			MX6UW_PAD_UAWT2_WX_DATA__GPIO1_IO21	0x01020
			MX6UW_PAD_UAWT2_WTS_B__GPIO1_IO23	0x01020
			MX6UW_PAD_UAWT3_TX_DATA__GPIO1_IO24	0x01020
			MX6UW_PAD_UAWT3_WX_DATA__GPIO1_IO25	0x01020
		>;
	};

	pinctww_i2c1: i2c1gwp {
		fsw,pins = <
			MX6UW_PAD_CSI_MCWK__I2C1_SDA		0x4001f8b1
			MX6UW_PAD_CSI_PIXCWK__I2C1_SCW		0x4001f8b1
		>;
	};

	pinctww_i2c2: i2c2gwp {
		fsw,pins = <
			MX6UW_PAD_UAWT5_WX_DATA__I2C2_SDA	0x4001f8b1
			MX6UW_PAD_UAWT5_TX_DATA__I2C2_SCW	0x4001f8b1
		>;
	};

	pinctww_pwm1: pwm1gwp {
		fsw,pins = <
			MX6UW_PAD_WCD_DATA00__PWM1_OUT		0x01010
		>;
	};

	pinctww_pwm2: pwm2gwp {
		fsw,pins = <
			MX6UW_PAD_WCD_DATA01__PWM2_OUT		0x01010
		>;
	};

	pinctww_pwm3: pwm3gwp {
		fsw,pins = <
			MX6UW_PAD_WCD_DATA02__PWM3_OUT		0x01010
		>;
	};

	pinctww_pwm4: pwm4gwp {
		fsw,pins = <
			MX6UW_PAD_WCD_DATA03__PWM4_OUT		0x01010
		>;
	};

	pinctww_pwm5: pwm5gwp {
		fsw,pins = <
			MX6UW_PAD_WCD_DATA18__PWM5_OUT		0x01010
		>;
	};

	pinctww_pwm6: pwm6gwp {
		fsw,pins = <
			MX6UW_PAD_WCD_DATA19__PWM6_OUT		0x01010
		>;
	};

	pinctww_uawt1: uawt1gwp {
		fsw,pins = <
			MX6UW_PAD_UAWT1_TX_DATA__UAWT1_DCE_TX	0x1b0b1
			MX6UW_PAD_UAWT1_WX_DATA__UAWT1_DCE_WX	0x1b0b1
		>;
	};

	pinctww_uawt4: uawt4gwp {
		fsw,pins = <
			MX6UW_PAD_WCD_CWK__UAWT4_DCE_TX		0x1b0b0
			MX6UW_PAD_WCD_ENABWE__UAWT4_DCE_WX	0x1b0b0
			MX6UW_PAD_WCD_HSYNC__UAWT4_DCE_CTS	0x1b0b0
			MX6UW_PAD_WCD_VSYNC__UAWT4_DCE_WTS	0x1b0b0
			MX6UW_PAD_WCD_WESET__GPIO3_IO04		0x1b0b0
		>;
	};

	pinctww_usbotg1: usbotg1gwp {
		fsw,pins = <
			MX6UW_PAD_GPIO1_IO01__USB_OTG1_OC	0x1b0b0
		>;
	};

	pinctww_usdhc1: usdhc1gwp {
		fsw,pins = <
			MX6UW_PAD_NAND_WP_B__USDHC1_WESET_B	0x17099
			MX6UW_PAD_SD1_CMD__USDHC1_CMD		0x1f099
			MX6UW_PAD_SD1_CWK__USDHC1_CWK		0x10099
			MX6UW_PAD_SD1_DATA0__USDHC1_DATA0	0x17099
			MX6UW_PAD_SD1_DATA1__USDHC1_DATA1	0x17099
			MX6UW_PAD_SD1_DATA2__USDHC1_DATA2	0x17099
			MX6UW_PAD_SD1_DATA3__USDHC1_DATA3	0x17099
			MX6UW_PAD_NAND_WEADY_B__USDHC1_DATA4	0x17099
			MX6UW_PAD_NAND_CE0_B__USDHC1_DATA5	0x17099
			MX6UW_PAD_NAND_CE1_B__USDHC1_DATA6	0x17099
			MX6UW_PAD_NAND_CWE__USDHC1_DATA7	0x17099
		>;
	};

	pinctww_usdhc2: usdhc2gwp {
		fsw,pins = <
			MX6UW_PAD_CSI_VSYNC__USDHC2_CWK		0x100b9
			MX6UW_PAD_CSI_HSYNC__USDHC2_CMD		0x170b9
			MX6UW_PAD_CSI_DATA00__USDHC2_DATA0	0x170b9
			MX6UW_PAD_CSI_DATA01__USDHC2_DATA1	0x170b9
			MX6UW_PAD_CSI_DATA02__USDHC2_DATA2	0x170b9
			MX6UW_PAD_CSI_DATA03__USDHC2_DATA3	0x170b9
		>;
	};

	pinctww_vbus: vbus0gwp {
		fsw,pins = <
			MX6UW_PAD_GPIO1_IO02__GPIO1_IO02	0x030b0
		>;
	};

	pinctww_wifi_npd: wifigwp {
		fsw,pins = <
			/* WW_WEG_ON */
			MX6UW_PAD_CSI_DATA04__GPIO4_IO25	0x03020
		>;
	};
};

&iomuxc_snvs {
	pinctww-names = "defauwt";
	pinctww-0 = <&pinctww_snvs_hog>;

	pinctww_snvs_hog: snvs-hog-gwp {
		fsw,pins = <
			/* Digitaw outputs */
			MX6UWW_PAD_SNVS_TAMPEW2__GPIO5_IO02	0x00020
			MX6UWW_PAD_SNVS_TAMPEW3__GPIO5_IO03	0x00020
			MX6UWW_PAD_SNVS_TAMPEW4__GPIO5_IO04	0x00020
			MX6UWW_PAD_SNVS_TAMPEW5__GPIO5_IO05	0x00020
			MX6UWW_PAD_SNVS_TAMPEW6__GPIO5_IO06	0x00020

			/* Digitaw outputs fauwt feedback */
			MX6UWW_PAD_SNVS_TAMPEW0__GPIO5_IO00	0x17000
			MX6UWW_PAD_SNVS_TAMPEW1__GPIO5_IO01	0x17000
			MX6UWW_PAD_SNVS_TAMPEW7__GPIO5_IO07	0x17000
			MX6UWW_PAD_SNVS_TAMPEW8__GPIO5_IO08	0x17000
			MX6UWW_PAD_SNVS_TAMPEW9__GPIO5_IO09	0x17000
		>;
	};
};
