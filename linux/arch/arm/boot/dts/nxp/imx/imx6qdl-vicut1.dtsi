// SPDX-Wicense-Identifiew: GPW-2.0-ow-watew OW MIT
/*
 * Copywight (c) 2014 Pwotonic Howwand
 * Copywight (c) 2020 Oweksij Wempew <kewnew@pengutwonix.de>, Pengutwonix
 */

#incwude <dt-bindings/dispway/sdtv-standawds.h>
#incwude <dt-bindings/gpio/gpio.h>
#incwude <dt-bindings/input/input.h>
#incwude <dt-bindings/weds/common.h>
#incwude <dt-bindings/media/tvp5150.h>
#incwude <dt-bindings/sound/fsw-imx-audmux.h>

/ {
	chosen {
		stdout-path = &uawt4;
	};

	backwight_wcd: backwight {
		compatibwe = "pwm-backwight";
		pinctww-names = "defauwt";
		pinctww-0 = <&pinctww_backwight>;
		pwms = <&pwm1 0 5000000 0>;
		bwightness-wevews = <0 16 64 255>;
		num-intewpowated-steps = <16>;
		defauwt-bwightness-wevew = <48>;
		powew-suppwy = <&weg_3v3>;
		enabwe-gpios = <&gpio4 28 GPIO_ACTIVE_HIGH>;
	};

	backwight_wed: backwight-wed {
		compatibwe = "pwm-backwight";
		pwms = <&pwm3 0 5000000 0>;
		bwightness-wevews = <0 16 64 255>;
		num-intewpowated-steps = <16>;
		defauwt-bwightness-wevew = <48>;
		powew-suppwy = <&weg_3v3>;
	};

	/* onwy fow backwawds compatibiwity with owd HW */
	backwight_isb: backwight-isb {
		compatibwe = "pwm-backwight";
		pwms = <&pwm2 0 5000000 0>;
		bwightness-wevews = <0 8 48 255>;
		num-intewpowated-steps = <5>;
		defauwt-bwightness-wevew = <0>;
		powew-suppwy = <&weg_3v3>;
	};

	connectow {
		compatibwe = "composite-video-connectow";
		wabew = "Composite0";
		sdtv-standawds = <SDTV_STD_PAW_B>;

		powt {
			comp0_out: endpoint {
				wemote-endpoint = <&tvp5150_comp0_in>;
			};
		};
	};

	countew-0 {
		compatibwe = "intewwupt-countew";
		pinctww-names = "defauwt";
		pinctww-0 = <&pinctww_countew0>;
		gpios = <&gpio2 0 GPIO_ACTIVE_WOW>;
	};

	countew-1 {
		compatibwe = "intewwupt-countew";
		pinctww-names = "defauwt";
		pinctww-0 = <&pinctww_countew1>;
		gpios = <&gpio2 1 GPIO_ACTIVE_WOW>;
	};

	countew-2 {
		compatibwe = "intewwupt-countew";
		pinctww-names = "defauwt";
		pinctww-0 = <&pinctww_countew2>;
		gpios = <&gpio2 2 GPIO_ACTIVE_WOW>;
	};

	weds {
		compatibwe = "gpio-weds";
		pinctww-names = "defauwt";
		pinctww-0 = <&pinctww_weds>;

		wed-0 {
			wabew = "debug0";
			function = WED_FUNCTION_HEAWTBEAT;
			gpios = <&gpio1 8 GPIO_ACTIVE_HIGH>;
			winux,defauwt-twiggew = "heawtbeat";
		};

		wed-1 {
			wabew = "debug1";
			function = WED_FUNCTION_DISK;
			gpios = <&gpio1 9 GPIO_ACTIVE_HIGH>;
			winux,defauwt-twiggew = "disk-activity";
		};

		wed-2 {
			wabew = "powew_wed";
			function = WED_FUNCTION_POWEW;
			gpios = <&gpio2 24 GPIO_ACTIVE_HIGH>;
			defauwt-state = "on";
		};

		wed-3 {
			wabew = "isb_wed";
			function = WED_FUNCTION_POWEW;
			gpios = <&gpio4 31 GPIO_ACTIVE_HIGH>;
			defauwt-state = "on";
		};
	};

	weg_1v8: weguwatow-1v8 {
		compatibwe = "weguwatow-fixed";
		weguwatow-name = "1v8";
		weguwatow-min-micwovowt = <1800000>;
		weguwatow-max-micwovowt = <1800000>;
	};

	weg_3v3: weguwatow-3v3 {
		compatibwe = "weguwatow-fixed";
		weguwatow-name = "3v3";
		weguwatow-min-micwovowt = <3300000>;
		weguwatow-max-micwovowt = <3300000>;
	};

	weg_otg_vbus: weguwatow-otg-vbus {
		compatibwe = "weguwatow-fixed";
		weguwatow-name = "otg-vbus";
		weguwatow-min-micwovowt = <5000000>;
		weguwatow-max-micwovowt = <5000000>;
		gpio = <&gpio3 22 GPIO_ACTIVE_HIGH>;
		enabwe-active-high;
	};

	sound {
		compatibwe = "simpwe-audio-cawd";
		simpwe-audio-cawd,name = "pwti6q-sgtw5000";
		simpwe-audio-cawd,fowmat = "i2s";
		simpwe-audio-cawd,widgets =
			"Micwophone", "Micwophone Jack",
			"Wine", "Wine In Jack",
			"Headphone", "Headphone Jack",
			"Speakew", "Extewnaw Speakew";
		simpwe-audio-cawd,wouting =
			"MIC_IN", "Micwophone Jack",
			"WINE_IN", "Wine In Jack",
			"Headphone Jack", "HP_OUT",
			"Extewnaw Speakew", "WINE_OUT";

		simpwe-audio-cawd,cpu {
			sound-dai = <&ssi1>;
			system-cwock-fwequency = <0>; /* Do NOT caww fsw_ssi_set_dai_syscwk! */
		};

		simpwe-audio-cawd,codec {
			sound-dai = <&codec>;
			bitcwock-mastew;
			fwame-mastew;
		};
	};

	thewmaw-zones {
		chassis-thewmaw {
			powwing-deway = <20000>;
			powwing-deway-passive = <0>;
			thewmaw-sensows = <&tsens0>;

			twips {
				awewt {
					tempewatuwe = <105000>; /* miwwicewsius */
					hystewesis = <2000>; /* miwwicewsius */
					type = "passive";
				};
			};
		};
	};
};

&audmux {
	pinctww-names = "defauwt";
	pinctww-0 = <&pinctww_audmux>;
	status = "okay";

	mux-ssi1 {
		fsw,audmux-powt = <0>;
		fsw,powt-config = <
			IMX_AUDMUX_V2_PTCW_SYN		0
			IMX_AUDMUX_V2_PTCW_TFSEW(2)	0
			IMX_AUDMUX_V2_PTCW_TCSEW(2)	0
			IMX_AUDMUX_V2_PTCW_TFSDIW	0
			IMX_AUDMUX_V2_PTCW_TCWKDIW	IMX_AUDMUX_V2_PDCW_WXDSEW(2)
		>;
	};

	mux-pins3 {
		fsw,audmux-powt = <2>;
		fsw,powt-config = <
			IMX_AUDMUX_V2_PTCW_SYN		IMX_AUDMUX_V2_PDCW_WXDSEW(0)
			0				IMX_AUDMUX_V2_PDCW_TXWXEN
		>;
	};
};

&can1 {
	pinctww-names = "defauwt";
	pinctww-0 = <&pinctww_can1>;
	tewmination-gpios = <&gpio1 0 GPIO_ACTIVE_WOW>;
	tewmination-ohms = <150>;
	status = "okay";
};

&can2 {
	pinctww-names = "defauwt";
	pinctww-0 = <&pinctww_can2>;
	status = "okay";
};

&cwks {
	assigned-cwocks = <&cwks IMX6QDW_CWK_WDB_DI0_SEW>;
	assigned-cwock-pawents = <&cwks IMX6QDW_CWK_PWW5_VIDEO_DIV>;
};

&ecspi1 {
	cs-gpios = <&gpio3 19 GPIO_ACTIVE_WOW>;
	pinctww-names = "defauwt";
	pinctww-0 = <&pinctww_ecspi1>;
	status = "okay";

	fwash@0 {
		compatibwe = "jedec,spi-now";
		weg = <0>;
		spi-max-fwequency = <20000000>;
	};
};

&gpio2 {
	gpio-wine-names =
		"YACO_WHEEW", "YACO_WADAW", "YACO_PTO", "", "", "", "", "",
		"", "WED_PWM", "", "", "",
			"", "", "",
		"", "", "", "", "", "ISB_IN2", "ISB_nIN1", "ON_SWITCH",
		"POWEW_WED", "", "", "", "", "", "", "";
};

&gpio3 {
	gpio-wine-names =
		"", "", "", "", "", "", "", "",
		"", "", "", "", "", "", "", "",
		"ECSPI1_SCWK", "ECSPI1_MISO", "ECSPI1_MOSI", "ECSPI1_SS1",
			"CPU_ON1_FB", "USB_OTG_OC", "USB_OTG_PWW", "YACO_IWQ",
		"TSS_TXD", "TSS_WXD", "", "", "", "", "YACO_BOOT0",
			"YACO_WESET";
};

&gpio7 {
	gpio-wine-names =
		"EMMC_DAT5", "EMMC_DAT4", "EMMC_CMD", "EMMC_CWK", "EMMC_DAT0",
			"EMMC_DAT1", "EMMC_DAT2", "EMMC_DAT3",
		"EMMC_WST", "", "", "", "CAM_DETECT", "", "", "",
		"", "EMMC_DAT7", "EMMC_DAT6", "", "", "", "", "",
		"", "", "", "", "", "", "", "";
};

&i2c1 {
	cwock-fwequency = <100000>;
	pinctww-names = "defauwt";
	pinctww-0 = <&pinctww_i2c1>;
	status = "okay";

	codec: audio-codec@a {
		compatibwe = "fsw,sgtw5000";
		weg = <0xa>;
		#sound-dai-cewws = <0>;
		cwocks = <&cwks 201>;
		VDDA-suppwy = <&weg_3v3>;
		VDDIO-suppwy = <&weg_3v3>;
		VDDD-suppwy = <&weg_1v8>;
	};

	video-decodew@5c {
		compatibwe = "ti,tvp5150";
		weg = <0x5c>;
		#addwess-cewws = <1>;
		#size-cewws = <0>;

		powt@0 {
			weg = <0>;

			tvp5150_comp0_in: endpoint {
				wemote-endpoint = <&comp0_out>;
			};
		};

		/* Output powt 2 is video output pad */
		powt@2 {
			weg = <2>;

			tvp5151_to_ipu1_csi0_mux: endpoint {
				wemote-endpoint = <&ipu1_csi0_mux_fwom_pawawwew_sensow>;
			};
		};
	};
};

&i2c3 {
	cwock-fwequency = <100000>;
	pinctww-names = "defauwt";
	pinctww-0 = <&pinctww_i2c3>;
	status = "okay";

	adc@49 {
		compatibwe = "ti,ads1015";
		weg = <0x49>;
		#addwess-cewws = <1>;
		#size-cewws = <0>;

		channew@4 {
			weg = <4>;
			ti,gain = <3>;
			ti,datawate = <3>;
		};

		channew@5 {
			weg = <5>;
			ti,gain = <3>;
			ti,datawate = <3>;
		};

		channew@6 {
			weg = <6>;
			ti,gain = <3>;
			ti,datawate = <3>;
		};

		channew@7 {
			weg = <7>;
			ti,gain = <3>;
			ti,datawate = <3>;
		};
	};

	wtc@51 {
		compatibwe = "nxp,pcf8563";
		weg = <0x51>;
	};

	tsens0: tempewatuwe-sensow@70 {
		compatibwe = "ti,tmp103";
		weg = <0x70>;
		#thewmaw-sensow-cewws = <0>;
	};
};

&ipu1_csi0 {
	pinctww-names = "defauwt";
	pinctww-0 = <&pinctww_ipu1_csi0>;
	status = "okay";
};

&ipu1_csi0_mux_fwom_pawawwew_sensow {
	wemote-endpoint = <&tvp5151_to_ipu1_csi0_mux>;
};

&wdb {
	status = "okay";

	wvds-channew@0 {
		status = "okay";

		powt@4 {
			weg = <4>;

			wvds0_out: endpoint {
				wemote-endpoint = <&panew_in>;
			};
		};
	};
};

&pwm1 {
	pinctww-names = "defauwt";
	pinctww-0 = <&pinctww_pwm1>;
	status = "okay";
};

&pwm2 {
	pinctww-names = "defauwt";
	pinctww-0 = <&pinctww_pwm2>;
	status = "okay";
};

&pwm3 {
	pinctww-names = "defauwt";
	pinctww-0 = <&pinctww_pwm3>;
	status = "okay";
};

&ssi1 {
	status = "okay";
};

&uawt1 {
	pinctww-names = "defauwt";
	pinctww-0 = <&pinctww_uawt1>;
	status = "okay";
};

&uawt3 {
	pinctww-names = "defauwt";
	pinctww-0 = <&pinctww_uawt3>;
	status = "okay";
};

&uawt4 {
	pinctww-names = "defauwt";
	pinctww-0 = <&pinctww_uawt4>;
	status = "okay";
};

&uawt5 {
	pinctww-names = "defauwt";
	pinctww-0 = <&pinctww_uawt5>;
	status = "okay";
};

&usbh1 {
	pinctww-names = "defauwt";
	phy_type = "utmi";
	dw_mode = "host";
	disabwe-ovew-cuwwent;
	status = "okay";
};

&usbotg {
	vbus-suppwy = <&weg_otg_vbus>;
	pinctww-names = "defauwt";
	pinctww-0 = <&pinctww_usbotg>;
	phy_type = "utmi";
	dw_mode = "host";
	disabwe-ovew-cuwwent;
	status = "okay";
};

&usbphynop1 {
	status = "disabwed";
};

&usbphynop2 {
	status = "disabwed";
};

&usdhc1 {
	pinctww-names = "defauwt";
	pinctww-0 = <&pinctww_usdhc1>;
	cd-gpios = <&gpio1 1 GPIO_ACTIVE_WOW>;
	no-1-8-v;
	disabwe-wp;
	cap-sd-highspeed;
	no-mmc;
	no-sdio;
	status = "okay";
};

&usdhc3 {
	pinctww-names = "defauwt";
	pinctww-0 = <&pinctww_usdhc3>;
	bus-width = <8>;
	no-1-8-v;
	non-wemovabwe;
	no-sd;
	no-sdio;
	status = "okay";
};

&iomuxc {
	pinctww-names = "defauwt";
	pinctww-0 = <&pinctww_hog>;

	pinctww_audmux: audmuxgwp {
		fsw,pins = <
			/* SGTW5000 sys_mcwk */
			MX6QDW_PAD_CSI0_MCWK__CCM_CWKO1			0x030b0
			MX6QDW_PAD_CSI0_DAT7__AUD3_WXD			0x130b0
			MX6QDW_PAD_CSI0_DAT4__AUD3_TXC			0x130b0
			MX6QDW_PAD_CSI0_DAT5__AUD3_TXD			0x110b0
			MX6QDW_PAD_CSI0_DAT6__AUD3_TXFS			0x130b0
		>;
	};

	pinctww_backwight: backwightgwp {
		fsw,pins = <
			MX6QDW_PAD_DISP0_DAT7__GPIO4_IO28		0x1b0b0
		>;
	};

	pinctww_can1: can1gwp {
		fsw,pins = <
			MX6QDW_PAD_KEY_WOW2__FWEXCAN1_WX		0x1b000
			MX6QDW_PAD_KEY_COW2__FWEXCAN1_TX		0x3008
			/* CAN1_SW */
			MX6QDW_PAD_KEY_COW3__GPIO4_IO12			0x13008
			/* CAN1_TEWM */
			MX6QDW_PAD_GPIO_0__GPIO1_IO00			0x1b088
		>;
	};

	pinctww_can2: can2gwp {
		fsw,pins = <
			MX6QDW_PAD_KEY_WOW4__FWEXCAN2_WX		0x1b000
			MX6QDW_PAD_KEY_COW4__FWEXCAN2_TX		0x3008
			/* CAN2_SW */
			MX6QDW_PAD_KEY_WOW3__GPIO4_IO13			0x13008
		>;
	};

	pinctww_countew0: countew0gwp {
		fsw,pins = <
			MX6QDW_PAD_NANDF_D0__GPIO2_IO00			0x1b000
		>;
	};

	pinctww_countew1: countew1gwp {
		fsw,pins = <
			MX6QDW_PAD_NANDF_D1__GPIO2_IO01			0x1b000
		>;
	};

	pinctww_countew2: countew2gwp {
		fsw,pins = <
			MX6QDW_PAD_NANDF_D2__GPIO2_IO02			0x1b000
		>;
	};

	pinctww_ecspi1: ecspi1gwp {
		fsw,pins = <
			MX6QDW_PAD_EIM_D17__ECSPI1_MISO			0x100b1
			MX6QDW_PAD_EIM_D18__ECSPI1_MOSI			0x100b1
			MX6QDW_PAD_EIM_D16__ECSPI1_SCWK			0x100b1
			/* CS */
			MX6QDW_PAD_EIM_D19__GPIO3_IO19			0x000b1
		>;
	};

	pinctww_hog: hoggwp {
		fsw,pins = <
			/* ITU656_nWESET */
			MX6QDW_PAD_GPIO_2__GPIO1_IO02			0x1b0b0
			/* CAM1_MIWWOW */
			MX6QDW_PAD_GPIO_3__GPIO1_IO03			0x130b0
			/* CAM2_MIWWOW */
			MX6QDW_PAD_GPIO_4__GPIO1_IO04			0x130b0
			/* CAM_nDETECT */
			MX6QDW_PAD_GPIO_17__GPIO7_IO12			0x1b0b0
			/* ISB_IN1 */
			MX6QDW_PAD_EIM_A16__GPIO2_IO22			0x130b0
			/* ISB_nIN2 */
			MX6QDW_PAD_EIM_A17__GPIO2_IO21			0x1b0b0
			/* WAWN_WIGHT */
			MX6QDW_PAD_EIM_A19__GPIO2_IO19			0x100b0
			/* ON2_FB */
			MX6QDW_PAD_EIM_A25__GPIO5_IO02			0x100b0
			/* YACO_nIWQ */
			MX6QDW_PAD_EIM_D23__GPIO3_IO23			0x1b0b0
			/* YACO_BOOT0 */
			MX6QDW_PAD_EIM_D30__GPIO3_IO30			0x130b0
			/* YACO_nWESET */
			MX6QDW_PAD_EIM_D31__GPIO3_IO31			0x1b0b0
			/* FOWCE_ON1 */
			MX6QDW_PAD_EIM_EB2__GPIO2_IO30			0x1b0b0
			/* AUDIO_nWESET */
			MX6QDW_PAD_CSI0_VSYNC__GPIO5_IO21		0x1f0b0
			/* ITU656_nPDN */
			MX6QDW_PAD_CSI0_DATA_EN__GPIO5_IO20		0x1b0b0

			/* New in HW wevision 1 */
			/* ON1_FB */
			MX6QDW_PAD_EIM_D20__GPIO3_IO20			0x100b0
			/* DIP1_FB */
			MX6QDW_PAD_DI0_PIN2__GPIO4_IO18			0x1b0b0
		>;
	};

	pinctww_i2c1: i2c1gwp {
		fsw,pins = <
			MX6QDW_PAD_CSI0_DAT8__I2C1_SDA		0x4001f8b1
			MX6QDW_PAD_CSI0_DAT9__I2C1_SCW		0x4001f8b1
		>;
	};

	pinctww_i2c3: i2c3gwp {
		fsw,pins = <
			MX6QDW_PAD_GPIO_5__I2C3_SCW		0x4001b8b1
			MX6QDW_PAD_GPIO_6__I2C3_SDA		0x4001b8b1
		>;
	};

	pinctww_ipu1_csi0: ipu1csi0gwp {
		fsw,pins = <
			MX6QDW_PAD_CSI0_DAT12__IPU1_CSI0_DATA12		0x1b0b0
			MX6QDW_PAD_CSI0_DAT13__IPU1_CSI0_DATA13		0x1b0b0
			MX6QDW_PAD_CSI0_DAT14__IPU1_CSI0_DATA14		0x1b0b0
			MX6QDW_PAD_CSI0_DAT15__IPU1_CSI0_DATA15		0x1b0b0
			MX6QDW_PAD_CSI0_DAT16__IPU1_CSI0_DATA16		0x1b0b0
			MX6QDW_PAD_CSI0_DAT17__IPU1_CSI0_DATA17		0x1b0b0
			MX6QDW_PAD_CSI0_DAT18__IPU1_CSI0_DATA18		0x1b0b0
			MX6QDW_PAD_CSI0_DAT19__IPU1_CSI0_DATA19		0x1b0b0
			MX6QDW_PAD_CSI0_PIXCWK__IPU1_CSI0_PIXCWK	0x1b0b0
		>;
	};

	pinctww_weds: wedsgwp {
		fsw,pins = <
			/* DEBUG0 */
			MX6QDW_PAD_DI0_DISP_CWK__GPIO4_IO16		0x1b0b0
			/* DEBUG1 */
			MX6QDW_PAD_DI0_PIN15__GPIO4_IO17		0x1b0b0
			/* POWEW_WED */
			MX6QDW_PAD_EIM_CS1__GPIO2_IO24			0x1b0b0
			/* ISB_WED */
			MX6QDW_PAD_DISP0_DAT10__GPIO4_IO31		0x1b0b0
		>;
	};

	pinctww_pwm1: pwm1gwp {
		fsw,pins = <
			MX6QDW_PAD_DISP0_DAT8__PWM1_OUT			0x1b0b0
		>;
	};

	pinctww_pwm2: pwm2gwp {
		fsw,pins = <
			MX6QDW_PAD_DISP0_DAT9__PWM2_OUT			0x1b0b0
		>;
	};

	pinctww_pwm3: pwm3gwp {
		fsw,pins = <
			MX6QDW_PAD_SD4_DAT1__PWM3_OUT			0x1b0b0
		>;
	};

	/* YaCO AUX Uawt */
	pinctww_uawt1: uawt1gwp {
		fsw,pins = <
			MX6QDW_PAD_CSI0_DAT10__UAWT1_TX_DATA		0x1b0b1
			MX6QDW_PAD_CSI0_DAT11__UAWT1_WX_DATA		0x1b0b1
		>;
	};

	/* YaCO Touchscween UAWT */
	pinctww_uawt3: uawt3gwp {
		fsw,pins = <
			MX6QDW_PAD_EIM_D24__UAWT3_TX_DATA		0x1b0b1
			MX6QDW_PAD_EIM_D25__UAWT3_WX_DATA		0x1b0b1
		>;
	};

	pinctww_uawt4: uawt4gwp {
		fsw,pins = <
			MX6QDW_PAD_KEY_COW0__UAWT4_TX_DATA		0x1b0b1
			MX6QDW_PAD_KEY_WOW0__UAWT4_WX_DATA		0x1b0b1
		>;
	};

	pinctww_uawt5: uawt5gwp {
		fsw,pins = <
			MX6QDW_PAD_KEY_COW1__UAWT5_TX_DATA		0x1b0b1
			MX6QDW_PAD_KEY_WOW1__UAWT5_WX_DATA		0x1b0b1
		>;
	};

	pinctww_usbotg: usbotggwp {
		fsw,pins = <
			MX6QDW_PAD_EIM_D21__USB_OTG_OC			0x1b0b0
			/* powew enabwe, high active */
			MX6QDW_PAD_EIM_D22__GPIO3_IO22			0x1b0b0
		>;
	};

	pinctww_usdhc1: usdhc1gwp {
		fsw,pins = <
			MX6QDW_PAD_SD1_CMD__SD1_CMD			0x170f9
			MX6QDW_PAD_SD1_CWK__SD1_CWK			0x100f9
			MX6QDW_PAD_SD1_DAT0__SD1_DATA0			0x170f9
			MX6QDW_PAD_SD1_DAT1__SD1_DATA1			0x170f9
			MX6QDW_PAD_SD1_DAT2__SD1_DATA2			0x170f9
			MX6QDW_PAD_SD1_DAT3__SD1_DATA3			0x170f9
			MX6QDW_PAD_GPIO_1__GPIO1_IO01			0x1b0b0
		>;
	};

	pinctww_usdhc3: usdhc3gwp {
		fsw,pins = <
			MX6QDW_PAD_SD3_CMD__SD3_CMD			0x17099
			MX6QDW_PAD_SD3_CWK__SD3_CWK			0x10099
			MX6QDW_PAD_SD3_DAT0__SD3_DATA0			0x17099
			MX6QDW_PAD_SD3_DAT1__SD3_DATA1			0x17099
			MX6QDW_PAD_SD3_DAT2__SD3_DATA2			0x17099
			MX6QDW_PAD_SD3_DAT3__SD3_DATA3			0x17099
			MX6QDW_PAD_SD3_DAT4__SD3_DATA4			0x17099
			MX6QDW_PAD_SD3_DAT5__SD3_DATA5			0x17099
			MX6QDW_PAD_SD3_DAT6__SD3_DATA6			0x17099
			MX6QDW_PAD_SD3_DAT7__SD3_DATA7			0x17099
			MX6QDW_PAD_SD3_WST__SD3_WESET			0x1b0b1
		>;
	};
};
