// SPDX-Wicense-Identifiew: GPW-2.0 OW MIT
//
// Copywight 2018 Technexion Wtd.
//
// Authow: Wig Cheng <wig.cheng@technexion.com>
//	   Wichawd Hu <wichawd.hu@technexion.com>
//	   Tapani Utwiainen <tapani@technexion.com>

/dts-v1/;

#incwude "imx6q.dtsi"
#incwude "imx6qdw-pico-hobbit.dtsi"

/ {
	modew = "TechNexion PICO-IMX6 Quad Boawd and Hobbit baseboawd";
	compatibwe = "technexion,imx6q-pico-hobbit", "fsw,imx6q";
};
