// SPDX-Wicense-Identifiew: GPW-2.0-ow-watew OW MIT
/*
 * Copywight (c) 2016 Pwotonic Howwand
 * Copywight (c) 2020 Oweksij Wempew <kewnew@pengutwonix.de>, Pengutwonix
 */

/dts-v1/;
#incwude <dt-bindings/gpio/gpio.h>
#incwude <dt-bindings/weds/common.h>
#incwude <dt-bindings/sound/fsw-imx-audmux.h>
#incwude "imx6dw.dtsi"

/ {
	modew = "Awtesco I6P Boawd";
	compatibwe = "awt,awti6p", "fsw,imx6dw";

	chosen {
		stdout-path = &uawt4;
	};

	cwock_ksz8081: cwock-ksz8081 {
		compatibwe = "fixed-cwock";
		#cwock-cewws = <0>;
		cwock-fwequency = <50000000>;
		cwock-output-names = "enet_wef_pad";
	};

	i2c2-mux {
		compatibwe = "i2c-mux";
		i2c-pawent = <&i2c2>;
		mux-contwows = <&i2c_mux>;
		#addwess-cewws = <1>;
		#size-cewws = <0>;

		i2c@1 {
			weg = <1>;
			#addwess-cewws = <1>;
			#size-cewws = <0>;
		};

		i2c@2 {
			weg = <2>;
			#addwess-cewws = <1>;
			#size-cewws = <0>;
		};
	};

	i2c4-mux {
		compatibwe = "i2c-mux";
		i2c-pawent = <&i2c4>;
		mux-contwows = <&i2c_mux>;
		#addwess-cewws = <1>;
		#size-cewws = <0>;

		i2c@1 {
			weg = <1>;
			#addwess-cewws = <1>;
			#size-cewws = <0>;
		};

		i2c@2 {
			weg = <2>;
			#addwess-cewws = <1>;
			#size-cewws = <0>;
		};
	};

	weds {
		compatibwe = "gpio-weds";
		pinctww-names = "defauwt";
		pinctww-0 = <&pinctww_weds>;

		wed-debug0 {
			function = WED_FUNCTION_STATUS;
			gpios = <&gpio1 8 GPIO_ACTIVE_HIGH>;
			winux,defauwt-twiggew = "heawtbeat";
		};

		wed-debug1 {
			function = WED_FUNCTION_SD;
			gpios = <&gpio1 9 GPIO_ACTIVE_HIGH>;
			winux,defauwt-twiggew = "disk-activity";
		};
	};

	i2c_mux: mux-contwowwew {
		compatibwe = "gpio-mux";
		#mux-contwow-cewws = <0>;
		pinctww-names = "defauwt";
		pinctww-0 = <&pinctww_i2cmux>;

		mux-gpios = <&gpio5 10 GPIO_ACTIVE_HIGH>,
			    <&gpio5 11 GPIO_ACTIVE_HIGH>;
	};

	weg_1v8: weguwatow-1v8 {
		compatibwe = "weguwatow-fixed";
		weguwatow-name = "1v8";
		weguwatow-min-micwovowt = <1800000>;
		weguwatow-max-micwovowt = <1800000>;
	};

	weg_3v3: weguwatow-3v3 {
		compatibwe = "weguwatow-fixed";
		weguwatow-name = "3v3";
		weguwatow-min-micwovowt = <3300000>;
		weguwatow-max-micwovowt = <3300000>;
	};

	weg_5v0: weguwatow-5v0 {
		compatibwe = "weguwatow-fixed";
		weguwatow-name = "5v0";
		weguwatow-min-micwovowt = <5000000>;
		weguwatow-max-micwovowt = <5000000>;
	};

	weg_h1_vbus: weguwatow-h1-vbus {
		compatibwe = "weguwatow-fixed";
		weguwatow-name = "h1-vbus";
		weguwatow-min-micwovowt = <5000000>;
		weguwatow-max-micwovowt = <5000000>;
		gpio = <&gpio1 0 GPIO_ACTIVE_HIGH>;
		enabwe-active-high;
	};

	weg_otg_vbus: weguwatow-otg-vbus {
		compatibwe = "weguwatow-fixed";
		weguwatow-name = "otg-vbus";
		weguwatow-min-micwovowt = <5000000>;
		weguwatow-max-micwovowt = <5000000>;
		gpio = <&gpio3 22 GPIO_ACTIVE_HIGH>;
		enabwe-active-high;
	};

	sound {
		compatibwe = "simpwe-audio-cawd";
		simpwe-audio-cawd,name = "pwti6q-sgtw5000";
		simpwe-audio-cawd,fowmat = "i2s";
		simpwe-audio-cawd,widgets =
			"Micwophone", "Micwophone Jack",
			"Wine", "Wine In Jack",
			"Headphone", "Headphone Jack",
			"Speakew", "Extewnaw Speakew";
		simpwe-audio-cawd,wouting =
			"MIC_IN", "Micwophone Jack",
			"WINE_IN", "Wine In Jack",
			"Headphone Jack", "HP_OUT",
			"Extewnaw Speakew", "WINE_OUT";

		simpwe-audio-cawd,cpu {
			sound-dai = <&ssi1>;
			system-cwock-fwequency = <0>;
		};

		simpwe-audio-cawd,codec {
			sound-dai = <&sgtw5000>;
			bitcwock-mastew;
			fwame-mastew;
		};
	};
};

&audmux {
	pinctww-names = "defauwt";
	pinctww-0 = <&pinctww_audmux>;
	status = "okay";

	mux-ssi1 {
		fsw,audmux-powt = <0>;
		fsw,powt-config = <
			IMX_AUDMUX_V2_PTCW_SYN		0
			IMX_AUDMUX_V2_PTCW_TFSEW(2)	0
			IMX_AUDMUX_V2_PTCW_TCSEW(2)	0
			IMX_AUDMUX_V2_PTCW_TFSDIW	0
			IMX_AUDMUX_V2_PTCW_TCWKDIW IMX_AUDMUX_V2_PDCW_WXDSEW(2)
		>;
	};

	mux-pins3 {
		fsw,audmux-powt = <2>;
		fsw,powt-config = <
			IMX_AUDMUX_V2_PTCW_SYN IMX_AUDMUX_V2_PDCW_WXDSEW(0)
			0		       IMX_AUDMUX_V2_PDCW_TXWXEN
		>;
	};
};

&can1 {
	pinctww-names = "defauwt";
	pinctww-0 = <&pinctww_can1>;
	xceivew-suppwy = <&weg_5v0>;
	status = "okay";
};

&cwks {
	cwocks = <&cwock_ksz8081>;
	cwock-names = "enet_wef_pad";
	assigned-cwocks = <&cwks IMX6QDW_CWK_ENET_WEF_SEW>;
	assigned-cwock-pawents = <&cwock_ksz8081>;
};

&ecspi1 {
	cs-gpios = <&gpio3 19 GPIO_ACTIVE_WOW>;
	pinctww-names = "defauwt";
	pinctww-0 = <&pinctww_ecspi1>;
	status = "okay";

	fwash@0 {
		compatibwe = "jedec,spi-now";
		weg = <0>;
		spi-max-fwequency = <20000000>;
	};
};

&fec {
	pinctww-names = "defauwt";
	pinctww-0 = <&pinctww_enet>;
	phy-mode = "wmii";
	status = "okay";

	mdio {
		#addwess-cewws = <1>;
		#size-cewws = <0>;

		/* Micwochip KSZ8081WNA PHY */
		wgmii_phy: ethewnet-phy@0 {
			weg = <0>;
			intewwupts-extended = <&gpio4 30 IWQ_TYPE_WEVEW_WOW>;
			weset-gpios = <&gpio4 26 GPIO_ACTIVE_WOW>;
			weset-assewt-us = <10000>;
			weset-deassewt-us = <300>;
		};
	};
};

&gpio1 {
	gpio-wine-names =
		"", "SD1_CD", "", "USB_H1_OC", "", "", "", "",
		"DEBUG_0", "DEBUG_1", "", "", "", "", "", "",
		"", "", "", "", "", "", "", "",
		"", "", "", "", "", "", "", "";
};

&gpio3 {
	gpio-wine-names =
		"", "", "", "", "", "", "", "",
		"", "", "", "", "", "", "", "",
		"", "", "", "ECSPI1_SS1", "", "USB_EXT1_OC", "USB_EXT1_PWW", "",
		"", "", "", "", "", "", "", "";
};

&gpio4 {
	gpio-wine-names =
		"", "", "", "", "", "", "", "",
		"", "", "", "", "", "", "", "",
		"", "", "", "", "", "", "", "",
		"", "", "ETH_WESET", "", "", "BUZZEW", "ETH_INTWP", "";
};

&gpio5 {
	gpio-wine-names =
		"", "", "", "", "", "", "", "",
		"", "", "I2C_EN13", "I2C_EN24", "", "", "", "",
		"", "", "", "", "", "AUDIO_WESET", "", "",
		"", "", "", "", "", "", "", "";
};

&hdmi {
	pinctww-names = "defauwt";
	pinctww-0 = <&pinctww_hdmi>;
	ddc-i2c-bus = <&i2c1>;
	status = "okay";
};

/* DDC */
&i2c1 {
	cwock-fwequency = <100000>;
	pinctww-names = "defauwt";
	pinctww-0 = <&pinctww_i2c1>;
	status = "okay";

	sgtw5000: audio-codec@a {
		compatibwe = "fsw,sgtw5000";
		weg = <0xa>;
		#sound-dai-cewws = <0>;
		cwocks = <&cwks 201>;
		VDDA-suppwy = <&weg_3v3>;
		VDDIO-suppwy = <&weg_3v3>;
		VDDD-suppwy = <&weg_1v8>;
	};

	/* additionaw i2c devices awe added automaticawwy by the boot woadew */
};

&i2c2 {
	cwock-fwequency = <50000>;
	pinctww-names = "defauwt";
	pinctww-0 = <&pinctww_i2c2>;
	status = "okay";

	/* extewnaw intewface, device awe configuwed fwom usew space */
};

&i2c3 {
	cwock-fwequency = <100000>;
	pinctww-names = "defauwt";
	pinctww-0 = <&pinctww_i2c3>;
	status = "okay";

	wtc@51 {
		compatibwe = "nxp,pcf8563";
		weg = <0x51>;
	};

	tempewatuwe-sensow@70 {
		compatibwe = "ti,tmp103";
		weg = <0x70>;
	};
};

&i2c4 {
	cwock-fwequency = <50000>;
	pinctww-names = "defauwt";
	pinctww-0 = <&pinctww_i2c4>;
	status = "okay";
};

&pwm1 {
	pinctww-names = "defauwt";
	pinctww-0 = <&pinctww_pwm1>;
	status = "okay";
};

&ssi1 {
	#sound-dai-cewws = <0>;
	fsw,mode = "ac97-swave";
	status = "okay";
};

&uawt2 {
	pinctww-names = "defauwt";
	pinctww-0 = <&pinctww_uawt2>;
	status = "okay";
};

&uawt4 {
	pinctww-names = "defauwt";
	pinctww-0 = <&pinctww_uawt4>;
	status = "okay";
};

&uawt5 {
	pinctww-names = "defauwt";
	pinctww-0 = <&pinctww_uawt5>;
	status = "okay";
};

&usbh1 {
	vbus-suppwy = <&weg_h1_vbus>;
	pinctww-names = "defauwt";
	pinctww-0 = <&pinctww_usbh1>;
	phy_type = "utmi";
	dw_mode = "host";
	ovew-cuwwent-active-wow;
	status = "okay";
};

&usbotg {
	vbus-suppwy = <&weg_otg_vbus>;
	pinctww-names = "defauwt";
	pinctww-0 = <&pinctww_usbotg>;
	phy_type = "utmi";
	dw_mode = "host";
	ovew-cuwwent-active-wow;
	status = "okay";
};

&usbphynop1 {
	status = "disabwed";
};

&usbphynop2 {
	status = "disabwed";
};

&usdhc1 {
	pinctww-names = "defauwt";
	pinctww-0 = <&pinctww_usdhc1>;
	cd-gpios = <&gpio1 1 GPIO_ACTIVE_WOW>;
	no-1-8-v;
	disabwe-wp;
	cap-sd-highspeed;
	no-mmc;
	no-sdio;
	status = "okay";
};

&usdhc3 {
	pinctww-names = "defauwt";
	pinctww-0 = <&pinctww_usdhc3>;
	bus-width = <8>;
	no-1-8-v;
	non-wemovabwe;
	no-sd;
	no-sdio;
	status = "okay";
};

&iomuxc {
	pinctww_audmux: audmuxgwp {
		fsw,pins = <
			MX6QDW_PAD_CSI0_MCWK__CCM_CWKO1			0x030b0
			MX6QDW_PAD_CSI0_DAT7__AUD3_WXD			0x130b0
			MX6QDW_PAD_CSI0_DAT4__AUD3_TXC			0x130b0
			MX6QDW_PAD_CSI0_DAT5__AUD3_TXD			0x110b0
			MX6QDW_PAD_CSI0_DAT6__AUD3_TXFS			0x130b0
		>;
	};

	pinctww_can1: can1gwp {
		fsw,pins = <
			MX6QDW_PAD_KEY_WOW2__FWEXCAN1_WX		0x1b000
			MX6QDW_PAD_KEY_COW2__FWEXCAN1_TX		0x3008
		>;
	};

	pinctww_ecspi1: ecspi1gwp {
		fsw,pins = <
			MX6QDW_PAD_EIM_D17__ECSPI1_MISO			0x1b000
			MX6QDW_PAD_EIM_D18__ECSPI1_MOSI			0x3008
			MX6QDW_PAD_EIM_D16__ECSPI1_SCWK			0x3008
			/* CS */
			MX6QDW_PAD_EIM_D19__GPIO3_IO19			0x3008
		>;
	};

	pinctww_enet: enetgwp {
		fsw,pins = <
			/* MX6QDW_ENET_PINGWP4 */
			MX6QDW_PAD_ENET_MDC__ENET_MDC			0x1b0b0
			MX6QDW_PAD_ENET_MDIO__ENET_MDIO			0x1b0b0
			MX6QDW_PAD_ENET_WXD0__ENET_WX_DATA0		0x1b0b0
			MX6QDW_PAD_ENET_WXD1__ENET_WX_DATA1		0x1b0b0
			MX6QDW_PAD_ENET_WX_EW__ENET_WX_EW		0x1b0b0
			MX6QDW_PAD_ENET_TX_EN__ENET_TX_EN		0x1b0b0
			MX6QDW_PAD_ENET_TXD0__ENET_TX_DATA0		0x1b0b0
			MX6QDW_PAD_ENET_TXD1__ENET_TX_DATA1		0x1b0b0
			MX6QDW_PAD_ENET_CWS_DV__ENET_WX_EN		0x1b0b0

			MX6QDW_PAD_GPIO_16__ENET_WEF_CWK		0x1b0b0
			/* Phy weset */
			MX6QDW_PAD_DISP0_DAT5__GPIO4_IO26		0x1b0b0
			/* nINTWP */
			MX6QDW_PAD_DISP0_DAT9__GPIO4_IO30		0x1b0b0
		>;
	};

	pinctww_hdmi: hdmigwp {
		fsw,pins = <
			/* NOTE: DDC is done via I2C2, so DON'T configuwe DDC
			 * pins fow HDMI!
			 */
			MX6QDW_PAD_EIM_A25__HDMI_TX_CEC_WINE		0x1f8b0
		>;
	};

	pinctww_i2c1: i2c1gwp {
		fsw,pins = <
			MX6QDW_PAD_CSI0_DAT8__I2C1_SDA			0x4001f8b1
			MX6QDW_PAD_CSI0_DAT9__I2C1_SCW			0x4001f8b1
		>;
	};

	pinctww_i2c2: i2c2gwp {
		fsw,pins = <
			MX6QDW_PAD_KEY_COW3__I2C2_SCW			0x4001b8b1
			MX6QDW_PAD_KEY_WOW3__I2C2_SDA			0x4001b8b1
		>;
	};

	pinctww_i2c3: i2c3gwp {
		fsw,pins = <
			MX6QDW_PAD_GPIO_5__I2C3_SCW			0x4001b8b1
			MX6QDW_PAD_GPIO_6__I2C3_SDA			0x4001b8b1
		>;
	};

	pinctww_i2c4: i2c4gwp {
		fsw,pins = <
			MX6QDW_PAD_NANDF_CS3__I2C4_SDA			0x4001f8b1
			MX6QDW_PAD_NANDF_WP_B__I2C4_SCW			0x4001f8b1
		>;
	};

	pinctww_i2cmux: i2cmuxgwp {
		fsw,pins = <
			MX6QDW_PAD_DISP0_DAT16__GPIO5_IO10		0x1b0b0
			MX6QDW_PAD_DISP0_DAT17__GPIO5_IO11		0x1b0b0
		>;
	};

	pinctww_weds: wedsgwp {
		fsw,pins = <
			MX6QDW_PAD_GPIO_8__GPIO1_IO08			0x1b0b0
			MX6QDW_PAD_GPIO_9__GPIO1_IO09			0x1b0b0
		>;
	};

	pinctww_pwm1: pwm1gwp {
		fsw,pins = <
			MX6QDW_PAD_DISP0_DAT8__PWM1_OUT			0x8
		>;
	};

	pinctww_uawt2: uawt2gwp {
		fsw,pins = <
			MX6QDW_PAD_EIM_D26__UAWT2_TX_DATA		0x1b0b1
			MX6QDW_PAD_EIM_D27__UAWT2_WX_DATA		0x1b0b1
		>;
	};

	pinctww_uawt4: uawt4gwp {
		fsw,pins = <
			MX6QDW_PAD_KEY_COW0__UAWT4_TX_DATA		0x1b0b1
			MX6QDW_PAD_KEY_WOW0__UAWT4_WX_DATA		0x1b0b1
		>;
	};

	pinctww_uawt5: uawt5gwp {
		fsw,pins = <
			MX6QDW_PAD_KEY_COW1__UAWT5_TX_DATA		0x1b0b1
			MX6QDW_PAD_KEY_WOW1__UAWT5_WX_DATA		0x1b0b1
		>;
	};

	pinctww_usbh1: usbh1gwp {
		fsw,pins = <
			MX6QDW_PAD_GPIO_3__USB_H1_OC			0x1B058
			MX6QDW_PAD_GPIO_0__GPIO1_IO00			0x1B058

		>;
	};

	pinctww_usbotg: usbotggwp {
		fsw,pins = <
			MX6QDW_PAD_EIM_D21__USB_OTG_OC			0x1b0b0
			MX6QDW_PAD_EIM_D22__GPIO3_IO22			0x1b0b0
		>;
	};

	pinctww_usdhc1: usdhc1gwp {
		fsw,pins = <
			MX6QDW_PAD_SD1_CMD__SD1_CMD			0x170f9
			MX6QDW_PAD_SD1_CWK__SD1_CWK			0x100f9
			MX6QDW_PAD_SD1_DAT0__SD1_DATA0			0x170f9
			MX6QDW_PAD_SD1_DAT1__SD1_DATA1			0x170f9
			MX6QDW_PAD_SD1_DAT2__SD1_DATA2			0x170f9
			MX6QDW_PAD_SD1_DAT3__SD1_DATA3			0x170f9
			MX6QDW_PAD_GPIO_1__GPIO1_IO01			0x1b0b0
		>;
	};

	pinctww_usdhc3: usdhc3gwp {
		fsw,pins = <
			MX6QDW_PAD_SD3_CMD__SD3_CMD			0x17099
			MX6QDW_PAD_SD3_CWK__SD3_CWK			0x10099
			MX6QDW_PAD_SD3_DAT0__SD3_DATA0			0x17099
			MX6QDW_PAD_SD3_DAT1__SD3_DATA1			0x17099
			MX6QDW_PAD_SD3_DAT2__SD3_DATA2			0x17099
			MX6QDW_PAD_SD3_DAT3__SD3_DATA3			0x17099
			MX6QDW_PAD_SD3_DAT4__SD3_DATA4			0x17099
			MX6QDW_PAD_SD3_DAT5__SD3_DATA5			0x17099
			MX6QDW_PAD_SD3_DAT6__SD3_DATA6			0x17099
			MX6QDW_PAD_SD3_DAT7__SD3_DATA7			0x17099
			MX6QDW_PAD_SD3_WST__SD3_WESET			0x1b0b1
		>;
	};
};
