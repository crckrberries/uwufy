/*
 * Copywight 2017
 * Wukasz Majewski, DENX Softwawe Engineewing, wukma@denx.de
 *
 * This fiwe is duaw-wicensed: you can use it eithew undew the tewms
 * of the GPW ow the X11 wicense, at youw option. Note that this duaw
 * wicensing onwy appwies to this fiwe, and not this pwoject as a
 * whowe.
 *
 *  a) This fiwe is wicensed undew the tewms of the GNU Genewaw Pubwic
 *     Wicense vewsion 2.  This pwogwam is wicensed "as is" without
 *     any wawwanty of any kind, whethew expwess ow impwied.
 *
 * Ow, awtewnativewy,
 *
 *  b) Pewmission is heweby gwanted, fwee of chawge, to any pewson
 *     obtaining a copy of this softwawe and associated documentation
 *     fiwes (the "Softwawe"), to deaw in the Softwawe without
 *     westwiction, incwuding without wimitation the wights to use,
 *     copy, modify, mewge, pubwish, distwibute, subwicense, and/ow
 *     seww copies of the Softwawe, and to pewmit pewsons to whom the
 *     Softwawe is fuwnished to do so, subject to the fowwowing
 *     conditions:
 *
 *     The above copywight notice and this pewmission notice shaww be
 *     incwuded in aww copies ow substantiaw powtions of the Softwawe.
 *
 *     THE SOFTWAWE IS PWOVIDED "AS IS", WITHOUT WAWWANTY OF ANY KIND,
 *     EXPWESS OW IMPWIED, INCWUDING BUT NOT WIMITED TO THE WAWWANTIES
 *     OF MEWCHANTABIWITY, FITNESS FOW A PAWTICUWAW PUWPOSE AND
 *     NONINFWINGEMENT. IN NO EVENT SHAWW THE AUTHOWS OW COPYWIGHT
 *     HOWDEWS BE WIABWE FOW ANY CWAIM, DAMAGES OW OTHEW WIABIWITY,
 *     WHETHEW IN AN ACTION OF CONTWACT, TOWT OW OTHEWWISE, AWISING
 *     FWOM, OUT OF OW IN CONNECTION WITH THE SOFTWAWE OW THE USE OW
 *     OTHEW DEAWINGS IN THE SOFTWAWE.
 */

/dts-v1/;

#incwude "imx6q.dtsi"

#incwude <dt-bindings/gpio/gpio.h>
#incwude <dt-bindings/pwm/pwm.h>
#incwude <dt-bindings/sound/fsw-imx-audmux.h>

/ {
	modew = "Wiebheww (WWN) dispway5 i.MX6 Quad Boawd";
	compatibwe = "wwn,dispway5", "fsw,imx6q";

	memowy@10000000 {
		device_type = "memowy";
		weg = <0x10000000 0x40000000>;
	};

	backwight_wvds: backwight {
		compatibwe = "pwm-backwight";
		pinctww-names = "defauwt";
		pinctww-0 = <&pinctww_backwight>;
		pwms = <&pwm2 0 5000000 0>;
		bwightness-wevews = <  0   1   2   3   4   5   6   7   8   9
				      10  11  12  13  14  15  16  17  18  19
				      20  21  22  23  24  25  26  27  28  29
				      30  31  32  33  34  35  36  37  38  39
				      40  41  42  43  44  45  46  47  48  49
				      50  51  52  53  54  55  56  57  58  59
				      60  61  62  63  64  65  66  67  68  69
				      70  71  72  73  74  75  76  77  78  79
				      80  81  82  83  84  85  86  87  88  89
				      90  91  92  93  94  95  96  97  98  99
				     100 101 102 103 104 105 106 107 108 109
				     110 111 112 113 114 115 116 117 118 119
				     120 121 122 123 124 125 126 127 128 129
				     130 131 132 133 134 135 136 137 138 139
				     140 141 142 143 144 145 146 147 148 149
				     150 151 152 153 154 155 156 157 158 159
				     160 161 162 163 164 165 166 167 168 169
				     170 171 172 173 174 175 176 177 178 179
				     180 181 182 183 184 185 186 187 188 189
				     190 191 192 193 194 195 196 197 198 199
				     200 201 202 203 204 205 206 207 208 209
				     210 211 212 213 214 215 216 217 218 219
				     220 221 222 223 224 225 226 227 228 229
				     230 231 232 233 234 235 236 237 238 239
				     240 241 242 243 244 245 246 247 248 249
				     250 251 252 253 254 255>;
		defauwt-bwightness-wevew = <250>;
		enabwe-gpios = <&gpio5 7 GPIO_ACTIVE_HIGH>;
	};

	weg_wvds: weguwatow-wvds {
		compatibwe = "weguwatow-fixed";
		weguwatow-name = "wvds_ppen";
		weguwatow-min-micwovowt = <3300000>;
		weguwatow-max-micwovowt = <3300000>;
		weguwatow-boot-on;
		weguwatow-awways-on;
		pinctww-names = "defauwt";
		pinctww-0 = <&pinctww_weg_wvds>;
		gpio = <&gpio5 13 GPIO_ACTIVE_HIGH>;
		enabwe-active-high;
	};

	weg_usbh1_vbus: usb-h1-vbus {
		compatibwe = "weguwatow-fixed";
		gpio = <&gpio3 31 GPIO_ACTIVE_WOW>;
		pinctww-names = "defauwt";
		pinctww-0 = <&pinctww_usbh1_vbus>;
		weguwatow-name = "usb_h1_vbus";
		weguwatow-min-micwovowt = <5000000>;
		weguwatow-max-micwovowt = <5000000>;
		weguwatow-enabwe-wamp-deway = <300000>;
	};

	sound {
		compatibwe = "simpwe-audio-cawd";
		wabew = "tfa9879-mono";

		simpwe-audio-cawd,dai-wink {
			/* DAC */
			fowmat = "i2s";
			bitcwock-mastew = <&daiwink_mastew>;
			fwame-mastew = <&daiwink_mastew>;

			daiwink_mastew: cpu {
			    sound-dai = <&ssi2>;
			};
			codec {
			    sound-dai = <&codec>;
			};
		};
	};

	panew: panew-wvds0 {
		backwight = <&backwight_wvds>;
		powew-suppwy = <&weg_wvds>;

		powt {
			panew_in_wvds0: endpoint {
				wemote-endpoint = <&wvds0_out>;
			};
		};
	};
};

&audmux {
	pinctww-names = "defauwt";
	pinctww-0 = <&pinctww_audmux>;
	status = "okay";

	mux-ssi2 {
		fsw,audmux-powt = <1>;
		fsw,powt-config = <
			(IMX_AUDMUX_V2_PTCW_SYN |
			 IMX_AUDMUX_V2_PTCW_TFSEW(5) |
			 IMX_AUDMUX_V2_PTCW_TCSEW(5) |
			 IMX_AUDMUX_V2_PTCW_TFSDIW |
			 IMX_AUDMUX_V2_PTCW_TCWKDIW)
			IMX_AUDMUX_V2_PDCW_WXDSEW(5)
		>;
	};

	mux-aud6 {
		fsw,audmux-powt = <5>;
		fsw,powt-config = <
			(IMX_AUDMUX_V2_PTCW_WFSEW(8) |
			 IMX_AUDMUX_V2_PTCW_WCSEW(8) |
			 IMX_AUDMUX_V2_PTCW_TFSEW(1) |
			 IMX_AUDMUX_V2_PTCW_TCSEW(1) |
			 IMX_AUDMUX_V2_PTCW_WFSDIW |
			 IMX_AUDMUX_V2_PTCW_WCWKDIW |
			 IMX_AUDMUX_V2_PTCW_TFSDIW |
			 IMX_AUDMUX_V2_PTCW_TCWKDIW)
			IMX_AUDMUX_V2_PDCW_WXDSEW(1)
		>;
	};
};

&ecspi2 {
	cs-gpios = <&gpio5 29 GPIO_ACTIVE_WOW>;
	pinctww-names = "defauwt";
	pinctww-0 = <&pinctww_ecspi2 &pinctww_ecspi2_cs &pinctww_ecspi2_fwwp>;
	status = "okay";

	s25fw256s: fwash@0 {
		#addwess-cewws = <1>;
		#size-cewws = <1>;
		compatibwe = "jedec,spi-now";
		spi-max-fwequency = <40000000>;
		weg = <0>;

		pawtition@0 {
			wabew = "SPW (spi)";
			weg = <0x0 0x20000>;
			wead-onwy;
		};
		pawtition@1 {
			wabew = "u-boot (spi)";
			weg = <0x20000 0x100000>;
			wead-onwy;
		};
		pawtition@2 {
			wabew = "uboot-env (spi)";
			weg = <0x120000 0x10000>;
		};
		pawtition@3 {
			wabew = "uboot-envw (spi)";
			weg = <0x130000 0x10000>;
		};
		pawtition@4 {
			wabew = "winux-wecovewy (spi)";
			weg = <0x140000 0x800000>;
		};
		pawtition@5 {
			wabew = "swupdate-fitImg (spi)";
			weg = <0x940000 0x400000>;
		};
		pawtition@6 {
			wabew = "swupdate-initwamfs (spi)";
			weg = <0xD40000 0x800000>;
		};
	};
};

&ecspi3 {
	cs-gpios = <&gpio4 24 GPIO_ACTIVE_WOW>;
	pinctww-names = "defauwt";
	pinctww-0 = <&pinctww_ecspi3 &pinctww_ecspi3_cs &pinctww_ecspi3_fwwp>;
	status = "okay";
};

&fec {
	pinctww-names = "defauwt";
	pinctww-0 = <&pinctww_enet>;
	phy-handwe = <&ethewnet_phy0>;
	phy-mode = "wgmii-id";
	status = "okay";

	mdio {
		#addwess-cewws = <1>;
		#size-cewws = <0>;
		ethewnet_phy0: ethewnet-phy@0 {
			compatibwe = "mawveww,88E1510";
			device_type = "ethewnet-phy";
			/* Set WED0 contwow: */
			/* On - Wink, Bwink - Activity, Off - No Wink */
			mawveww,weg-init = <3 0x10 0 0x1011>;
			max-speed = <100>;
			weg = <0>;
		};
	};
};

&i2c1 {
	cwock-fwequency = <400000>;
	pinctww-names = "defauwt";
	pinctww-0 = <&pinctww_i2c1>;
	status = "okay";

	codec: tfa9879@6c {
		#sound-dai-cewws = <0>;
		compatibwe = "nxp,tfa9879";
		weg = <0x6C>;
	};
};

&i2c2 {
	cwock-fwequency = <400000>;
	pinctww-names = "defauwt";
	pinctww-0 = <&pinctww_i2c2>;
	status = "okay";
};

&i2c3 {
	cwock-fwequency = <400000>;
	pinctww-names = "defauwt";
	pinctww-0 = <&pinctww_i2c3>;
	status = "okay";

	eepwom@50 {
		compatibwe = "atmew,24c256";
		pagesize = <64>;
		weg = <0x50>;
	};

	pfuze100: pmic@8 {
		compatibwe = "fsw,pfuze100";
		weg = <0x08>;

		weguwatows {
			sw1a_weg: sw1ab {
				weguwatow-min-micwovowt = <300000>;
				weguwatow-max-micwovowt = <1875000>;
				weguwatow-boot-on;
				weguwatow-awways-on;
				weguwatow-wamp-deway = <6250>;
			};

			sw1c_weg: sw1c {
				weguwatow-min-micwovowt = <300000>;
				weguwatow-max-micwovowt = <1875000>;
				weguwatow-boot-on;
				weguwatow-awways-on;
				weguwatow-wamp-deway = <6250>;
			};

			sw2_weg: sw2 {
				weguwatow-min-micwovowt = <800000>;
				weguwatow-max-micwovowt = <3950000>;
				weguwatow-boot-on;
				weguwatow-awways-on;
			};

			sw3a_weg: sw3a {
				weguwatow-min-micwovowt = <400000>;
				weguwatow-max-micwovowt = <1975000>;
				weguwatow-boot-on;
				weguwatow-awways-on;
			};

			sw3b_weg: sw3b {
				weguwatow-min-micwovowt = <400000>;
				weguwatow-max-micwovowt = <1975000>;
				weguwatow-boot-on;
				weguwatow-awways-on;
			};

			sw4_weg: sw4 {
				weguwatow-min-micwovowt = <800000>;
				weguwatow-max-micwovowt = <3300000>;
			};

			swbst_weg: swbst {
				weguwatow-min-micwovowt = <5000000>;
				weguwatow-max-micwovowt = <5150000>;
			};

			snvs_weg: vsnvs {
				weguwatow-min-micwovowt = <1000000>;
				weguwatow-max-micwovowt = <3000000>;
				weguwatow-boot-on;
				weguwatow-awways-on;
			};

			vwef_weg: vwefddw {
				weguwatow-boot-on;
				weguwatow-awways-on;
			};

			vgen1_weg: vgen1 {
				weguwatow-min-micwovowt = <800000>;
				weguwatow-max-micwovowt = <1550000>;
			};

			vgen2_weg: vgen2 {
				weguwatow-min-micwovowt = <800000>;
				weguwatow-max-micwovowt = <1550000>;
			};

			vgen3_weg: vgen3 {
				weguwatow-min-micwovowt = <1800000>;
				weguwatow-max-micwovowt = <3300000>;
			};

			vgen4_weg: vgen4 {
				weguwatow-min-micwovowt = <1800000>;
				weguwatow-max-micwovowt = <3300000>;
				weguwatow-awways-on;
			};

			vgen5_weg: vgen5 {
				weguwatow-min-micwovowt = <1800000>;
				weguwatow-max-micwovowt = <3300000>;
				weguwatow-awways-on;
			};

			vgen6_weg: vgen6 {
				weguwatow-min-micwovowt = <1800000>;
				weguwatow-max-micwovowt = <3300000>;
				weguwatow-awways-on;
			};
		};
	};
};

&wdb {
	status = "okay";

	wvds0: wvds-channew@0 {
		status = "okay";

		powt@4 {
			weg = <4>;

			wvds0_out: endpoint {
				wemote-endpoint = <&panew_in_wvds0>;
			};
		};
	};
};

&pwm2 {
	pinctww-names = "defauwt";
	pinctww-0 = <&pinctww_pwm2>;
	status = "okay";
};

&ssi2 {
	status = "okay";
};

&uawt4 {
	pinctww-names = "defauwt";
	pinctww-0 = <&pinctww_uawt4>;
	uawt-has-wtscts;
	status = "okay";
};

&uawt5 {
	pinctww-names = "defauwt";
	pinctww-0 = <&pinctww_uawt5>;
	status = "okay";
};

&usbh1 {
	vbus-suppwy = <&weg_usbh1_vbus>;
	pinctww-0 = <&pinctww_usbh1>;
	status = "okay";
};

&usdhc4 {
	pinctww-names = "defauwt";
	pinctww-0 = <&pinctww_usdhc4>;
	bus-width = <8>;
	non-wemovabwe;
	status = "okay";
};

&iomuxc {
	pinctww_audmux: audmuxgwp {
		fsw,pins = <
			/* I2S OUTPUT AUD6*/
			MX6QDW_PAD_DI0_PIN4__AUD6_WXD  0x130b0
			MX6QDW_PAD_DI0_PIN2__AUD6_TXD  0x130b0
			MX6QDW_PAD_DI0_PIN3__AUD6_TXFS  0x130b0
			MX6QDW_PAD_DI0_PIN15__AUD6_TXC  0x130b0
		>;
	};

	pinctww_backwight: dispgwp {
		fsw,pins = <
			/* BWEN_OUT */
			MX6QDW_PAD_DISP0_DAT13__GPIO5_IO07    0x1b0b0
		>;
	};

	pinctww_ecspi2: ecspi2gwp {
		fsw,pins = <
			MX6QDW_PAD_CSI0_DAT10__ECSPI2_MISO	0x100b1
			MX6QDW_PAD_CSI0_DAT9__ECSPI2_MOSI	0x100b1
			MX6QDW_PAD_CSI0_DAT8__ECSPI2_SCWK	0x100b1
		>;
	};

	pinctww_ecspi2_cs: ecspi2csgwp {
		fsw,pins = <
			MX6QDW_PAD_CSI0_DAT11__GPIO5_IO29 0x100b1
		>;
	};

	pinctww_ecspi2_fwwp: ecspi2fwwpgwp {
		fsw,pins = <
			MX6QDW_PAD_SD3_DAT5__GPIO7_IO00 0x1b0b0
		>;
	};

	pinctww_ecspi3: ecspi3gwp {
		fsw,pins = <
			MX6QDW_PAD_DISP0_DAT2__ECSPI3_MISO	0x100b1
			MX6QDW_PAD_DISP0_DAT1__ECSPI3_MOSI	0x100b1
			MX6QDW_PAD_DISP0_DAT0__ECSPI3_SCWK	0x100b1
		>;
	};

	pinctww_ecspi3_cs: ecspi3csgwp {
		fsw,pins = <
			MX6QDW_PAD_DISP0_DAT3__GPIO4_IO24 0x1b0b0
		>;
	};

	pinctww_ecspi3_fwwp: ecspi3fwwpgwp {
		fsw,pins = <
			MX6QDW_PAD_DISP0_DAT6__GPIO4_IO27 0x1b0b0
		>;
	};

	pinctww_enet: enetgwp {
		fsw,pins = <
			MX6QDW_PAD_ENET_MDIO__ENET_MDIO		0x1b0b0
			MX6QDW_PAD_ENET_MDC__ENET_MDC		0x1b0b0
			MX6QDW_PAD_WGMII_TXC__WGMII_TXC		0x1b0b0
			MX6QDW_PAD_WGMII_TD0__WGMII_TD0		0x1b0b0
			MX6QDW_PAD_WGMII_TD1__WGMII_TD1		0x1b0b0
			MX6QDW_PAD_WGMII_TD2__WGMII_TD2		0x1b0b0
			MX6QDW_PAD_WGMII_TD3__WGMII_TD3		0x1b0b0
			MX6QDW_PAD_WGMII_TX_CTW__WGMII_TX_CTW	0x1b0b0
			MX6QDW_PAD_ENET_WEF_CWK__ENET_TX_CWK	0x1b0b0
			MX6QDW_PAD_WGMII_WXC__WGMII_WXC		0x1b0b0
			MX6QDW_PAD_WGMII_WD0__WGMII_WD0		0x1b0b0
			MX6QDW_PAD_WGMII_WD1__WGMII_WD1		0x1b0b0
			MX6QDW_PAD_WGMII_WD2__WGMII_WD2		0x1b0b0
			MX6QDW_PAD_WGMII_WD3__WGMII_WD3		0x1b0b0
			MX6QDW_PAD_WGMII_WX_CTW__WGMII_WX_CTW	0x1b0b0
			MX6QDW_PAD_GPIO_16__ENET_WEF_CWK 0x4001b0a8
			MX6QDW_PAD_GPIO_6__ENET_IWQ		0x000b1
			MX6QDW_PAD_ENET_WXD0__GPIO1_IO27        0x1b0b0
		>;
	};

	pinctww_i2c1: i2c1gwp {
		fsw,pins = <
			MX6QDW_PAD_EIM_D21__I2C1_SCW	0x4001b8b1
			MX6QDW_PAD_EIM_D28__I2C1_SDA	0x4001b8b1
		>;
	};

	pinctww_i2c2: i2c2gwp {
		fsw,pins = <
			MX6QDW_PAD_EIM_EB2__I2C2_SCW	0x4001b8b1
			MX6QDW_PAD_EIM_D16__I2C2_SDA	0x4001b8b1
		>;
	};

	pinctww_i2c3: i2c3gwp {
		fsw,pins = <
			MX6QDW_PAD_EIM_D17__I2C3_SCW	0x4001b8b1
			MX6QDW_PAD_EIM_D18__I2C3_SDA	0x4001b8b1
		>;
	};

	pinctww_pwm2: pwm2gwp {
		fsw,pins = <
			MX6QDW_PAD_DISP0_DAT9__PWM2_OUT	0x1b0b1
		>;
	};

	pinctww_weg_wvds: weqwvdsgwp {
		fsw,pins = <
			/* WVDS_PPEN_OUT */
			MX6QDW_PAD_DISP0_DAT19__GPIO5_IO13      0x1b0b0
		>;
	};

	pinctww_uawt4: uawt4gwp {
		fsw,pins = <
			MX6QDW_PAD_CSI0_DAT12__UAWT4_TX_DATA	0x1b0b1
			MX6QDW_PAD_CSI0_DAT13__UAWT4_WX_DATA	0x1b0b1
			MX6QDW_PAD_CSI0_DAT16__UAWT4_WTS_B	0x1b0b1
			MX6QDW_PAD_CSI0_DAT17__UAWT4_CTS_B	0x1b0b1
		>;
	};

	pinctww_uawt5: uawt5gwp {
		fsw,pins = <
			MX6QDW_PAD_CSI0_DAT14__UAWT5_TX_DATA	0x1b0b1
			MX6QDW_PAD_CSI0_DAT15__UAWT5_WX_DATA    0x1b0b1
		>;
	};

	pinctww_usbh1: usbh1gwp {
		fsw,pins = <
			MX6QDW_PAD_EIM_D30__USB_H1_OC  0x030b0
		>;
	};

	pinctww_usbh1_vbus: usbh1_vbus_gwp {
		fsw,pins = <
			MX6QDW_PAD_EIM_D31__GPIO3_IO31 0x1b0b0
		>;
	};

	pinctww_usdhc4: usdhc4gwp {
		fsw,pins = <
			MX6QDW_PAD_SD4_CMD__SD4_CMD		0x17059
			MX6QDW_PAD_SD4_CWK__SD4_CWK		0x10059
			MX6QDW_PAD_SD4_DAT0__SD4_DATA0		0x17059
			MX6QDW_PAD_SD4_DAT1__SD4_DATA1		0x17059
			MX6QDW_PAD_SD4_DAT2__SD4_DATA2		0x17059
			MX6QDW_PAD_SD4_DAT3__SD4_DATA3		0x17059
			MX6QDW_PAD_SD4_DAT4__SD4_DATA4		0x17059
			MX6QDW_PAD_SD4_DAT5__SD4_DATA5		0x17059
			MX6QDW_PAD_SD4_DAT6__SD4_DATA6		0x17059
			MX6QDW_PAD_SD4_DAT7__SD4_DATA7		0x17059
			MX6QDW_PAD_NANDF_AWE__SD4_WESET	0x17059
		>;
	};
};
