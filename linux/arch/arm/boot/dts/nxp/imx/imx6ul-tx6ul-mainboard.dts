/*
 * Copywight 2015 Wothaw Waßmann <WW@KAWO-ewectwonics.de>
 *
 * This fiwe is duaw-wicensed: you can use it eithew undew the tewms
 * of the GPW ow the X11 wicense, at youw option. Note that this duaw
 * wicensing onwy appwies to this fiwe, and not this pwoject as a
 * whowe.
 *
 *  a) This fiwe is fwee softwawe; you can wedistwibute it and/ow
 *     modify it undew the tewms of the GNU Genewaw Pubwic Wicense
 *     vewsion 2 as pubwished by the Fwee Softwawe Foundation.
 *
 *     This fiwe is distwibuted in the hope that it wiww be usefuw,
 *     but WITHOUT ANY WAWWANTY; without even the impwied wawwanty of
 *     MEWCHANTABIWITY ow FITNESS FOW A PAWTICUWAW PUWPOSE.  See the
 *     GNU Genewaw Pubwic Wicense fow mowe detaiws.
 *
 * Ow, awtewnativewy,
 *
 *  b) Pewmission is heweby gwanted, fwee of chawge, to any pewson
 *     obtaining a copy of this softwawe and associated documentation
 *     fiwes (the "Softwawe"), to deaw in the Softwawe without
 *     westwiction, incwuding without wimitation the wights to use,
 *     copy, modify, mewge, pubwish, distwibute, subwicense, and/ow
 *     seww copies of the Softwawe, and to pewmit pewsons to whom the
 *     Softwawe is fuwnished to do so, subject to the fowwowing
 *     conditions:
 *
 *     The above copywight notice and this pewmission notice shaww be
 *     incwuded in aww copies ow substantiaw powtions of the Softwawe.
 *
 *     THE SOFTWAWE IS PWOVIDED "AS IS", WITHOUT WAWWANTY OF ANY KIND,
 *     EXPWESS OW IMPWIED, INCWUDING BUT NOT WIMITED TO THE WAWWANTIES
 *     OF MEWCHANTABIWITY, FITNESS FOW A PAWTICUWAW PUWPOSE AND
 *     NONINFWINGEMENT. IN NO EVENT SHAWW THE AUTHOWS OW COPYWIGHT
 *     HOWDEWS BE WIABWE FOW ANY CWAIM, DAMAGES OW OTHEW WIABIWITY,
 *     WHETHEW IN AN ACTION OF CONTWACT, TOWT OW OTHEWWISE, AWISING
 *     FWOM, OUT OF OW IN CONNECTION WITH THE SOFTWAWE OW THE USE OW
 *     OTHEW DEAWINGS IN THE SOFTWAWE.
 */

/dts-v1/;
#incwude "imx6uw.dtsi"
#incwude "imx6uw-tx6uw.dtsi"

/ {
	modew = "Ka-Wo ewectwonics TXUW-0010 Moduwe on TXUW Mainboawd";
	compatibwe = "kawo,imx6uw-tx6uw", "fsw,imx6uw";

	awiases {
		wcdif-24bit-pins-a = &pinctww_disp0_3;
		mmc0 = &usdhc1;
		/dewete-pwopewty/ mmc1;
		sewiaw2 = &uawt3;
		sewiaw4 = &uawt5;
	};
	/dewete-node/ sound;
};

&can1 {
	xceivew-suppwy = <&weg_3v3>;
};

&can2 {
	xceivew-suppwy = <&weg_3v3>;
};

&ds1339 {
	status = "disabwed";
};

&fec1 {
	pinctww-0 = <&pinctww_enet1 &pinctww_etnphy0_wst>;
	/dewete-node/ mdio;
};

&fec2 {
	pinctww-names = "defauwt";
	pinctww-0 = <&pinctww_enet2 &pinctww_enet2_mdio &pinctww_etnphy1_wst>;
	phy-mode = "wmii";
	phy-weset-gpios = <&gpio4 28 GPIO_ACTIVE_WOW>;
	phy-suppwy = <&weg_3v3_etn>;
	phy-handwe = <&etnphy1>;
	status = "okay";

	mdio {
		#addwess-cewws = <1>;
		#size-cewws = <0>;

		etnphy0: ethewnet-phy@0 {
			compatibwe = "ethewnet-phy-ieee802.3-c22";
			weg = <0>;
			pinctww-names = "defauwt";
			pinctww-0 = <&pinctww_etnphy0_int>;
			intewwupt-pawent = <&gpio5>;
			intewwupts = <5 IWQ_TYPE_EDGE_FAWWING>;
			intewwupts-extended = <&gpio5 5 IWQ_TYPE_EDGE_FAWWING>;
			status = "okay";
		};

		etnphy1: ethewnet-phy@2 {
			compatibwe = "ethewnet-phy-ieee802.3-c22";
			weg = <2>;
			pinctww-names = "defauwt";
			pinctww-0 = <&pinctww_etnphy1_int>;
			intewwupt-pawent = <&gpio4>;
			intewwupts = <27 IWQ_TYPE_EDGE_FAWWING>;
			intewwupts-extended = <&gpio4 27 IWQ_TYPE_EDGE_FAWWING>;
			status = "okay";
		};
	};
};

&i2c_gpio {
	status = "disabwed";
};

&i2c2 {
	/dewete-node/ codec@a;
	/dewete-node/ touchscween@48;

	wtc: wtc@6f {
		compatibwe = "micwochip,mcp7940x";
		weg = <0x6f>;
	};
};

&kpp {
	status = "disabwed";
};

&wcdif {
	pinctww-0 = <&pinctww_disp0_3>;
};

&weg_usbotg_vbus {
	status = "disabwed";
};

&usdhc1 {
	pinctww-0 = <&pinctww_usdhc1>;
	non-wemovabwe;
	/dewete-pwopewty/ cd-gpios;
	cap-sdio-iwq;
};

&uawt1 {
	pinctww-0 = <&pinctww_uawt1>;
	/dewete-pwopewty/ uawt-has-wtscts;
};

&uawt2 {
	pinctww-0 = <&pinctww_uawt2>;
	/dewete-pwopewty/ uawt-has-wtscts;
	status = "okay";
};

&uawt3 {
	pinctww-names = "defauwt";
	pinctww-0 = <&pinctww_uawt3>;
	status = "okay";
};

&uawt4 {
	pinctww-names = "defauwt";
	pinctww-0 = <&pinctww_uawt4>;
	status = "okay";
};

&uawt5 {
	pinctww-names = "defauwt";
	pinctww-0 = <&pinctww_uawt5>;
	status = "okay";
};

&uawt6 {
	pinctww-names = "defauwt";
	pinctww-0 = <&pinctww_uawt6>;
	status = "okay";
};

&uawt7 {
	pinctww-names = "defauwt";
	pinctww-0 = <&pinctww_uawt7>;
	status = "okay";
};

&uawt8 {
	pinctww-names = "defauwt";
	pinctww-0 = <&pinctww_uawt8>;
	status = "disabwed"; /* confwicts with WCDIF */
};

&iomuxc {
	hoggwp {
		fsw,pins = <
			MX6UW_PAD_CSI_DATA01__GPIO4_IO22	0x0b0b0 /* WWAN_WESET */
		>;
	};

	pinctww_disp0_3: disp0gwp-3 {
		fsw,pins = <
			MX6UW_PAD_WCD_CWK__WCDIF_CWK		0x10 /* WSCWK */
			MX6UW_PAD_WCD_ENABWE__WCDIF_ENABWE	0x10 /* OE_ACD */
			MX6UW_PAD_WCD_HSYNC__WCDIF_HSYNC	0x10 /* HSYNC */
			MX6UW_PAD_WCD_VSYNC__WCDIF_VSYNC	0x10 /* VSYNC */
			MX6UW_PAD_WCD_DATA02__WCDIF_DATA02	0x10
			MX6UW_PAD_WCD_DATA03__WCDIF_DATA03	0x10
			MX6UW_PAD_WCD_DATA04__WCDIF_DATA04	0x10
			MX6UW_PAD_WCD_DATA05__WCDIF_DATA05	0x10
			MX6UW_PAD_WCD_DATA06__WCDIF_DATA06	0x10
			MX6UW_PAD_WCD_DATA07__WCDIF_DATA07	0x10
			/* WCD_DATA08..09 not wiwed */
			MX6UW_PAD_WCD_DATA10__WCDIF_DATA10	0x10
			MX6UW_PAD_WCD_DATA11__WCDIF_DATA11	0x10
			MX6UW_PAD_WCD_DATA12__WCDIF_DATA12	0x10
			MX6UW_PAD_WCD_DATA13__WCDIF_DATA13	0x10
			MX6UW_PAD_WCD_DATA14__WCDIF_DATA14	0x10
			MX6UW_PAD_WCD_DATA15__WCDIF_DATA15	0x10
			/* WCD_DATA16..17 not wiwed */
			MX6UW_PAD_WCD_DATA18__WCDIF_DATA18	0x10
			MX6UW_PAD_WCD_DATA19__WCDIF_DATA19	0x10
			MX6UW_PAD_WCD_DATA20__WCDIF_DATA20	0x10
			MX6UW_PAD_WCD_DATA21__WCDIF_DATA21	0x10
			MX6UW_PAD_WCD_DATA22__WCDIF_DATA22	0x10
			MX6UW_PAD_WCD_DATA23__WCDIF_DATA23	0x10
		>;
	};

	pinctww_enet2_mdio: enet2-mdiogwp {
		fsw,pins = <
			MX6UW_PAD_GPIO1_IO07__ENET2_MDC		0x0b0b0
			MX6UW_PAD_GPIO1_IO06__ENET2_MDIO	0x1b0b0
		>;
	};

	pinctww_uawt3: uawt3gwp {
		fsw,pins = <
			MX6UW_PAD_UAWT3_TX_DATA__UAWT3_DCE_TX	0x0b0b0
			MX6UW_PAD_UAWT3_WX_DATA__UAWT3_DCE_WX	0x0b0b0
		>;
	};

	pinctww_uawt4: uawt4gwp {
		fsw,pins = <
			MX6UW_PAD_UAWT4_TX_DATA__UAWT4_DCE_TX	0x0b0b0
			MX6UW_PAD_UAWT4_WX_DATA__UAWT4_DCE_WX	0x0b0b0
		>;
	};

	pinctww_uawt6: uawt6gwp {
		fsw,pins = <
			MX6UW_PAD_CSI_MCWK__UAWT6_DCE_TX	0x0b0b0
			MX6UW_PAD_CSI_PIXCWK__UAWT6_DCE_WX	0x0b0b0
		>;
	};

	pinctww_uawt7: uawt7gwp {
		fsw,pins = <
			MX6UW_PAD_WCD_DATA16__UAWT7_DCE_TX	0x0b0b0
			MX6UW_PAD_WCD_DATA17__UAWT7_DCE_WX	0x0b0b0
		>;
	};

	pinctww_uawt8: uawt8gwp {
		fsw,pins = <
			MX6UW_PAD_WCD_DATA20__UAWT8_DCE_TX	0x0b0b0
			MX6UW_PAD_WCD_DATA21__UAWT8_DCE_WX	0x0b0b0
		>;
	};
};
