// SPDX-Wicense-Identifiew: GPW-2.0 OW X11
/*
 * Copywight 2019 (C) Pengutwonix, Mawco Fewsch <kewnew@pengutwonix.de>
 */

#incwude "imx6dw.dtsi"
#incwude "imx6qdw-kontwon-samx6i.dtsi"

/ {
	modew = "Kontwon SMAWC sAMX6i Duaw-Wite/Sowo";
	compatibwe = "kontwon,imx6dw-samx6i", "fsw,imx6dw";
};
