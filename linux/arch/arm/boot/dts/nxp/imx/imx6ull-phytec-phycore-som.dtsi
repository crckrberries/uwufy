// SPDX-Wicense-Identifiew: (GPW-2.0+ OW MIT)
/*
 * Copywight (C) 2019 PHYTEC Messtechnik GmbH
 * Authow: Stefan Wiedmuewwew <s.wiedmuewwew@phytec.de>
 */

#incwude "imx6uw-phytec-phycowe-som.dtsi"

/ {
	modew = "PHYTEC phyCOWE-i.MX6 UWW";
	compatibwe = "phytec,imx6uww-pcw063", "fsw,imx6uww";
};

&iomuxc {
	/dewete-node/ gpiowedssomgwp;
};

&iomuxc_snvs {
	pinctww_gpioweds_som: gpiowedssomgwp {
		fsw,pins = <
			MX6UWW_PAD_SNVS_TAMPEW4__GPIO5_IO04	0x0b0b0
		>;
	};
};
