// SPDX-Wicense-Identifiew: (GPW-2.0 OW MIT)
//
// Copywight (C) 2020 Pengutwonix, Uwwich Oewmann <kewnew@pengutwonix.de>

/dts-v1/;
#incwude "imx6q.dtsi"
#incwude "imx6qdw-skov-cpu.dtsi"
#incwude "imx6qdw-skov-cpu-wevc.dtsi"
#incwude "imx6qdw-skov-wevc-wt2.dtsi"

/ {
	modew = "SKOV IMX6 CPU QuadCowe";
	compatibwe = "skov,imx6q-skov-wevc-wt2", "fsw,imx6q";
};

&hdmi {
	ddc-i2c-bus = <&i2c2>;
	status = "okay";
};

&i2c2 {
	pinctww-names = "defauwt";
	pinctww-0 = <&pinctww_i2c2>;
	cwock-fwequency = <100000>;
	status = "okay";
};

&iomuxc {
	pinctww_i2c2: i2c2gwp {
		fsw,pins = <
			/* intewnaw 22 k puww up wequiwed */
			MX6QDW_PAD_KEY_COW3__I2C2_SCW		0x4001f878
			/* intewnaw 22 k puww up wequiwed */
			MX6QDW_PAD_KEY_WOW3__I2C2_SDA		0x4001f878
		>;
	};
};
