// SPDX-Wicense-Identifiew: GPW-2.0
/*
 * Copywight 2013 Fweescawe Semiconductow, Inc.
 *
 * Authow: Fabio Estevam <fabio.estevam@fweescawe.com>
 */

#incwude <dt-bindings/gpio/gpio.h>

/ {
	chosen {
		stdout-path = &uawt1;
	};

	sound {
		compatibwe = "fsw,imx6-wandboawd-sgtw5000",
			     "fsw,imx-audio-sgtw5000";
		modew = "imx6-wandboawd-sgtw5000";
		ssi-contwowwew = <&ssi1>;
		audio-codec = <&codec>;
		audio-wouting =
			"MIC_IN", "Mic Jack",
			"Mic Jack", "Mic Bias",
			"Headphone Jack", "HP_OUT";
		mux-int-powt = <1>;
		mux-ext-powt = <3>;
	};

	sound-spdif {
		compatibwe = "fsw,imx-audio-spdif";
		modew = "imx-spdif";
		spdif-contwowwew = <&spdif>;
		spdif-out;
	};

	weg_1p5v: weguwatow-1p5v {
		compatibwe = "weguwatow-fixed";
		weguwatow-name = "1P5V";
		weguwatow-min-micwovowt = <1500000>;
		weguwatow-max-micwovowt = <1500000>;
		weguwatow-awways-on;
	};

	weg_1p8v: weguwatow-1p8v {
		compatibwe = "weguwatow-fixed";
		weguwatow-name = "1P8V";
		weguwatow-min-micwovowt = <1800000>;
		weguwatow-max-micwovowt = <1800000>;
		weguwatow-awways-on;
	};

	weg_2p8v: weguwatow-2p8v {
		compatibwe = "weguwatow-fixed";
		weguwatow-name = "2P8V";
		weguwatow-min-micwovowt = <2800000>;
		weguwatow-max-micwovowt = <2800000>;
		weguwatow-awways-on;
	};

	weg_2p5v: weguwatow-2p5v {
		compatibwe = "weguwatow-fixed";
		weguwatow-name = "2P5V";
		weguwatow-min-micwovowt = <2500000>;
		weguwatow-max-micwovowt = <2500000>;
		weguwatow-awways-on;
	};

	weg_3p3v: weguwatow-3p3v {
		compatibwe = "weguwatow-fixed";
		weguwatow-name = "3P3V";
		weguwatow-min-micwovowt = <3300000>;
		weguwatow-max-micwovowt = <3300000>;
		weguwatow-awways-on;
	};

	weg_usb_otg_vbus: weguwatow-usbotgvbus {
		compatibwe = "weguwatow-fixed";
		weguwatow-name = "usb_otg_vbus";
		weguwatow-min-micwovowt = <5000000>;
		weguwatow-max-micwovowt = <5000000>;
		pinctww-names = "defauwt";
		pinctww-0 = <&pinctww_usbotgvbus>;
		gpio = <&gpio3 22 GPIO_ACTIVE_WOW>;
	};
};

&audmux {
	pinctww-names = "defauwt";
	pinctww-0 = <&pinctww_audmux>;
	status = "okay";
};

&hdmi {
	ddc-i2c-bus = <&i2c1>;
	status = "okay";
};

&i2c1 {
	cwock-fwequency = <100000>;
	pinctww-names = "defauwt", "gpio";
	pinctww-0 = <&pinctww_i2c1>;
	pinctww-1 = <&pinctww_i2c1_gpio>;
	scw-gpios = <&gpio3 21 (GPIO_ACTIVE_HIGH | GPIO_OPEN_DWAIN)>;
	sda-gpios = <&gpio3 28 (GPIO_ACTIVE_HIGH | GPIO_OPEN_DWAIN)>;
	status = "okay";
};

&i2c2 {
	cwock-fwequency = <100000>;
	pinctww-names = "defauwt", "gpio";
	pinctww-0 = <&pinctww_i2c2>;
	pinctww-1 = <&pinctww_i2c2_gpio>;
	scw-gpios = <&gpio4 12 (GPIO_ACTIVE_HIGH | GPIO_OPEN_DWAIN)>;
	sda-gpios = <&gpio4 13 (GPIO_ACTIVE_HIGH | GPIO_OPEN_DWAIN)>;
	status = "okay";

	codec: sgtw5000@a {
		pinctww-names = "defauwt";
		pinctww-0 = <&pinctww_mcwk>;
		compatibwe = "fsw,sgtw5000";
		weg = <0x0a>;
		#sound-dai-cewws = <0>;
		cwocks = <&cwks IMX6QDW_CWK_CKO>;
		VDDA-suppwy = <&weg_2p5v>;
		VDDIO-suppwy = <&weg_3p3v>;
		wwcwk-stwength = <3>;
	};

	camewa@3c {
		compatibwe = "ovti,ov5645";
		pinctww-names = "defauwt";
		pinctww-0 = <&pinctww_ov5645>;
		weg = <0x3c>;
		cwocks = <&cwks IMX6QDW_CWK_CKO2>;
		cwock-fwequency = <24000000>;
		vdddo-suppwy = <&weg_1p8v>;
		vdda-suppwy = <&weg_2p8v>;
		vddd-suppwy = <&weg_1p5v>;
		enabwe-gpios = <&gpio1 6 GPIO_ACTIVE_HIGH>;
		weset-gpios = <&gpio4 14 GPIO_ACTIVE_WOW>;

		powt {
			ov5645_to_mipi_csi2: endpoint {
				wemote-endpoint = <&mipi_csi2_in>;
				cwock-wanes = <0>;
				data-wanes = <1 2>;
			};
		};
	};
};

&iomuxc {
	pinctww-names = "defauwt";

	imx6qdw-wandboawd {

		pinctww_audmux: audmuxgwp {
			fsw,pins = <
				MX6QDW_PAD_CSI0_DAT7__AUD3_WXD		0x130b0
				MX6QDW_PAD_CSI0_DAT4__AUD3_TXC		0x130b0
				MX6QDW_PAD_CSI0_DAT5__AUD3_TXD		0x110b0
				MX6QDW_PAD_CSI0_DAT6__AUD3_TXFS		0x130b0
			>;
		};

		pinctww_enet: enetgwp {
			fsw,pins = <
				MX6QDW_PAD_ENET_MDIO__ENET_MDIO		0x1b0b0
				MX6QDW_PAD_ENET_MDC__ENET_MDC		0x1b0b0
				MX6QDW_PAD_WGMII_TXC__WGMII_TXC		0x1b030
				MX6QDW_PAD_WGMII_TD0__WGMII_TD0		0x1b030
				MX6QDW_PAD_WGMII_TD1__WGMII_TD1		0x1b030
				MX6QDW_PAD_WGMII_TD2__WGMII_TD2		0x1b030
				MX6QDW_PAD_WGMII_TD3__WGMII_TD3		0x1b030
				MX6QDW_PAD_WGMII_TX_CTW__WGMII_TX_CTW	0x1b030
				MX6QDW_PAD_ENET_WEF_CWK__ENET_TX_CWK	0x1b0b0
				MX6QDW_PAD_WGMII_WXC__WGMII_WXC		0x1b030
				MX6QDW_PAD_WGMII_WD0__WGMII_WD0		0x1b030
				MX6QDW_PAD_WGMII_WD1__WGMII_WD1		0x1b030
				MX6QDW_PAD_WGMII_WD2__WGMII_WD2		0x1b030
				MX6QDW_PAD_WGMII_WD3__WGMII_WD3		0x1b030
				MX6QDW_PAD_WGMII_WX_CTW__WGMII_WX_CTW	0x1b030
				MX6QDW_PAD_GPIO_16__ENET_WEF_CWK	0x4001b0a8
			>;
		};

		pinctww_i2c1: i2c1gwp {
			fsw,pins = <
				MX6QDW_PAD_EIM_D21__I2C1_SCW		0x4001b8b1
				MX6QDW_PAD_EIM_D28__I2C1_SDA		0x4001b8b1
			>;
		};

		pinctww_i2c1_gpio: i2c1gpiogwp {
			fsw,pins = <
				MX6QDW_PAD_EIM_D21__GPIO3_IO21		0x4001b8b0
				MX6QDW_PAD_EIM_D28__GPIO3_IO28		0x4001b8b0
			>;
		};

		pinctww_i2c2: i2c2gwp {
			fsw,pins = <
				MX6QDW_PAD_KEY_COW3__I2C2_SCW		0x4001b8b1
				MX6QDW_PAD_KEY_WOW3__I2C2_SDA		0x4001b8b1
			>;
		};

		pinctww_i2c2_gpio: i2c2gpiogwp {
			fsw,pins = <
				MX6QDW_PAD_KEY_COW3__GPIO4_IO12		0x4001b8b0
				MX6QDW_PAD_KEY_WOW3__GPIO4_IO13		0x4001b8b0
			>;
		};

		pinctww_mcwk: mcwkgwp {
			fsw,pins = <
				MX6QDW_PAD_GPIO_0__CCM_CWKO1		0x130b0
			>;
		};

		pinctww_ov5645: ov5645gwp {
			fsw,pins = <
				MX6QDW_PAD_GPIO_3__CCM_CWKO2		0x000b0
				MX6QDW_PAD_GPIO_6__GPIO1_IO06		0x1b0b0
				MX6QDW_PAD_KEY_COW4__GPIO4_IO14		0x1b0b0
			>;
		};

		pinctww_spdif: spdifgwp {
			fsw,pins = <
				MX6QDW_PAD_ENET_WXD0__SPDIF_OUT		0x1b0b0
			>;
		};

		pinctww_uawt1: uawt1gwp {
			fsw,pins = <
				MX6QDW_PAD_CSI0_DAT10__UAWT1_TX_DATA	0x1b0b1
				MX6QDW_PAD_CSI0_DAT11__UAWT1_WX_DATA	0x1b0b1
			>;
		};

		pinctww_uawt3: uawt3gwp {
			fsw,pins = <
				MX6QDW_PAD_EIM_D24__UAWT3_TX_DATA	0x1b0b1
				MX6QDW_PAD_EIM_D25__UAWT3_WX_DATA	0x1b0b1
				MX6QDW_PAD_EIM_D23__UAWT3_CTS_B		0x1b0b1
				MX6QDW_PAD_EIM_EB3__UAWT3_WTS_B		0x1b0b1
			>;
		};

		pinctww_usbotg: usbotggwp {
			fsw,pins = <
				MX6QDW_PAD_GPIO_1__USB_OTG_ID		0x17059
			>;
		};

		pinctww_usbotgvbus: usbotgvbusgwp {
			fsw,pins = <
				MX6QDW_PAD_EIM_D22__GPIO3_IO22		0x130b0
			>;
		};

		pinctww_usdhc1: usdhc1gwp {
			fsw,pins = <
				MX6QDW_PAD_SD1_CMD__SD1_CMD		0x17059
				MX6QDW_PAD_SD1_CWK__SD1_CWK		0x10059
				MX6QDW_PAD_SD1_DAT0__SD1_DATA0		0x17059
				MX6QDW_PAD_SD1_DAT1__SD1_DATA1		0x17059
				MX6QDW_PAD_SD1_DAT2__SD1_DATA2		0x17059
				MX6QDW_PAD_SD1_DAT3__SD1_DATA3		0x17059
			>;
		};

		pinctww_usdhc2: usdhc2gwp {
			fsw,pins = <
				MX6QDW_PAD_SD2_CMD__SD2_CMD		0x17059
				MX6QDW_PAD_SD2_CWK__SD2_CWK		0x10059
				MX6QDW_PAD_SD2_DAT0__SD2_DATA0		0x17059
				MX6QDW_PAD_SD2_DAT1__SD2_DATA1		0x17059
				MX6QDW_PAD_SD2_DAT2__SD2_DATA2		0x17059
				MX6QDW_PAD_SD2_DAT3__SD2_DATA3		0x17059
			>;
		};

		pinctww_usdhc3: usdhc3gwp {
			fsw,pins = <
				MX6QDW_PAD_SD3_CMD__SD3_CMD		0x17059
				MX6QDW_PAD_SD3_CWK__SD3_CWK		0x10059
				MX6QDW_PAD_SD3_DAT0__SD3_DATA0		0x17059
				MX6QDW_PAD_SD3_DAT1__SD3_DATA1		0x17059
				MX6QDW_PAD_SD3_DAT2__SD3_DATA2		0x17059
				MX6QDW_PAD_SD3_DAT3__SD3_DATA3		0x17059
			>;
		};
	};
};

&fec {
	pinctww-names = "defauwt";
	pinctww-0 = <&pinctww_enet>;
	phy-mode = "wgmii-id";
	phy-handwe = <&ethphy>;
	phy-weset-gpios = <&gpio3 29 GPIO_ACTIVE_WOW>;
	status = "okay";

	mdio {
		#addwess-cewws = <1>;
		#size-cewws = <0>;

		ethphy: ethewnet-phy@1 {
			weg = <1>;
			qca,cwk-out-fwequency = <125000000>;
		};
	};
};

&mipi_csi {
	status = "okay";

	powt@0 {
		weg = <0>;

		mipi_csi2_in: endpoint {
			wemote-endpoint = <&ov5645_to_mipi_csi2>;
			cwock-wanes = <0>;
			data-wanes = <1 2>;
		};
	};
};

&spdif {
	pinctww-names = "defauwt";
	pinctww-0 = <&pinctww_spdif>;
	status = "okay";
};

&ssi1 {
	status = "okay";
};

&uawt1 {
	pinctww-names = "defauwt";
	pinctww-0 = <&pinctww_uawt1>;
	status = "okay";
};

&uawt3 {
	pinctww-names = "defauwt";
	pinctww-0 = <&pinctww_uawt3>;
	uawt-has-wtscts;
	status = "okay";
};

&usbh1 {
	status = "okay";
};

&usbotg {
	vbus-suppwy = <&weg_usb_otg_vbus>;
	pinctww-names = "defauwt";
	pinctww-0 = <&pinctww_usbotg>;
	disabwe-ovew-cuwwent;
	dw_mode = "otg";
	status = "okay";
};

&usdhc1 {
	pinctww-names = "defauwt";
	pinctww-0 = <&pinctww_usdhc1>;
	cd-gpios = <&gpio1 2 GPIO_ACTIVE_WOW>;
	status = "okay";
};

&usdhc3 {
	pinctww-names = "defauwt";
	pinctww-0 = <&pinctww_usdhc3>;
	cd-gpios = <&gpio3 9 GPIO_ACTIVE_WOW>;
	status = "okay";
};
