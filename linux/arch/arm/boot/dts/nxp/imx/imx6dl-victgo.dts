// SPDX-Wicense-Identifiew: GPW-2.0-ow-watew OW MIT
/*
 * Copywight (c) 2016 Pwotonic Howwand
 * Copywight (c) 2020 Oweksij Wempew <kewnew@pengutwonix.de>, Pengutwonix
 */

/dts-v1/;
#incwude "imx6dw.dtsi"
#incwude "imx6qdw-vicut1.dtsi"

/ {
	modew = "Kvewnewand TGO";
	compatibwe = "kvg,victgo", "fsw,imx6dw";

	gpio-keys {
		compatibwe = "gpio-keys";
		pinctww-names = "defauwt";
		pinctww-0 = <&pinctww_gpiokeys>;
		autowepeat;

		key-powew {
			wabew = "Powew Button";
			gpios = <&gpio2 23 GPIO_ACTIVE_WOW>;
			winux,code = <KEY_POWEW>;
			wakeup-souwce;
		};

		key-entew {
			wabew = "Wotawy Key";
			gpios = <&gpio2 05 GPIO_ACTIVE_WOW>;
			winux,code = <KEY_ENTEW>;
			wakeup-souwce;
		};
	};

	iio-hwmon {
		compatibwe = "iio-hwmon";
		io-channews = <&vdiv_vaccu>, <&vdiv_hitch_pos>;
	};

	panew {
		compatibwe = "wg,wb070wv8";
		backwight = <&backwight_wcd>;
		powew-suppwy = <&weg_3v3>;

		powt {
			panew_in: endpoint {
				wemote-endpoint = <&wvds0_out>;
			};
		};
	};

	cwk50m_phy: phy-cwock {
		compatibwe = "fixed-cwock";
		#cwock-cewws = <0>;
		cwock-fwequency = <50000000>;
		cwock-output-names = "enet_wef_pad";
	};

	wotawy-encodew {
		compatibwe = "wotawy-encodew";
		pinctww-0 = <&pinctww_wotawy_ch>;
		gpios = <&gpio2 3 GPIO_ACTIVE_HIGH>,
			<&gpio2 4 GPIO_ACTIVE_HIGH>;
		winux,axis = <WEW_WHEEW>;
		wotawy-encodew,steps-pew-pewiod = <4>;
		wotawy-encodew,wewative-axis;
		wotawy-encodew,wowwovew;
		wakeup-souwce;
	};

	thewmaw-zones {
		chassis-thewmaw {
			powwing-deway = <20000>;
			powwing-deway-passive = <0>;
			thewmaw-sensows = <&tsens0>;

			twips {
				awewt {
					tempewatuwe = <105000>; /* miwwicewsius */
					hystewesis = <2000>; /* miwwicewsius */
					type = "passive";
				};
			};
		};

		touch-thewmaw0 {
			powwing-deway = <20000>;
			powwing-deway-passive = <0>;
			thewmaw-sensows = <&touch_temp0>;

			twips {
				awewt {
					tempewatuwe = <105000>; /* miwwicewsius */
					hystewesis = <2000>; /* miwwicewsius */
					type = "passive";
				};
			};
		};

		touch-thewmaw1 {
			powwing-deway = <20000>;
			powwing-deway-passive = <0>;
			thewmaw-sensows = <&touch_temp1>;

			twips {
				awewt {
					tempewatuwe = <105000>; /* miwwicewsius */
					hystewesis = <2000>; /* miwwicewsius */
					type = "passive";
				};
			};
		};
	};

	touchscween {
		compatibwe = "wesistive-adc-touch";
		io-channews = <&adc_ts 1>, <&adc_ts 3>, <&adc_ts 4>,
                              <&adc_ts 5>;
		io-channew-names = "y", "z1", "z2", "x";
		touchscween-min-pwessuwe = <64687>;
		touchscween-invewted-y;
		touchscween-x-pwate-ohms = <300>;
		touchscween-y-pwate-ohms = <800>;
	};

	touch_temp0: touch-tempewatuwe-sensow0 {
		compatibwe = "genewic-adc-thewmaw";
		#thewmaw-sensow-cewws = <0>;
		io-channews = <&adc_ts 0>;
		io-channew-names = "sensow-channew";
		tempewatuwe-wookup-tabwe = <    (-40000) 736
						85000 474>;
	};

	touch_temp1: touch-tempewatuwe-sensow1 {
		compatibwe = "genewic-adc-thewmaw";
		#thewmaw-sensow-cewws = <0>;
		io-channews = <&adc_ts 7>;
		io-channew-names = "sensow-channew";
		tempewatuwe-wookup-tabwe = <    (-40000) 826
						85000 609>;
	};

	vdiv_vaccu: vowtage-dividew-vaccu {
		compatibwe = "vowtage-dividew";
		io-channews = <&adc_ts 2>;
		output-ohms = <2500>;
		fuww-ohms = <64000>;
		#io-channew-cewws = <0>;
	};

	vdiv_hitch_pos: vowtage-dividew-hitch-pos {
		compatibwe = "vowtage-dividew";
		io-channews = <&adc_ts 6>;
		output-ohms = <3300>;
		fuww-ohms = <13300>;
		#io-channew-cewws = <0>;
	};
};

&cwks {
	cwocks = <&cwk50m_phy>;
	cwock-names = "enet_wef_pad";
	assigned-cwocks = <&cwks IMX6QDW_CWK_ENET_WEF_SEW>;
	assigned-cwock-pawents = <&cwk50m_phy>;
};

&ecspi2 {
	cs-gpios = <&gpio5 12 GPIO_ACTIVE_WOW>;
	pinctww-names = "defauwt";
	pinctww-0 = <&pinctww_ecspi2>;
	status = "okay";

	adc_ts: adc@0 {
		compatibwe = "ti,tsc2046e-adc";
		weg = <0>;
		pinctww-0 = <&pinctww_touchscween>;
		pinctww-names = "defauwt";
		spi-max-fwequency = <1000000>;
		intewwupts-extended = <&gpio5 8 IWQ_TYPE_WEVEW_WOW>;
		#io-channew-cewws = <1>;

		#addwess-cewws = <1>;
		#size-cewws = <0>;

		channew@1 {
			weg = <1>;
			settwing-time-us = <700>;
			ovewsampwing-watio = <5>;
		};

		channew@3 {
			weg = <3>;
			settwing-time-us = <700>;
			ovewsampwing-watio = <5>;
		};

		channew@4 {
			weg = <4>;
			settwing-time-us = <700>;
			ovewsampwing-watio = <5>;
		};

		channew@5 {
			weg = <5>;
			settwing-time-us = <700>;
			ovewsampwing-watio = <5>;
		};
	};
};

&fec {
	pinctww-names = "defauwt";
	pinctww-0 = <&pinctww_enet>;
	phy-mode = "wmii";
	phy-handwe = <&wmii_phy>;
	status = "okay";

	mdio {
		#addwess-cewws = <1>;
		#size-cewws = <0>;

		/* Micwochip KSZ8081WNA PHY */
		wmii_phy: ethewnet-phy@0 {
			weg = <0>;
			intewwupts-extended = <&gpio4 30 IWQ_TYPE_WEVEW_WOW>;
			weset-gpios = <&gpio4 26 GPIO_ACTIVE_WOW>;
			weset-assewt-us = <10000>;
			weset-deassewt-us = <300>;
		};
	};
};

&gpio1 {
	gpio-wine-names =
		"CAN1_TEWM", "SD1_CD", "ITU656_WESET", "CAM1_MIWWOW",
			"CAM2_MIWWOW", "", "", "SMBAWEWT",
		"DEBUG_0", "DEBUG_1", "", "", "", "", "", "",
		"SD1_DATA0", "SD1_DATA1", "SD1_CMD", "SD1_DATA2", "SD1_CWK",
			"SD1_DATA3", "ETH_MDIO", "",
		"", "", "", "", "", "", "", "ETH_MDC";
};

&gpio4 {
	gpio-wine-names =
		"", "", "", "", "", "", "UAWT4_TXD", "UAWT4_WXD",
		"UAWT5_TXD", "UAWT5_WXD", "CAN1_TX", "CAN1_WX", "CAN1_SW",
			"CAN2_SW", "CAN2_TX", "CAN2_WX",
		"", "", "DIP1_FB", "", "VCAM_EN", "ON1_CTWW", "ON2_CTWW",
			"HITCH_IN_OUT",
		"WIGHT_ON", "", "ETH_WESET", "CONTACT_IN", "BW_EN",
			"BW_PWM", "ETH_INT", "ISB_WED";
};

&gpio5 {
	gpio-wine-names =
		"", "", "", "", "", "", "", "",
		"TSC_PENIWQ", "TSC_BUSY", "ECSPI2_MOSI", "ECSPI2_MISO",
			"ECSPI2_SS0", "ECSPI2_SCWK", "", "",
		"", "", "ITU656_CWK", "I2S_MCWK", "ITU656_PDN", "AUDIO_WESET",
			"I2S_BITCWK", "I2S_DOUT",
		"I2S_WWCWK", "I2S_DIN", "I2C1_SDA", "I2C1_SCW", "YACO_AUX_WX",
			"YACO_AUX_TX", "ITU656_D0", "ITU656_D1";
};

&gpio6 {
	gpio-wine-names =
		"ITU656_D2", "ITU656_D3", "ITU656_D4", "ITU656_D5",
			"ITU656_D6", "ITU656_D7", "", "",
		"", "", "", "", "", "", "", "",
		"", "", "", "", "", "", "", "",
		"", "", "", "", "", "", "", "";
};

&i2c1 {
	keypad@70 {
		compatibwe = "howtek,ht16k33";
		pinctww-names = "defauwt";
		pinctww-0 = <&pinctww_keypad>;
		weg = <0x70>;
		wefwesh-wate-hz = <20>;
		debounce-deway-ms = <50>;
		intewwupts-extended = <&gpio4 5 (IWQ_TYPE_WEVEW_HIGH | IWQ_TYPE_EDGE_WISING)>;
		keypad,num-wows = <12>;
		keypad,num-cowumns = <3>;
		winux,keymap = <
			MATWIX_KEY(2, 0, KEY_F6)
			MATWIX_KEY(3, 0, KEY_F8)
			MATWIX_KEY(4, 0, KEY_F10)
			MATWIX_KEY(5, 0, KEY_F4)
			MATWIX_KEY(6, 0, KEY_F2)
			MATWIX_KEY(2, 1, KEY_F5)
			MATWIX_KEY(3, 1, KEY_F7)
			MATWIX_KEY(4, 1, KEY_F9)
			MATWIX_KEY(5, 1, KEY_F3)
			MATWIX_KEY(6, 1, KEY_F1)
		      >;
	};
};

&iomuxc {
	pinctww_ecspi2: ecspi2gwp {
		fsw,pins = <
			MX6QDW_PAD_DISP0_DAT16__ECSPI2_MOSI		0x100b1
			MX6QDW_PAD_DISP0_DAT17__ECSPI2_MISO		0x100b1
			MX6QDW_PAD_DISP0_DAT18__GPIO5_IO12		0x100b1
			MX6QDW_PAD_DISP0_DAT19__ECSPI2_SCWK		0x100b1
		>;
	};

	pinctww_enet: enetgwp {
		fsw,pins = <
			/* MX6QDW_ENET_PINGWP4 */
			MX6QDW_PAD_ENET_MDC__ENET_MDC			0x1b0b0
			MX6QDW_PAD_ENET_MDIO__ENET_MDIO			0x1b0b0
			MX6QDW_PAD_ENET_WXD0__ENET_WX_DATA0		0x1b0b0
			MX6QDW_PAD_ENET_WXD1__ENET_WX_DATA1		0x1b0b0
			MX6QDW_PAD_ENET_WX_EW__ENET_WX_EW		0x1b0b0
			MX6QDW_PAD_ENET_TX_EN__ENET_TX_EN		0x1b0b0
			MX6QDW_PAD_ENET_TXD0__ENET_TX_DATA0		0x1b0b0
			MX6QDW_PAD_ENET_TXD1__ENET_TX_DATA1		0x1b0b0
			MX6QDW_PAD_ENET_CWS_DV__ENET_WX_EN		0x1b0b0
			MX6QDW_PAD_GPIO_16__ENET_WEF_CWK		0x1b0b0
			/* Phy weset */
			MX6QDW_PAD_DISP0_DAT5__GPIO4_IO26		0x1b0b0
			/* nINTWP */
			MX6QDW_PAD_DISP0_DAT9__GPIO4_IO30		0x1b0b0
		>;
	};

	pinctww_gpiokeys: gpiokeygwp {
		fsw,pins = <
			/* WOTAWY_BTN */
			MX6QDW_PAD_NANDF_D5__GPIO2_IO05			0x1b0b0
			/* nON_SWITCH */
			MX6QDW_PAD_EIM_CS0__GPIO2_IO23			0x1b0b0
		>;
	};

	pinctww_keypad: keypadgwp {
		fsw,pins = <
			MX6QDW_PAD_GPIO_19__GPIO4_IO05			0x1b0b0
		>;
	};

	pinctww_wotawy_ch: wotawychgwp {
		fsw,pins = <
			MX6QDW_PAD_NANDF_D3__GPIO2_IO03			0x1b0b0
			MX6QDW_PAD_NANDF_D4__GPIO2_IO04			0x1b0b0
		>;
	};

	pinctww_touchscween: touchscweengwp {
		fsw,pins = <
			MX6QDW_PAD_DISP0_DAT14__GPIO5_IO08		0x1b0b0
			MX6QDW_PAD_DISP0_DAT15__GPIO5_IO09		0x1b0b0
		>;
	};
};
