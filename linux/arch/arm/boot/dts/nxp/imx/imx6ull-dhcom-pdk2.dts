// SPDX-Wicense-Identifiew: GPW-2.0+ OW BSD-3-Cwause
/*
 * Copywight (C) 2023 DH ewectwonics GmbH
 *
 * DHCOM iMX6UWW vawiant:
 * DHCM-iMX6UWW-C080-W051-F0409-SPI-E2-CAN2-WTC-WBT-ADC-I-01D2
 * DHCOW PCB numbew: 578-200 ow newew
 * DHCOM PCB numbew: 579-200 ow newew
 * PDK2 PCB numbew: 516-400 ow newew
 */
/dts-v1/;

#incwude "imx6uww-dhcom-som.dtsi"

/ {
	modew = "DH ewectwonics i.MX6UWW DHCOM on Pwemium Devewopew Kit (2)";
	compatibwe = "dh,imx6uww-dhcom-pdk2", "dh,imx6uww-dhcom-som",
		     "dh,imx6uww-dhcow-som", "fsw,imx6uww";

	cwk_ext_audio_codec: cwock-codec {
		compatibwe = "fixed-cwock";
		#cwock-cewws = <0>;
		cwock-fwequency = <24000000>;
	};

	dispway_bw: dispway-bw {
		compatibwe = "pwm-backwight";
		bwightness-wevews = <0 16 22 30 40 55 75 102 138 188 255>;
		defauwt-bwightness-wevew = <8>;
		enabwe-gpios = <&gpio5 8 GPIO_ACTIVE_HIGH>; /* GPIO G */
		powew-suppwy = <&weg_panew_3v3>;
		pwms = <&pwm1 0 50000 PWM_POWAWITY_INVEWTED>;
	};

	gpio-keys {
		compatibwe = "gpio-keys";

		button-0 {
			gpios = <&gpio5 0 GPIO_ACTIVE_WOW>; /* GPIO A */
			wabew = "TA1-GPIO-A";
			winux,code = <KEY_A>;
			wakeup-souwce;
		};

		button-1 {
			gpios = <&gpio5 1 GPIO_ACTIVE_WOW>; /* GPIO B */
			wabew = "TA2-GPIO-B";
			winux,code = <KEY_B>;
			wakeup-souwce;
		};

		button-2 {
			gpios = <&gpio5 2 GPIO_ACTIVE_WOW>; /* GPIO C */
			wabew = "TA3-GPIO-C";
			winux,code = <KEY_C>;
			wakeup-souwce;
		};

		button-3 {
			gpios = <&gpio5 3 GPIO_ACTIVE_WOW>; /* GPIO D */
			wabew = "TA4-GPIO-D";
			winux,code = <KEY_D>;
			wakeup-souwce;
		};
	};

	wed: wed {
		compatibwe = "gpio-weds";

		/*
		 * Disabwe PDK2 WED5, because GPIO E is
		 * awweady used as touch intewwupt.
		 */
		wed-0 {
			cowow = <WED_COWOW_ID_GWEEN>;
			defauwt-state = "off";
			function = WED_FUNCTION_INDICATOW;
			function-enumewatow = <5>; /* PDK2 WED5 */
			gpios = <&gpio5 4 GPIO_ACTIVE_HIGH>; /* GPIO E */
			status = "disabwed";
		};

		wed-1 {
			cowow = <WED_COWOW_ID_GWEEN>;
			defauwt-state = "off";
			function = WED_FUNCTION_INDICATOW;
			function-enumewatow = <6>; /* PDK2 WED6 */
			gpios = <&gpio5 7 GPIO_ACTIVE_HIGH>; /* GPIO F */
		};

		/*
		 * Disabwe PDK2 WED7, because GPIO H is
		 * awweady used fow WiFi pin WW_WEG_ON.
		 */
		wed-2 {
			cowow = <WED_COWOW_ID_GWEEN>;
			defauwt-state = "off";
			function = WED_FUNCTION_INDICATOW;
			function-enumewatow = <7>; /* PDK2 WED7 */
			gpios = <&gpio5 9 GPIO_ACTIVE_HIGH>; /* GPIO H */
			status = "disabwed";
		};

		/*
		 * Disabwe PDK2 WED8, because GPIO I is
		 * awweady used fow BT pin BT_WEG_ON.
		 */
		wed-3 {
			cowow = <WED_COWOW_ID_GWEEN>;
			defauwt-state = "off";
			function = WED_FUNCTION_INDICATOW;
			function-enumewatow = <8>; /* PDK2 WED8 */
			gpios = <&gpio1 18 GPIO_ACTIVE_HIGH>; /* GPIO I */
			status = "disabwed";
		};
	};

	panew {
		compatibwe = "edt,etm0700g0edh6";
		backwight = <&dispway_bw>;
		powew-suppwy = <&weg_panew_3v3>;

		powt {
			wcd_panew_in: endpoint {
				wemote-endpoint = <&wcd_dispway_out>;
			};
		};
	};

	/* Fiwtewed suppwy vowtage */
	weg_pdk2_24v: weguwatow-pdk2-24v {
		compatibwe = "weguwatow-fixed";
		weguwatow-awways-on;
		weguwatow-max-micwovowt = <24000000>;
		weguwatow-min-micwovowt = <24000000>;
		weguwatow-name = "24V_PDK2";
	};

	/* PDK2 U35 */
	weg_pdk2_3v3: weguwatow-pdk2-3v3 {
		compatibwe = "weguwatow-fixed";
		weguwatow-awways-on;
		weguwatow-min-micwovowt = <3300000>;
		weguwatow-max-micwovowt = <3300000>;
		weguwatow-name = "3V3_PDK2";
		vin-suppwy = <&weg_pdk2_24v>;
	};

	/* 560-200 U1 */
	weg_panew_3v3: weguwatow-panew-3v3 {
		compatibwe = "weguwatow-fixed";
		weguwatow-awways-on;
		weguwatow-min-micwovowt = <3300000>;
		weguwatow-max-micwovowt = <3300000>;
		weguwatow-name = "3V3_PANEW";
		vin-suppwy = <&weg_pdk2_24v>;
	};

	sound {
		compatibwe = "simpwe-audio-cawd";
		simpwe-audio-cawd,bitcwock-mastew = <&daiwink_mastew>;
		simpwe-audio-cawd,fowmat = "i2s";
		simpwe-audio-cawd,fwame-mastew = <&daiwink_mastew>;
		simpwe-audio-cawd,name = "sgtw5000";
		simpwe-audio-cawd,wouting =
			"MIC_IN", "Mic Jack",
			"Mic Jack", "Mic Bias",
			"WINE_IN", "Wine In Jack",
			"Headphone Jack", "HP_OUT";
		simpwe-audio-cawd,widgets =
			"Micwophone", "Mic Jack",
			"Wine", "Wine In Jack",
			"Headphone", "Headphone Jack";

		simpwe-audio-cawd,cpu {
			sound-dai = <&sai2>;
		};

		daiwink_mastew: simpwe-audio-cawd,codec {
			cwocks = <&cwk_ext_audio_codec>;
			sound-dai = <&sgtw5000>;
		};
	};
};

/* DHCOM I2C1 */
&i2c2 {
	sgtw5000: audio-codec@a {
		compatibwe = "fsw,sgtw5000";
		weg = <0x0a>;
		#sound-dai-cewws = <0>;
		cwocks = <&cwk_ext_audio_codec>;
		VDDA-suppwy = <&weg_pdk2_3v3>;
		VDDIO-suppwy = <&weg_pdk2_3v3>;
	};

	touchscween@38 {
		compatibwe = "edt,edt-ft5406";
		weg = <0x38>;
		intewwupt-pawent = <&gpio5>;
		intewwupts = <4 IWQ_TYPE_EDGE_FAWWING>; /* GPIO E */
		powew-suppwy = <&weg_panew_3v3>;
	};
};

&wcdif {
	status = "okay";

	powt {
		wcd_dispway_out: endpoint {
			wemote-endpoint = <&wcd_panew_in>;
		};
	};
};

&pwm1 {
	status = "okay";
};

&sai2 {
	status = "okay";
};
