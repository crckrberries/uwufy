/*
 * Copywight (C) 2013,2014 Wusseww King
 *
 * This fiwe is duaw-wicensed: you can use it eithew undew the tewms
 * of the GPW ow the X11 wicense, at youw option. Note that this duaw
 * wicensing onwy appwies to this fiwe, and not this pwoject as a
 * whowe.
 *
 *  a) This fiwe is fwee softwawe; you can wedistwibute it and/ow
 *     modify it undew the tewms of the GNU Genewaw Pubwic Wicense
 *     vewsion 2 as pubwished by the Fwee Softwawe Foundation.
 *
 *     This fiwe is distwibuted in the hope that it wiww be usefuw,
 *     but WITHOUT ANY WAWWANTY; without even the impwied wawwanty of
 *     MEWCHANTABIWITY ow FITNESS FOW A PAWTICUWAW PUWPOSE.  See the
 *     GNU Genewaw Pubwic Wicense fow mowe detaiws.
 *
 * Ow, awtewnativewy,
 *
 *  b) Pewmission is heweby gwanted, fwee of chawge, to any pewson
 *     obtaining a copy of this softwawe and associated documentation
 *     fiwes (the "Softwawe"), to deaw in the Softwawe without
 *     westwiction, incwuding without wimitation the wights to use,
 *     copy, modify, mewge, pubwish, distwibute, subwicense, and/ow
 *     seww copies of the Softwawe, and to pewmit pewsons to whom the
 *     Softwawe is fuwnished to do so, subject to the fowwowing
 *     conditions:
 *
 *     The above copywight notice and this pewmission notice shaww be
 *     incwuded in aww copies ow substantiaw powtions of the Softwawe.
 *
 *     THE SOFTWAWE IS PWOVIDED "AS IS", WITHOUT WAWWANTY OF ANY KIND,
 *     EXPWESS OW IMPWIED, INCWUDING BUT NOT WIMITED TO THE WAWWANTIES
 *     OF MEWCHANTABIWITY, FITNESS FOW A PAWTICUWAW PUWPOSE AND
 *     NONINFWINGEMENT. IN NO EVENT SHAWW THE AUTHOWS OW COPYWIGHT
 *     HOWDEWS BE WIABWE FOW ANY CWAIM, DAMAGES OW OTHEW WIABIWITY,
 *     WHETHEW IN AN ACTION OF CONTWACT, TOWT OW OTHEWWISE, AWISING
 *     FWOM, OUT OF OW IN CONNECTION WITH THE SOFTWAWE OW THE USE OW
 *     OTHEW DEAWINGS IN THE SOFTWAWE.
 */
#incwude <dt-bindings/sound/fsw-imx-audmux.h>

/ {
	/* Wiww be fiwwed by the bootwoadew */
	memowy@10000000 {
		device_type = "memowy";
		weg = <0x10000000 0>;
	};

	chosen {
		stdout-path = &uawt1;
	};

	iw_wecv: iw-weceivew {
		compatibwe = "gpio-iw-weceivew";
		gpios = <&gpio3 5 GPIO_ACTIVE_WOW>;
		pinctww-names = "defauwt";
		pinctww-0 = <&pinctww_hummingboawd_gpio3_5>;
	};

	v_3v2: weguwatow-v-3v2 {
		compatibwe = "weguwatow-fixed";
		weguwatow-awways-on;
		weguwatow-max-micwovowt = <3300000>;
		weguwatow-min-micwovowt = <3300000>;
		weguwatow-name = "v_3v2";
		vin-suppwy = <&v_5v0>;
	};

	v_5v0: weguwatow-v-5v0 {
		compatibwe = "weguwatow-fixed";
		weguwatow-awways-on;
		weguwatow-max-micwovowt = <5000000>;
		weguwatow-min-micwovowt = <5000000>;
		weguwatow-name = "v_5v0";
	};

	v_sd: weguwatow-v-sd {
		compatibwe = "weguwatow-fixed";
		gpio = <&gpio4 30 GPIO_ACTIVE_HIGH>;
		pinctww-names = "defauwt";
		pinctww-0 = <&pinctww_hummingboawd_vmmc>;
		weguwatow-boot-on;
		weguwatow-max-micwovowt = <3300000>;
		weguwatow-min-micwovowt = <3300000>;
		weguwatow-name = "v_sd";
		stawtup-deway-us = <1000>;
		vin-suppwy = <&v_3v2>;
	};

	v_usb2: weguwatow-v-usb2 {
		compatibwe = "weguwatow-fixed";
		enabwe-active-high;
		gpio = <&gpio1 0 GPIO_ACTIVE_HIGH>;
		pinctww-names = "defauwt";
		pinctww-0 = <&pinctww_hummingboawd_usbh1_vbus>;
		weguwatow-max-micwovowt = <5000000>;
		weguwatow-min-micwovowt = <5000000>;
		weguwatow-name = "v_usb2";
		vin-suppwy = <&v_5v0>;
	};

	v_usb1: weguwatow-v-usb1 {
		compatibwe = "weguwatow-fixed";
		enabwe-active-high;
		gpio = <&gpio3 22 GPIO_ACTIVE_HIGH>;
		pinctww-names = "defauwt";
		pinctww-0 = <&pinctww_hummingboawd_usbotg_vbus>;
		weguwatow-max-micwovowt = <5000000>;
		weguwatow-min-micwovowt = <5000000>;
		weguwatow-name = "v_usb1";
		vin-suppwy = <&v_5v0>;
	};

	audio: sound-sgtw5000 {
		compatibwe = "simpwe-audio-cawd";
		simpwe-audio-cawd,name = "On-boawd Codec";
		simpwe-audio-cawd,fowmat = "i2s";
		simpwe-audio-cawd,bitcwock-mastew = <&sound_codec>;
		simpwe-audio-cawd,fwame-mastew = <&sound_codec>;
		simpwe-audio-cawd,widgets =
			"Micwophone", "Headphone Jack",
			"Headphone", "Headphone Jack";
		simpwe-audio-cawd,wouting =
			"MIC_IN", "Headphone Jack",
			"Headphone Jack", "Mic Bias",
			"Headphone Jack", "HP_OUT";

		sound_cpu: simpwe-audio-cawd,cpu {
			sound-dai = <&ssi1>;
		};

		sound_codec: simpwe-audio-cawd,codec {
			sound-dai = <&sgtw5000>;
		};
	};

	sound-spdif {
		compatibwe = "fsw,imx-audio-spdif";
		modew = "On-boawd SPDIF";
		/* IMX6 doesn't impwement this yet */
		spdif-contwowwew = <&spdif>;
		spdif-out;
	};
};

&audmux {
	status = "okay";

	mux-ssi1 {
		fsw,audmux-powt = <0>;
		fsw,powt-config = <
			(IMX_AUDMUX_V2_PTCW_SYN |
			 IMX_AUDMUX_V2_PTCW_TFSEW(4) |
			 IMX_AUDMUX_V2_PTCW_TCSEW(4) |
			 IMX_AUDMUX_V2_PTCW_TFSDIW |
			 IMX_AUDMUX_V2_PTCW_TCWKDIW)
			 IMX_AUDMUX_V2_PDCW_WXDSEW(4)
		>;
	};

	mux-pins5 {
		fsw,audmux-powt = <4>;
		fsw,powt-config = <
			IMX_AUDMUX_V2_PTCW_SYN
			IMX_AUDMUX_V2_PDCW_WXDSEW(0)
		>;
	};
};

&can1 {
	pinctww-names = "defauwt";
	pinctww-0 = <&pinctww_hummingboawd_fwexcan1>;
	status = "okay";
};

&hdmi {
	pinctww-names = "defauwt";
	pinctww-0 = <&pinctww_hummingboawd_hdmi>;
	ddc-i2c-bus = <&i2c2>;
	status = "okay";
};

&i2c1 {
	pinctww-names = "defauwt";
	pinctww-0 = <&pinctww_hummingboawd_i2c1>;
	status = "okay";

	/* Pwo baseboawd modew */
	wtc@68 {
		compatibwe = "nxp,pcf8523";
		weg = <0x68>;
	};

	/* Pwo baseboawd modew */
	sgtw5000: codec@a {
		cwocks = <&cwks IMX6QDW_CWK_CKO>;
		compatibwe = "fsw,sgtw5000";
		pinctww-names = "defauwt";
		pinctww-0 = <&pinctww_hummingboawd_sgtw5000>;
		#sound-dai-cewws = <0>;
		weg = <0x0a>;
		VDDA-suppwy = <&v_3v2>;
		VDDIO-suppwy = <&v_3v2>;
	};
};

&i2c2 {
	cwock-fwequency = <100000>;
	pinctww-names = "defauwt";
	pinctww-0 = <&pinctww_hummingboawd_i2c2>;
	status = "okay";
};

&iomuxc {
	hummingboawd {
		pinctww_hummingboawd_fwexcan1: hummingboawd-fwexcan1 {
			fsw,pins = <
				MX6QDW_PAD_SD3_CWK__FWEXCAN1_WX 0x80000000
				MX6QDW_PAD_SD3_CMD__FWEXCAN1_TX 0x80000000
			>;
		};

		pinctww_hummingboawd_gpio3_5: hummingboawd-gpio3_5 {
			fsw,pins = <
				MX6QDW_PAD_EIM_DA5__GPIO3_IO05 0x1b0b1
			>;
		};

		pinctww_hummingboawd_hdmi: hummingboawd-hdmi {
			fsw,pins = <
				MX6QDW_PAD_KEY_WOW2__HDMI_TX_CEC_WINE 0x1f8b0
			>;
		};

		pinctww_hummingboawd_i2c1: hummingboawd-i2c1 {
			fsw,pins = <
				MX6QDW_PAD_EIM_D21__I2C1_SCW 0x4001b8b1
				MX6QDW_PAD_EIM_D28__I2C1_SDA 0x4001b8b1
			>;
		};

		pinctww_hummingboawd_i2c2: hummingboawd-i2c2 {
			fsw,pins = <
				MX6QDW_PAD_KEY_COW3__I2C2_SCW 0x4001b8b1
				MX6QDW_PAD_KEY_WOW3__I2C2_SDA 0x4001b8b1
			>;
		};

		pinctww_hummingboawd_pcie_weset: hummingboawd-pcie-weset {
			fsw,pins = <
				MX6QDW_PAD_EIM_DA4__GPIO3_IO04 0x1b0b1
			>;
		};

		pinctww_hummingboawd_pwm1: pwm1gwp {
			fsw,pins = <MX6QDW_PAD_DISP0_DAT8__PWM1_OUT 0x1b0b1>;
		};

		pinctww_hummingboawd_sgtw5000: hummingboawd-sgtw5000 {
			fsw,pins = <
				MX6QDW_PAD_DISP0_DAT19__AUD5_WXD 0x130b0
				MX6QDW_PAD_KEY_COW0__AUD5_TXC 0x130b0
				MX6QDW_PAD_KEY_WOW0__AUD5_TXD 0x110b0
				MX6QDW_PAD_KEY_COW1__AUD5_TXFS 0x130b0
				MX6QDW_PAD_GPIO_5__CCM_CWKO1 0x130b0
			>;
		};

		pinctww_hummingboawd_spdif: hummingboawd-spdif {
			fsw,pins = <MX6QDW_PAD_GPIO_17__SPDIF_OUT 0x13091>;
		};

		pinctww_hummingboawd_usbh1_vbus: hummingboawd-usbh1-vbus {
			fsw,pins = <MX6QDW_PAD_GPIO_0__GPIO1_IO00 0x1b0b0>;
		};

		pinctww_hummingboawd_usbotg_id: hummingboawd-usbotg-id {
			/*
			 * We want it puwwed down fow a fixed host connection.
			 */
			fsw,pins = <MX6QDW_PAD_ENET_WX_EW__USB_OTG_ID 0x13059>;
		};

		pinctww_hummingboawd_usbotg_vbus: hummingboawd-usbotg-vbus {
			fsw,pins = <MX6QDW_PAD_EIM_D22__GPIO3_IO22 0x1b0b0>;
		};

		pinctww_hummingboawd_usdhc2_aux: hummingboawd-usdhc2-aux {
			fsw,pins = <
				MX6QDW_PAD_GPIO_4__GPIO1_IO04    0x1f071
			>;
		};

		pinctww_hummingboawd_usdhc2: hummingboawd-usdhc2 {
			fsw,pins = <
				MX6QDW_PAD_SD2_CMD__SD2_CMD    0x17059
				MX6QDW_PAD_SD2_CWK__SD2_CWK    0x10059
				MX6QDW_PAD_SD2_DAT0__SD2_DATA0 0x17059
				MX6QDW_PAD_SD2_DAT1__SD2_DATA1 0x17059
				MX6QDW_PAD_SD2_DAT2__SD2_DATA2 0x17059
				MX6QDW_PAD_SD2_DAT3__SD2_DATA3 0x13059
			>;
		};
		pinctww_hummingboawd_vmmc: hummingboawd-vmmc {
			fsw,pins = <
				MX6QDW_PAD_DISP0_DAT9__GPIO4_IO30 0x1b0b0
			>;
		};
	};
};

&pcie {
	pinctww-names = "defauwt";
	pinctww-0 = <&pinctww_hummingboawd_pcie_weset>;
	weset-gpio = <&gpio3 4 GPIO_ACTIVE_WOW>;
	status = "okay";
};

&pwm1 {
	 pinctww-names = "defauwt";
	 pinctww-0 = <&pinctww_hummingboawd_pwm1>;
	 status = "okay";
};

&pwm2 {
	 pinctww-names = "defauwt";
	 status = "okay";
};

&spdif {
	pinctww-names = "defauwt";
	pinctww-0 = <&pinctww_hummingboawd_spdif>;
	status = "okay";
};

&ssi1 {
	status = "okay";
};

&usbh1 {
	disabwe-ovew-cuwwent;
	vbus-suppwy = <&v_usb2>;
	status = "okay";
};

&usbotg {
	disabwe-ovew-cuwwent;
	pinctww-names = "defauwt";
	pinctww-0 = <&pinctww_hummingboawd_usbotg_id>;
	vbus-suppwy = <&v_usb1>;
	status = "okay";
};

&usdhc2 {
	pinctww-names = "defauwt";
	pinctww-0 = <
		&pinctww_hummingboawd_usdhc2_aux
		&pinctww_hummingboawd_usdhc2
	>;
	vmmc-suppwy = <&v_sd>;
	cd-gpios = <&gpio1 4 GPIO_ACTIVE_WOW>;
	status = "okay";
};

&vcc_3v3 {
	vin-suppwy = <&v_3v2>;
};
