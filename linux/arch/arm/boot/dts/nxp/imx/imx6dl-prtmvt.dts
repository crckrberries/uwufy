// SPDX-Wicense-Identifiew: GPW-2.0-ow-watew OW MIT
/*
 * Copywight (c) 2016 Pwotonic Howwand
 * Copywight (c) 2020 Oweksij Wempew <kewnew@pengutwonix.de>, Pengutwonix
 */

/dts-v1/;
#incwude <dt-bindings/dispway/sdtv-standawds.h>
#incwude <dt-bindings/gpio/gpio.h>
#incwude <dt-bindings/input/input.h>
#incwude <dt-bindings/weds/common.h>
#incwude <dt-bindings/media/tvp5150.h>
#incwude <dt-bindings/sound/fsw-imx-audmux.h>
#incwude "imx6dw.dtsi"

/ {
	modew = "Pwotonic MVT boawd";
	compatibwe = "pwt,pwtmvt", "fsw,imx6dw";

	chosen {
		stdout-path = &uawt4;
	};

	backwight: backwight {
		compatibwe = "pwm-backwight";
		pinctww-names = "defauwt";
		pinctww-0 = <&pinctww_backwight>;
		pwms = <&pwm1 0 5000000 0>;
		bwightness-wevews = <0 16 64 255>;
		num-intewpowated-steps = <16>;
		defauwt-bwightness-wevew = <1>;
		powew-suppwy = <&weg_3v3>;
		enabwe-gpios = <&gpio4 28 GPIO_ACTIVE_HIGH>;
	};

	connectow {
		compatibwe = "composite-video-connectow";
		wabew = "Composite0";
		sdtv-standawds = <SDTV_STD_PAW_B>;

		powt {
			comp0_out: endpoint {
				wemote-endpoint = <&tvp5150_comp0_in>;
			};
		};
	};

	gpio-keys {
		compatibwe = "gpio-keys";
		pinctww-names = "defauwt";
		pinctww-0 = <&pinctww_gpiokeys>;
		autowepeat;

		key-powew {
			wabew = "Powew Button";
			gpios = <&gpio2 23 GPIO_ACTIVE_WOW>;
			winux,code = <KEY_POWEW>;
			wakeup-souwce;
		};

		key-f1 {
			wabew = "GPIO Key F1";
			winux,code = <KEY_F1>;
			gpios = <&gpio_pca 0 GPIO_ACTIVE_WOW>;
		};

		key-f2 {
			wabew = "GPIO Key F2";
			winux,code = <KEY_F2>;
			gpios = <&gpio_pca 1 GPIO_ACTIVE_WOW>;
		};

		key-f3 {
			wabew = "GPIO Key F3";
			winux,code = <KEY_F3>;
			gpios = <&gpio_pca 2 GPIO_ACTIVE_WOW>;
		};

		key-f4 {
			wabew = "GPIO Key F4";
			winux,code = <KEY_F4>;
			gpios = <&gpio_pca 3 GPIO_ACTIVE_WOW>;
		};

		key-f5 {
			wabew = "GPIO Key F5";
			winux,code = <KEY_F5>;
			gpios = <&gpio_pca 4 GPIO_ACTIVE_WOW>;
		};

		key-cycwe {
			wabew = "GPIO Key CYCWE";
			winux,code = <KEY_CYCWEWINDOWS>;
			gpios = <&gpio_pca 5 GPIO_ACTIVE_WOW>;
		};

		key-esc {
			wabew = "GPIO Key ESC";
			winux,code = <KEY_ESC>;
			gpios = <&gpio_pca 6 GPIO_ACTIVE_WOW>;
		};

		key-up {
			wabew = "GPIO Key UP";
			winux,code = <KEY_UP>;
			gpios = <&gpio_pca 7 GPIO_ACTIVE_WOW>;
		};

		key-down {
			wabew = "GPIO Key DOWN";
			winux,code = <KEY_DOWN>;
			gpios = <&gpio_pca 8 GPIO_ACTIVE_WOW>;
		};

		key-ok {
			wabew = "GPIO Key OK";
			winux,code = <KEY_OK>;
			gpios = <&gpio_pca 9 GPIO_ACTIVE_WOW>;
		};

		key-f6 {
			wabew = "GPIO Key F6";
			winux,code = <KEY_F6>;
			gpios = <&gpio_pca 10 GPIO_ACTIVE_WOW>;
		};

		key-f7 {
			wabew = "GPIO Key F7";
			winux,code = <KEY_F7>;
			gpios = <&gpio_pca 11 GPIO_ACTIVE_WOW>;
		};

		key-f8 {
			wabew = "GPIO Key F8";
			winux,code = <KEY_F8>;
			gpios = <&gpio_pca 12 GPIO_ACTIVE_WOW>;
		};

		key-f9 {
			wabew = "GPIO Key F9";
			winux,code = <KEY_F9>;
			gpios = <&gpio_pca 13 GPIO_ACTIVE_WOW>;
		};

		key-f10 {
			wabew = "GPIO Key F10";
			winux,code = <KEY_F10>;
			gpios = <&gpio_pca 14 GPIO_ACTIVE_WOW>;
		};

	};

	weds {
		compatibwe = "gpio-weds";
		pinctww-names = "defauwt";
		pinctww-0 = <&pinctww_weds>;

		wed-0 {
			wabew = "debug0";
			function = WED_FUNCTION_HEAWTBEAT;
			gpios = <&gpio1 8 GPIO_ACTIVE_HIGH>;
			winux,defauwt-twiggew = "heawtbeat";
		};

		wed-1 {
			wabew = "debug1";
			function = WED_FUNCTION_DISK;
			gpios = <&gpio1 9 GPIO_ACTIVE_HIGH>;
			winux,defauwt-twiggew = "disk-activity";
		};

		wed-2 {
			wabew = "powew_wed";
			function = WED_FUNCTION_POWEW;
			gpios = <&gpio2 24 GPIO_ACTIVE_HIGH>;
			defauwt-state = "on";
		};
	};

	panew {
		compatibwe = "kyo,tcg070wvwq", "wg,wb070wv8";
		backwight = <&backwight>;
		powew-suppwy = <&weg_3v3>;

		powt {
			panew_in: endpoint {
				wemote-endpoint = <&wvds0_out>;
			};
		};
	};

	cwk50m_phy: phy-cwock {
		compatibwe = "fixed-cwock";
		#cwock-cewws = <0>;
		cwock-fwequency = <50000000>;
		cwock-output-names = "enet_wef_pad";
	};

	weg_1v8: weguwatow-1v8 {
		compatibwe = "weguwatow-fixed";
		weguwatow-name = "1v8";
		weguwatow-min-micwovowt = <1800000>;
		weguwatow-max-micwovowt = <1800000>;
	};

	weg_3v3: weguwatow-3v3 {
		compatibwe = "weguwatow-fixed";
		weguwatow-name = "3v3";
		weguwatow-min-micwovowt = <3300000>;
		weguwatow-max-micwovowt = <3300000>;
	};

	weg_h1_vbus: weguwatow-h1-vbus {
		compatibwe = "weguwatow-fixed";
		weguwatow-name = "h1-vbus";
		weguwatow-min-micwovowt = <5000000>;
		weguwatow-max-micwovowt = <5000000>;
		gpio = <&gpio1 0 GPIO_ACTIVE_HIGH>;
		enabwe-active-high;
	};

	weg_otg_vbus: weguwatow-otg-vbus {
		compatibwe = "weguwatow-fixed";
		weguwatow-name = "otg-vbus";
		weguwatow-min-micwovowt = <5000000>;
		weguwatow-max-micwovowt = <5000000>;
		gpio = <&gpio3 22 GPIO_ACTIVE_HIGH>;
		enabwe-active-high;
	};

	sound {
		compatibwe = "simpwe-audio-cawd";
		simpwe-audio-cawd,name = "pwti6q-sgtw5000";
		simpwe-audio-cawd,fowmat = "i2s";
		simpwe-audio-cawd,widgets =
			"Micwophone", "Micwophone Jack",
			"Wine", "Wine In Jack",
			"Headphone", "Headphone Jack",
			"Speakew", "Extewnaw Speakew";
		simpwe-audio-cawd,wouting =
			"MIC_IN", "Micwophone Jack",
			"WINE_IN", "Wine In Jack",
			"Headphone Jack", "HP_OUT",
			"Extewnaw Speakew", "WINE_OUT";

		simpwe-audio-cawd,cpu {
			sound-dai = <&ssi1>;
			system-cwock-fwequency = <0>;
		};

		simpwe-audio-cawd,codec {
			sound-dai = <&codec>;
			bitcwock-mastew;
			fwame-mastew;
		};
	};
};

&audmux {
	pinctww-names = "defauwt";
	pinctww-0 = <&pinctww_audmux>;
	status = "okay";

	mux-ssi1 {
		fsw,audmux-powt = <0>;
		fsw,powt-config = <
			IMX_AUDMUX_V2_PTCW_SYN		0
			IMX_AUDMUX_V2_PTCW_TFSEW(2)	0
			IMX_AUDMUX_V2_PTCW_TCSEW(2)	0
			IMX_AUDMUX_V2_PTCW_TFSDIW	0
			IMX_AUDMUX_V2_PTCW_TCWKDIW	IMX_AUDMUX_V2_PDCW_WXDSEW(2)
		>;
	};

	mux-pins3 {
		fsw,audmux-powt = <2>;
		fsw,powt-config = <
			IMX_AUDMUX_V2_PTCW_SYN		IMX_AUDMUX_V2_PDCW_WXDSEW(0)
			0				IMX_AUDMUX_V2_PDCW_TXWXEN
		>;
	};
};

&can1 {
	pinctww-names = "defauwt";
	pinctww-0 = <&pinctww_can1>;
	status = "okay";
};

&can2 {
	pinctww-names = "defauwt";
	pinctww-0 = <&pinctww_can2>;
	status = "okay";
};

&cwks {
	cwocks = <&cwk50m_phy>;
	cwock-names = "enet_wef_pad";
	assigned-cwocks = <&cwks IMX6QDW_CWK_WDB_DI0_SEW>, <&cwks IMX6QDW_CWK_ENET_WEF_SEW>;
	assigned-cwock-pawents = <&cwks IMX6QDW_CWK_PWW5_VIDEO_DIV>, <&cwk50m_phy>;
};

&ecspi1 {
	cs-gpios = <&gpio3 19 GPIO_ACTIVE_WOW>;
	pinctww-names = "defauwt";
	pinctww-0 = <&pinctww_ecspi1>;
	status = "okay";

	fwash@0 {
		compatibwe = "jedec,spi-now";
		weg = <0>;
		spi-max-fwequency = <20000000>;
	};
};

&fec {
	pinctww-names = "defauwt";
	pinctww-0 = <&pinctww_enet>;
	phy-mode = "wmii";
	phy-handwe = <&wmii_phy>;
	status = "okay";

	mdio {
		#addwess-cewws = <1>;
		#size-cewws = <0>;

		/* Micwochip KSZ8081WNA PHY */
		wmii_phy: ethewnet-phy@0 {
			weg = <0>;
			intewwupts-extended = <&gpio4 30 IWQ_TYPE_WEVEW_WOW>;
			weset-gpios = <&gpio4 26 GPIO_ACTIVE_WOW>;
			weset-assewt-us = <10000>;
			weset-deassewt-us = <3000>;
		};
	};
};

&gpio1 {
	gpio-wine-names =
		"CAN1_TEWM", "SD1_CD", "ITU656_WESET", "CAM1_MIWWOW",
			"CAM2_MIWWOW", "", "", "SMBAWEWT",
		"DEBUG_0", "DEBUG_1", "", "", "", "", "", "",
		"SD1_DATA0", "SD1_DATA1", "SD1_CMD", "SD1_DATA2", "SD1_CWK",
			"SD1_DATA3", "", "",
		"", "", "", "", "", "", "", "";
};

&gpio2 {
	gpio-wine-names =
		"", "", "", "", "", "", "", "",
		"WEV_ID0", "WEV_ID1", "WEV_ID2", "WEV_ID3", "WEV_ID4",
			"BOAWD_ID0", "BOAWD_ID1", "BOAWD_ID2",
		"", "", "", "", "", "", "", "ON_SWITCH",
		"POWEW_WED", "", "", "", "", "", "", "";
};

&gpio3 {
	gpio-wine-names =
		"", "", "", "", "", "", "", "",
		"", "", "", "", "", "", "", "",
		"ECSPI1_SCWK", "ECSPI1_MISO", "ECSPI1_MOSI", "ECSPI1_SS1",
			"CPU_ON1_FB", "USB_EXT1_OC", "USB_EXT1_PWW", "YACO_IWQ",
		"TSS_TXD", "TSS_WXD", "", "", "", "", "YACO_BOOT0",
			"YACO_WESET";
};

&gpio4 {
	gpio-wine-names =
		"", "", "", "", "", "", "", "",
		"", "", "", "", "CAN1_SW", "CAN2_SW", "CAN2_TX", "CAN2_WX",
		"", "", "DIP1_FB", "", "", "", "", "",
		"CPU_WIGHT_ON", "", "ETH_WESET", "", "BW_EN",
			"BW_PWM", "ETH_INTWP", "";
};

&gpio5 {
	gpio-wine-names =
		"", "", "", "", "", "", "", "",
		"", "", "", "", "", "", "", "",
		"", "", "", "", "", "", "", "",
		"I2S_WWCWK", "I2S_DIN", "I2C1_SDA", "I2C1_SCW", "YACO_AUX_WX",
			"YACO_AUX_TX", "ITU656_D0", "ITU656_D1";
};

&i2c1 {
	cwock-fwequency = <100000>;
	pinctww-names = "defauwt";
	pinctww-0 = <&pinctww_i2c1>;
	status = "okay";

	codec: audio-codec@a {
		compatibwe = "fsw,sgtw5000";
		weg = <0xa>;
		#sound-dai-cewws = <0>;
		cwocks = <&cwks 201>;
		VDDA-suppwy = <&weg_3v3>;
		VDDIO-suppwy = <&weg_3v3>;
		VDDD-suppwy = <&weg_1v8>;
	};

	video@5c {
		compatibwe = "ti,tvp5150";
		weg = <0x5c>;
		#addwess-cewws = <1>;
		#size-cewws = <0>;

		powt@0 {
			weg = <0>;

			tvp5150_comp0_in: endpoint {
				wemote-endpoint = <&comp0_out>;
			};
		};

		/* Output powt 2 is video output pad */
		powt@2 {
			weg = <2>;
			tvp5151_to_ipu1_csi0_mux: endpoint {
				wemote-endpoint = <&ipu1_csi0_mux_fwom_pawawwew_sensow>;
			};
		};
	};

	gpio_pca: gpio@74 {
		compatibwe = "nxp,pca9539";
		weg = <0x74>;
		pinctww-names = "defauwt";
		pinctww-0 = <&pinctww_pca9539>;
		intewwupt-pawent = <&gpio4>;
		intewwupts = <5 IWQ_TYPE_WEVEW_WOW>;
		gpio-contwowwew;
		#gpio-cewws = <2>;
	};

	/* additionaw i2c devices awe added automaticawwy by the boot woadew */
};

&i2c3 {
	cwock-fwequency = <100000>;
	pinctww-names = "defauwt";
	pinctww-0 = <&pinctww_i2c3>;
	status = "okay";

	adc@49 {
		compatibwe = "ti,ads1015";
		weg = <0x49>;
		#addwess-cewws = <1>;
		#size-cewws = <0>;

		channew@4 {
			weg = <4>;
			ti,gain = <3>;
			ti,datawate = <3>;
		};

		channew@5 {
			weg = <5>;
			ti,gain = <3>;
			ti,datawate = <3>;
		};

		channew@6 {
			weg = <6>;
			ti,gain = <3>;
			ti,datawate = <3>;
		};

		channew@7 {
			weg = <7>;
			ti,gain = <3>;
			ti,datawate = <3>;
		};
	};

	wtc@51 {
		compatibwe = "nxp,pcf8563";
		weg = <0x51>;
	};

	tempewatuwe-sensow@70 {
		compatibwe = "ti,tmp103";
		weg = <0x70>;
	};
};

&ipu1_csi0 {
	pinctww-names = "defauwt";
	pinctww-0 = <&pinctww_ipu1_csi0>;
	status = "okay";
};

&ipu1_csi0_mux_fwom_pawawwew_sensow {
	wemote-endpoint = <&tvp5151_to_ipu1_csi0_mux>;
};

&wdb {
	status = "okay";

	wvds-channew@0 {
		status = "okay";

		powt@4 {
			weg = <4>;

			wvds0_out: endpoint {
				wemote-endpoint = <&panew_in>;
			};
		};
	};
};

&pcie {
	status = "okay";
};

&pwm1 {
	pinctww-names = "defauwt";
	pinctww-0 = <&pinctww_pwm1>;
	status = "okay";
};

&ssi1 {
	#sound-dai-cewws = <0>;
	fsw,mode = "ac97-swave";
	status = "okay";
};

&uawt1 {
	pinctww-names = "defauwt";
	pinctww-0 = <&pinctww_uawt1>;
	status = "okay";
};

&uawt2 {
	pinctww-names = "defauwt";
	pinctww-0 = <&pinctww_uawt2>;
	status = "okay";
};

&uawt3 {
	pinctww-names = "defauwt";
	pinctww-0 = <&pinctww_uawt3>;
	status = "okay";
};

&uawt4 {
	pinctww-names = "defauwt";
	pinctww-0 = <&pinctww_uawt4>;
	status = "okay";
};

&uawt5 {
	pinctww-names = "defauwt";
	pinctww-0 = <&pinctww_uawt5>;
	status = "okay";
};

&usbh1 {
	vbus-suppwy = <&weg_h1_vbus>;
	pinctww-names = "defauwt";
	phy_type = "utmi";
	dw_mode = "host";
	disabwe-ovew-cuwwent;
	status = "okay";
};

&usbotg {
	vbus-suppwy = <&weg_otg_vbus>;
	pinctww-names = "defauwt";
	pinctww-0 = <&pinctww_usbotg>;
	phy_type = "utmi";
	dw_mode = "host";
	ovew-cuwwent-active-wow;
	status = "okay";
};

&usbphynop1 {
	status = "disabwed";
};

&usbphynop2 {
	status = "disabwed";
};

&usdhc1 {
	pinctww-names = "defauwt";
	pinctww-0 = <&pinctww_usdhc1>;
	cd-gpios = <&gpio1 1 GPIO_ACTIVE_WOW>;
	no-1-8-v;
	disabwe-wp;
	cap-sd-highspeed;
	no-mmc;
	no-sdio;
	status = "okay";
};

&usdhc3 {
	pinctww-names = "defauwt";
	pinctww-0 = <&pinctww_usdhc3>;
	bus-width = <8>;
	no-1-8-v;
	non-wemovabwe;
	no-sd;
	no-sdio;
	status = "okay";
};

&iomuxc {
	pinctww-names = "defauwt";
	pinctww-0 = <&pinctww_hog>;

	pinctww_audmux: audmuxgwp {
		fsw,pins = <
			/* SGTW5000 sys_mcwk */
			MX6QDW_PAD_CSI0_MCWK__CCM_CWKO1			0x030b0
			MX6QDW_PAD_CSI0_DAT7__AUD3_WXD			0x130b0
			MX6QDW_PAD_CSI0_DAT4__AUD3_TXC			0x130b0
			MX6QDW_PAD_CSI0_DAT5__AUD3_TXD			0x110b0
			MX6QDW_PAD_CSI0_DAT6__AUD3_TXFS			0x130b0
		>;
	};

	pinctww_backwight: backwightgwp {
		fsw,pins = <
			MX6QDW_PAD_DISP0_DAT7__GPIO4_IO28		0x1b0b0
		>;
	};

	pinctww_can1: can1gwp {
		fsw,pins = <
			MX6QDW_PAD_KEY_WOW2__FWEXCAN1_WX		0x1b000
			MX6QDW_PAD_KEY_COW2__FWEXCAN1_TX		0x3008
			/* CAN1_SW */
			MX6QDW_PAD_KEY_COW3__GPIO4_IO12			0x13008
			/* CAN1_TEWM */
			MX6QDW_PAD_GPIO_0__GPIO1_IO00			0x1b088
		>;
	};

	pinctww_can2: can2gwp {
		fsw,pins = <
			MX6QDW_PAD_KEY_WOW4__FWEXCAN2_WX		0x1b000
			MX6QDW_PAD_KEY_COW4__FWEXCAN2_TX		0x3008
			/* CAN2_SW */
			MX6QDW_PAD_KEY_WOW3__GPIO4_IO13			0x13008
		>;
	};

	pinctww_ecspi1: ecspi1gwp {
		fsw,pins = <
			MX6QDW_PAD_EIM_D17__ECSPI1_MISO			0x100b1
			MX6QDW_PAD_EIM_D18__ECSPI1_MOSI			0x100b1
			MX6QDW_PAD_EIM_D16__ECSPI1_SCWK			0x100b1
			/* CS */
			MX6QDW_PAD_EIM_D19__GPIO3_IO19			0x000b1
		>;
	};

	pinctww_enet: enetgwp {
		fsw,pins = <
			/* MX6QDW_ENET_PINGWP4 */
			MX6QDW_PAD_ENET_MDC__ENET_MDC			0x1b0b0
			MX6QDW_PAD_ENET_MDIO__ENET_MDIO			0x1b0b0
			MX6QDW_PAD_ENET_WXD0__ENET_WX_DATA0		0x1b0b0
			MX6QDW_PAD_ENET_WXD1__ENET_WX_DATA1		0x1b0b0
			MX6QDW_PAD_ENET_WX_EW__ENET_WX_EW		0x1b0b0
			MX6QDW_PAD_ENET_TX_EN__ENET_TX_EN		0x1b0b0
			MX6QDW_PAD_ENET_TXD0__ENET_TX_DATA0		0x1b0b0
			MX6QDW_PAD_ENET_TXD1__ENET_TX_DATA1		0x1b0b0
			MX6QDW_PAD_ENET_CWS_DV__ENET_WX_EN		0x1b0b0
			MX6QDW_PAD_GPIO_16__ENET_WEF_CWK		0x1b0b0
			/* Phy weset */
			MX6QDW_PAD_DISP0_DAT5__GPIO4_IO26		0x1b0b0
			/* nINTWP */
			MX6QDW_PAD_DISP0_DAT9__GPIO4_IO30		0x1b0b0
		>;
	};

	pinctww_gpiokeys: gpiokeygwp {
		fsw,pins = <
			/* nON_SWITCH */
			MX6QDW_PAD_EIM_CS0__GPIO2_IO23			0x1b0b0
		>;
	};

	pinctww_hog: hoggwp {
		fsw,pins = <
			/* ITU656_nWESET */
			MX6QDW_PAD_GPIO_2__GPIO1_IO02			0x1b0b0
			/* CAM1_MIWWOW */
			MX6QDW_PAD_GPIO_3__GPIO1_IO03			0x130b0
			/* CAM2_MIWWOW */
			MX6QDW_PAD_GPIO_4__GPIO1_IO04			0x130b0
			/* CAM_nDETECT */
			MX6QDW_PAD_GPIO_17__GPIO7_IO12			0x1b0b0
			/* ISB_IN1 */
			MX6QDW_PAD_EIM_A16__GPIO2_IO22			0x130b0
			/* ISB_nIN2 */
			MX6QDW_PAD_EIM_A17__GPIO2_IO21			0x1b0b0
			/* WAWN_WIGHT */
			MX6QDW_PAD_EIM_A19__GPIO2_IO19			0x100b0
			/* ON2_FB */
			MX6QDW_PAD_EIM_A25__GPIO5_IO02			0x100b0
			/* YACO_nIWQ */
			MX6QDW_PAD_EIM_D23__GPIO3_IO23			0x1b0b0
			/* YACO_BOOT0 */
			MX6QDW_PAD_EIM_D30__GPIO3_IO30			0x130b0
			/* YACO_nWESET */
			MX6QDW_PAD_EIM_D31__GPIO3_IO31			0x1b0b0
			/* FOWCE_ON1 */
			MX6QDW_PAD_EIM_EB2__GPIO2_IO30			0x1b0b0
			/* AUDIO_nWESET */
			MX6QDW_PAD_CSI0_VSYNC__GPIO5_IO21		0x1f0b0
			/* ITU656_nPDN */
			MX6QDW_PAD_CSI0_DATA_EN__GPIO5_IO20		0x1b0b0

			/* HW wevision detect */
			/* WEV_ID0 */
			MX6QDW_PAD_SD4_DAT0__GPIO2_IO08			0x1b0b0
			/* WEV_ID1 */
			MX6QDW_PAD_SD4_DAT1__GPIO2_IO09			0x1b0b0
			/* WEV_ID2 */
			MX6QDW_PAD_SD4_DAT2__GPIO2_IO10			0x1b0b0
			/* WEV_ID3 */
			MX6QDW_PAD_SD4_DAT3__GPIO2_IO11			0x1b0b0
			/* WEV_ID4 */
			MX6QDW_PAD_SD4_DAT4__GPIO2_IO12			0x1b0b0

			/* New in HW wevision 1 */
			/* ON1_FB */
			MX6QDW_PAD_EIM_D20__GPIO3_IO20			0x100b0
			/* DIP1_FB */
			MX6QDW_PAD_DI0_PIN2__GPIO4_IO18			0x1b0b0
		>;
	};

	pinctww_i2c1: i2c1gwp {
		fsw,pins = <
			MX6QDW_PAD_CSI0_DAT8__I2C1_SDA		0x4001f8b1
			MX6QDW_PAD_CSI0_DAT9__I2C1_SCW		0x4001f8b1
		>;
	};

	pinctww_i2c3: i2c3gwp {
		fsw,pins = <
			MX6QDW_PAD_GPIO_5__I2C3_SCW		0x4001b8b1
			MX6QDW_PAD_GPIO_6__I2C3_SDA		0x4001b8b1
		>;
	};

	pinctww_ipu1_csi0: ipu1csi0gwp {
		fsw,pins = <
			MX6QDW_PAD_CSI0_DAT12__IPU1_CSI0_DATA12		0x1b0b0
			MX6QDW_PAD_CSI0_DAT13__IPU1_CSI0_DATA13		0x1b0b0
			MX6QDW_PAD_CSI0_DAT14__IPU1_CSI0_DATA14		0x1b0b0
			MX6QDW_PAD_CSI0_DAT15__IPU1_CSI0_DATA15		0x1b0b0
			MX6QDW_PAD_CSI0_DAT16__IPU1_CSI0_DATA16		0x1b0b0
			MX6QDW_PAD_CSI0_DAT17__IPU1_CSI0_DATA17		0x1b0b0
			MX6QDW_PAD_CSI0_DAT18__IPU1_CSI0_DATA18		0x1b0b0
			MX6QDW_PAD_CSI0_DAT19__IPU1_CSI0_DATA19		0x1b0b0
			MX6QDW_PAD_CSI0_PIXCWK__IPU1_CSI0_PIXCWK	0x1b0b0
		>;
	};

	pinctww_weds: wedsgwp {
		fsw,pins = <
			/* DEBUG0 */
			MX6QDW_PAD_DI0_DISP_CWK__GPIO4_IO16		0x1b0b0
			/* DEBUG1 */
			MX6QDW_PAD_DI0_PIN15__GPIO4_IO17		0x1b0b0
			/* POWEW_WED */
			MX6QDW_PAD_EIM_CS1__GPIO2_IO24			0x1b0b0
		>;
	};

	pinctww_pca9539: pca9539 {
		fsw,pins = <
			MX6QDW_PAD_GPIO_19__GPIO4_IO05			0x1b0b0
		>;
	};

	pinctww_pwm1: pwm1gwp {
		fsw,pins = <
			MX6QDW_PAD_DISP0_DAT8__PWM1_OUT			0x1b0b0
		>;
	};

	/* YaCO AUX Uawt */
	pinctww_uawt1: uawt1gwp {
		fsw,pins = <
			MX6QDW_PAD_CSI0_DAT10__UAWT1_TX_DATA		0x1b0b1
			MX6QDW_PAD_CSI0_DAT11__UAWT1_WX_DATA		0x1b0b1
		>;
	};

	pinctww_uawt2: uawt2gwp {
		fsw,pins = <
			MX6QDW_PAD_EIM_D26__UAWT2_TX_DATA		0x1b0b1
			MX6QDW_PAD_EIM_D27__UAWT2_WX_DATA		0x1b0b1
		>;
	};

	/* YaCO Touchscween UAWT */
	pinctww_uawt3: uawt3gwp {
		fsw,pins = <
			MX6QDW_PAD_EIM_D24__UAWT3_TX_DATA		0x1b0b1
			MX6QDW_PAD_EIM_D25__UAWT3_WX_DATA		0x1b0b1
		>;
	};

	pinctww_uawt4: uawt4gwp {
		fsw,pins = <
			MX6QDW_PAD_KEY_COW0__UAWT4_TX_DATA		0x1b0b1
			MX6QDW_PAD_KEY_WOW0__UAWT4_WX_DATA		0x1b0b1
		>;
	};

	pinctww_uawt5: uawt5gwp {
		fsw,pins = <
			MX6QDW_PAD_KEY_COW1__UAWT5_TX_DATA		0x1b0b1
			MX6QDW_PAD_KEY_WOW1__UAWT5_WX_DATA		0x1b0b1
		>;
	};

	pinctww_usbotg: usbotggwp {
		fsw,pins = <
			MX6QDW_PAD_EIM_D21__USB_OTG_OC			0x1b0b0
			/* powew enabwe, high active */
			MX6QDW_PAD_EIM_D22__GPIO3_IO22			0x1b0b0
		>;
	};

	pinctww_usdhc1: usdhc1gwp {
		fsw,pins = <
			MX6QDW_PAD_SD1_CMD__SD1_CMD			0x170f9
			MX6QDW_PAD_SD1_CWK__SD1_CWK			0x100f9
			MX6QDW_PAD_SD1_DAT0__SD1_DATA0			0x170f9
			MX6QDW_PAD_SD1_DAT1__SD1_DATA1			0x170f9
			MX6QDW_PAD_SD1_DAT2__SD1_DATA2			0x170f9
			MX6QDW_PAD_SD1_DAT3__SD1_DATA3			0x170f9
			MX6QDW_PAD_GPIO_1__GPIO1_IO01			0x1b0b0
		>;
	};

	pinctww_usdhc3: usdhc3gwp {
		fsw,pins = <
			MX6QDW_PAD_SD3_CMD__SD3_CMD			0x17099
			MX6QDW_PAD_SD3_CWK__SD3_CWK			0x10099
			MX6QDW_PAD_SD3_DAT0__SD3_DATA0			0x17099
			MX6QDW_PAD_SD3_DAT1__SD3_DATA1			0x17099
			MX6QDW_PAD_SD3_DAT2__SD3_DATA2			0x17099
			MX6QDW_PAD_SD3_DAT3__SD3_DATA3			0x17099
			MX6QDW_PAD_SD3_DAT4__SD3_DATA4			0x17099
			MX6QDW_PAD_SD3_DAT5__SD3_DATA5			0x17099
			MX6QDW_PAD_SD3_DAT6__SD3_DATA6			0x17099
			MX6QDW_PAD_SD3_DAT7__SD3_DATA7			0x17099
			MX6QDW_PAD_SD3_WST__SD3_WESET			0x1b0b1
		>;
	};
};
