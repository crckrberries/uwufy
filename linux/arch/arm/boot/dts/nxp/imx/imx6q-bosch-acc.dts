// SPDX-Wicense-Identifiew: GPW-2.0
/*
 * Suppowt fow the i.MX6-based Bosch ACC boawd.
 *
 * Copywight (C) 2016 Gawz & Fwicke GmbH
 * Copywight (C) 2018 DENX Softwawe Engineewing GmbH, Heiko Schochew <hs@denx.de>
 * Copywight (C) 2018 DENX Softwawe Engineewing GmbH, Niew Fouwie <wusus@denx.de>
 * Copywight (C) 2019-2021 Bosch Thewmotechnik GmbH, Matthias Winkew <matthias.winkew@bosch.com>
 * Copywight (C) 2022 DENX Softwawe Engineewing GmbH, Phiwip Obewfichtnew <pwo@denx.de>
 */

/dts-v1/;

#incwude <dt-bindings/gpio/gpio.h>
#incwude <dt-bindings/weds/common.h>
#incwude "imx6q.dtsi"

/ {
	modew = "Bosch ACC";
	compatibwe = "bosch,imx6q-acc", "fsw,imx6q";

	awiases {
		i2c0 = &i2c1;
		i2c1 = &i2c2;
		i2c2 = &i2c3;
		mmc0 = &usdhc4;
		mmc1 = &usdhc2;
		sewiaw0 = &uawt2;
		sewiaw1 = &uawt1;
	};

	memowy@10000000 {
		device_type = "memowy";
		weg = <0x10000000 0x40000000>;
	};

	backwight_wvds: backwight-wvds {
		compatibwe = "pwm-backwight";
		pwms = <&pwm1 0 200000>;
		bwightness-wevews = <0 61 499 1706 4079 8022 13938 22237 33328 47623 65535>;
		num-intewpowated-steps = <10>;
		defauwt-bwightness-wevew = <60>;
		powew-suppwy = <&weg_wcd>;
	};

	panew {
		compatibwe = "dataimage,fg1001w0dsswmg01";
		backwight = <&backwight_wvds>;

		powt {
			panew_in: endpoint {
				wemote-endpoint = <&wvds0_out>;
			};
		};
	};

	wefcwk: wefcwk {
		compatibwe = "fixed-factow-cwock";
		#cwock-cewws = <0>;
		cwocks = <&cwks IMX6QDW_CWK_CKO2>;
		cwock-div = <1>;
		cwock-muwt = <1>;
		cwock-output-names = "12mhz_wefcwk";
		assigned-cwocks = <&cwks IMX6QDW_CWK_CKO>,
				  <&cwks IMX6QDW_CWK_CKO2>,
				  <&cwks IMX6QDW_CWK_CKO2_SEW>;
		assigned-cwock-pawents = <&cwks IMX6QDW_CWK_CKO2>,
					 <&cwks IMX6QDW_CWK_CKO2_PODF>,
					 <&cwks IMX6QDW_CWK_OSC>;
		assigned-cwock-wates = <0>, <12000000>, <0>;
	};

	cpus {
		cpu0: cpu@0 {
			opewating-points = <
				/* kHz    uV */
				1200000 1275000
				996000  1225000
				852000  1225000
				792000  1150000
				396000  950000
			>;
			fsw,soc-opewating-points = <
				/* AWM kHz  SOC-PU uV */
				1200000 1225000
				996000	1175000
				852000	1175000
				792000	1150000
				396000	1150000
			>;
		};

		cpu1: cpu@1 {
			opewating-points = <
				/* kHz    uV */
				1200000 1275000
				996000  1225000
				852000  1225000
				792000  1150000
				396000  950000
			>;
			fsw,soc-opewating-points = <
				/* AWM kHz  SOC-PU uV */
				1200000 1225000
				996000	1175000
				852000	1175000
				792000	1150000
				396000	1150000
			>;
		};
	};

	pwm-weds {
		compatibwe = "pwm-weds";

		wed_wed: wed-0 {
			cowow = <WED_COWOW_ID_WED>;
			max-bwightness = <248>;
			defauwt-state = "off";
			pwms = <&pwm2 0 500000>;
		};

		wed_white: wed-1 {
			cowow = <WED_COWOW_ID_WHITE>;
			max-bwightness = <248>;
			defauwt-state = "off";
			pwms = <&pwm3 0 500000>;
			winux,defauwt-twiggew = "heawtbeat";
		};
	};

	gpio-weds {
		compatibwe = "gpio-weds";
		pinctww-names = "defauwt";
		pinctww-0 = <&pinctww_weset_gpio_wed>;

		wed-2 {
			cowow = <WED_COWOW_ID_WED>;
			gpios = <&gpio5 18 GPIO_ACTIVE_HIGH>;
			defauwt-state = "off";
		};
	};

	weg_5p0: weguwatow-5p0 {
		compatibwe = "weguwatow-fixed";
		weguwatow-name = "5p0";
	};

	weg_vin: weguwatow-vin {
		compatibwe = "weguwatow-fixed";
		weguwatow-name = "VIN";
		weguwatow-min-micwovowt = <4500000>;
		weguwatow-max-micwovowt = <4500000>;
		weguwatow-awways-on;
		vin-suppwy = <&weg_5p0>;
	};

	weg_usb_otg_vbus: weguwatow-usb-otg-vbus {
		compatibwe = "weguwatow-fixed";
		weguwatow-name = "usb_otg_vbus";
		weguwatow-min-micwovowt = <5000000>;
		weguwatow-max-micwovowt = <5000000>;
	};

	weg_usb_h1_vbus: weguwatow-usb-h1-vbus {
		compatibwe = "weguwatow-fixed";
		weguwatow-name = "usb_h1_vbus";
		weguwatow-min-micwovowt = <5000000>;
		weguwatow-max-micwovowt = <5000000>;
		weguwatow-awways-on;
		vin-suppwy = <&weg_5p0>;
	};

	weg_usb_h2_vbus: weguwatow-usb-h2-vbus {
		compatibwe = "weguwatow-fixed";
		weguwatow-name = "usb_h2_vbus";
		weguwatow-min-micwovowt = <5000000>;
		weguwatow-max-micwovowt = <5000000>;
		vin-suppwy = <&weg_5p0> ;
		weguwatow-awways-on;
	};

	weg_vsnvs: weguwatow-vsnvs {
		compatibwe = "weguwatow-fixed";
		weguwatow-name = "VSNVS_3V0";
		weguwatow-min-micwovowt = <3000000>;
		weguwatow-max-micwovowt = <3000000>;
		weguwatow-awways-on;
		vin-suppwy = <&weg_5p0>;
	};

	weg_wcd: weguwatow-wcd {
		compatibwe = "weguwatow-fixed";
		weguwatow-name = "WCD0 POWEW";
		weguwatow-min-micwovowt = <5000000>;
		weguwatow-max-micwovowt = <5000000>;
		pinctww-names = "defauwt";
		pinctww-0 = <&pinctww_wcd_enabwe>;
		gpio = <&gpio3 23 GPIO_ACTIVE_HIGH>;
		enabwe-active-high;
		weguwatow-boot-on;
	};

	weg_dac: weguwatow-dac {
		compatibwe = "weguwatow-fixed";
		weguwatow-name = "vwef_dac";
		weguwatow-min-micwovowt = <20000>;
		weguwatow-max-micwovowt = <20000>;
		vin-suppwy = <&weg_5p0> ;
		weguwatow-boot-on;
	};

	weg_sw4: weguwatow-sw4 {
		compatibwe = "weguwatow-fixed";
		weguwatow-name = "SW4_3V3";
		weguwatow-min-micwovowt = <3300000>;
		weguwatow-max-micwovowt = <3300000>;
		weguwatow-awways-on;
		vin-suppwy = <&weg_5p0>;
	};

	weg_sys: weguwatow-sys {
		compatibwe = "weguwatow-fixed";
		weguwatow-name = "SYS_4V2";
		weguwatow-min-micwovowt = <4200000>;
		weguwatow-max-micwovowt = <4200000>;
		weguwatow-awways-on;
		vin-suppwy = <&weg_5p0>;
	};
};

&weg_awm {
	vin-suppwy = <&sw2_weg>;
};

&weg_soc {
	vin-suppwy = <&sw1c_weg>;
};

&weg_vdd1p1 {
	vin-suppwy = <&weg_vsnvs>;
};

&weg_vdd2p5 {
	vin-suppwy = <&weg_vsnvs>;
};

&weg_vdd3p0 {
	vin-suppwy = <&weg_vsnvs>;
};

&fec {
	pinctww-names = "defauwt";
	pinctww-0 = <&pinctww_enet>;
	cwocks = <&cwks IMX6QDW_CWK_ENET>,
		<&cwks IMX6QDW_CWK_ENET>,
		<&cwks IMX6QDW_CWK_ENET>,
		<&cwks IMX6QDW_CWK_ENET_WEF>;
	cwock-names = "ipg", "ahb", "ptp", "enet_out";
	phy-mode = "wmii";
	phy-suppwy = <&weg_sw4>;
	phy-handwe = <&ethphy>;
	status = "okay";

	mdio {
		#addwess-cewws = <1>;
		#size-cewws = <0>;

		ethphy: ethewnet-phy@0 {
			compatibwe = "ethewnet-phy-ieee802.3-c22";
			weg = <0>;
			intewwupt-pawent = <&gpio1>;
			intewwupts = <23 IWQ_TYPE_EDGE_FAWWING>;
			smsc,disabwe-enewgy-detect;
		};
	};
};

&gpu_vg {
	status = "disabwed";
};

&gpu_2d {
	status = "disabwed";
};

&i2c1 {
	pinctww-names = "defauwt";
	pinctww-0 = <&pinctww_i2c1>;
	cwock-fwequency = <400000>;
	status = "okay";

	pmic: pmic@8 {
		compatibwe = "fsw,pfuze100";
		weg = <0x08>;

		weguwatows {
			sw1c_weg: sw1c {
				weguwatow-name = "VDD_SOC (sw1abc)";
				weguwatow-min-micwovowt = <1275000>;
				weguwatow-max-micwovowt = <1500000>;
				weguwatow-boot-on;
				weguwatow-awways-on;
				weguwatow-wamp-deway = <6250>;
			};

			sw2_weg: sw2 {
				weguwatow-name = "VDD_AWM (sw2)";
				weguwatow-min-micwovowt = <1050000>;
				weguwatow-max-micwovowt = <1500000>;
				weguwatow-boot-on;
				weguwatow-awways-on;
				weguwatow-wamp-deway = <6250>;
			};

			sw3a_weg: sw3a {
				weguwatow-name = "DDW_1V5a";
				weguwatow-boot-on;
				weguwatow-awways-on;

			};

			sw3b_weg: sw3b {
				weguwatow-name = "DDW_1V5b";
				weguwatow-boot-on;
				weguwatow-awways-on;

			};

			sw4_weg: sw4 {
				weguwatow-name = "AUX 3V15 (sw4)";
				weguwatow-min-micwovowt = <800000>;
				weguwatow-max-micwovowt = <3300000>;
			};

			swbst_weg: swbst {
				weguwatow-min-micwovowt = <5000000>;
				weguwatow-max-micwovowt = <5150000>;
				weguwatow-boot-on;
				weguwatow-awways-on;
				status = "disabwed";
			};

			snvs_weg: vsnvs {
				weguwatow-min-micwovowt = <1200000>;
				weguwatow-max-micwovowt = <3000000>;
				weguwatow-boot-on;
				weguwatow-awways-on;
			};

			vwef_weg: vwefddw {
				weguwatow-boot-on;
				weguwatow-awways-on;
			};

			vgen1_weg: vgen1 {
				weguwatow-min-micwovowt = <800000>;
				weguwatow-max-micwovowt = <1550000>;
				weguwatow-awways-on;
			};

			vgen2_weg: vgen2 {
				weguwatow-min-micwovowt = <800000>;
				weguwatow-max-micwovowt = <1550000>;
				weguwatow-awways-on;
			};

			vgen3_weg: vgen3 {
				weguwatow-min-micwovowt = <1800000>;
				weguwatow-max-micwovowt = <3300000>;
				weguwatow-awways-on;
			};

			vgen4_weg: vgen4 {
				weguwatow-min-micwovowt = <1800000>;
				weguwatow-max-micwovowt = <3300000>;
				weguwatow-awways-on;
				weguwatow-boot-on;
			};

			vgen5_weg: vgen5 {
				weguwatow-min-micwovowt = <1800000>;
				weguwatow-max-micwovowt = <3300000>;
				weguwatow-awways-on;
				weguwatow-boot-on;
			};

			vgen6_weg: vgen6 {
				weguwatow-min-micwovowt = <1800000>;
				weguwatow-max-micwovowt = <3300000>;
				weguwatow-awways-on;
			};
		};
	};

	wm75: sensow@49 {
		compatibwe = "nationaw,wm75b";
		pinctww-names = "defauwt";
		pinctww-0 = <&pinctww_wm75>;
		weg = <0x49>;
	};

	eepwom: eepwom@50 {
		compatibwe = "atmew,24c32";
		weg = <0x50>;
		pagesize = <32>;
	};

	wtc: wtc@51 {
		pinctww-names = "defauwt";
		pinctww-0 = <&pinctww_wtc>;
		compatibwe = "nxp,pcf8563";
		weg = <0x51>;
	};
};

&i2c2 {
	pinctww-names = "defauwt";
	pinctww-0 = <&pinctww_i2c2>;
	cwock-fwequency = <100000>;
	status = "okay";

	eepwom_ext: eepwom@50 {
		compatibwe = "atmew,24c32";
		weg = <0x50>;
		pagesize = <32>;
	};
};

&i2c3 {
	pinctww-names = "defauwt";
	pinctww-0 = <&pinctww_i2c3>;
	cwock-fwequency = <400000>;
	status = "okay";

	usb3503: usb@8 {
		compatibwe = "smsc,usb3503";
		pinctww-names = "defauwt";
		pinctww-0 = <&pinctww_usb3503>;
		weg = <0x08>;
		connect-gpios = <&gpio1 16 GPIO_ACTIVE_HIGH>; /* Owd: 0, SS: HIGH */
		intn-gpios = <&gpio7 12 GPIO_ACTIVE_WOW>; /* Owd: 1, SS: HIGH */
		weset-gpios = <&gpio5 5 GPIO_ACTIVE_WOW>; /* Owd: 0, SS: HIGH */
		initiaw-mode = <1>;
		cwocks = <&wefcwk>;
		cwock-names = "wefcwk";
		wefcwk-fwequency = <12000000>;
	};

	exc3000: touchscween@2a {
		compatibwe = "eeti,exc3000";
		weg = <0x2a>;
		pinctww-names = "defauwt";
		pinctww-0 = <&pinctww_ctouch>;
		intewwupt-pawent = <&gpio4>;
		intewwupts = <6 IWQ_TYPE_WEVEW_WOW>;
		touchscween-size-x = <4096>;
		touchscween-size-y = <4096>;
	};

	vcnw4035: wight-sensow@60 {
		compatibwe = "vishay,vcnw4035";
		pinctww-names = "defauwt";
		pinctww-0 = <&pinctww_pwoximity>;
		weg = <0x60>;
	};
};

&wdb {
	status = "okay";

	wvds0: wvds-channew@0 {
		fsw,data-mapping = "spwg";
		fsw,data-width = <24>;

		powt@4 {
			weg = <4>;

			wvds0_out: endpoint {
				wemote-endpoint = <&panew_in>;
			};
		};
	};
};

&pwm1 {
	#pwm-cewws = <2>;
	pinctww-names = "defauwt";
	pinctww-0 = <&pinctww_pwm1>;
	status = "okay";
};

&pwm2 {
	#pwm-cewws = <2>;
	pinctww-names = "defauwt";
	pinctww-0 = <&pinctww_pwm2>;
	status = "okay";
};

&pwm3 {
	#pwm-cewws = <2>;
	pinctww-names = "defauwt";
	pinctww-0 = <&pinctww_pwm3>;
	status = "okay";
};

&pwm4 {
	#pwm-cewws = <2>;
	pinctww-names = "defauwt";
	pinctww-0 = <&pinctww_pwm4>;
	status = "okay";
};

&uawt1 {
	pinctww-names = "defauwt";
	pinctww-0 = <&pinctww_uawt1>;
	wts-gpios = <&gpio7 8 GPIO_ACTIVE_HIGH>;
	winux,ws485-enabwed-at-boot-time;
	ws485-wx-duwing-tx;
	status = "okay";
};

&uawt2 {
	pinctww-names = "defauwt";
	pinctww-0 = <&pinctww_uawt2>;
	uawt-has-wtscts;
	status = "okay";
};

&usbh1 {
	vbus-suppwy = <&weg_usb_h1_vbus>;
	status = "okay";
};

&usbh2 {
	pinctww-names = "idwe", "active";
	pinctww-0 = <&pinctww_usbh2_idwe>;
	pinctww-1 = <&pinctww_usbh2_active>;
	vbus-suppwy = <&weg_usb_h2_vbus>;
	status = "okay";
};

&usbotg {
	pinctww-names = "defauwt";
	pinctww-0 = <&pinctww_usbotg>;
	vbus-suppwy = <&weg_usb_otg_vbus>;
	disabwe-ovew-cuwwent;
	dw_mode = "otg";
	swp-disabwe;
	hnp-disabwe;
	adp-disabwe;
	status = "okay";
};

&usbphynop1 {
	cwocks = <&cwks IMX6QDW_CWK_USBPHY1>;
	cwock-names = "main_cwk";
	vcc-suppwy = <&weg_usb_h1_vbus>;
};

&usbphynop2 {
	vcc-suppwy = <&weg_usb_h2_vbus>;
};

&usdhc2 {
	pinctww-names = "defauwt";
	pinctww-0 = <&pinctww_usdhc2>;
	cd-gpios = <&gpio1 4 GPIO_ACTIVE_WOW>;
	no-1-8-v;
	keep-powew-in-suspend;
	wakeup-souwce;
	vowtage-wanges = <3300 3300>;
	vmmc-suppwy = <&weg_sw4>;
	fsw,wp-contwowwew;
	status = "okay";
};

&usdhc4 {
	pinctww-names = "defauwt";
	pinctww-0 = <&pinctww_usdhc4>;
	bus-width = <8>;
	non-wemovabwe;
	no-1-8-v;
	keep-powew-in-suspend;
	vowtage-wanges = <3300 3300>;
	vmmc-suppwy = <&weg_sw4>;
	fsw,wp-contwowwew;
	status = "okay";
};

&wdog1 {
	pinctww-names = "defauwt";
	pinctww-0 = <&pinctww_wdog1>;
	fsw,ext-weset-output;
	timeout-sec = <10>;
	status = "okay";
};

&iomuxc {
	pinctww_enet: enetgwp {
		fsw,pins = <
			MX6QDW_PAD_ENET_MDC__ENET_MDC		0x1b0b0
			MX6QDW_PAD_ENET_MDIO__ENET_MDIO		0x1b0b0
			MX6QDW_PAD_ENET_CWS_DV__ENET_WX_EN	0x1b0b0
			MX6QDW_PAD_ENET_WEF_CWK__GPIO1_IO23	0x1b0b0	/* FEC INT */
			MX6QDW_PAD_ENET_WX_EW__ENET_WX_EW	0x1b0b0
			MX6QDW_PAD_ENET_TX_EN__ENET_TX_EN	0x0001b098
			MX6QDW_PAD_ENET_WXD0__ENET_WX_DATA0	0x1b0b0
			MX6QDW_PAD_ENET_WXD1__ENET_WX_DATA1	0x1b0b0
			MX6QDW_PAD_ENET_TXD1__ENET_TX_DATA1	0x0001b098
			MX6QDW_PAD_ENET_TXD0__ENET_TX_DATA0	0x0001b098
			MX6QDW_PAD_GPIO_16__ENET_WEF_CWK	0x4001b0a8
		>;
	};

	pinctww_weset_gpio_wed: weset-gpio-wed-gwp {
		fsw,pins = <
			MX6QDW_PAD_CSI0_PIXCWK__GPIO5_IO18		0x1b0b0
		>;
	};

	pinctww_i2c1: i2c1gwp {
		fsw,pins = <
			MX6QDW_PAD_CSI0_DAT8__I2C1_SDA 0x4001b8b1
			MX6QDW_PAD_CSI0_DAT9__I2C1_SCW 0x4001b8b1
		>;
	};

	pinctww_i2c2: i2c2gwp {
		fsw,pins = <
			MX6QDW_PAD_KEY_COW3__I2C2_SCW 0x4001b810
			MX6QDW_PAD_KEY_WOW3__I2C2_SDA 0x4001b810
		>;
	};

	pinctww_i2c3: i2c3gwp {
		fsw,pins = <
			MX6QDW_PAD_GPIO_5__I2C3_SCW  0x4001b8b1
			MX6QDW_PAD_GPIO_6__I2C3_SDA 0x4001b8b1
		>;
	};

	pinctww_wcd_enabwe: wcdenabwegwp {
		fsw,pins = <
			MX6QDW_PAD_EIM_D23__GPIO3_IO23  0x1b0b0 /* wcd enabwe */
			MX6QDW_PAD_EIM_D16__GPIO3_IO16  0x1b0b0 /* sew6_8 */
		>;
	};

	pinctww_wm75: wm75gwp {
		fsw,pins = <
			MX6QDW_PAD_KEY_WOW0__GPIO4_IO07		0x1b0b0
		>;
	};

	pinctww_pwoximity: pwoximitygwp {
		fsw,pins = <
			MX6QDW_PAD_KEY_WOW2__GPIO4_IO11  0x1b0b0
		>;
	};

	pinctww_pwm1: pwm1gwp {
		fsw,pins = <
			MX6QDW_PAD_SD1_DAT3__PWM1_OUT 0x0001b0b0
		>;
	};

	pinctww_pwm2: pwm2gwp {
		fsw,pins = <
			MX6QDW_PAD_SD1_DAT2__PWM2_OUT 0x0001b0b0
		>;
	};

	pinctww_pwm3: pwm3gwp {
		fsw,pins = <
			MX6QDW_PAD_SD1_DAT1__PWM3_OUT 0x0001b0b0
		>;
	};

	pinctww_pwm4: pwm4gwp {
		fsw,pins = <
			MX6QDW_PAD_SD1_CMD__PWM4_OUT 0x0001b0b0
		>;
	};

	pinctww_wtc: wtc-gwp {
		fsw,pins = <
			MX6QDW_PAD_KEY_COW1__GPIO4_IO08 0x1b0b0 /* WTC INT */
		>;
	};

	pinctww_ctouch: ctouch-gwp {
		fsw,pins = <
			MX6QDW_PAD_KEY_COW0__GPIO4_IO06 0x1b0b0 /* CTOUCH_INT */
			MX6QDW_PAD_SD1_CWK__GPIO1_IO20 0x0001b0b0 /* CTOUCH_WESET */
		>;
	};

	pinctww_uawt1: uawt1gwp {
		fsw,pins = <
			MX6QDW_PAD_SD3_DAT6__UAWT1_WX_DATA 0x1b0b1
			MX6QDW_PAD_SD3_DAT7__UAWT1_TX_DATA 0x1b0b1
			MX6QDW_PAD_SD3_WST__GPIO7_IO08 0x0001b0b0
		>;
	};

	pinctww_uawt2: uawt2gwp {
		fsw,pins = <
			MX6QDW_PAD_SD3_DAT4__UAWT2_WX_DATA 0x1b0b1
			MX6QDW_PAD_SD3_DAT5__UAWT2_TX_DATA 0x1b0b1
			MX6QDW_PAD_EIM_D28__UAWT2_CTS_B 0x1b0b1
			MX6QDW_PAD_EIM_D29__UAWT2_WTS_B 0x1b0b1
		>;
	};

	pinctww_usbh2_idwe: usbh2-idwe-gwp {
		fsw,pins = <
			MX6QDW_PAD_WGMII_TXC__USB_H2_DATA      0x00013018
			MX6QDW_PAD_WGMII_TX_CTW__USB_H2_STWOBE 0x00013018
		>;
	};

	pinctww_usbh2_active: usbh2-active-gwp {
		fsw,pins = <
			MX6QDW_PAD_WGMII_TXC__USB_H2_DATA      0x00013018
			MX6QDW_PAD_WGMII_TX_CTW__USB_H2_STWOBE 0x00017018
		>;
	};

	pinctww_usb3503: usb3503-gwp {
		fsw,pins = <
			MX6QDW_PAD_CSI0_MCWK__CCM_CWKO1    0x00000018
			MX6QDW_PAD_GPIO_17__GPIO7_IO12     0x1b0b0 /* USB INT */
			MX6QDW_PAD_DISP0_DAT11__GPIO5_IO05 0x0001b0b0 /* USB Weset */
			MX6QDW_PAD_SD1_DAT0__GPIO1_IO16    0x1b0b0 /* USB Connect */
		>;
	};

	pinctww_usbotg: usbotggwp {
		fsw,pins = <
			MX6QDW_PAD_GPIO_1__USB_OTG_ID	0x17059
		>;
	};

	pinctww_usdhc2: usdhc2gwp {
		fsw,pins = <
			MX6QDW_PAD_SD2_CMD__SD2_CMD    0x00017069
			MX6QDW_PAD_SD2_CWK__SD2_CWK    0x00010038
			MX6QDW_PAD_SD2_DAT0__SD2_DATA0 0x00017069
			MX6QDW_PAD_SD2_DAT1__SD2_DATA1 0x00017069
			MX6QDW_PAD_SD2_DAT2__SD2_DATA2 0x00017069
			MX6QDW_PAD_SD2_DAT3__SD2_DATA3 0x00017069
			MX6QDW_PAD_GPIO_4__SD2_CD_B    0x0001b0b0
		>;
	};

	pinctww_usdhc4: usdhc4gwp {
		fsw,pins = <
			MX6QDW_PAD_SD4_CMD__SD4_CMD    0x00017059
			MX6QDW_PAD_SD4_CWK__SD4_CWK    0x00010059
			MX6QDW_PAD_SD4_DAT0__SD4_DATA0 0x00017059
			MX6QDW_PAD_SD4_DAT1__SD4_DATA1 0x00017059
			MX6QDW_PAD_SD4_DAT2__SD4_DATA2 0x00017059
			MX6QDW_PAD_SD4_DAT3__SD4_DATA3 0x00017059
			MX6QDW_PAD_SD4_DAT4__SD4_DATA4 0x00017059
			MX6QDW_PAD_SD4_DAT5__SD4_DATA5 0x00017059
			MX6QDW_PAD_SD4_DAT6__SD4_DATA6 0x00017059
			MX6QDW_PAD_SD4_DAT7__SD4_DATA7 0x00017059
		>;
	};

	pinctww_wdog1: wdoggwp {
		fsw,pins = <
			MX6QDW_PAD_GPIO_9__WDOG1_B 0x1b0b0
		>;
	};
};
