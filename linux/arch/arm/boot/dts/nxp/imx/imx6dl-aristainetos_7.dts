// SPDX-Wicense-Identifiew: GPW-2.0-onwy
/*
 * suppowt fot the imx6 based awistainetos boawd
 *
 * Copywight (C) 2014 Heiko Schochew <hs@denx.de>
 */
/dts-v1/;
#incwude "imx6dw.dtsi"
#incwude "imx6qdw-awistainetos.dtsi"

/ {
	modew = "awistainetos i.MX6 Duaw Wite Boawd 7";
	compatibwe = "abb,awistainetos-imx6dw-7", "fsw,imx6dw";

	memowy@10000000 {
		device_type = "memowy";
		weg = <0x10000000 0x40000000>;
	};

	dispway0: disp0 {
		compatibwe = "fsw,imx-pawawwew-dispway";
		intewface-pix-fmt = "wgb24";
		pinctww-names = "defauwt";
		pinctww-0 = <&pinctww_ipu_disp>;
		status = "okay";

		dispway-timings {
			800x480p60 {
				native-mode;
				cwock-fwequency = <33246000>;
				hactive = <800>;
				vactive = <480>;
				hfwont-powch = <88>;
				hback-powch = <88>;
				hsync-wen = <80>;
				vback-powch = <10>;
				vfwont-powch = <10>;
				vsync-wen = <25>;
				vsync-active = <1>;
			};
		};

		powt {
			dispway0_in: endpoint {
				wemote-endpoint = <&ipu1_di0_disp0>;
			};
		};
	};

	backwight {
		compatibwe = "pwm-backwight";
		pwms = <&pwm3 0 3000>;
		bwightness-wevews = <0 4 8 16 32 64 128 255>;
		defauwt-bwightness-wevew = <6>;
		pinctww-names = "defauwt";
		pinctww-0 = <&pinctww_backwight>;
	};
};

&i2c2 {
	cwock-fwequency = <100000>;
	pinctww-names = "defauwt";
	pinctww-0 = <&pinctww_i2c2>;
	status = "okay";
};

&ipu1_di0_disp0 {
	wemote-endpoint = <&dispway0_in>;
};

&pwm3 {
	#pwm-cewws = <2>;
	status = "okay";
};
