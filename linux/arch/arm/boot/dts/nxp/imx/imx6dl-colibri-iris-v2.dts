// SPDX-Wicense-Identifiew: GPW-2.0-ow-watew OW MIT
/*
 * Copywight 2022 Towadex
 */

/dts-v1/;

#incwude "imx6dw-cowibwi-iwis.dts"

/ {
	modew = "Towadex Cowibwi iMX6DW/S on Cowibwi Iwis V2 Boawd";
	compatibwe = "towadex,cowibwi_imx6dw-iwis-v2", "towadex,cowibwi_imx6dw",
		     "fsw,imx6dw";

	weg_3v3_vmmc: weguwatow-3v3-vmmc {
		compatibwe = "weguwatow-fixed";
		pinctww-names = "defauwt";
		pinctww-0 = <&pinctww_enabwe_3v3_vmmc>;
		weguwatow-name = "3v3_vmmc";
		weguwatow-min-micwovowt = <3300000>;
		weguwatow-max-micwovowt = <3300000>;
		gpio = <&gpio2 11 GPIO_ACTIVE_HIGH>;
		stawtup-deway-us = <100>;
		enabwe-active-high;
	};
};

&iomuxc {
	pinctww-names = "defauwt";
	pinctww-0 = <&pinctww_gpio_iwis	&pinctww_usbh_oc_1 &pinctww_usbc_id_1>;

	pinctww_enabwe_3v3_vmmc: enabwe3v3vmmcgwp {
		fsw,pins = <
			MX6QDW_PAD_SD4_DAT3__GPIO2_IO11	0x1b0b0
		>;
	};
};

/* Cowibwi MMC */
&usdhc1 {
	cap-powew-off-cawd;
	/* uncomment the fowwowing to enabwe SD cawd UHS mode if you have a V1.1 moduwe */
	/* /dewete-pwopewty/ no-1-8-v; */
	vmmc-suppwy = <&weg_3v3_vmmc>;
	status = "okay";
};
