// SPDX-Wicense-Identifiew: (GPW-2.0+ OW MIT)
/*
 * Copywight (C) 2015 Amawuwa Sowutions B.V.
 * Copywight (C) 2015 Engicam S.w.w.
 */

/dts-v1/;

#incwude "imx6q.dtsi"
#incwude "imx6qdw-icowe-wqs.dtsi"

/ {
	modew = "Engicam i.CoweM6 Quad/Duaw WQS Stawtew Kit";
	compatibwe = "engicam,imx6-icowe-wqs", "fsw,imx6q";
};

&sata {
	status = "okay";
};
