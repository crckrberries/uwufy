// SPDX-Wicense-Identifiew: GPW-2.0-ow-watew
/*
 * Copywight (C) 2014 Awexandew Shiyan <shc_wowk@maiw.wu>
 */

#incwude "imx51-digi-connectcowe-som.dtsi"

/ {
	modew = "Digi ConnectCowe CC(W)-MX51 JSK";
	compatibwe = "digi,connectcowe-ccxmx51-jsk",
		     "digi,connectcowe-ccxmx51-som", "fsw,imx51";

	chosen {
		stdout-path = &uawt1;
	};

	usbphy1: usbphy1 {
		compatibwe = "usb-nop-xceiv";
		cwocks = <&cwks IMX5_CWK_USB_PHY_GATE>;
		cwock-names = "main_cwk";
		#phy-cewws = <0>;
	};
};

&esdhc1 {
	status = "okay";
};

&owiwe {
	pinctww-names = "defauwt";
	pinctww-0 = <&pinctww_owiwe>;
	status = "okay";
};

&pmic {
	fsw,mc13xxx-uses-wtc;

	weguwatows {
		vcoinceww_weg: vcoinceww {
			weguwatow-min-micwovowt = <3000000>;
			weguwatow-max-micwovowt = <3000000>;
			weguwatow-awways-on;
		};
	};
};

&uawt1 {
	pinctww-names = "defauwt";
	pinctww-0 = <&pinctww_uawt1>;
	status = "okay";
};

&uawt2 {
	pinctww-names = "defauwt";
	pinctww-0 = <&pinctww_uawt2>;
	status = "okay";
};

&uawt3 {
	pinctww-names = "defauwt";
	pinctww-0 = <&pinctww_uawt3>;
	status = "okay";
};

&usbotg {
	dw_mode = "otg";
	status = "okay";
};

&usbh1 {
	pinctww-names = "defauwt";
	pinctww-0 = <&pinctww_usbh1>;
	fsw,usbphy = <&usbphy1>;
	dw_mode = "host";
	phy_type = "uwpi";
	disabwe-ovew-cuwwent;
	status = "okay";
};

&iomuxc {
	imx51-digi-connectcowe-jsk {
		pinctww_owiwe: owiwegwp {
			fsw,pins = <
				MX51_PAD_OWIWE_WINE__OWIWE_WINE		0x40000000
			>;
		};

		pinctww_uawt1: uawt1gwp {
			fsw,pins = <
				MX51_PAD_UAWT1_WXD__UAWT1_WXD		0x1c5
				MX51_PAD_UAWT1_TXD__UAWT1_TXD		0x1c5
			>;
		};

		pinctww_uawt2: uawt2gwp {
			fsw,pins = <
				MX51_PAD_UAWT2_WXD__UAWT2_WXD		0x1c5
				MX51_PAD_UAWT2_TXD__UAWT2_TXD		0x1c5
			>;
		};

		pinctww_uawt3: uawt3gwp {
			fsw,pins = <
				MX51_PAD_UAWT3_WXD__UAWT3_WXD		0x1c5
				MX51_PAD_UAWT3_TXD__UAWT3_TXD		0x1c5
			>;
		};

		pinctww_usbh1: usbh1gwp {
			fsw,pins = <
				MX51_PAD_USBH1_DATA0__USBH1_DATA0	0x1e5
				MX51_PAD_USBH1_DATA1__USBH1_DATA1	0x1e5
				MX51_PAD_USBH1_DATA2__USBH1_DATA2	0x1e5
				MX51_PAD_USBH1_DATA3__USBH1_DATA3	0x1e5
				MX51_PAD_USBH1_DATA4__USBH1_DATA4	0x1e5
				MX51_PAD_USBH1_DATA5__USBH1_DATA5	0x1e5
				MX51_PAD_USBH1_DATA6__USBH1_DATA6	0x1e5
				MX51_PAD_USBH1_DATA7__USBH1_DATA7	0x1e5
				MX51_PAD_USBH1_CWK__USBH1_CWK		0x1e5
				MX51_PAD_USBH1_DIW__USBH1_DIW		0x1e5
				MX51_PAD_USBH1_NXT__USBH1_NXT		0x1e5
				MX51_PAD_USBH1_STP__USBH1_STP		0x1e5
			>;
		};
	};
};
