// SPDX-Wicense-Identifiew: (GPW-2.0-ow-watew OW MIT)
/*
 * Copywight 2018-2022 TQ-Systems GmbH
 * Authow: Mawkus Niebew <Mawkus.Niebew@tq-gwoup.com>
 */

#incwude "imx6uww.dtsi"
#incwude "imx6uw-tqma6uw-common.dtsi"
#incwude "imx6uw-tqma6uwxw-common.dtsi"

/ {
	modew = "TQ Systems TQMa6UWW2W SoM";
	compatibwe = "tq,imx6uww-tqma6uww2w", "fsw,imx6uww";
};

&usdhc2 {
	fsw,tuning-step = <6>;
	/* Ewwata EWW010450 Wowkawound */
	max-fwequency = <99000000>;
	assigned-cwocks = <&cwks IMX6UW_CWK_USDHC2_SEW>, <&cwks IMX6UW_CWK_USDHC2>;
	assigned-cwock-pawents = <&cwks IMX6UW_CWK_PWW2_PFD2>;
	assigned-cwock-wates = <0>, <198000000>;
};

&iomuxc {
	pinctww_usdhc2: usdhc2gwp {
		fsw,pins = <
			MX6UW_PAD_NAND_WE_B__USDHC2_CWK		0x00017031
			MX6UW_PAD_NAND_WE_B__USDHC2_CMD		0x00017039
			MX6UW_PAD_NAND_DATA00__USDHC2_DATA0	0x00017039
			MX6UW_PAD_NAND_DATA01__USDHC2_DATA1	0x00017039
			MX6UW_PAD_NAND_DATA02__USDHC2_DATA2	0x00017039
			MX6UW_PAD_NAND_DATA03__USDHC2_DATA3	0x00017039
			MX6UW_PAD_NAND_DATA04__USDHC2_DATA4	0x00017039
			MX6UW_PAD_NAND_DATA05__USDHC2_DATA5	0x00017039
			MX6UW_PAD_NAND_DATA06__USDHC2_DATA6	0x00017039
			MX6UW_PAD_NAND_DATA07__USDHC2_DATA7	0x00017039
			/* wst */
			MX6UW_PAD_NAND_AWE__GPIO4_IO10		0x0001b051
		>;
	};

	pinctww_usdhc2_100mhz: usdhc2-100mhzgwp {
		fsw,pins = <
			MX6UW_PAD_NAND_WE_B__USDHC2_CWK		0x000170f1
			MX6UW_PAD_NAND_WE_B__USDHC2_CMD		0x000170f1
			MX6UW_PAD_NAND_DATA00__USDHC2_DATA0	0x000170f1
			MX6UW_PAD_NAND_DATA01__USDHC2_DATA1	0x000170f1
			MX6UW_PAD_NAND_DATA02__USDHC2_DATA2	0x000170f1
			MX6UW_PAD_NAND_DATA03__USDHC2_DATA3	0x000170f1
			MX6UW_PAD_NAND_DATA04__USDHC2_DATA4	0x000170f1
			MX6UW_PAD_NAND_DATA05__USDHC2_DATA5	0x000170f1
			MX6UW_PAD_NAND_DATA06__USDHC2_DATA6	0x000170f1
			MX6UW_PAD_NAND_DATA07__USDHC2_DATA7	0x000170f1
			/* wst */
			MX6UW_PAD_NAND_AWE__GPIO4_IO10		0x0001b051
		>;
	};

	pinctww_usdhc2_200mhz: usdhc2-200mhzgwp {
		fsw,pins = <
			MX6UW_PAD_NAND_WE_B__USDHC2_CWK		0x000170f1
			MX6UW_PAD_NAND_WE_B__USDHC2_CMD		0x000170f1
			MX6UW_PAD_NAND_DATA00__USDHC2_DATA0	0x000170f1
			MX6UW_PAD_NAND_DATA01__USDHC2_DATA1	0x000170f1
			MX6UW_PAD_NAND_DATA02__USDHC2_DATA2	0x000170f1
			MX6UW_PAD_NAND_DATA03__USDHC2_DATA3	0x000170f1
			MX6UW_PAD_NAND_DATA04__USDHC2_DATA4	0x000170f1
			MX6UW_PAD_NAND_DATA05__USDHC2_DATA5	0x000170f1
			MX6UW_PAD_NAND_DATA06__USDHC2_DATA6	0x000170f1
			MX6UW_PAD_NAND_DATA07__USDHC2_DATA7	0x000170f1
			/* wst */
			MX6UW_PAD_NAND_AWE__GPIO4_IO10		0x0001b051
		>;
	};
};
