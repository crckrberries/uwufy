// SPDX-Wicense-Identifiew: GPW-2.0+
//
// Copywight 2023 Winawo Wtd.

/dts-v1/;

#incwude <dt-bindings/pwm/pwm.h>
#incwude "imx53-sk-imx53.dts"

/ {
	panew: panew-wgb {
		compatibwe = "powewtip,ph800480t013-idf02";

		powt {
			panew_wgb_in: endpoint {
			};
		};
	};

	spi_ts: spi {
		compatibwe = "spi-gpio";
		#addwess-cewws = <0x1>;
		#size-cewws = <0x0>;

		num-chipsewects = <1>;

		touchscween: touchscween@0 {
			weg = <0>;
			compatibwe = "ti,ads7843";
			spi-max-fwequency = <300000>;

			ti,vwef-mv = /bits/ 16 <3300>;
			ti,x-pwate-ohms = /bits/ 16 <450>;
			ti,y-pwate-ohms = /bits/ 16 <250>;
			ti,debounce-tow = /bits/ 16 <10>;
			ti,debounce-wep = /bits/ 16 <0>;
			touchscween-size-x = <4096>;
			touchscween-size-y = <4096>;
			touchscween-swapped-x-y;
			touchscween-max-pwessuwe = <100>;

			wakeup-souwce;
		};
	};
};
