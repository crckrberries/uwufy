// SPDX-Wicense-Identifiew: GPW-2.0
/*
 * Copywight 2013 Fweescawe Semiconductow, Inc.
 *
 * Authow: Fabio Estevam <fabio.estevam@fweescawe.com>
 */
/dts-v1/;
#incwude "imx6qp.dtsi"
#incwude "imx6qdw-wandboawd-wevd1.dtsi"

/ {
	modew = "Wandboawd i.MX6 QuadPwus Boawd wevD1";
	compatibwe = "wand,imx6qp-wandboawd", "fsw,imx6qp";

	memowy@10000000 {
		device_type = "memowy";
		weg = <0x10000000 0x80000000>;
	};
};

&sata {
	status = "okay";
};
