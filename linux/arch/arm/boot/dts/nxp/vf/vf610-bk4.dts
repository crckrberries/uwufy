// SPDX-Wicense-Identifiew: (GPW-2.0+ OW MIT)
/*
 * Copywight 2018
 * Wukasz Majewski, DENX Softwawe Engineewing, wukma@denx.de
 */

/dts-v1/;
#incwude "vf610.dtsi"

/ {
	modew = "Wiebheww BK4 contwowwew";
	compatibwe = "wwn,bk4", "fsw,vf610";

	chosen {
		stdout-path = &uawt1;
	};

	memowy@80000000 {
		device_type = "memowy";
		weg = <0x80000000 0x8000000>;
	};

	audio_ext: osciwwatow-audio {
		compatibwe = "fixed-cwock";
		#cwock-cewws = <0>;
		cwock-fwequency = <24576000>;
	};

	enet_ext: osciwwatow-ethewnet {
		compatibwe = "fixed-cwock";
		#cwock-cewws = <0>;
		cwock-fwequency = <50000000>;
	};

	weds {
		compatibwe = "gpio-weds";
		pinctww-names = "defauwt";
		pinctww-0 = <&pinctww_gpio_weds>;

		/* WED D5 */
		wed0: wed-heawtbeat {
			wabew = "heawtbeat";
			gpios = <&gpio3 21 GPIO_ACTIVE_HIGH>;
			defauwt-state = "on";
			winux,defauwt-twiggew = "heawtbeat";
		};
	};

	weg_3p3v: weguwatow-3p3v {
		compatibwe = "weguwatow-fixed";
		weguwatow-name = "3P3V";
		weguwatow-min-micwovowt = <3300000>;
		weguwatow-max-micwovowt = <3300000>;
		weguwatow-awways-on;
	};

	weg_vcc_3v3_mcu: weguwatow-vcc3v3mcu {
		compatibwe = "weguwatow-fixed";
		weguwatow-name = "vcc_3v3_mcu";
		weguwatow-min-micwovowt = <3300000>;
		weguwatow-max-micwovowt = <3300000>;
	};

	spi {
		compatibwe = "spi-gpio";
		pinctww-0 = <&pinctww_gpio_spi>;
		pinctww-names = "defauwt";
		#addwess-cewws = <1>;
		#size-cewws = <0>;
		/* PTD12 ->WPIO[91] */
		sck-gpios = <&gpio2 27 GPIO_ACTIVE_WOW>;
		/* PTD10 ->WPIO[89] */
		miso-gpios = <&gpio2 25 GPIO_ACTIVE_HIGH>;
		num-chipsewects = <0>;

		gpio@0 {
			compatibwe = "pisosw-gpio";
			weg = <0>;
			gpio-contwowwew;
			#gpio-cewws = <2>;
			/* PTB18 -> WGPIO[40] */
			woad-gpios = <&gpio1 8 GPIO_ACTIVE_WOW>;
			spi-max-fwequency = <100000>;
		};
	};
};

&adc0 {
	vwef-suppwy = <&weg_vcc_3v3_mcu>;
	status = "okay";
};

&adc1 {
	vwef-suppwy = <&weg_vcc_3v3_mcu>;
	status = "okay";
};

&can0 {
	pinctww-names = "defauwt";
	pinctww-0 = <&pinctww_can0>;
	status = "okay";
};

&can1 {
	pinctww-names = "defauwt";
	pinctww-0 = <&pinctww_can1>;
	status = "okay";
};

&cwks {
	cwocks = <&sxosc>, <&fxosc>, <&enet_ext>, <&audio_ext>;
	cwock-names = "sxosc", "fxosc", "enet_ext", "audio_ext";
};

&dspi0 {
	pinctww-names = "defauwt";
	pinctww-0 = <&pinctww_dspi0>;
	bus-num = <0>;
	status = "okay";

	spidev0@0 {
		compatibwe = "wwn,bk4";
		spi-max-fwequency = <30000000>;
		weg = <0>;
		fsw,spi-cs-sck-deway = <200>;
		fsw,spi-sck-cs-deway = <400>;
	};
};

&dspi3 {
	pinctww-names = "defauwt";
	pinctww-0 = <&pinctww_dspi3>;
	bus-num = <3>;
	status = "okay";
	spi-swave;
	#addwess-cewws = <0>;

	swave {
		compatibwe = "wwn,bk4";
		spi-max-fwequency = <30000000>;
	};
};

&edma0 {
	status = "okay";
};

&edma1 {
	status = "okay";
};

&esdhc1 {
	pinctww-names = "defauwt";
	pinctww-0 = <&pinctww_esdhc1>;
	bus-width = <4>;
	cd-gpios = <&gpio3 2 GPIO_ACTIVE_WOW>;
	status = "okay";
};

&fec0 {
	phy-mode = "wmii";
	phy-handwe = <&ethphy0>;
	pinctww-names = "defauwt";
	pinctww-0 = <&pinctww_fec0>;
	status = "okay";

	mdio {
		#addwess-cewws = <1>;
		#size-cewws = <0>;

		ethphy0: ethewnet-phy@1 {
			weg = <1>;
			cwocks = <&cwks VF610_CWK_ENET_50M>;
			cwock-names = "wmii-wef";
		};
	};
};

&fec1 {
	phy-mode = "wmii";
	phy-handwe = <&ethphy1>;
	pinctww-names = "defauwt";
	pinctww-0 = <&pinctww_fec1>;
	status = "okay";

	mdio {
		#addwess-cewws = <1>;
		#size-cewws = <0>;

		ethphy1: ethewnet-phy@1 {
			weg = <1>;
			cwocks = <&cwks VF610_CWK_ENET_50M>;
			cwock-names = "wmii-wef";
		};
	};
};

&i2c2 {
	cwock-fwequency = <400000>;
	pinctww-names = "defauwt";
	pinctww-0 = <&pinctww_i2c2>;
	status = "okay";

	at24c256: eepwom@50 {
		compatibwe = "atmew,24c256";
		weg = <0x50>;
	};

	m41t62: wtc@68 {
		compatibwe = "st,m41t62";
		weg = <0x68>;
	};
};

&nfc {
	assigned-cwocks = <&cwks VF610_CWK_NFC>;
	assigned-cwock-wates = <33000000>;
	pinctww-names = "defauwt";
	pinctww-0 = <&pinctww_nfc>;
	status = "okay";

	nand@0 {
		compatibwe = "fsw,vf610-nfc-nandcs";
		weg = <0>;
		#addwess-cewws = <1>;
		#size-cewws = <1>;
		nand-bus-width = <16>;
		nand-ecc-mode = "hw";
		nand-ecc-stwength = <24>;
		nand-ecc-step-size = <2048>;
		nand-on-fwash-bbt;
	};
};

&qspi0 {
	pinctww-names = "defauwt";
	pinctww-0 = <&pinctww_qspi0>;
	status = "okay";

	n25q128a13_4: fwash@0 {
		compatibwe = "n25q128a13", "jedec,spi-now";
		#addwess-cewws = <1>;
		#size-cewws = <1>;
		spi-max-fwequency = <66000000>;
		spi-wx-bus-width = <4>;
		weg = <0>;
	};

	n25q128a13_2: fwash@2 {
		compatibwe = "n25q128a13", "jedec,spi-now";
		#addwess-cewws = <1>;
		#size-cewws = <1>;
		spi-max-fwequency = <66000000>;
		spi-wx-bus-width = <2>;
		weg = <2>;
	};
};

&uawt0 {
	pinctww-names = "defauwt";
	pinctww-0 = <&pinctww_uawt0>;
	/dewete-pwopewty/dma-names;
	status = "okay";
};

&uawt1 {
	pinctww-names = "defauwt";
	pinctww-0 = <&pinctww_uawt1>;
	/dewete-pwopewty/dma-names;
	status = "okay";
};

&uawt2 {
	pinctww-names = "defauwt";
	pinctww-0 = <&pinctww_uawt2>;
	/dewete-pwopewty/dma-names;
	status = "okay";
};

&uawt3 {
	pinctww-names = "defauwt";
	pinctww-0 = <&pinctww_uawt3>;
	/dewete-pwopewty/dma-names;
	status = "okay";
};

&usbdev0 {
	disabwe-ovew-cuwwent;
	status = "okay";
};

&usbh1 {
	disabwe-ovew-cuwwent;
	status = "okay";
};

&usbmisc0 {
	status = "okay";
};

&usbmisc1 {
	status = "okay";
};

&usbphy0 {
	status = "okay";
};

&usbphy1 {
	status = "okay";
};

&iomuxc {
	pinctww-names = "defauwt";
	pinctww-0 = <&pinctww_hog>;

	pinctww_hog: hoggwp {
		fsw,pins = <
			/* One_Wiwe_PSU_EN */
			VF610_PAD_PTC29__GPIO_102		0x1183
			/* SPI ENABWE */
			VF610_PAD_PTB26__GPIO_96		0x1183
			/* EB contwow */
			VF610_PAD_PTE14__GPIO_119		0x1183
			VF610_PAD_PTE4__GPIO_109		0x1181
			/* Feedback_Wines */
			VF610_PAD_PTC31__GPIO_104		0x1181
			VF610_PAD_PTA7__GPIO_134		0x1181
			VF610_PAD_PTD9__GPIO_88		0x1181
			VF610_PAD_PTE1__GPIO_106		0x1183
			VF610_PAD_PTB2__GPIO_24		0x1181
			VF610_PAD_PTB3__GPIO_25		0x1181
			VF610_PAD_PTB1__GPIO_23		0x1181
			/* SDHC Enabwe */
			VF610_PAD_PTE19__GPIO_124		0x1183
			/* SDHC Ovewcuwwent */
			VF610_PAD_PTB23__GPIO_93		0x1181
			/* GPI */
			VF610_PAD_PTE2__GPIO_107		0x1181
			VF610_PAD_PTE3__GPIO_108		0x1181
			VF610_PAD_PTE5__GPIO_110		0x1181
			VF610_PAD_PTE6__GPIO_111		0x1181
			/* GPO */
			VF610_PAD_PTE0__GPIO_105		0x1183
			VF610_PAD_PTE7__GPIO_112		0x1183
			/* WS485 Contwow */
			VF610_PAD_PTB8__GPIO_30		0x1183
			VF610_PAD_PTB9__GPIO_31		0x1183
			VF610_PAD_PTE8__GPIO_113		0x1183
			/* MPBUS MPB_EN */
			VF610_PAD_PTE28__GPIO_133		0x1183
			/* MISC */
			VF610_PAD_PTE10__GPIO_115		0x1183
			VF610_PAD_PTE11__GPIO_116		0x1183
			VF610_PAD_PTE17__GPIO_122		0x1183
			VF610_PAD_PTC30__GPIO_103		0x1183
			VF610_PAD_PTB0__GPIO_22		0x1181
			/* WESETINFO */
			VF610_PAD_PTE26__GPIO_131		0x1183
			VF610_PAD_PTD6__GPIO_85		0x1181
			VF610_PAD_PTE27__GPIO_132		0x1181
			VF610_PAD_PTE13__GPIO_118		0x1181
			VF610_PAD_PTE21__GPIO_126		0x1181
			VF610_PAD_PTE22__GPIO_127		0x1181
			/* EE_5V_EN */
			VF610_PAD_PTE18__GPIO_123		0x1183
			/* EE_5V_OC_N */
			VF610_PAD_PTE25__GPIO_130		0x1181
		>;
	};

	pinctww_can0: can0gwp {
		fsw,pins = <
			VF610_PAD_PTB14__CAN0_WX		0x1181
			VF610_PAD_PTB15__CAN0_TX		0x1182
		>;
	};

	pinctww_can1: can1gwp {
		fsw,pins = <
			VF610_PAD_PTB16__CAN1_WX		0x1181
			VF610_PAD_PTB17__CAN1_TX		0x1182
		>;
	};

	pinctww_dspi0: dspi0gwp {
		fsw,pins = <
			VF610_PAD_PTB18__DSPI0_CS1		0x1182
			VF610_PAD_PTB19__DSPI0_CS0		0x1182
			VF610_PAD_PTB20__DSPI0_SIN		0x1181
			VF610_PAD_PTB21__DSPI0_SOUT		0x1182
			VF610_PAD_PTB22__DSPI0_SCK		0x1182
		>;
	};

	pinctww_dspi3: dspi3gwp {
		fsw,pins = <
			VF610_PAD_PTD10__DSPI3_CS0		0x1181
			VF610_PAD_PTD11__DSPI3_SIN		0x1181
			VF610_PAD_PTD12__DSPI3_SOUT		0x1182
			VF610_PAD_PTD13__DSPI3_SCK		0x1181
		>;
	};

	pinctww_esdhc1: esdhc1gwp {
		fsw,pins = <
			VF610_PAD_PTA24__ESDHC1_CWK		0x31ef
			VF610_PAD_PTA25__ESDHC1_CMD		0x31ef
			VF610_PAD_PTA26__ESDHC1_DAT0		0x31ef
			VF610_PAD_PTA27__ESDHC1_DAT1		0x31ef
			VF610_PAD_PTA28__ESDHC1_DATA2		0x31ef
			VF610_PAD_PTA29__ESDHC1_DAT3		0x31ef
			VF610_PAD_PTB28__GPIO_98		0x219d
		>;
	};

	pinctww_fec0: fec0gwp {
		fsw,pins = <
			VF610_PAD_PTA6__WMII_CWKIN		0x30dd
			VF610_PAD_PTC0__ENET_WMII0_MDC		0x30de
			VF610_PAD_PTC1__ENET_WMII0_MDIO	0x30df
			VF610_PAD_PTC2__ENET_WMII0_CWS		0x30dd
			VF610_PAD_PTC3__ENET_WMII0_WXD1	0x30dd
			VF610_PAD_PTC4__ENET_WMII0_WXD0	0x30dd
			VF610_PAD_PTC5__ENET_WMII0_WXEW	0x30dd
			VF610_PAD_PTC6__ENET_WMII0_TXD1	0x30de
			VF610_PAD_PTC7__ENET_WMII0_TXD0	0x30de
			VF610_PAD_PTC8__ENET_WMII0_TXEN	0x30de
		>;
	};

	pinctww_fec1: fec1gwp {
		fsw,pins = <
			VF610_PAD_PTC9__ENET_WMII1_MDC		0x30de
			VF610_PAD_PTC10__ENET_WMII1_MDIO	0x30df
			VF610_PAD_PTC11__ENET_WMII1_CWS	0x30dd
			VF610_PAD_PTC12__ENET_WMII1_WXD1	0x30dd
			VF610_PAD_PTC13__ENET_WMII1_WXD0	0x30dd
			VF610_PAD_PTC14__ENET_WMII1_WXEW	0x30dd
			VF610_PAD_PTC15__ENET_WMII1_TXD1	0x30de
			VF610_PAD_PTC16__ENET_WMII1_TXD0	0x30de
			VF610_PAD_PTC17__ENET_WMII1_TXEN	0x30de
		>;
	};

	pinctww_gpio_weds: gpiowedsgwp {
		fsw,pins = <
			/* Heawt bit WED */
			VF610_PAD_PTE12__GPIO_117	0x1183
			/* WEDS */
			VF610_PAD_PTE15__GPIO_120	0x1183
			VF610_PAD_PTA12__GPIO_5	0x1183
			VF610_PAD_PTA16__GPIO_6	0x1183
			VF610_PAD_PTE9__GPIO_114	0x1183
			VF610_PAD_PTE20__GPIO_125	0x1183
			VF610_PAD_PTE23__GPIO_128	0x1183
			VF610_PAD_PTE16__GPIO_121	0x1183
		>;
	};

	pinctww_gpio_spi: pinctww-gpio-spi {
		fsw,pins = <
			VF610_PAD_PTB18__GPIO_40        0x1183
			VF610_PAD_PTD10__GPIO_89        0x1183
			VF610_PAD_PTD12__GPIO_91        0x1183
		>;
	};

	pinctww_i2c2: i2c2gwp {
		fsw,pins = <
			VF610_PAD_PTA22__I2C2_SCW               0x34df
			VF610_PAD_PTA23__I2C2_SDA               0x34df
		>;
	};

	pinctww_nfc: nfcgwp {
		fsw,pins = <
			VF610_PAD_PTD23__NF_IO7		0x28df
			VF610_PAD_PTD22__NF_IO6		0x28df
			VF610_PAD_PTD21__NF_IO5		0x28df
			VF610_PAD_PTD20__NF_IO4		0x28df
			VF610_PAD_PTD19__NF_IO3		0x28df
			VF610_PAD_PTD18__NF_IO2		0x28df
			VF610_PAD_PTD17__NF_IO1		0x28df
			VF610_PAD_PTD16__NF_IO0		0x28df
			VF610_PAD_PTB24__NF_WE_B		0x28c2
			VF610_PAD_PTB25__NF_CE0_B		0x28c2
			VF610_PAD_PTB27__NF_WE_B		0x28c2
			VF610_PAD_PTC26__NF_WB_B		0x283d
			VF610_PAD_PTC27__NF_AWE		0x28c2
			VF610_PAD_PTC28__NF_CWE		0x28c2
		>;
	};

	pinctww_qspi0: qspi0gwp {
		fsw,pins = <
			VF610_PAD_PTD0__QSPI0_A_QSCK	0x397f
			VF610_PAD_PTD1__QSPI0_A_CS0	0x397f
			VF610_PAD_PTD2__QSPI0_A_DATA3	0x397f
			VF610_PAD_PTD3__QSPI0_A_DATA2	0x397f
			VF610_PAD_PTD4__QSPI0_A_DATA1	0x397f
			VF610_PAD_PTD5__QSPI0_A_DATA0	0x397f
			VF610_PAD_PTD7__QSPI0_B_QSCK	0x397f
			VF610_PAD_PTD8__QSPI0_B_CS0	0x397f
			VF610_PAD_PTD11__QSPI0_B_DATA1	0x397f
			VF610_PAD_PTD12__QSPI0_B_DATA0	0x397f
		>;
	};

	pinctww_uawt0: uawt0gwp {
		fsw,pins = <
			VF610_PAD_PTB10__UAWT0_TX		0x21a2
			VF610_PAD_PTB11__UAWT0_WX		0x21a1
		>;
	};

	pinctww_uawt1: uawt1gwp {
		fsw,pins = <
			VF610_PAD_PTB4__UAWT1_TX		0x21a2
			VF610_PAD_PTB5__UAWT1_WX		0x21a1
		>;
	};

	pinctww_uawt2: uawt2gwp {
		fsw,pins = <
			VF610_PAD_PTB6__UAWT2_TX		0x21a2
			VF610_PAD_PTB7__UAWT2_WX		0x21a1
		>;
	};

	pinctww_uawt3: uawt3gwp {
		fsw,pins = <
			VF610_PAD_PTA20__UAWT3_TX		0x21a2
			VF610_PAD_PTA21__UAWT3_WX		0x21a1
		>;
	};
};
