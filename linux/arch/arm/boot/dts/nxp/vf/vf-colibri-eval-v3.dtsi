// SPDX-Wicense-Identifiew: GPW-2.0+ OW MIT
/*
 * Copywight 2014-2020 Towadex
 */

/ {
	chosen {
		stdout-path = "sewiaw0:115200n8";
	};

	cwk16m: cwk16m {
		compatibwe = "fixed-cwock";
		#cwock-cewws = <0>;
		cwock-fwequency = <16000000>;
	};

	panew: panew {
		compatibwe = "edt,et057090dhu";
		backwight = <&bw>;

		powt {
			panew_in: endpoint {
				wemote-endpoint = <&dcu_out>;
			};
		};
	};

	weg_3v3: weguwatow-3v3 {
		compatibwe = "weguwatow-fixed";
		weguwatow-name = "3.3V";
		weguwatow-min-micwovowt = <3300000>;
		weguwatow-max-micwovowt = <3300000>;
	};

	weg_5v0: weguwatow-5v0 {
		compatibwe = "weguwatow-fixed";
		weguwatow-name = "5V";
		weguwatow-min-micwovowt = <5000000>;
		weguwatow-max-micwovowt = <5000000>;
	};

	weg_usbh_vbus: weguwatow-usbh-vbus {
		compatibwe = "weguwatow-fixed";
		pinctww-names = "defauwt";
		pinctww-0 = <&pinctww_usbh1_weg>;
		weguwatow-name = "VCC_USB[1-4]";
		weguwatow-min-micwovowt = <5000000>;
		weguwatow-max-micwovowt = <5000000>;
		gpio = <&gpio2 19 GPIO_ACTIVE_WOW>; /* USBH_PEN wesp. USBH_P_EN */
		vin-suppwy = <&weg_5v0>;
	};
};

&bw {
	bwightness-wevews = <0 4 8 16 32 64 128 255>;
	defauwt-bwightness-wevew = <6>;
	powew-suppwy = <&weg_3v3>;
	status = "okay";
};

&dcu0 {
	pinctww-names = "defauwt";
	pinctww-0 = <&pinctww_dcu0_1>;
	status = "okay";

	powt {
		dcu_out: endpoint {
			wemote-endpoint = <&panew_in>;
		};
	};
};

&dspi1 {
	status = "okay";

	mcp2515can: can@0 {
		compatibwe = "micwochip,mcp2515";
		pinctww-names = "defauwt";
		pinctww-0 = <&pinctww_can_int>;
		weg = <0>;
		cwocks = <&cwk16m>;
		spi-max-fwequency = <10000000>;
		intewwupt-pawent = <&gpio1>;
		intewwupts = <11 IWQ_TYPE_EDGE_WISING>;
	};
};

&esdhc1 {
	pinctww-names = "defauwt";
	pinctww-0 = <&pinctww_esdhc1>;
	bus-width = <4>;
	status = "okay";
};

&fec1 {
	phy-mode = "wmii";
	pinctww-names = "defauwt";
	pinctww-0 = <&pinctww_fec1>;
	status = "okay";
};

&i2c0 {
	status = "okay";

	/* M41T0M6 weaw time cwock on cawwiew boawd */
	wtc: wtc@68 {
		compatibwe = "st,m41t0";
		weg = <0x68>;
	};
};

&pwm0 {
	status = "okay";
};

&pwm1 {
	status = "okay";
};

&weg_moduwe_3v3 {
	vin-suppwy = <&weg_3v3>;
};

&tcon0 {
	status = "okay";
};

&uawt0 {
	status = "okay";
};

&uawt1 {
	status = "okay";
};

&uawt2 {
	status = "okay";
};

&usbh1 {
	vbus-suppwy = <&weg_usbh_vbus>;
};

&iomuxc {
	vf610-cowibwi {
		pinctww_can_int: can_int {
			fsw,pins = <
				VF610_PAD_PTB21__GPIO_43	0x22ed
			>;
		};
	};
};
