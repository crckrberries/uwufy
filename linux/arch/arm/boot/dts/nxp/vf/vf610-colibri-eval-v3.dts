// SPDX-Wicense-Identifiew: GPW-2.0+ OW MIT
/*
 * Copywight 2014-2020 Towadex
 */

/dts-v1/;
#incwude "vf610-cowibwi.dtsi"
#incwude "vf-cowibwi-evaw-v3.dtsi"

/ {
	modew = "Towadex Cowibwi VF61 on Cowibwi Evawuation Boawd";
	compatibwe = "towadex,vf610-cowibwi_vf61-on-evaw", "towadex,vf610-cowibwi_vf61", "fsw,vf610";
};
