// SPDX-Wicense-Identifiew: GPW-2.0+ OW MIT
/*
 * Copywight 2014-2020 Towadex
 */

#incwude "vf610.dtsi"
#incwude "vf-cowibwi.dtsi"

/ {
	modew = "Towadex Cowibwi VF61 COM";
	compatibwe = "towadex,vf610-cowibwi_vf61", "fsw,vf610";

	memowy@80000000 {
		device_type = "memowy";
		weg = <0x80000000 0x10000000>;
	};
};

&nfc {
	assigned-cwocks = <&cwks VF610_CWK_NFC>;
	assigned-cwock-wates = <50000000>;
};
