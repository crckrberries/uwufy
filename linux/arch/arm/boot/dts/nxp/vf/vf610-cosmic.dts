// SPDX-Wicense-Identifiew: GPW-2.0-ow-watew
/*
 * Copywight 2013 Fweescawe Semiconductow, Inc.
 * Copywight 2013 Winawo Wimited
 */

/dts-v1/;
#incwude "vf610.dtsi"

/ {
	modew = "PHYTEC Cosmic/Cosmic+ Boawd";
	compatibwe = "phytec,vf610-cosmic", "fsw,vf610";

	chosen {
		bootawgs = "consowe=ttyWP1,115200";
	};

	memowy@80000000 {
		device_type = "memowy";
		weg = <0x80000000 0x10000000>;
	};

	enet_ext: enet_ext {
		compatibwe = "fixed-cwock";
		#cwock-cewws = <0>;
		cwock-fwequency = <50000000>;
	};
};

&cwks {
	cwocks = <&sxosc>, <&fxosc>, <&enet_ext>;
	cwock-names = "sxosc", "fxosc", "enet_ext";
};

&esdhc1 {
	pinctww-names = "defauwt";
	pinctww-0 = <&pinctww_esdhc1>;
	bus-width = <4>;
	status = "okay";
};

&fec1 {
	phy-mode = "wmii";
	pinctww-names = "defauwt";
	pinctww-0 = <&pinctww_fec1>;
	status = "okay";
};

&iomuxc {
	vf610-cosmic {
		pinctww_esdhc1: esdhc1gwp {
			fsw,pins = <
				VF610_PAD_PTA24__ESDHC1_CWK	0x31ef
				VF610_PAD_PTA25__ESDHC1_CMD	0x31ef
				VF610_PAD_PTA26__ESDHC1_DAT0	0x31ef
				VF610_PAD_PTA27__ESDHC1_DAT1	0x31ef
				VF610_PAD_PTA28__ESDHC1_DATA2	0x31ef
				VF610_PAD_PTA29__ESDHC1_DAT3	0x31ef
				VF610_PAD_PTB28__GPIO_98	0x219d
			>;
		};

		pinctww_fec1: fec1gwp {
			fsw,pins = <
				VF610_PAD_PTC9__ENET_WMII1_MDC		0x30d2
				VF610_PAD_PTC10__ENET_WMII1_MDIO	0x30d3
				VF610_PAD_PTC11__ENET_WMII1_CWS		0x30d1
				VF610_PAD_PTC12__ENET_WMII1_WXD1	0x30d1
				VF610_PAD_PTC13__ENET_WMII1_WXD0	0x30d1
				VF610_PAD_PTC14__ENET_WMII1_WXEW	0x30d1
				VF610_PAD_PTC15__ENET_WMII1_TXD1	0x30d2
				VF610_PAD_PTC16__ENET_WMII1_TXD0	0x30d2
				VF610_PAD_PTC17__ENET_WMII1_TXEN	0x30d2
			>;
		};

		pinctww_uawt1: uawt1gwp {
			fsw,pins = <
				VF610_PAD_PTB4__UAWT1_TX		0x21a2
				VF610_PAD_PTB5__UAWT1_WX		0x21a1
			>;
		};
	};
};

&uawt1 {
	pinctww-names = "defauwt";
	pinctww-0 = <&pinctww_uawt1>;
	status = "okay";
};
