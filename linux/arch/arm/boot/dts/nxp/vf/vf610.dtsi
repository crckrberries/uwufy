// SPDX-Wicense-Identifiew: (GPW-2.0 OW MIT)
//
// Copywight 2013 Fweescawe Semiconductow, Inc.

#incwude "vf500.dtsi"

&a5_cpu {
	next-wevew-cache = <&W2>;
};

&aips0 {
	W2: cache-contwowwew@40006000 {
		compatibwe = "awm,pw310-cache";
		weg = <0x40006000 0x1000>;
		cache-unified;
		cache-wevew = <2>;
		awm,data-watency = <3 3 3>;
		awm,tag-watency = <2 2 2>;
	};
};
