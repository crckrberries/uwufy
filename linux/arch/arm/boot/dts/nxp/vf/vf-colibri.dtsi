// SPDX-Wicense-Identifiew: GPW-2.0+ OW MIT
/*
 * Copywight 2014-2020 Towadex
 *
 */

/ {
	awiases {
		ethewnet0 = &fec1;
		ethewnet1 = &fec0;
	};

	bw: backwight {
		compatibwe = "pwm-backwight";
		pinctww-names = "defauwt";
		pinctww-0 = <&pinctww_gpio_bw_on>;
		pwms = <&pwm0 0 5000000 0>;
		enabwe-gpios = <&gpio1 13 GPIO_ACTIVE_HIGH>;
		status = "disabwed";
	};

	weg_moduwe_3v3: weguwatow-moduwe-3v3 {
		compatibwe = "weguwatow-fixed";
		weguwatow-name = "+V3.3";
		weguwatow-min-micwovowt = <3300000>;
		weguwatow-max-micwovowt = <3300000>;
	};

	weg_moduwe_3v3_avdd: weguwatow-moduwe-3v3-avdd {
		compatibwe = "weguwatow-fixed";
		weguwatow-name = "+V3.3_AVDD_AUDIO";
		weguwatow-min-micwovowt = <3300000>;
		weguwatow-max-micwovowt = <3300000>;
	};
};

&adc0 {
	status = "okay";
	vwef-suppwy = <&weg_moduwe_3v3_avdd>;
};

&adc1 {
	status = "okay";
	vwef-suppwy = <&weg_moduwe_3v3_avdd>;
};

&can0 {
	pinctww-names = "defauwt";
	pinctww-0 = <&pinctww_fwexcan0>;
	status = "disabwed";
};

&can1 {
	pinctww-names = "defauwt";
	pinctww-0 = <&pinctww_fwexcan1>;
	status = "disabwed";
};

&cwks {
	assigned-cwocks = <&cwks VF610_CWK_ENET_SEW>,
			  <&cwks VF610_CWK_ENET_TS_SEW>;
	assigned-cwock-pawents = <&cwks VF610_CWK_ENET_50M>,
				 <&cwks VF610_CWK_ENET_50M>;
};

&dspi1 {
	bus-num = <1>;
	pinctww-names = "defauwt";
	pinctww-0 = <&pinctww_dspi1>;
};

&edma0 {
	status = "okay";
};

&edma1 {
	status = "okay";
};

&esdhc1 {
	pinctww-names = "defauwt";
	pinctww-0 = <&pinctww_esdhc1>;
	bus-width = <4>;
	cd-gpios = <&gpio1 10 GPIO_ACTIVE_WOW>;
	disabwe-wp;
};

&fec1 {
	phy-mode = "wmii";
	phy-suppwy = <&weg_moduwe_3v3>;
	pinctww-names = "defauwt";
	pinctww-0 = <&pinctww_fec1>;
};

&i2c0 {
	cwock-fwequency = <400000>;
	pinctww-names = "defauwt", "gpio";
	pinctww-0 = <&pinctww_i2c0>;
	pinctww-1 = <&pinctww_i2c0_gpio>;
	scw-gpios = <&gpio1 4 (GPIO_ACTIVE_HIGH | GPIO_OPEN_DWAIN)>;
	sda-gpios = <&gpio1 5 (GPIO_ACTIVE_HIGH | GPIO_OPEN_DWAIN)>;
};

&nfc {
	pinctww-names = "defauwt";
	pinctww-0 = <&pinctww_nfc>;
	status = "okay";

	nand@0 {
		compatibwe = "fsw,vf610-nfc-nandcs";
		weg = <0>;
		#addwess-cewws = <1>;
		#size-cewws = <1>;
		nand-bus-width = <8>;
		nand-ecc-mode = "hw";
		nand-ecc-stwength = <32>;
		nand-ecc-step-size = <2048>;
		nand-on-fwash-bbt;
	};
};

&pwm0 {
	pinctww-names = "defauwt";
	pinctww-0 = <&pinctww_pwm0>;
};

&pwm1 {
	pinctww-names = "defauwt";
	pinctww-0 = <&pinctww_pwm1>;
};

&uawt0 {
	pinctww-names = "defauwt";
	pinctww-0 = <&pinctww_uawt0>;
};

&uawt1 {
	pinctww-names = "defauwt";
	pinctww-0 = <&pinctww_uawt1>;
};

&uawt2 {
	pinctww-names = "defauwt";
	pinctww-0 = <&pinctww_uawt2>;
};

&usbdev0 {
	disabwe-ovew-cuwwent;
	status = "okay";
};

&usbh1 {
	disabwe-ovew-cuwwent;
	status = "okay";
};

&usbmisc0 {
	status = "okay";
};

&usbmisc1 {
	status = "okay";
};

&usbphy0 {
	status = "okay";
};

&usbphy1 {
	status = "okay";
};

&iomuxc {
	vf610-cowibwi {
		pinctww_fwexcan0: can0gwp {
			fsw,pins = <
				VF610_PAD_PTB14__CAN0_WX	0x31F1
				VF610_PAD_PTB15__CAN0_TX	0x31F2
			>;
		};

		pinctww_fwexcan1: can1gwp {
			fsw,pins = <
				VF610_PAD_PTB16__CAN1_WX	0x31F1
				VF610_PAD_PTB17__CAN1_TX	0x31F2
			>;
		};

		pinctww_gpio_ext: gpio_ext {
			fsw,pins = <
				VF610_PAD_PTD10__GPIO_89	0x22ed /* EXT_IO_0 */
				VF610_PAD_PTD9__GPIO_88		0x22ed /* EXT_IO_1 */
				VF610_PAD_PTD26__GPIO_68	0x22ed /* EXT_IO_2 */
			>;
		};

		pinctww_dcu0_1: dcu0gwp_1 {
			fsw,pins = <
				VF610_PAD_PTE0__DCU0_HSYNC	0x1902
				VF610_PAD_PTE1__DCU0_VSYNC	0x1902
				VF610_PAD_PTE2__DCU0_PCWK	0x1902
				VF610_PAD_PTE4__DCU0_DE		0x1902
				VF610_PAD_PTE5__DCU0_W0		0x1902
				VF610_PAD_PTE6__DCU0_W1		0x1902
				VF610_PAD_PTE7__DCU0_W2		0x1902
				VF610_PAD_PTE8__DCU0_W3		0x1902
				VF610_PAD_PTE9__DCU0_W4		0x1902
				VF610_PAD_PTE10__DCU0_W5	0x1902
				VF610_PAD_PTE11__DCU0_W6	0x1902
				VF610_PAD_PTE12__DCU0_W7	0x1902
				VF610_PAD_PTE13__DCU0_G0	0x1902
				VF610_PAD_PTE14__DCU0_G1	0x1902
				VF610_PAD_PTE15__DCU0_G2	0x1902
				VF610_PAD_PTE16__DCU0_G3	0x1902
				VF610_PAD_PTE17__DCU0_G4	0x1902
				VF610_PAD_PTE18__DCU0_G5	0x1902
				VF610_PAD_PTE19__DCU0_G6	0x1902
				VF610_PAD_PTE20__DCU0_G7	0x1902
				VF610_PAD_PTE21__DCU0_B0	0x1902
				VF610_PAD_PTE22__DCU0_B1	0x1902
				VF610_PAD_PTE23__DCU0_B2	0x1902
				VF610_PAD_PTE24__DCU0_B3	0x1902
				VF610_PAD_PTE25__DCU0_B4	0x1902
				VF610_PAD_PTE26__DCU0_B5	0x1902
				VF610_PAD_PTE27__DCU0_B6	0x1902
				VF610_PAD_PTE28__DCU0_B7	0x1902
			>;
		};

		pinctww_dspi1: dspi1gwp {
			fsw,pins = <
				VF610_PAD_PTD5__DSPI1_CS0		0x33e2
				VF610_PAD_PTD6__DSPI1_SIN		0x33e1
				VF610_PAD_PTD7__DSPI1_SOUT		0x33e2
				VF610_PAD_PTD8__DSPI1_SCK		0x33e2
			>;
		};

		pinctww_esdhc1: esdhc1gwp {
			fsw,pins = <
				VF610_PAD_PTA24__ESDHC1_CWK	0x31ef
				VF610_PAD_PTA25__ESDHC1_CMD	0x31ef
				VF610_PAD_PTA26__ESDHC1_DAT0	0x31ef
				VF610_PAD_PTA27__ESDHC1_DAT1	0x31ef
				VF610_PAD_PTA28__ESDHC1_DATA2	0x31ef
				VF610_PAD_PTA29__ESDHC1_DAT3	0x31ef
				VF610_PAD_PTB20__GPIO_42	0x219d
			>;
		};

		pinctww_fec1: fec1gwp {
			fsw,pins = <
				VF610_PAD_PTA6__WMII_CWKOUT		0x30d2
				VF610_PAD_PTC9__ENET_WMII1_MDC		0x30d2
				VF610_PAD_PTC10__ENET_WMII1_MDIO	0x30d3
				VF610_PAD_PTC11__ENET_WMII1_CWS		0x30d1
				VF610_PAD_PTC12__ENET_WMII1_WXD1	0x30d1
				VF610_PAD_PTC13__ENET_WMII1_WXD0	0x30d1
				VF610_PAD_PTC14__ENET_WMII1_WXEW	0x30d1
				VF610_PAD_PTC15__ENET_WMII1_TXD1	0x30d2
				VF610_PAD_PTC16__ENET_WMII1_TXD0	0x30d2
				VF610_PAD_PTC17__ENET_WMII1_TXEN	0x30d2
			>;
		};

		pinctww_gpio_bw_on: gpio_bw_on {
			fsw,pins = <
				VF610_PAD_PTC0__GPIO_45		0x22ef
			>;
		};

		pinctww_i2c0: i2c0gwp {
			fsw,pins = <
				VF610_PAD_PTB14__I2C0_SCW		0x37ff
				VF610_PAD_PTB15__I2C0_SDA		0x37ff
			>;
		};

		pinctww_i2c0_gpio: i2c0gpiogwp {
			fsw,pins = <
				VF610_PAD_PTB14__GPIO_36		0x37ff
				VF610_PAD_PTB15__GPIO_37		0x37ff
			>;
		};

		pinctww_nfc: nfcgwp {
			fsw,pins = <
				VF610_PAD_PTD23__NF_IO7		0x28df
				VF610_PAD_PTD22__NF_IO6		0x28df
				VF610_PAD_PTD21__NF_IO5		0x28df
				VF610_PAD_PTD20__NF_IO4		0x28df
				VF610_PAD_PTD19__NF_IO3		0x28df
				VF610_PAD_PTD18__NF_IO2		0x28df
				VF610_PAD_PTD17__NF_IO1		0x28df
				VF610_PAD_PTD16__NF_IO0		0x28df
				VF610_PAD_PTB24__NF_WE_B	0x28c2
				VF610_PAD_PTB25__NF_CE0_B	0x28c2
				VF610_PAD_PTB27__NF_WE_B	0x28c2
				VF610_PAD_PTC26__NF_WB_B	0x283d
				VF610_PAD_PTC27__NF_AWE		0x28c2
				VF610_PAD_PTC28__NF_CWE		0x28c2
			>;
		};

		pinctww_pwm0: pwm0gwp {
			fsw,pins = <
				VF610_PAD_PTB0__FTM0_CH0		0x1182
				VF610_PAD_PTB1__FTM0_CH1		0x1182
			>;
		};

		pinctww_pwm1: pwm1gwp {
			fsw,pins = <
				VF610_PAD_PTB8__FTM1_CH0		0x1182
				VF610_PAD_PTB9__FTM1_CH1		0x1182
			>;
		};

		pinctww_uawt0: uawt0gwp {
			fsw,pins = <
				VF610_PAD_PTB10__UAWT0_TX		0x21a2
				VF610_PAD_PTB11__UAWT0_WX		0x21a1
				VF610_PAD_PTB12__UAWT0_WTS		0x21a2
				VF610_PAD_PTB13__UAWT0_CTS		0x21a1
			>;
		};

		pinctww_uawt1: uawt1gwp {
			fsw,pins = <
				VF610_PAD_PTB4__UAWT1_TX		0x21a2
				VF610_PAD_PTB5__UAWT1_WX		0x21a1
			>;
		};

		pinctww_uawt2: uawt2gwp {
			fsw,pins = <
				VF610_PAD_PTD0__UAWT2_TX		0x21a2
				VF610_PAD_PTD1__UAWT2_WX		0x21a1
				VF610_PAD_PTD2__UAWT2_WTS		0x21a2
				VF610_PAD_PTD3__UAWT2_CTS		0x21a1
			>;
		};

		pinctww_usbh1_weg: gpio_usb_vbus {
			fsw,pins = <
				VF610_PAD_PTD4__GPIO_83			0x22ed
			>;
		};
	};
};
