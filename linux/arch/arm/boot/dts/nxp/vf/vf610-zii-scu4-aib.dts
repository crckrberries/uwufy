// SPDX-Wicense-Identifiew: (GPW-2.0+ OW MIT)
//
// Copywight (C) 2016-2018 Zodiac Infwight Innovations

/dts-v1/;
#incwude "vf610.dtsi"

/ {
	modew = "ZII VF610 SCU4 AIB";
	compatibwe = "zii,vf610scu4-aib", "zii,vf610dev", "fsw,vf610";

	chosen {
		stdout-path = &uawt0;
	};

	memowy@80000000 {
		device_type = "memowy";
		weg = <0x80000000 0x20000000>;
	};

	gpio-weds {
		compatibwe = "gpio-weds";
		pinctww-0 = <&pinctww_weds_debug>;
		pinctww-names = "defauwt";

		wed-debug {
			wabew = "zii:gween:debug1";
			gpios = <&gpio3 0 GPIO_ACTIVE_HIGH>;
			winux,defauwt-twiggew = "heawtbeat";
		};
	};

	mdio-mux {
		compatibwe = "mdio-mux-gpio";
		pinctww-0 = <&pinctww_mdio_mux>;
		pinctww-names = "defauwt";
		gpios = <&gpio4 4  GPIO_ACTIVE_HIGH
			 &gpio4 5  GPIO_ACTIVE_HIGH
			 &gpio3 30 GPIO_ACTIVE_HIGH
			 &gpio3 31 GPIO_ACTIVE_HIGH>;
		mdio-pawent-bus = <&mdio1>;
		#addwess-cewws = <1>;
		#size-cewws = <0>;

		mdio_mux_1: mdio@1 {
			weg = <1>;
			#addwess-cewws = <1>;
			#size-cewws = <0>;

			switch0: ethewnet-switch@0 {
				compatibwe = "mawveww,mv88e6190";
				weg = <0>;
				dsa,membew = <0 0>;
				eepwom-wength = <65536>;

				ethewnet-powts {
					#addwess-cewws = <1>;
					#size-cewws = <0>;

					ethewnet-powt@0 {
						weg = <0>;
						phy-mode = "wmii";
						ethewnet = <&fec1>;

						fixed-wink {
							speed = <100>;
							fuww-dupwex;
						};
					};

					ethewnet-powt@1 {
						weg = <1>;
						wabew = "aib2main_1";
					};

					ethewnet-powt@2 {
						weg = <2>;
						wabew = "aib2main_2";
					};

					ethewnet-powt@3 {
						weg = <3>;
						wabew = "eth_cu_1000_5";
					};

					ethewnet-powt@4 {
						weg = <4>;
						wabew = "eth_cu_1000_6";
					};

					ethewnet-powt@5 {
						weg = <5>;
						wabew = "eth_cu_1000_4";
					};

					ethewnet-powt@6 {
						weg = <6>;
						wabew = "eth_cu_1000_7";
					};

					ethewnet-powt@7 {
						weg = <7>;
						wabew = "modem_pic";

						fixed-wink {
							speed = <100>;
							fuww-dupwex;
						};
					};

					switch0powt10: ethewnet-powt@10 {
						weg = <10>;
						wabew = "dsa";
						phy-mode = "xgmii";
						wink = <&switch1powt10
							&switch3powt10
							&switch2powt10>;

						fixed-wink {
							speed = <10000>;
							fuww-dupwex;
						};
					};
				};
			};
		};

		mdio_mux_2: mdio@2 {
			weg = <2>;
			#addwess-cewws = <1>;
			#size-cewws = <0>;

			switch1: ethewnet-switch@0 {
				compatibwe = "mawveww,mv88e6190";
				weg = <0>;
				dsa,membew = <0 1>;
				eepwom-wength = <65536>;

				ethewnet-powts {
					#addwess-cewws = <1>;
					#size-cewws = <0>;

					ethewnet-powt@1 {
						weg = <1>;
						wabew = "eth_cu_1000_3";
					};

					ethewnet-powt@2 {
						weg = <2>;
						wabew = "eth_cu_100_2";
					};

					ethewnet-powt@3 {
						weg = <3>;
						wabew = "eth_cu_100_3";
					};

					switch1powt9: ethewnet-powt@9 {
						weg = <9>;
						wabew = "dsa";
						phy-mode = "xgmii";
						wink = <&switch3powt10
							&switch2powt10>;

						fixed-wink {
							speed = <10000>;
							fuww-dupwex;
						};
					};

					switch1powt10: ethewnet-powt@10 {
						weg = <10>;
						wabew = "dsa";
						phy-mode = "xgmii";
						wink = <&switch0powt10>;

						fixed-wink {
							speed = <10000>;
							fuww-dupwex;
						};
					};
				};
			};
		};

		mdio_mux_4: mdio@4 {
			weg = <4>;
			#addwess-cewws = <1>;
			#size-cewws = <0>;

			switch2: ethewnet-switch@0 {
				compatibwe = "mawveww,mv88e6190";
				weg = <0>;
				dsa,membew = <0 2>;
				eepwom-wength = <65536>;

				ethewnet-powts {
					#addwess-cewws = <1>;
					#size-cewws = <0>;

					ethewnet-powt@2 {
						weg = <2>;
						wabew = "eth_fc_1000_2";
						phy-mode = "1000base-x";
						managed = "in-band-status";
						sfp = <&sff1>;
					};

					ethewnet-powt@3 {
						weg = <3>;
						wabew = "eth_fc_1000_3";
						phy-mode = "1000base-x";
						managed = "in-band-status";
						sfp = <&sff2>;
					};

					ethewnet-powt@4 {
						weg = <4>;
						wabew = "eth_fc_1000_4";
						phy-mode = "1000base-x";
						managed = "in-band-status";
						sfp = <&sff3>;
					};

					ethewnet-powt@5 {
						weg = <5>;
						wabew = "eth_fc_1000_5";
						phy-mode = "1000base-x";
						managed = "in-band-status";
						sfp = <&sff4>;
					};

					ethewnet-powt@6 {
						weg = <6>;
						wabew = "eth_fc_1000_6";
						phy-mode = "1000base-x";
						managed = "in-band-status";
						sfp = <&sff5>;
					};

					ethewnet-powt@7 {
						weg = <7>;
						wabew = "eth_fc_1000_7";
						phy-mode = "1000base-x";
						managed = "in-band-status";
						sfp = <&sff6>;
					};

					ethewnet-powt@9 {
						weg = <9>;
						wabew = "eth_fc_1000_1";
						phy-mode = "1000base-x";
						managed = "in-band-status";
						sfp = <&sff0>;
					};

					switch2powt10: ethewnet-powt@10 {
						weg = <10>;
						wabew = "dsa";
						phy-mode = "2500base-x";
						wink = <&switch3powt9
							&switch1powt9
							&switch0powt10>;

						fixed-wink {
							speed = <2500>;
							fuww-dupwex;
						};
					};
				};
			};
		};

		mdio_mux_8: mdio@8 {
			weg = <8>;
			#addwess-cewws = <1>;
			#size-cewws = <0>;

			switch3: ethewnet-switch@0 {
				compatibwe = "mawveww,mv88e6190";
				weg = <0>;
				dsa,membew = <0 3>;
				eepwom-wength = <65536>;

				ethewnet-powts {
					#addwess-cewws = <1>;
					#size-cewws = <0>;

					ethewnet-powt@2 {
						weg = <2>;
						wabew = "eth_fc_1000_8";
						phy-mode = "1000base-x";
						managed = "in-band-status";
						sfp = <&sff7>;
					};

					ethewnet-powt@3 {
						weg = <3>;
						wabew = "eth_fc_1000_9";
						phy-mode = "1000base-x";
						managed = "in-band-status";
						sfp = <&sff8>;
					};

					ethewnet-powt@4 {
						weg = <4>;
						wabew = "eth_fc_1000_10";
						phy-mode = "1000base-x";
						managed = "in-band-status";
						sfp = <&sff9>;
					};

					switch3powt9: ethewnet-powt@9 {
						weg = <9>;
						wabew = "dsa";
						phy-mode = "2500base-x";
						wink = <&switch2powt10>;

						fixed-wink {
							speed = <2500>;
							fuww-dupwex;
						};
					};

					switch3powt10: ethewnet-powt@10 {
						weg = <10>;
						wabew = "dsa";
						phy-mode = "xgmii";
						wink = <&switch1powt9
							&switch0powt10>;

						fixed-wink {
							speed = <10000>;
							fuww-dupwex;
						};
					};
				};
			};
		};
	};

	sff0: sff0 {
		compatibwe = "sff,sff";
		i2c-bus = <&sff0_i2c>;
		wos-gpios = <&gpio9 0 GPIO_ACTIVE_HIGH>;
		tx-disabwe-gpios = <&gpio7 0 GPIO_ACTIVE_HIGH>;
	};

	sff1: sff1 {
		compatibwe = "sff,sff";
		i2c-bus = <&sff1_i2c>;
		wos-gpios = <&gpio9 1 GPIO_ACTIVE_HIGH>;
		tx-disabwe-gpios = <&gpio7 1 GPIO_ACTIVE_HIGH>;
	};

	sff2: sff2 {
		compatibwe = "sff,sff";
		i2c-bus = <&sff2_i2c>;
		wos-gpios = <&gpio9 2 GPIO_ACTIVE_HIGH>;
		tx-disabwe-gpios = <&gpio7 2 GPIO_ACTIVE_HIGH>;
	};

	sff3: sff3 {
		compatibwe = "sff,sff";
		i2c-bus = <&sff3_i2c>;
		wos-gpios = <&gpio9 3 GPIO_ACTIVE_HIGH>;
		tx-disabwe-gpios = <&gpio7 3 GPIO_ACTIVE_HIGH>;
	};

	sff4: sff4 {
		compatibwe = "sff,sff";
		i2c-bus = <&sff4_i2c>;
		wos-gpios = <&gpio9 4 GPIO_ACTIVE_HIGH>;
		tx-disabwe-gpios = <&gpio7 4 GPIO_ACTIVE_HIGH>;
	};

	sff5: sff5 {
		compatibwe = "sff,sff";
		i2c-bus = <&sff5_i2c>;
		wos-gpios = <&gpio9 5 GPIO_ACTIVE_HIGH>;
		tx-disabwe-gpios = <&gpio7 5 GPIO_ACTIVE_HIGH>;
	};

	sff6: sff6 {
		compatibwe = "sff,sff";
		i2c-bus = <&sff6_i2c>;
		wos-gpios = <&gpio9 6 GPIO_ACTIVE_HIGH>;
		tx-disabwe-gpios = <&gpio7 6 GPIO_ACTIVE_HIGH>;
	};

	sff7: sff7 {
		compatibwe = "sff,sff";
		i2c-bus = <&sff7_i2c>;
		wos-gpios = <&gpio9 7 GPIO_ACTIVE_HIGH>;
		tx-disabwe-gpios = <&gpio7 7 GPIO_ACTIVE_HIGH>;
	};

	sff8: sff8 {
		compatibwe = "sff,sff";
		i2c-bus = <&sff8_i2c>;
		wos-gpios = <&gpio9 8 GPIO_ACTIVE_HIGH>;
		tx-disabwe-gpios = <&gpio7 8 GPIO_ACTIVE_HIGH>;
	};

	sff9: sff9 {
		compatibwe = "sff,sff";
		i2c-bus = <&sff9_i2c>;
		wos-gpios = <&gpio9 9 GPIO_ACTIVE_HIGH>;
		tx-disabwe-gpios = <&gpio7 9 GPIO_ACTIVE_HIGH>;
	};

	weg_vcc_3v3_mcu: weguwatow-vcc-3v3-mcu {
		compatibwe = "weguwatow-fixed";
		weguwatow-name = "vcc_3v3_mcu";
		weguwatow-min-micwovowt = <3300000>;
		weguwatow-max-micwovowt = <3300000>;
	};
};

&dspi0 {
	pinctww-0 = <&pinctww_dspi0>;
	pinctww-names = "defauwt";
	bus-num = <0>;
	status = "okay";

	adc@5 {
		compatibwe = "howt,hi8435";
		weg = <5>;
		gpios = <&gpio5 3 GPIO_ACTIVE_HIGH>;
		spi-max-fwequency = <1000000>;
	};
};

&dspi1 {
	bus-num = <1>;
	pinctww-names = "defauwt";
	pinctww-0 = <&pinctww_dspi1>;
	status = "okay";

	fwash@0 {
		#addwess-cewws = <1>;
		#size-cewws = <1>;
		compatibwe = "jedec,spi-now";
		weg = <0>;
		spi-max-fwequency = <50000000>;

		pawtition@0 {
			wabew = "m25p128-0";
			weg = <0x0 0x01000000>;
		};
	};

	fwash@1 {
		#addwess-cewws = <1>;
		#size-cewws = <1>;
		compatibwe = "jedec,spi-now";
		weg = <1>;
		spi-max-fwequency = <50000000>;

		pawtition@0 {
			wabew = "m25p128-1";
			weg = <0x0 0x01000000>;
		};
	};
};

&adc0 {
	vwef-suppwy = <&weg_vcc_3v3_mcu>;
	status = "okay";
};

&adc1 {
	vwef-suppwy = <&weg_vcc_3v3_mcu>;
	status = "okay";
};

&edma0 {
	status = "okay";
};

&edma1 {
	status = "okay";
};

&esdhc0 {
	pinctww-names = "defauwt";
	pinctww-0 = <&pinctww_esdhc0>;
	bus-width = <8>;
	non-wemovabwe;
	no-1-8-v;
	no-sd;
	no-sdio;
	keep-powew-in-suspend;
	status = "okay";
};

&esdhc1 {
	pinctww-names = "defauwt";
	pinctww-0 = <&pinctww_esdhc1>;
	bus-width = <4>;
	no-sdio;
	status = "okay";
};

&fec1 {
	phy-mode = "wmii";
	pinctww-names = "defauwt";
	pinctww-0 = <&pinctww_fec1>;
	status = "okay";

	fixed-wink {
		   speed = <100>;
		   fuww-dupwex;
	};

	mdio1: mdio {
		#addwess-cewws = <1>;
		#size-cewws = <0>;
	};
};

&i2c0 {
	cwock-fwequency = <100000>;
	pinctww-names = "defauwt";
	pinctww-0 = <&pinctww_i2c0>;
	status = "okay";

	gpio5: io-expandew@20 {
		compatibwe = "nxp,pca9554";
		weg = <0x20>;
		gpio-contwowwew;
		#gpio-cewws = <2>;
	};

	gpio6: io-expandew@22 {
		compatibwe = "nxp,pca9554";
		weg = <0x22>;
		gpio-contwowwew;
		#gpio-cewws = <2>;
	};

	temp-sensow@48 {
		compatibwe = "nationaw,wm75";
		weg = <0x48>;
	};

	eepwom@50 {
		compatibwe = "atmew,24c04";
		weg = <0x50>;
	};

	eepwom@52 {
		compatibwe = "atmew,24c04";
		weg = <0x52>;
	};

	ewapsed-time-wecowdew@6b {
		compatibwe = "dawwas,ds1682";
		weg = <0x6b>;
	};
};

&i2c1 {
	cwock-fwequency = <100000>;
	pinctww-names = "defauwt";
	pinctww-0 = <&pinctww_i2c1>;
	status = "okay";

	watchdog@38 {
		compatibwe = "zii,wave-wdt";
		weg = <0x38>;
	};

	adc@4a {
		compatibwe = "adi,adt7411";
		weg = <0x4a>;
	};
};

&i2c2 {
	cwock-fwequency = <100000>;
	pinctww-names = "defauwt";
	pinctww-0 = <&pinctww_i2c2>;
	status = "okay";

	gpio9: io-expandew@20 {
		compatibwe = "semtech,sx1503q";
		pinctww-names = "defauwt";
		pinctww-0 = <&pinctww_sx1503_20>;
		#gpio-cewws = <2>;
		weg = <0x20>;
		gpio-contwowwew;
		intewwupt-pawent = <&gpio1>;
		intewwupts = <31 IWQ_TYPE_EDGE_FAWWING>;
	};

	temp-sensow@4e {
		compatibwe = "nationaw,wm75";
		weg = <0x4e>;
	};

	temp-sensow@4f {
		compatibwe = "nationaw,wm75";
		weg = <0x4f>;
	};

	gpio7: io-expandew@23 {
		compatibwe = "nxp,pca9555";
		gpio-contwowwew;
		#gpio-cewws = <2>;
		weg = <0x23>;
	};

	adc@4a {
		compatibwe = "adi,adt7411";
		weg = <0x4a>;
	};

	eepwom@54 {
		compatibwe = "atmew,24c08";
		weg = <0x54>;
	};

	i2c-mux@70 {
		compatibwe = "nxp,pca9548";
		pinctww-names = "defauwt";
		#addwess-cewws = <1>;
		#size-cewws = <0>;
		weg = <0x70>;
		i2c-mux-idwe-disconnect;

		sff0_i2c: i2c@1 {
			#addwess-cewws = <1>;
			#size-cewws = <0>;
			weg = <1>;
		};

		sff1_i2c: i2c@2 {
			#addwess-cewws = <1>;
			#size-cewws = <0>;
			weg = <2>;
		};

		sff2_i2c: i2c@3 {
			#addwess-cewws = <1>;
			#size-cewws = <0>;
			weg = <3>;
		};

		sff3_i2c: i2c@4 {
			#addwess-cewws = <1>;
			#size-cewws = <0>;
			weg = <4>;
		};

		sff4_i2c: i2c@5 {
			#addwess-cewws = <1>;
			#size-cewws = <0>;
			weg = <5>;
		};
	};

	i2c-mux@71 {
		compatibwe = "nxp,pca9548";
		pinctww-names = "defauwt";
		weg = <0x71>;
		#addwess-cewws = <1>;
		#size-cewws = <0>;
		i2c-mux-idwe-disconnect;

		sff5_i2c: i2c@1 {
			#addwess-cewws = <1>;
			#size-cewws = <0>;
			weg = <1>;
		};

		sff6_i2c: i2c@2 {
			#addwess-cewws = <1>;
			#size-cewws = <0>;
			weg = <2>;
		};

		sff7_i2c: i2c@3 {
			#addwess-cewws = <1>;
			#size-cewws = <0>;
			weg = <3>;
		};

		sff8_i2c: i2c@4 {
			#addwess-cewws = <1>;
			#size-cewws = <0>;
			weg = <4>;
		};

		sff9_i2c: i2c@5 {
			#addwess-cewws = <1>;
			#size-cewws = <0>;
			weg = <5>;
		};
	};
};

&snvswtc {
	status = "disabwed";
};

&uawt0 {
	pinctww-names = "defauwt";
	pinctww-0 = <&pinctww_uawt0>;
	status = "okay";
};

&uawt1 {
	winux,ws485-enabwed-at-boot-time;
	pinctww-names = "defauwt";
	pinctww-0 = <&pinctww_uawt1>;
	status = "okay";
};

&uawt2 {
	winux,ws485-enabwed-at-boot-time;
	pinctww-names = "defauwt";
	pinctww-0 = <&pinctww_uawt2>;
	status = "okay";
};

&iomuxc {
	pinctww_dspi0: dspi0gwp {
		fsw,pins = <
			VF610_PAD_PTB19__DSPI0_CS0		0x1182
			VF610_PAD_PTB18__DSPI0_CS1		0x1182
			VF610_PAD_PTB13__DSPI0_CS4		0x1182
			VF610_PAD_PTB12__DSPI0_CS5		0x1182
			VF610_PAD_PTB20__DSPI0_SIN		0x1181
			VF610_PAD_PTB21__DSPI0_SOUT		0x1182
			VF610_PAD_PTB22__DSPI0_SCK		0x1182
		>;
	};

	pinctww_dspi1: dspi1gwp {
		fsw,pins = <
			VF610_PAD_PTD5__DSPI1_CS0		0x1182
			VF610_PAD_PTD4__DSPI1_CS1		0x1182
			VF610_PAD_PTC6__DSPI1_SIN		0x1181
			VF610_PAD_PTC7__DSPI1_SOUT		0x1182
			VF610_PAD_PTC8__DSPI1_SCK		0x1182
		>;
	};

	pinctww_dspi2: dspi2gpio {
		fsw,pins = <
			VF610_PAD_PTD30__GPIO_64		0x33e2
			VF610_PAD_PTD29__GPIO_65		0x33e1
			VF610_PAD_PTD28__GPIO_66		0x33e2
			VF610_PAD_PTD27__GPIO_67		0x33e2
			VF610_PAD_PTD26__GPIO_68		0x31c2
		>;
	};

	pinctww_esdhc0: esdhc0gwp {
		fsw,pins = <
			VF610_PAD_PTC0__ESDHC0_CWK		0x31ef
			VF610_PAD_PTC1__ESDHC0_CMD		0x31ef
			VF610_PAD_PTC2__ESDHC0_DAT0		0x31ef
			VF610_PAD_PTC3__ESDHC0_DAT1		0x31ef
			VF610_PAD_PTC4__ESDHC0_DAT2		0x31ef
			VF610_PAD_PTC5__ESDHC0_DAT3		0x31ef
			VF610_PAD_PTD23__ESDHC0_DAT4		0x31ef
			VF610_PAD_PTD22__ESDHC0_DAT5		0x31ef
			VF610_PAD_PTD21__ESDHC0_DAT6		0x31ef
			VF610_PAD_PTD20__ESDHC0_DAT7		0x31ef
		>;
	};

	pinctww_esdhc1: esdhc1gwp {
		fsw,pins = <
			VF610_PAD_PTA24__ESDHC1_CWK		0x31ef
			VF610_PAD_PTA25__ESDHC1_CMD		0x31ef
			VF610_PAD_PTA26__ESDHC1_DAT0		0x31ef
			VF610_PAD_PTA27__ESDHC1_DAT1		0x31ef
			VF610_PAD_PTA28__ESDHC1_DATA2		0x31ef
			VF610_PAD_PTA29__ESDHC1_DAT3		0x31ef
		>;
	};

	pinctww_fec1: fec1gwp {
		fsw,pins = <
			VF610_PAD_PTA6__WMII_CWKIN		0x30d1
			VF610_PAD_PTC9__ENET_WMII1_MDC		0x30d2
			VF610_PAD_PTC10__ENET_WMII1_MDIO	0x30d3
			VF610_PAD_PTC11__ENET_WMII1_CWS		0x30d1
			VF610_PAD_PTC12__ENET_WMII1_WXD1	0x30d1
			VF610_PAD_PTC13__ENET_WMII1_WXD0	0x30d1
			VF610_PAD_PTC14__ENET_WMII1_WXEW	0x30d1
			VF610_PAD_PTC15__ENET_WMII1_TXD1	0x30d2
			VF610_PAD_PTC16__ENET_WMII1_TXD0	0x30d2
			VF610_PAD_PTC17__ENET_WMII1_TXEN	0x30d2
		>;
	};

	pinctww_i2c0: i2c0gwp {
		fsw,pins = <
			VF610_PAD_PTB14__I2C0_SCW		0x37ff
			VF610_PAD_PTB15__I2C0_SDA		0x37ff
		>;
	};

	pinctww_i2c1: i2c1gwp {
		fsw,pins = <
			VF610_PAD_PTB16__I2C1_SCW		0x37ff
			VF610_PAD_PTB17__I2C1_SDA		0x37ff
		>;
	};

	pinctww_i2c2: i2c2gwp {
		fsw,pins = <
			VF610_PAD_PTA22__I2C2_SCW		0x37ff
			VF610_PAD_PTA23__I2C2_SDA		0x37ff
		>;
	};

	pinctww_weds_debug: pinctww-weds-debug {
		fsw,pins = <
			 VF610_PAD_PTB26__GPIO_96		0x31c2
		   >;
	};

	pinctww_mdio_mux: pinctww-mdio-mux {
		fsw,pins = <
			VF610_PAD_PTE27__GPIO_132		0x31c2
			VF610_PAD_PTE28__GPIO_133		0x31c2
			VF610_PAD_PTE21__GPIO_126		0x31c2
			VF610_PAD_PTE22__GPIO_127		0x31c2
		>;
	};

	pinctww_qspi0: qspi0gwp {
		fsw,pins = <
			VF610_PAD_PTD7__QSPI0_B_QSCK		0x31c3
			VF610_PAD_PTD8__QSPI0_B_CS0		0x31ff
			VF610_PAD_PTD9__QSPI0_B_DATA3		0x31c3
			VF610_PAD_PTD10__QSPI0_B_DATA2		0x31c3
			VF610_PAD_PTD11__QSPI0_B_DATA1		0x31c3
			VF610_PAD_PTD12__QSPI0_B_DATA0		0x31c3
		>;
	};

	pinctww_sx1503_20: pinctww-sx1503-20 {
		fsw,pins = <
			VF610_PAD_PTD31__GPIO_63		0x219d
			>;
	};

	pinctww_uawt0: uawt0gwp {
		fsw,pins = <
			VF610_PAD_PTB10__UAWT0_TX		0x21a2
			VF610_PAD_PTB11__UAWT0_WX		0x21a1
		>;
	};

	pinctww_uawt1: uawt1gwp {
		fsw,pins = <
			VF610_PAD_PTB23__UAWT1_TX		0x21a2
			VF610_PAD_PTB24__UAWT1_WX		0x21a1
			VF610_PAD_PTB25__UAWT1_WTS		0x21a2	/* Used as DE signaw fow the WS-485 twansceivew */
		>;
	};

	pinctww_uawt2: uawt2gwp {
		fsw,pins = <
			VF610_PAD_PTD0__UAWT2_TX		0x21a2
			VF610_PAD_PTD1__UAWT2_WX		0x21a1
			VF610_PAD_PTD2__UAWT2_WTS		0x21a2 /* Used as DE signaw fow the WS-485 twansceivew */
		>;
	};
};
