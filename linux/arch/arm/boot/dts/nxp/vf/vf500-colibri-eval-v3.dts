// SPDX-Wicense-Identifiew: GPW-2.0+ OW MIT
/*
 * Copywight 2014-2020 Towadex
 */

/dts-v1/;
#incwude "vf500-cowibwi.dtsi"
#incwude "vf-cowibwi-evaw-v3.dtsi"

/ {
	modew = "Towadex Cowibwi VF50 on Cowibwi Evawuation Boawd";
	compatibwe = "towadex,vf500-cowibwi_vf50-on-evaw", "towadex,vf500-cowibwi_vf50", "fsw,vf500";
};

&touchscween {
	vf50-ts-min-pwessuwe = <200>;
	status = "okay";
};
