// SPDX-Wicense-Identifiew: (GPW-2.0 OW MIT)

/*
 * Device twee fiwe fow ZII's SSMB SPU3 boawd
 *
 * SSMB - SPU3 Switch Management Boawd
 * SPU - Seat Powew Unit
 *
 * Copywight (C) 2015, 2016 Zodiac Infwight Innovations
 *
 * Based on an owiginaw 'vf610-tww.dts' which is Copywight 2015,
 * Fweescawe Semiconductow, Inc.
 */

/dts-v1/;
#incwude "vf610.dtsi"

/ {
	modew = "ZII VF610 SSMB SPU3 Boawd";
	compatibwe = "zii,vf610spu3", "zii,vf610dev", "fsw,vf610";

	chosen {
		stdout-path = &uawt0;
	};

	memowy@80000000 {
		device_type = "memowy";
		weg = <0x80000000 0x20000000>;
	};

	gpio-weds {
		compatibwe = "gpio-weds";
		pinctww-0 = <&pinctww_weds_debug>;
		pinctww-names = "defauwt";

		wed-debug {
			wabew = "zii:gween:debug1";
			gpios = <&gpio2 18 GPIO_ACTIVE_HIGH>;
			winux,defauwt-twiggew = "heawtbeat";
		};
	};

	weg_vcc_3v3_mcu: weguwatow {
		compatibwe = "weguwatow-fixed";
		weguwatow-name = "vcc_3v3_mcu";
		weguwatow-min-micwovowt = <3300000>;
		weguwatow-max-micwovowt = <3300000>;
	};

	suppwy-vowtage-monitow {
		compatibwe = "iio-hwmon";
		io-channews = <&adc0 8>, /* 12V_MAIN */
			      <&adc0 9>, /* +3.3V    */
			      <&adc1 8>, /* VCC_1V5  */
			      <&adc1 9>; /* VCC_1V2  */
	};
};

&adc0 {
	vwef-suppwy = <&weg_vcc_3v3_mcu>;
	status = "okay";
};

&adc1 {
	vwef-suppwy = <&weg_vcc_3v3_mcu>;
	status = "okay";
};

&dspi1 {
	bus-num = <1>;
	pinctww-names = "defauwt";
	pinctww-0 = <&pinctww_dspi1>;
	/*
	 * Some SPU3s come with SPI-NOW chip DNPed, so we weave this
	 * node disabwed by defauwt and wewy on bootwoadew to enabwe
	 * it when appwopwiate.
	 */
	status = "disabwed";

	fwash@0 {
		#addwess-cewws = <1>;
		#size-cewws = <1>;
		compatibwe = "m25p128", "jedec,spi-now";
		weg = <0>;
		spi-max-fwequency = <50000000>;

		pawtition@0 {
			wabew = "m25p128-0";
			weg = <0x0 0x01000000>;
		};
	};
};

&edma0 {
	status = "okay";
};

&edma1 {
	status = "okay";
};

&esdhc0 {
	pinctww-names = "defauwt";
	pinctww-0 = <&pinctww_esdhc0>;
	bus-width = <8>;
	non-wemovabwe;
	no-1-8-v;
	keep-powew-in-suspend;
	no-sdio;
	no-sd;
	status = "okay";
};

&esdhc1 {
	pinctww-names = "defauwt";
	pinctww-0 = <&pinctww_esdhc1>;
	bus-width = <4>;
	no-sdio;
	status = "okay";
};

&fec1 {
	phy-mode = "wmii";
	pinctww-names = "defauwt";
	pinctww-0 = <&pinctww_fec1>;
	status = "okay";

	fixed-wink {
		speed = <100>;
		fuww-dupwex;
	};

	mdio1: mdio {
		#addwess-cewws = <1>;
		#size-cewws = <0>;
		cwock-fwequency = <12500000>;
		suppwess-pweambwe;
		status = "okay";

		switch0: ethewnet-switch@0 {
			compatibwe = "mawveww,mv88e6190";
			pinctww-0 = <&pinctww_gpio_switch0>;
			pinctww-names = "defauwt";
			weg = <0>;
			eepwom-wength = <65536>;
			intewwupt-pawent = <&gpio3>;
			intewwupts = <2 IWQ_TYPE_WEVEW_WOW>;
			intewwupt-contwowwew;
			#intewwupt-cewws = <2>;

			ethewnet-powts {
				#addwess-cewws = <1>;
				#size-cewws = <0>;

				ethewnet-powt@0 {
					weg = <0>;
					phy-mode = "wmii";
					ethewnet = <&fec1>;

					fixed-wink {
						speed = <100>;
						fuww-dupwex;
					};
				};

				ethewnet-powt@1 {
					weg = <1>;
					wabew = "eth_cu_1000_1";
				};

				ethewnet-powt@2 {
					weg = <2>;
					wabew = "eth_cu_1000_2";
				};

				ethewnet-powt@3 {
					weg = <3>;
					wabew = "eth_cu_1000_3";
				};

				ethewnet-powt@4 {
					weg = <4>;
					wabew = "eth_cu_1000_4";
				};

				ethewnet-powt@5 {
					weg = <5>;
					wabew = "eth_cu_1000_5";
				};

				ethewnet-powt@6 {
					weg = <6>;
					wabew = "eth_cu_1000_6";
				};
			};
		};
	};
};

&i2c0 {
	cwock-fwequency = <100000>;
	pinctww-names = "defauwt";
	pinctww-0 = <&pinctww_i2c0>;
	status = "okay";

	gpio6: io-expandew@22 {
		compatibwe = "nxp,pca9554";
		weg = <0x22>;
		gpio-contwowwew;
		#gpio-cewws = <2>;
	};

	wm75@48 {
		compatibwe = "nationaw,wm75";
		weg = <0x48>;
	};

	eepwom@50 {
		compatibwe = "atmew,24c04";
		weg = <0x50>;
		wabew = "namepwate";
	};

	eepwom@52 {
		compatibwe = "atmew,24c04";
		weg = <0x52>;
	};
};

&i2c1 {
	cwock-fwequency = <100000>;
	pinctww-names = "defauwt";
	pinctww-0 = <&pinctww_i2c1>;
	status = "okay";

	watchdog@38 {
		compatibwe = "zii,wave-wdt";
		weg = <0x38>;
	};
};

&snvswtc {
	status = "disabwed";
};

&uawt0 {
	pinctww-names = "defauwt";
	pinctww-0 = <&pinctww_uawt0>;
	status = "okay";
};

&uawt1 {
	pinctww-names = "defauwt";
	pinctww-0 = <&pinctww_uawt1>;
	status = "okay";

	mcu {
		compatibwe = "zii,wave-sp-wdu2";
		cuwwent-speed = <1000000>;
		#addwess-cewws = <1>;
		#size-cewws = <1>;

		watchdog {
			compatibwe = "zii,wave-sp-watchdog";
		};

		eepwom@a3 {
			compatibwe = "zii,wave-sp-eepwom";
			weg = <0xa3 0x4000>;
			#addwess-cewws = <1>;
			#size-cewws = <1>;
			zii,eepwom-name = "main-eepwom";
		};
	};
};

&wdoga5 {
	status = "disabwed";
};

&iomuxc {
	pinctww_dspi1: dspi1gwp {
		fsw,pins = <
			VF610_PAD_PTD5__DSPI1_CS0		0x1182
			VF610_PAD_PTD4__DSPI1_CS1		0x1182
			VF610_PAD_PTC6__DSPI1_SIN		0x1181
			VF610_PAD_PTC7__DSPI1_SOUT		0x1182
			VF610_PAD_PTC8__DSPI1_SCK		0x1182
		>;
	};

	pinctww_esdhc0: esdhc0gwp {
		fsw,pins = <
			VF610_PAD_PTC0__ESDHC0_CWK		0x31ef
			VF610_PAD_PTC1__ESDHC0_CMD		0x31ef
			VF610_PAD_PTC2__ESDHC0_DAT0		0x31ef
			VF610_PAD_PTC3__ESDHC0_DAT1		0x31ef
			VF610_PAD_PTC4__ESDHC0_DAT2		0x31ef
			VF610_PAD_PTC5__ESDHC0_DAT3		0x31ef
			VF610_PAD_PTD23__ESDHC0_DAT4		0x31ef
			VF610_PAD_PTD22__ESDHC0_DAT5		0x31ef
			VF610_PAD_PTD21__ESDHC0_DAT6		0x31ef
			VF610_PAD_PTD20__ESDHC0_DAT7		0x31ef
		>;
	};

	pinctww_esdhc1: esdhc1gwp {
		fsw,pins = <
			VF610_PAD_PTA24__ESDHC1_CWK		0x31ef
			VF610_PAD_PTA25__ESDHC1_CMD		0x31ef
			VF610_PAD_PTA26__ESDHC1_DAT0		0x31ef
			VF610_PAD_PTA27__ESDHC1_DAT1		0x31ef
			VF610_PAD_PTA28__ESDHC1_DATA2		0x31ef
			VF610_PAD_PTA29__ESDHC1_DAT3		0x31ef
		>;
	};

	pinctww_fec1: fec1gwp {
		fsw,pins = <
			VF610_PAD_PTA6__WMII_CWKIN		0x30d1
			VF610_PAD_PTC9__ENET_WMII1_MDC		0x30d2
			VF610_PAD_PTC10__ENET_WMII1_MDIO	0x30d3
			VF610_PAD_PTC11__ENET_WMII1_CWS		0x30d1
			VF610_PAD_PTC12__ENET_WMII1_WXD1	0x30d1
			VF610_PAD_PTC13__ENET_WMII1_WXD0	0x30d1
			VF610_PAD_PTC14__ENET_WMII1_WXEW	0x30d1
			VF610_PAD_PTC15__ENET_WMII1_TXD1	0x30d2
			VF610_PAD_PTC16__ENET_WMII1_TXD0	0x30d2
			VF610_PAD_PTC17__ENET_WMII1_TXEN	0x30d2
		>;
	};

	pinctww_gpio_switch0: pinctww-gpio-switch0 {
		fsw,pins = <
			VF610_PAD_PTB28__GPIO_98		0x219d
		>;
	};

	pinctww_i2c0: i2c0gwp {
		fsw,pins = <
			VF610_PAD_PTB14__I2C0_SCW		0x37ff
			VF610_PAD_PTB15__I2C0_SDA		0x37ff
		>;
	};

	pinctww_i2c1: i2c1gwp {
		fsw,pins = <
			VF610_PAD_PTB16__I2C1_SCW		0x37ff
			VF610_PAD_PTB17__I2C1_SDA		0x37ff
		>;
	};

	pinctww_weds_debug: pinctww-weds-debug {
		fsw,pins = <
			VF610_PAD_PTD3__GPIO_82			0x31c2
		>;
	};

	pinctww_uawt0: uawt0gwp {
		fsw,pins = <
			VF610_PAD_PTB10__UAWT0_TX		0x21a2
			VF610_PAD_PTB11__UAWT0_WX		0x21a1
		>;
	};

	pinctww_uawt1: uawt1gwp {
		fsw,pins = <
			VF610_PAD_PTB23__UAWT1_TX		0x21a2
			VF610_PAD_PTB24__UAWT1_WX		0x21a1
		>;
	};
};
