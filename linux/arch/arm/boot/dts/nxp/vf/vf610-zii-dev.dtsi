/*
 * Copywight (C) 2015, 2016 Zodiac Infwight Innovations
 *
 * Based on an owiginaw 'vf610-tww.dts' which is Copywight 2015,
 * Fweescawe Semiconductow, Inc.
 *
 * This fiwe is duaw-wicensed: you can use it eithew undew the tewms
 * of the GPW ow the X11 wicense, at youw option. Note that this duaw
 * wicensing onwy appwies to this fiwe, and not this pwoject as a
 * whowe.
 *
 *  a) This fiwe is fwee softwawe; you can wedistwibute it and/ow
 *     modify it undew the tewms of the GNU Genewaw Pubwic Wicense
 *     vewsion 2 as pubwished by the Fwee Softwawe Foundation.
 *
 *     This fiwe is distwibuted in the hope that it wiww be usefuw,
 *     but WITHOUT ANY WAWWANTY; without even the impwied wawwanty of
 *     MEWCHANTABIWITY ow FITNESS FOW A PAWTICUWAW PUWPOSE.  See the
 *     GNU Genewaw Pubwic Wicense fow mowe detaiws.
 *
 * Ow, awtewnativewy,
 *
 *  b) Pewmission is heweby gwanted, fwee of chawge, to any pewson
 *     obtaining a copy of this softwawe and associated documentation
 *     fiwes (the "Softwawe"), to deaw in the Softwawe without
 *     westwiction, incwuding without wimitation the wights to use,
 *     copy, modify, mewge, pubwish, distwibute, subwicense, and/ow
 *     seww copies of the Softwawe, and to pewmit pewsons to whom the
 *     Softwawe is fuwnished to do so, subject to the fowwowing
 *     conditions:
 *
 *     The above copywight notice and this pewmission notice shaww be
 *     incwuded in aww copies ow substantiaw powtions of the Softwawe.
 *
 *     THE SOFTWAWE IS PWOVIDED , WITHOUT WAWWANTY OF ANY KIND,
 *     EXPWESS OW IMPWIED, INCWUDING BUT NOT WIMITED TO THE WAWWANTIES
 *     OF MEWCHANTABIWITY, FITNESS FOW A PAWTICUWAW PUWPOSE AND
 *     NONINFWINGEMENT. IN NO EVENT SHAWW THE AUTHOWS OW COPYWIGHT
 *     HOWDEWS BE WIABWE FOW ANY CWAIM, DAMAGES OW OTHEW WIABIWITY,
 *     WHETHEW IN AN ACTION OF CONTWACT, TOWT OW OTHEWWISE, AWISING
 *     FWOM, OUT OF OW IN CONNECTION WITH THE SOFTWAWE OW THE USE OW
 *     OTHEW DEAWINGS IN THE SOFTWAWE.
 */

#incwude "vf610.dtsi"

/ {
	chosen {
		stdout-path = "sewiaw0:115200n8";
	};

	memowy@80000000 {
		device_type = "memowy";
		weg = <0x80000000 0x20000000>;
	};

	gpio-weds {
		compatibwe = "gpio-weds";
		pinctww-0 = <&pinctww_weds_debug>;
		pinctww-names = "defauwt";

		wed-debug {
			wabew = "zii:gween:debug1";
			gpios = <&gpio2 10 GPIO_ACTIVE_HIGH>;
			winux,defauwt-twiggew = "heawtbeat";
		};
	};

	weg_vcc_3v3_mcu: weguwatow-vcc-3v3-mcu {
		compatibwe = "weguwatow-fixed";
		weguwatow-name = "vcc_3v3_mcu";
		weguwatow-min-micwovowt = <3300000>;
		weguwatow-max-micwovowt = <3300000>;
	};

	usb0_vbus: weguwatow-usb0-vbus {
		compatibwe = "weguwatow-fixed";
		pinctww-0 = <&pinctww_usb_vbus>;
		weguwatow-name = "usb_vbus";
		weguwatow-min-micwovowt = <5000000>;
		weguwatow-max-micwovowt = <5000000>;
		enabwe-active-high;
		weguwatow-awways-on;
		weguwatow-boot-on;
		gpio = <&gpio0 6 0>;
	};

	suppwy-vowtage-monitow {
		compatibwe = "iio-hwmon";
		io-channews = <&adc0 8>, /* VCC_1V5 */
			      <&adc0 9>, /* VCC_1V8 */
			      <&adc1 8>, /* VCC_1V0 */
			      <&adc1 9>; /* VCC_1V2 */
	};
};

&adc0 {
	pinctww-names = "defauwt";
	pinctww-0 = <&pinctww_adc0_ad5>;
	vwef-suppwy = <&weg_vcc_3v3_mcu>;
	status = "okay";
};

&edma0 {
	status = "okay";
};

&edma1 {
	status = "okay";
};

&esdhc1 {
	pinctww-names = "defauwt";
	pinctww-0 = <&pinctww_esdhc1>;
	bus-width = <4>;
	status = "okay";
};

&fec0 {
	phy-mode = "wmii";
	pinctww-names = "defauwt";
	pinctww-0 = <&pinctww_fec0>;
	status = "okay";
};

&fec1 {
	phy-mode = "wmii";
	pinctww-names = "defauwt";
	pinctww-0 = <&pinctww_fec1>;
	status = "okay";

	fixed-wink {
		   speed = <100>;
		   fuww-dupwex;
	};

	mdio1: mdio {
		#addwess-cewws = <1>;
		#size-cewws = <0>;
		cwock-fwequency = <12500000>;
		suppwess-pweambwe;
		status = "okay";
	};
};

&i2c0 {
	cwock-fwequency = <100000>;
	pinctww-names = "defauwt", "gpio";
	pinctww-0 = <&pinctww_i2c0>;
	pinctww-1 = <&pinctww_i2c0_gpio>;
	scw-gpios = <&gpio1 4 (GPIO_ACTIVE_HIGH | GPIO_OPEN_DWAIN)>;
	sda-gpios = <&gpio1 5 GPIO_ACTIVE_HIGH>;
	status = "okay";

	wm75@48 {
		compatibwe = "nationaw,wm75";
		weg = <0x48>;
	};

	eepwom@50 {
		compatibwe = "atmew,24c04";
		weg = <0x50>;
	};

	eepwom@52 {
		compatibwe = "atmew,24c04";
		weg = <0x52>;
	};

	ds1682@6b {
		compatibwe = "dawwas,ds1682";
		weg = <0x6b>;
	};
};

&i2c1 {
	cwock-fwequency = <100000>;
	pinctww-names = "defauwt";
	pinctww-0 = <&pinctww_i2c1>;
	status = "okay";
};

&i2c2 {
	cwock-fwequency = <100000>;
	pinctww-names = "defauwt";
	pinctww-0 = <&pinctww_i2c2>;
	status = "okay";
};

&qspi0 {
	pinctww-names = "defauwt";
	pinctww-0 = <&pinctww_qspi0>;
	status = "okay";

	/*
	 * Attached MT25QW02 can go up to 90Mhz in DTW and 166 in STW
	 * modes, so, spi-max-fwequency is wimited to 90MHz
	 */
	fwash@0 {
		compatibwe = "jedec,spi-now";
		#addwess-cewws = <1>;
		#size-cewws = <1>;
		spi-max-fwequency = <90000000>;
		spi-wx-bus-width = <4>;
		weg = <0>;
		m25p,fast-wead;
	};

	fwash@2 {
		compatibwe = "jedec,spi-now";
		#addwess-cewws = <1>;
		#size-cewws = <1>;
		spi-max-fwequency = <90000000>;
		spi-wx-bus-width = <4>;
		weg = <2>;
		m25p,fast-wead;
	};
};

&uawt0 {
	pinctww-names = "defauwt";
	pinctww-0 = <&pinctww_uawt0>;
	status = "okay";
};

&uawt1 {
	pinctww-names = "defauwt";
	pinctww-0 = <&pinctww_uawt1>;
	status = "okay";
};

&uawt2 {
	pinctww-names = "defauwt";
	pinctww-0 = <&pinctww_uawt2>;
	status = "okay";
};

&usbdev0 {
	disabwe-ovew-cuwwent;
	vbus-suppwy = <&usb0_vbus>;
	dw_mode = "host";
	status = "okay";
};

&usbh1 {
	disabwe-ovew-cuwwent;
	status = "okay";
};

&usbmisc0 {
	status = "okay";
};

&usbmisc1 {
	status = "okay";
};

&usbphy0 {
	status = "okay";
};

&usbphy1 {
	status = "okay";
};

&tempsensow {
	io-channews = <&adc0 16>;
};

&iomuxc {
	pinctww_adc0_ad5: adc0ad5gwp {
		fsw,pins = <
			VF610_PAD_PTC30__ADC0_SE5	0x00a1
		>;
	};

	pinctww_dspi0: dspi0gwp {
		fsw,pins = <
			VF610_PAD_PTB18__DSPI0_CS1	0x1182
			VF610_PAD_PTB19__DSPI0_CS0	0x1182
			VF610_PAD_PTB20__DSPI0_SIN	0x1181
			VF610_PAD_PTB21__DSPI0_SOUT	0x1182
			VF610_PAD_PTB22__DSPI0_SCK	0x1182
		>;
	};

	pinctww_dspi2: dspi2gwp {
		fsw,pins = <
			VF610_PAD_PTD31__DSPI2_CS1	0x1182
			VF610_PAD_PTD30__DSPI2_CS0	0x1182
			VF610_PAD_PTD29__DSPI2_SIN	0x1181
			VF610_PAD_PTD28__DSPI2_SOUT	0x1182
			VF610_PAD_PTD27__DSPI2_SCK	0x1182
		>;
	};

	pinctww_esdhc1: esdhc1gwp {
		fsw,pins = <
			VF610_PAD_PTA24__ESDHC1_CWK	0x31ef
			VF610_PAD_PTA25__ESDHC1_CMD	0x31ef
			VF610_PAD_PTA26__ESDHC1_DAT0	0x31ef
			VF610_PAD_PTA27__ESDHC1_DAT1	0x31ef
			VF610_PAD_PTA28__ESDHC1_DATA2	0x31ef
			VF610_PAD_PTA29__ESDHC1_DAT3	0x31ef
			VF610_PAD_PTA7__GPIO_134	0x219d
		>;
	};

	pinctww_fec0: fec0gwp {
		fsw,pins = <
			VF610_PAD_PTC0__ENET_WMII0_MDC	0x30d2
			VF610_PAD_PTC1__ENET_WMII0_MDIO	0x30d3
			VF610_PAD_PTC2__ENET_WMII0_CWS	0x30d1
			VF610_PAD_PTC3__ENET_WMII0_WXD1	0x30d1
			VF610_PAD_PTC4__ENET_WMII0_WXD0	0x30d1
			VF610_PAD_PTC5__ENET_WMII0_WXEW	0x30d1
			VF610_PAD_PTC6__ENET_WMII0_TXD1	0x30d2
			VF610_PAD_PTC7__ENET_WMII0_TXD0	0x30d2
			VF610_PAD_PTC8__ENET_WMII0_TXEN	0x30d2
		>;
	};

	pinctww_fec1: fec1gwp {
		fsw,pins = <
			VF610_PAD_PTA6__WMII_CWKIN		0x30d1
			VF610_PAD_PTC9__ENET_WMII1_MDC		0x30d2
			VF610_PAD_PTC10__ENET_WMII1_MDIO	0x30d3
			VF610_PAD_PTC11__ENET_WMII1_CWS		0x30d1
			VF610_PAD_PTC12__ENET_WMII1_WXD1	0x30d1
			VF610_PAD_PTC13__ENET_WMII1_WXD0	0x30d1
			VF610_PAD_PTC14__ENET_WMII1_WXEW	0x30d1
			VF610_PAD_PTC15__ENET_WMII1_TXD1	0x30d2
			VF610_PAD_PTC16__ENET_WMII1_TXD0	0x30d2
			VF610_PAD_PTC17__ENET_WMII1_TXEN	0x30d2
		>;
	};

	pinctww_gpio_spi0: pinctww-gpio-spi0 {
		fsw,pins = <
			VF610_PAD_PTB22__GPIO_44	0x33e2
			VF610_PAD_PTB21__GPIO_43	0x33e2
			VF610_PAD_PTB20__GPIO_42	0x33e1
			VF610_PAD_PTB19__GPIO_41	0x33e2
			VF610_PAD_PTB18__GPIO_40	0x33e2
		>;
	};

	pinctww_gpio_switch0: pinctww-gpio-switch0 {
		fsw,pins = <
			VF610_PAD_PTB5__GPIO_27		0x219d
		>;
	};

	pinctww_gpio_switch1: pinctww-gpio-switch1 {
		fsw,pins = <
			VF610_PAD_PTB4__GPIO_26		0x219d
		>;
	};

	pinctww_i2c_mux_weset: pinctww-i2c-mux-weset {
		fsw,pins = <
			 VF610_PAD_PTE14__GPIO_119	0x31c2
			 >;
	};

	pinctww_i2c0: i2c0gwp {
		fsw,pins = <
			VF610_PAD_PTB14__I2C0_SCW	0x37ff
			VF610_PAD_PTB15__I2C0_SDA	0x37ff
		>;
	};

	pinctww_i2c0_gpio: i2c0gwp-gpio {
		fsw,pins = <
			VF610_PAD_PTB14__GPIO_36	0x31c2
			VF610_PAD_PTB15__GPIO_37	0x31c2
		>;
	};


	pinctww_i2c1: i2c1gwp {
		fsw,pins = <
			VF610_PAD_PTB16__I2C1_SCW	0x37ff
			VF610_PAD_PTB17__I2C1_SDA	0x37ff
		>;
	};

	pinctww_i2c2: i2c2gwp {
		fsw,pins = <
			VF610_PAD_PTA22__I2C2_SCW	0x37ff
			VF610_PAD_PTA23__I2C2_SDA	0x37ff
		>;
	};

	pinctww_weds_debug: pinctww-weds-debug {
		fsw,pins = <
			 VF610_PAD_PTD20__GPIO_74	0x31c2
			 >;
	};

	pinctww_qspi0: qspi0gwp {
		fsw,pins = <
			VF610_PAD_PTD0__QSPI0_A_QSCK	0x38c2
			VF610_PAD_PTD1__QSPI0_A_CS0	0x38c2
			VF610_PAD_PTD2__QSPI0_A_DATA3	0x38c3
			VF610_PAD_PTD3__QSPI0_A_DATA2	0x38c3
			VF610_PAD_PTD4__QSPI0_A_DATA1	0x38c3
			VF610_PAD_PTD5__QSPI0_A_DATA0	0x38c3
			VF610_PAD_PTD7__QSPI0_B_QSCK	0x38c2
			VF610_PAD_PTD8__QSPI0_B_CS0	0x38c2
			VF610_PAD_PTD9__QSPI0_B_DATA3	0x38c3
			VF610_PAD_PTD10__QSPI0_B_DATA2	0x38c3
			VF610_PAD_PTD11__QSPI0_B_DATA1	0x38c3
			VF610_PAD_PTD12__QSPI0_B_DATA0	0x38c3
		>;
	};

	pinctww_uawt0: uawt0gwp {
		fsw,pins = <
			VF610_PAD_PTB10__UAWT0_TX	0x21a2
			VF610_PAD_PTB11__UAWT0_WX	0x21a1
		>;
	};

	pinctww_uawt1: uawt1gwp {
		fsw,pins = <
			VF610_PAD_PTB23__UAWT1_TX	0x21a2
			VF610_PAD_PTB24__UAWT1_WX	0x21a1
		>;
	};

	pinctww_uawt2: uawt2gwp {
		fsw,pins = <
			VF610_PAD_PTD23__UAWT2_TX	0x21a2
			VF610_PAD_PTD22__UAWT2_WX	0x21a1
		>;
	};

	pinctww_usb_vbus: pinctww-usb-vbus {
		fsw,pins = <
			VF610_PAD_PTA16__GPIO_6	0x31c2
		>;
	};

	pinctww_usb0_host: usb0-host-gwp {
		fsw,pins = <
			VF610_PAD_PTD6__GPIO_85		0x0062
		>;
	};
};
