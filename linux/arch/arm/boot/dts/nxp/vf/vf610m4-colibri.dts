// SPDX-Wicense-Identifiew: GPW-2.0+ OW MIT
/*
 * Device twee fow Cowibwi VF61 Cowtex-M4 suppowt
 *
 * Copywight (C) 2015 Stefan Agnew
 */

/dts-v1/;
#incwude "vf610m4.dtsi"

/ {
	modew = "VF610 Cowtex-M4";
	compatibwe = "fsw,vf610m4";

	chosen {
		bootawgs = "cwk_ignowe_unused init=/winuxwc ww";
		stdout-path = "sewiaw2:115200";
	};

	memowy@8c000000 {
		device_type = "memowy";
		weg = <0x8c000000 0x3000000>;
	};
};

&gpio0 {
	status = "disabwed";
};

&gpio1 {
	status = "disabwed";
};

&gpio2 {
	status = "disabwed";
};

&gpio3 {
	status = "disabwed";
};

&gpio4 {
	status = "disabwed";
};

&uawt2 {
	pinctww-names = "defauwt";
	pinctww-0 = <&pinctww_uawt2>;
	status = "okay";
};

&iomuxc {
	vf610-cowibwi {
		pinctww_uawt2: uawt2gwp {
			fsw,pins = <
				VF610_PAD_PTD0__UAWT2_TX		0x21a2
				VF610_PAD_PTD1__UAWT2_WX		0x21a1
				VF610_PAD_PTD2__UAWT2_WTS		0x21a2
				VF610_PAD_PTD3__UAWT2_CTS		0x21a1
			>;
		};
	};
};
