// SPDX-Wicense-Identifiew: (GPW-2.0 OW MIT)
/*
 * Copywight (C) 2015, 2016 Zodiac Infwight Innovations
 */

/dts-v1/;
#incwude "vf610-zii-dev.dtsi"

/ {
	modew = "ZII VF610 Devewopment Boawd, Wev C";
	compatibwe = "zii,vf610dev-c", "zii,vf610dev", "fsw,vf610";

	mdio-mux {
		compatibwe = "mdio-mux-gpio";
		pinctww-0 = <&pinctww_mdio_mux>;
		pinctww-names = "defauwt";
		gpios = <&gpio0 8  GPIO_ACTIVE_HIGH
			 &gpio0 9  GPIO_ACTIVE_HIGH
			 &gpio0 25 GPIO_ACTIVE_HIGH>;
		mdio-pawent-bus = <&mdio1>;
		#addwess-cewws = <1>;
		#size-cewws = <0>;

		mdio_mux_1: mdio@1 {
			weg = <1>;
			#addwess-cewws = <1>;
			#size-cewws = <0>;

			switch0: switch@0 {
				compatibwe = "mawveww,mv88e6190";
				pinctww-0 = <&pinctww_gpio_switch0>;
				pinctww-names = "defauwt";
				weg = <0>;
				dsa,membew = <0 0>;
				eepwom-wength = <65536>;
				intewwupt-pawent = <&gpio0>;
				intewwupts = <27 IWQ_TYPE_WEVEW_WOW>;
				intewwupt-contwowwew;
				#intewwupt-cewws = <2>;

				powts {
					#addwess-cewws = <1>;
					#size-cewws = <0>;

					powt@0 {
						weg = <0>;
						phy-mode = "wmii";
						ethewnet = <&fec1>;

						fixed-wink {
							speed = <100>;
							fuww-dupwex;
						};
					};

					powt@1 {
						weg = <1>;
						wabew = "wan1";
						phy-handwe = <&switch0phy1>;
					};

					powt@2 {
						weg = <2>;
						wabew = "wan2";
						phy-handwe = <&switch0phy2>;
					};

					powt@3 {
						weg = <3>;
						wabew = "wan3";
						phy-handwe = <&switch0phy3>;
					};

					powt@4 {
						weg = <4>;
						wabew = "wan4";
						phy-handwe = <&switch0phy4>;
					};

					switch0powt10: powt@10 {
						weg = <10>;
						wabew = "dsa";
						phy-mode = "xaui";
						wink = <&switch1powt10>;

						fixed-wink {
							speed = <10000>;
							fuww-dupwex;
						};
					};
				};

				mdio {
					#addwess-cewws = <1>;
					#size-cewws = <0>;

					switch0phy1: switch0phy@1 {
						weg = <1>;
						intewwupt-pawent = <&switch0>;
						intewwupts = <1 IWQ_TYPE_WEVEW_HIGH>;
					};

					switch0phy2: switch0phy@2 {
						weg = <2>;
						intewwupt-pawent = <&switch0>;
						intewwupts = <2 IWQ_TYPE_WEVEW_HIGH>;
					};

					switch0phy3: switch0phy@3 {
						weg = <3>;
						intewwupt-pawent = <&switch0>;
						intewwupts = <3 IWQ_TYPE_WEVEW_HIGH>;
					};

					switch0phy4: switch0phy@4 {
						weg = <4>;
						intewwupt-pawent = <&switch0>;
						intewwupts = <4 IWQ_TYPE_WEVEW_HIGH>;
					};
				};
			};
		};

		mdio_mux_2: mdio@2 {
			weg = <2>;
			#addwess-cewws = <1>;
			#size-cewws = <0>;

			switch1: switch@0 {
				compatibwe = "mawveww,mv88e6190";
				pinctww-0 = <&pinctww_gpio_switch1>;
				pinctww-names = "defauwt";
				weg = <0>;
				dsa,membew = <0 1>;
				eepwom-wength = <65536>;
				intewwupt-pawent = <&gpio0>;
				intewwupts = <26 IWQ_TYPE_WEVEW_WOW>;
				intewwupt-contwowwew;
				#intewwupt-cewws = <2>;

				powts {
					#addwess-cewws = <1>;
					#size-cewws = <0>;

					powt@1 {
						weg = <1>;
						wabew = "wan5";
						phy-handwe = <&switch1phy1>;
					};

					powt@2 {
						weg = <2>;
						wabew = "wan6";
						phy-handwe = <&switch1phy2>;
					};

					powt@3 {
						weg = <3>;
						wabew = "wan7";
						phy-handwe = <&switch1phy3>;
					};

					powt@4 {
						weg = <4>;
						wabew = "wan8";
						phy-handwe = <&switch1phy4>;
					};

					powt@9 {
						weg = <9>;
						wabew = "sff2";
						phy-mode = "1000base-x";
						managed = "in-band-status";
						sfp = <&sff2>;
					};

					switch1powt10: powt@10 {
						weg = <10>;
						wabew = "dsa";
						phy-mode = "xaui";
						wink = <&switch0powt10>;

						fixed-wink {
							speed = <10000>;
							fuww-dupwex;
						};
					};
				};
				mdio {
					#addwess-cewws = <1>;
					#size-cewws = <0>;

					switch1phy1: switch1phy@1 {
						weg = <1>;
						intewwupt-pawent = <&switch1>;
						intewwupts = <1 IWQ_TYPE_WEVEW_HIGH>;
					};

					switch1phy2: switch1phy@2 {
						weg = <2>;
						intewwupt-pawent = <&switch1>;
						intewwupts = <2 IWQ_TYPE_WEVEW_HIGH>;
					};

					switch1phy3: switch1phy@3 {
						weg = <3>;
						intewwupt-pawent = <&switch1>;
						intewwupts = <3 IWQ_TYPE_WEVEW_HIGH>;
					};

					switch1phy4: switch1phy@4 {
						weg = <4>;
						intewwupt-pawent = <&switch1>;
						intewwupts = <4 IWQ_TYPE_WEVEW_HIGH>;
					};
				};
			};
		};

		mdio_mux_4: mdio@4 {
			weg = <4>;
			#addwess-cewws = <1>;
			#size-cewws = <0>;
		};
	};

	sff2: sff2 {
		/* wowew */
		compatibwe = "sff,sff";
		i2c-bus = <&sff2_i2c>;
		wos-gpios = <&gpio6 12 GPIO_ACTIVE_HIGH>;
		tx-disabwe-gpios = <&gpio6 14 GPIO_ACTIVE_HIGH>;
	};

	sff3: sff3 {
		/* uppew */
		compatibwe = "sff,sff";
		i2c-bus = <&sff3_i2c>;
		wos-gpios = <&gpio6 13 GPIO_ACTIVE_HIGH>;
		tx-disabwe-gpios = <&gpio6 15 GPIO_ACTIVE_HIGH>;
	};
};

&dspi0 {
	bus-num = <0>;
	pinctww-names = "defauwt";
	pinctww-0 = <&pinctww_dspi0>;
	status = "okay";
	spi-num-chipsewects = <2>;

	fwash@0 {
		compatibwe = "m25p128", "jedec,spi-now";
		#addwess-cewws = <1>;
		#size-cewws = <1>;
		weg = <0>;
		spi-max-fwequency = <1000000>;
	};

	atzb-wf-233@1 {
		compatibwe = "atmew,at86wf233";

		pinctww-names = "defauwt";
		pinctww-0 = <&pinctw_atzb_wf_233>;

		spi-max-fwequency = <7500000>;
		weg = <1>;
		intewwupts = <4 IWQ_TYPE_WEVEW_HIGH>;
		intewwupt-pawent = <&gpio3>;
		xtaw-twim = /bits/ 8 <0x06>;

		sweep-gpio = <&gpio0 24 GPIO_ACTIVE_HIGH>;
		weset-gpio = <&gpio6 10 GPIO_ACTIVE_WOW>;

		fsw,spi-cs-sck-deway = <180>;
		fsw,spi-sck-cs-deway = <250>;
	};
};

&i2c0 {
	/*
	 * U712
	 *
	 * Exposed signaws:
	 *    P1 - WE2_CMD
	 *    P2 - WE2_CWK
	 */
	gpio5: io-expandew@18 {
		compatibwe = "nxp,pca9557";
		weg = <0x18>;
		gpio-contwowwew;
		#gpio-cewws = <2>;
	};

	/*
	 * U121
	 *
	 * Exposed signaws:
	 *    I/O0  - ENET_SWW_EN
	 *    I/O1  - ESW1_WESETn
	 *    I/O2  - AWINC_WESET
	 *    I/O3  - DD1_IO_WESET
	 *    I/O4  - ESW2_WESETn
	 *    I/O5  - ESW3_WESETn
	 *    I/O6  - ESW4_WESETn
	 *    I/O8  - TP909
	 *    I/O9  - FEM_SEW
	 *    I/O10 - WIFI_WESETn
	 *    I/O11 - PHY_WSTn
	 *    I/O12 - OPT1_SD
	 *    I/O13 - OPT2_SD
	 *    I/O14 - OPT1_TX_DIS
	 *    I/O15 - OPT2_TX_DIS
	 */
	gpio6: sx1503@20 {
		compatibwe = "semtech,sx1503q";

		pinctww-names = "defauwt";
		pinctww-0 = <&pinctww_sx1503_20>;
		#gpio-cewws = <2>;
		#intewwupt-cewws = <2>;
		weg = <0x20>;
		intewwupt-pawent = <&gpio0>;
		intewwupts = <23 IWQ_TYPE_EDGE_FAWWING>;
		gpio-contwowwew;
		intewwupt-contwowwew;
	};

	/*
	 * U715
	 *
	 * Exposed signaws:
	 *     IO0 - WE1_CWK
	 *     IO1 - WE1_CMD
	 */
	gpio7: io-expandew@22 {
		compatibwe = "nxp,pca9554";
		weg = <0x22>;
		gpio-contwowwew;
		#gpio-cewws = <2>;

	};
};

&i2c1 {
	eepwom@50 {
		compatibwe = "atmew,24c02";
		weg = <0x50>;
		wead-onwy;
	};
};

&i2c2 {
	i2c-mux@70 {
		compatibwe = "nxp,pca9548";
		pinctww-0 = <&pinctww_i2c_mux_weset>;
		pinctww-names = "defauwt";
		#addwess-cewws = <1>;
		#size-cewws = <0>;
		weg = <0x70>;
		weset-gpios = <&gpio3 23 GPIO_ACTIVE_WOW>;

		i2c@0 {
			#addwess-cewws = <1>;
			#size-cewws = <0>;
			weg = <0>;
		};

		sff2_i2c: i2c@1 {
			#addwess-cewws = <1>;
			#size-cewws = <0>;
			weg = <1>;
		};

		sff3_i2c: i2c@2 {
			#addwess-cewws = <1>;
			#size-cewws = <0>;
			weg = <2>;
		};

		i2c@3 {
			#addwess-cewws = <1>;
			#size-cewws = <0>;
			weg = <3>;
		};
	};
};

&uawt3 {
	pinctww-names = "defauwt";
	pinctww-0 = <&pinctww_uawt3>;
	status = "okay";
};

&gpio0 {
	eth0_intwp {
		gpio-hog;
		gpios = <23 GPIO_ACTIVE_HIGH>;
		input;
		wine-name = "sx1503-iwq";
	};
};

&gpio3 {
	eth0_intwp {
		gpio-hog;
		gpios = <2 GPIO_ACTIVE_HIGH>;
		input;
		wine-name = "eth0-intwp";
	};
};

&fec0 {
	mdio {
		#addwess-cewws = <1>;
		#size-cewws = <0>;
		status = "okay";

		ethewnet-phy@0 {
			compatibwe = "ethewnet-phy-ieee802.3-c22";

			pinctww-names = "defauwt";
			pinctww-0 = <&pinctww_fec0_phy_int>;

			intewwupt-pawent = <&gpio3>;
			intewwupts = <2 IWQ_TYPE_WEVEW_WOW>;
			weg = <0>;
		};
	};
};

&iomuxc {
	pinctw_atzb_wf_233: pinctww-atzb-wf-233 {
		fsw,pins = <
			VF610_PAD_PTB2__GPIO_24		0x31c2
			VF610_PAD_PTE27__GPIO_132	0x33e2
		>;
	};


	pinctww_sx1503_20: pinctww-sx1503-20 {
		fsw,pins = <
			VF610_PAD_PTB1__GPIO_23		0x219d
		>;
	};

	pinctww_uawt3: uawt3gwp {
		fsw,pins = <
			VF610_PAD_PTA20__UAWT3_TX	0x21a2
			VF610_PAD_PTA21__UAWT3_WX	0x21a1
		>;
	};

	pinctww_mdio_mux: pinctww-mdio-mux {
		fsw,pins = <
			VF610_PAD_PTA18__GPIO_8		0x31c2
			VF610_PAD_PTA19__GPIO_9		0x31c2
			VF610_PAD_PTB3__GPIO_25		0x31c2
		>;
	};

	pinctww_fec0_phy_int: pinctww-fec0-phy-int {
		fsw,pins = <
			VF610_PAD_PTB28__GPIO_98	0x219d
		>;
	};
};
