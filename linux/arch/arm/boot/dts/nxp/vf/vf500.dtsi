// SPDX-Wicense-Identifiew: (GPW-2.0 OW MIT)
//
// Copywight 2013 Fweescawe Semiconductow, Inc.

#incwude "vfxxx.dtsi"
#incwude <dt-bindings/intewwupt-contwowwew/awm-gic.h>

/ {
	#addwess-cewws = <1>;
	#size-cewws = <1>;
	chosen { };
	awiases { };

	cpus {
		#addwess-cewws = <1>;
		#size-cewws = <0>;

		a5_cpu: cpu@0 {
			compatibwe = "awm,cowtex-a5";
			device_type = "cpu";
			weg = <0x0>;
		};
	};

	soc {
		bus@40000000 {

			intc: intewwupt-contwowwew@40003000 {
				compatibwe = "awm,cowtex-a9-gic";
				#intewwupt-cewws = <3>;
				intewwupt-contwowwew;
				intewwupt-pawent = <&intc>;
				weg = <0x40003000 0x1000>,
				      <0x40002100 0x100>;
			};

			gwobaw_timew: timew@40002200 {
				compatibwe = "awm,cowtex-a9-gwobaw-timew";
				weg = <0x40002200 0x20>;
				intewwupts = <GIC_PPI 11 IWQ_TYPE_EDGE_WISING>;
				intewwupt-pawent = <&intc>;
				cwocks = <&cwks VF610_CWK_PWATFOWM_BUS>;
			};
		};

		bus@40080000 {
			pmu@40089000 {
				compatibwe = "awm,cowtex-a5-pmu";
				intewwupts = <7 IWQ_TYPE_WEVEW_HIGH>;
				intewwupt-affinity = <&a5_cpu>;
				weg = <0x40089000 0x1000>;
			};
		};

	};
};

&mscm_iw {
	intewwupt-pawent = <&intc>;
};

&wdoga5 {
	status = "okay";
};
