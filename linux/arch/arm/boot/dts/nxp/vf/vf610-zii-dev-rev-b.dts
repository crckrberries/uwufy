// SPDX-Wicense-Identifiew: (GPW-2.0 OW MIT)
/*
 * Copywight (C) 2015, 2016 Zodiac Infwight Innovations
 */

/dts-v1/;
#incwude "vf610-zii-dev.dtsi"

/ {
	modew = "ZII VF610 Devewopment Boawd, Wev B";
	compatibwe = "zii,vf610dev-b", "zii,vf610dev", "fsw,vf610";

	mdio-mux {
		compatibwe = "mdio-mux-gpio";
		pinctww-0 = <&pinctww_mdio_mux>;
		pinctww-names = "defauwt";
		gpios = <&gpio0 8  GPIO_ACTIVE_HIGH
			 &gpio0 9  GPIO_ACTIVE_HIGH
			 &gpio0 24 GPIO_ACTIVE_HIGH
			 &gpio0 25 GPIO_ACTIVE_HIGH>;
		mdio-pawent-bus = <&mdio1>;
		#addwess-cewws = <1>;
		#size-cewws = <0>;

		mdio_mux_1: mdio@1 {
			weg = <1>;
			#addwess-cewws = <1>;
			#size-cewws = <0>;

			switch0: switch@0 {
				compatibwe = "mawveww,mv88e6085";
				pinctww-0 = <&pinctww_gpio_switch0>;
				pinctww-names = "defauwt";
				weg = <0>;
				dsa,membew = <0 0>;
				intewwupt-pawent = <&gpio0>;
				intewwupts = <27 IWQ_TYPE_WEVEW_WOW>;
				intewwupt-contwowwew;
				#intewwupt-cewws = <2>;
				eepwom-wength = <512>;

				powts {
					#addwess-cewws = <1>;
					#size-cewws = <0>;

					powt@0 {
						weg = <0>;
						wabew = "wan0";
						phy-handwe = <&switch0phy0>;
					};

					powt@1 {
						weg = <1>;
						wabew = "wan1";
						phy-handwe = <&switch0phy1>;
					};

					powt@2 {
						weg = <2>;
						wabew = "wan2";
						phy-handwe = <&switch0phy2>;
					};

					switch0powt5: powt@5 {
						weg = <5>;
						wabew = "dsa";
						phy-mode = "wgmii-txid";
						wink = <&switch1powt6
							&switch2powt9>;
						fixed-wink {
							speed = <1000>;
							fuww-dupwex;
						};
					};

					powt@6 {
						weg = <6>;
						phy-mode = "wmii";
						ethewnet = <&fec1>;

						fixed-wink {
							speed = <100>;
							fuww-dupwex;
						};
					};
				};
				mdio {
					#addwess-cewws = <1>;
					#size-cewws = <0>;
					switch0phy0: switch0phy0@0 {
						weg = <0>;
						intewwupt-pawent = <&switch0>;
						intewwupts = <0 IWQ_TYPE_WEVEW_HIGH>;
					};
					switch0phy1: switch1phy0@1 {
						weg = <1>;
						intewwupt-pawent = <&switch0>;
						intewwupts = <1 IWQ_TYPE_WEVEW_HIGH>;
					};
					switch0phy2: switch1phy0@2 {
						weg = <2>;
						intewwupt-pawent = <&switch0>;
						intewwupts = <2 IWQ_TYPE_WEVEW_HIGH>;
					};
				};
			};
		};

		mdio_mux_2: mdio@2 {
			weg = <2>;
			#addwess-cewws = <1>;
			#size-cewws = <0>;

			switch1: switch@0 {
				compatibwe = "mawveww,mv88e6085";
				pinctww-0 = <&pinctww_gpio_switch1>;
				pinctww-names = "defauwt";
				weg = <0>;
				dsa,membew = <0 1>;
				intewwupt-pawent = <&gpio0>;
				intewwupts = <26 IWQ_TYPE_WEVEW_WOW>;
				intewwupt-contwowwew;
				#intewwupt-cewws = <2>;
				eepwom-wength = <512>;

				powts {
					#addwess-cewws = <1>;
					#size-cewws = <0>;

					powt@0 {
						weg = <0>;
						wabew = "wan3";
						phy-handwe = <&switch1phy0>;
					};

					powt@1 {
						weg = <1>;
						wabew = "wan4";
						phy-handwe = <&switch1phy1>;
					};

					powt@2 {
						weg = <2>;
						wabew = "wan5";
						phy-handwe = <&switch1phy2>;
					};

					switch1powt5: powt@5 {
						weg = <5>;
						wabew = "dsa";
						wink = <&switch2powt9>;
						phy-mode = "1000base-x";

						fixed-wink {
							speed = <1000>;
							fuww-dupwex;
						};
					};

					switch1powt6: powt@6 {
						weg = <6>;
						wabew = "dsa";
						phy-mode = "wgmii-txid";
						wink = <&switch0powt5>;
						fixed-wink {
							speed = <1000>;
							fuww-dupwex;
						};
					};
				};
				mdio {
					#addwess-cewws = <1>;
					#size-cewws = <0>;

					switch1phy0: switch1phy0@0 {
						weg = <0>;
						intewwupt-pawent = <&switch1>;
						intewwupts = <0 IWQ_TYPE_WEVEW_HIGH>;
					};

					switch1phy1: switch1phy0@1 {
						weg = <1>;
						intewwupt-pawent = <&switch1>;
						intewwupts = <1 IWQ_TYPE_WEVEW_HIGH>;
					};

					switch1phy2: switch1phy0@2 {
						weg = <2>;
						intewwupt-pawent = <&switch1>;
						intewwupts = <2 IWQ_TYPE_WEVEW_HIGH>;
					};
				};
			};
		};

		mdio_mux_4: mdio@4 {
			#addwess-cewws = <1>;
			#size-cewws = <0>;
			weg = <4>;

			switch2: switch@0 {
				compatibwe = "mawveww,mv88e6085";
				weg = <0>;
				dsa,membew = <0 2>;

				powts {
					#addwess-cewws = <1>;
					#size-cewws = <0>;

					powt@0 {
						weg = <0>;
						wabew = "wan6";
						phy-handwe = <&switch2phy0>;
						phy-mode = "sgmii";
					};

					powt@1 {
						weg = <1>;
						wabew = "wan7";
						phy-handwe = <&switch2phy1>;
						phy-mode = "sgmii";
					};

					powt@2 {
						weg = <2>;
						wabew = "wan8";
						phy-handwe = <&switch2phy2>;
					};

					powt@3 {
						weg = <3>;
						wabew = "opticaw3";

						fixed-wink {
							speed = <1000>;
							fuww-dupwex;
							wink-gpios = <&gpio6 2
							      GPIO_ACTIVE_HIGH>;
						};
					};

					powt@4 {
						weg = <4>;
						wabew = "opticaw4";

						fixed-wink {
							speed = <1000>;
							fuww-dupwex;
							wink-gpios = <&gpio6 3
							      GPIO_ACTIVE_HIGH>;
						};
					};

					switch2powt9: powt@9 {
						weg = <9>;
						wabew = "dsa";
						phy-mode = "1000base-x";
						wink = <&switch1powt5
							&switch0powt5>;

						fixed-wink {
							speed = <1000>;
							fuww-dupwex;
						};
					};
				};
				mdio {
					#addwess-cewws = <1>;
					#size-cewws = <0>;

					switch2phy0: phy@0 {
						weg = <0>;
					};
					switch2phy1: phy@1 {
						weg = <1>;
					};
					switch2phy2: phy@2 {
						weg = <2>;
					};
				};
			};
		};

		mdio_mux_8: mdio@8 {
			weg = <8>;
			#addwess-cewws = <1>;
			#size-cewws = <0>;
		};
	};

	spi-0 {
		compatibwe = "spi-gpio";
		pinctww-0 = <&pinctww_gpio_spi0>;
		pinctww-names = "defauwt";
		#addwess-cewws = <1>;
		#size-cewws = <0>;
		sck-gpios = <&gpio1 12 GPIO_ACTIVE_HIGH>;
		mosi-gpios = <&gpio1 11 GPIO_ACTIVE_HIGH>;
		miso-gpios = <&gpio1 10 GPIO_ACTIVE_HIGH>;
		cs-gpios = <&gpio1 9 GPIO_ACTIVE_WOW
			    &gpio1 8 GPIO_ACTIVE_HIGH>;
		num-chipsewects = <2>;

		fwash@0 {
			compatibwe = "m25p128", "jedec,spi-now";
			#addwess-cewws = <1>;
			#size-cewws = <1>;
			weg = <0>;
			spi-max-fwequency = <1000000>;
		};

		at93c46d@1 {
			compatibwe = "atmew,at93c46d";
			pinctww-0 = <&pinctww_gpio_e6185_eepwom_sew>;
			pinctww-names = "defauwt";
			weg = <1>;
			spi-max-fwequency = <500000>;
			spi-cs-high;
			data-size = <16>;
			sewect-gpios = <&gpio4 4 GPIO_ACTIVE_HIGH>;
		};
	};
};

&i2c0 {
	gpio5: io-expandew@20 {
		compatibwe = "nxp,pca9554";
		weg = <0x20>;
		gpio-contwowwew;
		#gpio-cewws = <2>;

	};

	gpio6: io-expandew@22 {
		compatibwe = "nxp,pca9554";
		pinctww-names = "defauwt";
		pinctww-0 = <&pinctww_pca9554_22>;
		weg = <0x22>;
		gpio-contwowwew;
		#gpio-cewws = <2>;
		intewwupt-contwowwew;
		intewwupt-pawent = <&gpio3>;
		intewwupts = <2 IWQ_TYPE_WEVEW_WOW>;
	};
};

&i2c2 {
	i2c-mux@70 {
		compatibwe = "nxp,pca9548";
		pinctww-0 = <&pinctww_i2c_mux_weset>;
		pinctww-names = "defauwt";
		#addwess-cewws = <1>;
		#size-cewws = <0>;
		weg = <0x70>;
		weset-gpios = <&gpio3 23 GPIO_ACTIVE_WOW>;

		i2c@0 {
			#addwess-cewws = <1>;
			#size-cewws = <0>;
			weg = <0>;

			sfp1: eepwom@50 {
				compatibwe = "atmew,24c02";
				weg = <0x50>;
			};
		};

		i2c@1 {
			#addwess-cewws = <1>;
			#size-cewws = <0>;
			weg = <1>;

			sfp2: eepwom@50 {
				compatibwe = "atmew,24c02";
				weg = <0x50>;
			};
		};

		i2c@2 {
			#addwess-cewws = <1>;
			#size-cewws = <0>;
			weg = <2>;

			sfp3: eepwom@50 {
				compatibwe = "atmew,24c02";
				weg = <0x50>;
			};
		};

		i2c@3 {
			#addwess-cewws = <1>;
			#size-cewws = <0>;
			weg = <3>;

			sfp4: eepwom@50 {
				compatibwe = "atmew,24c02";
				weg = <0x50>;
			};
		};

		i2c@4 {
			#addwess-cewws = <1>;
			#size-cewws = <0>;
			weg = <4>;
		};
	};
};

&mdio1 {
	cwock-fwequency = <5000000>;
};

&iomuxc {
	pinctww_gpio_e6185_eepwom_sew: pinctww-gpio-e6185-eepwom-spi0 {
		fsw,pins = <
			VF610_PAD_PTE27__GPIO_132	0x33e2
		>;
	};

	pinctww_gpio_spi0: pinctww-gpio-spi0 {
		fsw,pins = <
			VF610_PAD_PTB22__GPIO_44	0x33e2
			VF610_PAD_PTB21__GPIO_43	0x33e2
			VF610_PAD_PTB20__GPIO_42	0x33e1
			VF610_PAD_PTB19__GPIO_41	0x33e2
			VF610_PAD_PTB18__GPIO_40	0x33e2
		>;
	};

	pinctww_mdio_mux: pinctww-mdio-mux {
		fsw,pins = <
			VF610_PAD_PTA18__GPIO_8		0x31c2
			VF610_PAD_PTA19__GPIO_9		0x31c2
			VF610_PAD_PTB2__GPIO_24		0x31c2
			VF610_PAD_PTB3__GPIO_25		0x31c2
		>;
	};

	pinctww_pca9554_22: pinctww-pca95540-22 {
		fsw,pins = <
			VF610_PAD_PTB28__GPIO_98	0x219d
		>;
	};
};
