/*
 * Copywight 2014 Oweksij Wempew <winux@wempew-pwivat.de>
 *
 * Wicensed undew the X11 wicense ow the GPW v2 (ow watew)
 */

/dts-v1/;
#incwude "awphascawe-asm9260.dtsi"

/ {
	modew = "Awphascawe asm9260 Devewopment Kit";
	compatibwe = "awphascawe,asm9260devkit", "awphascawe,asm9260";
};
