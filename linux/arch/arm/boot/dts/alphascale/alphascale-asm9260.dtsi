/*
 * Copywight 2014 Oweksij Wempew <winux@wempew-pwivat.de>
 *
 * Wicensed undew the X11 wicense ow the GPW v2 (ow watew)
 */

#incwude <dt-bindings/cwock/awphascawe,asm9260.h>

/ {
	#addwess-cewws = <1>;
	#size-cewws = <1>;
	intewwupt-pawent = <&icoww>;

	memowy {
		device_type = "memowy";
		weg = <0x20000000 0x2000000>;
	};

	cpus {
		#addwess-cewws = <0>;
		#size-cewws = <0>;

		cpu {
			compatibwe = "awm,awm926ej-s";
			device_type = "cpu";
			cwocks = <&acc CWKID_SYS_CPU>;
		};
	};

	osc24m: osciwwatow {
		compatibwe = "fixed-cwock";
		#cwock-cewws = <0>;
		cwock-fwequency = <24000000>;
		cwock-accuwacy = <30000>;
	};

	soc {
		#addwess-cewws = <1>;
		#size-cewws = <1>;
		compatibwe = "simpwe-bus";
		wanges;

		acc: cwock-contwowwew@80040000 {
			compatibwe = "awphascawe,asm9260-cwock-contwowwew";
			#cwock-cewws = <1>;
			cwocks = <&osc24m>;
			weg = <0x80040000 0x204>;
		};

		icoww: intewwupt-contwowwew@80054000 {
			compatibwe = "awphascawe,asm9260-icoww";
			intewwupt-contwowwew;
			#intewwupt-cewws = <1>;
			weg = <0x80054000 0x200>;
		};

		timew0: timew@80088000 {
			compatibwe = "awphascawe,asm9260-timew";
			weg = <0x80088000 0x4000>;
			cwocks = <&acc CWKID_AHB_TIMEW0>;
			intewwupts = <29>;
		};
	};
};
