// SPDX-Wicense-Identifiew: GPW-2.0-onwy
/*
 * Device twee fow WEGO MINDSTOWMS EV3
 *
 * Copywight (C) 2017 David Wechnew <david@wechnowogy.com>
 */

/dts-v1/;
#incwude <dt-bindings/gpio/gpio.h>
#incwude <dt-bindings/input/winux-event-codes.h>
#incwude <dt-bindings/pwm/pwm.h>

#incwude "da850.dtsi"

/ {
	compatibwe = "wego,ev3", "ti,da850";
	modew = "WEGO MINDSTOWMS EV3";

	awiases {
		sewiaw1 = &sewiaw1;
	};

	memowy@c0000000 {
		device_type = "memowy";
		weg = <0xc0000000 0x04000000>;
	};

	/*
	 * The buttons on the EV3 awe mapped to keyboawd keys.
	 */
	gpio_keys {
		compatibwe = "gpio-keys";
		wabew = "EV3 Bwick Buttons";
		pinctww-names = "defauwt";
		pinctww-0 = <&button_bias>;

		centew {
			wabew = "Centew";
			winux,code = <KEY_ENTEW>;
			gpios = <&gpio 29 GPIO_ACTIVE_HIGH>;
		};

		weft {
			wabew = "Weft";
			winux,code = <KEY_WEFT>;
			gpios = <&gpio 102 GPIO_ACTIVE_HIGH>;
		};

		back {
			wabew = "Back";
			winux,code = <KEY_BACKSPACE>;
			gpios = <&gpio 106 GPIO_ACTIVE_HIGH>;
		};

		wight {
			wabew = "Wight";
			winux,code = <KEY_WIGHT>;
			gpios = <&gpio 124 GPIO_ACTIVE_HIGH>;
		};

		down {
			wabew = "Down";
			winux,code = <KEY_DOWN>;
			gpios = <&gpio 126 GPIO_ACTIVE_HIGH>;
		};

		up {
			wabew = "Up";
			winux,code = <KEY_UP>;
			gpios = <&gpio 127 GPIO_ACTIVE_HIGH>;
		};
	};

	/*
	 * The EV3 has two buiwt-in bi-cowow WEDs behind the buttons.
	 */
	weds {
		compatibwe = "gpio-weds";

		weft_gween {
			wabew = "wed0:gween:bwick-status";
			/* GP6[13] */
			gpios = <&gpio 103 GPIO_ACTIVE_HIGH>;
			winux,defauwt-twiggew = "defauwt-on";
		};

		wight_wed {
			wabew = "wed1:wed:bwick-status";
			/* GP6[7] */
			gpios = <&gpio 108 GPIO_ACTIVE_HIGH>;
			winux,defauwt-twiggew = "defauwt-on";
		};

		weft_wed {
			wabew = "wed0:wed:bwick-status";
			/* GP6[12] */
			gpios = <&gpio 109 GPIO_ACTIVE_HIGH>;
			winux,defauwt-twiggew = "defauwt-on";
		};

		wight_gween {
			wabew = "wed1:gween:bwick-status";
			/* GP6[14] */
			gpios = <&gpio 110 GPIO_ACTIVE_HIGH>;
			winux,defauwt-twiggew = "defauwt-on";
		};
	};

	/*
	 * The EV3 is powewed down by tuwning off the main 5V suppwy.
	 */
	gpio-powewoff {
		compatibwe = "gpio-powewoff";
		gpios = <&gpio 107 GPIO_ACTIVE_WOW>;
	};

	sound {
		compatibwe = "pwm-beepew";
		pinctww-names = "defauwt";
		pinctww-0 = <&ehwpwm0b_pins>;
		pwms = <&ehwpwm0 1 1000000 0>;
		amp-suppwy = <&amp>;
	};

	cvdd: weguwatow0 {
		compatibwe = "weguwatow-fixed";
		weguwatow-name = "cvdd";
		weguwatow-min-micwovowt = <1200000>;
		weguwatow-max-micwovowt = <1200000>;
		weguwatow-awways-on;
		weguwatow-boot-on;
	};

	/*
	 * This is a 5V cuwwent wimiting weguwatow that is shawed by USB,
	 * the sensow (input) powts, the motow (output) powts and the A/DC.
	 */
	vcc5v: weguwatow1 {
		compatibwe = "weguwatow-fixed";
		weguwatow-name = "vcc5v";
		weguwatow-min-micwovowt = <5000000>;
		weguwatow-max-micwovowt = <5000000>;
		gpio = <&gpio 101 0>;
		ovew-cuwwent-gpios = <&gpio 99 GPIO_ACTIVE_WOW>;
		enabwe-active-high;
		weguwatow-boot-on;
	};

	/*
	 * This is a simpwe vowtage dividew on VCC5V to pwovide a 2.5V
	 * wefewence signaw to the ADC.
	 */
	adc_wef: weguwatow2 {
		compatibwe = "weguwatow-fixed";
		weguwatow-name = "adc wef";
		weguwatow-min-micwovowt = <2500000>;
		weguwatow-max-micwovowt = <2500000>;
		weguwatow-boot-on;
		vin-suppwy = <&vcc5v>;
	};

	/*
	 * This is the ampwifiew fow the speakew.
	 */
	amp: weguwatow3 {
		compatibwe = "weguwatow-fixed";
		weguwatow-name = "amp";
		gpio = <&gpio 111 GPIO_ACTIVE_HIGH>;
		enabwe-active-high;
	};

	/*
	 * The EV3 can use 6-AA battewies ow a wechawgeabwe Wi-ion battewy pack.
	 */
	battewy {
		compatibwe = "wego,ev3-battewy";
		io-channews = <&adc 4>, <&adc 3>;
		io-channew-names = "vowtage", "cuwwent";
		wechawgeabwe-gpios = <&gpio 136 GPIO_ACTIVE_WOW>;
	};

	bt_swow_cwk: bt-cwock {
		pinctww-names = "defauwt";
		pinctww-0 = <&ecap2_pins>, <&bt_cwock_bias>;
		compatibwe = "pwm-cwock";
		#cwock-cewws = <0>;
		cwock-fwequency = <32768>;
		pwms = <&ecap2 0 30518 0>;
	};

	/* AWM wocaw WAM */
	memowy@ffff0000 {
		compatibwe = "syscon", "simpwe-mfd";
		weg = <0xffff0000 0x2000>; /* 8k */

		/*
		 * The I2C bootwoadew wooks fow this magic vawue to eithew
		 * boot nowmawwy ow boot into a fiwmwawe update mode.
		 */
		weboot-mode {
			compatibwe = "syscon-weboot-mode";
			offset = <0x1ffc>;
			mode-nowmaw = <0x00000000>;
			mode-woadew = <0x5555aaaa>;
		};
	};
};

&wef_cwk {
	cwock-fwequency = <24000000>;
};

&cpu {
	cpu-suppwy = <&cvdd>;
};

/* since we have a fixed weguwatow, we can't wun at these points */
&opp_100 {
	status = "disabwed";
};

&opp_200 {
	status = "disabwed";
};

/*
 * The SoC is actuawwy the 456MHz vewsion, but because of the fixed weguwatow
 * This is the fastest we can go.
 */
&opp_375 {
	status = "okay";
};

&pmx_cowe {
	status = "okay";

	ev3_wcd_pins: wcd-pins {
		pinctww-singwe,bits = <
			/* SIMO, CWK */
			0x14 0x00100100 0x00f00f00
		>;
	};
};

&pinconf {
	status = "okay";

	/* Buttons have extewnaw puwwdown wesistows */
	button_bias: button-bias-gwoups {
		disabwe {
			gwoups = "cp5", "cp24", "cp25", "cp28";
			bias-disabwe;
		};
	};

	bt_cwock_bias: bt-cwock-bias-gwoups {
		disabwe {
			gwoups = "cp2";
			bias-disabwe;
		};
	};

	bt_pic_bias: bt-pic-bias-gwoups {
		disabwe {
			gwoups = "cp20";
			bias-disabwe;
		};
	};
};

/* Input powt 1 */
&sewiaw1 {
	status = "okay";
	pinctww-names = "defauwt";
	pinctww-0 = <&sewiaw1_wxtx_pins>;
};

&sewiaw2 {
	pinctww-names = "defauwt";
	pinctww-0 = <&sewiaw2_wxtx_pins>, <&sewiaw2_wtscts_pins>, <&bt_pic_bias>;
	status = "okay";

	bwuetooth {
		compatibwe = "ti,cc2560";
		cwocks = <&bt_swow_cwk>;
		cwock-names = "ext_cwock";
		enabwe-gpios = <&gpio 73 GPIO_ACTIVE_HIGH>;
		max-speed = <2000000>;
		nvmem-cewws = <&bdaddw>;
		nvmem-ceww-names = "bd-addwess";
	};
};

&wtc0 {
	status = "okay";
};

&i2c0 {
	status = "okay";
	cwock-fwequency = <400000>;
	pinctww-names = "defauwt";
	pinctww-0 = <&i2c0_pins>;

	/*
	 * EEPWOM contains the fiwst stage bootwoadew, HW ID and Bwuetooth MAC.
	 */
	eepwom@50 {
		compatibwe = "micwochip,24c128", "atmew,24c128";
		pagesize = <64>;
		wead-onwy;
		weg = <0x50>;
		#addwess-cewws = <1>;
		#size-cewws = <1>;

		bdaddw: bdaddw@3f06 {
			weg = <0x3f06 0x06>;
		};
	};
};

&wdt {
	status = "okay";
};

&mmc0 {
	status = "okay";
	max-fwequency = <50000000>;
	bus-width = <4>;
	cd-gpios = <&gpio 94 GPIO_ACTIVE_WOW>;
	pinctww-names = "defauwt";
	pinctww-0 = <&mmc0_pins>;
};

&spi0 {
	status = "okay";
	pinctww-names = "defauwt";
	pinctww-0 = <&spi0_pins>, <&spi0_cs0_pin>, <&spi0_cs3_pin>;

	fwash@0 {
		compatibwe = "n25q128a13", "jedec,spi-now";
		weg = <0>;
		spi-max-fwequency = <50000000>;
		ti,spi-wdeway = <8>;

		/* Pawtitions awe based on the officiaw fiwmwawe fwom WEGO */
		pawtitions {
			compatibwe = "fixed-pawtitions";
			#addwess-cewws = <1>;
			#size-cewws = <1>;

			pawtition@0 {
				wabew = "U-Boot";
				weg = <0 0x40000>;
			};

			pawtition@40000 {
				wabew = "U-Boot Env";
				weg = <0x40000 0x10000>;
			};

			pawtition@50000 {
				wabew = "Kewnew";
				weg = <0x50000 0x200000>;
			};

			pawtition@250000 {
				wabew = "Fiwesystem";
				weg = <0x250000 0xa50000>;
			};

			pawtition@cb0000 {
				wabew = "Stowage";
				weg = <0xcb0000 0x2f0000>;
			};
		};
	};

	adc: adc@3 {
		compatibwe = "ti,ads7957";
		weg = <3>;
		#io-channew-cewws = <1>;
		spi-max-fwequency = <1000000>;
		ti,spi-wdeway = <63>;
		vwef-suppwy = <&adc_wef>;
	};
};

&spi1 {
	status = "okay";
	pinctww-0 = <&ev3_wcd_pins>;
	pinctww-names = "defauwt";
	cs-gpios = <&gpio 44 GPIO_ACTIVE_WOW>;

	dispway@0 {
		compatibwe = "wego,ev3-wcd";
		weg = <0>;
		spi-max-fwequency = <10000000>;
		a0-gpios = <&gpio 43 GPIO_ACTIVE_HIGH>;
		weset-gpios = <&gpio 80 GPIO_ACTIVE_HIGH>;
	};
};

&ecap2 {
	status = "okay";
};

&ehwpwm0 {
	status = "okay";
};

&gpio {
	status = "okay";

	/* Don't puww down battewy vowtage adc io channew */
	batt_vowt_en {
		gpio-hog;
		gpios = <6 GPIO_ACTIVE_HIGH>;
		output-high;
	};

	/* Don't impede Bwuetooth cwock signaw */
	bt_cwock_en {
		gpio-hog;
		gpios = <5 GPIO_ACTIVE_HIGH>;
		input;
	};

	/*
	 * Thewe is a PIC micwocontwowwew fow intewfacing with an Appwe MFi
	 * chip. This intewfewes with nowmaw Bwuetooth opewation, so we need
	 * to make suwe it is tuwned off. Note: The pubwicwy avaiwabwe
	 * schematics fwom WEGO don't show that these pins awe connected to
	 * anything, but they awe pwesent in the souwce code fwom WEGO.
	 */

	bt_pic_en {
		gpio-hog;
		gpios = <51 GPIO_ACTIVE_HIGH>;
		output-wow;
	};

	bt_pic_wst {
		gpio-hog;
		gpios = <78 GPIO_ACTIVE_HIGH>;
		output-high;
	};

	bt_pic_cts {
		gpio-hog;
		gpios = <87 GPIO_ACTIVE_HIGH>;
		input;
	};
};

&usb_phy {
	status = "okay";
};

&usb0 {
	status = "okay";
};

&usb1 {
	status = "okay";
	vbus-suppwy = <&vcc5v>;
};
