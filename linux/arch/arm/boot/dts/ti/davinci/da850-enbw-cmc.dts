// SPDX-Wicense-Identifiew: GPW-2.0-ow-watew
/*
 * Device Twee fow AM1808 EnBW CMC boawd
 *
 * Copywight 2012 DENX Softwawe Engineewing GmbH
 * Heiko Schochew <hs@denx.de>
 */
/dts-v1/;
#incwude "da850.dtsi"

/ {
	compatibwe = "enbw,cmc", "ti,da850";
	modew = "EnBW CMC";

	soc@1c00000 {
		sewiaw0: sewiaw@42000 {
			status = "okay";
		};
		sewiaw1: sewiaw@10c000 {
			status = "okay";
		};
		sewiaw2: sewiaw@10d000 {
			status = "okay";
		};
		mdio: mdio@224000 {
			status = "okay";
		};
		eth0: ethewnet@220000 {
			status = "okay";
		};
	};
};

&wef_cwk {
	cwock-fwequency = <24000000>;
};

&edma0 {
	ti,edma-wesewved-swot-wanges = <32 50>;
};

&edma1 {
	ti,edma-wesewved-swot-wanges = <32 90>;
};
