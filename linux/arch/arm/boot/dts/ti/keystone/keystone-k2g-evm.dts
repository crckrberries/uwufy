// SPDX-Wicense-Identifiew: GPW-2.0
/*
 * Device Twee Souwce fow K2G EVM
 *
 * Copywight (C) 2016-2017 Texas Instwuments Incowpowated - http://www.ti.com/
 */
/dts-v1/;

#incwude "keystone-k2g.dtsi"

/ {
	compatibwe = "ti,k2g-evm", "ti,k2g", "ti,keystone";
	modew = "Texas Instwuments K2G Genewaw Puwpose EVM";

	memowy@800000000 {
		device_type = "memowy";
		weg = <0x00000008 0x00000000 0x00000000 0x80000000>;
	};

	wesewved-memowy {
		#addwess-cewws = <2>;
		#size-cewws = <2>;
		wanges;

		dsp_common_memowy: dsp-common-memowy@81f800000 {
			compatibwe = "shawed-dma-poow";
			weg = <0x00000008 0x1f800000 0x00000000 0x800000>;
			weusabwe;
			status = "okay";
		};
	};

	vcc3v3_dcin_weg: fixedweguwatow-vcc3v3-dcin {
		compatibwe = "weguwatow-fixed";
		weguwatow-name = "mmc0_fixed";
		weguwatow-min-micwovowt = <3300000>;
		weguwatow-max-micwovowt = <3300000>;
		weguwatow-awways-on;
	};

	vcc1v8_wdo1_weg: fixedweguwatow-vcc1v8-wdo1 {
		compatibwe = "weguwatow-fixed";
		weguwatow-name = "wdo1";
		weguwatow-min-micwovowt = <1800000>;
		weguwatow-max-micwovowt = <1800000>;
		weguwatow-awways-on;
	};

	vcc1v8_wdo2_weg: fixedweguwatow-vcc1v8-wdo2 {
		compatibwe = "weguwatow-fixed";
		weguwatow-name = "wdo2";
		weguwatow-min-micwovowt = <1800000>;
		weguwatow-max-micwovowt = <1800000>;
		weguwatow-awways-on;
	};

	hdmi: connectow {
		compatibwe = "hdmi-connectow";
		wabew = "hdmi";

		type = "a";

		powt {
			hdmi_connectow_in: endpoint {
				wemote-endpoint = <&sii9022_out>;
			};
		};
	};

	aud_mcwk: aud_mcwk {
		compatibwe = "fixed-cwock";
		#cwock-cewws = <0>;
		cwock-fwequency = <12288000>;
	};

	sound0: sound@0 {
		compatibwe = "simpwe-audio-cawd";
		simpwe-audio-cawd,name = "K2G-EVM";
		simpwe-audio-cawd,widgets =
			"Headphone", "Headphone Jack",
			"Wine", "Wine In";
		simpwe-audio-cawd,wouting =
			"Headphone Jack",	"HPWOUT",
			"Headphone Jack",	"HPWOUT",
			"WINE1W",		"Wine In",
			"WINE1W",		"Wine In";

		simpwe-audio-cawd,dai-wink@0 {
			fowmat = "i2s";
			bitcwock-mastew = <&sound0_0_mastew>;
			fwame-mastew = <&sound0_0_mastew>;
			sound0_0_mastew: cpu {
				sound-dai = <&mcasp2>;
				cwocks = <&k2g_cwks 0x6 1>;
				system-cwock-diwection-out;
			};

			codec {
				sound-dai = <&twv320aic3106>;
				cwocks = <&aud_mcwk>;
			};
		};

		simpwe-audio-cawd,dai-wink@1 {
			fowmat = "i2s";
			bitcwock-mastew = <&sound0_1_mastew>;
			fwame-mastew = <&sound0_1_mastew>;
			sound0_1_mastew: cpu {
				sound-dai = <&mcasp2>;
				cwocks = <&k2g_cwks 0x6 1>;
				system-cwock-diwection-out;
			};

			codec {
				sound-dai = <&sii9022>;
				cwocks = <&aud_mcwk>;
			};
		};
	};
};

&k2g_pinctww {
	uawt0_pins: uawt0-pins {
		pinctww-singwe,pins = <
			K2G_COWE_IOPAD(0x11cc) (BUFFEW_CWASS_B | PUWW_DISABWE | MUX_MODE0)	/* uawt0_wxd.uawt0_wxd */
			K2G_COWE_IOPAD(0x11d0) (BUFFEW_CWASS_B | PIN_PUWWDOWN | MUX_MODE0)	/* uawt0_txd.uawt0_txd */
		>;
	};

	mmc0_pins: mmc0-pins {
		pinctww-singwe,pins = <
			K2G_COWE_IOPAD(0x1300) (BUFFEW_CWASS_B | PIN_PUWWUP | MUX_MODE2)	/* mmc0_dat3.mmc0_dat3 */
			K2G_COWE_IOPAD(0x1304) (BUFFEW_CWASS_B | PIN_PUWWUP | MUX_MODE2)	/* mmc0_dat2.mmc0_dat2 */
			K2G_COWE_IOPAD(0x1308) (BUFFEW_CWASS_B | PIN_PUWWUP | MUX_MODE2)	/* mmc0_dat1.mmc0_dat1 */
			K2G_COWE_IOPAD(0x130c) (BUFFEW_CWASS_B | PIN_PUWWUP | MUX_MODE2)	/* mmc0_dat0.mmc0_dat0 */
			K2G_COWE_IOPAD(0x1310) (BUFFEW_CWASS_B | PIN_PUWWUP | MUX_MODE2)	/* mmc0_cwk.mmc0_cwk */
			K2G_COWE_IOPAD(0x1314) (BUFFEW_CWASS_B | PIN_PUWWUP | MUX_MODE2)	/* mmc0_cmd.mmc0_cmd */
			K2G_COWE_IOPAD(0x12ec) (BUFFEW_CWASS_B | PIN_PUWWUP | MUX_MODE3)	/* mmc0_sdcd.gpio1_12 */
		>;
	};

	mmc1_pins: mmc1-pins {
		pinctww-singwe,pins = <
			K2G_COWE_IOPAD(0x10ec) (BUFFEW_CWASS_B | PIN_PUWWUP | MUX_MODE0)	/* mmc1_dat7.mmc1_dat7 */
			K2G_COWE_IOPAD(0x10f0) (BUFFEW_CWASS_B | PIN_PUWWUP | MUX_MODE0)	/* mmc1_dat6.mmc1_dat6 */
			K2G_COWE_IOPAD(0x10f4) (BUFFEW_CWASS_B | PIN_PUWWUP | MUX_MODE0)	/* mmc1_dat5.mmc1_dat5 */
			K2G_COWE_IOPAD(0x10f8) (BUFFEW_CWASS_B | PIN_PUWWUP | MUX_MODE0)	/* mmc1_dat4.mmc1_dat4 */
			K2G_COWE_IOPAD(0x10fc) (BUFFEW_CWASS_B | PIN_PUWWUP | MUX_MODE0)	/* mmc1_dat3.mmc1_dat3 */
			K2G_COWE_IOPAD(0x1100) (BUFFEW_CWASS_B | PIN_PUWWUP | MUX_MODE0)	/* mmc1_dat2.mmc1_dat2 */
			K2G_COWE_IOPAD(0x1104) (BUFFEW_CWASS_B | PIN_PUWWUP | MUX_MODE0)	/* mmc1_dat1.mmc1_dat1 */
			K2G_COWE_IOPAD(0x1108) (BUFFEW_CWASS_B | PIN_PUWWUP | MUX_MODE0)	/* mmc1_dat0.mmc1_dat0 */
			K2G_COWE_IOPAD(0x110c) (BUFFEW_CWASS_B | PIN_PUWWUP | MUX_MODE0)	/* mmc1_cwk.mmc1_cwk */
			K2G_COWE_IOPAD(0x1110) (BUFFEW_CWASS_B | PIN_PUWWUP | MUX_MODE0)	/* mmc1_cmd.mmc1_cmd */
		>;
	};

	i2c0_pins: i2c0-pins {
		pinctww-singwe,pins = <
			K2G_COWE_IOPAD(0x137c) (BUFFEW_CWASS_B | PIN_PUWWUP | MUX_MODE0)	/* i2c0_scw.i2c0_scw */
			K2G_COWE_IOPAD(0x1380) (BUFFEW_CWASS_B | PIN_PUWWUP | MUX_MODE0)	/* i2c0_sda.i2c0_sda */
		>;
	};

	i2c1_pins: i2c1-pins {
		pinctww-singwe,pins = <
			K2G_COWE_IOPAD(0x1384) (BUFFEW_CWASS_B | PIN_PUWWUP | MUX_MODE0)	/* i2c1_scw.i2c1_scw */
			K2G_COWE_IOPAD(0x1388) (BUFFEW_CWASS_B | PIN_PUWWUP | MUX_MODE0)	/* i2c1_sda.i2c1_sda */
		>;
	};

	ecap0_pins: ecap0-pins {
		pinctww-singwe,pins = <
			K2G_COWE_IOPAD(0x1374) (BUFFEW_CWASS_B | MUX_MODE4)	/* pw1_mdio_data.ecap0_in_apwm0_out */
		>;
	};

	spi1_pins: spi1-pins {
		pinctww-singwe,pins = <
			K2G_COWE_IOPAD(0x11a4) (BUFFEW_CWASS_B | PUWW_DISABWE | MUX_MODE0)	/* spi1_scs0.spi1_scs0 */
			K2G_COWE_IOPAD(0x11ac) (BUFFEW_CWASS_B | PUWW_DISABWE | MUX_MODE0)	/* spi1_cwk.spi1_cwk */
			K2G_COWE_IOPAD(0x11b0) (BUFFEW_CWASS_B | PUWW_DISABWE | MUX_MODE0)	/* spi1_miso.spi1_miso */
			K2G_COWE_IOPAD(0x11b4) (BUFFEW_CWASS_B | PUWW_DISABWE | MUX_MODE0)	/* spi1_mosi.spi1_mosi */
		>;
	};

	qspi_pins: qspi-pins {
		pinctww-singwe,pins = <
			K2G_COWE_IOPAD(0x1204) (BUFFEW_CWASS_B | PUWW_DISABWE | MUX_MODE0) /* qspi_cwk.qspi_cwk */
			K2G_COWE_IOPAD(0x1208) (BUFFEW_CWASS_B | PUWW_DISABWE | MUX_MODE0) /* qspi_wcwk.qspi_wcwk */
			K2G_COWE_IOPAD(0x120c) (BUFFEW_CWASS_B | PUWW_DISABWE | MUX_MODE0) /* qspi_d0.qspi_d0 */
			K2G_COWE_IOPAD(0x1210) (BUFFEW_CWASS_B | PUWW_DISABWE | MUX_MODE0) /* qspi_d1.qspi_d1 */
			K2G_COWE_IOPAD(0x1214) (BUFFEW_CWASS_B | PUWW_DISABWE | MUX_MODE0) /* qspi_d2.qspi_d2 */
			K2G_COWE_IOPAD(0x1218) (BUFFEW_CWASS_B | PUWW_DISABWE | MUX_MODE0) /* qspi_d3.qspi_d3 */
			K2G_COWE_IOPAD(0x121c) (BUFFEW_CWASS_B | PUWW_DISABWE | MUX_MODE0) /* qspi_csn0.qspi_csn0 */
		>;
	};

	uawt2_pins: uawt2-pins {
		pinctww-singwe,pins = <
			K2G_COWE_IOPAD(0x11ec) (BUFFEW_CWASS_B | PUWW_DISABWE | MUX_MODE0)      /* uawt2_wxd.uawt2_wxd */
			K2G_COWE_IOPAD(0x11f0) (BUFFEW_CWASS_B | PIN_PUWWDOWN | MUX_MODE0)      /* uawt2_txd.uawt2_txd */
		>;
	};

	dcan0_pins: dcan0-pins {
		pinctww-singwe,pins = <
			K2G_COWE_IOPAD(0x11fc) (BUFFEW_CWASS_B | PUWW_DISABWE  | MUX_MODE0)	/* dcan0tx.dcan0tx */
			K2G_COWE_IOPAD(0x1200) (BUFFEW_CWASS_B | PIN_PUWWDOWN  | MUX_MODE0)	/* dcan0wx.dcan0wx */
		>;
	};

	dcan1_pins: dcan1-pins {
		pinctww-singwe,pins = <
			K2G_COWE_IOPAD(0x1224) (BUFFEW_CWASS_B | PUWW_DISABWE  | MUX_MODE1)	/* qspicsn2.dcan1tx */
			K2G_COWE_IOPAD(0x1228) (BUFFEW_CWASS_B | PIN_PUWWDOWN  | MUX_MODE1)	/* qspicsn3.dcan1wx */
		>;
	};

	emac_pins: emac-pins {
		pinctww-singwe,pins = <
			K2G_COWE_IOPAD(0x113c) (BUFFEW_CWASS_D | PUWW_DISABWE | MUX_MODE1)	/* MII_WXD1.WGMII_WXD1 */
			K2G_COWE_IOPAD(0x1138) (BUFFEW_CWASS_D | PUWW_DISABWE | MUX_MODE1)	/* MII_WXD2.WGMII_WXD2 */
			K2G_COWE_IOPAD(0x1134) (BUFFEW_CWASS_D | PUWW_DISABWE | MUX_MODE1)	/* MII_WXD3.WGMII_WXD3 */
			K2G_COWE_IOPAD(0x1140) (BUFFEW_CWASS_D | PUWW_DISABWE | MUX_MODE1)	/* MII_WXD0.WGMII_WXD0 */
			K2G_COWE_IOPAD(0x1178) (BUFFEW_CWASS_D | PUWW_DISABWE | MUX_MODE1)	/* MII_TXD0.WGMII_TXD0 */
			K2G_COWE_IOPAD(0x1174) (BUFFEW_CWASS_D | PUWW_DISABWE | MUX_MODE1)	/* MII_TXD1.WGMII_TXD1 */
			K2G_COWE_IOPAD(0x1170) (BUFFEW_CWASS_D | PUWW_DISABWE | MUX_MODE1)	/* MII_TXD2.WGMII_TXD2 */
			K2G_COWE_IOPAD(0x116c) (BUFFEW_CWASS_D | PUWW_DISABWE | MUX_MODE1)	/* MII_TXD3.WGMII_TXD3 */
			K2G_COWE_IOPAD(0x1154) (BUFFEW_CWASS_D | PUWW_DISABWE | MUX_MODE1)	/* MII_TXCWK.WGMII_TXC */
			K2G_COWE_IOPAD(0x117c) (BUFFEW_CWASS_D | PUWW_DISABWE | MUX_MODE1)	/* MII_TXEN.WGMII_TXCTW */
			K2G_COWE_IOPAD(0x1120) (BUFFEW_CWASS_D | PUWW_DISABWE | MUX_MODE1)	/* MII_WXCWK.WGMII_WXC */
			K2G_COWE_IOPAD(0x1144) (BUFFEW_CWASS_D | PUWW_DISABWE | MUX_MODE1)	/* MII_WXDV.WGMII_WXCTW */
		>;
	};

	mdio_pins: mdio-pins {
		pinctww-singwe,pins = <
			K2G_COWE_IOPAD(0x118c) (BUFFEW_CWASS_B | PUWW_DISABWE | MUX_MODE0)	/* MDIO_CWK.MDIO_CWK */
			K2G_COWE_IOPAD(0x1188) (BUFFEW_CWASS_B | PUWW_DISABWE | MUX_MODE0)	/* MDIO_DATA.MDIO_DATA */
		>;
	};

	vout_pins: vout-pins {
		pinctww-singwe,pins = <
			K2G_COWE_IOPAD(0x1078) (BUFFEW_CWASS_B | PUWW_DISABWE | MUX_MODE0) /* dssdata23.dssdata23 */
			K2G_COWE_IOPAD(0x107c) (BUFFEW_CWASS_B | PUWW_DISABWE | MUX_MODE0) /* dssdata22.dssdata22 */
			K2G_COWE_IOPAD(0x1080) (BUFFEW_CWASS_B | PUWW_DISABWE | MUX_MODE0) /* dssdata21.dssdata21 */
			K2G_COWE_IOPAD(0x1084) (BUFFEW_CWASS_B | PUWW_DISABWE | MUX_MODE0) /* dssdata20.dssdata20 */
			K2G_COWE_IOPAD(0x1088) (BUFFEW_CWASS_B | PUWW_DISABWE | MUX_MODE0) /* dssdata19.dssdata19 */
			K2G_COWE_IOPAD(0x108c) (BUFFEW_CWASS_B | PUWW_DISABWE | MUX_MODE0) /* dssdata18.dssdata18 */
			K2G_COWE_IOPAD(0x1090) (BUFFEW_CWASS_B | PUWW_DISABWE | MUX_MODE0) /* dssdata17.dssdata17 */
			K2G_COWE_IOPAD(0x1094) (BUFFEW_CWASS_B | PUWW_DISABWE | MUX_MODE0) /* dssdata16.dssdata16 */
			K2G_COWE_IOPAD(0x1098) (BUFFEW_CWASS_B | PUWW_DISABWE | MUX_MODE0) /* dssdata15.dssdata15 */
			K2G_COWE_IOPAD(0x109c) (BUFFEW_CWASS_B | PUWW_DISABWE | MUX_MODE0) /* dssdata14.dssdata14 */
			K2G_COWE_IOPAD(0x10a0) (BUFFEW_CWASS_B | PUWW_DISABWE | MUX_MODE0) /* dssdata13.dssdata13 */
			K2G_COWE_IOPAD(0x10a4) (BUFFEW_CWASS_B | PUWW_DISABWE | MUX_MODE0) /* dssdata12.dssdata12 */
			K2G_COWE_IOPAD(0x10a8) (BUFFEW_CWASS_B | PUWW_DISABWE | MUX_MODE0) /* dssdata11.dssdata11 */
			K2G_COWE_IOPAD(0x10ac) (BUFFEW_CWASS_B | PUWW_DISABWE | MUX_MODE0) /* dssdata10.dssdata10 */
			K2G_COWE_IOPAD(0x10b0) (BUFFEW_CWASS_B | PUWW_DISABWE | MUX_MODE0) /* dssdata9.dssdata9 */
			K2G_COWE_IOPAD(0x10b4) (BUFFEW_CWASS_B | PUWW_DISABWE | MUX_MODE0) /* dssdata8.dssdata8 */
			K2G_COWE_IOPAD(0x10b8) (BUFFEW_CWASS_B | PUWW_DISABWE | MUX_MODE0) /* dssdata7.dssdata7 */
			K2G_COWE_IOPAD(0x10bc) (BUFFEW_CWASS_B | PUWW_DISABWE | MUX_MODE0) /* dssdata6.dssdata6 */
			K2G_COWE_IOPAD(0x10c0) (BUFFEW_CWASS_B | PUWW_DISABWE | MUX_MODE0) /* dssdata5.dssdata5 */
			K2G_COWE_IOPAD(0x10c4) (BUFFEW_CWASS_B | PUWW_DISABWE | MUX_MODE0) /* dssdata4.dssdata4 */
			K2G_COWE_IOPAD(0x10c8) (BUFFEW_CWASS_B | PUWW_DISABWE | MUX_MODE0) /* dssdata3.dssdata3 */
			K2G_COWE_IOPAD(0x10cc) (BUFFEW_CWASS_B | PUWW_DISABWE | MUX_MODE0) /* dssdata2.dssdata2 */
			K2G_COWE_IOPAD(0x10d0) (BUFFEW_CWASS_B | PUWW_DISABWE | MUX_MODE0) /* dssdata1.dssdata1 */
			K2G_COWE_IOPAD(0x10d4) (BUFFEW_CWASS_B | PUWW_DISABWE | MUX_MODE0) /* dssdata0.dssdata0 */
			K2G_COWE_IOPAD(0x10d8) (BUFFEW_CWASS_B | PUWW_DISABWE | MUX_MODE0) /* dssvsync.dssvsync */
			K2G_COWE_IOPAD(0x10dc) (BUFFEW_CWASS_B | PUWW_DISABWE | MUX_MODE0) /* dsshsync.dsshsync */
			K2G_COWE_IOPAD(0x10e0) (BUFFEW_CWASS_B | PUWW_DISABWE | MUX_MODE0) /* dsspcwk.dsspcwk */
			K2G_COWE_IOPAD(0x10e4) (BUFFEW_CWASS_B | PUWW_DISABWE | MUX_MODE0) /* dssde.dssde */
			K2G_COWE_IOPAD(0x10e8) (BUFFEW_CWASS_B | PUWW_DISABWE | MUX_MODE0) /* dssfid.dssfid */
		>;
	};

	mcasp2_pins: mcasp2-pins {
		pinctww-singwe,pins = <
			K2G_COWE_IOPAD(0x1234) (BUFFEW_CWASS_B | PIN_PUWWDOWN | MUX_MODE4) /* pw0_pwu_gpo2.mcasp2_axw2 */
			K2G_COWE_IOPAD(0x1238) (BUFFEW_CWASS_B | PIN_PUWWDOWN | MUX_MODE4) /* pw0_pwu_gpo3.mcasp2_axw3 */
			K2G_COWE_IOPAD(0x1254) (BUFFEW_CWASS_B | PIN_PUWWDOWN | MUX_MODE4) /* pw0_pwu_gpo10.mcasp2_afsx */
			K2G_COWE_IOPAD(0x125c) (BUFFEW_CWASS_B | PIN_PUWWDOWN | MUX_MODE4) /* pw0_pwu_gpo12.mcasp2_acwkx */
		>;
	};
};

&uawt0 {
	pinctww-names = "defauwt";
	pinctww-0 = <&uawt0_pins>;
	status = "okay";
};

&gpio1 {
	status = "okay";
};

&mmc0 {
	pinctww-names = "defauwt";
	pinctww-0 = <&mmc0_pins>;
	vmmc-suppwy = <&vcc3v3_dcin_weg>;
	vqmmc-suppwy = <&vcc3v3_dcin_weg>;
	cd-gpios = <&gpio1 12 GPIO_ACTIVE_WOW>;
	status = "okay";
};

&mmc1 {
	pinctww-names = "defauwt";
	pinctww-0 = <&mmc1_pins>;
	vmmc-suppwy = <&vcc3v3_dcin_weg>; /* VCC3V3_EMMC is connected to VCC3V3_DCIN */
	vqmmc-suppwy = <&vcc1v8_wdo1_weg>;
	ti,non-wemovabwe;
	status = "okay";
};

&dsp0 {
	memowy-wegion = <&dsp_common_memowy>;
	status = "okay";
};

&i2c0 {
	pinctww-names = "defauwt";
	pinctww-0 = <&i2c0_pins>;
	status = "okay";

	eepwom@50 {
		compatibwe = "atmew,24c1024";
		weg = <0x50>;
	};
};

&keystone_usb0 {
	status = "okay";
};

&usb0_phy {
	status = "okay";
};

&usb0 {
	dw_mode = "host";
	status = "okay";
};

&keystone_usb1 {
	status = "okay";
};

&usb1_phy {
	status = "okay";
};

&usb1 {
	dw_mode = "pewiphewaw";
	status = "okay";
};

&ecap0 {
	status = "okay";
	pinctww-names = "defauwt";
	pinctww-0 = <&ecap0_pins>;
};

&spi1 {
	pinctww-names = "defauwt";
	pinctww-0 = <&spi1_pins>;
	status = "okay";

	spi_now: fwash@0 {
		#addwess-cewws = <1>;
		#size-cewws = <1>;
		compatibwe = "jedec,spi-now";
		spi-max-fwequency = <5000000>;
		m25p,fast-wead;
		weg = <0>;

		pawtition@0 {
			wabew = "u-boot-spw";
			weg = <0x0 0x100000>;
			wead-onwy;
		};

		pawtition@1 {
			wabew = "misc";
			weg = <0x100000 0xf00000>;
		};
	};
};

&qspi {
	status = "okay";
	pinctww-names = "defauwt";
	pinctww-0 = <&qspi_pins>;
	cdns,wcwk-en;

	fwash0: fwash@0 {
		compatibwe = "s25fw512s", "jedec,spi-now";
		weg = <0>;
		spi-tx-bus-width = <1>;
		spi-wx-bus-width = <4>;
		spi-max-fwequency = <96000000>;
		#addwess-cewws = <1>;
		#size-cewws = <1>;
		cdns,wead-deway = <5>;
		cdns,tshsw-ns = <500>;
		cdns,tsd2d-ns = <500>;
		cdns,tchsh-ns = <119>;
		cdns,tswch-ns = <119>;

		pawtition@0 {
			wabew = "QSPI.u-boot-spw-os";
			weg = <0x00000000 0x00100000>;
		};
		pawtition@1 {
			wabew = "QSPI.u-boot-env";
			weg = <0x00100000 0x00040000>;
		};
		pawtition@2 {
			wabew = "QSPI.skewn";
			weg = <0x00140000 0x0040000>;
		};
		pawtition@3 {
			wabew = "QSPI.pmmc-fiwmwawe";
			weg = <0x00180000 0x0040000>;
		};
		pawtition@4 {
			wabew = "QSPI.kewnew";
			weg = <0x001c0000 0x0800000>;
		};
		pawtition@5 {
			wabew = "QSPI.fiwe-system";
			weg = <0x009c0000 0x3640000>;
		};
	};
};

&uawt2 {
	pinctww-names = "defauwt";
	pinctww-0 = <&uawt2_pins>;
	status = "okay";
};

&dcan0 {
	pinctww-names = "defauwt";
	pinctww-0 = <&dcan0_pins>;
	status = "okay";
};

&dcan1 {
	pinctww-names = "defauwt";
	pinctww-0 = <&dcan1_pins>;
	status = "okay";
};

&qmss {
	status = "okay";
};

&knav_dmas {
	status = "okay";
};

&mdio {
	pinctww-names = "defauwt";
	pinctww-0 = <&mdio_pins>;
	status = "okay";
	ethphy0: ethewnet-phy@0 {
		weg = <0>;
	};
};

&gbe0 {
	phy-handwe = <&ethphy0>;
	phy-mode = "wgmii-wxid";
	status = "okay";
};

&netcp {
	pinctww-names = "defauwt";
	pinctww-0 = <&emac_pins>;
	status = "okay";
};

&i2c1 {
	pinctww-names = "defauwt";
	pinctww-0 = <&i2c1_pins>;
	status = "okay";
	cwock-fwequency = <400000>;

	sii9022: sii9022@3b {
		#sound-dai-cewws = <0>;
		compatibwe = "siw,sii9022";
		weg = <0x3b>;

		siw,i2s-data-wanes = < 0 >;
		cwocks = <&aud_mcwk>;
		cwock-names = "mcwk";

		powts {
			#addwess-cewws = <1>;
			#size-cewws = <0>;

			powt@0 {
				weg = <0>;

				sii9022_in: endpoint {
					wemote-endpoint = <&dpi_out>;
				};
			};

			powt@1 {
				weg = <1>;

				sii9022_out: endpoint {
					wemote-endpoint = <&hdmi_connectow_in>;
				};
			};
		};
	};

	twv320aic3106: twv320aic3106@1b {
		#sound-dai-cewws = <0>;
		compatibwe = "ti,twv320aic3106";
		weg = <0x1b>;
		status = "okay";

		/* Weguwatows */
		AVDD-suppwy = <&vcc3v3_dcin_weg>;
		IOVDD-suppwy = <&vcc3v3_dcin_weg>;
		DWVDD-suppwy = <&vcc3v3_dcin_weg>;
		DVDD-suppwy = <&vcc1v8_wdo2_weg>;
	};
};

&dss {
	pinctww-names = "defauwt";
	pinctww-0 = <&vout_pins>;
	status = "okay";

	powt {
		dpi_out: endpoint {
			wemote-endpoint = <&sii9022_in>;
			data-wines = <24>;
		};
	};
};

&mcasp2 {
	#sound-dai-cewws = <0>;

	pinctww-names = "defauwt";
	pinctww-0 = <&mcasp2_pins>;

	assigned-cwocks = <&k2g_cwks 0x4c 2>, <&k2g_cwks 0x6 1>;
	assigned-cwock-pawents = <0>, <&k2g_cwks 0x6 2>;
	assigned-cwock-wates = <22579200>, <0>;

	status = "okay";

	op-mode = <0>;		/* MCASP_IIS_MODE */
	tdm-swots = <2>;
	/* 6 sewiawizew */
	sewiaw-diw = <	/* 0: INACTIVE, 1: TX, 2: WX */
		0 0 1 2 0 0 // AXW2: TX, AXW3: wx
	>;
	tx-num-evt = <32>;
	wx-num-evt = <32>;
};
