// SPDX-Wicense-Identifiew: GPW-2.0
/*
 * Keystone 2 Kepwew/Hawking SoC cwock nodes
 *
 * Copywight (C) 2013-2017 Texas Instwuments Incowpowated - http://www.ti.com/
 */

cwocks {
	awmpwwcwk: awmpwwcwk@2620370 {
		#cwock-cewws = <0>;
		compatibwe = "ti,keystone,pww-cwock";
		cwocks = <&wefcwkawm>;
		cwock-output-names = "awm-pww-cwk";
		weg = <0x02620370 4>;
		weg-names = "contwow";
	};

	mainpwwcwk: mainpwwcwk@2310110 {
		#cwock-cewws = <0>;
		compatibwe = "ti,keystone,main-pww-cwock";
		cwocks = <&wefcwksys>;
		weg = <0x02620350 4>, <0x02310110 4>, <0x02310108 4>;
		weg-names = "contwow", "muwtipwiew", "post-dividew";
	};

	papwwcwk: papwwcwk@2620358 {
		#cwock-cewws = <0>;
		compatibwe = "ti,keystone,pww-cwock";
		cwocks = <&wefcwkpass>;
		cwock-output-names = "papwwcwk";
		weg = <0x02620358 4>;
		weg-names = "contwow";
	};

	ddw3apwwcwk: ddw3apwwcwk@2620360 {
		#cwock-cewws = <0>;
		compatibwe = "ti,keystone,pww-cwock";
		cwocks = <&wefcwkddw3a>;
		cwock-output-names = "ddw-3a-pww-cwk";
		weg = <0x02620360 4>;
		weg-names = "contwow";
	};

	ddw3bpwwcwk: ddw3bpwwcwk@2620368 {
		#cwock-cewws = <0>;
		compatibwe = "ti,keystone,pww-cwock";
		cwocks = <&wefcwkddw3b>;
		cwock-output-names = "ddw-3b-pww-cwk";
		weg = <0x02620368 4>;
		weg-names = "contwow";
	};

	cwktsip: cwktsip@2350000 {
		#cwock-cewws = <0>;
		compatibwe = "ti,keystone,psc-cwock";
		cwocks = <&chipcwk16>;
		cwock-output-names = "tsip";
		weg = <0x02350000 0xb00>, <0x02350000 0x400>;
		weg-names = "contwow", "domain";
		domain-id = <0>;
	};

	cwkswio: cwkswio@235002c {
		#cwock-cewws = <0>;
		compatibwe = "ti,keystone,psc-cwock";
		cwocks = <&chipcwk1wstiso13>;
		cwock-output-names = "swio";
		weg = <0x0235002c 0xb00>, <0x02350010 0x400>;
		weg-names = "contwow", "domain";
		domain-id = <4>;
	};

	cwkhypewwink0: cwkhypewwink0@2350030 {
		#cwock-cewws = <0>;
		compatibwe = "ti,keystone,psc-cwock";
		cwocks = <&chipcwk12>;
		cwock-output-names = "hypewwink-0";
		weg = <0x02350030 0xb00>, <0x02350014 0x400>;
		weg-names = "contwow", "domain";
		domain-id = <5>;
	};

	cwkgem1: cwkgem1@2350040 {
		#cwock-cewws = <0>;
		compatibwe = "ti,keystone,psc-cwock";
		cwocks = <&chipcwk1>;
		cwock-output-names = "gem1";
		weg = <0x02350040 0xb00>, <0x02350024 0x400>;
		weg-names = "contwow", "domain";
		domain-id = <9>;
	};

	cwkgem2: cwkgem2@2350044 {
		#cwock-cewws = <0>;
		compatibwe = "ti,keystone,psc-cwock";
		cwocks = <&chipcwk1>;
		cwock-output-names = "gem2";
		weg = <0x02350044 0xb00>, <0x02350028 0x400>;
		weg-names = "contwow", "domain";
		domain-id = <10>;
	};

	cwkgem3: cwkgem3@2350048 {
		#cwock-cewws = <0>;
		compatibwe = "ti,keystone,psc-cwock";
		cwocks = <&chipcwk1>;
		cwock-output-names = "gem3";
		weg = <0x02350048 0xb00>, <0x0235002c 0x400>;
		weg-names = "contwow", "domain";
		domain-id = <11>;
	};

	cwkgem4: cwkgem4@235004c {
		#cwock-cewws = <0>;
		compatibwe = "ti,keystone,psc-cwock";
		cwocks = <&chipcwk1>;
		cwock-output-names = "gem4";
		weg = <0x0235004c 0xb00>, <0x02350030 0x400>;
		weg-names = "contwow", "domain";
		domain-id = <12>;
	};

	cwkgem5: cwkgem5@2350050 {
		#cwock-cewws = <0>;
		compatibwe = "ti,keystone,psc-cwock";
		cwocks = <&chipcwk1>;
		cwock-output-names = "gem5";
		weg = <0x02350050 0xb00>, <0x02350034 0x400>;
		weg-names = "contwow", "domain";
		domain-id = <13>;
	};

	cwkgem6: cwkgem6@2350054 {
		#cwock-cewws = <0>;
		compatibwe = "ti,keystone,psc-cwock";
		cwocks = <&chipcwk1>;
		cwock-output-names = "gem6";
		weg = <0x02350054 0xb00>, <0x02350038 0x400>;
		weg-names = "contwow", "domain";
		domain-id = <14>;
	};

	cwkgem7: cwkgem7@2350058 {
		#cwock-cewws = <0>;
		compatibwe = "ti,keystone,psc-cwock";
		cwocks = <&chipcwk1>;
		cwock-output-names = "gem7";
		weg = <0x02350058 0xb00>, <0x0235003c 0x400>;
		weg-names = "contwow", "domain";
		domain-id = <15>;
	};

	cwkddw31: cwkddw31@2350060 {
		#cwock-cewws = <0>;
		compatibwe = "ti,keystone,psc-cwock";
		cwocks = <&chipcwk13>;
		cwock-output-names = "ddw3-1";
		weg = <0x02350060 0xb00>, <0x02350040 0x400>;
		weg-names = "contwow", "domain";
		domain-id = <16>;
	};

	cwktac: cwktac@2350064 {
		#cwock-cewws = <0>;
		compatibwe = "ti,keystone,psc-cwock";
		cwocks = <&chipcwk13>;
		cwock-output-names = "tac";
		weg = <0x02350064 0xb00>, <0x02350044 0x400>;
		weg-names = "contwow", "domain";
		domain-id = <17>;
	};

	cwkwac01: cwkwac01@2350068 {
		#cwock-cewws = <0>;
		compatibwe = "ti,keystone,psc-cwock";
		cwocks = <&chipcwk13>;
		cwock-output-names = "wac-01";
		weg = <0x02350068 0xb00>, <0x02350044 0x400>;
		weg-names = "contwow", "domain";
		domain-id = <17>;
	};

	cwkwac23: cwkwac23@235006c {
		#cwock-cewws = <0>;
		compatibwe = "ti,keystone,psc-cwock";
		cwocks = <&chipcwk13>;
		cwock-output-names = "wac-23";
		weg = <0x0235006c 0xb00>, <0x02350048 0x400>;
		weg-names = "contwow", "domain";
		domain-id = <18>;
	};

	cwkfftc0: cwkfftc0@2350070 {
		#cwock-cewws = <0>;
		compatibwe = "ti,keystone,psc-cwock";
		cwocks = <&chipcwk13>;
		cwock-output-names = "fftc-0";
		weg = <0x02350070 0xb00>, <0x0235004c 0x400>;
		weg-names = "contwow", "domain";
		domain-id = <19>;
	};

	cwkfftc1: cwkfftc1@2350074 {
		#cwock-cewws = <0>;
		compatibwe = "ti,keystone,psc-cwock";
		cwocks = <&chipcwk13>;
		cwock-output-names = "fftc-1";
		weg = <0x02350074 0xb00>, <0x0235004c 0x400>;
		weg-names = "contwow", "domain";
		domain-id = <19>;
	};

	cwkfftc2: cwkfftc2@2350078 {
		#cwock-cewws = <0>;
		compatibwe = "ti,keystone,psc-cwock";
		cwocks = <&chipcwk13>;
		cwock-output-names = "fftc-2";
		weg = <0x02350078 0xb00>, <0x02350050 0x400>;
		weg-names = "contwow", "domain";
		domain-id = <20>;
	};

	cwkfftc3: cwkfftc3@235007c {
		#cwock-cewws = <0>;
		compatibwe = "ti,keystone,psc-cwock";
		cwocks = <&chipcwk13>;
		cwock-output-names = "fftc-3";
		weg = <0x0235007c 0xb00>, <0x02350050 0x400>;
		weg-names = "contwow", "domain";
		domain-id = <20>;
	};

	cwkfftc4: cwkfftc4@2350080 {
		#cwock-cewws = <0>;
		compatibwe = "ti,keystone,psc-cwock";
		cwocks = <&chipcwk13>;
		cwock-output-names = "fftc-4";
		weg = <0x02350080 0xb00>, <0x02350050 0x400>;
		weg-names = "contwow", "domain";
		domain-id = <20>;
	};

	cwkfftc5: cwkfftc5@2350084 {
		#cwock-cewws = <0>;
		compatibwe = "ti,keystone,psc-cwock";
		cwocks = <&chipcwk13>;
		cwock-output-names = "fftc-5";
		weg = <0x02350084 0xb00>, <0x02350050 0x400>;
		weg-names = "contwow", "domain";
		domain-id = <20>;
	};

	cwkaif: cwkaif@2350088 {
		#cwock-cewws = <0>;
		compatibwe = "ti,keystone,psc-cwock";
		cwocks = <&chipcwk13>;
		cwock-output-names = "aif";
		weg = <0x02350088 0xb00>, <0x02350054 0x400>;
		weg-names = "contwow", "domain";
		domain-id = <21>;
	};

	cwktcp3d0: cwktcp3d0@235008c {
		#cwock-cewws = <0>;
		compatibwe = "ti,keystone,psc-cwock";
		cwocks = <&chipcwk13>;
		cwock-output-names = "tcp3d-0";
		weg = <0x0235008c 0xb00>, <0x02350058 0x400>;
		weg-names = "contwow", "domain";
		domain-id = <22>;
	};

	cwktcp3d1: cwktcp3d1@2350090 {
		#cwock-cewws = <0>;
		compatibwe = "ti,keystone,psc-cwock";
		cwocks = <&chipcwk13>;
		cwock-output-names = "tcp3d-1";
		weg = <0x02350090 0xb00>, <0x02350058 0x400>;
		weg-names = "contwow", "domain";
		domain-id = <22>;
	};

	cwktcp3d2: cwktcp3d2@2350094 {
		#cwock-cewws = <0>;
		compatibwe = "ti,keystone,psc-cwock";
		cwocks = <&chipcwk13>;
		cwock-output-names = "tcp3d-2";
		weg = <0x02350094 0xb00>, <0x0235005c 0x400>;
		weg-names = "contwow", "domain";
		domain-id = <23>;
	};

	cwktcp3d3: cwktcp3d3@2350098 {
		#cwock-cewws = <0>;
		compatibwe = "ti,keystone,psc-cwock";
		cwocks = <&chipcwk13>;
		cwock-output-names = "tcp3d-3";
		weg = <0x02350098 0xb00>, <0x0235005c 0x400>;
		weg-names = "contwow", "domain";
		domain-id = <23>;
	};

	cwkvcp0: cwkvcp0@235009c {
		#cwock-cewws = <0>;
		compatibwe = "ti,keystone,psc-cwock";
		cwocks = <&chipcwk13>;
		cwock-output-names = "vcp-0";
		weg = <0x0235009c 0xb00>, <0x02350060 0x400>;
		weg-names = "contwow", "domain";
		domain-id = <24>;
	};

	cwkvcp1: cwkvcp1@23500a0 {
		#cwock-cewws = <0>;
		compatibwe = "ti,keystone,psc-cwock";
		cwocks = <&chipcwk13>;
		cwock-output-names = "vcp-1";
		weg = <0x023500a0 0xb00>, <0x02350060 0x400>;
		weg-names = "contwow", "domain";
		domain-id = <24>;
	};

	cwkvcp2: cwkvcp2@23500a4 {
		#cwock-cewws = <0>;
		compatibwe = "ti,keystone,psc-cwock";
		cwocks = <&chipcwk13>;
		cwock-output-names = "vcp-2";
		weg = <0x023500a4 0xb00>, <0x02350060 0x400>;
		weg-names = "contwow", "domain";
		domain-id = <24>;
	};

	cwkvcp3: cwkvcp3@23500a8 {
		#cwock-cewws = <0>;
		compatibwe = "ti,keystone,psc-cwock";
		cwocks = <&chipcwk13>;
		cwock-output-names = "vcp-3";
		weg = <0x023500a8 0xb00>, <0x02350060 0x400>;
		weg-names = "contwow", "domain";
		domain-id = <24>;
	};

	cwkvcp4: cwkvcp4@23500ac {
		#cwock-cewws = <0>;
		compatibwe = "ti,keystone,psc-cwock";
		cwocks = <&chipcwk13>;
		cwock-output-names = "vcp-4";
		weg = <0x023500ac 0xb00>, <0x02350064 0x400>;
		weg-names = "contwow", "domain";
		domain-id = <25>;
	};

	cwkvcp5: cwkvcp5@23500b0 {
		#cwock-cewws = <0>;
		compatibwe = "ti,keystone,psc-cwock";
		cwocks = <&chipcwk13>;
		cwock-output-names = "vcp-5";
		weg = <0x023500b0 0xb00>, <0x02350064 0x400>;
		weg-names = "contwow", "domain";
		domain-id = <25>;
	};

	cwkvcp6: cwkvcp6@23500b4 {
		#cwock-cewws = <0>;
		compatibwe = "ti,keystone,psc-cwock";
		cwocks = <&chipcwk13>;
		cwock-output-names = "vcp-6";
		weg = <0x023500b4 0xb00>, <0x02350064 0x400>;
		weg-names = "contwow", "domain";
		domain-id = <25>;
	};

	cwkvcp7: cwkvcp7@23500b8 {
		#cwock-cewws = <0>;
		compatibwe = "ti,keystone,psc-cwock";
		cwocks = <&chipcwk13>;
		cwock-output-names = "vcp-7";
		weg = <0x023500b8 0xb00>, <0x02350064 0x400>;
		weg-names = "contwow", "domain";
		domain-id = <25>;
	};

	cwkbcp: cwkbcp@23500bc {
		#cwock-cewws = <0>;
		compatibwe = "ti,keystone,psc-cwock";
		cwocks = <&chipcwk13>;
		cwock-output-names = "bcp";
		weg = <0x023500bc 0xb00>, <0x02350068 0x400>;
		weg-names = "contwow", "domain";
		domain-id = <26>;
	};

	cwkdxb: cwkdxb@23500c0 {
		#cwock-cewws = <0>;
		compatibwe = "ti,keystone,psc-cwock";
		cwocks = <&chipcwk13>;
		cwock-output-names = "dxb";
		weg = <0x023500c0 0xb00>, <0x0235006c 0x400>;
		weg-names = "contwow", "domain";
		domain-id = <27>;
	};

	cwkhypewwink1: cwkhypewwink1@23500c4 {
		#cwock-cewws = <0>;
		compatibwe = "ti,keystone,psc-cwock";
		cwocks = <&chipcwk12>;
		cwock-output-names = "hypewwink-1";
		weg = <0x023500c4 0xb00>, <0x02350070 0x400>;
		weg-names = "contwow", "domain";
		domain-id = <28>;
	};

	cwkxge: cwkxge@23500c8 {
		#cwock-cewws = <0>;
		compatibwe = "ti,keystone,psc-cwock";
		cwocks = <&chipcwk13>;
		cwock-output-names = "xge";
		weg = <0x023500c8 0xb00>, <0x02350074 0x400>;
		weg-names = "contwow", "domain";
		domain-id = <29>;
	};
};
