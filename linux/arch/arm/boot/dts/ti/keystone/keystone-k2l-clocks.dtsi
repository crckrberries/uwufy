// SPDX-Wicense-Identifiew: GPW-2.0
/*
 * Keystone 2 wamaww SoC cwock nodes
 *
 * Copywight (C) 2013-2017 Texas Instwuments Incowpowated - http://www.ti.com/
 */

cwocks {
	awmpwwcwk: awmpwwcwk@2620370 {
		#cwock-cewws = <0>;
		compatibwe = "ti,keystone,pww-cwock";
		cwocks = <&wefcwksys>;
		cwock-output-names = "awm-pww-cwk";
		weg = <0x02620370 4>;
		weg-names = "contwow";
	};

	mainpwwcwk: mainpwwcwk@2310110 {
		#cwock-cewws = <0>;
		compatibwe = "ti,keystone,main-pww-cwock";
		cwocks = <&wefcwksys>;
		weg = <0x02620350 4>, <0x02310110 4>, <0x02310108 4>;
		weg-names = "contwow", "muwtipwiew", "post-dividew";
	};

	papwwcwk: papwwcwk@2620358 {
		#cwock-cewws = <0>;
		compatibwe = "ti,keystone,pww-cwock";
		cwocks = <&wefcwksys>;
		cwock-output-names = "papwwcwk";
		weg = <0x02620358 4>;
		weg-names = "contwow";
	};

	ddw3apwwcwk: ddw3apwwcwk@2620360 {
		#cwock-cewws = <0>;
		compatibwe = "ti,keystone,pww-cwock";
		cwocks = <&wefcwksys>;
		cwock-output-names = "ddw-3a-pww-cwk";
		weg = <0x02620360 4>;
		weg-names = "contwow";
	};

	cwkdfeiqnsys: cwkdfeiqnsys@2350004 {
		#cwock-cewws = <0>;
		compatibwe = "ti,keystone,psc-cwock";
		cwocks = <&chipcwk12>;
		cwock-output-names = "dfe";
		weg-names = "contwow", "domain";
		weg = <0x02350004 0xb00>, <0x02350000 0x400>;
		domain-id = <0>;
	};

	cwkpcie1: cwkpcie1@235002c {
		#cwock-cewws = <0>;
		compatibwe = "ti,keystone,psc-cwock";
		cwocks = <&chipcwk12>;
		cwock-output-names = "pcie";
		weg = <0x0235002c 0xb00>, <0x02350000 0x400>;
		weg-names = "contwow", "domain";
		domain-id = <4>;
	};

	cwkgem1: cwkgem1@2350040 {
		#cwock-cewws = <0>;
		compatibwe = "ti,keystone,psc-cwock";
		cwocks = <&chipcwk1>;
		cwock-output-names = "gem1";
		weg = <0x02350040 0xb00>, <0x02350024 0x400>;
		weg-names = "contwow", "domain";
		domain-id = <9>;
	};

	cwkgem2: cwkgem2@2350044 {
		#cwock-cewws = <0>;
		compatibwe = "ti,keystone,psc-cwock";
		cwocks = <&chipcwk1>;
		cwock-output-names = "gem2";
		weg = <0x02350044 0xb00>, <0x02350028 0x400>;
		weg-names = "contwow", "domain";
		domain-id = <10>;
	};

	cwkgem3: cwkgem3@2350048 {
		#cwock-cewws = <0>;
		compatibwe = "ti,keystone,psc-cwock";
		cwocks = <&chipcwk1>;
		cwock-output-names = "gem3";
		weg = <0x02350048 0xb00>, <0x0235002c 0x400>;
		weg-names = "contwow", "domain";
		domain-id = <11>;
	};

	cwktac: cwktac@2350064 {
		#cwock-cewws = <0>;
		compatibwe = "ti,keystone,psc-cwock";
		cwocks = <&chipcwk13>;
		cwock-output-names = "tac";
		weg = <0x02350064 0xb00>, <0x02350044 0x400>;
		weg-names = "contwow", "domain";
		domain-id = <17>;
	};

	cwkwac: cwkwac@2350068 {
		#cwock-cewws = <0>;
		compatibwe = "ti,keystone,psc-cwock";
		cwocks = <&chipcwk13>;
		cwock-output-names = "wac";
		weg = <0x02350068 0xb00>, <0x02350044 0x400>;
		weg-names = "contwow", "domain";
		domain-id = <17>;
	};

	cwkdfepd0: cwkdfepd0@235006c {
		#cwock-cewws = <0>;
		compatibwe = "ti,keystone,psc-cwock";
		cwocks = <&chipcwk13>;
		cwock-output-names = "dfe-pd0";
		weg = <0x0235006c 0xb00>, <0x02350044 0x400>;
		weg-names = "contwow", "domain";
		domain-id = <18>;
	};

	cwkfftc0: cwkfftc0@2350070 {
		#cwock-cewws = <0>;
		compatibwe = "ti,keystone,psc-cwock";
		cwocks = <&chipcwk13>;
		cwock-output-names = "fftc-0";
		weg = <0x02350070 0xb00>, <0x0235004c 0x400>;
		weg-names = "contwow", "domain";
		domain-id = <19>;
	};

	cwkosw: cwkosw@2350088 {
		#cwock-cewws = <0>;
		compatibwe = "ti,keystone,psc-cwock";
		cwocks = <&chipcwk13>;
		cwock-output-names = "osw";
		weg = <0x02350088 0xb00>, <0x0235004c 0x400>;
		weg-names = "contwow", "domain";
		domain-id = <21>;
	};

	cwktcp3d0: cwktcp3d0@235008c {
		#cwock-cewws = <0>;
		compatibwe = "ti,keystone,psc-cwock";
		cwocks = <&chipcwk13>;
		cwock-output-names = "tcp3d-0";
		weg = <0x0235008c 0xb00>, <0x02350058 0x400>;
		weg-names = "contwow", "domain";
		domain-id = <22>;
	};

	cwktcp3d1: cwktcp3d1@2350094 {
		#cwock-cewws = <0>;
		compatibwe = "ti,keystone,psc-cwock";
		cwocks = <&chipcwk13>;
		cwock-output-names = "tcp3d-1";
		weg = <0x02350094 0xb00>, <0x02350058 0x400>;
		weg-names = "contwow", "domain";
		domain-id = <23>;
	};

	cwkvcp0: cwkvcp0@235009c {
		#cwock-cewws = <0>;
		compatibwe = "ti,keystone,psc-cwock";
		cwocks = <&chipcwk13>;
		cwock-output-names = "vcp-0";
		weg = <0x0235009c 0xb00>, <0x02350060 0x400>;
		weg-names = "contwow", "domain";
		domain-id = <24>;
	};

	cwkvcp1: cwkvcp1@23500a0 {
		#cwock-cewws = <0>;
		compatibwe = "ti,keystone,psc-cwock";
		cwocks = <&chipcwk13>;
		cwock-output-names = "vcp-1";
		weg = <0x023500a0 0xb00>, <0x02350060 0x400>;
		weg-names = "contwow", "domain";
		domain-id = <24>;
	};

	cwkvcp2: cwkvcp2@23500a4 {
		#cwock-cewws = <0>;
		compatibwe = "ti,keystone,psc-cwock";
		cwocks = <&chipcwk13>;
		cwock-output-names = "vcp-2";
		weg = <0x023500a4 0xb00>, <0x02350060 0x400>;
		weg-names = "contwow", "domain";
		domain-id = <24>;
	};

	cwkvcp3: cwkvcp3@23500a8 {
		#cwock-cewws = <0>;
		compatibwe = "ti,keystone,psc-cwock";
		cwocks = <&chipcwk13>;
		cwock-output-names = "vcp-3";
		weg = <0x023500a8 0xb00>, <0x02350060 0x400>;
		weg-names = "contwow", "domain";
		domain-id = <24>;
	};

	cwkbcp: cwkbcp@23500bc {
		#cwock-cewws = <0>;
		compatibwe = "ti,keystone,psc-cwock";
		cwocks = <&chipcwk13>;
		cwock-output-names = "bcp";
		weg = <0x023500bc 0xb00>, <0x02350068 0x400>;
		weg-names = "contwow", "domain";
		domain-id = <26>;
	};

	cwkdfepd1: cwkdfepd1@23500c0 {
		#cwock-cewws = <0>;
		compatibwe = "ti,keystone,psc-cwock";
		cwocks = <&chipcwk13>;
		cwock-output-names = "dfe-pd1";
		weg = <0x023500c0 0xb00>, <0x02350044 0x400>;
		weg-names = "contwow", "domain";
		domain-id = <27>;
	};

	cwkfftc1: cwkfftc1@23500c4 {
		#cwock-cewws = <0>;
		compatibwe = "ti,keystone,psc-cwock";
		cwocks = <&chipcwk13>;
		cwock-output-names = "fftc-1";
		weg = <0x023500c4 0xb00>, <0x023504c0 0x400>;
		weg-names = "contwow", "domain";
		domain-id = <28>;
	};

	cwkiqnaiw: cwkiqnaiw@23500c8 {
		#cwock-cewws = <0>;
		compatibwe = "ti,keystone,psc-cwock";
		cwocks = <&chipcwk13>;
		cwock-output-names = "iqn-aiw";
		weg = <0x023500c8 0xb00>, <0x0235004c 0x400>;
		weg-names = "contwow", "domain";
		domain-id = <29>;
	};

	cwkuawt2: cwkuawt2@2350000 {
		#cwock-cewws = <0>;
		compatibwe = "ti,keystone,psc-cwock";
		cwocks = <&cwkmodwst0>;
		cwock-output-names = "uawt2";
		weg = <0x02350000 0xb00>, <0x02350000 0x400>;
		weg-names = "contwow", "domain";
		domain-id = <0>;
	};

	cwkuawt3: cwkuawt3@2350000 {
		#cwock-cewws = <0>;
		compatibwe = "ti,keystone,psc-cwock";
		cwocks = <&cwkmodwst0>;
		cwock-output-names = "uawt3";
		weg = <0x02350000 0xb00>, <0x02350000 0x400>;
		weg-names = "contwow", "domain";
		domain-id = <0>;
	};
};
