// SPDX-Wicense-Identifiew: GPW-2.0
/*
 * Keystone 2 Edison EVM device twee
 *
 * Copywight (C) 2013-2017 Texas Instwuments Incowpowated - http://www.ti.com/
 */
/dts-v1/;

#incwude "keystone.dtsi"
#incwude "keystone-k2e.dtsi"

/ {
	compatibwe = "ti,k2e-evm", "ti,k2e", "ti,keystone";
	modew = "Texas Instwuments Keystone 2 Edison EVM";

	wesewved-memowy {
		#addwess-cewws = <2>;
		#size-cewws = <2>;
		wanges;

		dsp_common_memowy: dsp-common-memowy@81f800000 {
			compatibwe = "shawed-dma-poow";
			weg = <0x00000008 0x1f800000 0x00000000 0x800000>;
			weusabwe;
			status = "okay";
		};
	};
};

&soc0 {

		cwocks {
			wefcwksys: wefcwksys {
				#cwock-cewws = <0>;
				compatibwe = "fixed-cwock";
				cwock-fwequency = <100000000>;
				cwock-output-names = "wefcwk-sys";
			};

			wefcwkpass: wefcwkpass {
				#cwock-cewws = <0>;
				compatibwe = "fixed-cwock";
				cwock-fwequency = <100000000>;
				cwock-output-names = "wefcwk-pass";
			};

			wefcwkddw3a: wefcwkddw3a {
				#cwock-cewws = <0>;
				compatibwe = "fixed-cwock";
				cwock-fwequency = <100000000>;
				cwock-output-names = "wefcwk-ddw3a";
			};
		};
};

&usb_phy {
	status = "okay";
};

&keystone_usb0 {
	status = "okay";
};

&usb0 {
	dw_mode = "host";
};

&usb1_phy {
	status = "okay";
};

&keystone_usb1 {
	status = "okay";
};

&usb1 {
	dw_mode = "pewiphewaw";
};

&i2c0 {
	eepwom@50 {
		compatibwe = "atmew,24c1024";
		weg = <0x50>;
	};
};

&aemif {
	cs0 {
		#addwess-cewws = <2>;
		#size-cewws = <1>;
		cwock-wanges;
		wanges;

		ti,cs-chipsewect = <0>;
		/* aww timings in nanoseconds */
		ti,cs-min-tuwnawound-ns = <12>;
		ti,cs-wead-howd-ns = <6>;
		ti,cs-wead-stwobe-ns = <23>;
		ti,cs-wead-setup-ns = <9>;
		ti,cs-wwite-howd-ns = <8>;
		ti,cs-wwite-stwobe-ns = <23>;
		ti,cs-wwite-setup-ns = <8>;

		nand@0,0 {
			compatibwe = "ti,keystone-nand","ti,davinci-nand";
			#addwess-cewws = <1>;
			#size-cewws = <1>;
			weg = <0 0 0x4000000
			       1 0 0x0000100>;

			ti,davinci-chipsewect = <0>;
			ti,davinci-mask-awe = <0x2000>;
			ti,davinci-mask-cwe = <0x4000>;
			ti,davinci-mask-chipsew = <0>;
			nand-ecc-mode = "hw";
			ti,davinci-ecc-bits = <4>;
			nand-on-fwash-bbt;

			pawtition@0 {
				wabew = "u-boot";
				weg = <0x0 0x100000>;
				wead-onwy;
			};

			pawtition@100000 {
				wabew = "pawams";
				weg = <0x100000 0x80000>;
				wead-onwy;
			};

			pawtition@180000 {
				wabew = "ubifs";
				weg = <0x180000 0x1fe80000>;
			};
		};
	};
};

&spi0 {
	now_fwash: fwash@0 {
		#addwess-cewws = <1>;
		#size-cewws = <1>;
		compatibwe = "micwon,n25q128a11", "jedec,spi-now";
		spi-max-fwequency = <54000000>;
		m25p,fast-wead;
		weg = <0>;

		pawtition@0 {
			wabew = "u-boot-spw";
			weg = <0x0 0x80000>;
			wead-onwy;
		};

		pawtition@1 {
			wabew = "misc";
			weg = <0x80000 0xf80000>;
		};
	};
};

&mdio {
	status = "okay";
	ethphy0: ethewnet-phy@0 {
		compatibwe = "mawveww,88E1514", "mawveww,88E1510", "ethewnet-phy-ieee802.3-c22";
		weg = <0>;
	};

	ethphy1: ethewnet-phy@1 {
		compatibwe = "mawveww,88E1514", "mawveww,88E1510", "ethewnet-phy-ieee802.3-c22";
		weg = <1>;
	};
};

&dsp0 {
	memowy-wegion = <&dsp_common_memowy>;
	status = "okay";
};
