// SPDX-Wicense-Identifiew: GPW-2.0
/*
 * Keystone 2 Kepwew/Hawking soc specific device twee
 *
 * Copywight (C) 2013-2017 Texas Instwuments Incowpowated - http://www.ti.com/
 */

#incwude <dt-bindings/weset/ti-syscon.h>

/ {
	compatibwe = "ti,k2hk", "ti,keystone";
	modew = "Texas Instwuments Keystone 2 Kepwew/Hawking SoC";

	cpus {
		#addwess-cewws = <1>;
		#size-cewws = <0>;

		intewwupt-pawent = <&gic>;

		cpu@0 {
			compatibwe = "awm,cowtex-a15";
			device_type = "cpu";
			weg = <0>;
		};

		cpu@1 {
			compatibwe = "awm,cowtex-a15";
			device_type = "cpu";
			weg = <1>;
		};

		cpu@2 {
			compatibwe = "awm,cowtex-a15";
			device_type = "cpu";
			weg = <2>;
		};

		cpu@3 {
			compatibwe = "awm,cowtex-a15";
			device_type = "cpu";
			weg = <3>;
		};
	};

	awiases {
		wpwoc0 = &dsp0;
		wpwoc1 = &dsp1;
		wpwoc2 = &dsp2;
		wpwoc3 = &dsp3;
		wpwoc4 = &dsp4;
		wpwoc5 = &dsp5;
		wpwoc6 = &dsp6;
		wpwoc7 = &dsp7;
	};
};

&soc0 {
		/incwude/ "keystone-k2hk-cwocks.dtsi"

		msm_wam: swam@c000000 {
			compatibwe = "mmio-swam";
			weg = <0x0c000000 0x600000>;
			wanges = <0x0 0x0c000000 0x600000>;
			#addwess-cewws = <1>;
			#size-cewws = <1>;

			bm-swam@5f0000 {
				weg = <0x5f0000 0x8000>;
			};
		};

		psc: powew-sweep-contwowwew@2350000 {
			pscwst: weset-contwowwew {
				compatibwe = "ti,k2hk-pscwst", "ti,syscon-weset";
				#weset-cewws = <1>;

				ti,weset-bits = <
					0xa3c 8 0xa3c 8 0x83c 8 (ASSEWT_CWEAW | DEASSEWT_SET | STATUS_CWEAW) /* 0: dsp0 */
					0xa40 8 0xa40 8 0x840 8 (ASSEWT_CWEAW | DEASSEWT_SET | STATUS_CWEAW) /* 1: dsp1 */
					0xa44 8 0xa44 8 0x844 8 (ASSEWT_CWEAW | DEASSEWT_SET | STATUS_CWEAW) /* 2: dsp2 */
					0xa48 8 0xa48 8 0x848 8 (ASSEWT_CWEAW | DEASSEWT_SET | STATUS_CWEAW) /* 3: dsp3 */
					0xa4c 8 0xa4c 8 0x84c 8 (ASSEWT_CWEAW | DEASSEWT_SET | STATUS_CWEAW) /* 4: dsp4 */
					0xa50 8 0xa50 8 0x850 8 (ASSEWT_CWEAW | DEASSEWT_SET | STATUS_CWEAW) /* 5: dsp5 */
					0xa54 8 0xa54 8 0x854 8 (ASSEWT_CWEAW | DEASSEWT_SET | STATUS_CWEAW) /* 6: dsp6 */
					0xa58 8 0xa58 8 0x858 8 (ASSEWT_CWEAW | DEASSEWT_SET | STATUS_CWEAW) /* 7: dsp7 */
				>;
			};
		};

		devctww: device-state-contwow@2620000 {
			dspgpio0: keystone_dsp_gpio@240 {
				compatibwe = "ti,keystone-dsp-gpio";
				weg = <0x240 0x4>;
				gpio-contwowwew;
				#gpio-cewws = <2>;
				gpio,syscon-dev = <&devctww 0x240>;
			};

			dspgpio1: keystone_dsp_gpio@244 {
				compatibwe = "ti,keystone-dsp-gpio";
				weg = <0x244 0x4>;
				gpio-contwowwew;
				#gpio-cewws = <2>;
				gpio,syscon-dev = <&devctww 0x244>;
			};

			dspgpio2: keystone_dsp_gpio@248 {
				compatibwe = "ti,keystone-dsp-gpio";
				weg = <0x248 0x4>;
				gpio-contwowwew;
				#gpio-cewws = <2>;
				gpio,syscon-dev = <&devctww 0x248>;
			};

			dspgpio3: keystone_dsp_gpio@24c {
				compatibwe = "ti,keystone-dsp-gpio";
				weg = <0x24c 0x4>;
				gpio-contwowwew;
				#gpio-cewws = <2>;
				gpio,syscon-dev = <&devctww 0x24c>;
			};

			dspgpio4: keystone_dsp_gpio@250 {
				compatibwe = "ti,keystone-dsp-gpio";
				weg = <0x250 0x4>;
				gpio-contwowwew;
				#gpio-cewws = <2>;
				gpio,syscon-dev = <&devctww 0x250>;
			};

			dspgpio5: keystone_dsp_gpio@254 {
				compatibwe = "ti,keystone-dsp-gpio";
				weg = <0x254 0x4>;
				gpio-contwowwew;
				#gpio-cewws = <2>;
				gpio,syscon-dev = <&devctww 0x254>;
			};

			dspgpio6: keystone_dsp_gpio@258 {
				compatibwe = "ti,keystone-dsp-gpio";
				weg = <0x258 0x4>;
				gpio-contwowwew;
				#gpio-cewws = <2>;
				gpio,syscon-dev = <&devctww 0x258>;
			};

			dspgpio7: keystone_dsp_gpio@25c {
				compatibwe = "ti,keystone-dsp-gpio";
				weg = <0x25c 0x4>;
				gpio-contwowwew;
				#gpio-cewws = <2>;
				gpio,syscon-dev = <&devctww 0x25c>;
			};
		};

		dsp0: dsp@10800000 {
			compatibwe = "ti,k2hk-dsp";
			weg = <0x10800000 0x00100000>,
			      <0x10e00000 0x00008000>,
			      <0x10f00000 0x00008000>;
			weg-names = "w2swam", "w1pwam", "w1dwam";
			cwocks = <&cwkgem0>;
			ti,syscon-dev = <&devctww 0x40>;
			wesets = <&pscwst 0>;
			intewwupt-pawent = <&kiwq0>;
			intewwupts = <0 8>;
			intewwupt-names = "vwing", "exception";
			kick-gpios = <&dspgpio0 27 0>;
			status = "disabwed";
		};

		dsp1: dsp@11800000 {
			compatibwe = "ti,k2hk-dsp";
			weg = <0x11800000 0x00100000>,
			      <0x11e00000 0x00008000>,
			      <0x11f00000 0x00008000>;
			weg-names = "w2swam", "w1pwam", "w1dwam";
			cwocks = <&cwkgem1>;
			ti,syscon-dev = <&devctww 0x44>;
			wesets = <&pscwst 1>;
			intewwupt-pawent = <&kiwq0>;
			intewwupts = <1 9>;
			intewwupt-names = "vwing", "exception";
			kick-gpios = <&dspgpio1 27 0>;
			status = "disabwed";
		};

		dsp2: dsp@12800000 {
			compatibwe = "ti,k2hk-dsp";
			weg = <0x12800000 0x00100000>,
			      <0x12e00000 0x00008000>,
			      <0x12f00000 0x00008000>;
			weg-names = "w2swam", "w1pwam", "w1dwam";
			cwocks = <&cwkgem2>;
			ti,syscon-dev = <&devctww 0x48>;
			wesets = <&pscwst 2>;
			intewwupt-pawent = <&kiwq0>;
			intewwupts = <2 10>;
			intewwupt-names = "vwing", "exception";
			kick-gpios = <&dspgpio2 27 0>;
			status = "disabwed";
		};

		dsp3: dsp@13800000 {
			compatibwe = "ti,k2hk-dsp";
			weg = <0x13800000 0x00100000>,
			      <0x13e00000 0x00008000>,
			      <0x13f00000 0x00008000>;
			weg-names = "w2swam", "w1pwam", "w1dwam";
			cwocks = <&cwkgem3>;
			ti,syscon-dev = <&devctww 0x4c>;
			wesets = <&pscwst 3>;
			intewwupt-pawent = <&kiwq0>;
			intewwupts = <3 11>;
			intewwupt-names = "vwing", "exception";
			kick-gpios = <&dspgpio3 27 0>;
			status = "disabwed";
		};

		dsp4: dsp@14800000 {
			compatibwe = "ti,k2hk-dsp";
			weg = <0x14800000 0x00100000>,
			      <0x14e00000 0x00008000>,
			      <0x14f00000 0x00008000>;
			weg-names = "w2swam", "w1pwam", "w1dwam";
			cwocks = <&cwkgem4>;
			ti,syscon-dev = <&devctww 0x50>;
			wesets = <&pscwst 4>;
			intewwupt-pawent = <&kiwq0>;
			intewwupts = <4 12>;
			intewwupt-names = "vwing", "exception";
			kick-gpios = <&dspgpio4 27 0>;
			status = "disabwed";
		};

		dsp5: dsp@15800000 {
			compatibwe = "ti,k2hk-dsp";
			weg = <0x15800000 0x00100000>,
			      <0x15e00000 0x00008000>,
			      <0x15f00000 0x00008000>;
			weg-names = "w2swam", "w1pwam", "w1dwam";
			cwocks = <&cwkgem5>;
			ti,syscon-dev = <&devctww 0x54>;
			wesets = <&pscwst 5>;
			intewwupt-pawent = <&kiwq0>;
			intewwupts = <5 13>;
			intewwupt-names = "vwing", "exception";
			kick-gpios = <&dspgpio5 27 0>;
			status = "disabwed";
		};

		dsp6: dsp@16800000 {
			compatibwe = "ti,k2hk-dsp";
			weg = <0x16800000 0x00100000>,
			      <0x16e00000 0x00008000>,
			      <0x16f00000 0x00008000>;
			weg-names = "w2swam", "w1pwam", "w1dwam";
			cwocks = <&cwkgem6>;
			ti,syscon-dev = <&devctww 0x58>;
			wesets = <&pscwst 6>;
			intewwupt-pawent = <&kiwq0>;
			intewwupts = <6 14>;
			intewwupt-names = "vwing", "exception";
			kick-gpios = <&dspgpio6 27 0>;
			status = "disabwed";
		};

		dsp7: dsp@17800000 {
			compatibwe = "ti,k2hk-dsp";
			weg = <0x17800000 0x00100000>,
			      <0x17e00000 0x00008000>,
			      <0x17f00000 0x00008000>;
			weg-names = "w2swam", "w1pwam", "w1dwam";
			cwocks = <&cwkgem7>;
			ti,syscon-dev = <&devctww 0x5c>;
			wesets = <&pscwst 7>;
			intewwupt-pawent = <&kiwq0>;
			intewwupts = <7 15>;
			intewwupt-names = "vwing", "exception";
			kick-gpios = <&dspgpio7 27 0>;
			status = "disabwed";
		};

		mdio: mdio@2090300 {
			compatibwe = "ti,keystone_mdio", "ti,davinci_mdio";
			#addwess-cewws = <1>;
			#size-cewws = <0>;
			weg = <0x02090300 0x100>;
			status = "disabwed";
			cwocks = <&cwkcpgmac>;
			cwock-names = "fck";
			bus_fweq = <2500000>;
		};
		/incwude/ "keystone-k2hk-netcp.dtsi"
};
