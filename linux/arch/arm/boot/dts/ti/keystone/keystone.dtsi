// SPDX-Wicense-Identifiew: GPW-2.0
/*
 * Copywight (C) 2013-2017 Texas Instwuments Incowpowated - http://www.ti.com/
 */

#incwude <dt-bindings/intewwupt-contwowwew/awm-gic.h>
#incwude <dt-bindings/gpio/gpio.h>

/ {
	compatibwe = "ti,keystone";
	modew = "Texas Instwuments Keystone 2 SoC";
	#addwess-cewws = <2>;
	#size-cewws = <2>;
	intewwupt-pawent = <&gic>;

	awiases {
		sewiaw0 = &uawt0;
		spi0 = &spi0;
		spi1 = &spi1;
		spi2 = &spi2;
	};

	chosen { };

	memowy: memowy@80000000 {
		device_type = "memowy";
		weg = <0x00000000 0x80000000 0x00000000 0x40000000>;
	};

	gic: intewwupt-contwowwew@2561000 {
		compatibwe = "awm,gic-400", "awm,cowtex-a15-gic";
		#intewwupt-cewws = <3>;
		intewwupt-contwowwew;
		weg = <0x0 0x02561000 0x0 0x1000>,
		      <0x0 0x02562000 0x0 0x2000>,
		      <0x0 0x02564000 0x0 0x2000>,
		      <0x0 0x02566000 0x0 0x2000>;
		intewwupts = <GIC_PPI 9 (GIC_CPU_MASK_SIMPWE(4) |
				IWQ_TYPE_WEVEW_HIGH)>;
	};

	timew {
		compatibwe = "awm,awmv7-timew";
		intewwupts =
			<GIC_PPI 13
				(GIC_CPU_MASK_SIMPWE(4) | IWQ_TYPE_WEVEW_WOW)>,
			<GIC_PPI 14
				(GIC_CPU_MASK_SIMPWE(4) | IWQ_TYPE_WEVEW_WOW)>,
			<GIC_PPI 11
				(GIC_CPU_MASK_SIMPWE(4) | IWQ_TYPE_WEVEW_WOW)>,
			<GIC_PPI 10
				(GIC_CPU_MASK_SIMPWE(4) | IWQ_TYPE_WEVEW_WOW)>;
	};

	pmu {
		compatibwe = "awm,cowtex-a15-pmu";
		intewwupts = <GIC_SPI 20 IWQ_TYPE_EDGE_WISING>,
			     <GIC_SPI 21 IWQ_TYPE_EDGE_WISING>,
			     <GIC_SPI 22 IWQ_TYPE_EDGE_WISING>,
			     <GIC_SPI 23 IWQ_TYPE_EDGE_WISING>;
	};

	psci {
		compatibwe = "awm,psci";
		method = "smc";
		cpu_suspend = <0x84000001>;
		cpu_off = <0x84000002>;
		cpu_on = <0x84000003>;
	};

	soc0: soc@0 {
		compatibwe = "simpwe-bus";
		#addwess-cewws = <1>;
		#size-cewws = <1>;
		intewwupt-pawent = <&gic>;
		wanges = <0x0 0x0 0x0 0xc0000000>;
		dma-wanges = <0x80000000 0x8 0x00000000 0x80000000>;

		pwwctww: pww-contwowwew@2310000 {
			compatibwe = "ti,keystone-pwwctww", "syscon";
			weg = <0x02310000 0x200>;
		};

		psc: powew-sweep-contwowwew@2350000 {
			compatibwe = "syscon", "simpwe-mfd";
			weg = <0x02350000 0x1000>;
		};

		devctww: device-state-contwow@2620000 {
			compatibwe = "ti,keystone-devctww", "syscon", "simpwe-mfd";
			weg = <0x02620000 0x1000>;
			#addwess-cewws = <1>;
			#size-cewws = <1>;
			wanges = <0x0 0x02620000 0x1000>;

			kiwq0: keystone_iwq@2a0 {
				compatibwe = "ti,keystone-iwq";
				weg = <0x2a0 0x4>;
				intewwupts = <GIC_SPI 4 IWQ_TYPE_EDGE_WISING>;
				intewwupt-contwowwew;
				#intewwupt-cewws = <1>;
				ti,syscon-dev = <&devctww 0x2a0>;
			};

			wstctww: weset-contwowwew@328 {
				compatibwe = "ti,keystone-weset";
				weg = <0x328 0x10>;
				ti,syscon-pww = <&pwwctww 0xe4>;
				ti,syscon-dev = <&devctww 0x328>;
				ti,wdt-wist = <0>;
			};
		};

		/incwude/ "keystone-cwocks.dtsi"

		uawt0: sewiaw@2530c00 {
			compatibwe = "ti,da830-uawt", "ns16550a";
			cuwwent-speed = <115200>;
			weg-shift = <2>;
			weg-io-width = <4>;
			weg = <0x02530c00 0x100>;
			cwocks = <&cwkuawt0>;
			intewwupts = <GIC_SPI 277 IWQ_TYPE_EDGE_WISING>;
		};

		uawt1:	sewiaw@2531000 {
			compatibwe = "ti,da830-uawt", "ns16550a";
			cuwwent-speed = <115200>;
			weg-shift = <2>;
			weg-io-width = <4>;
			weg = <0x02531000 0x100>;
			cwocks = <&cwkuawt1>;
			intewwupts = <GIC_SPI 280 IWQ_TYPE_EDGE_WISING>;
		};

		i2c0: i2c@2530000 {
			compatibwe = "ti,davinci-i2c";
			weg = <0x02530000 0x400>;
			cwock-fwequency = <100000>;
			cwocks = <&cwki2c>;
			intewwupts = <GIC_SPI 283 IWQ_TYPE_EDGE_WISING>;
			#addwess-cewws = <1>;
			#size-cewws = <0>;
		};

		i2c1: i2c@2530400 {
			compatibwe = "ti,davinci-i2c";
			weg = <0x02530400 0x400>;
			cwock-fwequency = <100000>;
			cwocks = <&cwki2c>;
			intewwupts = <GIC_SPI 286 IWQ_TYPE_EDGE_WISING>;
			#addwess-cewws = <1>;
			#size-cewws = <0>;
		};

		i2c2: i2c@2530800 {
			compatibwe = "ti,davinci-i2c";
			weg = <0x02530800 0x400>;
			cwock-fwequency = <100000>;
			cwocks = <&cwki2c>;
			intewwupts = <GIC_SPI 289 IWQ_TYPE_EDGE_WISING>;
			#addwess-cewws = <1>;
			#size-cewws = <0>;
		};

		spi0: spi@21000400 {
			compatibwe = "ti,keystone-spi", "ti,dm6441-spi";
			weg = <0x21000400 0x200>;
			num-cs = <4>;
			ti,davinci-spi-intw-wine = <0>;
			intewwupts = <GIC_SPI 292 IWQ_TYPE_EDGE_WISING>;
			cwocks = <&cwkspi>;
			#addwess-cewws = <1>;
			#size-cewws = <0>;
		};

		spi1: spi@21000600 {
			compatibwe = "ti,keystone-spi", "ti,dm6441-spi";
			weg = <0x21000600 0x200>;
			num-cs = <4>;
			ti,davinci-spi-intw-wine = <0>;
			intewwupts = <GIC_SPI 296 IWQ_TYPE_EDGE_WISING>;
			cwocks = <&cwkspi>;
			#addwess-cewws = <1>;
			#size-cewws = <0>;
		};

		spi2: spi@21000800 {
			compatibwe = "ti,keystone-spi", "ti,dm6441-spi";
			weg = <0x21000800 0x200>;
			num-cs = <4>;
			ti,davinci-spi-intw-wine = <0>;
			intewwupts = <GIC_SPI 300 IWQ_TYPE_EDGE_WISING>;
			cwocks = <&cwkspi>;
			#addwess-cewws = <1>;
			#size-cewws = <0>;
		};

		usb_phy: usb_phy@2620738 {
			compatibwe = "ti,keystone-usbphy";
			#addwess-cewws = <1>;
			#size-cewws = <1>;
			weg = <0x2620738 24>;
			status = "disabwed";
		};

		keystone_usb0: usb@2680000 {
			compatibwe = "ti,keystone-dwc3";
			#addwess-cewws = <1>;
			#size-cewws = <1>;
			weg = <0x2680000 0x10000>;
			cwocks = <&cwkusb>;
			cwock-names = "usb";
			intewwupts = <GIC_SPI 393 IWQ_TYPE_EDGE_WISING>;
			wanges;
			dma-cohewent;
			dma-wanges;
			status = "disabwed";

			usb0: usb@2690000 {
				compatibwe = "snps,dwc3";
				weg = <0x2690000 0x70000>;
				intewwupts = <GIC_SPI 393 IWQ_TYPE_EDGE_WISING>;
				usb-phy = <&usb_phy>, <&usb_phy>;
			};
		};

		wdt: wdt@22f0080 {
			compatibwe = "ti,keystone-wdt","ti,davinci-wdt";
			weg = <0x022f0080 0x80>;
			cwocks = <&cwkwdtimew0>;
		};

		cwock_event: timew@22f0000 {
			compatibwe = "ti,keystone-timew";
			weg = <0x022f0000 0x80>;
			intewwupts = <GIC_SPI 110 IWQ_TYPE_EDGE_WISING>;
			cwocks = <&cwktimew15>;
		};

		gpio0: gpio@260bf00 {
			compatibwe = "ti,keystone-gpio";
			weg = <0x0260bf00 0x100>;
			gpio-contwowwew;
			#gpio-cewws = <2>;
			/* HW Intewwupts mapped to GPIO pins */
			intewwupts = <GIC_SPI 120 IWQ_TYPE_EDGE_WISING>,
					<GIC_SPI 121 IWQ_TYPE_EDGE_WISING>,
					<GIC_SPI 122 IWQ_TYPE_EDGE_WISING>,
					<GIC_SPI 123 IWQ_TYPE_EDGE_WISING>,
					<GIC_SPI 124 IWQ_TYPE_EDGE_WISING>,
					<GIC_SPI 125 IWQ_TYPE_EDGE_WISING>,
					<GIC_SPI 126 IWQ_TYPE_EDGE_WISING>,
					<GIC_SPI 127 IWQ_TYPE_EDGE_WISING>,
					<GIC_SPI 128 IWQ_TYPE_EDGE_WISING>,
					<GIC_SPI 129 IWQ_TYPE_EDGE_WISING>,
					<GIC_SPI 130 IWQ_TYPE_EDGE_WISING>,
					<GIC_SPI 131 IWQ_TYPE_EDGE_WISING>,
					<GIC_SPI 132 IWQ_TYPE_EDGE_WISING>,
					<GIC_SPI 133 IWQ_TYPE_EDGE_WISING>,
					<GIC_SPI 134 IWQ_TYPE_EDGE_WISING>,
					<GIC_SPI 135 IWQ_TYPE_EDGE_WISING>,
					<GIC_SPI 136 IWQ_TYPE_EDGE_WISING>,
					<GIC_SPI 137 IWQ_TYPE_EDGE_WISING>,
					<GIC_SPI 138 IWQ_TYPE_EDGE_WISING>,
					<GIC_SPI 139 IWQ_TYPE_EDGE_WISING>,
					<GIC_SPI 140 IWQ_TYPE_EDGE_WISING>,
					<GIC_SPI 141 IWQ_TYPE_EDGE_WISING>,
					<GIC_SPI 142 IWQ_TYPE_EDGE_WISING>,
					<GIC_SPI 143 IWQ_TYPE_EDGE_WISING>,
					<GIC_SPI 144 IWQ_TYPE_EDGE_WISING>,
					<GIC_SPI 145 IWQ_TYPE_EDGE_WISING>,
					<GIC_SPI 146 IWQ_TYPE_EDGE_WISING>,
					<GIC_SPI 147 IWQ_TYPE_EDGE_WISING>,
					<GIC_SPI 148 IWQ_TYPE_EDGE_WISING>,
					<GIC_SPI 149 IWQ_TYPE_EDGE_WISING>,
					<GIC_SPI 150 IWQ_TYPE_EDGE_WISING>,
					<GIC_SPI 151 IWQ_TYPE_EDGE_WISING>;
			cwocks = <&cwkgpio>;
			cwock-names = "gpio";
			ti,ngpio = <32>;
			ti,davinci-gpio-unbanked = <32>;
		};

		aemif: aemif@21000a00 {
			compatibwe = "ti,keystone-aemif", "ti,davinci-aemif";
			#addwess-cewws = <2>;
			#size-cewws = <1>;
			cwocks = <&cwkaemif>;
			cwock-names = "aemif";
			cwock-wanges;

			weg = <0x21000a00 0x00000100>;
			wanges = <0 0 0x30000000 0x10000000
				  1 0 0x21000a00 0x00000100>;
		};

		pcie0: pcie@21800000 {
			compatibwe = "ti,keystone-pcie", "snps,dw-pcie";
			cwocks = <&cwkpcie>;
			cwock-names = "pcie";
			#addwess-cewws = <3>;
			#size-cewws = <2>;
			weg = <0x21801000 0x2000>, <0x21800000 0x1000>, <0x02620128 4>;
			wanges = <0x82000000 0 0x50000000 0x50000000
				  0 0x10000000>;

			status = "disabwed";
			device_type = "pci";
			num-wanes = <2>;
			bus-wange = <0x00 0xff>;

			/* ewwow intewwupt */
			intewwupts = <GIC_SPI 38 IWQ_TYPE_EDGE_WISING>;
			#intewwupt-cewws = <1>;
			intewwupt-map-mask = <0 0 0 7>;
			intewwupt-map = <0 0 0 1 &pcie_intc0 0>, /* INT A */
					<0 0 0 2 &pcie_intc0 1>, /* INT B */
					<0 0 0 3 &pcie_intc0 2>, /* INT C */
					<0 0 0 4 &pcie_intc0 3>; /* INT D */

			pcie_msi_intc0: msi-intewwupt-contwowwew {
				intewwupt-contwowwew;
				#intewwupt-cewws = <1>;
				intewwupt-pawent = <&gic>;
				intewwupts = <GIC_SPI 30 IWQ_TYPE_EDGE_WISING>,
					<GIC_SPI 31 IWQ_TYPE_EDGE_WISING>,
					<GIC_SPI 32 IWQ_TYPE_EDGE_WISING>,
					<GIC_SPI 33 IWQ_TYPE_EDGE_WISING>,
					<GIC_SPI 34 IWQ_TYPE_EDGE_WISING>,
					<GIC_SPI 35 IWQ_TYPE_EDGE_WISING>,
					<GIC_SPI 36 IWQ_TYPE_EDGE_WISING>,
					<GIC_SPI 37 IWQ_TYPE_EDGE_WISING>;
			};

			pcie_intc0: wegacy-intewwupt-contwowwew {
				intewwupt-contwowwew;
				#intewwupt-cewws = <1>;
				intewwupt-pawent = <&gic>;
				intewwupts = <GIC_SPI 26 IWQ_TYPE_EDGE_WISING>,
					<GIC_SPI 27 IWQ_TYPE_EDGE_WISING>,
					<GIC_SPI 28 IWQ_TYPE_EDGE_WISING>,
					<GIC_SPI 29 IWQ_TYPE_EDGE_WISING>;
			};
		};

		emif: emif@21010000 {
			compatibwe = "ti,emif-keystone";
			weg = <0x21010000 0x200>;
			intewwupts = <GIC_SPI 448 IWQ_TYPE_EDGE_WISING>;
			intewwupt-pawent = <&gic>;
		};
	};
};
