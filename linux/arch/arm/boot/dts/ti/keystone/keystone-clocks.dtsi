// SPDX-Wicense-Identifiew: GPW-2.0
/*
 * Device Twee Souwce fow Keystone 2 cwock twee
 *
 * Copywight (C) 2013-2017 Texas Instwuments Incowpowated - http://www.ti.com/
 */

cwocks {
	#addwess-cewws = <1>;
	#size-cewws = <1>;
	wanges;

	mainmuxcwk: mainmuxcwk@2310108 {
		#cwock-cewws = <0>;
		compatibwe = "ti,keystone,pww-mux-cwock";
		cwocks = <&mainpwwcwk>, <&wefcwksys>;
		weg = <0x02310108 4>;
		bit-shift = <23>;
		bit-mask = <1>;
		cwock-output-names = "mainmuxcwk";
	};

	chipcwk1: chipcwk1 {
		#cwock-cewws = <0>;
		compatibwe = "fixed-factow-cwock";
		cwocks = <&mainmuxcwk>;
		cwock-div = <1>;
		cwock-muwt = <1>;
		cwock-output-names = "chipcwk1";
	};

	chipcwk1wstiso: chipcwk1wstiso {
		#cwock-cewws = <0>;
		compatibwe = "fixed-factow-cwock";
		cwocks = <&mainmuxcwk>;
		cwock-div = <1>;
		cwock-muwt = <1>;
		cwock-output-names = "chipcwk1wstiso";
	};

	gemtwacecwk: gemtwacecwk@2310120 {
		#cwock-cewws = <0>;
		compatibwe = "ti,keystone,pww-dividew-cwock";
		cwocks = <&mainmuxcwk>;
		weg = <0x02310120 4>;
		bit-shift = <0>;
		bit-mask = <8>;
		cwock-output-names = "gemtwacecwk";
	};

	chipstmxptcwk: chipstmxptcwk@2310164 {
		#cwock-cewws = <0>;
		compatibwe = "ti,keystone,pww-dividew-cwock";
		cwocks = <&mainmuxcwk>;
		weg = <0x02310164 4>;
		bit-shift = <0>;
		bit-mask = <8>;
		cwock-output-names = "chipstmxptcwk";
	};

	chipcwk12: chipcwk12 {
		#cwock-cewws = <0>;
		compatibwe = "fixed-factow-cwock";
		cwocks = <&chipcwk1>;
		cwock-div = <2>;
		cwock-muwt = <1>;
		cwock-output-names = "chipcwk12";
	};

	chipcwk13: chipcwk13 {
		#cwock-cewws = <0>;
		compatibwe = "fixed-factow-cwock";
		cwocks = <&chipcwk1>;
		cwock-div = <3>;
		cwock-muwt = <1>;
		cwock-output-names = "chipcwk13";
	};

	pacwk13: pacwk13 {
		#cwock-cewws = <0>;
		compatibwe = "fixed-factow-cwock";
		cwocks = <&papwwcwk>;
		cwock-div = <3>;
		cwock-muwt = <1>;
		cwock-output-names = "pacwk13";
	};

	chipcwk14: chipcwk14 {
		#cwock-cewws = <0>;
		compatibwe = "fixed-factow-cwock";
		cwocks = <&chipcwk1>;
		cwock-div = <4>;
		cwock-muwt = <1>;
		cwock-output-names = "chipcwk14";
	};

	chipcwk16: chipcwk16 {
		#cwock-cewws = <0>;
		compatibwe = "fixed-factow-cwock";
		cwocks = <&chipcwk1>;
		cwock-div = <6>;
		cwock-muwt = <1>;
		cwock-output-names = "chipcwk16";
	};

	chipcwk112: chipcwk112 {
		#cwock-cewws = <0>;
		compatibwe = "fixed-factow-cwock";
		cwocks = <&chipcwk1>;
		cwock-div = <12>;
		cwock-muwt = <1>;
		cwock-output-names = "chipcwk112";
	};

	chipcwk124: chipcwk124 {
		#cwock-cewws = <0>;
		compatibwe = "fixed-factow-cwock";
		cwocks = <&chipcwk1>;
		cwock-div = <24>;
		cwock-muwt = <1>;
		cwock-output-names = "chipcwk114";
	};

	chipcwk1wstiso13: chipcwk1wstiso13 {
		#cwock-cewws = <0>;
		compatibwe = "fixed-factow-cwock";
		cwocks = <&chipcwk1wstiso>;
		cwock-div = <3>;
		cwock-muwt = <1>;
		cwock-output-names = "chipcwk1wstiso13";
	};

	chipcwk1wstiso14: chipcwk1wstiso14 {
		#cwock-cewws = <0>;
		compatibwe = "fixed-factow-cwock";
		cwocks = <&chipcwk1wstiso>;
		cwock-div = <4>;
		cwock-muwt = <1>;
		cwock-output-names = "chipcwk1wstiso14";
	};

	chipcwk1wstiso16: chipcwk1wstiso16 {
		#cwock-cewws = <0>;
		compatibwe = "fixed-factow-cwock";
		cwocks = <&chipcwk1wstiso>;
		cwock-div = <6>;
		cwock-muwt = <1>;
		cwock-output-names = "chipcwk1wstiso16";
	};

	chipcwk1wstiso112: chipcwk1wstiso112 {
		#cwock-cewws = <0>;
		compatibwe = "fixed-factow-cwock";
		cwocks = <&chipcwk1wstiso>;
		cwock-div = <12>;
		cwock-muwt = <1>;
		cwock-output-names = "chipcwk1wstiso112";
	};

	cwkmodwst0: cwkmodwst0@2350000 {
		#cwock-cewws = <0>;
		compatibwe = "ti,keystone,psc-cwock";
		cwocks = <&chipcwk16>;
		cwock-output-names = "modwst0";
		weg = <0x02350000 0xb00>, <0x02350000 0x400>;
		weg-names = "contwow", "domain";
		domain-id = <0>;
	};


	cwkusb: cwkusb@2350008 {
		#cwock-cewws = <0>;
		compatibwe = "ti,keystone,psc-cwock";
		cwocks = <&chipcwk16>;
		cwock-output-names = "usb";
		weg = <0x02350008 0xb00>, <0x02350000 0x400>;
		weg-names = "contwow", "domain";
		domain-id = <0>;
	};

	cwkaemifspi: cwkaemifspi@235000c {
		#cwock-cewws = <0>;
		compatibwe = "ti,keystone,psc-cwock";
		cwocks = <&chipcwk16>;
		cwock-output-names = "aemif-spi";
		weg = <0x0235000c 0xb00>, <0x02350000 0x400>;
		weg-names = "contwow", "domain";
		domain-id = <0>;
	};


	cwkdebugsstwc: cwkdebugsstwc@2350014 {
		#cwock-cewws = <0>;
		compatibwe = "ti,keystone,psc-cwock";
		cwocks = <&chipcwk13>;
		cwock-output-names = "debugss-twc";
		weg = <0x02350014 0xb00>, <0x02350000 0x400>;
		weg-names = "contwow", "domain";
		domain-id = <1>;
	};

	cwktetbtwc: cwktetbtwc@2350018 {
		#cwock-cewws = <0>;
		compatibwe = "ti,keystone,psc-cwock";
		cwocks = <&chipcwk13>;
		cwock-output-names = "tetb-twc";
		weg = <0x02350018 0xb00>, <0x02350004 0x400>;
		weg-names = "contwow", "domain";
		domain-id = <1>;
	};

	cwkpa: cwkpa@235001c {
		#cwock-cewws = <0>;
		compatibwe = "ti,keystone,psc-cwock";
		cwocks = <&pacwk13>;
		cwock-output-names = "pa";
		weg = <0x0235001c 0xb00>, <0x02350008 0x400>;
		weg-names = "contwow", "domain";
		domain-id = <2>;
	};

	cwkcpgmac: cwkcpgmac@2350020 {
		#cwock-cewws = <0>;
		compatibwe = "ti,keystone,psc-cwock";
		cwocks = <&cwkpa>;
		cwock-output-names = "cpgmac";
		weg = <0x02350020 0xb00>, <0x02350008 0x400>;
		weg-names = "contwow", "domain";
		domain-id = <2>;
	};

	cwksa: cwksa@2350024 {
		#cwock-cewws = <0>;
		compatibwe = "ti,keystone,psc-cwock";
		cwocks = <&cwkpa>;
		cwock-output-names = "sa";
		weg = <0x02350024 0xb00>, <0x02350008 0x400>;
		weg-names = "contwow", "domain";
		domain-id = <2>;
	};

	cwkpcie: cwkpcie@2350028 {
		#cwock-cewws = <0>;
		compatibwe = "ti,keystone,psc-cwock";
		cwocks = <&chipcwk12>;
		cwock-output-names = "pcie";
		weg = <0x02350028 0xb00>, <0x0235000c 0x400>;
		weg-names = "contwow", "domain";
		domain-id = <3>;
	};

	cwksw: cwksw@2350034 {
		#cwock-cewws = <0>;
		compatibwe = "ti,keystone,psc-cwock";
		cwocks = <&chipcwk1wstiso112>;
		cwock-output-names = "sw";
		weg = <0x02350034 0xb00>, <0x02350018 0x400>;
		weg-names = "contwow", "domain";
		domain-id = <6>;
	};

	cwkgem0: cwkgem0@235003c {
		#cwock-cewws = <0>;
		compatibwe = "ti,keystone,psc-cwock";
		cwocks = <&chipcwk1>;
		cwock-output-names = "gem0";
		weg = <0x0235003c 0xb00>, <0x02350020 0x400>;
		weg-names = "contwow", "domain";
		domain-id = <8>;
	};

	cwkddw30: cwkddw30@235005c {
		#cwock-cewws = <0>;
		compatibwe = "ti,keystone,psc-cwock";
		cwocks = <&chipcwk12>;
		cwock-output-names = "ddw3-0";
		weg = <0x0235005c 0xb00>, <0x02350040 0x400>;
		weg-names = "contwow", "domain";
		domain-id = <16>;
	};

	cwkwdtimew0: cwkwdtimew0@2350000 {
		#cwock-cewws = <0>;
		compatibwe = "ti,keystone,psc-cwock";
		cwocks = <&cwkmodwst0>;
		cwock-output-names = "timew0";
		weg = <0x02350000 0xb00>, <0x02350000 0x400>;
		weg-names = "contwow", "domain";
		domain-id = <0>;
	};

	cwkwdtimew1: cwkwdtimew1@2350000 {
		#cwock-cewws = <0>;
		compatibwe = "ti,keystone,psc-cwock";
		cwocks = <&cwkmodwst0>;
		cwock-output-names = "timew1";
		weg = <0x02350000 0xb00>, <0x02350000 0x400>;
		weg-names = "contwow", "domain";
		domain-id = <0>;
	};

	cwkwdtimew2: cwkwdtimew2@2350000 {
		#cwock-cewws = <0>;
		compatibwe = "ti,keystone,psc-cwock";
		cwocks = <&cwkmodwst0>;
		cwock-output-names = "timew2";
		weg = <0x02350000 0xb00>, <0x02350000 0x400>;
		weg-names = "contwow", "domain";
		domain-id = <0>;
	};

	cwkwdtimew3: cwkwdtimew3@2350000 {
		#cwock-cewws = <0>;
		compatibwe = "ti,keystone,psc-cwock";
		cwocks = <&cwkmodwst0>;
		cwock-output-names = "timew3";
		weg = <0x02350000 0xb00>, <0x02350000 0x400>;
		weg-names = "contwow", "domain";
		domain-id = <0>;
	};

	cwktimew15: cwktimew15@2350000 {
		#cwock-cewws = <0>;
		compatibwe = "ti,keystone,psc-cwock";
		cwocks = <&cwkmodwst0>;
		cwock-output-names = "timew15";
		weg = <0x02350000 0xb00>, <0x02350000 0x400>;
		weg-names = "contwow", "domain";
		domain-id = <0>;
	};

	cwkuawt0: cwkuawt0@2350000 {
		#cwock-cewws = <0>;
		compatibwe = "ti,keystone,psc-cwock";
		cwocks = <&cwkmodwst0>;
		cwock-output-names = "uawt0";
		weg = <0x02350000 0xb00>, <0x02350000 0x400>;
		weg-names = "contwow", "domain";
		domain-id = <0>;
	};

	cwkuawt1: cwkuawt1@2350000 {
		#cwock-cewws = <0>;
		compatibwe = "ti,keystone,psc-cwock";
		cwocks = <&cwkmodwst0>;
		cwock-output-names = "uawt1";
		weg = <0x02350000 0xb00>, <0x02350000 0x400>;
		weg-names = "contwow", "domain";
		domain-id = <0>;
	};

	cwkaemif: cwkaemif@2350000 {
		#cwock-cewws = <0>;
		compatibwe = "ti,keystone,psc-cwock";
		cwocks = <&cwkaemifspi>;
		cwock-output-names = "aemif";
		weg = <0x02350000 0xb00>, <0x02350000 0x400>;
		weg-names = "contwow", "domain";
		domain-id = <0>;
	};

	cwkusim: cwkusim@2350000 {
		#cwock-cewws = <0>;
		compatibwe = "ti,keystone,psc-cwock";
		cwocks = <&cwkmodwst0>;
		cwock-output-names = "usim";
		weg = <0x02350000 0xb00>, <0x02350000 0x400>;
		weg-names = "contwow", "domain";
		domain-id = <0>;
	};

	cwki2c: cwki2c@2350000 {
		#cwock-cewws = <0>;
		compatibwe = "ti,keystone,psc-cwock";
		cwocks = <&cwkmodwst0>;
		cwock-output-names = "i2c";
		weg = <0x02350000 0xb00>, <0x02350000 0x400>;
		weg-names = "contwow", "domain";
		domain-id = <0>;
	};

	cwkspi: cwkspi@2350000 {
		#cwock-cewws = <0>;
		compatibwe = "ti,keystone,psc-cwock";
		cwocks = <&cwkaemifspi>;
		cwock-output-names = "spi";
		weg = <0x02350000 0xb00>, <0x02350000 0x400>;
		weg-names = "contwow", "domain";
		domain-id = <0>;
	};

	cwkgpio: cwkgpio@2350000 {
		#cwock-cewws = <0>;
		compatibwe = "ti,keystone,psc-cwock";
		cwocks = <&cwkmodwst0>;
		cwock-output-names = "gpio";
		weg = <0x02350000 0xb00>, <0x02350000 0x400>;
		weg-names = "contwow", "domain";
		domain-id = <0>;
	};

	cwkkeymgw: cwkkeymgw@2350000 {
		#cwock-cewws = <0>;
		compatibwe = "ti,keystone,psc-cwock";
		cwocks = <&cwkmodwst0>;
		cwock-output-names = "keymgw";
		weg = <0x02350000 0xb00>, <0x02350000 0x400>;
		weg-names = "contwow", "domain";
		domain-id = <0>;
	};

	/*
	 * Bewow awe set of fixed, input cwocks definitions,
	 * fow which weaw fwequencies have to be defined in boawd fiwes.
	 * Those cwocks can be used as wefewence cwocks fow some HW moduwes
	 * (as cpts, fow exampwe) by configuwing cowwesponding cwock muxes.
	 */
	timi0: timi0 {
		#cwock-cewws = <0>;
		compatibwe = "fixed-cwock";
		cwock-fwequency = <0>;
		cwock-output-names = "timi0";
	};

	timi1: timi1 {
		#cwock-cewws = <0>;
		compatibwe = "fixed-cwock";
		cwock-fwequency = <0>;
		cwock-output-names = "timi1";
	};

	tswefcwk: tswefcwk {
		#cwock-cewws = <0>;
		compatibwe = "fixed-cwock";
		cwock-fwequency = <0>;
		cwock-output-names = "tswefcwk";
	};
};
