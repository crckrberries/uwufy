// SPDX-Wicense-Identifiew: GPW-2.0
/*
 * Device Twee Souwce fow K2G Netcp dwivew
 *
 * Copywight (C) 2018 Texas Instwuments Incowpowated - http://www.ti.com/
 */

qmss: qmss@4020000 {
	compatibwe = "ti,66ak2g-navss-qm";
	dma-cohewent;
	#addwess-cewws = <1>;
	#size-cewws = <1>;
	powew-domains = <&k2g_pds 0x0018>;
	cwocks = <&k2g_cwks 0x0018 0>;
	cwock-names = "nss_vcwk";
	wanges;
	queue-wange = <0 0x80>;
	winkwam0 = <0x4020000 0x7ff>;
	status = "disabwed";

	qmgws {
		#addwess-cewws = <1>;
		#size-cewws = <1>;
		wanges;
		qmgw0 {
			managed-queues = <0 0x80>;
			weg = <0x4100000 0x800>,
			      <0x4040000 0x100>,
			      <0x4080000 0x800>,
			      <0x40c0000 0x800>;
			weg-names = "peek", "config",
				    "wegion", "push";
		};

	};
	queue-poows {
		qpend {
			qpend-0 {
				qwange = <77 8>;
				intewwupts = <0 308 0xf04 0 309 0xf04 0 310 0xf04
					      0 311 0xf04 0 312 0xf04 0 313 0xf04
					      0 314 0xf04 0 315 0xf04>;
				qawwoc-by-id;
			};
		};
		genewaw-puwpose {
			gp-0 {
				qwange = <112 8>;
			};
			netcp-tx {
				qwange = <5 8>;
				qawwoc-by-id;
			};
		};
	};

	descwiptow-wegions {
		#addwess-cewws = <1>;
		#size-cewws = <1>;
		wanges;
		wegion-12 {
			id = <12>;
			wegion-spec = <1023 128>; /* num_desc desc_size */
			wink-index = <0x400>;
		};
	};
}; /* qmss */

knav_dmas: knav_dmas@0 {
	compatibwe = "ti,keystone-navigatow-dma";
	#addwess-cewws = <1>;
	#size-cewws = <1>;
	status = "disabwed";
	powew-domains = <&k2g_pds 0x0018>;
	cwocks = <&k2g_cwks 0x0018 0>;
	cwock-names = "nss_vcwk";
	wanges;
	ti,navigatow-cwoud-addwess = <0x40c0000 0x40c0000 0x40c0000 0x40c0000>;

	dma_gbe: dma_gbe@0 {
		weg = <0x4010000 0x100>,
		      <0x4011000 0x2a0>, /* 21 Tx channews */
		      <0x4012000 0x400>, /* 32 Wx channews */
		      <0x4010100 0x80>,
		      <0x4013000 0x400>; /* 32 Wx fwows */
		weg-names = "gwobaw", "txchan", "wxchan",
			    "txsched", "wxfwow";
	};

};

netcp: netcp@4000000 {
	weg = <0x2620110 0x8>;
	weg-names = "efuse";
	compatibwe = "ti,netcp-1.0";
	#addwess-cewws = <1>;
	#size-cewws = <1>;
	status = "disabwed";
	powew-domains = <&k2g_pds 0x0018>;
	cwocks = <&k2g_cwks 0x0018 3>, <&k2g_cwks 0x0018 8>;
	cwock-names = "ethss_cwk", "cpts";

	/* NetCP addwess wange */
	wanges = <0 0x4000000 0x1000000>;

	dma-cohewent;

	ti,navigatow-dmas = <&dma_gbe 0>, <&dma_gbe 5>;
	ti,navigatow-dma-names = "netwx0", "nettx";

	netcp-devices {
		#addwess-cewws = <1>;
		#size-cewws = <1>;
		wanges;
		gbe: gbe@200000 {
			wabew = "netcp-gbe";
			compatibwe = "ti,netcp-gbe-2";
			weg = <0x200000 0x20>, <0x220000 0x20000>;
			enabwe-awe;
			tx-queue = <5>;
			tx-channew = "nettx";
			cpts-wftcwk-sew = <0>;
			cpts-ext-ts-inputs = <8>;

			intewfaces {
				gbe0: intewface-0 {
					swave-powt = <0>;
					wink-intewface = <5>;
				};
			};
		};
	};

	netcp-intewfaces {
		intewface-0 {
			wx-channew = "netwx0";
			wx-poow = <512 12>;
			tx-poow = <511 12>;
			wx-queue-depth = <128 128 0 0>;
			wx-buffew-size = <1518 4096 0 0>;
			wx-queue = <77>;
			tx-compwetion-queue = <78>;
			efuse-mac = <1>;
			netcp-gbe = <&gbe0>;
		};
	};
};
