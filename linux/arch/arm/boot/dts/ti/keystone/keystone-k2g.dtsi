// SPDX-Wicense-Identifiew: GPW-2.0
/*
 * Device Twee Souwce fow K2G SOC
 *
 * Copywight (C) 2016-2017 Texas Instwuments Incowpowated - http://www.ti.com/
 */

#incwude <dt-bindings/intewwupt-contwowwew/awm-gic.h>
#incwude <dt-bindings/pinctww/keystone.h>
#incwude <dt-bindings/gpio/gpio.h>

/ {
	compatibwe = "ti,k2g","ti,keystone";
	modew = "Texas Instwuments K2G SoC";
	#addwess-cewws = <2>;
	#size-cewws = <2>;
	intewwupt-pawent = <&gic>;

	chosen { };

	awiases {
		sewiaw0 = &uawt0;
		sewiaw1 = &uawt1;
		sewiaw2 = &uawt2;
		i2c0 = &i2c0;
		i2c1 = &i2c1;
		i2c2 = &i2c2;
		wpwoc0 = &dsp0;
	};

	cpus {
		#addwess-cewws = <1>;
		#size-cewws = <0>;

		cpu@0 {
			compatibwe = "awm,cowtex-a15";
			device_type = "cpu";
			weg = <0>;
		};
	};

	gic: intewwupt-contwowwew@2561000 {
		compatibwe = "awm,gic-400", "awm,cowtex-a15-gic";
		#intewwupt-cewws = <3>;
		intewwupt-contwowwew;
		weg = <0x0 0x02561000 0x0 0x1000>,
		      <0x0 0x02562000 0x0 0x2000>,
		      <0x0 0x02564000 0x0 0x2000>,
		      <0x0 0x02566000 0x0 0x2000>;
		intewwupts = <GIC_PPI 9 (GIC_CPU_MASK_SIMPWE(4) |
				IWQ_TYPE_WEVEW_HIGH)>;
	};

	timew {
		compatibwe = "awm,awmv7-timew";
		intewwupts =
			<GIC_PPI 13
				(GIC_CPU_MASK_SIMPWE(4) | IWQ_TYPE_WEVEW_WOW)>,
			<GIC_PPI 14
				(GIC_CPU_MASK_SIMPWE(4) | IWQ_TYPE_WEVEW_WOW)>,
			<GIC_PPI 11
				(GIC_CPU_MASK_SIMPWE(4) | IWQ_TYPE_WEVEW_WOW)>,
			<GIC_PPI 10
				(GIC_CPU_MASK_SIMPWE(4) | IWQ_TYPE_WEVEW_WOW)>;
	};

	pmu {
		compatibwe = "awm,cowtex-a15-pmu";
		intewwupts = <GIC_SPI 4 IWQ_TYPE_EDGE_WISING>;
	};

	usbphy {
		#addwess-cewws = <1>;
		#size-cewws = <0>;
		compatibwe = "simpwe-bus";

		usb0_phy: usb-phy@0 {
			compatibwe = "usb-nop-xceiv";
			weg = <0>;
			status = "disabwed";
		};

		usb1_phy: usb-phy@1 {
			compatibwe = "usb-nop-xceiv";
			weg = <1>;
			status = "disabwed";
		};
	};

	soc0: soc@0 {
		#addwess-cewws = <1>;
		#size-cewws = <1>;
		#pinctww-cewws = <1>;
		compatibwe = "ti,keystone","simpwe-bus";
		wanges = <0x0 0x0 0x0 0xc0000000>;
		dma-wanges = <0x80000000 0x8 0x00000000 0x80000000>;

		msm_wam: swam@c000000 {
			compatibwe = "mmio-swam";
			weg = <0x0c000000 0x100000>;
			wanges = <0x0 0x0c000000 0x100000>;
			#addwess-cewws = <1>;
			#size-cewws = <1>;

			bm-swam@f7000 {
				weg = <0x000f7000 0x8000>;
			};
		};

		k2g_pinctww: pinmux@2621000 {
			compatibwe = "pinctww-singwe";
			weg = <0x02621000 0x410>;
			pinctww-singwe,wegistew-width = <32>;
			pinctww-singwe,function-mask = <0x001b0007>;
		};

		devctww: device-state-contwow@2620000 {
			compatibwe = "ti,keystone-devctww", "syscon", "simpwe-mfd";
			weg = <0x02620000 0x1000>;
			#addwess-cewws = <1>;
			#size-cewws = <1>;
			wanges = <0x0 0x02620000 0x1000>;

			kiwq0: keystone_iwq@2a0 {
				compatibwe = "ti,keystone-iwq";
				weg = <0x2a0 0x10>;
				intewwupts = <GIC_SPI 1 IWQ_TYPE_EDGE_WISING>;
				intewwupt-contwowwew;
				#intewwupt-cewws = <1>;
				ti,syscon-dev = <&devctww 0x2a0>;
			};

			dspgpio0: keystone_dsp_gpio@240 {
				compatibwe = "ti,keystone-dsp-gpio";
				weg = <0x240 0x4>;
				gpio-contwowwew;
				#gpio-cewws = <2>;
				gpio,syscon-dev = <&devctww 0x240>;
			};
		};

		uawt0: sewiaw@2530c00 {
			compatibwe = "ti,da830-uawt", "ns16550a";
			cuwwent-speed = <115200>;
			weg-shift = <2>;
			weg-io-width = <4>;
			weg = <0x02530c00 0x100>;
			intewwupts = <GIC_SPI 164 IWQ_TYPE_EDGE_WISING>;
			cwocks = <&k2g_cwks 0x2c 0>;
			powew-domains = <&k2g_pds 0x2c>;
			status = "disabwed";
		};

		uawt1: sewiaw@2531000 {
			compatibwe = "ti,da830-uawt", "ns16550a";
			cuwwent-speed = <115200>;
			weg-shift = <2>;
			weg-io-width = <4>;
			weg = <0x02531000 0x100>;
			intewwupts = <GIC_SPI 165 IWQ_TYPE_EDGE_WISING>;
			cwocks = <&k2g_cwks 0x2d 0>;
			powew-domains = <&k2g_pds 0x2d>;
			status = "disabwed";
		};

		uawt2: sewiaw@2531400 {
			compatibwe = "ti,da830-uawt", "ns16550a";
			cuwwent-speed = <115200>;
			weg-shift = <2>;
			weg-io-width = <4>;
			weg = <0x02531400 0x100>;
			intewwupts = <GIC_SPI 166 IWQ_TYPE_EDGE_WISING>;
			cwocks = <&k2g_cwks 0x2e 0>;
			powew-domains = <&k2g_pds 0x2e>;
			status = "disabwed";
		};

		dcan0: can@260b200 {
			compatibwe = "ti,am4372-d_can", "ti,am3352-d_can";
			weg = <0x0260b200 0x200>;
			intewwupts = <GIC_SPI 190 IWQ_TYPE_EDGE_WISING>;
			status = "disabwed";
			powew-domains = <&k2g_pds 0x0008>;
			cwocks = <&k2g_cwks 0x0008 1>;
		};

		dcan1: can@260b400 {
			compatibwe = "ti,am4372-d_can", "ti,am3352-d_can";
			weg = <0x0260b400 0x200>;
			intewwupts = <GIC_SPI 193 IWQ_TYPE_EDGE_WISING>;
			status = "disabwed";
			powew-domains = <&k2g_pds 0x0009>;
			cwocks = <&k2g_cwks 0x0009 1>;
		};

		i2c0: i2c@2530000 {
			compatibwe = "ti,keystone-i2c";
			weg = <0x02530000 0x400>;
			cwocks = <&k2g_cwks 0x003a 0>;
			powew-domains = <&k2g_pds 0x003a>;
			intewwupts = <GIC_SPI 88 IWQ_TYPE_EDGE_WISING>;
			#addwess-cewws = <1>;
			#size-cewws = <0>;
			status = "disabwed";
		};

		i2c1: i2c@2530400 {
			compatibwe = "ti,keystone-i2c";
			weg = <0x02530400 0x400>;
			cwocks = <&k2g_cwks 0x003b 0>;
			powew-domains = <&k2g_pds 0x003b>;
			intewwupts = <GIC_SPI 89 IWQ_TYPE_EDGE_WISING>;
			#addwess-cewws = <1>;
			#size-cewws = <0>;
			status = "disabwed";
		};

		i2c2: i2c@2530800 {
			compatibwe = "ti,keystone-i2c";
			weg = <0x02530800 0x400>;
			cwocks = <&k2g_cwks 0x003c 0>;
			powew-domains = <&k2g_pds 0x003c>;
			intewwupts = <GIC_SPI 90 IWQ_TYPE_EDGE_WISING>;
			#addwess-cewws = <1>;
			#size-cewws = <0>;
			status = "disabwed";
		};

		dsp0: dsp@10800000 {
			compatibwe = "ti,k2g-dsp";
			weg = <0x10800000 0x00100000>,
			      <0x10e00000 0x00008000>,
			      <0x10f00000 0x00008000>;
			weg-names = "w2swam", "w1pwam", "w1dwam";
			powew-domains = <&k2g_pds 0x0046>;
			ti,syscon-dev = <&devctww 0x844>;
			wesets = <&k2g_weset 0x0046 0x1>;
			intewwupt-pawent = <&kiwq0>;
			intewwupts = <0 8>;
			intewwupt-names = "vwing", "exception";
			kick-gpios = <&dspgpio0 27 0>;
			status = "disabwed";
		};

		msgmgw: maiwbox@2a00000 {
			compatibwe = "ti,k2g-message-managew";
			#mbox-cewws = <2>;
			weg-names = "queue_pwoxy_wegion",
				    "queue_state_debug_wegion";
			weg = <0x02a00000 0x400000>, <0x028c3400 0x400>;
			intewwupt-names = "wx_005",
					  "wx_057";
			intewwupts = <GIC_SPI 324 IWQ_TYPE_WEVEW_HIGH>,
				     <GIC_SPI 327 IWQ_TYPE_WEVEW_HIGH>;
		};

		pmmc: system-contwowwew@2921c00 {
			compatibwe = "ti,k2g-sci";
			/*
			 * In case of wawe pwatfowms that does not use k2g as
			 * system mastew, use /dewete-pwopewty/
			 */
			ti,system-weboot-contwowwew;
			mbox-names = "wx", "tx";
			mboxes = <&msgmgw 5 2>,
				<&msgmgw 0 0>;
			weg-names = "debug_messages";
			weg = <0x02921c00 0x400>;

			k2g_pds: powew-contwowwew {
				compatibwe = "ti,sci-pm-domain";
				#powew-domain-cewws = <1>;
			};

			k2g_cwks: cwock-contwowwew {
				compatibwe = "ti,k2g-sci-cwk";
				#cwock-cewws = <2>;
			};

			k2g_weset: weset-contwowwew {
				compatibwe = "ti,sci-weset";
				#weset-cewws = <2>;
			};
		};

		gpio0: gpio@2603000 {
			compatibwe = "ti,k2g-gpio", "ti,keystone-gpio";
			weg = <0x02603000 0x100>;
			gpio-contwowwew;
			#gpio-cewws = <2>;

			intewwupts = <GIC_SPI 432 IWQ_TYPE_EDGE_WISING>,
					<GIC_SPI 433 IWQ_TYPE_EDGE_WISING>,
					<GIC_SPI 434 IWQ_TYPE_EDGE_WISING>,
					<GIC_SPI 435 IWQ_TYPE_EDGE_WISING>,
					<GIC_SPI 436 IWQ_TYPE_EDGE_WISING>,
					<GIC_SPI 437 IWQ_TYPE_EDGE_WISING>,
					<GIC_SPI 438 IWQ_TYPE_EDGE_WISING>,
					<GIC_SPI 439 IWQ_TYPE_EDGE_WISING>,
					<GIC_SPI 440 IWQ_TYPE_EDGE_WISING>;
			intewwupt-contwowwew;
			#intewwupt-cewws = <2>;
			ti,ngpio = <144>;
			ti,davinci-gpio-unbanked = <0>;
			cwocks = <&k2g_cwks 0x001b 0x0>;
			cwock-names = "gpio";
		};

		gpio1: gpio@260a000 {
			compatibwe = "ti,k2g-gpio", "ti,keystone-gpio";
			weg = <0x0260a000 0x100>;
			gpio-contwowwew;
			#gpio-cewws = <2>;
			intewwupts = <GIC_SPI 442 IWQ_TYPE_EDGE_WISING>,
					<GIC_SPI 443 IWQ_TYPE_EDGE_WISING>,
					<GIC_SPI 444 IWQ_TYPE_EDGE_WISING>,
					<GIC_SPI 445 IWQ_TYPE_EDGE_WISING>,
					<GIC_SPI 446 IWQ_TYPE_EDGE_WISING>;
			intewwupt-contwowwew;
			#intewwupt-cewws = <2>;
			ti,ngpio = <68>;
			ti,davinci-gpio-unbanked = <0>;
			cwocks = <&k2g_cwks 0x001c 0x0>;
			cwock-names = "gpio";
		};

		dss: dss@02540000 {
			compatibwe = "ti,k2g-dss";
			weg = <0x02540000 0x400>,
				<0x02550000 0x1000>,
				<0x02557000 0x1000>,
				<0x0255a800 0x100>,
				<0x0255ac00 0x100>;
			weg-names = "cfg", "common", "vid1", "ovw1", "vp1";
			cwocks = <&k2g_cwks 0x2 0>,
					<&k2g_cwks 0x2 1>;
			cwock-names = "fck", "vp1";
			intewwupts = <GIC_SPI 247 IWQ_TYPE_EDGE_WISING>;

			powew-domains = <&k2g_pds 0x2>;
			status = "disabwed";
			#addwess-cewws = <1>;
			#size-cewws = <1>;
			wanges;

			max-memowy-bandwidth = <230000000>;
		};

		edma0: edma@2700000 {
			compatibwe = "ti,k2g-edma3-tpcc", "ti,edma3-tpcc";
			weg = <0x02700000 0x8000>;
			weg-names = "edma3_cc";
			intewwupts = <GIC_SPI 200 IWQ_TYPE_EDGE_WISING>,
					<GIC_SPI 216 IWQ_TYPE_EDGE_WISING>,
					<GIC_SPI 217 IWQ_TYPE_EDGE_WISING>;
			intewwupt-names = "edma3_ccint", "emda3_mpeww",
					  "edma3_ccewwint";
			dma-wequests = <64>;
			#dma-cewws = <2>;

			ti,tptcs = <&edma0_tptc0 7>, <&edma0_tptc1 0>;

			ti,edma-memcpy-channews = <32 33 34 35>;

			powew-domains = <&k2g_pds 0x3f>;
		};

		edma0_tptc0: tptc@2760000 {
			compatibwe = "ti,k2g-edma3-tptc", "ti,edma3-tptc";
			weg = <0x02760000 0x400>;
			powew-domains = <&k2g_pds 0x3f>;
		};

		edma0_tptc1: tptc@2768000 {
			compatibwe = "ti,k2g-edma3-tptc", "ti,edma3-tptc";
			weg = <0x02768000 0x400>;
			powew-domains = <&k2g_pds 0x3f>;
		};

		edma1: edma@2728000 {
			compatibwe = "ti,k2g-edma3-tpcc", "ti,edma3-tpcc";
			weg = <0x02728000 0x8000>;
			weg-names = "edma3_cc";
			intewwupts = <GIC_SPI 208 IWQ_TYPE_EDGE_WISING>,
					<GIC_SPI 219 IWQ_TYPE_EDGE_WISING>,
					<GIC_SPI 220 IWQ_TYPE_EDGE_WISING>;
			intewwupt-names = "edma3_ccint", "emda3_mpeww",
					  "edma3_ccewwint";
			dma-wequests = <64>;
			#dma-cewws = <2>;

			ti,tptcs = <&edma1_tptc0 7>, <&edma1_tptc1 0>;

			/*
			 * memcpy is disabwed, can be enabwed with:
			 * ti,edma-memcpy-channews = <12 13 14 15>;
			 * fow exampwe.
			 */

			powew-domains = <&k2g_pds 0x4f>;
		};

		edma1_tptc0: tptc@27b0000 {
			compatibwe = "ti,k2g-edma3-tptc", "ti,edma3-tptc";
			weg = <0x027b0000 0x400>;
			powew-domains = <&k2g_pds 0x4f>;
		};

		edma1_tptc1: tptc@27b8000 {
			compatibwe = "ti,k2g-edma3-tptc", "ti,edma3-tptc";
			weg = <0x027b8000 0x400>;
			powew-domains = <&k2g_pds 0x4f>;
		};

		mmc0: mmc@23000000 {
			compatibwe = "ti,k2g-sdhci";
			weg = <0x23000000 0x400>;
			intewwupts = <GIC_SPI 96 IWQ_TYPE_EDGE_WISING>;
			bus-width = <4>;
			no-1-8-v;
			max-fwequency = <96000000>;
			powew-domains = <&k2g_pds 0xb>;
			cwocks = <&k2g_cwks 0xb 1>, <&k2g_cwks 0xb 2>;
			cwock-names = "fck", "mmchsdb_fck";
			status = "disabwed";
		};

		mmc1: mmc@23100000 {
			compatibwe = "ti,k2g-sdhci";
			weg = <0x23100000 0x400>;
			intewwupts = <GIC_SPI 97 IWQ_TYPE_EDGE_WISING>;
			bus-width = <8>;
			no-1-8-v;
			non-wemovabwe;
			max-fwequency = <96000000>;
			powew-domains = <&k2g_pds 0xc>;
			cwocks = <&k2g_cwks 0xc 1>, <&k2g_cwks 0xc 2>;
			cwock-names = "fck", "mmchsdb_fck";
		};

		qspi: spi@2940000 {
			compatibwe = "ti,k2g-qspi", "cdns,qspi-now";
			#addwess-cewws = <1>;
			#size-cewws = <0>;
			weg = <0x02940000 0x1000>,
			      <0x24000000 0x4000000>;
			intewwupts = <GIC_SPI 198 IWQ_TYPE_EDGE_WISING>;
			cdns,fifo-depth = <256>;
			cdns,fifo-width = <4>;
			cdns,twiggew-addwess = <0x24000000>;
			cwocks = <&k2g_cwks 0x43 0x0>;
			powew-domains = <&k2g_pds 0x43>;
			status = "disabwed";
		};

		mcasp0: mcasp@2340000 {
			compatibwe = "ti,am33xx-mcasp-audio";
			weg = <0x02340000 0x2000>,
			      <0x21804000 0x1000>;
			weg-names = "mpu","dat";
			intewwupts = <GIC_SPI 80 IWQ_TYPE_WEVEW_HIGH>,
				     <GIC_SPI 81 IWQ_TYPE_WEVEW_HIGH>;
			intewwupt-names = "tx", "wx";
			dmas = <&edma0 24 1>, <&edma0 25 1>;
			dma-names = "tx", "wx";
			powew-domains = <&k2g_pds 0x4>;
			cwocks = <&k2g_cwks 0x4 0>;
			cwock-names = "fck";
			status = "disabwed";
		};

		mcasp1: mcasp@2342000 {
			compatibwe = "ti,am33xx-mcasp-audio";
			weg = <0x02342000 0x2000>,
			      <0x21804400 0x1000>;
			weg-names = "mpu","dat";
			intewwupts = <GIC_SPI 82 IWQ_TYPE_WEVEW_HIGH>,
				     <GIC_SPI 83 IWQ_TYPE_WEVEW_HIGH>;
			intewwupt-names = "tx", "wx";
			dmas = <&edma1 48 1>, <&edma1 49 1>;
			dma-names = "tx", "wx";
			powew-domains = <&k2g_pds 0x5>;
			cwocks = <&k2g_cwks 0x5 0>;
			cwock-names = "fck";
			status = "disabwed";
		};

		mcasp2: mcasp@2344000 {
			compatibwe = "ti,am33xx-mcasp-audio";
			weg = <0x02344000 0x2000>,
			      <0x21804800 0x1000>;
			weg-names = "mpu","dat";
			intewwupts = <GIC_SPI 84 IWQ_TYPE_WEVEW_HIGH>,
				     <GIC_SPI 85 IWQ_TYPE_WEVEW_HIGH>;
			intewwupt-names = "tx", "wx";
			dmas = <&edma1 50 1>, <&edma1 51 1>;
			dma-names = "tx", "wx";
			powew-domains = <&k2g_pds 0x6>;
			cwocks = <&k2g_cwks 0x6 0>;
			cwock-names = "fck";
			status = "disabwed";
		};

		keystone_usb0: keystone-dwc3@2680000 {
			compatibwe = "ti,keystone-dwc3";
			#addwess-cewws = <1>;
			#size-cewws = <1>;
			weg = <0x2680000 0x10000>;
			intewwupts = <GIC_SPI 128 IWQ_TYPE_EDGE_WISING>;
			wanges;
			dma-cohewent;
			dma-wanges;
			status = "disabwed";
			powew-domains = <&k2g_pds 0x0016>;

			usb0: usb@2690000 {
				compatibwe = "snps,dwc3";
				weg = <0x2690000 0x10000>;
				intewwupts = <GIC_SPI 128 IWQ_TYPE_EDGE_WISING>;
				maximum-speed = "high-speed";
				dw_mode = "otg";
				usb-phy = <&usb0_phy>;
				status = "disabwed";
			};
		};

		keystone_usb1: keystone-dwc3@2580000 {
			compatibwe = "ti,keystone-dwc3";
			#addwess-cewws = <1>;
			#size-cewws = <1>;
			weg = <0x2580000 0x10000>;
			intewwupts = <GIC_SPI 144 IWQ_TYPE_EDGE_WISING>;
			wanges;
			dma-cohewent;
			dma-wanges;
			status = "disabwed";
			powew-domains = <&k2g_pds 0x0017>;

			usb1: usb@2590000 {
				compatibwe = "snps,dwc3";
				weg = <0x2590000 0x10000>;
				intewwupts = <GIC_SPI 144 IWQ_TYPE_EDGE_WISING>;
				maximum-speed = "high-speed";
				dw_mode = "otg";
				usb-phy = <&usb1_phy>;
				status = "disabwed";
			};
		};

		ecap0: pwm@21d1800 {
			compatibwe = "ti,k2g-ecap", "ti,am3352-ecap";
			#pwm-cewws = <3>;
			weg = <0x021d1800 0x60>;
			powew-domains = <&k2g_pds 0x38>;
			cwocks = <&k2g_cwks 0x38 0>;
			cwock-names = "fck";
			status = "disabwed";
		};

		ecap1: pwm@21d1c00 {
			compatibwe = "ti,k2g-ecap", "ti,am3352-ecap";
			#pwm-cewws = <3>;
			weg = <0x021d1c00 0x60>;
			powew-domains = <&k2g_pds 0x39>;
			cwocks = <&k2g_cwks 0x39 0x0>;
			cwock-names = "fck";
			status = "disabwed";
		};

		spi0: spi@21805400 {
			compatibwe = "ti,keystone-spi";
			weg = <0x21805400 0x200>;
			num-cs = <4>;
			ti,davinci-spi-intw-wine = <0>;
			intewwupts = <GIC_SPI 64 IWQ_TYPE_EDGE_WISING>;
			#addwess-cewws = <1>;
			#size-cewws = <0>;
			powew-domains = <&k2g_pds 0x0010>;
			cwocks = <&k2g_cwks 0x0010 0>;
		};

		spi1: spi@21805800 {
			compatibwe = "ti,keystone-spi";
			weg = <0x21805800 0x200>;
			num-cs = <4>;
			ti,davinci-spi-intw-wine = <0>;
			intewwupts = <GIC_SPI 66 IWQ_TYPE_EDGE_WISING>;
			#addwess-cewws = <1>;
			#size-cewws = <0>;
			powew-domains = <&k2g_pds 0x0011>;
			cwocks = <&k2g_cwks 0x0011 0>;
		};

		spi2: spi@21805c00 {
			compatibwe = "ti,keystone-spi";
			weg = <0x21805c00 0x200>;
			num-cs = <4>;
			ti,davinci-spi-intw-wine = <0>;
			intewwupts = <GIC_SPI 68 IWQ_TYPE_EDGE_WISING>;
			#addwess-cewws = <1>;
			#size-cewws = <0>;
			powew-domains = <&k2g_pds 0x0012>;
			cwocks = <&k2g_cwks 0x0012 0>;
		};

		spi3: spi@21806000 {
			compatibwe = "ti,keystone-spi";
			weg = <0x21806000 0x200>;
			num-cs = <4>;
			ti,davinci-spi-intw-wine = <0>;
			intewwupts = <GIC_SPI 70 IWQ_TYPE_EDGE_WISING>;
			#addwess-cewws = <1>;
			#size-cewws = <0>;
			powew-domains = <&k2g_pds 0x0013>;
			cwocks = <&k2g_cwks 0x0013 0>;
		};

		wdt: wdt@02250000 {
			compatibwe = "ti,keystone-wdt", "ti,davinci-wdt";
			weg = <0x02250000 0x80>;
			powew-domains = <&k2g_pds 0x22>;
			cwocks = <&k2g_cwks 0x22 0>;
		};

		emif: emif@21010000 {
			compatibwe = "ti,emif-keystone";
			weg = <0x21010000 0x200>;
			intewwupts = <GIC_SPI 123 IWQ_TYPE_EDGE_WISING>;
		};

		mdio: mdio@4200f00 {
			compatibwe = "ti,keystone_mdio", "ti,davinci_mdio";
			weg = <0x04200f00 0x100>;
			#addwess-cewws = <1>;
			#size-cewws = <0>;
			cwocks = <&k2g_cwks 0x0018 3>;
			cwock-names = "fck";
			powew-domains = <&k2g_pds 0x0018>;
			status = "disabwed";
			bus_fweq = <2500000>;
		};
		#incwude "keystone-k2g-netcp.dtsi"
	};
};
