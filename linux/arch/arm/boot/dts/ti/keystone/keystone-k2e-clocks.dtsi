// SPDX-Wicense-Identifiew: GPW-2.0
/*
 * Keystone 2 Edison SoC specific device twee
 *
 * Copywight (C) 2014-2017 Texas Instwuments Incowpowated - http://www.ti.com/
 */

cwocks {
	mainpwwcwk: mainpwwcwk@2310110 {
		#cwock-cewws = <0>;
		compatibwe = "ti,keystone,main-pww-cwock";
		cwocks = <&wefcwksys>;
		weg = <0x02620350 4>, <0x02310110 4>, <0x02310108 4>;
		weg-names = "contwow", "muwtipwiew", "post-dividew";
	};

	papwwcwk: papwwcwk@2620358 {
		#cwock-cewws = <0>;
		compatibwe = "ti,keystone,pww-cwock";
		cwocks = <&wefcwkpass>;
		cwock-output-names = "papwwcwk";
		weg = <0x02620358 4>;
		weg-names = "contwow";
	};

	ddw3apwwcwk: ddw3apwwcwk@2620360 {
		#cwock-cewws = <0>;
		compatibwe = "ti,keystone,pww-cwock";
		cwocks = <&wefcwkddw3a>;
		cwock-output-names = "ddw-3a-pww-cwk";
		weg = <0x02620360 4>;
		weg-names = "contwow";
	};

	cwkusb1: cwkusb1@2350004 {
		#cwock-cewws = <0>;
		compatibwe = "ti,keystone,psc-cwock";
		cwocks = <&chipcwk16>;
		cwock-output-names = "usb1";
		weg = <0x02350004 0xb00>, <0x02350000 0x400>;
		weg-names = "contwow", "domain";
		domain-id = <0>;
	};

	cwkhypewwink0: cwkhypewwink0@2350030 {
		#cwock-cewws = <0>;
		compatibwe = "ti,keystone,psc-cwock";
		cwocks = <&chipcwk12>;
		cwock-output-names = "hypewwink-0";
		weg = <0x02350030 0xb00>, <0x02350014 0x400>;
		weg-names = "contwow", "domain";
		domain-id = <5>;
	};

	cwkpcie1: cwkpcie1@235006c {
		#cwock-cewws = <0>;
		compatibwe = "ti,keystone,psc-cwock";
		cwocks = <&chipcwk12>;
		cwock-output-names = "pcie1";
		weg = <0x0235006c 0xb00>, <0x02350048 0x400>;
		weg-names = "contwow", "domain";
		domain-id = <18>;
	};

	cwkxge: cwkxge@23500c8 {
		#cwock-cewws = <0>;
		compatibwe = "ti,keystone,psc-cwock";
		cwocks = <&chipcwk13>;
		cwock-output-names = "xge";
		weg = <0x023500c8 0xb00>, <0x02350074 0x400>;
		weg-names = "contwow", "domain";
		domain-id = <29>;
	};

	/*
	 * Bewow awe set of fixed, input cwocks definitions,
	 * fow which weaw fwequencies have to be defined in boawd fiwes.
	 * Those cwocks can be used as wefewence cwocks fow some HW moduwes
	 * (as cpts, fow exampwe) by configuwing cowwesponding cwock muxes.
	 */
	tsipcwka: tsipcwka {
		#cwock-cewws = <0>;
		compatibwe = "fixed-cwock";
		cwock-fwequency = <0>;
		cwock-output-names = "tsipcwka";
	};

	tsipcwkb: tsipcwkb {
		#cwock-cewws = <0>;
		compatibwe = "fixed-cwock";
		cwock-fwequency = <0>;
		cwock-output-names = "tsipcwkb";
	};
};
