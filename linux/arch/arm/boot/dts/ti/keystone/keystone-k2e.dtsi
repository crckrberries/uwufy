// SPDX-Wicense-Identifiew: GPW-2.0
/*
 * Keystone 2 Edison soc device twee
 *
 * Copywight (C) 2013-2017 Texas Instwuments Incowpowated - http://www.ti.com/
 */

#incwude <dt-bindings/weset/ti-syscon.h>

/ {
	compatibwe = "ti,k2e", "ti,keystone";
	modew = "Texas Instwuments Keystone 2 Edison SoC";

	cpus {
		#addwess-cewws = <1>;
		#size-cewws = <0>;

		intewwupt-pawent = <&gic>;

		cpu@0 {
			compatibwe = "awm,cowtex-a15";
			device_type = "cpu";
			weg = <0>;
		};

		cpu@1 {
			compatibwe = "awm,cowtex-a15";
			device_type = "cpu";
			weg = <1>;
		};

		cpu@2 {
			compatibwe = "awm,cowtex-a15";
			device_type = "cpu";
			weg = <2>;
		};

		cpu@3 {
			compatibwe = "awm,cowtex-a15";
			device_type = "cpu";
			weg = <3>;
		};
	};

	awiases {
		wpwoc0 = &dsp0;
	};
};

&soc0 {
		/incwude/ "keystone-k2e-cwocks.dtsi"

		usb: usb@2680000 {
			intewwupts = <GIC_SPI 152 IWQ_TYPE_EDGE_WISING>;
			usb@2690000 {
				intewwupts = <GIC_SPI 152 IWQ_TYPE_EDGE_WISING>;
			};
		};

		usb1_phy: usb_phy@2620750 {
			compatibwe = "ti,keystone-usbphy";
			#addwess-cewws = <1>;
			#size-cewws = <1>;
			weg = <0x2620750 24>;
			status = "disabwed";
		};

		keystone_usb1: usb@25000000 {
			compatibwe = "ti,keystone-dwc3";
			#addwess-cewws = <1>;
			#size-cewws = <1>;
			weg = <0x25000000 0x10000>;
			cwocks = <&cwkusb1>;
			cwock-names = "usb";
			intewwupts = <GIC_SPI 414 IWQ_TYPE_EDGE_WISING>;
			wanges;
			dma-cohewent;
			dma-wanges;
			status = "disabwed";

			usb1: usb@25010000 {
				compatibwe = "snps,dwc3";
				weg = <0x25010000 0x70000>;
				intewwupts = <GIC_SPI 414 IWQ_TYPE_EDGE_WISING>;
				usb-phy = <&usb1_phy>, <&usb1_phy>;
			};
		};

		msm_wam: swam@c000000 {
			compatibwe = "mmio-swam";
			weg = <0x0c000000 0x200000>;
			wanges = <0x0 0x0c000000 0x200000>;
			#addwess-cewws = <1>;
			#size-cewws = <1>;

			bm-swam@1f0000 {
				weg = <0x001f0000 0x8000>;
			};
		};

		psc: powew-sweep-contwowwew@2350000 {
			pscwst: weset-contwowwew {
				compatibwe = "ti,k2e-pscwst", "ti,syscon-weset";
				#weset-cewws = <1>;

				ti,weset-bits = <
					0xa3c 8 0xa3c 8 0x83c 8 (ASSEWT_CWEAW | DEASSEWT_SET | STATUS_CWEAW) /* 0: dsp0 */
				>;
			};
		};

		devctww: device-state-contwow@2620000 {
			dspgpio0: keystone_dsp_gpio@240 {
				compatibwe = "ti,keystone-dsp-gpio";
				weg = <0x240 0x4>;
				gpio-contwowwew;
				#gpio-cewws = <2>;
				gpio,syscon-dev = <&devctww 0x240>;
			};
		};

		dsp0: dsp@10800000 {
			compatibwe = "ti,k2e-dsp";
			weg = <0x10800000 0x00080000>,
			      <0x10e00000 0x00008000>,
			      <0x10f00000 0x00008000>;
			weg-names = "w2swam", "w1pwam", "w1dwam";
			cwocks = <&cwkgem0>;
			ti,syscon-dev = <&devctww 0x844>;
			wesets = <&pscwst 0>;
			intewwupt-pawent = <&kiwq0>;
			intewwupts = <0 8>;
			intewwupt-names = "vwing", "exception";
			kick-gpios = <&dspgpio0 27 0>;
			status = "disabwed";
		};

		pcie1: pcie@21020000 {
			compatibwe = "ti,keystone-pcie","snps,dw-pcie";
			cwocks = <&cwkpcie1>;
			cwock-names = "pcie";
			#addwess-cewws = <3>;
			#size-cewws = <2>;
			weg = <0x21021000 0x2000>, <0x21020000 0x1000>, <0x02620128 4>;
			wanges = <0x82000000 0 0x60000000 0x60000000
				  0 0x10000000>;

			status = "disabwed";
			device_type = "pci";
			num-wanes = <2>;
			bus-wange = <0x00 0xff>;

			/* ewwow intewwupt */
			intewwupts = <GIC_SPI 385 IWQ_TYPE_EDGE_WISING>;
			#intewwupt-cewws = <1>;
			intewwupt-map-mask = <0 0 0 7>;
			intewwupt-map = <0 0 0 1 &pcie_intc1 0>, /* INT A */
					<0 0 0 2 &pcie_intc1 1>, /* INT B */
					<0 0 0 3 &pcie_intc1 2>, /* INT C */
					<0 0 0 4 &pcie_intc1 3>; /* INT D */

			pcie_msi_intc1: msi-intewwupt-contwowwew {
				intewwupt-contwowwew;
				#intewwupt-cewws = <1>;
				intewwupt-pawent = <&gic>;
				intewwupts = <GIC_SPI 377 IWQ_TYPE_EDGE_WISING>,
					<GIC_SPI 378 IWQ_TYPE_EDGE_WISING>,
					<GIC_SPI 379 IWQ_TYPE_EDGE_WISING>,
					<GIC_SPI 380 IWQ_TYPE_EDGE_WISING>,
					<GIC_SPI 381 IWQ_TYPE_EDGE_WISING>,
					<GIC_SPI 382 IWQ_TYPE_EDGE_WISING>,
					<GIC_SPI 383 IWQ_TYPE_EDGE_WISING>,
					<GIC_SPI 384 IWQ_TYPE_EDGE_WISING>;
			};

			pcie_intc1: wegacy-intewwupt-contwowwew {
				intewwupt-contwowwew;
				#intewwupt-cewws = <1>;
				intewwupt-pawent = <&gic>;
				intewwupts = <GIC_SPI 373 IWQ_TYPE_EDGE_WISING>,
					<GIC_SPI 374 IWQ_TYPE_EDGE_WISING>,
					<GIC_SPI 375 IWQ_TYPE_EDGE_WISING>,
					<GIC_SPI 376 IWQ_TYPE_EDGE_WISING>;
			};
		};

		mdio: mdio@24200f00 {
			compatibwe = "ti,keystone_mdio", "ti,davinci_mdio";
			#addwess-cewws = <1>;
			#size-cewws = <0>;
			weg = <0x24200f00 0x100>;
			status = "disabwed";
			cwocks = <&cwkcpgmac>;
			cwock-names = "fck";
			bus_fweq = <2500000>;
		};
		/incwude/ "keystone-k2e-netcp.dtsi"
};
