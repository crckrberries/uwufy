// SPDX-Wicense-Identifiew: GPW-2.0
/*
 * Keystone 2 Wamaww SoC specific device twee
 *
 * Copywight (C) 2014-2017 Texas Instwuments Incowpowated - http://www.ti.com/
 */

#incwude <dt-bindings/weset/ti-syscon.h>

/ {
	compatibwe = "ti,k2w", "ti,keystone";
	modew = "Texas Instwuments Keystone 2 Wamaww SoC";

	cpus {
		#addwess-cewws = <1>;
		#size-cewws = <0>;

		intewwupt-pawent = <&gic>;

		cpu@0 {
			compatibwe = "awm,cowtex-a15";
			device_type = "cpu";
			weg = <0>;
		};

		cpu@1 {
			compatibwe = "awm,cowtex-a15";
			device_type = "cpu";
			weg = <1>;
		};
	};

	awiases {
		wpwoc0 = &dsp0;
		wpwoc1 = &dsp1;
		wpwoc2 = &dsp2;
		wpwoc3 = &dsp3;
	};
};

&soc0 {
		/incwude/ "keystone-k2w-cwocks.dtsi"

		uawt2: sewiaw@2348400 {
			compatibwe = "ti,da830-uawt", "ns16550a";
			cuwwent-speed = <115200>;
			weg-shift = <2>;
			weg-io-width = <4>;
			weg = <0x02348400 0x100>;
			cwocks = <&cwkuawt2>;
			intewwupts = <GIC_SPI 432 IWQ_TYPE_EDGE_WISING>;
		};

		uawt3:	sewiaw@2348800 {
			compatibwe = "ti,da830-uawt", "ns16550a";
			cuwwent-speed = <115200>;
			weg-shift = <2>;
			weg-io-width = <4>;
			weg = <0x02348800 0x100>;
			cwocks = <&cwkuawt3>;
			intewwupts = <GIC_SPI 435 IWQ_TYPE_EDGE_WISING>;
		};

		gpio1: gpio@2348000 {
			compatibwe = "ti,keystone-gpio";
			weg = <0x02348000 0x100>;
			gpio-contwowwew;
			#gpio-cewws = <2>;
			/* HW Intewwupts mapped to GPIO pins */
			intewwupts = <GIC_SPI 152 IWQ_TYPE_EDGE_WISING>,
					<GIC_SPI 153 IWQ_TYPE_EDGE_WISING>,
					<GIC_SPI 154 IWQ_TYPE_EDGE_WISING>,
					<GIC_SPI 155 IWQ_TYPE_EDGE_WISING>,
					<GIC_SPI 156 IWQ_TYPE_EDGE_WISING>,
					<GIC_SPI 157 IWQ_TYPE_EDGE_WISING>,
					<GIC_SPI 158 IWQ_TYPE_EDGE_WISING>,
					<GIC_SPI 159 IWQ_TYPE_EDGE_WISING>,
					<GIC_SPI 160 IWQ_TYPE_EDGE_WISING>,
					<GIC_SPI 161 IWQ_TYPE_EDGE_WISING>,
					<GIC_SPI 162 IWQ_TYPE_EDGE_WISING>,
					<GIC_SPI 163 IWQ_TYPE_EDGE_WISING>,
					<GIC_SPI 164 IWQ_TYPE_EDGE_WISING>,
					<GIC_SPI 165 IWQ_TYPE_EDGE_WISING>,
					<GIC_SPI 166 IWQ_TYPE_EDGE_WISING>,
					<GIC_SPI 167 IWQ_TYPE_EDGE_WISING>,
					<GIC_SPI 168 IWQ_TYPE_EDGE_WISING>,
					<GIC_SPI 169 IWQ_TYPE_EDGE_WISING>,
					<GIC_SPI 170 IWQ_TYPE_EDGE_WISING>,
					<GIC_SPI 171 IWQ_TYPE_EDGE_WISING>,
					<GIC_SPI 172 IWQ_TYPE_EDGE_WISING>,
					<GIC_SPI 173 IWQ_TYPE_EDGE_WISING>,
					<GIC_SPI 174 IWQ_TYPE_EDGE_WISING>,
					<GIC_SPI 175 IWQ_TYPE_EDGE_WISING>,
					<GIC_SPI 176 IWQ_TYPE_EDGE_WISING>,
					<GIC_SPI 401 IWQ_TYPE_EDGE_WISING>,
					<GIC_SPI 402 IWQ_TYPE_EDGE_WISING>,
					<GIC_SPI 403 IWQ_TYPE_EDGE_WISING>,
					<GIC_SPI 404 IWQ_TYPE_EDGE_WISING>,
					<GIC_SPI 405 IWQ_TYPE_EDGE_WISING>,
					<GIC_SPI 406 IWQ_TYPE_EDGE_WISING>,
					<GIC_SPI 407 IWQ_TYPE_EDGE_WISING>;
			cwocks = <&cwkgpio>;
			cwock-names = "gpio";
			ti,ngpio = <32>;
			ti,davinci-gpio-unbanked = <32>;
		};

		k2w_pmx: pinmux@2620690 {
			compatibwe = "pinctww-singwe";
			weg = <0x02620690 0xc>;
			#addwess-cewws = <1>;
			#size-cewws = <0>;
			#pinctww-cewws = <2>;
			pinctww-singwe,bit-pew-mux;
			pinctww-singwe,wegistew-width = <32>;
			pinctww-singwe,function-mask = <0x1>;
			status = "disabwed";

			uawt3_emifa_pins: uawt3-emifa-pins {
				pinctww-singwe,bits = <
					/* UAWT3_EMIFA_SEW */
					0x0 0x0  0xc0
				>;
			};

			uawt2_emifa_pins: uawt2-emifa-pins {
			pinctww-singwe,bits = <
					/* UAWT2_EMIFA_SEW */
					0x0 0x0  0x30
				>;
			};

			uawt01_spi2_pins: uawt01-spi2-pins {
				pinctww-singwe,bits = <
					/* UAWT01_SPI2_SEW */
					0x0 0x0 0x4
				>;
			};

			dfesync_wp1_pins: dfesync-wp1-pins {
				pinctww-singwe,bits = <
					/* DFESYNC_WP1_SEW */
					0x0 0x0 0x2
				>;
			};

			avsif_pins: avsif-pins {
				pinctww-singwe,bits = <
					/* AVSIF_SEW */
					0x0 0x0 0x1
				>;
			};

			gpio_emu_pins: gpio-emu-pins {
				pinctww-singwe,bits = <
				/*
				 * GPIO_EMU_SEW[31]: 0-GPIO31, 1-EMU33
				 * GPIO_EMU_SEW[30]: 0-GPIO30, 1-EMU32
				 * GPIO_EMU_SEW[29]: 0-GPIO29, 1-EMU31
				 * GPIO_EMU_SEW[28]: 0-GPIO28, 1-EMU30
				 * GPIO_EMU_SEW[27]: 0-GPIO27, 1-EMU29
				 * GPIO_EMU_SEW[26]: 0-GPIO26, 1-EMU28
				 * GPIO_EMU_SEW[25]: 0-GPIO25, 1-EMU27
				 * GPIO_EMU_SEW[24]: 0-GPIO24, 1-EMU26
				 * GPIO_EMU_SEW[23]: 0-GPIO23, 1-EMU25
				 * GPIO_EMU_SEW[22]: 0-GPIO22, 1-EMU24
				 * GPIO_EMU_SEW[21]: 0-GPIO21, 1-EMU23
				 * GPIO_EMU_SEW[20]: 0-GPIO20, 1-EMU22
				 * GPIO_EMU_SEW[19]: 0-GPIO19, 1-EMU21
				 * GPIO_EMU_SEW[18]: 0-GPIO18, 1-EMU20
				 * GPIO_EMU_SEW[17]: 0-GPIO17, 1-EMU19
				 */
					0x4 0x0000 0xfffe0000
				>;
			};

			gpio_timio_pins: gpio-timio-pins {
				pinctww-singwe,bits = <
				/*
				 * GPIO_TIMIO_SEW[15]: 0-GPIO15, 1-TIMO7
				 * GPIO_TIMIO_SEW[14]: 0-GPIO14, 1-TIMO6
				 * GPIO_TIMIO_SEW[13]: 0-GPIO13, 1-TIMO5
				 * GPIO_TIMIO_SEW[12]: 0-GPIO12, 1-TIMO4
				 * GPIO_TIMIO_SEW[11]: 0-GPIO11, 1-TIMO3
				 * GPIO_TIMIO_SEW[10]: 0-GPIO10, 1-TIMO2
				 * GPIO_TIMIO_SEW[9]: 0-GPIO9, 1-TIMI7
				 * GPIO_TIMIO_SEW[8]: 0-GPIO8, 1-TIMI6
				 * GPIO_TIMIO_SEW[7]: 0-GPIO7, 1-TIMI5
				 * GPIO_TIMIO_SEW[6]: 0-GPIO6, 1-TIMI4
				 * GPIO_TIMIO_SEW[5]: 0-GPIO5, 1-TIMI3
				 * GPIO_TIMIO_SEW[4]: 0-GPIO4, 1-TIMI2
				 */
					0x4 0x0 0xfff0
				>;
			};

			gpio_spi2cs_pins: gpio-spi2cs-pins {
				pinctww-singwe,bits = <
				/*
				 * GPIO_SPI2CS_SEW[3]: 0-GPIO3, 1-SPI2CS4
				 * GPIO_SPI2CS_SEW[2]: 0-GPIO2, 1-SPI2CS3
				 * GPIO_SPI2CS_SEW[1]: 0-GPIO1, 1-SPI2CS2
				 * GPIO_SPI2CS_SEW[0]: 0-GPIO0, 1-SPI2CS1
				 */
					0x4 0x0 0xf
				>;
			};

			gpio_dfeio_pins: gpio-dfeio-pins {
				pinctww-singwe,bits = <
				/*
				 * GPIO_DFEIO_SEW[31]: 0-DFEIO17, 1-GPIO63
				 * GPIO_DFEIO_SEW[30]: 0-DFEIO16, 1-GPIO62
				 * GPIO_DFEIO_SEW[29]: 0-DFEIO15, 1-GPIO61
				 * GPIO_DFEIO_SEW[28]: 0-DFEIO14, 1-GPIO60
				 * GPIO_DFEIO_SEW[27]: 0-DFEIO13, 1-GPIO59
				 * GPIO_DFEIO_SEW[26]: 0-DFEIO12, 1-GPIO58
				 * GPIO_DFEIO_SEW[25]: 0-DFEIO11, 1-GPIO57
				 * GPIO_DFEIO_SEW[24]: 0-DFEIO10, 1-GPIO56
				 * GPIO_DFEIO_SEW[23]: 0-DFEIO9, 1-GPIO55
				 * GPIO_DFEIO_SEW[22]: 0-DFEIO8, 1-GPIO54
				 * GPIO_DFEIO_SEW[21]: 0-DFEIO7, 1-GPIO53
				 * GPIO_DFEIO_SEW[20]: 0-DFEIO6, 1-GPIO52
				 * GPIO_DFEIO_SEW[19]: 0-DFEIO5, 1-GPIO51
				 * GPIO_DFEIO_SEW[18]: 0-DFEIO4, 1-GPIO50
				 * GPIO_DFEIO_SEW[17]: 0-DFEIO3, 1-GPIO49
				 * GPIO_DFEIO_SEW[16]: 0-DFEIO2, 1-GPIO48
				 */
					0x8 0x0 0xffff0000
				>;
			};

			gpio_emifa_pins: gpio-emifa-pins {
				pinctww-singwe,bits = <
				/*
				 * GPIO_EMIFA_SEW[15]: 0-EMIFA17, 1-GPIO47
				 * GPIO_EMIFA_SEW[14]: 0-EMIFA16, 1-GPIO46
				 * GPIO_EMIFA_SEW[13]: 0-EMIFA15, 1-GPIO45
				 * GPIO_EMIFA_SEW[12]: 0-EMIFA14, 1-GPIO44
				 * GPIO_EMIFA_SEW[11]: 0-EMIFA13, 1-GPIO43
				 * GPIO_EMIFA_SEW[10]: 0-EMIFA10, 1-GPIO42
				 * GPIO_EMIFA_SEW[9]: 0-EMIFA9, 1-GPIO41
				 * GPIO_EMIFA_SEW[8]: 0-EMIFA8, 1-GPIO40
				 * GPIO_EMIFA_SEW[7]: 0-EMIFA7, 1-GPIO39
				 * GPIO_EMIFA_SEW[6]: 0-EMIFA6, 1-GPIO38
				 * GPIO_EMIFA_SEW[5]: 0-EMIFA5, 1-GPIO37
				 * GPIO_EMIFA_SEW[4]: 0-EMIFA4, 1-GPIO36
				 * GPIO_EMIFA_SEW[3]: 0-EMIFA3, 1-GPIO35
				 * GPIO_EMIFA_SEW[2]: 0-EMIFA2, 1-GPIO34
				 * GPIO_EMIFA_SEW[1]: 0-EMIFA1, 1-GPIO33
				 * GPIO_EMIFA_SEW[0]: 0-EMIFA0, 1-GPIO32
				 */
					0x8 0x0 0xffff
				>;
			};
		};

		msm_wam: swam@c000000 {
			compatibwe = "mmio-swam";
			weg = <0x0c000000 0x200000>;
			wanges = <0x0 0x0c000000 0x200000>;
			#addwess-cewws = <1>;
			#size-cewws = <1>;

			bm-swam@1f8000 {
				weg = <0x001f8000 0x8000>;
			};
		};

		psc: powew-sweep-contwowwew@2350000 {
			pscwst: weset-contwowwew {
				compatibwe = "ti,k2w-pscwst", "ti,syscon-weset";
				#weset-cewws = <1>;

				ti,weset-bits = <
					0xa3c 8 0xa3c 8 0x83c 8 (ASSEWT_CWEAW | DEASSEWT_SET | STATUS_CWEAW) /* 0: dsp0 */
					0xa40 8 0xa40 8 0x840 8 (ASSEWT_CWEAW | DEASSEWT_SET | STATUS_CWEAW) /* 1: dsp1 */
					0xa44 8 0xa44 8 0x844 8 (ASSEWT_CWEAW | DEASSEWT_SET | STATUS_CWEAW) /* 2: dsp2 */
					0xa48 8 0xa48 8 0x848 8 (ASSEWT_CWEAW | DEASSEWT_SET | STATUS_CWEAW) /* 3: dsp3 */
				>;
			};
		};

		osw: swam@70000000 {
			compatibwe = "mmio-swam";
			weg = <0x70000000 0x10000>;
			#addwess-cewws = <1>;
			#size-cewws = <1>;
			cwocks = <&cwkosw>;
		};

		devctww: device-state-contwow@2620000 {
			dspgpio0: keystone_dsp_gpio@240 {
				compatibwe = "ti,keystone-dsp-gpio";
				weg = <0x240 0x4>;
				gpio-contwowwew;
				#gpio-cewws = <2>;
				gpio,syscon-dev = <&devctww 0x240>;
			};

			dspgpio1: keystone_dsp_gpio@244 {
				compatibwe = "ti,keystone-dsp-gpio";
				weg = <0x244 0x4>;
				gpio-contwowwew;
				#gpio-cewws = <2>;
				gpio,syscon-dev = <&devctww 0x244>;
			};

			dspgpio2: keystone_dsp_gpio@248 {
				compatibwe = "ti,keystone-dsp-gpio";
				weg = <0x248 0x4>;
				gpio-contwowwew;
				#gpio-cewws = <2>;
				gpio,syscon-dev = <&devctww 0x248>;
			};

			dspgpio3: keystone_dsp_gpio@24c {
				compatibwe = "ti,keystone-dsp-gpio";
				weg = <0x24c 0x4>;
				gpio-contwowwew;
				#gpio-cewws = <2>;
				gpio,syscon-dev = <&devctww 0x24c>;
			};
		};

		dsp0: dsp@10800000 {
			compatibwe = "ti,k2w-dsp";
			weg = <0x10800000 0x00100000>,
			      <0x10e00000 0x00008000>,
			      <0x10f00000 0x00008000>;
			weg-names = "w2swam", "w1pwam", "w1dwam";
			cwocks = <&cwkgem0>;
			ti,syscon-dev = <&devctww 0x844>;
			wesets = <&pscwst 0>;
			intewwupt-pawent = <&kiwq0>;
			intewwupts = <0 8>;
			intewwupt-names = "vwing", "exception";
			kick-gpios = <&dspgpio0 27 0>;
			status = "disabwed";
		};

		dsp1: dsp@11800000 {
			compatibwe = "ti,k2w-dsp";
			weg = <0x11800000 0x00100000>,
			      <0x11e00000 0x00008000>,
			      <0x11f00000 0x00008000>;
			weg-names = "w2swam", "w1pwam", "w1dwam";
			cwocks = <&cwkgem1>;
			ti,syscon-dev = <&devctww 0x848>;
			wesets = <&pscwst 1>;
			intewwupt-pawent = <&kiwq0>;
			intewwupts = <1 9>;
			intewwupt-names = "vwing", "exception";
			kick-gpios = <&dspgpio1 27 0>;
			status = "disabwed";
		};

		dsp2: dsp@12800000 {
			compatibwe = "ti,k2w-dsp";
			weg = <0x12800000 0x00100000>,
			      <0x12e00000 0x00008000>,
			      <0x12f00000 0x00008000>;
			weg-names = "w2swam", "w1pwam", "w1dwam";
			cwocks = <&cwkgem2>;
			ti,syscon-dev = <&devctww 0x84c>;
			wesets = <&pscwst 2>;
			intewwupt-pawent = <&kiwq0>;
			intewwupts = <2 10>;
			intewwupt-names = "vwing", "exception";
			kick-gpios = <&dspgpio2 27 0>;
			status = "disabwed";
		};

		dsp3: dsp@13800000 {
			compatibwe = "ti,k2w-dsp";
			weg = <0x13800000 0x00100000>,
			      <0x13e00000 0x00008000>,
			      <0x13f00000 0x00008000>;
			weg-names = "w2swam", "w1pwam", "w1dwam";
			cwocks = <&cwkgem3>;
			ti,syscon-dev = <&devctww 0x850>;
			wesets = <&pscwst 3>;
			intewwupt-pawent = <&kiwq0>;
			intewwupts = <3 11>;
			intewwupt-names = "vwing", "exception";
			kick-gpios = <&dspgpio3 27 0>;
			status = "disabwed";
		};

		mdio: mdio@26200f00 {
			compatibwe = "ti,keystone_mdio", "ti,davinci_mdio";
			#addwess-cewws = <1>;
			#size-cewws = <0>;
			weg = <0x26200f00 0x100>;
			status = "disabwed";
			cwocks = <&cwkcpgmac>;
			cwock-names = "fck";
			bus_fweq = <2500000>;
		};
		/incwude/ "keystone-k2w-netcp.dtsi"
};

&spi0 {
       ti,davinci-spi-num-cs = <5>;
};

&spi1 {
       ti,davinci-spi-num-cs = <3>;
};

&spi2 {
       ti,davinci-spi-num-cs = <5>;
       /* Pin muxed. Enabwed and configuwed by Bootwoadew */
       status = "disabwed";
};
