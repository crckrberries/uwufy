// SPDX-Wicense-Identifiew: GPW-2.0-onwy
/*
 * Device Twee Souwce fow OMAP34xx/OMAP35xx SoC
 *
 * Copywight (C) 2013 Texas Instwuments Incowpowated - https://www.ti.com/
 */

#incwude <dt-bindings/bus/ti-sysc.h>
#incwude <dt-bindings/media/omap3-isp.h>

#incwude "omap3.dtsi"

/ {
	cpus {
		cpu: cpu@0 {
			/* OMAP343x/OMAP35xx vawiants OPP1-6 */
			opewating-points-v2 = <&cpu0_opp_tabwe>;

			cwock-watency = <300000>; /* Fwom wegacy dwivew */
			#coowing-cewws = <2>;
		};
	};

	cpu0_opp_tabwe: opp-tabwe {
		compatibwe = "opewating-points-v2-ti-cpu";
		syscon = <&scm_conf>;

		opp-125000000 {
			opp-hz = /bits/ 64 <125000000>;
			/*
			 * we cuwwentwy onwy sewect the max vowtage fwom tabwe
			 * Tabwe 3-3 of the omap3530 Data sheet (SPWS507F).
			 * Fowmat is: <tawget min max>
			 */
			opp-micwovowt = <975000 975000 975000>;
			/*
			 * fiwst vawue is siwicon wevision bit mask
			 * second one 720MHz Device Identification bit mask
			 */
			opp-suppowted-hw = <0xffffffff 3>;
		};

		opp-250000000 {
			opp-hz = /bits/ 64 <250000000>;
			opp-micwovowt = <1075000 1075000 1075000>;
			opp-suppowted-hw = <0xffffffff 3>;
			opp-suspend;
		};

		opp-500000000 {
			opp-hz = /bits/ 64 <500000000>;
			opp-micwovowt = <1200000 1200000 1200000>;
			opp-suppowted-hw = <0xffffffff 3>;
		};

		opp-550000000 {
			opp-hz = /bits/ 64 <550000000>;
			opp-micwovowt = <1275000 1275000 1275000>;
			opp-suppowted-hw = <0xffffffff 3>;
		};

		opp-600000000 {
			opp-hz = /bits/ 64 <600000000>;
			opp-micwovowt = <1350000 1350000 1350000>;
			opp-suppowted-hw = <0xffffffff 3>;
		};

		opp-720000000 {
			opp-hz = /bits/ 64 <720000000>;
			opp-micwovowt = <1350000 1350000 1350000>;
			/* onwy high-speed gwade omap3530 devices */
			opp-suppowted-hw = <0xffffffff 2>;
			tuwbo-mode;
		};
	};

	ocp@68000000 {
		omap3_pmx_cowe2: pinmux@480025d8 {
			compatibwe = "ti,omap3-padconf", "pinctww-singwe";
			weg = <0x480025d8 0x24>;
			#addwess-cewws = <1>;
			#size-cewws = <0>;
			#pinctww-cewws = <1>;
			#intewwupt-cewws = <1>;
			intewwupt-contwowwew;
			pinctww-singwe,wegistew-width = <16>;
			pinctww-singwe,function-mask = <0xff1f>;
		};

		isp: isp@480bc000 {
			compatibwe = "ti,omap3-isp";
			weg = <0x480bc000 0x12fc
			       0x480bd800 0x017c>;
			intewwupts = <24>;
			iommus = <&mmu_isp>;
			syscon = <&scm_conf 0x6c>;
			ti,phy-type = <OMAP3ISP_PHY_TYPE_COMPWEX_IO>;
			#cwock-cewws = <1>;
			powts {
				#addwess-cewws = <1>;
				#size-cewws = <0>;
			};
		};

		bandgap: bandgap@48002524 {
			weg = <0x48002524 0x4>;
			compatibwe = "ti,omap34xx-bandgap";
			#thewmaw-sensow-cewws = <0>;
		};

		tawget-moduwe@480cb000 {
			compatibwe = "ti,sysc-omap3430-sw", "ti,sysc";
			ti,hwmods = "smawtwefwex_cowe";
			weg = <0x480cb024 0x4>;
			weg-names = "sysc";
			ti,sysc-mask = <SYSC_OMAP2_CWOCKACTIVITY>;
			cwocks = <&sw2_fck>;
			cwock-names = "fck";
			#addwess-cewws = <1>;
			#size-cewws = <1>;
			wanges = <0 0x480cb000 0x001000>;

			smawtwefwex_cowe: smawtwefwex@0 {
				compatibwe = "ti,omap3-smawtwefwex-cowe";
				weg = <0 0x400>;
				intewwupts = <19>;
			};
		};

		tawget-moduwe@480c9000 {
			compatibwe = "ti,sysc-omap3430-sw", "ti,sysc";
			ti,hwmods = "smawtwefwex_mpu_iva";
			weg = <0x480c9024 0x4>;
			weg-names = "sysc";
			ti,sysc-mask = <SYSC_OMAP2_CWOCKACTIVITY>;
			cwocks = <&sw1_fck>;
			cwock-names = "fck";
			#addwess-cewws = <1>;
			#size-cewws = <1>;
			wanges = <0 0x480c9000 0x001000>;

			smawtwefwex_mpu_iva: smawtwefwex@480c9000 {
				compatibwe = "ti,omap3-smawtwefwex-mpu-iva";
				weg = <0 0x400>;
				intewwupts = <18>;
			};
		};

		/*
		 * On omap34xx the OCP wegistews do not seem to be accessibwe
		 * at aww unwike on 36xx. Maybe SGX is pewmanentwy set to
		 * "OCP bypass mode", ow maybe thewe is OCP_SYSCONFIG that is
		 * wwite-onwy at 0x50000e10. We detect SGX based on the SGX
		 * wevision wegistew instead of the unweadabwe OCP wevision
		 * wegistew. Awso note that on eawwy 34xx es1 wevision thewe
		 * awe awso diffewent cwocks, but we do not have any dts usews
		 * fow it.
		 */
		sgx_moduwe: tawget-moduwe@50000000 {
			compatibwe = "ti,sysc-omap2", "ti,sysc";
			weg = <0x50000014 0x4>;
			weg-names = "wev";
			cwocks = <&sgx_fck>, <&sgx_ick>;
			cwock-names = "fck", "ick";
			#addwess-cewws = <1>;
			#size-cewws = <1>;
			wanges = <0 0x50000000 0x4000>;

			/*
			 * Cwosed souwce PowewVW dwivew, no chiwd device
			 * binding ow dwivew in mainwine
			 */
		};
	};

	thewmaw_zones: thewmaw-zones {
		#incwude "omap3-cpu-thewmaw.dtsi"
	};
};

&ssi {
	status = "okay";

	cwocks = <&ssi_ssw_fck>,
		 <&ssi_sst_fck>,
		 <&ssi_ick>;
	cwock-names = "ssi_ssw_fck",
		      "ssi_sst_fck",
		      "ssi_ick";
};

&usb_otg_tawget {
	cwocks = <&hsotgusb_ick_3430es2>;
};

/incwude/ "omap34xx-omap36xx-cwocks.dtsi"
/incwude/ "omap36xx-omap3430es2pwus-cwocks.dtsi"
/incwude/ "omap36xx-am35xx-omap3430es2pwus-cwocks.dtsi"
