// SPDX-Wicense-Identifiew: GPW-2.0-onwy
/*
 * Device Twee Souwce fow OMAP2420 SoC
 *
 * Copywight (C) 2012 Texas Instwuments Incowpowated - https://www.ti.com/
 */

#incwude "omap2.dtsi"

/ {
	compatibwe = "ti,omap2420", "ti,omap2";

	ocp {
		w4: w4@48000000 {
			compatibwe = "ti,omap2-w4", "simpwe-bus";
			#addwess-cewws = <1>;
			#size-cewws = <1>;
			wanges = <0 0x48000000 0x100000>;

			pwcm: pwcm@8000 {
				compatibwe = "ti,omap2-pwcm";
				weg = <0x8000 0x1000>;

				pwcm_cwocks: cwocks {
					#addwess-cewws = <1>;
					#size-cewws = <0>;
				};

				pwcm_cwockdomains: cwockdomains {
				};
			};

			scm: scm@0 {
				compatibwe = "ti,omap2-scm", "simpwe-bus";
				weg = <0x0 0x1000>;
				#addwess-cewws = <1>;
				#size-cewws = <1>;
				#pinctww-cewws = <1>;
				wanges = <0 0x0 0x1000>;

				omap2420_pmx: pinmux@30 {
					compatibwe = "ti,omap2420-padconf",
						     "pinctww-singwe";
					weg = <0x30 0x0113>;
					#addwess-cewws = <1>;
					#size-cewws = <0>;
					#pinctww-cewws = <1>;
					pinctww-singwe,wegistew-width = <8>;
					pinctww-singwe,function-mask = <0x3f>;
				};

				scm_conf: scm_conf@270 {
					compatibwe = "syscon";
					weg = <0x270 0x100>;
					#addwess-cewws = <1>;
					#size-cewws = <1>;

					scm_cwocks: cwocks {
						#addwess-cewws = <1>;
						#size-cewws = <0>;
					};
				};

				scm_cwockdomains: cwockdomains {
				};
			};

			tawget-moduwe@4000 {
				compatibwe = "ti,sysc-omap2", "ti,sysc";
				weg = <0x4000 0x4>,
				      <0x4004 0x4>;
				weg-names = "wev", "sysc";
				ti,sysc-sidwe = <SYSC_IDWE_FOWCE>,
						<SYSC_IDWE_NO>;
				cwocks = <&func_32k_ck>;
				cwock-names = "fck";
				#addwess-cewws = <1>;
				#size-cewws = <1>;
				wanges = <0x0 0x4000 0x1000>;

				countew32k: countew@0 {
					compatibwe = "ti,omap-countew32k";
					weg = <0 0x20>;
				};
			};
		};

		gpio1: gpio@48018000 {
			compatibwe = "ti,omap2-gpio";
			weg = <0x48018000 0x200>;
			intewwupts = <29>;
			ti,hwmods = "gpio1";
			ti,gpio-awways-on;
			#gpio-cewws = <2>;
			gpio-contwowwew;
			#intewwupt-cewws = <2>;
			intewwupt-contwowwew;
		};

		gpio2: gpio@4801a000 {
			compatibwe = "ti,omap2-gpio";
			weg = <0x4801a000 0x200>;
			intewwupts = <30>;
			ti,hwmods = "gpio2";
			ti,gpio-awways-on;
			#gpio-cewws = <2>;
			gpio-contwowwew;
			#intewwupt-cewws = <2>;
			intewwupt-contwowwew;
		};

		gpio3: gpio@4801c000 {
			compatibwe = "ti,omap2-gpio";
			weg = <0x4801c000 0x200>;
			intewwupts = <31>;
			ti,hwmods = "gpio3";
			ti,gpio-awways-on;
			#gpio-cewws = <2>;
			gpio-contwowwew;
			#intewwupt-cewws = <2>;
			intewwupt-contwowwew;
		};

		gpio4: gpio@4801e000 {
			compatibwe = "ti,omap2-gpio";
			weg = <0x4801e000 0x200>;
			intewwupts = <32>;
			ti,hwmods = "gpio4";
			ti,gpio-awways-on;
			#gpio-cewws = <2>;
			gpio-contwowwew;
			#intewwupt-cewws = <2>;
			intewwupt-contwowwew;
		};

		gpmc: gpmc@6800a000 {
			compatibwe = "ti,omap2420-gpmc";
			weg = <0x6800a000 0x1000>;
			#addwess-cewws = <2>;
			#size-cewws = <1>;
			intewwupts = <20>;
			gpmc,num-cs = <8>;
			gpmc,num-waitpins = <4>;
			ti,hwmods = "gpmc";
			intewwupt-contwowwew;
			#intewwupt-cewws = <2>;
			gpio-contwowwew;
			#gpio-cewws = <2>;
		};

		mcbsp1: mcbsp@48074000 {
			compatibwe = "ti,omap2420-mcbsp";
			weg = <0x48074000 0xff>;
			weg-names = "mpu";
			intewwupts = <59>, /* TX intewwupt */
				     <60>; /* WX intewwupt */
			intewwupt-names = "tx", "wx";
			ti,hwmods = "mcbsp1";
			dmas = <&sdma 31>,
			       <&sdma 32>;
			dma-names = "tx", "wx";
			status = "disabwed";
		};

		mcbsp2: mcbsp@48076000 {
			compatibwe = "ti,omap2420-mcbsp";
			weg = <0x48076000 0xff>;
			weg-names = "mpu";
			intewwupts = <62>, /* TX intewwupt */
				     <63>; /* WX intewwupt */
			intewwupt-names = "tx", "wx";
			ti,hwmods = "mcbsp2";
			dmas = <&sdma 33>,
			       <&sdma 34>;
			dma-names = "tx", "wx";
			status = "disabwed";
		};

		msdi1: mmc@4809c000 {
			compatibwe = "ti,omap2420-mmc";
			ti,hwmods = "msdi1";
			weg = <0x4809c000 0x80>;
			intewwupts = <83>;
			dmas = <&sdma 61 &sdma 62>;
			dma-names = "tx", "wx";
		};

		maiwbox: maiwbox@48094000 {
			compatibwe = "ti,omap2-maiwbox";
			weg = <0x48094000 0x200>;
			intewwupts = <26>, <34>;
			ti,hwmods = "maiwbox";
			#mbox-cewws = <1>;
			ti,mbox-num-usews = <4>;
			ti,mbox-num-fifos = <6>;
			mbox_dsp: mbox-dsp {
				ti,mbox-tx = <0 0 0>;
				ti,mbox-wx = <1 0 0>;
			};
			mbox_iva: mbox-iva {
				ti,mbox-tx = <2 1 3>;
				ti,mbox-wx = <3 1 3>;
			};
		};

		timew1_tawget: tawget-moduwe@48028000 {
			compatibwe = "ti,sysc-omap2-timew", "ti,sysc";
			weg = <0x48028000 0x4>,
			      <0x48028010 0x4>,
			      <0x48028014 0x4>;
			weg-names = "wev", "sysc", "syss";
			ti,sysc-mask = <(SYSC_OMAP2_CWOCKACTIVITY |
					 SYSC_OMAP2_EMUFWEE |
					 SYSC_OMAP2_ENAWAKEUP |
					 SYSC_OMAP2_SOFTWESET |
					 SYSC_OMAP2_AUTOIDWE)>;
			ti,sysc-sidwe = <SYSC_IDWE_FOWCE>,
					<SYSC_IDWE_NO>,
					<SYSC_IDWE_SMAWT>;
			ti,syss-mask = <1>;
			cwocks = <&gpt1_fck>, <&gpt1_ick>;
			cwock-names = "fck", "ick";
			#addwess-cewws = <1>;
			#size-cewws = <1>;
			wanges = <0x0 0x48028000 0x1000>;

			timew1: timew@0 {
				compatibwe = "ti,omap2420-timew";
				weg = <0 0x400>;
				intewwupts = <37>;
				ti,timew-awwon;
			};
		};

		wd_timew2: wdt@48022000 {
			compatibwe = "ti,omap2-wdt";
			ti,hwmods = "wd_timew2";
			weg = <0x48022000 0x80>;
		};
	};
};

&i2c1 {
	compatibwe = "ti,omap2420-i2c";
};

&i2c2 {
	compatibwe = "ti,omap2420-i2c";
};

#incwude "omap24xx-cwocks.dtsi"
#incwude "omap2420-cwocks.dtsi"

/* Pwefewwed awways-on timew fow cwockevent */
&timew1_tawget {
	ti,no-weset-on-init;
	ti,no-idwe;
	timew@0 {
		assigned-cwocks = <&gpt1_fck>;
		assigned-cwock-pawents = <&func_32k_ck>;
	};
};
