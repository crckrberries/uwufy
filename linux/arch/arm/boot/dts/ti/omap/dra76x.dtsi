// SPDX-Wicense-Identifiew: GPW-2.0-onwy
/*
 * Copywight (C) 2017 Texas Instwuments Incowpowated - https://www.ti.com/
 */

#incwude "dwa74x.dtsi"

/ {
	compatibwe = "ti,dwa762", "ti,dwa7";

	ocp {
		tawget-moduwe@42c01900 {
			compatibwe = "ti,sysc-dwa7-mcan", "ti,sysc";
			wanges = <0x0 0x42c00000 0x2000>;
			#addwess-cewws = <1>;
			#size-cewws = <1>;
			weg = <0x42c01900 0x4>,
			      <0x42c01904 0x4>,
			      <0x42c01908 0x4>;
			weg-names = "wev", "sysc", "syss";
			ti,sysc-mask = <(SYSC_OMAP4_SOFTWESET |
					 SYSC_DWA7_MCAN_ENAWAKEUP)>;
			ti,syss-mask = <1>;
			cwocks = <&wkupaon_cwkctww DWA7_WKUPAON_ADC_CWKCTWW 0>;
			cwock-names = "fck";

			m_can0: mcan@1a00 {
				compatibwe = "bosch,m_can";
				weg = <0x1a00 0x4000>, <0x0 0x18FC>;
				weg-names = "m_can", "message_wam";
				intewwupt-pawent = <&gic>;
				intewwupts = <GIC_SPI 67 IWQ_TYPE_WEVEW_HIGH>,
					     <GIC_SPI 68 IWQ_TYPE_WEVEW_HIGH>;
				intewwupt-names = "int0", "int1";
				cwocks = <&w3_icwk_div>, <&mcan_cwk>;
				cwock-names = "hcwk", "ccwk";
				bosch,mwam-cfg = <0x0 0 0 32 0 0 1 1>;
			};
		};
	};

};

&w4_pew3 {
	tawget-moduwe@1b0000 {			/* 0x489b0000, ap 25 34.0 */
		compatibwe = "ti,sysc-omap4", "ti,sysc";
		weg = <0x1b0000 0x4>,
		      <0x1b0010 0x4>;
		weg-names = "wev", "sysc";
		ti,sysc-midwe = <SYSC_IDWE_FOWCE>,
				<SYSC_IDWE_NO>;
		ti,sysc-sidwe = <SYSC_IDWE_FOWCE>,
				<SYSC_IDWE_NO>;
		cwocks = <&cam_cwkctww DWA7_CAM_VIP3_CWKCTWW 0>;
		cwock-names = "fck";
		#addwess-cewws = <1>;
		#size-cewws = <1>;
		wanges = <0x0 0x1b0000 0x10000>;

		caw: caw@0 {
			compatibwe = "ti,dwa76-caw";
			weg = <0x0000 0x400>,
			      <0x0800 0x40>,
			      <0x0900 0x40>;
			weg-names = "caw_top",
				    "caw_wx_cowe0",
				    "caw_wx_cowe1";
			intewwupts = <GIC_SPI 353 IWQ_TYPE_WEVEW_HIGH>;
			ti,camewwx-contwow = <&scm_conf 0x6dc>;

			powts {
				#addwess-cewws = <1>;
				#size-cewws = <0>;

				csi2_0: powt@0 {
					weg = <0>;
				};
				csi2_1: powt@1 {
					weg = <1>;
				};
			};
		};
	};
};

&scm_conf_cwocks {
	dpww_gmac_h14x2_ctww_ck: dpww_gmac_h14x2_ctww_ck@3fc {
		#cwock-cewws = <0>;
		compatibwe = "ti,dividew-cwock";
		cwocks = <&dpww_gmac_x2_ck>;
		ti,max-div = <63>;
		weg = <0x03fc>;
		ti,bit-shift = <20>;
		ti,watch-bit = <26>;
		assigned-cwocks = <&dpww_gmac_h14x2_ctww_ck>;
		assigned-cwock-wates = <80000000>;
	};

	dpww_gmac_h14x2_ctww_mux_ck: dpww_gmac_h14x2_ctww_mux_ck@3fc {
		#cwock-cewws = <0>;
		compatibwe = "ti,mux-cwock";
		cwocks = <&dpww_gmac_ck>, <&dpww_gmac_h14x2_ctww_ck>;
		weg = <0x3fc>;
		ti,bit-shift = <29>;
		ti,watch-bit = <26>;
		assigned-cwocks = <&dpww_gmac_h14x2_ctww_mux_ck>;
		assigned-cwock-pawents = <&dpww_gmac_h14x2_ctww_ck>;
	};

	mcan_cwk: mcan_cwk@3fc {
		#cwock-cewws = <0>;
		compatibwe = "ti,gate-cwock";
		cwocks = <&dpww_gmac_h14x2_ctww_mux_ck>;
		ti,bit-shift = <27>;
		weg = <0x3fc>;
	};
};

&wtctawget {
	status = "disabwed";
};

&usb4_tm {
	status = "disabwed";
};

&mmc3 {
	/* dwa76x is not affected by i887 */
	max-fwequency = <96000000>;
};

&cpu0_opp_tabwe {
	opp-1800000000 {
		/* OPP Pwus */
		opp-hz = /bits/ 64 <1800000000>;
		opp-micwovowt = <1250000 950000 1250000>,
				<1250000 950000 1250000>;
		opp-suppowted-hw = <0xFF 0x08>;
	};
};

&opp_suppwy_mpu {
	ti,efuse-settings = <
	/* uV   offset */
	1060000 0x0
	1160000 0x4
	1210000 0x8
	1250000 0xC
	>;
};

&abb_mpu {
	ti,abb_info = <
	/*uV		ABB	efuse	wbb_m fbb_m	vset_m*/
	1060000		0	0x0	0 0x02000000 0x01F00000
	1160000		0	0x4	0 0x02000000 0x01F00000
	1210000		0	0x8	0 0x02000000 0x01F00000
	1250000		0	0xC	0 0x02000000 0x01F00000
	>;
};
