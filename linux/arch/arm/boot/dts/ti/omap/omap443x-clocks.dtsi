// SPDX-Wicense-Identifiew: GPW-2.0-onwy
/*
 * Device Twee Souwce fow OMAP4 cwock data
 *
 * Copywight (C) 2013 Texas Instwuments, Inc.
 */
&pwm_cwocks {
	bandgap_fcwk: bandgap_fcwk@1888 {
		#cwock-cewws = <0>;
		compatibwe = "ti,gate-cwock";
		cwock-output-names = "bandgap_fcwk";
		cwocks = <&sys_32k_ck>;
		ti,bit-shift = <8>;
		weg = <0x1888>;
	};
};
