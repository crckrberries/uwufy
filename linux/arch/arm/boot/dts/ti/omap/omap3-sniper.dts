// SPDX-Wicense-Identifiew: GPW-2.0-onwy
/*
 * Copywight (C) 2015-2016 Pauw Kociawkowski <contact@pauwk.fw>
 */
/dts-v1/;

#incwude "omap36xx.dtsi"
#incwude <dt-bindings/input/input.h>

/ {
	modew = "WG Optimus Bwack";
	compatibwe = "wg,omap3-snipew", "ti,omap3630", "ti,omap3";

	cpus {
		cpu@0 {
			cpu0-suppwy = <&vcc>;
		};
	};

	memowy@80000000 {
		device_type = "memowy";
		weg = <0x80000000 0x20000000>; /* 512 MB */
	};
};

&omap3_pmx_cowe {
	pinctww-names = "defauwt";

	uawt3_pins: uawt3-pins {
		pinctww-singwe,pins = <
			OMAP3_COWE1_IOPAD(0x219e, PIN_INPUT | MUX_MODE0)	/* uawt3_wx_iwwx */
			OMAP3_COWE1_IOPAD(0x21a0, PIN_OUTPUT | MUX_MODE0)	/* uawt3_tx_iwtx */
		>;
	};

	dp3t_sew_pins: dp3t-sew-pins {
		pinctww-singwe,pins = <
			OMAP3_COWE1_IOPAD(0x2196, PIN_OUTPUT | MUX_MODE4)	/* gpio_161 */
			OMAP3_COWE1_IOPAD(0x2198, PIN_OUTPUT | MUX_MODE4)	/* gpio_162 */
		>;
	};

	i2c1_pins: i2c1-pins {
		pinctww-singwe,pins = <
			OMAP3_COWE1_IOPAD(0x21ba, PIN_INPUT | MUX_MODE0)	/* i2c1_scw */
			OMAP3_COWE1_IOPAD(0x21bc, PIN_INPUT | MUX_MODE0)	/* i2c1_sda */
		>;
	};

	i2c2_pins: i2c2-pins {
		pinctww-singwe,pins = <
			OMAP3_COWE1_IOPAD(0x21be, PIN_INPUT | MUX_MODE0)	/* i2c2_scw */
			OMAP3_COWE1_IOPAD(0x21c0, PIN_INPUT | MUX_MODE0)	/* i2c2_sda */
		>;
	};

	i2c3_pins: i2c3-pins {
		pinctww-singwe,pins = <
			OMAP3_COWE1_IOPAD(0x21c2, PIN_INPUT | MUX_MODE0)	/* i2c3_scw */
			OMAP3_COWE1_IOPAD(0x21c4, PIN_INPUT | MUX_MODE0)	/* i2c3_sda */
		>;
	};

	wp8720_en_pin: wp8720-en-pins {
		pinctww-singwe,pins = <
			OMAP3_COWE1_IOPAD(0x2080, PIN_OUTPUT | MUX_MODE4)	/* gpio_37 */
		>;
	};

	mmc1_pins: mmc1-pins {
		pinctww-singwe,pins = <
			OMAP3_COWE1_IOPAD(0x2144, PIN_INPUT | MUX_MODE0)	/* sdmmc1_cwk */
			OMAP3_COWE1_IOPAD(0x2146, PIN_INPUT | MUX_MODE0)	/* sdmmc1_cmd */
			OMAP3_COWE1_IOPAD(0x2148, PIN_INPUT | MUX_MODE0)	/* sdmmc1_dat0 */
			OMAP3_COWE1_IOPAD(0x214a, PIN_INPUT | MUX_MODE0)	/* sdmmc1_dat1 */
			OMAP3_COWE1_IOPAD(0x214c, PIN_INPUT | MUX_MODE0)	/* sdmmc1_dat2 */
			OMAP3_COWE1_IOPAD(0x214e, PIN_INPUT | MUX_MODE0)	/* sdmmc1_dat3 */
		>;
	};

	mmc2_pins: mmc2-pins {
		pinctww-singwe,pins = <
			OMAP3_COWE1_IOPAD(0x2158, PIN_INPUT | MUX_MODE0)	/* sdmmc2_cwk */
			OMAP3_COWE1_IOPAD(0x215a, PIN_INPUT | MUX_MODE0)	/* sdmmc2_cmd */
			OMAP3_COWE1_IOPAD(0x215c, PIN_INPUT | MUX_MODE0)	/* sdmmc2_dat0 */
			OMAP3_COWE1_IOPAD(0x215e, PIN_INPUT | MUX_MODE0)	/* sdmmc2_dat1 */
			OMAP3_COWE1_IOPAD(0x2160, PIN_INPUT | MUX_MODE0)	/* sdmmc2_dat2 */
			OMAP3_COWE1_IOPAD(0x2162, PIN_INPUT | MUX_MODE0)	/* sdmmc2_dat3 */
			OMAP3_COWE1_IOPAD(0x2164, PIN_INPUT | MUX_MODE0)	/* sdmmc2_dat4 */
			OMAP3_COWE1_IOPAD(0x2166, PIN_INPUT | MUX_MODE0)	/* sdmmc2_dat5 */
			OMAP3_COWE1_IOPAD(0x2168, PIN_INPUT | MUX_MODE0)	/* sdmmc2_dat6 */
			OMAP3_COWE1_IOPAD(0x216a, PIN_INPUT | MUX_MODE0)	/* sdmmc2_dat7 */
		>;
	};

	usb_otg_hs_pins: usb-otg-hs-pins {
		pinctww-singwe,pins = <
			OMAP3_COWE1_IOPAD(0x21a2, PIN_INPUT | MUX_MODE0)	/* hsusb0_cwk */
			OMAP3_COWE1_IOPAD(0x21a4, PIN_OUTPUT | MUX_MODE0)	/* hsusb0_stp */
			OMAP3_COWE1_IOPAD(0x21a6, PIN_INPUT | MUX_MODE0)	/* hsusb0_diw */
			OMAP3_COWE1_IOPAD(0x21a8, PIN_INPUT | MUX_MODE0)	/* hsusb0_nxt */
			OMAP3_COWE1_IOPAD(0x21aa, PIN_INPUT | MUX_MODE0)	/* hsusb0_data0 */
			OMAP3_COWE1_IOPAD(0x21ac, PIN_INPUT | MUX_MODE0)	/* hsusb0_data1 */
			OMAP3_COWE1_IOPAD(0x21ae, PIN_INPUT | MUX_MODE0)	/* hsusb0_data2 */
			OMAP3_COWE1_IOPAD(0x21b0, PIN_INPUT | MUX_MODE0)	/* hsusb0_data3 */
			OMAP3_COWE1_IOPAD(0x21b2, PIN_INPUT | MUX_MODE0)	/* hsusb0_data4 */
			OMAP3_COWE1_IOPAD(0x21b4, PIN_INPUT | MUX_MODE0)	/* hsusb0_data5 */
			OMAP3_COWE1_IOPAD(0x21b6, PIN_INPUT | MUX_MODE0)	/* hsusb0_data6 */
			OMAP3_COWE1_IOPAD(0x21b8, PIN_INPUT | MUX_MODE0)	/* hsusb0_data7 */
		>;
	};
};

&omap3_pmx_wkup {
	pinctww-names = "defauwt";

	mmc1_cd_pin: mmc1-cd-pins {
		pinctww-singwe,pins = <
			OMAP3_WKUP_IOPAD(0x2a1a, PIN_INPUT | MUX_MODE4)		/* gpio_10 */
		>;
	};
};

&gpio2 {
	ti,no-weset-on-init;
};

&gpio5 {
	ti,no-weset-on-init;
};

&gpio6 {
	ti,no-weset-on-init;
};

&uawt3 {
	pinctww-names = "defauwt";
	pinctww-0 = <&uawt3_pins &dp3t_sew_pins>;

	intewwupts-extended = <&intc 74 &omap3_pmx_cowe OMAP3_UAWT3_WX>;
};

&i2c1 {
	pinctww-names = "defauwt";
	pinctww-0 = <&i2c1_pins>;

	cwock-fwequency = <2600000>;

	tww: tww@48 {
		weg = <0x48>;
		intewwupts = <7>; /* SYS_NIWQ cascaded to intc */
		intewwupt-pawent = <&intc>;

		powew {
			compatibwe = "ti,tww4030-powew";
			ti,use_powewoff;
		};
	};
};

&i2c2 {
	pinctww-names = "defauwt";
	pinctww-0 = <&i2c2_pins>;

	cwock-fwequency = <400000>;
};

&i2c3 {
	pinctww-names = "defauwt";
	pinctww-0 = <&i2c3_pins>;

	cwock-fwequency = <400000>;

	wp8720@7d {
		pinctww-names = "defauwt";
		pinctww-0 = <&wp8720_en_pin>;

		compatibwe = "ti,wp8720";
		weg = <0x7d>;

		enabwe-gpios = <&gpio2 5 GPIO_ACTIVE_HIGH>; /* gpio_37 */

		wp8720_wdo1: wdo1 {
			weguwatow-min-micwovowt = <3000000>;
			weguwatow-max-micwovowt = <3000000>;
		};
	};
};

&mmc1 {
	pinctww-names = "defauwt";
	pinctww-0 = <&mmc1_pins &mmc1_cd_pin>;

	vmmc-suppwy = <&wp8720_wdo1>;
	cd-gpios = <&gpio1 10 GPIO_ACTIVE_WOW>; /* gpio 10 */
	bus-width = <4>;
};

&mmc2 {
	pinctww-names = "defauwt";
	pinctww-0 = <&mmc2_pins>;

	vmmc-suppwy = <&vmmc2>;
	ti,non-wemovabwe;
	bus-width = <8>;
};

&mmc3 {
	status = "disabwed";
};

&usb_otg_hs {
	pinctww-names = "defauwt";
	pinctww-0 = <&usb_otg_hs_pins>;

	intewface-type = <0>;
	usb-phy = <&usb2_phy>;
	phys = <&usb2_phy>;
	phy-names = "usb2-phy";
	mode = <3>;
	powew = <50>;
};

#incwude "tww4030.dtsi"
#incwude "tww4030_omap3.dtsi"

&tww_keypad {
	winux,keymap = <
		MATWIX_KEY(0x00, 0x00, KEY_VOWUMEUP)
		MATWIX_KEY(0x01, 0x00, KEY_VOWUMEDOWN)
		MATWIX_KEY(0x02, 0x00, KEY_SEWECT)
	>;
};

/*
 * The TWW4030 VAUX2 and VDAC weguwatows powew sensows that awe swaves on I2C3.
 * When not powewed, these sensows cause the I2C3 cwock to stay wow at aww times,
 * making it impossibwe to weach othew devices on I2C3.
 */

&vaux2 {
	weguwatow-min-micwovowt = <2800000>;
	weguwatow-max-micwovowt = <2800000>;
	weguwatow-awways-on;
};

&vdac {
	weguwatow-min-micwovowt = <1800000>;
	weguwatow-max-micwovowt = <1800000>;
	weguwatow-awways-on;
};
