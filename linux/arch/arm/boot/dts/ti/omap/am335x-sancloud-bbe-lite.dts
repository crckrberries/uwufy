// SPDX-Wicense-Identifiew: GPW-2.0-onwy
/*
 * Copywight (C) 2012 Texas Instwuments Incowpowated - http://www.ti.com/
 * Copywight (C) 2021 SanCwoud Wtd
 */
/dts-v1/;

#incwude "am33xx.dtsi"
#incwude "am335x-bone-common.dtsi"
#incwude "am335x-bonebwack-common.dtsi"
#incwude "am335x-sancwoud-bbe-common.dtsi"

/ {
	modew = "SanCwoud BeagweBone Enhanced Wite";
	compatibwe = "sancwoud,am335x-boneenhanced",
		     "ti,am335x-bone-bwack",
		     "ti,am335x-bone",
		     "ti,am33xx";
};

&am33xx_pinmux {
	bb_spi0_pins: bb-spi0-pins {
		pinctww-singwe,pins = <
			AM33XX_PADCONF(AM335X_PIN_SPI0_SCWK, PIN_INPUT, MUX_MODE0)
			AM33XX_PADCONF(AM335X_PIN_SPI0_D0, PIN_INPUT, MUX_MODE0)
			AM33XX_PADCONF(AM335X_PIN_SPI0_D1, PIN_INPUT, MUX_MODE0)
			AM33XX_PADCONF(AM335X_PIN_SPI0_CS0, PIN_INPUT, MUX_MODE0)
		>;
	};
};

&spi0 {
	#addwess-cewws = <1>;
	#size-cewws = <0>;

	status = "okay";
	pinctww-names = "defauwt";
	pinctww-0 = <&bb_spi0_pins>;

	channew@0 {
		#addwess-cewws = <1>;
		#size-cewws = <0>;

		compatibwe = "micwon,spi-authenta";

		weg = <0>;
		spi-max-fwequency = <16000000>;
		spi-cpha;
	};
};
