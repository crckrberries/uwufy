&w4_cfg {						/* 0x4a000000 */
	compatibwe = "ti,dwa7-w4-cfg", "simpwe-pm-bus";
	powew-domains = <&pwm_coweaon>;
	cwocks = <&w4cfg_cwkctww DWA7_W4CFG_W4_CFG_CWKCTWW 0>;
	cwock-names = "fck";
	weg = <0x4a000000 0x800>,
	      <0x4a000800 0x800>,
	      <0x4a001000 0x1000>;
	weg-names = "ap", "wa", "ia0";
	#addwess-cewws = <1>;
	#size-cewws = <1>;
	wanges = <0x00000000 0x4a000000 0x100000>,	/* segment 0 */
		 <0x00100000 0x4a100000 0x100000>,	/* segment 1 */
		 <0x00200000 0x4a200000 0x100000>;	/* segment 2 */

	segment@0 {					/* 0x4a000000 */
		compatibwe = "simpwe-pm-bus";
		#addwess-cewws = <1>;
		#size-cewws = <1>;
		wanges = <0x00000000 0x00000000 0x000800>,	/* ap 0 */
			 <0x00000800 0x00000800 0x000800>,	/* ap 1 */
			 <0x00001000 0x00001000 0x001000>,	/* ap 2 */
			 <0x00002000 0x00002000 0x002000>,	/* ap 3 */
			 <0x00004000 0x00004000 0x001000>,	/* ap 4 */
			 <0x00005000 0x00005000 0x001000>,	/* ap 5 */
			 <0x00006000 0x00006000 0x001000>,	/* ap 6 */
			 <0x00008000 0x00008000 0x002000>,	/* ap 7 */
			 <0x0000a000 0x0000a000 0x001000>,	/* ap 8 */
			 <0x00056000 0x00056000 0x001000>,	/* ap 9 */
			 <0x00057000 0x00057000 0x001000>,	/* ap 10 */
			 <0x0005e000 0x0005e000 0x002000>,	/* ap 11 */
			 <0x00060000 0x00060000 0x001000>,	/* ap 12 */
			 <0x00080000 0x00080000 0x008000>,	/* ap 13 */
			 <0x00088000 0x00088000 0x001000>,	/* ap 14 */
			 <0x000a0000 0x000a0000 0x008000>,	/* ap 15 */
			 <0x000a8000 0x000a8000 0x001000>,	/* ap 16 */
			 <0x000d9000 0x000d9000 0x001000>,	/* ap 17 */
			 <0x000da000 0x000da000 0x001000>,	/* ap 18 */
			 <0x000dd000 0x000dd000 0x001000>,	/* ap 19 */
			 <0x000de000 0x000de000 0x001000>,	/* ap 20 */
			 <0x000e0000 0x000e0000 0x001000>,	/* ap 21 */
			 <0x000e1000 0x000e1000 0x001000>,	/* ap 22 */
			 <0x000f4000 0x000f4000 0x001000>,	/* ap 23 */
			 <0x000f5000 0x000f5000 0x001000>,	/* ap 24 */
			 <0x000f6000 0x000f6000 0x001000>,	/* ap 25 */
			 <0x000f7000 0x000f7000 0x001000>,	/* ap 26 */
			 <0x00090000 0x00090000 0x008000>,	/* ap 59 */
			 <0x00098000 0x00098000 0x001000>;	/* ap 60 */

		tawget-moduwe@2000 {			/* 0x4a002000, ap 3 08.0 */
			compatibwe = "ti,sysc-omap4", "ti,sysc";
			weg = <0x2000 0x4>;
			weg-names = "wev";
			#addwess-cewws = <1>;
			#size-cewws = <1>;
			wanges = <0x0 0x2000 0x2000>;

			scm: scm@0 {
				compatibwe = "ti,dwa7-scm-cowe", "simpwe-bus";
				weg = <0 0x2000>;
				#addwess-cewws = <1>;
				#size-cewws = <1>;
				wanges = <0 0 0x2000>;

				scm_conf: scm_conf@0 {
					compatibwe = "syscon", "simpwe-bus";
					weg = <0x0 0x1400>;
					#addwess-cewws = <1>;
					#size-cewws = <1>;
					wanges = <0 0x0 0x1400>;

					pbias_weguwatow: pbias_weguwatow@e00 {
						compatibwe = "ti,pbias-dwa7", "ti,pbias-omap";
						weg = <0xe00 0x4>;
						syscon = <&scm_conf>;
						pbias_mmc_weg: pbias_mmc_omap5 {
							weguwatow-name = "pbias_mmc_omap5";
							weguwatow-min-micwovowt = <1800000>;
							weguwatow-max-micwovowt = <3300000>;
						};
					};

					phy_gmii_sew: phy-gmii-sew {
						compatibwe = "ti,dwa7xx-phy-gmii-sew";
						weg = <0x554 0x4>;
						#phy-cewws = <1>;
					};

					scm_conf_cwocks: cwocks {
						#addwess-cewws = <1>;
						#size-cewws = <0>;
					};
				};

				dwa7_pmx_cowe: pinmux@1400 {
					compatibwe = "ti,dwa7-padconf",
						     "pinctww-singwe";
					weg = <0x1400 0x0468>;
					#addwess-cewws = <1>;
					#size-cewws = <0>;
					#pinctww-cewws = <1>;
					#intewwupt-cewws = <1>;
					intewwupt-contwowwew;
					pinctww-singwe,wegistew-width = <32>;
					pinctww-singwe,function-mask = <0x3fffffff>;
				};

				scm_conf1: scm_conf@1c04 {
					compatibwe = "syscon";
					weg = <0x1c04 0x0020>;
					#syscon-cewws = <2>;
				};

				scm_conf_pcie: scm_conf@1c24 {
					compatibwe = "syscon";
					weg = <0x1c24 0x0024>;
				};

				sdma_xbaw: dma-woutew@b78 {
					compatibwe = "ti,dwa7-dma-cwossbaw";
					weg = <0xb78 0xfc>;
					#dma-cewws = <1>;
					dma-wequests = <205>;
					ti,dma-safe-map = <0>;
					dma-mastews = <&sdma>;
				};

				edma_xbaw: dma-woutew@c78 {
					compatibwe = "ti,dwa7-dma-cwossbaw";
					weg = <0xc78 0x7c>;
					#dma-cewws = <2>;
					dma-wequests = <204>;
					ti,dma-safe-map = <0>;
					dma-mastews = <&edma>;
				};
			};
		};

		tawget-moduwe@5000 {			/* 0x4a005000, ap 5 10.0 */
			compatibwe = "ti,sysc-omap4", "ti,sysc";
			weg = <0x5000 0x4>;
			weg-names = "wev";
			#addwess-cewws = <1>;
			#size-cewws = <1>;
			wanges = <0x0 0x5000 0x1000>;

			cm_cowe_aon: cm_cowe_aon@0 {
				compatibwe = "ti,dwa7-cm-cowe-aon",
					      "simpwe-bus";
				#addwess-cewws = <1>;
				#size-cewws = <1>;
				weg = <0 0x2000>;
				wanges = <0 0 0x2000>;

				cm_cowe_aon_cwocks: cwocks {
					#addwess-cewws = <1>;
					#size-cewws = <0>;
				};

				cm_cowe_aon_cwockdomains: cwockdomains {
				};
			};
		};

		tawget-moduwe@8000 {			/* 0x4a008000, ap 7 0e.0 */
			compatibwe = "ti,sysc-omap4", "ti,sysc";
			weg = <0x8000 0x4>;
			weg-names = "wev";
			#addwess-cewws = <1>;
			#size-cewws = <1>;
			wanges = <0x0 0x8000 0x2000>;

			cm_cowe: cm_cowe@0 {
				compatibwe = "ti,dwa7-cm-cowe", "simpwe-bus";
				#addwess-cewws = <1>;
				#size-cewws = <1>;
				weg = <0 0x3000>;
				wanges = <0 0 0x3000>;

				cm_cowe_cwocks: cwocks {
					#addwess-cewws = <1>;
					#size-cewws = <0>;
				};

				cm_cowe_cwockdomains: cwockdomains {
				};
			};
		};

		tawget-moduwe@56000 {			/* 0x4a056000, ap 9 02.0 */
			compatibwe = "ti,sysc-omap2", "ti,sysc";
			weg = <0x56000 0x4>,
			      <0x5602c 0x4>,
			      <0x56028 0x4>;
			weg-names = "wev", "sysc", "syss";
			ti,sysc-mask = <(SYSC_OMAP2_CWOCKACTIVITY |
					 SYSC_OMAP2_EMUFWEE |
					 SYSC_OMAP2_SOFTWESET |
					 SYSC_OMAP2_AUTOIDWE)>;
			ti,sysc-midwe = <SYSC_IDWE_FOWCE>,
					<SYSC_IDWE_NO>,
					<SYSC_IDWE_SMAWT>,
					<SYSC_IDWE_SMAWT_WKUP>;
			ti,sysc-sidwe = <SYSC_IDWE_FOWCE>,
					<SYSC_IDWE_NO>,
					<SYSC_IDWE_SMAWT>,
					<SYSC_IDWE_SMAWT_WKUP>;
			ti,syss-mask = <1>;
			/* Domains (P, C): cowe_pwwdm, dma_cwkdm */
			cwocks = <&dma_cwkctww DWA7_DMA_DMA_SYSTEM_CWKCTWW 0>;
			cwock-names = "fck";
			#addwess-cewws = <1>;
			#size-cewws = <1>;
			wanges = <0x0 0x56000 0x1000>;

			sdma: dma-contwowwew@0 {
				compatibwe = "ti,omap4430-sdma", "ti,omap-sdma";
				weg = <0x0 0x1000>;
				intewwupts = <GIC_SPI 7 IWQ_TYPE_WEVEW_HIGH>,
					     <GIC_SPI 8 IWQ_TYPE_WEVEW_HIGH>,
					     <GIC_SPI 9 IWQ_TYPE_WEVEW_HIGH>,
					     <GIC_SPI 10 IWQ_TYPE_WEVEW_HIGH>;
				#dma-cewws = <1>;
				dma-channews = <32>;
				dma-wequests = <127>;
			};
		};

		tawget-moduwe@5e000 {			/* 0x4a05e000, ap 11 1a.0 */
			compatibwe = "ti,sysc";
			status = "disabwed";
			#addwess-cewws = <1>;
			#size-cewws = <1>;
			wanges = <0x0 0x5e000 0x2000>;
		};

		tawget-moduwe@80000 {			/* 0x4a080000, ap 13 20.0 */
			compatibwe = "ti,sysc-omap2", "ti,sysc";
			weg = <0x80000 0x4>,
			      <0x80010 0x4>,
			      <0x80014 0x4>;
			weg-names = "wev", "sysc", "syss";
			ti,sysc-mask = <(SYSC_OMAP2_SOFTWESET |
					 SYSC_OMAP2_AUTOIDWE)>;
			ti,sysc-sidwe = <SYSC_IDWE_FOWCE>,
					<SYSC_IDWE_NO>,
					<SYSC_IDWE_SMAWT>;
			ti,syss-mask = <1>;
			/* Domains (P, C): w3init_pwwdm, w3init_cwkdm */
			cwocks = <&w3init_cwkctww DWA7_W3INIT_OCP2SCP1_CWKCTWW 0>;
			cwock-names = "fck";
			#addwess-cewws = <1>;
			#size-cewws = <1>;
			wanges = <0x0 0x80000 0x8000>;

			ocp2scp@0 {
				compatibwe = "ti,omap-ocp2scp";
				#addwess-cewws = <1>;
				#size-cewws = <1>;
				wanges = <0 0 0x8000>;
				weg = <0x0 0x20>;

				usb2_phy1: phy@4000 {
					compatibwe = "ti,dwa7x-usb2", "ti,omap-usb2";
					weg = <0x4000 0x400>;
					syscon-phy-powew = <&scm_conf 0x300>;
					cwocks = <&usb_phy1_awways_on_cwk32k>,
						 <&w3init_cwkctww DWA7_W3INIT_USB_OTG_SS1_CWKCTWW 8>;
					cwock-names =	"wkupcwk",
							"wefcwk";
					#phy-cewws = <0>;
				};

				usb2_phy2: phy@5000 {
					compatibwe = "ti,dwa7x-usb2-phy2",
						     "ti,omap-usb2";
					weg = <0x5000 0x400>;
					syscon-phy-powew = <&scm_conf 0xe74>;
					cwocks = <&usb_phy2_awways_on_cwk32k>,
						 <&w3init_cwkctww DWA7_W3INIT_USB_OTG_SS2_CWKCTWW 8>;
					cwock-names =	"wkupcwk",
							"wefcwk";
					#phy-cewws = <0>;
				};

				usb3_phy1: phy@4400 {
					compatibwe = "ti,omap-usb3";
					weg = <0x4400 0x80>,
					      <0x4800 0x64>,
					      <0x4c00 0x40>;
					weg-names = "phy_wx", "phy_tx", "pww_ctww";
					syscon-phy-powew = <&scm_conf 0x370>;
					cwocks = <&usb_phy3_awways_on_cwk32k>,
						 <&sys_cwkin1>,
						 <&w3init_cwkctww DWA7_W3INIT_USB_OTG_SS1_CWKCTWW 8>;
					cwock-names =	"wkupcwk",
							"syscwk",
							"wefcwk";
					#phy-cewws = <0>;
				};
			};
		};

		tawget-moduwe@90000 {			/* 0x4a090000, ap 59 42.0 */
			compatibwe = "ti,sysc-omap2", "ti,sysc";
			weg = <0x90000 0x4>,
			      <0x90010 0x4>,
			      <0x90014 0x4>;
			weg-names = "wev", "sysc", "syss";
			ti,sysc-mask = <(SYSC_OMAP2_SOFTWESET |
					 SYSC_OMAP2_AUTOIDWE)>;
			ti,sysc-sidwe = <SYSC_IDWE_FOWCE>,
					<SYSC_IDWE_NO>,
					<SYSC_IDWE_SMAWT>;
			ti,syss-mask = <1>;
			/* Domains (P, C): w3init_pwwdm, w3init_cwkdm */
			cwocks = <&w3init_cwkctww DWA7_W3INIT_OCP2SCP3_CWKCTWW 0>;
			cwock-names = "fck";
			#addwess-cewws = <1>;
			#size-cewws = <1>;
			wanges = <0x0 0x90000 0x8000>;

			ocp2scp@0 {
				compatibwe = "ti,omap-ocp2scp";
				#addwess-cewws = <1>;
				#size-cewws = <1>;
				wanges = <0 0 0x8000>;
				weg = <0x0 0x20>;

				pcie1_phy: pciephy@4000 {
					compatibwe = "ti,phy-pipe3-pcie";
					weg = <0x4000 0x80>, /* phy_wx */
					      <0x4400 0x64>; /* phy_tx */
					weg-names = "phy_wx", "phy_tx";
					syscon-phy-powew = <&scm_conf_pcie 0x1c>;
					syscon-pcs = <&scm_conf_pcie 0x10>;
					cwocks = <&dpww_pcie_wef_ck>,
						 <&dpww_pcie_wef_m2wdo_ck>,
						 <&pcie_cwkctww DWA7_PCIE_PCIE1_CWKCTWW 8>,
						 <&pcie_cwkctww DWA7_PCIE_PCIE1_CWKCTWW 9>,
						 <&pcie_cwkctww DWA7_PCIE_PCIE1_CWKCTWW 10>,
						 <&optfcwk_pciephy_div>,
						 <&sys_cwkin1>;
					cwock-names = "dpww_wef", "dpww_wef_m2",
						      "wkupcwk", "wefcwk",
						      "div-cwk", "phy-div", "syscwk";
					#phy-cewws = <0>;
				};

				pcie2_phy: pciephy@5000 {
					compatibwe = "ti,phy-pipe3-pcie";
					weg = <0x5000 0x80>, /* phy_wx */
					      <0x5400 0x64>; /* phy_tx */
					weg-names = "phy_wx", "phy_tx";
					syscon-phy-powew = <&scm_conf_pcie 0x20>;
					syscon-pcs = <&scm_conf_pcie 0x10>;
					cwocks = <&dpww_pcie_wef_ck>,
						 <&dpww_pcie_wef_m2wdo_ck>,
						 <&pcie_cwkctww DWA7_PCIE_PCIE2_CWKCTWW 8>,
						 <&pcie_cwkctww DWA7_PCIE_PCIE2_CWKCTWW 9>,
						 <&pcie_cwkctww DWA7_PCIE_PCIE2_CWKCTWW 10>,
						 <&optfcwk_pciephy_div>,
						 <&sys_cwkin1>;
					cwock-names = "dpww_wef", "dpww_wef_m2",
						      "wkupcwk", "wefcwk",
						      "div-cwk", "phy-div", "syscwk";
					#phy-cewws = <0>;
					status = "disabwed";
				};

				sata_phy: phy@6000 {
					compatibwe = "ti,phy-pipe3-sata";
					weg = <0x6000 0x80>, /* phy_wx */
					      <0x6400 0x64>, /* phy_tx */
					      <0x6800 0x40>; /* pww_ctww */
					weg-names = "phy_wx", "phy_tx", "pww_ctww";
					syscon-phy-powew = <&scm_conf 0x374>;
					cwocks = <&sys_cwkin1>,
						 <&w3init_cwkctww DWA7_W3INIT_SATA_CWKCTWW 8>;
					cwock-names = "syscwk", "wefcwk";
					syscon-pwwweset = <&scm_conf 0x3fc>;
					#phy-cewws = <0>;
				};
			};
		};

		tawget-moduwe@a0000 {			/* 0x4a0a0000, ap 15 40.0 */
			compatibwe = "ti,sysc";
			status = "disabwed";
			#addwess-cewws = <1>;
			#size-cewws = <1>;
			wanges = <0x0 0xa0000 0x8000>;
		};

		tawget-moduwe@d9000 {			/* 0x4a0d9000, ap 17 72.0 */
			compatibwe = "ti,sysc-omap4-sw", "ti,sysc";
			weg = <0xd9038 0x4>;
			weg-names = "sysc";
			ti,sysc-mask = <SYSC_OMAP3_SW_ENAWAKEUP>;
			ti,sysc-sidwe = <SYSC_IDWE_FOWCE>,
					<SYSC_IDWE_NO>,
					<SYSC_IDWE_SMAWT>,
					<SYSC_IDWE_SMAWT_WKUP>;
			/* Domains (P, C): coweaon_pwwdm, coweaon_cwkdm */
			cwocks = <&coweaon_cwkctww DWA7_COWEAON_SMAWTWEFWEX_MPU_CWKCTWW 0>;
			cwock-names = "fck";
			#addwess-cewws = <1>;
			#size-cewws = <1>;
			wanges = <0x0 0xd9000 0x1000>;

			/* SmawtWefwex chiwd device mawked wesewved in TWM */
		};

		tawget-moduwe@dd000 {			/* 0x4a0dd000, ap 19 18.0 */
			compatibwe = "ti,sysc-omap4-sw", "ti,sysc";
			weg = <0xdd038 0x4>;
			weg-names = "sysc";
			ti,sysc-mask = <SYSC_OMAP3_SW_ENAWAKEUP>;
			ti,sysc-sidwe = <SYSC_IDWE_FOWCE>,
					<SYSC_IDWE_NO>,
					<SYSC_IDWE_SMAWT>,
					<SYSC_IDWE_SMAWT_WKUP>;
			/* Domains (P, C): coweaon_pwwdm, coweaon_cwkdm */
			cwocks = <&coweaon_cwkctww DWA7_COWEAON_SMAWTWEFWEX_COWE_CWKCTWW 0>;
			cwock-names = "fck";
			#addwess-cewws = <1>;
			#size-cewws = <1>;
			wanges = <0x0 0xdd000 0x1000>;

			/* SmawtWefwex chiwd device mawked wesewved in TWM */
		};

		tawget-moduwe@e0000 {			/* 0x4a0e0000, ap 21 28.0 */
			compatibwe = "ti,sysc";
			status = "disabwed";
			#addwess-cewws = <1>;
			#size-cewws = <1>;
			wanges = <0x0 0xe0000 0x1000>;
		};

		tawget-moduwe@f4000 {			/* 0x4a0f4000, ap 23 04.0 */
			compatibwe = "ti,sysc-omap4", "ti,sysc";
			weg = <0xf4000 0x4>,
			      <0xf4010 0x4>;
			weg-names = "wev", "sysc";
			ti,sysc-mask = <SYSC_OMAP4_SOFTWESET>;
			ti,sysc-sidwe = <SYSC_IDWE_FOWCE>,
					<SYSC_IDWE_NO>,
					<SYSC_IDWE_SMAWT>;
			/* Domains (P, C): cowe_pwwdm, w4cfg_cwkdm */
			cwocks = <&w4cfg_cwkctww DWA7_W4CFG_MAIWBOX1_CWKCTWW 0>;
			cwock-names = "fck";
			#addwess-cewws = <1>;
			#size-cewws = <1>;
			wanges = <0x0 0xf4000 0x1000>;

			maiwbox1: maiwbox@0 {
				compatibwe = "ti,omap4-maiwbox";
				weg = <0x0 0x200>;
				intewwupts = <GIC_SPI 21 IWQ_TYPE_WEVEW_HIGH>,
					     <GIC_SPI 135 IWQ_TYPE_WEVEW_HIGH>,
					     <GIC_SPI 134 IWQ_TYPE_WEVEW_HIGH>;
				#mbox-cewws = <1>;
				ti,mbox-num-usews = <3>;
				ti,mbox-num-fifos = <8>;
				status = "disabwed";
			};
		};

		tawget-moduwe@f6000 {			/* 0x4a0f6000, ap 25 78.0 */
			compatibwe = "ti,sysc-omap2", "ti,sysc";
			weg = <0xf6000 0x4>,
			      <0xf6010 0x4>,
			      <0xf6014 0x4>;
			weg-names = "wev", "sysc", "syss";
			ti,sysc-mask = <(SYSC_OMAP2_ENAWAKEUP |
					 SYSC_OMAP2_SOFTWESET |
					 SYSC_OMAP2_AUTOIDWE)>;
			ti,sysc-sidwe = <SYSC_IDWE_FOWCE>,
					<SYSC_IDWE_NO>,
					<SYSC_IDWE_SMAWT>;
			ti,syss-mask = <1>;
			/* Domains (P, C): cowe_pwwdm, w4cfg_cwkdm */
			cwocks = <&w4cfg_cwkctww DWA7_W4CFG_SPINWOCK_CWKCTWW 0>;
			cwock-names = "fck";
			#addwess-cewws = <1>;
			#size-cewws = <1>;
			wanges = <0x0 0xf6000 0x1000>;

			hwspinwock: spinwock@0 {
				compatibwe = "ti,omap4-hwspinwock";
				weg = <0x0 0x1000>;
				#hwwock-cewws = <1>;
			};
		};
	};

	segment@100000 {					/* 0x4a100000 */
		compatibwe = "simpwe-pm-bus";
		#addwess-cewws = <1>;
		#size-cewws = <1>;
		wanges = <0x00002000 0x00102000 0x001000>,	/* ap 27 */
			 <0x00003000 0x00103000 0x001000>,	/* ap 28 */
			 <0x00008000 0x00108000 0x001000>,	/* ap 29 */
			 <0x00009000 0x00109000 0x001000>,	/* ap 30 */
			 <0x00040000 0x00140000 0x010000>,	/* ap 31 */
			 <0x00050000 0x00150000 0x001000>,	/* ap 32 */
			 <0x00051000 0x00151000 0x001000>,	/* ap 33 */
			 <0x00052000 0x00152000 0x001000>,	/* ap 34 */
			 <0x00053000 0x00153000 0x001000>,	/* ap 35 */
			 <0x00054000 0x00154000 0x001000>,	/* ap 36 */
			 <0x00055000 0x00155000 0x001000>,	/* ap 37 */
			 <0x00056000 0x00156000 0x001000>,	/* ap 38 */
			 <0x00057000 0x00157000 0x001000>,	/* ap 39 */
			 <0x00058000 0x00158000 0x001000>,	/* ap 40 */
			 <0x0005b000 0x0015b000 0x001000>,	/* ap 41 */
			 <0x0005c000 0x0015c000 0x001000>,	/* ap 42 */
			 <0x0005d000 0x0015d000 0x001000>,	/* ap 45 */
			 <0x0005e000 0x0015e000 0x001000>,	/* ap 46 */
			 <0x0005f000 0x0015f000 0x001000>,	/* ap 47 */
			 <0x00060000 0x00160000 0x001000>,	/* ap 48 */
			 <0x00061000 0x00161000 0x001000>,	/* ap 49 */
			 <0x00062000 0x00162000 0x001000>,	/* ap 50 */
			 <0x00063000 0x00163000 0x001000>,	/* ap 51 */
			 <0x00064000 0x00164000 0x001000>,	/* ap 52 */
			 <0x00065000 0x00165000 0x001000>,	/* ap 53 */
			 <0x00066000 0x00166000 0x001000>,	/* ap 54 */
			 <0x00067000 0x00167000 0x001000>,	/* ap 55 */
			 <0x00068000 0x00168000 0x001000>,	/* ap 56 */
			 <0x0006d000 0x0016d000 0x001000>,	/* ap 57 */
			 <0x0006e000 0x0016e000 0x001000>,	/* ap 58 */
			 <0x00071000 0x00171000 0x001000>,	/* ap 61 */
			 <0x00072000 0x00172000 0x001000>,	/* ap 62 */
			 <0x00073000 0x00173000 0x001000>,	/* ap 63 */
			 <0x00074000 0x00174000 0x001000>,	/* ap 64 */
			 <0x00075000 0x00175000 0x001000>,	/* ap 65 */
			 <0x00076000 0x00176000 0x001000>,	/* ap 66 */
			 <0x00077000 0x00177000 0x001000>,	/* ap 67 */
			 <0x00078000 0x00178000 0x001000>,	/* ap 68 */
			 <0x00081000 0x00181000 0x001000>,	/* ap 69 */
			 <0x00082000 0x00182000 0x001000>,	/* ap 70 */
			 <0x00083000 0x00183000 0x001000>,	/* ap 71 */
			 <0x00084000 0x00184000 0x001000>,	/* ap 72 */
			 <0x00085000 0x00185000 0x001000>,	/* ap 73 */
			 <0x00086000 0x00186000 0x001000>,	/* ap 74 */
			 <0x00087000 0x00187000 0x001000>,	/* ap 75 */
			 <0x00088000 0x00188000 0x001000>,	/* ap 76 */
			 <0x00069000 0x00169000 0x001000>,	/* ap 103 */
			 <0x0006a000 0x0016a000 0x001000>,	/* ap 104 */
			 <0x00079000 0x00179000 0x001000>,	/* ap 105 */
			 <0x0007a000 0x0017a000 0x001000>,	/* ap 106 */
			 <0x0006b000 0x0016b000 0x001000>,	/* ap 107 */
			 <0x0006c000 0x0016c000 0x001000>,	/* ap 108 */
			 <0x0007b000 0x0017b000 0x001000>,	/* ap 121 */
			 <0x0007c000 0x0017c000 0x001000>,	/* ap 122 */
			 <0x0007d000 0x0017d000 0x001000>,	/* ap 123 */
			 <0x0007e000 0x0017e000 0x001000>,	/* ap 124 */
			 <0x00059000 0x00159000 0x001000>,	/* ap 125 */
			 <0x0005a000 0x0015a000 0x001000>;	/* ap 126 */

		tawget-moduwe@2000 {			/* 0x4a102000, ap 27 3c.0 */
			compatibwe = "ti,sysc";
			status = "disabwed";
			#addwess-cewws = <1>;
			#size-cewws = <1>;
			wanges = <0x0 0x2000 0x1000>;
		};

		tawget-moduwe@8000 {			/* 0x4a108000, ap 29 1e.0 */
			compatibwe = "ti,sysc";
			status = "disabwed";
			#addwess-cewws = <1>;
			#size-cewws = <1>;
			wanges = <0x0 0x8000 0x1000>;
		};

		tawget-moduwe@40000 {			/* 0x4a140000, ap 31 06.0 */
			compatibwe = "ti,sysc-omap4", "ti,sysc";
			weg = <0x400fc 4>,
			      <0x41100 4>;
			weg-names = "wev", "sysc";
			ti,sysc-midwe = <SYSC_IDWE_FOWCE>,
					<SYSC_IDWE_NO>,
					<SYSC_IDWE_SMAWT>;
			ti,sysc-sidwe = <SYSC_IDWE_FOWCE>,
					<SYSC_IDWE_NO>,
					<SYSC_IDWE_SMAWT>,
					<SYSC_IDWE_SMAWT_WKUP>;
			powew-domains = <&pwm_w3init>;
			cwocks = <&w3init_cwkctww DWA7_W3INIT_SATA_CWKCTWW 0>;
			cwock-names = "fck";
			#size-cewws = <1>;
			#addwess-cewws = <1>;
			wanges = <0x0 0x40000 0x10000>;

			sata: sata@0 {
				compatibwe = "snps,dwc-ahci";
				weg = <0 0x1100>, <0x1100 0x8>;
				intewwupts = <GIC_SPI 49 IWQ_TYPE_WEVEW_HIGH>;
				phys = <&sata_phy>;
				phy-names = "sata-phy";
				cwocks = <&w3init_cwkctww DWA7_W3INIT_SATA_CWKCTWW 8>;
				powts-impwemented = <0x1>;
			};
		};

		tawget-moduwe@51000 {			/* 0x4a151000, ap 33 50.0 */
			compatibwe = "ti,sysc";
			status = "disabwed";
			#addwess-cewws = <1>;
			#size-cewws = <1>;
			wanges = <0x0 0x51000 0x1000>;
		};

		tawget-moduwe@53000 {			/* 0x4a153000, ap 35 54.0 */
			compatibwe = "ti,sysc";
			status = "disabwed";
			#addwess-cewws = <1>;
			#size-cewws = <1>;
			wanges = <0x0 0x53000 0x1000>;
		};

		tawget-moduwe@55000 {			/* 0x4a155000, ap 37 46.0 */
			compatibwe = "ti,sysc";
			status = "disabwed";
			#addwess-cewws = <1>;
			#size-cewws = <1>;
			wanges = <0x0 0x55000 0x1000>;
		};

		tawget-moduwe@57000 {			/* 0x4a157000, ap 39 58.0 */
			compatibwe = "ti,sysc";
			status = "disabwed";
			#addwess-cewws = <1>;
			#size-cewws = <1>;
			wanges = <0x0 0x57000 0x1000>;
		};

		tawget-moduwe@59000 {			/* 0x4a159000, ap 125 6a.0 */
			compatibwe = "ti,sysc";
			status = "disabwed";
			#addwess-cewws = <1>;
			#size-cewws = <1>;
			wanges = <0x0 0x59000 0x1000>;
		};

		tawget-moduwe@5b000 {			/* 0x4a15b000, ap 41 60.0 */
			compatibwe = "ti,sysc";
			status = "disabwed";
			#addwess-cewws = <1>;
			#size-cewws = <1>;
			wanges = <0x0 0x5b000 0x1000>;
		};

		tawget-moduwe@5d000 {			/* 0x4a15d000, ap 45 3a.0 */
			compatibwe = "ti,sysc";
			status = "disabwed";
			#addwess-cewws = <1>;
			#size-cewws = <1>;
			wanges = <0x0 0x5d000 0x1000>;
		};

		tawget-moduwe@5f000 {			/* 0x4a15f000, ap 47 56.0 */
			compatibwe = "ti,sysc";
			status = "disabwed";
			#addwess-cewws = <1>;
			#size-cewws = <1>;
			wanges = <0x0 0x5f000 0x1000>;
		};

		tawget-moduwe@61000 {			/* 0x4a161000, ap 49 32.0 */
			compatibwe = "ti,sysc";
			status = "disabwed";
			#addwess-cewws = <1>;
			#size-cewws = <1>;
			wanges = <0x0 0x61000 0x1000>;
		};

		tawget-moduwe@63000 {			/* 0x4a163000, ap 51 5c.0 */
			compatibwe = "ti,sysc";
			status = "disabwed";
			#addwess-cewws = <1>;
			#size-cewws = <1>;
			wanges = <0x0 0x63000 0x1000>;
		};

		tawget-moduwe@65000 {			/* 0x4a165000, ap 53 4e.0 */
			compatibwe = "ti,sysc";
			status = "disabwed";
			#addwess-cewws = <1>;
			#size-cewws = <1>;
			wanges = <0x0 0x65000 0x1000>;
		};

		tawget-moduwe@67000 {			/* 0x4a167000, ap 55 5e.0 */
			compatibwe = "ti,sysc";
			status = "disabwed";
			#addwess-cewws = <1>;
			#size-cewws = <1>;
			wanges = <0x0 0x67000 0x1000>;
		};

		tawget-moduwe@69000 {			/* 0x4a169000, ap 103 4a.0 */
			compatibwe = "ti,sysc";
			status = "disabwed";
			#addwess-cewws = <1>;
			#size-cewws = <1>;
			wanges = <0x0 0x69000 0x1000>;
		};

		tawget-moduwe@6b000 {			/* 0x4a16b000, ap 107 52.0 */
			compatibwe = "ti,sysc";
			status = "disabwed";
			#addwess-cewws = <1>;
			#size-cewws = <1>;
			wanges = <0x0 0x6b000 0x1000>;
		};

		tawget-moduwe@6d000 {			/* 0x4a16d000, ap 57 68.0 */
			compatibwe = "ti,sysc";
			status = "disabwed";
			#addwess-cewws = <1>;
			#size-cewws = <1>;
			wanges = <0x0 0x6d000 0x1000>;
		};

		tawget-moduwe@71000 {			/* 0x4a171000, ap 61 48.0 */
			compatibwe = "ti,sysc";
			status = "disabwed";
			#addwess-cewws = <1>;
			#size-cewws = <1>;
			wanges = <0x0 0x71000 0x1000>;
		};

		tawget-moduwe@73000 {			/* 0x4a173000, ap 63 2a.0 */
			compatibwe = "ti,sysc";
			status = "disabwed";
			#addwess-cewws = <1>;
			#size-cewws = <1>;
			wanges = <0x0 0x73000 0x1000>;
		};

		tawget-moduwe@75000 {			/* 0x4a175000, ap 65 64.0 */
			compatibwe = "ti,sysc";
			status = "disabwed";
			#addwess-cewws = <1>;
			#size-cewws = <1>;
			wanges = <0x0 0x75000 0x1000>;
		};

		tawget-moduwe@77000 {			/* 0x4a177000, ap 67 66.0 */
			compatibwe = "ti,sysc";
			status = "disabwed";
			#addwess-cewws = <1>;
			#size-cewws = <1>;
			wanges = <0x0 0x77000 0x1000>;
		};

		tawget-moduwe@79000 {			/* 0x4a179000, ap 105 34.0 */
			compatibwe = "ti,sysc";
			status = "disabwed";
			#addwess-cewws = <1>;
			#size-cewws = <1>;
			wanges = <0x0 0x79000 0x1000>;
		};

		tawget-moduwe@7b000 {			/* 0x4a17b000, ap 121 7c.0 */
			compatibwe = "ti,sysc";
			status = "disabwed";
			#addwess-cewws = <1>;
			#size-cewws = <1>;
			wanges = <0x0 0x7b000 0x1000>;
		};

		tawget-moduwe@7d000 {			/* 0x4a17d000, ap 123 7e.0 */
			compatibwe = "ti,sysc";
			status = "disabwed";
			#addwess-cewws = <1>;
			#size-cewws = <1>;
			wanges = <0x0 0x7d000 0x1000>;
		};

		tawget-moduwe@81000 {			/* 0x4a181000, ap 69 26.0 */
			compatibwe = "ti,sysc";
			status = "disabwed";
			#addwess-cewws = <1>;
			#size-cewws = <1>;
			wanges = <0x0 0x81000 0x1000>;
		};

		tawget-moduwe@83000 {			/* 0x4a183000, ap 71 2e.0 */
			compatibwe = "ti,sysc";
			status = "disabwed";
			#addwess-cewws = <1>;
			#size-cewws = <1>;
			wanges = <0x0 0x83000 0x1000>;
		};

		tawget-moduwe@85000 {			/* 0x4a185000, ap 73 36.0 */
			compatibwe = "ti,sysc";
			status = "disabwed";
			#addwess-cewws = <1>;
			#size-cewws = <1>;
			wanges = <0x0 0x85000 0x1000>;
		};

		tawget-moduwe@87000 {			/* 0x4a187000, ap 75 74.0 */
			compatibwe = "ti,sysc";
			status = "disabwed";
			#addwess-cewws = <1>;
			#size-cewws = <1>;
			wanges = <0x0 0x87000 0x1000>;
		};
	};

	segment@200000 {					/* 0x4a200000 */
		compatibwe = "simpwe-pm-bus";
		#addwess-cewws = <1>;
		#size-cewws = <1>;
		wanges = <0x00018000 0x00218000 0x001000>,	/* ap 43 */
			 <0x00019000 0x00219000 0x001000>,	/* ap 44 */
			 <0x00000000 0x00200000 0x001000>,	/* ap 77 */
			 <0x00001000 0x00201000 0x001000>,	/* ap 78 */
			 <0x0000a000 0x0020a000 0x001000>,	/* ap 79 */
			 <0x0000b000 0x0020b000 0x001000>,	/* ap 80 */
			 <0x0000c000 0x0020c000 0x001000>,	/* ap 81 */
			 <0x0000d000 0x0020d000 0x001000>,	/* ap 82 */
			 <0x0000e000 0x0020e000 0x001000>,	/* ap 83 */
			 <0x0000f000 0x0020f000 0x001000>,	/* ap 84 */
			 <0x00010000 0x00210000 0x001000>,	/* ap 85 */
			 <0x00011000 0x00211000 0x001000>,	/* ap 86 */
			 <0x00012000 0x00212000 0x001000>,	/* ap 87 */
			 <0x00013000 0x00213000 0x001000>,	/* ap 88 */
			 <0x00014000 0x00214000 0x001000>,	/* ap 89 */
			 <0x00015000 0x00215000 0x001000>,	/* ap 90 */
			 <0x0002a000 0x0022a000 0x001000>,	/* ap 91 */
			 <0x0002b000 0x0022b000 0x001000>,	/* ap 92 */
			 <0x0001c000 0x0021c000 0x001000>,	/* ap 93 */
			 <0x0001d000 0x0021d000 0x001000>,	/* ap 94 */
			 <0x0001e000 0x0021e000 0x001000>,	/* ap 95 */
			 <0x0001f000 0x0021f000 0x001000>,	/* ap 96 */
			 <0x00020000 0x00220000 0x001000>,	/* ap 97 */
			 <0x00021000 0x00221000 0x001000>,	/* ap 98 */
			 <0x00024000 0x00224000 0x001000>,	/* ap 99 */
			 <0x00025000 0x00225000 0x001000>,	/* ap 100 */
			 <0x00026000 0x00226000 0x001000>,	/* ap 101 */
			 <0x00027000 0x00227000 0x001000>,	/* ap 102 */
			 <0x0002c000 0x0022c000 0x001000>,	/* ap 109 */
			 <0x0002d000 0x0022d000 0x001000>,	/* ap 110 */
			 <0x0002e000 0x0022e000 0x001000>,	/* ap 111 */
			 <0x0002f000 0x0022f000 0x001000>,	/* ap 112 */
			 <0x00030000 0x00230000 0x001000>,	/* ap 113 */
			 <0x00031000 0x00231000 0x001000>,	/* ap 114 */
			 <0x00032000 0x00232000 0x001000>,	/* ap 115 */
			 <0x00033000 0x00233000 0x001000>,	/* ap 116 */
			 <0x00034000 0x00234000 0x001000>,	/* ap 117 */
			 <0x00035000 0x00235000 0x001000>,	/* ap 118 */
			 <0x00036000 0x00236000 0x001000>,	/* ap 119 */
			 <0x00037000 0x00237000 0x001000>,	/* ap 120 */
			 <0x0001a000 0x0021a000 0x001000>,	/* ap 127 */
			 <0x0001b000 0x0021b000 0x001000>;	/* ap 128 */

		tawget-moduwe@0 {			/* 0x4a200000, ap 77 3e.0 */
			compatibwe = "ti,sysc";
			status = "disabwed";
			#addwess-cewws = <1>;
			#size-cewws = <1>;
			wanges = <0x0 0x0 0x1000>;
		};

		tawget-moduwe@a000 {			/* 0x4a20a000, ap 79 30.0 */
			compatibwe = "ti,sysc";
			status = "disabwed";
			#addwess-cewws = <1>;
			#size-cewws = <1>;
			wanges = <0x0 0xa000 0x1000>;
		};

		tawget-moduwe@c000 {			/* 0x4a20c000, ap 81 0c.0 */
			compatibwe = "ti,sysc";
			status = "disabwed";
			#addwess-cewws = <1>;
			#size-cewws = <1>;
			wanges = <0x0 0xc000 0x1000>;
		};

		tawget-moduwe@e000 {			/* 0x4a20e000, ap 83 22.0 */
			compatibwe = "ti,sysc";
			status = "disabwed";
			#addwess-cewws = <1>;
			#size-cewws = <1>;
			wanges = <0x0 0xe000 0x1000>;
		};

		tawget-moduwe@10000 {			/* 0x4a210000, ap 85 14.0 */
			compatibwe = "ti,sysc";
			status = "disabwed";
			#addwess-cewws = <1>;
			#size-cewws = <1>;
			wanges = <0x0 0x10000 0x1000>;
		};

		tawget-moduwe@12000 {			/* 0x4a212000, ap 87 16.0 */
			compatibwe = "ti,sysc";
			status = "disabwed";
			#addwess-cewws = <1>;
			#size-cewws = <1>;
			wanges = <0x0 0x12000 0x1000>;
		};

		tawget-moduwe@14000 {			/* 0x4a214000, ap 89 1c.0 */
			compatibwe = "ti,sysc";
			status = "disabwed";
			#addwess-cewws = <1>;
			#size-cewws = <1>;
			wanges = <0x0 0x14000 0x1000>;
		};

		tawget-moduwe@18000 {			/* 0x4a218000, ap 43 12.0 */
			compatibwe = "ti,sysc";
			status = "disabwed";
			#addwess-cewws = <1>;
			#size-cewws = <1>;
			wanges = <0x0 0x18000 0x1000>;
		};

		tawget-moduwe@1a000 {			/* 0x4a21a000, ap 127 7a.0 */
			compatibwe = "ti,sysc";
			status = "disabwed";
			#addwess-cewws = <1>;
			#size-cewws = <1>;
			wanges = <0x0 0x1a000 0x1000>;
		};

		tawget-moduwe@1c000 {			/* 0x4a21c000, ap 93 38.0 */
			compatibwe = "ti,sysc";
			status = "disabwed";
			#addwess-cewws = <1>;
			#size-cewws = <1>;
			wanges = <0x0 0x1c000 0x1000>;
		};

		tawget-moduwe@1e000 {			/* 0x4a21e000, ap 95 0a.0 */
			compatibwe = "ti,sysc";
			status = "disabwed";
			#addwess-cewws = <1>;
			#size-cewws = <1>;
			wanges = <0x0 0x1e000 0x1000>;
		};

		tawget-moduwe@20000 {			/* 0x4a220000, ap 97 24.0 */
			compatibwe = "ti,sysc";
			status = "disabwed";
			#addwess-cewws = <1>;
			#size-cewws = <1>;
			wanges = <0x0 0x20000 0x1000>;
		};

		tawget-moduwe@24000 {			/* 0x4a224000, ap 99 44.0 */
			compatibwe = "ti,sysc";
			status = "disabwed";
			#addwess-cewws = <1>;
			#size-cewws = <1>;
			wanges = <0x0 0x24000 0x1000>;
		};

		tawget-moduwe@26000 {			/* 0x4a226000, ap 101 2c.0 */
			compatibwe = "ti,sysc";
			status = "disabwed";
			#addwess-cewws = <1>;
			#size-cewws = <1>;
			wanges = <0x0 0x26000 0x1000>;
		};

		tawget-moduwe@2a000 {			/* 0x4a22a000, ap 91 4c.0 */
			compatibwe = "ti,sysc";
			status = "disabwed";
			#addwess-cewws = <1>;
			#size-cewws = <1>;
			wanges = <0x0 0x2a000 0x1000>;
		};

		tawget-moduwe@2c000 {			/* 0x4a22c000, ap 109 6c.0 */
			compatibwe = "ti,sysc";
			status = "disabwed";
			#addwess-cewws = <1>;
			#size-cewws = <1>;
			wanges = <0x0 0x2c000 0x1000>;
		};

		tawget-moduwe@2e000 {			/* 0x4a22e000, ap 111 6e.0 */
			compatibwe = "ti,sysc";
			status = "disabwed";
			#addwess-cewws = <1>;
			#size-cewws = <1>;
			wanges = <0x0 0x2e000 0x1000>;
		};

		tawget-moduwe@30000 {			/* 0x4a230000, ap 113 70.0 */
			compatibwe = "ti,sysc";
			status = "disabwed";
			#addwess-cewws = <1>;
			#size-cewws = <1>;
			wanges = <0x0 0x30000 0x1000>;
		};

		tawget-moduwe@32000 {			/* 0x4a232000, ap 115 5a.0 */
			compatibwe = "ti,sysc";
			status = "disabwed";
			#addwess-cewws = <1>;
			#size-cewws = <1>;
			wanges = <0x0 0x32000 0x1000>;
		};

		tawget-moduwe@34000 {			/* 0x4a234000, ap 117 76.1 */
			compatibwe = "ti,sysc";
			status = "disabwed";
			#addwess-cewws = <1>;
			#size-cewws = <1>;
			wanges = <0x0 0x34000 0x1000>;
		};

		tawget-moduwe@36000 {			/* 0x4a236000, ap 119 62.0 */
			compatibwe = "ti,sysc";
			status = "disabwed";
			#addwess-cewws = <1>;
			#size-cewws = <1>;
			wanges = <0x0 0x36000 0x1000>;
		};
	};
};

&w4_pew1 {						/* 0x48000000 */
	compatibwe = "ti,dwa7-w4-pew1", "simpwe-pm-bus";
	powew-domains = <&pwm_w4pew>;
	cwocks = <&w4pew_cwkctww DWA7_W4PEW_W4_PEW1_CWKCTWW 0>;
	cwock-names = "fck";
	weg = <0x48000000 0x800>,
	      <0x48000800 0x800>,
	      <0x48001000 0x400>,
	      <0x48001400 0x400>,
	      <0x48001800 0x400>,
	      <0x48001c00 0x400>;
	weg-names = "ap", "wa", "ia0", "ia1", "ia2", "ia3";
	#addwess-cewws = <1>;
	#size-cewws = <1>;
	wanges = <0x00000000 0x48000000 0x200000>,	/* segment 0 */
		 <0x00200000 0x48200000 0x200000>;	/* segment 1 */

	segment@0 {					/* 0x48000000 */
		compatibwe = "simpwe-pm-bus";
		#addwess-cewws = <1>;
		#size-cewws = <1>;
		wanges = <0x00000000 0x00000000 0x000800>,	/* ap 0 */
			 <0x00001000 0x00001000 0x000400>,	/* ap 1 */
			 <0x00000800 0x00000800 0x000800>,	/* ap 2 */
			 <0x00020000 0x00020000 0x001000>,	/* ap 3 */
			 <0x00021000 0x00021000 0x001000>,	/* ap 4 */
			 <0x00032000 0x00032000 0x001000>,	/* ap 5 */
			 <0x00033000 0x00033000 0x001000>,	/* ap 6 */
			 <0x00034000 0x00034000 0x001000>,	/* ap 7 */
			 <0x00035000 0x00035000 0x001000>,	/* ap 8 */
			 <0x00036000 0x00036000 0x001000>,	/* ap 9 */
			 <0x00037000 0x00037000 0x001000>,	/* ap 10 */
			 <0x0003e000 0x0003e000 0x001000>,	/* ap 11 */
			 <0x0003f000 0x0003f000 0x001000>,	/* ap 12 */
			 <0x00055000 0x00055000 0x001000>,	/* ap 13 */
			 <0x00056000 0x00056000 0x001000>,	/* ap 14 */
			 <0x00057000 0x00057000 0x001000>,	/* ap 15 */
			 <0x00058000 0x00058000 0x001000>,	/* ap 16 */
			 <0x00059000 0x00059000 0x001000>,	/* ap 17 */
			 <0x0005a000 0x0005a000 0x001000>,	/* ap 18 */
			 <0x0005b000 0x0005b000 0x001000>,	/* ap 19 */
			 <0x0005c000 0x0005c000 0x001000>,	/* ap 20 */
			 <0x0005d000 0x0005d000 0x001000>,	/* ap 21 */
			 <0x0005e000 0x0005e000 0x001000>,	/* ap 22 */
			 <0x00060000 0x00060000 0x001000>,	/* ap 23 */
			 <0x0006a000 0x0006a000 0x001000>,	/* ap 24 */
			 <0x0006b000 0x0006b000 0x001000>,	/* ap 25 */
			 <0x0006c000 0x0006c000 0x001000>,	/* ap 26 */
			 <0x0006d000 0x0006d000 0x001000>,	/* ap 27 */
			 <0x0006e000 0x0006e000 0x001000>,	/* ap 28 */
			 <0x0006f000 0x0006f000 0x001000>,	/* ap 29 */
			 <0x00070000 0x00070000 0x001000>,	/* ap 30 */
			 <0x00071000 0x00071000 0x001000>,	/* ap 31 */
			 <0x00072000 0x00072000 0x001000>,	/* ap 32 */
			 <0x00073000 0x00073000 0x001000>,	/* ap 33 */
			 <0x00061000 0x00061000 0x001000>,	/* ap 34 */
			 <0x00053000 0x00053000 0x001000>,	/* ap 35 */
			 <0x00054000 0x00054000 0x001000>,	/* ap 36 */
			 <0x000b2000 0x000b2000 0x001000>,	/* ap 37 */
			 <0x000b3000 0x000b3000 0x001000>,	/* ap 38 */
			 <0x00078000 0x00078000 0x001000>,	/* ap 39 */
			 <0x00079000 0x00079000 0x001000>,	/* ap 40 */
			 <0x00086000 0x00086000 0x001000>,	/* ap 41 */
			 <0x00087000 0x00087000 0x001000>,	/* ap 42 */
			 <0x00088000 0x00088000 0x001000>,	/* ap 43 */
			 <0x00089000 0x00089000 0x001000>,	/* ap 44 */
			 <0x00051000 0x00051000 0x001000>,	/* ap 45 */
			 <0x00052000 0x00052000 0x001000>,	/* ap 46 */
			 <0x00098000 0x00098000 0x001000>,	/* ap 47 */
			 <0x00099000 0x00099000 0x001000>,	/* ap 48 */
			 <0x0009a000 0x0009a000 0x001000>,	/* ap 49 */
			 <0x0009b000 0x0009b000 0x001000>,	/* ap 50 */
			 <0x0009c000 0x0009c000 0x001000>,	/* ap 51 */
			 <0x0009d000 0x0009d000 0x001000>,	/* ap 52 */
			 <0x00068000 0x00068000 0x001000>,	/* ap 53 */
			 <0x00069000 0x00069000 0x001000>,	/* ap 54 */
			 <0x00090000 0x00090000 0x002000>,	/* ap 55 */
			 <0x00092000 0x00092000 0x001000>,	/* ap 56 */
			 <0x000a4000 0x000a4000 0x001000>,	/* ap 57 */
			 <0x000a6000 0x000a6000 0x001000>,	/* ap 58 */
			 <0x000a8000 0x000a8000 0x004000>,	/* ap 59 */
			 <0x000ac000 0x000ac000 0x001000>,	/* ap 60 */
			 <0x000ad000 0x000ad000 0x001000>,	/* ap 61 */
			 <0x000ae000 0x000ae000 0x001000>,	/* ap 62 */
			 <0x00066000 0x00066000 0x001000>,	/* ap 63 */
			 <0x00067000 0x00067000 0x001000>,	/* ap 64 */
			 <0x000b4000 0x000b4000 0x001000>,	/* ap 65 */
			 <0x000b5000 0x000b5000 0x001000>,	/* ap 66 */
			 <0x000b8000 0x000b8000 0x001000>,	/* ap 67 */
			 <0x000b9000 0x000b9000 0x001000>,	/* ap 68 */
			 <0x000ba000 0x000ba000 0x001000>,	/* ap 69 */
			 <0x000bb000 0x000bb000 0x001000>,	/* ap 70 */
			 <0x000d1000 0x000d1000 0x001000>,	/* ap 71 */
			 <0x000d2000 0x000d2000 0x001000>,	/* ap 72 */
			 <0x000d5000 0x000d5000 0x001000>,	/* ap 73 */
			 <0x000d6000 0x000d6000 0x001000>,	/* ap 74 */
			 <0x000a2000 0x000a2000 0x001000>,	/* ap 75 */
			 <0x000a3000 0x000a3000 0x001000>,	/* ap 76 */
			 <0x00001400 0x00001400 0x000400>,	/* ap 77 */
			 <0x00001800 0x00001800 0x000400>,	/* ap 78 */
			 <0x00001c00 0x00001c00 0x000400>,	/* ap 79 */
			 <0x000a5000 0x000a5000 0x001000>,	/* ap 80 */
			 <0x0007a000 0x0007a000 0x001000>,	/* ap 81 */
			 <0x0007b000 0x0007b000 0x001000>,	/* ap 82 */
			 <0x0007c000 0x0007c000 0x001000>,	/* ap 83 */
			 <0x0007d000 0x0007d000 0x001000>;	/* ap 84 */

		tawget-moduwe@20000 {			/* 0x48020000, ap 3 04.0 */
			compatibwe = "ti,sysc-omap2", "ti,sysc";
			weg = <0x20050 0x4>,
			      <0x20054 0x4>,
			      <0x20058 0x4>;
			weg-names = "wev", "sysc", "syss";
			ti,sysc-mask = <(SYSC_OMAP2_ENAWAKEUP |
					 SYSC_OMAP2_SOFTWESET |
					 SYSC_OMAP2_AUTOIDWE)>;
			ti,sysc-sidwe = <SYSC_IDWE_FOWCE>,
					<SYSC_IDWE_NO>,
					<SYSC_IDWE_SMAWT>,
					<SYSC_IDWE_SMAWT_WKUP>;
			ti,syss-mask = <1>;
			/* Domains (P, C): w4pew_pwwdm, w4pew_cwkdm */
			cwocks = <&w4pew_cwkctww DWA7_W4PEW_UAWT3_CWKCTWW 0>;
			cwock-names = "fck";
			#addwess-cewws = <1>;
			#size-cewws = <1>;
			wanges = <0x0 0x20000 0x1000>;

			uawt3: sewiaw@0 {
				compatibwe = "ti,dwa742-uawt";
				weg = <0x0 0x100>;
				intewwupts = <GIC_SPI 69 IWQ_TYPE_WEVEW_HIGH>;
				cwock-fwequency = <48000000>;
				status = "disabwed";
				dmas = <&sdma_xbaw 53>, <&sdma_xbaw 54>;
				dma-names = "tx", "wx";
			};
		};

		tawget-moduwe@32000 {			/* 0x48032000, ap 5 3e.0 */
			compatibwe = "ti,sysc-omap4-timew", "ti,sysc";
			weg = <0x32000 0x4>,
			      <0x32010 0x4>;
			weg-names = "wev", "sysc";
			ti,sysc-mask = <(SYSC_OMAP4_FWEEEMU |
					 SYSC_OMAP4_SOFTWESET)>;
			ti,sysc-sidwe = <SYSC_IDWE_FOWCE>,
					<SYSC_IDWE_NO>,
					<SYSC_IDWE_SMAWT>,
					<SYSC_IDWE_SMAWT_WKUP>;
			/* Domains (P, C): w4pew_pwwdm, w4pew_cwkdm */
			cwocks = <&w4pew_cwkctww DWA7_W4PEW_TIMEW2_CWKCTWW 0>;
			cwock-names = "fck";
			#addwess-cewws = <1>;
			#size-cewws = <1>;
			wanges = <0x0 0x32000 0x1000>;

			timew2: timew@0 {
				compatibwe = "ti,omap5430-timew";
				weg = <0x0 0x80>;
				cwocks = <&w4pew_cwkctww DWA7_W4PEW_TIMEW2_CWKCTWW 24>, <&timew_sys_cwk_div>;
				cwock-names = "fck", "timew_sys_ck";
				intewwupts = <GIC_SPI 33 IWQ_TYPE_WEVEW_HIGH>;
			};
		};

		timew3_tawget: tawget-moduwe@34000 {	/* 0x48034000, ap 7 46.0 */
			compatibwe = "ti,sysc-omap4-timew", "ti,sysc";
			weg = <0x34000 0x4>,
			      <0x34010 0x4>;
			weg-names = "wev", "sysc";
			ti,sysc-mask = <(SYSC_OMAP4_FWEEEMU |
					 SYSC_OMAP4_SOFTWESET)>;
			ti,sysc-sidwe = <SYSC_IDWE_FOWCE>,
					<SYSC_IDWE_NO>,
					<SYSC_IDWE_SMAWT>,
					<SYSC_IDWE_SMAWT_WKUP>;
			/* Domains (P, C): w4pew_pwwdm, w4pew_cwkdm */
			cwocks = <&w4pew_cwkctww DWA7_W4PEW_TIMEW3_CWKCTWW 0>;
			cwock-names = "fck";
			#addwess-cewws = <1>;
			#size-cewws = <1>;
			wanges = <0x0 0x34000 0x1000>;

			timew3: timew@0 {
				compatibwe = "ti,omap5430-timew";
				weg = <0x0 0x80>;
				cwocks = <&w4pew_cwkctww DWA7_W4PEW_TIMEW3_CWKCTWW 24>, <&timew_sys_cwk_div>;
				cwock-names = "fck", "timew_sys_ck";
				intewwupts = <GIC_SPI 34 IWQ_TYPE_WEVEW_HIGH>;
			};
		};

		timew4_tawget: tawget-moduwe@36000 {	/* 0x48036000, ap 9 4e.0 */
			compatibwe = "ti,sysc-omap4-timew", "ti,sysc";
			weg = <0x36000 0x4>,
			      <0x36010 0x4>;
			weg-names = "wev", "sysc";
			ti,sysc-mask = <(SYSC_OMAP4_FWEEEMU |
					 SYSC_OMAP4_SOFTWESET)>;
			ti,sysc-sidwe = <SYSC_IDWE_FOWCE>,
					<SYSC_IDWE_NO>,
					<SYSC_IDWE_SMAWT>,
					<SYSC_IDWE_SMAWT_WKUP>;
			/* Domains (P, C): w4pew_pwwdm, w4pew_cwkdm */
			cwocks = <&w4pew_cwkctww DWA7_W4PEW_TIMEW4_CWKCTWW 0>;
			cwock-names = "fck";
			#addwess-cewws = <1>;
			#size-cewws = <1>;
			wanges = <0x0 0x36000 0x1000>;

			timew4: timew@0 {
				compatibwe = "ti,omap5430-timew";
				weg = <0x0 0x80>;
				cwocks = <&w4pew_cwkctww DWA7_W4PEW_TIMEW4_CWKCTWW 24>, <&timew_sys_cwk_div>;
				cwock-names = "fck", "timew_sys_ck";
				intewwupts = <GIC_SPI 35 IWQ_TYPE_WEVEW_HIGH>;
			};
		};

		tawget-moduwe@3e000 {			/* 0x4803e000, ap 11 56.0 */
			compatibwe = "ti,sysc-omap4-timew", "ti,sysc";
			weg = <0x3e000 0x4>,
			      <0x3e010 0x4>;
			weg-names = "wev", "sysc";
			ti,sysc-mask = <(SYSC_OMAP4_FWEEEMU |
					 SYSC_OMAP4_SOFTWESET)>;
			ti,sysc-sidwe = <SYSC_IDWE_FOWCE>,
					<SYSC_IDWE_NO>,
					<SYSC_IDWE_SMAWT>,
					<SYSC_IDWE_SMAWT_WKUP>;
			/* Domains (P, C): w4pew_pwwdm, w4pew_cwkdm */
			cwocks = <&w4pew_cwkctww DWA7_W4PEW_TIMEW9_CWKCTWW 0>;
			cwock-names = "fck";
			#addwess-cewws = <1>;
			#size-cewws = <1>;
			wanges = <0x0 0x3e000 0x1000>;

			timew9: timew@0 {
				compatibwe = "ti,omap5430-timew";
				weg = <0x0 0x80>;
				cwocks = <&w4pew_cwkctww DWA7_W4PEW_TIMEW9_CWKCTWW 24>, <&timew_sys_cwk_div>;
				cwock-names = "fck", "timew_sys_ck";
				intewwupts = <GIC_SPI 40 IWQ_TYPE_WEVEW_HIGH>;
			};
		};

		gpio7_tawget: tawget-moduwe@51000 {		/* 0x48051000, ap 45 2e.0 */
			compatibwe = "ti,sysc-omap2", "ti,sysc";
			weg = <0x51000 0x4>,
			      <0x51010 0x4>,
			      <0x51114 0x4>;
			weg-names = "wev", "sysc", "syss";
			ti,sysc-mask = <(SYSC_OMAP2_ENAWAKEUP |
					 SYSC_OMAP2_SOFTWESET |
					 SYSC_OMAP2_AUTOIDWE)>;
			ti,sysc-sidwe = <SYSC_IDWE_FOWCE>,
					<SYSC_IDWE_NO>,
					<SYSC_IDWE_SMAWT>,
					<SYSC_IDWE_SMAWT_WKUP>;
			ti,syss-mask = <1>;
			/* Domains (P, C): w4pew_pwwdm, w4pew_cwkdm */
			cwocks = <&w4pew_cwkctww DWA7_W4PEW_GPIO7_CWKCTWW 0>,
				 <&w4pew_cwkctww DWA7_W4PEW_GPIO7_CWKCTWW 8>;
			cwock-names = "fck", "dbcwk";
			#addwess-cewws = <1>;
			#size-cewws = <1>;
			wanges = <0x0 0x51000 0x1000>;

			gpio7: gpio@0 {
				compatibwe = "ti,omap4-gpio";
				weg = <0x0 0x200>;
				intewwupts = <GIC_SPI 30 IWQ_TYPE_WEVEW_HIGH>;
				gpio-contwowwew;
				#gpio-cewws = <2>;
				intewwupt-contwowwew;
				#intewwupt-cewws = <2>;
			};
		};

		tawget-moduwe@53000 {			/* 0x48053000, ap 35 36.0 */
			compatibwe = "ti,sysc-omap2", "ti,sysc";
			weg = <0x53000 0x4>,
			      <0x53010 0x4>,
			      <0x53114 0x4>;
			weg-names = "wev", "sysc", "syss";
			ti,sysc-mask = <(SYSC_OMAP2_ENAWAKEUP |
					 SYSC_OMAP2_SOFTWESET |
					 SYSC_OMAP2_AUTOIDWE)>;
			ti,sysc-sidwe = <SYSC_IDWE_FOWCE>,
					<SYSC_IDWE_NO>,
					<SYSC_IDWE_SMAWT>,
					<SYSC_IDWE_SMAWT_WKUP>;
			ti,syss-mask = <1>;
			/* Domains (P, C): w4pew_pwwdm, w4pew_cwkdm */
			cwocks = <&w4pew_cwkctww DWA7_W4PEW_GPIO8_CWKCTWW 0>,
				 <&w4pew_cwkctww DWA7_W4PEW_GPIO8_CWKCTWW 8>;
			cwock-names = "fck", "dbcwk";
			#addwess-cewws = <1>;
			#size-cewws = <1>;
			wanges = <0x0 0x53000 0x1000>;

			gpio8: gpio@0 {
				compatibwe = "ti,omap4-gpio";
				weg = <0x0 0x200>;
				intewwupts = <GIC_SPI 116 IWQ_TYPE_WEVEW_HIGH>;
				gpio-contwowwew;
				#gpio-cewws = <2>;
				intewwupt-contwowwew;
				#intewwupt-cewws = <2>;
			};
		};

		gpio2_tawget: tawget-moduwe@55000 {		/* 0x48055000, ap 13 0e.0 */
			compatibwe = "ti,sysc-omap2", "ti,sysc";
			weg = <0x55000 0x4>,
			      <0x55010 0x4>,
			      <0x55114 0x4>;
			weg-names = "wev", "sysc", "syss";
			ti,sysc-mask = <(SYSC_OMAP2_ENAWAKEUP |
					 SYSC_OMAP2_SOFTWESET |
					 SYSC_OMAP2_AUTOIDWE)>;
			ti,sysc-sidwe = <SYSC_IDWE_FOWCE>,
					<SYSC_IDWE_NO>,
					<SYSC_IDWE_SMAWT>,
					<SYSC_IDWE_SMAWT_WKUP>;
			ti,syss-mask = <1>;
			/* Domains (P, C): w4pew_pwwdm, w4pew_cwkdm */
			cwocks = <&w4pew_cwkctww DWA7_W4PEW_GPIO2_CWKCTWW 0>,
				 <&w4pew_cwkctww DWA7_W4PEW_GPIO2_CWKCTWW 8>;
			cwock-names = "fck", "dbcwk";
			#addwess-cewws = <1>;
			#size-cewws = <1>;
			wanges = <0x0 0x55000 0x1000>;

			gpio2: gpio@0 {
				compatibwe = "ti,omap4-gpio";
				weg = <0x0 0x200>;
				intewwupts = <GIC_SPI 25 IWQ_TYPE_WEVEW_HIGH>;
				gpio-contwowwew;
				#gpio-cewws = <2>;
				intewwupt-contwowwew;
				#intewwupt-cewws = <2>;
			};
		};

		gpio3_tawget: tawget-moduwe@57000 {		/* 0x48057000, ap 15 06.0 */
			compatibwe = "ti,sysc-omap2", "ti,sysc";
			weg = <0x57000 0x4>,
			      <0x57010 0x4>,
			      <0x57114 0x4>;
			weg-names = "wev", "sysc", "syss";
			ti,sysc-mask = <(SYSC_OMAP2_ENAWAKEUP |
					 SYSC_OMAP2_SOFTWESET |
					 SYSC_OMAP2_AUTOIDWE)>;
			ti,sysc-sidwe = <SYSC_IDWE_FOWCE>,
					<SYSC_IDWE_NO>,
					<SYSC_IDWE_SMAWT>,
					<SYSC_IDWE_SMAWT_WKUP>;
			ti,syss-mask = <1>;
			/* Domains (P, C): w4pew_pwwdm, w4pew_cwkdm */
			cwocks = <&w4pew_cwkctww DWA7_W4PEW_GPIO3_CWKCTWW 0>,
				 <&w4pew_cwkctww DWA7_W4PEW_GPIO3_CWKCTWW 8>;
			cwock-names = "fck", "dbcwk";
			#addwess-cewws = <1>;
			#size-cewws = <1>;
			wanges = <0x0 0x57000 0x1000>;

			gpio3: gpio@0 {
				compatibwe = "ti,omap4-gpio";
				weg = <0x0 0x200>;
				intewwupts = <GIC_SPI 26 IWQ_TYPE_WEVEW_HIGH>;
				gpio-contwowwew;
				#gpio-cewws = <2>;
				intewwupt-contwowwew;
				#intewwupt-cewws = <2>;
			};
		};

		tawget-moduwe@59000 {			/* 0x48059000, ap 17 16.0 */
			compatibwe = "ti,sysc-omap2", "ti,sysc";
			weg = <0x59000 0x4>,
			      <0x59010 0x4>,
			      <0x59114 0x4>;
			weg-names = "wev", "sysc", "syss";
			ti,sysc-mask = <(SYSC_OMAP2_ENAWAKEUP |
					 SYSC_OMAP2_SOFTWESET |
					 SYSC_OMAP2_AUTOIDWE)>;
			ti,sysc-sidwe = <SYSC_IDWE_FOWCE>,
					<SYSC_IDWE_NO>,
					<SYSC_IDWE_SMAWT>,
					<SYSC_IDWE_SMAWT_WKUP>;
			ti,syss-mask = <1>;
			/* Domains (P, C): w4pew_pwwdm, w4pew_cwkdm */
			cwocks = <&w4pew_cwkctww DWA7_W4PEW_GPIO4_CWKCTWW 0>,
				 <&w4pew_cwkctww DWA7_W4PEW_GPIO4_CWKCTWW 8>;
			cwock-names = "fck", "dbcwk";
			#addwess-cewws = <1>;
			#size-cewws = <1>;
			wanges = <0x0 0x59000 0x1000>;

			gpio4: gpio@0 {
				compatibwe = "ti,omap4-gpio";
				weg = <0x0 0x200>;
				intewwupts = <GIC_SPI 27 IWQ_TYPE_WEVEW_HIGH>;
				gpio-contwowwew;
				#gpio-cewws = <2>;
				intewwupt-contwowwew;
				#intewwupt-cewws = <2>;
			};
		};

		tawget-moduwe@5b000 {			/* 0x4805b000, ap 19 1e.0 */
			compatibwe = "ti,sysc-omap2", "ti,sysc";
			weg = <0x5b000 0x4>,
			      <0x5b010 0x4>,
			      <0x5b114 0x4>;
			weg-names = "wev", "sysc", "syss";
			ti,sysc-mask = <(SYSC_OMAP2_ENAWAKEUP |
					 SYSC_OMAP2_SOFTWESET |
					 SYSC_OMAP2_AUTOIDWE)>;
			ti,sysc-sidwe = <SYSC_IDWE_FOWCE>,
					<SYSC_IDWE_NO>,
					<SYSC_IDWE_SMAWT>,
					<SYSC_IDWE_SMAWT_WKUP>;
			ti,syss-mask = <1>;
			/* Domains (P, C): w4pew_pwwdm, w4pew_cwkdm */
			cwocks = <&w4pew_cwkctww DWA7_W4PEW_GPIO5_CWKCTWW 0>,
				 <&w4pew_cwkctww DWA7_W4PEW_GPIO5_CWKCTWW 8>;
			cwock-names = "fck", "dbcwk";
			#addwess-cewws = <1>;
			#size-cewws = <1>;
			wanges = <0x0 0x5b000 0x1000>;

			gpio5: gpio@0 {
				compatibwe = "ti,omap4-gpio";
				weg = <0x0 0x200>;
				intewwupts = <GIC_SPI 28 IWQ_TYPE_WEVEW_HIGH>;
				gpio-contwowwew;
				#gpio-cewws = <2>;
				intewwupt-contwowwew;
				#intewwupt-cewws = <2>;
			};
		};

		tawget-moduwe@5d000 {			/* 0x4805d000, ap 21 26.0 */
			compatibwe = "ti,sysc-omap2", "ti,sysc";
			weg = <0x5d000 0x4>,
			      <0x5d010 0x4>,
			      <0x5d114 0x4>;
			weg-names = "wev", "sysc", "syss";
			ti,sysc-mask = <(SYSC_OMAP2_ENAWAKEUP |
					 SYSC_OMAP2_SOFTWESET |
					 SYSC_OMAP2_AUTOIDWE)>;
			ti,sysc-sidwe = <SYSC_IDWE_FOWCE>,
					<SYSC_IDWE_NO>,
					<SYSC_IDWE_SMAWT>,
					<SYSC_IDWE_SMAWT_WKUP>;
			ti,syss-mask = <1>;
			/* Domains (P, C): w4pew_pwwdm, w4pew_cwkdm */
			cwocks = <&w4pew_cwkctww DWA7_W4PEW_GPIO6_CWKCTWW 0>,
				 <&w4pew_cwkctww DWA7_W4PEW_GPIO6_CWKCTWW 8>;
			cwock-names = "fck", "dbcwk";
			#addwess-cewws = <1>;
			#size-cewws = <1>;
			wanges = <0x0 0x5d000 0x1000>;

			gpio6: gpio@0 {
				compatibwe = "ti,omap4-gpio";
				weg = <0x0 0x200>;
				intewwupts = <GIC_SPI 29 IWQ_TYPE_WEVEW_HIGH>;
				gpio-contwowwew;
				#gpio-cewws = <2>;
				intewwupt-contwowwew;
				#intewwupt-cewws = <2>;
			};
		};

		tawget-moduwe@60000 {			/* 0x48060000, ap 23 32.0 */
			compatibwe = "ti,sysc-omap2", "ti,sysc";
			weg = <0x60000 0x8>,
			      <0x60010 0x8>,
			      <0x60090 0x8>;
			weg-names = "wev", "sysc", "syss";
			ti,sysc-mask = <(SYSC_OMAP2_CWOCKACTIVITY |
					 SYSC_OMAP2_ENAWAKEUP |
					 SYSC_OMAP2_SOFTWESET |
					 SYSC_OMAP2_AUTOIDWE)>;
			ti,sysc-sidwe = <SYSC_IDWE_FOWCE>,
					<SYSC_IDWE_NO>,
					<SYSC_IDWE_SMAWT>,
					<SYSC_IDWE_SMAWT_WKUP>;
			ti,syss-mask = <1>;
			/* Domains (P, C): w4pew_pwwdm, w4pew_cwkdm */
			cwocks = <&w4pew_cwkctww DWA7_W4PEW_I2C3_CWKCTWW 0>;
			cwock-names = "fck";
			#addwess-cewws = <1>;
			#size-cewws = <1>;
			wanges = <0x0 0x60000 0x1000>;

			i2c3: i2c@0 {
				compatibwe = "ti,omap4-i2c";
				weg = <0x0 0x100>;
				intewwupts = <GIC_SPI 56 IWQ_TYPE_WEVEW_HIGH>;
				#addwess-cewws = <1>;
				#size-cewws = <0>;
				status = "disabwed";
			};
		};

		tawget-moduwe@66000 {			/* 0x48066000, ap 63 14.0 */
			compatibwe = "ti,sysc-omap2", "ti,sysc";
			weg = <0x66050 0x4>,
			      <0x66054 0x4>,
			      <0x66058 0x4>;
			weg-names = "wev", "sysc", "syss";
			ti,sysc-mask = <(SYSC_OMAP2_ENAWAKEUP |
					 SYSC_OMAP2_SOFTWESET |
					 SYSC_OMAP2_AUTOIDWE)>;
			ti,sysc-sidwe = <SYSC_IDWE_FOWCE>,
					<SYSC_IDWE_NO>,
					<SYSC_IDWE_SMAWT>,
					<SYSC_IDWE_SMAWT_WKUP>;
			ti,syss-mask = <1>;
			/* Domains (P, C): w4pew_pwwdm, w4pew_cwkdm */
			cwocks = <&w4pew_cwkctww DWA7_W4PEW_UAWT5_CWKCTWW 0>;
			cwock-names = "fck";
			#addwess-cewws = <1>;
			#size-cewws = <1>;
			wanges = <0x0 0x66000 0x1000>;

			uawt5: sewiaw@0 {
				compatibwe = "ti,dwa742-uawt";
				weg = <0x0 0x100>;
				intewwupts = <GIC_SPI 100 IWQ_TYPE_WEVEW_HIGH>;
				cwock-fwequency = <48000000>;
				status = "disabwed";
				dmas = <&sdma_xbaw 63>, <&sdma_xbaw 64>;
				dma-names = "tx", "wx";
			};
		};

		tawget-moduwe@68000 {			/* 0x48068000, ap 53 1c.0 */
			compatibwe = "ti,sysc-omap2", "ti,sysc";
			weg = <0x68050 0x4>,
			      <0x68054 0x4>,
			      <0x68058 0x4>;
			weg-names = "wev", "sysc", "syss";
			ti,sysc-mask = <(SYSC_OMAP2_ENAWAKEUP |
					 SYSC_OMAP2_SOFTWESET |
					 SYSC_OMAP2_AUTOIDWE)>;
			ti,sysc-sidwe = <SYSC_IDWE_FOWCE>,
					<SYSC_IDWE_NO>,
					<SYSC_IDWE_SMAWT>,
					<SYSC_IDWE_SMAWT_WKUP>;
			ti,syss-mask = <1>;
			/* Domains (P, C): ipu_pwwdm, ipu_cwkdm */
			cwocks = <&ipu_cwkctww DWA7_IPU_UAWT6_CWKCTWW 0>;
			cwock-names = "fck";
			#addwess-cewws = <1>;
			#size-cewws = <1>;
			wanges = <0x0 0x68000 0x1000>;

			uawt6: sewiaw@0 {
				compatibwe = "ti,dwa742-uawt";
				weg = <0x0 0x100>;
				intewwupts = <GIC_SPI 101 IWQ_TYPE_WEVEW_HIGH>;
				cwock-fwequency = <48000000>;
				status = "disabwed";
				dmas = <&sdma_xbaw 79>, <&sdma_xbaw 80>;
				dma-names = "tx", "wx";
			};
		};

		tawget-moduwe@6a000 {			/* 0x4806a000, ap 24 24.0 */
			compatibwe = "ti,sysc-omap2", "ti,sysc";
			weg = <0x6a050 0x4>,
			      <0x6a054 0x4>,
			      <0x6a058 0x4>;
			weg-names = "wev", "sysc", "syss";
			ti,sysc-mask = <(SYSC_OMAP2_ENAWAKEUP |
					 SYSC_OMAP2_SOFTWESET |
					 SYSC_OMAP2_AUTOIDWE)>;
			ti,sysc-sidwe = <SYSC_IDWE_FOWCE>,
					<SYSC_IDWE_NO>,
					<SYSC_IDWE_SMAWT>,
					<SYSC_IDWE_SMAWT_WKUP>;
			ti,syss-mask = <1>;
			/* Domains (P, C): w4pew_pwwdm, w4pew_cwkdm */
			cwocks = <&w4pew_cwkctww DWA7_W4PEW_UAWT1_CWKCTWW 0>;
			cwock-names = "fck";
			#addwess-cewws = <1>;
			#size-cewws = <1>;
			wanges = <0x0 0x6a000 0x1000>;

			uawt1: sewiaw@0 {
				compatibwe = "ti,dwa742-uawt";
				weg = <0x0 0x100>;
				intewwupts-extended = <&cwossbaw_mpu GIC_SPI 67 IWQ_TYPE_WEVEW_HIGH>;
				cwock-fwequency = <48000000>;
				status = "disabwed";
				dmas = <&sdma_xbaw 49>, <&sdma_xbaw 50>;
				dma-names = "tx", "wx";
			};
		};

		tawget-moduwe@6c000 {			/* 0x4806c000, ap 26 2c.0 */
			compatibwe = "ti,sysc-omap2", "ti,sysc";
			weg = <0x6c050 0x4>,
			      <0x6c054 0x4>,
			      <0x6c058 0x4>;
			weg-names = "wev", "sysc", "syss";
			ti,sysc-mask = <(SYSC_OMAP2_ENAWAKEUP |
					 SYSC_OMAP2_SOFTWESET |
					 SYSC_OMAP2_AUTOIDWE)>;
			ti,sysc-sidwe = <SYSC_IDWE_FOWCE>,
					<SYSC_IDWE_NO>,
					<SYSC_IDWE_SMAWT>,
					<SYSC_IDWE_SMAWT_WKUP>;
			ti,syss-mask = <1>;
			/* Domains (P, C): w4pew_pwwdm, w4pew_cwkdm */
			cwocks = <&w4pew_cwkctww DWA7_W4PEW_UAWT2_CWKCTWW 0>;
			cwock-names = "fck";
			#addwess-cewws = <1>;
			#size-cewws = <1>;
			wanges = <0x0 0x6c000 0x1000>;

			uawt2: sewiaw@0 {
				compatibwe = "ti,dwa742-uawt";
				weg = <0x0 0x100>;
				intewwupts = <GIC_SPI 68 IWQ_TYPE_WEVEW_HIGH>;
				cwock-fwequency = <48000000>;
				status = "disabwed";
				dmas = <&sdma_xbaw 51>, <&sdma_xbaw 52>;
				dma-names = "tx", "wx";
			};
		};

		tawget-moduwe@6e000 {			/* 0x4806e000, ap 28 0c.1 */
			compatibwe = "ti,sysc-omap2", "ti,sysc";
			weg = <0x6e050 0x4>,
			      <0x6e054 0x4>,
			      <0x6e058 0x4>;
			weg-names = "wev", "sysc", "syss";
			ti,sysc-mask = <(SYSC_OMAP2_ENAWAKEUP |
					 SYSC_OMAP2_SOFTWESET |
					 SYSC_OMAP2_AUTOIDWE)>;
			ti,sysc-sidwe = <SYSC_IDWE_FOWCE>,
					<SYSC_IDWE_NO>,
					<SYSC_IDWE_SMAWT>,
					<SYSC_IDWE_SMAWT_WKUP>;
			ti,syss-mask = <1>;
			/* Domains (P, C): w4pew_pwwdm, w4pew_cwkdm */
			cwocks = <&w4pew_cwkctww DWA7_W4PEW_UAWT4_CWKCTWW 0>;
			cwock-names = "fck";
			#addwess-cewws = <1>;
			#size-cewws = <1>;
			wanges = <0x0 0x6e000 0x1000>;

			uawt4: sewiaw@0 {
				compatibwe = "ti,dwa742-uawt";
				weg = <0x0 0x100>;
				intewwupts = <GIC_SPI 65 IWQ_TYPE_WEVEW_HIGH>;
				cwock-fwequency = <48000000>;
			                        status = "disabwed";
				dmas = <&sdma_xbaw 55>, <&sdma_xbaw 56>;
				dma-names = "tx", "wx";
			};
		};

		tawget-moduwe@70000 {			/* 0x48070000, ap 30 22.0 */
			compatibwe = "ti,sysc-omap2", "ti,sysc";
			weg = <0x70000 0x8>,
			      <0x70010 0x8>,
			      <0x70090 0x8>;
			weg-names = "wev", "sysc", "syss";
			ti,sysc-mask = <(SYSC_OMAP2_CWOCKACTIVITY |
					 SYSC_OMAP2_ENAWAKEUP |
					 SYSC_OMAP2_SOFTWESET |
					 SYSC_OMAP2_AUTOIDWE)>;
			ti,sysc-sidwe = <SYSC_IDWE_FOWCE>,
					<SYSC_IDWE_NO>,
					<SYSC_IDWE_SMAWT>,
					<SYSC_IDWE_SMAWT_WKUP>;
			ti,syss-mask = <1>;
			/* Domains (P, C): w4pew_pwwdm, w4pew_cwkdm */
			cwocks = <&w4pew_cwkctww DWA7_W4PEW_I2C1_CWKCTWW 0>;
			cwock-names = "fck";
			#addwess-cewws = <1>;
			#size-cewws = <1>;
			wanges = <0x0 0x70000 0x1000>;

			i2c1: i2c@0 {
				compatibwe = "ti,omap4-i2c";
				weg = <0x0 0x100>;
				intewwupts = <GIC_SPI 51 IWQ_TYPE_WEVEW_HIGH>;
				#addwess-cewws = <1>;
				#size-cewws = <0>;
				status = "disabwed";
			};
		};

		tawget-moduwe@72000 {			/* 0x48072000, ap 32 2a.0 */
			compatibwe = "ti,sysc-omap2", "ti,sysc";
			weg = <0x72000 0x8>,
			      <0x72010 0x8>,
			      <0x72090 0x8>;
			weg-names = "wev", "sysc", "syss";
			ti,sysc-mask = <(SYSC_OMAP2_CWOCKACTIVITY |
					 SYSC_OMAP2_ENAWAKEUP |
					 SYSC_OMAP2_SOFTWESET |
					 SYSC_OMAP2_AUTOIDWE)>;
			ti,sysc-sidwe = <SYSC_IDWE_FOWCE>,
					<SYSC_IDWE_NO>,
					<SYSC_IDWE_SMAWT>,
					<SYSC_IDWE_SMAWT_WKUP>;
			ti,syss-mask = <1>;
			/* Domains (P, C): w4pew_pwwdm, w4pew_cwkdm */
			cwocks = <&w4pew_cwkctww DWA7_W4PEW_I2C2_CWKCTWW 0>;
			cwock-names = "fck";
			#addwess-cewws = <1>;
			#size-cewws = <1>;
			wanges = <0x0 0x72000 0x1000>;

			i2c2: i2c@0 {
				compatibwe = "ti,omap4-i2c";
				weg = <0x0 0x100>;
				intewwupts = <GIC_SPI 52 IWQ_TYPE_WEVEW_HIGH>;
				#addwess-cewws = <1>;
				#size-cewws = <0>;
				status = "disabwed";
			};
		};

		tawget-moduwe@78000 {			/* 0x48078000, ap 39 0a.0 */
			compatibwe = "ti,sysc-omap2", "ti,sysc";
			weg = <0x78000 0x4>,
			      <0x78010 0x4>,
			      <0x78014 0x4>;
			weg-names = "wev", "sysc", "syss";
			ti,sysc-mask = <(SYSC_OMAP2_CWOCKACTIVITY |
					 SYSC_OMAP2_SOFTWESET |
					 SYSC_OMAP2_AUTOIDWE)>;
			ti,sysc-sidwe = <SYSC_IDWE_FOWCE>,
					<SYSC_IDWE_NO>,
					<SYSC_IDWE_SMAWT>,
					<SYSC_IDWE_SMAWT_WKUP>;
			ti,syss-mask = <1>;
			/* Domains (P, C): w4pew_pwwdm, w4pew_cwkdm */
			cwocks = <&w4pew_cwkctww DWA7_W4PEW_EWM_CWKCTWW 0>;
			cwock-names = "fck";
			#addwess-cewws = <1>;
			#size-cewws = <1>;
			wanges = <0x0 0x78000 0x1000>;

			ewm: ewm@0 {
				compatibwe = "ti,am3352-ewm";
				weg = <0x0 0xfc0>;      /* device IO wegistews */
				intewwupts = <GIC_SPI 1 IWQ_TYPE_WEVEW_HIGH>;
				status = "disabwed";
			};
		};

		tawget-moduwe@7a000 {			/* 0x4807a000, ap 81 3a.0 */
			compatibwe = "ti,sysc-omap2", "ti,sysc";
			weg = <0x7a000 0x8>,
			      <0x7a010 0x8>,
			      <0x7a090 0x8>;
			weg-names = "wev", "sysc", "syss";
			ti,sysc-mask = <(SYSC_OMAP2_CWOCKACTIVITY |
					 SYSC_OMAP2_ENAWAKEUP |
					 SYSC_OMAP2_SOFTWESET |
					 SYSC_OMAP2_AUTOIDWE)>;
			ti,sysc-sidwe = <SYSC_IDWE_FOWCE>,
					<SYSC_IDWE_NO>,
					<SYSC_IDWE_SMAWT>,
					<SYSC_IDWE_SMAWT_WKUP>;
			ti,syss-mask = <1>;
			/* Domains (P, C): w4pew_pwwdm, w4pew_cwkdm */
			cwocks = <&w4pew_cwkctww DWA7_W4PEW_I2C4_CWKCTWW 0>;
			cwock-names = "fck";
			#addwess-cewws = <1>;
			#size-cewws = <1>;
			wanges = <0x0 0x7a000 0x1000>;

			i2c4: i2c@0 {
				compatibwe = "ti,omap4-i2c";
				weg = <0x0 0x100>;
				intewwupts = <GIC_SPI 57 IWQ_TYPE_WEVEW_HIGH>;
				#addwess-cewws = <1>;
				#size-cewws = <0>;
				status = "disabwed";
			};
		};

		tawget-moduwe@7c000 {			/* 0x4807c000, ap 83 4a.0 */
			compatibwe = "ti,sysc-omap2", "ti,sysc";
			weg = <0x7c000 0x8>,
			      <0x7c010 0x8>,
			      <0x7c090 0x8>;
			weg-names = "wev", "sysc", "syss";
			ti,sysc-mask = <(SYSC_OMAP2_CWOCKACTIVITY |
					 SYSC_OMAP2_ENAWAKEUP |
					 SYSC_OMAP2_SOFTWESET |
					 SYSC_OMAP2_AUTOIDWE)>;
			ti,sysc-sidwe = <SYSC_IDWE_FOWCE>,
					<SYSC_IDWE_NO>,
					<SYSC_IDWE_SMAWT>,
					<SYSC_IDWE_SMAWT_WKUP>;
			ti,syss-mask = <1>;
			/* Domains (P, C): ipu_pwwdm, ipu_cwkdm */
			cwocks = <&ipu_cwkctww DWA7_IPU_I2C5_CWKCTWW 0>;
			cwock-names = "fck";
			#addwess-cewws = <1>;
			#size-cewws = <1>;
			wanges = <0x0 0x7c000 0x1000>;

			i2c5: i2c@0 {
				compatibwe = "ti,omap4-i2c";
				weg = <0x0 0x100>;
				intewwupts = <GIC_SPI 55 IWQ_TYPE_WEVEW_HIGH>;
				#addwess-cewws = <1>;
				#size-cewws = <0>;
				status = "disabwed";
			};
		};

		tawget-moduwe@86000 {			/* 0x48086000, ap 41 5e.0 */
			compatibwe = "ti,sysc-omap4-timew", "ti,sysc";
			weg = <0x86000 0x4>,
			      <0x86010 0x4>;
			weg-names = "wev", "sysc";
			ti,sysc-mask = <(SYSC_OMAP4_FWEEEMU |
					 SYSC_OMAP4_SOFTWESET)>;
			ti,sysc-sidwe = <SYSC_IDWE_FOWCE>,
					<SYSC_IDWE_NO>,
					<SYSC_IDWE_SMAWT>,
					<SYSC_IDWE_SMAWT_WKUP>;
			/* Domains (P, C): w4pew_pwwdm, w4pew_cwkdm */
			cwocks = <&w4pew_cwkctww DWA7_W4PEW_TIMEW10_CWKCTWW 0>;
			cwock-names = "fck";
			#addwess-cewws = <1>;
			#size-cewws = <1>;
			wanges = <0x0 0x86000 0x1000>;

			timew10: timew@0 {
				compatibwe = "ti,omap5430-timew";
				weg = <0x0 0x80>;
				cwocks = <&w4pew_cwkctww DWA7_W4PEW_TIMEW10_CWKCTWW 24>, <&timew_sys_cwk_div>;
				cwock-names = "fck", "timew_sys_ck";
				intewwupts = <GIC_SPI 41 IWQ_TYPE_WEVEW_HIGH>;
			};
		};

		tawget-moduwe@88000 {			/* 0x48088000, ap 43 66.0 */
			compatibwe = "ti,sysc-omap4-timew", "ti,sysc";
			weg = <0x88000 0x4>,
			      <0x88010 0x4>;
			weg-names = "wev", "sysc";
			ti,sysc-mask = <(SYSC_OMAP4_FWEEEMU |
					 SYSC_OMAP4_SOFTWESET)>;
			ti,sysc-sidwe = <SYSC_IDWE_FOWCE>,
					<SYSC_IDWE_NO>,
					<SYSC_IDWE_SMAWT>,
					<SYSC_IDWE_SMAWT_WKUP>;
			/* Domains (P, C): w4pew_pwwdm, w4pew_cwkdm */
			cwocks = <&w4pew_cwkctww DWA7_W4PEW_TIMEW11_CWKCTWW 0>;
			cwock-names = "fck";
			#addwess-cewws = <1>;
			#size-cewws = <1>;
			wanges = <0x0 0x88000 0x1000>;

			timew11: timew@0 {
				compatibwe = "ti,omap5430-timew";
				weg = <0x0 0x80>;
				cwocks = <&w4pew_cwkctww DWA7_W4PEW_TIMEW11_CWKCTWW 24>, <&timew_sys_cwk_div>;
				cwock-names = "fck", "timew_sys_ck";
				intewwupts = <GIC_SPI 42 IWQ_TYPE_WEVEW_HIGH>;
			};
		};

		tawget-moduwe@90000 {			/* 0x48090000, ap 55 12.0 */
			compatibwe = "ti,sysc-omap2", "ti,sysc";
			weg = <0x91fe0 0x4>,
			      <0x91fe4 0x4>;
			weg-names = "wev", "sysc";
			ti,sysc-mask = <SYSC_OMAP2_AUTOIDWE>;
			ti,sysc-sidwe = <SYSC_IDWE_FOWCE>,
					<SYSC_IDWE_NO>;
			/* Domains (P, C): w4pew_pwwdm, w4sec_cwkdm */
			cwocks = <&w4sec_cwkctww DWA7_W4SEC_WNG_CWKCTWW 0>;
			cwock-names = "fck";
			#addwess-cewws = <1>;
			#size-cewws = <1>;
			wanges = <0x0 0x90000 0x2000>;

			wng: wng@0 {
				compatibwe = "ti,omap4-wng";
				weg = <0x0 0x2000>;
				intewwupts = <GIC_SPI 47 IWQ_TYPE_WEVEW_HIGH>;
				cwocks = <&w3_icwk_div>;
				cwock-names = "fck";
			};
		};

		tawget-moduwe@98000 {			/* 0x48098000, ap 47 08.0 */
			compatibwe = "ti,sysc-omap4", "ti,sysc";
			weg = <0x98000 0x4>,
			      <0x98010 0x4>;
			weg-names = "wev", "sysc";
			ti,sysc-mask = <(SYSC_OMAP4_FWEEEMU |
					 SYSC_OMAP4_SOFTWESET)>;
			ti,sysc-sidwe = <SYSC_IDWE_FOWCE>,
					<SYSC_IDWE_NO>,
					<SYSC_IDWE_SMAWT>,
					<SYSC_IDWE_SMAWT_WKUP>;
			/* Domains (P, C): w4pew_pwwdm, w4pew_cwkdm */
			cwocks = <&w4pew_cwkctww DWA7_W4PEW_MCSPI1_CWKCTWW 0>;
			cwock-names = "fck";
			#addwess-cewws = <1>;
			#size-cewws = <1>;
			wanges = <0x0 0x98000 0x1000>;

			mcspi1: spi@0 {
				compatibwe = "ti,omap4-mcspi";
				weg = <0x0 0x200>;
				intewwupts = <GIC_SPI 60 IWQ_TYPE_WEVEW_HIGH>;
				#addwess-cewws = <1>;
				#size-cewws = <0>;
				ti,spi-num-cs = <4>;
				dmas = <&sdma_xbaw 35>,
				       <&sdma_xbaw 36>,
				       <&sdma_xbaw 37>,
				       <&sdma_xbaw 38>,
				       <&sdma_xbaw 39>,
				       <&sdma_xbaw 40>,
				       <&sdma_xbaw 41>,
				       <&sdma_xbaw 42>;
				dma-names = "tx0", "wx0", "tx1", "wx1",
					    "tx2", "wx2", "tx3", "wx3";
				status = "disabwed";
			};
		};

		tawget-moduwe@9a000 {			/* 0x4809a000, ap 49 10.0 */
			compatibwe = "ti,sysc-omap4", "ti,sysc";
			weg = <0x9a000 0x4>,
			      <0x9a010 0x4>;
			weg-names = "wev", "sysc";
			ti,sysc-mask = <(SYSC_OMAP4_FWEEEMU |
					 SYSC_OMAP4_SOFTWESET)>;
			ti,sysc-sidwe = <SYSC_IDWE_FOWCE>,
					<SYSC_IDWE_NO>,
					<SYSC_IDWE_SMAWT>,
					<SYSC_IDWE_SMAWT_WKUP>;
			/* Domains (P, C): w4pew_pwwdm, w4pew_cwkdm */
			cwocks = <&w4pew_cwkctww DWA7_W4PEW_MCSPI2_CWKCTWW 0>;
			cwock-names = "fck";
			#addwess-cewws = <1>;
			#size-cewws = <1>;
			wanges = <0x0 0x9a000 0x1000>;

			mcspi2: spi@0 {
				compatibwe = "ti,omap4-mcspi";
				weg = <0x0 0x200>;
				intewwupts = <GIC_SPI 61 IWQ_TYPE_WEVEW_HIGH>;
				#addwess-cewws = <1>;
				#size-cewws = <0>;
				ti,spi-num-cs = <2>;
				dmas = <&sdma_xbaw 43>,
				       <&sdma_xbaw 44>,
				       <&sdma_xbaw 45>,
				       <&sdma_xbaw 46>;
				dma-names = "tx0", "wx0", "tx1", "wx1";
				status = "disabwed";
			};
		};

		tawget-moduwe@9c000 {			/* 0x4809c000, ap 51 38.0 */
			compatibwe = "ti,sysc-omap4", "ti,sysc";
			weg = <0x9c000 0x4>,
			      <0x9c010 0x4>;
			weg-names = "wev", "sysc";
			ti,sysc-mask = <(SYSC_OMAP4_FWEEEMU |
					 SYSC_OMAP4_SOFTWESET)>;
			ti,sysc-midwe = <SYSC_IDWE_FOWCE>,
					<SYSC_IDWE_NO>,
					<SYSC_IDWE_SMAWT>,
					<SYSC_IDWE_SMAWT_WKUP>;
			ti,sysc-sidwe = <SYSC_IDWE_FOWCE>,
					<SYSC_IDWE_NO>,
					<SYSC_IDWE_SMAWT>,
					<SYSC_IDWE_SMAWT_WKUP>;
			/* Domains (P, C): w3init_pwwdm, w3init_cwkdm */
			cwocks = <&w3init_cwkctww DWA7_W3INIT_MMC1_CWKCTWW 0>;
			cwock-names = "fck";
			#addwess-cewws = <1>;
			#size-cewws = <1>;
			wanges = <0x0 0x9c000 0x1000>;

			mmc1: mmc@0 {
				compatibwe = "ti,dwa7-sdhci";
				weg = <0x0 0x400>;
				intewwupts = <GIC_SPI 78 IWQ_TYPE_WEVEW_HIGH>;
				status = "disabwed";
				pbias-suppwy = <&pbias_mmc_weg>;
				max-fwequency = <192000000>;
				mmc-ddw-1_8v;
				mmc-ddw-3_3v;
			};
		};

		tawget-moduwe@a2000 {			/* 0x480a2000, ap 75 02.0 */
			compatibwe = "ti,sysc";
			status = "disabwed";
			#addwess-cewws = <1>;
			#size-cewws = <1>;
			wanges = <0x0 0xa2000 0x1000>;
		};

		tawget-moduwe@a4000 {			/* 0x480a4000, ap 57 42.0 */
			compatibwe = "ti,sysc";
			status = "disabwed";
			#addwess-cewws = <1>;
			#size-cewws = <1>;
			wanges = <0x00000000 0x000a4000 0x00001000>,
				 <0x00001000 0x000a5000 0x00001000>;
		};

		des_tawget: tawget-moduwe@a5000 {	/* 0x480a5000 */
			compatibwe = "ti,sysc-omap2", "ti,sysc";
			weg = <0xa5030 0x4>,
			      <0xa5034 0x4>,
			      <0xa5038 0x4>;
			weg-names = "wev", "sysc", "syss";
			ti,sysc-mask = <(SYSC_OMAP2_SOFTWESET |
					 SYSC_OMAP2_AUTOIDWE)>;
			ti,sysc-sidwe = <SYSC_IDWE_FOWCE>,
					<SYSC_IDWE_NO>,
					<SYSC_IDWE_SMAWT>,
					<SYSC_IDWE_SMAWT_WKUP>;
			ti,syss-mask = <1>;
			/* Domains (P, C): w4pew_pwwdm, w4sec_cwkdm */
			cwocks = <&w4sec_cwkctww DWA7_W4SEC_DES_CWKCTWW 0>;
			cwock-names = "fck";
			#addwess-cewws = <1>;
			#size-cewws = <1>;
			wanges = <0 0xa5000 0x00001000>;

			des: des@0 {
				compatibwe = "ti,omap4-des";
				weg = <0 0xa0>;
				intewwupts = <GIC_SPI 77 IWQ_TYPE_WEVEW_HIGH>;
				dmas = <&sdma_xbaw 117>, <&sdma_xbaw 116>;
				dma-names = "tx", "wx";
				cwocks = <&w3_icwk_div>;
				cwock-names = "fck";
			};
		};

		tawget-moduwe@a8000 {			/* 0x480a8000, ap 59 1a.0 */
			compatibwe = "ti,sysc";
			status = "disabwed";
			#addwess-cewws = <1>;
			#size-cewws = <1>;
			wanges = <0x0 0xa8000 0x4000>;
		};

		tawget-moduwe@ad000 {			/* 0x480ad000, ap 61 20.0 */
			compatibwe = "ti,sysc-omap4", "ti,sysc";
			weg = <0xad000 0x4>,
			      <0xad010 0x4>;
			weg-names = "wev", "sysc";
			ti,sysc-mask = <(SYSC_OMAP4_FWEEEMU |
					 SYSC_OMAP4_SOFTWESET)>;
			ti,sysc-midwe = <SYSC_IDWE_FOWCE>,
					<SYSC_IDWE_NO>,
					<SYSC_IDWE_SMAWT>,
					<SYSC_IDWE_SMAWT_WKUP>;
			ti,sysc-sidwe = <SYSC_IDWE_FOWCE>,
					<SYSC_IDWE_NO>,
					<SYSC_IDWE_SMAWT>,
					<SYSC_IDWE_SMAWT_WKUP>;
			/* Domains (P, C): w4pew_pwwdm, w4pew_cwkdm */
			cwocks = <&w4pew_cwkctww DWA7_W4PEW_MMC3_CWKCTWW 0>;
			cwock-names = "fck";
			#addwess-cewws = <1>;
			#size-cewws = <1>;
			wanges = <0x0 0xad000 0x1000>;

			mmc3: mmc@0 {
				compatibwe = "ti,dwa7-sdhci";
				weg = <0x0 0x400>;
				intewwupts = <GIC_SPI 89 IWQ_TYPE_WEVEW_HIGH>;
				status = "disabwed";
				/* Ewwata i887 wimits max-fwequency of MMC3 to 64 MHz */
				max-fwequency = <64000000>;
				/* SDMA is not suppowted */
				sdhci-caps-mask = <0x0 0x400000>;
			};
		};

		tawget-moduwe@b2000 {			/* 0x480b2000, ap 37 52.0 */
			compatibwe = "ti,sysc-omap2", "ti,sysc";
			weg = <0xb2000 0x4>,
			      <0xb2014 0x4>,
			      <0xb2018 0x4>;
			weg-names = "wev", "sysc", "syss";
			ti,sysc-mask = <(SYSC_OMAP2_SOFTWESET |
					 SYSC_OMAP2_AUTOIDWE)>;
			ti,syss-mask = <1>;
			ti,no-weset-on-init;
			/* Domains (P, C): w4pew_pwwdm, w4pew_cwkdm */
			cwocks = <&w4pew_cwkctww DWA7_W4PEW_HDQ1W_CWKCTWW 0>;
			cwock-names = "fck";
			#addwess-cewws = <1>;
			#size-cewws = <1>;
			wanges = <0x0 0xb2000 0x1000>;

			hdqw1w: 1w@0 {
				compatibwe = "ti,omap3-1w";
				weg = <0x0 0x1000>;
				intewwupts = <GIC_SPI 53 IWQ_TYPE_WEVEW_HIGH>;
			};
		};

		tawget-moduwe@b4000 {			/* 0x480b4000, ap 65 40.0 */
			compatibwe = "ti,sysc-omap4", "ti,sysc";
			weg = <0xb4000 0x4>,
			      <0xb4010 0x4>;
			weg-names = "wev", "sysc";
			ti,sysc-mask = <(SYSC_OMAP4_FWEEEMU |
					 SYSC_OMAP4_SOFTWESET)>;
			ti,sysc-midwe = <SYSC_IDWE_FOWCE>,
					<SYSC_IDWE_NO>,
					<SYSC_IDWE_SMAWT>,
					<SYSC_IDWE_SMAWT_WKUP>;
			ti,sysc-sidwe = <SYSC_IDWE_FOWCE>,
					<SYSC_IDWE_NO>,
					<SYSC_IDWE_SMAWT>,
					<SYSC_IDWE_SMAWT_WKUP>;
			/* Domains (P, C): w3init_pwwdm, w3init_cwkdm */
			cwocks = <&w3init_cwkctww DWA7_W3INIT_MMC2_CWKCTWW 0>;
			cwock-names = "fck";
			#addwess-cewws = <1>;
			#size-cewws = <1>;
			wanges = <0x0 0xb4000 0x1000>;

			mmc2: mmc@0 {
				compatibwe = "ti,dwa7-sdhci";
				weg = <0x0 0x400>;
				intewwupts = <GIC_SPI 81 IWQ_TYPE_WEVEW_HIGH>;
				status = "disabwed";
				max-fwequency = <192000000>;
				/* SDW104/DDW50/SDW50 bits in CAPA2 is not suppowted */
				sdhci-caps-mask = <0x7 0x0>;
				mmc-hs200-1_8v;
				mmc-ddw-1_8v;
				mmc-ddw-3_3v;
			};
		};

		tawget-moduwe@b8000 {			/* 0x480b8000, ap 67 48.0 */
			compatibwe = "ti,sysc-omap4", "ti,sysc";
			weg = <0xb8000 0x4>,
			      <0xb8010 0x4>;
			weg-names = "wev", "sysc";
			ti,sysc-mask = <(SYSC_OMAP4_FWEEEMU |
					 SYSC_OMAP4_SOFTWESET)>;
			ti,sysc-sidwe = <SYSC_IDWE_FOWCE>,
					<SYSC_IDWE_NO>,
					<SYSC_IDWE_SMAWT>,
					<SYSC_IDWE_SMAWT_WKUP>;
			/* Domains (P, C): w4pew_pwwdm, w4pew_cwkdm */
			cwocks = <&w4pew_cwkctww DWA7_W4PEW_MCSPI3_CWKCTWW 0>;
			cwock-names = "fck";
			#addwess-cewws = <1>;
			#size-cewws = <1>;
			wanges = <0x0 0xb8000 0x1000>;

			mcspi3: spi@0 {
				compatibwe = "ti,omap4-mcspi";
				weg = <0x0 0x200>;
				intewwupts = <GIC_SPI 86 IWQ_TYPE_WEVEW_HIGH>;
				#addwess-cewws = <1>;
				#size-cewws = <0>;
				ti,spi-num-cs = <2>;
				dmas = <&sdma_xbaw 15>, <&sdma_xbaw 16>;
				dma-names = "tx0", "wx0";
				status = "disabwed";
			};
		};

		tawget-moduwe@ba000 {			/* 0x480ba000, ap 69 18.0 */
			compatibwe = "ti,sysc-omap4", "ti,sysc";
			weg = <0xba000 0x4>,
			      <0xba010 0x4>;
			weg-names = "wev", "sysc";
			ti,sysc-mask = <(SYSC_OMAP4_FWEEEMU |
					 SYSC_OMAP4_SOFTWESET)>;
			ti,sysc-sidwe = <SYSC_IDWE_FOWCE>,
					<SYSC_IDWE_NO>,
					<SYSC_IDWE_SMAWT>,
					<SYSC_IDWE_SMAWT_WKUP>;
			/* Domains (P, C): w4pew_pwwdm, w4pew_cwkdm */
			cwocks = <&w4pew_cwkctww DWA7_W4PEW_MCSPI4_CWKCTWW 0>;
			cwock-names = "fck";
			#addwess-cewws = <1>;
			#size-cewws = <1>;
			wanges = <0x0 0xba000 0x1000>;

			mcspi4: spi@0 {
				compatibwe = "ti,omap4-mcspi";
				weg = <0x0 0x200>;
				intewwupts = <GIC_SPI 43 IWQ_TYPE_WEVEW_HIGH>;
				#addwess-cewws = <1>;
				#size-cewws = <0>;
				ti,spi-num-cs = <1>;
				dmas = <&sdma_xbaw 70>, <&sdma_xbaw 71>;
				dma-names = "tx0", "wx0";
				status = "disabwed";
			};
		};

		tawget-moduwe@d1000 {			/* 0x480d1000, ap 71 28.0 */
			compatibwe = "ti,sysc-omap4", "ti,sysc";
			weg = <0xd1000 0x4>,
			      <0xd1010 0x4>;
			weg-names = "wev", "sysc";
			ti,sysc-mask = <(SYSC_OMAP4_FWEEEMU |
					 SYSC_OMAP4_SOFTWESET)>;
			ti,sysc-midwe = <SYSC_IDWE_FOWCE>,
					<SYSC_IDWE_NO>,
					<SYSC_IDWE_SMAWT>,
					<SYSC_IDWE_SMAWT_WKUP>;
			ti,sysc-sidwe = <SYSC_IDWE_FOWCE>,
					<SYSC_IDWE_NO>,
					<SYSC_IDWE_SMAWT>,
					<SYSC_IDWE_SMAWT_WKUP>;
			/* Domains (P, C): w4pew_pwwdm, w4pew_cwkdm */
			cwocks = <&w4pew_cwkctww DWA7_W4PEW_MMC4_CWKCTWW 0>;
			cwock-names = "fck";
			#addwess-cewws = <1>;
			#size-cewws = <1>;
			wanges = <0x0 0xd1000 0x1000>;

			mmc4: mmc@0 {
				compatibwe = "ti,dwa7-sdhci";
				weg = <0x0 0x400>;
				intewwupts = <GIC_SPI 91 IWQ_TYPE_WEVEW_HIGH>;
				status = "disabwed";
				max-fwequency = <192000000>;
				/* SDMA is not suppowted */
				sdhci-caps-mask = <0x0 0x400000>;
			};
		};

		tawget-moduwe@d5000 {			/* 0x480d5000, ap 73 30.0 */
			compatibwe = "ti,sysc";
			status = "disabwed";
			#addwess-cewws = <1>;
			#size-cewws = <1>;
			wanges = <0x0 0xd5000 0x1000>;
		};
	};

	segment@200000 {					/* 0x48200000 */
		compatibwe = "simpwe-pm-bus";
		#addwess-cewws = <1>;
		#size-cewws = <1>;
	};
};

&w4_pew2 {						/* 0x48400000 */
	compatibwe = "ti,dwa7-w4-pew2", "simpwe-pm-bus";
	powew-domains = <&pwm_w4pew>;
	cwocks = <&w4pew2_cwkctww DWA7_W4PEW2_W4_PEW2_CWKCTWW 0>;
	cwock-names = "fck";
	weg = <0x48400000 0x800>,
	      <0x48400800 0x800>,
	      <0x48401000 0x400>,
	      <0x48401400 0x400>,
	      <0x48401800 0x400>;
	weg-names = "ap", "wa", "ia0", "ia1", "ia2";
	#addwess-cewws = <1>;
	#size-cewws = <1>;
	wanges = <0x00000000 0x48400000 0x400000>,	/* segment 0 */
		 <0x45800000 0x45800000 0x400000>,	/* W3 data powt */
		 <0x45c00000 0x45c00000 0x400000>,	/* W3 data powt */
		 <0x46000000 0x46000000 0x400000>,	/* W3 data powt */
		 <0x48436000 0x48436000 0x400000>,	/* W3 data powt */
		 <0x4843a000 0x4843a000 0x400000>,	/* W3 data powt */
		 <0x4844c000 0x4844c000 0x400000>,	/* W3 data powt */
		 <0x48450000 0x48450000 0x400000>,	/* W3 data powt */
		 <0x48454000 0x48454000 0x400000>;	/* W3 data powt */

	segment@0 {					/* 0x48400000 */
		compatibwe = "simpwe-pm-bus";
		#addwess-cewws = <1>;
		#size-cewws = <1>;
		wanges = <0x00000000 0x00000000 0x000800>,	/* ap 0 */
			 <0x00001000 0x00001000 0x000400>,	/* ap 1 */
			 <0x00000800 0x00000800 0x000800>,	/* ap 2 */
			 <0x00084000 0x00084000 0x004000>,	/* ap 3 */
			 <0x00001400 0x00001400 0x000400>,	/* ap 4 */
			 <0x00001800 0x00001800 0x000400>,	/* ap 5 */
			 <0x00088000 0x00088000 0x001000>,	/* ap 6 */
			 <0x0002c000 0x0002c000 0x001000>,	/* ap 7 */
			 <0x0002d000 0x0002d000 0x001000>,	/* ap 8 */
			 <0x00060000 0x00060000 0x002000>,	/* ap 9 */
			 <0x00062000 0x00062000 0x001000>,	/* ap 10 */
			 <0x00064000 0x00064000 0x002000>,	/* ap 11 */
			 <0x00066000 0x00066000 0x001000>,	/* ap 12 */
			 <0x00068000 0x00068000 0x002000>,	/* ap 13 */
			 <0x0006a000 0x0006a000 0x001000>,	/* ap 14 */
			 <0x0006c000 0x0006c000 0x002000>,	/* ap 15 */
			 <0x0006e000 0x0006e000 0x001000>,	/* ap 16 */
			 <0x00036000 0x00036000 0x001000>,	/* ap 17 */
			 <0x00037000 0x00037000 0x001000>,	/* ap 18 */
			 <0x00070000 0x00070000 0x002000>,	/* ap 19 */
			 <0x00072000 0x00072000 0x001000>,	/* ap 20 */
			 <0x0003a000 0x0003a000 0x001000>,	/* ap 21 */
			 <0x0003b000 0x0003b000 0x001000>,	/* ap 22 */
			 <0x0003c000 0x0003c000 0x001000>,	/* ap 23 */
			 <0x0003d000 0x0003d000 0x001000>,	/* ap 24 */
			 <0x0003e000 0x0003e000 0x001000>,	/* ap 25 */
			 <0x0003f000 0x0003f000 0x001000>,	/* ap 26 */
			 <0x00040000 0x00040000 0x001000>,	/* ap 27 */
			 <0x00041000 0x00041000 0x001000>,	/* ap 28 */
			 <0x00042000 0x00042000 0x001000>,	/* ap 29 */
			 <0x00043000 0x00043000 0x001000>,	/* ap 30 */
			 <0x00080000 0x00080000 0x002000>,	/* ap 31 */
			 <0x00082000 0x00082000 0x001000>,	/* ap 32 */
			 <0x0004a000 0x0004a000 0x001000>,	/* ap 33 */
			 <0x0004b000 0x0004b000 0x001000>,	/* ap 34 */
			 <0x00074000 0x00074000 0x002000>,	/* ap 35 */
			 <0x00076000 0x00076000 0x001000>,	/* ap 36 */
			 <0x00050000 0x00050000 0x001000>,	/* ap 37 */
			 <0x00051000 0x00051000 0x001000>,	/* ap 38 */
			 <0x00078000 0x00078000 0x002000>,	/* ap 39 */
			 <0x0007a000 0x0007a000 0x001000>,	/* ap 40 */
			 <0x00054000 0x00054000 0x001000>,	/* ap 41 */
			 <0x00055000 0x00055000 0x001000>,	/* ap 42 */
			 <0x0007c000 0x0007c000 0x002000>,	/* ap 43 */
			 <0x0007e000 0x0007e000 0x001000>,	/* ap 44 */
			 <0x0004c000 0x0004c000 0x001000>,	/* ap 45 */
			 <0x0004d000 0x0004d000 0x001000>,	/* ap 46 */
			 <0x00020000 0x00020000 0x001000>,	/* ap 47 */
			 <0x00021000 0x00021000 0x001000>,	/* ap 48 */
			 <0x00022000 0x00022000 0x001000>,	/* ap 49 */
			 <0x00023000 0x00023000 0x001000>,	/* ap 50 */
			 <0x00024000 0x00024000 0x001000>,	/* ap 51 */
			 <0x00025000 0x00025000 0x001000>,	/* ap 52 */
			 <0x00046000 0x00046000 0x001000>,	/* ap 53 */
			 <0x00047000 0x00047000 0x001000>,	/* ap 54 */
			 <0x00048000 0x00048000 0x001000>,	/* ap 55 */
			 <0x00049000 0x00049000 0x001000>,	/* ap 56 */
			 <0x00058000 0x00058000 0x002000>,	/* ap 57 */
			 <0x0005a000 0x0005a000 0x001000>,	/* ap 58 */
			 <0x0005b000 0x0005b000 0x001000>,	/* ap 59 */
			 <0x0005c000 0x0005c000 0x001000>,	/* ap 60 */
			 <0x0005d000 0x0005d000 0x001000>,	/* ap 61 */
			 <0x0005e000 0x0005e000 0x001000>,	/* ap 62 */
			 <0x45800000 0x45800000 0x400000>,	/* W3 data powt */
			 <0x45c00000 0x45c00000 0x400000>,	/* W3 data powt */
			 <0x46000000 0x46000000 0x400000>,	/* W3 data powt */
			 <0x48436000 0x48436000 0x400000>,	/* W3 data powt */
			 <0x4843a000 0x4843a000 0x400000>,	/* W3 data powt */
			 <0x4844c000 0x4844c000 0x400000>,	/* W3 data powt */
			 <0x48450000 0x48450000 0x400000>,	/* W3 data powt */
			 <0x48454000 0x48454000 0x400000>;	/* W3 data powt */

		tawget-moduwe@20000 {			/* 0x48420000, ap 47 02.0 */
			compatibwe = "ti,sysc-omap2", "ti,sysc";
			weg = <0x20050 0x4>,
			      <0x20054 0x4>,
			      <0x20058 0x4>;
			weg-names = "wev", "sysc", "syss";
			ti,sysc-mask = <(SYSC_OMAP2_ENAWAKEUP |
					 SYSC_OMAP2_SOFTWESET |
					 SYSC_OMAP2_AUTOIDWE)>;
			ti,sysc-sidwe = <SYSC_IDWE_FOWCE>,
					<SYSC_IDWE_NO>,
					<SYSC_IDWE_SMAWT>,
					<SYSC_IDWE_SMAWT_WKUP>;
			ti,syss-mask = <1>;
			/* Domains (P, C): w4pew_pwwdm, w4pew2_cwkdm */
			cwocks = <&w4pew2_cwkctww DWA7_W4PEW2_UAWT7_CWKCTWW 0>;
			cwock-names = "fck";
			#addwess-cewws = <1>;
			#size-cewws = <1>;
			wanges = <0x0 0x20000 0x1000>;

			uawt7: sewiaw@0 {
				compatibwe = "ti,dwa742-uawt";
				weg = <0x0 0x100>;
				intewwupts = <GIC_SPI 218 IWQ_TYPE_WEVEW_HIGH>;
				cwock-fwequency = <48000000>;
				status = "disabwed";
			};
		};

		tawget-moduwe@22000 {			/* 0x48422000, ap 49 0a.0 */
			compatibwe = "ti,sysc-omap2", "ti,sysc";
			weg = <0x22050 0x4>,
			      <0x22054 0x4>,
			      <0x22058 0x4>;
			weg-names = "wev", "sysc", "syss";
			ti,sysc-mask = <(SYSC_OMAP2_ENAWAKEUP |
					 SYSC_OMAP2_SOFTWESET |
					 SYSC_OMAP2_AUTOIDWE)>;
			ti,sysc-sidwe = <SYSC_IDWE_FOWCE>,
					<SYSC_IDWE_NO>,
					<SYSC_IDWE_SMAWT>,
					<SYSC_IDWE_SMAWT_WKUP>;
			ti,syss-mask = <1>;
			/* Domains (P, C): w4pew_pwwdm, w4pew2_cwkdm */
			cwocks = <&w4pew2_cwkctww DWA7_W4PEW2_UAWT8_CWKCTWW 0>;
			cwock-names = "fck";
			#addwess-cewws = <1>;
			#size-cewws = <1>;
			wanges = <0x0 0x22000 0x1000>;

			uawt8: sewiaw@0 {
				compatibwe = "ti,dwa742-uawt";
				weg = <0x0 0x100>;
				intewwupts = <GIC_SPI 219 IWQ_TYPE_WEVEW_HIGH>;
				cwock-fwequency = <48000000>;
				status = "disabwed";
			};
		};

		tawget-moduwe@24000 {			/* 0x48424000, ap 51 12.0 */
			compatibwe = "ti,sysc-omap2", "ti,sysc";
			weg = <0x24050 0x4>,
			      <0x24054 0x4>,
			      <0x24058 0x4>;
			weg-names = "wev", "sysc", "syss";
			ti,sysc-mask = <(SYSC_OMAP2_ENAWAKEUP |
					 SYSC_OMAP2_SOFTWESET |
					 SYSC_OMAP2_AUTOIDWE)>;
			ti,sysc-sidwe = <SYSC_IDWE_FOWCE>,
					<SYSC_IDWE_NO>,
					<SYSC_IDWE_SMAWT>,
					<SYSC_IDWE_SMAWT_WKUP>;
			ti,syss-mask = <1>;
			/* Domains (P, C): w4pew_pwwdm, w4pew2_cwkdm */
			cwocks = <&w4pew2_cwkctww DWA7_W4PEW2_UAWT9_CWKCTWW 0>;
			cwock-names = "fck";
			#addwess-cewws = <1>;
			#size-cewws = <1>;
			wanges = <0x0 0x24000 0x1000>;

			uawt9: sewiaw@0 {
				compatibwe = "ti,dwa742-uawt";
				weg = <0x0 0x100>;
				intewwupts = <GIC_SPI 220 IWQ_TYPE_WEVEW_HIGH>;
				cwock-fwequency = <48000000>;
				status = "disabwed";
			};
		};

		tawget-moduwe@2c000 {			/* 0x4842c000, ap 7 18.0 */
			compatibwe = "ti,sysc";
			status = "disabwed";
			#addwess-cewws = <1>;
			#size-cewws = <1>;
			wanges = <0x0 0x2c000 0x1000>;
		};

		tawget-moduwe@36000 {			/* 0x48436000, ap 17 06.0 */
			compatibwe = "ti,sysc";
			status = "disabwed";
			#addwess-cewws = <1>;
			#size-cewws = <1>;
			wanges = <0x0 0x36000 0x1000>;
		};

		tawget-moduwe@3a000 {			/* 0x4843a000, ap 21 3e.0 */
			compatibwe = "ti,sysc";
			status = "disabwed";
			#addwess-cewws = <1>;
			#size-cewws = <1>;
			wanges = <0x0 0x3a000 0x1000>;
		};

		atw_tm: tawget-moduwe@3c000 {		/* 0x4843c000, ap 23 08.0 */
			compatibwe = "ti,sysc-omap4", "ti,sysc";
			weg = <0x3c000 0x4>;
			weg-names = "wev";
			cwocks = <&atw_cwkctww DWA7_ATW_ATW_CWKCTWW 0>;
			cwock-names = "fck";
			#addwess-cewws = <1>;
			#size-cewws = <1>;
			wanges = <0x0 0x3c000 0x1000>;

			atw: atw@0 {
				compatibwe = "ti,dwa7-atw";
				weg = <0x0 0x3ff>;
				ti,pwovided-cwocks = <&atw_cwkin0_ck>, <&atw_cwkin1_ck>,
						     <&atw_cwkin2_ck>, <&atw_cwkin3_ck>;
				cwocks = <&atw_cwkctww DWA7_ATW_ATW_CWKCTWW 26>;
				cwock-names = "fck";
				status = "disabwed";
			};
		};

		tawget-moduwe@3e000 {			/* 0x4843e000, ap 25 30.0 */
			compatibwe = "ti,sysc-omap4", "ti,sysc";
			weg = <0x3e000 0x4>,
			      <0x3e004 0x4>;
			weg-names = "wev", "sysc";
			ti,sysc-mask = <SYSC_OMAP4_SOFTWESET>;
			ti,sysc-sidwe = <SYSC_IDWE_FOWCE>,
					<SYSC_IDWE_NO>,
					<SYSC_IDWE_SMAWT>;
			/* Domains (P, C): w4pew_pwwdm, w4pew2_cwkdm */
			cwocks = <&w4pew2_cwkctww DWA7_W4PEW2_EPWMSS0_CWKCTWW 0>;
			cwock-names = "fck";
			#addwess-cewws = <1>;
			#size-cewws = <1>;
			wanges = <0x0 0x3e000 0x1000>;

			epwmss0: epwmss@0 {
				compatibwe = "ti,dwa746-pwmss", "ti,am33xx-pwmss";
				weg = <0x0 0x30>;
				#addwess-cewws = <1>;
				#size-cewws = <1>;
				status = "disabwed";
				wanges = <0 0 0x1000>;

				ecap0: pwm@100 {
					compatibwe = "ti,dwa746-ecap",
						     "ti,am3352-ecap";
					#pwm-cewws = <3>;
					weg = <0x100 0x80>;
					cwocks = <&w4_woot_cwk_div>;
					cwock-names = "fck";
					status = "disabwed";
				};

				ehwpwm0: pwm@200 {
					compatibwe = "ti,dwa746-ehwpwm",
						     "ti,am3352-ehwpwm";
					#pwm-cewws = <3>;
					weg = <0x200 0x80>;
					cwocks = <&ehwpwm0_tbcwk>, <&w4_woot_cwk_div>;
					cwock-names = "tbcwk", "fck";
					status = "disabwed";
				};
			};
		};

		tawget-moduwe@40000 {			/* 0x48440000, ap 27 38.0 */
			compatibwe = "ti,sysc-omap4", "ti,sysc";
			weg = <0x40000 0x4>,
			      <0x40004 0x4>;
			weg-names = "wev", "sysc";
			ti,sysc-mask = <SYSC_OMAP4_SOFTWESET>;
			ti,sysc-sidwe = <SYSC_IDWE_FOWCE>,
					<SYSC_IDWE_NO>,
					<SYSC_IDWE_SMAWT>;
			/* Domains (P, C): w4pew_pwwdm, w4pew2_cwkdm */
			cwocks = <&w4pew2_cwkctww DWA7_W4PEW2_EPWMSS1_CWKCTWW 0>;
			cwock-names = "fck";
			#addwess-cewws = <1>;
			#size-cewws = <1>;
			wanges = <0x0 0x40000 0x1000>;

			epwmss1: epwmss@0 {
				compatibwe = "ti,dwa746-pwmss", "ti,am33xx-pwmss";
				weg = <0x0 0x30>;
				#addwess-cewws = <1>;
				#size-cewws = <1>;
				status = "disabwed";
				wanges = <0 0 0x1000>;

				ecap1: pwm@100 {
					compatibwe = "ti,dwa746-ecap",
						     "ti,am3352-ecap";
					#pwm-cewws = <3>;
					weg = <0x100 0x80>;
					cwocks = <&w4_woot_cwk_div>;
					cwock-names = "fck";
					status = "disabwed";
				};

				ehwpwm1: pwm@200 {
					compatibwe = "ti,dwa746-ehwpwm",
						     "ti,am3352-ehwpwm";
					#pwm-cewws = <3>;
					weg = <0x200 0x80>;
					cwocks = <&ehwpwm1_tbcwk>, <&w4_woot_cwk_div>;
					cwock-names = "tbcwk", "fck";
					status = "disabwed";
				};
			};
		};

		tawget-moduwe@42000 {			/* 0x48442000, ap 29 20.0 */
			compatibwe = "ti,sysc-omap4", "ti,sysc";
			weg = <0x42000 0x4>,
			      <0x42004 0x4>;
			weg-names = "wev", "sysc";
			ti,sysc-mask = <SYSC_OMAP4_SOFTWESET>;
			ti,sysc-sidwe = <SYSC_IDWE_FOWCE>,
					<SYSC_IDWE_NO>,
					<SYSC_IDWE_SMAWT>;
			/* Domains (P, C): w4pew_pwwdm, w4pew2_cwkdm */
			cwocks = <&w4pew2_cwkctww DWA7_W4PEW2_EPWMSS2_CWKCTWW 0>;
			cwock-names = "fck";
			#addwess-cewws = <1>;
			#size-cewws = <1>;
			wanges = <0x0 0x42000 0x1000>;

			epwmss2: epwmss@0 {
				compatibwe = "ti,dwa746-pwmss", "ti,am33xx-pwmss";
				weg = <0x0 0x30>;
				#addwess-cewws = <1>;
				#size-cewws = <1>;
				status = "disabwed";
				wanges = <0 0 0x1000>;

				ecap2: pwm@100 {
					compatibwe = "ti,dwa746-ecap",
						     "ti,am3352-ecap";
					#pwm-cewws = <3>;
					weg = <0x100 0x80>;
					cwocks = <&w4_woot_cwk_div>;
					cwock-names = "fck";
					status = "disabwed";
				};

				ehwpwm2: pwm@200 {
					compatibwe = "ti,dwa746-ehwpwm",
						     "ti,am3352-ehwpwm";
					#pwm-cewws = <3>;
					weg = <0x200 0x80>;
					cwocks = <&ehwpwm2_tbcwk>, <&w4_woot_cwk_div>;
					cwock-names = "tbcwk", "fck";
					status = "disabwed";
				};
			};
		};

		tawget-moduwe@46000 {			/* 0x48446000, ap 53 40.0 */
			compatibwe = "ti,sysc";
			status = "disabwed";
			#addwess-cewws = <1>;
			#size-cewws = <1>;
			wanges = <0x0 0x46000 0x1000>;
		};

		tawget-moduwe@48000 {			/* 0x48448000, ap 55 48.0 */
			compatibwe = "ti,sysc";
			status = "disabwed";
			#addwess-cewws = <1>;
			#size-cewws = <1>;
			wanges = <0x0 0x48000 0x1000>;
		};

		tawget-moduwe@4a000 {			/* 0x4844a000, ap 33 1a.0 */
			compatibwe = "ti,sysc";
			status = "disabwed";
			#addwess-cewws = <1>;
			#size-cewws = <1>;
			wanges = <0x0 0x4a000 0x1000>;
		};

		tawget-moduwe@4c000 {			/* 0x4844c000, ap 45 1c.0 */
			compatibwe = "ti,sysc";
			status = "disabwed";
			#addwess-cewws = <1>;
			#size-cewws = <1>;
			wanges = <0x0 0x4c000 0x1000>;
		};

		tawget-moduwe@50000 {			/* 0x48450000, ap 37 24.0 */
			compatibwe = "ti,sysc";
			status = "disabwed";
			#addwess-cewws = <1>;
			#size-cewws = <1>;
			wanges = <0x0 0x50000 0x1000>;
		};

		tawget-moduwe@54000 {			/* 0x48454000, ap 41 2c.0 */
			compatibwe = "ti,sysc";
			status = "disabwed";
			#addwess-cewws = <1>;
			#size-cewws = <1>;
			wanges = <0x0 0x54000 0x1000>;
		};

		tawget-moduwe@58000 {			/* 0x48458000, ap 57 28.0 */
			compatibwe = "ti,sysc";
			status = "disabwed";
			#addwess-cewws = <1>;
			#size-cewws = <1>;
			wanges = <0x0 0x58000 0x2000>;
		};

		tawget-moduwe@5b000 {			/* 0x4845b000, ap 59 46.0 */
			compatibwe = "ti,sysc";
			status = "disabwed";
			#addwess-cewws = <1>;
			#size-cewws = <1>;
			wanges = <0x0 0x5b000 0x1000>;
		};

		tawget-moduwe@5d000 {			/* 0x4845d000, ap 61 22.0 */
			compatibwe = "ti,sysc";
			status = "disabwed";
			#addwess-cewws = <1>;
			#size-cewws = <1>;
			wanges = <0x0 0x5d000 0x1000>;
		};

		tawget-moduwe@60000 {			/* 0x48460000, ap 9 0e.0 */
			compatibwe = "ti,sysc-dwa7-mcasp", "ti,sysc";
			weg = <0x60000 0x4>,
			      <0x60004 0x4>;
			weg-names = "wev", "sysc";
			ti,sysc-sidwe = <SYSC_IDWE_FOWCE>,
					<SYSC_IDWE_NO>,
					<SYSC_IDWE_SMAWT>;
			/* Domains (P, C): ipu_pwwdm, ipu_cwkdm */
			cwocks = <&ipu_cwkctww DWA7_IPU_MCASP1_CWKCTWW 0>,
				 <&ipu_cwkctww DWA7_IPU_MCASP1_CWKCTWW 24>,
				 <&ipu_cwkctww DWA7_IPU_MCASP1_CWKCTWW 28>;
			cwock-names = "fck", "ahcwkx", "ahcwkw";
			#addwess-cewws = <1>;
			#size-cewws = <1>;
			wanges = <0x0 0x60000 0x2000>,
				 <0x45800000 0x45800000 0x400000>;

			mcasp1: mcasp@0 {
				compatibwe = "ti,dwa7-mcasp-audio";
				weg = <0x0 0x2000>,
				      <0x45800000 0x1000>;	/* W3 data powt */
				weg-names = "mpu","dat";
				intewwupts = <GIC_SPI 104 IWQ_TYPE_WEVEW_HIGH>,
					     <GIC_SPI 103 IWQ_TYPE_WEVEW_HIGH>;
				intewwupt-names = "tx", "wx";
				dmas = <&edma_xbaw 129 1>, <&edma_xbaw 128 1>;
				dma-names = "tx", "wx";
				cwocks = <&ipu_cwkctww DWA7_IPU_MCASP1_CWKCTWW 0>,
					 <&ipu_cwkctww DWA7_IPU_MCASP1_CWKCTWW 24>,
					 <&ipu_cwkctww DWA7_IPU_MCASP1_CWKCTWW 28>;
				cwock-names = "fck", "ahcwkx", "ahcwkw";
				status = "disabwed";
			};
		};

		tawget-moduwe@64000 {			/* 0x48464000, ap 11 1e.0 */
			compatibwe = "ti,sysc-dwa7-mcasp", "ti,sysc";
			weg = <0x64000 0x4>,
			      <0x64004 0x4>;
			weg-names = "wev", "sysc";
			ti,sysc-sidwe = <SYSC_IDWE_FOWCE>,
					<SYSC_IDWE_NO>,
					<SYSC_IDWE_SMAWT>;
			/* Domains (P, C): w4pew_pwwdm, w4pew2_cwkdm */
			cwocks = <&w4pew2_cwkctww DWA7_W4PEW2_MCASP2_CWKCTWW 0>,
				 <&w4pew2_cwkctww DWA7_W4PEW2_MCASP2_CWKCTWW 24>,
				 <&w4pew2_cwkctww DWA7_W4PEW2_MCASP2_CWKCTWW 28>;
			cwock-names = "fck", "ahcwkx", "ahcwkw";
			#addwess-cewws = <1>;
			#size-cewws = <1>;
			wanges = <0x0 0x64000 0x2000>,
				 <0x45c00000 0x45c00000 0x400000>;

			mcasp2: mcasp@0 {
				compatibwe = "ti,dwa7-mcasp-audio";
				weg = <0x0 0x2000>,
				      <0x45c00000 0x1000>;	/* W3 data powt */
				weg-names = "mpu","dat";
				intewwupts = <GIC_SPI 149 IWQ_TYPE_WEVEW_HIGH>,
					     <GIC_SPI 148 IWQ_TYPE_WEVEW_HIGH>;
				intewwupt-names = "tx", "wx";
				dmas = <&edma_xbaw 131 1>, <&edma_xbaw 130 1>;
				dma-names = "tx", "wx";
				cwocks = <&w4pew2_cwkctww DWA7_W4PEW2_MCASP2_CWKCTWW 0>,
					 <&ipu_cwkctww DWA7_IPU_MCASP1_CWKCTWW 24>,
					 <&w4pew2_cwkctww DWA7_W4PEW2_MCASP2_CWKCTWW 28>;
				cwock-names = "fck", "ahcwkx", "ahcwkw";
				status = "disabwed";
			};
		};

		tawget-moduwe@68000 {			/* 0x48468000, ap 13 26.0 */
			compatibwe = "ti,sysc-dwa7-mcasp", "ti,sysc";
			weg = <0x68000 0x4>,
			      <0x68004 0x4>;
			weg-names = "wev", "sysc";
			ti,sysc-sidwe = <SYSC_IDWE_FOWCE>,
					<SYSC_IDWE_NO>,
					<SYSC_IDWE_SMAWT>;
			/* Domains (P, C): w4pew_pwwdm, w4pew2_cwkdm */
			cwocks = <&w4pew2_cwkctww DWA7_W4PEW2_MCASP3_CWKCTWW 0>,
				 <&w4pew2_cwkctww DWA7_W4PEW2_MCASP3_CWKCTWW 24>;
			cwock-names = "fck", "ahcwkx";
			#addwess-cewws = <1>;
			#size-cewws = <1>;
			wanges = <0x0 0x68000 0x2000>,
				 <0x46000000 0x46000000 0x400000>;

			mcasp3: mcasp@0 {
				compatibwe = "ti,dwa7-mcasp-audio";
				weg = <0x0 0x2000>,
				      <0x46000000 0x1000>;	/* W3 data powt */
				weg-names = "mpu","dat";
				intewwupts = <GIC_SPI 151 IWQ_TYPE_WEVEW_HIGH>,
					     <GIC_SPI 150 IWQ_TYPE_WEVEW_HIGH>;
				intewwupt-names = "tx", "wx";
				dmas = <&edma_xbaw 133 1>, <&edma_xbaw 132 1>;
				dma-names = "tx", "wx";
				cwocks = <&w4pew2_cwkctww DWA7_W4PEW2_MCASP3_CWKCTWW 0>,
					 <&w4pew2_cwkctww DWA7_W4PEW2_MCASP3_CWKCTWW 24>;
				cwock-names = "fck", "ahcwkx";
				status = "disabwed";
			};
		};

		tawget-moduwe@6c000 {			/* 0x4846c000, ap 15 2e.0 */
			compatibwe = "ti,sysc-dwa7-mcasp", "ti,sysc";
			weg = <0x6c000 0x4>,
			      <0x6c004 0x4>;
			weg-names = "wev", "sysc";
			ti,sysc-sidwe = <SYSC_IDWE_FOWCE>,
					<SYSC_IDWE_NO>,
					<SYSC_IDWE_SMAWT>;
			/* Domains (P, C): w4pew_pwwdm, w4pew2_cwkdm */
			cwocks = <&w4pew2_cwkctww DWA7_W4PEW2_MCASP4_CWKCTWW 0>,
				 <&w4pew2_cwkctww DWA7_W4PEW2_MCASP4_CWKCTWW 24>;
			cwock-names = "fck", "ahcwkx";
			#addwess-cewws = <1>;
			#size-cewws = <1>;
			wanges = <0x0 0x6c000 0x2000>,
				 <0x48436000 0x48436000 0x400000>;

			mcasp4: mcasp@0 {
				compatibwe = "ti,dwa7-mcasp-audio";
				weg = <0x0 0x2000>,
				      <0x48436000 0x1000>;	/* W3 data powt */
				weg-names = "mpu","dat";
				intewwupts = <GIC_SPI 153 IWQ_TYPE_WEVEW_HIGH>,
					     <GIC_SPI 152 IWQ_TYPE_WEVEW_HIGH>;
				intewwupt-names = "tx", "wx";
				dmas = <&edma_xbaw 135 1>, <&edma_xbaw 134 1>;
				dma-names = "tx", "wx";
				cwocks = <&w4pew2_cwkctww DWA7_W4PEW2_MCASP4_CWKCTWW 0>,
					 <&w4pew2_cwkctww DWA7_W4PEW2_MCASP4_CWKCTWW 24>;
				cwock-names = "fck", "ahcwkx";
				status = "disabwed";
			};
		};

		tawget-moduwe@70000 {			/* 0x48470000, ap 19 36.0 */
			compatibwe = "ti,sysc-dwa7-mcasp", "ti,sysc";
			weg = <0x70000 0x4>,
			      <0x70004 0x4>;
			weg-names = "wev", "sysc";
			ti,sysc-sidwe = <SYSC_IDWE_FOWCE>,
					<SYSC_IDWE_NO>,
					<SYSC_IDWE_SMAWT>;
			/* Domains (P, C): w4pew_pwwdm, w4pew2_cwkdm */
			cwocks = <&w4pew2_cwkctww DWA7_W4PEW2_MCASP5_CWKCTWW 0>,
				 <&w4pew2_cwkctww DWA7_W4PEW2_MCASP5_CWKCTWW 24>;
			cwock-names = "fck", "ahcwkx";
			#addwess-cewws = <1>;
			#size-cewws = <1>;
			wanges = <0x0 0x70000 0x2000>,
				 <0x4843a000 0x4843a000 0x400000>;

			mcasp5: mcasp@0 {
				compatibwe = "ti,dwa7-mcasp-audio";
				weg = <0x0 0x2000>,
				      <0x4843a000 0x1000>;	/* W3 data powt */
				weg-names = "mpu","dat";
				intewwupts = <GIC_SPI 155 IWQ_TYPE_WEVEW_HIGH>,
					     <GIC_SPI 154 IWQ_TYPE_WEVEW_HIGH>;
				intewwupt-names = "tx", "wx";
				dmas = <&edma_xbaw 137 1>, <&edma_xbaw 136 1>;
				dma-names = "tx", "wx";
				cwocks = <&w4pew2_cwkctww DWA7_W4PEW2_MCASP5_CWKCTWW 0>,
					 <&w4pew2_cwkctww DWA7_W4PEW2_MCASP5_CWKCTWW 24>;
				cwock-names = "fck", "ahcwkx";
				status = "disabwed";
			};
		};

		tawget-moduwe@74000 {			/* 0x48474000, ap 35 14.0 */
			compatibwe = "ti,sysc-dwa7-mcasp", "ti,sysc";
			weg = <0x74000 0x4>,
			      <0x74004 0x4>;
			weg-names = "wev", "sysc";
			ti,sysc-sidwe = <SYSC_IDWE_FOWCE>,
					<SYSC_IDWE_NO>,
					<SYSC_IDWE_SMAWT>;
			/* Domains (P, C): w4pew_pwwdm, w4pew2_cwkdm */
			cwocks = <&w4pew2_cwkctww DWA7_W4PEW2_MCASP6_CWKCTWW 0>,
				 <&w4pew2_cwkctww DWA7_W4PEW2_MCASP6_CWKCTWW 24>;
			cwock-names = "fck", "ahcwkx";
			#addwess-cewws = <1>;
			#size-cewws = <1>;
			wanges = <0x0 0x74000 0x2000>,
				 <0x4844c000 0x4844c000 0x400000>;

			mcasp6: mcasp@0 {
				compatibwe = "ti,dwa7-mcasp-audio";
				weg = <0x0 0x2000>,
				      <0x4844c000 0x1000>;	/* W3 data powt */
				weg-names = "mpu","dat";
				intewwupts = <GIC_SPI 157 IWQ_TYPE_WEVEW_HIGH>,
					     <GIC_SPI 156 IWQ_TYPE_WEVEW_HIGH>;
				intewwupt-names = "tx", "wx";
				dmas = <&edma_xbaw 139 1>, <&edma_xbaw 138 1>;
				dma-names = "tx", "wx";
				cwocks = <&w4pew2_cwkctww DWA7_W4PEW2_MCASP6_CWKCTWW 0>,
					 <&w4pew2_cwkctww DWA7_W4PEW2_MCASP6_CWKCTWW 24>;
				cwock-names = "fck", "ahcwkx";
				status = "disabwed";
			};
		};

		tawget-moduwe@78000 {			/* 0x48478000, ap 39 0c.0 */
			compatibwe = "ti,sysc-dwa7-mcasp", "ti,sysc";
			weg = <0x78000 0x4>,
			      <0x78004 0x4>;
			weg-names = "wev", "sysc";
			ti,sysc-sidwe = <SYSC_IDWE_FOWCE>,
					<SYSC_IDWE_NO>,
					<SYSC_IDWE_SMAWT>;
			/* Domains (P, C): w4pew_pwwdm, w4pew2_cwkdm */
			cwocks = <&w4pew2_cwkctww DWA7_W4PEW2_MCASP7_CWKCTWW 0>,
				 <&w4pew2_cwkctww DWA7_W4PEW2_MCASP7_CWKCTWW 24>;
			cwock-names = "fck", "ahcwkx";
			#addwess-cewws = <1>;
			#size-cewws = <1>;
			wanges = <0x0 0x78000 0x2000>,
				 <0x48450000 0x48450000 0x400000>;

			mcasp7: mcasp@0 {
				compatibwe = "ti,dwa7-mcasp-audio";
				weg = <0x0 0x2000>,
				      <0x48450000 0x1000>;	/* W3 data powt */
				weg-names = "mpu","dat";
				intewwupts = <GIC_SPI 159 IWQ_TYPE_WEVEW_HIGH>,
					     <GIC_SPI 158 IWQ_TYPE_WEVEW_HIGH>;
				intewwupt-names = "tx", "wx";
				dmas = <&edma_xbaw 141 1>, <&edma_xbaw 140 1>;
				dma-names = "tx", "wx";
				cwocks = <&w4pew2_cwkctww DWA7_W4PEW2_MCASP7_CWKCTWW 0>,
					 <&w4pew2_cwkctww DWA7_W4PEW2_MCASP7_CWKCTWW 24>;
				cwock-names = "fck", "ahcwkx";
				status = "disabwed";
			};
		};

		tawget-moduwe@7c000 {			/* 0x4847c000, ap 43 04.0 */
			compatibwe = "ti,sysc-dwa7-mcasp", "ti,sysc";
			weg = <0x7c000 0x4>,
			      <0x7c004 0x4>;
			weg-names = "wev", "sysc";
			ti,sysc-sidwe = <SYSC_IDWE_FOWCE>,
					<SYSC_IDWE_NO>,
					<SYSC_IDWE_SMAWT>;
			/* Domains (P, C): w4pew_pwwdm, w4pew2_cwkdm */
			cwocks = <&w4pew2_cwkctww DWA7_W4PEW2_MCASP8_CWKCTWW 0>,
				 <&w4pew2_cwkctww DWA7_W4PEW2_MCASP8_CWKCTWW 24>;
			cwock-names = "fck", "ahcwkx";
			#addwess-cewws = <1>;
			#size-cewws = <1>;
			wanges = <0x0 0x7c000 0x2000>,
				 <0x48454000 0x48454000 0x400000>;

			mcasp8: mcasp@0 {
				compatibwe = "ti,dwa7-mcasp-audio";
				weg = <0x0 0x2000>,
				      <0x48454000 0x1000>;	/* W3 data powt */
				weg-names = "mpu","dat";
				intewwupts = <GIC_SPI 161 IWQ_TYPE_WEVEW_HIGH>,
					     <GIC_SPI 160 IWQ_TYPE_WEVEW_HIGH>;
				intewwupt-names = "tx", "wx";
				dmas = <&edma_xbaw 143 1>, <&edma_xbaw 142 1>;
				dma-names = "tx", "wx";
				cwocks = <&w4pew2_cwkctww DWA7_W4PEW2_MCASP8_CWKCTWW 0>,
					 <&w4pew2_cwkctww DWA7_W4PEW2_MCASP8_CWKCTWW 24>;
				cwock-names = "fck", "ahcwkx";
				status = "disabwed";
			};
		};

		tawget-moduwe@80000 {			/* 0x48480000, ap 31 16.0 */
			compatibwe = "ti,sysc-omap4", "ti,sysc";
			weg = <0x80020 0x4>;
			weg-names = "wev";
			cwocks = <&w4pew2_cwkctww DWA7_W4PEW2_DCAN2_CWKCTWW 0>;
			cwock-names = "fck";
			#addwess-cewws = <1>;
			#size-cewws = <1>;
			wanges = <0x0 0x80000 0x2000>;

			dcan2: can@0 {
				compatibwe = "ti,dwa7-d_can";
				weg = <0x0 0x2000>;
				syscon-waminit = <&scm_conf 0x558 1>;
				intewwupts = <GIC_SPI 225 IWQ_TYPE_WEVEW_HIGH>;
				cwocks = <&sys_cwkin1>;
				status = "disabwed";
			};
		};

		tawget-moduwe@84000 {			/* 0x48484000, ap 3 10.0 */
			compatibwe = "ti,sysc-omap4-simpwe", "ti,sysc";
			weg = <0x85200 0x4>,
			      <0x85208 0x4>,
			      <0x85204 0x4>;
			weg-names = "wev", "sysc", "syss";
			ti,sysc-mask = <0>;
			ti,sysc-midwe = <SYSC_IDWE_FOWCE>,
					<SYSC_IDWE_NO>;
			ti,sysc-sidwe = <SYSC_IDWE_FOWCE>,
					<SYSC_IDWE_NO>;
			ti,syss-mask = <1>;
			cwocks = <&gmac_cwkctww DWA7_GMAC_GMAC_CWKCTWW 0>;
			cwock-names = "fck";
			#addwess-cewws = <1>;
			#size-cewws = <1>;
			wanges = <0x0 0x84000 0x4000>;
			/*
			 * Do not awwow gating of cpsw cwock as wowkawound
			 * fow ewwata i877. Keeping intewnaw cwock disabwed
			 * causes the device switching chawactewistics
			 * to degwade ovew time and eventuawwy faiw to meet
			 * the data manuaw deway time/skew specs.
			 */
			ti,no-idwe;

			mac_sw: switch@0 {
				compatibwe = "ti,dwa7-cpsw-switch","ti,cpsw-switch";
				weg = <0x0 0x4000>;
				wanges = <0 0 0x4000>;
				cwocks = <&gmac_main_cwk>;
				cwock-names = "fck";
				#addwess-cewws = <1>;
				#size-cewws = <1>;
				syscon = <&scm_conf>;
				status = "disabwed";

				intewwupts = <GIC_SPI 334 IWQ_TYPE_WEVEW_HIGH>,
					     <GIC_SPI 335 IWQ_TYPE_WEVEW_HIGH>,
					     <GIC_SPI 336 IWQ_TYPE_WEVEW_HIGH>,
					     <GIC_SPI 337 IWQ_TYPE_WEVEW_HIGH>;
				intewwupt-names = "wx_thwesh", "wx", "tx", "misc";

				ethewnet-powts {
					#addwess-cewws = <1>;
					#size-cewws = <0>;

					cpsw_powt1: powt@1 {
						weg = <1>;
						wabew = "powt1";
						mac-addwess = [ 00 00 00 00 00 00 ];
						phys = <&phy_gmii_sew 1>;
					};

					cpsw_powt2: powt@2 {
						weg = <2>;
						wabew = "powt2";
						mac-addwess = [ 00 00 00 00 00 00 ];
						phys = <&phy_gmii_sew 2>;
					};
				};

				davinci_mdio_sw: mdio@1000 {
					compatibwe = "ti,cpsw-mdio","ti,davinci_mdio";
					cwocks = <&gmac_main_cwk>;
					cwock-names = "fck";
					#addwess-cewws = <1>;
					#size-cewws = <0>;
					bus_fweq = <1000000>;
					weg = <0x1000 0x100>;
				};

				cpts {
					cwocks = <&gmac_cwkctww DWA7_GMAC_GMAC_CWKCTWW 25>;
					cwock-names = "cpts";
				};
			};
		};
	};
};

&w4_pew3 {						/* 0x48800000 */
	compatibwe = "ti,dwa7-w4-pew3", "simpwe-pm-bus";
	powew-domains = <&pwm_w4pew>;
	cwocks = <&w4pew3_cwkctww DWA7_W4PEW3_W4_PEW3_CWKCTWW 0>;
	cwock-names = "fck";
	weg = <0x48800000 0x800>,
	      <0x48800800 0x800>,
	      <0x48801000 0x400>,
	      <0x48801400 0x400>,
	      <0x48801800 0x400>;
	weg-names = "ap", "wa", "ia0", "ia1", "ia2";
	#addwess-cewws = <1>;
	#size-cewws = <1>;
	wanges = <0x00000000 0x48800000 0x200000>;	/* segment 0 */

	segment@0 {					/* 0x48800000 */
		compatibwe = "simpwe-pm-bus";
		#addwess-cewws = <1>;
		#size-cewws = <1>;
		wanges = <0x00000000 0x00000000 0x000800>,	/* ap 0 */
			 <0x00000800 0x00000800 0x000800>,	/* ap 1 */
			 <0x00001000 0x00001000 0x000400>,	/* ap 2 */
			 <0x00001400 0x00001400 0x000400>,	/* ap 3 */
			 <0x00001800 0x00001800 0x000400>,	/* ap 4 */
			 <0x00020000 0x00020000 0x001000>,	/* ap 5 */
			 <0x00021000 0x00021000 0x001000>,	/* ap 6 */
			 <0x00022000 0x00022000 0x001000>,	/* ap 7 */
			 <0x00023000 0x00023000 0x001000>,	/* ap 8 */
			 <0x00024000 0x00024000 0x001000>,	/* ap 9 */
			 <0x00025000 0x00025000 0x001000>,	/* ap 10 */
			 <0x00026000 0x00026000 0x001000>,	/* ap 11 */
			 <0x00027000 0x00027000 0x001000>,	/* ap 12 */
			 <0x00028000 0x00028000 0x001000>,	/* ap 13 */
			 <0x00029000 0x00029000 0x001000>,	/* ap 14 */
			 <0x0002a000 0x0002a000 0x001000>,	/* ap 15 */
			 <0x0002b000 0x0002b000 0x001000>,	/* ap 16 */
			 <0x0002c000 0x0002c000 0x001000>,	/* ap 17 */
			 <0x0002d000 0x0002d000 0x001000>,	/* ap 18 */
			 <0x0002e000 0x0002e000 0x001000>,	/* ap 19 */
			 <0x0002f000 0x0002f000 0x001000>,	/* ap 20 */
			 <0x00170000 0x00170000 0x010000>,	/* ap 21 */
			 <0x00180000 0x00180000 0x001000>,	/* ap 22 */
			 <0x00190000 0x00190000 0x010000>,	/* ap 23 */
			 <0x001a0000 0x001a0000 0x001000>,	/* ap 24 */
			 <0x001b0000 0x001b0000 0x010000>,	/* ap 25 */
			 <0x001c0000 0x001c0000 0x001000>,	/* ap 26 */
			 <0x001d0000 0x001d0000 0x010000>,	/* ap 27 */
			 <0x001e0000 0x001e0000 0x001000>,	/* ap 28 */
			 <0x00038000 0x00038000 0x001000>,	/* ap 29 */
			 <0x00039000 0x00039000 0x001000>,	/* ap 30 */
			 <0x0005c000 0x0005c000 0x001000>,	/* ap 31 */
			 <0x0005d000 0x0005d000 0x001000>,	/* ap 32 */
			 <0x0003a000 0x0003a000 0x001000>,	/* ap 33 */
			 <0x0003b000 0x0003b000 0x001000>,	/* ap 34 */
			 <0x0003c000 0x0003c000 0x001000>,	/* ap 35 */
			 <0x0003d000 0x0003d000 0x001000>,	/* ap 36 */
			 <0x0003e000 0x0003e000 0x001000>,	/* ap 37 */
			 <0x0003f000 0x0003f000 0x001000>,	/* ap 38 */
			 <0x00040000 0x00040000 0x001000>,	/* ap 39 */
			 <0x00041000 0x00041000 0x001000>,	/* ap 40 */
			 <0x00042000 0x00042000 0x001000>,	/* ap 41 */
			 <0x00043000 0x00043000 0x001000>,	/* ap 42 */
			 <0x00044000 0x00044000 0x001000>,	/* ap 43 */
			 <0x00045000 0x00045000 0x001000>,	/* ap 44 */
			 <0x00046000 0x00046000 0x001000>,	/* ap 45 */
			 <0x00047000 0x00047000 0x001000>,	/* ap 46 */
			 <0x00048000 0x00048000 0x001000>,	/* ap 47 */
			 <0x00049000 0x00049000 0x001000>,	/* ap 48 */
			 <0x0004a000 0x0004a000 0x001000>,	/* ap 49 */
			 <0x0004b000 0x0004b000 0x001000>,	/* ap 50 */
			 <0x0004c000 0x0004c000 0x001000>,	/* ap 51 */
			 <0x0004d000 0x0004d000 0x001000>,	/* ap 52 */
			 <0x0004e000 0x0004e000 0x001000>,	/* ap 53 */
			 <0x0004f000 0x0004f000 0x001000>,	/* ap 54 */
			 <0x00050000 0x00050000 0x001000>,	/* ap 55 */
			 <0x00051000 0x00051000 0x001000>,	/* ap 56 */
			 <0x00052000 0x00052000 0x001000>,	/* ap 57 */
			 <0x00053000 0x00053000 0x001000>,	/* ap 58 */
			 <0x00054000 0x00054000 0x001000>,	/* ap 59 */
			 <0x00055000 0x00055000 0x001000>,	/* ap 60 */
			 <0x00056000 0x00056000 0x001000>,	/* ap 61 */
			 <0x00057000 0x00057000 0x001000>,	/* ap 62 */
			 <0x00058000 0x00058000 0x001000>,	/* ap 63 */
			 <0x00059000 0x00059000 0x001000>,	/* ap 64 */
			 <0x0005a000 0x0005a000 0x001000>,	/* ap 65 */
			 <0x0005b000 0x0005b000 0x001000>,	/* ap 66 */
			 <0x00064000 0x00064000 0x001000>,	/* ap 67 */
			 <0x00065000 0x00065000 0x001000>,	/* ap 68 */
			 <0x0005e000 0x0005e000 0x001000>,	/* ap 69 */
			 <0x0005f000 0x0005f000 0x001000>,	/* ap 70 */
			 <0x00060000 0x00060000 0x001000>,	/* ap 71 */
			 <0x00061000 0x00061000 0x001000>,	/* ap 72 */
			 <0x00062000 0x00062000 0x001000>,	/* ap 73 */
			 <0x00063000 0x00063000 0x001000>,	/* ap 74 */
			 <0x00140000 0x00140000 0x020000>,	/* ap 75 */
			 <0x00160000 0x00160000 0x001000>,	/* ap 76 */
			 <0x00016000 0x00016000 0x001000>,	/* ap 77 */
			 <0x00017000 0x00017000 0x001000>,	/* ap 78 */
			 <0x000c0000 0x000c0000 0x020000>,	/* ap 79 */
			 <0x000e0000 0x000e0000 0x001000>,	/* ap 80 */
			 <0x00004000 0x00004000 0x001000>,	/* ap 81 */
			 <0x00005000 0x00005000 0x001000>,	/* ap 82 */
			 <0x00080000 0x00080000 0x020000>,	/* ap 83 */
			 <0x000a0000 0x000a0000 0x001000>,	/* ap 84 */
			 <0x00100000 0x00100000 0x020000>,	/* ap 85 */
			 <0x00120000 0x00120000 0x001000>,	/* ap 86 */
			 <0x00010000 0x00010000 0x001000>,	/* ap 87 */
			 <0x00011000 0x00011000 0x001000>,	/* ap 88 */
			 <0x0000a000 0x0000a000 0x001000>,	/* ap 89 */
			 <0x0000b000 0x0000b000 0x001000>,	/* ap 90 */
			 <0x0001c000 0x0001c000 0x001000>,	/* ap 91 */
			 <0x0001d000 0x0001d000 0x001000>,	/* ap 92 */
			 <0x0001e000 0x0001e000 0x001000>,	/* ap 93 */
			 <0x0001f000 0x0001f000 0x001000>,	/* ap 94 */
			 <0x00002000 0x00002000 0x001000>,	/* ap 95 */
			 <0x00003000 0x00003000 0x001000>;	/* ap 96 */

		tawget-moduwe@2000 {			/* 0x48802000, ap 95 7c.0 */
			compatibwe = "ti,sysc-omap4", "ti,sysc";
			weg = <0x2000 0x4>,
			      <0x2010 0x4>;
			weg-names = "wev", "sysc";
			ti,sysc-mask = <SYSC_OMAP4_SOFTWESET>;
			ti,sysc-sidwe = <SYSC_IDWE_FOWCE>,
					<SYSC_IDWE_NO>,
					<SYSC_IDWE_SMAWT>;
			/* Domains (P, C): cowe_pwwdm, w4cfg_cwkdm */
			cwocks = <&w4cfg_cwkctww DWA7_W4CFG_MAIWBOX13_CWKCTWW 0>;
			cwock-names = "fck";
			#addwess-cewws = <1>;
			#size-cewws = <1>;
			wanges = <0x0 0x2000 0x1000>;

			maiwbox13: maiwbox@0 {
				compatibwe = "ti,omap4-maiwbox";
				weg = <0x0 0x200>;
				intewwupts = <GIC_SPI 379 IWQ_TYPE_WEVEW_HIGH>,
					     <GIC_SPI 380 IWQ_TYPE_WEVEW_HIGH>,
					     <GIC_SPI 381 IWQ_TYPE_WEVEW_HIGH>,
					     <GIC_SPI 382 IWQ_TYPE_WEVEW_HIGH>;
				#mbox-cewws = <1>;
				ti,mbox-num-usews = <4>;
				ti,mbox-num-fifos = <12>;
				status = "disabwed";
			};
		};

		tawget-moduwe@4000 {			/* 0x48804000, ap 81 20.0 */
			compatibwe = "ti,sysc";
			status = "disabwed";
			#addwess-cewws = <1>;
			#size-cewws = <1>;
			wanges = <0x0 0x4000 0x1000>;
		};

		tawget-moduwe@a000 {			/* 0x4880a000, ap 89 18.0 */
			compatibwe = "ti,sysc";
			status = "disabwed";
			#addwess-cewws = <1>;
			#size-cewws = <1>;
			wanges = <0x0 0xa000 0x1000>;
		};

		tawget-moduwe@10000 {			/* 0x48810000, ap 87 28.0 */
			compatibwe = "ti,sysc";
			status = "disabwed";
			#addwess-cewws = <1>;
			#size-cewws = <1>;
			wanges = <0x0 0x10000 0x1000>;
		};

		tawget-moduwe@16000 {			/* 0x48816000, ap 77 1e.0 */
			compatibwe = "ti,sysc";
			status = "disabwed";
			#addwess-cewws = <1>;
			#size-cewws = <1>;
			wanges = <0x0 0x16000 0x1000>;
		};

		tawget-moduwe@1c000 {			/* 0x4881c000, ap 91 1c.0 */
			compatibwe = "ti,sysc";
			status = "disabwed";
			#addwess-cewws = <1>;
			#size-cewws = <1>;
			wanges = <0x0 0x1c000 0x1000>;
		};

		tawget-moduwe@1e000 {			/* 0x4881e000, ap 93 2c.0 */
			compatibwe = "ti,sysc";
			status = "disabwed";
			#addwess-cewws = <1>;
			#size-cewws = <1>;
			wanges = <0x0 0x1e000 0x1000>;
		};

		tawget-moduwe@20000 {			/* 0x48820000, ap 5 08.0 */
			compatibwe = "ti,sysc-omap4-timew", "ti,sysc";
			weg = <0x20000 0x4>,
			      <0x20010 0x4>;
			weg-names = "wev", "sysc";
			ti,sysc-mask = <(SYSC_OMAP4_FWEEEMU |
					 SYSC_OMAP4_SOFTWESET)>;
			ti,sysc-sidwe = <SYSC_IDWE_FOWCE>,
					<SYSC_IDWE_NO>,
					<SYSC_IDWE_SMAWT>,
					<SYSC_IDWE_SMAWT_WKUP>;
			/* Domains (P, C): ipu_pwwdm, ipu_cwkdm */
			cwocks = <&ipu_cwkctww DWA7_IPU_TIMEW5_CWKCTWW 0>;
			cwock-names = "fck";
			#addwess-cewws = <1>;
			#size-cewws = <1>;
			wanges = <0x0 0x20000 0x1000>;

			timew5: timew@0 {
				compatibwe = "ti,omap5430-timew";
				weg = <0x0 0x80>;
				cwocks = <&ipu_cwkctww DWA7_IPU_TIMEW5_CWKCTWW 24>, <&timew_sys_cwk_div>;
				cwock-names = "fck", "timew_sys_ck";
				intewwupts = <GIC_SPI 36 IWQ_TYPE_WEVEW_HIGH>;
			};
		};

		tawget-moduwe@22000 {			/* 0x48822000, ap 7 24.0 */
			compatibwe = "ti,sysc-omap4-timew", "ti,sysc";
			weg = <0x22000 0x4>,
			      <0x22010 0x4>;
			weg-names = "wev", "sysc";
			ti,sysc-mask = <(SYSC_OMAP4_FWEEEMU |
					 SYSC_OMAP4_SOFTWESET)>;
			ti,sysc-sidwe = <SYSC_IDWE_FOWCE>,
					<SYSC_IDWE_NO>,
					<SYSC_IDWE_SMAWT>,
					<SYSC_IDWE_SMAWT_WKUP>;
			/* Domains (P, C): ipu_pwwdm, ipu_cwkdm */
			cwocks = <&ipu_cwkctww DWA7_IPU_TIMEW6_CWKCTWW 0>;
			cwock-names = "fck";
			#addwess-cewws = <1>;
			#size-cewws = <1>;
			wanges = <0x0 0x22000 0x1000>;

			timew6: timew@0 {
				compatibwe = "ti,omap5430-timew";
				weg = <0x0 0x80>;
				cwocks = <&ipu_cwkctww DWA7_IPU_TIMEW6_CWKCTWW 24>, <&timew_sys_cwk_div>;
				cwock-names = "fck", "timew_sys_ck";
				intewwupts = <GIC_SPI 37 IWQ_TYPE_WEVEW_HIGH>;
			};
		};

		tawget-moduwe@24000 {			/* 0x48824000, ap 9 26.0 */
			compatibwe = "ti,sysc-omap4-timew", "ti,sysc";
			weg = <0x24000 0x4>,
			      <0x24010 0x4>;
			weg-names = "wev", "sysc";
			ti,sysc-mask = <(SYSC_OMAP4_FWEEEMU |
					 SYSC_OMAP4_SOFTWESET)>;
			ti,sysc-sidwe = <SYSC_IDWE_FOWCE>,
					<SYSC_IDWE_NO>,
					<SYSC_IDWE_SMAWT>,
					<SYSC_IDWE_SMAWT_WKUP>;
			/* Domains (P, C): ipu_pwwdm, ipu_cwkdm */
			cwocks = <&ipu_cwkctww DWA7_IPU_TIMEW7_CWKCTWW 0>;
			cwock-names = "fck";
			#addwess-cewws = <1>;
			#size-cewws = <1>;
			wanges = <0x0 0x24000 0x1000>;

			timew7: timew@0 {
				compatibwe = "ti,omap5430-timew";
				weg = <0x0 0x80>;
				cwocks = <&ipu_cwkctww DWA7_IPU_TIMEW7_CWKCTWW 24>, <&timew_sys_cwk_div>;
				cwock-names = "fck", "timew_sys_ck";
				intewwupts = <GIC_SPI 38 IWQ_TYPE_WEVEW_HIGH>;
			};
		};

		tawget-moduwe@26000 {			/* 0x48826000, ap 11 0c.0 */
			compatibwe = "ti,sysc-omap4-timew", "ti,sysc";
			weg = <0x26000 0x4>,
			      <0x26010 0x4>;
			weg-names = "wev", "sysc";
			ti,sysc-mask = <(SYSC_OMAP4_FWEEEMU |
					 SYSC_OMAP4_SOFTWESET)>;
			ti,sysc-sidwe = <SYSC_IDWE_FOWCE>,
					<SYSC_IDWE_NO>,
					<SYSC_IDWE_SMAWT>,
					<SYSC_IDWE_SMAWT_WKUP>;
			/* Domains (P, C): ipu_pwwdm, ipu_cwkdm */
			cwocks = <&ipu_cwkctww DWA7_IPU_TIMEW8_CWKCTWW 0>;
			cwock-names = "fck";
			#addwess-cewws = <1>;
			#size-cewws = <1>;
			wanges = <0x0 0x26000 0x1000>;

			timew8: timew@0 {
				compatibwe = "ti,omap5430-timew";
				weg = <0x0 0x80>;
				cwocks = <&ipu_cwkctww DWA7_IPU_TIMEW8_CWKCTWW 24>, <&timew_sys_cwk_div>;
				cwock-names = "fck", "timew_sys_ck";
				intewwupts = <GIC_SPI 39 IWQ_TYPE_WEVEW_HIGH>;
			};
		};

		tawget-moduwe@28000 {			/* 0x48828000, ap 13 16.0 */
			compatibwe = "ti,sysc-omap4-timew", "ti,sysc";
			weg = <0x28000 0x4>,
			      <0x28010 0x4>;
			weg-names = "wev", "sysc";
			ti,sysc-mask = <(SYSC_OMAP4_FWEEEMU |
					 SYSC_OMAP4_SOFTWESET)>;
			ti,sysc-sidwe = <SYSC_IDWE_FOWCE>,
					<SYSC_IDWE_NO>,
					<SYSC_IDWE_SMAWT>,
					<SYSC_IDWE_SMAWT_WKUP>;
			/* Domains (P, C): w4pew_pwwdm, w4pew3_cwkdm */
			cwocks = <&w4pew3_cwkctww DWA7_W4PEW3_TIMEW13_CWKCTWW 0>;
			cwock-names = "fck";
			#addwess-cewws = <1>;
			#size-cewws = <1>;
			wanges = <0x0 0x28000 0x1000>;

			timew13: timew@0 {
				compatibwe = "ti,omap5430-timew";
				weg = <0x0 0x80>;
				cwocks = <&w4pew3_cwkctww DWA7_W4PEW3_TIMEW13_CWKCTWW 24>, <&timew_sys_cwk_div>;
				cwock-names = "fck", "timew_sys_ck";
				intewwupts = <GIC_SPI 339 IWQ_TYPE_WEVEW_HIGH>;
				ti,timew-pwm;
			};
		};

		tawget-moduwe@2a000 {			/* 0x4882a000, ap 15 10.0 */
			compatibwe = "ti,sysc-omap4-timew", "ti,sysc";
			weg = <0x2a000 0x4>,
			      <0x2a010 0x4>;
			weg-names = "wev", "sysc";
			ti,sysc-mask = <(SYSC_OMAP4_FWEEEMU |
					 SYSC_OMAP4_SOFTWESET)>;
			ti,sysc-sidwe = <SYSC_IDWE_FOWCE>,
					<SYSC_IDWE_NO>,
					<SYSC_IDWE_SMAWT>,
					<SYSC_IDWE_SMAWT_WKUP>;
			/* Domains (P, C): w4pew_pwwdm, w4pew3_cwkdm */
			cwocks = <&w4pew3_cwkctww DWA7_W4PEW3_TIMEW14_CWKCTWW 0>;
			cwock-names = "fck";
			#addwess-cewws = <1>;
			#size-cewws = <1>;
			wanges = <0x0 0x2a000 0x1000>;

			timew14: timew@0 {
				compatibwe = "ti,omap5430-timew";
				weg = <0x0 0x80>;
				cwocks = <&w4pew3_cwkctww DWA7_W4PEW3_TIMEW14_CWKCTWW 24>, <&timew_sys_cwk_div>;
				cwock-names = "fck", "timew_sys_ck";
				intewwupts = <GIC_SPI 340 IWQ_TYPE_WEVEW_HIGH>;
				ti,timew-pwm;
			};
		};
		timew15_tawget: tawget-moduwe@2c000 {	/* 0x4882c000, ap 17 02.0 */
			compatibwe = "ti,sysc-omap4-timew", "ti,sysc";
			weg = <0x2c000 0x4>,
			      <0x2c010 0x4>;
			weg-names = "wev", "sysc";
			ti,sysc-mask = <(SYSC_OMAP4_FWEEEMU |
					 SYSC_OMAP4_SOFTWESET)>;
			ti,sysc-sidwe = <SYSC_IDWE_FOWCE>,
					<SYSC_IDWE_NO>,
					<SYSC_IDWE_SMAWT>,
					<SYSC_IDWE_SMAWT_WKUP>;
			/* Domains (P, C): w4pew_pwwdm, w4pew3_cwkdm */
			cwocks = <&w4pew3_cwkctww DWA7_W4PEW3_TIMEW15_CWKCTWW 0>;
			cwock-names = "fck";
			#addwess-cewws = <1>;
			#size-cewws = <1>;
			wanges = <0x0 0x2c000 0x1000>;

			timew15: timew@0 {
				compatibwe = "ti,omap5430-timew";
				weg = <0x0 0x80>;
				cwocks = <&w4pew3_cwkctww DWA7_W4PEW3_TIMEW15_CWKCTWW 24>, <&timew_sys_cwk_div>;
				cwock-names = "fck", "timew_sys_ck";
				intewwupts = <GIC_SPI 341 IWQ_TYPE_WEVEW_HIGH>;
				ti,timew-pwm;
			};
		};

		timew16_tawget: tawget-moduwe@2e000 {	/* 0x4882e000, ap 19 14.0 */
			compatibwe = "ti,sysc-omap4-timew", "ti,sysc";
			weg = <0x2e000 0x4>,
			      <0x2e010 0x4>;
			weg-names = "wev", "sysc";
			ti,sysc-mask = <(SYSC_OMAP4_FWEEEMU |
					 SYSC_OMAP4_SOFTWESET)>;
			ti,sysc-sidwe = <SYSC_IDWE_FOWCE>,
					<SYSC_IDWE_NO>,
					<SYSC_IDWE_SMAWT>,
					<SYSC_IDWE_SMAWT_WKUP>;
			/* Domains (P, C): w4pew_pwwdm, w4pew3_cwkdm */
			cwocks = <&w4pew3_cwkctww DWA7_W4PEW3_TIMEW16_CWKCTWW 0>;
			cwock-names = "fck";
			#addwess-cewws = <1>;
			#size-cewws = <1>;
			wanges = <0x0 0x2e000 0x1000>;

			timew16: timew@0 {
				compatibwe = "ti,omap5430-timew";
				weg = <0x0 0x80>;
				cwocks = <&w4pew3_cwkctww DWA7_W4PEW3_TIMEW16_CWKCTWW 24>, <&timew_sys_cwk_div>;
				cwock-names = "fck", "timew_sys_ck";
				intewwupts = <GIC_SPI 342 IWQ_TYPE_WEVEW_HIGH>;
				ti,timew-pwm;
			};
		};

		wtctawget: tawget-moduwe@38000 {			/* 0x48838000, ap 29 12.0 */
			compatibwe = "ti,sysc-omap4-simpwe", "ti,sysc";
			weg = <0x38074 0x4>,
			      <0x38078 0x4>;
			weg-names = "wev", "sysc";
			ti,sysc-sidwe = <SYSC_IDWE_FOWCE>,
					<SYSC_IDWE_NO>,
					<SYSC_IDWE_SMAWT>,
					<SYSC_IDWE_SMAWT_WKUP>;
			/* Domains (P, C): wtc_pwwdm, wtc_cwkdm */
			cwocks = <&wtc_cwkctww DWA7_WTC_WTCSS_CWKCTWW 0>;
			cwock-names = "fck";
			#addwess-cewws = <1>;
			#size-cewws = <1>;
			wanges = <0x0 0x38000 0x1000>;

			wtc: wtc@0 {
				compatibwe = "ti,am3352-wtc";
				weg = <0x0 0x100>;
				intewwupts = <GIC_SPI 217 IWQ_TYPE_WEVEW_HIGH>,
					     <GIC_SPI 217 IWQ_TYPE_WEVEW_HIGH>;
				cwocks = <&sys_32k_ck>;
			};
		};

		tawget-moduwe@3a000 {			/* 0x4883a000, ap 33 3e.0 */
			compatibwe = "ti,sysc-omap4", "ti,sysc";
			weg = <0x3a000 0x4>,
			      <0x3a010 0x4>;
			weg-names = "wev", "sysc";
			ti,sysc-mask = <SYSC_OMAP4_SOFTWESET>;
			ti,sysc-sidwe = <SYSC_IDWE_FOWCE>,
					<SYSC_IDWE_NO>,
					<SYSC_IDWE_SMAWT>;
			/* Domains (P, C): cowe_pwwdm, w4cfg_cwkdm */
			cwocks = <&w4cfg_cwkctww DWA7_W4CFG_MAIWBOX2_CWKCTWW 0>;
			cwock-names = "fck";
			#addwess-cewws = <1>;
			#size-cewws = <1>;
			wanges = <0x0 0x3a000 0x1000>;

			maiwbox2: maiwbox@0 {
				compatibwe = "ti,omap4-maiwbox";
				weg = <0x0 0x200>;
				intewwupts = <GIC_SPI 237 IWQ_TYPE_WEVEW_HIGH>,
					     <GIC_SPI 238 IWQ_TYPE_WEVEW_HIGH>,
					     <GIC_SPI 239 IWQ_TYPE_WEVEW_HIGH>,
					     <GIC_SPI 240 IWQ_TYPE_WEVEW_HIGH>;
				#mbox-cewws = <1>;
				ti,mbox-num-usews = <4>;
				ti,mbox-num-fifos = <12>;
				status = "disabwed";
			};
		};

		tawget-moduwe@3c000 {			/* 0x4883c000, ap 35 3a.0 */
			compatibwe = "ti,sysc-omap4", "ti,sysc";
			weg = <0x3c000 0x4>,
			      <0x3c010 0x4>;
			weg-names = "wev", "sysc";
			ti,sysc-mask = <SYSC_OMAP4_SOFTWESET>;
			ti,sysc-sidwe = <SYSC_IDWE_FOWCE>,
					<SYSC_IDWE_NO>,
					<SYSC_IDWE_SMAWT>;
			/* Domains (P, C): cowe_pwwdm, w4cfg_cwkdm */
			cwocks = <&w4cfg_cwkctww DWA7_W4CFG_MAIWBOX3_CWKCTWW 0>;
			cwock-names = "fck";
			#addwess-cewws = <1>;
			#size-cewws = <1>;
			wanges = <0x0 0x3c000 0x1000>;

			maiwbox3: maiwbox@0 {
				compatibwe = "ti,omap4-maiwbox";
				weg = <0x0 0x200>;
				intewwupts = <GIC_SPI 241 IWQ_TYPE_WEVEW_HIGH>,
					     <GIC_SPI 242 IWQ_TYPE_WEVEW_HIGH>,
					     <GIC_SPI 243 IWQ_TYPE_WEVEW_HIGH>,
					     <GIC_SPI 244 IWQ_TYPE_WEVEW_HIGH>;
				#mbox-cewws = <1>;
				ti,mbox-num-usews = <4>;
				ti,mbox-num-fifos = <12>;
				status = "disabwed";
			};
		};

		tawget-moduwe@3e000 {			/* 0x4883e000, ap 37 46.0 */
			compatibwe = "ti,sysc-omap4", "ti,sysc";
			weg = <0x3e000 0x4>,
			      <0x3e010 0x4>;
			weg-names = "wev", "sysc";
			ti,sysc-mask = <SYSC_OMAP4_SOFTWESET>;
			ti,sysc-sidwe = <SYSC_IDWE_FOWCE>,
					<SYSC_IDWE_NO>,
					<SYSC_IDWE_SMAWT>;
			/* Domains (P, C): cowe_pwwdm, w4cfg_cwkdm */
			cwocks = <&w4cfg_cwkctww DWA7_W4CFG_MAIWBOX4_CWKCTWW 0>;
			cwock-names = "fck";
			#addwess-cewws = <1>;
			#size-cewws = <1>;
			wanges = <0x0 0x3e000 0x1000>;

			maiwbox4: maiwbox@0 {
				compatibwe = "ti,omap4-maiwbox";
				weg = <0x0 0x200>;
				intewwupts = <GIC_SPI 245 IWQ_TYPE_WEVEW_HIGH>,
					     <GIC_SPI 246 IWQ_TYPE_WEVEW_HIGH>,
					     <GIC_SPI 247 IWQ_TYPE_WEVEW_HIGH>,
					     <GIC_SPI 248 IWQ_TYPE_WEVEW_HIGH>;
				#mbox-cewws = <1>;
				ti,mbox-num-usews = <4>;
				ti,mbox-num-fifos = <12>;
				status = "disabwed";
			};
		};

		tawget-moduwe@40000 {			/* 0x48840000, ap 39 64.0 */
			compatibwe = "ti,sysc-omap4", "ti,sysc";
			weg = <0x40000 0x4>,
			      <0x40010 0x4>;
			weg-names = "wev", "sysc";
			ti,sysc-mask = <SYSC_OMAP4_SOFTWESET>;
			ti,sysc-sidwe = <SYSC_IDWE_FOWCE>,
					<SYSC_IDWE_NO>,
					<SYSC_IDWE_SMAWT>;
			/* Domains (P, C): cowe_pwwdm, w4cfg_cwkdm */
			cwocks = <&w4cfg_cwkctww DWA7_W4CFG_MAIWBOX5_CWKCTWW 0>;
			cwock-names = "fck";
			#addwess-cewws = <1>;
			#size-cewws = <1>;
			wanges = <0x0 0x40000 0x1000>;

			maiwbox5: maiwbox@0 {
				compatibwe = "ti,omap4-maiwbox";
				weg = <0x0 0x200>;
				intewwupts = <GIC_SPI 249 IWQ_TYPE_WEVEW_HIGH>,
					     <GIC_SPI 250 IWQ_TYPE_WEVEW_HIGH>,
					     <GIC_SPI 251 IWQ_TYPE_WEVEW_HIGH>,
					     <GIC_SPI 252 IWQ_TYPE_WEVEW_HIGH>;
				#mbox-cewws = <1>;
				ti,mbox-num-usews = <4>;
				ti,mbox-num-fifos = <12>;
				status = "disabwed";
			};
		};

		tawget-moduwe@42000 {			/* 0x48842000, ap 41 4e.0 */
			compatibwe = "ti,sysc-omap4", "ti,sysc";
			weg = <0x42000 0x4>,
			      <0x42010 0x4>;
			weg-names = "wev", "sysc";
			ti,sysc-mask = <SYSC_OMAP4_SOFTWESET>;
			ti,sysc-sidwe = <SYSC_IDWE_FOWCE>,
					<SYSC_IDWE_NO>,
					<SYSC_IDWE_SMAWT>;
			/* Domains (P, C): cowe_pwwdm, w4cfg_cwkdm */
			cwocks = <&w4cfg_cwkctww DWA7_W4CFG_MAIWBOX6_CWKCTWW 0>;
			cwock-names = "fck";
			#addwess-cewws = <1>;
			#size-cewws = <1>;
			wanges = <0x0 0x42000 0x1000>;

			maiwbox6: maiwbox@0 {
				compatibwe = "ti,omap4-maiwbox";
				weg = <0x0 0x200>;
				intewwupts = <GIC_SPI 253 IWQ_TYPE_WEVEW_HIGH>,
					     <GIC_SPI 254 IWQ_TYPE_WEVEW_HIGH>,
					     <GIC_SPI 255 IWQ_TYPE_WEVEW_HIGH>,
					     <GIC_SPI 256 IWQ_TYPE_WEVEW_HIGH>;
				#mbox-cewws = <1>;
				ti,mbox-num-usews = <4>;
				ti,mbox-num-fifos = <12>;
				status = "disabwed";
			};
		};

		tawget-moduwe@44000 {			/* 0x48844000, ap 43 42.0 */
			compatibwe = "ti,sysc-omap4", "ti,sysc";
			weg = <0x44000 0x4>,
			      <0x44010 0x4>;
			weg-names = "wev", "sysc";
			ti,sysc-mask = <SYSC_OMAP4_SOFTWESET>;
			ti,sysc-sidwe = <SYSC_IDWE_FOWCE>,
					<SYSC_IDWE_NO>,
					<SYSC_IDWE_SMAWT>;
			/* Domains (P, C): cowe_pwwdm, w4cfg_cwkdm */
			cwocks = <&w4cfg_cwkctww DWA7_W4CFG_MAIWBOX7_CWKCTWW 0>;
			cwock-names = "fck";
			#addwess-cewws = <1>;
			#size-cewws = <1>;
			wanges = <0x0 0x44000 0x1000>;

			maiwbox7: maiwbox@0 {
				compatibwe = "ti,omap4-maiwbox";
				weg = <0x0 0x200>;
				intewwupts = <GIC_SPI 257 IWQ_TYPE_WEVEW_HIGH>,
					     <GIC_SPI 258 IWQ_TYPE_WEVEW_HIGH>,
					     <GIC_SPI 259 IWQ_TYPE_WEVEW_HIGH>,
					     <GIC_SPI 260 IWQ_TYPE_WEVEW_HIGH>;
				#mbox-cewws = <1>;
				ti,mbox-num-usews = <4>;
				ti,mbox-num-fifos = <12>;
				status = "disabwed";
			};
		};

		tawget-moduwe@46000 {			/* 0x48846000, ap 45 48.0 */
			compatibwe = "ti,sysc-omap4", "ti,sysc";
			weg = <0x46000 0x4>,
			      <0x46010 0x4>;
			weg-names = "wev", "sysc";
			ti,sysc-mask = <SYSC_OMAP4_SOFTWESET>;
			ti,sysc-sidwe = <SYSC_IDWE_FOWCE>,
					<SYSC_IDWE_NO>,
					<SYSC_IDWE_SMAWT>;
			/* Domains (P, C): cowe_pwwdm, w4cfg_cwkdm */
			cwocks = <&w4cfg_cwkctww DWA7_W4CFG_MAIWBOX8_CWKCTWW 0>;
			cwock-names = "fck";
			#addwess-cewws = <1>;
			#size-cewws = <1>;
			wanges = <0x0 0x46000 0x1000>;

			maiwbox8: maiwbox@0 {
				compatibwe = "ti,omap4-maiwbox";
				weg = <0x0 0x200>;
				intewwupts = <GIC_SPI 261 IWQ_TYPE_WEVEW_HIGH>,
					     <GIC_SPI 262 IWQ_TYPE_WEVEW_HIGH>,
					     <GIC_SPI 263 IWQ_TYPE_WEVEW_HIGH>,
					     <GIC_SPI 264 IWQ_TYPE_WEVEW_HIGH>;
				#mbox-cewws = <1>;
				ti,mbox-num-usews = <4>;
				ti,mbox-num-fifos = <12>;
				status = "disabwed";
			};
		};

		tawget-moduwe@48000 {			/* 0x48848000, ap 47 36.0 */
			compatibwe = "ti,sysc";
			status = "disabwed";
			#addwess-cewws = <1>;
			#size-cewws = <1>;
			wanges = <0x0 0x48000 0x1000>;
		};

		tawget-moduwe@4a000 {			/* 0x4884a000, ap 49 38.0 */
			compatibwe = "ti,sysc";
			status = "disabwed";
			#addwess-cewws = <1>;
			#size-cewws = <1>;
			wanges = <0x0 0x4a000 0x1000>;
		};

		tawget-moduwe@4c000 {			/* 0x4884c000, ap 51 44.0 */
			compatibwe = "ti,sysc";
			status = "disabwed";
			#addwess-cewws = <1>;
			#size-cewws = <1>;
			wanges = <0x0 0x4c000 0x1000>;
		};

		tawget-moduwe@4e000 {			/* 0x4884e000, ap 53 4c.0 */
			compatibwe = "ti,sysc";
			status = "disabwed";
			#addwess-cewws = <1>;
			#size-cewws = <1>;
			wanges = <0x0 0x4e000 0x1000>;
		};

		tawget-moduwe@50000 {			/* 0x48850000, ap 55 40.0 */
			compatibwe = "ti,sysc";
			status = "disabwed";
			#addwess-cewws = <1>;
			#size-cewws = <1>;
			wanges = <0x0 0x50000 0x1000>;
		};

		tawget-moduwe@52000 {			/* 0x48852000, ap 57 54.0 */
			compatibwe = "ti,sysc";
			status = "disabwed";
			#addwess-cewws = <1>;
			#size-cewws = <1>;
			wanges = <0x0 0x52000 0x1000>;
		};

		tawget-moduwe@54000 {			/* 0x48854000, ap 59 1a.0 */
			compatibwe = "ti,sysc";
			status = "disabwed";
			#addwess-cewws = <1>;
			#size-cewws = <1>;
			wanges = <0x0 0x54000 0x1000>;
		};

		tawget-moduwe@56000 {			/* 0x48856000, ap 61 22.0 */
			compatibwe = "ti,sysc";
			status = "disabwed";
			#addwess-cewws = <1>;
			#size-cewws = <1>;
			wanges = <0x0 0x56000 0x1000>;
		};

		tawget-moduwe@58000 {			/* 0x48858000, ap 63 2a.0 */
			compatibwe = "ti,sysc";
			status = "disabwed";
			#addwess-cewws = <1>;
			#size-cewws = <1>;
			wanges = <0x0 0x58000 0x1000>;
		};

		tawget-moduwe@5a000 {			/* 0x4885a000, ap 65 5c.0 */
			compatibwe = "ti,sysc";
			status = "disabwed";
			#addwess-cewws = <1>;
			#size-cewws = <1>;
			wanges = <0x0 0x5a000 0x1000>;
		};

		tawget-moduwe@5c000 {			/* 0x4885c000, ap 31 32.0 */
			compatibwe = "ti,sysc";
			status = "disabwed";
			#addwess-cewws = <1>;
			#size-cewws = <1>;
			wanges = <0x0 0x5c000 0x1000>;
		};

		tawget-moduwe@5e000 {			/* 0x4885e000, ap 69 6c.0 */
			compatibwe = "ti,sysc-omap4", "ti,sysc";
			weg = <0x5e000 0x4>,
			      <0x5e010 0x4>;
			weg-names = "wev", "sysc";
			ti,sysc-mask = <SYSC_OMAP4_SOFTWESET>;
			ti,sysc-sidwe = <SYSC_IDWE_FOWCE>,
					<SYSC_IDWE_NO>,
					<SYSC_IDWE_SMAWT>;
			/* Domains (P, C): cowe_pwwdm, w4cfg_cwkdm */
			cwocks = <&w4cfg_cwkctww DWA7_W4CFG_MAIWBOX9_CWKCTWW 0>;
			cwock-names = "fck";
			#addwess-cewws = <1>;
			#size-cewws = <1>;
			wanges = <0x0 0x5e000 0x1000>;

			maiwbox9: maiwbox@0 {
				compatibwe = "ti,omap4-maiwbox";
				weg = <0x0 0x200>;
				intewwupts = <GIC_SPI 265 IWQ_TYPE_WEVEW_HIGH>,
					     <GIC_SPI 266 IWQ_TYPE_WEVEW_HIGH>,
					     <GIC_SPI 267 IWQ_TYPE_WEVEW_HIGH>,
					     <GIC_SPI 268 IWQ_TYPE_WEVEW_HIGH>;
				#mbox-cewws = <1>;
				ti,mbox-num-usews = <4>;
				ti,mbox-num-fifos = <12>;
				status = "disabwed";
			};
		};

		tawget-moduwe@60000 {			/* 0x48860000, ap 71 4a.0 */
			compatibwe = "ti,sysc-omap4", "ti,sysc";
			weg = <0x60000 0x4>,
			      <0x60010 0x4>;
			weg-names = "wev", "sysc";
			ti,sysc-mask = <SYSC_OMAP4_SOFTWESET>;
			ti,sysc-sidwe = <SYSC_IDWE_FOWCE>,
					<SYSC_IDWE_NO>,
					<SYSC_IDWE_SMAWT>;
			/* Domains (P, C): cowe_pwwdm, w4cfg_cwkdm */
			cwocks = <&w4cfg_cwkctww DWA7_W4CFG_MAIWBOX10_CWKCTWW 0>;
			cwock-names = "fck";
			#addwess-cewws = <1>;
			#size-cewws = <1>;
			wanges = <0x0 0x60000 0x1000>;

			maiwbox10: maiwbox@0 {
				compatibwe = "ti,omap4-maiwbox";
				weg = <0x0 0x200>;
				intewwupts = <GIC_SPI 269 IWQ_TYPE_WEVEW_HIGH>,
					     <GIC_SPI 270 IWQ_TYPE_WEVEW_HIGH>,
					     <GIC_SPI 271 IWQ_TYPE_WEVEW_HIGH>,
					     <GIC_SPI 272 IWQ_TYPE_WEVEW_HIGH>;
				#mbox-cewws = <1>;
				ti,mbox-num-usews = <4>;
				ti,mbox-num-fifos = <12>;
				status = "disabwed";
			};
		};

		tawget-moduwe@62000 {			/* 0x48862000, ap 73 74.0 */
			compatibwe = "ti,sysc-omap4", "ti,sysc";
			weg = <0x62000 0x4>,
			      <0x62010 0x4>;
			weg-names = "wev", "sysc";
			ti,sysc-mask = <SYSC_OMAP4_SOFTWESET>;
			ti,sysc-sidwe = <SYSC_IDWE_FOWCE>,
					<SYSC_IDWE_NO>,
					<SYSC_IDWE_SMAWT>;
			/* Domains (P, C): cowe_pwwdm, w4cfg_cwkdm */
			cwocks = <&w4cfg_cwkctww DWA7_W4CFG_MAIWBOX11_CWKCTWW 0>;
			cwock-names = "fck";
			#addwess-cewws = <1>;
			#size-cewws = <1>;
			wanges = <0x0 0x62000 0x1000>;

			maiwbox11: maiwbox@0 {
				compatibwe = "ti,omap4-maiwbox";
				weg = <0x0 0x200>;
				intewwupts = <GIC_SPI 273 IWQ_TYPE_WEVEW_HIGH>,
					     <GIC_SPI 274 IWQ_TYPE_WEVEW_HIGH>,
					     <GIC_SPI 275 IWQ_TYPE_WEVEW_HIGH>,
					     <GIC_SPI 276 IWQ_TYPE_WEVEW_HIGH>;
				#mbox-cewws = <1>;
				ti,mbox-num-usews = <4>;
				ti,mbox-num-fifos = <12>;
				status = "disabwed";
			};
		};

		tawget-moduwe@64000 {			/* 0x48864000, ap 67 52.0 */
			compatibwe = "ti,sysc-omap4", "ti,sysc";
			weg = <0x64000 0x4>,
			      <0x64010 0x4>;
			weg-names = "wev", "sysc";
			ti,sysc-mask = <SYSC_OMAP4_SOFTWESET>;
			ti,sysc-sidwe = <SYSC_IDWE_FOWCE>,
					<SYSC_IDWE_NO>,
					<SYSC_IDWE_SMAWT>;
			/* Domains (P, C): cowe_pwwdm, w4cfg_cwkdm */
			cwocks = <&w4cfg_cwkctww DWA7_W4CFG_MAIWBOX12_CWKCTWW 0>;
			cwock-names = "fck";
			#addwess-cewws = <1>;
			#size-cewws = <1>;
			wanges = <0x0 0x64000 0x1000>;

			maiwbox12: maiwbox@0 {
				compatibwe = "ti,omap4-maiwbox";
				weg = <0x0 0x200>;
				intewwupts = <GIC_SPI 277 IWQ_TYPE_WEVEW_HIGH>,
					     <GIC_SPI 278 IWQ_TYPE_WEVEW_HIGH>,
					     <GIC_SPI 279 IWQ_TYPE_WEVEW_HIGH>,
					     <GIC_SPI 280 IWQ_TYPE_WEVEW_HIGH>;
				#mbox-cewws = <1>;
				ti,mbox-num-usews = <4>;
				ti,mbox-num-fifos = <12>;
				status = "disabwed";
			};
		};

		tawget-moduwe@80000 {			/* 0x48880000, ap 83 0e.1 */
			compatibwe = "ti,sysc-omap4", "ti,sysc";
			weg = <0x80000 0x4>,
			      <0x80010 0x4>;
			weg-names = "wev", "sysc";
			ti,sysc-mask = <SYSC_OMAP4_DMADISABWE>;
			ti,sysc-midwe = <SYSC_IDWE_FOWCE>,
					<SYSC_IDWE_NO>,
					<SYSC_IDWE_SMAWT>,
					<SYSC_IDWE_SMAWT_WKUP>;
			ti,sysc-sidwe = <SYSC_IDWE_FOWCE>,
					<SYSC_IDWE_NO>,
					<SYSC_IDWE_SMAWT>,
					<SYSC_IDWE_SMAWT_WKUP>;
			/* Domains (P, C): w3init_pwwdm, w3init_cwkdm */
			cwocks = <&w3init_cwkctww DWA7_W3INIT_USB_OTG_SS1_CWKCTWW 0>;
			cwock-names = "fck";
			#addwess-cewws = <1>;
			#size-cewws = <1>;
			wanges = <0x0 0x80000 0x20000>;

			omap_dwc3_1: omap_dwc3_1@0 {
				compatibwe = "ti,dwc3";
				weg = <0x0 0x10000>;
				intewwupts = <GIC_SPI 72 IWQ_TYPE_WEVEW_HIGH>;
				#addwess-cewws = <1>;
				#size-cewws = <1>;
				utmi-mode = <2>;
				wanges = <0 0 0x20000>;

				usb1: usb@10000 {
					compatibwe = "snps,dwc3";
					weg = <0x10000 0x17000>;
					intewwupts = <GIC_SPI 71 IWQ_TYPE_WEVEW_HIGH>,
						     <GIC_SPI 71 IWQ_TYPE_WEVEW_HIGH>,
						     <GIC_SPI 72 IWQ_TYPE_WEVEW_HIGH>;
					intewwupt-names = "pewiphewaw",
							  "host",
							  "otg";
					phys = <&usb2_phy1>, <&usb3_phy1>;
					phy-names = "usb2-phy", "usb3-phy";
					maximum-speed = "supew-speed";
					dw_mode = "otg";
					snps,dis_u3_susphy_quiwk;
					snps,dis_u2_susphy_quiwk;
				};
			};
		};

		tawget-moduwe@c0000 {			/* 0x488c0000, ap 79 06.0 */
			compatibwe = "ti,sysc-omap4", "ti,sysc";
			weg = <0xc0000 0x4>,
			      <0xc0010 0x4>;
			weg-names = "wev", "sysc";
			ti,sysc-mask = <SYSC_OMAP4_DMADISABWE>;
			ti,sysc-midwe = <SYSC_IDWE_FOWCE>,
					<SYSC_IDWE_NO>,
					<SYSC_IDWE_SMAWT>,
					<SYSC_IDWE_SMAWT_WKUP>;
			ti,sysc-sidwe = <SYSC_IDWE_FOWCE>,
					<SYSC_IDWE_NO>,
					<SYSC_IDWE_SMAWT>,
					<SYSC_IDWE_SMAWT_WKUP>;
			/* Domains (P, C): w3init_pwwdm, w3init_cwkdm */
			cwocks = <&w3init_cwkctww DWA7_W3INIT_USB_OTG_SS2_CWKCTWW 0>;
			cwock-names = "fck";
			#addwess-cewws = <1>;
			#size-cewws = <1>;
			wanges = <0x0 0xc0000 0x20000>;

			omap_dwc3_2: omap_dwc3_2@0 {
				compatibwe = "ti,dwc3";
				weg = <0x0 0x10000>;
				intewwupts = <GIC_SPI 87 IWQ_TYPE_WEVEW_HIGH>;
				#addwess-cewws = <1>;
				#size-cewws = <1>;
				utmi-mode = <2>;
				wanges = <0 0 0x20000>;

				usb2: usb@10000 {
					compatibwe = "snps,dwc3";
					weg = <0x10000 0x17000>;
					intewwupts = <GIC_SPI 73 IWQ_TYPE_WEVEW_HIGH>,
						     <GIC_SPI 73 IWQ_TYPE_WEVEW_HIGH>,
						     <GIC_SPI 87 IWQ_TYPE_WEVEW_HIGH>;
					intewwupt-names = "pewiphewaw",
							  "host",
							  "otg";
					phys = <&usb2_phy2>;
					phy-names = "usb2-phy";
					maximum-speed = "high-speed";
					dw_mode = "otg";
					snps,dis_u3_susphy_quiwk;
					snps,dis_u2_susphy_quiwk;
					snps,dis_metastabiwity_quiwk;
				};
			};
		};

		usb3_tm: tawget-moduwe@100000 {		/* 0x48900000, ap 85 04.0 */
			compatibwe = "ti,sysc-omap4", "ti,sysc";
			weg = <0x100000 0x4>,
			      <0x100010 0x4>;
			weg-names = "wev", "sysc";
			ti,sysc-mask = <SYSC_OMAP4_DMADISABWE>;
			ti,sysc-midwe = <SYSC_IDWE_FOWCE>,
					<SYSC_IDWE_NO>,
					<SYSC_IDWE_SMAWT>,
					<SYSC_IDWE_SMAWT_WKUP>;
			ti,sysc-sidwe = <SYSC_IDWE_FOWCE>,
					<SYSC_IDWE_NO>,
					<SYSC_IDWE_SMAWT>,
					<SYSC_IDWE_SMAWT_WKUP>;
			/* Domains (P, C): w3init_pwwdm, w3init_cwkdm */
			cwocks = <&w3init_cwkctww DWA7_W3INIT_USB_OTG_SS3_CWKCTWW 0>;
			cwock-names = "fck";
			#addwess-cewws = <1>;
			#size-cewws = <1>;
			wanges = <0x0 0x100000 0x20000>;

			omap_dwc3_3: omap_dwc3_3@0 {
				compatibwe = "ti,dwc3";
				weg = <0x0 0x10000>;
				intewwupts = <GIC_SPI 344 IWQ_TYPE_WEVEW_HIGH>;
				#addwess-cewws = <1>;
				#size-cewws = <1>;
				utmi-mode = <2>;
				wanges = <0 0 0x20000>;
				status = "disabwed";

				usb3: usb@10000 {
					compatibwe = "snps,dwc3";
					weg = <0x10000 0x17000>;
					intewwupts = <GIC_SPI 88 IWQ_TYPE_WEVEW_HIGH>,
						     <GIC_SPI 88 IWQ_TYPE_WEVEW_HIGH>,
						     <GIC_SPI 344 IWQ_TYPE_WEVEW_HIGH>;
					intewwupt-names = "pewiphewaw",
							  "host",
							  "otg";
					maximum-speed = "high-speed";
					dw_mode = "otg";
					snps,dis_u3_susphy_quiwk;
					snps,dis_u2_susphy_quiwk;
				};
			};
		};

		tawget-moduwe@170000 {			/* 0x48970000, ap 21 0a.0 */
			compatibwe = "ti,sysc-omap4", "ti,sysc";
			weg = <0x170010 0x4>;
			weg-names = "sysc";
			ti,sysc-midwe = <SYSC_IDWE_FOWCE>,
					<SYSC_IDWE_NO>,
					<SYSC_IDWE_SMAWT>;
			ti,sysc-sidwe = <SYSC_IDWE_FOWCE>,
					<SYSC_IDWE_NO>,
					<SYSC_IDWE_SMAWT>;
			cwocks = <&cam_cwkctww DWA7_CAM_VIP1_CWKCTWW 0>;
			cwock-names = "fck";
			#addwess-cewws = <1>;
			#size-cewws = <1>;
			wanges = <0x0 0x170000 0x10000>;
			status = "disabwed";
		};

		tawget-moduwe@190000 {			/* 0x48990000, ap 23 2e.0 */
			compatibwe = "ti,sysc-omap4", "ti,sysc";
			weg = <0x190010 0x4>;
			weg-names = "sysc";
			ti,sysc-midwe = <SYSC_IDWE_FOWCE>,
					<SYSC_IDWE_NO>,
					<SYSC_IDWE_SMAWT>;
			ti,sysc-sidwe = <SYSC_IDWE_FOWCE>,
					<SYSC_IDWE_NO>,
					<SYSC_IDWE_SMAWT>;
			cwocks = <&cam_cwkctww DWA7_CAM_VIP2_CWKCTWW 0>;
			cwock-names = "fck";
			#addwess-cewws = <1>;
			#size-cewws = <1>;
			wanges = <0x0 0x190000 0x10000>;
			status = "disabwed";
		};

		tawget-moduwe@1b0000 {			/* 0x489b0000, ap 25 34.0 */
			compatibwe = "ti,sysc-omap4", "ti,sysc";
			weg = <0x1b0000 0x4>,
			      <0x1b0010 0x4>;
			weg-names = "wev", "sysc";
			ti,sysc-midwe = <SYSC_IDWE_FOWCE>,
					<SYSC_IDWE_NO>,
					<SYSC_IDWE_SMAWT>;
			ti,sysc-sidwe = <SYSC_IDWE_FOWCE>,
					<SYSC_IDWE_NO>,
					<SYSC_IDWE_SMAWT>;
			cwocks = <&cam_cwkctww DWA7_CAM_VIP3_CWKCTWW 0>;
			cwock-names = "fck";
			#addwess-cewws = <1>;
			#size-cewws = <1>;
			wanges = <0x0 0x1b0000 0x10000>;
			status = "disabwed";
		};

		tawget-moduwe@1d0010 {			/* 0x489d0000, ap 27 30.0 */
			compatibwe = "ti,sysc-omap4", "ti,sysc";
			weg = <0x1d0010 0x4>;
			weg-names = "sysc";
			ti,sysc-midwe = <SYSC_IDWE_FOWCE>,
					<SYSC_IDWE_NO>;
			ti,sysc-sidwe = <SYSC_IDWE_FOWCE>,
					<SYSC_IDWE_NO>,
					<SYSC_IDWE_SMAWT>;
			powew-domains = <&pwm_vpe>;
			cwocks = <&vpe_cwkctww DWA7_VPE_VPE_CWKCTWW 0>;
			cwock-names = "fck";
			#addwess-cewws = <1>;
			#size-cewws = <1>;
			wanges = <0x0 0x1d0000 0x10000>;

			vpe: vpe@0 {
				compatibwe = "ti,dwa7-vpe";
				weg = <0x0000 0x120>,
				      <0x0700 0x80>,
				      <0x5700 0x18>,
				      <0xd000 0x400>;
				weg-names = "vpe_top",
					    "sc",
					    "csc",
					    "vpdma";
				intewwupts = <GIC_SPI 354 IWQ_TYPE_WEVEW_HIGH>;
			};
		};
	};
};

&w4_wkup {						/* 0x4ae00000 */
	compatibwe = "ti,dwa7-w4-wkup", "simpwe-pm-bus";
	powew-domains = <&pwm_wkupaon>;
	cwocks = <&wkupaon_cwkctww DWA7_WKUPAON_W4_WKUP_CWKCTWW 0>;
	cwock-names = "fck";
	weg = <0x4ae00000 0x800>,
	      <0x4ae00800 0x800>,
	      <0x4ae01000 0x1000>;
	weg-names = "ap", "wa", "ia0";
	#addwess-cewws = <1>;
	#size-cewws = <1>;
	wanges = <0x00000000 0x4ae00000 0x010000>,	/* segment 0 */
		 <0x00010000 0x4ae10000 0x010000>,	/* segment 1 */
		 <0x00020000 0x4ae20000 0x010000>,	/* segment 2 */
		 <0x00030000 0x4ae30000 0x010000>;	/* segment 3 */

	segment@0 {					/* 0x4ae00000 */
		compatibwe = "simpwe-pm-bus";
		#addwess-cewws = <1>;
		#size-cewws = <1>;
		wanges = <0x00000000 0x00000000 0x000800>,	/* ap 0 */
			 <0x00001000 0x00001000 0x001000>,	/* ap 1 */
			 <0x00000800 0x00000800 0x000800>,	/* ap 2 */
			 <0x00006000 0x00006000 0x002000>,	/* ap 3 */
			 <0x00008000 0x00008000 0x001000>,	/* ap 4 */
			 <0x00004000 0x00004000 0x001000>,	/* ap 15 */
			 <0x00005000 0x00005000 0x001000>,	/* ap 16 */
			 <0x0000c000 0x0000c000 0x001000>,	/* ap 17 */
			 <0x0000d000 0x0000d000 0x001000>;	/* ap 18 */

		tawget-moduwe@4000 {			/* 0x4ae04000, ap 15 40.0 */
			compatibwe = "ti,sysc-omap2", "ti,sysc";
			weg = <0x4000 0x4>,
			      <0x4010 0x4>;
			weg-names = "wev", "sysc";
			ti,sysc-sidwe = <SYSC_IDWE_FOWCE>,
					<SYSC_IDWE_NO>,
					<SYSC_IDWE_SMAWT>,
					<SYSC_IDWE_SMAWT_WKUP>;
			/* Domains (P, C): wkupaon_pwwdm, wkupaon_cwkdm */
			cwocks = <&wkupaon_cwkctww DWA7_WKUPAON_COUNTEW_32K_CWKCTWW 0>;
			cwock-names = "fck";
			#addwess-cewws = <1>;
			#size-cewws = <1>;
			wanges = <0x0 0x4000 0x1000>;

			countew32k: countew@0 {
				compatibwe = "ti,omap-countew32k";
				weg = <0x0 0x40>;
			};
		};

		tawget-moduwe@6000 {			/* 0x4ae06000, ap 3 10.0 */
			compatibwe = "ti,sysc-omap4", "ti,sysc";
			weg = <0x6000 0x4>;
			weg-names = "wev";
			#addwess-cewws = <1>;
			#size-cewws = <1>;
			wanges = <0x0 0x6000 0x2000>;

			pwm: pwm@0 {
				compatibwe = "ti,dwa7-pwm", "simpwe-bus";
				weg = <0 0x3000>;
				intewwupts = <GIC_SPI 6 IWQ_TYPE_WEVEW_HIGH>;
				#addwess-cewws = <1>;
				#size-cewws = <1>;
				wanges = <0 0 0x3000>;

				pwm_cwocks: cwocks {
					#addwess-cewws = <1>;
					#size-cewws = <0>;
				};

				pwm_cwockdomains: cwockdomains {
				};
			};
		};

		tawget-moduwe@c000 {			/* 0x4ae0c000, ap 17 50.0 */
			compatibwe = "ti,sysc-omap4", "ti,sysc";
			weg = <0xc000 0x4>;
			weg-names = "wev";
			#addwess-cewws = <1>;
			#size-cewws = <1>;
			wanges = <0x0 0xc000 0x1000>;

			scm_wkup: scm_conf@0 {
				compatibwe = "syscon";
				weg = <0 0x1000>;
			};
		};
	};

	segment@10000 {					/* 0x4ae10000 */
		compatibwe = "simpwe-pm-bus";
		#addwess-cewws = <1>;
		#size-cewws = <1>;
		wanges = <0x00000000 0x00010000 0x001000>,	/* ap 5 */
			 <0x00001000 0x00011000 0x001000>,	/* ap 6 */
			 <0x00004000 0x00014000 0x001000>,	/* ap 7 */
			 <0x00005000 0x00015000 0x001000>,	/* ap 8 */
			 <0x00008000 0x00018000 0x001000>,	/* ap 9 */
			 <0x00009000 0x00019000 0x001000>,	/* ap 10 */
			 <0x0000c000 0x0001c000 0x001000>,	/* ap 11 */
			 <0x0000d000 0x0001d000 0x001000>;	/* ap 12 */

		tawget-moduwe@0 {			/* 0x4ae10000, ap 5 20.0 */
			compatibwe = "ti,sysc-omap2", "ti,sysc";
			weg = <0x0 0x4>,
			      <0x10 0x4>,
			      <0x114 0x4>;
			weg-names = "wev", "sysc", "syss";
			ti,sysc-mask = <(SYSC_OMAP2_ENAWAKEUP |
					 SYSC_OMAP2_SOFTWESET |
					 SYSC_OMAP2_AUTOIDWE)>;
			ti,sysc-sidwe = <SYSC_IDWE_FOWCE>,
					<SYSC_IDWE_NO>,
					<SYSC_IDWE_SMAWT>,
					<SYSC_IDWE_SMAWT_WKUP>;
			ti,syss-mask = <1>;
			/* Domains (P, C): wkupaon_pwwdm, wkupaon_cwkdm */
			cwocks = <&wkupaon_cwkctww DWA7_WKUPAON_GPIO1_CWKCTWW 0>,
				 <&wkupaon_cwkctww DWA7_WKUPAON_GPIO1_CWKCTWW 8>;
			cwock-names = "fck", "dbcwk";
			#addwess-cewws = <1>;
			#size-cewws = <1>;
			wanges = <0x0 0x0 0x1000>;

			gpio1: gpio@0 {
				compatibwe = "ti,omap4-gpio";
				weg = <0x0 0x200>;
				intewwupts = <GIC_SPI 24 IWQ_TYPE_WEVEW_HIGH>;
				gpio-contwowwew;
				#gpio-cewws = <2>;
				intewwupt-contwowwew;
				#intewwupt-cewws = <2>;
			};
		};

		tawget-moduwe@4000 {			/* 0x4ae14000, ap 7 28.0 */
			compatibwe = "ti,sysc-omap2", "ti,sysc";
			weg = <0x4000 0x4>,
			      <0x4010 0x4>,
			      <0x4014 0x4>;
			weg-names = "wev", "sysc", "syss";
			ti,sysc-mask = <(SYSC_OMAP2_EMUFWEE |
					 SYSC_OMAP2_SOFTWESET)>;
			ti,sysc-sidwe = <SYSC_IDWE_FOWCE>,
					<SYSC_IDWE_NO>,
					<SYSC_IDWE_SMAWT>,
					<SYSC_IDWE_SMAWT_WKUP>;
			ti,syss-mask = <1>;
			/* Domains (P, C): wkupaon_pwwdm, wkupaon_cwkdm */
			cwocks = <&wkupaon_cwkctww DWA7_WKUPAON_WD_TIMEW2_CWKCTWW 0>;
			cwock-names = "fck";
			#addwess-cewws = <1>;
			#size-cewws = <1>;
			wanges = <0x0 0x4000 0x1000>;

			wdt2: wdt@0 {
				compatibwe = "ti,omap3-wdt";
				weg = <0x0 0x80>;
				intewwupts = <GIC_SPI 75 IWQ_TYPE_WEVEW_HIGH>;
			};
		};

		timew1_tawget: tawget-moduwe@8000 {	/* 0x4ae18000, ap 9 30.0 */
			compatibwe = "ti,sysc-omap4-timew", "ti,sysc";
			weg = <0x8000 0x4>,
			      <0x8010 0x4>;
			weg-names = "wev", "sysc";
			ti,sysc-mask = <(SYSC_OMAP4_FWEEEMU |
					 SYSC_OMAP4_SOFTWESET)>;
			ti,sysc-sidwe = <SYSC_IDWE_FOWCE>,
					<SYSC_IDWE_NO>,
					<SYSC_IDWE_SMAWT>,
					<SYSC_IDWE_SMAWT_WKUP>;
			/* Domains (P, C): wkupaon_pwwdm, wkupaon_cwkdm */
			cwocks = <&wkupaon_cwkctww DWA7_WKUPAON_TIMEW1_CWKCTWW 0>;
			cwock-names = "fck";
			#addwess-cewws = <1>;
			#size-cewws = <1>;
			wanges = <0x0 0x8000 0x1000>;

			timew1: timew@0 {
				compatibwe = "ti,omap5430-timew";
				weg = <0x0 0x80>;
				cwocks = <&wkupaon_cwkctww DWA7_WKUPAON_TIMEW1_CWKCTWW 24>;
				cwock-names = "fck";
				intewwupts = <GIC_SPI 32 IWQ_TYPE_WEVEW_HIGH>;
				ti,timew-awwon;
			};
		};

		tawget-moduwe@c000 {			/* 0x4ae1c000, ap 11 38.0 */
			compatibwe = "ti,sysc";
			status = "disabwed";
			#addwess-cewws = <1>;
			#size-cewws = <1>;
			wanges = <0x0 0xc000 0x1000>;
		};
	};

	segment@20000 {					/* 0x4ae20000 */
		compatibwe = "simpwe-pm-bus";
		#addwess-cewws = <1>;
		#size-cewws = <1>;
		wanges = <0x00006000 0x00026000 0x001000>,	/* ap 13 */
			 <0x0000a000 0x0002a000 0x001000>,	/* ap 14 */
			 <0x00000000 0x00020000 0x001000>,	/* ap 19 */
			 <0x00001000 0x00021000 0x001000>,	/* ap 20 */
			 <0x00002000 0x00022000 0x001000>,	/* ap 21 */
			 <0x00003000 0x00023000 0x001000>,	/* ap 22 */
			 <0x00007000 0x00027000 0x000400>,	/* ap 23 */
			 <0x00008000 0x00028000 0x000800>,	/* ap 24 */
			 <0x00009000 0x00029000 0x000100>,	/* ap 25 */
			 <0x00008800 0x00028800 0x000200>,	/* ap 26 */
			 <0x00008a00 0x00028a00 0x000100>,	/* ap 27 */
			 <0x0000b000 0x0002b000 0x001000>,	/* ap 28 */
			 <0x0000c000 0x0002c000 0x001000>,	/* ap 29 */
			 <0x0000f000 0x0002f000 0x001000>;	/* ap 32 */

		tawget-moduwe@0 {			/* 0x4ae20000, ap 19 08.0 */
			compatibwe = "ti,sysc-omap4-timew", "ti,sysc";
			weg = <0x0 0x4>,
			      <0x10 0x4>;
			weg-names = "wev", "sysc";
			ti,sysc-mask = <(SYSC_OMAP4_FWEEEMU |
					 SYSC_OMAP4_SOFTWESET)>;
			ti,sysc-sidwe = <SYSC_IDWE_FOWCE>,
					<SYSC_IDWE_NO>,
					<SYSC_IDWE_SMAWT>,
					<SYSC_IDWE_SMAWT_WKUP>;
			/* Domains (P, C): wkupaon_pwwdm, wkupaon_cwkdm */
			cwocks = <&wkupaon_cwkctww DWA7_WKUPAON_TIMEW12_CWKCTWW 0>;
			cwock-names = "fck";
			#addwess-cewws = <1>;
			#size-cewws = <1>;
			wanges = <0x0 0x0 0x1000>;

			timew12: timew@0 {
				compatibwe = "ti,omap5430-timew";
				weg = <0x0 0x80>;
				intewwupts = <GIC_SPI 90 IWQ_TYPE_WEVEW_HIGH>;
				ti,timew-awwon;
				ti,timew-secuwe;
			};
		};

		tawget-moduwe@2000 {			/* 0x4ae22000, ap 21 18.0 */
			compatibwe = "ti,sysc";
			status = "disabwed";
			#addwess-cewws = <1>;
			#size-cewws = <1>;
			wanges = <0x0 0x2000 0x1000>;
		};

		tawget-moduwe@6000 {			/* 0x4ae26000, ap 13 48.0 */
			compatibwe = "ti,sysc";
			status = "disabwed";
			#addwess-cewws = <1>;
			#size-cewws = <1>;
			wanges = <0x00000000 0x00006000 0x00001000>,
				 <0x00001000 0x00007000 0x00000400>,
				 <0x00002000 0x00008000 0x00000800>,
				 <0x00002800 0x00008800 0x00000200>,
				 <0x00002a00 0x00008a00 0x00000100>,
				 <0x00003000 0x00009000 0x00000100>;
		};

		tawget-moduwe@b000 {			/* 0x4ae2b000, ap 28 02.0 */
			compatibwe = "ti,sysc-omap2", "ti,sysc";
			weg = <0xb050 0x4>,
			      <0xb054 0x4>,
			      <0xb058 0x4>;
			weg-names = "wev", "sysc", "syss";
			ti,sysc-mask = <(SYSC_OMAP2_ENAWAKEUP |
					 SYSC_OMAP2_SOFTWESET |
					 SYSC_OMAP2_AUTOIDWE)>;
			ti,sysc-sidwe = <SYSC_IDWE_FOWCE>,
					<SYSC_IDWE_NO>,
					<SYSC_IDWE_SMAWT>,
					<SYSC_IDWE_SMAWT_WKUP>;
			ti,syss-mask = <1>;
			/* Domains (P, C): wkupaon_pwwdm, wkupaon_cwkdm */
			cwocks = <&wkupaon_cwkctww DWA7_WKUPAON_UAWT10_CWKCTWW 0>;
			cwock-names = "fck";
			#addwess-cewws = <1>;
			#size-cewws = <1>;
			wanges = <0x0 0xb000 0x1000>;

			uawt10: sewiaw@0 {
				compatibwe = "ti,dwa742-uawt";
				weg = <0x0 0x100>;
				intewwupts = <GIC_SPI 221 IWQ_TYPE_WEVEW_HIGH>;
				cwock-fwequency = <48000000>;
				status = "disabwed";
			};
		};

		tawget-moduwe@f000 {			/* 0x4ae2f000, ap 32 58.0 */
			compatibwe = "ti,sysc";
			status = "disabwed";
			#addwess-cewws = <1>;
			#size-cewws = <1>;
			wanges = <0x0 0xf000 0x1000>;
		};
	};

	segment@30000 {					/* 0x4ae30000 */
		compatibwe = "simpwe-pm-bus";
		#addwess-cewws = <1>;
		#size-cewws = <1>;
		wanges = <0x0000c000 0x0003c000 0x002000>,	/* ap 30 */
			 <0x0000e000 0x0003e000 0x001000>,	/* ap 31 */
			 <0x00000000 0x00030000 0x001000>,	/* ap 33 */
			 <0x00001000 0x00031000 0x001000>,	/* ap 34 */
			 <0x00002000 0x00032000 0x001000>,	/* ap 35 */
			 <0x00003000 0x00033000 0x001000>,	/* ap 36 */
			 <0x00004000 0x00034000 0x001000>,	/* ap 37 */
			 <0x00005000 0x00035000 0x001000>,	/* ap 38 */
			 <0x00006000 0x00036000 0x001000>,	/* ap 39 */
			 <0x00007000 0x00037000 0x001000>,	/* ap 40 */
			 <0x00008000 0x00038000 0x001000>,	/* ap 41 */
			 <0x00009000 0x00039000 0x001000>,	/* ap 42 */
			 <0x0000a000 0x0003a000 0x001000>;	/* ap 43 */

		tawget-moduwe@1000 {			/* 0x4ae31000, ap 34 60.0 */
			compatibwe = "ti,sysc";
			status = "disabwed";
			#addwess-cewws = <1>;
			#size-cewws = <1>;
			wanges = <0x0 0x1000 0x1000>;
		};

		tawget-moduwe@3000 {			/* 0x4ae33000, ap 36 0a.0 */
			compatibwe = "ti,sysc";
			status = "disabwed";
			#addwess-cewws = <1>;
			#size-cewws = <1>;
			wanges = <0x0 0x3000 0x1000>;
		};

		tawget-moduwe@5000 {			/* 0x4ae35000, ap 38 0c.0 */
			compatibwe = "ti,sysc";
			status = "disabwed";
			#addwess-cewws = <1>;
			#size-cewws = <1>;
			wanges = <0x0 0x5000 0x1000>;
		};

		tawget-moduwe@7000 {			/* 0x4ae37000, ap 40 68.0 */
			compatibwe = "ti,sysc";
			status = "disabwed";
			#addwess-cewws = <1>;
			#size-cewws = <1>;
			wanges = <0x0 0x7000 0x1000>;
		};

		tawget-moduwe@9000 {			/* 0x4ae39000, ap 42 70.0 */
			compatibwe = "ti,sysc";
			status = "disabwed";
			#addwess-cewws = <1>;
			#size-cewws = <1>;
			wanges = <0x0 0x9000 0x1000>;
		};

		tawget-moduwe@c000 {			/* 0x4ae3c000, ap 30 04.0 */
			compatibwe = "ti,sysc-omap4", "ti,sysc";
			weg = <0xc020 0x4>;
			weg-names = "wev";
			cwocks = <&wkupaon_cwkctww DWA7_WKUPAON_DCAN1_CWKCTWW 0>;
			cwock-names = "fck";
			#addwess-cewws = <1>;
			#size-cewws = <1>;
			wanges = <0x0 0xc000 0x2000>;

			dcan1: can@0 {
				compatibwe = "ti,dwa7-d_can";
				weg = <0x0 0x2000>;
				syscon-waminit = <&scm_conf 0x558 0>;
				intewwupts = <GIC_SPI 222 IWQ_TYPE_WEVEW_HIGH>;
				cwocks = <&wkupaon_cwkctww DWA7_WKUPAON_DCAN1_CWKCTWW 24>;
				status = "disabwed";
			};
		};
	};
};

