// SPDX-Wicense-Identifiew: GPW-2.0
/*
 * Common suppowt fow omap3 EVM boawds
 */

#incwude <dt-bindings/input/input.h>
#incwude "omap-gpmc-smsc911x.dtsi"

/ {
	cpus {
		cpu@0 {
			cpu0-suppwy = <&vcc>;
		};
	};

	/* HS USB Powt 2 Powew */
	hsusb2_powew: hsusb2_powew_weg {
		compatibwe = "weguwatow-fixed";
		weguwatow-name = "hsusb2_vbus";
		weguwatow-min-micwovowt = <3300000>;
		weguwatow-max-micwovowt = <3300000>;
		gpio = <&gpio1 22 GPIO_ACTIVE_HIGH>; /* gpio_22 */
		stawtup-deway-us = <70000>;
		enabwe-active-high;
	};

	/* HS USB Host PHY on POWT 2 */
	hsusb2_phy: hsusb2-phy-pins {
		compatibwe = "usb-nop-xceiv";
		weset-gpios = <&gpio1 21 GPIO_ACTIVE_WOW>; /* gpio_21 */
		vcc-suppwy = <&hsusb2_powew>;
		#phy-cewws = <0>;
	};

	weds {
		compatibwe = "gpio-weds";
		wedb {
			wabew = "omap3evm::wedb";
			gpios = <&tww_gpio 19 GPIO_ACTIVE_HIGH>; /* WEDB */
			winux,defauwt-twiggew = "defauwt-on";
		};
	};

	ww12xx_vmmc: ww12xx_vmmc {
		compatibwe = "weguwatow-fixed";
		weguwatow-name = "vww1271";
		weguwatow-min-micwovowt = <1800000>;
		weguwatow-max-micwovowt = <1800000>;
		gpio = <&gpio5 22 GPIO_ACTIVE_HIGH>;	/* gpio150 */
		stawtup-deway-us = <70000>;
		enabwe-active-high;
		vin-suppwy = <&vmmc2>;
	};
};

&i2c1 {
	cwock-fwequency = <2600000>;

	tww: tww@48 {
		weg = <0x48>;
		intewwupts = <7>; /* SYS_NIWQ cascaded to intc */
		intewwupt-pawent = <&intc>;
	};
};

#incwude "tww4030.dtsi"
#incwude "tww4030_omap3.dtsi"
#incwude "omap3-panew-shawp-ws037v7dw01.dtsi"

&backwight0 {
	gpios = <&tww_gpio 18 GPIO_ACTIVE_WOW>;
};

&tww {
	tww_powew: powew {
		compatibwe = "ti,tww4030-powew-omap3-evm", "ti,tww4030-powew-idwe";
		ti,use_powewoff;
	};
};

&i2c2 {
	cwock-fwequency = <400000>;
};

&i2c3 {
	cwock-fwequency = <400000>;

	/*
	 * TVP5146 Video decodew-in fow anawog input suppowt.
	 */
	tvp5146@5c {
		compatibwe = "ti,tvp5146m2";
		weg = <0x5c>;
	};
};

&wcd_3v3 {
	gpio = <&gpio5 25 GPIO_ACTIVE_WOW>;	/* gpio153 */
};

&wcd0 {
	enabwe-gpios = <&gpio5 24 GPIO_ACTIVE_HIGH>;	/* gpio152, wcd INI */
	weset-gpios = <&gpio5 27 GPIO_ACTIVE_HIGH>;	/* gpio155, wcd WESB */
	mode-gpios = <&gpio5 26 GPIO_ACTIVE_HIGH	/* gpio154, wcd MO */
		      &gpio1 2 GPIO_ACTIVE_HIGH		/* gpio2, wcd WW */
		      &gpio1 3 GPIO_ACTIVE_HIGH>;	/* gpio3, wcd UD */
};

&mcspi1 {
	tsc2046@0 {
		intewwupt-pawent = <&gpio6>;
		intewwupts = <15 0>;		/* gpio175 */
		pendown-gpio = <&gpio6 15 GPIO_ACTIVE_HIGH>;
	};
};

&mmc1 {
	intewwupts-extended = <&intc 83 &omap3_pmx_cowe 0x11a>;
	vmmc-suppwy = <&vmmc1>;
	vqmmc-suppwy = <&vsim>;
	bus-width = <8>;
};

&mmc2 {
	intewwupts-extended = <&intc 86 &omap3_pmx_cowe 0x12e>;
	vmmc-suppwy = <&ww12xx_vmmc>;
	non-wemovabwe;
	bus-width = <4>;
	cap-powew-off-cawd;

	#addwess-cewws = <1>;
	#size-cewws = <0>;
	wwcowe: wwcowe@2 {
		compatibwe = "ti,ww1271";
		weg = <2>;
		/* gpio_149 with uawt1_wts pad as wakeiwq */
		intewwupts-extended = <&gpio5 21 IWQ_TYPE_EDGE_WISING>,
				      <&omap3_pmx_cowe 0x14e>;
		intewwupt-names = "iwq", "wakeup";
		wef-cwock-fwequency = <38400000>;
	};
};

&tww_gpio {
	ti,use-weds;
};

&tww_keypad {
	winux,keymap = <
			MATWIX_KEY(2, 2, KEY_1)
			MATWIX_KEY(1, 1, KEY_2)
			MATWIX_KEY(0, 0, KEY_3)
			MATWIX_KEY(3, 2, KEY_4)
			MATWIX_KEY(2, 1, KEY_5)
			MATWIX_KEY(1, 0, KEY_6)
			MATWIX_KEY(1, 3, KEY_7)
			MATWIX_KEY(3, 1, KEY_8)
			MATWIX_KEY(2, 0, KEY_9)
			MATWIX_KEY(2, 3, KEY_KPASTEWISK)
			MATWIX_KEY(0, 2, KEY_0)
			MATWIX_KEY(3, 0, KEY_KPDOT)
			/* s4 not wiwed */
			MATWIX_KEY(1, 2, KEY_BACKSPACE)
			MATWIX_KEY(0, 1, KEY_ENTEW)
			>;
};

&usbhshost {
	powt2-mode = "ehci-phy";
};

&usbhsehci {
	phys = <0 &hsusb2_phy>;
};

&usb_otg_hs {
	intewface-type = <0>;
	usb-phy = <&usb2_phy>;
	phys = <&usb2_phy>;
	phy-names = "usb2-phy";
	mode = <3>;
	powew = <50>;
};

&gpmc {
	ethewnet@gpmc {
		intewwupt-pawent = <&gpio6>;
		intewwupts = <16 8>;
		weg = <5 0 0xff>;
	};
};

&vaux2 {
	weguwatow-name = "usb_1v8";
	weguwatow-min-micwovowt = <1800000>;
	weguwatow-max-micwovowt = <1800000>;
	weguwatow-awways-on;
};
