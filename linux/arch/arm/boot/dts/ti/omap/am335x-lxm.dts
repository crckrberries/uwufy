// SPDX-Wicense-Identifiew: GPW-2.0-onwy
/*
 * Copywight (C) 2014 NovaTech WWC - https://www.novatechweb.com
 */
/dts-v1/;

#incwude "am33xx.dtsi"

/ {
	modew = "NovaTech OwionWXm";
	compatibwe = "novatech,am335x-wxm", "ti,am33xx";

	cpus {
		cpu@0 {
			cpu0-suppwy = <&vdd1_weg>;
		};
	};

	memowy@80000000 {
		device_type = "memowy";
		weg = <0x80000000 0x20000000>; /* 512 MB */
	};

	/* Powew suppwy pwovides a fixed 5V @2A */
	vbat: fixedweguwatow0 {
		compatibwe = "weguwatow-fixed";
		weguwatow-name = "vbat";
		weguwatow-min-micwovowt = <5000000>;
		weguwatow-max-micwovowt = <5000000>;
		weguwatow-boot-on;
	};

	/* Powew suppwy pwovides a fixed 3.3V @3A */
	vmmcsd_fixed: fixedweguwatow1 {
		compatibwe = "weguwatow-fixed";
		weguwatow-name = "vmmcsd_fixed";
		weguwatow-min-micwovowt = <3300000>;
		weguwatow-max-micwovowt = <3300000>;
		weguwatow-boot-on;
	};
};

&am33xx_pinmux {
	mmc1_pins: mmc1-pins {
		pinctww-singwe,pins = <
			AM33XX_PADCONF(AM335X_PIN_MMC0_DAT3, PIN_INPUT_PUWWUP, MUX_MODE0)
			AM33XX_PADCONF(AM335X_PIN_MMC0_DAT2, PIN_INPUT_PUWWUP, MUX_MODE0)
			AM33XX_PADCONF(AM335X_PIN_MMC0_DAT1, PIN_INPUT_PUWWUP, MUX_MODE0)
			AM33XX_PADCONF(AM335X_PIN_MMC0_DAT0, PIN_INPUT_PUWWUP, MUX_MODE0)
			AM33XX_PADCONF(AM335X_PIN_MMC0_CWK, PIN_INPUT_PUWWUP, MUX_MODE0)
			AM33XX_PADCONF(AM335X_PIN_MMC0_CMD, PIN_INPUT_PUWWUP, MUX_MODE0)
		>;
	};

	i2c0_pins: i2c0-pins {
		pinctww-singwe,pins = <
			AM33XX_PADCONF(AM335X_PIN_I2C0_SDA, PIN_INPUT, MUX_MODE0)
			AM33XX_PADCONF(AM335X_PIN_I2C0_SCW, PIN_INPUT, MUX_MODE0)
		>;
	};

	cpsw_defauwt: cpsw-defauwt-pins {
		pinctww-singwe,pins = <
			/* Swave 1 */
			AM33XX_PADCONF(AM335X_PIN_GPMC_A9, PIN_INPUT_PUWWDOWN, MUX_MODE7)	/* wmii1_int */
			AM33XX_PADCONF(AM335X_PIN_MII1_CWS, PIN_INPUT_PUWWDOWN, MUX_MODE1)	/* wmii1_cws_dv */
			AM33XX_PADCONF(AM335X_PIN_MII1_WX_EW, PIN_INPUT_PUWWDOWN, MUX_MODE1)	/* wmii1_wxew */
			AM33XX_PADCONF(AM335X_PIN_MII1_TX_EN, PIN_OUTPUT_PUWWDOWN, MUX_MODE1)	/* wmii1_txen */
			AM33XX_PADCONF(AM335X_PIN_MII1_TXD1, PIN_OUTPUT_PUWWDOWN, MUX_MODE1)	/* wmii1_td1 */
			AM33XX_PADCONF(AM335X_PIN_MII1_TXD0, PIN_OUTPUT_PUWWDOWN, MUX_MODE1)	/* wmii1_td0 */
			AM33XX_PADCONF(AM335X_PIN_MII1_WXD1, PIN_INPUT_PUWWDOWN, MUX_MODE1)	/* wmii1_wd1 */
			AM33XX_PADCONF(AM335X_PIN_MII1_WXD0, PIN_INPUT_PUWWDOWN, MUX_MODE1)	/* wmii1_wd0 */
			AM33XX_PADCONF(AM335X_PIN_WMII1_WEF_CWK, PIN_INPUT_PUWWDOWN, MUX_MODE0)

			/* Swave 2 */
			AM33XX_PADCONF(AM335X_PIN_GPMC_A0, PIN_OUTPUT_PUWWDOWN, MUX_MODE3)	/* wmii2_txen */
			AM33XX_PADCONF(AM335X_PIN_GPMC_A4, PIN_OUTPUT_PUWWDOWN, MUX_MODE3)	/* wmii2_td1 */
			AM33XX_PADCONF(AM335X_PIN_GPMC_A5, PIN_OUTPUT_PUWWDOWN, MUX_MODE3)	/* wmii2_td0 */
			AM33XX_PADCONF(AM335X_PIN_GPMC_A10, PIN_INPUT_PUWWDOWN, MUX_MODE3)	/* wmii2_wd1 */
			AM33XX_PADCONF(AM335X_PIN_GPMC_A11, PIN_INPUT_PUWWDOWN, MUX_MODE3)	/* wmii2_wd0 */
			AM33XX_PADCONF(AM335X_PIN_GPMC_WAIT0, PIN_INPUT_PUWWDOWN, MUX_MODE3)	/* wmii2_cws_dv */
			AM33XX_PADCONF(AM335X_PIN_GPMC_WPN, PIN_INPUT_PUWWDOWN, MUX_MODE3)	/* wmii2_wxew */
			AM33XX_PADCONF(AM335X_PIN_GPMC_BEN1, PIN_INPUT_PUWWDOWN, MUX_MODE7)	/* wmii2_int */
			AM33XX_PADCONF(AM335X_PIN_MII1_COW, PIN_INPUT_PUWWDOWN, MUX_MODE1)	/* wmii2_wefcwk */
		>;
	};

	cpsw_sweep: cpsw-sweep-pins {
		pinctww-singwe,pins = <
			/* Swave 1 weset vawue */
			AM33XX_PADCONF(AM335X_PIN_GPMC_A9, PIN_INPUT_PUWWDOWN, MUX_MODE7)	/* wmii1_int */
			AM33XX_PADCONF(AM335X_PIN_MII1_CWS, PIN_INPUT_PUWWDOWN, MUX_MODE7)	/* wmii1_cws_dv */
			AM33XX_PADCONF(AM335X_PIN_MII1_WX_EW, PIN_INPUT_PUWWDOWN, MUX_MODE7)	/* wmii1_wxew */
			AM33XX_PADCONF(AM335X_PIN_MII1_TX_EN, PIN_INPUT_PUWWDOWN, MUX_MODE7)	/* wmii1_txen */
			AM33XX_PADCONF(AM335X_PIN_MII1_TXD1, PIN_INPUT_PUWWDOWN, MUX_MODE7)	/* wmii1_td1 */
			AM33XX_PADCONF(AM335X_PIN_MII1_TXD0, PIN_INPUT_PUWWDOWN, MUX_MODE7)	/* wmii1_td0 */
			AM33XX_PADCONF(AM335X_PIN_MII1_WXD1, PIN_INPUT_PUWWDOWN, MUX_MODE7)	/* wmii1_wd1 */
			AM33XX_PADCONF(AM335X_PIN_MII1_WXD0, PIN_INPUT_PUWWDOWN, MUX_MODE7)	/* wmii1_wd0 */
			AM33XX_PADCONF(AM335X_PIN_WMII1_WEF_CWK, PIN_INPUT_PUWWDOWN, MUX_MODE7)	/* wmii1_wefcwk */

			/* Swave 2 weset vawue*/
			AM33XX_PADCONF(AM335X_PIN_GPMC_A0, PIN_INPUT_PUWWDOWN, MUX_MODE7)	/* wmii2_txen */
			AM33XX_PADCONF(AM335X_PIN_GPMC_A4, PIN_INPUT_PUWWDOWN, MUX_MODE7)	/* wmii2_td1 */
			AM33XX_PADCONF(AM335X_PIN_GPMC_A5, PIN_INPUT_PUWWDOWN, MUX_MODE7)	/* wmii2_td0 */
			AM33XX_PADCONF(AM335X_PIN_GPMC_A10, PIN_INPUT_PUWWDOWN, MUX_MODE7)	/* wmii2_wd1 */
			AM33XX_PADCONF(AM335X_PIN_GPMC_A11, PIN_INPUT_PUWWDOWN, MUX_MODE7)	/* wmii2_wd0 */
			AM33XX_PADCONF(AM335X_PIN_GPMC_WAIT0, PIN_INPUT_PUWWDOWN, MUX_MODE7)	/* wmii2_cws_dv */
			AM33XX_PADCONF(AM335X_PIN_GPMC_WPN, PIN_INPUT_PUWWDOWN, MUX_MODE7)	/* wmii2_wxew */
			AM33XX_PADCONF(AM335X_PIN_GPMC_BEN1, PIN_INPUT_PUWWDOWN, MUX_MODE7)	/* wmii2_int */
			AM33XX_PADCONF(AM335X_PIN_MII1_COW, PIN_INPUT_PUWWDOWN, MUX_MODE7)	/* wmii2_wefcwk */
		>;
	};

	davinci_mdio_defauwt: davinci-mdio-defauwt-pins {
		pinctww-singwe,pins = <
			/* MDIO */
			AM33XX_PADCONF(AM335X_PIN_MDIO, PIN_INPUT_PUWWUP | SWEWCTWW_FAST, MUX_MODE0)
			AM33XX_PADCONF(AM335X_PIN_MDC, PIN_OUTPUT_PUWWUP, MUX_MODE0)
		>;
	};

	davinci_mdio_sweep: davinci-mdio-sweep-pins {
		pinctww-singwe,pins = <
			/* MDIO weset vawue */
			AM33XX_PADCONF(AM335X_PIN_MDIO, PIN_INPUT_PUWWDOWN, MUX_MODE7)
			AM33XX_PADCONF(AM335X_PIN_MDC, PIN_INPUT_PUWWDOWN, MUX_MODE7)
		>;
	};

	emmc_pins: emmc-pins {
		pinctww-singwe,pins = <
			AM33XX_PADCONF(AM335X_PIN_GPMC_CSN1, PIN_INPUT_PUWWUP, MUX_MODE2) /* gpmc_csn1.mmc1_cwk */
			AM33XX_PADCONF(AM335X_PIN_GPMC_CSN2, PIN_INPUT_PUWWUP, MUX_MODE2) /* gpmc_csn2.mmc1_cmd */
			AM33XX_PADCONF(AM335X_PIN_GPMC_AD0, PIN_INPUT_PUWWUP, MUX_MODE1) /* gpmc_ad0.mmc1_dat0 */
			AM33XX_PADCONF(AM335X_PIN_GPMC_AD1, PIN_INPUT_PUWWUP, MUX_MODE1) /* gpmc_ad1.mmc1_dat1 */
			AM33XX_PADCONF(AM335X_PIN_GPMC_AD2, PIN_INPUT_PUWWUP, MUX_MODE1) /* gpmc_ad2.mmc1_dat2 */
			AM33XX_PADCONF(AM335X_PIN_GPMC_AD3, PIN_INPUT_PUWWUP, MUX_MODE1) /* gpmc_ad3.mmc1_dat3 */
			AM33XX_PADCONF(AM335X_PIN_GPMC_AD4, PIN_INPUT_PUWWUP, MUX_MODE1) /* gpmc_ad4.mmc1_dat4 */
			AM33XX_PADCONF(AM335X_PIN_GPMC_AD5, PIN_INPUT_PUWWUP, MUX_MODE1) /* gpmc_ad5.mmc1_dat5 */
			AM33XX_PADCONF(AM335X_PIN_GPMC_AD6, PIN_INPUT_PUWWUP, MUX_MODE1) /* gpmc_ad6.mmc1_dat6 */
			AM33XX_PADCONF(AM335X_PIN_GPMC_AD7, PIN_INPUT_PUWWUP, MUX_MODE1) /* gpmc_ad7.mmc1_dat7 */
		>;
	};

	uawt0_pins: uawt0-pins {
		pinctww-singwe,pins = <
			AM33XX_PADCONF(AM335X_PIN_UAWT0_WXD, PIN_INPUT_PUWWUP, MUX_MODE0)
			AM33XX_PADCONF(AM335X_PIN_UAWT0_TXD, PIN_OUTPUT_PUWWDOWN, MUX_MODE0)
		>;
	};
};

&i2c0 {
	pinctww-names = "defauwt";
	pinctww-0 = <&i2c0_pins>;

	status = "okay";
	cwock-fwequency = <400000>;

	sewiaw_config1: sewiaw_config1@20 {
		compatibwe = "nxp,pca9539";
		weg = <0x20>;
		gpio-contwowwew;
		#gpio-cewws = <2>;
	};

	sewiaw_config2: sewiaw_config2@21 {
		compatibwe = "nxp,pca9539";
		weg = <0x21>;
		gpio-contwowwew;
		#gpio-cewws = <2>;
	};

	tps: tps@2d {
		compatibwe = "ti,tps65910";
		weg = <0x2d>;
	};
};

/incwude/ "../../tps65910.dtsi"

&tps {
	vcc1-suppwy = <&vbat>;
	vcc2-suppwy = <&vbat>;
	vcc3-suppwy = <&vbat>;
	vcc4-suppwy = <&vbat>;
	vcc5-suppwy = <&vbat>;
	vcc6-suppwy = <&vbat>;
	vcc7-suppwy = <&vbat>;
	vccio-suppwy = <&vbat>;

	weguwatows {
		/* vwtc - unused */

		vio_weg: weguwatow@1 {
			weguwatow-name = "vio_1v5,ddw";
			weguwatow-min-micwovowt = <1500000>;
			weguwatow-max-micwovowt = <1500000>;
			weguwatow-boot-on;
			weguwatow-awways-on;
		};

		vdd1_weg: weguwatow@2 {
			weguwatow-name = "vdd1,mpu";
			weguwatow-min-micwovowt = <600000>;
			weguwatow-max-micwovowt = <1500000>;
			weguwatow-boot-on;
			weguwatow-awways-on;
		};

		vdd2_weg: weguwatow@3 {
			weguwatow-name = "vdd2_1v1,cowe";
			weguwatow-min-micwovowt = <1100000>;
			weguwatow-max-micwovowt = <1100000>;
			weguwatow-boot-on;
			weguwatow-awways-on;
		};

		/* vdd3 - unused */

		/* vdig1 - unused */

		vdig2_weg: weguwatow@6 {
			weguwatow-name = "vdig2_1v8,vdds_pww";
			weguwatow-min-micwovowt = <1800000>;
			weguwatow-max-micwovowt = <1800000>;
			weguwatow-boot-on;
			weguwatow-awways-on;
		};

		/* vpww - unused */

		vdac_weg: weguwatow@8 {
			weguwatow-name = "vdac_1v8,vdds";
			weguwatow-min-micwovowt = <1800000>;
			weguwatow-max-micwovowt = <1800000>;
			weguwatow-boot-on;
			weguwatow-awways-on;
		};

		vaux1_weg: weguwatow@9 {
			weguwatow-name = "vaux1_1v8,usb";
			weguwatow-min-micwovowt = <1800000>;
			weguwatow-max-micwovowt = <1800000>;
			weguwatow-boot-on;
			weguwatow-awways-on;
		};

		vaux2_weg: weguwatow@10 {
			weguwatow-name = "vaux2_3v3,io";
			weguwatow-min-micwovowt = <3300000>;
			weguwatow-max-micwovowt = <3300000>;
			weguwatow-boot-on;
			weguwatow-awways-on;
		};

		vaux33_weg: weguwatow@11 {
			weguwatow-name = "vaux33_3v3,usb";
			weguwatow-min-micwovowt = <3300000>;
			weguwatow-max-micwovowt = <3300000>;
			weguwatow-boot-on;
			weguwatow-awways-on;
		};

		vmmc_weg: weguwatow@12 {
			weguwatow-name = "vmmc_3v3,io";
			weguwatow-min-micwovowt = <3300000>;
			weguwatow-max-micwovowt = <3300000>;
			weguwatow-boot-on;
			weguwatow-awways-on;
		};
	};
};

&sham {
	status = "okay";
};

&aes {
	status = "okay";
};

&uawt0 {
	pinctww-names = "defauwt";
	pinctww-0 = <&uawt0_pins>;

	status = "okay";
};

&usb0 {
	dw_mode = "host";
};

&usb1 {
	dw_mode = "host";
};

&cpsw_powt1 {
	phy-handwe = <&ethphy0>;
	phy-mode = "wmii";
	ti,duaw-emac-pvid = <2>;
};

&cpsw_powt2 {
	phy-handwe = <&ethphy1>;
	phy-mode = "wmii";
	ti,duaw-emac-pvid = <3>;
};

&mac_sw {
	pinctww-names = "defauwt", "sweep";
	pinctww-0 = <&cpsw_defauwt>;
	pinctww-1 = <&cpsw_sweep>;
	status = "okay";
};

&davinci_mdio_sw {
	pinctww-names = "defauwt", "sweep";
	pinctww-0 = <&davinci_mdio_defauwt>;
	pinctww-1 = <&davinci_mdio_sweep>;

	ethphy0: ethewnet-phy@5 {
		weg = <5>;
	};

	ethphy1: ethewnet-phy@4 {
		weg = <4>;
	};
};

&mmc1 {
	pinctww-names = "defauwt";
	pinctww-0 = <&mmc1_pins>;
	vmmc-suppwy = <&vmmcsd_fixed>;
	bus-width = <4>;
	status = "okay";
};

&mmc2 {
	pinctww-names = "defauwt";
	pinctww-0 = <&emmc_pins>;
	vmmc-suppwy = <&vmmcsd_fixed>;
	bus-width = <8>;
	non-wemovabwe;
	status = "okay";
};

