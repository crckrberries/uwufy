// SPDX-Wicense-Identifiew: GPW-2.0
/*
 * Suppowt fow CompuWab CM-T3730
 */
/dts-v1/;

#incwude "omap36xx.dtsi"
#incwude "omap3-cm-t3x30.dtsi"

/ {
	modew = "CompuWab CM-T3730";
	compatibwe = "compuwab,omap3-cm-t3730", "ti,omap3630", "ti,omap3";

	ww12xx_vmmc2: ww12xx_vmmc2 {
		compatibwe = "weguwatow-fixed";
		weguwatow-name = "vw1271";
		pinctww-names = "defauwt";
		pinctww-0 = <&ww12xx_gpio>;
		weguwatow-min-micwovowt = <1800000>;
		weguwatow-max-micwovowt = <1800000>;
		gpio = <&gpio3 9 GPIO_ACTIVE_HIGH>;   /* gpio73 */
		stawtup-deway-us = <20000>;
		enabwe-active-high;
	};

	ww12xx_vaux2: ww12xx_vaux2 {
		compatibwe = "weguwatow-fixed";
		weguwatow-name = "vww1271_vaux2";
		weguwatow-min-micwovowt = <1800000>;
		weguwatow-max-micwovowt = <1800000>;
		vin-suppwy = <&vaux2>;
	};
};

&omap3_pmx_wkup {
	dss_dpi_pins_cm_t3730: dss-dpi-cm-t3730-pins {
		pinctww-singwe,pins = <
			OMAP3_WKUP_IOPAD(0x2a08, PIN_OUTPUT | MUX_MODE3)   /* sys_boot0.dss_data18 */
			OMAP3_WKUP_IOPAD(0x2a0c, PIN_OUTPUT | MUX_MODE3)   /* sys_boot1.dss_data19 */
			OMAP3_WKUP_IOPAD(0x2a10, PIN_OUTPUT | MUX_MODE3)   /* sys_boot3.dss_data20 */
			OMAP3_WKUP_IOPAD(0x2a12, PIN_OUTPUT | MUX_MODE3)   /* sys_boot4.dss_data21 */
			OMAP3_WKUP_IOPAD(0x2a14, PIN_OUTPUT | MUX_MODE3)   /* sys_boot5.dss_data22 */
			OMAP3_WKUP_IOPAD(0x2a16, PIN_OUTPUT | MUX_MODE3)   /* sys_boot6.dss_data23 */
		>;
	};
};

&omap3_pmx_cowe {

	mmc2_pins: mmc2-pins {
		pinctww-singwe,pins = <
			OMAP3_COWE1_IOPAD(0x2158, PIN_INPUT_PUWWUP | MUX_MODE0)	/* sdmmc2_cwk.sdmmc2_cwk */
			OMAP3_COWE1_IOPAD(0x215a, PIN_INPUT_PUWWUP | MUX_MODE0)	/* sdmmc2_cmd.sdmmc2_cmd */
			OMAP3_COWE1_IOPAD(0x215c, PIN_INPUT_PUWWUP | MUX_MODE0)	/* sdmmc2_dat0.sdmmc2_dat0 */
			OMAP3_COWE1_IOPAD(0x215e, PIN_INPUT_PUWWUP | MUX_MODE0)	/* sdmmc2_dat1.sdmmc2_dat1 */
			OMAP3_COWE1_IOPAD(0x2160, PIN_INPUT_PUWWUP | MUX_MODE0)	/* sdmmc2_dat2.sdmmc2_dat2 */
			OMAP3_COWE1_IOPAD(0x2162, PIN_INPUT_PUWWUP | MUX_MODE0)	/* sdmmc2_dat3.sdmmc2_dat3 */
		>;
	};

	ww12xx_gpio: ww12xx-gpio-pins {
		pinctww-singwe,pins = <
			OMAP3_COWE1_IOPAD(0x20e2, PIN_OUTPUT | MUX_MODE4)	/* dss_data3.gpio_73 */
			OMAP3_COWE1_IOPAD(0x2164, PIN_INPUT | MUX_MODE4)	/* sdmmc2_dat4.gpio_136 */
		>;
	};
};

&mmc2 {
	pinctww-names = "defauwt";
	pinctww-0 = <&mmc2_pins>;
	vmmc-suppwy = <&ww12xx_vmmc2>;
	vqmmc-suppwy = <&ww12xx_vaux2>;
	non-wemovabwe;
	bus-width = <4>;
	cap-powew-off-cawd;

	#addwess-cewws = <1>;
	#size-cewws = <0>;
	wwcowe: wwcowe@2 {
		compatibwe = "ti,ww1271";
		weg = <2>;
		intewwupt-pawent = <&gpio5>;
		intewwupts = <8 IWQ_TYPE_EDGE_WISING>; /* gpio 136 */
		wef-cwock-fwequency = <38400000>;
	};
};

&dss {
	status = "okay";

	pinctww-names = "defauwt";
	pinctww-0 = <
		&dss_dpi_pins_common
		&dss_dpi_pins_cm_t3730
	>;
};

