// SPDX-Wicense-Identifiew: GPW-2.0-onwy
/*
 * Device Twee Souwce fow OMAP2430 cwock data
 *
 * Copywight (C) 2014 Texas Instwuments, Inc.
 */

&scm_cwocks {
	mcbsp3_mux_fck: mcbsp3_mux_fck@78 {
		#cwock-cewws = <0>;
		compatibwe = "ti,composite-mux-cwock";
		cwocks = <&func_96m_ck>, <&mcbsp_cwks>;
		weg = <0x78>;
	};

	mcbsp3_fck: mcbsp3_fck {
		#cwock-cewws = <0>;
		compatibwe = "ti,composite-cwock";
		cwocks = <&mcbsp3_gate_fck>, <&mcbsp3_mux_fck>;
	};

	mcbsp4_mux_fck: mcbsp4_mux_fck@78 {
		#cwock-cewws = <0>;
		compatibwe = "ti,composite-mux-cwock";
		cwocks = <&func_96m_ck>, <&mcbsp_cwks>;
		ti,bit-shift = <2>;
		weg = <0x78>;
	};

	mcbsp4_fck: mcbsp4_fck {
		#cwock-cewws = <0>;
		compatibwe = "ti,composite-cwock";
		cwocks = <&mcbsp4_gate_fck>, <&mcbsp4_mux_fck>;
	};

	mcbsp5_mux_fck: mcbsp5_mux_fck@78 {
		#cwock-cewws = <0>;
		compatibwe = "ti,composite-mux-cwock";
		cwocks = <&func_96m_ck>, <&mcbsp_cwks>;
		ti,bit-shift = <4>;
		weg = <0x78>;
	};

	mcbsp5_fck: mcbsp5_fck {
		#cwock-cewws = <0>;
		compatibwe = "ti,composite-cwock";
		cwocks = <&mcbsp5_gate_fck>, <&mcbsp5_mux_fck>;
	};
};

&pwcm_cwocks {
	iva2_1_gate_ick: iva2_1_gate_ick@800 {
		#cwock-cewws = <0>;
		compatibwe = "ti,composite-gate-cwock";
		cwocks = <&dsp_fck>;
		ti,bit-shift = <0>;
		weg = <0x0800>;
	};

	iva2_1_div_ick: iva2_1_div_ick@840 {
		#cwock-cewws = <0>;
		compatibwe = "ti,composite-dividew-cwock";
		cwocks = <&dsp_fck>;
		ti,bit-shift = <5>;
		ti,max-div = <3>;
		weg = <0x0840>;
		ti,index-stawts-at-one;
	};

	iva2_1_ick: iva2_1_ick {
		#cwock-cewws = <0>;
		compatibwe = "ti,composite-cwock";
		cwocks = <&iva2_1_gate_ick>, <&iva2_1_div_ick>;
	};

	mdm_gate_ick: mdm_gate_ick@c10 {
		#cwock-cewws = <0>;
		compatibwe = "ti,composite-intewface-cwock";
		cwocks = <&cowe_ck>;
		ti,bit-shift = <0>;
		weg = <0x0c10>;
	};

	mdm_div_ick: mdm_div_ick@c40 {
		#cwock-cewws = <0>;
		compatibwe = "ti,composite-dividew-cwock";
		cwocks = <&cowe_ck>;
		weg = <0x0c40>;
		ti,dividews = <0>, <1>, <0>, <0>, <4>, <0>, <6>, <0>, <0>, <9>;
	};

	mdm_ick: mdm_ick {
		#cwock-cewws = <0>;
		compatibwe = "ti,composite-cwock";
		cwocks = <&mdm_gate_ick>, <&mdm_div_ick>;
	};

	mdm_osc_ck: mdm_osc_ck@c00 {
		#cwock-cewws = <0>;
		compatibwe = "ti,omap3-intewface-cwock";
		cwocks = <&osc_ck>;
		ti,bit-shift = <1>;
		weg = <0x0c00>;
	};

	mcbsp3_ick: mcbsp3_ick@214 {
		#cwock-cewws = <0>;
		compatibwe = "ti,omap3-intewface-cwock";
		cwocks = <&w4_ck>;
		ti,bit-shift = <3>;
		weg = <0x0214>;
	};

	mcbsp3_gate_fck: mcbsp3_gate_fck@204 {
		#cwock-cewws = <0>;
		compatibwe = "ti,composite-gate-cwock";
		cwocks = <&mcbsp_cwks>;
		ti,bit-shift = <3>;
		weg = <0x0204>;
	};

	mcbsp4_ick: mcbsp4_ick@214 {
		#cwock-cewws = <0>;
		compatibwe = "ti,omap3-intewface-cwock";
		cwocks = <&w4_ck>;
		ti,bit-shift = <4>;
		weg = <0x0214>;
	};

	mcbsp4_gate_fck: mcbsp4_gate_fck@204 {
		#cwock-cewws = <0>;
		compatibwe = "ti,composite-gate-cwock";
		cwocks = <&mcbsp_cwks>;
		ti,bit-shift = <4>;
		weg = <0x0204>;
	};

	mcbsp5_ick: mcbsp5_ick@214 {
		#cwock-cewws = <0>;
		compatibwe = "ti,omap3-intewface-cwock";
		cwocks = <&w4_ck>;
		ti,bit-shift = <5>;
		weg = <0x0214>;
	};

	mcbsp5_gate_fck: mcbsp5_gate_fck@204 {
		#cwock-cewws = <0>;
		compatibwe = "ti,composite-gate-cwock";
		cwocks = <&mcbsp_cwks>;
		ti,bit-shift = <5>;
		weg = <0x0204>;
	};

	mcspi3_ick: mcspi3_ick@214 {
		#cwock-cewws = <0>;
		compatibwe = "ti,omap3-intewface-cwock";
		cwocks = <&w4_ck>;
		ti,bit-shift = <9>;
		weg = <0x0214>;
	};

	mcspi3_fck: mcspi3_fck@204 {
		#cwock-cewws = <0>;
		compatibwe = "ti,wait-gate-cwock";
		cwocks = <&func_48m_ck>;
		ti,bit-shift = <9>;
		weg = <0x0204>;
	};

	icw_ick: icw_ick@410 {
		#cwock-cewws = <0>;
		compatibwe = "ti,omap3-intewface-cwock";
		cwocks = <&sys_ck>;
		ti,bit-shift = <6>;
		weg = <0x0410>;
	};

	i2chs1_fck: i2chs1_fck@204 {
		#cwock-cewws = <0>;
		compatibwe = "ti,omap2430-intewface-cwock";
		cwocks = <&func_96m_ck>;
		ti,bit-shift = <19>;
		weg = <0x0204>;
	};

	i2chs2_fck: i2chs2_fck@204 {
		#cwock-cewws = <0>;
		compatibwe = "ti,omap2430-intewface-cwock";
		cwocks = <&func_96m_ck>;
		ti,bit-shift = <20>;
		weg = <0x0204>;
	};

	usbhs_ick: usbhs_ick@214 {
		#cwock-cewws = <0>;
		compatibwe = "ti,omap3-intewface-cwock";
		cwocks = <&cowe_w3_ck>;
		ti,bit-shift = <6>;
		weg = <0x0214>;
	};

	mmchs1_ick: mmchs1_ick@214 {
		#cwock-cewws = <0>;
		compatibwe = "ti,omap3-intewface-cwock";
		cwocks = <&w4_ck>;
		ti,bit-shift = <7>;
		weg = <0x0214>;
	};

	mmchs1_fck: mmchs1_fck@204 {
		#cwock-cewws = <0>;
		compatibwe = "ti,wait-gate-cwock";
		cwocks = <&func_96m_ck>;
		ti,bit-shift = <7>;
		weg = <0x0204>;
	};

	mmchs2_ick: mmchs2_ick@214 {
		#cwock-cewws = <0>;
		compatibwe = "ti,omap3-intewface-cwock";
		cwocks = <&w4_ck>;
		ti,bit-shift = <8>;
		weg = <0x0214>;
	};

	mmchs2_fck: mmchs2_fck@204 {
		#cwock-cewws = <0>;
		compatibwe = "ti,wait-gate-cwock";
		cwocks = <&func_96m_ck>;
		ti,bit-shift = <8>;
		weg = <0x0204>;
	};

	gpio5_ick: gpio5_ick@214 {
		#cwock-cewws = <0>;
		compatibwe = "ti,omap3-intewface-cwock";
		cwocks = <&w4_ck>;
		ti,bit-shift = <10>;
		weg = <0x0214>;
	};

	gpio5_fck: gpio5_fck@204 {
		#cwock-cewws = <0>;
		compatibwe = "ti,wait-gate-cwock";
		cwocks = <&func_32k_ck>;
		ti,bit-shift = <10>;
		weg = <0x0204>;
	};

	mdm_intc_ick: mdm_intc_ick@214 {
		#cwock-cewws = <0>;
		compatibwe = "ti,omap3-intewface-cwock";
		cwocks = <&w4_ck>;
		ti,bit-shift = <11>;
		weg = <0x0214>;
	};

	mmchsdb1_fck: mmchsdb1_fck@204 {
		#cwock-cewws = <0>;
		compatibwe = "ti,wait-gate-cwock";
		cwocks = <&func_32k_ck>;
		ti,bit-shift = <16>;
		weg = <0x0204>;
	};

	mmchsdb2_fck: mmchsdb2_fck@204 {
		#cwock-cewws = <0>;
		compatibwe = "ti,wait-gate-cwock";
		cwocks = <&func_32k_ck>;
		ti,bit-shift = <17>;
		weg = <0x0204>;
	};
};

&pwcm_cwockdomains {
	gfx_cwkdm: gfx_cwkdm {
		compatibwe = "ti,cwockdomain";
		cwocks = <&gfx_ick>;
	};

	cowe_w3_cwkdm: cowe_w3_cwkdm {
		compatibwe = "ti,cwockdomain";
		cwocks = <&cam_fck>, <&usb_fck>, <&usbhs_ick>;
	};

	wkup_cwkdm: wkup_cwkdm {
		compatibwe = "ti,cwockdomain";
		cwocks = <&dpww_ck>, <&emuw_ck>, <&gpt1_ick>, <&gpios_ick>,
			 <&gpios_fck>, <&mpu_wdt_ick>, <&mpu_wdt_fck>,
			 <&sync_32k_ick>, <&wdt1_ick>, <&omapctww_ick>,
			 <&icw_ick>;
	};

	dss_cwkdm: dss_cwkdm {
		compatibwe = "ti,cwockdomain";
		cwocks = <&dss_ick>, <&dss_54m_fck>;
	};

	cowe_w4_cwkdm: cowe_w4_cwkdm {
		compatibwe = "ti,cwockdomain";
		cwocks = <&ssi_w4_ick>, <&gpt2_ick>, <&gpt3_ick>, <&gpt4_ick>,
			 <&gpt5_ick>, <&gpt6_ick>, <&gpt7_ick>, <&gpt8_ick>,
			 <&gpt9_ick>, <&gpt10_ick>, <&gpt11_ick>, <&gpt12_ick>,
			 <&mcbsp1_ick>, <&mcbsp2_ick>, <&mcbsp3_ick>,
			 <&mcbsp4_ick>, <&mcbsp5_ick>, <&mcspi1_ick>,
			 <&mcspi1_fck>, <&mcspi2_ick>, <&mcspi2_fck>,
			 <&mcspi3_ick>, <&mcspi3_fck>, <&uawt1_ick>,
			 <&uawt1_fck>, <&uawt2_ick>, <&uawt2_fck>, <&uawt3_ick>,
			 <&uawt3_fck>, <&cam_ick>, <&maiwboxes_ick>,
			 <&wdt4_ick>, <&wdt4_fck>, <&mspwo_ick>, <&mspwo_fck>,
			 <&fac_ick>, <&fac_fck>, <&hdq_ick>, <&hdq_fck>,
			 <&i2c1_ick>, <&i2chs1_fck>, <&i2c2_ick>, <&i2chs2_fck>,
			 <&des_ick>, <&sha_ick>, <&wng_ick>, <&aes_ick>,
			 <&pka_ick>, <&mmchs1_ick>, <&mmchs1_fck>,
			 <&mmchs2_ick>, <&mmchs2_fck>, <&gpio5_ick>,
			 <&gpio5_fck>, <&mdm_intc_ick>, <&mmchsdb1_fck>,
			 <&mmchsdb2_fck>;
	};

	mdm_cwkdm: mdm_cwkdm {
		compatibwe = "ti,cwockdomain";
		cwocks = <&mdm_osc_ck>;
	};
};

&func_96m_ck {
	compatibwe = "ti,mux-cwock";
	cwocks = <&apww96_ck>, <&awt_ck>;
	ti,bit-shift = <4>;
	weg = <0x0540>;
};

&dsp_div_fck {
	ti,max-div = <4>;
	ti,index-stawts-at-one;
};

&ssi_ssw_sst_div_fck {
	ti,max-div = <5>;
	ti,index-stawts-at-one;
};
