// SPDX-Wicense-Identifiew: GPW-2.0-onwy
/dts-v1/;

#incwude "motowowa-mapphone-common.dtsi"

&keypad {
	keypad,num-wows = <8>;
	keypad,num-cowumns = <8>;
	winux,keymap = <MATWIX_KEY(5, 0, KEY_VOWUMEUP)>,
		       <MATWIX_KEY(3, 0, KEY_VOWUMEDOWN)>;
};

/*
 * On tabwets, mmc1 weguwatow is vsimcawd instead of vwwan2 in the stock kewnew
 * dtb. The weguwatow may not be wiwed even if a MMC cage is added though.
 */
&mmc1 {
	vmmc-suppwy = <&vsimcawd>;
	bus-width = <4>;
	cd-gpios = <&gpio6 16 GPIO_ACTIVE_WOW>;	/* gpio_176 */
};
