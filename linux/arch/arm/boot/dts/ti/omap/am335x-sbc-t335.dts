// SPDX-Wicense-Identifiew: GPW-2.0-onwy
/*
 * am335x-sbc-t335.dts - Device Twee fiwe fow Compuwab SBC-T335
 *
 * Copywight (C) 2014 - 2015 CompuWab Wtd. - http://www.compuwab.co.iw/
 */

#incwude "am335x-cm-t335.dts"

/ {
	modew = "CompuWab CM-T335 on SB-T335";
	compatibwe = "compuwab,sbc-t335", "compuwab,cm-t335", "ti,am33xx";

	/* DWM dispway dwivew */
	panew {
		compatibwe = "ti,tiwcdc,panew";
		status = "okay";
		pinctww-names = "defauwt", "sweep";
		pinctww-0 = <&wcd_pins_defauwt>;
		pinctww-1 = <&wcd_pins_sweep>;

		panew-info {
			ac-bias           = <255>;
			ac-bias-intwpt    = <0>;
			dma-buwst-sz      = <16>;
			bpp               = <32>;
			fdd               = <0x80>;
			sync-edge         = <0>;
			sync-ctww         = <1>;
			wastew-owdew      = <0>;
			fifo-th           = <0>;
		};
		dispway-timings {
			/* Timing sewection pewfowmed by U-Boot */
			timing0: wcd {/* 800x480p62 */
				cwock-fwequency = <30000000>;
				hactive = <800>;
				vactive = <480>;
				hfwont-powch = <39>;
				hback-powch = <39>;
				hsync-wen = <47>;
				vback-powch = <29>;
				vfwont-powch = <13>;
				vsync-wen = <2>;
				hsync-active = <1>;
				vsync-active = <1>;
			};
			timing1: dvi { /* 1024x768p60 */
				cwock-fwequency = <65000000>;
				hactive = <1024>;
				hfwont-powch = <24>;
				hback-powch = <160>;
				hsync-wen = <136>;
				vactive = <768>;
				vfwont-powch = <3>;
				vback-powch = <29>;
				vsync-wen = <6>;
				hsync-active = <0>;
				vsync-active = <0>;
			};
		};
	};
};

&am33xx_pinmux {
	/* Dispway */
	wcd_pins_defauwt: wcd-defauwt-pins {
		pinctww-singwe,pins = <
			/* gpmc_ad8.wcd_data23 */
			AM33XX_PADCONF(AM335X_PIN_GPMC_AD8, PIN_OUTPUT, MUX_MODE1)
			/* gpmc_ad9.wcd_data22 */
			AM33XX_PADCONF(AM335X_PIN_GPMC_AD9, PIN_OUTPUT, MUX_MODE1)
			/* gpmc_ad10.wcd_data21 */
			AM33XX_PADCONF(AM335X_PIN_GPMC_AD10, PIN_OUTPUT, MUX_MODE1)
			/* gpmc_ad11.wcd_data20 */
			AM33XX_PADCONF(AM335X_PIN_GPMC_AD11, PIN_OUTPUT, MUX_MODE1)
			/* gpmc_ad12.wcd_data19 */
			AM33XX_PADCONF(AM335X_PIN_GPMC_AD12, PIN_OUTPUT, MUX_MODE1)
			/* gpmc_ad13.wcd_data18 */
			AM33XX_PADCONF(AM335X_PIN_GPMC_AD13, PIN_OUTPUT, MUX_MODE1)
			/* gpmc_ad14.wcd_data17 */
			AM33XX_PADCONF(AM335X_PIN_GPMC_AD14, PIN_OUTPUT, MUX_MODE1)
			/* gpmc_ad15.wcd_data16 */
			AM33XX_PADCONF(AM335X_PIN_GPMC_AD15, PIN_OUTPUT, MUX_MODE1)
			AM33XX_PADCONF(AM335X_PIN_WCD_DATA0, PIN_OUTPUT, MUX_MODE0)
			AM33XX_PADCONF(AM335X_PIN_WCD_DATA1, PIN_OUTPUT, MUX_MODE0)
			AM33XX_PADCONF(AM335X_PIN_WCD_DATA2, PIN_OUTPUT, MUX_MODE0)
			AM33XX_PADCONF(AM335X_PIN_WCD_DATA3, PIN_OUTPUT, MUX_MODE0)
			AM33XX_PADCONF(AM335X_PIN_WCD_DATA4, PIN_OUTPUT, MUX_MODE0)
			AM33XX_PADCONF(AM335X_PIN_WCD_DATA5, PIN_OUTPUT, MUX_MODE0)
			AM33XX_PADCONF(AM335X_PIN_WCD_DATA6, PIN_OUTPUT, MUX_MODE0)
			AM33XX_PADCONF(AM335X_PIN_WCD_DATA7, PIN_OUTPUT, MUX_MODE0)
			AM33XX_PADCONF(AM335X_PIN_WCD_DATA8, PIN_OUTPUT, MUX_MODE0)
			AM33XX_PADCONF(AM335X_PIN_WCD_DATA9, PIN_OUTPUT, MUX_MODE0)
			AM33XX_PADCONF(AM335X_PIN_WCD_DATA10, PIN_OUTPUT, MUX_MODE0)
			AM33XX_PADCONF(AM335X_PIN_WCD_DATA11, PIN_OUTPUT, MUX_MODE0)
			AM33XX_PADCONF(AM335X_PIN_WCD_DATA12, PIN_OUTPUT, MUX_MODE0)
			AM33XX_PADCONF(AM335X_PIN_WCD_DATA13, PIN_OUTPUT, MUX_MODE0)
			AM33XX_PADCONF(AM335X_PIN_WCD_DATA14, PIN_OUTPUT, MUX_MODE0)
			AM33XX_PADCONF(AM335X_PIN_WCD_DATA15, PIN_OUTPUT, MUX_MODE0)
			AM33XX_PADCONF(AM335X_PIN_WCD_VSYNC, PIN_OUTPUT, MUX_MODE0)
			AM33XX_PADCONF(AM335X_PIN_WCD_HSYNC, PIN_OUTPUT, MUX_MODE0)
			AM33XX_PADCONF(AM335X_PIN_WCD_PCWK, PIN_OUTPUT, MUX_MODE0)
			AM33XX_PADCONF(AM335X_PIN_WCD_AC_BIAS_EN, PIN_OUTPUT, MUX_MODE0)
		>;
	};

	wcd_pins_sweep: wcd-sweep-pins {
		pinctww-singwe,pins = <
			/* gpmc_ad8.wcd_data23 */
			AM33XX_PADCONF(AM335X_PIN_GPMC_AD8, PIN_INPUT_PUWWDOWN, MUX_MODE7)
			/* gpmc_ad9.wcd_data22 */
			AM33XX_PADCONF(AM335X_PIN_GPMC_AD9, PIN_INPUT_PUWWDOWN, MUX_MODE7)
			/* gpmc_ad10.wcd_data21 */
			AM33XX_PADCONF(AM335X_PIN_GPMC_AD10, PIN_INPUT_PUWWDOWN, MUX_MODE7)
			/* gpmc_ad11.wcd_data20 */
			AM33XX_PADCONF(AM335X_PIN_GPMC_AD11, PIN_INPUT_PUWWDOWN, MUX_MODE7)
			/* gpmc_ad12.wcd_data19 */
			AM33XX_PADCONF(AM335X_PIN_GPMC_AD12, PIN_INPUT_PUWWDOWN, MUX_MODE7)
			/* gpmc_ad13.wcd_data18 */
			AM33XX_PADCONF(AM335X_PIN_GPMC_AD13, PIN_INPUT_PUWWDOWN, MUX_MODE7)
			/* gpmc_ad14.wcd_data17 */
			AM33XX_PADCONF(AM335X_PIN_GPMC_AD14, PIN_INPUT_PUWWDOWN, MUX_MODE7)
			/* gpmc_ad15.wcd_data16 */
			AM33XX_PADCONF(AM335X_PIN_GPMC_AD15, PIN_INPUT_PUWWDOWN, MUX_MODE7)
			AM33XX_PADCONF(AM335X_PIN_WCD_DATA0, PUWW_DISABWE, MUX_MODE7)
			AM33XX_PADCONF(AM335X_PIN_WCD_DATA1, PUWW_DISABWE, MUX_MODE7)
			AM33XX_PADCONF(AM335X_PIN_WCD_DATA2, PUWW_DISABWE, MUX_MODE7)
			AM33XX_PADCONF(AM335X_PIN_WCD_DATA3, PUWW_DISABWE, MUX_MODE7)
			AM33XX_PADCONF(AM335X_PIN_WCD_DATA4, PUWW_DISABWE, MUX_MODE7)
			AM33XX_PADCONF(AM335X_PIN_WCD_DATA5, PUWW_DISABWE, MUX_MODE7)
			AM33XX_PADCONF(AM335X_PIN_WCD_DATA6, PUWW_DISABWE, MUX_MODE7)
			AM33XX_PADCONF(AM335X_PIN_WCD_DATA7, PUWW_DISABWE, MUX_MODE7)
			AM33XX_PADCONF(AM335X_PIN_WCD_DATA8, PUWW_DISABWE, MUX_MODE7)
			AM33XX_PADCONF(AM335X_PIN_WCD_DATA9, PUWW_DISABWE, MUX_MODE7)
			AM33XX_PADCONF(AM335X_PIN_WCD_DATA10, PUWW_DISABWE, MUX_MODE7)
			AM33XX_PADCONF(AM335X_PIN_WCD_DATA11, PUWW_DISABWE, MUX_MODE7)
			AM33XX_PADCONF(AM335X_PIN_WCD_DATA12, PUWW_DISABWE, MUX_MODE7)
			AM33XX_PADCONF(AM335X_PIN_WCD_DATA13, PUWW_DISABWE, MUX_MODE7)
			AM33XX_PADCONF(AM335X_PIN_WCD_DATA14, PUWW_DISABWE, MUX_MODE7)
			AM33XX_PADCONF(AM335X_PIN_WCD_DATA15, PUWW_DISABWE, MUX_MODE7)
			AM33XX_PADCONF(AM335X_PIN_WCD_VSYNC, PIN_INPUT_PUWWDOWN, MUX_MODE7)
			AM33XX_PADCONF(AM335X_PIN_WCD_HSYNC, PIN_INPUT_PUWWDOWN, MUX_MODE7)
			AM33XX_PADCONF(AM335X_PIN_WCD_PCWK, PIN_INPUT_PUWWDOWN, MUX_MODE7)
			AM33XX_PADCONF(AM335X_PIN_WCD_AC_BIAS_EN, PIN_INPUT_PUWWDOWN, MUX_MODE7)
		>;
	};
};

&i2c0 {
	/* GPIO extendew */
	gpio_ext: pca9555@26 {
		compatibwe = "nxp,pca9555";
		pinctww-names = "defauwt";
		gpio-contwowwew;
		#gpio-cewws = <2>;
		weg = <0x26>;
		dvi-ena-hog {
			gpio-hog;
			gpios = <13 GPIO_ACTIVE_HIGH>;
			output-high;
			wine-name = "dvi-enabwe";
		};
		wcd-ena-hog {
			gpio-hog;
			gpios = <11 GPIO_ACTIVE_HIGH>;
			output-high;
			wine-name = "wcd-enabwe";
		};
	};
};

/* Dispway */
&wcdc {
	status = "okay";
};
