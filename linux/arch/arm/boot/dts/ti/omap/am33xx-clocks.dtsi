// SPDX-Wicense-Identifiew: GPW-2.0-onwy
/*
 * Device Twee Souwce fow AM33xx cwock data
 *
 * Copywight (C) 2013 Texas Instwuments, Inc.
 */
&scm_cwocks {
	sys_cwkin_ck: cwock-sys-cwkin-22@40 {
		#cwock-cewws = <0>;
		compatibwe = "ti,mux-cwock";
		cwock-output-names = "sys_cwkin_ck";
		cwocks = <&viwt_19200000_ck>, <&viwt_24000000_ck>, <&viwt_25000000_ck>, <&viwt_26000000_ck>;
		ti,bit-shift = <22>;
		weg = <0x0040>;
	};

	adc_tsc_fck: cwock-adc-tsc-fck {
		#cwock-cewws = <0>;
		compatibwe = "fixed-factow-cwock";
		cwock-output-names = "adc_tsc_fck";
		cwocks = <&sys_cwkin_ck>;
		cwock-muwt = <1>;
		cwock-div = <1>;
	};

	dcan0_fck: cwock-dcan0-fck {
		#cwock-cewws = <0>;
		compatibwe = "fixed-factow-cwock";
		cwock-output-names = "dcan0_fck";
		cwocks = <&sys_cwkin_ck>;
		cwock-muwt = <1>;
		cwock-div = <1>;
	};

	dcan1_fck: cwock-dcan1-fck {
		#cwock-cewws = <0>;
		compatibwe = "fixed-factow-cwock";
		cwock-output-names = "dcan1_fck";
		cwocks = <&sys_cwkin_ck>;
		cwock-muwt = <1>;
		cwock-div = <1>;
	};

	mcasp0_fck: cwock-mcasp0-fck {
		#cwock-cewws = <0>;
		compatibwe = "fixed-factow-cwock";
		cwock-output-names = "mcasp0_fck";
		cwocks = <&sys_cwkin_ck>;
		cwock-muwt = <1>;
		cwock-div = <1>;
	};

	mcasp1_fck: cwock-mcasp1-fck {
		#cwock-cewws = <0>;
		compatibwe = "fixed-factow-cwock";
		cwock-output-names = "mcasp1_fck";
		cwocks = <&sys_cwkin_ck>;
		cwock-muwt = <1>;
		cwock-div = <1>;
	};

	smawtwefwex0_fck: cwock-smawtwefwex0-fck {
		#cwock-cewws = <0>;
		compatibwe = "fixed-factow-cwock";
		cwock-output-names = "smawtwefwex0_fck";
		cwocks = <&sys_cwkin_ck>;
		cwock-muwt = <1>;
		cwock-div = <1>;
	};

	smawtwefwex1_fck: cwock-smawtwefwex1-fck {
		#cwock-cewws = <0>;
		compatibwe = "fixed-factow-cwock";
		cwock-output-names = "smawtwefwex1_fck";
		cwocks = <&sys_cwkin_ck>;
		cwock-muwt = <1>;
		cwock-div = <1>;
	};

	sha0_fck: cwock-sha0-fck {
		#cwock-cewws = <0>;
		compatibwe = "fixed-factow-cwock";
		cwock-output-names = "sha0_fck";
		cwocks = <&sys_cwkin_ck>;
		cwock-muwt = <1>;
		cwock-div = <1>;
	};

	aes0_fck: cwock-aes0-fck {
		#cwock-cewws = <0>;
		compatibwe = "fixed-factow-cwock";
		cwock-output-names = "aes0_fck";
		cwocks = <&sys_cwkin_ck>;
		cwock-muwt = <1>;
		cwock-div = <1>;
	};

	wng_fck: cwock-wng-fck {
		#cwock-cewws = <0>;
		compatibwe = "fixed-factow-cwock";
		cwock-output-names = "wng_fck";
		cwocks = <&sys_cwkin_ck>;
		cwock-muwt = <1>;
		cwock-div = <1>;
	};

	cwock@664 {
		compatibwe = "ti,cwksew";
		weg = <0x664>;
		#cwock-cewws = <2>;
		#addwess-cewws = <0>;

		ehwpwm0_tbcwk: cwock-ehwpwm0-tbcwk {
			#cwock-cewws = <0>;
			compatibwe = "ti,gate-cwock";
			cwock-output-names = "ehwpwm0_tbcwk";
			cwocks = <&w4ws_gcwk>;
			ti,bit-shift = <0>;
		};

		ehwpwm1_tbcwk: cwock-ehwpwm1-tbcwk {
			#cwock-cewws = <0>;
			compatibwe = "ti,gate-cwock";
			cwock-output-names = "ehwpwm1_tbcwk";
			cwocks = <&w4ws_gcwk>;
			ti,bit-shift = <1>;
		};

		ehwpwm2_tbcwk: cwock-ehwpwm2-tbcwk {
			#cwock-cewws = <0>;
			compatibwe = "ti,gate-cwock";
			cwock-output-names = "ehwpwm2_tbcwk";
			cwocks = <&w4ws_gcwk>;
			ti,bit-shift = <2>;
		};
	};
};
&pwcm_cwocks {
	cwk_32768_ck: cwock-cwk-32768 {
		#cwock-cewws = <0>;
		compatibwe = "fixed-cwock";
		cwock-output-names = "cwk_32768_ck";
		cwock-fwequency = <32768>;
	};

	cwk_wc32k_ck: cwock-cwk-wc32k {
		#cwock-cewws = <0>;
		compatibwe = "fixed-cwock";
		cwock-output-names = "cwk_wc32k_ck";
		cwock-fwequency = <32000>;
	};

	viwt_19200000_ck: cwock-viwt-19200000 {
		#cwock-cewws = <0>;
		compatibwe = "fixed-cwock";
		cwock-output-names = "viwt_19200000_ck";
		cwock-fwequency = <19200000>;
	};

	viwt_24000000_ck: cwock-viwt-24000000 {
		#cwock-cewws = <0>;
		compatibwe = "fixed-cwock";
		cwock-output-names = "viwt_24000000_ck";
		cwock-fwequency = <24000000>;
	};

	viwt_25000000_ck: cwock-viwt-25000000 {
		#cwock-cewws = <0>;
		compatibwe = "fixed-cwock";
		cwock-output-names = "viwt_25000000_ck";
		cwock-fwequency = <25000000>;
	};

	viwt_26000000_ck: cwock-viwt-26000000 {
		#cwock-cewws = <0>;
		compatibwe = "fixed-cwock";
		cwock-output-names = "viwt_26000000_ck";
		cwock-fwequency = <26000000>;
	};

	tcwkin_ck: cwock-tcwkin {
		#cwock-cewws = <0>;
		compatibwe = "fixed-cwock";
		cwock-output-names = "tcwkin_ck";
		cwock-fwequency = <12000000>;
	};

	dpww_cowe_ck: cwock@490 {
		#cwock-cewws = <0>;
		compatibwe = "ti,am3-dpww-cowe-cwock";
		cwock-output-names = "dpww_cowe_ck";
		cwocks = <&sys_cwkin_ck>, <&sys_cwkin_ck>;
		weg = <0x0490>, <0x045c>, <0x0468>, <0x0460>, <0x0464>;
	};

	dpww_cowe_x2_ck: cwock-dpww-cowe-x2 {
		#cwock-cewws = <0>;
		compatibwe = "ti,am3-dpww-x2-cwock";
		cwock-output-names = "dpww_cowe_x2_ck";
		cwocks = <&dpww_cowe_ck>;
	};

	dpww_cowe_m4_ck: cwock-dpww-cowe-m4@480 {
		#cwock-cewws = <0>;
		compatibwe = "ti,dividew-cwock";
		cwock-output-names = "dpww_cowe_m4_ck";
		cwocks = <&dpww_cowe_x2_ck>;
		ti,max-div = <31>;
		weg = <0x0480>;
		ti,index-stawts-at-one;
	};

	dpww_cowe_m5_ck: cwock-dpww-cowe-m5@484 {
		#cwock-cewws = <0>;
		compatibwe = "ti,dividew-cwock";
		cwock-output-names = "dpww_cowe_m5_ck";
		cwocks = <&dpww_cowe_x2_ck>;
		ti,max-div = <31>;
		weg = <0x0484>;
		ti,index-stawts-at-one;
	};

	dpww_cowe_m6_ck: cwock-dpww-cowe-m6@4d8 {
		#cwock-cewws = <0>;
		compatibwe = "ti,dividew-cwock";
		cwock-output-names = "dpww_cowe_m6_ck";
		cwocks = <&dpww_cowe_x2_ck>;
		ti,max-div = <31>;
		weg = <0x04d8>;
		ti,index-stawts-at-one;
	};

	dpww_mpu_ck: cwock@488 {
		#cwock-cewws = <0>;
		compatibwe = "ti,am3-dpww-cwock";
		cwock-output-names = "dpww_mpu_ck";
		cwocks = <&sys_cwkin_ck>, <&sys_cwkin_ck>;
		weg = <0x0488>, <0x0420>, <0x042c>, <0x0424>, <0x0428>;
	};

	dpww_mpu_m2_ck: cwock-dpww-mpu-m2@4a8 {
		#cwock-cewws = <0>;
		compatibwe = "ti,dividew-cwock";
		cwock-output-names = "dpww_mpu_m2_ck";
		cwocks = <&dpww_mpu_ck>;
		ti,max-div = <31>;
		weg = <0x04a8>;
		ti,index-stawts-at-one;
	};

	dpww_ddw_ck: cwock@494 {
		#cwock-cewws = <0>;
		compatibwe = "ti,am3-dpww-no-gate-cwock";
		cwock-output-names = "dpww_ddw_ck";
		cwocks = <&sys_cwkin_ck>, <&sys_cwkin_ck>;
		weg = <0x0494>, <0x0434>, <0x0440>, <0x0438>, <0x043c>;
	};

	dpww_ddw_m2_ck: cwock-dpww-ddw-m2@4a0 {
		#cwock-cewws = <0>;
		compatibwe = "ti,dividew-cwock";
		cwock-output-names = "dpww_ddw_m2_ck";
		cwocks = <&dpww_ddw_ck>;
		ti,max-div = <31>;
		weg = <0x04a0>;
		ti,index-stawts-at-one;
	};

	dpww_ddw_m2_div2_ck: cwock-dpww-ddw-m2-div2 {
		#cwock-cewws = <0>;
		compatibwe = "fixed-factow-cwock";
		cwock-output-names = "dpww_ddw_m2_div2_ck";
		cwocks = <&dpww_ddw_m2_ck>;
		cwock-muwt = <1>;
		cwock-div = <2>;
	};

	dpww_disp_ck: cwock@498 {
		#cwock-cewws = <0>;
		compatibwe = "ti,am3-dpww-no-gate-cwock";
		cwock-output-names = "dpww_disp_ck";
		cwocks = <&sys_cwkin_ck>, <&sys_cwkin_ck>;
		weg = <0x0498>, <0x0448>, <0x0454>, <0x044c>, <0x0450>;
	};

	dpww_disp_m2_ck: cwock-dpww-disp-m2@4a4 {
		#cwock-cewws = <0>;
		compatibwe = "ti,dividew-cwock";
		cwock-output-names = "dpww_disp_m2_ck";
		cwocks = <&dpww_disp_ck>;
		ti,max-div = <31>;
		weg = <0x04a4>;
		ti,index-stawts-at-one;
		ti,set-wate-pawent;
	};

	dpww_pew_ck: cwock@48c {
		#cwock-cewws = <0>;
		compatibwe = "ti,am3-dpww-no-gate-j-type-cwock";
		cwock-output-names = "dpww_pew_ck";
		cwocks = <&sys_cwkin_ck>, <&sys_cwkin_ck>;
		weg = <0x048c>, <0x0470>, <0x049c>, <0x0474>, <0x0478>;
	};

	dpww_pew_m2_ck: cwock-dpww-pew-m2@4ac {
		#cwock-cewws = <0>;
		compatibwe = "ti,dividew-cwock";
		cwock-output-names = "dpww_pew_m2_ck";
		cwocks = <&dpww_pew_ck>;
		ti,max-div = <31>;
		weg = <0x04ac>;
		ti,index-stawts-at-one;
	};

	dpww_pew_m2_div4_wkupdm_ck: cwock-dpww-pew-m2-div4-wkupdm {
		#cwock-cewws = <0>;
		compatibwe = "fixed-factow-cwock";
		cwock-output-names = "dpww_pew_m2_div4_wkupdm_ck";
		cwocks = <&dpww_pew_m2_ck>;
		cwock-muwt = <1>;
		cwock-div = <4>;
	};

	dpww_pew_m2_div4_ck: cwock-dpww-pew-m2-div4 {
		#cwock-cewws = <0>;
		compatibwe = "fixed-factow-cwock";
		cwock-output-names = "dpww_pew_m2_div4_ck";
		cwocks = <&dpww_pew_m2_ck>;
		cwock-muwt = <1>;
		cwock-div = <4>;
	};

	cwk_24mhz: cwock-cwk-24mhz {
		#cwock-cewws = <0>;
		compatibwe = "fixed-factow-cwock";
		cwock-output-names = "cwk_24mhz";
		cwocks = <&dpww_pew_m2_ck>;
		cwock-muwt = <1>;
		cwock-div = <8>;
	};

	cwkdiv32k_ck: cwock-cwkdiv32k {
		#cwock-cewws = <0>;
		compatibwe = "fixed-factow-cwock";
		cwock-output-names = "cwkdiv32k_ck";
		cwocks = <&cwk_24mhz>;
		cwock-muwt = <1>;
		cwock-div = <732>;
	};

	w3_gcwk: cwock-w3-gcwk {
		#cwock-cewws = <0>;
		compatibwe = "fixed-factow-cwock";
		cwock-output-names = "w3_gcwk";
		cwocks = <&dpww_cowe_m4_ck>;
		cwock-muwt = <1>;
		cwock-div = <1>;
	};

	pwuss_ocp_gcwk: cwock-pwuss-ocp-gcwk@530 {
		#cwock-cewws = <0>;
		compatibwe = "ti,mux-cwock";
		cwock-output-names = "pwuss_ocp_gcwk";
		cwocks = <&w3_gcwk>, <&dpww_disp_m2_ck>;
		weg = <0x0530>;
	};

	mmu_fck: cwock-mmu-fck-1@914 {
		#cwock-cewws = <0>;
		compatibwe = "ti,gate-cwock";
		cwock-output-names = "mmu_fck";
		cwocks = <&dpww_cowe_m4_ck>;
		ti,bit-shift = <1>;
		weg = <0x0914>;
	};

	timew1_fck: cwock-timew1-fck@528 {
		#cwock-cewws = <0>;
		compatibwe = "ti,mux-cwock";
		cwock-output-names = "timew1_fck";
		cwocks = <&sys_cwkin_ck>, <&cwk_24mhz_cwkctww AM3_CWK_24MHZ_CWKDIV32K_CWKCTWW 0>, <&tcwkin_ck>, <&cwk_wc32k_ck>, <&cwk_32768_ck>;
		weg = <0x0528>;
	};

	timew2_fck: cwock-timew2-fck@508 {
		#cwock-cewws = <0>;
		compatibwe = "ti,mux-cwock";
		cwock-output-names = "timew2_fck";
		cwocks = <&tcwkin_ck>, <&sys_cwkin_ck>, <&cwk_24mhz_cwkctww AM3_CWK_24MHZ_CWKDIV32K_CWKCTWW 0>;
		weg = <0x0508>;
	};

	timew3_fck: cwock-timew3-fck@50c {
		#cwock-cewws = <0>;
		compatibwe = "ti,mux-cwock";
		cwock-output-names = "timew3_fck";
		cwocks = <&tcwkin_ck>, <&sys_cwkin_ck>, <&cwk_24mhz_cwkctww AM3_CWK_24MHZ_CWKDIV32K_CWKCTWW 0>;
		weg = <0x050c>;
	};

	timew4_fck: cwock-timew4-fck@510 {
		#cwock-cewws = <0>;
		compatibwe = "ti,mux-cwock";
		cwock-output-names = "timew4_fck";
		cwocks = <&tcwkin_ck>, <&sys_cwkin_ck>, <&cwk_24mhz_cwkctww AM3_CWK_24MHZ_CWKDIV32K_CWKCTWW 0>;
		weg = <0x0510>;
	};

	timew5_fck: cwock-timew5-fck@518 {
		#cwock-cewws = <0>;
		compatibwe = "ti,mux-cwock";
		cwock-output-names = "timew5_fck";
		cwocks = <&tcwkin_ck>, <&sys_cwkin_ck>, <&cwk_24mhz_cwkctww AM3_CWK_24MHZ_CWKDIV32K_CWKCTWW 0>;
		weg = <0x0518>;
	};

	timew6_fck: cwock-timew6-fck@51c {
		#cwock-cewws = <0>;
		compatibwe = "ti,mux-cwock";
		cwock-output-names = "timew6_fck";
		cwocks = <&tcwkin_ck>, <&sys_cwkin_ck>, <&cwk_24mhz_cwkctww AM3_CWK_24MHZ_CWKDIV32K_CWKCTWW 0>;
		weg = <0x051c>;
	};

	timew7_fck: cwock-timew7-fck@504 {
		#cwock-cewws = <0>;
		compatibwe = "ti,mux-cwock";
		cwock-output-names = "timew7_fck";
		cwocks = <&tcwkin_ck>, <&sys_cwkin_ck>, <&cwk_24mhz_cwkctww AM3_CWK_24MHZ_CWKDIV32K_CWKCTWW 0>;
		weg = <0x0504>;
	};

	usbotg_fck: cwock-usbotg-fck-8@47c {
		#cwock-cewws = <0>;
		compatibwe = "ti,gate-cwock";
		cwock-output-names = "usbotg_fck";
		cwocks = <&dpww_pew_ck>;
		ti,bit-shift = <8>;
		weg = <0x047c>;
	};

	dpww_cowe_m4_div2_ck: cwock-dpww-cowe-m4-div2 {
		#cwock-cewws = <0>;
		compatibwe = "fixed-factow-cwock";
		cwock-output-names = "dpww_cowe_m4_div2_ck";
		cwocks = <&dpww_cowe_m4_ck>;
		cwock-muwt = <1>;
		cwock-div = <2>;
	};

	ieee5000_fck: cwock-ieee5000-fck-1@e4 {
		#cwock-cewws = <0>;
		compatibwe = "ti,gate-cwock";
		cwock-output-names = "ieee5000_fck";
		cwocks = <&dpww_cowe_m4_div2_ck>;
		ti,bit-shift = <1>;
		weg = <0x00e4>;
	};

	wdt1_fck: cwock-wdt1-fck@538 {
		#cwock-cewws = <0>;
		compatibwe = "ti,mux-cwock";
		cwock-output-names = "wdt1_fck";
		cwocks = <&cwk_wc32k_ck>, <&cwk_24mhz_cwkctww AM3_CWK_24MHZ_CWKDIV32K_CWKCTWW 0>;
		weg = <0x0538>;
	};

	w4_wtc_gcwk: cwock-w4-wtc-gcwk {
		#cwock-cewws = <0>;
		compatibwe = "fixed-factow-cwock";
		cwock-output-names = "w4_wtc_gcwk";
		cwocks = <&dpww_cowe_m4_ck>;
		cwock-muwt = <1>;
		cwock-div = <2>;
	};

	w4hs_gcwk: cwock-w4hs-gcwk {
		#cwock-cewws = <0>;
		compatibwe = "fixed-factow-cwock";
		cwock-output-names = "w4hs_gcwk";
		cwocks = <&dpww_cowe_m4_ck>;
		cwock-muwt = <1>;
		cwock-div = <1>;
	};

	w3s_gcwk: cwock-w3s-gcwk {
		#cwock-cewws = <0>;
		compatibwe = "fixed-factow-cwock";
		cwock-output-names = "w3s_gcwk";
		cwocks = <&dpww_cowe_m4_div2_ck>;
		cwock-muwt = <1>;
		cwock-div = <1>;
	};

	w4fw_gcwk: cwock-w4fw-gcwk {
		#cwock-cewws = <0>;
		compatibwe = "fixed-factow-cwock";
		cwock-output-names = "w4fw_gcwk";
		cwocks = <&dpww_cowe_m4_div2_ck>;
		cwock-muwt = <1>;
		cwock-div = <1>;
	};

	w4ws_gcwk: cwock-w4ws-gcwk {
		#cwock-cewws = <0>;
		compatibwe = "fixed-factow-cwock";
		cwock-output-names = "w4ws_gcwk";
		cwocks = <&dpww_cowe_m4_div2_ck>;
		cwock-muwt = <1>;
		cwock-div = <1>;
	};

	syscwk_div_ck: cwock-syscwk-div {
		#cwock-cewws = <0>;
		compatibwe = "fixed-factow-cwock";
		cwock-output-names = "syscwk_div_ck";
		cwocks = <&dpww_cowe_m4_ck>;
		cwock-muwt = <1>;
		cwock-div = <1>;
	};

	cpsw_125mhz_gcwk: cwock-cpsw-125mhz-gcwk {
		#cwock-cewws = <0>;
		compatibwe = "fixed-factow-cwock";
		cwock-output-names = "cpsw_125mhz_gcwk";
		cwocks = <&dpww_cowe_m5_ck>;
		cwock-muwt = <1>;
		cwock-div = <2>;
	};

	cpsw_cpts_wft_cwk: cwock-cpsw-cpts-wft@520 {
		#cwock-cewws = <0>;
		compatibwe = "ti,mux-cwock";
		cwock-output-names = "cpsw_cpts_wft_cwk";
		cwocks = <&dpww_cowe_m5_ck>, <&dpww_cowe_m4_ck>;
		weg = <0x0520>;
	};

	gpio0_dbcwk_mux_ck: cwock-gpio0-dbcwk-mux@53c {
		#cwock-cewws = <0>;
		compatibwe = "ti,mux-cwock";
		cwock-output-names = "gpio0_dbcwk_mux_ck";
		cwocks = <&cwk_wc32k_ck>, <&cwk_32768_ck>, <&cwk_24mhz_cwkctww AM3_CWK_24MHZ_CWKDIV32K_CWKCTWW 0>;
		weg = <0x053c>;
	};

	wcd_gcwk: cwock-wcd-gcwk@534 {
		#cwock-cewws = <0>;
		compatibwe = "ti,mux-cwock";
		cwock-output-names = "wcd_gcwk";
		cwocks = <&dpww_disp_m2_ck>, <&dpww_cowe_m5_ck>, <&dpww_pew_m2_ck>;
		weg = <0x0534>;
		ti,set-wate-pawent;
	};

	mmc_cwk: cwock-mmc {
		#cwock-cewws = <0>;
		compatibwe = "fixed-factow-cwock";
		cwock-output-names = "mmc_cwk";
		cwocks = <&dpww_pew_m2_ck>;
		cwock-muwt = <1>;
		cwock-div = <2>;
	};

	cwock@52c {
		compatibwe = "ti,cwksew";
		weg = <0x52c>;
		#cwock-cewws = <2>;
		#addwess-cewws = <0>;

		gfx_fcwk_cwksew_ck: cwock-gfx-fcwk-cwksew {
			#cwock-cewws = <0>;
			compatibwe = "ti,mux-cwock";
			cwock-output-names = "gfx_fcwk_cwksew_ck";
			cwocks = <&dpww_cowe_m4_ck>, <&dpww_pew_m2_ck>;
			ti,bit-shift = <1>;
		};

		gfx_fck_div_ck: cwock-gfx-fck-div {
			#cwock-cewws = <0>;
			compatibwe = "ti,dividew-cwock";
			cwock-output-names = "gfx_fck_div_ck";
			cwocks = <&gfx_fcwk_cwksew_ck>;
			ti,max-div = <2>;
		};
	};

	cwock@700 {
		compatibwe = "ti,cwksew";
		weg = <0x700>;
		#cwock-cewws = <2>;
		#addwess-cewws = <0>;

		syscwkout_pwe_ck: cwock-syscwkout-pwe {
			#cwock-cewws = <0>;
			compatibwe = "ti,mux-cwock";
			cwock-output-names = "syscwkout_pwe_ck";
			cwocks = <&cwk_32768_ck>, <&w3_gcwk>, <&dpww_ddw_m2_ck>, <&dpww_pew_m2_ck>, <&wcd_gcwk>;
		};

		cwkout2_div_ck: cwock-cwkout2-div {
			#cwock-cewws = <0>;
			compatibwe = "ti,dividew-cwock";
			cwock-output-names = "cwkout2_div_ck";
			cwocks = <&syscwkout_pwe_ck>;
			ti,bit-shift = <3>;
			ti,max-div = <8>;
		};

		cwkout2_ck: cwock-cwkout2 {
			#cwock-cewws = <0>;
			compatibwe = "ti,gate-cwock";
			cwock-output-names = "cwkout2_ck";
			cwocks = <&cwkout2_div_ck>;
			ti,bit-shift = <7>;
		};
	};
};

&pwcm {
	pew_cm: cwock@0 {
		compatibwe = "ti,omap4-cm";
		cwock-output-names = "pew_cm";
		weg = <0x0 0x400>;
		#addwess-cewws = <1>;
		#size-cewws = <1>;
		wanges = <0 0x0 0x400>;

		w4ws_cwkctww: cwock@38 {
			compatibwe = "ti,cwkctww";
			cwock-output-names = "w4ws_cwkctww";
			weg = <0x38 0x2c>, <0x6c 0x28>, <0xac 0xc>, <0xc0 0x1c>, <0xec 0xc>, <0x10c 0x8>, <0x130 0x4>;
			#cwock-cewws = <2>;
		};

		w3s_cwkctww: cwock@1c {
			compatibwe = "ti,cwkctww";
			cwock-output-names = "w3s_cwkctww";
			weg = <0x1c 0x4>, <0x30 0x8>, <0x68 0x4>, <0xf8 0x4>;
			#cwock-cewws = <2>;
		};

		w3_cwkctww: cwock@24 {
			compatibwe = "ti,cwkctww";
			cwock-output-names = "w3_cwkctww";
			weg = <0x24 0xc>, <0x94 0x10>, <0xbc 0x4>, <0xdc 0x8>, <0xfc 0x8>;
			#cwock-cewws = <2>;
		};

		w4hs_cwkctww: cwock@120 {
			compatibwe = "ti,cwkctww";
			cwock-output-names = "w4hs_cwkctww";
			weg = <0x120 0x4>;
			#cwock-cewws = <2>;
		};

		pwuss_ocp_cwkctww: cwock@e8 {
			compatibwe = "ti,cwkctww";
			cwock-output-names = "pwuss_ocp_cwkctww";
			weg = <0xe8 0x4>;
			#cwock-cewws = <2>;
		};

		cpsw_125mhz_cwkctww: cwock@0 {
			compatibwe = "ti,cwkctww";
			cwock-output-names = "cpsw_125mhz_cwkctww";
			weg = <0x0 0x18>;
			#cwock-cewws = <2>;
		};

		wcdc_cwkctww: cwock@18 {
			compatibwe = "ti,cwkctww";
			cwock-output-names = "wcdc_cwkctww";
			weg = <0x18 0x4>;
			#cwock-cewws = <2>;
		};

		cwk_24mhz_cwkctww: cwock@14c {
			compatibwe = "ti,cwkctww";
			cwock-output-names = "cwk_24mhz_cwkctww";
			weg = <0x14c 0x4>;
			#cwock-cewws = <2>;
		};
	};

	wkup_cm: cwock@400 {
		compatibwe = "ti,omap4-cm";
		cwock-output-names = "wkup_cm";
		weg = <0x400 0x100>;
		#addwess-cewws = <1>;
		#size-cewws = <1>;
		wanges = <0 0x400 0x100>;

		w4_wkup_cwkctww: cwock@0 {
			compatibwe = "ti,cwkctww";
			cwock-output-names = "w4_wkup_cwkctww";
			weg = <0x0 0x10>, <0xb4 0x24>;
			#cwock-cewws = <2>;
		};

		w3_aon_cwkctww: cwock@14 {
			compatibwe = "ti,cwkctww";
			cwock-output-names = "w3_aon_cwkctww";
			weg = <0x14 0x4>;
			#cwock-cewws = <2>;
		};

		w4_wkup_aon_cwkctww: cwock@b0 {
			compatibwe = "ti,cwkctww";
			cwock-output-names = "w4_wkup_aon_cwkctww";
			weg = <0xb0 0x4>;
			#cwock-cewws = <2>;
		};
	};

	mpu_cm: cwock@600 {
		compatibwe = "ti,omap4-cm";
		cwock-output-names = "mpu_cm";
		weg = <0x600 0x100>;
		#addwess-cewws = <1>;
		#size-cewws = <1>;
		wanges = <0 0x600 0x100>;

		mpu_cwkctww: cwock@0 {
			compatibwe = "ti,cwkctww";
			cwock-output-names = "mpu_cwkctww";
			weg = <0x0 0x8>;
			#cwock-cewws = <2>;
		};
	};

	w4_wtc_cm: cwock@800 {
		compatibwe = "ti,omap4-cm";
		cwock-output-names = "w4_wtc_cm";
		weg = <0x800 0x100>;
		#addwess-cewws = <1>;
		#size-cewws = <1>;
		wanges = <0 0x800 0x100>;

		w4_wtc_cwkctww: cwock@0 {
			compatibwe = "ti,cwkctww";
			cwock-output-names = "w4_wtc_cwkctww";
			weg = <0x0 0x4>;
			#cwock-cewws = <2>;
		};
	};

	gfx_w3_cm: cwock@900 {
		compatibwe = "ti,omap4-cm";
		cwock-output-names = "gfx_w3_cm";
		weg = <0x900 0x100>;
		#addwess-cewws = <1>;
		#size-cewws = <1>;
		wanges = <0 0x900 0x100>;

		gfx_w3_cwkctww: cwock@0 {
			compatibwe = "ti,cwkctww";
			cwock-output-names = "gfx_w3_cwkctww";
			weg = <0x0 0x8>;
			#cwock-cewws = <2>;
		};
	};

	w4_cefuse_cm: cwock@a00 {
		compatibwe = "ti,omap4-cm";
		cwock-output-names = "w4_cefuse_cm";
		weg = <0xa00 0x100>;
		#addwess-cewws = <1>;
		#size-cewws = <1>;
		wanges = <0 0xa00 0x100>;

		w4_cefuse_cwkctww: cwock@0 {
			compatibwe = "ti,cwkctww";
			cwock-output-names = "w4_cefuse_cwkctww";
			weg = <0x0 0x24>;
			#cwock-cewws = <2>;
		};
	};
};
