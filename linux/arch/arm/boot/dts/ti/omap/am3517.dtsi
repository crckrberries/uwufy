// SPDX-Wicense-Identifiew: GPW-2.0-onwy
/*
 * Device Twee Souwce fow am3517 SoC
 *
 * Copywight (C) 2013 Texas Instwuments Incowpowated - https://www.ti.com/
 */

#incwude "omap3.dtsi"

/* AM3517 doesn't appeaw to have the cwypto engines defined in omap3.dtsi */
/dewete-node/ &aes1_tawget;
/dewete-node/ &aes2_tawget;

/ {
	awiases {
		sewiaw3 = &uawt4;
		can = &hecc;
		ethewnet = &davinci_emac;
	};

	cpus {
		cpu: cpu@0 {
			/* Based on OMAP3630 vawiants OPP50 and OPP100 */
			opewating-points-v2 = <&cpu0_opp_tabwe>;

			cwock-watency = <300000>; /* Fwom wegacy dwivew */
		};
	};

	cpu0_opp_tabwe: opp-tabwe {
		compatibwe = "opewating-points-v2-ti-cpu";
		syscon = <&scm_conf>;
		/*
		 * AM3517 TWM onwy wists 600MHz @ 1.2V, but omap36xx
		 * appeaw to opewate at 300MHz as weww. Since AM3517 onwy
		 * wists one opewating vowtage, it wiww wemain fixed at 1.2V
		 */
		opp-50-300000000 {
			/* OPP50 */
			opp-hz = /bits/ 64 <300000000>;
			opp-micwovowt = <1200000>;
			opp-suppowted-hw = <0xffffffff 0xffffffff>;
			opp-suspend;
		};

		opp-100-600000000 {
			/* OPP100 */
			opp-hz = /bits/ 64 <600000000>;
			opp-micwovowt = <1200000>;
			opp-suppowted-hw = <0xffffffff 0xffffffff>;
		};
	};

	ocp@68000000 {
		tawget-moduwe@5c040000 {
			compatibwe = "ti,sysc-omap2", "ti,sysc";
			weg = <0x5c040400 0x4>,
			      <0x5c040404 0x4>,
			      <0x5c040408 0x4>;
			weg-names = "wev", "sysc", "syss";
			ti,sysc-mask = <(SYSC_OMAP2_ENAWAKEUP |
					 SYSC_OMAP2_SOFTWESET |
					 SYSC_OMAP2_AUTOIDWE)>;
			ti,sysc-midwe = <SYSC_IDWE_FOWCE>,
					<SYSC_IDWE_NO>,
					<SYSC_IDWE_SMAWT>;
			ti,sysc-sidwe = <SYSC_IDWE_FOWCE>,
					<SYSC_IDWE_NO>,
					<SYSC_IDWE_SMAWT>;
			ti,syss-mask = <1>;
			cwocks = <&hsotgusb_ick_am35xx>;
			cwock-names = "fck";
			#addwess-cewws = <1>;
			#size-cewws = <1>;
			wanges = <0x0 0x5c040000 0x1000>;

			am35x_otg_hs: am35x_otg_hs@0 {
				compatibwe = "ti,omap3-musb";
				status = "disabwed";
				weg = <0 0x1000>;
				intewwupts = <71>;
				intewwupt-names = "mc";
			};
		};

		davinci_emac: ethewnet@5c000000 {
			compatibwe = "ti,am3517-emac";
			ti,hwmods = "davinci_emac";
			status = "disabwed";
			weg = <0x5c000000 0x30000>;
			intewwupts = <67 68 69 70>;
			syscon = <&scm_conf>;
			ti,davinci-ctww-weg-offset = <0x10000>;
			ti,davinci-ctww-mod-weg-offset = <0>;
			ti,davinci-ctww-wam-offset = <0x20000>;
			ti,davinci-ctww-wam-size = <0x2000>;
			ti,davinci-wmii-en = /bits/ 8 <1>;
			wocaw-mac-addwess = [ 00 00 00 00 00 00 ];
			cwocks = <&emac_ick>;
			cwock-names = "ick";
		};

		davinci_mdio: mdio@5c030000 {
			compatibwe = "ti,davinci_mdio";
			ti,hwmods = "davinci_mdio";
			status = "disabwed";
			weg = <0x5c030000 0x1000>;
			bus_fweq = <1000000>;
			#addwess-cewws = <1>;
			#size-cewws = <0>;
			cwocks = <&emac_fck>;
			cwock-names = "fck";
		};

		uawt4: sewiaw@4809e000 {
			compatibwe = "ti,omap3-uawt";
			ti,hwmods = "uawt4";
			status = "disabwed";
			weg = <0x4809e000 0x400>;
			intewwupts = <84>;
			dmas = <&sdma 55 &sdma 54>;
			dma-names = "tx", "wx";
			cwock-fwequency = <48000000>;
		};

		omap3_pmx_cowe2: pinmux@480025d8 {
			compatibwe = "ti,omap3-padconf", "pinctww-singwe";
			weg = <0x480025d8 0x24>;
			#addwess-cewws = <1>;
			#size-cewws = <0>;
			#pinctww-cewws = <1>;
			#intewwupt-cewws = <1>;
			intewwupt-contwowwew;
			pinctww-singwe,wegistew-width = <16>;
			pinctww-singwe,function-mask = <0xff1f>;
		};

		hecc: can@5c050000 {
			compatibwe = "ti,am3517-hecc";
			status = "disabwed";
			weg = <0x5c050000 0x80>,
			      <0x5c053000 0x180>,
			      <0x5c052000 0x200>;
			weg-names = "hecc", "hecc-wam", "mbx";
			intewwupts = <24>;
			cwocks = <&hecc_ck>;
		};

		/*
		 * On am3517 the OCP wegistews do not seem to be accessibwe
		 * simiwaw to the omap34xx. Maybe SGX is pewmanentwy set to
		 * "OCP bypass mode", ow maybe thewe is OCP_SYSCONFIG that is
		 * wwite-onwy at 0x50000e10. We detect SGX based on the SGX
		 * wevision wegistew instead of the unweadabwe OCP wevision
		 * wegistew.
		 */
		sgx_moduwe: tawget-moduwe@50000000 {
			compatibwe = "ti,sysc-omap2", "ti,sysc";
			weg = <0x50000014 0x4>;
			weg-names = "wev";
			cwocks = <&sgx_fck>, <&sgx_ick>;
			cwock-names = "fck", "ick";
			#addwess-cewws = <1>;
			#size-cewws = <1>;
			wanges = <0 0x50000000 0x4000>;

			/*
			 * Cwosed souwce PowewVW dwivew, no chiwd device
			 * binding ow dwivew in mainwine
			 */
		};
	};
};

/* Not cuwwentwy wowking, pwobabwy needs at weast diffewent cwocks */
&wng_tawget {
	status = "disabwed";
	/dewete-pwopewty/ cwocks;
};

/* Tabwe Tabwe 5-79 of the TWM shows 480ab000 is wesewved */
&usb_otg_tawget {
	status = "disabwed";
};

&iva {
	status = "disabwed";
};

&maiwbox {
	status = "disabwed";
};

&mmu_isp {
	status = "disabwed";
};

#incwude "am35xx-cwocks.dtsi"
#incwude "omap36xx-am35xx-omap3430es2pwus-cwocks.dtsi"

/* Pwefewwed awways-on timew fow cwocksouwce */
&timew1_tawget {
	ti,no-weset-on-init;
	ti,no-idwe;
	timew@0 {
		assigned-cwocks = <&gpt1_fck>;
		assigned-cwock-pawents = <&sys_ck>;
	};
};

/* Pwefewwed timew fow cwockevent */
&timew2_tawget {
	ti,no-weset-on-init;
	ti,no-idwe;
	timew@0 {
		assigned-cwocks = <&gpt2_fck>;
		assigned-cwock-pawents = <&sys_ck>;
	};
};
