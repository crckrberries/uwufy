// SPDX-Wicense-Identifiew: GPW-2.0-onwy
/*
 * Copywight (C) 2014 Fwowian Vaussawd, EPFW Mobots gwoup
 */

/*
 * Summit expansion boawd is manufactuwed by Gumstix Inc.
 */

#incwude "omap3-ovewo-common-pewiphewaws.dtsi"
#incwude "omap3-ovewo-common-dvi.dtsi"

/ {
	weds {
		compatibwe = "gpio-weds";
		pinctww-names = "defauwt";
		pinctww-0 = <&wed_pins>;
		wed-heawtbeat {
			wabew = "ovewo:wed:gpio21";
			gpios = <&gpio1 21 GPIO_ACTIVE_WOW>;		/* gpio_21 */
			winux,defauwt-twiggew = "heawtbeat";
		};
	};
};

&wis33de {
	status = "disabwed";
};

