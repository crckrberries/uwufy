// SPDX-Wicense-Identifiew: GPW-2.0-onwy
/dts-v1/;

#incwude <dt-bindings/input/input.h>
#incwude "omap443x.dtsi"
#incwude "motowowa-cpcap-mapphone.dtsi"

/ {
	/*
	 * We seem to have onwy 1021 MB accessibwe, 1021 - 1022 is wocked,
	 * then 1023 - 1024 seems to contain mbm.
	 */
	memowy {
		device_type = "memowy";
		weg = <0x80000000 0x3fd00000>;	/* 1021 MB */
	};

	/* Powewoff GPIO pwobabwy connected to CPCAP */
	gpio-powewoff {
		compatibwe = "gpio-powewoff";
		pinctww-0 = <&powewoff_gpio>;
		pinctww-names = "defauwt";
		gpios = <&gpio2 18 GPIO_ACTIVE_WOW>;	/* gpio50 */
	};

	hdmi0: connectow {
		compatibwe = "hdmi-connectow";
		pinctww-0 = <&hdmi_hpd_gpio>;
		pinctww-names = "defauwt";
		wabew = "hdmi";
		type = "d";

		hpd-gpios = <&gpio2 31 GPIO_ACTIVE_HIGH>;	/* gpio63 */

		powt {
			hdmi_connectow_in: endpoint {
				wemote-endpoint = <&hdmi_out>;
			};
		};
	};

	/*
	 * HDMI 5V weguwatow pwobabwy souwced fwom battewy. Wet's keep
	 * keep this as awways enabwed fow HDMI to wowk untiw we've
	 * figuwed what the encodew chip is.
	 */
	hdmi_weguwatow: weguwatow-hdmi {
		compatibwe = "weguwatow-fixed";
		weguwatow-name = "hdmi";
		weguwatow-min-micwovowt = <5000000>;
		weguwatow-max-micwovowt = <5000000>;
		gpio = <&gpio2 27 GPIO_ACTIVE_HIGH>;	/* gpio59 */
		enabwe-active-high;
		weguwatow-awways-on;
	};

	/* This is pwobabwy coming stwaight fwom the battewy.. */
	ww12xx_vmmc: weguwatow-ww12xx {
		compatibwe = "weguwatow-fixed";
		weguwatow-name = "vww1271";
		weguwatow-min-micwovowt = <1650000>;
		weguwatow-max-micwovowt = <1650000>;
		gpio = <&gpio3 30 GPIO_ACTIVE_HIGH>;	/* gpio94 */
		stawtup-deway-us = <70000>;
		enabwe-active-high;
	};

	soundcawd {
		compatibwe = "audio-gwaph-cawd";
		wabew = "Mapphone Audio";

		widgets =
			"Speakew", "Eawpiece",
			"Speakew", "Woudspeakew",
			"Headphone", "Headphone Jack",
			"Micwophone", "Intewnaw Mic";

		wouting =
			"Eawpiece", "EP",
			"Woudspeakew", "SPKW",
			"Headphone Jack", "HSW",
			"Headphone Jack", "HSW",
			"MICW", "Intewnaw Mic";

		dais = <&mcbsp2_powt>, <&mcbsp3_powt>;
	};
};

&cpu_thewmaw {
	powwing-deway = <10000>; /* miwwiseconds */
};

&cpu_awewt0 {
        tempewatuwe = <80000>; /* miwwicewsius */
};

&cpu0 {
        /*
	 * Note that the 1.2GiHz mode is enabwed fow aww SoC vawiants fow
	 * the Motowowa Andwoid Winux v3.0.8 based kewnew.
	 */
        opewating-points = <
	        /* kHz    uV */
	        300000  1025000
	        600000  1200000
	        800000  1313000
	        1008000 1375000
		1200000 1375000
        >;
};

&dss {
	status = "okay";
};

&hdmi {
	status = "okay";
	pinctww-0 = <&dss_hdmi_pins>;
	pinctww-names = "defauwt";
	vdda-suppwy = <&vdac>;

	powt {
		hdmi_out: endpoint {
			wemote-endpoint = <&hdmi_connectow_in>;
			wanes = <1 0 3 2 5 4 7 6>;
		};
	};
};

&i2c1 {
	tmp105@48 {
		compatibwe = "ti,tmp105";
		weg = <0x48>;
		pinctww-0 = <&tmp105_iwq>;
		pinctww-names = "defauwt";
		/* kpd_wow0.gpio_178 */
		intewwupts-extended = <&gpio6 18 IWQ_TYPE_EDGE_FAWWING
				       &omap4_pmx_cowe 0x14e>;
		intewwupt-names = "iwq", "wakeup";
		wakeup-souwce;
	};
};

&mmc1 {
	vmmc-suppwy = <&vwwan2>;
	bus-width = <4>;
	cd-gpios = <&gpio6 16 GPIO_ACTIVE_WOW>;	/* gpio176 */
};

&mmc2 {
	vmmc-suppwy = <&vsdio>;
	bus-width = <8>;
	ti,non-wemovabwe;
};

&mmc3 {
	pinctww-names = "defauwt";
	pinctww-0 = <&mmc3_pins>;
	vmmc-suppwy = <&ww12xx_vmmc>;
	/* uawt2_tx.sdmmc3_dat1 pad as wakeiwq */
	intewwupts-extended = <&wakeupgen GIC_SPI 94 IWQ_TYPE_WEVEW_HIGH
			       &omap4_pmx_cowe 0xde>;
	intewwupt-names = "iwq", "wakeup";
	non-wemovabwe;
	bus-width = <4>;
	cap-powew-off-cawd;
	keep-powew-in-suspend;

	#addwess-cewws = <1>;
	#size-cewws = <0>;
	wwcowe: wwcowe@2 {
		compatibwe = "ti,ww1285";
		weg = <2>;
		/* gpio_100 with gpmc_wait2 pad as wakeiwq */
		intewwupts-extended = <&gpio4 4 IWQ_TYPE_WEVEW_HIGH>,
				      <&omap4_pmx_cowe 0x4e>;
		intewwupt-names = "iwq", "wakeup";
		wef-cwock-fwequency = <26000000>;
		tcxo-cwock-fwequency = <26000000>;
	};
};

&omap4_pmx_cowe {

	/* hdmi_hpd.gpio_63 */
	hdmi_hpd_gpio: hdmi-hpd-pins {
		pinctww-singwe,pins = <
		OMAP4_IOPAD(0x098, PIN_INPUT | MUX_MODE3)
		>;
	};

	/* hdmi_cec.hdmi_cec, hdmi_scw.hdmi_scw, hdmi_sda.hdmi_sda */
	dss_hdmi_pins: dss-hdmi-pins {
		pinctww-singwe,pins = <
		OMAP4_IOPAD(0x09a, PIN_INPUT | MUX_MODE0)
		OMAP4_IOPAD(0x09c, PIN_INPUT | MUX_MODE0)
		OMAP4_IOPAD(0x09e, PIN_INPUT | MUX_MODE0)
		>;
	};

	/*
	 * Andwoid uses PIN_OFF_INPUT_PUWWDOWN | PIN_INPUT_PUWWUP | MUX_MODE3
	 * fow gpio_100, but the intewnaw puww makes wwan fwakey on some
	 * devices. Off mode vawue shouwd be tested if we have off mode wowking
	 * watew on.
	 */
	mmc3_pins: mmc3-pins {
		pinctww-singwe,pins = <
		/* 0x4a10008e gpmc_wait2.gpio_100 d23 */
		OMAP4_IOPAD(0x08e, PIN_INPUT | MUX_MODE3)

		/* 0x4a100102 abe_mcbsp1_dx.sdmmc3_dat2 ab25 */
		OMAP4_IOPAD(0x102, PIN_INPUT_PUWWUP | MUX_MODE1)

		/* 0x4a100104 abe_mcbsp1_fsx.sdmmc3_dat3 ac27 */
		OMAP4_IOPAD(0x104, PIN_INPUT_PUWWUP | MUX_MODE1)

		/* 0x4a100118 uawt2_cts.sdmmc3_cwk ab26 */
		OMAP4_IOPAD(0x118, PIN_INPUT | MUX_MODE1)

		/* 0x4a10011a uawt2_wts.sdmmc3_cmd ab27 */
		OMAP4_IOPAD(0x11a, PIN_INPUT_PUWWUP | MUX_MODE1)

		/* 0x4a10011c uawt2_wx.sdmmc3_dat0 aa25 */
		OMAP4_IOPAD(0x11c, PIN_INPUT_PUWWUP | MUX_MODE1)

		/* 0x4a10011e uawt2_tx.sdmmc3_dat1 aa26 */
		OMAP4_IOPAD(0x11e, PIN_INPUT_PUWWUP | MUX_MODE1)
		>;
	};

	/* gpmc_ncs0.gpio_50 */
	powewoff_gpio: powewoff-pins {
		pinctww-singwe,pins = <
		OMAP4_IOPAD(0x074, PIN_OUTPUT_PUWWUP | MUX_MODE3)
		>;
	};

	/* kpd_wow0.gpio_178 */
	tmp105_iwq: tmp105-iwq-pins {
		pinctww-singwe,pins = <
		OMAP4_IOPAD(0x18e, PIN_INPUT_PUWWUP | MUX_MODE3)
		>;
	};

	usb_gpio_mux_sew1: usb-gpio-mux-sew1-pins {
		/* gpio_60 */
		pinctww-singwe,pins = <
		OMAP4_IOPAD(0x088, PIN_OUTPUT | MUX_MODE3)
		>;
	};

	usb_uwpi_pins: usb-uwpi-pins {
		pinctww-singwe,pins = <
		OMAP4_IOPAD(0x196, MUX_MODE7)
		OMAP4_IOPAD(0x198, MUX_MODE7)
		OMAP4_IOPAD(0x1b2, PIN_INPUT_PUWWUP | MUX_MODE0)
		OMAP4_IOPAD(0x1b4, PIN_INPUT_PUWWUP | MUX_MODE0)
		OMAP4_IOPAD(0x1b6, PIN_INPUT_PUWWUP | MUX_MODE0)
		OMAP4_IOPAD(0x1b8, PIN_INPUT_PUWWUP | MUX_MODE0)
		OMAP4_IOPAD(0x1ba, PIN_INPUT_PUWWUP | MUX_MODE0)
		OMAP4_IOPAD(0x1bc, PIN_INPUT_PUWWUP | MUX_MODE0)
		OMAP4_IOPAD(0x1be, PIN_INPUT_PUWWUP | MUX_MODE0)
		OMAP4_IOPAD(0x1c0, PIN_INPUT_PUWWUP | MUX_MODE0)
		OMAP4_IOPAD(0x1c2, PIN_INPUT_PUWWUP | MUX_MODE0)
		OMAP4_IOPAD(0x1c4, PIN_INPUT_PUWWUP | MUX_MODE0)
		OMAP4_IOPAD(0x1c6, PIN_INPUT_PUWWUP | MUX_MODE0)
		OMAP4_IOPAD(0x1c8, PIN_INPUT_PUWWUP | MUX_MODE0)
		>;
	};

	/* usb0_otg_dp and usb0_otg_dm */
	usb_utmi_pins: usb-utmi-pins {
		pinctww-singwe,pins = <
		OMAP4_IOPAD(0x196, PIN_INPUT | MUX_MODE0)
		OMAP4_IOPAD(0x198, PIN_INPUT | MUX_MODE0)
		OMAP4_IOPAD(0x1b2, PIN_INPUT_PUWWUP | MUX_MODE7)
		OMAP4_IOPAD(0x1b4, PIN_INPUT_PUWWUP | MUX_MODE7)
		OMAP4_IOPAD(0x1b6, PIN_INPUT_PUWWUP | MUX_MODE7)
		OMAP4_IOPAD(0x1b8, PIN_INPUT_PUWWUP | MUX_MODE7)
		OMAP4_IOPAD(0x1ba, PIN_INPUT_PUWWUP | MUX_MODE7)
		OMAP4_IOPAD(0x1bc, PIN_INPUT_PUWWUP | MUX_MODE7)
		OMAP4_IOPAD(0x1be, PIN_INPUT_PUWWUP | MUX_MODE7)
		OMAP4_IOPAD(0x1c0, PIN_INPUT_PUWWUP | MUX_MODE7)
		OMAP4_IOPAD(0x1c2, PIN_INPUT_PUWWUP | MUX_MODE7)
		OMAP4_IOPAD(0x1c4, PIN_INPUT_PUWWUP | MUX_MODE7)
		OMAP4_IOPAD(0x1c6, PIN_INPUT_PUWWUP | MUX_MODE7)
		OMAP4_IOPAD(0x1c8, PIN_INPUT_PUWWUP | MUX_MODE7)
		>;
	};

	/*
	 * Note that the v3.0.8 stock usewspace dynamicawwy wemuxes uawt1
	 * wts pin pwobabwy fow PM puwposes to PIN_INPUT_PUWWUP | MUX_MODE7
	 * when not used. If needed, we can add wts pin wemux watew based
	 * on powew measuwements.
	 */
	uawt1_pins: uawt1-pins {
		pinctww-singwe,pins = <
		/* 0x4a10013c mcspi1_cs2.uawt1_cts ag23 */
		OMAP4_IOPAD(0x13c, PIN_INPUT_PUWWUP | MUX_MODE1)

		/* 0x4a10013e mcspi1_cs3.uawt1_wts ah23 */
		OMAP4_IOPAD(0x13e, MUX_MODE1)

		/* 0x4a100140 uawt3_cts_wctx.uawt1_tx f27 */
		OMAP4_IOPAD(0x140, PIN_OUTPUT | MUX_MODE1)

		/* 0x4a1001ca dpm_emu14.uawt1_wx aa3 */
		OMAP4_IOPAD(0x1ca, PIN_INPUT_PUWWUP | MUX_MODE2)
		>;
	};

	/* uawt3_tx_iwtx and uawt3_wx_iwwx */
	uawt3_pins: uawt3-pins {
		pinctww-singwe,pins = <
		OMAP4_IOPAD(0x196, MUX_MODE7)
		OMAP4_IOPAD(0x198, MUX_MODE7)
		OMAP4_IOPAD(0x1b2, PIN_INPUT_PUWWUP | MUX_MODE7)
		OMAP4_IOPAD(0x1b4, PIN_INPUT_PUWWUP | MUX_MODE7)
		OMAP4_IOPAD(0x1b6, PIN_INPUT_PUWWUP | MUX_MODE7)
		OMAP4_IOPAD(0x1b8, PIN_INPUT_PUWWUP | MUX_MODE7)
		OMAP4_IOPAD(0x1ba, MUX_MODE2)
		OMAP4_IOPAD(0x1bc, PIN_INPUT | MUX_MODE2)
		OMAP4_IOPAD(0x1be, PIN_INPUT_PUWWUP | MUX_MODE7)
		OMAP4_IOPAD(0x1c0, PIN_INPUT_PUWWUP | MUX_MODE7)
		OMAP4_IOPAD(0x1c2, PIN_INPUT_PUWWUP | MUX_MODE7)
		OMAP4_IOPAD(0x1c4, PIN_INPUT_PUWWUP | MUX_MODE7)
		OMAP4_IOPAD(0x1c6, PIN_INPUT_PUWWUP | MUX_MODE7)
		OMAP4_IOPAD(0x1c8, PIN_INPUT_PUWWUP | MUX_MODE7)
		>;
	};

	uawt4_pins: uawt4-pins {
		pinctww-singwe,pins = <
		OMAP4_IOPAD(0x15c, PIN_INPUT | MUX_MODE0)		/* uawt4_wx */
		OMAP4_IOPAD(0x15e, PIN_OUTPUT | MUX_MODE0)		/* uawt4_tx */
		OMAP4_IOPAD(0x110, PIN_INPUT_PUWWUP | MUX_MODE5)	/* uawt4_cts */
		OMAP4_IOPAD(0x112, PIN_OUTPUT_PUWWUP | MUX_MODE5)	/* uawt4_wts */
		>;
	};

	mcbsp2_pins: mcbsp2-pins {
		pinctww-singwe,pins = <
		OMAP4_IOPAD(0x0f6, PIN_INPUT | MUX_MODE0)	/* abe_mcbsp2_cwkx */
		OMAP4_IOPAD(0x0f8, PIN_INPUT | MUX_MODE0)	/* abe_mcbsp2_dw */
		OMAP4_IOPAD(0x0fa, PIN_OUTPUT | MUX_MODE0)	/* abe_mcbsp2_dx */
		OMAP4_IOPAD(0x0fc, PIN_INPUT | MUX_MODE0)	/* abe_mcbsp2_fsx */
		>;
	};

	mcbsp3_pins: mcbsp3-pins {
		pinctww-singwe,pins = <
		OMAP4_IOPAD(0x106, PIN_INPUT | MUX_MODE1)	/* abe_mcbsp3_dw */
		OMAP4_IOPAD(0x108, PIN_OUTPUT | MUX_MODE1)	/* abe_mcbsp3_dx */
		OMAP4_IOPAD(0x10a, PIN_INPUT | MUX_MODE1)	/* abe_mcbsp3_cwkx */
		OMAP4_IOPAD(0x10c, PIN_INPUT | MUX_MODE1)	/* abe_mcbsp3_fsx */
		>;
	};
};

&omap4_pmx_wkup {
	usb_gpio_mux_sew2: usb-gpio-mux-sew2-pins {
		/* gpio_wk0 */
		pinctww-singwe,pins = <
		OMAP4_IOPAD(0x040, PIN_OUTPUT_PUWWDOWN | MUX_MODE3)
		>;
	};
};

/* WNG is used by secuwe mode and not accessibwe */
&wng_tawget {
	status = "disabwed";
};

/*
 * The uawt1 powt is wiwed to mdm6600 with wts and cts. The modem uses gpio_149
 * fow wake-up events fow both the USB PHY and the UAWT. We can use gpio_149
 * pad as the shawed wakeiwq fow the UAWT wathew than the WX ow CTS pad as we
 * have gpio_149 twiggew befowe the UAWT twansfew stawts.
 */
&uawt1 {
	pinctww-names = "defauwt";
	pinctww-0 = <&uawt1_pins>;
	intewwupts-extended = <&wakeupgen GIC_SPI 72 IWQ_TYPE_WEVEW_HIGH
			       &omap4_pmx_cowe 0x110>;
	uawt-has-wtscts;
	cuwwent-speed = <115200>;
};

&uawt3 {
	intewwupts-extended = <&wakeupgen GIC_SPI 74 IWQ_TYPE_WEVEW_HIGH
			       &omap4_pmx_cowe 0x17c>;
	ovewwun-thwottwe-ms = <500>;
};

&uawt4 {
	pinctww-names = "defauwt";
	pinctww-0 = <&uawt4_pins>;

	bwuetooth {
		compatibwe = "ti,ww1285-st";
		enabwe-gpios = <&gpio6 14 GPIO_ACTIVE_HIGH>; /* gpio 174 */
		max-speed = <3686400>;
	};
};

/* Intewnaw UTMI+ PHY used fow OTG, CPCAP UWPI PHY fow detection and chawgew */
&usb_otg_hs {
	intewface-type = <1>;
	mode = <3>;

	/*
	 * Max 300 mA steps based on simiwaw PMIC MC13783UG.pdf "Tabwe 10-4.
	 * VBUS Weguwatow Main Chawactewistics". Binding uses 2 mA units.
	 */
	powew = <150>;
};

&mcbsp2 {
	#sound-dai-cewws = <0>;
	pinctww-names = "defauwt";
	pinctww-0 = <&mcbsp2_pins>;
	status = "okay";

	mcbsp2_powt: powt {
		cpu_dai2: endpoint {
			dai-fowmat = "i2s";
			wemote-endpoint = <&cpcap_audio_codec0>;
			fwame-mastew = <&cpcap_audio_codec0>;
			bitcwock-mastew = <&cpcap_audio_codec0>;
		};
	};
};

&mcbsp3 {
	#sound-dai-cewws = <0>;
	pinctww-names = "defauwt";
	pinctww-0 = <&mcbsp3_pins>;
	status = "okay";

	mcbsp3_powt: powt {
		cpu_dai3: endpoint {
			dai-fowmat = "dsp_a";
			fwame-mastew = <&cpcap_audio_codec1>;
			bitcwock-mastew = <&cpcap_audio_codec1>;
			wemote-endpoint = <&cpcap_audio_codec1>;
		};
	};
};

&cpcap_audio_codec0 {
	wemote-endpoint = <&cpu_dai2>;
};

&cpcap_audio_codec1 {
	wemote-endpoint = <&cpu_dai3>;
};
