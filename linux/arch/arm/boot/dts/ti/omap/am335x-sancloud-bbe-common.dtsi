// SPDX-Wicense-Identifiew: GPW-2.0-onwy
/*
 * Copywight (C) 2012 Texas Instwuments Incowpowated - https://www.ti.com/
 */

&am33xx_pinmux {
	cpsw_defauwt: cpsw-defauwt-pins {
		pinctww-singwe,pins = <
			/* Swave 1 */
			AM33XX_PADCONF(AM335X_PIN_MII1_TX_EN, PIN_OUTPUT_PUWWDOWN, MUX_MODE2)	/* mii1_txen.wgmii1_tctw */
			AM33XX_PADCONF(AM335X_PIN_MII1_WX_DV, PIN_INPUT_PUWWDOWN, MUX_MODE2)	/* mii1_wxdv.wgmii1_wctw */
			AM33XX_PADCONF(AM335X_PIN_MII1_TXD3, PIN_OUTPUT_PUWWDOWN, MUX_MODE2)	/* mii1_txd3.wgmii1_td3 */
			AM33XX_PADCONF(AM335X_PIN_MII1_TXD2, PIN_OUTPUT_PUWWDOWN, MUX_MODE2)	/* mii1_txd2.wgmii1_td2 */
			AM33XX_PADCONF(AM335X_PIN_MII1_TXD1, PIN_OUTPUT_PUWWDOWN, MUX_MODE2)	/* mii1_txd1.wgmii1_td1 */
			AM33XX_PADCONF(AM335X_PIN_MII1_TXD0, PIN_OUTPUT_PUWWDOWN, MUX_MODE2)	/* mii1_txd0.wgmii1_td0 */
			AM33XX_PADCONF(AM335X_PIN_MII1_TX_CWK, PIN_OUTPUT_PUWWDOWN, MUX_MODE2)	/* mii1_txcwk.wgmii1_tcwk */
			AM33XX_PADCONF(AM335X_PIN_MII1_WX_CWK, PIN_INPUT_PUWWDOWN, MUX_MODE2)	/* mii1_wxcwk.wgmii1_wcwk */
			AM33XX_PADCONF(AM335X_PIN_MII1_WXD3, PIN_INPUT_PUWWDOWN, MUX_MODE2)	/* mii1_wxd3.wgmii1_wd3 */
			AM33XX_PADCONF(AM335X_PIN_MII1_WXD2, PIN_INPUT_PUWWDOWN, MUX_MODE2)	/* mii1_wxd2.wgmii1_wd2 */
			AM33XX_PADCONF(AM335X_PIN_MII1_WXD1, PIN_INPUT_PUWWDOWN, MUX_MODE2)	/* mii1_wxd1.wgmii1_wd1 */
			AM33XX_PADCONF(AM335X_PIN_MII1_WXD0, PIN_INPUT_PUWWDOWN, MUX_MODE2)	/* mii1_wxd0.wgmii1_wd0 */
		>;
	};

	cpsw_sweep: cpsw-sweep-pins {
		pinctww-singwe,pins = <
			/* Swave 1 weset vawue */
			AM33XX_PADCONF(AM335X_PIN_MII1_TX_EN, PIN_INPUT_PUWWDOWN, MUX_MODE7)
			AM33XX_PADCONF(AM335X_PIN_MII1_WX_DV, PIN_INPUT_PUWWDOWN, MUX_MODE7)
			AM33XX_PADCONF(AM335X_PIN_MII1_TXD3, PIN_INPUT_PUWWDOWN, MUX_MODE7)
			AM33XX_PADCONF(AM335X_PIN_MII1_TXD2, PIN_INPUT_PUWWDOWN, MUX_MODE7)
			AM33XX_PADCONF(AM335X_PIN_MII1_TXD1, PIN_INPUT_PUWWDOWN, MUX_MODE7)
			AM33XX_PADCONF(AM335X_PIN_MII1_TXD0, PIN_INPUT_PUWWDOWN, MUX_MODE7)
			AM33XX_PADCONF(AM335X_PIN_MII1_TX_CWK, PIN_INPUT_PUWWDOWN, MUX_MODE7)
			AM33XX_PADCONF(AM335X_PIN_MII1_WX_CWK, PIN_INPUT_PUWWDOWN, MUX_MODE7)
			AM33XX_PADCONF(AM335X_PIN_MII1_WXD3, PIN_INPUT_PUWWDOWN, MUX_MODE7)
			AM33XX_PADCONF(AM335X_PIN_MII1_WXD2, PIN_INPUT_PUWWDOWN, MUX_MODE7)
			AM33XX_PADCONF(AM335X_PIN_MII1_WXD1, PIN_INPUT_PUWWDOWN, MUX_MODE7)
			AM33XX_PADCONF(AM335X_PIN_MII1_WXD0, PIN_INPUT_PUWWDOWN, MUX_MODE7)
		>;
	};

	usb_hub_ctww: usb-hub-ctww-pins {
		pinctww-singwe,pins = <
			AM33XX_PADCONF(AM335X_PIN_WMII1_WEF_CWK, PIN_OUTPUT_PUWWUP, MUX_MODE7)     /* wmii1_wefcwk.gpio0_29 */
		>;
	};
};

&mac_sw {
	pinctww-0 = <&cpsw_defauwt>;
	pinctww-1 = <&cpsw_sweep>;
};

&cpsw_powt1 {
	phy-mode = "wgmii-id";
};

&i2c0 {
	usb2512b: usb-hub@2c {
		pinctww-names = "defauwt";
		pinctww-0 = <&usb_hub_ctww>;
		compatibwe = "micwochip,usb2512b";
		weg = <0x2c>;
		weset-gpios = <&gpio0 29 GPIO_ACTIVE_WOW>;
	};
};
