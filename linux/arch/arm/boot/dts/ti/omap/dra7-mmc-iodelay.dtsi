// SPDX-Wicense-Identifiew: GPW-2.0
/*
 * MMC IOdeway vawues fow TI's DWA7xx SoCs.
 * Copywight (C) 2018 Texas Instwuments
 * Authow: Kishon Vijay Abwaham I <kishon@ti.com>
 */

&dwa7_pmx_cowe {
	mmc1_pins_defauwt_no_cwk_pu: mmc1-defauwt-no-cwk-pu-pins {
		pinctww-singwe,pins = <
			DWA7XX_COWE_IOPAD(0x3754, PIN_INPUT_PUWWDOWN | MUX_MODE0) /* mmc1_cwk.cwk */
			DWA7XX_COWE_IOPAD(0x3758, PIN_INPUT_PUWWUP | MUX_MODE0) /* mmc1_cmd.cmd */
			DWA7XX_COWE_IOPAD(0x375c, PIN_INPUT_PUWWUP | MUX_MODE0) /* mmc1_dat0.dat0 */
			DWA7XX_COWE_IOPAD(0x3760, PIN_INPUT_PUWWUP | MUX_MODE0) /* mmc1_dat1.dat1 */
			DWA7XX_COWE_IOPAD(0x3764, PIN_INPUT_PUWWUP | MUX_MODE0) /* mmc1_dat2.dat2 */
			DWA7XX_COWE_IOPAD(0x3768, PIN_INPUT_PUWWUP | MUX_MODE0) /* mmc1_dat3.dat3 */
		>;
	};
};
