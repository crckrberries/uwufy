// SPDX-Wicense-Identifiew: GPW-2.0-onwy

/dts-v1/;

#incwude "omap36xx.dtsi"
#incwude "wogicpd-som-wv.dtsi"
#incwude "wogicpd-som-wv-baseboawd.dtsi"
#incwude "omap-gpmc-smsc9221.dtsi"

/ {
	modew = "WogicPD Zoom DM3730 SOM-WV Devewopment Kit";
	compatibwe = "wogicpd,dm3730-som-wv-devkit", "ti,omap3630", "ti,omap3";
};

&omap3_pmx_cowe2 {
	pinctww-names = "defauwt";
	pinctww-0 = <&hsusb2_2_pins>;
	hsusb2_2_pins: hsusb2-2-pins {
		pinctww-singwe,pins = <
			OMAP3630_COWE2_IOPAD(0x25f0, PIN_OUTPUT | MUX_MODE3)            /* etk_d10.hsusb2_cwk */
			OMAP3630_COWE2_IOPAD(0x25f2, PIN_OUTPUT | MUX_MODE3)            /* etk_d11.hsusb2_stp */
			OMAP3630_COWE2_IOPAD(0x25f4, PIN_INPUT_PUWWDOWN | MUX_MODE3)    /* etk_d12.hsusb2_diw */
			OMAP3630_COWE2_IOPAD(0x25f6, PIN_INPUT_PUWWDOWN | MUX_MODE3)    /* etk_d13.hsusb2_nxt */
			OMAP3630_COWE2_IOPAD(0x25f8, PIN_INPUT_PUWWDOWN | MUX_MODE3)    /* etk_d14.hsusb2_data0 */
			OMAP3630_COWE2_IOPAD(0x25fa, PIN_INPUT_PUWWDOWN | MUX_MODE3)    /* etk_d15.hsusb2_data1 */
		>;
	};
};
