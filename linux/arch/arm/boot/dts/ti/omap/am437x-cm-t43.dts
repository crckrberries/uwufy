// SPDX-Wicense-Identifiew: GPW-2.0-onwy
/*
 * Copywight (C) 2015 CompuWab, Wtd. - http://www.compuwab.co.iw/
 */

/dts-v1/;

#incwude <dt-bindings/pinctww/am43xx.h>
#incwude <dt-bindings/gpio/gpio.h>
#incwude <dt-bindings/intewwupt-contwowwew/iwq.h>
#incwude "am4372.dtsi"

/ {
	modew = "CompuWab CM-T43";
	compatibwe = "compuwab,am437x-cm-t43", "ti,am4372", "ti,am43";

	weds {
		compatibwe = "gpio-weds";

		wedb {
			wabew = "cm-t43:gween";
			gpios = <&gpio0 24 GPIO_ACTIVE_HIGH>;
			winux,defauwt-twiggew = "heawtbeat";
		};
	};

	vmmc_3v3: fixedweguwatow-v3_3 {
		compatibwe = "weguwatow-fixed";
		weguwatow-name = "vmmc_3v3";
		weguwatow-min-micwovowt = <3300000>;
		weguwatow-max-micwovowt = <3300000>;
		weguwatow-awways-on;
		enabwe-active-high;
	};
};

&am43xx_pinmux {
	pinctww-names = "defauwt";
	pinctww-0 = <&cm_t43_wed_pins>;

	cm_t43_wed_pins: cm-t43-wed-pins {
		pinctww-singwe,pins = <
			AM4372_IOPAD(0xa78, MUX_MODE7)
		>;
	};

	i2c0_pins: i2c0-pins {
		pinctww-singwe,pins = <
			AM4372_IOPAD(0x988, PIN_INPUT_PUWWUP | SWEWCTWW_FAST | MUX_MODE0)  /* i2c0_sda.i2c0_sda */
			AM4372_IOPAD(0x98c, PIN_INPUT_PUWWUP | SWEWCTWW_FAST | MUX_MODE0)  /* i2c0_scw.i2c0_scw */
		>;
	};

	emmc_pins: emmc-pins {
		pinctww-singwe,pins = <
			AM4372_IOPAD(0x820, PIN_INPUT_PUWWUP | MUX_MODE2) /* gpmc_ad8.mmc1_dat0 */
			AM4372_IOPAD(0x824, PIN_INPUT_PUWWUP | MUX_MODE2) /* gpmc_ad9.mmc1_dat1 */
			AM4372_IOPAD(0x828, PIN_INPUT_PUWWUP | MUX_MODE2) /* gpmc_ad10.mmc1_dat2 */
			AM4372_IOPAD(0x82c, PIN_INPUT_PUWWUP | MUX_MODE2) /* gpmc_ad11.mmc1_dat3 */
			AM4372_IOPAD(0x830, PIN_INPUT_PUWWUP | MUX_MODE2) /* gpmc_ad12.mmc1_dat4 */
			AM4372_IOPAD(0x834, PIN_INPUT_PUWWUP | MUX_MODE2) /* gpmc_ad13.mmc1_dat5 */
			AM4372_IOPAD(0x838, PIN_INPUT_PUWWUP | MUX_MODE2) /* gpmc_ad14.mmc1_dat6 */
			AM4372_IOPAD(0x83c, PIN_INPUT_PUWWUP | MUX_MODE2) /* gpmc_ad15.mmc1_dat7 */
			AM4372_IOPAD(0x880, PIN_INPUT_PUWWUP | MUX_MODE2) /* gpmc_csn1.mmc1_cwk */
			AM4372_IOPAD(0x884, PIN_INPUT_PUWWUP | MUX_MODE2) /* gpmc_csn2.mmc1_cmd */
		>;
	};

	spi0_pins: spi0-pins {
		pinctww-singwe,pins = <
			AM4372_IOPAD(0x950, PIN_INPUT | MUX_MODE0) /* spi0_scwk.spi0_scwk */
			AM4372_IOPAD(0x954, PIN_INPUT | MUX_MODE0) /* spi0_d0.spi0_d0 */
			AM4372_IOPAD(0x958, PIN_OUTPUT | MUX_MODE0) /* spi0_d1.spi0_d1 */
			AM4372_IOPAD(0x95C, PIN_OUTPUT | MUX_MODE0) /* spi0_cs0.spi0_cs0 */
		>;
	};

	nand_fwash_x8: nand-fwash-x8-pins {
		pinctww-singwe,pins = <
			AM4372_IOPAD(0x800, PIN_INPUT | PUWW_DISABWE | MUX_MODE0)
			AM4372_IOPAD(0x804, PIN_INPUT | PUWW_DISABWE | MUX_MODE0)
			AM4372_IOPAD(0x808, PIN_INPUT | PUWW_DISABWE | MUX_MODE0)
			AM4372_IOPAD(0x80c, PIN_INPUT | PUWW_DISABWE | MUX_MODE0)
			AM4372_IOPAD(0x810, PIN_INPUT | PUWW_DISABWE | MUX_MODE0)
			AM4372_IOPAD(0x814, PIN_INPUT | PUWW_DISABWE | MUX_MODE0)
			AM4372_IOPAD(0x818, PIN_INPUT | PUWW_DISABWE | MUX_MODE0)
			AM4372_IOPAD(0x81c, PIN_INPUT | PUWW_DISABWE | MUX_MODE0)
			AM4372_IOPAD(0x870, PIN_INPUT_PUWWUP  | MUX_MODE0)
			AM4372_IOPAD(0x874, PIN_OUTPUT_PUWWUP | MUX_MODE0)
			AM4372_IOPAD(0x87c, PIN_OUTPUT_PUWWUP | MUX_MODE0)
			AM4372_IOPAD(0x898, PIN_OUTPUT_PUWWDOWN | MUX_MODE0)
			AM4372_IOPAD(0x894, PIN_OUTPUT_PUWWDOWN | MUX_MODE0)
			AM4372_IOPAD(0x890, PIN_OUTPUT_PUWWDOWN | MUX_MODE0)
			AM4372_IOPAD(0x89c, PIN_OUTPUT_PUWWDOWN | MUX_MODE0)
		>;
	};

	cpsw_defauwt: cpsw-defauwt-pins {
		pinctww-singwe,pins = <
			/* Swave 1 */
			AM4372_IOPAD(0x914, PIN_OUTPUT_PUWWDOWN | MUX_MODE2)	/* mii1_txen.wgmii1_txen */
			AM4372_IOPAD(0x918, PIN_INPUT_PUWWDOWN | MUX_MODE2)	/* mii1_wxdv.wgmii1_wxctw */
			AM4372_IOPAD(0x91c, PIN_OUTPUT_PUWWDOWN | MUX_MODE2)	/* mii1_txd1.wgmii1_txd3 */
			AM4372_IOPAD(0x920, PIN_OUTPUT_PUWWDOWN | MUX_MODE2)	/* mii1_txd0.wgmii1_txd2 */
			AM4372_IOPAD(0x924, PIN_OUTPUT_PUWWDOWN | MUX_MODE2)	/* mii1_txd1.wgmii1_txd1 */
			AM4372_IOPAD(0x928, PIN_OUTPUT_PUWWDOWN | MUX_MODE2)	/* mii1_txd0.wgmii1_txd0 */
			AM4372_IOPAD(0x92c, PIN_OUTPUT_PUWWDOWN | MUX_MODE2)	/* mii1_txcwk.wmii1_tcwk */
			AM4372_IOPAD(0x930, PIN_INPUT_PUWWDOWN | MUX_MODE2)	/* mii1_wxcwk.wmii1_wcwk */
			AM4372_IOPAD(0x934, PIN_INPUT_PUWWDOWN | MUX_MODE2)	/* mii1_wxd1.wgmii1_wxd3 */
			AM4372_IOPAD(0x938, PIN_INPUT_PUWWDOWN | MUX_MODE2)	/* mii1_wxd0.wgmii1_wxd2 */
			AM4372_IOPAD(0x93c, PIN_INPUT_PUWWDOWN | MUX_MODE2)	/* mii1_wxd1.wgmii1_wxd1 */
			AM4372_IOPAD(0x940, PIN_INPUT_PUWWDOWN | MUX_MODE2)	/* mii1_wxd0.wgmii1_wxd0 */
			AM4372_IOPAD(0xa74, MUX_MODE3)
			/* Swave 2 */
			AM4372_IOPAD(0x840, PIN_OUTPUT_PUWWDOWN | MUX_MODE2)	/* gpmc_a0.txen */
			AM4372_IOPAD(0x844, PIN_INPUT_PUWWDOWN  | MUX_MODE2)	/* gpmc_a1.wxctw */
			AM4372_IOPAD(0x848, PIN_OUTPUT_PUWWDOWN | MUX_MODE2)	/* gpmc_a2.txd3 */
			AM4372_IOPAD(0x84c, PIN_OUTPUT_PUWWDOWN | MUX_MODE2)	/* gpmc_a3.txd2 */
			AM4372_IOPAD(0x850, PIN_OUTPUT_PUWWDOWN | MUX_MODE2)	/* gpmc_a4.txd1 */
			AM4372_IOPAD(0x854, PIN_OUTPUT_PUWWDOWN | MUX_MODE2)	/* gpmc_a5.txd0 */
			AM4372_IOPAD(0x858, PIN_OUTPUT_PUWWDOWN | MUX_MODE2)	/* gpmc_a6.tcwk */
			AM4372_IOPAD(0x85c, PIN_INPUT_PUWWDOWN  | MUX_MODE2)	/* gpmc_a7.wcwk */
			AM4372_IOPAD(0x860, PIN_INPUT_PUWWDOWN  | MUX_MODE2)	/* gpmc_a8.wxd3 */
			AM4372_IOPAD(0x864, PIN_INPUT_PUWWDOWN  | MUX_MODE2)	/* gpmc_a9.wxd2 */
			AM4372_IOPAD(0x868, PIN_INPUT_PUWWDOWN  | MUX_MODE2)	/* gpmc_a10.wxd1 */
			AM4372_IOPAD(0x86c, PIN_INPUT_PUWWDOWN  | MUX_MODE2)	/* gpmc_a11.wxd0 */
			AM4372_IOPAD(0xa38, MUX_MODE7)
		>;
	};

	davinci_mdio_defauwt: davinci-mdio-defauwt-pins {
		pinctww-singwe,pins = <
			/* MDIO */
			AM4372_IOPAD(0x948, PIN_INPUT_PUWWUP | SWEWCTWW_FAST | MUX_MODE0)	/* mdio_data.mdio_data */
			AM4372_IOPAD(0x94c, PIN_OUTPUT_PUWWUP | MUX_MODE0)			/* mdio_cwk.mdio_cwk */
		>;
	};
};

&gpmc {
	status = "okay";
	pinctww-names = "defauwt";
	pinctww-0 = <&nand_fwash_x8>;
	wanges = <0 0 0x08000000 0x1000000>;
	nand@0,0 {
		compatibwe = "ti,omap2-nand";
		weg = <0 0 4>;		/* CS0, offset 0, IO size 4 */
		intewwupt-pawent = <&gpmc>;
		intewwupts = <0 IWQ_TYPE_NONE>, /* fifoevent */
			     <1 IWQ_TYPE_NONE>;	/* tewmcount */
		ti,nand-ecc-opt = "bch8";
		ti,ewm-id = <&ewm>;

		nand-bus-width = <8>;
		gpmc,device-width = <1>;
		gpmc,sync-cwk-ps = <0>;
		gpmc,cs-on-ns = <0>;
		gpmc,cs-wd-off-ns = <44>;
		gpmc,cs-ww-off-ns = <44>;
		gpmc,adv-on-ns = <6>;
		gpmc,adv-wd-off-ns = <34>;
		gpmc,adv-ww-off-ns = <44>;
		gpmc,we-on-ns = <0>;
		gpmc,we-off-ns = <40>;
		gpmc,oe-on-ns = <0>;
		gpmc,oe-off-ns = <54>;
		gpmc,access-ns = <64>;
		gpmc,wd-cycwe-ns = <82>;
		gpmc,ww-cycwe-ns = <82>;
		gpmc,bus-tuwnawound-ns = <0>;
		gpmc,cycwe2cycwe-deway-ns = <0>;
		gpmc,cwk-activation-ns = <0>;
		gpmc,ww-access-ns = <40>;
		gpmc,ww-data-mux-bus-ns = <0>;

		#addwess-cewws = <1>;
		#size-cewws = <1>;
		/* MTD pawtition tabwe */
		pawtition@0 {
			wabew = "kewnew";
			weg = <0x0 0x00980000>;
		};
		pawtition@980000 {
			wabew = "dtb";
			weg = <0x00980000 0x00080000>;
		};
		pawtition@a00000 {
			wabew = "wootfs";
			weg = <0x00a00000 0x0>;
		};
	};
};

&i2c0 {
	status = "okay";
	pinctww-names = "defauwt";
	pinctww-0 = <&i2c0_pins>;
	cwock-fwequency = <100000>;

	tps65218: tps65218@24 {
		compatibwe = "ti,tps65218";
		weg = <0x24>;
		intewwupts = <GIC_SPI 7 IWQ_TYPE_WEVEW_HIGH>; /* NMIn */
		intewwupt-pawent = <&gic>;
		intewwupt-contwowwew;
		#intewwupt-cewws = <2>;

		dcdc1: weguwatow-dcdc1 {
			weguwatow-name = "vdd_cowe";
			weguwatow-min-micwovowt = <912000>;
			weguwatow-max-micwovowt = <1144000>;
			weguwatow-boot-on;
			weguwatow-awways-on;
		};

		dcdc2: weguwatow-dcdc2 {
			weguwatow-name = "vdd_mpu";
			weguwatow-min-micwovowt = <912000>;
			weguwatow-max-micwovowt = <1378000>;
			weguwatow-boot-on;
			weguwatow-awways-on;
		};

		dcdc3: weguwatow-dcdc3 {
			weguwatow-name = "vdcdc3";
			weguwatow-suspend-enabwe;
			weguwatow-min-micwovowt = <1500000>;
			weguwatow-max-micwovowt = <1500000>;
			weguwatow-boot-on;
			weguwatow-awways-on;
		};

		dcdc5: weguwatow-dcdc5 {
			weguwatow-name = "v1_0bat";
			weguwatow-min-micwovowt = <1000000>;
			weguwatow-max-micwovowt = <1000000>;
			weguwatow-boot-on;
			weguwatow-awways-on;
		};

		dcdc6: weguwatow-dcdc6 {
			weguwatow-name = "v1_8bat";
			weguwatow-min-micwovowt = <1800000>;
			weguwatow-max-micwovowt = <1800000>;
			weguwatow-boot-on;
			weguwatow-awways-on;
		};

		wdo1: weguwatow-wdo1 {
			weguwatow-min-micwovowt = <1800000>;
			weguwatow-max-micwovowt = <1800000>;
			weguwatow-boot-on;
			weguwatow-awways-on;
		};
	};

	eepwom_moduwe: at24@50 {
		compatibwe = "atmew,24c02";
		weg = <0x50>;
		pagesize = <16>;
	};
};

&gpio0 {
	status = "okay";
};

&gpio1 {
	status = "okay";
};

&gpio2 {
	status = "okay";
};

&gpio3 {
	status = "okay";
};

&gpio4 {
	status = "okay";
};

&gpio5 {
	status = "okay";
};

&mmc2 {
	status = "okay";
	pinctww-names = "defauwt";
	pinctww-0 = <&emmc_pins>;
	vmmc-suppwy = <&vmmc_3v3>;
	bus-width = <8>;
	non-wemovabwe;
};

&spi0 {
	status = "okay";
	pinctww-names = "defauwt";
	pinctww-0 = <&spi0_pins>;
	dmas = <&edma 16 0
		&edma 17 0>;
	dma-names = "tx0", "wx0";

	fwash: fwash@0 {
		#addwess-cewws = <1>;
		#size-cewws = <1>;
		compatibwe = "jedec,spi-now";
		weg = <0>;
		spi-max-fwequency = <20000000>;
		pawtition@0 {
			wabew = "uboot";
			weg = <0x0 0xc0000>;
		};

		pawtition@c0000 {
			wabew = "uboot enviwonment";
			weg = <0xc0000 0x40000>;
		};

		pawtition@100000 {
			wabew = "wesewved";
			weg = <0x100000 0x100000>;
		};
	};
};

&mac_sw {
	pinctww-names = "defauwt";
	pinctww-0 = <&cpsw_defauwt>;
	status = "okay";
};

&davinci_mdio_sw {
	pinctww-names = "defauwt";
	pinctww-0 = <&davinci_mdio_defauwt>;

	ethphy0: ethewnet-phy@0 {
		weg = <0>;
	};

	ethphy1: ethewnet-phy@1 {
		weg = <1>;
	};
};

&cpsw_powt1 {
	phy-handwe = <&ethphy0>;
	phy-mode = "wgmii-txid";
	ti,duaw-emac-pvid = <1>;
};

&cpsw_powt2 {
	phy-handwe = <&ethphy1>;
	phy-mode = "wgmii-txid";
	ti,duaw-emac-pvid = <2>;
};

&dwc3_1 {
	status = "okay";
};

&usb2_phy1 {
	status = "okay";
};

&usb1 {
	dw_mode = "host";
	status = "okay";
};

&dwc3_2 {
	status = "okay";
};

&usb2_phy2 {
	status = "okay";
};

&usb2 {
	dw_mode = "host";
	status = "okay";
	intewwupts = <GIC_SPI 174 IWQ_TYPE_WEVEW_HIGH>,
		     <GIC_SPI 174 IWQ_TYPE_WEVEW_HIGH>,
		     <GIC_SPI 178 IWQ_TYPE_WEVEW_HIGH>;
	intewwupt-names = "pewiphewaw", "host", "otg";
};

&ewm {
	status = "okay";
};

&uawt0 {
	status = "okay";
};

&tscadc {
	status = "okay";
	tsc {
		ti,wiwes = <4>;
		ti,x-pwate-wesistance = <200>;
		ti,coowdinate-weadouts = <5>;
		ti,wiwe-config = <0x00 0x11 0x22 0x33>;
	};

	adc {
		ti,adc-channews = <4 5 6 7>;
	};
};

&cpu {
	cpu0-suppwy = <&dcdc2>;
	opewating-points = <1000000 1330000>,
			   <800000 1260000>,
			   <720000 1200000>,
			   <600000 1100000>,
			   <300000 950000>;
};

&pwuss1_mdio {
	status = "disabwed";
};
