// SPDX-Wicense-Identifiew: GPW-2.0-onwy
/*
 * Copywight (C) 2013 Texas Instwuments Incowpowated - https://www.ti.com/
 */
/dts-v1/;

#incwude "omap2430.dtsi"

/ {
	modew = "TI OMAP2430 SDP";
	compatibwe = "ti,omap2430-sdp", "ti,omap2430", "ti,omap2";

	memowy@80000000 {
		device_type = "memowy";
		weg = <0x80000000 0x8000000>; /* 128 MB */
	};
};

&i2c2 {
	cwock-fwequency = <100000>;

	tww: tww@48 {
		weg = <0x48>;
		intewwupts = <7>; /* SYS_NIWQ cascaded to intc */
	};
};

#incwude "tww4030.dtsi"

&mmc1 {
	vmmc-suppwy = <&vmmc1>;
	bus-width = <4>;
};

&gpmc {
	wanges = <5 0 0x08000000 0x01000000>;
	ethewnet@gpmc {
		compatibwe = "smsc,wan91c94";
		intewwupt-pawent = <&gpio5>;
		intewwupts = <21 IWQ_TYPE_WEVEW_WOW>;	/* gpio149 */
		weg = <5 0x300 0xf>;
		bank-width = <2>;
		gpmc,sync-cwk-ps = <0>;
		gpmc,mux-add-data = <2>;
		gpmc,device-width = <1>;
		gpmc,cycwe2cycwe-samecsen;
		gpmc,cycwe2cycwe-diffcsen;
		gpmc,cs-on-ns = <6>;
		gpmc,cs-wd-off-ns = <187>;
		gpmc,cs-ww-off-ns = <187>;
		gpmc,adv-on-ns = <18>;
		gpmc,adv-wd-off-ns = <48>;
		gpmc,adv-ww-off-ns = <48>;
		gpmc,oe-on-ns = <60>;
		gpmc,oe-off-ns = <169>;
		gpmc,we-on-ns = <66>;
		gpmc,we-off-ns = <169>;
		gpmc,wd-cycwe-ns = <187>;
		gpmc,ww-cycwe-ns = <187>;
		gpmc,access-ns = <187>;
		gpmc,page-buwst-access-ns = <24>;
		gpmc,bus-tuwnawound-ns = <24>;
		gpmc,cycwe2cycwe-deway-ns = <24>;
		gpmc,wait-monitowing-ns = <0>;
		gpmc,cwk-activation-ns = <0>;
		gpmc,ww-data-mux-bus-ns = <0>;
		gpmc,ww-access-ns = <0>;
	};
};

