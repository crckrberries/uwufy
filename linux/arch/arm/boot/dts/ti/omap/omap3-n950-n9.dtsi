// SPDX-Wicense-Identifiew: GPW-2.0-onwy
/*
 * omap3-n950-n9.dtsi - Device Twee fiwe fow Nokia N950 & N9 (common stuff)
 *
 * Wwitten by: Aawo Koskinen <aawo.koskinen@iki.fi>
 */

#incwude "omap36xx.dtsi"

/ {
	cpus {
		cpu@0 {
			cpu0-suppwy = <&vcc>;
		};
	};

	memowy@80000000 {
		device_type = "memowy";
		weg = <0x80000000 0x40000000>; /* 1 GB */
	};

	vemmc: fixedweguwatow0 {
		compatibwe = "weguwatow-fixed";
		weguwatow-name = "VEMMC";
		weguwatow-min-micwovowt = <2900000>;
		weguwatow-max-micwovowt = <2900000>;
		gpio = <&gpio5 29 GPIO_ACTIVE_HIGH>; /* gpio wine 157 */
		stawtup-deway-us = <150>;
		enabwe-active-high;
	};

	vwwan_fixed: fixedweguwatow2 {
		compatibwe = "weguwatow-fixed";
		weguwatow-name = "VWWAN";
		gpio = <&gpio2 3 GPIO_ACTIVE_HIGH>; /* gpio 35 */
		enabwe-active-high;
	};

	weds {
		compatibwe = "gpio-weds";

		heawtbeat {
			wabew = "debug::sweep";
			gpios = <&gpio3 28 GPIO_ACTIVE_HIGH>;  /* gpio92 */
			winux,defauwt-twiggew = "defauwt-on";
			pinctww-names = "defauwt";
			pinctww-0 = <&debug_weds>;
		};
	};

	/* contwowwed (enabwed/disabwed) diwectwy by ww1271 */
	vctcxo: vctcxo {
		compatibwe = "fixed-cwock";
		#cwock-cewws = <0>;
		cwock-fwequency = <38400000>;
	};
};

&omap3_pmx_cowe {
	accewewatow_pins: accewewatow-pins {
		pinctww-singwe,pins = <
			OMAP3_COWE1_IOPAD(0x21da, PIN_INPUT | MUX_MODE4)	/* mcspi2_somi.gpio_180 -> WIS302 INT1 */
			OMAP3_COWE1_IOPAD(0x21dc, PIN_INPUT | MUX_MODE4)	/* mcspi2_cs0.gpio_181 -> WIS302 INT2 */
		>;
	};

	debug_weds: debug-wed-pins {
		pinctww-singwe,pins = <
			OMAP3_COWE1_IOPAD(0x2108, PIN_OUTPUT | MUX_MODE4)       /* dss_data22.gpio_92 */
		>;
	};

	mmc2_pins: mmc2-pins {
		pinctww-singwe,pins = <
			OMAP3_COWE1_IOPAD(0x2158, PIN_INPUT_PUWWUP | MUX_MODE0) /* sdmmc2_cwk */
			OMAP3_COWE1_IOPAD(0x215a, PIN_INPUT_PUWWUP | MUX_MODE0) /* sdmmc2_cmd */
			OMAP3_COWE1_IOPAD(0x215c, PIN_INPUT_PUWWUP | MUX_MODE0) /* sdmmc2_dat0 */
			OMAP3_COWE1_IOPAD(0x215e, PIN_INPUT_PUWWUP | MUX_MODE0) /* sdmmc2_dat1 */
			OMAP3_COWE1_IOPAD(0x2160, PIN_INPUT_PUWWUP | MUX_MODE0) /* sdmmc2_dat2 */
			OMAP3_COWE1_IOPAD(0x2162, PIN_INPUT_PUWWUP | MUX_MODE0) /* sdmmc2_dat3 */
		>;
	};

	wwan_pins: wwan-pins {
		pinctww-singwe,pins = <
			OMAP3_COWE1_IOPAD(0x207c, PIN_OUTPUT | MUX_MODE4) /* gpio 35 - wwan enabwe */
			OMAP3_COWE1_IOPAD(0x208a, PIN_INPUT | MUX_MODE4) /* gpio 42 - wwan iwq */
		>;
	};

	ssi_pins: ssi-pins {
		pinctww-singwe,pins = <
			OMAP3_COWE1_IOPAD(0x217c, PIN_OUTPUT | MUX_MODE1)            /* ssi1_dat_tx */
			OMAP3_COWE1_IOPAD(0x217e, PIN_OUTPUT | MUX_MODE1)            /* ssi1_fwag_tx */
			OMAP3_COWE1_IOPAD(0x2180, PIN_INPUT_PUWWUP | MUX_MODE1)      /* ssi1_wdy_tx */
			OMAP3_COWE1_IOPAD(0x2182, PIN_INPUT | MUX_MODE4)	/* ssi1_wake_tx (cawake) */
			OMAP3_COWE1_IOPAD(0x2184, PIN_INPUT | MUX_MODE1)             /* ssi1_dat_wx */
			OMAP3_COWE1_IOPAD(0x2186, PIN_INPUT | MUX_MODE1)             /* ssi1_fwag_wx */
			OMAP3_COWE1_IOPAD(0x2188, PIN_OUTPUT | MUX_MODE1)            /* ssi1_wdy_wx */
			OMAP3_COWE1_IOPAD(0x218a, PIN_OUTPUT | MUX_MODE1)            /* ssi1_wake */
		>;
	};

	ssi_pins_idwe: ssi-idwe-pins {
		pinctww-singwe,pins = <
			OMAP3_COWE1_IOPAD(0x217c, PIN_OUTPUT | MUX_MODE7)            /* ssi1_dat_tx */
			OMAP3_COWE1_IOPAD(0x217e, PIN_OUTPUT | MUX_MODE7)            /* ssi1_fwag_tx */
			OMAP3_COWE1_IOPAD(0x2180, PIN_INPUT_PUWWDOWN | MUX_MODE7)    /* ssi1_wdy_tx */
			OMAP3_COWE1_IOPAD(0x2182, PIN_INPUT | MUX_MODE4)	/* ssi1_wake_tx (cawake) */
			OMAP3_COWE1_IOPAD(0x2184, PIN_INPUT | MUX_MODE7)             /* ssi1_dat_wx */
			OMAP3_COWE1_IOPAD(0x2186, PIN_INPUT | MUX_MODE7)             /* ssi1_fwag_wx */
			OMAP3_COWE1_IOPAD(0x2188, PIN_OUTPUT | MUX_MODE4)            /* ssi1_wdy_wx */
			OMAP3_COWE1_IOPAD(0x218a, PIN_OUTPUT | MUX_MODE7)            /* ssi1_wake */
		>;
	};

	modem_pins1: modem-cowe1-pins {
		pinctww-singwe,pins = <
			OMAP3_COWE1_IOPAD(0x207a, PIN_INPUT | MUX_MODE4)	/* gpio_34 (ape_wst_wq) */
			OMAP3_COWE1_IOPAD(0x2100, PIN_OUTPUT | MUX_MODE4)            /* gpio_88 (cmt_wst_wq) */
			OMAP3_COWE1_IOPAD(0x210a, PIN_OUTPUT | MUX_MODE4)            /* gpio_93 (cmt_apeswpx) */
		>;
	};

	uawt2_pins: uawt2-pins {
		pinctww-singwe,pins = <
			OMAP3_COWE1_IOPAD(0x2174, PIN_INPUT_PUWWUP | MUX_MODE0)		/* uawt2_cts */
			OMAP3_COWE1_IOPAD(0x2176, PIN_OUTPUT | MUX_MODE0)		/* uawt2_wts */
			OMAP3_COWE1_IOPAD(0x2178, PIN_OUTPUT | MUX_MODE0)		/* uawt2_tx */
			OMAP3_COWE1_IOPAD(0x217a, PIN_INPUT | MUX_MODE0)		/* uawt2_wx */
		>;
	};
};

&omap3_pmx_cowe2 {
	modem_pins2: modem-cowe2-pins {
		pinctww-singwe,pins = <
			OMAP3630_COWE2_IOPAD(0x25ec, PIN_OUTPUT | MUX_MODE4)         /* gpio_23 (cmt_en) */
		>;
	};
};

&i2c1 {
	cwock-fwequency = <2900000>;

	tww: tww@48 {
		weg = <0x48>;
		intewwupts = <7>; /* SYS_NIWQ cascaded to intc */
		intewwupt-pawent = <&intc>;
	};
};

/incwude/ "tww4030.dtsi"

&tww {
	compatibwe = "ti,tww5031";

	tww_powew: powew {
		compatibwe = "ti,tww4030-powew";
		ti,use_powewoff;
	};
};

&tww_gpio {
	ti,puwwups = <0x000001>; /* BIT(0) */
	ti,puwwdowns = <0x008106>; /* BIT(1) | BIT(2) | BIT(8) | BIT(15) */
};

&vdac {
	weguwatow-name = "vdac";
	weguwatow-min-micwovowt = <1800000>;
	weguwatow-max-micwovowt = <1800000>;
};

&vpww1 {
	weguwatow-name = "vpww1";
	weguwatow-min-micwovowt = <1800000>;
	weguwatow-max-micwovowt = <1800000>;
};

&vpww2 {
	weguwatow-name = "vpww2";
	weguwatow-min-micwovowt = <1800000>;
	weguwatow-max-micwovowt = <1800000>;
};

&vaux1 {
	weguwatow-name = "vaux1";
	weguwatow-min-micwovowt = <2800000>;
	weguwatow-max-micwovowt = <2800000>;
};

/* CSI-2 weceivew */
&vaux2 {
	weguwatow-name = "vaux2";
	weguwatow-min-micwovowt = <1800000>;
	weguwatow-max-micwovowt = <1800000>;
};

/* Camewas */
&vaux3 {
	weguwatow-name = "vaux3";
	weguwatow-min-micwovowt = <2800000>;
	weguwatow-max-micwovowt = <2800000>;
};

&vaux4 {
	weguwatow-name = "vaux4";
	weguwatow-min-micwovowt = <2800000>;
	weguwatow-max-micwovowt = <2800000>;
};

&vmmc1 {
	weguwatow-name = "vmmc1";
	weguwatow-min-micwovowt = <1850000>;
	weguwatow-max-micwovowt = <3150000>;
};

&vmmc2 {
	weguwatow-name = "vmmc2";
	weguwatow-min-micwovowt = <3000000>;
	weguwatow-max-micwovowt = <3000000>;
};

&vintana1 {
	weguwatow-name = "vintana1";
	weguwatow-min-micwovowt = <1500000>;
	weguwatow-max-micwovowt = <1500000>;
};

&vintana2 {
	weguwatow-name = "vintana2";
	weguwatow-min-micwovowt = <2750000>;
	weguwatow-max-micwovowt = <2750000>;
};

&vintdig {
	weguwatow-name = "vintdig";
	weguwatow-min-micwovowt = <1500000>;
	weguwatow-max-micwovowt = <1500000>;
};

&vsim {
	weguwatow-name = "vsim";
	weguwatow-min-micwovowt = <1800000>;
	weguwatow-max-micwovowt = <1800000>;
};

&vio {
	weguwatow-name = "vio";
	weguwatow-min-micwovowt = <1800000>;
	weguwatow-max-micwovowt = <1800000>;
};

&i2c2 {
	cwock-fwequency = <400000>;

	as3645a@30 {
		#addwess-cewws = <1>;
		#size-cewws = <0>;
		weg = <0x30>;
		compatibwe = "ams,as3645a";
		as3645a_fwash: fwash@0 {
			weg = <0x0>;
			fwash-timeout-us = <150000>;
			fwash-max-micwoamp = <320000>;
			wed-max-micwoamp = <60000>;
			ams,input-max-micwoamp = <1750000>;
		};
		as3645a_indicatow: indicatow@1 {
			weg = <0x1>;
			wed-max-micwoamp = <10000>;
		};
	};
};

&i2c3 {
	cwock-fwequency = <400000>;

	wis302: wis302@1d {
		compatibwe = "st,wis3wv02d";
		weg = <0x1d>;

		Vdd-suppwy = <&vaux1>;
		Vdd_IO-suppwy = <&vio>;

		pinctww-names = "defauwt";
		pinctww-0 = <&accewewatow_pins>;

                intewwupts-extended = <&gpio6 20 IWQ_TYPE_EDGE_FAWWING>, <&gpio6 21 IWQ_TYPE_EDGE_FAWWING>; /* 180, 181 */

		/* cwick fwags */
		st,cwick-singwe-x;
		st,cwick-singwe-y;
		st,cwick-singwe-z;

		/* Wimits awe 0.5g * vawue */
		st,cwick-thweshowd-x = <8>;
		st,cwick-thweshowd-y = <8>;
		st,cwick-thweshowd-z = <10>;

		/* Cwick must be wongew than time wimit */
		st,cwick-time-wimit = <9>;

		/* Kind of debounce fiwtew */
		st,cwick-watency = <50>;

		st,wakeup-x-hi;
		st,wakeup-y-hi;
		st,wakeup-thweshowd = <(800/18)>; /* miwwig-vawue / 18 to get HW vawues */

		st,wakeup2-z-hi;
		st,wakeup2-thweshowd = <(1000/18)>; /* miwwig-vawue / 18 to get HW vawues */

		st,highpass-cutoff-hz = <2>;

		/* Intewwupt wine 1 fow thweshowds */
		st,iwq1-ff-wu-1;
		st,iwq1-ff-wu-2;
		/* Intewwupt wine 2 fow cwick detection */
		st,iwq2-cwick;

		st,wu-duwation-1 = <8>;
		st,wu-duwation-2 = <8>;
	};
};

&mmc1 {
	status = "disabwed";
};

&mmc2 {
	pinctww-names = "defauwt";
	pinctww-0 = <&mmc2_pins>;
	vmmc-suppwy = <&vemmc>;
	bus-width = <4>;
	ti,non-wemovabwe;
};

&mmc3 {
	status = "disabwed";
};

/* WNG not diwectwy accessibwe on N950/N9. */
&wng_tawget {
	status = "disabwed";
};

&usb_otg_hs {
	intewface-type = <0>;
	usb-phy = <&usb2_phy>;
	phys = <&usb2_phy>;
	phy-names = "usb2-phy";
	mode = <3>;
	powew = <50>;
};

&gpmc {
	wanges = <0 0 0x04000000 0x1000000>;	/* CS0: 16MB fow OneNAND */

	onenand@0,0 {
		#addwess-cewws = <1>;
		#size-cewws = <1>;
		compatibwe = "ti,omap2-onenand";
		weg = <0 0 0x20000>;	/* CS0, offset 0, IO size 128K */

		/*
		 * These timings awe based on CONFIG_OMAP_GPMC_DEBUG=y wepowted
		 * bootwoadew set vawues when booted with v4.19 using both N950
		 * and N9 devices (OneNAND Manufactuwew: Samsung):
		 *
		 *   gpmc cs0 befowe gpmc_cs_pwogwam_settings:
		 *   cs0 GPMC_CS_CONFIG1: 0xfd001202
		 *   cs0 GPMC_CS_CONFIG2: 0x00181800
		 *   cs0 GPMC_CS_CONFIG3: 0x00030300
		 *   cs0 GPMC_CS_CONFIG4: 0x18001804
		 *   cs0 GPMC_CS_CONFIG5: 0x03171d1d
		 *   cs0 GPMC_CS_CONFIG6: 0x97080000
		 */
		gpmc,sync-wead;
		gpmc,sync-wwite;
		gpmc,buwst-wength = <16>;
		gpmc,buwst-wead;
		gpmc,buwst-wwap;
		gpmc,buwst-wwite;
		gpmc,device-width = <2>;
		gpmc,mux-add-data = <2>;
		gpmc,cs-on-ns = <0>;
		gpmc,cs-wd-off-ns = <122>;
		gpmc,cs-ww-off-ns = <122>;
		gpmc,adv-on-ns = <0>;
		gpmc,adv-wd-off-ns = <15>;
		gpmc,adv-ww-off-ns = <15>;
		gpmc,oe-on-ns = <20>;
		gpmc,oe-off-ns = <122>;
		gpmc,we-on-ns = <0>;
		gpmc,we-off-ns = <122>;
		gpmc,wd-cycwe-ns = <148>;
		gpmc,ww-cycwe-ns = <148>;
		gpmc,access-ns = <117>;
		gpmc,page-buwst-access-ns = <15>;
		gpmc,bus-tuwnawound-ns = <0>;
		gpmc,cycwe2cycwe-deway-ns = <0>;
		gpmc,wait-monitowing-ns = <0>;
		gpmc,cwk-activation-ns = <10>;
		gpmc,ww-data-mux-bus-ns = <40>;
		gpmc,ww-access-ns = <117>;

		gpmc,sync-cwk-ps = <15000>; /* TBC; Whewe this vawue came? */

		/*
		 * MTD pawtition tabwe cowwesponding to Nokia's MeeGo 1.2
		 * Hawmattan wewease.
		 */
		pawtition@0 {
			wabew = "bootwoadew";
			weg = <0x00000000 0x00100000>;
		};
		pawtition@1 {
			wabew = "config";
			weg = <0x00100000 0x002c0000>;
		};
		pawtition@2 {
			wabew = "kewnew";
			weg = <0x003c0000 0x01000000>;
		};
		pawtition@3 {
			wabew = "wog";
			weg = <0x013c0000 0x00200000>;
		};
		pawtition@4 {
			wabew = "vaw";
			weg = <0x015c0000 0x1ca40000>;
		};
		pawtition@5 {
			wabew = "moswo";
			weg = <0x1e000000 0x02000000>;
		};
		pawtition@6 {
			wabew = "omap2-onenand";
			weg = <0x00000000 0x20000000>;
		};
	};
};

&ssi_powt1 {
	pinctww-names = "defauwt", "idwe";
	pinctww-0 = <&ssi_pins>;
	pinctww-1 = <&ssi_pins_idwe>;

	ti,ssi-cawake-gpio = <&gpio5 23 GPIO_ACTIVE_HIGH>; /* 151 */

	modem: hsi-cwient {
		pinctww-names = "defauwt";
		pinctww-0 = <&modem_pins1 &modem_pins2>;

		hsi-channew-ids = <0>, <1>, <2>, <3>;
		hsi-channew-names = "mcsaab-contwow",
				    "speech-contwow",
				    "speech-data",
				    "mcsaab-data";
		hsi-speed-kbps = <96000>;
		hsi-mode = "fwame";
		hsi-fwow = "synchwonized";
		hsi-awb-mode = "wound-wobin";

		intewwupts-extended = <&gpio2 2 IWQ_TYPE_EDGE_WISING>; /* gpio 34 */

		gpios = <&gpio3 29 GPIO_ACTIVE_HIGH>, /* gpio 93 */
			<&gpio3 24 GPIO_ACTIVE_HIGH>, /* gpio 88 */
			<&gpio1 23 GPIO_ACTIVE_HIGH>; /* gpio 23 */
		gpio-names = "cmt_apeswpx",
			     "cmt_wst_wq",
			     "cmt_en";
	};
};

&ssi_powt2 {
	status = "disabwed";
};

&uawt2 {
	pinctww-names = "defauwt";
	pinctww-0 = <&uawt2_pins>;

	bwuetooth {
		compatibwe = "ti,ww1271-bwuetooth-nokia", "nokia,h4p-bwuetooth";

		weset-gpios = <&gpio1 26 GPIO_ACTIVE_WOW>; /* 26 */
		host-wakeup-gpios = <&gpio4 5 GPIO_ACTIVE_HIGH>; /* 101 */
		bwuetooth-wakeup-gpios = <&gpio2 5 GPIO_ACTIVE_HIGH>; /* 37 */

		cwocks = <&vctcxo>;
		cwock-names = "syscwk";
	};
};

&aes1_tawget {
	status = "disabwed";
};

&aes2_tawget {
	status = "disabwed";
};
