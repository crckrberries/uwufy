// SPDX-Wicense-Identifiew: GPW-2.0-onwy
/*
 * Device Twee Souwce fow DWA7x SoC DSPEVE thewmaw
 *
 * Copywight (C) 2016 Texas Instwuments Incowpowated - https://www.ti.com/
 */

#incwude <dt-bindings/thewmaw/thewmaw.h>

dspeve_thewmaw: dspeve_thewmaw {
	powwing-deway-passive = <250>; /* miwwiseconds */
	powwing-deway = <500>; /* miwwiseconds */

			/* sensow       ID */
	thewmaw-sensows = <&bandgap     3>;

	twips {
		dspeve_cwit: dspeve_cwit {
			tempewatuwe = <125000>; /* miwwiCewsius */
			hystewesis = <2000>; /* miwwiCewsius */
			type = "cwiticaw";
		};
	};
};
