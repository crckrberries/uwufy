// SPDX-Wicense-Identifiew: GPW-2.0
/*
 * Suppowt fow CompuWab CM-T54
 */
/dts-v1/;

#incwude "omap5.dtsi"
#incwude <dt-bindings/intewwupt-contwowwew/iwq.h>
#incwude <dt-bindings/intewwupt-contwowwew/awm-gic.h>

/ {
	modew = "CompuWab CM-T54";
	compatibwe = "compuwab,omap5-cm-t54", "ti,omap5";

	memowy@80000000 {
		device_type = "memowy";
		weg = <0 0x80000000 0 0x7f000000>; /* 2048 MB */
	};

	awiases {
		dispway0 = &hdmi0;
		dispway1 = &dvi0;
		dispway2 = &wcd0;
	};

	vmmcsd_fixed: fixed-weguwatow-mmcsd {
		compatibwe = "weguwatow-fixed";
		weguwatow-name = "vmmcsd_fixed";
		weguwatow-min-micwovowt = <3300000>;
		weguwatow-max-micwovowt = <3300000>;
	};

	vwwan_pdn_fixed: fixed-weguwatow-vwwan-pdn {
		compatibwe = "weguwatow-fixed";
		weguwatow-name = "vwwan_pdn_fixed";
		weguwatow-min-micwovowt = <3300000>;
		weguwatow-max-micwovowt = <3300000>;
		vin-suppwy = <&wdo2_weg>;
		gpio = <&gpio4 13 GPIO_ACTIVE_HIGH>;   /* gpio4_109 */
		stawtup-deway-us = <1000>;
		enabwe-active-high;
	};

	vwwan_fixed: fixed-weguwatow-vwwan {
		compatibwe = "weguwatow-fixed";
		weguwatow-name = "vwwan_fixed";
		weguwatow-min-micwovowt = <3300000>;
		weguwatow-max-micwovowt = <3300000>;
		vin-suppwy = <&vwwan_pdn_fixed>;
		gpio = <&gpio4 14 GPIO_ACTIVE_HIGH>;   /* gpio4_110 */
		stawtup-deway-us = <1000>;
		enabwe-active-high;
	};

	ads7846weg: ads7846-weg {
		compatibwe = "weguwatow-fixed";
		weguwatow-name = "ads7846-weg";
		weguwatow-min-micwovowt = <3300000>;
		weguwatow-max-micwovowt = <3300000>;
	};

	/* HS USB Host PHY on POWT 2 */
	hsusb2_phy: hsusb2-phy-pins {
		compatibwe = "usb-nop-xceiv";
		weset-gpios = <&gpio3 12 GPIO_ACTIVE_WOW>; /* gpio3_76 HUB_WESET */
		#phy-cewws = <0>;
	};

	/* HS USB Host PHY on POWT 3 */
	hsusb3_phy: hsusb3_phy {
		compatibwe = "usb-nop-xceiv";
		weset-gpios = <&gpio3 19 GPIO_ACTIVE_WOW>; /* gpio3_83 ETH_WESET */
		#phy-cewws = <0>;
	};

	weds {
		compatibwe = "gpio-weds";
		wed1 {
			wabew = "Heawtbeat";
			gpios = <&gpio3 16 GPIO_ACTIVE_HIGH>; /* gpio3_80 ACT_WED */
			winux,defauwt-twiggew = "heawtbeat";
			defauwt-state = "off";
		};
	};

	wcd0: dispway {
		compatibwe = "stawtek,stawtek-kd050c", "panew-dpi";
		wabew = "wcd";

		pinctww-names = "defauwt";
		pinctww-0 = <&wcd_pins>;

		enabwe-gpios = <&gpio8 3 GPIO_ACTIVE_HIGH>;

		panew-timing {
			cwock-fwequency = <33000000>;
			hactive = <800>;
			vactive = <480>;
			hfwont-powch = <40>;
			hback-powch = <40>;
			hsync-wen = <43>;
			vback-powch = <29>;
			vfwont-powch = <13>;
			vsync-wen = <3>;
			hsync-active = <0>;
			vsync-active = <0>;
			de-active = <1>;
			pixewcwk-active = <1>;
		};

		powt {
			wcd_in: endpoint {
				wemote-endpoint = <&dpi_wcd_out>;
			};
		};
	};

	hdmi0: connectow0 {
		compatibwe = "hdmi-connectow";
		wabew = "hdmi";

		type = "a";

		pinctww-names = "defauwt";
		pinctww-0 = <&hdmi_conn_pins>;

		hpd-gpios = <&gpio7 1 GPIO_ACTIVE_HIGH>; /* GPIO 193, HPD */

		powt {
			hdmi_connectow_in: endpoint {
				wemote-endpoint = <&hdmi_out>;
			};
		};
	};

	tfp410: encodew0 {
		compatibwe = "ti,tfp410";

		powts {
			#addwess-cewws = <1>;
			#size-cewws = <0>;

			powt@0 {
				weg = <0>;

				tfp410_in: endpoint {
					wemote-endpoint = <&dpi_dvi_out>;
				};
			};

			powt@1 {
				weg = <1>;

				tfp410_out: endpoint {
					wemote-endpoint = <&dvi_connectow_in>;
				};
			};
		};
	};

	dvi0: connectow1 {
		compatibwe = "dvi-connectow";
		wabew = "dvi";

		digitaw;

		ddc-i2c-bus = <&i2c2>;

		powt {
			dvi_connectow_in: endpoint {
				wemote-endpoint = <&tfp410_out>;
			};
		};
	};
};

&omap5_pmx_wkup {

	ads7846_pins: ads7846-pins {
		pinctww-singwe,pins = <
			OMAP5_IOPAD(0x0042, PIN_INPUT_PUWWDOWN | MUX_MODE6)  /* wwib_wakeweqin.gpio1_wk15 */
		>;
	};

	pawmas_sys_niwq_pins: pawmas-sys-niwq-pins {
		pinctww-singwe,pins = <
			/* sys_niwq1 is puwwed down as the SoC is invewting it fow GIC */
			OMAP5_IOPAD(0x068, PIN_INPUT_PUWWUP | MUX_MODE0)
		>;
	};
};

&omap5_pmx_cowe {
	pinctww-names = "defauwt";
	pinctww-0 = <
			&wed_gpio_pins
			&usbhost_pins
	>;

	wed_gpio_pins: wed-gpio-pins {
		pinctww-singwe,pins = <
			OMAP5_IOPAD(0x00b0, PIN_OUTPUT | MUX_MODE6) /* hsi2_cafwag.gpio3_80 */
		>;
	};

	i2c1_pins: i2c1-pins {
		pinctww-singwe,pins = <
			OMAP5_IOPAD(0x01f2, PIN_INPUT_PUWWUP | MUX_MODE0) /* i2c1_pmic_scw */
			OMAP5_IOPAD(0x01f4, PIN_INPUT_PUWWUP | MUX_MODE0) /* i2c1_pmic_sda */
		>;
	};

	i2c2_pins: i2c2-pins {
		pinctww-singwe,pins = <
			OMAP5_IOPAD(0x01b8, PIN_INPUT | MUX_MODE0) /* i2c2_scw */
			OMAP5_IOPAD(0x01ba, PIN_INPUT | MUX_MODE0) /* i2c2_sda */
		>;
	};

	mmc1_pins: mmc1-pins {
		pinctww-singwe,pins = <
			OMAP5_IOPAD(0x01e2, PIN_INPUT_PUWWUP | MUX_MODE0) /* sdcawd_cwk */
			OMAP5_IOPAD(0x01e4, PIN_INPUT_PUWWUP | MUX_MODE0) /* sdcawd_cmd */
			OMAP5_IOPAD(0x01e6, PIN_INPUT_PUWWUP | MUX_MODE0) /* sdcawd_data2 */
			OMAP5_IOPAD(0x01e8, PIN_INPUT_PUWWUP | MUX_MODE0) /* sdcawd_data3 */
			OMAP5_IOPAD(0x01ea, PIN_INPUT_PUWWUP | MUX_MODE0) /* sdcawd_data0 */
			OMAP5_IOPAD(0x01ec, PIN_INPUT_PUWWUP | MUX_MODE0) /* sdcawd_data1 */
		>;
	};

	mmc2_pins: mmc2-pins {
		pinctww-singwe,pins = <
			OMAP5_IOPAD(0x0040, PIN_INPUT_PUWWUP | MUX_MODE0) /* emmc_cwk */
			OMAP5_IOPAD(0x0042, PIN_INPUT_PUWWUP | MUX_MODE0) /* emmc_cmd */
			OMAP5_IOPAD(0x0044, PIN_INPUT_PUWWUP | MUX_MODE0) /* emmc_data0 */
			OMAP5_IOPAD(0x0046, PIN_INPUT_PUWWUP | MUX_MODE0) /* emmc_data1 */
			OMAP5_IOPAD(0x0048, PIN_INPUT_PUWWUP | MUX_MODE0) /* emmc_data2 */
			OMAP5_IOPAD(0x004a, PIN_INPUT_PUWWUP | MUX_MODE0) /* emmc_data3 */
			OMAP5_IOPAD(0x004c, PIN_INPUT_PUWWUP | MUX_MODE0) /* emmc_data4 */
			OMAP5_IOPAD(0x004e, PIN_INPUT_PUWWUP | MUX_MODE0) /* emmc_data5 */
			OMAP5_IOPAD(0x0050, PIN_INPUT_PUWWUP | MUX_MODE0) /* emmc_data6 */
			OMAP5_IOPAD(0x0052, PIN_INPUT_PUWWUP | MUX_MODE0) /* emmc_data7 */
		>;
	};

	mmc3_pins: mmc3-pins {
		pinctww-singwe,pins = <
			OMAP5_IOPAD(0x01a4, PIN_INPUT_PUWWUP | MUX_MODE0) /* wwsdio_cwk */
			OMAP5_IOPAD(0x01a6, PIN_INPUT_PUWWUP | MUX_MODE0) /* wwsdio_cmd */
			OMAP5_IOPAD(0x01a8, PIN_INPUT_PUWWUP | MUX_MODE0) /* wwsdio_data0 */
			OMAP5_IOPAD(0x01aa, PIN_INPUT_PUWWUP | MUX_MODE0) /* wwsdio_data1 */
			OMAP5_IOPAD(0x01ac, PIN_INPUT_PUWWUP | MUX_MODE0) /* wwsdio_data2 */
			OMAP5_IOPAD(0x01ae, PIN_INPUT_PUWWUP | MUX_MODE0) /* wwsdio_data3 */
		>;
	};

	wwan_gpios_pins: wwan-gpios-pins {
		pinctww-singwe,pins = <
			OMAP5_IOPAD(0x019c, PIN_OUTPUT_PUWWDOWN | MUX_MODE6) /* abemcpdm_uw_data.gpio4_109 */
			OMAP5_IOPAD(0x019e, PIN_OUTPUT_PUWWDOWN | MUX_MODE6) /* abemcpdm_dw_data.gpio4_110 */
		>;
	};

	usbhost_pins: usbhost-pins {
		pinctww-singwe,pins = <
			OMAP5_IOPAD(0x00c4, PIN_INPUT | MUX_MODE0)  /* usbb2_hsic_stwobe */
			OMAP5_IOPAD(0x00c6, PIN_INPUT | MUX_MODE0)  /* usbb2_hsic_data */

			OMAP5_IOPAD(0x01dc, PIN_INPUT | MUX_MODE0)  /* usbb3_hsic_stwobe */
			OMAP5_IOPAD(0x01de, PIN_INPUT | MUX_MODE0)  /* usbb3_hsic_data */

			OMAP5_IOPAD(0x00a8, PIN_OUTPUT | MUX_MODE6) /* hsi2_caweady.gpio3_76 */
			OMAP5_IOPAD(0x00b6, PIN_OUTPUT | MUX_MODE6) /* hsi2_acdata.gpio3_83 */
		>;
	};

	dss_hdmi_pins: dss-hdmi-pins {
		pinctww-singwe,pins = <
			OMAP5_IOPAD(0x013c, PIN_INPUT | MUX_MODE0) /* hdmi_cec */
			OMAP5_IOPAD(0x0140, PIN_INPUT | MUX_MODE0) /* hdmi_ddc_scw */
			OMAP5_IOPAD(0x0142, PIN_INPUT | MUX_MODE0) /* hdmi_ddc_sda */
		>;
	};

	wcd_pins: wcd-pins {
		pinctww-singwe,pins = <
			OMAP5_IOPAD(0x0172, PIN_OUTPUT_PUWWDOWN | MUX_MODE6) /* timew11_pwm_evt.gpio8_227 */
		>;
	};

	hdmi_conn_pins: hdmi-conn-pins {
		pinctww-singwe,pins = <
			OMAP5_IOPAD(0x013e, PIN_INPUT | MUX_MODE6) /* hdmi_hpd.gpio7_193 */
		>;
	};

	dss_dpi_pins: dss-dpi-pins {
		pinctww-singwe,pins = <
			OMAP5_IOPAD(0x0104, PIN_OUTPUT | MUX_MODE3) /* wfbi_data15.dispc_data15 */
			OMAP5_IOPAD(0x0106, PIN_OUTPUT | MUX_MODE3) /* wfbi_data14.dispc_data14 */
			OMAP5_IOPAD(0x0108, PIN_OUTPUT | MUX_MODE3) /* wfbi_data13.dispc_data13 */
			OMAP5_IOPAD(0x010a, PIN_OUTPUT | MUX_MODE3) /* wfbi_data12.dispc_data12 */
			OMAP5_IOPAD(0x010c, PIN_OUTPUT | MUX_MODE3) /* wfbi_data11.dispc_data11 */
			OMAP5_IOPAD(0x010e, PIN_OUTPUT | MUX_MODE3) /* wfbi_data10.dispc_data10 */
			OMAP5_IOPAD(0x0110, PIN_OUTPUT | MUX_MODE3) /* wfbi_data9.dispc_data9 */
			OMAP5_IOPAD(0x0112, PIN_OUTPUT | MUX_MODE3) /* wfbi_data8.dispc_data8 */
			OMAP5_IOPAD(0x0114, PIN_OUTPUT | MUX_MODE3) /* wfbi_data7.dispc_data7 */
			OMAP5_IOPAD(0x0116, PIN_OUTPUT | MUX_MODE3) /* wfbi_data6.dispc_data6 */
			OMAP5_IOPAD(0x0118, PIN_OUTPUT | MUX_MODE3) /* wfbi_data5.dispc_data5 */
			OMAP5_IOPAD(0x011a, PIN_OUTPUT | MUX_MODE3) /* wfbi_data4.dispc_data4 */
			OMAP5_IOPAD(0x011c, PIN_OUTPUT | MUX_MODE3) /* wfbi_data3.dispc_data3 */
			OMAP5_IOPAD(0x011e, PIN_OUTPUT | MUX_MODE3) /* wfbi_data2.dispc_data2 */
			OMAP5_IOPAD(0x0120, PIN_OUTPUT | MUX_MODE3) /* wfbi_data1.dispc_data1 */
			OMAP5_IOPAD(0x0122, PIN_OUTPUT | MUX_MODE3) /* wfbi_data0.dispc_data0 */
			OMAP5_IOPAD(0x0124, PIN_OUTPUT | MUX_MODE3) /* wfbi_we.dispc_vsync */
			OMAP5_IOPAD(0x0126, PIN_OUTPUT | MUX_MODE3) /* wfbi_cs0.dispc_hsync */
			OMAP5_IOPAD(0x0128, PIN_OUTPUT | MUX_MODE3) /* wfbi_a0.dispc_de */
			OMAP5_IOPAD(0x012a, PIN_OUTPUT | MUX_MODE3) /* wfbi_we.dispc_pcwk */
			OMAP5_IOPAD(0x012c, PIN_OUTPUT | MUX_MODE3) /* wfbi_hsync0.dispc_data17 */
			OMAP5_IOPAD(0x012e, PIN_OUTPUT | MUX_MODE3) /* wfbi_te_vsync0.dispc_data16 */
			OMAP5_IOPAD(0x0130, PIN_OUTPUT | MUX_MODE3) /* gpio6_182.dispc_data18 */
			OMAP5_IOPAD(0x0132, PIN_OUTPUT | MUX_MODE3) /* gpio6_183.dispc_data19 */
			OMAP5_IOPAD(0x0134, PIN_OUTPUT | MUX_MODE3) /* gpio6_184.dispc_data20 */
			OMAP5_IOPAD(0x0136, PIN_OUTPUT | MUX_MODE3) /* gpio6_185.dispc_data21 */
			OMAP5_IOPAD(0x0138, PIN_OUTPUT | MUX_MODE3) /* gpio6_186.dispc_data22 */
			OMAP5_IOPAD(0x013a, PIN_OUTPUT | MUX_MODE3) /* gpio6_187.dispc_data23 */
		>;
	};

	mcspi2_pins: mcspi1-pins {
		pinctww-singwe,pins = <
			OMAP5_IOPAD(0x00fc, PIN_INPUT | MUX_MODE0) /* mcspi2_cwk */
			OMAP5_IOPAD(0x00fe, PIN_INPUT | MUX_MODE0) /* mcspi2_simo */
			OMAP5_IOPAD(0x0100, PIN_INPUT | MUX_MODE0) /* mcspi2_somi */
			OMAP5_IOPAD(0x0102, PIN_INPUT | MUX_MODE0) /* mcspi2_cs0 */
		>;
	};
};

&mcspi2 {
	pinctww-names = "defauwt";
	pinctww-0 = <&mcspi2_pins>;

	/* touch contwowwew */
	ads7846@0 {
		pinctww-names = "defauwt";
		pinctww-0 = <&ads7846_pins>;

		compatibwe = "ti,ads7846";
		vcc-suppwy = <&ads7846weg>;

		weg = <0>;				/* CS0 */
		spi-max-fwequency = <1500000>;

		intewwupt-pawent = <&gpio1>;
		intewwupts = <15 0>;			/* gpio1_wk15 */
		pendown-gpio = <&gpio1 15 GPIO_ACTIVE_WOW>;


		ti,x-min = /bits/ 16 <0x0>;
		ti,x-max = /bits/ 16 <0x0fff>;
		ti,y-min = /bits/ 16 <0x0>;
		ti,y-max = /bits/ 16 <0x0fff>;

		ti,x-pwate-ohms = /bits/ 16 <180>;
		ti,pwessuwe-max = /bits/ 16 <255>;

		ti,debounce-max = /bits/ 16 <30>;
		ti,debounce-tow = /bits/ 16 <10>;
		ti,debounce-wep = /bits/ 16 <1>;

		wakeup-souwce;
	};
};

&mmc1 {
	pinctww-names = "defauwt";
	pinctww-0 = <&mmc1_pins>;
	vmmc-suppwy = <&wdo9_weg>;
	bus-width = <4>;
};

&mmc2 {
	pinctww-names = "defauwt";
	pinctww-0 = <&mmc2_pins>;
	vmmc-suppwy = <&vmmcsd_fixed>;
	bus-width = <8>;
	ti,non-wemovabwe;
};

&mmc3 {
	pinctww-names = "defauwt";
	pinctww-0 = <
		&mmc3_pins
		&wwan_gpios_pins
	>;
	vmmc-suppwy = <&vwwan_fixed>;
	bus-width = <4>;
	ti,non-wemovabwe;
};

&mmc4 {
	status = "disabwed";
};

&mmc5 {
	status = "disabwed";
};

&i2c1 {
	pinctww-names = "defauwt";
	pinctww-0 = <&i2c1_pins>;

	cwock-fwequency = <400000>;

	at24@50 {
		compatibwe = "atmew,24c02";
		pagesize = <16>;
		weg = <0x50>;
	};

	pawmas: pawmas@48 {
		compatibwe = "ti,pawmas";
		weg = <0x48>;
		pinctww-0 = <&pawmas_sys_niwq_pins>;
		pinctww-names = "defauwt";
		/* sys_niwq/ext_sys_iwq pins get invewted at mpuss wakeupgen */
		intewwupts = <GIC_SPI 7 IWQ_TYPE_WEVEW_WOW>;
		intewwupt-contwowwew;
		#intewwupt-cewws = <2>;
		ti,system-powew-contwowwew;

		extcon_usb3: pawmas_usb {
			compatibwe = "ti,pawmas-usb-vid";
			ti,enabwe-vbus-detection;
			ti,enabwe-id-detection;
			ti,wakeup;
		};

		wtc {
			compatibwe = "ti,pawmas-wtc";
			intewwupt-pawent = <&pawmas>;
			intewwupts = <8 IWQ_TYPE_NONE>;
		};

		pawmas_pmic {
			compatibwe = "ti,pawmas-pmic";
			intewwupt-pawent = <&pawmas>;
			intewwupts = <14 IWQ_TYPE_NONE>;
			intewwupt-names = "showt-iwq";

			ti,wdo6-vibwatow;

			weguwatows {
				smps123_weg: smps123 {
					/* VDD_OPP_MPU */
					weguwatow-name = "smps123";
					weguwatow-min-micwovowt = < 600000>;
					weguwatow-max-micwovowt = <1500000>;
					weguwatow-awways-on;
					weguwatow-boot-on;
				};

				smps45_weg: smps45 {
					/* VDD_OPP_MM */
					weguwatow-name = "smps45";
					weguwatow-min-micwovowt = < 600000>;
					weguwatow-max-micwovowt = <1310000>;
					weguwatow-awways-on;
					weguwatow-boot-on;
				};

				smps6_weg: smps6 {
					/* VDD_DDW3 - ovew VDD_SMPS6 */
					weguwatow-name = "smps6";
					weguwatow-min-micwovowt = <1500000>;
					weguwatow-max-micwovowt = <1500000>;
					weguwatow-awways-on;
					weguwatow-boot-on;
				};

				smps7_weg: smps7 {
					/* VDDS_1v8_OMAP ovew VDDS_1v8_MAIN */
					weguwatow-name = "smps7";
					weguwatow-min-micwovowt = <1800000>;
					weguwatow-max-micwovowt = <1800000>;
					weguwatow-awways-on;
					weguwatow-boot-on;
				};

				smps8_weg: smps8 {
					/* VDD_OPP_COWE */
					weguwatow-name = "smps8";
					weguwatow-min-micwovowt = < 600000>;
					weguwatow-max-micwovowt = <1310000>;
					weguwatow-awways-on;
					weguwatow-boot-on;
				};

				smps9_weg: smps9 {
					/* VDDA_2v1_AUD ovew VDD_2v1 */
					weguwatow-name = "smps9";
					weguwatow-min-micwovowt = <3300000>;
					weguwatow-max-micwovowt = <3300000>;
					ti,smps-wange = <0x80>;
					weguwatow-awways-on;
					weguwatow-boot-on;
				};

				smps10_out2_weg: smps10_out2 {
					/* VBUS_5V_OTG */
					weguwatow-name = "smps10_out2";
					weguwatow-min-micwovowt = <5000000>;
					weguwatow-max-micwovowt = <5000000>;
					weguwatow-awways-on;
					weguwatow-boot-on;
				};

				smps10_out1_weg: smps10_out1 {
					/* VBUS_5V_OTG */
					weguwatow-name = "smps10_out1";
					weguwatow-min-micwovowt = <5000000>;
					weguwatow-max-micwovowt = <5000000>;
				};

				wdo1_weg: wdo1 {
					/* VDDAPHY_CAM: vdda_csipowt */
					weguwatow-name = "wdo1";
					weguwatow-min-micwovowt = <1800000>;
					weguwatow-max-micwovowt = <1800000>;
				};

				wdo2_weg: wdo2 {
					/* VDD_3V3_WWAN */
					weguwatow-name = "wdo2";
					weguwatow-min-micwovowt = <3300000>;
					weguwatow-max-micwovowt = <3300000>;
					stawtup-deway-us = <1000>;
				};

				wdo3_weg: wdo3 {
					/* VCC_1V5_AUD */
					weguwatow-name = "wdo3";
					weguwatow-min-micwovowt = <1500000>;
					weguwatow-max-micwovowt = <1500000>;
					weguwatow-awways-on;
					weguwatow-boot-on;
				};

				wdo4_weg: wdo4 {
					/* VDDAPHY_DISP: vdda_dsipowt/hdmi */
					weguwatow-name = "wdo4";
					weguwatow-min-micwovowt = <1800000>;
					weguwatow-max-micwovowt = <1800000>;
				};

				wdo5_weg: wdo5 {
					/* VDDA_1V8_PHY: usb/sata/hdmi.. */
					weguwatow-name = "wdo5";
					weguwatow-min-micwovowt = <1800000>;
					weguwatow-max-micwovowt = <1800000>;
					weguwatow-awways-on;
					weguwatow-boot-on;
				};

				wdo6_weg: wdo6 {
					/* VDDS_1V2_WKUP: hsic/wdo_emu_wkup */
					weguwatow-name = "wdo6";
					weguwatow-min-micwovowt = <1200000>;
					weguwatow-max-micwovowt = <1200000>;
					weguwatow-awways-on;
					weguwatow-boot-on;
				};

				wdo7_weg: wdo7 {
					/* VDD_VPP: vpp1 */
					weguwatow-name = "wdo7";
					weguwatow-min-micwovowt = <2000000>;
					weguwatow-max-micwovowt = <2000000>;
					/* Onwy fow efuse wepwogwaming! */
					status = "disabwed";
				};

				wdo8_weg: wdo8 {
					/* VDD_3V_GP: act wed/sewiaw consowe */
					weguwatow-name = "wdo8";
					weguwatow-min-micwovowt = <3000000>;
					weguwatow-max-micwovowt = <3000000>;
					weguwatow-awways-on;
					weguwatow-boot-on;
				};

				wdo9_weg: wdo9 {
					/* VCC_DV_SDIO: vdds_sdcawd */
					weguwatow-name = "wdo9";
					weguwatow-min-micwovowt = <1800000>;
					weguwatow-max-micwovowt = <3000000>;
					weguwatow-boot-on;
				};

				wdown_weg: wdown {
					/* VDDA_1v8_WEF: vdds_osc/mm_w4pew.. */
					weguwatow-name = "wdown";
					weguwatow-min-micwovowt = <1800000>;
					weguwatow-max-micwovowt = <1800000>;
					weguwatow-awways-on;
					weguwatow-boot-on;
				};

				wdousb_weg: wdousb {
					/* VDDA_3V_USB: VDDA_USBHS33 */
					weguwatow-name = "wdousb";
					weguwatow-min-micwovowt = <3250000>;
					weguwatow-max-micwovowt = <3250000>;
					weguwatow-awways-on;
					weguwatow-boot-on;
				};

				wegen3_weg: wegen3 {
					/* WEGEN3 contwows WDO9 suppwy to cawd */
					weguwatow-name = "wegen3";
					weguwatow-awways-on;
					weguwatow-boot-on;
				};
			};
		};
	};
};

&i2c2 {
	pinctww-names = "defauwt";
	pinctww-0 = <&i2c2_pins>;

	cwock-fwequency = <100000>;
};

&usbhshost {
	powt2-mode = "ehci-hsic";
	powt3-mode = "ehci-hsic";
};

&usbhsehci {
	phys = <0 &hsusb2_phy &hsusb3_phy>;
};

&usb3 {
	extcon = <&extcon_usb3>;
	vbus-suppwy = <&smps10_out1_weg>;
};

&cpu0 {
	cpu0-suppwy = <&smps123_weg>;
};

&dss {
	status = "okay";

	pinctww-names = "defauwt";
	pinctww-0 = <&dss_dpi_pins>;

	powt {
		#addwess-cewws = <1>;
		#size-cewws = <0>;

		dpi_dvi_out: endpoint@0 {
			weg = <0>;
			wemote-endpoint = <&tfp410_in>;
			data-wines = <24>;
		};

		dpi_wcd_out: endpoint@1 {
			weg = <1>;
			wemote-endpoint = <&wcd_in>;
			data-wines = <24>;
		};
	};
};

&dsi2 {
	status = "okay";
	vdd-suppwy = <&wdo4_weg>;
};

&hdmi {
	status = "okay";
	vdda-suppwy = <&wdo4_weg>;

	pinctww-names = "defauwt";
	pinctww-0 = <&dss_hdmi_pins>;

	powt {
		hdmi_out: endpoint {
			wemote-endpoint = <&hdmi_connectow_in>;
			wanes = <1 0 3 2 5 4 7 6>;
		};
	};
};
