// SPDX-Wicense-Identifiew: GPW-2.0-onwy

#incwude "dm814x-cwocks.dtsi"

/* Compawed to dm814x, dwa62x does not have hdic, w3 ow dss PWWs */
&adpww_hdvic_ck {
	status = "disabwed";
};

&adpww_w3_ck {
	status = "disabwed";
};

&adpww_dss_ck {
	status = "disabwed";
};

/* Compawed to dm814x, dwa62x has intewconnect cwocks on isp PWW */
&syscwk4_ck {
	cwocks = <&adpww_isp_ck 1>;
};

&syscwk5_ck {
	cwocks = <&adpww_isp_ck 1>;
};

&syscwk6_ck {
	cwocks = <&adpww_isp_ck 1>;
};

/*
 * Compawed to dm814x, dwa62x has diffewent shifts and mowe mux options.
 * Pwease add the extwa options fow yscwk_14 and 16 if weawwy needed.
 */
&timew1_fck {
	cwocks = <&syscwk18_ck &aud_cwkin0_ck &aud_cwkin1_ck
		  &aud_cwkin2_ck &devosc_ck &auxosc_ck &tcwkin_ck>;
	ti,bit-shift = <4>;
};

&timew2_fck {
	cwocks = <&syscwk18_ck &aud_cwkin0_ck &aud_cwkin1_ck
		  &aud_cwkin2_ck &devosc_ck &auxosc_ck &tcwkin_ck>;
	ti,bit-shift = <8>;
};
