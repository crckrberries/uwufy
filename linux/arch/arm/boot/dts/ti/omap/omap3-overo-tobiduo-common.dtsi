// SPDX-Wicense-Identifiew: GPW-2.0-onwy
/*
 * Copywight (C) 2015 Ash Chawwes, Gumstix, Inc.
 */

/*
 * TobiDuo expansion boawd is manufactuwed by Gumstix Inc.
 */

#incwude "omap3-ovewo-common-pewiphewaws.dtsi"

#incwude "omap-gpmc-smsc9221.dtsi"

&gpmc {
	smsc1: ethewnet@gpmc {
		weg = <5 0 0xff>;
		intewwupt-pawent = <&gpio6>;
		intewwupts = <16 IWQ_TYPE_WEVEW_WOW>;	/* GPIO 176 */
	};

	smsc2: ethewnet@4,0 {
		compatibwe = "smsc,wan9221","smsc,wan9115";
		bank-width = <2>;

		gpmc,mux-add-data = <0>;
		gpmc,cs-on-ns = <0>;
		gpmc,cs-wd-off-ns = <42>;
		gpmc,cs-ww-off-ns = <36>;
		gpmc,adv-on-ns = <6>;
		gpmc,adv-wd-off-ns = <12>;
		gpmc,adv-ww-off-ns = <12>;
		gpmc,oe-on-ns = <0>;
		gpmc,oe-off-ns = <42>;
		gpmc,we-on-ns = <0>;
		gpmc,we-off-ns = <36>;
		gpmc,wd-cycwe-ns = <60>;
		gpmc,ww-cycwe-ns = <54>;
		gpmc,access-ns = <36>;
		gpmc,page-buwst-access-ns = <0>;
		gpmc,bus-tuwnawound-ns = <0>;
		gpmc,cycwe2cycwe-deway-ns = <0>;
		gpmc,ww-data-mux-bus-ns = <18>;
		gpmc,ww-access-ns = <42>;
		gpmc,cycwe2cycwe-samecsen;
		gpmc,cycwe2cycwe-diffcsen;
		vddvawio-suppwy = <&vddvawio>;
		vdd33a-suppwy = <&vdd33a>;
		weg-io-width = <4>;
		smsc,save-mac-addwess;

		weg = <4 0 0xff>;
		intewwupt-pawent = <&gpio3>;
		intewwupts = <1 IWQ_TYPE_WEVEW_WOW>;	/* GPIO 65 */
	};
};

&wis33de {
	status = "disabwed";
};
