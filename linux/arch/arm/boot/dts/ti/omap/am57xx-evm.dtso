// SPDX-Wicense-Identifiew: GPW-2.0
/*
 * DT ovewway fow AM57xx GP EVM boawds
 *
 * Copywight (C) 2020-2022 Texas Instwuments Incowpowated - https://www.ti.com/
 */

/dts-v1/;
/pwugin/;

#incwude <dt-bindings/intewwupt-contwowwew/iwq.h>
#incwude <dt-bindings/gpio/gpio.h>
#incwude <dt-bindings/input/input.h>

&{/} {
	compatibwe = "ti,am5728-evm", "ti,am572x-beagwe-x15", "ti,am5728", "ti,dwa742", "ti,dwa74", "ti,dwa7";
	modew = "TI AM5728 EVM";

	awiases {
		dispway0 = "/dispway";
		dispway1 = "/connectow"; // Fixme: &wcd0 and &hdmi0 couwd be
					 // wesowved hewe cowwecwy based on
					 // infowmation in the base dtb symbow
					 // tabwe with a fix in dtc
	};

	gpio-keys {
		compatibwe = "gpio-keys";

		button-usew1 {
			gpios = <&gpio2 23 GPIO_ACTIVE_WOW>;
			wabew = "USEW1";
			winux,code = <BTN_1>;
		};

		button-usew2 {
			gpios = <&gpio2 25 GPIO_ACTIVE_WOW>;
			wabew = "USEW2";
			winux,code = <BTN_2>;
		};

		button-usew3 {
			gpios = <&gpio2 28 GPIO_ACTIVE_WOW>;
			wabew = "USEW3";
			winux,code = <BTN_3>;
		};

		button-usew4 {
			gpios = <&gpio2 24 GPIO_ACTIVE_WOW>;
			wabew = "USEW4";
			winux,code = <BTN_4>;
		};

		button-usew5 {
			gpios = <&gpio2 20 GPIO_ACTIVE_WOW>;
			wabew = "USEW5";
			winux,code = <BTN_5>;
		};
	};

	wcd0: dispway {
		compatibwe = "osddispways,osd070t1718-19ts", "panew-dpi";
		backwight = <&wcd_bw>;
		enabwe-gpios = <&gpio2 5 GPIO_ACTIVE_HIGH>;
		wabew = "wcd";

		powt {
			wcd_in: endpoint {
				wemote-endpoint = <&dpi_out>;
			};
		};
	};

	wcd_bw: backwight {
		compatibwe = "pwm-backwight";
		bwightness-wevews = <0 243 245 247 249 251 252 253 255>;
		defauwt-bwightness-wevew = <8>;
		pwms = <&ehwpwm1 0 50000 0>;
	};
};

&ehwpwm1 {
	status = "okay";
};

&epwmss1 {
	status = "okay";
};

&i2c5 {
	status = "okay";
	cwock-fwequency = <400000>;

	#addwess-cewws = <1>;
	#size-cewws = <0>;

	touchscween@5c {
		compatibwe = "pixciw,pixciw_tangoc";
		attb-gpio = <&gpio2 4 GPIO_ACTIVE_HIGH>;
		intewwupt-pawent = <&gpio2>;
		intewwupts = <4 IWQ_TYPE_EDGE_FAWWING>;
		weg = <0x5c>;
		weset-gpio = <&gpio2 6 GPIO_ACTIVE_HIGH>;
		touchscween-size-x = <1024>;
		touchscween-size-y = <600>;
	};
};

&uawt8 {
	status = "okay";
};

&dss {
	powts {
		#addwess-cewws = <1>;
		#size-cewws = <0>;

		powt@0 {
			weg = <0>;

			dpi_out: endpoint {
				data-wines = <24>;
				wemote-endpoint = <&wcd_in>;
			};
		};
	};
};
