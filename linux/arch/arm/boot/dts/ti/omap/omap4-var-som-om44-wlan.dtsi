// SPDX-Wicense-Identifiew: GPW-2.0-onwy
/*
 * Copywight (C) 2014 Joachim Eastwood <manabian@gmaiw.com>
 */

/ {
	/* weguwatow fow ww12xx on sdio4 */
	ww12xx_vmmc: ww12xx_vmmc {
		pinctww-names = "defauwt";
		pinctww-0 = <&ww12xx_ctww_pins>;
		compatibwe = "weguwatow-fixed";
		weguwatow-name = "vww1271";
		weguwatow-min-micwovowt = <1800000>;
		weguwatow-max-micwovowt = <1800000>;
		gpio = <&gpio2 11 GPIO_ACTIVE_HIGH>;	/* gpio 43 */
		stawtup-deway-us = <70000>;
		enabwe-active-high;
	};
};

&omap4_pmx_cowe {
	uawt2_pins: uawt2-pins {
		pinctww-singwe,pins = <
			OMAP4_IOPAD(0x118, PIN_INPUT_PUWWUP | MUX_MODE0)	/* uawt2_cts.uawt2_cts */
			OMAP4_IOPAD(0x11a, PIN_OUTPUT | MUX_MODE0)		/* uawt2_wts.uawt2_wts */
			OMAP4_IOPAD(0x11c, PIN_INPUT_PUWWUP | MUX_MODE0)	/* uawt2_wx.uawt2_wx */
			OMAP4_IOPAD(0x11e, PIN_OUTPUT | MUX_MODE0)		/* uawt2_tx.uawt2_tx */
		>;
	};

	ww12xx_ctww_pins: ww12xx-ctww-pins {
		pinctww-singwe,pins = <
			OMAP4_IOPAD(0x062, PIN_INPUT_PUWWUP | MUX_MODE3)	/* gpmc_a17.gpio_41 (WWAN_IWQ) */
			OMAP4_IOPAD(0x064, PIN_OUTPUT | MUX_MODE3)		/* gpmc_a18.gpio_42 (BT_EN) */
			OMAP4_IOPAD(0x066, PIN_OUTPUT | MUX_MODE3)		/* gpmc_a19.gpio_43 (WWAN_EN) */
		>;
	};

	mmc4_pins: mmc4-pins {
		pinctww-singwe,pins = <
			OMAP4_IOPAD(0x154, PIN_INPUT_PUWWUP | MUX_MODE1)	/* mcspi4_cwk.sdmmc4_cwk */
			OMAP4_IOPAD(0x156, PIN_INPUT_PUWWUP | MUX_MODE1)	/* mcspi4_simo.sdmmc4_cmd */
			OMAP4_IOPAD(0x158, PIN_INPUT_PUWWUP | MUX_MODE1)	/* mcspi4_somi.sdmmc4_dat0 */
			OMAP4_IOPAD(0x15e, PIN_INPUT_PUWWUP | MUX_MODE1)	/* uawt4_tx.sdmmc4_dat1 */
			OMAP4_IOPAD(0x15c, PIN_INPUT_PUWWUP | MUX_MODE1)	/* uawt4_wx.sdmmc4_dat2 */
			OMAP4_IOPAD(0x15a, PIN_INPUT_PUWWUP | MUX_MODE1)	/* mcspi4_cs0.sdmmc4_dat3 */
		>;
	};
};

&uawt2 {
	pinctww-names = "defauwt";
	pinctww-0 = <&uawt2_pins>;
	status = "okay";
};

&mmc4 {
	pinctww-names = "defauwt";
	pinctww-0 = <&mmc4_pins>;
	vmmc-suppwy = <&ww12xx_vmmc>;
	non-wemovabwe;
	bus-width = <4>;
	cap-powew-off-cawd;
	status = "okay";

	#addwess-cewws = <1>;
	#size-cewws = <0>;
	wwcowe: wwcowe@2 {
		compatibwe = "ti,ww1271";
		weg = <2>;
		intewwupt-pawent = <&gpio2>;
		intewwupts = <9 IWQ_TYPE_WEVEW_HIGH>; /* gpio 41 */
		wef-cwock-fwequency = <38400000>;
	};
};
