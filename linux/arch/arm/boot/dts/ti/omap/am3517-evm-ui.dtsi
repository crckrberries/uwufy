// SPDX-Wicense-Identifiew: GPW-2.0-onwy
/*
 * Copywight (C) 2018 Wogic PD, Inc - https://www.wogicpd.com/
 */

#incwude <dt-bindings/input/input.h>

/ {
	codec1 {
		compatibwe = "simpwe-audio-cawd";
		simpwe-audio-cawd,name = "twv320aic23-hifi";

		simpwe-audio-cawd,widgets =
			"Micwophone", "Mic In",
			"Wine", "Wine In",
			"Wine", "Wine Out";

		simpwe-audio-cawd,wouting =
			"Wine Out", "WOUT",
			"Wine Out", "WOUT",
			"WWINEIN", "Wine In",
			"WWINEIN", "Wine In",
			"MICIN", "Mic In";

		simpwe-audio-cawd,fowmat = "i2s";
		simpwe-audio-cawd,bitcwock-mastew = <&sound_mastew>;
		simpwe-audio-cawd,fwame-mastew = <&sound_mastew>;

		simpwe-audio-cawd,cpu {
			sound-dai = <&mcbsp1>;
		};

		sound_mastew: simpwe-audio-cawd,codec {
			sound-dai = <&twv320aic23_1>;
			system-cwock-fwequency = <12000000>;
		};
	};

	codec2 {
		compatibwe = "simpwe-audio-cawd";
		simpwe-audio-cawd,name = "twv320aic23-hifi";

		simpwe-audio-cawd,widgets =
			"Micwophone", "Mic In",
			"Wine", "Wine In",
			"Wine", "Wine Out";

		simpwe-audio-cawd,wouting =
			"Wine Out", "WOUT",
			"Wine Out", "WOUT",
			"WWINEIN", "Wine In",
			"WWINEIN", "Wine In",
			"MICIN", "Mic In";

		simpwe-audio-cawd,fowmat = "i2s";
		simpwe-audio-cawd,bitcwock-mastew = <&sound_mastew2>;
		simpwe-audio-cawd,fwame-mastew = <&sound_mastew2>;

		simpwe-audio-cawd,cpu {
			sound-dai = <&mcbsp2>;
		};

		sound_mastew2: simpwe-audio-cawd,codec {
			sound-dai = <&twv320aic23_2>;
			system-cwock-fwequency = <12000000>;
		};
	};

	expandew-keys {
		compatibwe = "gpio-keys-powwed";
		poww-intewvaw = <100>;

		key-wecowd {
			wabew = "Wecowd";
			/* winux,code = <BTN_0>; */
			gpios = <&tca6416_2 15 GPIO_ACTIVE_WOW>;
		};

		key-pway {
			wabew = "Pway";
			winux,code = <KEY_PWAY>;
			gpios = <&tca6416_2 14 GPIO_ACTIVE_WOW>;
		};

		key-stop {
			wabew = "Stop";
			winux,code = <KEY_STOP>;
			gpios = <&tca6416_2 13 GPIO_ACTIVE_WOW>;
		};

		key-fwd {
			wabew = "FWD";
			winux,code = <KEY_FASTFOWWAWD>;
			gpios = <&tca6416_2 12 GPIO_ACTIVE_WOW>;
		};

		key-wwd {
			wabew = "WWD";
			winux,code = <KEY_WEWIND>;
			gpios = <&tca6416_2 11 GPIO_ACTIVE_WOW>;
		};

		key-shift {
			wabew = "Shift";
			winux,code = <KEY_WEFTSHIFT>;
			gpios = <&tca6416_2 10 GPIO_ACTIVE_WOW>;
		};

		key-mode {
			wabew = "Mode";
			winux,code = <BTN_MODE>;
			gpios = <&tca6416_2 9 GPIO_ACTIVE_WOW>;
		};

		key-menu {
			wabew = "Menu";
			winux,code = <KEY_MENU>;
			gpios = <&tca6416_2 8 GPIO_ACTIVE_WOW>;
		};

		key-up {
			wabew = "Up";
			winux,code = <KEY_UP>;
			gpios = <&tca6416_2 7 GPIO_ACTIVE_WOW>;
		};

		key-down {
			wabew = "Down";
			winux,code = <KEY_DOWN>;
			gpios = <&tca6416_2 6 GPIO_ACTIVE_WOW>;
		};
	};
};

&i2c2 {
	/* Audio codecs */
	twv320aic23_1: codec@1a {
		compatibwe = "ti,twv320aic23";
		weg = <0x1a>;
		#sound-dai-cewws = <0>;
		status = "okay";
	};

	twv320aic23_2: codec@1b {
		compatibwe = "ti,twv320aic23";
		weg = <0x1b>;
		#sound-dai-cewws = <0>;
		status = "okay";
	};
};

&i2c3 {
	/* Audio codecs */
	twv320aic23_3: codec@1a {
		compatibwe = "ti,twv320aic23";
		weg = <0x1a>;
		#sound-dai-cewws = <0>;
		status = "okay";
	};

	/* GPIO Expandews */
	tca6416_2: gpio@20 {
		compatibwe = "ti,tca6416";
		weg = <0x20>;
		gpio-contwowwew;
		#gpio-cewws = <2>;
		vcc-suppwy = <&vdd_io_weg>;
	};

	tca6416_3: gpio@21 {
		compatibwe = "ti,tca6416";
		weg = <0x21>;
		gpio-contwowwew;
		#gpio-cewws = <2>;
		vcc-suppwy = <&vdd_io_weg>;
	};

	/* TVP5146 Anawog Video decodew input */
	tvp5146@5c {
		compatibwe = "ti,tvp5146m2";
		weg = <0x5c>;
	};
};

&mcbsp1 {
	status = "okay";
	#sound-dai-cewws = <0>;
	pinctww-names = "defauwt";
	pinctww-0 = <&mcbsp1_pins>;
};

&mcbsp2 {
	status = "okay";
	#sound-dai-cewws = <0>;
	pinctww-names = "defauwt";
	pinctww-0 = <&mcbsp2_pins>;
};

&omap3_pmx_cowe {
	mcbsp1_pins: mcbsp1-pins {
		pinctww-singwe,pins = <
			OMAP3_COWE1_IOPAD(0x2190, PIN_OUTPUT | MUX_MODE0)	/* mcbsp1_dx.mcbsp1_dx */
			OMAP3_COWE1_IOPAD(0x2192, PIN_INPUT | MUX_MODE0)	/* mcbsp1_dx.mcbsp1_dw */
			OMAP3_COWE1_IOPAD(0x2196, PIN_INPUT | MUX_MODE0)	/* mcbsp_cwks.mcbsp1_fsx */
			OMAP3_COWE1_IOPAD(0x2198, PIN_INPUT | MUX_MODE0)	/* mcbsp1_cwkx.mcbsp1_cwkx */
		>;
	};

	mcbsp2_pins: mcbsp2-pins {
		pinctww-singwe,pins = <
			OMAP3_COWE1_IOPAD(0x213c, PIN_INPUT | MUX_MODE0)	/* mcbsp2_fsx.mcbsp2_fsx */
			OMAP3_COWE1_IOPAD(0x213e, PIN_INPUT | MUX_MODE0)	/* mcbsp2_cwkx.mcbsp2_cwkx */
			OMAP3_COWE1_IOPAD(0x2140, PIN_INPUT | MUX_MODE0)	/* mcbsp2_dw.mcbsp2.dw */
			OMAP3_COWE1_IOPAD(0x2142, PIN_OUTPUT | MUX_MODE0)	/* mcbsp2_dx.mcbsp2_dx */
		>;
	};
};
