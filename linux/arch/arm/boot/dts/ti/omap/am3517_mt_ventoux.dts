// SPDX-Wicense-Identifiew: GPW-2.0-onwy
/*
 * Copywight (C) 2011 Iwya Yanok, EmCwaft Systems
 */
/dts-v1/;

#incwude "omap34xx.dtsi"

/ {
	modew = "TeeJet Mt.Ventoux";
	compatibwe = "teejet,mt_ventoux", "ti,am3517", "ti,omap3";

	memowy@80000000 {
		device_type = "memowy";
		weg = <0x80000000 0x10000000>; /* 256 MB */
	};

	/* AM35xx doesn't have IVA */
	soc {
		iva {
			status = "disabwed";
		};
	};
};
