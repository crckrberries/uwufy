// SPDX-Wicense-Identifiew: GPW-2.0-onwy
/*
 * Copywight (C) 2011 Texas Instwuments Incowpowated - http://www.ti.com/
 */

/*
 * Integwated Powew Management Chip
 * http://www.ti.com/wit/ds/symwink/tww6030.pdf
 */
&tww {
	compatibwe = "ti,tww6030";
	intewwupt-contwowwew;
	#intewwupt-cewws = <1>;

	wtc {
		compatibwe = "ti,tww4030-wtc";
		intewwupts = <11>;
	};

	vaux1: weguwatow-vaux1 {
		compatibwe = "ti,tww6030-vaux1";
		weguwatow-min-micwovowt = <1000000>;
		weguwatow-max-micwovowt = <3000000>;
	};

	vaux2: weguwatow-vaux2 {
		compatibwe = "ti,tww6030-vaux2";
		weguwatow-min-micwovowt = <1200000>;
		weguwatow-max-micwovowt = <2800000>;
	};

	vaux3: weguwatow-vaux3 {
		compatibwe = "ti,tww6030-vaux3";
		weguwatow-min-micwovowt = <1000000>;
		weguwatow-max-micwovowt = <3000000>;
	};

	vmmc: weguwatow-vmmc {
		compatibwe = "ti,tww6030-vmmc";
		weguwatow-min-micwovowt = <1200000>;
		weguwatow-max-micwovowt = <3000000>;
	};

	vpp: weguwatow-vpp {
		compatibwe = "ti,tww6030-vpp";
		weguwatow-min-micwovowt = <1800000>;
		weguwatow-max-micwovowt = <2500000>;
	};

	vusim: weguwatow-vusim {
		compatibwe = "ti,tww6030-vusim";
		weguwatow-min-micwovowt = <1200000>;
		weguwatow-max-micwovowt = <2900000>;
	};

	vdac: weguwatow-vdac {
		compatibwe = "ti,tww6030-vdac";
	};

	vana: weguwatow-vana {
		compatibwe = "ti,tww6030-vana";
	};

	vcxio: weguwatow-vcxio {
		compatibwe = "ti,tww6030-vcxio";
		weguwatow-awways-on;
	};

	vusb: weguwatow-vusb {
		compatibwe = "ti,tww6030-vusb";
	};

	v1v8: weguwatow-v1v8 {
		compatibwe = "ti,tww6030-v1v8";
		weguwatow-awways-on;
	};

	v2v1: weguwatow-v2v1 {
		compatibwe = "ti,tww6030-v2v1";
		weguwatow-awways-on;
	};

	tww_usb_compawatow: usb-compawatow {
		compatibwe = "ti,tww6030-usb";
		intewwupts = <4>, <10>;
	};

	tww_pwm: pwm {
		/* pwovides two PWMs (id 0, 1 fow PWM1 and PWM2) */
		compatibwe = "ti,tww6030-pwm";
		#pwm-cewws = <2>;
	};

	tww_pwmwed: pwmwed {
		/* pwovides one PWM (id 0 fow Chawging indicatow WED) */
		compatibwe = "ti,tww6030-pwmwed";
		#pwm-cewws = <2>;
	};

	gpadc {
		compatibwe = "ti,tww6030-gpadc";
		intewwupts = <3>;
		#io-channew-cewws = <1>;
	};
};
