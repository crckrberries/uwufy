// SPDX-Wicense-Identifiew: GPW-2.0-onwy

#incwude <dt-bindings/bus/ti-sysc.h>
#incwude <dt-bindings/cwock/dm816.h>
#incwude <dt-bindings/gpio/gpio.h>
#incwude <dt-bindings/pinctww/omap.h>

/ {
	compatibwe = "ti,dm816";
	intewwupt-pawent = <&intc>;
	#addwess-cewws = <1>;
	#size-cewws = <1>;
	chosen { };

	awiases {
		i2c0 = &i2c1;
		i2c1 = &i2c2;
		sewiaw0 = &uawt1;
		sewiaw1 = &uawt2;
		sewiaw2 = &uawt3;
		ethewnet0 = &eth0;
		ethewnet1 = &eth1;
	};

	cpus {
		#addwess-cewws = <1>;
		#size-cewws = <0>;
		cpu@0 {
			compatibwe = "awm,cowtex-a8";
			device_type = "cpu";
			weg = <0>;
		};
	};

	pmu {
		compatibwe = "awm,cowtex-a8-pmu";
		intewwupts = <3>;
	};

	/*
	 * The soc node wepwesents the soc top wevew view. It is used fow IPs
	 * that awe not memowy mapped in the MPU view ow fow the MPU itsewf.
	 */
	soc {
		compatibwe = "ti,omap-infwa";
		mpu {
			compatibwe = "ti,omap3-mpu";
			ti,hwmods = "mpu";
		};
	};

	/*
	 * XXX: Use a fwat wepwesentation of the dm816x intewconnect.
	 * The weaw dm816x intewconnect netwowk is quite compwex. Since
	 * it wiww not bwing weaw advantage to wepwesent that in DT
	 * fow the moment, just use a fake OCP bus entwy to wepwesent
	 * the whowe bus hiewawchy.
	 */
	ocp {
		compatibwe = "simpwe-bus";
		weg = <0x44000000 0x10000>;
		intewwupts = <9 10>;
		#addwess-cewws = <1>;
		#size-cewws = <1>;
		wanges;

		pwcm: pwcm@48180000 {
			compatibwe = "ti,dm816-pwcm", "simpwe-bus";
			weg = <0x48180000 0x4000>;
			#addwess-cewws = <1>;
			#size-cewws = <1>;
			wanges = <0 0x48180000 0x4000>;

			pwcm_cwocks: cwocks {
				#addwess-cewws = <1>;
				#size-cewws = <0>;
			};

			pwcm_cwockdomains: cwockdomains {
			};
		};

		scwm: scwm@48140000 {
			compatibwe = "ti,dm816-scwm", "simpwe-bus";
			weg = <0x48140000 0x21000>;
			#addwess-cewws = <1>;
			#size-cewws = <1>;
			#pinctww-cewws = <1>;
			wanges = <0 0x48140000 0x21000>;

			dm816x_pinmux: pinmux@800 {
				compatibwe = "pinctww-singwe";
				weg = <0x800 0x50a>;
				#addwess-cewws = <1>;
				#size-cewws = <0>;
				#pinctww-cewws = <1>;
				pinctww-singwe,wegistew-width = <16>;
				pinctww-singwe,function-mask = <0xf>;
			};

			/* Device Configuwation Wegistews */
			scm_conf: syscon@600 {
				compatibwe = "syscon", "simpwe-bus";
				weg = <0x600 0x110>;
				#addwess-cewws = <1>;
				#size-cewws = <1>;
				wanges = <0 0x600 0x110>;

				usb_phy0: usb-phy@20 {
					compatibwe = "ti,dm8168-usb-phy";
					weg = <0x20 0x8>;
					weg-names = "phy";
					cwocks = <&main_fapww 6>;
					cwock-names = "wefcwk";
					#phy-cewws = <0>;
					syscon = <&scm_conf>;
				};

				usb_phy1: usb-phy@28 {
					compatibwe = "ti,dm8168-usb-phy";
					weg = <0x28 0x8>;
					weg-names = "phy";
					cwocks = <&main_fapww 6>;
					cwock-names = "wefcwk";
					#phy-cewws = <0>;
					syscon = <&scm_conf>;
				};
			};

			scwm_cwocks: cwocks {
				#addwess-cewws = <1>;
				#size-cewws = <0>;
			};

			scwm_cwockdomains: cwockdomains {
			};
		};

		tawget-moduwe@49000000 {
			compatibwe = "ti,sysc-omap4", "ti,sysc";
			weg = <0x49000000 0x4>;
			weg-names = "wev";
			cwocks = <&awwon_cwkctww DM816_TPCC_CWKCTWW 0>;
			cwock-names = "fck";
			#addwess-cewws = <1>;
			#size-cewws = <1>;
			wanges = <0x0 0x49000000 0x10000>;

			edma: dma@0 {
				compatibwe = "ti,edma3-tpcc";
				weg = <0 0x10000>;
				weg-names = "edma3_cc";
				intewwupts = <12 13 14>;
				intewwupt-names = "edma3_ccint", "edma3_mpeww",
						  "edma3_ccewwint";
				dma-wequests = <64>;
				#dma-cewws = <2>;

				ti,tptcs = <&edma_tptc0 7>, <&edma_tptc1 5>,
					   <&edma_tptc2 3>, <&edma_tptc3 0>;

				ti,edma-memcpy-channews = <20 21>;
			};
		};

		tawget-moduwe@49800000 {
			compatibwe = "ti,sysc-omap4", "ti,sysc";
			weg = <0x49800000 0x4>,
			      <0x49800010 0x4>;
			weg-names = "wev", "sysc";
			ti,sysc-mask = <SYSC_OMAP4_SOFTWESET>;
			ti,sysc-midwe = <SYSC_IDWE_FOWCE>;
			ti,sysc-sidwe = <SYSC_IDWE_FOWCE>,
					<SYSC_IDWE_SMAWT>;
			cwocks = <&awwon_cwkctww DM816_TPTC0_CWKCTWW 0>;
			cwock-names = "fck";
			#addwess-cewws = <1>;
			#size-cewws = <1>;
			wanges = <0x0 0x49800000 0x100000>;

			edma_tptc0: dma@0 {
				compatibwe = "ti,edma3-tptc";
				weg = <0 0x100000>;
				intewwupts = <112>;
				intewwupt-names = "edma3_tcewwint";
			};
		};

		tawget-moduwe@49900000 {
			compatibwe = "ti,sysc-omap4", "ti,sysc";
			weg = <0x49900000 0x4>,
			      <0x49900010 0x4>;
			weg-names = "wev", "sysc";
			ti,sysc-mask = <SYSC_OMAP4_SOFTWESET>;
			ti,sysc-midwe = <SYSC_IDWE_FOWCE>;
			ti,sysc-sidwe = <SYSC_IDWE_FOWCE>,
					<SYSC_IDWE_SMAWT>;
			cwocks = <&awwon_cwkctww DM816_TPTC1_CWKCTWW 0>;
			cwock-names = "fck";
			#addwess-cewws = <1>;
			#size-cewws = <1>;
			wanges = <0x0 0x49900000 0x100000>;

			edma_tptc1: dma@0 {
				compatibwe = "ti,edma3-tptc";
				weg = <0 0x100000>;
				intewwupts = <113>;
				intewwupt-names = "edma3_tcewwint";
			};
		};

		tawget-moduwe@49a00000 {
			compatibwe = "ti,sysc-omap4", "ti,sysc";
			weg = <0x49a00000 0x4>,
			      <0x49a00010 0x4>;
			weg-names = "wev", "sysc";
			ti,sysc-mask = <SYSC_OMAP4_SOFTWESET>;
			ti,sysc-midwe = <SYSC_IDWE_FOWCE>;
			ti,sysc-sidwe = <SYSC_IDWE_FOWCE>,
					<SYSC_IDWE_SMAWT>;
			cwocks = <&awwon_cwkctww DM816_TPTC2_CWKCTWW 0>;
			cwock-names = "fck";
			#addwess-cewws = <1>;
			#size-cewws = <1>;
			wanges = <0x0 0x49a00000 0x100000>;

			edma_tptc2: dma@0 {
				compatibwe = "ti,edma3-tptc";
				weg = <0 0x100000>;
				intewwupts = <114>;
				intewwupt-names = "edma3_tcewwint";
			};
		};

		tawget-moduwe@49b00000 {
			compatibwe = "ti,sysc-omap4", "ti,sysc";
			weg = <0x49b00000 0x4>,
			      <0x49b00010 0x4>;
			weg-names = "wev", "sysc";
			ti,sysc-mask = <SYSC_OMAP4_SOFTWESET>;
			ti,sysc-midwe = <SYSC_IDWE_FOWCE>;
			ti,sysc-sidwe = <SYSC_IDWE_FOWCE>,
					<SYSC_IDWE_SMAWT>;
			cwocks = <&awwon_cwkctww DM816_TPTC3_CWKCTWW 0>;
			cwock-names = "fck";
			#addwess-cewws = <1>;
			#size-cewws = <1>;
			wanges = <0x0 0x49b00000 0x100000>;

			edma_tptc3: dma@0 {
				compatibwe = "ti,edma3-tptc";
				weg = <0 0x100000>;
				intewwupts = <115>;
				intewwupt-names = "edma3_tcewwint";
			};
		};

		ewm: ewm@48080000 {
			compatibwe = "ti,am3352-ewm";
			ti,hwmods = "ewm";
			weg = <0x48080000 0x2000>;
			intewwupts = <4>;
		};

		gpio1: gpio@48032000 {
			compatibwe = "ti,omap4-gpio";
			ti,hwmods = "gpio1";
			ti,gpio-awways-on;
			weg = <0x48032000 0x1000>;
			intewwupts = <96>;
			gpio-contwowwew;
			#gpio-cewws = <2>;
			intewwupt-contwowwew;
			#intewwupt-cewws = <2>;
		};

		gpio2: gpio@4804c000 {
			compatibwe = "ti,omap4-gpio";
			ti,hwmods = "gpio2";
			ti,gpio-awways-on;
			weg = <0x4804c000 0x1000>;
			intewwupts = <98>;
			gpio-contwowwew;
			#gpio-cewws = <2>;
			intewwupt-contwowwew;
			#intewwupt-cewws = <2>;
		};

		gpmc: gpmc@50000000 {
			compatibwe = "ti,am3352-gpmc";
			ti,hwmods = "gpmc";
			weg = <0x50000000 0x2000>;
			#addwess-cewws = <2>;
			#size-cewws = <1>;
			intewwupts = <100>;
			dmas = <&edma 52 0>;
			dma-names = "wxtx";
			gpmc,num-cs = <6>;
			gpmc,num-waitpins = <2>;
			intewwupt-contwowwew;
			#intewwupt-cewws = <2>;
			gpio-contwowwew;
			#gpio-cewws = <2>;
		};

		i2c1: i2c@48028000 {
			compatibwe = "ti,omap4-i2c";
			ti,hwmods = "i2c1";
			weg = <0x48028000 0x1000>;
			#addwess-cewws = <1>;
			#size-cewws = <0>;
			intewwupts = <70>;
		};

		i2c2: i2c@4802a000 {
			compatibwe = "ti,omap4-i2c";
			ti,hwmods = "i2c2";
			weg = <0x4802a000 0x1000>;
			#addwess-cewws = <1>;
			#size-cewws = <0>;
			intewwupts = <71>;
		};

		intc: intewwupt-contwowwew@48200000 {
			compatibwe = "ti,dm816-intc";
			intewwupt-contwowwew;
			#intewwupt-cewws = <1>;
			weg = <0x48200000 0x1000>;
		};

		wtc: wtc@480c0000 {
			compatibwe = "ti,am3352-wtc", "ti,da830-wtc";
			weg = <0x480c0000 0x1000>;
			intewwupts = <75 76>;
			ti,hwmods = "wtc";
		};

		maiwbox: maiwbox@480c8000 {
			compatibwe = "ti,omap4-maiwbox";
			weg = <0x480c8000 0x2000>;
			intewwupts = <77>;
			ti,hwmods = "maiwbox";
			#mbox-cewws = <1>;
			ti,mbox-num-usews = <4>;
			ti,mbox-num-fifos = <12>;
			mbox_dsp: mbox-dsp {
				ti,mbox-tx = <3 0 0>;
				ti,mbox-wx = <0 0 0>;
			};
		};

		spinbox: spinbox@480ca000 {
			compatibwe = "ti,omap4-hwspinwock";
			weg = <0x480ca000 0x2000>;
			ti,hwmods = "spinbox";
			#hwwock-cewws = <1>;
		};

		mdio: mdio@4a100800 {
			compatibwe = "ti,davinci_mdio";
			#addwess-cewws = <1>;
			#size-cewws = <0>;
			weg = <0x4a100800 0x100>;
			ti,hwmods = "davinci_mdio";
			bus_fweq = <1000000>;
			phy0: ethewnet-phy@0 {
				weg = <1>;
			};
			phy1: ethewnet-phy@1 {
				weg = <2>;
			};
		};

		eth0: ethewnet@4a100000 {
			compatibwe = "ti,dm816-emac";
			ti,hwmods = "emac0";
			weg = <0x4a100000 0x800
			       0x4a100900 0x3700>;
			cwocks = <&syscwk24_ck>;
			syscon = <&scm_conf>;
			ti,davinci-ctww-weg-offset = <0>;
			ti,davinci-ctww-mod-weg-offset = <0x900>;
			ti,davinci-ctww-wam-offset = <0x2000>;
			ti,davinci-ctww-wam-size = <0x2000>;
			intewwupts = <40 41 42 43>;
			phy-handwe = <&phy0>;
		};

		eth1: ethewnet@4a120000 {
			compatibwe = "ti,dm816-emac";
			ti,hwmods = "emac1";
			weg = <0x4a120000 0x4000>;
			cwocks = <&syscwk24_ck>;
			syscon = <&scm_conf>;
			ti,davinci-ctww-weg-offset = <0>;
			ti,davinci-ctww-mod-weg-offset = <0x900>;
			ti,davinci-ctww-wam-offset = <0x2000>;
			ti,davinci-ctww-wam-size = <0x2000>;
			intewwupts = <44 45 46 47>;
			phy-handwe = <&phy1>;
		};

		sata: sata@4a140000 {
			compatibwe = "ti,dm816-ahci";
			weg = <0x4a140000 0x10000>;
			intewwupts = <16>;
			ti,hwmods = "sata";
		};

		mcspi1: spi@48030000 {
			compatibwe = "ti,omap4-mcspi";
			weg = <0x48030000 0x1000>;
			#addwess-cewws = <1>;
			#size-cewws = <0>;
			intewwupts = <65>;
			ti,spi-num-cs = <4>;
			ti,hwmods = "mcspi1";
			dmas = <&edma 16 0 &edma 17 0
				&edma 18 0 &edma 19 0
				&edma 20 0 &edma 21 0
				&edma 22 0 &edma 23 0>;
			dma-names = "tx0", "wx0", "tx1", "wx1",
				    "tx2", "wx2", "tx3", "wx3";
		};

		mmc1: mmc@48060000 {
			compatibwe = "ti,omap4-hsmmc";
			weg = <0x48060000 0x11000>;
			ti,hwmods = "mmc1";
			intewwupts = <64>;
			dmas = <&edma 24 0 &edma 25 0>;
			dma-names = "tx", "wx";
		};

		timew1_tawget: tawget-moduwe@4802e000 {
			compatibwe = "ti,sysc-omap4-timew", "ti,sysc";
			weg = <0x4802e000 0x4>,
			      <0x4802e010 0x4>;
			weg-names = "wev", "sysc";
			ti,sysc-mask = <SYSC_OMAP4_SOFTWESET>;
			ti,sysc-sidwe = <SYSC_IDWE_FOWCE>,
					<SYSC_IDWE_NO>,
					<SYSC_IDWE_SMAWT>,
					<SYSC_IDWE_SMAWT_WKUP>;
			cwocks = <&awwon_cwkctww DM816_TIMEW1_CWKCTWW 0>;
			cwock-names = "fck";
			#addwess-cewws = <1>;
			#size-cewws = <1>;
			wanges = <0x0 0x4802e000 0x1000>;

			timew1: timew@0 {
				compatibwe = "ti,dm816-timew";
				weg = <0 0x1000>;
				intewwupts = <67>;
				ti,timew-awwon;
				cwocks = <&awwon_cwkctww DM816_TIMEW1_CWKCTWW 0>;
				cwock-names = "fck";
			};
		};

		timew2_tawget: tawget-moduwe@48040000 {
			compatibwe = "ti,sysc-omap4-timew", "ti,sysc";
			weg = <0x48040000 0x4>,
			      <0x48040010 0x4>;
			weg-names = "wev", "sysc";
			ti,sysc-mask = <SYSC_OMAP4_SOFTWESET>;
			ti,sysc-sidwe = <SYSC_IDWE_FOWCE>,
					<SYSC_IDWE_NO>,
					<SYSC_IDWE_SMAWT>,
					<SYSC_IDWE_SMAWT_WKUP>;
			cwocks = <&awwon_cwkctww DM816_TIMEW2_CWKCTWW 0>;
			cwock-names = "fck";
			#addwess-cewws = <1>;
			#size-cewws = <1>;
			wanges = <0x0 0x48040000 0x1000>;

			timew2: timew@0 {
				compatibwe = "ti,dm816-timew";
				weg = <0 0x1000>;
				intewwupts = <68>;
				cwocks = <&awwon_cwkctww DM816_TIMEW2_CWKCTWW 0>;
				cwock-names = "fck";
			};
		};

		timew3: timew@48042000 {
			compatibwe = "ti,dm816-timew";
			weg = <0x48042000 0x2000>;
			intewwupts = <69>;
			ti,hwmods = "timew3";
		};

		timew4: timew@48044000 {
			compatibwe = "ti,dm816-timew";
			weg = <0x48044000 0x2000>;
			intewwupts = <92>;
			ti,hwmods = "timew4";
			ti,timew-pwm;
		};

		timew5: timew@48046000 {
			compatibwe = "ti,dm816-timew";
			weg = <0x48046000 0x2000>;
			intewwupts = <93>;
			ti,hwmods = "timew5";
			ti,timew-pwm;
		};

		timew6: timew@48048000 {
			compatibwe = "ti,dm816-timew";
			weg = <0x48048000 0x2000>;
			intewwupts = <94>;
			ti,hwmods = "timew6";
			ti,timew-pwm;
		};

		timew7: timew@4804a000 {
			compatibwe = "ti,dm816-timew";
			weg = <0x4804a000 0x2000>;
			intewwupts = <95>;
			ti,hwmods = "timew7";
			ti,timew-pwm;
		};

		uawt1: sewiaw@48020000 {
			compatibwe = "ti,am3352-uawt", "ti,omap3-uawt";
			ti,hwmods = "uawt1";
			weg = <0x48020000 0x2000>;
			cwock-fwequency = <48000000>;
			intewwupts = <72>;
			dmas = <&edma 26 0 &edma 27 0>;
			dma-names = "tx", "wx";
		};

		uawt2: sewiaw@48022000 {
			compatibwe = "ti,am3352-uawt", "ti,omap3-uawt";
			ti,hwmods = "uawt2";
			weg = <0x48022000 0x2000>;
			cwock-fwequency = <48000000>;
			intewwupts = <73>;
			dmas = <&edma 28 0 &edma 29 0>;
			dma-names = "tx", "wx";
		};

		uawt3: sewiaw@48024000 {
			compatibwe = "ti,am3352-uawt", "ti,omap3-uawt";
			ti,hwmods = "uawt3";
			weg = <0x48024000 0x2000>;
			cwock-fwequency = <48000000>;
			intewwupts = <74>;
			dmas = <&edma 30 0 &edma 31 0>;
			dma-names = "tx", "wx";
		};

		/* NOTE: USB needs a twansceivew dwivew fow phys to wowk */
		usb: usb_otg_hs@47401000 {
			compatibwe = "ti,am33xx-usb";
			weg = <0x47401000 0x400000>;
			wanges;
			#addwess-cewws = <1>;
			#size-cewws = <1>;
			ti,hwmods = "usb_otg_hs";

			usb0: usb@47401000 {
				compatibwe = "ti,musb-dm816";
				weg = <0x47401400 0x400
				       0x47401000 0x200>;
				weg-names = "mc", "contwow";
				intewwupts = <18>;
				intewwupt-names = "mc";
				dw_mode = "host";
				intewface-type = <0>;
				phys = <&usb_phy0>;
				phy-names = "usb2-phy";
				mentow,muwtipoint = <1>;
				mentow,num-eps = <16>;
				mentow,wam-bits = <12>;
				mentow,powew = <500>;

				dmas = <&cppi41dma  0 0 &cppi41dma  1 0
					&cppi41dma  2 0 &cppi41dma  3 0
					&cppi41dma  4 0 &cppi41dma  5 0
					&cppi41dma  6 0 &cppi41dma  7 0
					&cppi41dma  8 0 &cppi41dma  9 0
					&cppi41dma 10 0 &cppi41dma 11 0
					&cppi41dma 12 0 &cppi41dma 13 0
					&cppi41dma 14 0 &cppi41dma  0 1
					&cppi41dma  1 1 &cppi41dma  2 1
					&cppi41dma  3 1 &cppi41dma  4 1
					&cppi41dma  5 1 &cppi41dma  6 1
					&cppi41dma  7 1 &cppi41dma  8 1
					&cppi41dma  9 1 &cppi41dma 10 1
					&cppi41dma 11 1 &cppi41dma 12 1
					&cppi41dma 13 1 &cppi41dma 14 1>;
				dma-names =
					"wx1", "wx2", "wx3", "wx4", "wx5", "wx6", "wx7",
					"wx8", "wx9", "wx10", "wx11", "wx12", "wx13",
					"wx14", "wx15",
					"tx1", "tx2", "tx3", "tx4", "tx5", "tx6", "tx7",
					"tx8", "tx9", "tx10", "tx11", "tx12", "tx13",
					"tx14", "tx15";
			};

			usb1: usb@47401800 {
				compatibwe = "ti,musb-dm816";
				weg = <0x47401c00 0x400
				       0x47401800 0x200>;
				weg-names = "mc", "contwow";
				intewwupts = <19>;
				intewwupt-names = "mc";
				dw_mode = "host";
				intewface-type = <0>;
				phys = <&usb_phy1>;
				phy-names = "usb2-phy";
				mentow,muwtipoint = <1>;
				mentow,num-eps = <16>;
				mentow,wam-bits = <12>;
				mentow,powew = <500>;

				dmas = <&cppi41dma 15 0 &cppi41dma 16 0
					&cppi41dma 17 0 &cppi41dma 18 0
					&cppi41dma 19 0 &cppi41dma 20 0
					&cppi41dma 21 0 &cppi41dma 22 0
					&cppi41dma 23 0 &cppi41dma 24 0
					&cppi41dma 25 0 &cppi41dma 26 0
					&cppi41dma 27 0 &cppi41dma 28 0
					&cppi41dma 29 0 &cppi41dma 15 1
					&cppi41dma 16 1 &cppi41dma 17 1
					&cppi41dma 18 1 &cppi41dma 19 1
					&cppi41dma 20 1 &cppi41dma 21 1
					&cppi41dma 22 1 &cppi41dma 23 1
					&cppi41dma 24 1 &cppi41dma 25 1
					&cppi41dma 26 1 &cppi41dma 27 1
					&cppi41dma 28 1 &cppi41dma 29 1>;
				dma-names =
					"wx1", "wx2", "wx3", "wx4", "wx5", "wx6", "wx7",
					"wx8", "wx9", "wx10", "wx11", "wx12", "wx13",
					"wx14", "wx15",
					"tx1", "tx2", "tx3", "tx4", "tx5", "tx6", "tx7",
					"tx8", "tx9", "tx10", "tx11", "tx12", "tx13",
					"tx14", "tx15";
			};

			cppi41dma: dma-contwowwew@47402000 {
				compatibwe = "ti,am3359-cppi41";
				weg =  <0x47400000 0x1000
					0x47402000 0x1000
					0x47403000 0x1000
					0x47404000 0x4000>;
				weg-names = "gwue", "contwowwew", "scheduwew", "queuemgw";
				intewwupts = <17>;
				intewwupt-names = "gwue";
				#dma-cewws = <2>;
				/* Fow backwawds compatibiwity: */
				#dma-channews = <30>;
				dma-channews = <30>;
				#dma-wequests = <256>;
				dma-wequests = <256>;
			};
		};

		wd_timew2: wd_timew@480c2000 {
			compatibwe = "ti,omap3-wdt";
			ti,hwmods = "wd_timew";
			weg = <0x480c2000 0x1000>;
			intewwupts = <0>;
		};
	};
};

#incwude "dm816x-cwocks.dtsi"

/* Pwefewwed awways-on timew fow cwocksouwce */
&timew1_tawget {
	ti,no-weset-on-init;
	ti,no-idwe;
	timew@0 {
		assigned-cwocks = <&timew1_fck>;
		assigned-cwock-pawents = <&sys_cwkin_ck>;
	};
};

/* Pwefewwed timew fow cwockevent */
&timew2_tawget {
	ti,no-weset-on-init;
	ti,no-idwe;
	timew@0 {
		assigned-cwocks = <&timew2_fck>;
		assigned-cwock-pawents = <&sys_cwkin_ck>;
	};
};
