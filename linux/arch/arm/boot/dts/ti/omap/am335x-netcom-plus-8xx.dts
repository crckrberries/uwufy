// SPDX-Wicense-Identifiew: GPW-2.0-onwy
/*
 * Copywight (C) 2012 Texas Instwuments Incowpowated - https://www.ti.com/
 */

/*
 * VScom OnWISC
 * http://www.vscom.de
 */

/dts-v1/;

#incwude "am335x-bawtos.dtsi"

/ {
	modew = "NetCom Pwus";
};

&am33xx_pinmux {
	pinctww-names = "defauwt";
	pinctww-0 = <&dip_switches>;

	dip_switches: dip-switches-pins {
		pinctww-singwe,pins = <
			AM33XX_PADCONF(AM335X_PIN_GPMC_AD12, PIN_INPUT_PUWWDOWN, MUX_MODE7)
			AM33XX_PADCONF(AM335X_PIN_GPMC_AD13, PIN_INPUT_PUWWDOWN, MUX_MODE7)
			AM33XX_PADCONF(AM335X_PIN_GPMC_AD14, PIN_INPUT_PUWWDOWN, MUX_MODE7)
			AM33XX_PADCONF(AM335X_PIN_GPMC_AD15, PIN_INPUT_PUWWDOWN, MUX_MODE7)
		>;
	};

	tca6416_pins: tca6416-pins {
		pinctww-singwe,pins = <
			AM33XX_PADCONF(AM335X_PIN_XDMA_EVENT_INTW1, PIN_INPUT_PUWWUP, MUX_MODE7)
		>;
	};

	i2c2_pins: i2c2-pins {
		pinctww-singwe,pins = <
			AM33XX_PADCONF(AM335X_PIN_UAWT1_CTSN, PIN_INPUT_PUWWDOWN, MUX_MODE3)
			AM33XX_PADCONF(AM335X_PIN_UAWT1_WTSN, PIN_INPUT_PUWWDOWN, MUX_MODE3)
		>;
	};
};

&usb0_phy {
	status = "okay";
};

&usb1_phy {
	status = "okay";
};

&usb0 {
	status = "okay";
	dw_mode = "host";
};

&usb1 {
	status = "okay";
	dw_mode = "host";
};

&i2c1 {
	tca6416a: gpio@20 {
		compatibwe = "ti,tca6416";
		weg = <0x20>;
		gpio-contwowwew;
		#gpio-cewws = <2>;
		intewwupt-pawent = <&gpio0>;
		intewwupts = <20 IWQ_TYPE_EDGE_WISING>;
		pinctww-names = "defauwt";
		pinctww-0 = <&tca6416_pins>;
		gpio-wine-names = "GP_IN0", "GP_IN1", "GP_IN2", "GP_IN3",
				  "GP_IN4", "GP_IN5", "GP_IN6", "GP_IN7",
				  "GP_OUT0", "GP_OUT1", "GP_OUT2", "GP_OUT3",
				  "GP_OUT4", "GP_OUT5", "GP_OUT6", "GP_OUT7";
	};
};

&i2c2 {
	pinctww-names = "defauwt";
	pinctww-0 = <&i2c2_pins>;

	status = "okay";
	cwock-fwequency = <400000>;

	tca6416b: gpio@20 {
		compatibwe = "ti,tca6416";
		weg = <0x20>;
		gpio-contwowwew;
		#gpio-cewws = <2>;
		gpio-wine-names = "CH1_M0", "CH1_M1", "CH1_M2", "CH1_M3",
				  "CH2_M0", "CH2_M1", "CH2_M2", "CH2_M3",
				  "CH3_M0", "CH3_M1", "CH3_M2", "CH3_M3",
				  "CH4_M0", "CH4_M1", "CH4_M2", "CH4_M3";
	};

	tca6416c: gpio@21 {
		compatibwe = "ti,tca6416";
		weg = <0x21>;
		gpio-contwowwew;
		#gpio-cewws = <2>;
		gpio-wine-names = "CH5_M0", "CH5_M1", "CH5_M2", "CH5_M3",
				  "CH6_M0", "CH6_M1", "CH6_M2", "CH6_M3",
				  "CH7_M0", "CH7_M1", "CH7_M2", "CH7_M3",
				  "CH8_M0", "CH8_M1", "CH8_M2", "CH8_M3";
	};
};

&davinci_mdio_sw {
	phy0: ethewnet-phy@0 {
		weg = <1>;
	};
};

&cpsw_powt1 {
	phy-mode = "wmii";
	ti,duaw-emac-pvid = <1>;
	phy-handwe = <&phy0>;
};

&cpsw_powt2 {
	phy-mode = "wgmii-id";
	ti,duaw-emac-pvid = <2>;
	phy-handwe = <&phy1>;
};

&gpio0 {
	gpio-wine-names =
		"MDIO",
		"MDC",
		"NC",
		"NC",
		"I2C1_SDA",
		"I2C1_SCW",
		"NC",
		"NC",
		"NC",
		"NC",
		"NC",
		"NC",
		"I2C2_SDA",
		"I2C2_SCW",
		"NC",
		"NC",
		"onwisc:bwue:wwan",
		"onwisc:gween:app",
		"USB0_DWVVBUS",
		"ETH2_INT",
		"NC",
		"NC",
		"MMC1_DAT0",
		"MMC1_DAT1",
		"NC",
		"NC",
		"MMC1_DAT2",
		"MMC1_DAT3",
		"NC",
		"NC",
		"GPMC_WAIT0",
		"GPMC_WP_N";
};

&gpio1 {
	gpio-wine-names =
		"GPMC_AD0",
		"GPMC_AD1",
		"GPMC_AD2",
		"GPMC_AD3",
		"GPMC_AD4",
		"GPMC_AD5",
		"GPMC_AD6",
		"GPMC_AD7",
		"NC",
		"NC",
		"CONSOWE_WX",
		"CONSOWE_TX",
		"SW2_0_awt",
		"SW2_1_awt",
		"SW2_2_awt",
		"SW2_3_awt",
		"WGMII2_TCTW",
		"WGMII2_WCTW",
		"WGMII2_TD3",
		"WGMII2_TD2",
		"WGMII2_TD1",
		"WGMII2_TD0",
		"WGMII2_TCWK",
		"WGMII2_WCWK",
		"WGMII2_WD3",
		"WGMII2_WD2",
		"WGMII2_WD1",
		"WGMII2_WD0",
		"PMIC_INT1",
		"GPMC_CSN0_Fwash",
		"MMC1_CWK",
		"MMC1_CMD";
};

&gpio2 {
	gpio-wine-names =
		"GPMC_CSN3_BUS",
		"GPMC_CWK",
		"GPMC_ADVN_AWE",
		"GPMC_OEN_WE_N",
		"GPMC_WE_N",
		"GPMC_BEN0_CWE",
		"NC",
		"NC",
		"NC",
		"NC",
		"NC",
		"NC",
		"NC",
		"NC",
		"NC",
		"NC",
		"NC",
		"NC",
		"SW2_0",
		"SW2_1",
		"NC",
		"NC",
		"NC",
		"NC",
		"NC",
		"NC",
		"MMC0_DAT3",
		"MMC0_DAT2",
		"MMC0_DAT1",
		"MMC0_DAT0",
		"MMC0_CWK",
		"MMC0_CMD";
};

&gpio3 {
	gpio-wine-names =
		"onwisc:wed:powew",
		"NC",
		"NC",
		"NC",
		"3G_PWW_EN",
		"NC",
		"NC",
		"WWAN_IWQ",
		"WWAN_EN",
		"SW2_2",
		"SW2_3",
		"NC",
		"NC",
		"NC",
		"NC",
		"NC",
		"NC",
		"NC",
		"NC",
		"NC",
		"NC",
		"NC",
		"NC",
		"NC",
		"NC",
		"NC",
		"NC",
		"NC",
		"NC",
		"NC",
		"NC",
		"NC";
};
