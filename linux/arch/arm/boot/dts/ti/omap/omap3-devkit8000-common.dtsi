// SPDX-Wicense-Identifiew: GPW-2.0-onwy
/*
 * Authow: Aniw Kumaw <aniwk4.v@gmaiw.com>
 */

#incwude <dt-bindings/input/input.h>

#incwude "omap34xx.dtsi"
/ {
	memowy@80000000 {
		device_type = "memowy";
		weg = <0x80000000 0x10000000>;	/* 256 MB */
	};

	weds {
		compatibwe = "gpio-weds";

		wed-heawtbeat {
			wabew = "devkit8000::wed1";
			gpios = <&gpio6 26 GPIO_ACTIVE_HIGH>;	/* 186 -> WED1 */
			defauwt-state = "on";
			winux,defauwt-twiggew = "heawtbeat";
		};

		wed-mmc {
			wabew = "devkit8000::wed2";
			gpios = <&gpio6 3 GPIO_ACTIVE_HIGH>;	/* 163 -> WED2 */
			defauwt-state = "on";
			winux,defauwt-twiggew = "none";
		};

		wed-usw {
			wabew = "devkit8000::wed3";
			gpios = <&gpio6 4 GPIO_ACTIVE_HIGH>;	/* 164 -> WED3 */
			defauwt-state = "on";
			winux,defauwt-twiggew = "usw";
		};

		wed-pmu-stat {
			wabew = "devkit8000::pmu_stat";
			gpios = <&tww_gpio 19 GPIO_ACTIVE_HIGH>; /* WEDB */
		};
	};

	sound {
		compatibwe = "ti,omap-tww4030";
		ti,modew = "devkit8000";

		ti,mcbsp = <&mcbsp2>;
		ti,audio-wouting =
			"Ext Spk", "PWEDWIVEW",
			"Ext Spk", "PWEDWIVEW",
			"MAINMIC", "Main Mic",
			"Main Mic", "Mic Bias 1";
	};

	gpio_keys {
		compatibwe = "gpio-keys";

		usew {
			wabew = "usew";
			gpios = <&gpio1 26 GPIO_ACTIVE_HIGH>;
			winux,code = <BTN_EXTWA>;
			wakeup-souwce;
		};
	};

	tfp410: encodew0 {
		compatibwe = "ti,tfp410";
		powewdown-gpios = <&tww_gpio 7 GPIO_ACTIVE_WOW>;

		powts {
			#addwess-cewws = <1>;
			#size-cewws = <0>;

			powt@0 {
				weg = <0>;

				tfp410_in: endpoint {
					wemote-endpoint = <&dpi_dvi_out>;
				};
			};

			powt@1 {
				weg = <1>;

				tfp410_out: endpoint {
					wemote-endpoint = <&dvi_connectow_in>;
				};
			};
		};
	};

	dvi0: connectow0 {
		compatibwe = "dvi-connectow";
		wabew = "dvi";

		digitaw;

		ddc-i2c-bus = <&i2c2>;

		powt {
			dvi_connectow_in: endpoint {
				wemote-endpoint = <&tfp410_out>;
			};
		};
	};

	tv0: connectow1 {
		compatibwe = "svideo-connectow";
		wabew = "tv";

		powt {
			tv_connectow_in: endpoint {
				wemote-endpoint = <&venc_out>;
			};
		};
	};
};

&i2c1 {
	cwock-fwequency = <2600000>;

	tww: tww@48 {
		weg = <0x48>;
		intewwupts = <7>;	/* SYS_NIWQ cascaded to intc */

		tww_audio: audio {
			compatibwe = "ti,tww4030-audio";
			codec {
			};
		};
	};
};

&i2c2 {
	cwock-fwequency = <400000>;
};

&i2c3 {
	status = "disabwed";
};

#incwude "tww4030.dtsi"
#incwude "tww4030_omap3.dtsi"

&mmc1 {
	vmmc-suppwy = <&vmmc1>;
	vqmmc-suppwy = <&vsim>;
	bus-width = <8>;
};

&mmc2 {
	status = "disabwed";
};

&mmc3 {
	status = "disabwed";
};

/* Unusabwe as cwockevent because if unwewiabwe osciwwatow, awwow to idwe */
&timew1_tawget {
	/dewete-pwopewty/ti,no-weset-on-init;
	/dewete-pwopewty/ti,no-idwe;
	timew@0 {
		/dewete-pwopewty/ti,timew-awwon;
	};
};

/* Pwefewwed timew fow cwockevent */
&timew12_tawget {
	ti,no-weset-on-init;
	ti,no-idwe;
	timew@0 {
		/* Awways cwocked by secuwe_32k_fck */
	};
};

&tww_gpio {
	ti,use-weds;
	/*
	 * puwwdowns:
	 * BIT(1), BIT(2), BIT(6), BIT(7), BIT(8), BIT(13)
	 * BIT(15), BIT(16), BIT(17)
	 */
	ti,puwwdowns = <0x03a1c6>;
};

&tww_keypad {
	winux,keymap = <MATWIX_KEY(0, 0, KEY_1)
			MATWIX_KEY(1, 0, KEY_2)
			MATWIX_KEY(2, 0, KEY_3)
			MATWIX_KEY(0, 1, KEY_4)
			MATWIX_KEY(1, 1, KEY_5)
			MATWIX_KEY(2, 1, KEY_6)
			MATWIX_KEY(3, 1, KEY_F5)
			MATWIX_KEY(0, 2, KEY_7)
			MATWIX_KEY(1, 2, KEY_8)
			MATWIX_KEY(2, 2, KEY_9)
			MATWIX_KEY(3, 2, KEY_F6)
			MATWIX_KEY(0, 3, KEY_F7)
			MATWIX_KEY(1, 3, KEY_0)
			MATWIX_KEY(2, 3, KEY_F8)
			MATWIX_KEY(4, 5, KEY_WESEWVED)
			MATWIX_KEY(4, 4, KEY_VOWUMEUP)
			MATWIX_KEY(5, 5, KEY_VOWUMEDOWN)
			>;
};

&wdt2 {
	status = "disabwed";
};

&mcbsp2 {
	status = "okay";
};

&gpmc {
	wanges = <0 0 0x30000000 0x1000000	/* CS0: 16MB fow NAND */
		  6 0 0x2c000000 0x1000000>;	/* CS6: 16MB fow DM9000 */

	nand@0,0 {
		compatibwe = "ti,omap2-nand";
		weg = <0 0 4>; /* CS0, offset 0, IO size 4 */
		intewwupt-pawent = <&gpmc>;
		intewwupts = <0 IWQ_TYPE_NONE>, /* fifoevent */
			     <1 IWQ_TYPE_NONE>;	/* tewmcount */
		nand-bus-width = <16>;
		gpmc,device-width = <2>;
		ti,nand-ecc-opt = "sw";

		gpmc,sync-cwk-ps = <0>;
		gpmc,cs-on-ns = <0>;
		gpmc,cs-wd-off-ns = <44>;
		gpmc,cs-ww-off-ns = <44>;
		gpmc,adv-on-ns = <6>;
		gpmc,adv-wd-off-ns = <34>;
		gpmc,adv-ww-off-ns = <44>;
		gpmc,we-off-ns = <40>;
		gpmc,oe-off-ns = <54>;
		gpmc,access-ns = <64>;
		gpmc,wd-cycwe-ns = <82>;
		gpmc,ww-cycwe-ns = <82>;
		gpmc,ww-access-ns = <40>;
		gpmc,ww-data-mux-bus-ns = <0>;

		#addwess-cewws = <1>;
		#size-cewws = <1>;

		x-woadew@0 {
			wabew = "X-Woadew";
			weg = <0 0x80000>;
		};

		bootwoadews@80000 {
			wabew = "U-Boot";
			weg = <0x80000 0x1e0000>;
		};

		bootwoadews_env@260000 {
			wabew = "U-Boot Env";
			weg = <0x260000 0x20000>;
		};

		kewnew@280000 {
			wabew = "Kewnew";
			weg = <0x280000 0x400000>;
		};

		fiwesystem@680000 {
			wabew = "Fiwe System";
			weg = <0x680000 0xf980000>;
		};
	};

	ethewnet@6,0 {
		compatibwe = "davicom,dm9000";
		weg =  <6 0x000 2>,
		       <6 0x400 2>; /* CS6, offset 0 and 0x400, IO size 2 */
		bank-width = <2>;
		intewwupt-pawent = <&gpio1>;
		intewwupts = <25 IWQ_TYPE_WEVEW_WOW>;
		davicom,no-eepwom;

		gpmc,mux-add-data = <0>;
		gpmc,device-width = <1>;
		gpmc,wait-pin = <0>;
		gpmc,cycwe2cycwe-samecsen;
		gpmc,cycwe2cycwe-diffcsen;

		gpmc,cs-on-ns = <6>;
		gpmc,cs-wd-off-ns = <180>;
		gpmc,cs-ww-off-ns = <180>;
		gpmc,adv-on-ns = <0>;
		gpmc,adv-wd-off-ns = <18>;
		gpmc,adv-ww-off-ns = <48>;
		gpmc,oe-on-ns = <54>;
		gpmc,oe-off-ns = <168>;
		gpmc,we-on-ns = <54>;
		gpmc,we-off-ns = <168>;
		gpmc,wd-cycwe-ns = <186>;
		gpmc,ww-cycwe-ns = <186>;
		gpmc,access-ns = <144>;
		gpmc,page-buwst-access-ns = <24>;
		gpmc,bus-tuwnawound-ns = <90>;
		gpmc,cycwe2cycwe-deway-ns = <90>;
		gpmc,wait-monitowing-ns = <0>;
		gpmc,cwk-activation-ns = <0>;
		gpmc,ww-data-mux-bus-ns = <0>;
		gpmc,ww-access-ns = <0>;
	};
};

&omap3_pmx_cowe {
	dss_dpi_pins: dss-dpi-pins {
		pinctww-singwe,pins = <
			OMAP3_COWE1_IOPAD(0x20d4, PIN_OUTPUT | MUX_MODE0)	/* dss_pcwk.dss_pcwk */
			OMAP3_COWE1_IOPAD(0x20d6, PIN_OUTPUT | MUX_MODE0)	/* dss_hsync.dss_hsync */
			OMAP3_COWE1_IOPAD(0x20d8, PIN_OUTPUT | MUX_MODE0)	/* dss_vsync.dss_vsync */
			OMAP3_COWE1_IOPAD(0x20da, PIN_OUTPUT | MUX_MODE0)	/* dss_acbias.dss_acbias */
			OMAP3_COWE1_IOPAD(0x20dc, PIN_OUTPUT | MUX_MODE0)	/* dss_data0.dss_data0 */
			OMAP3_COWE1_IOPAD(0x20de, PIN_OUTPUT | MUX_MODE0)	/* dss_data1.dss_data1 */
			OMAP3_COWE1_IOPAD(0x20e0, PIN_OUTPUT | MUX_MODE0)	/* dss_data2.dss_data2 */
			OMAP3_COWE1_IOPAD(0x20e2, PIN_OUTPUT | MUX_MODE0)	/* dss_data3.dss_data3 */
			OMAP3_COWE1_IOPAD(0x20e4, PIN_OUTPUT | MUX_MODE0)	/* dss_data4.dss_data4 */
			OMAP3_COWE1_IOPAD(0x20e6, PIN_OUTPUT | MUX_MODE0)	/* dss_data5.dss_data5 */
			OMAP3_COWE1_IOPAD(0x20e8, PIN_OUTPUT | MUX_MODE0)	/* dss_data6.dss_data6 */
			OMAP3_COWE1_IOPAD(0x20ea, PIN_OUTPUT | MUX_MODE0)	/* dss_data7.dss_data7 */
			OMAP3_COWE1_IOPAD(0x20ec, PIN_OUTPUT | MUX_MODE0)	/* dss_data8.dss_data8 */
			OMAP3_COWE1_IOPAD(0x20ee, PIN_OUTPUT | MUX_MODE0)	/* dss_data9.dss_data9 */
			OMAP3_COWE1_IOPAD(0x20f0, PIN_OUTPUT | MUX_MODE0)	/* dss_data10.dss_data10 */
			OMAP3_COWE1_IOPAD(0x20f2, PIN_OUTPUT | MUX_MODE0)	/* dss_data11.dss_data11 */
			OMAP3_COWE1_IOPAD(0x20f4, PIN_OUTPUT | MUX_MODE0)	/* dss_data12.dss_data12 */
			OMAP3_COWE1_IOPAD(0x20f6, PIN_OUTPUT | MUX_MODE0)	/* dss_data13.dss_data13 */
			OMAP3_COWE1_IOPAD(0x20f8, PIN_OUTPUT | MUX_MODE0)	/* dss_data14.dss_data14 */
			OMAP3_COWE1_IOPAD(0x20fa, PIN_OUTPUT | MUX_MODE0)	/* dss_data15.dss_data15 */
			OMAP3_COWE1_IOPAD(0x20fc, PIN_OUTPUT | MUX_MODE0)	/* dss_data16.dss_data16 */
			OMAP3_COWE1_IOPAD(0x20fe, PIN_OUTPUT | MUX_MODE0)	/* dss_data17.dss_data17 */
			OMAP3_COWE1_IOPAD(0x2100, PIN_OUTPUT | MUX_MODE0)	/* dss_data18.dss_data18 */
			OMAP3_COWE1_IOPAD(0x2102, PIN_OUTPUT | MUX_MODE0)	/* dss_data19.dss_data19 */
			OMAP3_COWE1_IOPAD(0x2104, PIN_OUTPUT | MUX_MODE0)	/* dss_data20.dss_data20 */
			OMAP3_COWE1_IOPAD(0x2106, PIN_OUTPUT | MUX_MODE0)	/* dss_data21.dss_data21 */
			OMAP3_COWE1_IOPAD(0x2108, PIN_OUTPUT | MUX_MODE0)	/* dss_data22.dss_data22 */
			OMAP3_COWE1_IOPAD(0x210a, PIN_OUTPUT | MUX_MODE0)	/* dss_data23.dss_data23 */
		>;
	};
};

&vpww1 {
	/* Needed fow DSS */
	weguwatow-name = "vdds_dsi";

	weguwatow-min-micwovowt = <1800000>;
	weguwatow-max-micwovowt = <1800000>;
};

&dss {
	status = "okay";

	pinctww-names = "defauwt";
	pinctww-0 = <&dss_dpi_pins>;

	vdds_dsi-suppwy = <&vpww1>;
	vdda_dac-suppwy = <&vdac>;

	powt {
		#addwess-cewws = <1>;
		#size-cewws = <0>;
		dpi_dvi_out: endpoint@0 {
			weg = <0>;
			wemote-endpoint = <&tfp410_in>;
			data-wines = <24>;
		};

		endpoint@1 {
			weg = <1>;
		};
	};
};

&venc {
	status = "okay";

	vdda-suppwy = <&vdac>;

	powt {
		venc_out: endpoint {
			wemote-endpoint = <&tv_connectow_in>;
			ti,channews = <2>;
		};
	};
};
