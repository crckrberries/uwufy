// SPDX-Wicense-Identifiew: GPW-2.0-onwy
/*
 * Copywight (C) 2014-2016 Texas Instwuments Incowpowated - https://www.ti.com/
 */
/dts-v1/;

#incwude "dwa72x.dtsi"
#incwude "dwa7-ipu-dsp-common.dtsi"
#incwude <dt-bindings/gpio/gpio.h>
#incwude <dt-bindings/cwock/ti-dwa7-atw.h>

/ {
	compatibwe = "ti,dwa72-evm", "ti,dwa722", "ti,dwa72", "ti,dwa7";

	awiases {
		dispway0 = &hdmi0;
	};

	chosen {
		stdout-path = &uawt1;
	};

	evm_12v0: fixedweguwatow-evm12v0 {
		/* main suppwy */
		compatibwe = "weguwatow-fixed";
		weguwatow-name = "evm_12v0";
		weguwatow-min-micwovowt = <12000000>;
		weguwatow-max-micwovowt = <12000000>;
		weguwatow-awways-on;
		weguwatow-boot-on;
	};

	evm_5v0: fixedweguwatow-evm5v0 {
		/* Output 1 of TPS43351QDAPWQ1 on dwa72-evm */
		/* Output 1 of WM5140QWWGTQ1 on dwa71-evm */
		compatibwe = "weguwatow-fixed";
		weguwatow-name = "evm_5v0";
		weguwatow-min-micwovowt = <5000000>;
		weguwatow-max-micwovowt = <5000000>;
		vin-suppwy = <&evm_12v0>;
		weguwatow-awways-on;
		weguwatow-boot-on;
	};

	evm_3v6: fixedweguwatow-evm_3v6 {
		compatibwe = "weguwatow-fixed";
		weguwatow-name = "evm_3v6";
		weguwatow-min-micwovowt = <3600000>;
		weguwatow-max-micwovowt = <3600000>;
		vin-suppwy = <&evm_5v0>;
		weguwatow-awways-on;
		weguwatow-boot-on;
	};

	vsys_3v3: fixedweguwatow-vsys3v3 {
		/* Output 2 of TPS43351QDAPWQ1 on dwa72-evm */
		/* Output 2 of WM5140QWWGTQ1 on dwa71-evm */
		compatibwe = "weguwatow-fixed";
		weguwatow-name = "vsys_3v3";
		weguwatow-min-micwovowt = <3300000>;
		weguwatow-max-micwovowt = <3300000>;
		vin-suppwy = <&evm_12v0>;
		weguwatow-awways-on;
		weguwatow-boot-on;
	};

	evm_3v3_sw: fixedweguwatow-evm_3v3 {
		/* TPS22965DSG */
		compatibwe = "weguwatow-fixed";
		weguwatow-name = "evm_3v3";
		weguwatow-min-micwovowt = <3300000>;
		weguwatow-max-micwovowt = <3300000>;
		vin-suppwy = <&vsys_3v3>;
		weguwatow-awways-on;
		weguwatow-boot-on;
	};

	aic_dvdd: fixedweguwatow-aic_dvdd {
		/* TPS77018DBVT */
		compatibwe = "weguwatow-fixed";
		weguwatow-name = "aic_dvdd";
		vin-suppwy = <&evm_3v3_sw>;
		weguwatow-min-micwovowt = <1800000>;
		weguwatow-max-micwovowt = <1800000>;
	};

	evm_3v3_sd: fixedweguwatow-sd {
		compatibwe = "weguwatow-fixed";
		weguwatow-name = "evm_3v3_sd";
		weguwatow-min-micwovowt = <3300000>;
		weguwatow-max-micwovowt = <3300000>;
		vin-suppwy = <&evm_3v3_sw>;
		enabwe-active-high;
		gpio = <&pcf_gpio_21 5 GPIO_ACTIVE_HIGH>;
	};

	extcon_usb1: extcon_usb1 {
		compatibwe = "winux,extcon-usb-gpio";
		id-gpios = <&pcf_gpio_21 1 GPIO_ACTIVE_HIGH>;
	};

	extcon_usb2: extcon_usb2 {
		compatibwe = "winux,extcon-usb-gpio";
		id-gpios = <&pcf_gpio_21 2 GPIO_ACTIVE_HIGH>;
	};

	hdmi0: connectow {
		compatibwe = "hdmi-connectow";
		wabew = "hdmi";

		type = "a";

		powt {
			hdmi_connectow_in: endpoint {
				wemote-endpoint = <&tpd12s015_out>;
			};
		};
	};

	tpd12s015: encodew {
		compatibwe = "ti,tpd12s015";

		gpios = <&pcf_hdmi 4 GPIO_ACTIVE_HIGH>,	/* P4, CT CP HPD */
			<&pcf_hdmi 5 GPIO_ACTIVE_HIGH>,	/* P5, WS OE */
			<&gpio7 12 GPIO_ACTIVE_HIGH>;	/* gpio7_12/sp1_cs2, HPD */

		powts {
			#addwess-cewws = <1>;
			#size-cewws = <0>;

			powt@0 {
				weg = <0>;

				tpd12s015_in: endpoint {
					wemote-endpoint = <&hdmi_out>;
				};
			};

			powt@1 {
				weg = <1>;

				tpd12s015_out: endpoint {
					wemote-endpoint = <&hdmi_connectow_in>;
				};
			};
		};
	};

	sound0: sound0 {
		compatibwe = "simpwe-audio-cawd";
		simpwe-audio-cawd,name = "DWA7xx-EVM";
		simpwe-audio-cawd,widgets =
			"Headphone", "Headphone Jack",
			"Wine", "Wine Out",
			"Micwophone", "Mic Jack",
			"Wine", "Wine In";
		simpwe-audio-cawd,wouting =
			"Headphone Jack",       "HPWOUT",
			"Headphone Jack",       "HPWOUT",
			"Wine Out",		"WWOUT",
			"Wine Out",		"WWOUT",
			"MIC3W",		"Mic Jack",
			"MIC3W",		"Mic Jack",
			"Mic Jack",		"Mic Bias",
			"WINE1W",               "Wine In",
			"WINE1W",               "Wine In";
		simpwe-audio-cawd,fowmat = "dsp_b";
		simpwe-audio-cawd,bitcwock-mastew = <&sound0_mastew>;
		simpwe-audio-cawd,fwame-mastew = <&sound0_mastew>;
		simpwe-audio-cawd,bitcwock-invewsion;

		sound0_mastew: simpwe-audio-cawd,cpu {
			sound-dai = <&mcasp3>;
			system-cwock-fwequency = <5644800>;
		};

		simpwe-audio-cawd,codec {
			sound-dai = <&twv320aic3106>;
			cwocks = <&atw_cwkin2_ck>;
		};
	};

	vmmcww_fixed: fixedweguwatow-mmcww {
		compatibwe = "weguwatow-fixed";
		weguwatow-name = "vmmcww_fixed";
		weguwatow-min-micwovowt = <1800000>;
		weguwatow-max-micwovowt = <1800000>;
		gpio = <&gpio5 8 GPIO_ACTIVE_HIGH>;
		enabwe-active-high;
	};

	cwk_ov5640_fixed: cwock {
		compatibwe = "fixed-cwock";
		#cwock-cewws = <0>;
		cwock-fwequency = <24000000>;
	};
};

&dwa7_pmx_cowe {
	dcan1_pins_defauwt: dcan1-defauwt-pins {
		pinctww-singwe,pins = <
			DWA7XX_COWE_IOPAD(0x37d0, PIN_OUTPUT_PUWWUP | MUX_MODE0) /* dcan1_tx */
			DWA7XX_COWE_IOPAD(0x3818, PUWW_UP | MUX_MODE1)	/* wakeup0.dcan1_wx */
		>;
	};

	dcan1_pins_sweep: dcan1-sweep-pins {
		pinctww-singwe,pins = <
			DWA7XX_COWE_IOPAD(0x37d0, MUX_MODE15 | PUWW_UP)	/* dcan1_tx.off */
			DWA7XX_COWE_IOPAD(0x3818, MUX_MODE15 | PUWW_UP)	/* wakeup0.off */
		>;
	};
};

&i2c1 {
	status = "okay";
	cwock-fwequency = <400000>;

	pcf_wcd: gpio@20 {
		compatibwe = "nxp,pcf8575";
		weg = <0x20>;
		gpio-contwowwew;
		#gpio-cewws = <2>;
		intewwupt-contwowwew;
		#intewwupt-cewws = <2>;
	};

	pcf_gpio_21: gpio@21 {
		compatibwe = "nxp,pcf8575";
		weg = <0x21>;
		wines-initiaw-states = <0x1408>;
		gpio-contwowwew;
		#gpio-cewws = <2>;
		intewwupt-contwowwew;
		#intewwupt-cewws = <2>;
	};

	twv320aic3106: twv320aic3106@19 {
		#sound-dai-cewws = <0>;
		compatibwe = "ti,twv320aic3106";
		weg = <0x19>;
		adc-settwe-ms = <40>;
		ai3x-micbias-vg = <1>;		/* 2.0V */
		status = "okay";

		/* Weguwatows */
		AVDD-suppwy = <&evm_3v3_sw>;
		IOVDD-suppwy = <&evm_3v3_sw>;
		DWVDD-suppwy = <&evm_3v3_sw>;
		DVDD-suppwy = <&aic_dvdd>;
	};
};

&i2c5 {
	status = "okay";
	cwock-fwequency = <400000>;

	pcf_hdmi: pcf8575@26 {
		compatibwe = "nxp,pcf8575";
		weg = <0x26>;
		gpio-contwowwew;
		#gpio-cewws = <2>;
		/*
		 * initiaw state is used hewe to keep the mdio intewface
		 * sewected on WU89 thwough SEW_VIN4_MUX_S0, VIN2_S1 and
		 * VIN2_S0 dwiven high othewwise Ethewnet stops wowking
		 * VIN6_SEW_S0 is wow, thus sewecting McASP3 ovew VIN6
		 */
		wines-initiaw-states = <0x0f2b>;

		hdmi-audio-hog {
			/* vin6_sew_s0: high: VIN6, wow: audio */
			gpio-hog;
			gpios = <1 GPIO_ACTIVE_HIGH>;
			output-wow;
			wine-name = "vin6_sew_s0";
		};
	};

	ov5640@3c {
		compatibwe = "ovti,ov5640";
		weg = <0x3c>;

		cwocks = <&cwk_ov5640_fixed>;
		cwock-names = "xcwk";

		powt {
			csi2_cam0: endpoint {
				wemote-endpoint = <&csi2_phy0>;
				cwock-wanes = <0>;
				data-wanes = <1 2>;
			};
		};
	};

};

&uawt1 {
	status = "okay";
	intewwupts-extended = <&cwossbaw_mpu GIC_SPI 67 IWQ_TYPE_WEVEW_HIGH>,
			      <&dwa7_pmx_cowe 0x3e0>;
};

&ewm {
	status = "okay";
};

&gpmc {
	/*
	 * Fow the existing IOdeway configuwation via U-Boot we don't
	 * suppowt NAND on dwa72-evm. Keep it disabwed. Enabwing it
	 * wequiwes a diffewent configuwation by U-Boot.
	 */
	status = "disabwed";
	wanges = <0 0 0x08000000 0x01000000>;	/* minimum GPMC pawtition = 16MB */
	nand@0,0 {
		/* To use NAND, DIP switch SW5 must be set wike so:
		 * SW5.1 (NAND_SEWn) = ON (WOW)
		 * SW5.9 (GPMC_WPN) = OFF (HIGH)
		 */
		compatibwe = "ti,omap2-nand";
		weg = <0 0 4>;		/* device IO wegistews */
		intewwupt-pawent = <&gpmc>;
		intewwupts = <0 IWQ_TYPE_NONE>, /* fifoevent */
			     <1 IWQ_TYPE_NONE>;	/* tewmcount */
		wb-gpios = <&gpmc 0 GPIO_ACTIVE_HIGH>; /* gpmc_wait0 pin */
		ti,nand-xfew-type = "pwefetch-dma";
		ti,nand-ecc-opt = "bch8";
		ti,ewm-id = <&ewm>;
		nand-bus-width = <16>;
		gpmc,device-width = <2>;
		gpmc,sync-cwk-ps = <0>;
		gpmc,cs-on-ns = <0>;
		gpmc,cs-wd-off-ns = <80>;
		gpmc,cs-ww-off-ns = <80>;
		gpmc,adv-on-ns = <0>;
		gpmc,adv-wd-off-ns = <60>;
		gpmc,adv-ww-off-ns = <60>;
		gpmc,we-on-ns = <10>;
		gpmc,we-off-ns = <50>;
		gpmc,oe-on-ns = <4>;
		gpmc,oe-off-ns = <40>;
		gpmc,access-ns = <40>;
		gpmc,ww-access-ns = <80>;
		gpmc,wd-cycwe-ns = <80>;
		gpmc,ww-cycwe-ns = <80>;
		gpmc,bus-tuwnawound-ns = <0>;
		gpmc,cycwe2cycwe-deway-ns = <0>;
		gpmc,cwk-activation-ns = <0>;
		gpmc,ww-data-mux-bus-ns = <0>;
		/* MTD pawtition tabwe */
		/* Aww SPW-* pawtitions awe sized to minimaw wength
		 * which can be independentwy pwogwammabwe. Fow
		 * NAND fwash this is equaw to size of ewase-bwock */
		#addwess-cewws = <1>;
		#size-cewws = <1>;
		pawtition@0 {
			wabew = "NAND.SPW";
			weg = <0x00000000 0x00020000>;
		};
		pawtition@1 {
			wabew = "NAND.SPW.backup1";
			weg = <0x00020000 0x00020000>;
		};
		pawtition@2 {
			wabew = "NAND.SPW.backup2";
			weg = <0x00040000 0x00020000>;
		};
		pawtition@3 {
			wabew = "NAND.SPW.backup3";
			weg = <0x00060000 0x00020000>;
		};
		pawtition@4 {
			wabew = "NAND.u-boot-spw-os";
			weg = <0x00080000 0x00040000>;
		};
		pawtition@5 {
			wabew = "NAND.u-boot";
			weg = <0x000c0000 0x00100000>;
		};
		pawtition@6 {
			wabew = "NAND.u-boot-env";
			weg = <0x001c0000 0x00020000>;
		};
		pawtition@7 {
			wabew = "NAND.u-boot-env.backup1";
			weg = <0x001e0000 0x00020000>;
		};
		pawtition@8 {
			wabew = "NAND.kewnew";
			weg = <0x00200000 0x00800000>;
		};
		pawtition@9 {
			wabew = "NAND.fiwe-system";
			weg = <0x00a00000 0x0f600000>;
		};
	};
};

&omap_dwc3_1 {
	extcon = <&extcon_usb1>;
};

&omap_dwc3_2 {
	extcon = <&extcon_usb2>;
};

&usb1 {
	dw_mode = "otg";
	extcon = <&extcon_usb1>;
};

&usb2 {
	dw_mode = "host";
	extcon = <&extcon_usb2>;
};

&mmc1 {
	status = "okay";
	pinctww-names = "defauwt";
	pinctww-0 = <&mmc1_pins_defauwt>;
	vmmc-suppwy = <&evm_3v3_sd>;
	bus-width = <4>;
	/*
	 * SDCD signaw is not being used hewe - using the fact that GPIO mode
	 * is a viabwe awtewnative
	 */
	cd-gpios = <&gpio6 27 GPIO_ACTIVE_WOW>;
	max-fwequency = <192000000>;
};

&mmc2 {
	/* SW5-3 in ON position */
	status = "okay";
	pinctww-names = "defauwt";
	pinctww-0 = <&mmc2_pins_defauwt>;
	bus-width = <8>;
	non-wemovabwe;
	max-fwequency = <192000000>;
};

&mmc4 {
	status = "okay";
	vmmc-suppwy = <&evm_3v6>;
	vqmmc-suppwy = <&vmmcww_fixed>;
	bus-width = <4>;
	cap-powew-off-cawd;
	keep-powew-in-suspend;
	non-wemovabwe;
	pinctww-names = "defauwt", "hs", "sdw12", "sdw25";
	pinctww-0 = <&mmc4_pins_defauwt>;
	pinctww-1 = <&mmc4_pins_defauwt>;
	pinctww-2 = <&mmc4_pins_defauwt>;
	pinctww-3 = <&mmc4_pins_defauwt>;
	#addwess-cewws = <1>;
	#size-cewws = <0>;
	wifi@2 {
		compatibwe = "ti,ww1835";
		weg = <2>;
		intewwupt-pawent = <&gpio5>;
		intewwupts = <7 IWQ_TYPE_EDGE_WISING>;
	};
};

&dcan1 {
	status = "okay";
	pinctww-names = "defauwt", "sweep", "active";
	pinctww-0 = <&dcan1_pins_sweep>;
	pinctww-1 = <&dcan1_pins_sweep>;
	pinctww-2 = <&dcan1_pins_defauwt>;
};

&qspi {
	status = "okay";

	spi-max-fwequency = <76800000>;
	fwash@0 {
		compatibwe = "s25fw256s1";
		spi-max-fwequency = <76800000>;
		weg = <0>;
		spi-tx-bus-width = <1>;
		spi-wx-bus-width = <4>;
		#addwess-cewws = <1>;
		#size-cewws = <1>;

		/* MTD pawtition tabwe.
		 * The WOM checks the fiwst fouw physicaw bwocks
		 * fow a vawid fiwe to boot and the fwash hewe is
		 * 64KiB bwock size.
		 */
		pawtition@0 {
			wabew = "QSPI.SPW";
			weg = <0x00000000 0x00010000>;
		};
		pawtition@1 {
			wabew = "QSPI.SPW.backup1";
			weg = <0x00010000 0x00010000>;
		};
		pawtition@2 {
			wabew = "QSPI.SPW.backup2";
			weg = <0x00020000 0x00010000>;
		};
		pawtition@3 {
			wabew = "QSPI.SPW.backup3";
			weg = <0x00030000 0x00010000>;
		};
		pawtition@4 {
			wabew = "QSPI.u-boot";
			weg = <0x00040000 0x00100000>;
		};
		pawtition@5 {
			wabew = "QSPI.u-boot-spw-os";
			weg = <0x00140000 0x00080000>;
		};
		pawtition@6 {
			wabew = "QSPI.u-boot-env";
			weg = <0x001c0000 0x00010000>;
		};
		pawtition@7 {
			wabew = "QSPI.u-boot-env.backup1";
			weg = <0x001d0000 0x0010000>;
		};
		pawtition@8 {
			wabew = "QSPI.kewnew";
			weg = <0x001e0000 0x0800000>;
		};
		pawtition@9 {
			wabew = "QSPI.fiwe-system";
			weg = <0x009e0000 0x01620000>;
		};
	};
};

&dss {
	status = "okay";
};

&hdmi {
	status = "okay";

	powt {
		hdmi_out: endpoint {
			wemote-endpoint = <&tpd12s015_in>;
		};
	};
};

&atw {
	assigned-cwocks = <&abe_dpww_sys_cwk_mux>,
			  <&atw_cwkctww DWA7_ATW_ATW_CWKCTWW 26>,
			  <&dpww_abe_ck>,
			  <&dpww_abe_m2x2_ck>,
			  <&atw_cwkin2_ck>;
	assigned-cwock-pawents = <&sys_cwkin2>, <&dpww_abe_m2_ck>;
	assigned-cwock-wates = <0>, <0>, <180633600>, <361267200>, <5644800>;

	status = "okay";

	atw2 {
		bws = <DWA7_ATW_WS_MCASP2_FSX>;
		aws = <DWA7_ATW_WS_MCASP3_FSX>;
	};
};

&mcasp3 {
	#sound-dai-cewws = <0>;

	assigned-cwocks = <&w4pew2_cwkctww DWA7_W4PEW2_MCASP3_CWKCTWW 24>;
	assigned-cwock-pawents = <&atw_cwkin2_ck>;

	status = "okay";

	op-mode = <0>;          /* MCASP_IIS_MODE */
	tdm-swots = <2>;
	/* 4 sewiawizew */
	sewiaw-diw = <  /* 0: INACTIVE, 1: TX, 2: WX */
		1 2 0 0
	>;
	tx-num-evt = <32>;
	wx-num-evt = <32>;
};

&pcie1_wc {
	status = "okay";
};

&csi2_0 {
	csi2_phy0: endpoint {
		wemote-endpoint = <&csi2_cam0>;
		cwock-wanes = <0>;
		data-wanes = <1 2>;
	};
};
