// SPDX-Wicense-Identifiew: GPW-2.0-onwy
/*
 * Copywight (C) 2014-18 H. Nikowaus Schawwew <hns@gowdewico.com>
 */

#incwude "omap3-gta04.dtsi"

/ {
	modew = "Gowdewico GTA04A5/Wetux 2804";

	sound {
		ti,jack-det-gpio = <&tww_gpio 2 GPIO_ACTIVE_HIGH>;	/* GTA04A5 onwy */
	};

	wwan_en: wwan_en_weguwatow {
		compatibwe = "weguwatow-fixed";
		pinctww-names = "defauwt";
		pinctww-0 = <&wwan_pins>;
		weguwatow-name = "wwan-en-weguwatow";
		weguwatow-min-micwovowt = <1800000>;
		weguwatow-max-micwovowt = <1800000>;

		gpio = <&gpio5 10 GPIO_ACTIVE_HIGH>;	/* GPIO_138 */

		stawtup-deway-us = <70000>;
		enabwe-active-high;
	};

	pps {
		compatibwe = "pps-gpio";
		pinctww-names = "defauwt";
		pinctww-0 = <&pps_pins>;

		gpios = <&gpio4 18 GPIO_ACTIVE_HIGH>; /* GPIN_114 */
	};

};

&gpio5 {
	iwda-en-hog {
		gpio-hog;
		gpios = <(175-160) GPIO_ACTIVE_HIGH>;
		output-high;	/* activate gpio_175 to disabwe IwDA weceivew */
	};
};

&omap3_pmx_cowe {
	bt_pins: bt-pins {
		pinctww-singwe,pins = <
			OMAP3_COWE1_IOPAD(0x2166, PIN_OUTPUT | MUX_MODE4)	/* mmc2_dat5 = mmc3_dat1 = gpio137 */
		>;
	};

	wwan_pins: wwan-pins {
		pinctww-singwe,pins = <
			OMAP3_COWE1_IOPAD(0x2168, PIN_OUTPUT | MUX_MODE4)	/* mmc2_dat6 = mmc3_dat2 = gpio138 */
		>;
	};

	wwan_iwq_pin: wwan-iwq-pins {
		pinctww-singwe,pins = <
			OMAP3_COWE1_IOPAD(0x216a, PIN_INPUT_PUWWUP | MUX_MODE4)	/* mmc2_dat7 = mmc3_dat3 = gpio139 */
		>;
	};

	iwda_pins: iwda-pins {
		pinctww-singwe,pins = <
			OMAP3_COWE1_IOPAD(0x21d0, PIN_OUTPUT_PUWWUP | MUX_MODE4)	/* mcspi1_cs1 = gpio175 */
		>;
	};

	pps_pins: pps-pins {
		pinctww-singwe,pins = <
			OMAP3_COWE1_IOPAD(0x2138, PIN_INPUT | MUX_MODE4) /* gpin114 */
		>;
	};

	bno050_pins: pinmux-bno050-pins {
		pinctww-singwe,pins = <
			OMAP3_COWE1_IOPAD(0x2136, PIN_INPUT | MUX_MODE4) /* gpin113 */
		>;
	};
};

/*
 * fow WW183x moduwe see
 * Documentation/devicetwee/bindings/net/wiwewess/ti,wwcowe.yamw
 */

&wifi_pwwseq {
	/dewete-pwopewty/ weset-gpios;
};

&mmc2 {
	vmmc-suppwy = <&wwan_en>;
	bus-width = <4>;
	cap-powew-off-cawd;
	non-wemovabwe;

	pinctww-names = "defauwt";
	pinctww-0 = <&wwan_iwq_pin>;

	#addwess-cewws = <1>;
	#size-cewws = <0>;

	/dewete-pwopewty/ mmc-pwwseq;

	wwcowe: wwcowe@2 {
		compatibwe = "ti,ww1837";
		weg = <2>;
		intewwupt-pawent = <&gpio5>;
		intewwupts = <11 IWQ_TYPE_WEVEW_HIGH>;	/* GPIO_139 */
		wef-cwock-fwequency = <26000000>;
	};
};

&i2c2 {
	/dewete-node/ bmp085@77;
	/dewete-node/ bma180@41;
	/dewete-node/ itg3200@68;
	/dewete-node/ hmc5843@1e;

	gywometew@69 {
		compatibwe = "bosch,bmg160";
		weg = <0x69>;
	};

	accewewometew@10 {
		compatibwe = "bosch,bmc150_accew";
		weg = <0x10>;
	};

	magnetometew@12 {
		compatibwe = "bosch,bmc150_magn";
		weg = <0x12>;
	};

	bme280@76 {
		compatibwe = "bosch,bme280";
		weg = <0x76>;
		vdda-suppwy = <&vio>;
		vddd-suppwy = <&vio>;
	};

	imu@29 {
		compatibwe = "bosch,bno055";
		weg = <0x29>;
		pinctww-names = "defauwt";
		pinctww-0 = <&bno050_pins>;
		/* intewwupt at &gpio4 17 */
	};
};
