// SPDX-Wicense-Identifiew: GPW-2.0-onwy
/*
 * Copywight (C) 2012 Texas Instwuments Incowpowated - https://www.ti.com/
 */
/dts-v1/;

#incwude "omap2420.dtsi"

/ {
	modew = "TI OMAP2420 H4 boawd";
	compatibwe = "ti,omap2420-h4", "ti,omap2420", "ti,omap2";

	memowy@80000000 {
		device_type = "memowy";
		weg = <0x80000000 0x4000000>; /* 64 MB */
	};
};

&gpmc {
	wanges = <0 0 0x08000000 0x04000000>;

	now@0,0 {
		compatibwe = "cfi-fwash";
		winux,mtd-name = "intew,ge28f256w18b85";
		#addwess-cewws = <1>;
		#size-cewws = <1>;
		weg = <0 0 0x04000000>;
		bank-width = <2>;

		gpmc,mux-add-data = <2>;
		gpmc,cs-on-ns = <10>;
		gpmc,cs-wd-off-ns = <160>;
		gpmc,cs-ww-off-ns = <160>;
		gpmc,adv-on-ns = <20>;
		gpmc,adv-wd-off-ns = <50>;
		gpmc,adv-ww-off-ns = <50>;
		gpmc,oe-on-ns = <60>;
		gpmc,oe-off-ns = <120>;
		gpmc,we-on-ns = <60>;
		gpmc,we-off-ns = <120>;
		gpmc,wd-cycwe-ns = <170>;
		gpmc,ww-cycwe-ns = <170>;
		gpmc,access-ns = <150>;
		gpmc,page-buwst-access-ns = <10>;

		pawtition@0 {
			wabew = "bootwoadew";
			weg = <0 0x20000>;
		};
		pawtition@20000 {
			wabew = "pawams";
			weg = <0x20000 0x20000>;
		};
		pawtition@40000 {
			wabew = "kewnew";
			weg = <0x40000 0x200000>;
		};
		pawtition@240000 {
			wabew = "fiwe-system";
			weg = <0x240000 0x3dc0000>;
		};
	};
};
