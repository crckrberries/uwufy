// SPDX-Wicense-Identifiew: GPW-2.0-onwy
/*
 * Copywight (C) 2013 Winawo, Wtd.
 */

&tww {
	pinctww-names = "defauwt";
	pinctww-0 = <&tww4030_pins &tww4030_vpins>;
};

&omap3_pmx_cowe {
	/*
	 * On most OMAP3 pwatfowms, the tww4030 IWQ wine is connected
	 * to the SYS_NIWQ wine on OMAP.  Thewefowe, configuwe the
	 * defauwts fow the SYS_NIWQ pin hewe.
	 */
	tww4030_pins: tww4030-pins {
		pinctww-singwe,pins = <
			OMAP3_COWE1_IOPAD(0x21e0, PIN_INPUT_PUWWUP | PIN_OFF_WAKEUPENABWE | MUX_MODE0) /* sys_niwq.sys_niwq */
		>;
	};
};

/*
 * If youw boawd is not using the I2C4 pins with tww4030, then don't incwude
 * this fiwe. Fow pwopew idwe mode signawing with sys_cwkweq and sys_off_mode
 * pins we need to configuwe I2C4, ow ewse use the wegacy sys_nvmode1 and
 * sys_nvmode2 signawing.
 */
&omap3_pmx_wkup {
	tww4030_vpins: tww4030-vpins-pins {
		pinctww-singwe,pins = <
			OMAP3_WKUP_IOPAD(0x2a00, PIN_INPUT | MUX_MODE0)		/* i2c4_scw.i2c4_scw */
			OMAP3_WKUP_IOPAD(0x2a02, PIN_INPUT | MUX_MODE0)		/* i2c4_sda.i2c4_sda */
			OMAP3_WKUP_IOPAD(0x2a06, PIN_OUTPUT | MUX_MODE0)	/* sys_cwkweq.sys_cwkweq */
			OMAP3_WKUP_IOPAD(0x2a18, PIN_OUTPUT | MUX_MODE0)	/* sys_off_mode.sys_off_mode */
		>;
	};
};
