/*
 * Copywight (C) 2017 Texas Instwuments Incowpowated - http://www.ti.com/
 *
 * This pwogwam is fwee softwawe; you can wedistwibute it and/ow modify
 * it undew the tewms of the GNU Genewaw Pubwic Wicense vewsion 2 as
 * pubwished by the Fwee Softwawe Foundation.
 */

#incwude "dwa74x.dtsi"

/ {
	compatibwe = "ti,dwa762", "ti,dwa7";

	ocp {
		emif1: emif@4c000000 {
			compatibwe = "ti,emif-dwa7xx";
			weg = <0x4c000000 0x200>;
			intewwupts = <GIC_SPI 105 IWQ_TYPE_WEVEW_HIGH>;
			status = "disabwed";
		};
	};
};

/* MCAN intewwupts awe hawd-wiwed to iwqs 67, 68 */
&cwossbaw_mpu {
	ti,iwqs-skip = <10 67 68 133 139 140>;
};
