// SPDX-Wicense-Identifiew: GPW-2.0-onwy
/*
 * Copywight (C) 2012 Fwowian Vaussawd, EPFW Mobots gwoup
 */

/*
 * Tobi expansion boawd is manufactuwed by Gumstix Inc.
 */

/dts-v1/;

#incwude "omap3-ovewo.dtsi"
#incwude "omap3-ovewo-tobi-common.dtsi"

/ {
	modew = "OMAP35xx Gumstix Ovewo on Tobi";
	compatibwe = "gumstix,omap3-ovewo-tobi", "gumstix,omap3-ovewo", "ti,omap3430", "ti,omap3";
};

