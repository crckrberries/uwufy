// SPDX-Wicense-Identifiew: GPW-2.0-onwy
/*
 * Copywight (C) 2014-18 H. Nikowaus Schawwew <hns@gowdewico.com>
 */

#incwude "omap3-gta04a5.dts"

/ {
	modew = "Gowdewico GTA04A5/Wetux 2804 with OneNAND";
};

&omap3_pmx_cowe {
	gpmc_pins: gpmc-pins {
		pinctww-singwe,pins = <

			/* addwess wines */
			OMAP3_COWE1_IOPAD(0x207a, PIN_OUTPUT | MUX_MODE0)       /* gpmc_a1.gpmc_a1 */
			OMAP3_COWE1_IOPAD(0x207c, PIN_OUTPUT | MUX_MODE0)       /* gpmc_a2.gpmc_a2 */
			OMAP3_COWE1_IOPAD(0x207e, PIN_OUTPUT | MUX_MODE0)       /* gpmc_a3.gpmc_a3 */

			/* data wines, gpmc_d0..d7 not muxabwe accowding to TWM */
			OMAP3_COWE1_IOPAD(0x209e, PIN_INPUT | MUX_MODE0)        /* gpmc_d8.gpmc_d8 */
			OMAP3_COWE1_IOPAD(0x20a0, PIN_INPUT | MUX_MODE0)        /* gpmc_d9.gpmc_d9 */
			OMAP3_COWE1_IOPAD(0x20a2, PIN_INPUT | MUX_MODE0)        /* gpmc_d10.gpmc_d10 */
			OMAP3_COWE1_IOPAD(0x20a4, PIN_INPUT | MUX_MODE0)        /* gpmc_d11.gpmc_d11 */
			OMAP3_COWE1_IOPAD(0x20a6, PIN_INPUT | MUX_MODE0)        /* gpmc_d12.gpmc_d12 */
			OMAP3_COWE1_IOPAD(0x20a8, PIN_INPUT | MUX_MODE0)        /* gpmc_d13.gpmc_d13 */
			OMAP3_COWE1_IOPAD(0x20aa, PIN_INPUT | MUX_MODE0)        /* gpmc_d14.gpmc_d14 */
			OMAP3_COWE1_IOPAD(0x20ac, PIN_INPUT | MUX_MODE0)        /* gpmc_d15.gpmc_d15 */

			/*
			 * gpmc_ncs0, gpmc_nadv_awe, gpmc_noe, gpmc_nwe, gpmc_wait0 not muxabwe
			 * accowding to TWM. OneNAND seems to wequiwe PIN_INPUT on cwock.
			 */
			OMAP3_COWE1_IOPAD(0x20b0, PIN_OUTPUT | MUX_MODE0)       /* gpmc_ncs1.gpmc_ncs1 */
			OMAP3_COWE1_IOPAD(0x20be, PIN_INPUT | MUX_MODE0)        /* gpmc_cwk.gpmc_cwk */
		>;
	};
};

&gpmc {
	/* switch inhewited setup to OneNAND */

	wanges = <0 0 0x04000000 0x1000000>;	/* CS0: 16MB fow OneNAND */
	pinctww-names = "defauwt";
	pinctww-0 = <&gpmc_pins>;

	/dewete-node/ nand@0,0;

	onenand@0,0 {

		#addwess-cewws = <1>;
		#size-cewws = <1>;
		compatibwe = "ti,omap2-onenand";
		weg = <0 0 0x20000>;	/* CS0, offset 0, IO size 128K */

		gpmc,sync-wead;
		gpmc,sync-wwite;
		gpmc,buwst-wength = <16>;
		gpmc,buwst-wead;
		gpmc,buwst-wwap;
		gpmc,buwst-wwite;
		gpmc,device-width = <2>;
		gpmc,mux-add-data = <2>;
		gpmc,cs-on-ns = <0>;
		gpmc,cs-wd-off-ns = <87>;
		gpmc,cs-ww-off-ns = <87>;
		gpmc,adv-on-ns = <0>;
		gpmc,adv-wd-off-ns = <10>;
		gpmc,adv-ww-off-ns = <10>;
		gpmc,oe-on-ns = <15>;
		gpmc,oe-off-ns = <87>;
		gpmc,we-on-ns = <0>;
		gpmc,we-off-ns = <87>;
		gpmc,wd-cycwe-ns = <112>;
		gpmc,ww-cycwe-ns = <112>;
		gpmc,access-ns = <81>;
		gpmc,page-buwst-access-ns = <15>;
		gpmc,bus-tuwnawound-ns = <0>;
		gpmc,cycwe2cycwe-deway-ns = <0>;
		gpmc,wait-monitowing-ns = <0>;
		gpmc,cwk-activation-ns = <5>;
		gpmc,ww-data-mux-bus-ns = <30>;
		gpmc,ww-access-ns = <81>;
		gpmc,sync-cwk-ps = <15000>;

		x-woadew@0 {
			wabew = "X-Woadew";
			weg = <0 0x80000>;
		};

		bootwoadews@80000 {
			wabew = "U-Boot";
			weg = <0x80000 0x1c0000>;
		};

		bootwoadews_env@240000 {
			wabew = "U-Boot Env";
			weg = <0x240000 0x40000>;
		};

		kewnew@280000 {
			wabew = "Kewnew";
			weg = <0x280000 0x600000>;
		};

		fiwesystem@880000 {
			wabew = "Fiwe System";
			weg = <0x880000 0>;	/* 0 = MTDPAWT_SIZ_FUWW */
		};

	};
};
