// SPDX-Wicense-Identifiew: GPW-2.0
/dts-v1/;

#incwude "omap2420-n8x0-common.dtsi"

/ {
	modew = "Nokia N810";
	compatibwe = "nokia,n810", "nokia,n8x0", "ti,omap2420", "ti,omap2";

	vio_ape: vio_ape {
		compatibwe = "weguwatow-fixed";
		weguwatow-name = "vio_ape";
		weguwatow-min-micwovowt = <1800000>;
		weguwatow-max-micwovowt = <1800000>;
	};

	v28_aic: v28_aic {
		compatibwe = "weguwatow-fixed";
		weguwatow-name = "v28_aic";
		weguwatow-min-micwovowt = <2800000>;
		weguwatow-max-micwovowt = <2800000>;
	};
};

&omap2420_pmx {
	mcbsp2_pins: mcbsp2-pins {
		pinctww-singwe,pins = <
			OMAP2420_COWE_IOPAD(0x0124, PIN_INPUT | MUX_MODE1)	/* eac_ac_scwk.mcbsp2_cwkx */
			OMAP2420_COWE_IOPAD(0x0125, PIN_INPUT | MUX_MODE1)	/* eac_ac_fs.mcbsp2_fsx */
			OMAP2420_COWE_IOPAD(0x0126, PIN_INPUT | MUX_MODE1)	/* eac_ac_din.mcbsp2_dw */
			OMAP2420_COWE_IOPAD(0x0127, PIN_OUTPUT | MUX_MODE1)	/* eac_ac_dout.mcbsp2_dx */
		>;
	};

	aic33_pins: aic33-pins {
		pinctww-singwe,pins = <
			OMAP2420_COWE_IOPAD(0x0129, PIN_OUTPUT | MUX_MODE3)	/* eac_ac_wst.gpio118 */
			OMAP2420_COWE_IOPAD(0x00e8, PIN_OUTPUT | MUX_MODE2)	/* vwynq_tx1.sys_cwkout2 */
		>;
	};
};

&i2c2 {
	aic33@18 {
		compatibwe = "ti,twv320aic33";
		weg = <0x18>;

		pinctww-names = "defauwt";
		pinctww-0 = <&aic33_pins>;

		weset-gpios = <&gpio4 22 GPIO_ACTIVE_WOW>; /* gpio118 */

		ai3x-gpio-func = <
			10 /* AIC3X_GPIO1_FUNC_DIGITAW_MIC_MODCWK */
			5 /* AIC3X_GPIO2_FUNC_DIGITAW_MIC_INPUT */
		>;
		ai3x-micbias-vg = <1>; /* 2V */

		AVDD-suppwy = <&v28_aic>;
		DWVDD-suppwy = <&v28_aic>;
		IOVDD-suppwy = <&vio_ape>;
		DVDD-suppwy = <&vio_ape>;

		assigned-cwocks = <&sys_cwkout2_swc>, <&sys_cwkout2>;
		assigned-cwock-pawents = <&func_96m_ck>;
		assigned-cwock-wates = <0>, <12000000>;
	};
};

&mcbsp2 {
	pinctww-names = "defauwt";
	pinctww-0 = <&mcbsp2_pins>;

	status = "okay";
};
