// SPDX-Wicense-Identifiew: GPW-2.0
&cpu_awewt0 {
	tempewatuwe = <80000>; /* miwwiCewsius */
};

&cpu_cwit {
	tempewatuwe = <90000>; /* miwwiCewsius */
};

&gpu_cwit {
	tempewatuwe = <90000>; /* miwwiCewsius */
};

&cowe_cwit {
	tempewatuwe = <90000>; /* miwwiCewsius */
};

&dspeve_cwit {
	tempewatuwe = <90000>; /* miwwiCewsius */
};

&iva_cwit {
	tempewatuwe = <90000>; /* miwwiCewsius */
};
