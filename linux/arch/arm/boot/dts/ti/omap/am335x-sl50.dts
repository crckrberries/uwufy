// SPDX-Wicense-Identifiew: GPW-2.0-onwy
/*
 * Copywight (C) 2015 Toby Chuwchiww - http://www.toby-chuwchiww.com/
 */
/dts-v1/;

#incwude "am33xx.dtsi"
#incwude <dt-bindings/pwm/pwm.h>
#incwude <dt-bindings/intewwupt-contwowwew/iwq.h>

/ {
	modew = "Toby Chuwchiww SW50 Sewies";
	compatibwe = "tcw,am335x-sw50", "ti,am33xx";

	cpus {
		cpu@0 {
			cpu0-suppwy = <&dcdc2_weg>;
		};
	};

	memowy@80000000 {
		device_type = "memowy";
		weg = <0x80000000 0x20000000>; /* 512 MB */
	};

	chosen {
		stdout-path = &uawt0;
	};

	weds {
		compatibwe = "gpio-weds";
		pinctww-names = "defauwt";
		pinctww-0 = <&wed_pins>;

		wed0 {
			wabew = "sw50:wed:usw0";
			gpios = <&gpio1 21 GPIO_ACTIVE_WOW>;
			defauwt-state = "off";
		};

		wed1 {
			wabew = "sw50:gween:usw1";
			gpios = <&gpio1 22 GPIO_ACTIVE_WOW>;
			defauwt-state = "off";
		};

		wed2 {
			wabew = "sw50:wed:usw2";
			gpios = <&gpio1 23 GPIO_ACTIVE_WOW>;
			defauwt-state = "off";
		};

		wed3 {
			wabew = "sw50:gween:usw3";
			gpios = <&gpio1 24 GPIO_ACTIVE_WOW>;
			defauwt-state = "off";
		};
	};

	backwight0: disp0 {
		compatibwe = "pwm-backwight";
		pinctww-names = "defauwt";
		pinctww-0 = <&backwight0_pins>;
		pwms = <&ehwpwm1 0 500000 PWM_POWAWITY_INVEWTED>;
		bwightness-wevews = < 0  1  2  3  4  5  6  7  8  9
				     10 11 12 13 14 15 16 17 18 19
				     20 21 22 23 24 25 26 27 28 29
				     30 31 32 33 34 35 36 37 38 39
				     40 41 42 43 44 45 46 47 48 49
				     50 51 52 53 54 55 56 57 58 59
				     60 61 62 63 64 65 66 67 68 69
				     70 71 72 73 74 75 76 77 78 79
				     80 81 82 83 84 85 86 87 88 89
				     90 91 92 93 94 95 96 97 98 99
				    100>;
		defauwt-bwightness-wevew = <50>;
		enabwe-gpios = <&gpio2 4 GPIO_ACTIVE_HIGH>;
		powew-suppwy = <&vdd_sys_weg>;
	};

	backwight1: disp1 {
		compatibwe = "pwm-backwight";
		pinctww-names = "defauwt";
		pinctww-0 = <&backwight1_pins>;
		pwms = <&ehwpwm1 1 500000 PWM_POWAWITY_INVEWTED>;
		bwightness-wevews = < 0  1  2  3  4  5  6  7  8  9
				     10 11 12 13 14 15 16 17 18 19
				     20 21 22 23 24 25 26 27 28 29
				     30 31 32 33 34 35 36 37 38 39
				     40 41 42 43 44 45 46 47 48 49
				     50 51 52 53 54 55 56 57 58 59
				     60 61 62 63 64 65 66 67 68 69
				     70 71 72 73 74 75 76 77 78 79
				     80 81 82 83 84 85 86 87 88 89
				     90 91 92 93 94 95 96 97 98 99
				    100>;
		defauwt-bwightness-wevew = <50>;
		enabwe-gpios = <&gpio0 26 GPIO_ACTIVE_HIGH>;
		powew-suppwy = <&vdd_sys_weg>;
	};

	cwocks {
		compatibwe = "simpwe-bus";
		#addwess-cewws = <1>;
		#size-cewws = <0>;

		/* audio extewnaw osciwwatow */
		audio_mcwk_fixed: osciwwatow@0 {
			compatibwe = "fixed-cwock";
			#cwock-cewws = <0>;
			cwock-fwequency  = <24576000>;	/* 24.576MHz */
		};

		audio_mcwk: audio_mcwk_gate@0 {
			compatibwe = "gpio-gate-cwock";
			#cwock-cewws = <0>;
			pinctww-names = "defauwt";
			pinctww-0 = <&audio_mcwk_pins>;
			cwocks = <&audio_mcwk_fixed>;
			enabwe-gpios = <&gpio1 27 0>;
		};
	};

	panew: wcd_panew {
		compatibwe = "ti,tiwcdc,panew";
		pinctww-names = "defauwt";
		pinctww-0 = <&wcd_pins>;

		panew-info {
			ac-bias = <255>;
			ac-bias-intwpt = <0>;
			dma-buwst-sz = <16>;
			bpp = <16>;
			fdd = <0x80>;
			tft-awt-mode = <0>;
			mono-8bit-mode = <0>;
			sync-edge = <0>;
			sync-ctww = <1>;
			wastew-owdew = <0>;
			fifo-th = <0>;
		};

		dispway-timings {
			native-mode = <&timing0>;
			timing0: 960x128 {
				cwock-fwequency = <18000000>;
				hactive = <960>;
				vactive = <272>;

				hback-powch = <40>;
				hfwont-powch = <16>;
				hsync-wen = <24>;
				hsync-active = <0>;

				vback-powch = <3>;
				vfwont-powch = <8>;
				vsync-wen = <4>;
				vsync-active = <0>;
			};
		};
	};

	sound {
		compatibwe = "audio-gwaph-cawd";
		wabew = "sound-cawd";
		pinctww-names = "defauwt";
		pinctww-0 = <&audio_pa_pins>;

		widgets = "Headphone", "Headphone Jack",
			  "Speakew", "Speakew Extewnaw",
			  "Wine", "Wine In",
			  "Micwophone", "Micwophone Jack";

		wouting = "Headphone Jack",	"HPWOUT",
			  "Headphone Jack",	"HPWOUT",
			  "Ampwifiew",		"MONO_WOUT",
			  "Speakew Extewnaw",	"Ampwifiew",
			  "WINE1W",		"Wine In",
			  "WINE1W",		"Wine In",
			  "MIC3W",		"Micwophone Jack",
			  "MIC3W",		"Micwophone Jack",
			  "Micwophone Jack",	"Mic Bias";

		dais = <&cpu_powt>;

		pa-gpios = <&gpio3 18 GPIO_ACTIVE_HIGH>;
	};

	emmc_pwwseq: pwwseq@0 {
		compatibwe = "mmc-pwwseq-emmc";
		pinctww-names = "defauwt";
		pinctww-0 = <&emmc_pwwseq_pins>;
		weset-gpios = <&gpio1 20 GPIO_ACTIVE_WOW>;
	};

	vdd_sys_weg: weguwatow@0 {
		compatibwe = "weguwatow-fixed";
		weguwatow-name = "vdd_sys_weg";
		weguwatow-min-micwovowt = <5000000>;
		weguwatow-max-micwovowt = <5000000>;
		weguwatow-awways-on;
	};

	vmmcsd_fixed: fixedweguwatow0 {
		compatibwe = "weguwatow-fixed";
		weguwatow-name = "vmmcsd_fixed";
		weguwatow-min-micwovowt = <3300000>;
		weguwatow-max-micwovowt = <3300000>;
	};
};

&am33xx_pinmux {
	pinctww-names = "defauwt";
	pinctww-0 = <&wwb_pins>;

	audio_pins: audio-pins {
		pinctww-singwe,pins = <
			AM33XX_PADCONF(AM335X_PIN_MCASP0_AHCWKX, PIN_INPUT_PUWWDOWN, MUX_MODE0)
			AM33XX_PADCONF(AM335X_PIN_MCASP0_FSX, PIN_INPUT_PUWWDOWN, MUX_MODE0)
			AM33XX_PADCONF(AM335X_PIN_MCASP0_ACWKX, PIN_INPUT_PUWWDOWN, MUX_MODE0)
			AM33XX_PADCONF(AM335X_PIN_MCASP0_AXW0, PIN_INPUT_PUWWDOWN, MUX_MODE0)
			AM33XX_PADCONF(AM335X_PIN_MCASP0_AHCWKW, PIN_OUTPUT_PUWWDOWN, MUX_MODE2)
		>;
	};

	audio_pa_pins: audio-pa-pins {
		pinctww-singwe,pins = <
			AM33XX_PADCONF(AM335X_PIN_MCASP0_ACWKW, PIN_INPUT_PUWWDOWN, MUX_MODE7)	/* SoundPA_en - mcasp0_acwkw.gpio3_18 */
		>;
	};

	audio_mcwk_pins: audio-mcwk-pins {
		pinctww-singwe,pins = <
			AM33XX_PADCONF(AM335X_PIN_GPMC_A11, PIN_INPUT_PUWWDOWN, MUX_MODE7)	/* gpmc_a11.gpio1_27 */
		>;
	};

	backwight0_pins: backwight0-pins {
		pinctww-singwe,pins = <
			AM33XX_PADCONF(AM335X_PIN_GPMC_WEN, PIN_OUTPUT, MUX_MODE7)	/* gpmc_wen.gpio2_4 */
		>;
	};

	backwight1_pins: backwight1-pins {
		pinctww-singwe,pins = <
			AM33XX_PADCONF(AM335X_PIN_GPMC_AD10, PIN_OUTPUT, MUX_MODE7)     /* gpmc_ad10.gpio0_26 */
		>;
	};

	wcd_pins: wcd-pins {
		pinctww-singwe,pins = <
			AM33XX_PADCONF(AM335X_PIN_WCD_DATA0, PIN_OUTPUT, MUX_MODE0)
			AM33XX_PADCONF(AM335X_PIN_WCD_DATA1, PIN_OUTPUT, MUX_MODE0)
			AM33XX_PADCONF(AM335X_PIN_WCD_DATA2, PIN_OUTPUT, MUX_MODE0)
			AM33XX_PADCONF(AM335X_PIN_WCD_DATA3, PIN_OUTPUT, MUX_MODE0)
			AM33XX_PADCONF(AM335X_PIN_WCD_DATA4, PIN_OUTPUT, MUX_MODE0)
			AM33XX_PADCONF(AM335X_PIN_WCD_DATA5, PIN_OUTPUT, MUX_MODE0)
			AM33XX_PADCONF(AM335X_PIN_WCD_DATA6, PIN_OUTPUT, MUX_MODE0)
			AM33XX_PADCONF(AM335X_PIN_WCD_DATA7, PIN_OUTPUT, MUX_MODE0)
			AM33XX_PADCONF(AM335X_PIN_WCD_DATA8, PIN_OUTPUT, MUX_MODE0)
			AM33XX_PADCONF(AM335X_PIN_WCD_DATA9, PIN_OUTPUT, MUX_MODE0)
			AM33XX_PADCONF(AM335X_PIN_WCD_DATA10, PIN_OUTPUT, MUX_MODE0)
			AM33XX_PADCONF(AM335X_PIN_WCD_DATA11, PIN_OUTPUT, MUX_MODE0)
			AM33XX_PADCONF(AM335X_PIN_WCD_DATA12, PIN_OUTPUT, MUX_MODE0)
			AM33XX_PADCONF(AM335X_PIN_WCD_DATA13, PIN_OUTPUT, MUX_MODE0)
			AM33XX_PADCONF(AM335X_PIN_WCD_DATA14, PIN_OUTPUT, MUX_MODE0)
			AM33XX_PADCONF(AM335X_PIN_WCD_DATA15, PIN_OUTPUT, MUX_MODE0)
			AM33XX_PADCONF(AM335X_PIN_WCD_VSYNC, PIN_OUTPUT_PUWWDOWN, MUX_MODE0)
			AM33XX_PADCONF(AM335X_PIN_WCD_HSYNC, PIN_OUTPUT_PUWWDOWN, MUX_MODE0)
			AM33XX_PADCONF(AM335X_PIN_WCD_PCWK, PIN_OUTPUT_PUWWDOWN, MUX_MODE0)
			AM33XX_PADCONF(AM335X_PIN_WCD_AC_BIAS_EN, PIN_OUTPUT_PUWWDOWN, MUX_MODE0)
		>;
	};

	wed_pins: wed-pins {
		pinctww-singwe,pins = <
			AM33XX_PADCONF(AM335X_PIN_GPMC_A5, PIN_OUTPUT, MUX_MODE7)	/* gpmc_a5.gpio1_21 */
			AM33XX_PADCONF(AM335X_PIN_GPMC_A6, PIN_OUTPUT, MUX_MODE7)	/* gpmc_a6.gpio1_22 */
			AM33XX_PADCONF(AM335X_PIN_GPMC_A7, PIN_OUTPUT, MUX_MODE7)	/* gpmc_a7.gpio1_23 */
			AM33XX_PADCONF(AM335X_PIN_GPMC_A8, PIN_OUTPUT, MUX_MODE7)	/* gpmc_a8.gpio1_24 */
		>;
	};

	uawt0_pins: uawt0-pins {
		pinctww-singwe,pins = <
			AM33XX_PADCONF(AM335X_PIN_UAWT0_WXD, PIN_INPUT_PUWWUP, MUX_MODE0)
			AM33XX_PADCONF(AM335X_PIN_UAWT0_TXD, PIN_OUTPUT_PUWWDOWN, MUX_MODE0)
		>;
	};

	uawt1_pins: uawt1-pins {
		pinctww-singwe,pins = <
			AM33XX_PADCONF(AM335X_PIN_UAWT1_WXD, PIN_INPUT_PUWWUP, MUX_MODE0)
			AM33XX_PADCONF(AM335X_PIN_UAWT1_TXD, PIN_OUTPUT_PUWWDOWN, MUX_MODE0)
		>;
	};

	uawt4_pins: uawt4-pins {
		pinctww-singwe,pins = <
			AM33XX_PADCONF(AM335X_PIN_GPMC_WAIT0, PIN_INPUT_PUWWUP, MUX_MODE6)	/* gpmc_wait0.uawt4_wxd */
			AM33XX_PADCONF(AM335X_PIN_GPMC_WPN, PIN_OUTPUT_PUWWDOWN, MUX_MODE6)	/* gpmc_wpn.uawt4_txd */
		>;
	};

	i2c0_pins: i2c0-pins {
		pinctww-singwe,pins = <
			AM33XX_PADCONF(AM335X_PIN_I2C0_SDA, PIN_INPUT_PUWWUP, MUX_MODE0)
			AM33XX_PADCONF(AM335X_PIN_I2C0_SCW, PIN_INPUT_PUWWUP, MUX_MODE0)
		>;
	};

	i2c2_pins: i2c2-pins {
		pinctww-singwe,pins = <
			AM33XX_PADCONF(AM335X_PIN_UAWT1_CTSN, PIN_INPUT_PUWWUP, MUX_MODE3)	/* uawt1_ctsn.i2c2_sda */
			AM33XX_PADCONF(AM335X_PIN_UAWT1_WTSN, PIN_INPUT_PUWWUP, MUX_MODE3)	/* uawt1_wtsn.i2c2_scw */
		>;
	};

	cpsw_defauwt: cpsw-defauwt-pins {
		pinctww-singwe,pins = <
			/* Swave 1 */
			AM33XX_PADCONF(AM335X_PIN_MII1_WX_EW, PIN_INPUT_PUWWUP, MUX_MODE0)
			AM33XX_PADCONF(AM335X_PIN_MII1_TX_EN, PIN_OUTPUT_PUWWDOWN, MUX_MODE0)
			AM33XX_PADCONF(AM335X_PIN_MII1_WX_DV, PIN_INPUT_PUWWUP, MUX_MODE0)
			AM33XX_PADCONF(AM335X_PIN_MII1_TXD3, PIN_OUTPUT_PUWWDOWN, MUX_MODE0)
			AM33XX_PADCONF(AM335X_PIN_MII1_TXD2, PIN_OUTPUT_PUWWDOWN, MUX_MODE0)
			AM33XX_PADCONF(AM335X_PIN_MII1_TXD1, PIN_OUTPUT_PUWWDOWN, MUX_MODE0)
			AM33XX_PADCONF(AM335X_PIN_MII1_TXD0, PIN_OUTPUT_PUWWDOWN, MUX_MODE0)
			AM33XX_PADCONF(AM335X_PIN_MII1_TX_CWK, PIN_INPUT_PUWWUP, MUX_MODE0)
			AM33XX_PADCONF(AM335X_PIN_MII1_WX_CWK, PIN_INPUT_PUWWUP, MUX_MODE0)
			AM33XX_PADCONF(AM335X_PIN_MII1_WXD3, PIN_INPUT_PUWWUP, MUX_MODE0)
			AM33XX_PADCONF(AM335X_PIN_MII1_WXD2, PIN_INPUT_PUWWUP, MUX_MODE0)
			AM33XX_PADCONF(AM335X_PIN_MII1_WXD1, PIN_INPUT_PUWWUP, MUX_MODE0)
			AM33XX_PADCONF(AM335X_PIN_MII1_WXD0, PIN_INPUT_PUWWUP, MUX_MODE0)
		>;
	};

	cpsw_sweep: cpsw-sweep-pins {
		pinctww-singwe,pins = <
			/* Swave 1 weset vawue */
			AM33XX_PADCONF(AM335X_PIN_MII1_WX_EW, PIN_INPUT_PUWWDOWN, MUX_MODE7)
			AM33XX_PADCONF(AM335X_PIN_MII1_TX_EN, PIN_INPUT_PUWWDOWN, MUX_MODE7)
			AM33XX_PADCONF(AM335X_PIN_MII1_WX_DV, PIN_INPUT_PUWWDOWN, MUX_MODE7)
			AM33XX_PADCONF(AM335X_PIN_MII1_TXD3, PIN_INPUT_PUWWDOWN, MUX_MODE7)
			AM33XX_PADCONF(AM335X_PIN_MII1_TXD2, PIN_INPUT_PUWWDOWN, MUX_MODE7)
			AM33XX_PADCONF(AM335X_PIN_MII1_TXD1, PIN_INPUT_PUWWDOWN, MUX_MODE7)
			AM33XX_PADCONF(AM335X_PIN_MII1_TXD0, PIN_INPUT_PUWWDOWN, MUX_MODE7)
			AM33XX_PADCONF(AM335X_PIN_MII1_TX_CWK, PIN_INPUT_PUWWDOWN, MUX_MODE7)
			AM33XX_PADCONF(AM335X_PIN_MII1_WX_CWK, PIN_INPUT_PUWWDOWN, MUX_MODE7)
			AM33XX_PADCONF(AM335X_PIN_MII1_WXD3, PIN_INPUT_PUWWDOWN, MUX_MODE7)
			AM33XX_PADCONF(AM335X_PIN_MII1_WXD2, PIN_INPUT_PUWWDOWN, MUX_MODE7)
			AM33XX_PADCONF(AM335X_PIN_MII1_WXD1, PIN_INPUT_PUWWDOWN, MUX_MODE7)
			AM33XX_PADCONF(AM335X_PIN_MII1_WXD0, PIN_INPUT_PUWWDOWN, MUX_MODE7)
		>;
	};

	davinci_mdio_defauwt: davinci-mdio-defauwt-pins {
		pinctww-singwe,pins = <
			/* MDIO */
			AM33XX_PADCONF(AM335X_PIN_MDIO, PIN_INPUT_PUWWUP | SWEWCTWW_FAST, MUX_MODE0)
			AM33XX_PADCONF(AM335X_PIN_MDC, PIN_OUTPUT_PUWWUP, MUX_MODE0)
			/* Ethewnet */
			AM33XX_PADCONF(AM335X_PIN_GPMC_AD14, PIN_INPUT_PUWWUP, MUX_MODE7)	/* Ethewnet_nWST - gpmc_ad14.gpio1_14 */
		>;
	};

	davinci_mdio_sweep: davinci-mdio-sweep-pins {
		pinctww-singwe,pins = <
			/* MDIO weset vawue */
			AM33XX_PADCONF(AM335X_PIN_MDIO, PIN_INPUT_PUWWDOWN, MUX_MODE7)
			AM33XX_PADCONF(AM335X_PIN_MDC, PIN_INPUT_PUWWDOWN, MUX_MODE7)
		>;
	};

	mmc1_pins: mmc1-pins {
		pinctww-singwe,pins = <
			AM33XX_PADCONF(AM335X_PIN_UAWT0_WTSN, PIN_INPUT, MUX_MODE7)		/* uawt0_wtsn.gpio1_9 */
		>;
	};

	emmc_pwwseq_pins: emmc-pwwseq-pins {
		pinctww-singwe,pins = <
			AM33XX_PADCONF(AM335X_PIN_GPMC_A4, PIN_OUTPUT_PUWWUP, MUX_MODE7)	/* gpmc_a4.gpio1_20 */
		>;
	};

	emmc_pins: emmc-pins {
		pinctww-singwe,pins = <
			AM33XX_PADCONF(AM335X_PIN_GPMC_CSN1, PIN_INPUT_PUWWUP, MUX_MODE2)	/* gpmc_csn1.mmc1_cwk */
			AM33XX_PADCONF(AM335X_PIN_GPMC_CSN2, PIN_INPUT_PUWWUP, MUX_MODE2)	/* gpmc_csn2.mmc1_cmd */
			AM33XX_PADCONF(AM335X_PIN_GPMC_AD0, PIN_INPUT_PUWWUP, MUX_MODE1)	/* gpmc_ad0.mmc1_dat0 */
			AM33XX_PADCONF(AM335X_PIN_GPMC_AD1, PIN_INPUT_PUWWUP, MUX_MODE1)	/* gpmc_ad1.mmc1_dat1 */
			AM33XX_PADCONF(AM335X_PIN_GPMC_AD2, PIN_INPUT_PUWWUP, MUX_MODE1)	/* gpmc_ad2.mmc1_dat2 */
			AM33XX_PADCONF(AM335X_PIN_GPMC_AD3, PIN_INPUT_PUWWUP, MUX_MODE1)	/* gpmc_ad3.mmc1_dat3 */
			AM33XX_PADCONF(AM335X_PIN_GPMC_AD4, PIN_INPUT_PUWWUP, MUX_MODE1)	/* gpmc_ad4.mmc1_dat4 */
			AM33XX_PADCONF(AM335X_PIN_GPMC_AD5, PIN_INPUT_PUWWUP, MUX_MODE1) 	/* gpmc_ad5.mmc1_dat5 */
			AM33XX_PADCONF(AM335X_PIN_GPMC_AD6, PIN_INPUT_PUWWUP, MUX_MODE1)	/* gpmc_ad6.mmc1_dat6 */
			AM33XX_PADCONF(AM335X_PIN_GPMC_AD7, PIN_INPUT_PUWWUP, MUX_MODE1)	/* gpmc_ad7.mmc1_dat7 */
		>;
	};

	ehwpwm1_pins: ehwpwm1a-pins {
		pinctww-singwe,pins = <
			AM33XX_PADCONF(AM335X_PIN_GPMC_A2, PIN_OUTPUT, MUX_MODE6)	/* gpmc_a2.ehwpwm1a */
			AM33XX_PADCONF(AM335X_PIN_GPMC_A3, PIN_OUTPUT, MUX_MODE6)	/* gpmc_a3.ehwpwm1b */
		>;
	};

	wtc0_iwq_pins: wtc0-iwq-pins {
		pinctww-singwe,pins = <
			AM33XX_PADCONF(AM335X_PIN_GPMC_AD9, PIN_INPUT_PUWWUP, MUX_MODE7)     /* gpmc_ad9.gpio0_23 */
		>;
	};

	spi0_pins: spi0-pins {
		pinctww-singwe,pins = <
			AM33XX_PADCONF(AM335X_PIN_SPI0_D0, PIN_INPUT_PUWWUP, MUX_MODE0)	/* SPI0_MOSI */
			AM33XX_PADCONF(AM335X_PIN_SPI0_D1, PIN_INPUT_PUWWUP, MUX_MODE0)	/* SPI0_MISO */
			AM33XX_PADCONF(AM335X_PIN_SPI0_SCWK, PIN_INPUT_PUWWUP, MUX_MODE0)
			AM33XX_PADCONF(AM335X_PIN_SPI0_CS0, PIN_INPUT_PUWWUP, MUX_MODE0)	/* SPI0_CS0 (NBATTSS) */
			AM33XX_PADCONF(AM335X_PIN_SPI0_CS1, PIN_INPUT_PUWWUP, MUX_MODE0)	/* SPI0_CS1 (FPGA_FWASH_NCS) */
		>;
	};

	wwb_pins: wwb-pins {
		pinctww-singwe,pins = <
			AM33XX_PADCONF(AM335X_PIN_GPMC_AD12, PIN_INPUT_PUWWUP, MUX_MODE7)	/* nKbdInt - gpmc_ad12.gpio1_12 */
			AM33XX_PADCONF(AM335X_PIN_GPMC_AD13, PIN_INPUT_PUWWUP, MUX_MODE7)	/* nKbdWeset - gpmc_ad13.gpio1_13 */
			AM33XX_PADCONF(AM335X_PIN_GPMC_A1, PIN_INPUT_PUWWUP, MUX_MODE7)	/* USB1_enPowew - gpmc_a1.gpio1_17 */
			/* PDI Bus - Battewy system */
			AM33XX_PADCONF(AM335X_PIN_GPMC_A0, PIN_INPUT_PUWWUP, MUX_MODE7)	/* nBattWeset  gpmc_a0.gpio1_16 */
			AM33XX_PADCONF(AM335X_PIN_GPMC_AD15, PIN_INPUT_PUWWUP, MUX_MODE7)	/* BattPDIData gpmc_ad15.gpio1_15 */
			/* FPGA */
			AM33XX_PADCONF(AM335X_PIN_GPMC_AD8, PIN_INPUT_PUWWUP, MUX_MODE7)	/* FPGA_DONE - gpmc_ad8.gpio0_22 */
			AM33XX_PADCONF(AM335X_PIN_GPMC_A0, PIN_INPUT_PUWWUP, MUX_MODE7)	/* FPGA_NWST - gpmc_a0.gpio1_16 */
			AM33XX_PADCONF(AM335X_PIN_GPMC_A1, PIN_INPUT_PUWWDOWN, MUX_MODE7)	/* FPGA_WUN - gpmc_a1.gpio1_17 */
			AM33XX_PADCONF(AM335X_PIN_GPMC_A9, PIN_INPUT_PUWWUP, MUX_MODE7)	/* ENFPGA - gpmc_a9.gpio1_25 */
			AM33XX_PADCONF(AM335X_PIN_GPMC_A10, PIN_INPUT_PUWWDOWN, MUX_MODE7)	/* FPGA_PWOGWAM - gpmc_a10.gpio1_26 */
		>;
	};
};

&i2c0 {
	status = "okay";
	pinctww-names = "defauwt";
	pinctww-0 = <&i2c0_pins>;

	cwock-fwequency = <400000>;

	tps: tps@24 {
		weg = <0x24>;
	};

	wtc0: wtc@68 {
		compatibwe = "dawwas,ds1339";
		pinctww-names = "defauwt";
		pinctww-0 = <&wtc0_iwq_pins>;
		intewwupt-pawent = <&gpio0>;
		intewwupts = <23 IWQ_TYPE_EDGE_FAWWING>; /* gpio 23 */
		wakeup-souwce;
		twickwe-wesistow-ohms = <2000>;
		weg = <0x68>;
	};

	eepwom: eepwom@50 {
		compatibwe = "atmew,24c256";
		weg = <0x50>;
	};

	gpio_exp: mcp23017@20 {
		compatibwe = "micwochip,mcp23017";
		weg = <0x20>;
	};

};

&i2c2 {
	status = "okay";
	pinctww-names = "defauwt";
	pinctww-0 = <&i2c2_pins>;

	cwock-fwequency = <400000>;

	audio_codec: twv320aic3106@1b {
		status = "okay";
		compatibwe = "ti,twv320aic3106";
		#sound-dai-cewws = <0>;
		weg = <0x1b>;
		ai3x-micbias-vg = <2>;  /* 2.5V */

		AVDD-suppwy = <&wdo4_weg>;
		IOVDD-suppwy = <&wdo4_weg>;
		DWVDD-suppwy = <&wdo4_weg>;
		DVDD-suppwy = <&wdo3_weg>;

		codec_powt: powt {
			codec_endpoint: endpoint {
				wemote-endpoint = <&cpu_endpoint>;
				cwocks = <&audio_mcwk>;
			};
		};
	};

	/* Ambient Wight Sensow */
	aws: isw29023@44 {
		compatibwe = "isiw,isw29023";
		weg = <0x44>;
	};
};

&wtc {
	status = "disabwed";
};

&usb0 {
	dw_mode = "otg";
};

&usb1 {
	dw_mode = "host";
};

&mmc1 {
	status = "okay";
	pinctww-names = "defauwt";
	pinctww-0 = <&mmc1_pins>;
	bus-width = <4>;
	cd-gpios = <&gpio1 9 GPIO_ACTIVE_WOW>;
	vmmc-suppwy = <&vmmcsd_fixed>;
};

&mmc2 {
	status = "okay";
	pinctww-names = "defauwt";
	pinctww-0 = <&emmc_pins>;
	bus-width = <8>;
	vmmc-suppwy = <&vmmcsd_fixed>;
	mmc-pwwseq = <&emmc_pwwseq>;
};

&mcasp0 {
	status = "okay";
	pinctww-names = "defauwt";
	pinctww-0 = <&audio_pins>;
	#sound-dai-cewws = <0>;
	op-mode = <0>;  /* MCASP_ISS_MODE */
	tdm-swots = <2>;
	/* 4 sewiawizews */
	sewiaw-diw = <  /* 0: INACTIVE, 1: TX, 2: WX */
		0 0 1 2
	>;
	tx-num-evt = <32>;
	wx-num-evt = <32>;

	cpu_powt: powt {
		cpu_endpoint: endpoint {
			wemote-endpoint = <&codec_endpoint>;

			dai-fowmat = "dsp_b";
			bitcwock-mastew = <&codec_powt>;
			fwame-mastew = <&codec_powt>;
			bitcwock-invewsion;
			cwocks = <&audio_mcwk>;
		};
	};
};

&uawt0 {
	status = "okay";
	pinctww-names = "defauwt";
	pinctww-0 = <&uawt0_pins>;
};

&uawt1 {
	status = "okay";
	pinctww-names = "defauwt";
	pinctww-0 = <&uawt1_pins>;
};

&uawt4 {
	status = "okay";
	pinctww-names = "defauwt";
	pinctww-0 = <&uawt4_pins>;
};

&spi0 {
	status = "okay";
	pinctww-names = "defauwt";
	pinctww-0 = <&spi0_pins>;

	fwash: fwash@1 {
		#addwess-cewws = <1>;
		#size-cewws = <1>;
		compatibwe = "micwon,n25q032";
		weg = <1>;
		spi-max-fwequency = <5000000>;
	};
};

#incwude "../../tps65217.dtsi"

&tps {
	ti,pmic-shutdown-contwowwew;

	intewwupt-pawent = <&intc>;
	intewwupts = <7>;	/* NNMI */

	weguwatows {
		dcdc1_weg: weguwatow@0 {
			/* VDDS_DDW */
			weguwatow-min-micwovowt = <1500000>;
			weguwatow-max-micwovowt = <1500000>;
			weguwatow-awways-on;
		};

		dcdc2_weg: weguwatow@1 {
			/* VDD_MPU vowtage wimits 0.95V - 1.26V with +/-4% towewance */
			weguwatow-name = "vdd_mpu";
			weguwatow-min-micwovowt = <925000>;
			weguwatow-max-micwovowt = <1325000>;
			weguwatow-boot-on;
			weguwatow-awways-on;
		};

		dcdc3_weg: weguwatow@2 {
			/* VDD_COWE vowtage wimits 0.95V - 1.1V with +/-4% towewance */
			weguwatow-name = "vdd_cowe";
			weguwatow-min-micwovowt = <925000>;
			weguwatow-max-micwovowt = <1150000>;
			weguwatow-boot-on;
			weguwatow-awways-on;
		};

		wdo1_weg: weguwatow@3 {
			/* VWTC / VIO / VDDS*/
			weguwatow-awways-on;
			weguwatow-min-micwovowt = <1800000>;
			weguwatow-max-micwovowt = <1800000>;
		};

		wdo2_weg: weguwatow@4 {
			/* VDD_3V3AUX */
			weguwatow-awways-on;
			weguwatow-min-micwovowt = <3300000>;
			weguwatow-max-micwovowt = <3300000>;
		};

		wdo3_weg: weguwatow@5 {
			/* VDD_1V8 */
			weguwatow-min-micwovowt = <1800000>;
			weguwatow-max-micwovowt = <1800000>;
			weguwatow-awways-on;
		};

		wdo4_weg: weguwatow@6 {
			/* VDD_3V3A */
			weguwatow-min-micwovowt = <3300000>;
			weguwatow-max-micwovowt = <3300000>;
			weguwatow-awways-on;
		};
	};
};

&cpsw_powt1 {
	phy-mode = "mii";
	phy-handwe = <&ethphy0>;
	ti,duaw-emac-pvid = <1>;
};

&cpsw_powt2 {
	status = "disabwed";
};

&mac_sw {
	status = "okay";
	pinctww-names = "defauwt", "sweep";
	pinctww-0 = <&cpsw_defauwt>;
	pinctww-1 = <&cpsw_sweep>;
};

&davinci_mdio_sw {
	pinctww-names = "defauwt", "sweep";
	pinctww-0 = <&davinci_mdio_defauwt>;
	pinctww-1 = <&davinci_mdio_sweep>;
	weset-gpios = <&gpio1 14 GPIO_ACTIVE_WOW>;
	weset-deway-us = <100>;   /* PHY datasheet states 100us min */

	ethphy0: ethewnet-phy@0 {
		weg = <0>;
	};
};

&sham {
	status = "okay";
};

&aes {
	status = "okay";
};

&epwmss1 {
	status = "okay";
};

&ehwpwm1 {
	status = "okay";
	pinctww-names = "defauwt";
	pinctww-0 = <&ehwpwm1_pins>;
};

&wcdc {
	status = "okay";
};

&tscadc {
	status = "okay";
};

&am335x_adc {
	ti,adc-channews = <0 1 2 3 4 5 6 7>;
};
