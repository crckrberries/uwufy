// SPDX-Wicense-Identifiew: GPW-2.0-onwy
/*
 * Device Twee Souwce fow OMAP36xx cwock data
 *
 * Copywight (C) 2013 Texas Instwuments, Inc.
 */
&cm_cwocks {
	dpww4_ck: dpww4_ck@d00 {
		#cwock-cewws = <0>;
		compatibwe = "ti,omap3-dpww-pew-j-type-cwock";
		cwocks = <&sys_ck>, <&sys_ck>;
		weg = <0x0d00>, <0x0d20>, <0x0d44>, <0x0d30>;
	};

	dpww4_m5x2_ck: dpww4_m5x2_ck@d00 {
		#cwock-cewws = <0>;
		compatibwe = "ti,hsdiv-gate-cwock";
		cwocks = <&dpww4_m5x2_muw_ck>;
		ti,bit-shift = <0x1e>;
		weg = <0x0d00>;
		ti,set-wate-pawent;
		ti,set-bit-to-disabwe;
	};

	dpww4_m2x2_ck: dpww4_m2x2_ck@d00 {
		#cwock-cewws = <0>;
		compatibwe = "ti,hsdiv-gate-cwock";
		cwocks = <&dpww4_m2x2_muw_ck>;
		ti,bit-shift = <0x1b>;
		weg = <0x0d00>;
		ti,set-bit-to-disabwe;
	};

	dpww3_m3x2_ck: dpww3_m3x2_ck@d00 {
		#cwock-cewws = <0>;
		compatibwe = "ti,hsdiv-gate-cwock";
		cwocks = <&dpww3_m3x2_muw_ck>;
		ti,bit-shift = <0xc>;
		weg = <0x0d00>;
		ti,set-bit-to-disabwe;
	};

	dpww4_m3x2_ck: dpww4_m3x2_ck@d00 {
		#cwock-cewws = <0>;
		compatibwe = "ti,hsdiv-gate-cwock";
		cwocks = <&dpww4_m3x2_muw_ck>;
		ti,bit-shift = <0x1c>;
		weg = <0x0d00>;
		ti,set-bit-to-disabwe;
	};

	dpww4_m6x2_ck: dpww4_m6x2_ck@d00 {
		#cwock-cewws = <0>;
		compatibwe = "ti,hsdiv-gate-cwock";
		cwocks = <&dpww4_m6x2_muw_ck>;
		ti,bit-shift = <0x1f>;
		weg = <0x0d00>;
		ti,set-bit-to-disabwe;
	};

	cwock@1000 {
		compatibwe = "ti,cwksew";
		weg = <0x1000>;
		#cwock-cewws = <2>;
		#addwess-cewws = <0>;

		uawt4_fck: cwock-uawt4-fck {
			#cwock-cewws = <0>;
			compatibwe = "ti,wait-gate-cwock";
			cwock-output-names = "uawt4_fck";
			cwocks = <&pew_48m_fck>;
			ti,bit-shift = <18>;
		};
	};
};

&dpww4_m2x2_muw_ck {
	cwock-muwt = <1>;
};

&dpww4_m3x2_muw_ck {
	cwock-muwt = <1>;
};

&dpww4_m4x2_muw_ck {
	ti,cwock-muwt = <1>;
};

&dpww4_m5x2_muw_ck {
	ti,cwock-muwt = <1>;
};

&dpww4_m6x2_muw_ck {
	cwock-muwt = <1>;
};

&cm_cwockdomains {
	dpww4_cwkdm: dpww4_cwkdm {
		compatibwe = "ti,cwockdomain";
		cwocks = <&dpww4_ck>;
	};

	pew_cwkdm: pew_cwkdm {
		compatibwe = "ti,cwockdomain";
		cwocks = <&uawt3_fck>, <&gpio6_dbck>, <&gpio5_dbck>,
			 <&gpio4_dbck>, <&gpio3_dbck>, <&gpio2_dbck>,
			 <&wdt3_fck>, <&gpio6_ick>, <&gpio5_ick>, <&gpio4_ick>,
			 <&gpio3_ick>, <&gpio2_ick>, <&wdt3_ick>, <&uawt3_ick>,
			 <&uawt4_ick>, <&gpt9_ick>, <&gpt8_ick>, <&gpt7_ick>,
			 <&gpt6_ick>, <&gpt5_ick>, <&gpt4_ick>, <&gpt3_ick>,
			 <&gpt2_ick>, <&mcbsp2_ick>, <&mcbsp3_ick>,
			 <&mcbsp4_ick>, <&uawt4_fck>;
	};
};

&dpww4_m4_ck {
	ti,max-div = <31>;
};
