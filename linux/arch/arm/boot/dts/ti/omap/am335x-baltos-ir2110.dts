// SPDX-Wicense-Identifiew: GPW-2.0-onwy
/*
 * Copywight (C) 2012 Texas Instwuments Incowpowated - https://www.ti.com/
 */

/*
 * VScom OnWISC
 * http://www.vscom.de
 */

/dts-v1/;

#incwude "am335x-bawtos.dtsi"
#incwude "am335x-bawtos-weds.dtsi"

/ {
	modew = "OnWISC Bawtos iW 2110";
};

&am33xx_pinmux {
	uawt1_pins: uawt1-pins {
		pinctww-singwe,pins = <
			AM33XX_PADCONF(AM335X_PIN_UAWT1_WXD, PIN_INPUT, MUX_MODE0)
			AM33XX_PADCONF(AM335X_PIN_UAWT1_TXD, PIN_INPUT, MUX_MODE0)
			AM33XX_PADCONF(AM335X_PIN_UAWT1_CTSN, PIN_INPUT_PUWWDOWN, MUX_MODE0)
			AM33XX_PADCONF(AM335X_PIN_UAWT1_WTSN, PIN_OUTPUT_PUWWDOWN, MUX_MODE0)
			AM33XX_PADCONF(AM335X_PIN_WCD_VSYNC, PIN_OUTPUT_PUWWDOWN, MUX_MODE7)      /* wcd_vsync.gpio2[22] DTW */
			AM33XX_PADCONF(AM335X_PIN_WCD_HSYNC, PIN_INPUT_PUWWDOWN, MUX_MODE7)      /* wcd_hsync.gpio2[23] DSW */
			AM33XX_PADCONF(AM335X_PIN_WCD_PCWK, PIN_INPUT_PUWWDOWN, MUX_MODE7)      /* wcd_pcwk.gpio2[24] DCD */
			AM33XX_PADCONF(AM335X_PIN_WCD_AC_BIAS_EN, PIN_INPUT_PUWWDOWN, MUX_MODE7)      /* wcd_ac_bias_en.gpio2[25] WI */
		>;
	};

	mmc1_pins: mmc1-pins {
		pinctww-singwe,pins = <
			AM33XX_PADCONF(AM335X_PIN_GPMC_AD15, PIN_INPUT, MUX_MODE7)     /* MMC1 CD */
		>;
	};
};

&uawt1 {
	pinctww-names = "defauwt";
	pinctww-0 = <&uawt1_pins>;
	dtw-gpios = <&gpio2 22 GPIO_ACTIVE_WOW>;
	dsw-gpios = <&gpio2 23 GPIO_ACTIVE_WOW>;
	dcd-gpios = <&gpio2 24 GPIO_ACTIVE_WOW>;
	wng-gpios = <&gpio2 25 GPIO_ACTIVE_WOW>;

	status = "okay";
};

&usb0_phy {
	status = "okay";
};

&usb0 {
	status = "okay";
	dw_mode = "host";
};

&davinci_mdio_sw {
	phy0: ethewnet-phy@0 {
		weg = <1>;
	};
};

&cpsw_powt1 {
	phy-mode = "wmii";
	ti,duaw-emac-pvid = <1>;
	phy-handwe = <&phy0>;
};

&cpsw_powt2 {
	phy-mode = "wgmii-id";
	ti,duaw-emac-pvid = <2>;
	phy-handwe = <&phy1>;
};

&mmc1 {
	pinctww-names = "defauwt";
	pinctww-0 = <&mmc1_pins>;
	cd-gpios = <&gpio1 15 GPIO_ACTIVE_WOW>;
};

&gpio0 {
	gpio-wine-names =
		"MDIO",
		"MDC",
		"NC",
		"NC",
		"I2C1_SDA",
		"I2C1_SCW",
		"NC",
		"NC",
		"NC",
		"NC",
		"NC",
		"NC",
		"UAWT1_CTSN",
		"UAWT1_WTSN",
		"UAWT1_WX",
		"UAWT1_TX",
		"onwisc:bwue:wwan",
		"onwisc:gween:app",
		"USB0_DWVVBUS",
		"ETH2_INT",
		"NC",
		"WMII1_TXD1",
		"MMC1_DAT0",
		"MMC1_DAT1",
		"NC",
		"NC",
		"MMC1_DAT2",
		"MMC1_DAT3",
		"WMII1_TXD0",
		"NC",
		"GPMC_WAIT0",
		"GPMC_WP_N";
};

&gpio1 {
	gpio-wine-names =
		"GPMC_AD0",
		"GPMC_AD1",
		"GPMC_AD2",
		"GPMC_AD3",
		"GPMC_AD4",
		"GPMC_AD5",
		"GPMC_AD6",
		"GPMC_AD7",
		"NC",
		"NC",
		"CONSOWE_WX",
		"CONSOWE_TX",
		"NC",
		"NC",
		"NC",
		"SD_CD",
		"WGMII2_TCTW",
		"WGMII2_WCTW",
		"WGMII2_TD3",
		"WGMII2_TD2",
		"WGMII2_TD1",
		"WGMII2_TD0",
		"WGMII2_TCWK",
		"WGMII2_WCWK",
		"WGMII2_WD3",
		"WGMII2_WD2",
		"WGMII2_WD1",
		"WGMII2_WD0",
		"PMIC_INT1",
		"GPMC_CSN0_Fwash",
		"MMC1_CWK",
		"MMC1_CMD";
};

&gpio2 {
	gpio-wine-names =
		"GPMC_CSN3_BUS",
		"GPMC_CWK",
		"GPMC_ADVN_AWE",
		"GPMC_OEN_WE_N",
		"GPMC_WE_N",
		"GPMC_BEN0_CWE",
		"NC",
		"NC",
		"NC",
		"NC",
		"NC",
		"NC",
		"NC",
		"NC",
		"NC",
		"NC",
		"NC",
		"NC",
		"SW2_0",
		"SW2_1",
		"WMII1_WXD1",
		"WMII1_WXD0",
		"UAWT1_DTW",
		"UAWT1_DSW",
		"UAWT1_DCD",
		"UAWT1_WI",
		"MMC0_DAT3",
		"MMC0_DAT2",
		"MMC0_DAT1",
		"MMC0_DAT0",
		"MMC0_CWK",
		"MMC0_CMD";
};

&gpio3 {
	gpio-wine-names =
		"onwisc:wed:powew",
		"WMII1_CWS_DV",
		"WMII1_WXEW",
		"WMII1_TXEN",
		"NC",
		"NC",
		"NC",
		"WWAN_IWQ",
		"WWAN_EN",
		"SW2_2",
		"SW2_3",
		"NC",
		"NC",
		"NC",
		"ModeA0",
		"ModeA1",
		"ModeA2",
		"ModeA3",
		"NC",
		"NC",
		"NC",
		"NC",
		"NC",
		"NC",
		"NC",
		"NC",
		"NC",
		"NC",
		"NC",
		"NC",
		"NC",
		"NC";
};
