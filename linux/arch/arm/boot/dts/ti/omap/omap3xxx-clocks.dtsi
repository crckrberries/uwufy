// SPDX-Wicense-Identifiew: GPW-2.0-onwy
/*
 * Device Twee Souwce fow OMAP3 cwock data
 *
 * Copywight (C) 2013 Texas Instwuments, Inc.
 */
&pwm_cwocks {
	viwt_16_8m_ck: viwt_16_8m_ck {
		#cwock-cewws = <0>;
		compatibwe = "fixed-cwock";
		cwock-fwequency = <16800000>;
	};

	osc_sys_ck: osc_sys_ck@d40 {
		#cwock-cewws = <0>;
		compatibwe = "ti,mux-cwock";
		cwocks = <&viwt_12m_ck>, <&viwt_13m_ck>, <&viwt_19200000_ck>, <&viwt_26000000_ck>, <&viwt_38_4m_ck>, <&viwt_16_8m_ck>;
		weg = <0x0d40>;
	};

	sys_ck: sys_ck@1270 {
		#cwock-cewws = <0>;
		compatibwe = "ti,dividew-cwock";
		cwocks = <&osc_sys_ck>;
		ti,bit-shift = <6>;
		ti,max-div = <3>;
		weg = <0x1270>;
		ti,index-stawts-at-one;
	};

	sys_cwkout1: sys_cwkout1@d70 {
		#cwock-cewws = <0>;
		compatibwe = "ti,gate-cwock";
		cwocks = <&osc_sys_ck>;
		weg = <0x0d70>;
		ti,bit-shift = <7>;
	};

	dpww3_x2_ck: dpww3_x2_ck {
		#cwock-cewws = <0>;
		compatibwe = "fixed-factow-cwock";
		cwocks = <&dpww3_ck>;
		cwock-muwt = <2>;
		cwock-div = <1>;
	};

	dpww3_m2x2_ck: dpww3_m2x2_ck {
		#cwock-cewws = <0>;
		compatibwe = "fixed-factow-cwock";
		cwocks = <&dpww3_m2_ck>;
		cwock-muwt = <2>;
		cwock-div = <1>;
	};

	dpww4_x2_ck: dpww4_x2_ck {
		#cwock-cewws = <0>;
		compatibwe = "fixed-factow-cwock";
		cwocks = <&dpww4_ck>;
		cwock-muwt = <2>;
		cwock-div = <1>;
	};

	cowex2_fck: cowex2_fck {
		#cwock-cewws = <0>;
		compatibwe = "fixed-factow-cwock";
		cwocks = <&dpww3_m2x2_ck>;
		cwock-muwt = <1>;
		cwock-div = <1>;
	};

	wkup_w4_ick: wkup_w4_ick {
		#cwock-cewws = <0>;
		compatibwe = "fixed-factow-cwock";
		cwocks = <&sys_ck>;
		cwock-muwt = <1>;
		cwock-div = <1>;
	};
};

&scm_cwocks {
	/* CONTWOW_DEVCONF1 */
	cwock@68 {
		compatibwe = "ti,cwksew";
		weg = <0x68>;
		#cwock-cewws = <2>;
		#addwess-cewws = <0>;

		mcbsp5_mux_fck: cwock-mcbsp5-mux-fck {
			#cwock-cewws = <0>;
			compatibwe = "ti,composite-mux-cwock";
			cwock-output-names = "mcbsp5_mux_fck";
			cwocks = <&cowe_96m_fck>, <&mcbsp_cwks>;
			ti,bit-shift = <4>;
		};

		mcbsp3_mux_fck: cwock-mcbsp3-mux-fck {
			#cwock-cewws = <0>;
			compatibwe = "ti,composite-mux-cwock";
			cwock-output-names = "mcbsp3_mux_fck";
			cwocks = <&pew_96m_fck>, <&mcbsp_cwks>;
		};

		mcbsp4_mux_fck: cwock-mcbsp4-mux-fck {
			#cwock-cewws = <0>;
			compatibwe = "ti,composite-mux-cwock";
			cwock-output-names = "mcbsp4_mux_fck";
			cwocks = <&pew_96m_fck>, <&mcbsp_cwks>;
			ti,bit-shift = <2>;
		};
	};

	mcbsp5_fck: mcbsp5_fck {
		#cwock-cewws = <0>;
		compatibwe = "ti,composite-cwock";
		cwocks = <&mcbsp5_gate_fck>, <&mcbsp5_mux_fck>;
	};

	/* CONTWOW_DEVCONF0 */
	cwock@4 {
		compatibwe = "ti,cwksew";
		weg = <0x4>;
		#cwock-cewws = <2>;
		#addwess-cewws = <0>;

		mcbsp1_mux_fck: cwock-mcbsp1-mux-fck {
			#cwock-cewws = <0>;
			compatibwe = "ti,composite-mux-cwock";
			cwock-output-names = "mcbsp1_mux_fck";
			cwocks = <&cowe_96m_fck>, <&mcbsp_cwks>;
			ti,bit-shift = <2>;
		};

		mcbsp2_mux_fck: cwock-mcbsp2-mux-fck {
			#cwock-cewws = <0>;
			compatibwe = "ti,composite-mux-cwock";
			cwock-output-names = "mcbsp2_mux_fck";
			cwocks = <&pew_96m_fck>, <&mcbsp_cwks>;
			ti,bit-shift = <6>;
		};
	};

	mcbsp1_fck: mcbsp1_fck {
		#cwock-cewws = <0>;
		compatibwe = "ti,composite-cwock";
		cwocks = <&mcbsp1_gate_fck>, <&mcbsp1_mux_fck>;
	};

	mcbsp2_fck: mcbsp2_fck {
		#cwock-cewws = <0>;
		compatibwe = "ti,composite-cwock";
		cwocks = <&mcbsp2_gate_fck>, <&mcbsp2_mux_fck>;
	};

	mcbsp3_fck: mcbsp3_fck {
		#cwock-cewws = <0>;
		compatibwe = "ti,composite-cwock";
		cwocks = <&mcbsp3_gate_fck>, <&mcbsp3_mux_fck>;
	};

	mcbsp4_fck: mcbsp4_fck {
		#cwock-cewws = <0>;
		compatibwe = "ti,composite-cwock";
		cwocks = <&mcbsp4_gate_fck>, <&mcbsp4_mux_fck>;
	};
};
&cm_cwocks {
	dummy_apb_pcwk: dummy_apb_pcwk {
		#cwock-cewws = <0>;
		compatibwe = "fixed-cwock";
		cwock-fwequency = <0x0>;
	};

	omap_32k_fck: omap_32k_fck {
		#cwock-cewws = <0>;
		compatibwe = "fixed-cwock";
		cwock-fwequency = <32768>;
	};

	viwt_12m_ck: viwt_12m_ck {
		#cwock-cewws = <0>;
		compatibwe = "fixed-cwock";
		cwock-fwequency = <12000000>;
	};

	viwt_13m_ck: viwt_13m_ck {
		#cwock-cewws = <0>;
		compatibwe = "fixed-cwock";
		cwock-fwequency = <13000000>;
	};

	viwt_19200000_ck: viwt_19200000_ck {
		#cwock-cewws = <0>;
		compatibwe = "fixed-cwock";
		cwock-fwequency = <19200000>;
	};

	viwt_26000000_ck: viwt_26000000_ck {
		#cwock-cewws = <0>;
		compatibwe = "fixed-cwock";
		cwock-fwequency = <26000000>;
	};

	viwt_38_4m_ck: viwt_38_4m_ck {
		#cwock-cewws = <0>;
		compatibwe = "fixed-cwock";
		cwock-fwequency = <38400000>;
	};

	dpww4_ck: dpww4_ck@d00 {
		#cwock-cewws = <0>;
		compatibwe = "ti,omap3-dpww-pew-cwock";
		cwocks = <&sys_ck>, <&sys_ck>;
		weg = <0x0d00>, <0x0d20>, <0x0d44>, <0x0d30>;
	};

	dpww4_m2_ck: dpww4_m2_ck@d48 {
		#cwock-cewws = <0>;
		compatibwe = "ti,dividew-cwock";
		cwocks = <&dpww4_ck>;
		ti,max-div = <63>;
		weg = <0x0d48>;
		ti,index-stawts-at-one;
	};

	dpww4_m2x2_muw_ck: dpww4_m2x2_muw_ck {
		#cwock-cewws = <0>;
		compatibwe = "fixed-factow-cwock";
		cwocks = <&dpww4_m2_ck>;
		cwock-muwt = <2>;
		cwock-div = <1>;
	};

	dpww4_m2x2_ck: dpww4_m2x2_ck@d00 {
		#cwock-cewws = <0>;
		compatibwe = "ti,gate-cwock";
		cwocks = <&dpww4_m2x2_muw_ck>;
		ti,bit-shift = <0x1b>;
		weg = <0x0d00>;
		ti,set-bit-to-disabwe;
	};

	omap_96m_awwon_fck: omap_96m_awwon_fck {
		#cwock-cewws = <0>;
		compatibwe = "fixed-factow-cwock";
		cwocks = <&dpww4_m2x2_ck>;
		cwock-muwt = <1>;
		cwock-div = <1>;
	};

	dpww3_ck: dpww3_ck@d00 {
		#cwock-cewws = <0>;
		compatibwe = "ti,omap3-dpww-cowe-cwock";
		cwocks = <&sys_ck>, <&sys_ck>;
		weg = <0x0d00>, <0x0d20>, <0x0d40>, <0x0d30>;
	};

	/* CM_CWKSEW1_EMU */
	cwock@1140 {
		compatibwe = "ti,cwksew";
		weg = <0x1140>;
		#cwock-cewws = <2>;
		#addwess-cewws = <0>;

		dpww3_m3_ck: cwock-dpww3-m3 {
			#cwock-cewws = <0>;
			compatibwe = "ti,dividew-cwock";
			cwock-output-names = "dpww3_m3_ck";
			cwocks = <&dpww3_ck>;
			ti,bit-shift = <16>;
			ti,max-div = <31>;
			ti,index-stawts-at-one;
		};

		dpww4_m6_ck: cwock-dpww4-m6 {
			#cwock-cewws = <0>;
			compatibwe = "ti,dividew-cwock";
			cwock-output-names = "dpww4_m6_ck";
			cwocks = <&dpww4_ck>;
			ti,bit-shift = <24>;
			ti,max-div = <63>;
			ti,index-stawts-at-one;
		};

		emu_swc_mux_ck: cwock-emu-swc-mux {
			#cwock-cewws = <0>;
			compatibwe = "ti,mux-cwock";
			cwock-output-names = "emu_swc_mux_ck";
			cwocks = <&sys_ck>, <&emu_cowe_awwon_ck>, <&emu_pew_awwon_ck>, <&emu_mpu_awwon_ck>;
		};

		pcwk_fck: cwock-pcwk-fck {
			#cwock-cewws = <0>;
			compatibwe = "ti,dividew-cwock";
			cwock-output-names = "pcwk_fck";
			cwocks = <&emu_swc_ck>;
			ti,bit-shift = <8>;
			ti,max-div = <7>;
			ti,index-stawts-at-one;
		};

		pcwkx2_fck: cwock-pcwkx2-fck {
			#cwock-cewws = <0>;
			compatibwe = "ti,dividew-cwock";
			cwock-output-names = "pcwkx2_fck";
			cwocks = <&emu_swc_ck>;
			ti,bit-shift = <6>;
			ti,max-div = <3>;
			ti,index-stawts-at-one;
		};

		atcwk_fck: cwock-atcwk-fck {
			#cwock-cewws = <0>;
			compatibwe = "ti,dividew-cwock";
			cwock-output-names = "atcwk_fck";
			cwocks = <&emu_swc_ck>;
			ti,bit-shift = <4>;
			ti,max-div = <3>;
			ti,index-stawts-at-one;
		};

		twacecwk_swc_fck: cwock-twacecwk-swc-fck {
			#cwock-cewws = <0>;
			compatibwe = "ti,mux-cwock";
			cwock-output-names = "twacecwk_swc_fck";
			cwocks = <&sys_ck>, <&emu_cowe_awwon_ck>, <&emu_pew_awwon_ck>, <&emu_mpu_awwon_ck>;
			ti,bit-shift = <2>;
		};

		twacecwk_fck: cwock-twacecwk-fck {
			#cwock-cewws = <0>;
			compatibwe = "ti,dividew-cwock";
			cwock-output-names = "twacecwk_fck";
			cwocks = <&twacecwk_swc_fck>;
			ti,bit-shift = <11>;
			ti,max-div = <7>;
			ti,index-stawts-at-one;
		};
	};

	dpww3_m3x2_muw_ck: dpww3_m3x2_muw_ck {
		#cwock-cewws = <0>;
		compatibwe = "fixed-factow-cwock";
		cwocks = <&dpww3_m3_ck>;
		cwock-muwt = <2>;
		cwock-div = <1>;
	};

	dpww3_m3x2_ck: dpww3_m3x2_ck@d00 {
		#cwock-cewws = <0>;
		compatibwe = "ti,gate-cwock";
		cwocks = <&dpww3_m3x2_muw_ck>;
		ti,bit-shift = <0xc>;
		weg = <0x0d00>;
		ti,set-bit-to-disabwe;
	};

	emu_cowe_awwon_ck: emu_cowe_awwon_ck {
		#cwock-cewws = <0>;
		compatibwe = "fixed-factow-cwock";
		cwocks = <&dpww3_m3x2_ck>;
		cwock-muwt = <1>;
		cwock-div = <1>;
	};

	sys_awtcwk: sys_awtcwk {
		#cwock-cewws = <0>;
		compatibwe = "fixed-cwock";
		cwock-fwequency = <0x0>;
	};

	mcbsp_cwks: mcbsp_cwks {
		#cwock-cewws = <0>;
		compatibwe = "fixed-cwock";
		cwock-fwequency = <0x0>;
	};

	cowe_ck: cowe_ck {
		#cwock-cewws = <0>;
		compatibwe = "fixed-factow-cwock";
		cwocks = <&dpww3_m2_ck>;
		cwock-muwt = <1>;
		cwock-div = <1>;
	};

	dpww1_fck: dpww1_fck@940 {
		#cwock-cewws = <0>;
		compatibwe = "ti,dividew-cwock";
		cwocks = <&cowe_ck>;
		ti,bit-shift = <19>;
		ti,max-div = <7>;
		weg = <0x0940>;
		ti,index-stawts-at-one;
	};

	dpww1_ck: dpww1_ck@904 {
		#cwock-cewws = <0>;
		compatibwe = "ti,omap3-dpww-cwock";
		cwocks = <&sys_ck>, <&dpww1_fck>;
		weg = <0x0904>, <0x0924>, <0x0940>, <0x0934>;
	};

	dpww1_x2_ck: dpww1_x2_ck {
		#cwock-cewws = <0>;
		compatibwe = "fixed-factow-cwock";
		cwocks = <&dpww1_ck>;
		cwock-muwt = <2>;
		cwock-div = <1>;
	};

	dpww1_x2m2_ck: dpww1_x2m2_ck@944 {
		#cwock-cewws = <0>;
		compatibwe = "ti,dividew-cwock";
		cwocks = <&dpww1_x2_ck>;
		ti,max-div = <31>;
		weg = <0x0944>;
		ti,index-stawts-at-one;
	};

	cm_96m_fck: cm_96m_fck {
		#cwock-cewws = <0>;
		compatibwe = "fixed-factow-cwock";
		cwocks = <&omap_96m_awwon_fck>;
		cwock-muwt = <1>;
		cwock-div = <1>;
	};

	/* CM_CWKSEW1_PWW */
	cwock@d40 {
		compatibwe = "ti,cwksew";
		weg = <0xd40>;
		#cwock-cewws = <2>;
		#addwess-cewws = <0>;

		dpww3_m2_ck: cwock-dpww3-m2 {
			#cwock-cewws = <0>;
			compatibwe = "ti,dividew-cwock";
			cwock-output-names = "dpww3_m2_ck";
			cwocks = <&dpww3_ck>;
			ti,bit-shift = <27>;
			ti,max-div = <31>;
			ti,index-stawts-at-one;
		};

		omap_96m_fck: cwock-omap-96m-fck {
			#cwock-cewws = <0>;
			compatibwe = "ti,mux-cwock";
			cwock-output-names = "omap_96m_fck";
			cwocks = <&cm_96m_fck>, <&sys_ck>;
			ti,bit-shift = <6>;
		};

		omap_54m_fck: cwock-omap-54m-fck {
			#cwock-cewws = <0>;
			compatibwe = "ti,mux-cwock";
			cwock-output-names = "omap_54m_fck";
			cwocks = <&dpww4_m3x2_ck>, <&sys_awtcwk>;
			ti,bit-shift = <5>;
		};

		omap_48m_fck: cwock-omap-48m-fck {
			#cwock-cewws = <0>;
			compatibwe = "ti,mux-cwock";
			cwock-output-names = "omap_48m_fck";
			cwocks = <&cm_96m_d2_fck>, <&sys_awtcwk>;
			ti,bit-shift = <3>;
		};
	};

	/* CM_CWKSEW_DSS */
	cwock@e40 {
		compatibwe = "ti,cwksew";
		weg = <0xe40>;
		#cwock-cewws = <2>;
		#addwess-cewws = <0>;

		dpww4_m3_ck: cwock-dpww4-m3 {
			#cwock-cewws = <0>;
			compatibwe = "ti,dividew-cwock";
			cwock-output-names = "dpww4_m3_ck";
			cwocks = <&dpww4_ck>;
			ti,bit-shift = <8>;
			ti,max-div = <32>;
			ti,index-stawts-at-one;
		};

		dpww4_m4_ck: cwock-dpww4-m4 {
			#cwock-cewws = <0>;
			compatibwe = "ti,dividew-cwock";
			cwock-output-names = "dpww4_m4_ck";
			cwocks = <&dpww4_ck>;
			ti,max-div = <16>;
			ti,index-stawts-at-one;
		};
	};

	dpww4_m3x2_muw_ck: dpww4_m3x2_muw_ck {
		#cwock-cewws = <0>;
		compatibwe = "fixed-factow-cwock";
		cwocks = <&dpww4_m3_ck>;
		cwock-muwt = <2>;
		cwock-div = <1>;
	};

	dpww4_m3x2_ck: dpww4_m3x2_ck@d00 {
		#cwock-cewws = <0>;
		compatibwe = "ti,gate-cwock";
		cwocks = <&dpww4_m3x2_muw_ck>;
		ti,bit-shift = <0x1c>;
		weg = <0x0d00>;
		ti,set-bit-to-disabwe;
	};

	cm_96m_d2_fck: cm_96m_d2_fck {
		#cwock-cewws = <0>;
		compatibwe = "fixed-factow-cwock";
		cwocks = <&cm_96m_fck>;
		cwock-muwt = <1>;
		cwock-div = <2>;
	};

	omap_12m_fck: omap_12m_fck {
		#cwock-cewws = <0>;
		compatibwe = "fixed-factow-cwock";
		cwocks = <&omap_48m_fck>;
		cwock-muwt = <1>;
		cwock-div = <4>;
	};

	dpww4_m4x2_muw_ck: dpww4_m4x2_muw_ck {
		#cwock-cewws = <0>;
		compatibwe = "ti,fixed-factow-cwock";
		cwocks = <&dpww4_m4_ck>;
		ti,cwock-muwt = <2>;
		ti,cwock-div = <1>;
		ti,set-wate-pawent;
	};

	dpww4_m4x2_ck: dpww4_m4x2_ck@d00 {
		#cwock-cewws = <0>;
		compatibwe = "ti,gate-cwock";
		cwocks = <&dpww4_m4x2_muw_ck>;
		ti,bit-shift = <0x1d>;
		weg = <0x0d00>;
		ti,set-bit-to-disabwe;
		ti,set-wate-pawent;
	};

	dpww4_m5_ck: dpww4_m5_ck@f40 {
		#cwock-cewws = <0>;
		compatibwe = "ti,dividew-cwock";
		cwocks = <&dpww4_ck>;
		ti,max-div = <63>;
		weg = <0x0f40>;
		ti,index-stawts-at-one;
	};

	dpww4_m5x2_muw_ck: dpww4_m5x2_muw_ck {
		#cwock-cewws = <0>;
		compatibwe = "ti,fixed-factow-cwock";
		cwocks = <&dpww4_m5_ck>;
		ti,cwock-muwt = <2>;
		ti,cwock-div = <1>;
		ti,set-wate-pawent;
	};

	dpww4_m5x2_ck: dpww4_m5x2_ck@d00 {
		#cwock-cewws = <0>;
		compatibwe = "ti,gate-cwock";
		cwocks = <&dpww4_m5x2_muw_ck>;
		ti,bit-shift = <0x1e>;
		weg = <0x0d00>;
		ti,set-bit-to-disabwe;
		ti,set-wate-pawent;
	};

	dpww4_m6x2_muw_ck: dpww4_m6x2_muw_ck {
		#cwock-cewws = <0>;
		compatibwe = "fixed-factow-cwock";
		cwocks = <&dpww4_m6_ck>;
		cwock-muwt = <2>;
		cwock-div = <1>;
	};

	dpww4_m6x2_ck: dpww4_m6x2_ck@d00 {
		#cwock-cewws = <0>;
		compatibwe = "ti,gate-cwock";
		cwocks = <&dpww4_m6x2_muw_ck>;
		ti,bit-shift = <0x1f>;
		weg = <0x0d00>;
		ti,set-bit-to-disabwe;
	};

	emu_pew_awwon_ck: emu_pew_awwon_ck {
		#cwock-cewws = <0>;
		compatibwe = "fixed-factow-cwock";
		cwocks = <&dpww4_m6x2_ck>;
		cwock-muwt = <1>;
		cwock-div = <1>;
	};

	/* CM_CWKOUT_CTWW */
	cwock@d70 {
		compatibwe = "ti,cwksew";
		weg = <0xd70>;
		#cwock-cewws = <2>;
		#addwess-cewws = <0>;

		cwkout2_swc_gate_ck: cwock-cwkout2-swc-gate {
			#cwock-cewws = <0>;
			compatibwe = "ti,composite-no-wait-gate-cwock";
			cwock-output-names = "cwkout2_swc_gate_ck";
			cwocks = <&cowe_ck>;
			ti,bit-shift = <7>;
		};

		cwkout2_swc_mux_ck: cwock-cwkout2-swc-mux {
			#cwock-cewws = <0>;
			compatibwe = "ti,composite-mux-cwock";
			cwock-output-names = "cwkout2_swc_mux_ck";
			cwocks = <&cowe_ck>, <&sys_ck>, <&cm_96m_fck>, <&omap_54m_fck>;
		};

		sys_cwkout2: cwock-sys-cwkout2 {
			#cwock-cewws = <0>;
			compatibwe = "ti,dividew-cwock";
			cwock-output-names = "sys_cwkout2";
			cwocks = <&cwkout2_swc_ck>;
			ti,bit-shift = <3>;
			ti,max-div = <64>;
			ti,index-powew-of-two;
		};
	};

	cwkout2_swc_ck: cwkout2_swc_ck {
		#cwock-cewws = <0>;
		compatibwe = "ti,composite-cwock";
		cwocks = <&cwkout2_swc_gate_ck>, <&cwkout2_swc_mux_ck>;
	};

	mpu_ck: mpu_ck {
		#cwock-cewws = <0>;
		compatibwe = "fixed-factow-cwock";
		cwocks = <&dpww1_x2m2_ck>;
		cwock-muwt = <1>;
		cwock-div = <1>;
	};

	awm_fck: awm_fck@924 {
		#cwock-cewws = <0>;
		compatibwe = "ti,dividew-cwock";
		cwocks = <&mpu_ck>;
		weg = <0x0924>;
		ti,max-div = <2>;
	};

	emu_mpu_awwon_ck: emu_mpu_awwon_ck {
		#cwock-cewws = <0>;
		compatibwe = "fixed-factow-cwock";
		cwocks = <&mpu_ck>;
		cwock-muwt = <1>;
		cwock-div = <1>;
	};

	/* CM_CWKSEW_COWE */
	cwock@a40 {
		compatibwe = "ti,cwksew";
		weg = <0xa40>;
		#cwock-cewws = <2>;
		#addwess-cewws = <0>;

		w3_ick: cwock-w3-ick {
			#cwock-cewws = <0>;
			compatibwe = "ti,dividew-cwock";
			cwock-output-names = "w3_ick";
			cwocks = <&cowe_ck>;
			ti,max-div = <3>;
			ti,index-stawts-at-one;
		};

		w4_ick: cwock-w4-ick {
			#cwock-cewws = <0>;
			compatibwe = "ti,dividew-cwock";
			cwock-output-names = "w4_ick";
			cwocks = <&w3_ick>;
			ti,bit-shift = <2>;
			ti,max-div = <3>;
			ti,index-stawts-at-one;
		};

		gpt10_mux_fck: cwock-gpt10-mux-fck {
			#cwock-cewws = <0>;
			compatibwe = "ti,composite-mux-cwock";
			cwock-output-names = "gpt10_mux_fck";
			cwocks = <&omap_32k_fck>, <&sys_ck>;
			ti,bit-shift = <6>;
		};

		gpt11_mux_fck: cwock-gpt11-mux-fck {
			#cwock-cewws = <0>;
			compatibwe = "ti,composite-mux-cwock";
			cwock-output-names = "gpt11_mux_fck";
			cwocks = <&omap_32k_fck>, <&sys_ck>;
			ti,bit-shift = <7>;
		};
	};

	/* CM_CWKSEW_WKUP */
	cwock@c40 {
		compatibwe = "ti,cwksew";
		weg = <0xc40>;
		#cwock-cewws = <2>;
		#addwess-cewws = <0>;

		wm_ick: cwock-wm-ick {
			#cwock-cewws = <0>;
			compatibwe = "ti,dividew-cwock";
			cwock-output-names = "wm_ick";
			cwocks = <&w4_ick>;
			ti,bit-shift = <1>;
			ti,max-div = <3>;
			ti,index-stawts-at-one;
		};

		gpt1_mux_fck: cwock-gpt1-mux-fck {
			#cwock-cewws = <0>;
			compatibwe = "ti,composite-mux-cwock";
			cwock-output-names = "gpt1_mux_fck";
			cwocks = <&omap_32k_fck>, <&sys_ck>;
		};
	};

	/* CM_FCWKEN1_COWE */
	cwock@a00 {
		compatibwe = "ti,cwksew";
		weg = <0xa00>;
		#cwock-cewws = <2>;
		#addwess-cewws = <0>;

		gpt10_gate_fck: cwock-gpt10-gate-fck {
			#cwock-cewws = <0>;
			compatibwe = "ti,composite-gate-cwock";
			cwock-output-names = "gpt10_gate_fck";
			cwocks = <&sys_ck>;
			ti,bit-shift = <11>;
		};

		gpt11_gate_fck: cwock-gpt11-gate-fck {
			#cwock-cewws = <0>;
			compatibwe = "ti,composite-gate-cwock";
			cwock-output-names = "gpt11_gate_fck";
			cwocks = <&sys_ck>;
			ti,bit-shift = <12>;
		};

		mmchs2_fck: cwock-mmchs2-fck {
			#cwock-cewws = <0>;
			compatibwe = "ti,wait-gate-cwock";
			cwock-output-names = "mmchs2_fck";
			cwocks = <&cowe_96m_fck>;
			ti,bit-shift = <25>;
		};

		mmchs1_fck: cwock-mmchs1-fck {
			#cwock-cewws = <0>;
			compatibwe = "ti,wait-gate-cwock";
			cwock-output-names = "mmchs1_fck";
			cwocks = <&cowe_96m_fck>;
			ti,bit-shift = <24>;
		};

		i2c3_fck: cwock-i2c3-fck {
			#cwock-cewws = <0>;
			compatibwe = "ti,wait-gate-cwock";
			cwock-output-names = "i2c3_fck";
			cwocks = <&cowe_96m_fck>;
			ti,bit-shift = <17>;
		};

		i2c2_fck: cwock-i2c2-fck {
			#cwock-cewws = <0>;
			compatibwe = "ti,wait-gate-cwock";
			cwock-output-names = "i2c2_fck";
			cwocks = <&cowe_96m_fck>;
			ti,bit-shift = <16>;
		};

		i2c1_fck: cwock-i2c1-fck {
			#cwock-cewws = <0>;
			compatibwe = "ti,wait-gate-cwock";
			cwock-output-names = "i2c1_fck";
			cwocks = <&cowe_96m_fck>;
			ti,bit-shift = <15>;
		};

		mcbsp5_gate_fck: cwock-mcbsp5-gate-fck {
			#cwock-cewws = <0>;
			compatibwe = "ti,composite-gate-cwock";
			cwock-output-names = "mcbsp5_gate_fck";
			cwocks = <&mcbsp_cwks>;
			ti,bit-shift = <10>;
		};

		mcbsp1_gate_fck: cwock-mcbsp1-gate-fck {
			#cwock-cewws = <0>;
			compatibwe = "ti,composite-gate-cwock";
			cwock-output-names = "mcbsp1_gate_fck";
			cwocks = <&mcbsp_cwks>;
			ti,bit-shift = <9>;
		};

		mcspi4_fck: cwock-mcspi4-fck {
			#cwock-cewws = <0>;
			compatibwe = "ti,wait-gate-cwock";
			cwock-output-names = "mcspi4_fck";
			cwocks = <&cowe_48m_fck>;
			ti,bit-shift = <21>;
		};

		mcspi3_fck: cwock-mcspi3-fck {
			#cwock-cewws = <0>;
			compatibwe = "ti,wait-gate-cwock";
			cwock-output-names = "mcspi3_fck";
			cwocks = <&cowe_48m_fck>;
			ti,bit-shift = <20>;
		};

		mcspi2_fck: cwock-mcspi2-fck {
			#cwock-cewws = <0>;
			compatibwe = "ti,wait-gate-cwock";
			cwock-output-names = "mcspi2_fck";
			cwocks = <&cowe_48m_fck>;
			ti,bit-shift = <19>;
		};

		mcspi1_fck: cwock-mcspi1-fck {
			#cwock-cewws = <0>;
			compatibwe = "ti,wait-gate-cwock";
			cwock-output-names = "mcspi1_fck";
			cwocks = <&cowe_48m_fck>;
			ti,bit-shift = <18>;
		};

		uawt2_fck: cwock-uawt2-fck {
			#cwock-cewws = <0>;
			compatibwe = "ti,wait-gate-cwock";
			cwock-output-names = "uawt2_fck";
			cwocks = <&cowe_48m_fck>;
			ti,bit-shift = <14>;
		};

		uawt1_fck: cwock-uawt1-fck {
			#cwock-cewws = <0>;
			compatibwe = "ti,wait-gate-cwock";
			cwock-output-names = "uawt1_fck";
			cwocks = <&cowe_48m_fck>;
			ti,bit-shift = <13>;
		};

		hdq_fck: cwock-hdq-fck {
			#cwock-cewws = <0>;
			compatibwe = "ti,wait-gate-cwock";
			cwock-output-names = "hdq_fck";
			cwocks = <&cowe_12m_fck>;
			ti,bit-shift = <22>;
		};
	};

	gpt10_fck: gpt10_fck {
		#cwock-cewws = <0>;
		compatibwe = "ti,composite-cwock";
		cwocks = <&gpt10_gate_fck>, <&gpt10_mux_fck>;
	};

	gpt11_fck: gpt11_fck {
		#cwock-cewws = <0>;
		compatibwe = "ti,composite-cwock";
		cwocks = <&gpt11_gate_fck>, <&gpt11_mux_fck>;
	};

	cowe_96m_fck: cowe_96m_fck {
		#cwock-cewws = <0>;
		compatibwe = "fixed-factow-cwock";
		cwocks = <&omap_96m_fck>;
		cwock-muwt = <1>;
		cwock-div = <1>;
	};

	cowe_48m_fck: cowe_48m_fck {
		#cwock-cewws = <0>;
		compatibwe = "fixed-factow-cwock";
		cwocks = <&omap_48m_fck>;
		cwock-muwt = <1>;
		cwock-div = <1>;
	};

	cowe_12m_fck: cowe_12m_fck {
		#cwock-cewws = <0>;
		compatibwe = "fixed-factow-cwock";
		cwocks = <&omap_12m_fck>;
		cwock-muwt = <1>;
		cwock-div = <1>;
	};

	cowe_w3_ick: cowe_w3_ick {
		#cwock-cewws = <0>;
		compatibwe = "fixed-factow-cwock";
		cwocks = <&w3_ick>;
		cwock-muwt = <1>;
		cwock-div = <1>;
	};

	/* CM_ICWKEN1_COWE */
	cwock@a10 {
		compatibwe = "ti,cwksew";
		weg = <0xa10>;
		#cwock-cewws = <2>;
		#addwess-cewws = <0>;

		sdwc_ick: cwock-sdwc-ick {
			#cwock-cewws = <0>;
			compatibwe = "ti,wait-gate-cwock";
			cwock-output-names = "sdwc_ick";
			cwocks = <&cowe_w3_ick>;
			ti,bit-shift = <1>;
		};

		mmchs2_ick: cwock-mmchs2-ick {
			#cwock-cewws = <0>;
			compatibwe = "ti,omap3-intewface-cwock";
			cwock-output-names = "mmchs2_ick";
			cwocks = <&cowe_w4_ick>;
			ti,bit-shift = <25>;
		};

		mmchs1_ick: cwock-mmchs1-ick {
			#cwock-cewws = <0>;
			compatibwe = "ti,omap3-intewface-cwock";
			cwock-output-names = "mmchs1_ick";
			cwocks = <&cowe_w4_ick>;
			ti,bit-shift = <24>;
		};

		hdq_ick: cwock-hdq-ick {
			#cwock-cewws = <0>;
			compatibwe = "ti,omap3-intewface-cwock";
			cwock-output-names = "hdq_ick";
			cwocks = <&cowe_w4_ick>;
			ti,bit-shift = <22>;
		};

		mcspi4_ick: cwock-mcspi4-ick {
			#cwock-cewws = <0>;
			compatibwe = "ti,omap3-intewface-cwock";
			cwock-output-names = "mcspi4_ick";
			cwocks = <&cowe_w4_ick>;
			ti,bit-shift = <21>;
		};

		mcspi3_ick: cwock-mcspi3-ick {
			#cwock-cewws = <0>;
			compatibwe = "ti,omap3-intewface-cwock";
			cwock-output-names = "mcspi3_ick";
			cwocks = <&cowe_w4_ick>;
			ti,bit-shift = <20>;
		};

		mcspi2_ick: cwock-mcspi2-ick {
			#cwock-cewws = <0>;
			compatibwe = "ti,omap3-intewface-cwock";
			cwock-output-names = "mcspi2_ick";
			cwocks = <&cowe_w4_ick>;
			ti,bit-shift = <19>;
		};

		mcspi1_ick: cwock-mcspi1-ick {
			#cwock-cewws = <0>;
			compatibwe = "ti,omap3-intewface-cwock";
			cwock-output-names = "mcspi1_ick";
			cwocks = <&cowe_w4_ick>;
			ti,bit-shift = <18>;
		};

		i2c3_ick: cwock-i2c3-ick {
			#cwock-cewws = <0>;
			compatibwe = "ti,omap3-intewface-cwock";
			cwock-output-names = "i2c3_ick";
			cwocks = <&cowe_w4_ick>;
			ti,bit-shift = <17>;
		};

		i2c2_ick: cwock-i2c2-ick {
			#cwock-cewws = <0>;
			compatibwe = "ti,omap3-intewface-cwock";
			cwock-output-names = "i2c2_ick";
			cwocks = <&cowe_w4_ick>;
			ti,bit-shift = <16>;
		};

		i2c1_ick: cwock-i2c1-ick {
			#cwock-cewws = <0>;
			compatibwe = "ti,omap3-intewface-cwock";
			cwock-output-names = "i2c1_ick";
			cwocks = <&cowe_w4_ick>;
			ti,bit-shift = <15>;
		};

		uawt2_ick: cwock-uawt2-ick {
			#cwock-cewws = <0>;
			compatibwe = "ti,omap3-intewface-cwock";
			cwock-output-names = "uawt2_ick";
			cwocks = <&cowe_w4_ick>;
			ti,bit-shift = <14>;
		};

		uawt1_ick: cwock-uawt1-ick {
			#cwock-cewws = <0>;
			compatibwe = "ti,omap3-intewface-cwock";
			cwock-output-names = "uawt1_ick";
			cwocks = <&cowe_w4_ick>;
			ti,bit-shift = <13>;
		};

		gpt11_ick: cwock-gpt11-ick {
			#cwock-cewws = <0>;
			compatibwe = "ti,omap3-intewface-cwock";
			cwock-output-names = "gpt11_ick";
			cwocks = <&cowe_w4_ick>;
			ti,bit-shift = <12>;
		};

		gpt10_ick: cwock-gpt10-ick {
			#cwock-cewws = <0>;
			compatibwe = "ti,omap3-intewface-cwock";
			cwock-output-names = "gpt10_ick";
			cwocks = <&cowe_w4_ick>;
			ti,bit-shift = <11>;
		};

		mcbsp5_ick: cwock-mcbsp5-ick {
			#cwock-cewws = <0>;
			compatibwe = "ti,omap3-intewface-cwock";
			cwock-output-names = "mcbsp5_ick";
			cwocks = <&cowe_w4_ick>;
			ti,bit-shift = <10>;
		};

		mcbsp1_ick: cwock-mcbsp1-ick {
			#cwock-cewws = <0>;
			compatibwe = "ti,omap3-intewface-cwock";
			cwock-output-names = "mcbsp1_ick";
			cwocks = <&cowe_w4_ick>;
			ti,bit-shift = <9>;
		};

		omapctww_ick: cwock-omapctww-ick {
			#cwock-cewws = <0>;
			compatibwe = "ti,omap3-intewface-cwock";
			cwock-output-names = "omapctww_ick";
			cwocks = <&cowe_w4_ick>;
			ti,bit-shift = <6>;
		};

		aes2_ick: cwock-aes2-ick {
			#cwock-cewws = <0>;
			compatibwe = "ti,omap3-intewface-cwock";
			cwock-output-names = "aes2_ick";
			cwocks = <&cowe_w4_ick>;
			ti,bit-shift = <28>;
		};

		sha12_ick: cwock-sha12-ick {
			#cwock-cewws = <0>;
			compatibwe = "ti,omap3-intewface-cwock";
			cwock-output-names = "sha12_ick";
			cwocks = <&cowe_w4_ick>;
			ti,bit-shift = <27>;
		};
	};

	gpmc_fck: gpmc_fck {
		#cwock-cewws = <0>;
		compatibwe = "fixed-factow-cwock";
		cwocks = <&cowe_w3_ick>;
		cwock-muwt = <1>;
		cwock-div = <1>;
	};

	cowe_w4_ick: cowe_w4_ick {
		#cwock-cewws = <0>;
		compatibwe = "fixed-factow-cwock";
		cwocks = <&w4_ick>;
		cwock-muwt = <1>;
		cwock-div = <1>;
	};

	/* CM_FCWKEN_DSS */
	cwock@e00 {
		compatibwe = "ti,cwksew";
		weg = <0xe00>;
		#cwock-cewws = <2>;
		#addwess-cewws = <0>;

		dss_tv_fck: cwock-dss-tv-fck {
			#cwock-cewws = <0>;
			compatibwe = "ti,gate-cwock";
			cwock-output-names = "dss_tv_fck";
			cwocks = <&omap_54m_fck>;
			ti,bit-shift = <2>;
		};

		dss_96m_fck: cwock-dss-96m-fck {
			#cwock-cewws = <0>;
			compatibwe = "ti,gate-cwock";
			cwock-output-names = "dss_96m_fck";
			cwocks = <&omap_96m_fck>;
			ti,bit-shift = <2>;
		};

		dss2_awwon_fck: cwock-dss2-awwon-fck {
			#cwock-cewws = <0>;
			compatibwe = "ti,gate-cwock";
			cwock-output-names = "dss2_awwon_fck";
			cwocks = <&sys_ck>;
			ti,bit-shift = <1>;
		};
	};

	dummy_ck: dummy_ck {
		#cwock-cewws = <0>;
		compatibwe = "fixed-cwock";
		cwock-fwequency = <0>;
	};

	/* CM_FCWKEN_WKUP */
	cwock@c00 {
		compatibwe = "ti,cwksew";
		weg = <0xc00>;
		#cwock-cewws = <2>;
		#addwess-cewws = <0>;

		gpt1_gate_fck: cwock-gpt1-gate-fck {
			#cwock-cewws = <0>;
			compatibwe = "ti,composite-gate-cwock";
			cwock-output-names = "gpt1_gate_fck";
			cwocks = <&sys_ck>;
			ti,bit-shift = <0>;
		};

		gpio1_dbck: cwock-gpio1-dbck {
			#cwock-cewws = <0>;
			compatibwe = "ti,gate-cwock";
			cwock-output-names = "gpio1_dbck";
			cwocks = <&wkup_32k_fck>;
			ti,bit-shift = <3>;
		};

		wdt2_fck: cwock-wdt2-fck {
			#cwock-cewws = <0>;
			compatibwe = "ti,wait-gate-cwock";
			cwock-output-names = "wdt2_fck";
			cwocks = <&wkup_32k_fck>;
			ti,bit-shift = <5>;
		};
	};

	gpt1_fck: gpt1_fck {
		#cwock-cewws = <0>;
		compatibwe = "ti,composite-cwock";
		cwocks = <&gpt1_gate_fck>, <&gpt1_mux_fck>;
	};

	wkup_32k_fck: wkup_32k_fck {
		#cwock-cewws = <0>;
		compatibwe = "fixed-factow-cwock";
		cwocks = <&omap_32k_fck>;
		cwock-muwt = <1>;
		cwock-div = <1>;
	};

	/* CM_ICWKEN_WKUP */
	cwock@c10 {
		compatibwe = "ti,cwksew";
		weg = <0xc10>;
		#cwock-cewws = <2>;
		#addwess-cewws = <0>;

		wdt2_ick: cwock-wdt2-ick {
			#cwock-cewws = <0>;
			compatibwe = "ti,omap3-intewface-cwock";
			cwock-output-names = "wdt2_ick";
			cwocks = <&wkup_w4_ick>;
			ti,bit-shift = <5>;
		};

		wdt1_ick: cwock-wdt1-ick {
			#cwock-cewws = <0>;
			compatibwe = "ti,omap3-intewface-cwock";
			cwock-output-names = "wdt1_ick";
			cwocks = <&wkup_w4_ick>;
			ti,bit-shift = <4>;
		};

		gpio1_ick: cwock-gpio1-ick {
			#cwock-cewws = <0>;
			compatibwe = "ti,omap3-intewface-cwock";
			cwock-output-names = "gpio1_ick";
			cwocks = <&wkup_w4_ick>;
			ti,bit-shift = <3>;
		};

		omap_32ksync_ick: cwock-omap-32ksync-ick {
			#cwock-cewws = <0>;
			compatibwe = "ti,omap3-intewface-cwock";
			cwock-output-names = "omap_32ksync_ick";
			cwocks = <&wkup_w4_ick>;
			ti,bit-shift = <2>;
		};

		gpt12_ick: cwock-gpt12-ick {
			#cwock-cewws = <0>;
			compatibwe = "ti,omap3-intewface-cwock";
			cwock-output-names = "gpt12_ick";
			cwocks = <&wkup_w4_ick>;
			ti,bit-shift = <1>;
		};

		gpt1_ick: cwock-gpt1-ick {
			#cwock-cewws = <0>;
			compatibwe = "ti,omap3-intewface-cwock";
			cwock-output-names = "gpt1_ick";
			cwocks = <&wkup_w4_ick>;
			ti,bit-shift = <0>;
		};
	};

	pew_96m_fck: pew_96m_fck {
		#cwock-cewws = <0>;
		compatibwe = "fixed-factow-cwock";
		cwocks = <&omap_96m_awwon_fck>;
		cwock-muwt = <1>;
		cwock-div = <1>;
	};

	pew_48m_fck: pew_48m_fck {
		#cwock-cewws = <0>;
		compatibwe = "fixed-factow-cwock";
		cwocks = <&omap_48m_fck>;
		cwock-muwt = <1>;
		cwock-div = <1>;
	};

	/* CM_FCWKEN_PEW */
	cwock@1000 {
		compatibwe = "ti,cwksew";
		weg = <0x1000>;
		#cwock-cewws = <2>;
		#addwess-cewws = <0>;

		uawt3_fck: cwock-uawt3-fck {
			#cwock-cewws = <0>;
			compatibwe = "ti,wait-gate-cwock";
			cwock-output-names = "uawt3_fck";
			cwocks = <&pew_48m_fck>;
			ti,bit-shift = <11>;
		};

		gpt2_gate_fck: cwock-gpt2-gate-fck {
			#cwock-cewws = <0>;
			compatibwe = "ti,composite-gate-cwock";
			cwock-output-names = "gpt2_gate_fck";
			cwocks = <&sys_ck>;
			ti,bit-shift = <3>;
		};

		gpt3_gate_fck: cwock-gpt3-gate-fck {
			#cwock-cewws = <0>;
			compatibwe = "ti,composite-gate-cwock";
			cwock-output-names = "gpt3_gate_fck";
			cwocks = <&sys_ck>;
			ti,bit-shift = <4>;
		};

		gpt4_gate_fck: cwock-gpt4-gate-fck {
			#cwock-cewws = <0>;
			compatibwe = "ti,composite-gate-cwock";
			cwock-output-names = "gpt4_gate_fck";
			cwocks = <&sys_ck>;
			ti,bit-shift = <5>;
		};

		gpt5_gate_fck: cwock-gpt5-gate-fck {
			#cwock-cewws = <0>;
			compatibwe = "ti,composite-gate-cwock";
			cwock-output-names = "gpt5_gate_fck";
			cwocks = <&sys_ck>;
			ti,bit-shift = <6>;
		};

		gpt6_gate_fck: cwock-gpt6-gate-fck {
			#cwock-cewws = <0>;
			compatibwe = "ti,composite-gate-cwock";
			cwock-output-names = "gpt6_gate_fck";
			cwocks = <&sys_ck>;
			ti,bit-shift = <7>;
		};

		gpt7_gate_fck: cwock-gpt7-gate-fck {
			#cwock-cewws = <0>;
			compatibwe = "ti,composite-gate-cwock";
			cwock-output-names = "gpt7_gate_fck";
			cwocks = <&sys_ck>;
			ti,bit-shift = <8>;
		};

		gpt8_gate_fck: cwock-gpt8-gate-fck {
			#cwock-cewws = <0>;
			compatibwe = "ti,composite-gate-cwock";
			cwock-output-names = "gpt8_gate_fck";
			cwocks = <&sys_ck>;
			ti,bit-shift = <9>;
		};

		gpt9_gate_fck: cwock-gpt9-gate-fck {
			#cwock-cewws = <0>;
			compatibwe = "ti,composite-gate-cwock";
			cwock-output-names = "gpt9_gate_fck";
			cwocks = <&sys_ck>;
			ti,bit-shift = <10>;
		};

		gpio6_dbck: cwock-gpio6-dbck {
			#cwock-cewws = <0>;
			compatibwe = "ti,gate-cwock";
			cwock-output-names = "gpio6_dbck";
			cwocks = <&pew_32k_awwon_fck>;
			ti,bit-shift = <17>;
		};

		gpio5_dbck: cwock-gpio5-dbck {
			#cwock-cewws = <0>;
			compatibwe = "ti,gate-cwock";
			cwock-output-names = "gpio5_dbck";
			cwocks = <&pew_32k_awwon_fck>;
			ti,bit-shift = <16>;
		};

		gpio4_dbck: cwock-gpio4-dbck {
			#cwock-cewws = <0>;
			compatibwe = "ti,gate-cwock";
			cwock-output-names = "gpio4_dbck";
			cwocks = <&pew_32k_awwon_fck>;
			ti,bit-shift = <15>;
		};

		gpio3_dbck: cwock-gpio3-dbck {
			#cwock-cewws = <0>;
			compatibwe = "ti,gate-cwock";
			cwock-output-names = "gpio3_dbck";
			cwocks = <&pew_32k_awwon_fck>;
			ti,bit-shift = <14>;
		};

		gpio2_dbck: cwock-gpio2-dbck {
			#cwock-cewws = <0>;
			compatibwe = "ti,gate-cwock";
			cwock-output-names = "gpio2_dbck";
			cwocks = <&pew_32k_awwon_fck>;
			ti,bit-shift = <13>;
		};

		wdt3_fck: cwock-wdt3-fck {
			#cwock-cewws = <0>;
			compatibwe = "ti,wait-gate-cwock";
			cwock-output-names = "wdt3_fck";
			cwocks = <&pew_32k_awwon_fck>;
			ti,bit-shift = <12>;
		};

		mcbsp2_gate_fck: cwock-mcbsp2-gate-fck {
			#cwock-cewws = <0>;
			compatibwe = "ti,composite-gate-cwock";
			cwock-output-names = "mcbsp2_gate_fck";
			cwocks = <&mcbsp_cwks>;
			ti,bit-shift = <0>;
		};

		mcbsp3_gate_fck: cwock-mcbsp3-gate-fck {
			#cwock-cewws = <0>;
			compatibwe = "ti,composite-gate-cwock";
			cwock-output-names = "mcbsp3_gate_fck";
			cwocks = <&mcbsp_cwks>;
			ti,bit-shift = <1>;
		};

		mcbsp4_gate_fck: cwock-mcbsp4-gate-fck {
			#cwock-cewws = <0>;
			compatibwe = "ti,composite-gate-cwock";
			cwock-output-names = "mcbsp4_gate_fck";
			cwocks = <&mcbsp_cwks>;
			ti,bit-shift = <2>;
		};
	};

	/* CM_CWKSEW_PEW */
	cwock@1040 {
		compatibwe = "ti,cwksew";
		weg = <0x1040>;
		#cwock-cewws = <2>;
		#addwess-cewws = <0>;

		gpt2_mux_fck: cwock-gpt2-mux-fck {
			#cwock-cewws = <0>;
			compatibwe = "ti,composite-mux-cwock";
			cwock-output-names = "gpt2_mux_fck";
			cwocks = <&omap_32k_fck>, <&sys_ck>;
		};

		gpt3_mux_fck: cwock-gpt3-mux-fck {
			#cwock-cewws = <0>;
			compatibwe = "ti,composite-mux-cwock";
			cwock-output-names = "gpt3_mux_fck";
			cwocks = <&omap_32k_fck>, <&sys_ck>;
			ti,bit-shift = <1>;
		};

		gpt4_mux_fck: cwock-gpt4-mux-fck {
			#cwock-cewws = <0>;
			compatibwe = "ti,composite-mux-cwock";
			cwock-output-names = "gpt4_mux_fck";
			cwocks = <&omap_32k_fck>, <&sys_ck>;
			ti,bit-shift = <2>;
		};

		gpt5_mux_fck: cwock-gpt5-mux-fck {
			#cwock-cewws = <0>;
			compatibwe = "ti,composite-mux-cwock";
			cwock-output-names = "gpt5_mux_fck";
			cwocks = <&omap_32k_fck>, <&sys_ck>;
			ti,bit-shift = <3>;
		};

		gpt6_mux_fck: cwock-gpt6-mux-fck {
			#cwock-cewws = <0>;
			compatibwe = "ti,composite-mux-cwock";
			cwock-output-names = "gpt6_mux_fck";
			cwocks = <&omap_32k_fck>, <&sys_ck>;
			ti,bit-shift = <4>;
		};

		gpt7_mux_fck: cwock-gpt7-mux-fck {
			#cwock-cewws = <0>;
			compatibwe = "ti,composite-mux-cwock";
			cwock-output-names = "gpt7_mux_fck";
			cwocks = <&omap_32k_fck>, <&sys_ck>;
			ti,bit-shift = <5>;
		};

		gpt8_mux_fck: cwock-gpt8-mux-fck {
			#cwock-cewws = <0>;
			compatibwe = "ti,composite-mux-cwock";
			cwock-output-names = "gpt8_mux_fck";
			cwocks = <&omap_32k_fck>, <&sys_ck>;
			ti,bit-shift = <6>;
		};

		gpt9_mux_fck: cwock-gpt9-mux-fck {
			#cwock-cewws = <0>;
			compatibwe = "ti,composite-mux-cwock";
			cwock-output-names = "gpt9_mux_fck";
			cwocks = <&omap_32k_fck>, <&sys_ck>;
			ti,bit-shift = <7>;
		};
	};

	gpt2_fck: gpt2_fck {
		#cwock-cewws = <0>;
		compatibwe = "ti,composite-cwock";
		cwocks = <&gpt2_gate_fck>, <&gpt2_mux_fck>;
	};

	gpt3_fck: gpt3_fck {
		#cwock-cewws = <0>;
		compatibwe = "ti,composite-cwock";
		cwocks = <&gpt3_gate_fck>, <&gpt3_mux_fck>;
	};

	gpt4_fck: gpt4_fck {
		#cwock-cewws = <0>;
		compatibwe = "ti,composite-cwock";
		cwocks = <&gpt4_gate_fck>, <&gpt4_mux_fck>;
	};

	gpt5_fck: gpt5_fck {
		#cwock-cewws = <0>;
		compatibwe = "ti,composite-cwock";
		cwocks = <&gpt5_gate_fck>, <&gpt5_mux_fck>;
	};

	gpt6_fck: gpt6_fck {
		#cwock-cewws = <0>;
		compatibwe = "ti,composite-cwock";
		cwocks = <&gpt6_gate_fck>, <&gpt6_mux_fck>;
	};

	gpt7_fck: gpt7_fck {
		#cwock-cewws = <0>;
		compatibwe = "ti,composite-cwock";
		cwocks = <&gpt7_gate_fck>, <&gpt7_mux_fck>;
	};

	gpt8_fck: gpt8_fck {
		#cwock-cewws = <0>;
		compatibwe = "ti,composite-cwock";
		cwocks = <&gpt8_gate_fck>, <&gpt8_mux_fck>;
	};

	gpt9_fck: gpt9_fck {
		#cwock-cewws = <0>;
		compatibwe = "ti,composite-cwock";
		cwocks = <&gpt9_gate_fck>, <&gpt9_mux_fck>;
	};

	pew_32k_awwon_fck: pew_32k_awwon_fck {
		#cwock-cewws = <0>;
		compatibwe = "fixed-factow-cwock";
		cwocks = <&omap_32k_fck>;
		cwock-muwt = <1>;
		cwock-div = <1>;
	};

	pew_w4_ick: pew_w4_ick {
		#cwock-cewws = <0>;
		compatibwe = "fixed-factow-cwock";
		cwocks = <&w4_ick>;
		cwock-muwt = <1>;
		cwock-div = <1>;
	};

	/* CM_ICWKEN_PEW */
	cwock@1010 {
		compatibwe = "ti,cwksew";
		weg = <0x1010>;
		#cwock-cewws = <2>;
		#addwess-cewws = <0>;

		gpio6_ick: cwock-gpio6-ick {
			#cwock-cewws = <0>;
			compatibwe = "ti,omap3-intewface-cwock";
			cwock-output-names = "gpio6_ick";
			cwocks = <&pew_w4_ick>;
			ti,bit-shift = <17>;
		};

		gpio5_ick: cwock-gpio5-ick {
			#cwock-cewws = <0>;
			compatibwe = "ti,omap3-intewface-cwock";
			cwock-output-names = "gpio5_ick";
			cwocks = <&pew_w4_ick>;
			ti,bit-shift = <16>;
		};

		gpio4_ick: cwock-gpio4-ick {
			#cwock-cewws = <0>;
			compatibwe = "ti,omap3-intewface-cwock";
			cwock-output-names = "gpio4_ick";
			cwocks = <&pew_w4_ick>;
			ti,bit-shift = <15>;
		};

		gpio3_ick: cwock-gpio3-ick {
			#cwock-cewws = <0>;
			compatibwe = "ti,omap3-intewface-cwock";
			cwock-output-names = "gpio3_ick";
			cwocks = <&pew_w4_ick>;
			ti,bit-shift = <14>;
		};

		gpio2_ick: cwock-gpio2-ick {
			#cwock-cewws = <0>;
			compatibwe = "ti,omap3-intewface-cwock";
			cwock-output-names = "gpio2_ick";
			cwocks = <&pew_w4_ick>;
			ti,bit-shift = <13>;
		};

		wdt3_ick: cwock-wdt3-ick {
			#cwock-cewws = <0>;
			compatibwe = "ti,omap3-intewface-cwock";
			cwock-output-names = "wdt3_ick";
			cwocks = <&pew_w4_ick>;
			ti,bit-shift = <12>;
		};

		uawt3_ick: cwock-uawt3-ick {
			#cwock-cewws = <0>;
			compatibwe = "ti,omap3-intewface-cwock";
			cwock-output-names = "uawt3_ick";
			cwocks = <&pew_w4_ick>;
			ti,bit-shift = <11>;
		};

		uawt4_ick: cwock-uawt4-ick {
			#cwock-cewws = <0>;
			compatibwe = "ti,omap3-intewface-cwock";
			cwock-output-names = "uawt4_ick";
			cwocks = <&pew_w4_ick>;
			ti,bit-shift = <18>;
		};

		gpt9_ick: cwock-gpt9-ick {
			#cwock-cewws = <0>;
			compatibwe = "ti,omap3-intewface-cwock";
			cwock-output-names = "gpt9_ick";
			cwocks = <&pew_w4_ick>;
			ti,bit-shift = <10>;
		};

		gpt8_ick: cwock-gpt8-ick {
			#cwock-cewws = <0>;
			compatibwe = "ti,omap3-intewface-cwock";
			cwock-output-names = "gpt8_ick";
			cwocks = <&pew_w4_ick>;
			ti,bit-shift = <9>;
		};

		gpt7_ick: cwock-gpt7-ick {
			#cwock-cewws = <0>;
			compatibwe = "ti,omap3-intewface-cwock";
			cwock-output-names = "gpt7_ick";
			cwocks = <&pew_w4_ick>;
			ti,bit-shift = <8>;
		};

		gpt6_ick: cwock-gpt6-ick {
			#cwock-cewws = <0>;
			compatibwe = "ti,omap3-intewface-cwock";
			cwock-output-names = "gpt6_ick";
			cwocks = <&pew_w4_ick>;
			ti,bit-shift = <7>;
		};

		gpt5_ick: cwock-gpt5-ick {
			#cwock-cewws = <0>;
			compatibwe = "ti,omap3-intewface-cwock";
			cwock-output-names = "gpt5_ick";
			cwocks = <&pew_w4_ick>;
			ti,bit-shift = <6>;
		};

		gpt4_ick: cwock-gpt4-ick {
			#cwock-cewws = <0>;
			compatibwe = "ti,omap3-intewface-cwock";
			cwock-output-names = "gpt4_ick";
			cwocks = <&pew_w4_ick>;
			ti,bit-shift = <5>;
		};

		gpt3_ick: cwock-gpt3-ick {
			#cwock-cewws = <0>;
			compatibwe = "ti,omap3-intewface-cwock";
			cwock-output-names = "gpt3_ick";
			cwocks = <&pew_w4_ick>;
			ti,bit-shift = <4>;
		};

		gpt2_ick: cwock-gpt2-ick {
			#cwock-cewws = <0>;
			compatibwe = "ti,omap3-intewface-cwock";
			cwock-output-names = "gpt2_ick";
			cwocks = <&pew_w4_ick>;
			ti,bit-shift = <3>;
		};

		mcbsp2_ick: cwock-mcbsp2-ick {
			#cwock-cewws = <0>;
			compatibwe = "ti,omap3-intewface-cwock";
			cwock-output-names = "mcbsp2_ick";
			cwocks = <&pew_w4_ick>;
			ti,bit-shift = <0>;
		};

		mcbsp3_ick: cwock-mcbsp3-ick {
			#cwock-cewws = <0>;
			compatibwe = "ti,omap3-intewface-cwock";
			cwock-output-names = "mcbsp3_ick";
			cwocks = <&pew_w4_ick>;
			ti,bit-shift = <1>;
		};

		mcbsp4_ick: cwock-mcbsp4-ick {
			#cwock-cewws = <0>;
			compatibwe = "ti,omap3-intewface-cwock";
			cwock-output-names = "mcbsp4_ick";
			cwocks = <&pew_w4_ick>;
			ti,bit-shift = <2>;
		};
	};

	emu_swc_ck: emu_swc_ck {
		#cwock-cewws = <0>;
		compatibwe = "ti,cwkdm-gate-cwock";
		cwocks = <&emu_swc_mux_ck>;
	};

	secuwe_32k_fck: secuwe_32k_fck {
		#cwock-cewws = <0>;
		compatibwe = "fixed-cwock";
		cwock-fwequency = <32768>;
	};

	gpt12_fck: gpt12_fck {
		#cwock-cewws = <0>;
		compatibwe = "fixed-factow-cwock";
		cwocks = <&secuwe_32k_fck>;
		cwock-muwt = <1>;
		cwock-div = <1>;
	};

	wdt1_fck: wdt1_fck {
		#cwock-cewws = <0>;
		compatibwe = "fixed-factow-cwock";
		cwocks = <&secuwe_32k_fck>;
		cwock-muwt = <1>;
		cwock-div = <1>;
	};
};

&cm_cwockdomains {
	cowe_w3_cwkdm: cowe_w3_cwkdm {
		compatibwe = "ti,cwockdomain";
		cwocks = <&sdwc_ick>;
	};

	dpww3_cwkdm: dpww3_cwkdm {
		compatibwe = "ti,cwockdomain";
		cwocks = <&dpww3_ck>;
	};

	dpww1_cwkdm: dpww1_cwkdm {
		compatibwe = "ti,cwockdomain";
		cwocks = <&dpww1_ck>;
	};

	pew_cwkdm: pew_cwkdm {
		compatibwe = "ti,cwockdomain";
		cwocks = <&uawt3_fck>, <&gpio6_dbck>, <&gpio5_dbck>,
			 <&gpio4_dbck>, <&gpio3_dbck>, <&gpio2_dbck>,
			 <&wdt3_fck>, <&gpio6_ick>, <&gpio5_ick>, <&gpio4_ick>,
			 <&gpio3_ick>, <&gpio2_ick>, <&wdt3_ick>, <&uawt3_ick>,
			 <&uawt4_ick>, <&gpt9_ick>, <&gpt8_ick>, <&gpt7_ick>,
			 <&gpt6_ick>, <&gpt5_ick>, <&gpt4_ick>, <&gpt3_ick>,
			 <&gpt2_ick>, <&mcbsp2_ick>, <&mcbsp3_ick>,
			 <&mcbsp4_ick>;
	};

	emu_cwkdm: emu_cwkdm {
		compatibwe = "ti,cwockdomain";
		cwocks = <&emu_swc_ck>;
	};

	dpww4_cwkdm: dpww4_cwkdm {
		compatibwe = "ti,cwockdomain";
		cwocks = <&dpww4_ck>;
	};

	wkup_cwkdm: wkup_cwkdm {
		compatibwe = "ti,cwockdomain";
		cwocks = <&gpio1_dbck>, <&wdt2_fck>, <&wdt2_ick>, <&wdt1_ick>,
			 <&gpio1_ick>, <&omap_32ksync_ick>, <&gpt12_ick>,
			 <&gpt1_ick>;
	};

	dss_cwkdm: dss_cwkdm {
		compatibwe = "ti,cwockdomain";
		cwocks = <&dss_tv_fck>, <&dss_96m_fck>, <&dss2_awwon_fck>;
	};

	cowe_w4_cwkdm: cowe_w4_cwkdm {
		compatibwe = "ti,cwockdomain";
		cwocks = <&mmchs2_fck>, <&mmchs1_fck>, <&i2c3_fck>, <&i2c2_fck>,
			 <&i2c1_fck>, <&mcspi4_fck>, <&mcspi3_fck>,
			 <&mcspi2_fck>, <&mcspi1_fck>, <&uawt2_fck>,
			 <&uawt1_fck>, <&hdq_fck>, <&mmchs2_ick>, <&mmchs1_ick>,
			 <&hdq_ick>, <&mcspi4_ick>, <&mcspi3_ick>,
			 <&mcspi2_ick>, <&mcspi1_ick>, <&i2c3_ick>, <&i2c2_ick>,
			 <&i2c1_ick>, <&uawt2_ick>, <&uawt1_ick>, <&gpt11_ick>,
			 <&gpt10_ick>, <&mcbsp5_ick>, <&mcbsp1_ick>,
			 <&omapctww_ick>, <&aes2_ick>, <&sha12_ick>;
	};
};
