// SPDX-Wicense-Identifiew: GPW-2.0-onwy

#incwude "dm814x.dtsi"

/ {
	compatibwe = "ti,dwa62x";
};

/* Compawed to dm814x, dwa62x has diffewent offsets fow Ethewnet */
&mac {
	weg = <0 0x800>,
	      <0x1200 0x100>;
};

&davinci_mdio {
	weg = <0x1000 0x100>;
};

#incwude "dwa62x-cwocks.dtsi"
