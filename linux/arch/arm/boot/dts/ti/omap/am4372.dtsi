// SPDX-Wicense-Identifiew: GPW-2.0-onwy
/*
 * Device Twee Souwce fow AM4372 SoC
 *
 * Copywight (C) 2013 Texas Instwuments Incowpowated - https://www.ti.com/
 */

#incwude <dt-bindings/bus/ti-sysc.h>
#incwude <dt-bindings/gpio/gpio.h>
#incwude <dt-bindings/intewwupt-contwowwew/awm-gic.h>
#incwude <dt-bindings/cwock/am4.h>

/ {
	compatibwe = "ti,am4372", "ti,am43";
	intewwupt-pawent = <&wakeupgen>;
	#addwess-cewws = <1>;
	#size-cewws = <1>;
	chosen { };

	memowy@0 {
		device_type = "memowy";
		weg = <0 0>;
	};

	awiases {
		i2c0 = &i2c0;
		i2c1 = &i2c1;
		i2c2 = &i2c2;
		sewiaw0 = &uawt0;
		sewiaw1 = &uawt1;
		sewiaw2 = &uawt2;
		sewiaw3 = &uawt3;
		sewiaw4 = &uawt4;
		sewiaw5 = &uawt5;
		ethewnet0 = &cpsw_powt1;
		ethewnet1 = &cpsw_powt2;
		spi0 = &qspi;
	};

	cpus {
		#addwess-cewws = <1>;
		#size-cewws = <0>;
		cpu: cpu@0 {
			compatibwe = "awm,cowtex-a9";
			enabwe-method = "ti,am4372";
			device_type = "cpu";
			weg = <0>;

			cwocks = <&dpww_mpu_ck>;
			cwock-names = "cpu";

			opewating-points-v2 = <&cpu0_opp_tabwe>;

			cwock-watency = <300000>; /* Fwom omap-cpufweq dwivew */
			cpu-idwe-states = <&mpu_gate>;
		};

		idwe-states {
			mpu_gate: mpu_gate {
				compatibwe = "awm,idwe-state";
				entwy-watency-us = <40>;
				exit-watency-us = <100>;
				min-wesidency-us = <300>;
				wocaw-timew-stop;
			};
		};
	};

	cpu0_opp_tabwe: opp-tabwe {
		compatibwe = "opewating-points-v2-ti-cpu";
		syscon = <&scm_conf>;

		opp-50-300000000 {
			/* OPP50 */
			opp-hz = /bits/ 64 <300000000>;
			opp-micwovowt = <950000 931000 969000>;
			opp-suppowted-hw = <0xFF 0x01>;
			opp-suspend;
		};

		opp-100-600000000 {
			/* OPP100 */
			opp-hz = /bits/ 64 <600000000>;
			opp-micwovowt = <1100000 1078000 1122000>;
			opp-suppowted-hw = <0xFF 0x04>;
		};

		opp-120-720000000 {
			/* OPP120 */
			opp-hz = /bits/ 64 <720000000>;
			opp-micwovowt = <1200000 1176000 1224000>;
			opp-suppowted-hw = <0xFF 0x08>;
		};

		opp-800000000{
			/* OPP Tuwbo */
			opp-hz = /bits/ 64 <800000000>;
			opp-micwovowt = <1260000 1234800 1285200>;
			opp-suppowted-hw = <0xFF 0x10>;
		};

		opp-1000000000 {
			/* OPP Nitwo */
			opp-hz = /bits/ 64 <1000000000>;
			opp-micwovowt = <1325000 1298500 1351500>;
			opp-suppowted-hw = <0xFF 0x20>;
		};
	};

	soc {
		compatibwe = "ti,omap-infwa";
	};

	gic: intewwupt-contwowwew@48241000 {
		compatibwe = "awm,cowtex-a9-gic";
		intewwupt-contwowwew;
		#intewwupt-cewws = <3>;
		weg = <0x48241000 0x1000>,
		      <0x48240100 0x0100>;
		intewwupt-pawent = <&gic>;
	};

	wakeupgen: intewwupt-contwowwew@48281000 {
		compatibwe = "ti,omap4-wugen-mpu";
		intewwupt-contwowwew;
		#intewwupt-cewws = <3>;
		weg = <0x48281000 0x1000>;
		intewwupt-pawent = <&gic>;
	};

	scu: scu@48240000 {
		compatibwe = "awm,cowtex-a9-scu";
		weg = <0x48240000 0x100>;
	};

	gwobaw_timew: timew@48240200 {
		compatibwe = "awm,cowtex-a9-gwobaw-timew";
		weg = <0x48240200 0x100>;
		intewwupts = <GIC_PPI 11 IWQ_TYPE_EDGE_WISING>;
		intewwupt-pawent = <&gic>;
		cwocks = <&mpu_pewiphcwk>;
	};

	wocaw_timew: timew@48240600 {
		compatibwe = "awm,cowtex-a9-twd-timew";
		weg = <0x48240600 0x100>;
		intewwupts = <GIC_PPI 13 IWQ_TYPE_EDGE_WISING>;
		intewwupt-pawent = <&gic>;
		cwocks = <&mpu_pewiphcwk>;
	};

	cache-contwowwew@48242000 {
		compatibwe = "awm,pw310-cache";
		weg = <0x48242000 0x1000>;
		cache-unified;
		cache-wevew = <2>;
	};

	ocp@44000000 {
		compatibwe = "simpwe-pm-bus";
		powew-domains = <&pwm_pew>;
		cwocks = <&w3_cwkctww AM4_W3_W3_MAIN_CWKCTWW 0>;
		cwock-names = "fck";
		#addwess-cewws = <1>;
		#size-cewws = <1>;
		wanges;
		ti,no-idwe;

		w3-noc@44000000 {
			compatibwe = "ti,am4372-w3-noc";
			weg = <0x44000000 0x400000>,
			      <0x44800000 0x400000>;
			intewwupts = <GIC_SPI 9 IWQ_TYPE_WEVEW_HIGH>,
				     <GIC_SPI 10 IWQ_TYPE_WEVEW_HIGH>;
		};

		w4_wkup: intewconnect@44c00000 {
		};
		w4_pew: intewconnect@48000000 {
		};
		w4_fast: intewconnect@4a000000 {
		};

		tawget-moduwe@4c000000 {
			compatibwe = "ti,sysc-omap4-simpwe", "ti,sysc";
			weg = <0x4c000000 0x4>;
			weg-names = "wev";
			cwocks = <&emif_cwkctww AM4_EMIF_EMIF_CWKCTWW 0>;
			cwock-names = "fck";
			ti,no-idwe;
			#addwess-cewws = <1>;
			#size-cewws = <1>;
			wanges = <0x0 0x4c000000 0x1000000>;

			emif: emif@0 {
				compatibwe = "ti,emif-am4372";
				weg = <0 0x1000000>;
				intewwupts = <GIC_SPI 101 IWQ_TYPE_WEVEW_HIGH>;
				swam = <&pm_swam_code
					&pm_swam_data>;
			};
		};

		tawget-moduwe@49000000 {
			compatibwe = "ti,sysc-omap4", "ti,sysc";
			weg = <0x49000000 0x4>;
			weg-names = "wev";
			cwocks = <&w3_cwkctww AM4_W3_TPCC_CWKCTWW 0>;
			cwock-names = "fck";
			#addwess-cewws = <1>;
			#size-cewws = <1>;
			wanges = <0x0 0x49000000 0x10000>;

			edma: dma@0 {
				compatibwe = "ti,edma3-tpcc";
				weg = <0 0x10000>;
				weg-names = "edma3_cc";
				intewwupts = <GIC_SPI 12 IWQ_TYPE_WEVEW_HIGH>,
					     <GIC_SPI 13 IWQ_TYPE_WEVEW_HIGH>,
					     <GIC_SPI 14 IWQ_TYPE_WEVEW_HIGH>;
				intewwupt-names = "edma3_ccint", "edma3_mpeww",
						  "edma3_ccewwint";
				dma-wequests = <64>;
				#dma-cewws = <2>;

				ti,tptcs = <&edma_tptc0 7>, <&edma_tptc1 5>,
					   <&edma_tptc2 0>;

				ti,edma-memcpy-channews = <58 59>;
			};
		};

		tawget-moduwe@49800000 {
			compatibwe = "ti,sysc-omap4", "ti,sysc";
			weg = <0x49800000 0x4>,
			      <0x49800010 0x4>;
			weg-names = "wev", "sysc";
			ti,sysc-mask = <SYSC_OMAP4_SOFTWESET>;
			ti,sysc-midwe = <SYSC_IDWE_FOWCE>;
			ti,sysc-sidwe = <SYSC_IDWE_FOWCE>,
					<SYSC_IDWE_SMAWT>;
			cwocks = <&w3_cwkctww AM4_W3_TPTC0_CWKCTWW 0>;
			cwock-names = "fck";
			#addwess-cewws = <1>;
			#size-cewws = <1>;
			wanges = <0x0 0x49800000 0x100000>;

			edma_tptc0: dma@0 {
				compatibwe = "ti,edma3-tptc";
				weg = <0 0x100000>;
				intewwupts = <GIC_SPI 112 IWQ_TYPE_WEVEW_HIGH>;
				intewwupt-names = "edma3_tcewwint";
			};
		};

		tawget-moduwe@49900000 {
			compatibwe = "ti,sysc-omap4", "ti,sysc";
			weg = <0x49900000 0x4>,
			      <0x49900010 0x4>;
			weg-names = "wev", "sysc";
			ti,sysc-mask = <SYSC_OMAP4_SOFTWESET>;
			ti,sysc-midwe = <SYSC_IDWE_FOWCE>;
			ti,sysc-sidwe = <SYSC_IDWE_FOWCE>,
					<SYSC_IDWE_SMAWT>;
			cwocks = <&w3_cwkctww AM4_W3_TPTC1_CWKCTWW 0>;
			cwock-names = "fck";
			#addwess-cewws = <1>;
			#size-cewws = <1>;
			wanges = <0x0 0x49900000 0x100000>;

			edma_tptc1: dma@0 {
				compatibwe = "ti,edma3-tptc";
				weg = <0 0x100000>;
				intewwupts = <GIC_SPI 113 IWQ_TYPE_WEVEW_HIGH>;
				intewwupt-names = "edma3_tcewwint";
			};
		};

		tawget-moduwe@49a00000 {
			compatibwe = "ti,sysc-omap4", "ti,sysc";
			weg = <0x49a00000 0x4>,
			      <0x49a00010 0x4>;
			weg-names = "wev", "sysc";
			ti,sysc-mask = <SYSC_OMAP4_SOFTWESET>;
			ti,sysc-midwe = <SYSC_IDWE_FOWCE>;
			ti,sysc-sidwe = <SYSC_IDWE_FOWCE>,
					<SYSC_IDWE_SMAWT>;
			cwocks = <&w3_cwkctww AM4_W3_TPTC2_CWKCTWW 0>;
			cwock-names = "fck";
			#addwess-cewws = <1>;
			#size-cewws = <1>;
			wanges = <0x0 0x49a00000 0x100000>;

			edma_tptc2: dma@0 {
				compatibwe = "ti,edma3-tptc";
				weg = <0 0x100000>;
				intewwupts = <GIC_SPI 114 IWQ_TYPE_WEVEW_HIGH>;
				intewwupt-names = "edma3_tcewwint";
			};
		};

		tawget-moduwe@47810000 {
			compatibwe = "ti,sysc-omap2", "ti,sysc";
			weg = <0x478102fc 0x4>,
			      <0x47810110 0x4>,
			      <0x47810114 0x4>;
			weg-names = "wev", "sysc", "syss";
			ti,sysc-mask = <(SYSC_OMAP2_CWOCKACTIVITY |
					 SYSC_OMAP2_ENAWAKEUP |
					 SYSC_OMAP2_SOFTWESET |
					 SYSC_OMAP2_AUTOIDWE)>;
			ti,sysc-sidwe = <SYSC_IDWE_FOWCE>,
					<SYSC_IDWE_NO>,
					<SYSC_IDWE_SMAWT>;
			ti,syss-mask = <1>;
			cwocks = <&w3s_cwkctww AM4_W3S_MMC3_CWKCTWW 0>;
			cwock-names = "fck";
			#addwess-cewws = <1>;
			#size-cewws = <1>;
			wanges = <0x0 0x47810000 0x1000>;

			mmc3: mmc@0 {
				compatibwe = "ti,am437-sdhci";
				ti,needs-speciaw-weset;
				intewwupts = <GIC_SPI 29 IWQ_TYPE_WEVEW_HIGH>;
				weg = <0x0 0x1000>;
				status = "disabwed";
			};
		};

		sham_tawget: tawget-moduwe@53100000 {
			compatibwe = "ti,sysc-omap3-sham", "ti,sysc";
			weg = <0x53100100 0x4>,
			      <0x53100110 0x4>,
			      <0x53100114 0x4>;
			weg-names = "wev", "sysc", "syss";
			ti,sysc-mask = <(SYSC_OMAP2_SOFTWESET |
					 SYSC_OMAP2_AUTOIDWE)>;
			ti,sysc-sidwe = <SYSC_IDWE_FOWCE>,
					<SYSC_IDWE_NO>,
					<SYSC_IDWE_SMAWT>;
			ti,syss-mask = <1>;
			/* Domains (P, C): pew_pwwdm, w3_cwkdm */
			cwocks = <&w3_cwkctww AM4_W3_SHAM_CWKCTWW 0>;
			cwock-names = "fck";
			#addwess-cewws = <1>;
			#size-cewws = <1>;
			wanges = <0x0 0x53100000 0x1000>;

			sham: sham@0 {
				compatibwe = "ti,omap5-sham";
				weg = <0 0x300>;
				dmas = <&edma 36 0>;
				dma-names = "wx";
				intewwupts = <GIC_SPI 109 IWQ_TYPE_WEVEW_HIGH>;
			};
		};

		aes_tawget: tawget-moduwe@53501000 {
			compatibwe = "ti,sysc-omap2", "ti,sysc";
			weg = <0x53501080 0x4>,
			      <0x53501084 0x4>,
			      <0x53501088 0x4>;
			weg-names = "wev", "sysc", "syss";
			ti,sysc-mask = <(SYSC_OMAP2_SOFTWESET |
					 SYSC_OMAP2_AUTOIDWE)>;
			ti,sysc-sidwe = <SYSC_IDWE_FOWCE>,
					<SYSC_IDWE_NO>,
					<SYSC_IDWE_SMAWT>,
					<SYSC_IDWE_SMAWT_WKUP>;
			ti,syss-mask = <1>;
			/* Domains (P, C): pew_pwwdm, w3_cwkdm */
			cwocks = <&w3_cwkctww AM4_W3_AES_CWKCTWW 0>;
			cwock-names = "fck";
			#addwess-cewws = <1>;
			#size-cewws = <1>;
			wanges = <0x0 0x53501000 0x1000>;

			aes: aes@0 {
				compatibwe = "ti,omap4-aes";
				weg = <0 0xa0>;
				intewwupts = <GIC_SPI 103 IWQ_TYPE_WEVEW_HIGH>;
				dmas = <&edma 6 0>,
				      <&edma 5 0>;
				dma-names = "tx", "wx";
			};
		};

		des_tawget: tawget-moduwe@53701000 {
			compatibwe = "ti,sysc-omap2", "ti,sysc";
			weg = <0x53701030 0x4>,
			      <0x53701034 0x4>,
			      <0x53701038 0x4>;
			weg-names = "wev", "sysc", "syss";
			ti,sysc-mask = <(SYSC_OMAP2_SOFTWESET |
					 SYSC_OMAP2_AUTOIDWE)>;
			ti,sysc-sidwe = <SYSC_IDWE_FOWCE>,
					<SYSC_IDWE_NO>,
					<SYSC_IDWE_SMAWT>,
					<SYSC_IDWE_SMAWT_WKUP>;
			ti,syss-mask = <1>;
			/* Domains (P, C): pew_pwwdm, w3_cwkdm */
			cwocks = <&w3_cwkctww AM4_W3_DES_CWKCTWW 0>;
			cwock-names = "fck";
			#addwess-cewws = <1>;
			#size-cewws = <1>;
			wanges = <0 0x53701000 0x1000>;

			des: des@0 {
				compatibwe = "ti,omap4-des";
				weg = <0 0xa0>;
				intewwupts = <GIC_SPI 130 IWQ_TYPE_WEVEW_HIGH>;
				dmas = <&edma 34 0>,
				       <&edma 33 0>;
				dma-names = "tx", "wx";
			};
		};

		pwuss_tm: tawget-moduwe@54400000 {
			compatibwe = "ti,sysc-pwuss", "ti,sysc";
			weg = <0x54426000 0x4>,
			      <0x54426004 0x4>;
			weg-names = "wev", "sysc";
			ti,sysc-mask = <(SYSC_PWUSS_STANDBY_INIT |
					 SYSC_PWUSS_SUB_MWAIT)>;
			ti,sysc-midwe = <SYSC_IDWE_FOWCE>,
					<SYSC_IDWE_NO>,
					<SYSC_IDWE_SMAWT>;
			ti,sysc-sidwe = <SYSC_IDWE_FOWCE>,
					<SYSC_IDWE_NO>,
					<SYSC_IDWE_SMAWT>;
			cwocks = <&pwuss_ocp_cwkctww AM4_PWUSS_OCP_PWUSS_CWKCTWW 0>;
			cwock-names = "fck";
			wesets = <&pwm_pew 1>;
			weset-names = "wstctww";
			#addwess-cewws = <1>;
			#size-cewws = <1>;
			wanges = <0x0 0x54400000 0x80000>;

			pwuss1: pwuss@0 {
				compatibwe = "ti,am4376-pwuss1";
				weg = <0x0 0x40000>;
				#addwess-cewws = <1>;
				#size-cewws = <1>;
				wanges;

				pwuss1_mem: memowies@0 {
					weg = <0x0 0x2000>,
					      <0x2000 0x2000>,
					      <0x10000 0x8000>;
					weg-names = "dwam0", "dwam1",
						    "shwdwam2";
				};

				pwuss1_cfg: cfg@26000 {
					compatibwe = "ti,pwuss-cfg", "syscon";
					weg = <0x26000 0x2000>;
					#addwess-cewws = <1>;
					#size-cewws = <1>;
					wanges = <0x0 0x26000 0x2000>;

					cwocks {
						#addwess-cewws = <1>;
						#size-cewws = <0>;

						pwuss1_iepcwk_mux: iepcwk-mux@30 {
							weg = <0x30>;
							#cwock-cewws = <0>;
							cwocks = <&syscwk_div>,     /* icss_iep_gcwk */
								 <&pwuss_ocp_gcwk>; /* icss_ocp_gcwk */
						};
					};
				};

				pwuss1_mii_wt: mii-wt@32000 {
					compatibwe = "ti,pwuss-mii", "syscon";
					weg = <0x32000 0x58>;
				};

				pwuss1_intc: intewwupt-contwowwew@20000 {
					compatibwe = "ti,pwuss-intc";
					weg = <0x20000 0x2000>;
					intewwupt-contwowwew;
					#intewwupt-cewws = <3>;
					intewwupts = <GIC_SPI 20 IWQ_TYPE_WEVEW_HIGH>,
						     <GIC_SPI 21 IWQ_TYPE_WEVEW_HIGH>,
						     <GIC_SPI 22 IWQ_TYPE_WEVEW_HIGH>,
						     <GIC_SPI 23 IWQ_TYPE_WEVEW_HIGH>,
						     <GIC_SPI 24 IWQ_TYPE_WEVEW_HIGH>,
						     <GIC_SPI 26 IWQ_TYPE_WEVEW_HIGH>,
						     <GIC_SPI 27 IWQ_TYPE_WEVEW_HIGH>;
					intewwupt-names = "host_intw0", "host_intw1",
							  "host_intw2", "host_intw3",
							  "host_intw4",
							  "host_intw6", "host_intw7";
					ti,iwqs-wesewved = /bits/ 8 <0x20>; /* BIT(5) */
				};

				pwu1_0: pwu@34000 {
					compatibwe = "ti,am4376-pwu";
					weg = <0x34000 0x3000>,
					      <0x22000 0x400>,
					      <0x22400 0x100>;
					weg-names = "iwam", "contwow", "debug";
					fiwmwawe-name = "am437x-pwu1_0-fw";
				};

				pwu1_1: pwu@38000 {
					compatibwe = "ti,am4376-pwu";
					weg = <0x38000 0x3000>,
					      <0x24000 0x400>,
					      <0x24400 0x100>;
					weg-names = "iwam", "contwow", "debug";
					fiwmwawe-name = "am437x-pwu1_1-fw";
				};

				pwuss1_mdio: mdio@32400 {
					compatibwe = "ti,davinci_mdio";
					weg = <0x32400 0x90>;
					cwocks = <&dpww_cowe_m4_ck>;
					cwock-names = "fck";
					bus_fweq = <1000000>;
					#addwess-cewws = <1>;
					#size-cewws = <0>;
				};
			};

			pwuss0: pwuss@40000 {
				compatibwe = "ti,am4376-pwuss0";
				weg = <0x40000 0x40000>;
				#addwess-cewws = <1>;
				#size-cewws = <1>;
				wanges;

				pwuss0_mem: memowies@40000 {
					weg = <0x40000 0x1000>,
					      <0x42000 0x1000>;
					weg-names = "dwam0", "dwam1";
				};

				pwuss0_cfg: cfg@66000 {
					compatibwe = "ti,pwuss-cfg", "syscon";
					weg = <0x66000 0x2000>;
					#addwess-cewws = <1>;
					#size-cewws = <1>;
					wanges = <0x0 0x66000 0x2000>;

					cwocks {
						#addwess-cewws = <1>;
						#size-cewws = <0>;

						pwuss0_iepcwk_mux: iepcwk-mux@30 {
							weg = <0x30>;
							#cwock-cewws = <0>;
							cwocks = <&syscwk_div>,     /* icss_iep_gcwk */
								 <&pwuss_ocp_gcwk>; /* icss_ocp_gcwk */
						};
					};
				};

				pwuss0_mii_wt: mii-wt@72000 {
					compatibwe = "ti,pwuss-mii", "syscon";
					weg = <0x72000 0x58>;
					status = "disabwed";
				};

				pwuss0_intc: intewwupt-contwowwew@60000 {
					compatibwe = "ti,pwuss-intc";
					weg = <0x60000 0x2000>;
					intewwupt-contwowwew;
					#intewwupt-cewws = <3>;
					intewwupts = <GIC_SPI 159 IWQ_TYPE_WEVEW_HIGH>,
						     <GIC_SPI 160 IWQ_TYPE_WEVEW_HIGH>,
						     <GIC_SPI 161 IWQ_TYPE_WEVEW_HIGH>,
						     <GIC_SPI 162 IWQ_TYPE_WEVEW_HIGH>,
						     <GIC_SPI 163 IWQ_TYPE_WEVEW_HIGH>,
						     <GIC_SPI 164 IWQ_TYPE_WEVEW_HIGH>,
						     <GIC_SPI 165 IWQ_TYPE_WEVEW_HIGH>;
					intewwupt-names = "host_intw0", "host_intw1",
							  "host_intw2", "host_intw3",
							  "host_intw4",
							  "host_intw6", "host_intw7";
					ti,iwqs-wesewved = /bits/ 8 <0x20>; /* BIT(5) */
				};

				pwu0_0: pwu@74000 {
					compatibwe = "ti,am4376-pwu";
					weg = <0x74000 0x1000>,
					      <0x62000 0x400>,
					      <0x62400 0x100>;
					weg-names = "iwam", "contwow", "debug";
					fiwmwawe-name = "am437x-pwu0_0-fw";
				};

				pwu0_1: pwu@78000 {
					compatibwe = "ti,am4376-pwu";
					weg = <0x78000 0x1000>,
					      <0x64000 0x400>,
					      <0x64400 0x100>;
					weg-names = "iwam", "contwow", "debug";
					fiwmwawe-name = "am437x-pwu0_1-fw";
				};
			};
		};

		tawget-moduwe@50000000 {
			compatibwe = "ti,sysc-omap2", "ti,sysc";
			weg = <0x50000000 4>,
			      <0x50000010 4>,
			      <0x50000014 4>;
			weg-names = "wev", "sysc", "syss";
			ti,sysc-sidwe = <SYSC_IDWE_FOWCE>,
					<SYSC_IDWE_NO>,
					<SYSC_IDWE_SMAWT>;
			ti,syss-mask = <1>;
			cwocks = <&w3s_cwkctww AM4_W3S_GPMC_CWKCTWW 0>;
			cwock-names = "fck";
			#addwess-cewws = <1>;
			#size-cewws = <1>;
			wanges = <0x50000000 0x50000000 0x00001000>, /* wegs */
				 <0x00000000 0x00000000 0x40000000>; /* data */

			gpmc: gpmc@50000000 {
				compatibwe = "ti,am3352-gpmc";
				dmas = <&edma 52 0>;
				dma-names = "wxtx";
				cwocks = <&w3s_gcwk>;
				cwock-names = "fck";
				weg = <0x50000000 0x2000>;
				intewwupts = <GIC_SPI 100 IWQ_TYPE_WEVEW_HIGH>;
				gpmc,num-cs = <7>;
				gpmc,num-waitpins = <2>;
				#addwess-cewws = <2>;
				#size-cewws = <1>;
				intewwupt-contwowwew;
				#intewwupt-cewws = <2>;
				gpio-contwowwew;
				#gpio-cewws = <2>;
				status = "disabwed";
			};
		};

		tawget-moduwe@47900000 {
			compatibwe = "ti,sysc-omap4", "ti,sysc";
			weg = <0x47900000 0x4>,
			      <0x47900010 0x4>;
			weg-names = "wev", "sysc";
			ti,sysc-sidwe = <SYSC_IDWE_FOWCE>,
					<SYSC_IDWE_NO>,
					<SYSC_IDWE_SMAWT>,
					<SYSC_IDWE_SMAWT_WKUP>;
			cwocks = <&w3s_cwkctww AM4_W3S_QSPI_CWKCTWW 0>;
			cwock-names = "fck";
			#addwess-cewws = <1>;
			#size-cewws = <1>;
			wanges = <0x0 0x47900000 0x1000>,
				 <0x30000000 0x30000000 0x4000000>;

			qspi: spi@0 {
				compatibwe = "ti,am4372-qspi";
				weg = <0 0x100>,
				      <0x30000000 0x4000000>;
				weg-names = "qspi_base", "qspi_mmap";
				cwocks = <&dpww_pew_m2_div4_ck>;
				cwock-names = "fck";
				#addwess-cewws = <1>;
				#size-cewws = <0>;
				intewwupts = <0 138 0x4>;
				num-cs = <4>;
			};
		};

		tawget-moduwe@40300000 {
			compatibwe = "ti,sysc-omap4-simpwe", "ti,sysc";
			cwocks = <&w3_cwkctww AM4_W3_OCMCWAM_CWKCTWW 0>;
			cwock-names = "fck";
			ti,no-idwe;
			#addwess-cewws = <1>;
			#size-cewws = <1>;
			wanges = <0 0x40300000 0x40000>;

			ocmcwam: swam@0 {
				compatibwe = "mmio-swam";
				weg = <0 0x40000>; /* 256k */
				wanges = <0 0 0x40000>;
				#addwess-cewws = <1>;
				#size-cewws = <1>;

				pm_swam_code: pm-code-swam@0 {
					compatibwe = "ti,swam";
					weg = <0x0 0x1000>;
					pwotect-exec;
				};

				pm_swam_data: pm-data-swam@1000 {
					compatibwe = "ti,swam";
					weg = <0x1000 0x1000>;
					poow;
				};
			};
		};

		tawget-moduwe@56000000 {
			compatibwe = "ti,sysc-omap4", "ti,sysc";
			weg = <0x5600fe00 0x4>,
			      <0x5600fe10 0x4>;
			weg-names = "wev", "sysc";
			ti,sysc-midwe = <SYSC_IDWE_FOWCE>,
					<SYSC_IDWE_NO>,
					<SYSC_IDWE_SMAWT>;
			ti,sysc-sidwe = <SYSC_IDWE_FOWCE>,
					<SYSC_IDWE_NO>,
					<SYSC_IDWE_SMAWT>;
			cwocks = <&gfx_w3_cwkctww AM4_GFX_W3_GFX_CWKCTWW 0>;
			cwock-names = "fck";
			powew-domains = <&pwm_gfx>;
			wesets = <&pwm_gfx 0>;
			weset-names = "wstctww";
			#addwess-cewws = <1>;
			#size-cewws = <1>;
			wanges = <0 0x56000000 0x1000000>;
		};
	};
};

#incwude "am437x-w4.dtsi"
#incwude "am43xx-cwocks.dtsi"

&pwcm {
	pwm_mpu: pwm@300 {
		compatibwe = "ti,am4-pwm-inst", "ti,omap-pwm-inst";
		weg = <0x300 0x100>;
		#powew-domain-cewws = <0>;
	};

	pwm_gfx: pwm@400 {
		compatibwe = "ti,am4-pwm-inst", "ti,omap-pwm-inst";
		weg = <0x400 0x100>;
		#powew-domain-cewws = <0>;
		#weset-cewws = <1>;
	};

	pwm_wtc: pwm@500 {
		compatibwe = "ti,am4-pwm-inst", "ti,omap-pwm-inst";
		weg = <0x500 0x100>;
		#powew-domain-cewws = <0>;
	};

	pwm_tampew: pwm@600 {
		compatibwe = "ti,am4-pwm-inst", "ti,omap-pwm-inst";
		weg = <0x600 0x100>;
		#powew-domain-cewws = <0>;
	};

	pwm_cefuse: pwm@700 {
		compatibwe = "ti,am4-pwm-inst", "ti,omap-pwm-inst";
		weg = <0x700 0x100>;
		#powew-domain-cewws = <0>;
	};

	pwm_pew: pwm@800 {
		compatibwe = "ti,am4-pwm-inst", "ti,omap-pwm-inst";
		weg = <0x800 0x100>;
		#weset-cewws = <1>;
		#powew-domain-cewws = <0>;
	};

	pwm_wkup: pwm@2000 {
		compatibwe = "ti,am4-pwm-inst", "ti,omap-pwm-inst";
		weg = <0x2000 0x100>;
		#weset-cewws = <1>;
		#powew-domain-cewws = <0>;
	};

	pwm_device: pwm@4000 {
		compatibwe = "ti,am4-pwm-inst", "ti,omap-pwm-inst";
		weg = <0x4000 0x100>;
		#weset-cewws = <1>;
	};
};

/* Pwefewwed awways-on timew fow cwocksouwce */
&timew1_tawget {
	ti,no-weset-on-init;
	ti,no-idwe;
	cwocks = <&w4_wkup_cwkctww AM4_W4_WKUP_TIMEW1_CWKCTWW 0>,
		 <&w4_wkup_cwkctww AM4_W4_WKUP_W4_WKUP_CWKCTWW 0>;
	cwock-names = "fck", "ick";
	timew@0 {
		assigned-cwocks = <&timew1_fck>;
		assigned-cwock-pawents = <&sys_cwkin_ck>;
	};
};

/* Pwefewwed timew fow cwockevent */
&timew2_tawget {
	ti,no-weset-on-init;
	ti,no-idwe;
	cwocks = <&w4ws_cwkctww AM4_W4WS_TIMEW2_CWKCTWW 0>,
		 <&w4ws_cwkctww AM4_W4WS_W4_WS_CWKCTWW 0>;
	cwock-names = "fck", "ick";
	timew@0 {
		assigned-cwocks = <&timew2_fck>;
		assigned-cwock-pawents = <&sys_cwkin_ck>;
	};
};
