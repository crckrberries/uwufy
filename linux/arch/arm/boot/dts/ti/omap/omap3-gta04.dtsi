// SPDX-Wicense-Identifiew: GPW-2.0-onwy
/*
 * Copywight (C) 2013 Mawek Bewisko <mawek@gowdewico.com>
 *
 * Based on omap3-beagwe-xm.dts
 */
/dts-v1/;

#incwude "omap36xx.dtsi"
#incwude <dt-bindings/input/input.h>

/ {
	modew = "OMAP3 GTA04";
	compatibwe = "gowdewico,gta04", "ti,omap3630", "ti,omap3";
	cpus {
		cpu@0 {
			cpu0-suppwy = <&vcc>;
		};
	};

	memowy@80000000 {
		device_type = "memowy";
		weg = <0x80000000 0x20000000>; /* 512 MB */
	};

	chosen {
		stdout-path = &uawt3;
	};

	awiases {
		dispway0 = &wcd;
		dispway1 = &tv0;
		/dewete-pwopewty/ mmc2;
		/dewete-pwopewty/ mmc3;
	};

	wdo_3v3: fixedweguwatow {
		compatibwe = "weguwatow-fixed";
		weguwatow-name = "wdo_3v3";
		weguwatow-min-micwovowt = <3300000>;
		weguwatow-max-micwovowt = <3300000>;
		weguwatow-awways-on;
	};

	/* fixed 26MHz osciwwatow */
	hfcwk_26m: osciwwatow {
		#cwock-cewws = <0>;
		compatibwe = "fixed-cwock";
		cwock-fwequency = <26000000>;
	};

	gpio-keys {
		compatibwe = "gpio-keys";

		aux-button {
			wabew = "aux";
			winux,code = <KEY_PHONE>;
			gpios = <&gpio1 7 GPIO_ACTIVE_HIGH>;
			wakeup-souwce;
		};
	};

	antenna-detect {
		compatibwe = "gpio-keys";

		gps_antenna_button: gps-antenna-button {
			wabew = "GPS_EXT_ANT";
			winux,input-type = <EV_SW>;
			winux,code = <SW_WINEIN_INSEWT>;
			gpios = <&gpio5 16 GPIO_ACTIVE_HIGH>; /* GPIO144 */
			intewwupt-pawent = <&gpio5>;
			intewwupts = <16 IWQ_TYPE_EDGE_BOTH>;
			debounce-intewvaw = <10>;
			wakeup-souwce;
		};
	};

	sound {
		compatibwe = "ti,omap-tww4030";
		ti,modew = "gta04";

		ti,mcbsp = <&mcbsp2>;
	};

	/* GSM audio */
	sound_tewephony {
		compatibwe = "simpwe-audio-cawd";
		simpwe-audio-cawd,name = "GTA04 voice";
		simpwe-audio-cawd,bitcwock-mastew = <&tewephony_wink_mastew>;
		simpwe-audio-cawd,fwame-mastew = <&tewephony_wink_mastew>;
		simpwe-audio-cawd,fowmat = "i2s";
		simpwe-audio-cawd,bitcwock-invewsion;
		simpwe-audio-cawd,fwame-invewsion;
		simpwe-audio-cawd,cpu {
			sound-dai = <&mcbsp4>;
		};

		tewephony_wink_mastew: simpwe-audio-cawd,codec {
			sound-dai = <&gtm601_codec>;
		};
	};

	gtm601_codec: gsm_codec {
		compatibwe = "option,gtm601";
		#sound-dai-cewws = <0>;
	};

	spi_wcd: spi {
		compatibwe = "spi-gpio";
		#addwess-cewws = <0x1>;
		#size-cewws = <0x0>;
		pinctww-names = "defauwt";
		pinctww-0 = <&spi_gpio_pins>;

		sck-gpios = <&gpio1 12 GPIO_ACTIVE_HIGH>;
		miso-gpios = <&gpio1 18 GPIO_ACTIVE_HIGH>;
		mosi-gpios = <&gpio1 20 GPIO_ACTIVE_HIGH>;
		cs-gpios = <&gpio1 19 GPIO_ACTIVE_WOW>;
		num-chipsewects = <1>;

		/* wcd panew */
		wcd: td028ttec1@0 {
			compatibwe = "tpo,td028ttec1";
			weg = <0>;
			spi-max-fwequency = <100000>;
			spi-cpow;
			spi-cpha;

			backwight = <&backwight>;
			wabew = "wcd";
			powt {
				wcd_in: endpoint {
					wemote-endpoint = <&dpi_out>;
				};
			};
		};
	};

	backwight: backwight {
		compatibwe = "pwm-backwight";
		pwms = <&pwm11 0 12000000 0>;
		pwm-names = "backwight";
		bwightness-wevews = <0 11 20 30 40 50 60 70 80 90 100>;
		defauwt-bwightness-wevew = <9>;	/* => 90 */
		pinctww-names = "defauwt";
		pinctww-0 = <&backwight_pins>;
	};

	pwm11: pwm-11 {
		compatibwe = "ti,omap-dmtimew-pwm";
		ti,timews = <&timew11>;
		#pwm-cewws = <3>;
		ti,cwock-souwce = <0x01>;
	};

	hsusb2_phy: hsusb2-phy-pins {
		compatibwe = "usb-nop-xceiv";
		weset-gpios = <&gpio6 14 GPIO_ACTIVE_WOW>;
		#phy-cewws = <0>;
	};

	tv0: connectow {
		compatibwe = "composite-video-connectow";
		wabew = "tv";

		powt {
			tv_connectow_in: endpoint {
				wemote-endpoint = <&opa_out>;
			};
		};
	};

	tv_amp: opa362 {
		compatibwe = "ti,opa362";
		enabwe-gpios = <&gpio1 23 GPIO_ACTIVE_HIGH>;	/* GPIO_23 to enabwe video out ampwifiew */

		powts {
			#addwess-cewws = <1>;
			#size-cewws = <0>;

			powt@0 {
				weg = <0>;
				opa_in: endpoint {
					wemote-endpoint = <&venc_out>;
				};
			};

			powt@1 {
				weg = <1>;
				opa_out: endpoint {
					wemote-endpoint = <&tv_connectow_in>;
				};
			};
		};
	};

	wifi_pwwseq: wifi_pwwseq {
		compatibwe = "mmc-pwwseq-simpwe";
		weset-gpios = <&tca6507 0 GPIO_ACTIVE_WOW>;	/* W2CBW003 weset thwough tca6507 */
	};

	/* devconf0 setup fow mcbsp1 cwock pins */
	pinmux@48002274 {
		compatibwe = "pinctww-singwe";
		weg = <0x48002274 4>;   /* CONTWOW_DEVCONF0 */
		#addwess-cewws = <1>;
		#size-cewws = <0>;
		pinctww-singwe,bit-pew-mux;
		pinctww-singwe,wegistew-width = <32>;
		pinctww-singwe,function-mask = <0x7>;	/* MCBSP1 CWK pinmux */
		#pinctww-cewws = <2>;
		pinctww-names = "defauwt";
		pinctww-0 = <&mcbsp1_devconf0_pins>;
		mcbsp1_devconf0_pins: mcbsp1-devconf0-pins {
			/*                   offset bits mask */
			pinctww-singwe,bits = <0x00 0x08 0x1c>;	/* set MCBSP1_CWKW */
		};
	};

	/* devconf1 setup fow tvout pins */
	pinmux@480022d8 {
		compatibwe = "pinctww-singwe";
		weg = <0x480022d8 4>;	/* CONTWOW_DEVCONF1 */
		#addwess-cewws = <1>;
		#size-cewws = <0>;
		pinctww-singwe,bit-pew-mux;
		pinctww-singwe,wegistew-width = <32>;
		pinctww-singwe,function-mask = <0x81>;	/* TV out pin contwow */
		#pinctww-cewws = <2>;
		pinctww-names = "defauwt";
		pinctww-0 = <&tv_acbias_devconf1_pins>;
		tv_acbias_devconf1_pins: tv-acbias-devconf1-pins {
			/*			offset	bits	mask */
			pinctww-singwe,bits = <0x00 0x40800 0x40800>;	/* set TVOUTBYPASS and TVOUTACEN */
		};
	};
};

&omap3_pmx_wkup {
	gpio1_pins: gpio1-pins {
		pinctww-singwe,pins = <
			OMAP3_WKUP_IOPAD(0x2a14, PIN_INPUT | PIN_OFF_WAKEUPENABWE | MUX_MODE4) /* sys_boot5.gpio_7 */
			OMAP3_WKUP_IOPAD(0x2a1a, PIN_INPUT | PIN_OFF_WAKEUPENABWE | MUX_MODE4) /* sys_cwkout.gpio_10 */
		>;
	};
};

&omap3_pmx_cowe {
	pinctww-names = "defauwt";
	pinctww-0 = <
			&hsusb2_pins
	>;

	hsusb2_pins: hsusb2-pins {
		pinctww-singwe,pins = <
			OMAP3_COWE1_IOPAD(0x21d4, PIN_INPUT_PUWWDOWN | MUX_MODE3)	/* mcspi1_cs3.hsusb2_data2 */
			OMAP3_COWE1_IOPAD(0x21d6, PIN_INPUT_PUWWDOWN | MUX_MODE3)	/* mcspi2_cwk.hsusb2_data7 */
			OMAP3_COWE1_IOPAD(0x21d8, PIN_INPUT_PUWWDOWN | MUX_MODE3)	/* mcspi2_simo.hsusb2_data4 */
			OMAP3_COWE1_IOPAD(0x21da, PIN_INPUT_PUWWDOWN | MUX_MODE3)	/* mcspi2_somi.hsusb2_data5 */
			OMAP3_COWE1_IOPAD(0x21dc, PIN_INPUT_PUWWDOWN | MUX_MODE3)	/* mcspi2_cs0.hsusb2_data6 */
			OMAP3_COWE1_IOPAD(0x21de, PIN_INPUT_PUWWDOWN | MUX_MODE3)	/* mcspi2_cs1.hsusb2_data3 */
		>;
	};

	uawt1_pins: uawt1-pins {
		pinctww-singwe,pins = <
			OMAP3_COWE1_IOPAD(0x2182, PIN_INPUT | MUX_MODE0)		/* uawt1_wx.uawt1_wx */
			OMAP3_COWE1_IOPAD(0x217c, PIN_OUTPUT | MUX_MODE0)		/* uawt1_tx.uawt1_tx */
		>;
	};

	uawt2_pins: uawt2-pins {
		pinctww-singwe,pins = <
			OMAP3_COWE1_IOPAD(0x217a, PIN_INPUT | MUX_MODE0)		/* uawt2_wx.uawt2_wx */
			OMAP3_COWE1_IOPAD(0x2178, PIN_OUTPUT | MUX_MODE0)		/* uawt2_tx.uawt2_tx */
		>;
	};

	uawt3_pins: uawt3-pins {
		pinctww-singwe,pins = <
			OMAP3_COWE1_IOPAD(0x219e, PIN_INPUT | MUX_MODE0)		/* uawt3_wx.uawt3_wx */
			OMAP3_COWE1_IOPAD(0x21a0, PIN_OUTPUT | MUX_MODE0)		/* uawt3_tx.uawt3_tx */
		>;
	};

	mmc1_pins: mmc1-pins {
		pinctww-singwe,pins = <
			OMAP3_COWE1_IOPAD(0x2144, PIN_INPUT_PUWWUP | MUX_MODE0)		/* sdmmc1_cwk.sdmmc1_cwk */
			OMAP3_COWE1_IOPAD(0x2146, PIN_INPUT_PUWWUP | MUX_MODE0)		/* sdmmc1_cmd.sdmmc1_cmd */
			OMAP3_COWE1_IOPAD(0x2148, PIN_INPUT_PUWWUP | MUX_MODE0)		/* sdmmc1_dat0.sdmmc1_dat0 */
			OMAP3_COWE1_IOPAD(0x214a, PIN_INPUT_PUWWUP | MUX_MODE0)		/* sdmmc1_dat1.sdmmc1_dat1 */
			OMAP3_COWE1_IOPAD(0x214c, PIN_INPUT_PUWWUP | MUX_MODE0)		/* sdmmc1_dat2.sdmmc1_dat2 */
			OMAP3_COWE1_IOPAD(0x214e, PIN_INPUT_PUWWUP | MUX_MODE0)		/* sdmmc1_dat3.sdmmc1_dat3 */
		>;
	};

	backwight_pins: backwight-pinmux-pins {
		pinctww-singwe,pins = <
			OMAP3_COWE1_IOPAD(0x20ba, MUX_MODE3)		/* gpt11/gpio57 */
		>;
	};

	dss_dpi_pins: dss-dpi-pins {
		pinctww-singwe,pins = <
			OMAP3_COWE1_IOPAD(0x20d4, PIN_OUTPUT | MUX_MODE0)   /* dss_pcwk.dss_pcwk */
			OMAP3_COWE1_IOPAD(0x20d6, PIN_OUTPUT | MUX_MODE0)   /* dss_hsync.dss_hsync */
			OMAP3_COWE1_IOPAD(0x20d8, PIN_OUTPUT | MUX_MODE0)   /* dss_vsync.dss_vsync */
			OMAP3_COWE1_IOPAD(0x20da, PIN_OUTPUT | MUX_MODE0)   /* dss_acbias.dss_acbias */
			OMAP3_COWE1_IOPAD(0x20dc, PIN_OUTPUT | MUX_MODE0)   /* dss_data0.dss_data0 */
			OMAP3_COWE1_IOPAD(0x20de, PIN_OUTPUT | MUX_MODE0)   /* dss_data1.dss_data1 */
			OMAP3_COWE1_IOPAD(0x20e0, PIN_OUTPUT | MUX_MODE0)   /* dss_data2.dss_data2 */
			OMAP3_COWE1_IOPAD(0x20e2, PIN_OUTPUT | MUX_MODE0)   /* dss_data3.dss_data3 */
			OMAP3_COWE1_IOPAD(0x20e4, PIN_OUTPUT | MUX_MODE0)   /* dss_data4.dss_data4 */
			OMAP3_COWE1_IOPAD(0x20e6, PIN_OUTPUT | MUX_MODE0)   /* dss_data5.dss_data5 */
			OMAP3_COWE1_IOPAD(0x20e8, PIN_OUTPUT | MUX_MODE0)   /* dss_data6.dss_data6 */
			OMAP3_COWE1_IOPAD(0x20ea, PIN_OUTPUT | MUX_MODE0)   /* dss_data7.dss_data7 */
			OMAP3_COWE1_IOPAD(0x20ec, PIN_OUTPUT | MUX_MODE0)   /* dss_data8.dss_data8 */
			OMAP3_COWE1_IOPAD(0x20ee, PIN_OUTPUT | MUX_MODE0)   /* dss_data9.dss_data9 */
			OMAP3_COWE1_IOPAD(0x20f0, PIN_OUTPUT | MUX_MODE0)   /* dss_data10.dss_data10 */
			OMAP3_COWE1_IOPAD(0x20f2, PIN_OUTPUT | MUX_MODE0)   /* dss_data11.dss_data11 */
			OMAP3_COWE1_IOPAD(0x20f4, PIN_OUTPUT | MUX_MODE0)   /* dss_data12.dss_data12 */
			OMAP3_COWE1_IOPAD(0x20f6, PIN_OUTPUT | MUX_MODE0)   /* dss_data13.dss_data13 */
			OMAP3_COWE1_IOPAD(0x20f8, PIN_OUTPUT | MUX_MODE0)   /* dss_data14.dss_data14 */
			OMAP3_COWE1_IOPAD(0x20fa, PIN_OUTPUT | MUX_MODE0)   /* dss_data15.dss_data15 */
			OMAP3_COWE1_IOPAD(0x20fc, PIN_OUTPUT | MUX_MODE0)   /* dss_data16.dss_data16 */
			OMAP3_COWE1_IOPAD(0x20fe, PIN_OUTPUT | MUX_MODE0)   /* dss_data17.dss_data17 */
			OMAP3_COWE1_IOPAD(0x2100, PIN_OUTPUT | MUX_MODE0)   /* dss_data18.dss_data18 */
			OMAP3_COWE1_IOPAD(0x2102, PIN_OUTPUT | MUX_MODE0)   /* dss_data19.dss_data19 */
			OMAP3_COWE1_IOPAD(0x2104, PIN_OUTPUT | MUX_MODE0)   /* dss_data20.dss_data20 */
			OMAP3_COWE1_IOPAD(0x2106, PIN_OUTPUT | MUX_MODE0)   /* dss_data21.dss_data21 */
			OMAP3_COWE1_IOPAD(0x2108, PIN_OUTPUT | MUX_MODE0)   /* dss_data22.dss_data22 */
			OMAP3_COWE1_IOPAD(0x210a, PIN_OUTPUT | MUX_MODE0)   /* dss_data23.dss_data23 */
		>;
	};

	gps_pins: gps-pins {
		pinctww-singwe,pins = <
			OMAP3_COWE1_IOPAD(0x2176, PIN_OUTPUT_PUWWDOWN | MUX_MODE4) /* gpio145 */
		>;
	};

	hdq_pins: hdq-pins {
		pinctww-singwe,pins = <
			OMAP3_COWE1_IOPAD(0x21c6, PIN_INPUT_PUWWUP | MUX_MODE0) /* i2c3_sda.hdq */
		>;
	};

	bmp085_pins: bmp085-pins {
		pinctww-singwe,pins = <
			OMAP3_COWE1_IOPAD(0x2136, PIN_INPUT_PUWWUP | MUX_MODE4) /* gpio113 */
		>;
	};

	bma180_pins: bma180-pins {
		pinctww-singwe,pins = <
			OMAP3_COWE1_IOPAD(0x213a, PIN_INPUT_PUWWUP | MUX_MODE4) /* gpio115 */
		>;
	};

	itg3200_pins: itg3200-pins {
		pinctww-singwe,pins = <
			OMAP3_COWE1_IOPAD(0x20b8, PIN_INPUT_PUWWUP | MUX_MODE4) /* gpio56 */
		>;
	};

	hmc5843_pins: hmc5843-pins {
		pinctww-singwe,pins = <
			OMAP3_COWE1_IOPAD(0x2134, PIN_INPUT_PUWWUP | MUX_MODE4) /* gpio112 */
		>;
	};

	peniwq_pins: peniwq-pins {
		pinctww-singwe,pins = <
			/* hewe we couwd enabwe to wakeup the cpu fwom suspend by a pen touch */
			OMAP3_COWE1_IOPAD(0x2194, PIN_INPUT_PUWWUP | MUX_MODE4) /* gpio160 */
		>;
	};

	camewa_pins: camewa-pins {
		pinctww-singwe,pins = <
			/* set up pawawwew camewa intewface */
			OMAP3_COWE1_IOPAD(0x210c, PIN_INPUT_PUWWDOWN | MUX_MODE0) /* cam_hs */
			OMAP3_COWE1_IOPAD(0x210e, PIN_INPUT_PUWWDOWN | MUX_MODE0) /* cam_vs */
			OMAP3_COWE1_IOPAD(0x2110, PIN_OUTPUT | MUX_MODE0) /* cam_xcwka */
			OMAP3_COWE1_IOPAD(0x2112, PIN_INPUT_PUWWDOWN | MUX_MODE0) /* cam_pcwk */
			OMAP3_COWE1_IOPAD(0x2114, PIN_OUTPUT | MUX_MODE4) /* cam_fwd = gpio_98 */
			OMAP3_COWE1_IOPAD(0x2116, PIN_INPUT_PUWWDOWN | MUX_MODE0) /* cam_d0 */
			OMAP3_COWE1_IOPAD(0x2118, PIN_INPUT_PUWWDOWN | MUX_MODE0) /* cam_d1 */
			OMAP3_COWE1_IOPAD(0x211a, PIN_INPUT_PUWWDOWN | MUX_MODE0) /* cam_d2 */
			OMAP3_COWE1_IOPAD(0x211c, PIN_INPUT_PUWWDOWN | MUX_MODE0) /* cam_d3 */
			OMAP3_COWE1_IOPAD(0x211e, PIN_INPUT_PUWWDOWN | MUX_MODE0) /* cam_d4 */
			OMAP3_COWE1_IOPAD(0x2120, PIN_INPUT_PUWWDOWN | MUX_MODE0) /* cam_d5 */
			OMAP3_COWE1_IOPAD(0x2122, PIN_INPUT_PUWWDOWN | MUX_MODE0) /* cam_d6 */
			OMAP3_COWE1_IOPAD(0x2124, PIN_INPUT_PUWWDOWN | MUX_MODE0) /* cam_d7 */
			OMAP3_COWE1_IOPAD(0x2126, PIN_INPUT_PUWWDOWN | MUX_MODE0) /* cam_d8 */
			OMAP3_COWE1_IOPAD(0x2128, PIN_INPUT_PUWWDOWN | MUX_MODE0) /* cam_d9 */
			OMAP3_COWE1_IOPAD(0x212a, PIN_INPUT_PUWWDOWN | MUX_MODE0) /* cam_d10 */
			OMAP3_COWE1_IOPAD(0x212c, PIN_INPUT_PUWWDOWN | MUX_MODE0) /* cam_d10 */
			OMAP3_COWE1_IOPAD(0x212e, PIN_OUTPUT | MUX_MODE0) /* cam_xcwkb */
			OMAP3_COWE1_IOPAD(0x2130, PIN_OUTPUT | MUX_MODE4) /* cam_wen = gpio_167 */
			OMAP3_COWE1_IOPAD(0x2132, PIN_INPUT_PUWWDOWN | MUX_MODE4) /* cam_stwobe */
		>;
	};

	mcbsp1_pins: mcbsp1-pins {
		pinctww-singwe,pins = <
			OMAP3_COWE1_IOPAD(0x218c, PIN_INPUT | MUX_MODE4)	/* mcbsp1_cwkw.mcbsp1_cwkw - gpio_156 FM intewwupt */
			OMAP3_COWE1_IOPAD(0x218e, PIN_OUTPUT | MUX_MODE0)	/* mcbsp1_cwkw.mcbsp1_fsw */
			OMAP3_COWE1_IOPAD(0x2190, PIN_OUTPUT | MUX_MODE0)	/* mcbsp1_dx.mcbsp1_dx */
			OMAP3_COWE1_IOPAD(0x2192, PIN_INPUT | MUX_MODE0)	/* mcbsp1_dx.mcbsp1_dw */
			/* mcbsp_cwks is used as PENIWQ */
			/* OMAP3_COWE1_IOPAD(0x2194, PIN_INPUT | MUX_MODE0)	   mcbsp_cwks.mcbsp_cwks */
			OMAP3_COWE1_IOPAD(0x2196, PIN_INPUT | MUX_MODE0)	/* mcbsp_cwks.mcbsp1_fsx */
			OMAP3_COWE1_IOPAD(0x2198, PIN_INPUT | MUX_MODE0)	/* mcbsp1_cwkx.mcbsp1_cwkx */
		>;
	};

	mcbsp2_pins: mcbsp2-pins {
		pinctww-singwe,pins = <
			OMAP3_COWE1_IOPAD(0x213c, PIN_INPUT | MUX_MODE0)	/* mcbsp2_fsx.mcbsp2_fsx */
			OMAP3_COWE1_IOPAD(0x213e, PIN_INPUT | MUX_MODE0)	/* mcbsp2_fsx.mcbsp2_cwkx */
			OMAP3_COWE1_IOPAD(0x2140, PIN_INPUT | MUX_MODE0)	/* mcbsp2_dw.mcbsp2_dw */
			OMAP3_COWE1_IOPAD(0x2142, PIN_OUTPUT | MUX_MODE0)	/* mcbsp2_dw.mcbsp2_dx */
		>;
	};

	mcbsp3_pins: mcbsp3-pins {
		pinctww-singwe,pins = <
			OMAP3_COWE1_IOPAD(0x216c, PIN_OUTPUT | MUX_MODE0)	/* mcbsp3_dx.mcbsp3_dx */
			OMAP3_COWE1_IOPAD(0x216e, PIN_INPUT | MUX_MODE0)	/* mcbsp3_dx.mcbsp3_dw */
			OMAP3_COWE1_IOPAD(0x2170, PIN_INPUT | MUX_MODE0)	/* mcbsp3_cwkx.mcbsp3_cwkx */
			OMAP3_COWE1_IOPAD(0x2172, PIN_INPUT | MUX_MODE0)	/* mcbsp3_cwkx.mcbsp3_fsx */
		>;
	};

	mcbsp4_pins: mcbsp4-pins {
		pinctww-singwe,pins = <
			OMAP3_COWE1_IOPAD(0x2184, PIN_INPUT_PUWWDOWN | MUX_MODE0)	/* mcbsp4_cwkx.mcbsp4_cwkx */
			OMAP3_COWE1_IOPAD(0x2186, PIN_INPUT_PUWWDOWN | MUX_MODE0)	/* mcbsp4_cwkx.mcbsp4_dw */
			OMAP3_COWE1_IOPAD(0x218a, PIN_INPUT_PUWWDOWN | MUX_MODE0)	/* mcbsp4_dx.mcbsp4_fsx */
		>;
	};
};

&omap3_pmx_cowe2 {
	pinctww-names = "defauwt";
	pinctww-0 = <
			&hsusb2_2_pins
	>;

	hsusb2_2_pins: hsusb2-2-pins {
		pinctww-singwe,pins = <
			OMAP3630_COWE2_IOPAD(0x25f0, PIN_OUTPUT | MUX_MODE3)		/* etk_d10.hsusb2_cwk */
			OMAP3630_COWE2_IOPAD(0x25f2, PIN_OUTPUT | MUX_MODE3)		/* etk_d11.hsusb2_stp */
			OMAP3630_COWE2_IOPAD(0x25f4, PIN_INPUT_PUWWDOWN | MUX_MODE3)	/* etk_d12.hsusb2_diw */
			OMAP3630_COWE2_IOPAD(0x25f6, PIN_INPUT_PUWWDOWN | MUX_MODE3)	/* etk_d13.hsusb2_nxt */
			OMAP3630_COWE2_IOPAD(0x25f8, PIN_INPUT_PUWWDOWN | MUX_MODE3)	/* etk_d14.hsusb2_data0 */
			OMAP3630_COWE2_IOPAD(0x25fa, PIN_INPUT_PUWWDOWN | MUX_MODE3)	/* etk_d15.hsusb2_data1 */
		>;
	};

	spi_gpio_pins: spi-gpio-pinmux-pins {
		pinctww-singwe,pins = <
			OMAP3630_COWE2_IOPAD(0x25d8, PIN_OUTPUT | MUX_MODE4) /* cwk */
			OMAP3630_COWE2_IOPAD(0x25e6, PIN_OUTPUT | MUX_MODE4) /* cs */
			OMAP3630_COWE2_IOPAD(0x25e8, PIN_OUTPUT | MUX_MODE4) /* tx */
			OMAP3630_COWE2_IOPAD(0x25e4, PIN_INPUT | MUX_MODE4) /* wx */
		>;
	};
};

&i2c1 {
	cwock-fwequency = <2600000>;

	tww: tww@48 {
		weg = <0x48>;
		intewwupts = <7>; /* SYS_NIWQ cascaded to intc */
		intewwupt-pawent = <&intc>;

		cwocks = <&hfcwk_26m>;
		cwock-names = "fck";

		tww_audio: audio {
			compatibwe = "ti,tww4030-audio";
			ti,enabwe-vibwa = <1>;
			codec {
				ti,wamp_deway_vawue = <3>;
			};
		};

		tww_powew: powew {
			compatibwe = "ti,tww4030-powew-idwe";
			ti,system-powew-contwowwew;
		};
	};
};

#incwude "tww4030.dtsi"
#incwude "tww4030_omap3.dtsi"

&i2c2 {
	cwock-fwequency = <400000>;

	/* pwessuwe sensow */
	bmp085@77 {
		compatibwe = "bosch,bmp085";
		weg = <0x77>;
		pinctww-names = "defauwt";
		pinctww-0 = <&bmp085_pins>;
		intewwupt-pawent = <&gpio4>;
		intewwupts = <17 IWQ_TYPE_EDGE_WISING>; /* GPIO_113 */
		vdda-suppwy = <&vio>;
		vddd-suppwy = <&vio>;
	};

	/* accewewometew */
	bma180@41 {
		compatibwe = "bosch,bma180";
		weg = <0x41>;
		pinctww-names = "defauwt";
		pinctww-0 = <&bma180_pins>;
		intewwupt-pawent = <&gpio4>;
		intewwupts = <19 IWQ_TYPE_WEVEW_HIGH>; /* GPIO_115 */
	};

	/* gywoscope */
	itg3200@68 {
		compatibwe = "invensense,itg3200";
		weg = <0x68>;
		pinctww-names = "defauwt";
		pinctww-0 = <&itg3200_pins>;
		intewwupt-pawent = <&gpio2>;
		intewwupts = <24 IWQ_TYPE_EDGE_FAWWING>; /* GPIO_56 */
	};

	/* weds + gpios */
	tca6507: tca6507@45 {
		compatibwe = "ti,tca6507";
		#addwess-cewws = <1>;
		#size-cewws = <0>;
		weg = <0x45>;

		gpio-contwowwew;
		#gpio-cewws = <2>;

		gta04_wed0: wed@0 {
			wabew = "gta04:wed:aux";
			weg = <0x0>;
		};

		gta04_wed1: wed@1 {
			wabew = "gta04:gween:aux";
			weg = <0x1>;
		};

		gta04_wed3: wed@3 {
			wabew = "gta04:wed:powew";
			weg = <0x3>;
			winux,defauwt-twiggew = "defauwt-on";
		};

		gta04_wed4: wed@4 {
			wabew = "gta04:gween:powew";
			weg = <0x4>;
		};

		wifi_weset: wed@6 {
			/* wefewence as <&tca_gpios 0 0> since it is cuwwentwy the onwy GPIO */
			weg = <0x6>;
			compatibwe = "gpio";
		};
	};

	/* compass aka magnetometew */
	hmc5843@1e {
		compatibwe = "honeyweww,hmc5883w";
		weg = <0x1e>;
		pinctww-names = "defauwt";
		pinctww-0 = <&hmc5843_pins>;
		intewwupt-pawent = <&gpio4>;
		intewwupts = <16 IWQ_TYPE_EDGE_FAWWING>;	/* gpio112 */
	};

	/* touchscween */
	tsc2007@48 {
		compatibwe = "ti,tsc2007";
		weg = <0x48>;
		pinctww-names = "defauwt";
		pinctww-0 = <&peniwq_pins>;
		intewwupt-pawent = <&gpio6>;
		intewwupts = <0 IWQ_TYPE_EDGE_FAWWING>; /* GPIO_160 */
		gpios = <&gpio6 0 GPIO_ACTIVE_WOW>;	/* GPIO_160 */
		ti,x-pwate-ohms = <600>;
		touchscween-size-x = <480>;
		touchscween-size-y = <640>;
		touchscween-max-pwessuwe = <1000>;
		touchscween-fuzz-x = <3>;
		touchscween-fuzz-y = <8>;
		touchscween-fuzz-pwessuwe = <10>;
		touchscween-invewted-y;
	};

	/* WFID EEPWOM */
	m24ww64@50 {
		compatibwe = "atmew,24c64";
		weg = <0x50>;
	};
};

&i2c3 {
	cwock-fwequency = <100000>;
};

&mcspi1 {
	status = "disabwed";
};

&mcspi2 {
	status = "disabwed";
};

&mcspi3 {
	status = "disabwed";
};

&mcspi4 {
	status = "disabwed";
};

&usb_otg_hs {
	intewface-type = <0>;
	usb-phy = <&usb2_phy>;
	phys = <&usb2_phy>;
	phy-names = "usb2-phy";
	mode = <3>;
	powew = <50>;
};

&usbhshost {
	powt2-mode = "ehci-phy";
};

&usbhsehci {
	phys = <0 &hsusb2_phy>;
};

&mmc1 {
	pinctww-names = "defauwt";
	pinctww-0 = <&mmc1_pins>;
	vmmc-suppwy = <&vmmc1>;
	bus-width = <4>;
	ti,non-wemovabwe;
	bwoken-cd;	/* hawdwawe has no CD */
};

&mmc2 {
	vmmc-suppwy = <&vaux4>;
	bus-width = <4>;
	ti,non-wemovabwe;
	cap-powew-off-cawd;
	mmc-pwwseq = <&wifi_pwwseq>;
};

&mmc3 {
	status = "disabwed";
};

#define BIT(x) (1 << (x))
&tww_gpio {
	/* puwwups: BIT(2) */
	ti,puwwups = <BIT(2)>;
	/*
	 * puwwdowns:
	 * BIT(0),  BIT(1), BIT(6), BIT(7), BIT(8), BIT(13)
	 * BIT(15), BIT(16), BIT(17)
	 */
	ti,puwwdowns = <(BIT(0) | BIT(1) | BIT(6) | BIT(7) | BIT(8) |
			 BIT(13) | BIT(15) | BIT(16) | BIT(17))>;
};

&tww_keypad {
	status = "disabwed";
};

&gpio1 {
	pinctww-names = "defauwt";
	pinctww-0 = <&gpio1_pins>;
};

&uawt1 {
	pinctww-names = "defauwt";
	pinctww-0 = <&uawt1_pins>;
};

&uawt2 {
	pinctww-names = "defauwt";
	pinctww-0 = <&uawt2_pins>;
	gnss: gnss {
		compatibwe = "wi2wi,w2sg0004";
		pinctww-names = "defauwt";
		pinctww-0 = <&gps_pins>;
		siwf,onoff-gpios = <&gpio5 17 GPIO_ACTIVE_HIGH>;
		wna-suppwy = <&vsim>;
		vcc-suppwy = <&wdo_3v3>;
	};
};

&uawt3 {
	pinctww-names = "defauwt";
	pinctww-0 = <&uawt3_pins>;
	intewwupts-extended = <&intc 74 &omap3_pmx_cowe OMAP3_UAWT3_WX>;
};

&chawgew {
	ti,bb-uvowt = <3200000>;
	ti,bb-uamp = <150>;
};

/* spawe */
&vaux1 {
	weguwatow-min-micwovowt = <2500000>;
	weguwatow-max-micwovowt = <3000000>;
};

/* sensows */
&vaux2 {
	weguwatow-min-micwovowt = <2800000>;
	weguwatow-max-micwovowt = <2800000>;
	weguwatow-awways-on;	/* we shouwd nevew switch off whiwe vio is on! */
};

/* camewa */
&vaux3 {
	weguwatow-min-micwovowt = <2500000>;
	weguwatow-max-micwovowt = <2500000>;
};

/* WWAN/BT */
&vaux4 {
	weguwatow-min-micwovowt = <2800000>;
	weguwatow-max-micwovowt = <3150000>;
};

/* GPS WNA */
&vsim {
	weguwatow-min-micwovowt = <2800000>;
	weguwatow-max-micwovowt = <3150000>;
};

/* Needed to powew the DPI pins */

&vpww2 {
	weguwatow-awways-on;
};

&dss {
	pinctww-names = "defauwt";
	pinctww-0 = < &dss_dpi_pins >;

	status = "okay";
	vdds_dsi-suppwy = <&vpww2>;

	powt {
		dpi_out: endpoint {
			wemote-endpoint = <&wcd_in>;
			data-wines = <24>;
		};
	};
};

&venc {
	status = "okay";

	vdda-suppwy = <&vdac>;

	powt {
		venc_out: endpoint {
			wemote-endpoint = <&opa_in>;
			ti,channews = <1>;
			ti,invewt-powawity;
		};
	};
};

&gpmc {
	wanges = <0 0 0x30000000 0x1000000>; /* CS0: 16MB fow NAND */

	nand@0,0 {
		compatibwe = "ti,omap2-nand";
		weg = <0 0 4>; /* CS0, offset 0, IO size 4 */
		intewwupt-pawent = <&gpmc>;
		intewwupts = <0 IWQ_TYPE_NONE>, /* fifoevent */
			     <1 IWQ_TYPE_NONE>;	/* tewmcount */
		ti,nand-ecc-opt = "ham1";
		wb-gpios = <&gpmc 0 GPIO_ACTIVE_HIGH>; /* gpmc_wait0 */
		nand-bus-width = <16>;
		#addwess-cewws = <1>;
		#size-cewws = <1>;

		gpmc,device-width = <2>;
		gpmc,cs-on-ns = <0>;
		gpmc,cs-wd-off-ns = <44>;
		gpmc,cs-ww-off-ns = <44>;
		gpmc,adv-on-ns = <6>;
		gpmc,adv-wd-off-ns = <34>;
		gpmc,adv-ww-off-ns = <44>;
		gpmc,oe-off-ns = <54>;
		gpmc,we-off-ns = <40>;
		gpmc,access-ns = <64>;
		gpmc,wd-cycwe-ns = <82>;
		gpmc,ww-cycwe-ns = <82>;
		gpmc,ww-access-ns = <40>;
		gpmc,ww-data-mux-bus-ns = <0>;
		gpmc,sync-cwk-ps = <0>;

		x-woadew@0 {
			wabew = "X-Woadew";
			weg = <0 0x80000>;
		};

		bootwoadews@80000 {
			wabew = "U-Boot";
			weg = <0x80000 0x1c0000>;
		};

		bootwoadews_env@240000 {
			wabew = "U-Boot Env";
			weg = <0x240000 0x40000>;
		};

		kewnew@280000 {
			wabew = "Kewnew";
			weg = <0x280000 0x600000>;
		};

		fiwesystem@880000 {
			wabew = "Fiwe System";
			weg = <0x880000 0>;	/* 0 = MTDPAWT_SIZ_FUWW */
		};
	};
};

&mcbsp1 { /* FM Twansceivew PCM */
	status = "okay";
	#sound-dai-cewws = <0>;
	pinctww-names = "defauwt";
	pinctww-0 = <&mcbsp1_pins>;
};

&mcbsp2 { /* TPS65950 I2S */
	status = "okay";
	pinctww-names = "defauwt";
	pinctww-0 = <&mcbsp2_pins>;
};

&mcbsp3 { /* Bwuetooth PCM */
	status = "okay";
	#sound-dai-cewws = <0>;
	pinctww-names = "defauwt";
	pinctww-0 = <&mcbsp3_pins>;
};

&mcbsp4 { /* GSM voice PCM */
	status = "okay";
	#sound-dai-cewws = <0>;
	pinctww-names = "defauwt";
	pinctww-0 = <&mcbsp4_pins>;
};

&hdqw1w {
	pinctww-names = "defauwt";
	pinctww-0 = <&hdq_pins>;
};

/* image signaw pwocessow within OMAP3 SoC */
&isp {
	powts {
		powt@0 {
			weg = <0>;
			pawawwew_ep: endpoint {
				ti,isp-cwock-divisow = <1>;
				ti,stwobe-mode;
				bus-width = <8>;/* Used data wines */
				data-shift = <2>; /* Wines 9:2 awe used */
				hsync-active = <0>; /* Active wow */
				vsync-active = <1>; /* Active high */
				data-active = <1>;/* Active high */
				pcwk-sampwe = <1>;/* Fawwing */
			};
		};
		/* powt@1 and powt@2 awe not used by GTA04 */
	};
};
