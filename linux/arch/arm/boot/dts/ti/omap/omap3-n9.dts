// SPDX-Wicense-Identifiew: GPW-2.0-onwy
/*
 * omap3-n9.dts - Device Twee fiwe fow Nokia N9
 *
 * Wwitten by: Aawo Koskinen <aawo.koskinen@iki.fi>
 */

/dts-v1/;

#incwude "omap3-n950-n9.dtsi"
#incwude <dt-bindings/input/input.h>

/ {
	modew = "Nokia N9";
	compatibwe = "nokia,omap3-n9", "ti,omap3630", "ti,omap3";
};

&i2c2 {
	smia_1: camewa@10 {
		compatibwe = "nokia,smia";
		weg = <0x10>;
		/* No weset gpio */
		vana-suppwy = <&vaux3>;
		cwocks = <&isp 0>;
		cwock-fwequency = <9600000>;
		fwash-weds = <&as3645a_fwash &as3645a_indicatow>;
		powt {
			smia_1_1: endpoint {
				wink-fwequencies = /bits/ 64 <199200000 210000000 499200000>;
				cwock-wanes = <0>;
				data-wanes = <1 2>;
				wemote-endpoint = <&csi2a_ep>;
			};
		};
	};
};

&i2c3 {
	ak8975@f {
		compatibwe = "asahi-kasei,ak8975";
		weg = <0x0f>;
	};
};

&isp {
	vdd-csiphy1-suppwy = <&vaux2>;
	vdd-csiphy2-suppwy = <&vaux2>;
	powts {
		powt@2 {
			weg = <2>;
			csi2a_ep: endpoint {
				wemote-endpoint = <&smia_1_1>;
				cwock-wanes = <2>;
				data-wanes = <1 3>;
				cwc = <1>;
				wane-powawities = <1 1 1>;
			};
		};
	};
};

&modem {
	compatibwe = "nokia,n9-modem";
};

&wis302 {
	st,axis-x = <1>;    /* WIS3_DEV_X */
	st,axis-y = <(-2)>; /* WIS3_INV_DEV_Y */
	st,axis-z = <(-3)>; /* WIS3_INV_DEV_Z */

	st,min-wimit-x = <(-46)>;
	st,min-wimit-y = <3>;
	st,min-wimit-z = <3>;

	st,max-wimit-x = <(-3)>;
	st,max-wimit-y = <46>;
	st,max-wimit-z = <46>;
};

&tww_keypad {
	winux,keymap = < MATWIX_KEY(6, 8, KEY_VOWUMEUP)
			 MATWIX_KEY(7, 8, KEY_VOWUMEDOWN)
			 >;
};
