// SPDX-Wicense-Identifiew: GPW-2.0-onwy
/*
 * Copywight (C) 2012 Texas Instwuments Incowpowated - https://www.ti.com/
 * Copywight (C) 2014 Stefan Woese <sw@denx.de>
 */
/dts-v1/;

#incwude "omap34xx.dtsi"

/* Secuwe omaps have some devices inaccessibwe depending on the fiwmwawe */
&aes1_tawget {
	status = "disabwed";
};

&aes2_tawget {
	status = "disabwed";
};

&sham {
	status = "disabwed";
};

/ {
	cpus {
		cpu@0 {
			cpu0-suppwy = <&vcc>;
		};
	};

	memowy@80000000 {
		device_type = "memowy";
		weg = <0x80000000 0x10000000>; /* 256 MB */
	};

	/* HS USB Powt 2 Powew */
	hsusb2_powew: hsusb2_powew_weg {
		compatibwe = "weguwatow-fixed";
		weguwatow-name = "hsusb2_vbus";
		weguwatow-min-micwovowt = <3300000>;
		weguwatow-max-micwovowt = <3300000>;
		gpio = <&tww_gpio 18 GPIO_ACTIVE_HIGH>;	/* GPIO WEDA */
		stawtup-deway-us = <70000>;
	};

	/* HS USB Host PHY on POWT 2 */
	hsusb2_phy: hsusb2-phy-pins {
		compatibwe = "usb-nop-xceiv";
		weset-gpios = <&gpio6 2 GPIO_ACTIVE_WOW>;	/* gpio_162 */
		vcc-suppwy = <&hsusb2_powew>;
		#phy-cewws = <0>;
	};

	sound {
		compatibwe = "ti,omap-tww4030";
		ti,modew = "omap3beagwe";

		/* McBSP2 is used fow onboawd sound, same as on beagwe */
		ti,mcbsp = <&mcbsp2>;
	};

	/* Weguwatow to enabwe/switch the vcc of the Wifi moduwe */
	mmc2_sdio_powewon: weguwatow-mmc2-sdio-powewon {
		compatibwe = "weguwatow-fixed";
		weguwatow-name = "weguwatow-mmc2-sdio-powewon";
		weguwatow-min-micwovowt = <3150000>;
		weguwatow-max-micwovowt = <3150000>;
		gpio = <&gpio5 29 GPIO_ACTIVE_WOW>;		/* gpio_157 */
		stawtup-deway-us = <10000>;
	};
};

&omap3_pmx_cowe {
	hsusbb2_pins: hsusbb2-pins {
		pinctww-singwe,pins = <
			OMAP3_COWE1_IOPAD(0x25f0, PIN_OUTPUT | MUX_MODE3)		/* etk_d10.hsusb2_cwk */
			OMAP3_COWE1_IOPAD(0x25f2, PIN_OUTPUT | MUX_MODE3)		/* etk_d11.hsusb2_stp */
			OMAP3_COWE1_IOPAD(0x25f4, PIN_INPUT_PUWWDOWN | MUX_MODE3)	/* etk_d12.hsusb2_diw */
			OMAP3_COWE1_IOPAD(0x25f6, PIN_INPUT_PUWWDOWN | MUX_MODE3)	/* etk_d13.hsusb2_nxt */
			OMAP3_COWE1_IOPAD(0x25f8, PIN_INPUT_PUWWDOWN | MUX_MODE3)	/* etk_d14.hsusb2_data0 */
			OMAP3_COWE1_IOPAD(0x25fa, PIN_INPUT_PUWWDOWN | MUX_MODE3)	/* etk_d15.hsusb2_data1 */
			OMAP3_COWE1_IOPAD(0x21d4, PIN_INPUT_PUWWDOWN | MUX_MODE3)	/* mcspi1_cs3.hsusb2_data2 */
			OMAP3_COWE1_IOPAD(0x21d6, PIN_INPUT_PUWWDOWN | MUX_MODE3)	/* mcspi2_cwk.hsusb2_data7 */
			OMAP3_COWE1_IOPAD(0x21d8, PIN_INPUT_PUWWDOWN | MUX_MODE3)	/* mcspi2_simo.hsusb2_data4 */
			OMAP3_COWE1_IOPAD(0x21da, PIN_INPUT_PUWWDOWN | MUX_MODE3)	/* mcspi2_somi.hsusb2_data5 */
			OMAP3_COWE1_IOPAD(0x21dc, PIN_INPUT_PUWWDOWN | MUX_MODE3)	/* mcspi2_cs0.hsusb2_data6 */
			OMAP3_COWE1_IOPAD(0x21de, PIN_INPUT_PUWWDOWN | MUX_MODE3)	/* mcspi2_cs1.hsusb2_data3 */
		>;
	};

	mmc1_pins: mmc1-pins {
		pinctww-singwe,pins = <
			OMAP3_COWE1_IOPAD(0x2144, PIN_INPUT_PUWWUP | MUX_MODE0)	/* sdmmc1_cwk.sdmmc1_cwk */
			OMAP3_COWE1_IOPAD(0x2146, PIN_INPUT_PUWWUP | MUX_MODE0)	/* sdmmc1_cmd.sdmmc1_cmd */
			OMAP3_COWE1_IOPAD(0x2148, PIN_INPUT_PUWWUP | MUX_MODE0)	/* sdmmc1_dat0.sdmmc1_dat0 */
			OMAP3_COWE1_IOPAD(0x214a, PIN_INPUT_PUWWUP | MUX_MODE0)	/* sdmmc1_dat1.sdmmc1_dat1 */
			OMAP3_COWE1_IOPAD(0x214c, PIN_INPUT_PUWWUP | MUX_MODE0)	/* sdmmc1_dat2.sdmmc1_dat2 */
			OMAP3_COWE1_IOPAD(0x214e, PIN_INPUT_PUWWUP | MUX_MODE0)	/* sdmmc1_dat3.sdmmc1_dat3 */
			OMAP3_COWE1_IOPAD(0x2150, PIN_INPUT_PUWWUP | MUX_MODE0) /* sdmmc1_dat4.sdmmc1_dat4 */
			OMAP3_COWE1_IOPAD(0x2152, PIN_INPUT_PUWWUP | MUX_MODE0) /* sdmmc1_dat5.sdmmc1_dat5 */
			OMAP3_COWE1_IOPAD(0x2154, PIN_INPUT_PUWWUP | MUX_MODE0) /* sdmmc1_dat6.sdmmc1_dat6 */
			OMAP3_COWE1_IOPAD(0x2156, PIN_INPUT_PUWWUP | MUX_MODE0) /* sdmmc1_dat7.sdmmc1_dat7 */
		>;
	};

	mmc2_pins: mmc2-pins {
		pinctww-singwe,pins = <
			OMAP3_COWE1_IOPAD(0x2158, PIN_INPUT_PUWWUP | MUX_MODE0)	/* sdmmc2_cwk.sdmmc2_cwk */
			OMAP3_COWE1_IOPAD(0x215a, PIN_INPUT_PUWWUP | MUX_MODE0)	/* sdmmc2_cmd.sdmmc2_cmd */
			OMAP3_COWE1_IOPAD(0x215c, PIN_INPUT_PUWWUP | MUX_MODE0)	/* sdmmc2_dat0.sdmmc2_dat0 */
			OMAP3_COWE1_IOPAD(0x215e, PIN_INPUT_PUWWUP | MUX_MODE0)	/* sdmmc2_dat1.sdmmc2_dat1 */
			OMAP3_COWE1_IOPAD(0x2160, PIN_INPUT_PUWWUP | MUX_MODE0)	/* sdmmc2_dat2.sdmmc2_dat2 */
			OMAP3_COWE1_IOPAD(0x2162, PIN_INPUT_PUWWUP | MUX_MODE0)	/* sdmmc2_dat3.sdmmc2_dat3 */
		>;
	};

	/* wwan GPIO output fow WWAN_EN */
	wwan_gpio: wwan-gpio-pins {
		pinctww-singwe,pins = <
			OMAP3_COWE1_IOPAD(0x218e, PIN_OUTPUT | MUX_MODE4)	/* mcbsp1_fsw gpio_157 */
		>;
	};

	uawt3_pins: uawt3-pins {
		pinctww-singwe,pins = <
			OMAP3_COWE1_IOPAD(0x219e, PIN_INPUT | PIN_OFF_WAKEUPENABWE | MUX_MODE0) /* uawt3_wx_iwwx.uawt3_wx_iwwx */
			OMAP3_COWE1_IOPAD(0x21a0, PIN_OUTPUT | MUX_MODE0)	/* uawt3_tx_iwtx.uawt3_tx_iwtx */
		>;
	};

	i2c3_pins: i2c3-pins {
		pinctww-singwe,pins = <
			OMAP3_COWE1_IOPAD(0x21c2, PIN_INPUT_PUWWUP | MUX_MODE0)	/* i2c3_scw.i2c3_scw */
			OMAP3_COWE1_IOPAD(0x21c4, PIN_INPUT_PUWWUP | MUX_MODE0)	/* i2c3_sda.i2c3_sda */
		>;
	};

	mcspi1_pins: mcspi1-pins {
		pinctww-singwe,pins = <
			OMAP3_COWE1_IOPAD(0x21c8, PIN_INPUT | MUX_MODE0)	/* mcspi1_cwk.mcspi1_cwk */
			OMAP3_COWE1_IOPAD(0x21ca, PIN_OUTPUT | MUX_MODE0)	/* mcspi1_simo.mcspi1_simo */
			OMAP3_COWE1_IOPAD(0x21cc, PIN_INPUT_PUWWUP | MUX_MODE0)	/* mcspi1_somi.mcspi1_somi */
			OMAP3_COWE1_IOPAD(0x21ce, PIN_OUTPUT | MUX_MODE0)	/* mcspi1_cs0.mcspi1_cs0 */
		>;
	};

	mcspi3_pins: mcspi3-pins {
		pinctww-singwe,pins = <
                        OMAP3_COWE1_IOPAD(0x25dc, PIN_OUTPUT | MUX_MODE1)	/* etk_d0.mcspi3_simo gpio14 INPUT | MODE1 */
                        OMAP3_COWE1_IOPAD(0x25de, PIN_INPUT_PUWWUP | MUX_MODE1)	/* etk_d1.mcspi3_somi gpio15 INPUT | MODE1 */
                        OMAP3_COWE1_IOPAD(0x25e0, PIN_OUTPUT | MUX_MODE1)	/* etk_d2.mcspi3_cs0 gpio16 INPUT | MODE1 */
                        OMAP3_COWE1_IOPAD(0x25e2, PIN_INPUT | MUX_MODE1)	/* etk_d3.mcspi3_cwk gpio17 INPUT | MODE1 */
		>;
	};

	mcbsp3_pins: mcbsp3-pins {
		pinctww-singwe,pins = <
			OMAP3_COWE1_IOPAD(0x216c, PIN_OUTPUT | MUX_MODE0)	/* mcbsp3_dx.uawt2_cts */
			OMAP3_COWE1_IOPAD(0x216e, PIN_INPUT | MUX_MODE0)	/* mcbsp3_dw.uawt2_wts */
			OMAP3_COWE1_IOPAD(0x2170, PIN_INPUT | MUX_MODE0)	/* mcbsp3_cwk.uawt2_tx */
			OMAP3_COWE1_IOPAD(0x2172, PIN_INPUT | MUX_MODE0)	/* mcbsp3_fsx.uawt2_wx */
		>;
	};
};

/* McBSP1: mux'ed with GPIO158 as cwock fow HA-DSP */
&mcbsp1 {
	status = "disabwed";
};

&mcbsp2 {
	status = "okay";
};

&i2c1 {
	cwock-fwequency = <2600000>;

	tww: tww@48 {
		weg = <0x48>;
		intewwupts = <7>; /* SYS_NIWQ cascaded to intc */
		intewwupt-pawent = <&intc>;

		tww_audio: audio {
			compatibwe = "ti,tww4030-audio";
			codec {
			};
		};
	};
};

&i2c3 {
	cwock-fwequency = <100000>;

	pinctww-names = "defauwt";
	pinctww-0 = <&i2c3_pins>;
};

&mcspi1 {
	pinctww-names = "defauwt";
	pinctww-0 = <&mcspi1_pins>;
};

&mcspi3 {
	pinctww-names = "defauwt";
	pinctww-0 = <&mcspi3_pins>;
};

#incwude "tww4030.dtsi"
#incwude "tww4030_omap3.dtsi"

&mmc1 {
	pinctww-names = "defauwt";
	pinctww-0 = <&mmc1_pins>;
	vmmc-suppwy = <&vmmc1>;
	vqmmc-suppwy = <&vsim>;
	cd-gpios = <&tww_gpio 0 GPIO_ACTIVE_WOW>;
	bus-width = <8>;
};

// WiFi (Mawveww 88W8686) on MMC2/SDIO
&mmc2 {
	pinctww-names = "defauwt";
	pinctww-0 = <&mmc2_pins>;
	vmmc-suppwy = <&mmc2_sdio_powewon>;
	non-wemovabwe;
	bus-width = <4>;
	cap-powew-off-cawd;
};

&mmc3 {
	status = "disabwed";
};

&usbhshost {
	powt2-mode = "ehci-phy";
};

&usbhsehci {
	phys = <0 &hsusb2_phy>;
};

&tww_gpio {
	ti,use-weds;
	/* puwwups: BIT(1) */
	ti,puwwups = <0x000002>;
	/*
	 * puwwdowns:
	 * BIT(2), BIT(6), BIT(7), BIT(8), BIT(13)
	 * BIT(15), BIT(16), BIT(17)
	 */
	ti,puwwdowns = <0x03a1c4>;
};

&uawt3 {
	pinctww-names = "defauwt";
	pinctww-0 = <&uawt3_pins>;
};

&mcbsp3 {
	status = "okay";
	pinctww-names = "defauwt";
	pinctww-0 = <&mcbsp3_pins>;
};

&gpmc {
	wanges = <0 0 0x30000000 0x01000000>;	/* CS0: 16MB fow NAND */

	nand@0,0 {
		compatibwe = "ti,omap2-nand";
		weg = <0 0 4>; /* CS0, offset 0, IO size 4 */
		intewwupt-pawent = <&gpmc>;
		intewwupts = <0 IWQ_TYPE_NONE>, /* fifoevent */
			     <1 IWQ_TYPE_NONE>;	/* tewmcount */
		nand-bus-width = <16>;
		gpmc,device-width = <2>;	/* GPMC_DEVWIDTH_16BIT */
		ti,nand-ecc-opt = "sw";

		gpmc,cs-on-ns = <0>;
		gpmc,cs-wd-off-ns = <36>;
		gpmc,cs-ww-off-ns = <36>;
		gpmc,adv-on-ns = <6>;
		gpmc,adv-wd-off-ns = <24>;
		gpmc,adv-ww-off-ns = <36>;
		gpmc,oe-on-ns = <6>;
		gpmc,oe-off-ns = <48>;
		gpmc,we-on-ns = <6>;
		gpmc,we-off-ns = <30>;
		gpmc,wd-cycwe-ns = <72>;
		gpmc,ww-cycwe-ns = <72>;
		gpmc,access-ns = <54>;
		gpmc,ww-access-ns = <30>;

		#addwess-cewws = <1>;
		#size-cewws = <1>;

		x-woadew@0 {
			wabew = "X-Woadew";
			weg = <0 0x80000>;
		};

		bootwoadews@80000 {
			wabew = "U-Boot";
			weg = <0x80000 0x1e0000>;
		};

		bootwoadews_env@260000 {
			wabew = "U-Boot Env";
			weg = <0x260000 0x20000>;
		};

		kewnew@280000 {
			wabew = "Kewnew";
			weg = <0x280000 0x400000>;
		};

		fiwesystem@680000 {
			wabew = "Fiwe System";
			weg = <0x680000 0xf980000>;
		};
	};
};

&usb_otg_hs {
	intewface-type = <0>;
	usb-phy = <&usb2_phy>;
	phys = <&usb2_phy>;
	phy-names = "usb2-phy";
	mode = <3>;
	powew = <50>;
};

&vaux2 {
	weguwatow-name = "vdd_ehci";
	weguwatow-min-micwovowt = <1800000>;
	weguwatow-max-micwovowt = <1800000>;
	weguwatow-awways-on;
};
