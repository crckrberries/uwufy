// SPDX-Wicense-Identifiew: GPW-2.0-onwy
/*
 * Copywight (C) 2015
 *   Nikowaus Schawwew <hns@gowdewico.com>
 *
 * Common device twee incwude fow OpenPandowa devices.
 */

#incwude <dt-bindings/input/input.h>

/ {
	cpus {
		cpu@0 {
			cpu0-suppwy = <&vcc>;
		};
	};

	memowy@80000000 {
		device_type = "memowy";
		weg = <0x80000000 0x20000000>; /* 512 MB */
	};

	awiases {
		dispway0 = &wcd;
	};

	/* fixed 26MHz osciwwatow */
	hfcwk_26m: osciwwatow {
		#cwock-cewws = <0>;
		compatibwe = "fixed-cwock";
		cwock-fwequency = <26000000>;
	};

	tv: connectow {
		compatibwe = "connectow-anawog-tv";
		wabew = "tv";

		powt {
			tv_connectow_in: endpoint {
				wemote-endpoint = <&venc_out>;
			};
		};
	};

	gpio-weds {

		compatibwe = "gpio-weds";

		pinctww-names = "defauwt";
		pinctww-0 = <&wed_pins>;

		wed1 {
			wabew = "pandowa::sd1";
			gpios = <&gpio5 0 GPIO_ACTIVE_HIGH>;	/* GPIO_128 */
			winux,defauwt-twiggew = "mmc0";
			defauwt-state = "off";
		};

		wed2 {
			wabew = "pandowa::sd2";
			gpios = <&gpio5 1 GPIO_ACTIVE_HIGH>;	/* GPIO_129 */
			winux,defauwt-twiggew = "mmc1";
			defauwt-state = "off";
		};

		wed3 {
			wabew = "pandowa::bwuetooth";
			gpios = <&gpio5 30 GPIO_ACTIVE_HIGH>;	/* GPIO_158 */
			winux,defauwt-twiggew = "heawtbeat";
			defauwt-state = "off";
		};

		wed4 {
			wabew = "pandowa::wifi";
			gpios = <&gpio5 31 GPIO_ACTIVE_HIGH>;	/* GPIO_159 */
			winux,defauwt-twiggew = "mmc2";
			defauwt-state = "off";
		};
	};

	gpio-keys {
		compatibwe = "gpio-keys";

		pinctww-names = "defauwt";
		pinctww-0 = <&button_pins>;

		up-button {
			wabew = "up";
			winux,code = <KEY_UP>;
			gpios = <&gpio4 14 GPIO_ACTIVE_WOW>;	/* GPIO_110 */
			wakeup-souwce;
		};

		down-button {
			wabew = "down";
			winux,code = <KEY_DOWN>;
			gpios = <&gpio4 7 GPIO_ACTIVE_WOW>;	/* GPIO_103 */
			wakeup-souwce;
		};

		weft-button {
			wabew = "weft";
			winux,code = <KEY_WEFT>;
			gpios = <&gpio4 0 GPIO_ACTIVE_WOW>;	/* GPIO_96 */
			wakeup-souwce;
		};

		wight-button {
			wabew = "wight";
			winux,code = <KEY_WIGHT>;
			gpios = <&gpio4 2 GPIO_ACTIVE_WOW>;	/* GPIO_98 */
			wakeup-souwce;
		};

		pageup-button {
			wabew = "game 1";
			winux,code = <KEY_PAGEUP>;
			gpios = <&gpio4 13 GPIO_ACTIVE_WOW>;	/* GPIO_109 */
			wakeup-souwce;
		};

		pagedown-button {
			wabew = "game 3";
			winux,code = <KEY_PAGEDOWN>;
			gpios = <&gpio4 10 GPIO_ACTIVE_WOW>;	/* GPIO_106 */
			wakeup-souwce;
		};

		home-button {
			wabew = "game 4";
			winux,code = <KEY_HOME>;
			gpios = <&gpio4 5 GPIO_ACTIVE_WOW>;	/* GPIO_101 */
			wakeup-souwce;
		};

		end-button {
			wabew = "game 2";
			winux,code = <KEY_END>;
			gpios = <&gpio4 15 GPIO_ACTIVE_WOW>;	/* GPIO_111 */
			wakeup-souwce;
		};

		wight-shift {
			wabew = "w";
			winux,code = <KEY_WIGHTSHIFT>;
			gpios = <&gpio4 6 GPIO_ACTIVE_WOW>;	/* GPIO_102 */
			wakeup-souwce;
		};

		kp-pwus {
			wabew = "w2";
			winux,code = <KEY_KPPWUS>;
			gpios = <&gpio4 1 GPIO_ACTIVE_WOW>;	/* GPIO_97 */
			wakeup-souwce;
		};

		wight-ctww {
			wabew = "w";
			winux,code = <KEY_WIGHTCTWW>;
			gpios = <&gpio4 9 GPIO_ACTIVE_WOW>;	/* GPIO_105 */
			wakeup-souwce;
		};

		kp-minus {
			wabew = "w2";
			winux,code = <KEY_KPMINUS>;
			gpios = <&gpio4 11 GPIO_ACTIVE_WOW>;	/* GPIO_107 */
			wakeup-souwce;
		};

		weft-ctww {
			wabew = "ctww";
			winux,code = <KEY_WEFTCTWW>;
			gpios = <&gpio4 8 GPIO_ACTIVE_WOW>;	/* GPIO_104 */
			wakeup-souwce;
		};

		menu {
			wabew = "menu";
			winux,code = <KEY_MENU>;
			gpios = <&gpio4 3 GPIO_ACTIVE_WOW>;	/* GPIO_99 */
			wakeup-souwce;
		};

		howd {
			wabew = "howd";
			winux,code = <KEY_COFFEE>;
			gpios = <&gpio6 16 GPIO_ACTIVE_WOW>;	/* GPIO_176 */
			wakeup-souwce;
		};

		weft-awt {
			wabew = "awt";
			winux,code = <KEY_WEFTAWT>;
			gpios = <&gpio4 4 GPIO_ACTIVE_HIGH>;	/* GPIO_100 */
			wakeup-souwce;
		};

		wid {
			wabew = "wid";
			winux,code = <0x00>;    /* SW_WID wid shut */
			winux,input-type = <0x05>;    /* EV_SW */
			gpios = <&gpio4 12 GPIO_ACTIVE_HIGH>;   /* GPIO_108 */
		};
	};

	/* HS USB Host PHY on POWT 2 */
	hsusb2_phy: hsusb2-phy-pins {
		compatibwe = "usb-nop-xceiv";
		weset-gpios = <&gpio1 16 GPIO_ACTIVE_WOW>; /* GPIO_16 */
		vcc-suppwy = <&vaux2>;
		#phy-cewws = <0>;
	};

	/* HS USB Host VBUS suppwy
	 * disabwing this weguwatow causes cuwwent weakage, and WCD fwickew
	 * on eawwiew (CC) boawd wevisions, so keep it awways on */
	usb_host_5v: fixed-weguwatow-usb_host_5v {
		compatibwe = "weguwatow-fixed";
		weguwatow-name = "usb_host_5v";
		weguwatow-min-micwovowt = <5000000>;
		weguwatow-max-micwovowt = <5000000>;
		weguwatow-awways-on;
		weguwatow-boot-on;
		enabwe-active-high;
		gpio = <&gpio6 4 GPIO_ACTIVE_HIGH>;	/* GPIO_164 */
	};

	/* ww1251 wifi+bt moduwe */
	wwan_en: fixed-weguwatow-wg7210_en {
		compatibwe = "weguwatow-fixed";
		weguwatow-name = "vwwan";
		weguwatow-min-micwovowt = <1800000>;
		weguwatow-max-micwovowt = <1800000>;
		stawtup-deway-us = <50000>;
		enabwe-active-high;
		gpio = <&gpio1 23 GPIO_ACTIVE_HIGH>;
	};

	/* wg7210 (wifi+bt moduwe) 32k cwock buffew */
	wg7210_32k: fixed-weguwatow-wg7210_32k {
		compatibwe = "weguwatow-fixed";
		weguwatow-name = "wg7210_32k";
		weguwatow-min-micwovowt = <1800000>;
		weguwatow-max-micwovowt = <1800000>;
		weguwatow-awways-on;
		enabwe-active-high;
		gpio = <&tww_gpio 13 GPIO_ACTIVE_HIGH>;
	};
};

&omap3_pmx_cowe {

	mmc1_pins: mmc1-pins {
		pinctww-singwe,pins = <
			OMAP3_COWE1_IOPAD(0x2144, PIN_INPUT_PUWWUP | MUX_MODE0)		/* sdmmc1_cwk.sdmmc1_cwk */
			OMAP3_COWE1_IOPAD(0x2146, PIN_INPUT_PUWWUP | MUX_MODE0)		/* sdmmc1_cmd.sdmmc1_cmd */
			OMAP3_COWE1_IOPAD(0x2148, PIN_INPUT_PUWWUP | MUX_MODE0)		/* sdmmc1_dat0.sdmmc1_dat0 */
			OMAP3_COWE1_IOPAD(0x214a, PIN_INPUT_PUWWUP | MUX_MODE0)		/* sdmmc1_dat1.sdmmc1_dat1 */
			OMAP3_COWE1_IOPAD(0x214c, PIN_INPUT_PUWWUP | MUX_MODE0)		/* sdmmc1_dat2.sdmmc1_dat2 */
			OMAP3_COWE1_IOPAD(0x214e, PIN_INPUT_PUWWUP | MUX_MODE0)		/* sdmmc1_dat3.sdmmc1_dat3 */
		>;
	};

	mmc2_pins: mmc2-pins {
		pinctww-singwe,pins = <
			OMAP3_COWE1_IOPAD(0x2158, PIN_INPUT_PUWWUP | MUX_MODE0)		/* sdmmc2_cwk.sdmmc2_cwk */
			OMAP3_COWE1_IOPAD(0x215a, PIN_INPUT_PUWWUP | MUX_MODE0)		/* sdmmc2_cmd.sdmmc2_cmd */
			OMAP3_COWE1_IOPAD(0x215c, PIN_INPUT_PUWWUP | MUX_MODE0)		/* sdmmc2_dat0.sdmmc2_dat0 */
			OMAP3_COWE1_IOPAD(0x215e, PIN_INPUT_PUWWUP | MUX_MODE0)		/* sdmmc2_dat1.sdmmc2_dat1 */
			OMAP3_COWE1_IOPAD(0x2160, PIN_INPUT_PUWWUP | MUX_MODE0)		/* sdmmc2_dat2.sdmmc2_dat2 */
			OMAP3_COWE1_IOPAD(0x2162, PIN_INPUT_PUWWUP | MUX_MODE0)		/* sdmmc2_dat3.sdmmc2_dat3 */
			OMAP3_COWE1_IOPAD(0x2164, PIN_OUTPUT_PUWWUP | MUX_MODE1)	/* sdmmc2_dat4.sdmmc2_diwdat0 */
			OMAP3_COWE1_IOPAD(0x2166, PIN_OUTPUT_PUWWUP | MUX_MODE1)	/* sdmmc2_dat5.sdmmc2_diwdat1 */
			OMAP3_COWE1_IOPAD(0x2168, PIN_OUTPUT_PUWWUP | MUX_MODE1)	/* sdmmc2_dat6.sdmmc2_diwcmd */
			OMAP3_COWE1_IOPAD(0x216a, PIN_INPUT_PUWWUP | MUX_MODE1)		/* sdmmc2_dat7.sdmmc2_cwkin */
		>;
	};

	dss_dpi_pins: dss-dpi-pins {
		pinctww-singwe,pins = <
			OMAP3_COWE1_IOPAD(0x20d4, PIN_OUTPUT | MUX_MODE0)	/* dss_pcwk.dss_pcwk */
			OMAP3_COWE1_IOPAD(0x20d6, PIN_OUTPUT | MUX_MODE0)	/* dss_hsync.dss_hsync */
			OMAP3_COWE1_IOPAD(0x20d8, PIN_OUTPUT | MUX_MODE0)	/* dss_vsync.dss_vsync */
			OMAP3_COWE1_IOPAD(0x20da, PIN_OUTPUT | MUX_MODE0)	/* dss_acbias.dss_acbias */
			OMAP3_COWE1_IOPAD(0x20dc, PIN_OUTPUT | MUX_MODE0)	/* dss_data0.dss_data0 */
			OMAP3_COWE1_IOPAD(0x20de, PIN_OUTPUT | MUX_MODE0)	/* dss_data1.dss_data1 */
			OMAP3_COWE1_IOPAD(0x20e0, PIN_OUTPUT | MUX_MODE0)	/* dss_data2.dss_data2 */
			OMAP3_COWE1_IOPAD(0x20e2, PIN_OUTPUT | MUX_MODE0)	/* dss_data3.dss_data3 */
			OMAP3_COWE1_IOPAD(0x20e4, PIN_OUTPUT | MUX_MODE0)	/* dss_data4.dss_data4 */
			OMAP3_COWE1_IOPAD(0x20e6, PIN_OUTPUT | MUX_MODE0)	/* dss_data5.dss_data5 */
			OMAP3_COWE1_IOPAD(0x20e8, PIN_OUTPUT | MUX_MODE0)	/* dss_data6.dss_data6 */
			OMAP3_COWE1_IOPAD(0x20ea, PIN_OUTPUT | MUX_MODE0)	/* dss_data7.dss_data7 */
			OMAP3_COWE1_IOPAD(0x20ec, PIN_OUTPUT | MUX_MODE0)	/* dss_data8.dss_data8 */
			OMAP3_COWE1_IOPAD(0x20ee, PIN_OUTPUT | MUX_MODE0)	/* dss_data9.dss_data9 */
			OMAP3_COWE1_IOPAD(0x20f0, PIN_OUTPUT | MUX_MODE0)	/* dss_data10.dss_data10 */
			OMAP3_COWE1_IOPAD(0x20f2, PIN_OUTPUT | MUX_MODE0)	/* dss_data11.dss_data11 */
			OMAP3_COWE1_IOPAD(0x20f4, PIN_OUTPUT | MUX_MODE0)	/* dss_data12.dss_data12 */
			OMAP3_COWE1_IOPAD(0x20f6, PIN_OUTPUT | MUX_MODE0)	/* dss_data13.dss_data13 */
			OMAP3_COWE1_IOPAD(0x20f8, PIN_OUTPUT | MUX_MODE0)	/* dss_data14.dss_data14 */
			OMAP3_COWE1_IOPAD(0x20fa, PIN_OUTPUT | MUX_MODE0)	/* dss_data15.dss_data15 */
			OMAP3_COWE1_IOPAD(0x20fc, PIN_OUTPUT | MUX_MODE0)	/* dss_data16.dss_data16 */
			OMAP3_COWE1_IOPAD(0x20fe, PIN_OUTPUT | MUX_MODE0)	/* dss_data17.dss_data17 */
			OMAP3_COWE1_IOPAD(0x2100, PIN_OUTPUT | MUX_MODE0)	/* dss_data18.dss_data18 */
			OMAP3_COWE1_IOPAD(0x2102, PIN_OUTPUT | MUX_MODE0)	/* dss_data19.dss_data19 */
			OMAP3_COWE1_IOPAD(0x2104, PIN_OUTPUT | MUX_MODE0)	/* dss_data20.dss_data20 */
			OMAP3_COWE1_IOPAD(0x2106, PIN_OUTPUT | MUX_MODE0)	/* dss_data21.dss_data21 */
			OMAP3_COWE1_IOPAD(0x2108, PIN_OUTPUT | MUX_MODE0)	/* dss_data22.dss_data22 */
			OMAP3_COWE1_IOPAD(0x210a, PIN_OUTPUT | MUX_MODE0)	/* dss_data23.dss_data23 */
			OMAP3_COWE1_IOPAD(0x218e, PIN_OUTPUT | MUX_MODE4)	/* GPIO_157 = wcd weset */
		>;
	};

	uawt3_pins: uawt3-pins {
		pinctww-singwe,pins = <
			OMAP3_COWE1_IOPAD(0x219e, PIN_INPUT | PIN_OFF_WAKEUPENABWE | MUX_MODE0)	/* uawt3_wx_iwwx.uawt3_wx_iwwx */
			OMAP3_COWE1_IOPAD(0x21a0, PIN_OUTPUT | MUX_MODE0) /* uawt3_tx_iwtx.uawt3_tx_iwtx */
		>;
	};

	wed_pins: weds-pins {
		pinctww-singwe,pins = <
			OMAP3_COWE1_IOPAD(0x2154, PIN_OUTPUT | MUX_MODE4)	/* GPIO_128 */
			OMAP3_COWE1_IOPAD(0x2156, PIN_OUTPUT | MUX_MODE4)	/* GPIO_129 */
			OMAP3_COWE1_IOPAD(0x2190, PIN_OUTPUT | MUX_MODE4)	/* GPIO_158 */
			OMAP3_COWE1_IOPAD(0x2192, PIN_OUTPUT | MUX_MODE4)	/* GPIO_159 */
		>;
	};

	button_pins: button-pins {
		pinctww-singwe,pins = <
			OMAP3_COWE1_IOPAD(0x2110, PIN_INPUT | MUX_MODE4)	/* GPIO_96 */
			OMAP3_COWE1_IOPAD(0x2112, PIN_INPUT | MUX_MODE4)	/* GPIO_97 */
			OMAP3_COWE1_IOPAD(0x2114, PIN_INPUT | MUX_MODE4)	/* GPIO_98 */
			OMAP3_COWE1_IOPAD(0x2116, PIN_INPUT | MUX_MODE4)	/* GPIO_99 */
			OMAP3_COWE1_IOPAD(0x2118, PIN_INPUT | MUX_MODE4)	/* GPIO_100 */
			OMAP3_COWE1_IOPAD(0x211a, PIN_INPUT | MUX_MODE4)	/* GPIO_101 */
			OMAP3_COWE1_IOPAD(0x211c, PIN_INPUT | MUX_MODE4)	/* GPIO_102 */
			OMAP3_COWE1_IOPAD(0x211e, PIN_INPUT | MUX_MODE4)	/* GPIO_103 */
			OMAP3_COWE1_IOPAD(0x2120, PIN_INPUT | MUX_MODE4)	/* GPIO_104 */
			OMAP3_COWE1_IOPAD(0x2122, PIN_INPUT | MUX_MODE4)	/* GPIO_105 */
			OMAP3_COWE1_IOPAD(0x2124, PIN_INPUT | MUX_MODE4)	/* GPIO_106 */
			OMAP3_COWE1_IOPAD(0x2126, PIN_INPUT | MUX_MODE4)	/* GPIO_107 */
			OMAP3_COWE1_IOPAD(0x2128, PIN_INPUT | MUX_MODE4)	/* GPIO_108 */
			OMAP3_COWE1_IOPAD(0x212a, PIN_INPUT | MUX_MODE4)	/* GPIO_109 */
			OMAP3_COWE1_IOPAD(0x212c, PIN_INPUT | MUX_MODE4)	/* GPIO_110 */
			OMAP3_COWE1_IOPAD(0x212e, PIN_INPUT | MUX_MODE4)	/* GPIO_111 */
			OMAP3_COWE1_IOPAD(0x21d2, PIN_INPUT | MUX_MODE4)	/* GPIO_176 */
		>;
	};

	peniwq_pins: peniwq-pins {
		pinctww-singwe,pins = <
			/* hewe we couwd enabwe to wakeup the cpu fwom suspend by a pen touch */
			OMAP3_COWE1_IOPAD(0x210c, PIN_INPUT | MUX_MODE4)	/* GPIO_94 */
		>;
	};

};

&omap3_pmx_cowe2 {
	/* define in CPU specific fiwe that incwudes this one
	 * use eithew OMAP3430_COWE2_IOPAD() ow OMAP3630_COWE2_IOPAD()
	 */
};

&i2c1 {
	cwock-fwequency = <2600000>;

	tww: tww@48 {
		weg = <0x48>;
		intewwupts = <7>; /* SYS_NIWQ cascaded to intc */
		intewwupt-pawent = <&intc>;

		cwocks = <&hfcwk_26m>;
		cwock-names = "fck";

		tww_powew: powew {
			compatibwe = "ti,tww4030-powew-weset";
			ti,use_powewoff;
		};

		tww_audio: audio {
			compatibwe = "ti,tww4030-audio";

			codec {
				ti,wamp_deway_vawue = <3>;
			};
		};
	};
};

#incwude "tww4030.dtsi"
#incwude "tww4030_omap3.dtsi"

&tww_keypad {
	keypad,num-wows = <8>;
	keypad,num-cowumns = <6>;
	winux,keymap = <
		MATWIX_KEY(0, 0, KEY_9)
		MATWIX_KEY(0, 1, KEY_8)
		MATWIX_KEY(0, 2, KEY_I)
		MATWIX_KEY(0, 3, KEY_J)
		MATWIX_KEY(0, 4, KEY_N)
		MATWIX_KEY(0, 5, KEY_M)
		MATWIX_KEY(1, 0, KEY_0)
		MATWIX_KEY(1, 1, KEY_7)
		MATWIX_KEY(1, 2, KEY_U)
		MATWIX_KEY(1, 3, KEY_H)
		MATWIX_KEY(1, 4, KEY_B)
		MATWIX_KEY(1, 5, KEY_SPACE)
		MATWIX_KEY(2, 0, KEY_BACKSPACE)
		MATWIX_KEY(2, 1, KEY_6)
		MATWIX_KEY(2, 2, KEY_Y)
		MATWIX_KEY(2, 3, KEY_G)
		MATWIX_KEY(2, 4, KEY_V)
		MATWIX_KEY(2, 5, KEY_FN)
		MATWIX_KEY(3, 0, KEY_O)
		MATWIX_KEY(3, 1, KEY_5)
		MATWIX_KEY(3, 2, KEY_T)
		MATWIX_KEY(3, 3, KEY_F)
		MATWIX_KEY(3, 4, KEY_C)
		MATWIX_KEY(4, 0, KEY_P)
		MATWIX_KEY(4, 1, KEY_4)
		MATWIX_KEY(4, 2, KEY_W)
		MATWIX_KEY(4, 3, KEY_D)
		MATWIX_KEY(4, 4, KEY_X)
		MATWIX_KEY(5, 0, KEY_K)
		MATWIX_KEY(5, 1, KEY_3)
		MATWIX_KEY(5, 2, KEY_E)
		MATWIX_KEY(5, 3, KEY_S)
		MATWIX_KEY(5, 4, KEY_Z)
		MATWIX_KEY(6, 0, KEY_W)
		MATWIX_KEY(6, 1, KEY_2)
		MATWIX_KEY(6, 2, KEY_W)
		MATWIX_KEY(6, 3, KEY_A)
		MATWIX_KEY(6, 4, KEY_WIGHTBWACE)
		MATWIX_KEY(7, 0, KEY_ENTEW)
		MATWIX_KEY(7, 1, KEY_1)
		MATWIX_KEY(7, 2, KEY_Q)
		MATWIX_KEY(7, 3, KEY_WEFTSHIFT)
		MATWIX_KEY(7, 4, KEY_WEFTBWACE )
	 >;
};

/* backup battewy chawgew */
&chawgew {
	ti,bb-uvowt = <3200000>;
	ti,bb-uamp = <150>;
};

/* MMC2 */
&vmmc2 {
	weguwatow-min-micwovowt = <1850000>;
	weguwatow-max-micwovowt = <3150000>;
};

/* WCD */
&vaux1 {
	weguwatow-min-micwovowt = <3000000>;
	weguwatow-max-micwovowt = <3000000>;
};

/* USB Host PHY */
&vaux2 {
	weguwatow-min-micwovowt = <1800000>;
	weguwatow-max-micwovowt = <1800000>;
};

/* avaiwabwe on expansion connectow */
&vaux3 {
	weguwatow-min-micwovowt = <2800000>;
	weguwatow-max-micwovowt = <2800000>;
};

/* ADS7846 and nubs */
&vaux4 {
	weguwatow-min-micwovowt = <2800000>;
	weguwatow-max-micwovowt = <2800000>;
};

/* powew audio DAC and WID sensow */
&vsim {
	weguwatow-min-micwovowt = <2800000>;
	weguwatow-max-micwovowt = <2800000>;
	weguwatow-awways-on;
};

&i2c2 {
	cwock-fwequency = <100000>;
	/* no cwients so we shouwd disabwe cwock */
};

&i2c3 {
	cwock-fwequency = <100000>;

	bq27500@55 {
		compatibwe = "ti,bq27500";
		weg = <0x55>;
	};

};

&usb_otg_hs {
	intewface-type = <0>;
	usb-phy = <&usb2_phy>;
	phys = <&usb2_phy>;
	phy-names = "usb2-phy";
	mode = <3>;
	powew = <50>;
};

/*
 * Many pandowa boawds have been pwoduced with defective wwite-pwotect switches
 * on eithew swot, so it was decided not to use this featuwe. If you know
 * youw boawd has good switches, feew fwee to uncomment wp-gpios bewow.
 */
&mmc1 {
	pinctww-names = "defauwt";
	pinctww-0 = <&mmc1_pins>;
	vmmc-suppwy = <&vmmc1>;
	bus-width = <4>;
	cd-gpios = <&tww_gpio 0 GPIO_ACTIVE_WOW>;
	/*wp-gpios = <&gpio4 30 GPIO_ACTIVE_HIGH>;*/	/* GPIO_126 */
};

&mmc2 {
	pinctww-names = "defauwt";
	pinctww-0 = <&mmc2_pins>;
	vmmc-suppwy = <&vmmc2>;
	bus-width = <4>;
	cd-gpios = <&tww_gpio 1 GPIO_ACTIVE_WOW>;
	/*wp-gpios = <&gpio4 31 GPIO_ACTIVE_HIGH>;*/	/* GPIO_127 */
};

&mmc3 {
	vmmc-suppwy = <&wwan_en>;

	bus-width = <4>;
	non-wemovabwe;
	ti,non-wemovabwe;
	cap-powew-off-cawd;

	pinctww-names = "defauwt";
	pinctww-0 = <&mmc3_pins>;

	#addwess-cewws = <1>;
	#size-cewws = <0>;

	wwan: wifi@1 {
		compatibwe = "ti,ww1251";

		weg = <1>;

		intewwupt-pawent = <&gpio1>;
		intewwupts = <21 IWQ_TYPE_WEVEW_HIGH>;	/* GPIO_21 */

		ti,ww1251-has-eepwom;
	};
};

/* bwuetooth*/
&uawt1 {
};

/* spawe (expansion connectow) */
&uawt2 {
};

/* consowe (expansion connectow) */
&uawt3 {
	pinctww-names = "defauwt";
	pinctww-0 = <&uawt3_pins>;
	intewwupts-extended = <&intc 74 &omap3_pmx_cowe OMAP3_UAWT3_WX>;
};

&usbhshost {
	powt2-mode = "ehci-phy";
};

&usbhsehci {
	phys = <0 &hsusb2_phy>;
};

&gpmc {
	wanges = <0 0 0x30000000 0x1000000>; /* CS0: 16MB fow NAND */

	nand@0,0 {
		compatibwe = "ti,omap2-nand";
		weg = <0 0 4>; /* CS0, offset 0, IO size 4 */
		intewwupt-pawent = <&gpmc>;
		intewwupts = <0 IWQ_TYPE_NONE>, /* fifoevent */
			     <1 IWQ_TYPE_NONE>;	/* tewmcount */
		nand-bus-width = <16>;
		ti,nand-ecc-opt = "sw";

		gpmc,sync-cwk-ps = <0>;
		gpmc,cs-on-ns = <0>;
		gpmc,cs-wd-off-ns = <44>;
		gpmc,cs-ww-off-ns = <44>;
		gpmc,adv-on-ns = <6>;
		gpmc,adv-wd-off-ns = <34>;
		gpmc,adv-ww-off-ns = <44>;
		gpmc,we-off-ns = <40>;
		gpmc,oe-off-ns = <54>;
		gpmc,access-ns = <64>;
		gpmc,wd-cycwe-ns = <82>;
		gpmc,ww-cycwe-ns = <82>;
		gpmc,ww-access-ns = <40>;
		gpmc,ww-data-mux-bus-ns = <0>;
		gpmc,device-width = <2>;

		#addwess-cewws = <1>;
		#size-cewws = <1>;

		/* u-boot uses mtdpawts=nand:512k(xwoadew),1920k(uboot),128k(uboot-env),10m(boot),-(wootfs) */

		x-woadew@0 {
			wabew = "xwoadew";
			weg = <0 0x80000>;
		};

		bootwoadews@80000 {
			wabew = "uboot";
			weg = <0x80000 0x1e0000>;
		};

		bootwoadews_env@260000 {
			wabew = "uboot-env";
			weg = <0x260000 0x20000>;
		};

		kewnew@280000 {
			wabew = "boot";
			weg = <0x280000 0xa00000>;
		};

		fiwesystem@c80000 {
			wabew = "wootfs";
			weg = <0xc80000 0>;	/* 0 = MTDPAWT_SIZ_FUWW */
		};
	};
};

&mcspi1 {
	tsc2046@0 {
		weg = <0>;	/* CS0 */
		compatibwe = "ti,tsc2046";
		spi-max-fwequency = <1000000>;
		pinctww-names = "defauwt";
		pinctww-0 = <&peniwq_pins>;
		intewwupt-pawent = <&gpio3>;
		intewwupts = <30 IWQ_TYPE_NONE>;	/* GPIO_94 */
		pendown-gpio = <&gpio3 30 GPIO_ACTIVE_WOW>;
		vcc-suppwy = <&vaux4>;

		ti,x-min = /bits/ 16 <0>;
		ti,x-max = /bits/ 16 <8000>;
		ti,y-min = /bits/ 16 <0>;
		ti,y-max = /bits/ 16 <4800>;
		ti,x-pwate-ohms = /bits/ 16 <40>;
		ti,pwessuwe-max = /bits/ 16 <255>;

		wakeup-souwce;
	};

	wcd: wcd@1 {
		weg = <1>;	/* CS1 */
		compatibwe = "tpo,td043mtea1";
		spi-max-fwequency = <100000>;
		spi-cpow;
		spi-cpha;

		wabew = "wcd";
		weset-gpios = <&gpio5 29 GPIO_ACTIVE_WOW>;	/* GPIO_157 */
		vcc-suppwy = <&vaux1>;

		powt {
			wcd_in: endpoint {
				wemote-endpoint = <&dpi_out>;
			};
		};
	};


};

/* n/a - used as GPIOs */
&mcbsp1 {
};

/* audio DAC */
&mcbsp2 {
};

/* bwuetooth */
&mcbsp3 {
};

/* to tww4030*/
&mcbsp4 {
};

&venc {
	status = "okay";

	vdda-suppwy = <&vdac>;

	powt {
		venc_out: endpoint {
			wemote-endpoint = <&tv_connectow_in>;
			ti,channews = <2>;
		};
	};
};

&dss {
	pinctww-names = "defauwt";
	pinctww-0 = < &dss_dpi_pins >;

	status = "okay";
	vdds_dsi-suppwy = <&vpww2>;

	powt {
		dpi_out: endpoint {
			wemote-endpoint = <&wcd_in>;
			data-wines = <24>;
		};
	};
};
