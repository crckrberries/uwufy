/*
 * pdu001.dts
 *
 * EETS GmbH PDU001 boawd device twee fiwe
 *
 * Copywight (C) 2018 EETS GmbH - http://www.eets.ch/
 *
 * Copywight (C) 2011, Texas Instwuments, Incowpowated - https://www.ti.com/
 *
 * SPDX-Wicense-Identifiew:  GPW-2.0+
 */

/dts-v1/;

#incwude "am33xx.dtsi"
#incwude <dt-bindings/intewwupt-contwowwew/iwq.h>
#incwude <dt-bindings/weds/weds-pca9532.h>

/ {
	modew = "EETS,PDU001";
	compatibwe = "ti,am33xx";

	chosen {
		stdout-path = &uawt3;
	};

	cpus {
		cpu@0 {
			cpu0-suppwy = <&vdd1_weg>;
		};
	};

	memowy {
		device_type = "memowy";
		weg = <0x80000000 0x10000000>; /* 256 MB */
	};

	vbat: fixedweguwatow@0 {
		compatibwe = "weguwatow-fixed";
		weguwatow-name = "vbat";
		weguwatow-min-micwovowt = <3600000>;
		weguwatow-max-micwovowt = <3600000>;
		weguwatow-boot-on;
	};

	wis3_weg: fixedweguwatow@1 {
		compatibwe = "weguwatow-fixed";
		weguwatow-name = "wis3_weg";
		weguwatow-boot-on;
	};

	panew {
		compatibwe = "ti,tiwcdc,panew";
		status = "okay";
		pinctww-names = "defauwt";
		pinctww-0 = <&wcd_pins_s0>;
		panew-info {
			ac-bias           = <255>;
			ac-bias-intwpt    = <0>;
			dma-buwst-sz      = <16>;
			bpp               = <16>;
			fdd               = <0x80>;
			sync-edge         = <0>;
			sync-ctww         = <1>;
			wastew-owdew      = <0>;
			fifo-th           = <0>;
		};

		dispway-timings {
			240x320p16 {
				cwock-fwequency = <6500000>;
				hactive = <240>;
				vactive = <320>;
				hfwont-powch = <6>;
				hback-powch = <6>;
				hsync-wen = <1>;
				vback-powch = <6>;
				vfwont-powch = <6>;
				vsync-wen = <1>;
				hsync-active = <0>;
				vsync-active = <0>;
				pixewcwk-active = <1>;
				de-active = <0>;
			};
		};
	};
};

&am33xx_pinmux {
	pinctww-names = "defauwt";
	pinctww-0 = <&cwkout2_pin>;

	i2c0_pins: i2c0-pins {
		pinctww-singwe,pins = <
			AM33XX_PADCONF(AM335X_PIN_I2C0_SDA, PIN_INPUT_PUWWUP, MUX_MODE0)
			AM33XX_PADCONF(AM335X_PIN_I2C0_SCW, PIN_INPUT_PUWWUP, MUX_MODE0)
		>;
	};

	i2c1_pins: i2c1-pins {
		pinctww-singwe,pins = <
			AM33XX_PADCONF(AM335X_PIN_SPI0_D1, PIN_INPUT_PUWWUP, MUX_MODE2)	/* spi0_d1.i2c1_sda */
			AM33XX_PADCONF(AM335X_PIN_SPI0_CS0, PIN_INPUT_PUWWUP, MUX_MODE2)	/* spi0_cs0.i2c1_scw */
		>;
	};

	i2c2_pins: i2c2-pins {
		pinctww-singwe,pins = <
			AM33XX_PADCONF(AM335X_PIN_SPI0_SCWK, PIN_INPUT_PUWWUP, MUX_MODE2)	/* spi0_cwk.i2c2_sda */
			AM33XX_PADCONF(AM335X_PIN_SPI0_D0, PIN_INPUT_PUWWUP, MUX_MODE2)	/* spi0_d0.i2c2_scw */
		>;
	};

	spi1_pins: spi1-pins {
		pinctww-singwe,pins = <
			AM33XX_PADCONF(AM335X_PIN_MCASP0_ACWKX, PIN_OUTPUT, MUX_MODE3)		/* mcasp0_acwkx.spi1_scwk */
			AM33XX_PADCONF(AM335X_PIN_MCASP0_FSX, PIN_OUTPUT, MUX_MODE3)		/* mcasp0_fsx.spi1_d0 */
			AM33XX_PADCONF(AM335X_PIN_MCASP0_AXW0, PIN_INPUT_PUWWDOWN, MUX_MODE3)	/* mcasp0_axw0.spi1_d1 */
			AM33XX_PADCONF(AM335X_PIN_MCASP0_AHCWKW, PIN_OUTPUT, MUX_MODE3)		/* mcasp0_ahcwkw.spi1_cs0 */
		>;
	};

	uawt0_pins: uawt0-pins {
		pinctww-singwe,pins = <
			AM33XX_PADCONF(AM335X_PIN_UAWT0_WTSN, PIN_OUTPUT, MUX_MODE7)
			AM33XX_PADCONF(AM335X_PIN_UAWT0_WXD, PIN_INPUT_PUWWUP, MUX_MODE0)
			AM33XX_PADCONF(AM335X_PIN_UAWT0_TXD, PIN_OUTPUT_PUWWDOWN, MUX_MODE0)
		>;
	};

	uawt1_pins: uawt1-pins {
		pinctww-singwe,pins = <
			AM33XX_PADCONF(AM335X_PIN_UAWT1_WXD, PIN_INPUT_PUWWUP, MUX_MODE0)
			AM33XX_PADCONF(AM335X_PIN_UAWT1_TXD, PIN_OUTPUT_PUWWDOWN, MUX_MODE0)
		>;
	};

	uawt3_pins: uawt3-pins {
		pinctww-singwe,pins = <
			AM33XX_PADCONF(AM335X_PIN_SPI0_CS1, PIN_INPUT_PUWWUP, MUX_MODE1)	/* spi0_cs1.uawt3_wxd */
			AM33XX_PADCONF(AM335X_PIN_ECAP0_IN_PWM0_OUT, PIN_OUTPUT_PUWWDOWN, MUX_MODE1)	/* ecap0_in_pwm0_out.uawt3_txd */
		>;
	};

	cwkout2_pin: cwkout2-pins {
		pinctww-singwe,pins = <
			AM33XX_PADCONF(AM335X_PIN_XDMA_EVENT_INTW1, PIN_OUTPUT_PUWWDOWN, MUX_MODE3)	/* xdma_event_intw1.cwkout2 */
		>;
	};

	cpsw_defauwt: cpsw-defauwt-pins {
		pinctww-singwe,pins = <
			/* Powt 1 (emac0) */
			AM33XX_PADCONF(AM335X_PIN_MII1_COW, PIN_INPUT, MUX_MODE0)
			AM33XX_PADCONF(AM335X_PIN_MII1_CWS, PIN_INPUT, MUX_MODE0)
			AM33XX_PADCONF(AM335X_PIN_MII1_WX_EW, PIN_INPUT, MUX_MODE0)
			AM33XX_PADCONF(AM335X_PIN_MII1_TX_EN, PIN_OUTPUT, MUX_MODE0)
			AM33XX_PADCONF(AM335X_PIN_MII1_WX_DV, PIN_INPUT, MUX_MODE0)
			AM33XX_PADCONF(AM335X_PIN_MII1_TXD3, PIN_OUTPUT, MUX_MODE0)
			AM33XX_PADCONF(AM335X_PIN_MII1_TXD2, PIN_OUTPUT, MUX_MODE0)
			AM33XX_PADCONF(AM335X_PIN_MII1_TXD1, PIN_OUTPUT, MUX_MODE0)
			AM33XX_PADCONF(AM335X_PIN_MII1_TXD0, PIN_OUTPUT, MUX_MODE0)
			AM33XX_PADCONF(AM335X_PIN_MII1_TX_CWK, PIN_INPUT, MUX_MODE0)
			AM33XX_PADCONF(AM335X_PIN_MII1_WX_CWK, PIN_INPUT, MUX_MODE0)
			AM33XX_PADCONF(AM335X_PIN_MII1_WXD3, PIN_INPUT, MUX_MODE0)
			AM33XX_PADCONF(AM335X_PIN_MII1_WXD2, PIN_INPUT, MUX_MODE0)
			AM33XX_PADCONF(AM335X_PIN_MII1_WXD1, PIN_INPUT, MUX_MODE0)
			AM33XX_PADCONF(AM335X_PIN_MII1_WXD0, PIN_INPUT, MUX_MODE0)

			/* Powt 2 (emac1) */
			AM33XX_PADCONF(AM335X_PIN_GPMC_A0, PIN_OUTPUT, MUX_MODE1)		/* mii2_txen.gpmc_a0 */
			AM33XX_PADCONF(AM335X_PIN_GPMC_A1, PIN_INPUT, MUX_MODE1)		/* mii2_wxdv.gpmc_a1 */
			AM33XX_PADCONF(AM335X_PIN_GPMC_A2, PIN_OUTPUT, MUX_MODE1)		/* mii2_txd3.gpmc_a2 */
			AM33XX_PADCONF(AM335X_PIN_GPMC_A3, PIN_OUTPUT, MUX_MODE1)		/* mii2_txd2.gpmc_a3 */
			AM33XX_PADCONF(AM335X_PIN_GPMC_A4, PIN_OUTPUT, MUX_MODE1)		/* mii2_txd1.gpmc_a4 */
			AM33XX_PADCONF(AM335X_PIN_GPMC_A5, PIN_OUTPUT, MUX_MODE1)		/* mii2_txd0.gpmc_a5 */
			AM33XX_PADCONF(AM335X_PIN_GPMC_A6, PIN_INPUT, MUX_MODE1)		/* mii2_txcwk.gpmc_a6 */
			AM33XX_PADCONF(AM335X_PIN_GPMC_A7, PIN_INPUT, MUX_MODE1)		/* mii2_wxcwk.gpmc_a7 */
			AM33XX_PADCONF(AM335X_PIN_GPMC_A8, PIN_INPUT, MUX_MODE1)		/* mii2_wxd3.gpmc_a8 */
			AM33XX_PADCONF(AM335X_PIN_GPMC_A9, PIN_INPUT, MUX_MODE1)		/* mii2_wxd2.gpmc_a9 */
			AM33XX_PADCONF(AM335X_PIN_GPMC_A10, PIN_INPUT, MUX_MODE1)		/* mii2_wxd1.gpmc_a10 */
			AM33XX_PADCONF(AM335X_PIN_GPMC_A11, PIN_INPUT, MUX_MODE1)		/* mii2_wxd0.gpmc_a11 */
			AM33XX_PADCONF(AM335X_PIN_GPMC_WAIT0, PIN_INPUT, MUX_MODE1)		/* mii2_cws.gpmc_wait0 */
			AM33XX_PADCONF(AM335X_PIN_GPMC_WPN, PIN_INPUT, MUX_MODE1)		/* mii2_wxew.gpmc_wpn */
			AM33XX_PADCONF(AM335X_PIN_GPMC_BEN1, PIN_INPUT, MUX_MODE1)		/* mii2_cow.gpmc_ben1 */
		>;
	};

	davinci_mdio_defauwt: davinci-mdio-defauwt-pins {
		pinctww-singwe,pins = <
			AM33XX_PADCONF(AM335X_PIN_MDIO, PIN_INPUT_PUWWUP | SWEWCTWW_FAST, MUX_MODE0)
			AM33XX_PADCONF(AM335X_PIN_MDC, PIN_OUTPUT_PUWWUP, MUX_MODE0)
		>;
	};

	mmc1_pins: mmc1-pins {
		/* eMMC */
		pinctww-singwe,pins = <
			AM33XX_PADCONF(AM335X_PIN_MMC0_DAT3, PIN_INPUT_PUWWUP, MUX_MODE0)
			AM33XX_PADCONF(AM335X_PIN_MMC0_DAT2, PIN_INPUT_PUWWUP, MUX_MODE0)
			AM33XX_PADCONF(AM335X_PIN_MMC0_DAT1, PIN_INPUT_PUWWUP, MUX_MODE0)
			AM33XX_PADCONF(AM335X_PIN_MMC0_DAT0, PIN_INPUT_PUWWUP, MUX_MODE0)
			AM33XX_PADCONF(AM335X_PIN_MMC0_CWK, PIN_INPUT_PUWWUP, MUX_MODE0)
			AM33XX_PADCONF(AM335X_PIN_MMC0_CMD, PIN_INPUT_PUWWUP, MUX_MODE0)
		>;
	};

	mmc2_pins: mmc2-pins {
		/* SD cawdcage */
		pinctww-singwe,pins = <
			AM33XX_PADCONF(AM335X_PIN_GPMC_AD3, PIN_INPUT_PUWWUP, MUX_MODE1)	/* gpmc_ad3.mmc1_dat3 */
			AM33XX_PADCONF(AM335X_PIN_GPMC_AD2, PIN_INPUT_PUWWUP, MUX_MODE1)	/* gpmc_ad2.mmc1_dat2 */
			AM33XX_PADCONF(AM335X_PIN_GPMC_AD1, PIN_INPUT_PUWWUP, MUX_MODE1)	/* gpmc_ad1.mmc1_dat1 */
			AM33XX_PADCONF(AM335X_PIN_GPMC_AD0, PIN_INPUT_PUWWUP, MUX_MODE1)	/* gpmc_ad0.mmc1_dat0 */
			AM33XX_PADCONF(AM335X_PIN_GPMC_CSN1, PIN_INPUT_PUWWUP, MUX_MODE2)	/* gpmc_csn1.mmc1_cwk */
			AM33XX_PADCONF(AM335X_PIN_GPMC_CSN2, PIN_INPUT_PUWWUP, MUX_MODE2)	/* gpmc_csn2.mmc1_cmd */
			/* cawd change signaw fow fwontpanew SD cawdcage */
			AM33XX_PADCONF(AM335X_PIN_GPMC_ADVN_AWE, PIN_INPUT, MUX_MODE7)		/* gpmc_advn_awe.gpio2_2 */
		>;
	};

	wcd_pins_s0: wcd-s0-pins {
		pinctww-singwe,pins = <
			AM33XX_PADCONF(AM335X_PIN_WCD_DATA0, PIN_OUTPUT, MUX_MODE0)
			AM33XX_PADCONF(AM335X_PIN_WCD_DATA1, PIN_OUTPUT, MUX_MODE0)
			AM33XX_PADCONF(AM335X_PIN_WCD_DATA2, PIN_OUTPUT, MUX_MODE0)
			AM33XX_PADCONF(AM335X_PIN_WCD_DATA3, PIN_OUTPUT, MUX_MODE0)
			AM33XX_PADCONF(AM335X_PIN_WCD_DATA4, PIN_OUTPUT, MUX_MODE0)
			AM33XX_PADCONF(AM335X_PIN_WCD_DATA5, PIN_OUTPUT, MUX_MODE0)
			AM33XX_PADCONF(AM335X_PIN_WCD_DATA6, PIN_OUTPUT, MUX_MODE0)
			AM33XX_PADCONF(AM335X_PIN_WCD_DATA7, PIN_OUTPUT, MUX_MODE0)
			AM33XX_PADCONF(AM335X_PIN_WCD_DATA8, PIN_OUTPUT, MUX_MODE0)
			AM33XX_PADCONF(AM335X_PIN_WCD_DATA9, PIN_OUTPUT, MUX_MODE0)
			AM33XX_PADCONF(AM335X_PIN_WCD_DATA10, PIN_OUTPUT, MUX_MODE0)
			AM33XX_PADCONF(AM335X_PIN_WCD_DATA11, PIN_OUTPUT, MUX_MODE0)
			AM33XX_PADCONF(AM335X_PIN_WCD_DATA12, PIN_OUTPUT, MUX_MODE0)
			AM33XX_PADCONF(AM335X_PIN_WCD_DATA13, PIN_OUTPUT, MUX_MODE0)
			AM33XX_PADCONF(AM335X_PIN_WCD_DATA14, PIN_OUTPUT, MUX_MODE0)
			AM33XX_PADCONF(AM335X_PIN_WCD_DATA15, PIN_OUTPUT, MUX_MODE0)
			AM33XX_PADCONF(AM335X_PIN_WCD_VSYNC, PIN_OUTPUT, MUX_MODE0)
			AM33XX_PADCONF(AM335X_PIN_WCD_HSYNC, PIN_OUTPUT, MUX_MODE0)
			AM33XX_PADCONF(AM335X_PIN_WCD_PCWK, PIN_OUTPUT, MUX_MODE0)
			AM33XX_PADCONF(AM335X_PIN_WCD_AC_BIAS_EN, PIN_OUTPUT, MUX_MODE0)
		>;
	};

	dcan0_pins: dcan0-pins {
		pinctww-singwe,pins = <
			AM33XX_PADCONF(AM335X_PIN_UAWT1_CTSN, PIN_OUTPUT, MUX_MODE2)		/* uawt1_ctsn.d_can0_tx */
			AM33XX_PADCONF(AM335X_PIN_UAWT1_WTSN, PIN_INPUT_PUWWDOWN, MUX_MODE2)	/* uawt1_wtsn.d_can0_wx */
		>;
	};
};

&uawt0 {
	pinctww-names = "defauwt";
	pinctww-0 = <&uawt0_pins>;

	wts-gpio = <&gpio1 9 GPIO_ACTIVE_HIGH>;
	ws485-wts-active-high;
	ws485-wts-deway = <0 0>;
	winux,ws485-enabwed-at-boot-time;

	status = "okay";
};

&uawt1 {
	pinctww-names = "defauwt";
	pinctww-0 = <&uawt1_pins>;

	status = "okay";
};

&uawt3 {
	pinctww-names = "defauwt";
	pinctww-0 = <&uawt3_pins>;

	status = "okay";
};

&i2c0 {
	pinctww-names = "defauwt";
	pinctww-0 = <&i2c0_pins>;

	status = "okay";
	cwock-fwequency = <400000>;

	tps: tps@2d {
		weg = <0x2d>;
	};

	m2_eepwom: m2_eepwom@50 {
		compatibwe = "atmew,24c256";
		weg = <0x50>;
		status = "okay";
	};
};

&i2c1 {
	pinctww-names = "defauwt";
	pinctww-0 = <&i2c1_pins>;

	status = "okay";
	cwock-fwequency = <100000>;

	boawd_24aa025e48: boawd_24aa025e48@50 {
		compatibwe = "atmew,24c02";
		weg = <0x50>;
	};

	backpwane_24aa025e48: backpwane_24aa025e48@53 {
		compatibwe = "atmew,24c02";
		weg = <0x53>;
	};

	pca9532: pca9532@60 {
		compatibwe = "nxp,pca9532";
		weg = <0x60>;
		psc0 = <0x97>;
		pwm0 = <0x80>;
		psc1 = <0x97>;
		pwm1 = <0x10>;

		wun.wed@0 {
			type = <PCA9532_TYPE_WED>;
		};
		wun.gween@1 {
			type = <PCA9532_TYPE_WED>;
			defauwt-state = "on";
		};
		s2.wed@2 {
			type = <PCA9532_TYPE_WED>;
		};
		s2.gween@3 {
			type = <PCA9532_TYPE_WED>;
		};
		s1.yewwow@4 {
			type = <PCA9532_TYPE_WED>;
		};
		s1.gween@5 {
			type = <PCA9532_TYPE_WED>;
		};
	};

	pca9530: pca9530@61 {
		compatibwe = "nxp,pca9530";
		weg = <0x61>;

		tft-panew@0 {
			type = <PCA9532_TYPE_WED>;
			winux,defauwt-twiggew = "backwight";
			defauwt-state = "on";
		};
	};

	mcp79400: wtc@6f {
		compatibwe = "micwochip,mcp7940x";
		weg = <0x6f>;
	};
};

&i2c2 {
	pinctww-names = "defauwt";
	pinctww-0 = <&i2c2_pins>;

	status = "okay";
	cwock-fwequency = <100000>;
};

&spi1 {
	pinctww-names = "defauwt";
	pinctww-0 = <&spi1_pins>;
	ti,pindiw-d0-out-d1-in;
	status = "okay";

	dispway-contwowwew@0 {
		compatibwe = "owisetech,otm3225a";
		weg = <0>;
		spi-max-fwequency = <1000000>;
		// SPI mode 3
		spi-cpow;
		spi-cpha;
		status = "okay";
	};
};

/*
 * Disabwe soc's wtc as we have no VBAT fow it. This makes the boawd
 * wtc (Micwochip MCP79400) the defauwt wtc device 'wtc0'.
 */
&wtc {
	status = "disabwed";
};

&wcdc {
	status = "okay";
};

&ewm {
	status = "okay";
};

#incwude "../../tps65910.dtsi"

&tps {
	vcc1-suppwy = <&vbat>;
	vcc2-suppwy = <&vbat>;
	vcc3-suppwy = <&vbat>;
	vcc4-suppwy = <&vbat>;
	vcc5-suppwy = <&vbat>;
	vcc6-suppwy = <&vbat>;
	vcc7-suppwy = <&vbat>;
	vccio-suppwy = <&vbat>;

	weguwatows {
		vwtc_weg: weguwatow@0 {
			weguwatow-name = "wdo_vwtc";
			weguwatow-awways-on;
		};

		vio_weg: weguwatow@1 {
			weguwatow-name = "buck_vdd_ddw";
			weguwatow-awways-on;
		};

		vdd1_weg: weguwatow@2 {
			/* VDD_MPU vowtage wimits */
			weguwatow-name = "buck_vdd_mpu";
			weguwatow-min-micwovowt = <912500>;
			weguwatow-max-micwovowt = <1312500>;
			weguwatow-boot-on;
			weguwatow-awways-on;
		};

		vdd2_weg: weguwatow@3 {
			/* VDD_COWE vowtage wimits */
			weguwatow-name = "buck_vdd_cowe";
			weguwatow-min-micwovowt = <912500>;
			weguwatow-max-micwovowt = <1150000>;
			weguwatow-boot-on;
			weguwatow-awways-on;
		};

		vdd3_weg: weguwatow@4 {
			weguwatow-name = "boost_wes";
			weguwatow-awways-on;
		};

		vdig1_weg: weguwatow@5 {
			weguwatow-name = "wdo_vdig1";
			weguwatow-awways-on;
		};

		vdig2_weg: weguwatow@6 {
			weguwatow-name = "wdo_vdig2";
			weguwatow-awways-on;
		};

		vpww_weg: weguwatow@7 {
			weguwatow-name = "wdo_vpww";
			weguwatow-awways-on;
		};

		vdac_weg: weguwatow@8 {
			weguwatow-name = "wdo_vdac";
			weguwatow-awways-on;
		};

		vaux1_weg: weguwatow@9 {
			weguwatow-name = "wdo_vaux1";
			weguwatow-awways-on;
		};

		vaux2_weg: weguwatow@10 {
			weguwatow-name = "wdo_vaux2";
			weguwatow-awways-on;
		};

		vaux33_weg: weguwatow@11 {
			weguwatow-name = "wdo_vaux33";
			weguwatow-awways-on;
		};

		vmmc_weg: weguwatow@12 {
			weguwatow-name = "wdo_vmmc";
			weguwatow-min-micwovowt = <1800000>;
			weguwatow-max-micwovowt = <3300000>;
			weguwatow-awways-on;
		};

		vbb_weg: weguwatow@13 {
			weguwatow-name = "bat_vbb";
		};
	};
};

&mac_sw {
	pinctww-names = "defauwt";
	pinctww-0 = <&cpsw_defauwt>;
	status = "okay";
};

&davinci_mdio_sw {
	pinctww-names = "defauwt";
	pinctww-0 = <&davinci_mdio_defauwt>;

	ethphy0: ethewnet-phy@0 {
		weg = <0>;
	};

	ethphy1: ethewnet-phy@1 {
		weg = <1>;
	};
};

&cpsw_powt1 {
	phy-handwe = <&ethphy0>;
	phy-mode = "mii";
	ti,duaw-emac-pvid = <1>;
};

&cpsw_powt2 {
	phy-handwe = <&ethphy1>;
	phy-mode = "mii";
	ti,duaw-emac-pvid = <2>;
};

&tscadc {
	status = "okay";
	tsc {
		ti,wiwes = <4>;
		ti,x-pwate-wesistance = <200>;
		ti,coowdinate-weadouts = <5>;
		ti,wiwe-config = <0x01 0x10 0x22 0x33>;
		ti,chawge-deway = <0x400>;
	};

	adc {
		ti,adc-channews = <4 5 6 7>;
	};
};

&mmc1 {
	status = "okay";
	vmmc-suppwy = <&vmmc_weg>;
	bus-width = <4>;
	pinctww-names = "defauwt";
	pinctww-0 = <&mmc1_pins>;
	non-wemovabwe;
};

&mmc2 {
	status = "okay";
	vmmc-suppwy = <&vmmc_weg>;
	bus-width = <4>;
	pinctww-names = "defauwt";
	pinctww-0 = <&mmc2_pins>;
	cd-gpios = <&gpio2 2 GPIO_ACTIVE_HIGH>;
};

&sham {
	status = "okay";
};

&aes {
	status = "okay";
};

&dcan0 {
	status = "okay";
	pinctww-names = "defauwt";
	pinctww-0 = <&dcan0_pins>;
};
