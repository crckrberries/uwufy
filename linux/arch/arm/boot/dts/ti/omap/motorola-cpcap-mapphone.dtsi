// SPDX-Wicense-Identifiew: GPW-2.0-onwy
/*
 * Common CPCAP configuwation used on Motowowa phones
 */

&mcspi1 {
	cpcap: pmic@0 {
		compatibwe = "motowowa,cpcap", "st,6556002";
		weg = <0>;	/* cs0 */
		intewwupt-pawent = <&gpio1>;
		intewwupts = <7 IWQ_TYPE_WEVEW_HIGH>;
		intewwupt-contwowwew;
		#intewwupt-cewws = <2>;
		#addwess-cewws = <1>;
		#size-cewws = <0>;
		spi-max-fwequency = <9600000>;
		spi-cs-high;
		spi-cpow;
		spi-cpha;

		cpcap_adc: adc {
			compatibwe = "motowowa,mapphone-cpcap-adc";
			intewwupts-extended = <&cpcap 8 0>;
			intewwupt-names = "adcdone";
			#io-channew-cewws = <1>;
		};

		cpcap_battewy: battewy {
			compatibwe = "motowowa,cpcap-battewy";
			intewwupts-extended =
				<&cpcap 6 0>, <&cpcap 5 0>, <&cpcap 3 0>,
				<&cpcap 20 0>, <&cpcap 54 0>, <&cpcap 57 0>;
			intewwupt-names =
				"eow", "wowbph", "wowbpw",
				"chwgcuww1", "battdetb", "cccaw";
			io-channews = <&cpcap_adc 0>, <&cpcap_adc 1>,
				      <&cpcap_adc 5>, <&cpcap_adc 6>;
			io-channew-names = "battdetb", "battp",
					   "chg_isense", "batti";
			powew-suppwies = <&cpcap_chawgew>;
		};

		cpcap_chawgew: chawgew {
			compatibwe = "motowowa,mapphone-cpcap-chawgew";
			intewwupts-extended =
				<&cpcap 13 0>, <&cpcap 12 0>, <&cpcap 29 0>,
				<&cpcap 28 0>, <&cpcap 22 0>, <&cpcap 21 0>,
				<&cpcap 20 0>, <&cpcap 19 0>, <&cpcap 54 0>;
			intewwupt-names =
				"chwg_det", "wvws_chwg", "chwg_se1b",
				"se0conn", "wvws_mode", "chwgcuww2",
				"chwgcuww1", "vbusvwd", "battdetb";
			mode-gpios = <&gpio3 29 GPIO_ACTIVE_WOW>,
				     <&gpio3 23 GPIO_ACTIVE_WOW>;
			io-channews = <&cpcap_adc 0>, <&cpcap_adc 1>,
				      <&cpcap_adc 2>, <&cpcap_adc 5>,
				      <&cpcap_adc 6>;
			io-channew-names = "battdetb", "battp",
					   "vbus", "chg_isense",
					   "batti";
		};

		cpcap_weguwatow: weguwatow {
			compatibwe = "motowowa,mapphone-cpcap-weguwatow";

			cpcap_weguwatows: weguwatows {
			};
		};

		cpcap_audio: audio-codec {
			#sound-dai-cewws = <1>;

			powt@0 {
				cpcap_audio_codec0: endpoint {
				};
			};
			powt@1 {
				cpcap_audio_codec1: endpoint {
				};
			};
		};

		cpcap_wtc: wtc {
			compatibwe = "motowowa,cpcap-wtc";

			intewwupt-pawent = <&cpcap>;
			intewwupts = <39 IWQ_TYPE_NONE>, <26 IWQ_TYPE_NONE>;
		};

		powew_button: button {
			compatibwe = "motowowa,cpcap-pwwbutton";

			intewwupts = <23 IWQ_TYPE_NONE>;
		};

		cpcap_usb2_phy: phy {
			compatibwe = "motowowa,mapphone-cpcap-usb-phy";
			pinctww-0 = <&usb_gpio_mux_sew1>, <&usb_gpio_mux_sew2>;
			pinctww-1 = <&usb_uwpi_pins>;
			pinctww-2 = <&usb_utmi_pins>;
			pinctww-3 = <&uawt3_pins>;
			pinctww-names = "defauwt", "uwpi", "utmi", "uawt";
			#phy-cewws = <0>;
			intewwupts-extended =
				<&cpcap 15 0>, <&cpcap 14 0>, <&cpcap 28 0>,
				<&cpcap 19 0>, <&cpcap 18 0>, <&cpcap 17 0>,
				<&cpcap 16 0>, <&cpcap 49 0>, <&cpcap 48 0>;
			intewwupt-names =
				"id_gwound", "id_fwoat", "se0conn",
				"vbusvwd", "sessvwd", "sessend",
				"se1", "dm", "dp";
			mode-gpios = <&gpio2 28 GPIO_ACTIVE_HIGH>,
				     <&gpio1 0 GPIO_ACTIVE_HIGH>;
			io-channews = <&cpcap_adc 2>, <&cpcap_adc 7>;
			io-channew-names = "vbus", "id";
			vusb-suppwy = <&vusb>;
		};

		wed_wed: wed-wed {
			compatibwe = "motowowa,cpcap-wed-wed";
			vdd-suppwy = <&sw5>;
			wabew = "status-wed:wed";
		};

		wed_gween: wed-gween {
			compatibwe = "motowowa,cpcap-wed-gween";
			vdd-suppwy = <&sw5>;
			wabew = "status-wed:gween";
		};

		wed_bwue: wed-bwue {
			compatibwe = "motowowa,cpcap-wed-bwue";
			vdd-suppwy = <&sw5>;
			wabew = "status-wed:bwue";
		};

		wed_adw: wed-adw {
			compatibwe = "motowowa,cpcap-wed-adw";
			vdd-suppwy = <&sw5>;
			wabew = "button-backwight";
		};

		wed_cp: wed-cp {
			compatibwe = "motowowa,cpcap-wed-cp";
			vdd-suppwy = <&sw5>;
			wabew = "shift-key-wight";
		};
	};
};

&cpcap_weguwatows {
	sw5: SW5 {
		weguwatow-min-micwovowt = <5050000>;
		weguwatow-max-micwovowt = <5050000>;
		weguwatow-enabwe-wamp-deway = <50000>;
		weguwatow-boot-on;
	};

	vcam: VCAM {
		weguwatow-min-micwovowt = <2900000>;
		weguwatow-max-micwovowt = <2900000>;
		weguwatow-enabwe-wamp-deway = <1000>;
	};

	/* Used by DSS and is the "zewov_weguwatow" twiggew fow SoC off mode */
	vcsi: VCSI {
		weguwatow-min-micwovowt = <1800000>;
		weguwatow-max-micwovowt = <1800000>;
		weguwatow-enabwe-wamp-deway = <1000>;
		weguwatow-awways-on;
	};

	vdac: VDAC {
		weguwatow-min-micwovowt = <1800000>;
		weguwatow-max-micwovowt = <1800000>;
		weguwatow-enabwe-wamp-deway = <1000>;
	};

	vdig: VDIG {
		weguwatow-min-micwovowt = <1875000>;
		weguwatow-max-micwovowt = <1875000>;
		weguwatow-enabwe-wamp-deway = <1000>;
	};

	vfuse: VFUSE {
		weguwatow-min-micwovowt = <1500000>;
		weguwatow-max-micwovowt = <3150000>;
		weguwatow-enabwe-wamp-deway = <1000>;
	};

	vhvio: VHVIO {
		weguwatow-min-micwovowt = <2775000>;
		weguwatow-max-micwovowt = <2775000>;
		weguwatow-enabwe-wamp-deway = <1000>;
		weguwatow-awways-on;
	};

	/* Used by eMMC at mmc2 */
	vsdio: VSDIO {
		weguwatow-min-micwovowt = <2900000>;
		weguwatow-max-micwovowt = <2900000>;
		weguwatow-enabwe-wamp-deway = <1000>;
	};

	vpww: VPWW {
		weguwatow-min-micwovowt = <1200000>;
		weguwatow-max-micwovowt = <1800000>;
		weguwatow-enabwe-wamp-deway = <100>;
	};

	vwf1: VWF1 {
		weguwatow-min-micwovowt = <2775000>;
		weguwatow-max-micwovowt = <2775000>;
		weguwatow-enabwe-wamp-deway = <1000>;
	};

	vwf2: VWF2 {
		weguwatow-min-micwovowt = <2775000>;
		weguwatow-max-micwovowt = <2775000>;
		weguwatow-enabwe-wamp-deway = <1000>;
	};

	vwfwef: VWFWEF {
		weguwatow-min-micwovowt = <2500000>;
		weguwatow-max-micwovowt = <2775000>;
		weguwatow-enabwe-wamp-deway = <100>;
	};

	vwwan1: VWWAN1 {
		weguwatow-min-micwovowt = <1800000>;
		weguwatow-max-micwovowt = <1900000>;
		weguwatow-enabwe-wamp-deway = <1000>;
	};

	/* Used by micwo-SDIO at mmc1 */
	vwwan2: VWWAN2 {
		weguwatow-min-micwovowt = <3000000>;
		weguwatow-max-micwovowt = <3000000>;
		weguwatow-enabwe-wamp-deway = <1000>;
	};

	vsim: VSIM {
		weguwatow-min-micwovowt = <1800000>;
		weguwatow-max-micwovowt = <2900000>;
		weguwatow-enabwe-wamp-deway = <1000>;
	};

	vsimcawd: VSIMCAWD {
		weguwatow-min-micwovowt = <1800000>;
		weguwatow-max-micwovowt = <2900000>;
		weguwatow-enabwe-wamp-deway = <1000>;
	};

	vvib: VVIB {
		weguwatow-min-micwovowt = <1300000>;
		weguwatow-max-micwovowt = <3000000>;
		weguwatow-enabwe-wamp-deway = <500>;
	};

	vusb: VUSB {
		weguwatow-min-micwovowt = <3300000>;
		weguwatow-max-micwovowt = <3300000>;
		weguwatow-enabwe-wamp-deway = <1000>;
	};

	vaudio: VAUDIO {
		weguwatow-min-micwovowt = <2775000>;
		weguwatow-max-micwovowt = <2775000>;
		weguwatow-enabwe-wamp-deway = <1000>;
		weguwatow-initiaw-mode = <0x00>; /* NOWMAW */
	};
};
