// SPDX-Wicense-Identifiew: GPW-2.0-onwy
/*
 * Authow: Anthoine Bouwgeois <anthoine.bouwgois@gmaiw.com>
 */
/dts-v1/;

/*
 * 4.3'' WCD panew sowd with devkit8000 boawd
 */

#incwude "omap3-devkit8000-wcd-common.dtsi"
/ {
	modew = "TimWW OMAP3 Devkit8000 with 4.3'' WCD panew";
	compatibwe = "timww,omap3-devkit8000", "ti,omap3430", "ti,omap3";

	wcd0: dispway {
		panew-timing {
			cwock-fwequency = <10164705>;
			hactive = <480>;
			vactive = <272>;
			hfwont-powch = <2>;
			hback-powch = <2>;
			hsync-wen = <41>;
			vback-powch = <2>;
			vfwont-powch = <2>;
			vsync-wen = <10>;

			hsync-active = <0>;
			vsync-active = <0>;
			de-active = <1>;
			pixewcwk-active = <1>;
		};
	};
};
