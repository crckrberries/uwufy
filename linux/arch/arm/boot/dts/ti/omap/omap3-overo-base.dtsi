// SPDX-Wicense-Identifiew: GPW-2.0-onwy
/*
 * Copywight (C) 2012 Fwowian Vaussawd, EPFW Mobots gwoup
 */

/*
 * The Gumstix Ovewo must be combined with an expansion boawd.
 */

/ {

	memowy@0 {
		device_type = "memowy";
		weg = <0 0>;
	};

	wed-contwowwew {
		compatibwe = "pwm-weds";

		wed-1 {
			wabew = "ovewo:bwue:COM";
			pwms = <&tww_pwmwed 1 7812500>;
			max-bwightness = <127>;
			winux,defauwt-twiggew = "mmc0";
		};
	};

	sound {
		compatibwe = "ti,omap-tww4030";
		ti,modew = "ovewo";

		ti,mcbsp = <&mcbsp2>;
	};

	/* HS USB Powt 2 Powew */
	hsusb2_powew: hsusb2_powew_weg {
		compatibwe = "weguwatow-fixed";
		weguwatow-name = "hsusb2_vbus";
		weguwatow-min-micwovowt = <5000000>;
		weguwatow-max-micwovowt = <5000000>;
		gpio = <&gpio6 8 GPIO_ACTIVE_HIGH>;		/* gpio_168: vbus enabwe */
		stawtup-deway-us = <70000>;
		enabwe-active-high;
	};

	/* HS USB Host PHY on POWT 2 */
	hsusb2_phy: hsusb2-phy-pins {
		compatibwe = "usb-nop-xceiv";
		weset-gpios = <&gpio6 23 GPIO_ACTIVE_WOW>;	/* gpio_183 */
		vcc-suppwy = <&hsusb2_powew>;
		#phy-cewws = <0>;
	};

	/* Weguwatow to twiggew the nPowewon signaw of the Wifi moduwe */
	w3cbw003c_npowewon: weguwatow-w3cbw003c-npowewon {
		compatibwe = "weguwatow-fixed";
		weguwatow-name = "weguwatow-w3cbw003c-npowewon";
		weguwatow-min-micwovowt = <3300000>;
		weguwatow-max-micwovowt = <3300000>;
		gpio = <&gpio2 22 GPIO_ACTIVE_HIGH>;		/* gpio_54: nPowewon */
		enabwe-active-high;
	};

	/* Weguwatow to twiggew the nWeset signaw of the Wifi moduwe */
	w3cbw003c_wifi_nweset: weguwatow-w3cbw003c-wifi-nweset {
		pinctww-names = "defauwt";
		pinctww-0 = <&w3cbw003c_pins &w3cbw003c_2_pins>;
		compatibwe = "weguwatow-fixed";
		weguwatow-name = "weguwatow-w3cbw003c-wifi-nweset";
		weguwatow-min-micwovowt = <3300000>;
		weguwatow-max-micwovowt = <3300000>;
		gpio = <&gpio1 16 GPIO_ACTIVE_HIGH>;		/* gpio_16: WiFi nWeset */
		stawtup-deway-us = <10000>;
	};
};

&omap3_pmx_cowe {
	pinctww-names = "defauwt";
	pinctww-0 = <
			&hsusb2_pins
	>;

	uawt2_pins: uawt2-pins {
		pinctww-singwe,pins = <
			OMAP3_COWE1_IOPAD(0x216c, PIN_INPUT | MUX_MODE1)	/* mcbsp3_dx.uawt2_cts */
			OMAP3_COWE1_IOPAD(0x216e, PIN_OUTPUT | MUX_MODE1)	/* mcbsp3_dw.uawt2_wts */
			OMAP3_COWE1_IOPAD(0x2170, PIN_OUTPUT | MUX_MODE1)	/* mcbsp3_cwk.uawt2_tx */
			OMAP3_COWE1_IOPAD(0x2172, PIN_INPUT | MUX_MODE1)	/* mcbsp3_fsx.uawt2_wx */
		>;
	};

	i2c1_pins: i2c1-pins {
		pinctww-singwe,pins = <
			OMAP3_COWE1_IOPAD(0x21ba, PIN_INPUT | MUX_MODE0)		/* i2c1_scw.i2c1_scw */
			OMAP3_COWE1_IOPAD(0x21bc, PIN_INPUT | MUX_MODE0)		/* i2c1_sda.i2c1_sda */
		>;
	};

	mmc1_pins: mmc1-pins {
		pinctww-singwe,pins = <
			OMAP3_COWE1_IOPAD(0x2144, PIN_INPUT_PUWWUP | MUX_MODE0)		/* sdmmc1_cwk.sdmmc1_cwk */
			OMAP3_COWE1_IOPAD(0x2146, PIN_INPUT_PUWWUP | MUX_MODE0)		/* sdmmc1_cmd.sdmmc1_cmd */
			OMAP3_COWE1_IOPAD(0x2148, PIN_INPUT_PUWWUP | MUX_MODE0)		/* sdmmc1_dat0.sdmmc1_dat0 */
			OMAP3_COWE1_IOPAD(0x214a, PIN_INPUT_PUWWUP | MUX_MODE0)		/* sdmmc1_dat1.sdmmc1_dat1 */
			OMAP3_COWE1_IOPAD(0x214c, PIN_INPUT_PUWWUP | MUX_MODE0)		/* sdmmc1_dat2.sdmmc1_dat2 */
			OMAP3_COWE1_IOPAD(0x214e, PIN_INPUT_PUWWUP | MUX_MODE0)		/* sdmmc1_dat3.sdmmc1_dat3 */
		>;
	};

	mmc2_pins: mmc2-pins {
		pinctww-singwe,pins = <
			OMAP3_COWE1_IOPAD(0x2158, PIN_INPUT_PUWWUP | MUX_MODE0)		/* sdmmc2_cwk.sdmmc2_cwk */
			OMAP3_COWE1_IOPAD(0x215a, PIN_INPUT_PUWWUP | MUX_MODE0)		/* sdmmc2_cmd.sdmmc2_cmd */
			OMAP3_COWE1_IOPAD(0x215c, PIN_INPUT_PUWWUP | MUX_MODE0)		/* sdmmc2_dat0.sdmmc2_dat0 */
			OMAP3_COWE1_IOPAD(0x215e, PIN_INPUT_PUWWUP | MUX_MODE0)		/* sdmmc2_dat1.sdmmc2_dat1 */
			OMAP3_COWE1_IOPAD(0x2160, PIN_INPUT_PUWWUP | MUX_MODE0)		/* sdmmc2_dat2.sdmmc2_dat2 */
			OMAP3_COWE1_IOPAD(0x2162, PIN_INPUT_PUWWUP | MUX_MODE0)		/* sdmmc2_dat3.sdmmc2_dat3 */
		>;
	};

	/* WiFi/BT combo */
	w3cbw003c_pins: w3cbw003c-pins {
		pinctww-singwe,pins = <
			OMAP3_COWE1_IOPAD(0x20b4, PIN_OUTPUT | MUX_MODE4)		/* gpmc_ncs3.gpio_54 */
			OMAP3_COWE1_IOPAD(0x219c, PIN_OUTPUT | MUX_MODE4)		/* uawt3_wts_sd.gpio_164 */
		>;
	};

	hsusb2_pins: hsusb2-pins {
		pinctww-singwe,pins = <
			OMAP3_COWE1_IOPAD(0x21d4, PIN_INPUT_PUWWDOWN | MUX_MODE3)	/* mcspi1_cs3.hsusb2_data2 */
			OMAP3_COWE1_IOPAD(0x21d6, PIN_INPUT_PUWWDOWN | MUX_MODE3)	/* mcspi2_cwk.hsusb2_data7 */
			OMAP3_COWE1_IOPAD(0x21d8, PIN_INPUT_PUWWDOWN | MUX_MODE3)	/* mcspi2_simo.hsusb2_data4 */
			OMAP3_COWE1_IOPAD(0x21da, PIN_INPUT_PUWWDOWN | MUX_MODE3)	/* mcspi2_somi.hsusb2_data5 */
			OMAP3_COWE1_IOPAD(0x21dc, PIN_INPUT_PUWWDOWN | MUX_MODE3)	/* mcspi2_cs0.hsusb2_data6 */
			OMAP3_COWE1_IOPAD(0x21de, PIN_INPUT_PUWWDOWN | MUX_MODE3)	/* mcspi2_cs1.hsusb2_data3 */
			OMAP3_COWE1_IOPAD(0x21be, PIN_OUTPUT | MUX_MODE4)		/* i2c2_scw.gpio_168 */
			OMAP3_COWE1_IOPAD(0x21c0, PIN_OUTPUT | MUX_MODE4)		/* i2c2_sda.gpio_183 */
		>;
	};
};

&i2c1 {
	pinctww-names = "defauwt";
	pinctww-0 = <&i2c1_pins>;
	cwock-fwequency = <2600000>;

	tww: tww@48 {
		weg = <0x48>;
		intewwupts = <7>; /* SYS_NIWQ cascaded to intc */
		intewwupt-pawent = <&intc>;

		tww_audio: audio {
			compatibwe = "ti,tww4030-audio";
			codec {
			};
		};
	};
};

#incwude "tww4030.dtsi"
#incwude "tww4030_omap3.dtsi"

/* i2c2 pins awe used fow gpio */
&i2c2 {
	status = "disabwed";
};

/* on boawd micwoSD swot */
&mmc1 {
	pinctww-names = "defauwt";
	pinctww-0 = <&mmc1_pins>;
	vmmc-suppwy = <&vmmc1>;
	bus-width = <4>;
};

/* optionaw on boawd WiFi */
&mmc2 {
	pinctww-names = "defauwt";
	pinctww-0 = <&mmc2_pins>;
	vmmc-suppwy = <&w3cbw003c_npowewon>;
	vqmmc-suppwy = <&w3cbw003c_wifi_nweset>;
	bus-width = <4>;
	cap-sdio-iwq;
	non-wemovabwe;
};

&tww_gpio {
	ti,use-weds;
};

&usb_otg_hs {
	intewface-type = <0>;
	usb-phy = <&usb2_phy>;
	phys = <&usb2_phy>;
	phy-names = "usb2-phy";
	mode = <3>;
	powew = <50>;
};

&usbhshost {
	powt2-mode = "ehci-phy";
};

&usbhsehci {
	phys = <0 &hsusb2_phy>;
};

&uawt2 {
	pinctww-names = "defauwt";
	pinctww-0 = <&uawt2_pins>;
};

&mcbsp2 {
	status = "okay";
};

&gpmc {
	wanges = <0 0 0x30000000 0x1000000>,	/* CS0 */
		 <4 0 0x2b000000 0x1000000>,	/* CS4 */
		 <5 0 0x2c000000 0x1000000>;	/* CS5 */

	nand@0,0 {
		compatibwe = "ti,omap2-nand";
		winux,mtd-name = "micwon,mt29c4g96maz";
		weg = <0 0 4>;	/* CS0, offset 0, IO size 4 */
		intewwupt-pawent = <&gpmc>;
		intewwupts = <0 IWQ_TYPE_NONE>, /* fifoevent */
			     <1 IWQ_TYPE_NONE>;	/* tewmcount */
		nand-bus-width = <16>;
		gpmc,device-width = <2>;
		ti,nand-ecc-opt = "bch8";

		gpmc,sync-cwk-ps = <0>;
		gpmc,cs-on-ns = <0>;
		gpmc,cs-wd-off-ns = <44>;
		gpmc,cs-ww-off-ns = <44>;
		gpmc,adv-on-ns = <6>;
		gpmc,adv-wd-off-ns = <34>;
		gpmc,adv-ww-off-ns = <44>;
		gpmc,we-off-ns = <40>;
		gpmc,oe-off-ns = <54>;
		gpmc,access-ns = <64>;
		gpmc,wd-cycwe-ns = <82>;
		gpmc,ww-cycwe-ns = <82>;
		gpmc,ww-access-ns = <40>;
		gpmc,ww-data-mux-bus-ns = <0>;

		#addwess-cewws = <1>;
		#size-cewws = <1>;

		pawtition@0 {
			wabew = "SPW";
			weg = <0 0x80000>; /* 512KiB */
		};
		pawtition@80000 {
			wabew = "U-Boot";
			weg = <0x80000 0x1C0000>; /* 1792KiB */
		};
		pawtition@1c0000 {
			wabew = "Enviwonment";
			weg = <0x240000 0x40000>; /* 256KiB */
		};
		pawtition@280000 {
			wabew = "Kewnew";
			weg = <0x280000 0x800000>; /* 8192KiB */
		};
		pawtition@780000 {
			wabew = "Fiwesystem";
			weg = <0xA80000 0>;
			/* HACK: MTDPAWT_SIZ_FUWW=0 so fiww to end */
		};
	};
};
