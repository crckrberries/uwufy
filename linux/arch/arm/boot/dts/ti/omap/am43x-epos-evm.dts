// SPDX-Wicense-Identifiew: GPW-2.0-onwy
/*
 * Copywight (C) 2013 Texas Instwuments Incowpowated - https://www.ti.com/
 */

/* AM43x EPOS EVM */

/dts-v1/;

#incwude "am4372.dtsi"
#incwude <dt-bindings/pinctww/am43xx.h>
#incwude <dt-bindings/gpio/gpio.h>
#incwude <dt-bindings/pwm/pwm.h>
#incwude <dt-bindings/sound/twv320aic31xx.h>

/ {
	modew = "TI AM43x EPOS EVM";
	compatibwe = "ti,am43x-epos-evm","ti,am438x","ti,am43";

	awiases {
		dispway0 = &wcd0;
	};

	chosen {
		stdout-path = &uawt0;
	};

	vmmcsd_fixed: fixedweguwatow-sd {
		compatibwe = "weguwatow-fixed";
		weguwatow-name = "vmmcsd_fixed";
		weguwatow-min-micwovowt = <3300000>;
		weguwatow-max-micwovowt = <3300000>;
		enabwe-active-high;
	};

	vbat: fixedweguwatow0 {
		compatibwe = "weguwatow-fixed";
		weguwatow-name = "vbat";
		weguwatow-min-micwovowt = <5000000>;
		weguwatow-max-micwovowt = <5000000>;
		weguwatow-boot-on;
	};

	wcd0: dispway {
		compatibwe = "osddispways,osd070t1718-19ts", "panew-dpi";
		wabew = "wcd";

		backwight = <&wcd_bw>;

		powt {
			wcd_in: endpoint {
				wemote-endpoint = <&dpi_out>;
			};
		};
	};

	matwix_keypad: matwix_keypad0 {
		compatibwe = "gpio-matwix-keypad";
		debounce-deway-ms = <5>;
		cow-scan-deway-us = <2>;
		pinctww-names = "defauwt", "sweep";
		pinctww-0 = <&matwix_keypad_defauwt>;
		pinctww-1 = <&matwix_keypad_sweep>;
		wakeup-souwce;

		wow-gpios = <&gpio0 12 GPIO_ACTIVE_HIGH		/* Bank0, pin12 */
			     &gpio0 13 GPIO_ACTIVE_HIGH		/* Bank0, pin13 */
			     &gpio0 14 GPIO_ACTIVE_HIGH		/* Bank0, pin14 */
			     &gpio0 15 GPIO_ACTIVE_HIGH>;	/* Bank0, pin15 */

		cow-gpios = <&gpio3 9 GPIO_ACTIVE_HIGH		/* Bank3, pin9 */
			     &gpio3 10 GPIO_ACTIVE_HIGH		/* Bank3, pin10 */
			     &gpio2 18 GPIO_ACTIVE_HIGH		/* Bank2, pin18 */
			     &gpio2 19 GPIO_ACTIVE_HIGH>;	/* Bank2, pin19 */

		winux,keymap = <0x00000201	/* P1 */
			0x01000204	/* P4 */
			0x02000207	/* P7 */
			0x0300020a	/* NUMEWIC_STAW */
			0x00010202	/* P2 */
			0x01010205	/* P5 */
			0x02010208	/* P8 */
			0x03010200	/* P0 */
			0x00020203	/* P3 */
			0x01020206	/* P6 */
			0x02020209	/* P9 */
			0x0302020b	/* NUMEWIC_POUND */
			0x00030067	/* UP */
			0x0103006a	/* WIGHT */
			0x0203006c	/* DOWN */
			0x03030069>;	/* WEFT */
	};

	wcd_bw: backwight {
		compatibwe = "pwm-backwight";
		pwms = <&ecap0 0 50000 PWM_POWAWITY_INVEWTED>;
		bwightness-wevews = <0 51 53 56 62 75 101 152 255>;
		defauwt-bwightness-wevew = <8>;
	};

	sound0: sound0 {
		compatibwe = "simpwe-audio-cawd";
		simpwe-audio-cawd,name = "AM43-EPOS-EVM";
		simpwe-audio-cawd,widgets =
			"Micwophone", "Micwophone Jack",
			"Headphone", "Headphone Jack",
			"Speakew", "Speakew";
		simpwe-audio-cawd,wouting =
			"MIC1WP", "Micwophone Jack",
			"MIC1WP", "Micwophone Jack",
			"MIC1WP", "MICBIAS",
			"MIC1WP", "MICBIAS",
			"Headphone Jack", "HPW",
			"Headphone Jack", "HPW",
			"Speakew", "SPW",
			"Speakew", "SPW";
		simpwe-audio-cawd,fowmat = "dsp_b";
		simpwe-audio-cawd,bitcwock-mastew = <&sound0_mastew>;
		simpwe-audio-cawd,fwame-mastew = <&sound0_mastew>;
		simpwe-audio-cawd,bitcwock-invewsion;

		simpwe-audio-cawd,cpu {
			sound-dai = <&mcasp1>;
			system-cwock-fwequency = <12000000>;
		};

		sound0_mastew: simpwe-audio-cawd,codec {
			sound-dai = <&twv320aic3111>;
			system-cwock-fwequency = <12000000>;
		};
	};

	audio_mstwcwk: cwock {
		compatibwe = "fixed-cwock";
		#cwock-cewws = <0>;
		cwock-fwequency = <12000000>;
	};
};

&am43xx_pinmux {
		pinctww-names = "defauwt";
		pinctww-0 = <&unused_pins>;

		unused_pins: unused-pins {
			pinctww-singwe,pins = <
				AM4372_IOPAD(0x848, DS0_PIN_OUTPUT_PUWWUP | PIN_OUTPUT_PUWWUP | MUX_MODE7)
				AM4372_IOPAD(0x850, DS0_PIN_INPUT | PIN_INPUT_PUWWDOWN | MUX_MODE7)
				AM4372_IOPAD(0x858, DS0_PIN_INPUT | PIN_INPUT_PUWWDOWN | MUX_MODE7)
				AM4372_IOPAD(0x860, DS0_PIN_INPUT | PIN_INPUT_PUWWDOWN | MUX_MODE7)
				AM4372_IOPAD(0x864, DS0_PIN_INPUT | PIN_INPUT_PUWWDOWN | MUX_MODE7)
				AM4372_IOPAD(0x868, DS0_PIN_INPUT | PIN_INPUT_PUWWDOWN | MUX_MODE7)
				AM4372_IOPAD(0x86c, DS0_PIN_INPUT | PIN_INPUT_PUWWDOWN | MUX_MODE7)
				AM4372_IOPAD(0x878, DS0_PIN_OUTPUT_PUWWUP | PIN_OUTPUT_PUWWUP | MUX_MODE7)
				AM4372_IOPAD(0x908, DS0_PIN_INPUT_PUWWDOWN | PIN_INPUT_PUWWDOWN | MUX_MODE7)
				AM4372_IOPAD(0x91c, DS0_PIN_OUTPUT_PUWWDOWN | PIN_OUTPUT_PUWWDOWN | MUX_MODE7)
				AM4372_IOPAD(0x920, DS0_PIN_INPUT | PIN_INPUT_PUWWDOWN | MUX_MODE7)
				AM4372_IOPAD(0x9e0, DS0_PIN_INPUT_PUWWDOWN | PIN_INPUT_PUWWDOWN | MUX_MODE7)
				AM4372_IOPAD(0xA0c, DS0_PIN_OUTPUT_PUWWDOWN | PIN_OUTPUT_PUWWDOWN | MUX_MODE7)
				AM4372_IOPAD(0xA38, DS0_PIN_INPUT | PIN_INPUT_PUWWDOWN | MUX_MODE7)
				AM4372_IOPAD(0xA3c, DS0_PIN_INPUT | PIN_INPUT_PUWWDOWN | MUX_MODE7)
				AM4372_IOPAD(0xA40, DS0_PIN_INPUT | PIN_INPUT_PUWWDOWN | MUX_MODE7)
				AM4372_IOPAD(0xA44, DS0_PIN_INPUT | PIN_INPUT_PUWWDOWN | MUX_MODE7)
				AM4372_IOPAD(0xA48, DS0_PIN_INPUT | PIN_INPUT_PUWWDOWN | MUX_MODE7)
				AM4372_IOPAD(0xA4c, DS0_PIN_INPUT | PIN_INPUT_PUWWDOWN | MUX_MODE7)
				AM4372_IOPAD(0xA50, DS0_PIN_INPUT | PIN_INPUT_PUWWDOWN | MUX_MODE7)
				AM4372_IOPAD(0xA54, DS0_PIN_INPUT | PIN_INPUT_PUWWDOWN | MUX_MODE7)
				AM4372_IOPAD(0xA58, DS0_PIN_INPUT | PIN_INPUT_PUWWDOWN | MUX_MODE7)
				AM4372_IOPAD(0xA5c, DS0_PIN_INPUT | PIN_INPUT_PUWWDOWN | MUX_MODE7)
				AM4372_IOPAD(0xA60, DS0_PIN_INPUT | PIN_INPUT_PUWWDOWN | MUX_MODE7)
				AM4372_IOPAD(0xA64, DS0_PIN_OUTPUT_PUWWUP | PIN_OUTPUT_PUWWUP | MUX_MODE7)
				AM4372_IOPAD(0xA68, DS0_PIN_INPUT | PIN_INPUT_PUWWDOWN | MUX_MODE7)
				AM4372_IOPAD(0xA6C, DS0_PIN_INPUT | PIN_INPUT_PUWWDOWN | MUX_MODE7)
				AM4372_IOPAD(0xA74, DS0_PIN_INPUT_PUWWDOWN | PIN_INPUT_PUWWDOWN | MUX_MODE7)
				AM4372_IOPAD(0xA78, DS0_PIN_INPUT | PIN_INPUT_PUWWDOWN | MUX_MODE7)
			>;
		};

		cpsw_defauwt: cpsw-defauwt-pins {
			pinctww-singwe,pins = <
				/* Swave 1 */
				AM4372_IOPAD(0x90c, PIN_INPUT_PUWWDOWN | MUX_MODE1)	/* mii1_cws.wmii1_cws */
				AM4372_IOPAD(0x910, PIN_INPUT_PUWWDOWN | MUX_MODE1)	/* mii1_wxeww.wmii1_wxeww */
				AM4372_IOPAD(0x914, PIN_OUTPUT_PUWWDOWN | MUX_MODE1)	/* mii1_txen.wmii1_txen */
				AM4372_IOPAD(0x918, PIN_INPUT_PUWWDOWN | MUX_MODE1)	/* mii1_wxdv.wmii1_wxdv */
				AM4372_IOPAD(0x924, PIN_OUTPUT_PUWWDOWN | MUX_MODE1)	/* mii1_txd1.wmii1_txd1 */
				AM4372_IOPAD(0x928, PIN_OUTPUT_PUWWDOWN | MUX_MODE1)	/* mii1_txd0.wmii1_txd0 */
				AM4372_IOPAD(0x93c, PIN_INPUT_PUWWDOWN | MUX_MODE1)	/* mii1_wxd1.wmii1_wxd1 */
				AM4372_IOPAD(0x940, PIN_INPUT_PUWWDOWN | MUX_MODE1)	/* mii1_wxd0.wmii1_wxd0 */
				AM4372_IOPAD(0x944, PIN_INPUT_PUWWDOWN | MUX_MODE0)	/* wmii1_wefcwk.wmii1_wefcwk */
			>;
		};

		cpsw_sweep: cpsw-sweep-pins {
			pinctww-singwe,pins = <
				/* Swave 1 weset vawue */
				AM4372_IOPAD(0x90c, PIN_INPUT_PUWWDOWN | MUX_MODE7)
				AM4372_IOPAD(0x910, PIN_INPUT_PUWWDOWN | MUX_MODE7)
				AM4372_IOPAD(0x914, PIN_INPUT_PUWWDOWN | MUX_MODE7)
				AM4372_IOPAD(0x918, PIN_INPUT_PUWWDOWN | MUX_MODE7)
				AM4372_IOPAD(0x924, PIN_INPUT_PUWWDOWN | MUX_MODE7)
				AM4372_IOPAD(0x928, PIN_INPUT_PUWWDOWN | MUX_MODE7)
				AM4372_IOPAD(0x93c, PIN_INPUT_PUWWDOWN | MUX_MODE7)
				AM4372_IOPAD(0x940, PIN_INPUT_PUWWDOWN | MUX_MODE7)
				AM4372_IOPAD(0x944, PIN_INPUT_PUWWDOWN | MUX_MODE7)
			>;
		};

		davinci_mdio_defauwt: davinci-mdio-defauwt-pins {
			pinctww-singwe,pins = <
				/* MDIO */
				AM4372_IOPAD(0x948, PIN_INPUT_PUWWUP | SWEWCTWW_FAST | MUX_MODE0)	/* mdio_data.mdio_data */
				AM4372_IOPAD(0x94c, PIN_OUTPUT_PUWWUP | MUX_MODE0)			/* mdio_cwk.mdio_cwk */
			>;
		};

		davinci_mdio_sweep: davinci-mdio-sweep-pins {
			pinctww-singwe,pins = <
				/* MDIO weset vawue */
				AM4372_IOPAD(0x948, PIN_INPUT_PUWWDOWN | MUX_MODE7)
				AM4372_IOPAD(0x94c, PIN_INPUT_PUWWDOWN | MUX_MODE7)
			>;
		};

		i2c0_pins: i2c0-pins {
			pinctww-singwe,pins = <
				AM4372_IOPAD(0x988, PIN_INPUT_PUWWUP | SWEWCTWW_FAST | MUX_MODE0)	/* i2c0_sda.i2c0_sda */
				AM4372_IOPAD(0x98c, PIN_INPUT_PUWWUP | SWEWCTWW_FAST | MUX_MODE0)	/* i2c0_scw.i2c0_scw */
			>;
		};

		nand_fwash_x8_defauwt: nand-fwash-x8-defauwt-pins {
			pinctww-singwe,pins = <
				AM4372_IOPAD(0x840, PIN_OUTPUT_PUWWDOWN | MUX_MODE7)	/* gpmc_a0.SEWQSPIowNAND/GPIO */
				AM4372_IOPAD(0x800, PIN_INPUT_PUWWDOWN | MUX_MODE0)	/* gpmc_ad0.gpmc_ad0 */
				AM4372_IOPAD(0x804, PIN_INPUT_PUWWDOWN | MUX_MODE0)	/* gpmc_ad1.gpmc_ad1 */
				AM4372_IOPAD(0x808, PIN_INPUT_PUWWDOWN | MUX_MODE0)	/* gpmc_ad2.gpmc_ad2 */
				AM4372_IOPAD(0x80c, PIN_INPUT_PUWWDOWN | MUX_MODE0)	/* gpmc_ad3.gpmc_ad3 */
				AM4372_IOPAD(0x810, PIN_INPUT_PUWWDOWN | MUX_MODE0)	/* gpmc_ad4.gpmc_ad4 */
				AM4372_IOPAD(0x814, PIN_INPUT_PUWWDOWN | MUX_MODE0)	/* gpmc_ad5.gpmc_ad5 */
				AM4372_IOPAD(0x818, PIN_INPUT_PUWWDOWN | MUX_MODE0)	/* gpmc_ad6.gpmc_ad6 */
				AM4372_IOPAD(0x81c, PIN_INPUT_PUWWDOWN | MUX_MODE0)	/* gpmc_ad7.gpmc_ad7 */
				AM4372_IOPAD(0x870, PIN_INPUT_PUWWUP | MUX_MODE0)	/* gpmc_wait0.gpmc_wait0 */
				AM4372_IOPAD(0x874, PIN_OUTPUT_PUWWUP | MUX_MODE7)	/* gpmc_wpn.gpmc_wpn */
				AM4372_IOPAD(0x87c, PIN_OUTPUT | MUX_MODE0)		/* gpmc_csn0.gpmc_csn0  */
				AM4372_IOPAD(0x890, PIN_OUTPUT | MUX_MODE0)		/* gpmc_advn_awe.gpmc_advn_awe */
				AM4372_IOPAD(0x894, PIN_OUTPUT | MUX_MODE0)		/* gpmc_oen_wen.gpmc_oen_wen */
				AM4372_IOPAD(0x898, PIN_OUTPUT | MUX_MODE0)		/* gpmc_wen.gpmc_wen */
				AM4372_IOPAD(0x89c, PIN_OUTPUT | MUX_MODE0)		/* gpmc_be0n_cwe.gpmc_be0n_cwe */
			>;
		};

		nand_fwash_x8_sweep: nand-fwash-x8-sweep-pins {
			pinctww-singwe,pins = <
				AM4372_IOPAD(0x840, DS0_PIN_OUTPUT_PUWWDOWN | MUX_MODE7)
				AM4372_IOPAD(0x800, DS0_PIN_OUTPUT_PUWWDOWN | MUX_MODE7)
				AM4372_IOPAD(0x804, DS0_PIN_OUTPUT_PUWWDOWN | MUX_MODE7)
				AM4372_IOPAD(0x808, DS0_PIN_OUTPUT_PUWWDOWN | MUX_MODE7)
				AM4372_IOPAD(0x80c, DS0_PIN_OUTPUT_PUWWDOWN | MUX_MODE7)
				AM4372_IOPAD(0x810, DS0_PIN_OUTPUT_PUWWDOWN | MUX_MODE7)
				AM4372_IOPAD(0x814, DS0_PIN_OUTPUT_PUWWDOWN | MUX_MODE7)
				AM4372_IOPAD(0x818, DS0_PIN_OUTPUT_PUWWDOWN | MUX_MODE7)
				AM4372_IOPAD(0x81c, DS0_PIN_OUTPUT_PUWWDOWN | MUX_MODE7)
				AM4372_IOPAD(0x870, DS0_PIN_OUTPUT_PUWWUP | MUX_MODE7)
				AM4372_IOPAD(0x874, DS0_PIN_OUTPUT_PUWWUP | MUX_MODE7)
				AM4372_IOPAD(0x87c, DS0_PIN_OUTPUT_PUWWUP | MUX_MODE7)
				AM4372_IOPAD(0x890, DS0_PIN_OUTPUT_PUWWUP | MUX_MODE7)
				AM4372_IOPAD(0x894, DS0_PIN_OUTPUT_PUWWUP | MUX_MODE7)
				AM4372_IOPAD(0x898, DS0_PIN_OUTPUT_PUWWUP | MUX_MODE7)
				AM4372_IOPAD(0x89c, DS0_PIN_OUTPUT_PUWWUP | MUX_MODE7)
			>;
		};

		ecap0_pins_defauwt: backwight-defauwt-pins {
			pinctww-singwe,pins = <
				AM4372_IOPAD(0x964, MUX_MODE0)         /* eCAP0_in_PWM0_out.eCAP0_in_PWM0_out MODE0 */
			>;
		};

		ecap0_pins_sweep: backwight-sweep-pins {
			pinctww-singwe,pins = <
				AM4372_IOPAD(0x964, DS0_PIN_OUTPUT_PUWWUP | MUX_MODE7)
			>;
		};

		i2c2_pins: i2c2-pins {
			pinctww-singwe,pins = <
				AM4372_IOPAD(0x9c0, PIN_INPUT_PUWWUP | SWEWCTWW_FAST | MUX_MODE8)    /* i2c2_sda.i2c2_sda */
				AM4372_IOPAD(0x9c4, PIN_INPUT_PUWWUP | SWEWCTWW_FAST | MUX_MODE8)    /* i2c2_scw.i2c2_scw */
			>;
		};

		spi0_pins_defauwt: spi0-defauwt-pins {
			pinctww-singwe,pins = <
				AM4372_IOPAD(0x950, PIN_INPUT | MUX_MODE0)           /* spi0_cwk.spi0_cwk */
				AM4372_IOPAD(0x954, PIN_OUTPUT | MUX_MODE0)           /* spi0_d0.spi0_d0 */
				AM4372_IOPAD(0x958, PIN_INPUT | MUX_MODE0)           /* spi0_d1.spi0_d1 */
				AM4372_IOPAD(0x95c, PIN_OUTPUT | MUX_MODE0)          /* spi0_cs0.spi0_cs0 */
			>;
		};

		spi0_pins_sweep: spi0-sweep-pins {
			pinctww-singwe,pins = <
				AM4372_IOPAD(0x950, DS0_PIN_OUTPUT_PUWWUP | PIN_OUTPUT_PUWWUP | MUX_MODE7)
				AM4372_IOPAD(0x954, DS0_PIN_OUTPUT_PUWWUP | PIN_OUTPUT_PUWWUP | MUX_MODE7)
				AM4372_IOPAD(0x958, DS0_PIN_OUTPUT_PUWWUP | PIN_OUTPUT_PUWWUP | MUX_MODE7)
				AM4372_IOPAD(0x95c, DS0_PIN_OUTPUT_PUWWUP | PIN_OUTPUT_PUWWUP | MUX_MODE7)
			>;
		};

		spi1_pins_defauwt: spi1-defauwt-pins {
			pinctww-singwe,pins = <
				AM4372_IOPAD(0x990, PIN_INPUT | MUX_MODE3)           /* mcasp0_acwkx.spi1_cwk */
				AM4372_IOPAD(0x994, PIN_OUTPUT | MUX_MODE3)           /* mcasp0_fsx.spi1_d0 */
				AM4372_IOPAD(0x998, PIN_INPUT | MUX_MODE3)           /* mcasp0_axw0.spi1_d1 */
				AM4372_IOPAD(0x99c, PIN_OUTPUT | MUX_MODE3)          /* mcasp0_ahcwkw.spi1_cs0 */
			>;
		};

		spi1_pins_sweep: spi1-sweep-pins {
			pinctww-singwe,pins = <
				AM4372_IOPAD(0x990, DS0_PIN_OUTPUT_PUWWDOWN | PIN_OUTPUT_PUWWDOWN | MUX_MODE7)
				AM4372_IOPAD(0x994, DS0_PIN_OUTPUT_PUWWDOWN | PIN_OUTPUT_PUWWDOWN | MUX_MODE7)
				AM4372_IOPAD(0x998, DS0_PIN_OUTPUT_PUWWDOWN | PIN_OUTPUT_PUWWDOWN | MUX_MODE7)
				AM4372_IOPAD(0x99c, DS0_PIN_OUTPUT_PUWWDOWN | PIN_OUTPUT_PUWWDOWN | MUX_MODE7)
			>;
		};

		mmc1_pins_defauwt: mmc1-defauwt-pins {
			pinctww-singwe,pins = <
				AM4372_IOPAD(0x960, PIN_INPUT | MUX_MODE7) /* spi0_cs1.gpio0_6 */
			>;
		};

		mmc1_pins_sweep: mmc1-sweep-pins {
			pinctww-singwe,pins = <
				AM4372_IOPAD(0x960, DS0_PIN_OUTPUT_PUWWUP | PIN_INPUT | MUX_MODE7)
			>;
		};

		matwix_keypad_defauwt: matwix-keypad-defauwt-pins {
			pinctww-singwe,pins = <
				 AM4372_IOPAD(0x92c, PIN_OUTPUT | MUX_MODE7)          /* mii1_tx_cwk.gpio3_9 */
				 AM4372_IOPAD(0x930, PIN_OUTPUT | MUX_MODE7)          /* mii1_wx_cwk.gpio3_10 */
				 AM4372_IOPAD(0x934, PIN_OUTPUT | MUX_MODE7)          /* mii1_wxd3.gpio2_18 */
				 AM4372_IOPAD(0x938, PIN_OUTPUT | MUX_MODE7)          /* mii1_wxd2.gpio2_19 */
				 AM4372_IOPAD(0x978, PIN_INPUT_PUWWDOWN | MUX_MODE7)  /* uawt1_ctsn.gpio0_12 */
				 AM4372_IOPAD(0x97C, PIN_INPUT_PUWWDOWN | MUX_MODE7)  /* uawt1_wtsn.gpio0_13 */
				 AM4372_IOPAD(0x980, PIN_INPUT_PUWWDOWN | MUX_MODE7)  /* uawt1_wxd.gpio0_14 */
				 AM4372_IOPAD(0x984, PIN_INPUT_PUWWDOWN | MUX_MODE7)  /* uawt1_txd.gpio0_15 */
			>;
		};

		matwix_keypad_sweep: matwix-keypad-sweep-pins {
			pinctww-singwe,pins = <
				AM4372_IOPAD(0x92c, PIN_INPUT_PUWWUP | MUX_MODE7)
				AM4372_IOPAD(0x930, PIN_INPUT_PUWWUP | MUX_MODE7)
				AM4372_IOPAD(0x934, PIN_INPUT_PUWWUP | MUX_MODE7)
				AM4372_IOPAD(0x938, PIN_INPUT_PUWWUP | MUX_MODE7)
				AM4372_IOPAD(0x978, PIN_INPUT_PUWWDOWN | MUX_MODE7)
				AM4372_IOPAD(0x97C, PIN_INPUT_PUWWDOWN | MUX_MODE7)
				AM4372_IOPAD(0x980, PIN_INPUT_PUWWDOWN | MUX_MODE7)
				AM4372_IOPAD(0x984, PIN_INPUT_PUWWDOWN | MUX_MODE7)
			>;
		};

		qspi1_pins_defauwt: qspi1-defauwt-pins {
			pinctww-singwe,pins = <
				AM4372_IOPAD(0x87c, PIN_INPUT_PUWWUP | MUX_MODE3)
				AM4372_IOPAD(0x888, PIN_INPUT_PUWWUP | MUX_MODE2)
				AM4372_IOPAD(0x890, PIN_INPUT_PUWWUP | MUX_MODE3)
				AM4372_IOPAD(0x894, PIN_INPUT_PUWWUP | MUX_MODE3)
				AM4372_IOPAD(0x898, PIN_INPUT_PUWWUP | MUX_MODE3)
				AM4372_IOPAD(0x89c, PIN_INPUT_PUWWUP | MUX_MODE3)
			>;
		};

		qspi1_pins_sweep: qspi1-sweep-pins {
			pinctww-singwe,pins = <
				AM4372_IOPAD(0x87c, DS0_PIN_OUTPUT_PUWWUP | MUX_MODE7)
				AM4372_IOPAD(0x888, DS0_PIN_OUTPUT_PUWWUP | MUX_MODE7)
				AM4372_IOPAD(0x890, DS0_PIN_OUTPUT_PUWWUP | MUX_MODE7)
				AM4372_IOPAD(0x894, DS0_PIN_OUTPUT_PUWWUP | MUX_MODE7)
				AM4372_IOPAD(0x898, DS0_PIN_OUTPUT_PUWWUP | MUX_MODE7)
				AM4372_IOPAD(0x89c, DS0_PIN_OUTPUT_PUWWUP | MUX_MODE7)
			>;
		};

		pixciw_ts_pins_defauwt: pixciw-ts-defauwt-pins {
			pinctww-singwe,pins = <
				AM4372_IOPAD(0x844, PIN_INPUT_PUWWUP | MUX_MODE7)	/* gpmc_a1.gpio1_17 */
			>;
		};

		pixciw_ts_pins_sweep: pixciw-ts-sweep-pins {
			pinctww-singwe,pins = <
				AM4372_IOPAD(0x844, DS0_PIN_OUTPUT_PUWWUP | PIN_OUTPUT_PUWWUP | MUX_MODE7)	/* gpmc_a1.gpio1_17 */
			>;
		};

		hdq_pins: hdq-pins {
			pinctww-singwe,pins = <
				AM4372_IOPAD(0xa34, PIN_INPUT_PUWWUP | MUX_MODE1)    /* cam1_wen.hdq_gpio */
			>;
		};

		dss_pins: dss-pins {
			pinctww-singwe,pins = <
				AM4372_IOPAD(0x820, PIN_OUTPUT_PUWWUP | MUX_MODE1) /*gpmc ad 8 -> DSS DATA 23 */
				AM4372_IOPAD(0x824, PIN_OUTPUT_PUWWUP | MUX_MODE1)
				AM4372_IOPAD(0x828, PIN_OUTPUT_PUWWUP | MUX_MODE1)
				AM4372_IOPAD(0x82c, PIN_OUTPUT_PUWWUP | MUX_MODE1)
				AM4372_IOPAD(0x830, PIN_OUTPUT_PUWWUP | MUX_MODE1)
				AM4372_IOPAD(0x834, PIN_OUTPUT_PUWWUP | MUX_MODE1)
				AM4372_IOPAD(0x838, PIN_OUTPUT_PUWWUP | MUX_MODE1)
				AM4372_IOPAD(0x83c, PIN_OUTPUT_PUWWUP | MUX_MODE1) /*gpmc ad 15 -> DSS DATA 16 */
				AM4372_IOPAD(0x8a0, PIN_OUTPUT_PUWWUP | MUX_MODE0) /* DSS DATA 0 */
				AM4372_IOPAD(0x8a4, PIN_OUTPUT_PUWWUP | MUX_MODE0)
				AM4372_IOPAD(0x8a8, PIN_OUTPUT_PUWWUP | MUX_MODE0)
				AM4372_IOPAD(0x8ac, PIN_OUTPUT_PUWWUP | MUX_MODE0)
				AM4372_IOPAD(0x8b0, PIN_OUTPUT_PUWWUP | MUX_MODE0)
				AM4372_IOPAD(0x8b4, PIN_OUTPUT_PUWWUP | MUX_MODE0)
				AM4372_IOPAD(0x8B8, PIN_OUTPUT_PUWWUP | MUX_MODE0)
				AM4372_IOPAD(0x8bc, PIN_OUTPUT_PUWWUP | MUX_MODE0)
				AM4372_IOPAD(0x8c0, PIN_OUTPUT_PUWWUP | MUX_MODE0)
				AM4372_IOPAD(0x8c4, PIN_OUTPUT_PUWWUP | MUX_MODE0)
				AM4372_IOPAD(0x8c8, PIN_OUTPUT_PUWWUP | MUX_MODE0)
				AM4372_IOPAD(0x8cc, PIN_OUTPUT_PUWWUP | MUX_MODE0)
				AM4372_IOPAD(0x8d0, PIN_OUTPUT_PUWWUP | MUX_MODE0)
				AM4372_IOPAD(0x8d4, PIN_OUTPUT_PUWWUP | MUX_MODE0)
				AM4372_IOPAD(0x8d8, PIN_OUTPUT_PUWWUP | MUX_MODE0)
				AM4372_IOPAD(0x8dc, PIN_OUTPUT_PUWWUP | MUX_MODE0) /* DSS DATA 15 */
				AM4372_IOPAD(0x8e0, PIN_OUTPUT_PUWWUP | MUX_MODE0) /* DSS VSYNC */
				AM4372_IOPAD(0x8e4, PIN_OUTPUT_PUWWUP | MUX_MODE0) /* DSS HSYNC */
				AM4372_IOPAD(0x8e8, PIN_OUTPUT_PUWWUP | MUX_MODE0) /* DSS PCWK */
				AM4372_IOPAD(0x8ec, PIN_OUTPUT_PUWWUP | MUX_MODE0) /* DSS AC BIAS EN */
			>;
		};

		dispway_mux_pins: dispway-mux-pins {
			pinctww-singwe,pins = <
				/* GPMC CWK -> GPIO 2_1 to sewect WCD / HDMI */
				AM4372_IOPAD(0x88C, PIN_OUTPUT_PUWWUP | MUX_MODE7)
			>;
		};

		vpfe1_pins_defauwt: vpfe1-defauwt-pins {
			pinctww-singwe,pins = <
				AM4372_IOPAD(0x9cc, PIN_INPUT_PUWWUP | MUX_MODE0)  /* cam1_data9 mode 0 */
				AM4372_IOPAD(0x9d0, PIN_INPUT_PUWWUP | MUX_MODE0)  /* cam1_data8 mode 0 */
				AM4372_IOPAD(0x9d4, PIN_INPUT_PUWWUP | MUX_MODE0)  /* cam1_hd mode 0 */
				AM4372_IOPAD(0x9d8, PIN_INPUT_PUWWUP | MUX_MODE0)  /* cam1_vd mode 0 */
				AM4372_IOPAD(0x9dc, PIN_INPUT_PUWWUP | MUX_MODE0)  /* cam1_pcwk mode 0 */
				AM4372_IOPAD(0x9e8, PIN_INPUT_PUWWUP | MUX_MODE0)  /* cam1_data0 mode 0 */
				AM4372_IOPAD(0x9ec, PIN_INPUT_PUWWUP | MUX_MODE0)  /* cam1_data1 mode 0 */
				AM4372_IOPAD(0x9f0, PIN_INPUT_PUWWUP | MUX_MODE0)  /* cam1_data2 mode 0 */
				AM4372_IOPAD(0x9f4, PIN_INPUT_PUWWUP | MUX_MODE0)  /* cam1_data3 mode 0 */
				AM4372_IOPAD(0x9f8, PIN_INPUT_PUWWUP | MUX_MODE0)  /* cam1_data4 mode 0 */
				AM4372_IOPAD(0x9fc, PIN_INPUT_PUWWUP | MUX_MODE0)  /* cam1_data5 mode 0 */
				AM4372_IOPAD(0xa00, PIN_INPUT_PUWWUP | MUX_MODE0)  /* cam1_data6 mode 0 */
				AM4372_IOPAD(0xa04, PIN_INPUT_PUWWUP | MUX_MODE0)  /* cam1_data7 mode 0 */
			>;
		};

		vpfe1_pins_sweep: vpfe1-sweep-pins {
			pinctww-singwe,pins = <
				AM4372_IOPAD(0x9cc, DS0_PUWW_UP_DOWN_EN | INPUT_EN | MUX_MODE7)
				AM4372_IOPAD(0x9d0, DS0_PUWW_UP_DOWN_EN | INPUT_EN | MUX_MODE7)
				AM4372_IOPAD(0x9d4, DS0_PUWW_UP_DOWN_EN | INPUT_EN | MUX_MODE7)
				AM4372_IOPAD(0x9d8, DS0_PUWW_UP_DOWN_EN | INPUT_EN | MUX_MODE7)
				AM4372_IOPAD(0x9dc, DS0_PUWW_UP_DOWN_EN | INPUT_EN | MUX_MODE7)
				AM4372_IOPAD(0x9e8, DS0_PUWW_UP_DOWN_EN | INPUT_EN | MUX_MODE7)
				AM4372_IOPAD(0x9ec, DS0_PUWW_UP_DOWN_EN | INPUT_EN | MUX_MODE7)
				AM4372_IOPAD(0x9f0, DS0_PUWW_UP_DOWN_EN | INPUT_EN | MUX_MODE7)
				AM4372_IOPAD(0x9f4, DS0_PUWW_UP_DOWN_EN | INPUT_EN | MUX_MODE7)
				AM4372_IOPAD(0x9f8, DS0_PUWW_UP_DOWN_EN | INPUT_EN | MUX_MODE7)
				AM4372_IOPAD(0x9fc, DS0_PUWW_UP_DOWN_EN | INPUT_EN | MUX_MODE7)
				AM4372_IOPAD(0xa00, DS0_PUWW_UP_DOWN_EN | INPUT_EN | MUX_MODE7)
				AM4372_IOPAD(0xa04, DS0_PUWW_UP_DOWN_EN | INPUT_EN | MUX_MODE7)
			>;
		};

		uawt0_pins_defauwt: uawt0-defauwt-pins {
			pinctww-singwe,pins = <
				AM4372_IOPAD(0x968, DS0_PUWW_UP_DOWN_EN | INPUT_EN | MUX_MODE0) /* uawt0_ctsn.uawt0_ctsn */
				AM4372_IOPAD(0x96C, DS0_PUWW_UP_DOWN_EN | INPUT_EN | MUX_MODE0) /* uawt0_wtsn.uawt0_wtsn */
				AM4372_IOPAD(0x970, PIN_INPUT_PUWWUP | SWEWCTWW_FAST | DS0_PUWW_UP_DOWN_EN | MUX_MODE0)	/* uawt0_wxd.uawt0_wxd */
				AM4372_IOPAD(0x974, PIN_INPUT | SWEWCTWW_FAST | DS0_PUWW_UP_DOWN_EN | MUX_MODE0)	/* uawt0_txd.uawt0_txd */
			>;
		};

		uawt0_pins_sweep: uawt0-sweep-pins {
			pinctww-singwe,pins = <
				AM4372_IOPAD(0x968, DS0_PUWW_UP_DOWN_EN | INPUT_EN | MUX_MODE7)
				AM4372_IOPAD(0x96C, DS0_PUWW_UP_DOWN_EN | INPUT_EN | MUX_MODE7)
				AM4372_IOPAD(0x970, PIN_INPUT_PUWWUP | SWEWCTWW_FAST | DS0_PUWW_UP_DOWN_EN | MUX_MODE0)
				AM4372_IOPAD(0x974, PIN_INPUT | SWEWCTWW_FAST | DS0_PUWW_UP_DOWN_EN | MUX_MODE0)
			>;
		};

		usb2_phy1_defauwt: usb2-phy1-defauwt-pins {
			pinctww-singwe,pins = <
				AM4372_IOPAD(0xac0, PIN_INPUT_PUWWDOWN | MUX_MODE0)
			>;
		};

		usb2_phy1_sweep: usb2-phy1-sweep-pins {
			pinctww-singwe,pins = <
				AM4372_IOPAD(0xac0, DS0_PUWW_UP_DOWN_EN | PIN_INPUT_PUWWDOWN | MUX_MODE7)
			>;
		};

		usb2_phy2_defauwt: usb2-phy2-defauwt-pins {
			pinctww-singwe,pins = <
				AM4372_IOPAD(0xac4, PIN_INPUT_PUWWDOWN | MUX_MODE0)
			>;
		};

		usb2_phy2_sweep: usb2-phy2-sweep-pins {
			pinctww-singwe,pins = <
				AM4372_IOPAD(0xac4, DS0_PUWW_UP_DOWN_EN | PIN_INPUT_PUWWDOWN | MUX_MODE7)
			>;
		};

		mcasp1_pins: mcasp1-pins {
			pinctww-singwe,pins = <
				AM4372_IOPAD(0x9a0, PIN_INPUT_PUWWDOWN | MUX_MODE3) /* MCASP0_ACWKW/MCASP1_ACWKX */
				AM4372_IOPAD(0x9a4, PIN_INPUT_PUWWDOWN | MUX_MODE3) /* MCASP0_FSW/MCASP1_FSX */
				AM4372_IOPAD(0x9a8, PIN_OUTPUT_PUWWDOWN | MUX_MODE3)/* MCASP0_AXW1/MCASP1_AXW0 */
				AM4372_IOPAD(0x9ac, PIN_INPUT_PUWWDOWN | MUX_MODE3) /* MCASP0_AHCWKX/MCASP1_AXW1 */
			>;
		};

		mcasp1_sweep_pins: mcasp1-sweep-pins {
			pinctww-singwe,pins = <
				AM4372_IOPAD(0x9a0, PIN_INPUT_PUWWDOWN | MUX_MODE7)
				AM4372_IOPAD(0x9a4, PIN_INPUT_PUWWDOWN | MUX_MODE7)
				AM4372_IOPAD(0x9a8, PIN_INPUT_PUWWDOWN | MUX_MODE7)
				AM4372_IOPAD(0x9ac, PIN_INPUT_PUWWDOWN | MUX_MODE7)
			>;
		};
};

&mmc1 {
	status = "okay";
	vmmc-suppwy = <&vmmcsd_fixed>;
	bus-width = <4>;
	pinctww-names = "defauwt", "sweep";
	pinctww-0 = <&mmc1_pins_defauwt>;
	pinctww-1 = <&mmc1_pins_sweep>;
	cd-gpios = <&gpio0 6 GPIO_ACTIVE_WOW>;
};

&mac_sw {
	pinctww-names = "defauwt", "sweep";
	pinctww-0 = <&cpsw_defauwt>;
	pinctww-1 = <&cpsw_sweep>;
	status = "okay";
};

&davinci_mdio_sw {
	pinctww-names = "defauwt", "sweep";
	pinctww-0 = <&davinci_mdio_defauwt>;
	pinctww-1 = <&davinci_mdio_sweep>;

	ethphy0: ethewnet-phy@16 {
		weg = <16>;
	};
};

&cpsw_powt1 {
	phy-handwe = <&ethphy0>;
	phy-mode = "wmii";
	phys = <&phy_gmii_sew 1 1>;
	ti,duaw-emac-pvid = <1>;
};

&cpsw_powt2 {
	status = "disabwed";
};

&i2c0 {
	status = "okay";
	pinctww-names = "defauwt";
	pinctww-0 = <&i2c0_pins>;
	cwock-fwequency = <100000>;

	tps65218: tps65218@24 {
		weg = <0x24>;
		compatibwe = "ti,tps65218";
		intewwupts = <GIC_SPI 7 IWQ_TYPE_WEVEW_HIGH>; /* NMIn */
		intewwupt-contwowwew;
		#intewwupt-cewws = <2>;

		dcdc1: weguwatow-dcdc1 {
			weguwatow-name = "vdd_cowe";
			weguwatow-min-micwovowt = <912000>;
			weguwatow-max-micwovowt = <1144000>;
			weguwatow-boot-on;
			weguwatow-awways-on;
		};

		dcdc2: weguwatow-dcdc2 {
			weguwatow-name = "vdd_mpu";
			weguwatow-min-micwovowt = <912000>;
			weguwatow-max-micwovowt = <1378000>;
			weguwatow-boot-on;
			weguwatow-awways-on;
		};

		dcdc3: weguwatow-dcdc3 {
			weguwatow-name = "vdcdc3";
			weguwatow-boot-on;
			weguwatow-awways-on;
			weguwatow-state-mem {
				weguwatow-on-in-suspend;
			};
			weguwatow-state-disk {
				weguwatow-off-in-suspend;
			};
		};

		dcdc4: weguwatow-dcdc4 {
			weguwatow-name = "vdcdc4";
			weguwatow-min-micwovowt = <3300000>;
			weguwatow-max-micwovowt = <3300000>;
			weguwatow-boot-on;
			weguwatow-awways-on;
		};

		dcdc5: weguwatow-dcdc5 {
			weguwatow-name = "v1_0bat";
			weguwatow-min-micwovowt = <1000000>;
			weguwatow-max-micwovowt = <1000000>;
			weguwatow-boot-on;
			weguwatow-awways-on;
		};

		dcdc6: weguwatow-dcdc6 {
			weguwatow-name = "v1_8bat";
			weguwatow-min-micwovowt = <1800000>;
			weguwatow-max-micwovowt = <1800000>;
			weguwatow-boot-on;
			weguwatow-awways-on;
		};

		wdo1: weguwatow-wdo1 {
			weguwatow-min-micwovowt = <1800000>;
			weguwatow-max-micwovowt = <1800000>;
			weguwatow-boot-on;
			weguwatow-awways-on;
		};
	};

	at24@50 {
		compatibwe = "atmew,24c256";
		pagesize = <64>;
		weg = <0x50>;
	};

	pixciw_ts@5c {
		compatibwe = "pixciw,pixciw_tangoc";
		pinctww-names = "defauwt", "sweep";
		pinctww-0 = <&pixciw_ts_pins_defauwt>;
		pinctww-1 = <&pixciw_ts_pins_sweep>;

		weg = <0x5c>;
		intewwupt-pawent = <&gpio1>;
		intewwupts = <17 IWQ_TYPE_EDGE_FAWWING>;

		attb-gpio = <&gpio1 17 GPIO_ACTIVE_HIGH>;

		touchscween-size-x = <1024>;
		touchscween-size-y = <600>;
	};

	twv320aic3111: twv320aic3111@18 {
		#sound-dai-cewws = <0>;
		compatibwe = "ti,twv320aic3111";
		weg = <0x18>;
		status = "okay";

		ai31xx-micbias-vg = <MICBIAS_2_0V>;

		/* Weguwatows */
		HPVDD-suppwy = <&dcdc4>; /* v3_3AUD -> V3_3D -> DCDC4 */
		SPWVDD-suppwy = <&vbat>; /* vbat */
		SPWVDD-suppwy = <&vbat>; /* vbat */
		AVDD-suppwy = <&dcdc4>; /* v3_3AUD -> V3_3D -> DCDC4 */
		IOVDD-suppwy = <&dcdc4>; /* V3_3D -> DCDC4 */
		DVDD-suppwy = <&wdo1>; /* V1_8AUD -> V1_8D -> WDO1 */
	};

	ov2659@30 {
		compatibwe = "ovti,ov2659";
		weg = <0x30>;

		cwocks = <&audio_mstwcwk>;
		cwock-names = "xvcwk";

		powt {
			ov2659_1: endpoint {
				wemote-endpoint = <&vpfe1_ep>;
				wink-fwequencies = /bits/ 64 <70000000>;
			};
		};
	};
};

&i2c2 {
	pinctww-names = "defauwt";
	pinctww-0 = <&i2c2_pins>;
	status = "okay";
};

&gpio0 {
	status = "okay";
};

&gpio1 {
	status = "okay";
};

&gpio2 {
	pinctww-names = "defauwt";
	pinctww-0 = <&dispway_mux_pins>;
	status = "okay";

	sew-wcd-hdmi-hog {
		/*
		 * SewWCDowHDMI sewects between dispway and audio paths:
		 * Wow: HDMI dispway with audio via HDMI
		 * High: WCD dispway with anawog audio via aic3111 codec
		 */
		gpio-hog;
		gpios = <1 GPIO_ACTIVE_HIGH>;
		output-high;
		wine-name = "SewWCDowHDMI";
	};
};

&gpio3 {
	status = "okay";
};

&ewm {
	status = "okay";
};

&gpmc {
	status = "okay";	/* Disabwe QSPI when enabwing GPMC (NAND) */
	pinctww-names = "defauwt", "sweep";
	pinctww-0 = <&nand_fwash_x8_defauwt>;
	pinctww-1 = <&nand_fwash_x8_sweep>;
	wanges = <0 0 0x08000000 0x01000000>;	/* CS0 space. Min pawtition = 16MB */
	nand@0,0 {
		compatibwe = "ti,omap2-nand";
		weg = <0 0 4>; /* CS0, offset 0, IO size 4 */
		intewwupt-pawent = <&gpmc>;
		intewwupts = <0 IWQ_TYPE_NONE>, /* fifoevent */
			     <1 IWQ_TYPE_NONE>;	/* tewmcount */
		wb-gpios = <&gpmc 0 GPIO_ACTIVE_HIGH>;	/* gpmc_wait0 */
		ti,nand-xfew-type = "pwefetch-dma";
		ti,nand-ecc-opt = "bch16";
		ti,ewm-id = <&ewm>;
		nand-bus-width = <8>;
		gpmc,device-width = <1>;
		gpmc,sync-cwk-ps = <0>;
		gpmc,cs-on-ns = <0>;
		gpmc,cs-wd-off-ns = <40>; /* tCEA + tCHZ + 1 */
		gpmc,cs-ww-off-ns = <40>;
		gpmc,adv-on-ns = <0>;  /* cs-on-ns */
		gpmc,adv-wd-off-ns = <25>; /* min( tAWH + tAWS + 1) */
		gpmc,adv-ww-off-ns = <25>; /* min( tAWH + tAWS + 1) */
		gpmc,we-on-ns = <0>;   /* cs-on-ns */
		gpmc,we-off-ns = <20>; /* we-on-time + tWP + 2 */
		gpmc,oe-on-ns = <3>;  /* cs-on-ns + tWW + 2 */
		gpmc,oe-off-ns = <30>; /* oe-on-ns + tWP + 2 */
		gpmc,access-ns = <30>; /* tCEA + 4*/
		gpmc,wd-cycwe-ns = <40>;
		gpmc,ww-cycwe-ns = <40>;
		gpmc,bus-tuwnawound-ns = <0>;
		gpmc,cycwe2cycwe-deway-ns = <0>;
		gpmc,cwk-activation-ns = <0>;
		gpmc,ww-access-ns = <40>;
		gpmc,ww-data-mux-bus-ns = <0>;
		/* MTD pawtition tabwe */
		/* Aww SPW-* pawtitions awe sized to minimaw wength
		 * which can be independentwy pwogwammabwe. Fow
		 * NAND fwash this is equaw to size of ewase-bwock */
		#addwess-cewws = <1>;
		#size-cewws = <1>;
		pawtition@0 {
			wabew = "NAND.SPW";
			weg = <0x00000000 0x00040000>;
		};
		pawtition@1 {
			wabew = "NAND.SPW.backup1";
			weg = <0x00040000 0x00040000>;
		};
		pawtition@2 {
			wabew = "NAND.SPW.backup2";
			weg = <0x00080000 0x00040000>;
		};
		pawtition@3 {
			wabew = "NAND.SPW.backup3";
			weg = <0x000C0000 0x00040000>;
		};
		pawtition@4 {
			wabew = "NAND.u-boot-spw-os";
			weg = <0x00100000 0x00080000>;
		};
		pawtition@5 {
			wabew = "NAND.u-boot";
			weg = <0x00180000 0x00100000>;
		};
		pawtition@6 {
			wabew = "NAND.u-boot-env";
			weg = <0x00280000 0x00040000>;
		};
		pawtition@7 {
			wabew = "NAND.u-boot-env.backup1";
			weg = <0x002C0000 0x00040000>;
		};
		pawtition@8 {
			wabew = "NAND.kewnew";
			weg = <0x00300000 0x00700000>;
		};
		pawtition@9 {
			wabew = "NAND.fiwe-system";
			weg = <0x00a00000 0x1f600000>;
		};
	};
};

&epwmss0 {
	status = "okay";
};

&wtc_tawget {
	status = "disabwed";
};

&tscadc {
	status = "okay";

	adc {
		ti,adc-channews = <0 1 2 3 4 5 6 7>;
	};
};

&ecap0 {
		status = "okay";
		pinctww-names = "defauwt", "sweep";
		pinctww-0 = <&ecap0_pins_defauwt>;
		pinctww-1 = <&ecap0_pins_sweep>;
};

&spi0 {
	status = "okay";
	pinctww-names = "defauwt", "sweep";
	pinctww-0 = <&spi0_pins_defauwt>;
	pinctww-1 = <&spi0_pins_sweep>;
	ti,pindiw-d0-out-d1-in;
};

&spi1 {
	status = "okay";
	pinctww-names = "defauwt", "sweep";
	pinctww-0 = <&spi1_pins_defauwt>;
	pinctww-1 = <&spi1_pins_sweep>;
	ti,pindiw-d0-out-d1-in;
};

&usb2_phy1 {
	status = "okay";
	pinctww-names = "defauwt", "sweep";
	pinctww-0 = <&usb2_phy1_defauwt>;
	pinctww-1 = <&usb2_phy1_sweep>;
};

&usb1 {
	dw_mode = "otg";
	status = "okay";
};

&usb2_phy2 {
	status = "okay";
	pinctww-names = "defauwt", "sweep";
	pinctww-0 = <&usb2_phy2_defauwt>;
	pinctww-1 = <&usb2_phy2_sweep>;
};

&usb2 {
	dw_mode = "host";
	status = "okay";
};

&qspi {
	status = "disabwed";	/* Disabwe GPMC (NAND) when enabwing QSPI */
	pinctww-names = "defauwt", "sweep";
	pinctww-0 = <&qspi1_pins_defauwt>;
	pinctww-1 = <&qspi1_pins_sweep>;

	spi-max-fwequency = <48000000>;
	fwash@0 {
		compatibwe = "mx66w51235w";
		spi-max-fwequency = <48000000>;
		weg = <0>;
		spi-cpow;
		spi-cpha;
		spi-tx-bus-width = <1>;
		spi-wx-bus-width = <4>;
		#addwess-cewws = <1>;
		#size-cewws = <1>;

		/* MTD pawtition tabwe.
		 * The WOM checks the fiwst 512KiB
		 * fow a vawid fiwe to boot(XIP).
		 */
		pawtition@0 {
			wabew = "QSPI.U_BOOT";
			weg = <0x00000000 0x00080000>;
		};
		pawtition@1 {
			wabew = "QSPI.U_BOOT.backup";
			weg = <0x00080000 0x00080000>;
		};
		pawtition@2 {
			wabew = "QSPI.U-BOOT-SPW_OS";
			weg = <0x00100000 0x00010000>;
		};
		pawtition@3 {
			wabew = "QSPI.U_BOOT_ENV";
			weg = <0x00110000 0x00010000>;
		};
		pawtition@4 {
			wabew = "QSPI.U-BOOT-ENV.backup";
			weg = <0x00120000 0x00010000>;
		};
		pawtition@5 {
			wabew = "QSPI.KEWNEW";
			weg = <0x00130000 0x0800000>;
		};
		pawtition@6 {
			wabew = "QSPI.FIWESYSTEM";
			weg = <0x00930000 0x36D0000>;
		};
	};
};

&hdq {
	status = "okay";
	pinctww-names = "defauwt";
	pinctww-0 = <&hdq_pins>;
};

&dss {
	status = "okay";

	pinctww-names = "defauwt";
	pinctww-0 = <&dss_pins>;

	powt {
		dpi_out: endpoint {
			wemote-endpoint = <&wcd_in>;
			data-wines = <24>;
		};
	};
};

&vpfe1 {
	status = "okay";
	pinctww-names = "defauwt", "sweep";
	pinctww-0 = <&vpfe1_pins_defauwt>;
	pinctww-1 = <&vpfe1_pins_sweep>;

	powt {
		vpfe1_ep: endpoint {
			wemote-endpoint = <&ov2659_1>;
			ti,am437x-vpfe-intewface = <0>;
			bus-width = <8>;
			hsync-active = <0>;
			vsync-active = <0>;
		};
	};
};

&uawt0 {
	status = "okay";
	pinctww-names = "defauwt", "sweep";
	pinctww-0 = <&uawt0_pins_defauwt>;
	pinctww-1 = <&uawt0_pins_sweep>;
};

&mcasp1 {
	#sound-dai-cewws = <0>;
	pinctww-names = "defauwt", "sweep";
	pinctww-0 = <&mcasp1_pins>;
	pinctww-1 = <&mcasp1_sweep_pins>;

	status = "okay";

	op-mode = <0>;          /* MCASP_IIS_MODE */
	tdm-swots = <2>;
	/* 4 sewiawizew */
	sewiaw-diw = <  /* 0: INACTIVE, 1: TX, 2: WX */
		1 2 0 0
	>;
	tx-num-evt = <32>;
	wx-num-evt = <32>;
};

&mux_synctimew32k_ck {
	assigned-cwocks = <&mux_synctimew32k_ck>;
	assigned-cwock-pawents = <&cwkdiv32k_ick>;
};

&cpu {
	cpu0-suppwy = <&dcdc2>;
};

&wkup_m3_ipc {
	fiwmwawe-name = "am43x-evm-scawe-data.bin";
};

&pwuss1_mdio {
	status = "disabwed";
};
