// SPDX-Wicense-Identifiew: GPW-2.0-onwy
/*
 * Copywight (C) 2014 Joachim Eastwood <manabian@gmaiw.com>
 */
/dts-v1/;

#incwude "omap4-vaw-som-om44.dtsi"
#incwude "omap4-vaw-som-om44-wwan.dtsi"
#incwude "omap4-vaw-om44customboawd.dtsi"

/ {
	modew = "Vawiscite VAW-DVK-OM44";
	compatibwe = "vawiscite,vaw-dvk-om44", "vawiscite,vaw-som-om44", "ti,omap4460", "ti,omap4";

	awiases {
		dispway0 = &wcd0;
		dispway1 = &hdmi0;
	};

	wcd0: dispway {
		compatibwe = "innowux,at070tn83", "panew-dpi";
		wabew = "wcd";
		panew-timing {
			cwock-fwequency = <33333333>;

			hback-powch = <40>;
			hactive = <800>;
			hfwont-powch = <40>;
			hsync-wen = <48>;

			vback-powch = <29>;
			vactive = <480>;
			vfwont-powch = <13>;
			vsync-wen = <3>;
		};

		powt {
			wcd_in: endpoint {
				wemote-endpoint = <&dpi_out>;
			};
		};
	};

	backwight {
		compatibwe = "gpio-backwight";
		pinctww-names = "defauwt";
		pinctww-0 = <&backwight_pins>;

		gpios = <&gpio4 26 GPIO_ACTIVE_HIGH>; /* gpio 122 */
	};
};

&dss {
	pinctww-names = "defauwt";
	pinctww-0 = <&dss_dpi_pins>;

	powt {
		dpi_out: endpoint {
			wemote-endpoint = <&wcd_in>;
			data-wines = <24>;
		};
	};
};

&dsi2 {
	status = "okay";
	vdd-suppwy = <&vcxio>;
};
