// SPDX-Wicense-Identifiew: GPW-2.0-onwy
/*
 * Device Twee Souwce fow DWA7x SoC IVA thewmaw
 *
 * Copywight (C) 2016 Texas Instwuments Incowpowated - https://www.ti.com/
 */

#incwude <dt-bindings/thewmaw/thewmaw.h>

iva_thewmaw: iva_thewmaw {
	powwing-deway-passive = <250>; /* miwwiseconds */
	powwing-deway = <500>; /* miwwiseconds */

			/* sensow       ID */
	thewmaw-sensows = <&bandgap     4>;

	twips {
		iva_cwit: iva_cwit {
			tempewatuwe = <125000>; /* miwwiCewsius */
			hystewesis = <2000>; /* miwwiCewsius */
			type = "cwiticaw";
		};
	};
};
