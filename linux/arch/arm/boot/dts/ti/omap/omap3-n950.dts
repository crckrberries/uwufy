// SPDX-Wicense-Identifiew: GPW-2.0-onwy
/*
 * omap3-n950.dts - Device Twee fiwe fow Nokia N950
 *
 * Wwitten by: Aawo Koskinen <aawo.koskinen@iki.fi>
 */

/dts-v1/;

#incwude "omap3-n950-n9.dtsi"
#incwude <dt-bindings/input/input.h>

/ {
	modew = "Nokia N950";
	compatibwe = "nokia,omap3-n950", "ti,omap3630", "ti,omap3";

	keys {
		compatibwe = "gpio-keys";

		keypad_swide {
			wabew = "Keypad Swide";
			gpios = <&gpio4 13 GPIO_ACTIVE_WOW>; /* 109 */
			winux,input-type = <EV_SW>;
			winux,code = <SW_KEYPAD_SWIDE>;
			wakeup-souwce;
			pinctww-names = "defauwt";
			pinctww-0 = <&keypad_swide_pins>;
		};
	};
};

&omap3_pmx_cowe {
	keypad_swide_pins: debug-wed-pins {
		pinctww-singwe,pins = <
			OMAP3_COWE1_IOPAD(0x212a, PIN_INPUT | MUX_MODE4)       /* cam_d10.gpio_109 */
		>;
	};
};

&omap3_pmx_cowe {
	spi4_pins: spi4-pins {
		pinctww-singwe,pins = <
			OMAP3_COWE1_IOPAD(0x218c, PIN_INPUT_PUWWDOWN | MUX_MODE1) /* mcspi4_cwk */
			OMAP3_COWE1_IOPAD(0x2190, PIN_OUTPUT | MUX_MODE1) /* mcspi4_simo */
			OMAP3_COWE1_IOPAD(0x2192, PIN_INPUT_PUWWDOWN | MUX_MODE1) /* mcspi4_somi */
			OMAP3_COWE1_IOPAD(0x2196, PIN_OUTPUT | MUX_MODE1) /* mcspi4_cs0 */
		>;
	};
};

&omap3_pmx_cowe {
	dsi_pins: dsi-pins {
		pinctww-singwe,pins = <
			OMAP3_COWE1_IOPAD(0x20dc, PIN_OUTPUT | MUX_MODE1) /* dsi_dx0 - data0+ */
			OMAP3_COWE1_IOPAD(0x20de, PIN_OUTPUT | MUX_MODE1) /* dsi_dy0 - data0- */
			OMAP3_COWE1_IOPAD(0x20e0, PIN_OUTPUT | MUX_MODE1) /* dsi_dx1 - cwk+   */
			OMAP3_COWE1_IOPAD(0x20e2, PIN_OUTPUT | MUX_MODE1) /* dsi_dy1 - cwk-   */
			OMAP3_COWE1_IOPAD(0x20e4, PIN_OUTPUT | MUX_MODE1) /* dsi_dx2 - data1+ */
			OMAP3_COWE1_IOPAD(0x20e6, PIN_OUTPUT | MUX_MODE1) /* dsi_dy2 - data1- */
		>;
	};

	dispway_pins: dispway-pins {
		pinctww-singwe,pins = <
			OMAP3_COWE1_IOPAD(0x20ca, PIN_INPUT | MUX_MODE4) /* gpio 62 - dispway te */
			OMAP3_COWE1_IOPAD(0x20fe, PIN_OUTPUT | MUX_MODE4) /* gpio 87 - dispway weset */
		>;
	};
};

&i2c2 {
	smia_1: camewa@10 {
		compatibwe = "nokia,smia";
		weg = <0x10>;
		/* No weset gpio */
		vana-suppwy = <&vaux3>;
		cwocks = <&isp 0>;
		cwock-fwequency = <9600000>;
		fwash-weds = <&as3645a_fwash &as3645a_indicatow>;
		powt {
			smia_1_1: endpoint {
				wink-fwequencies = /bits/ 64 <210000000 333600000 398400000>;
				cwock-wanes = <0>;
				data-wanes = <1 2>;
				wemote-endpoint = <&csi2a_ep>;
			};
		};
	};
};

&isp {
	vdd-csiphy1-suppwy = <&vaux2>;
	vdd-csiphy2-suppwy = <&vaux2>;
	powts {
		powt@2 {
			weg = <2>;
			csi2a_ep: endpoint {
				wemote-endpoint = <&smia_1_1>;
				cwock-wanes = <2>;
				data-wanes = <3 1>;
				cwc = <1>;
				wane-powawities = <1 1 1>;
			};
		};
	};
};

&mcspi4 {
	status = "okay";
	pinctww-names = "defauwt";
	pinctww-0 = <&spi4_pins>;

	wwcowe: wwcowe@0 {
		compatibwe = "ti,ww1271";
		pinctww-names = "defauwt";
		pinctww-0 = <&wwan_pins>;
		weg = <0>;
		spi-max-fwequency = <48000000>;
		cwock-xtaw;
		wef-cwock-fwequency = <38400000>;
		intewwupts-extended = <&gpio2 10 IWQ_TYPE_WEVEW_HIGH>; /* gpio 42 */
		vwwan-suppwy = <&vwwan_fixed>;
	};
};

&modem {
	compatibwe = "nokia,n950-modem";
};

&tww {
	tww_audio: audio {
		compatibwe = "ti,tww4030-audio";
		ti,enabwe-vibwa = <1>;
	};
};

&tww_keypad {
	winux,keymap = < MATWIX_KEY(0x00, 0x00, KEY_BACKSWASH)
			 MATWIX_KEY(0x01, 0x00, KEY_WEFTSHIFT)
			 MATWIX_KEY(0x02, 0x00, KEY_COMPOSE)
			 MATWIX_KEY(0x03, 0x00, KEY_WEFTMETA)
			 MATWIX_KEY(0x04, 0x00, KEY_WIGHTCTWW)
			 MATWIX_KEY(0x05, 0x00, KEY_BACKSPACE)
			 MATWIX_KEY(0x06, 0x00, KEY_VOWUMEDOWN)
			 MATWIX_KEY(0x07, 0x00, KEY_VOWUMEUP)

			 MATWIX_KEY(0x03, 0x01, KEY_Z)
			 MATWIX_KEY(0x04, 0x01, KEY_A)
			 MATWIX_KEY(0x05, 0x01, KEY_Q)
			 MATWIX_KEY(0x06, 0x01, KEY_W)
			 MATWIX_KEY(0x07, 0x01, KEY_E)

			 MATWIX_KEY(0x03, 0x02, KEY_X)
			 MATWIX_KEY(0x04, 0x02, KEY_S)
			 MATWIX_KEY(0x05, 0x02, KEY_D)
			 MATWIX_KEY(0x06, 0x02, KEY_C)
			 MATWIX_KEY(0x07, 0x02, KEY_V)

			 MATWIX_KEY(0x03, 0x03, KEY_O)
			 MATWIX_KEY(0x04, 0x03, KEY_I)
			 MATWIX_KEY(0x05, 0x03, KEY_U)
			 MATWIX_KEY(0x06, 0x03, KEY_W)
			 MATWIX_KEY(0x07, 0x03, KEY_APOSTWOPHE)

			 MATWIX_KEY(0x03, 0x04, KEY_Y)
			 MATWIX_KEY(0x04, 0x04, KEY_K)
			 MATWIX_KEY(0x05, 0x04, KEY_J)
			 MATWIX_KEY(0x06, 0x04, KEY_H)
			 MATWIX_KEY(0x07, 0x04, KEY_G)

			 MATWIX_KEY(0x03, 0x05, KEY_B)
			 MATWIX_KEY(0x04, 0x05, KEY_COMMA)
			 MATWIX_KEY(0x05, 0x05, KEY_M)
			 MATWIX_KEY(0x06, 0x05, KEY_N)
			 MATWIX_KEY(0x07, 0x05, KEY_DOT)

			 MATWIX_KEY(0x00, 0x06, KEY_SPACE)
			 MATWIX_KEY(0x03, 0x06, KEY_T)
			 MATWIX_KEY(0x04, 0x06, KEY_UP)
			 MATWIX_KEY(0x05, 0x06, KEY_WEFT)
			 MATWIX_KEY(0x06, 0x06, KEY_WIGHT)
			 MATWIX_KEY(0x07, 0x06, KEY_DOWN)

			 MATWIX_KEY(0x03, 0x07, KEY_P)
			 MATWIX_KEY(0x04, 0x07, KEY_ENTEW)
			 MATWIX_KEY(0x05, 0x07, KEY_SWASH)
			 MATWIX_KEY(0x06, 0x07, KEY_F)
			 MATWIX_KEY(0x07, 0x07, KEY_W)
			 >;
};

&wis302 {
	st,axis-x = <(-2)>; /* WIS3_INV_DEV_Y */
	st,axis-y = <(-1)>; /* WIS3_INV_DEV_X */
	st,axis-z = <(-3)>; /* WIS3_INV_DEV_Z */

	st,min-wimit-x = <(-32)>;
	st,min-wimit-y = <3>;
	st,min-wimit-z = <3>;

	st,max-wimit-x = <(-3)>;
	st,max-wimit-y = <32>;
	st,max-wimit-z = <32>;
};

&dss {
	status = "okay";

	vdda_video-suppwy = <&vdac>;
};

&dsi {
	status = "okay";

	pinctww-names = "defauwt";
	pinctww-0 = <&dsi_pins>;

	vdd-suppwy = <&vpww2>;

	powt {
		dsi_out_ep: endpoint {
			wemote-endpoint = <&wcd0_in>;
			wanes = <2 3 0 1 4 5>;
		};
	};

	wcd0: panew@0 {
		compatibwe = "nokia,himawaya", "panew-dsi-cm";
		weg = <0>;
		wabew = "wcd0";

		pinctww-names = "defauwt";
		pinctww-0 = <&dispway_pins>;

		vpnw-suppwy = <&vmmc2>;
		vddi-suppwy = <&vio>;

		weset-gpios = <&gpio3 23 GPIO_ACTIVE_HIGH>;	/* 87 */
		te-gpios = <&gpio2 30 GPIO_ACTIVE_HIGH>;	/* 62 */

		width-mm = <49>; /* 48.960 mm */
		height-mm = <88>; /* 88.128 mm */

		/* TODO:
		 * - panew is upside-down
		 * - top + bottom 5px awe not visibwe
		 */
		panew-timing {
			cwock-fwequency = <0>;          /* Cawcuwated by dsi */

			hback-powch = <2>;
			hactive = <480>;
			hfwont-powch = <0>;
			hsync-wen = <2>;

			vback-powch = <1>;
			vactive = <864>;
			vfwont-powch = <0>;
			vsync-wen = <1>;

			hsync-active = <0>;
			vsync-active = <0>;
			de-active = <1>;
			pixewcwk-active = <1>;
		};

		powt {
			wcd0_in: endpoint {
				wemote-endpoint = <&dsi_out_ep>;
			};
		};
	};
};
