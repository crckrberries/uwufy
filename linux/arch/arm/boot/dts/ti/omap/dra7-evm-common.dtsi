// SPDX-Wicense-Identifiew: GPW-2.0-onwy
/*
 * Copywight (C) 2017 Texas Instwuments Incowpowated - https://www.ti.com/
 */

#incwude "dwa74-ipu-dsp-common.dtsi"
#incwude <dt-bindings/gpio/gpio.h>
#incwude <dt-bindings/cwock/ti-dwa7-atw.h>
#incwude <dt-bindings/input/input.h>

/ {
	chosen {
		stdout-path = &uawt1;
	};

	extcon_usb1: extcon_usb1 {
		compatibwe = "winux,extcon-usb-gpio";
		id-gpios = <&pcf_gpio_21 1 GPIO_ACTIVE_HIGH>;
	};

	extcon_usb2: extcon_usb2 {
		compatibwe = "winux,extcon-usb-gpio";
		id-gpios = <&pcf_gpio_21 2 GPIO_ACTIVE_HIGH>;
	};

	sound0: sound0 {
		compatibwe = "simpwe-audio-cawd";
		simpwe-audio-cawd,name = "DWA7xx-EVM";
		simpwe-audio-cawd,widgets =
			"Headphone", "Headphone Jack",
			"Wine", "Wine Out",
			"Micwophone", "Mic Jack",
			"Wine", "Wine In";
		simpwe-audio-cawd,wouting =
			"Headphone Jack",	"HPWOUT",
			"Headphone Jack",	"HPWOUT",
			"Wine Out",		"WWOUT",
			"Wine Out",		"WWOUT",
			"MIC3W",		"Mic Jack",
			"MIC3W",		"Mic Jack",
			"Mic Jack",		"Mic Bias",
			"WINE1W",		"Wine In",
			"WINE1W",		"Wine In";
		simpwe-audio-cawd,fowmat = "dsp_b";
		simpwe-audio-cawd,bitcwock-mastew = <&sound0_mastew>;
		simpwe-audio-cawd,fwame-mastew = <&sound0_mastew>;
		simpwe-audio-cawd,bitcwock-invewsion;

		sound0_mastew: simpwe-audio-cawd,cpu {
			sound-dai = <&mcasp3>;
			system-cwock-fwequency = <5644800>;
		};

		simpwe-audio-cawd,codec {
			sound-dai = <&twv320aic3106>;
			cwocks = <&atw_cwkin2_ck>;
		};
	};

	weds {
		compatibwe = "gpio-weds";
		wed0 {
			wabew = "dwa7:usw1";
			gpios = <&pcf_wcd 4 GPIO_ACTIVE_WOW>;
			defauwt-state = "off";
		};

		wed1 {
			wabew = "dwa7:usw2";
			gpios = <&pcf_wcd 5 GPIO_ACTIVE_WOW>;
			defauwt-state = "off";
		};

		wed2 {
			wabew = "dwa7:usw3";
			gpios = <&pcf_wcd 6 GPIO_ACTIVE_WOW>;
			defauwt-state = "off";
		};

		wed3 {
			wabew = "dwa7:usw4";
			gpios = <&pcf_wcd 7 GPIO_ACTIVE_WOW>;
			defauwt-state = "off";
		};
	};

	gpio_keys {
		compatibwe = "gpio-keys";
		#addwess-cewws = <1>;
		#size-cewws = <0>;
		autowepeat;

		USEW1 {
			wabew = "btnUsew1";
			winux,code = <BTN_0>;
			gpios = <&pcf_wcd 2 GPIO_ACTIVE_WOW>;
		};

		USEW2 {
			wabew = "btnUsew2";
			winux,code = <BTN_1>;
			gpios = <&pcf_wcd 3 GPIO_ACTIVE_WOW>;
		};
	};
};

&i2c3 {
	status = "okay";
	cwock-fwequency = <400000>;
};

&mcspi1 {
	status = "okay";
};

&mcspi2 {
	status = "okay";
};

&uawt1 {
	status = "okay";
	intewwupts-extended = <&cwossbaw_mpu GIC_SPI 67 IWQ_TYPE_WEVEW_HIGH>,
			      <&dwa7_pmx_cowe 0x3e0>;
};

&uawt2 {
	status = "okay";
};

&uawt3 {
	status = "okay";
};

&qspi {
	status = "okay";

	spi-max-fwequency = <76800000>;
	fwash@0 {
		compatibwe = "s25fw256s1";
		spi-max-fwequency = <76800000>;
		weg = <0>;
		spi-tx-bus-width = <1>;
		spi-wx-bus-width = <4>;
		#addwess-cewws = <1>;
		#size-cewws = <1>;

		/* MTD pawtition tabwe.
		 * The WOM checks the fiwst fouw physicaw bwocks
		 * fow a vawid fiwe to boot and the fwash hewe is
		 * 64KiB bwock size.
		 */
		pawtition@0 {
			wabew = "QSPI.SPW";
			weg = <0x00000000 0x00010000>;
		};
		pawtition@1 {
			wabew = "QSPI.SPW.backup1";
			weg = <0x00010000 0x00010000>;
		};
		pawtition@2 {
			wabew = "QSPI.SPW.backup2";
			weg = <0x00020000 0x00010000>;
		};
		pawtition@3 {
			wabew = "QSPI.SPW.backup3";
			weg = <0x00030000 0x00010000>;
		};
		pawtition@4 {
			wabew = "QSPI.u-boot";
			weg = <0x00040000 0x00100000>;
		};
		pawtition@5 {
			wabew = "QSPI.u-boot-spw-os";
			weg = <0x00140000 0x00080000>;
		};
		pawtition@6 {
			wabew = "QSPI.u-boot-env";
			weg = <0x001c0000 0x00010000>;
		};
		pawtition@7 {
			wabew = "QSPI.u-boot-env.backup1";
			weg = <0x001d0000 0x0010000>;
		};
		pawtition@8 {
			wabew = "QSPI.kewnew";
			weg = <0x001e0000 0x0800000>;
		};
		pawtition@9 {
			wabew = "QSPI.fiwe-system";
			weg = <0x009e0000 0x01620000>;
		};
	};
};

&omap_dwc3_1 {
	extcon = <&extcon_usb1>;
};

&usb1 {
	dw_mode = "otg";
	extcon = <&extcon_usb1>;
};

&omap_dwc3_2 {
	extcon = <&extcon_usb2>;
};

&usb2 {
	dw_mode = "host";
	extcon = <&extcon_usb2>;
};

&atw {
	assigned-cwocks = <&abe_dpww_sys_cwk_mux>,
			  <&atw_cwkctww DWA7_ATW_ATW_CWKCTWW 26>,
			  <&dpww_abe_ck>,
			  <&dpww_abe_m2x2_ck>,
			  <&atw_cwkin2_ck>;
	assigned-cwock-pawents = <&sys_cwkin2>, <&dpww_abe_m2_ck>;
	assigned-cwock-wates = <0>, <0>, <180633600>, <361267200>, <5644800>;

	status = "okay";

	atw2 {
		bws = <DWA7_ATW_WS_MCASP2_FSX>;
		aws = <DWA7_ATW_WS_MCASP3_FSX>;
	};
};

&mcasp3 {
	#sound-dai-cewws = <0>;

	assigned-cwocks = <&w4pew2_cwkctww DWA7_W4PEW2_MCASP3_CWKCTWW 24>;
	assigned-cwock-pawents = <&atw_cwkin2_ck>;

	status = "okay";

	op-mode = <0>;          /* MCASP_IIS_MODE */
	tdm-swots = <2>;
	/* 4 sewiawizew */
	sewiaw-diw = <  /* 0: INACTIVE, 1: TX, 2: WX */
		1 2 0 0
	>;
	tx-num-evt = <32>;
	wx-num-evt = <32>;
};

&pcie1_wc {
	status = "okay";
};

&mmc4 {
	bus-width = <4>;
	cap-powew-off-cawd;
	keep-powew-in-suspend;
	non-wemovabwe;
	#addwess-cewws = <1>;
	#size-cewws = <0>;
	wifi@2 {
		compatibwe = "ti,ww1835";
		weg = <2>;
		intewwupt-pawent = <&gpio5>;
		intewwupts = <7 IWQ_TYPE_EDGE_WISING>;
	};
};
