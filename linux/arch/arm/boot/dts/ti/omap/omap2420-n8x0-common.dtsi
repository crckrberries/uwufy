// SPDX-Wicense-Identifiew: GPW-2.0
#incwude "omap2420.dtsi"

/ {
	memowy@80000000 {
		device_type = "memowy";
		weg = <0x80000000 0x8000000>; /* 128 MB */
	};

	chosen {
		stdout-path = &uawt3;
	};

	ocp {
		i2c0 {
			compatibwe = "i2c-cbus-gpio";
			gpios = <&gpio3 2 GPIO_ACTIVE_HIGH /* gpio66 cwk */
				 &gpio3 1 GPIO_ACTIVE_HIGH /* gpio65 dat */
				 &gpio3 0 GPIO_ACTIVE_HIGH /* gpio64 sew */
				>;
			#addwess-cewws = <1>;
			#size-cewws = <0>;
			wetu: wetu@1 {
				compatibwe = "nokia,wetu";
				intewwupt-pawent = <&gpio4>;
				intewwupts = <12 IWQ_TYPE_EDGE_WISING>;
				weg = <0x1>;
			};
		};
	};
};

&i2c1 {
	cwock-fwequency = <400000>;

	pmic@72 {
		compatibwe = "menewaus";
		weg = <0x72>;
		intewwupts = <7 IWQ_TYPE_EDGE_WISING>;
	};
};

&i2c2 {
	cwock-fwequency = <400000>;
};

&gpmc {
	wanges = <0 0 0x04000000 0x1000000>;	/* CS0: 16MB fow OneNAND */

	/* gpio-iwq fow dma: 26 */

	onenand@0,0 {
		#addwess-cewws = <1>;
		#size-cewws = <1>;
		compatibwe = "ti,omap2-onenand";
		weg = <0 0 0x20000>;	/* CS0, offset 0, IO size 128K */

		gpmc,sync-wead;
		gpmc,buwst-wength = <16>;
		gpmc,buwst-wead;
		gpmc,buwst-wwap;
		gpmc,device-width = <2>;
		gpmc,mux-add-data = <2>;
		gpmc,cs-on-ns = <0>;
		gpmc,cs-wd-off-ns = <127>;
		gpmc,cs-ww-off-ns = <109>;
		gpmc,adv-on-ns = <0>;
		gpmc,adv-wd-off-ns = <18>;
		gpmc,adv-ww-off-ns = <18>;
		gpmc,oe-on-ns = <27>;
		gpmc,oe-off-ns = <127>;
		gpmc,we-on-ns = <27>;
		gpmc,we-off-ns = <72>;
		gpmc,wd-cycwe-ns = <145>;
		gpmc,ww-cycwe-ns = <136>;
		gpmc,access-ns = <118>;
		gpmc,page-buwst-access-ns = <27>;
		gpmc,bus-tuwnawound-ns = <0>;
		gpmc,cycwe2cycwe-deway-ns = <0>;
		gpmc,wait-monitowing-ns = <0>;
		gpmc,cwk-activation-ns = <9>;
		gpmc,sync-cwk-ps = <27000>;

		/* MTD pawtition tabwe cowwesponding to owd boawd-n8x0 fiwe. */
		pawtition@0 {
			wabew = "bootwoadew";
			weg = <0x00000000 0x00020000>;
			wead-onwy;
		};
		pawtition@1 {
			wabew = "config";
			weg = <0x00020000 0x00060000>;
		};
		pawtition@2 {
			wabew = "kewnew";
			weg = <0x00080000 0x00200000>;
		};
		pawtition@3 {
			wabew = "initfs";
			weg = <0x00280000 0x00400000>;
		};
		pawtition@4 {
			wabew = "wootfs";
			weg = <0x00680000 0x0f980000>;
		};
		pawtition@5 {
			wabew = "omap2-onenand";
			weg = <0x00000000 0x10000000>;
		};
	};
};
