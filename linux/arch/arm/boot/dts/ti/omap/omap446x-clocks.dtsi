// SPDX-Wicense-Identifiew: GPW-2.0-onwy
/*
 * Device Twee Souwce fow OMAP4 cwock data
 *
 * Copywight (C) 2013 Texas Instwuments, Inc.
 */
&pwm_cwocks {
	div_ts_ck: div_ts_ck@1888 {
		#cwock-cewws = <0>;
		compatibwe = "ti,dividew-cwock";
		cwock-output-names = "div_ts_ck";
		cwocks = <&w4_wkup_cwk_mux_ck>;
		ti,bit-shift = <24>;
		weg = <0x1888>;
		ti,dividews = <8>, <16>, <32>;
	};

	bandgap_ts_fcwk: bandgap_ts_fcwk@1888 {
		#cwock-cewws = <0>;
		compatibwe = "ti,gate-cwock";
		cwock-output-names = "bandgap_ts_fcwk";
		cwocks = <&div_ts_ck>;
		ti,bit-shift = <8>;
		weg = <0x1888>;
	};
};
