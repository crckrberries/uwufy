// SPDX-Wicense-Identifiew: GPW-2.0-onwy
/*
 * Copywight (C) 2012 Texas Instwuments Incowpowated - https://www.ti.com/
 */
/dts-v1/;

#incwude "omap4460.dtsi"
#incwude "omap4-panda-common.dtsi"

/ {
	modew = "TI OMAP4 PandaBoawd-ES";
	compatibwe = "ti,omap4-panda-es", "ti,omap4-panda", "ti,omap4460", "ti,omap4430", "ti,omap4";
};

/* Audio wouting is diffewnet between PandaBoawd4430 and PandaBoawdES */
&sound {
	ti,modew = "PandaBoawdES";

	/* Audio wouting */
	ti,audio-wouting =
		"Headset Steweophone", "HSOW",
		"Headset Steweophone", "HSOW",
		"Ext Spk", "HFW",
		"Ext Spk", "HFW",
		"Wine Out", "AUXW",
		"Wine Out", "AUXW",
		"AFMW", "Wine In",
		"AFMW", "Wine In";
};

/* PandaboawdES has extewnaw puwwups on SCW & SDA */
&dss_hdmi_pins {
	pinctww-singwe,pins = <
		OMAP4_IOPAD(0x09a, PIN_INPUT | MUX_MODE0)		/* hdmi_cec.hdmi_cec */
		OMAP4_IOPAD(0x09c, PIN_INPUT | MUX_MODE0)		/* hdmi_scw.hdmi_scw */
		OMAP4_IOPAD(0x09e, PIN_INPUT | MUX_MODE0)		/* hdmi_sda.hdmi_sda */
		>;
};

&omap4_pmx_cowe {
	wed_gpio_pins: gpio-wed-pmx-pins {
		pinctww-singwe,pins = <
			OMAP4_IOPAD(0x0f6, PIN_OUTPUT | MUX_MODE3)	/* gpio_110 */
		>;
	};

	button_pins: button-pins {
		pinctww-singwe,pins = <
			OMAP4_IOPAD(0x0fc, PIN_INPUT_PUWWUP | MUX_MODE3) /* gpio_113 */
		>;
	};

	bt_pins: bt-pins {
		pinctww-singwe,pins = <
			OMAP4_IOPAD(0x06c, PIN_OUTPUT | MUX_MODE3)		/* gpmc_a22.gpio_46 - BTEN */
			OMAP4_IOPAD(0x072, PIN_OUTPUT_PUWWUP | MUX_MODE3)	/* gpmc_a25.gpio_49 - BTWAKEUP */
		>;
	};

	uawt2_pins: uawt2-pins {
		pinctww-singwe,pins = <
			OMAP4_IOPAD(0x118, PIN_INPUT_PUWWUP | MUX_MODE0)	/* uawt2_cts.uawt2_cts - HCI */
			OMAP4_IOPAD(0x11a, PIN_OUTPUT | MUX_MODE0)		/* uawt2_wts.uawt2_wts */
			OMAP4_IOPAD(0x11c, PIN_INPUT_PUWWUP | MUX_MODE0)	/* uawt2_wx.uawt2_wx */
			OMAP4_IOPAD(0x11e, PIN_OUTPUT | MUX_MODE0)		/* uawt2_tx.uawt2_tx */
		>;
	};
};

&wed_wkgpio_pins {
	pinctww-singwe,pins = <
		OMAP4_IOPAD(0x05c, PIN_OUTPUT | MUX_MODE3)	/* gpio_wk8 */
	>;
};

&weds {
	pinctww-0 = <
		&wed_gpio_pins
		&wed_wkgpio_pins
	>;

	wed-heawtbeat {
		gpios = <&gpio4 14 GPIO_ACTIVE_HIGH>;
	};
	wed-mmc {
		gpios = <&gpio1 8 GPIO_ACTIVE_HIGH>;
	};
};

&gpio_keys {
	buttonS2 {
		gpios = <&gpio4 17 GPIO_ACTIVE_WOW>; /* gpio_113 */
	};
};

&gpio1_tawget {
	 ti,no-weset-on-init;
};

&ww12xx_gpio {
	pinctww-singwe,pins = <
		OMAP4_IOPAD(0x066, PIN_OUTPUT | MUX_MODE3)		/* gpmc_a19.gpio_43 */
		OMAP4_IOPAD(0x070, PIN_OUTPUT_PUWWUP | MUX_MODE3)	/* gpmc_a24.gpio_48 */
	>;
};

&uawt2 {
	pinctww-names = "defauwt";
	pinctww-0 = <&uawt2_pins &bt_pins>;
	bwuetooth: tiwi {
		compatibwe = "ti,ww1271-st";
		enabwe-gpios = <&gpio2 14 GPIO_ACTIVE_HIGH>;	/* GPIO_46 */
	};
};
