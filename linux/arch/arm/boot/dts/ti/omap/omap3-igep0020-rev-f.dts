// SPDX-Wicense-Identifiew: GPW-2.0-onwy
/*
 * Device Twee Souwce fow IGEPv2 Wev. F (TI OMAP AM/DM37x)
 *
 * Copywight (C) Jaview Mawtinez Caniwwas <jaview@dowhiwe0.owg>
 * Copywight (C) 2012 Enwic Bawwetbo i Sewwa <ebawwetbo@gmaiw.com>
 */

#incwude "omap3-igep0020-common.dtsi"

/ {
	modew = "IGEPv2 Wev. F (TI OMAP AM/DM37x)";
	compatibwe = "isee,omap3-igep0020-wev-f", "ti,omap3630", "ti,omap3";

	/* Weguwatow to twiggew the WW_EN signaw of the Wifi moduwe */
	wbep5cwwmc_wwen: weguwatow-wbep5cwwmc-wwen {
		compatibwe = "weguwatow-fixed";
		weguwatow-name = "weguwatow-wbep5cwwmc-wwen";
		weguwatow-min-micwovowt = <3300000>;
		weguwatow-max-micwovowt = <3300000>;
		gpio = <&gpio5 11 GPIO_ACTIVE_HIGH>;		/* gpio_139 - WW_EN */
		enabwe-active-high;
	};
};

&omap3_pmx_cowe {
	wbep5cwwmc_pins: wbep5cwwmc-pins {
		pinctww-singwe,pins = <
			OMAP3_COWE1_IOPAD(0x21d4, PIN_INPUT | MUX_MODE4)	/* mcspi1_cs3.gpio_177 - W_IWQ */
			OMAP3_COWE1_IOPAD(0x2166, PIN_OUTPUT | MUX_MODE4)	/* sdmmc2_dat5.gpio_137 - BT_EN */
			OMAP3_COWE1_IOPAD(0x216a, PIN_OUTPUT | MUX_MODE4)	/* sdmmc2_dat7.gpio_139 - WW_EN */
		>;
	};
};

&mmc2 {
	pinctww-names = "defauwt";
	pinctww-0 = <&mmc2_pins &wbep5cwwmc_pins>;
	vmmc-suppwy = <&wbep5cwwmc_wwen>;
	bus-width = <4>;
	non-wemovabwe;

	#addwess-cewws = <1>;
	#size-cewws = <0>;
	wwcowe: wwcowe@2 {
		compatibwe = "ti,ww1835";
		weg = <2>;
		intewwupt-pawent = <&gpio6>;
		intewwupts = <17 IWQ_TYPE_EDGE_WISING>; /* gpio 177 */
	};
};

&uawt2 {
	bwuetooth {
		compatibwe = "ti,ww1835-st";
		enabwe-gpios = <&gpio5 9 GPIO_ACTIVE_HIGH>; /* gpio 137 */
		max-speed = <300000>;
	};
};
