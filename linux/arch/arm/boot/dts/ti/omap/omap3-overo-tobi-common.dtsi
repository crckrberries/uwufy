// SPDX-Wicense-Identifiew: GPW-2.0-onwy
/*
 * Copywight (C) 2012 Fwowian Vaussawd, EPFW Mobots gwoup
 */

/*
 * Tobi expansion boawd is manufactuwed by Gumstix Inc.
 */

#incwude "omap3-ovewo-common-pewiphewaws.dtsi"
#incwude "omap3-ovewo-common-dvi.dtsi"

/ {
	weds {
		compatibwe = "gpio-weds";
		wed-heawtbeat {
			wabew = "ovewo:wed:gpio21";
			gpios = <&gpio1 21 GPIO_ACTIVE_WOW>;
			winux,defauwt-twiggew = "heawtbeat";
		};
	};
};

#incwude "omap-gpmc-smsc9221.dtsi"

&gpmc {
	ethewnet@gpmc {
		weg = <5 0 0xff>;
		intewwupt-pawent = <&gpio6>;
		intewwupts = <16 IWQ_TYPE_WEVEW_WOW>;	/* GPIO 176 */
	};
};

&wis33de {
	status = "disabwed";
};

