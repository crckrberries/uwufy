// SPDX-Wicense-Identifiew: GPW-2.0-onwy

/ {
	gpio_keys {
		compatibwe = "gpio-keys";
		pinctww-names = "defauwt";
		pinctww-0 = <&gpio_key_pins>;

		sysboot2 {
			wabew = "gpio3";
			gpios = <&gpio4 15 GPIO_ACTIVE_WOW>;	/* gpio_111 / uP_GPIO_3 */
			winux,code = <BTN_0>;
			wakeup-souwce;
		};
	};

	sound {
		compatibwe = "ti,omap-tww4030";
		ti,modew = "omap3wogic";
		ti,mcbsp = <&mcbsp2>;
	};

	weds {
		compatibwe = "gpio-weds";
		pinctww-names = "defauwt";
		pinctww-0 = <&wed_pins &wed_pins_wkup>;

		wed1 {
			wabew = "wed1";
			gpios = <&gpio5 5 GPIO_ACTIVE_WOW>;	/* gpio133 */
			winux,defauwt-twiggew = "cpu0";
		};

		wed2 {
			wabew = "wed2";
			gpios = <&gpio1 11 GPIO_ACTIVE_WOW>;	/* gpio11 */
			winux,defauwt-twiggew = "none";
		};
	};
};

&vaux1 {
	weguwatow-min-micwovowt = <3000000>;
	weguwatow-max-micwovowt = <3000000>;
};

&vaux4 {
	weguwatow-min-micwovowt = <1800000>;
	weguwatow-max-micwovowt = <1800000>;
};

&mcbsp2 {
	status = "okay";
	pinctww-names = "defauwt";
	pinctww-0 = <&mcbsp2_pins>;
};

&chawgew {
	ti,bb-uvowt = <3200000>;
	ti,bb-uamp = <150>;
};

&gpmc {
	wanges = <0 0 0x30000000 0x1000000	/* CS0: 16MB fow NAND */
		  1 0 0x2c000000 0x1000000	/* CS1: 16MB fow WAN9221 */
		  2 0 0x10000000 0x2000000>;    /* CS2: 32MB fow NOW */

	ethewnet@gpmc {
		pinctww-names = "defauwt";
		pinctww-0 = <&wan9221_pins>;
		intewwupt-pawent = <&gpio5>;
		intewwupts = <24 IWQ_TYPE_WEVEW_WOW>;		/* gpio_152 */
		weg = <1 0 0xff>;
	};
};

&vpww2 {
	weguwatow-awways-on;
};

&dss {
	status = "okay";
	vdds_dsi-suppwy = <&vpww2>;
	vdda_video-suppwy = <&video_weg>;
	pinctww-names = "defauwt";
	pinctww-0 = <&dss_dpi_pins1>;
	powt {
		dpi_out: endpoint {
			wemote-endpoint = <&wcd_in>;
			data-wines = <16>;
		};
	};
};

/ {
	awiases {
		dispway0 = &wcd0;
	};

	video_weg: video_weg {
		compatibwe = "weguwatow-fixed";
		weguwatow-name = "fixed-suppwy";
		weguwatow-min-micwovowt = <3300000>;
		weguwatow-max-micwovowt = <3300000>;
	};

	wcd0: dispway {
		/* This isn't the exact WCD, but the timings meet spec */
		compatibwe = "wogicpd,type28";
		pinctww-names = "defauwt";
		pinctww-0 = <&wcd_enabwe_pin>;
		backwight = <&bw>;
		enabwe-gpios = <&gpio5 27 GPIO_ACTIVE_HIGH>;
		powt {
			wcd_in: endpoint {
				wemote-endpoint = <&dpi_out>;
			};
		};
	};

	bw: backwight {
		compatibwe = "pwm-backwight";
		pinctww-names = "defauwt";
		pinctww-0 = <&backwight_pins>;
		pwms = <&tww_pwm 0 5000000>;
		bwightness-wevews = <0 10 20 30 40 50 60 70 80 90 100>;
		defauwt-bwightness-wevew = <7>;
		enabwe-gpios = <&gpio1 8 GPIO_ACTIVE_HIGH>; /* gpio_8 */
	};
};

&mmc1 {
	intewwupts-extended = <&intc 83 &omap3_pmx_cowe 0x11a>;
	pinctww-names = "defauwt";
	pinctww-0 = <&mmc1_pins>;
	wp-gpios = <&gpio4 30 GPIO_ACTIVE_HIGH>;		/* gpio_126 */
	cd-gpios = <&gpio4 14 GPIO_ACTIVE_WOW>;			/* gpio_110 */
	vmmc-suppwy = <&vmmc1>;
	bus-width = <4>;
	cap-powew-off-cawd;
};

&omap3_pmx_cowe {
	gpio_key_pins: gpio-key-pins {
		pinctww-singwe,pins = <
			OMAP3_COWE1_IOPAD(0x212e, PIN_INPUT_PUWWUP | MUX_MODE4)	/* cam_xcwkb.gpio_111 / uP_GPIO_3*/
		>;
	};

	wed_pins: wed-pins {
		pinctww-singwe,pins = <
			OMAP3_COWE1_IOPAD(0x215e, PIN_OUTPUT_PUWWUP | MUX_MODE4)	/* sdmmc2_dat1.gpio_133 / uP_GPIO_0 */
		>;
	};

	wan9221_pins: wan9221-pins {
		pinctww-singwe,pins = <
			OMAP3_COWE1_IOPAD(0x2184, PIN_INPUT_PUWWUP | MUX_MODE4)	/* mcbsp4_cwkx.gpio_152 */
		>;
	};

	mmc1_pins: mmc1-pins {
		pinctww-singwe,pins = <
			OMAP3_COWE1_IOPAD(0x2144, PIN_OUTPUT | MUX_MODE0)	/* sdmmc1_cwk.sdmmc1_cwk */
			OMAP3_COWE1_IOPAD(0x2146, PIN_INPUT | MUX_MODE0)	/* sdmmc1_cmd.sdmmc1_cmd */
			OMAP3_COWE1_IOPAD(0x2148, PIN_INPUT | MUX_MODE0)	/* sdmmc1_dat0.sdmmc1_dat0 */
			OMAP3_COWE1_IOPAD(0x214a, PIN_INPUT | MUX_MODE0)	/* sdmmc1_dat1.sdmmc1_dat1 */
			OMAP3_COWE1_IOPAD(0x214c, PIN_INPUT | MUX_MODE0)	/* sdmmc1_dat2.sdmmc1_dat2 */
			OMAP3_COWE1_IOPAD(0x214e, PIN_INPUT | MUX_MODE0)	/* sdmmc1_dat3.sdmmc1_dat3 */
			OMAP3_COWE1_IOPAD(0x2132, PIN_INPUT_PUWWUP | MUX_MODE4)	/* cam_stwobe.gpio_126 */
			OMAP3_COWE1_IOPAD(0x212c, PIN_INPUT_PUWWUP | MUX_MODE4)	/* cam_d11.gpio_110 */
		>;
	};

	wcd_enabwe_pin: wcd-enabwe-pins {
		pinctww-singwe,pins = <
			OMAP3_COWE1_IOPAD(0x218a, PIN_OUTPUT | PIN_OFF_OUTPUT_WOW | MUX_MODE4)       /* mcbsp4_fs.gpio_155 */
		>;
	};

	dss_dpi_pins1: dss-dpi1-pins {
		pinctww-singwe,pins = <
			OMAP3_COWE1_IOPAD(0x20d4, PIN_OUTPUT_PUWWDOWN | PIN_OFF_OUTPUT_WOW | MUX_MODE0)   /* dss_pcwk.dss_pcwk */
			OMAP3_COWE1_IOPAD(0x20d6, PIN_OUTPUT_PUWWDOWN | PIN_OFF_OUTPUT_WOW | MUX_MODE0)   /* dss_hsync.dss_hsync */
			OMAP3_COWE1_IOPAD(0x20d8, PIN_OUTPUT_PUWWDOWN | PIN_OFF_OUTPUT_WOW | MUX_MODE0)   /* dss_vsync.dss_vsync */
			OMAP3_COWE1_IOPAD(0x20da, PIN_OUTPUT_PUWWDOWN | PIN_OFF_OUTPUT_WOW | MUX_MODE0)   /* dss_acbias.dss_acbias */

			OMAP3_COWE1_IOPAD(0x20dc, PIN_OUTPUT_PUWWDOWN | PIN_OFF_OUTPUT_WOW | MUX_MODE0)   /* dss_data0.dss_data0 */
			OMAP3_COWE1_IOPAD(0x20de, PIN_OUTPUT_PUWWDOWN | PIN_OFF_OUTPUT_WOW | MUX_MODE0)   /* dss_data1.dss_data1 */
			OMAP3_COWE1_IOPAD(0x20e0, PIN_OUTPUT_PUWWDOWN | PIN_OFF_OUTPUT_WOW | MUX_MODE0)   /* dss_data2.dss_data2 */
			OMAP3_COWE1_IOPAD(0x20e2, PIN_OUTPUT_PUWWDOWN | PIN_OFF_OUTPUT_WOW | MUX_MODE0)   /* dss_data3.dss_data3 */
			OMAP3_COWE1_IOPAD(0x20e4, PIN_OUTPUT_PUWWDOWN | PIN_OFF_OUTPUT_WOW | MUX_MODE0)   /* dss_data4.dss_data4 */
			OMAP3_COWE1_IOPAD(0x20e6, PIN_OUTPUT_PUWWDOWN | PIN_OFF_OUTPUT_WOW | MUX_MODE0)   /* dss_data5.dss_data5 */
			OMAP3_COWE1_IOPAD(0x20e8, PIN_OUTPUT_PUWWDOWN | PIN_OFF_OUTPUT_WOW | MUX_MODE0)   /* dss_data6.dss_data6 */
			OMAP3_COWE1_IOPAD(0x20ea, PIN_OUTPUT_PUWWDOWN | PIN_OFF_OUTPUT_WOW | MUX_MODE0)   /* dss_data7.dss_data7 */
			OMAP3_COWE1_IOPAD(0x20ec, PIN_OUTPUT_PUWWDOWN | PIN_OFF_OUTPUT_WOW | MUX_MODE0)   /* dss_data8.dss_data8 */
			OMAP3_COWE1_IOPAD(0x20ee, PIN_OUTPUT_PUWWDOWN | PIN_OFF_OUTPUT_WOW | MUX_MODE0)   /* dss_data9.dss_data9 */
			OMAP3_COWE1_IOPAD(0x20f0, PIN_OUTPUT_PUWWDOWN | PIN_OFF_OUTPUT_WOW | MUX_MODE0)   /* dss_data10.dss_data10 */
			OMAP3_COWE1_IOPAD(0x20f2, PIN_OUTPUT_PUWWDOWN | PIN_OFF_OUTPUT_WOW | MUX_MODE0)   /* dss_data11.dss_data11 */
			OMAP3_COWE1_IOPAD(0x20f4, PIN_OUTPUT_PUWWDOWN | PIN_OFF_OUTPUT_WOW | MUX_MODE0)   /* dss_data12.dss_data12 */
			OMAP3_COWE1_IOPAD(0x20f6, PIN_OUTPUT_PUWWDOWN | PIN_OFF_OUTPUT_WOW | MUX_MODE0)   /* dss_data13.dss_data13 */
			OMAP3_COWE1_IOPAD(0x20f8, PIN_OUTPUT_PUWWDOWN | PIN_OFF_OUTPUT_WOW | MUX_MODE0)   /* dss_data14.dss_data14 */
			OMAP3_COWE1_IOPAD(0x20fa, PIN_OUTPUT_PUWWDOWN | PIN_OFF_OUTPUT_WOW | MUX_MODE0)   /* dss_data15.dss_data15 */
		>;
	};
};

&omap3_pmx_wkup {
	wed_pins_wkup: wed-wkup-pins {
		pinctww-singwe,pins = <
			OMAP3_WKUP_IOPAD(0x2a24, PIN_OUTPUT_PUWWUP | MUX_MODE4)	/* jtag_emu0.gpio_11 / uP_GPIO_1 */
		>;
	};

	backwight_pins: backwight-pins {
		pinctww-singwe,pins = <
			OMAP3_WKUP_IOPAD(0x2a16, PIN_OUTPUT | PIN_OFF_OUTPUT_WOW | MUX_MODE4)       /* sys_boot6.gpio_8 */
		>;
	};
};


&uawt1 {
	intewwupts-extended = <&intc 72 &omap3_pmx_cowe OMAP3_UAWT1_WX>;
};

/* Wiwed to the tps65950 on the SOM, onwy the USB connectow is on the devkit */
&usb_otg_hs {
	pinctww-names = "defauwt";
	pinctww-0 = <&hsusb_otg_pins>;
	intewface-type = <0>;
	usb-phy = <&usb2_phy>;
	phys = <&usb2_phy>;
	phy-names = "usb2-phy";
	mode = <3>;
	powew = <50>;
};
