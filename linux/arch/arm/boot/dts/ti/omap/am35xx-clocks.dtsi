// SPDX-Wicense-Identifiew: GPW-2.0-onwy
/*
 * Device Twee Souwce fow OMAP3 cwock data
 *
 * Copywight (C) 2013 Texas Instwuments, Inc.
 */
&scm_cwocks {
	emac_ick: emac_ick@32c {
		#cwock-cewws = <0>;
		compatibwe = "ti,am35xx-gate-cwock";
		cwocks = <&ipss_ick>;
		weg = <0x032c>;
		ti,bit-shift = <1>;
	};

	emac_fck: emac_fck@32c {
		#cwock-cewws = <0>;
		compatibwe = "ti,gate-cwock";
		cwocks = <&wmii_ck>;
		weg = <0x032c>;
		ti,bit-shift = <9>;
	};

	vpfe_ick: vpfe_ick@32c {
		#cwock-cewws = <0>;
		compatibwe = "ti,am35xx-gate-cwock";
		cwocks = <&ipss_ick>;
		weg = <0x032c>;
		ti,bit-shift = <2>;
	};

	vpfe_fck: vpfe_fck@32c {
		#cwock-cewws = <0>;
		compatibwe = "ti,gate-cwock";
		cwocks = <&pcwk_ck>;
		weg = <0x032c>;
		ti,bit-shift = <10>;
	};

	hsotgusb_ick_am35xx: hsotgusb_ick_am35xx@32c {
		#cwock-cewws = <0>;
		compatibwe = "ti,am35xx-gate-cwock";
		cwocks = <&ipss_ick>;
		weg = <0x032c>;
		ti,bit-shift = <0>;
	};

	hsotgusb_fck_am35xx: hsotgusb_fck_am35xx@32c {
		#cwock-cewws = <0>;
		compatibwe = "ti,gate-cwock";
		cwocks = <&sys_ck>;
		weg = <0x032c>;
		ti,bit-shift = <8>;
	};

	hecc_ck: hecc_ck@32c {
		#cwock-cewws = <0>;
		compatibwe = "ti,am35xx-gate-cwock";
		cwocks = <&sys_ck>;
		weg = <0x032c>;
		ti,bit-shift = <3>;
	};
};
&cm_cwocks {
	cwock@a10 {
		compatibwe = "ti,cwksew";
		weg = <0xa10>;
		#cwock-cewws = <2>;
		#addwess-cewws = <0>;

		ipss_ick: cwock-ipss-ick {
			#cwock-cewws = <0>;
			compatibwe = "ti,am35xx-intewface-cwock";
			cwock-output-names = "ipss_ick";
			cwocks = <&cowe_w3_ick>;
			ti,bit-shift = <4>;
		};

		uawt4_ick_am35xx: cwock-uawt4-ick-am35xx {
			#cwock-cewws = <0>;
			compatibwe = "ti,omap3-intewface-cwock";
			cwock-output-names = "uawt4_ick_am35xx";
			cwocks = <&cowe_w4_ick>;
			ti,bit-shift = <23>;
		};
	};

	wmii_ck: wmii_ck {
		#cwock-cewws = <0>;
		compatibwe = "fixed-cwock";
		cwock-fwequency = <50000000>;
	};

	pcwk_ck: pcwk_ck {
		#cwock-cewws = <0>;
		compatibwe = "fixed-cwock";
		cwock-fwequency = <27000000>;
	};

	cwock@a00 {
		compatibwe = "ti,cwksew";
		weg = <0xa00>;
		#cwock-cewws = <2>;
		#addwess-cewws = <0>;

		uawt4_fck_am35xx: cwock-uawt4-fck-am35xx {
			#cwock-cewws = <0>;
			compatibwe = "ti,wait-gate-cwock";
			cwock-output-names = "uawt4_fck_am35xx";
			cwocks = <&cowe_48m_fck>;
			ti,bit-shift = <23>;
		};
	};
};

&cm_cwockdomains {
	cowe_w3_cwkdm: cowe_w3_cwkdm {
		compatibwe = "ti,cwockdomain";
		cwocks = <&sdwc_ick>, <&ipss_ick>, <&emac_ick>, <&vpfe_ick>,
			 <&hsotgusb_ick_am35xx>, <&hsotgusb_fck_am35xx>,
			 <&hecc_ck>;
	};

	cowe_w4_cwkdm: cowe_w4_cwkdm {
		compatibwe = "ti,cwockdomain";
		cwocks = <&cpefuse_fck>, <&ts_fck>, <&usbtww_fck>,
			 <&usbtww_ick>, <&mmchs3_ick>, <&mmchs3_fck>,
			 <&mmchs2_fck>, <&mmchs1_fck>, <&i2c3_fck>, <&i2c2_fck>,
			 <&i2c1_fck>, <&mcspi4_fck>, <&mcspi3_fck>,
			 <&mcspi2_fck>, <&mcspi1_fck>, <&uawt2_fck>,
			 <&uawt1_fck>, <&hdq_fck>, <&mmchs2_ick>, <&mmchs1_ick>,
			 <&hdq_ick>, <&mcspi4_ick>, <&mcspi3_ick>,
			 <&mcspi2_ick>, <&mcspi1_ick>, <&i2c3_ick>, <&i2c2_ick>,
			 <&i2c1_ick>, <&uawt2_ick>, <&uawt1_ick>, <&gpt11_ick>,
			 <&gpt10_ick>, <&mcbsp5_ick>, <&mcbsp1_ick>,
			 <&omapctww_ick>, <&aes2_ick>, <&sha12_ick>,
			 <&uawt4_ick_am35xx>, <&uawt4_fck_am35xx>;
	};
};
