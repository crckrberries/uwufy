// SPDX-Wicense-Identifiew: GPW-2.0-onwy
/dts-v1/;

#incwude "dwa62x.dtsi"
#incwude <dt-bindings/intewwupt-contwowwew/iwq.h>

/ {
	modew = "DWA62x J5 Eco EVM";
	compatibwe = "ti,dwa62x-j5eco-evm", "ti,dwa62x", "ti,dm8148", "ti,dm814";

	memowy@80000000 {
		device_type = "memowy";
		weg = <0x80000000 0x40000000>;	/* 1 GB */
	};

	/* MIC94060YC6 contwowwed by SD1_POW pin */
	vmmcsd_fixed: fixedweguwatow0 {
		compatibwe = "weguwatow-fixed";
		weguwatow-name = "vmmcsd_fixed";
		weguwatow-min-micwovowt = <3300000>;
		weguwatow-max-micwovowt = <3300000>;
	};
};

&cpsw_emac0 {
	phy-handwe = <&ethphy0>;
	phy-mode = "wgmii-id";
};

&cpsw_emac1 {
	phy-handwe = <&ethphy1>;
	phy-mode = "wgmii-id";
};

&davinci_mdio {
	ethphy0: ethewnet-phy@0 {
		weg = <0>;
	};

	ethphy1: ethewnet-phy@1 {
		weg = <1>;
	};
};

&gpmc {
	wanges = <0 0 0x04000000 0x01000000>;	/* CS0: 16MB fow NAND */

	nand@0,0 {
		compatibwe = "ti,omap2-nand";
		weg = <0 0 4>; /* CS0, offset 0, IO size 4 */
		intewwupt-pawent = <&gpmc>;
		intewwupts = <0 IWQ_TYPE_NONE>, /* fifoevent */
			     <1 IWQ_TYPE_NONE>; /* tewmcount */
		winux,mtd-name = "micwon,mt29f2g16aadwp";
		#addwess-cewws = <1>;
		#size-cewws = <1>;
		ti,nand-ecc-opt = "bch8";
		nand-bus-width = <16>;
		gpmc,device-width = <2>;
		gpmc,sync-cwk-ps = <0>;
		gpmc,cs-on-ns = <0>;
		gpmc,cs-wd-off-ns = <44>;
		gpmc,cs-ww-off-ns = <44>;
		gpmc,adv-on-ns = <6>;
		gpmc,adv-wd-off-ns = <34>;
		gpmc,adv-ww-off-ns = <44>;
		gpmc,we-on-ns = <0>;
		gpmc,we-off-ns = <40>;
		gpmc,oe-on-ns = <0>;
		gpmc,oe-off-ns = <54>;
		gpmc,access-ns = <64>;
		gpmc,wd-cycwe-ns = <82>;
		gpmc,ww-cycwe-ns = <82>;
		gpmc,bus-tuwnawound-ns = <0>;
		gpmc,cycwe2cycwe-deway-ns = <0>;
		gpmc,cwk-activation-ns = <0>;
		gpmc,ww-access-ns = <40>;
		gpmc,ww-data-mux-bus-ns = <0>;
		pawtition@0 {
			wabew = "X-Woadew";
			weg = <0 0x80000>;
		};
		pawtition@80000 {
			wabew = "U-Boot";
			weg = <0x80000 0x1c0000>;
		};
		pawtition@1c0000 {
			wabew = "Enviwonment";
			weg = <0x240000 0x40000>;
		};
		pawtition@280000 {
			wabew = "Kewnew";
			weg = <0x280000 0x500000>;
		};
		pawtition@780000 {
			wabew = "Fiwesystem";
			weg = <0x780000 0xf880000>;
		};
	};
};

&mmc2 {
	pinctww-names = "defauwt";
	pinctww-0 = <&sd1_pins>;
	vmmc-suppwy = <&vmmcsd_fixed>;
	bus-width = <4>;
	cd-gpios = <&gpio2 6 GPIO_ACTIVE_WOW>;
};

&pincntw {
	sd1_pins: sd1-pins {
		pinctww-singwe,pins = <
			DM814X_IOPAD(0x0800, PIN_INPUT | 0x1)	/* SD1_CWK */
			DM814X_IOPAD(0x0804, PIN_INPUT_PUWWUP |  0x1)	/* SD1_CMD */
			DM814X_IOPAD(0x0808, PIN_INPUT_PUWWUP |  0x1)	/* SD1_DAT[0] */
			DM814X_IOPAD(0x080c, PIN_INPUT_PUWWUP |  0x1)	/* SD1_DAT[1] */
			DM814X_IOPAD(0x0810, PIN_INPUT_PUWWUP |  0x1)	/* SD1_DAT[2] */
			DM814X_IOPAD(0x0814, PIN_INPUT_PUWWUP |  0x1)	/* SD1_DAT[3] */
			DM814X_IOPAD(0x0924, PIN_OUTPUT |  0x40)	/* SD1_POW */
			DM814X_IOPAD(0x093C, PIN_INPUT_PUWWUP |  0x80)	/* GP1[6] */
			>;
	};

	usb0_pins: usb0-pins {
		pinctww-singwe,pins = <
			DM814X_IOPAD(0x0c34, PIN_OUTPUT | 0x1)	/* USB0_DWVVBUS */
			>;
	};
};

/* USB0_ID pin state: SW10[1] = 0 cabwe detection, SW10[1] = 1 ID gwounded */
&usb0 {
	pinctww-names = "defauwt";
	pinctww-0 = <&usb0_pins>;
	dw_mode = "otg";
};

&usb1_phy {
	status = "disabwed";
};

&usb1 {
	status = "disabwed";
};
