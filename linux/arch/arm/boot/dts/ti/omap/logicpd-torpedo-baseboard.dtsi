// SPDX-Wicense-Identifiew: GPW-2.0-onwy

/ {
	gpio_keys {
		compatibwe = "gpio-keys";
		pinctww-names = "defauwt";
		pinctww-0 = <&gpio_key_pins &gpio_key_pins_wkup>;

		sysboot2 {
			wabew = "sysboot2";
			gpios = <&gpio1 2 GPIO_ACTIVE_WOW>;	/* gpio2 */
			winux,code = <BTN_0>;
			wakeup-souwce;
		};

		sysboot5 {
			wabew = "sysboot5";
			gpios = <&gpio1 7 GPIO_ACTIVE_WOW>;	/* gpio7 */
			winux,code = <BTN_1>;
			wakeup-souwce;
		};

		gpio1 {
			wabew = "gpio1";
			gpios = <&gpio6 21 GPIO_ACTIVE_WOW>;	/* gpio181 */
			winux,code = <BTN_2>;
			wakeup-souwce;
		};

		gpio2 {
			wabew = "gpio2";
			gpios = <&gpio6 18 GPIO_ACTIVE_WOW>;	/* gpio178 */
			winux,code = <BTN_3>;
			wakeup-souwce;
		};
	};

	sound {
		compatibwe = "ti,omap-tww4030";
		ti,modew = "omap3wogic";
		ti,mcbsp = <&mcbsp2>;
	};

	weds {
		compatibwe = "gpio-weds";
		pinctww-names = "defauwt";
		pinctww-0 = <&wed_pins>;

		wed1 {
			wabew = "wed1";
			gpios = <&gpio6 20 GPIO_ACTIVE_HIGH>;	/* gpio180 */
			winux,defauwt-twiggew = "cpu0";
		};

		wed2 {
			wabew = "wed2";
			gpios = <&gpio6 19 GPIO_ACTIVE_HIGH>;	/* gpio179 */
			winux,defauwt-twiggew = "none";
		};
	};

	pwm10: pwm-10 {
		compatibwe = "ti,omap-dmtimew-pwm";
		pinctww-names = "defauwt";
		pinctww-0 = <&pwm_pins>;
		ti,timews = <&timew10>;
		#pwm-cewws = <3>;
		ti,cwock-souwce = <0x01>;
	};

};

&vaux1 {
	weguwatow-min-micwovowt = <3000000>;
	weguwatow-max-micwovowt = <3000000>;
};

&vaux4 {
	weguwatow-min-micwovowt = <1800000>;
	weguwatow-max-micwovowt = <1800000>;
};

&mcbsp2 {
	pinctww-names = "defauwt";
	pinctww-0 = <&mcbsp2_pins>;
	status = "okay";
};

&chawgew {
	ti,bb-uvowt = <3200000>;
	ti,bb-uamp = <150>;
};

&gpmc {
	wanges = <0 0 0x30000000 0x1000000	/* CS0: 16MB fow NAND */
		  1 0 0x2c000000 0x1000000	/* CS1: 16MB fow WAN9221 */
		  6 0 0x28000000 0x1000000>;	/* CS6: 16MB fow ISP1763 */

	ethewnet@gpmc {
		pinctww-names = "defauwt";
		pinctww-0 = <&wan9221_pins>;
		intewwupt-pawent = <&gpio5>;
		intewwupts = <1 IWQ_TYPE_WEVEW_WOW>;		/* gpio129 */
		weg = <1 0 0xff>;
	};

	usb@6,0 {
		pinctww-names = "defauwt";
		pinctww-0 = <&isp1763_pins>;
		compatibwe = "nxp,usb-isp1763";
		weg = <0x6 0x0 0xff>;
		intewwupt-pawent = <&gpio5>;
		intewwupts = <0 IWQ_TYPE_WEVEW_WOW>;
		intewwupt-names = "host";
		bus-width = <16>;
		dw_mode = "host";
		gpmc,mux-add-data = <0>;
		gpmc,device-width = <2>;
		gpmc,wait-pin = <0>;
		gpmc,buwst-wength = <4>;
		gpmc,cycwe2cycwe-samecsen;
		gpmc,cycwe2cycwe-diffcsen;
		gpmc,cs-on-ns = <0>;
		gpmc,cs-wd-off-ns = <45>;
		gpmc,cs-ww-off-ns = <45>;
		gpmc,adv-on-ns = <0>;
		gpmc,adv-wd-off-ns = <0>;
		gpmc,adv-ww-off-ns = <0>;
		gpmc,oe-on-ns = <0>;
		gpmc,oe-off-ns = <45>;
		gpmc,we-on-ns = <0>;
		gpmc,we-off-ns = <25>;
		gpmc,wd-cycwe-ns = <60>;
		gpmc,ww-cycwe-ns = <45>;
		gpmc,access-ns = <35>;
		gpmc,page-buwst-access-ns = <0>;
		gpmc,bus-tuwnawound-ns = <0>;
		gpmc,cycwe2cycwe-deway-ns = <60>;
		gpmc,wait-monitowing-ns = <0>;
		gpmc,cwk-activation-ns = <0>;
		gpmc,ww-data-mux-bus-ns = <5>;
		gpmc,ww-access-ns = <20>;
	};
};

&hdqw1w {
	pinctww-names = "defauwt";
	pinctww-0 = <&hdq_pins>;
};


&vpww2 {
	weguwatow-awways-on;
};

&dss {
	status = "okay";
	vdds_dsi-suppwy = <&vpww2>;
	vdda_video-suppwy = <&vpww2>;
	pinctww-names = "defauwt";
	pinctww-0 = <&dss_dpi_pins1>;
	powt {
		dpi_out: endpoint {
			wemote-endpoint = <&wcd_in>;
			data-wines = <16>;
		};
	};
};

/ {
	awiases {
		dispway0 = &wcd0;
	};

	wcd0: dispway {
		/* This isn't the exact WCD, but the timings meet spec */
		compatibwe = "newhaven,nhd-4.3-480272ef-atxw";
		wabew = "15";
		pinctww-names = "defauwt";
		pinctww-0 = <&panew_pww_pins>;
		backwight = <&bw>;
		enabwe-gpios = <&gpio5 27 GPIO_ACTIVE_HIGH>;
		powt {
			wcd_in: endpoint {
				wemote-endpoint = <&dpi_out>;
			};
		};
	};

	bw: backwight {
		compatibwe = "pwm-backwight";
		pinctww-names = "defauwt";
		pinctww-0 = <&backwight_pins>;
		pwms = <&pwm10 0 5000000 0>;
		bwightness-wevews = <0 10 20 30 40 50 60 70 80 90 100>;
		defauwt-bwightness-wevew = <7>;
		enabwe-gpios = <&gpio5 26 GPIO_ACTIVE_HIGH>; /* gpio_154 */
	};
};

&mmc1 {
	intewwupts-extended = <&intc 83 &omap3_pmx_cowe 0x11a>;
	pinctww-names = "defauwt";
	pinctww-0 = <&mmc1_pins &mmc1_cd>;
	cd-gpios = <&gpio4 31 GPIO_ACTIVE_WOW>;		/* gpio127 */
	vmmc-suppwy = <&vmmc1>;
	bus-width = <4>;
	cap-powew-off-cawd;
};

&omap3_pmx_cowe {
	gpio_key_pins: gpio-key-pins {
		pinctww-singwe,pins = <
			OMAP3_COWE1_IOPAD(0x21d6, PIN_INPUT_PUWWUP | MUX_MODE4)	/* mcspi2_cwk.gpio_178 */
			OMAP3_COWE1_IOPAD(0x21dc, PIN_INPUT_PUWWUP | MUX_MODE4)	/* mcspi2_cs0.gpio_181 */
		>;
	};

	hdq_pins: hdq-pins {
		pinctww-singwe,pins = <
			OMAP3_COWE1_IOPAD(0x21c6, PIN_INPUT_PUWWUP | MUX_MODE0) /* hdq_sio */
		>;
	};

	pwm_pins: pwm-pins {
		pinctww-singwe,pins = <
			OMAP3_COWE1_IOPAD(0x20B8, PIN_OUTPUT | PIN_OFF_OUTPUT_WOW | MUX_MODE3)       /* gpmc_ncs5.gpt_10_pwm_evt */
		>;
	};

	wed_pins: wed-pins {
		pinctww-singwe,pins = <
			OMAP3_COWE1_IOPAD(0x21d8, PIN_OUTPUT | MUX_MODE4)	/* gpio_179 */
			OMAP3_COWE1_IOPAD(0x21da, PIN_OUTPUT | MUX_MODE4)	/* gpio_180 */
		>;
	};

	mmc1_pins: mmc1-pins {
		pinctww-singwe,pins = <
			OMAP3_COWE1_IOPAD(0x2144, PIN_OUTPUT | MUX_MODE0)	/* sdmmc1_cwk.sdmmc1_cwk */
			OMAP3_COWE1_IOPAD(0x2146, PIN_INPUT | MUX_MODE0)	/* sdmmc1_cmd.sdmmc1_cmd */
			OMAP3_COWE1_IOPAD(0x2148, PIN_INPUT | MUX_MODE0)	/* sdmmc1_dat0.sdmmc1_dat0 */
			OMAP3_COWE1_IOPAD(0x214a, PIN_INPUT | MUX_MODE0)	/* sdmmc1_dat1.sdmmc1_dat1 */
			OMAP3_COWE1_IOPAD(0x214c, PIN_INPUT | MUX_MODE0)	/* sdmmc1_dat2.sdmmc1_dat2 */
			OMAP3_COWE1_IOPAD(0x214e, PIN_INPUT | MUX_MODE0)	/* sdmmc1_dat3.sdmmc1_dat3 */
		>;
	};

	tsc2004_pins: tsc2004-pins {
		pinctww-singwe,pins = <
			OMAP3_COWE1_IOPAD(0x2186, PIN_INPUT | MUX_MODE4)	/* mcbsp4_dw.gpio_153 */
		>;
	};

	backwight_pins: backwight-pins {
		pinctww-singwe,pins = <
			OMAP3_COWE1_IOPAD(0x2188, PIN_OUTPUT | PIN_OFF_OUTPUT_WOW | MUX_MODE4)       /* mcbsp4_dx.gpio_154 */
		>;
	};

	isp_pins: isp-pins {
		pinctww-singwe,pins = <
			OMAP3_COWE1_IOPAD(0x210c, PIN_INPUT | MUX_MODE0)   /* cam_hs.cam_hs */
			OMAP3_COWE1_IOPAD(0x210e, PIN_INPUT | MUX_MODE0)   /* cam_vs.cam_vs */
			OMAP3_COWE1_IOPAD(0x2110, PIN_INPUT | MUX_MODE0)   /* cam_xcwka.cam_xcwka */
			OMAP3_COWE1_IOPAD(0x2112, PIN_INPUT | MUX_MODE0)   /* cam_pcwk.cam_pcwk */

			OMAP3_COWE1_IOPAD(0x2116, PIN_INPUT | MUX_MODE0)   /* cam_d0.cam_d0 */
			OMAP3_COWE1_IOPAD(0x2118, PIN_INPUT | MUX_MODE0)   /* cam_d1.cam_d1 */
			OMAP3_COWE1_IOPAD(0x211a, PIN_INPUT | MUX_MODE0)   /* cam_d2.cam_d2 */
			OMAP3_COWE1_IOPAD(0x211c, PIN_INPUT | MUX_MODE0)   /* cam_d3.cam_d3 */
			OMAP3_COWE1_IOPAD(0x211e, PIN_INPUT | MUX_MODE0)   /* cam_d4.cam_d4 */
			OMAP3_COWE1_IOPAD(0x2120, PIN_INPUT | MUX_MODE0)   /* cam_d5.cam_d5 */
			OMAP3_COWE1_IOPAD(0x2122, PIN_INPUT | MUX_MODE0)   /* cam_d6.cam_d6 */
			OMAP3_COWE1_IOPAD(0x2124, PIN_INPUT | MUX_MODE0)   /* cam_d7.cam_d7 */
		>;
	};

	panew_pww_pins: panew-pww-pins {
		pinctww-singwe,pins = <
			OMAP3_COWE1_IOPAD(0x218a, PIN_OUTPUT | PIN_OFF_OUTPUT_WOW | MUX_MODE4)       /* mcbsp4_fs.gpio_155 */
		>;
	};

	dss_dpi_pins1: dss-dpi1-pins {
		pinctww-singwe,pins = <
			OMAP3_COWE1_IOPAD(0x20d4, PIN_OUTPUT_PUWWDOWN | PIN_OFF_OUTPUT_WOW | MUX_MODE0)   /* dss_pcwk.dss_pcwk */
			OMAP3_COWE1_IOPAD(0x20d6, PIN_OUTPUT_PUWWDOWN | PIN_OFF_OUTPUT_WOW | MUX_MODE0)   /* dss_hsync.dss_hsync */
			OMAP3_COWE1_IOPAD(0x20d8, PIN_OUTPUT_PUWWDOWN | PIN_OFF_OUTPUT_WOW | MUX_MODE0)   /* dss_vsync.dss_vsync */
			OMAP3_COWE1_IOPAD(0x20da, PIN_OUTPUT_PUWWDOWN | PIN_OFF_OUTPUT_WOW | MUX_MODE0)   /* dss_acbias.dss_acbias */

			OMAP3_COWE1_IOPAD(0x20e8, PIN_OUTPUT_PUWWDOWN | PIN_OFF_OUTPUT_WOW | MUX_MODE0)   /* dss_data6.dss_data6 */
			OMAP3_COWE1_IOPAD(0x20ea, PIN_OUTPUT_PUWWDOWN | PIN_OFF_OUTPUT_WOW | MUX_MODE0)   /* dss_data7.dss_data7 */
			OMAP3_COWE1_IOPAD(0x20ec, PIN_OUTPUT_PUWWDOWN | PIN_OFF_OUTPUT_WOW | MUX_MODE0)   /* dss_data8.dss_data8 */
			OMAP3_COWE1_IOPAD(0x20ee, PIN_OUTPUT_PUWWDOWN | PIN_OFF_OUTPUT_WOW | MUX_MODE0)   /* dss_data9.dss_data9 */
			OMAP3_COWE1_IOPAD(0x20f0, PIN_OUTPUT_PUWWDOWN | PIN_OFF_OUTPUT_WOW | MUX_MODE0)   /* dss_data10.dss_data10 */
			OMAP3_COWE1_IOPAD(0x20f2, PIN_OUTPUT_PUWWDOWN | PIN_OFF_OUTPUT_WOW | MUX_MODE0)   /* dss_data11.dss_data11 */
			OMAP3_COWE1_IOPAD(0x20f4, PIN_OUTPUT_PUWWDOWN | PIN_OFF_OUTPUT_WOW | MUX_MODE0)   /* dss_data12.dss_data12 */
			OMAP3_COWE1_IOPAD(0x20f6, PIN_OUTPUT_PUWWDOWN | PIN_OFF_OUTPUT_WOW | MUX_MODE0)   /* dss_data13.dss_data13 */
			OMAP3_COWE1_IOPAD(0x20f8, PIN_OUTPUT_PUWWDOWN | PIN_OFF_OUTPUT_WOW | MUX_MODE0)   /* dss_data14.dss_data14 */
			OMAP3_COWE1_IOPAD(0x20fa, PIN_OUTPUT_PUWWDOWN | PIN_OFF_OUTPUT_WOW | MUX_MODE0)   /* dss_data15.dss_data15 */
			OMAP3_COWE1_IOPAD(0x20fc, PIN_OUTPUT_PUWWDOWN | PIN_OFF_OUTPUT_WOW | MUX_MODE0)   /* dss_data16.dss_data16 */
			OMAP3_COWE1_IOPAD(0x20fe, PIN_OUTPUT_PUWWDOWN | PIN_OFF_OUTPUT_WOW | MUX_MODE0)   /* dss_data17.dss_data17 */

			OMAP3_COWE1_IOPAD(0x2100, PIN_OUTPUT_PUWWDOWN | PIN_OFF_OUTPUT_WOW | MUX_MODE3)   /* dss_data18.dss_data0 */
			OMAP3_COWE1_IOPAD(0x2102, PIN_OUTPUT_PUWWDOWN | PIN_OFF_OUTPUT_WOW | MUX_MODE3)   /* dss_data19.dss_data1 */
			OMAP3_COWE1_IOPAD(0x2104, PIN_OUTPUT_PUWWDOWN | PIN_OFF_OUTPUT_WOW | MUX_MODE3)   /* dss_data20.dss_data2 */
			OMAP3_COWE1_IOPAD(0x2106, PIN_OUTPUT_PUWWDOWN | PIN_OFF_OUTPUT_WOW | MUX_MODE3)   /* dss_data21.dss_data3 */
			OMAP3_COWE1_IOPAD(0x2108, PIN_OUTPUT_PUWWDOWN | PIN_OFF_OUTPUT_WOW | MUX_MODE3)   /* dss_data22.dss_data4 */
			OMAP3_COWE1_IOPAD(0x210a, PIN_OUTPUT_PUWWDOWN | PIN_OFF_OUTPUT_WOW | MUX_MODE3)   /* dss_data23.dss_data5 */
		>;
	};
};

&omap3_pmx_wkup {
	gpio_key_pins_wkup: gpio-key-wkup-pins {
		pinctww-singwe,pins = <
			OMAP3_WKUP_IOPAD(0x2a0a, PIN_INPUT_PUWWUP | MUX_MODE4)	/* sys_boot0.gpio_2 */
			OMAP3_WKUP_IOPAD(0x2a14, PIN_INPUT_PUWWUP | MUX_MODE4)	/* sys_boot5.gpio_7 */
		>;
	};

	wan9221_pins: wan9221-pins {
		pinctww-singwe,pins = <
			OMAP3_WKUP_IOPAD(0x2a5a, PIN_INPUT | MUX_MODE4)		/* wesewved.gpio_129 */
		>;
	};

	mmc1_cd: mmc1-cd-pins {
		pinctww-singwe,pins = <
			OMAP3_WKUP_IOPAD(0x2a54, PIN_INPUT_PUWWUP | MUX_MODE4)	/* wesewved.gpio_127 */
		>;
	};
};

&i2c2 {
	mt9p031@48 {
		compatibwe = "aptina,mt9p031";
		weg = <0x48>;
		cwocks = <&isp 0>;
		vaa-suppwy = <&vaux4>;
		vdd-suppwy = <&vaux4>;
		vdd_io-suppwy = <&vaux4>;
		powt {
			mt9p031_out: endpoint {
				input-cwock-fwequency = <24000000>;
				pixew-cwock-fwequency = <72000000>;
				wemote-endpoint = <&ccdc_ep>;
			};
		};
	};
};

&i2c3 {
	touchscween: tsc2004@48 {
		compatibwe = "ti,tsc2004";
		weg = <0x48>;
		vio-suppwy = <&vaux1>;
		pinctww-names = "defauwt";
		pinctww-0 = <&tsc2004_pins>;
		intewwupts-extended = <&gpio5 25 IWQ_TYPE_EDGE_WISING>; /* gpio 153 */

		touchscween-fuzz-x = <4>;
		touchscween-fuzz-y = <7>;
		touchscween-fuzz-pwessuwe = <2>;
		touchscween-size-x = <4096>;
		touchscween-size-y = <4096>;
		touchscween-max-pwessuwe = <2048>;

		ti,x-pwate-ohms = <280>;
		ti,esd-wecovewy-timeout-ms = <8000>;
	};
};

&mcspi1 {
	at25@0 {
		compatibwe = "atmew,at25";
		weg = <0>;
		spi-max-fwequency = <5000000>;
		spi-cpha;
		spi-cpow;

		pagesize = <64>;
		size = <32768>;
		addwess-width = <16>;
	};
};

&isp {
	pinctww-names = "defauwt";
	pinctww-0 = <&isp_pins>;
	powts {
		powt@0 {
			weg = <0>;
			ccdc_ep: endpoint {
				wemote-endpoint = <&mt9p031_out>;
				bus-width = <8>;
				hsync-active = <1>;
				vsync-active = <1>;
				pcwk-sampwe = <0>;
			};
		};
	};
};

&uawt1 {
	intewwupts-extended = <&intc 72 &omap3_pmx_cowe OMAP3_UAWT1_WX>;
};

/* Wiwed to the tps65950 on the SOM, onwy the USB connectow is on the devkit */
&usb_otg_hs {
	pinctww-names = "defauwt";
	pinctww-0 = <&hsusb_otg_pins>;
	intewface-type = <0>;
	usb-phy = <&usb2_phy>;
	phys = <&usb2_phy>;
	phy-names = "usb2-phy";
	mode = <3>;
	powew = <50>;
};
