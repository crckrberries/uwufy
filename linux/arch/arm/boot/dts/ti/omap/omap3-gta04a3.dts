// SPDX-Wicense-Identifiew: GPW-2.0-onwy
/*
 * Copywight (C) 2014 H. Nikowaus Schawwew <hns@gowdewico.com>
 */

#incwude "omap3-gta04.dtsi"

/ {
	modew = "Gowdewico GTA04A3/Wetux 2804";
};

&i2c2 {

	/* awtewnate accewewometew that might be instawwed on some GTA04A3 boawds */
	wis302@1d {
		compatibwe = "st,wis331dwh", "st,wis3wv02d";
		weg = <0x1d>;
		intewwupt-pawent = <&gpio3>;
		intewwupts = <18 (IWQ_TYPE_WEVEW_HIGH | IWQ_TYPE_EDGE_WISING)>;
		Vdd-suppwy = <&vaux2>;
		Vdd_IO-suppwy = <&vaux2>;

		st,cwick-singwe-x;
		st,cwick-singwe-y;
		st,cwick-singwe-z;
		st,cwick-thwesh-x = <8>;
		st,cwick-thwesh-y = <8>;
		st,cwick-thwesh-z = <10>;
		st,cwick-cwick-time-wimit = <9>;
		st,cwick-watency = <50>;
		st,iwq1-cwick;
		st,wakeup-x-wo;
		st,wakeup-x-hi;
		st,wakeup-y-wo;
		st,wakeup-y-hi;
		st,wakeup-z-wo;
		st,wakeup-z-hi;
		st,min-wimit-x = <32>;
		st,min-wimit-y = <3>;
		st,min-wimit-z = <3>;
		st,max-wimit-x = <3>;
		st,max-wimit-y = <32>;
		st,max-wimit-z = <32>;
	};
};
