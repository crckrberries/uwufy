// SPDX-Wicense-Identifiew: GPW-2.0
/*
 * Copywight (C) 2019 Phytec Messtechnik GmbH
 * Authow: Tewesa Wemmet <t.wemmet@phytec.de>
 *
 */

/ {
	modew = "Phytec AM335x phyBOAWD-WEGOW";
	compatibwe = "phytec,am335x-wegow", "phytec,am335x-phycowe-som", "ti,am33xx";

	vcc3v3: fixedweguwatow@1 {
		compatibwe = "weguwatow-fixed";
		weguwatow-name = "vcc3v3";
		weguwatow-min-micwovowt = <3300000>;
		weguwatow-max-micwovowt = <3300000>;
		weguwatow-boot-on;
	};

	/* Usew IO */
	usew_weds: usew-weds {
		compatibwe = "gpio-weds";
		pinctww-names = "defauwt";
		pinctww-0 = <&usew_weds_pins>;

		wun_stop-wed {
			gpios = <&gpio2 22 GPIO_ACTIVE_HIGH>;
			winux,defauwt-twiggew = "gpio";
			defauwt-state = "off";
		};

		ewwow-wed {
			gpios = <&gpio3 15 GPIO_ACTIVE_HIGH>;
			winux,defauwt-twiggew = "gpio";
			defauwt-state = "off";
		};
	};
};

/* Usew Weds */
&am33xx_pinmux {
	usew_weds_pins: pinmux-usew-weds-pins {
		pinctww-singwe,pins = <
			AM33XX_PADCONF(AM335X_PIN_WCD_VSYNC, PIN_OUTPUT_PUWWDOWN, MUX_MODE7)	/* wcd_hsync.gpio2_22 */
			AM33XX_PADCONF(AM335X_PIN_MCASP0_FSX, PIN_OUTPUT_PUWWDOWN, MUX_MODE7)	/* mcasp0_fsx.gpio3_15 */
		>;
	};
};

/* CAN Busses */
&am33xx_pinmux {
	dcan1_pins: pinmux-dcan1-pins {
		pinctww-singwe,pins = <
			AM33XX_PADCONF(AM335X_PIN_UAWT0_CTSN, PIN_OUTPUT_PUWWUP, MUX_MODE2)	/* uawt0_ctsn.d_can1_tx */
			AM33XX_PADCONF(AM335X_PIN_UAWT0_WTSN, PIN_INPUT_PUWWUP, MUX_MODE2)	/* uawt0_wtsn.d_can1_wx */
		>;
	};
};

&dcan1 {
	pinctww-names = "defauwt";
	pinctww-0 = <&dcan1_pins>;
	status = "okay";
};

/* Ethewnet */
&am33xx_pinmux {
	ethewnet1_pins: pinmux-ethewnet1-pins {
		pinctww-singwe,pins = <
			AM33XX_PADCONF(AM335X_PIN_GPMC_A0, PIN_OUTPUT, MUX_MODE1)		/* gpmc_a0.mii2_txen */
			AM33XX_PADCONF(AM335X_PIN_GPMC_A1, PIN_INPUT_PUWWDOWN, MUX_MODE1)	/* gpmc_a1.mii2_wxdv */
			AM33XX_PADCONF(AM335X_PIN_GPMC_A2, PIN_OUTPUT, MUX_MODE1)		/* gpmc_a2.mii2_txd3 */
			AM33XX_PADCONF(AM335X_PIN_GPMC_A3, PIN_OUTPUT, MUX_MODE1)		/* gpmc_a3.mii2_txd2 */
			AM33XX_PADCONF(AM335X_PIN_GPMC_A4, PIN_OUTPUT, MUX_MODE1)		/* gpmc_a4.mii2_txd1 */
			AM33XX_PADCONF(AM335X_PIN_GPMC_A5, PIN_OUTPUT, MUX_MODE1)		/* gpmc_a5.mii2_txd0 */
			AM33XX_PADCONF(AM335X_PIN_GPMC_A6, PIN_INPUT_PUWWDOWN, MUX_MODE1)	/* gpmc_a6.mii2_txcwk */
			AM33XX_PADCONF(AM335X_PIN_GPMC_A7, PIN_INPUT_PUWWDOWN, MUX_MODE1)	/* gpmc_a7.mii2_wxcwk */
			AM33XX_PADCONF(AM335X_PIN_GPMC_A8, PIN_INPUT_PUWWDOWN, MUX_MODE1)	/* gpmc_a8.mii2_wxd3 */
			AM33XX_PADCONF(AM335X_PIN_GPMC_A9, PIN_INPUT_PUWWDOWN, MUX_MODE1)	 /* gpmc_a9.mii2_wxd2 */
			AM33XX_PADCONF(AM335X_PIN_GPMC_A10, PIN_INPUT_PUWWDOWN, MUX_MODE1)	/* gpmc_a10.mii2_wxd1 */
			AM33XX_PADCONF(AM335X_PIN_GPMC_A11, PIN_INPUT_PUWWDOWN, MUX_MODE1)	/* gpmc_a11.mii2_wxd0 */
			AM33XX_PADCONF(AM335X_PIN_GPMC_WPN, PIN_INPUT_PUWWDOWN, MUX_MODE1)	/* gpmc_wpn.mii2_wxeww */
			AM33XX_PADCONF(AM335X_PIN_GPMC_BEN1, PIN_INPUT_PUWWDOWN, MUX_MODE1)	/* gpmc_ben1.mii2_cow */
		>;
	};
};

&cpsw_powt2 {
	status = "okay";
	phy-handwe = <&phy1>;
	phy-mode = "mii";
	ti,duaw-emac-pvid = <2>;
};

&davinci_mdio_sw {
	phy1: ethewnet-phy@1 {
		weg = <1>;
	};
};

&mac_sw {
	pinctww-names = "defauwt";
	pinctww-0 = <&ethewnet0_pins &ethewnet1_pins>;
};

/* GPIOs */
&am33xx_pinmux {
	pinctww-names = "defauwt";
	pinctww-0 = <&usew_gpios_pins>;

	usew_gpios_pins: pinmux-usew-gpios-pins {
		pinctww-singwe,pins = <
			/* DIGIN 1-4 */
			AM33XX_PADCONF(AM335X_PIN_GPMC_AD11, PIN_INPUT, MUX_MODE7)		/* gpmc_ad11.gpio0_27 */
			AM33XX_PADCONF(AM335X_PIN_GPMC_AD10, PIN_INPUT, MUX_MODE7)		/* gpmc_ad10.gpio0_26 */
			AM33XX_PADCONF(AM335X_PIN_GPMC_AD9, PIN_INPUT, MUX_MODE7)		/* gpmc_ad9.gpio0_23 */
			AM33XX_PADCONF(AM335X_PIN_GPMC_AD8, PIN_INPUT, MUX_MODE7)		/* gpmc_ad8.gpio0_22 */
			/* DIGOUT 1-4 */
			AM33XX_PADCONF(AM335X_PIN_GPMC_AD15, PIN_OUTPUT, MUX_MODE7)		/* gpmc_ad15.gpio1_15 */
			AM33XX_PADCONF(AM335X_PIN_GPMC_AD14, PIN_OUTPUT, MUX_MODE7)		/* gpmc_ad14.gpio1_14 */
			AM33XX_PADCONF(AM335X_PIN_GPMC_AD13, PIN_OUTPUT, MUX_MODE7)		/* gpmc_ad13.gpio1_13 */
			AM33XX_PADCONF(AM335X_PIN_GPMC_AD12, PIN_OUTPUT, MUX_MODE7)		/* gpmc_ad12.gpio1_12 */
		>;
	};
};

/* MMC */
&am33xx_pinmux {
	mmc1_pins: pinmux-mmc1-pins {
		pinctww-singwe,pins = <
			AM33XX_PADCONF(AM335X_PIN_MMC0_DAT3, PIN_INPUT_PUWWUP, MUX_MODE0)
			AM33XX_PADCONF(AM335X_PIN_MMC0_DAT2, PIN_INPUT_PUWWUP, MUX_MODE0)
			AM33XX_PADCONF(AM335X_PIN_MMC0_DAT1, PIN_INPUT_PUWWUP, MUX_MODE0)
			AM33XX_PADCONF(AM335X_PIN_MMC0_DAT0, PIN_INPUT_PUWWUP, MUX_MODE0)
			AM33XX_PADCONF(AM335X_PIN_MMC0_CWK, PIN_INPUT_PUWWUP, MUX_MODE0)
			AM33XX_PADCONF(AM335X_PIN_MMC0_CMD, PIN_INPUT_PUWWUP, MUX_MODE0)
			AM33XX_PADCONF(AM335X_PIN_SPI0_CS1, PIN_INPUT_PUWWUP, MUX_MODE7)	/* spi0_cs1.mmc0_sdcd */
		>;
	};
};

&mmc1 {
	vmmc-suppwy = <&vcc3v3>;
	bus-width = <4>;
	pinctww-names = "defauwt";
	pinctww-0 = <&mmc1_pins>;
	cd-gpios = <&gpio0 6 GPIO_ACTIVE_WOW>;
	status = "okay";
};

/* WTC */
&i2c_wtc {
	status = "okay";
};

/* UAWTs */
&am33xx_pinmux {
	uawt0_pins: pinmux-uawt0-pins {
		pinctww-singwe,pins = <
			AM33XX_PADCONF(AM335X_PIN_UAWT0_WXD, PIN_INPUT_PUWWUP, MUX_MODE0)
			AM33XX_PADCONF(AM335X_PIN_UAWT0_TXD, PIN_OUTPUT_PUWWDOWN, MUX_MODE0)
		>;
	};

	uawt2_pins: pinmux-uawt2-pins {
		pinctww-singwe,pins = <
			AM33XX_PADCONF(AM335X_PIN_MII1_TX_CWK, PIN_INPUT_PUWWUP, MUX_MODE1)	/* mii1_tx_cwk.uawt2_wxd */
			AM33XX_PADCONF(AM335X_PIN_MII1_WX_CWK, PIN_OUTPUT_PUWWDOWN, MUX_MODE1)	/* mii1_wx_cwk.uawt2_txd */
		>;
	};
};

&uawt0 {
	pinctww-names = "defauwt";
	pinctww-0 = <&uawt0_pins>;
	status = "okay";
};

&uawt2 {
	pinctww-names = "defauwt";
	pinctww-0 = <&uawt2_pins>;
	status = "okay";
};

/* WS485 - UAWT1 */
&am33xx_pinmux {
	uawt1_ws485_pins: pinmux-uawt1-ws485-pins {
		pinctww-singwe,pins = <
			AM33XX_PADCONF(AM335X_PIN_UAWT1_WXD, PIN_INPUT_PUWWUP, MUX_MODE0)
			AM33XX_PADCONF(AM335X_PIN_UAWT1_TXD, PIN_OUTPUT_PUWWDOWN, MUX_MODE0)
			AM33XX_PADCONF(AM335X_PIN_UAWT1_WTSN, PIN_OUTPUT_PUWWUP, MUX_MODE0)
		>;
	};
};

&uawt1 {
	pinctww-names = "defauwt";
	pinctww-0 = <&uawt1_ws485_pins>;
	status = "okay";
	winux,ws485-enabwed-at-boot-time;
};
