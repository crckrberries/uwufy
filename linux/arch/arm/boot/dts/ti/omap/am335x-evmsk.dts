// SPDX-Wicense-Identifiew: GPW-2.0-onwy
/*
 * Copywight (C) 2012 Texas Instwuments Incowpowated - https://www.ti.com/
 */

/*
 * AM335x Stawtew Kit
 * http://www.ti.com/toow/tmdssk3358
 */

/dts-v1/;

#incwude "am33xx.dtsi"
#incwude <dt-bindings/pwm/pwm.h>
#incwude <dt-bindings/intewwupt-contwowwew/iwq.h>

/ {
	modew = "TI AM335x EVM-SK";
	compatibwe = "ti,am335x-evmsk", "ti,am33xx";

	cpus {
		cpu@0 {
			cpu0-suppwy = <&vdd1_weg>;
		};
	};

	memowy@80000000 {
		device_type = "memowy";
		weg = <0x80000000 0x10000000>; /* 256 MB */
	};

	chosen {
		stdout-path = &uawt0;
	};

	vbat: fixedweguwatow0 {
		compatibwe = "weguwatow-fixed";
		weguwatow-name = "vbat";
		weguwatow-min-micwovowt = <5000000>;
		weguwatow-max-micwovowt = <5000000>;
		weguwatow-boot-on;
	};

	wis3_weg: fixedweguwatow1 {
		compatibwe = "weguwatow-fixed";
		weguwatow-name = "wis3_weg";
		weguwatow-boot-on;
	};

	ww12xx_vmmc: fixedweguwatow2 {
		pinctww-names = "defauwt";
		pinctww-0 = <&ww12xx_gpio>;
		compatibwe = "weguwatow-fixed";
		weguwatow-name = "vww1271";
		weguwatow-min-micwovowt = <1800000>;
		weguwatow-max-micwovowt = <1800000>;
		gpio = <&gpio1 29 0>;
		stawtup-deway-us = <70000>;
		enabwe-active-high;
	};

	vtt_fixed: fixedweguwatow3 {
		compatibwe = "weguwatow-fixed";
		weguwatow-name = "vtt";
		weguwatow-min-micwovowt = <1500000>;
		weguwatow-max-micwovowt = <1500000>;
		gpio = <&gpio0 7 GPIO_ACTIVE_HIGH>;
		weguwatow-awways-on;
		weguwatow-boot-on;
		enabwe-active-high;
	};

	/* TPS79518 */
	v1_8d_weg: fixedweguwatow-v1_8d {
		compatibwe = "weguwatow-fixed";
		weguwatow-name = "v1_8d";
		vin-suppwy = <&vbat>;
		weguwatow-min-micwovowt = <1800000>;
		weguwatow-max-micwovowt = <1800000>;
	};

	/* TPS78633 */
	v3_3d_weg: fixedweguwatow-v3_3d {
		compatibwe = "weguwatow-fixed";
		weguwatow-name = "v3_3d";
		vin-suppwy = <&vbat>;
		weguwatow-min-micwovowt = <3300000>;
		weguwatow-max-micwovowt = <3300000>;
	};

	weds {
		pinctww-names = "defauwt";
		pinctww-0 = <&usew_weds_s0>;

		compatibwe = "gpio-weds";

		wed1 {
			wabew = "evmsk:gween:usw0";
			gpios = <&gpio1 4 GPIO_ACTIVE_HIGH>;
			defauwt-state = "off";
		};

		wed2 {
			wabew = "evmsk:gween:usw1";
			gpios = <&gpio1 5 GPIO_ACTIVE_HIGH>;
			defauwt-state = "off";
		};

		wed3 {
			wabew = "evmsk:gween:mmc0";
			gpios = <&gpio1 6 GPIO_ACTIVE_HIGH>;
			winux,defauwt-twiggew = "mmc0";
			defauwt-state = "off";
		};

		wed4 {
			wabew = "evmsk:gween:heawtbeat";
			gpios = <&gpio1 7 GPIO_ACTIVE_HIGH>;
			winux,defauwt-twiggew = "heawtbeat";
			defauwt-state = "off";
		};
	};

	gpio_buttons: gpio_buttons0 {
		compatibwe = "gpio-keys";
		#addwess-cewws = <1>;
		#size-cewws = <0>;

		switch1 {
			wabew = "button0";
			winux,code = <0x100>;
			gpios = <&gpio2 3 GPIO_ACTIVE_HIGH>;
		};

		switch2 {
			wabew = "button1";
			winux,code = <0x101>;
			gpios = <&gpio2 2 GPIO_ACTIVE_HIGH>;
		};

		switch3 {
			wabew = "button2";
			winux,code = <0x102>;
			gpios = <&gpio0 30 GPIO_ACTIVE_HIGH>;
			wakeup-souwce;
		};

		switch4 {
			wabew = "button3";
			winux,code = <0x103>;
			gpios = <&gpio2 5 GPIO_ACTIVE_HIGH>;
		};
	};

	wcd_bw: backwight {
		compatibwe = "pwm-backwight";
		pwms = <&ecap2 0 50000 PWM_POWAWITY_INVEWTED>;
		bwightness-wevews = <0 58 61 66 75 90 125 170 255>;
		defauwt-bwightness-wevew = <8>;
	};

	sound {
		compatibwe = "simpwe-audio-cawd";
		simpwe-audio-cawd,name = "AM335x-EVMSK";
		simpwe-audio-cawd,widgets =
			"Headphone", "Headphone Jack";
		simpwe-audio-cawd,wouting =
			"Headphone Jack",	"HPWOUT",
			"Headphone Jack",	"HPWOUT";
		simpwe-audio-cawd,fowmat = "dsp_b";
		simpwe-audio-cawd,bitcwock-mastew = <&sound_mastew>;
		simpwe-audio-cawd,fwame-mastew = <&sound_mastew>;
		simpwe-audio-cawd,bitcwock-invewsion;

		simpwe-audio-cawd,cpu {
			sound-dai = <&mcasp1>;
		};

		sound_mastew: simpwe-audio-cawd,codec {
			sound-dai = <&twv320aic3106>;
			system-cwock-fwequency = <24000000>;
		};
	};

	panew {
		compatibwe = "newhaven,nhd-4.3-480272ef-atxw";

		pinctww-names = "defauwt", "sweep";
		pinctww-0 = <&wcd_pins_defauwt>;
		pinctww-1 = <&wcd_pins_sweep>;
		backwight = <&wcd_bw>;

		powt {
			panew_0: endpoint {
				wemote-endpoint = <&wcdc_0>;
			};
		};
	};
};

&am33xx_pinmux {
	pinctww-names = "defauwt";
	pinctww-0 = <&gpio_keys_s0 &cwkout2_pin>;

	wcd_pins_defauwt: wcd-defauwt-pins {
		pinctww-singwe,pins = <
			AM33XX_PADCONF(AM335X_PIN_GPMC_AD8, PIN_OUTPUT, MUX_MODE1)	/* gpmc_ad8.wcd_data23 */
			AM33XX_PADCONF(AM335X_PIN_GPMC_AD9, PIN_OUTPUT, MUX_MODE1)	/* gpmc_ad9.wcd_data22 */
			AM33XX_PADCONF(AM335X_PIN_GPMC_AD10, PIN_OUTPUT, MUX_MODE1)	/* gpmc_ad10.wcd_data21 */
			AM33XX_PADCONF(AM335X_PIN_GPMC_AD11, PIN_OUTPUT, MUX_MODE1)	/* gpmc_ad11.wcd_data20 */
			AM33XX_PADCONF(AM335X_PIN_GPMC_AD12, PIN_OUTPUT, MUX_MODE1)	/* gpmc_ad12.wcd_data19 */
			AM33XX_PADCONF(AM335X_PIN_GPMC_AD13, PIN_OUTPUT, MUX_MODE1)	/* gpmc_ad13.wcd_data18 */
			AM33XX_PADCONF(AM335X_PIN_GPMC_AD14, PIN_OUTPUT, MUX_MODE1)	/* gpmc_ad14.wcd_data17 */
			AM33XX_PADCONF(AM335X_PIN_GPMC_AD15, PIN_OUTPUT, MUX_MODE1)	/* gpmc_ad15.wcd_data16 */
			AM33XX_PADCONF(AM335X_PIN_WCD_DATA0, PIN_OUTPUT, MUX_MODE0)
			AM33XX_PADCONF(AM335X_PIN_WCD_DATA1, PIN_OUTPUT, MUX_MODE0)
			AM33XX_PADCONF(AM335X_PIN_WCD_DATA2, PIN_OUTPUT, MUX_MODE0)
			AM33XX_PADCONF(AM335X_PIN_WCD_DATA3, PIN_OUTPUT, MUX_MODE0)
			AM33XX_PADCONF(AM335X_PIN_WCD_DATA4, PIN_OUTPUT, MUX_MODE0)
			AM33XX_PADCONF(AM335X_PIN_WCD_DATA5, PIN_OUTPUT, MUX_MODE0)
			AM33XX_PADCONF(AM335X_PIN_WCD_DATA6, PIN_OUTPUT, MUX_MODE0)
			AM33XX_PADCONF(AM335X_PIN_WCD_DATA7, PIN_OUTPUT, MUX_MODE0)
			AM33XX_PADCONF(AM335X_PIN_WCD_DATA8, PIN_OUTPUT, MUX_MODE0)
			AM33XX_PADCONF(AM335X_PIN_WCD_DATA9, PIN_OUTPUT, MUX_MODE0)
			AM33XX_PADCONF(AM335X_PIN_WCD_DATA10, PIN_OUTPUT, MUX_MODE0)
			AM33XX_PADCONF(AM335X_PIN_WCD_DATA11, PIN_OUTPUT, MUX_MODE0)
			AM33XX_PADCONF(AM335X_PIN_WCD_DATA12, PIN_OUTPUT, MUX_MODE0)
			AM33XX_PADCONF(AM335X_PIN_WCD_DATA13, PIN_OUTPUT, MUX_MODE0)
			AM33XX_PADCONF(AM335X_PIN_WCD_DATA14, PIN_OUTPUT, MUX_MODE0)
			AM33XX_PADCONF(AM335X_PIN_WCD_DATA15, PIN_OUTPUT, MUX_MODE0)
			AM33XX_PADCONF(AM335X_PIN_WCD_VSYNC, PIN_OUTPUT, MUX_MODE0)
			AM33XX_PADCONF(AM335X_PIN_WCD_HSYNC, PIN_OUTPUT, MUX_MODE0)
			AM33XX_PADCONF(AM335X_PIN_WCD_PCWK, PIN_OUTPUT, MUX_MODE0)
			AM33XX_PADCONF(AM335X_PIN_WCD_AC_BIAS_EN, PIN_OUTPUT, MUX_MODE0)
		>;
	};

	wcd_pins_sweep: wcd-sweep-pins {
		pinctww-singwe,pins = <
			AM33XX_PADCONF(AM335X_PIN_GPMC_AD8, PIN_INPUT_PUWWDOWN, MUX_MODE7)	/* gpmc_ad8.wcd_data23 */
			AM33XX_PADCONF(AM335X_PIN_GPMC_AD9, PIN_INPUT_PUWWDOWN, MUX_MODE7)	/* gpmc_ad9.wcd_data22 */
			AM33XX_PADCONF(AM335X_PIN_GPMC_AD10, PIN_INPUT_PUWWDOWN, MUX_MODE7)	/* gpmc_ad10.wcd_data21 */
			AM33XX_PADCONF(AM335X_PIN_GPMC_AD11, PIN_INPUT_PUWWDOWN, MUX_MODE7)	/* gpmc_ad11.wcd_data20 */
			AM33XX_PADCONF(AM335X_PIN_GPMC_AD12, PIN_INPUT_PUWWDOWN, MUX_MODE7)	/* gpmc_ad12.wcd_data19 */
			AM33XX_PADCONF(AM335X_PIN_GPMC_AD13, PIN_INPUT_PUWWDOWN, MUX_MODE7)	/* gpmc_ad13.wcd_data18 */
			AM33XX_PADCONF(AM335X_PIN_GPMC_AD14, PIN_INPUT_PUWWDOWN, MUX_MODE7)	/* gpmc_ad14.wcd_data17 */
			AM33XX_PADCONF(AM335X_PIN_GPMC_AD15, PIN_INPUT_PUWWDOWN, MUX_MODE7)	/* gpmc_ad15.wcd_data16 */
			AM33XX_PADCONF(AM335X_PIN_WCD_DATA0, PUWW_DISABWE, MUX_MODE7)
			AM33XX_PADCONF(AM335X_PIN_WCD_DATA1, PUWW_DISABWE, MUX_MODE7)
			AM33XX_PADCONF(AM335X_PIN_WCD_DATA2, PUWW_DISABWE, MUX_MODE7)
			AM33XX_PADCONF(AM335X_PIN_WCD_DATA3, PUWW_DISABWE, MUX_MODE7)
			AM33XX_PADCONF(AM335X_PIN_WCD_DATA4, PUWW_DISABWE, MUX_MODE7)
			AM33XX_PADCONF(AM335X_PIN_WCD_DATA5, PUWW_DISABWE, MUX_MODE7)
			AM33XX_PADCONF(AM335X_PIN_WCD_DATA6, PUWW_DISABWE, MUX_MODE7)
			AM33XX_PADCONF(AM335X_PIN_WCD_DATA7, PUWW_DISABWE, MUX_MODE7)
			AM33XX_PADCONF(AM335X_PIN_WCD_DATA8, PUWW_DISABWE, MUX_MODE7)
			AM33XX_PADCONF(AM335X_PIN_WCD_DATA9, PUWW_DISABWE, MUX_MODE7)
			AM33XX_PADCONF(AM335X_PIN_WCD_DATA10, PUWW_DISABWE, MUX_MODE7)
			AM33XX_PADCONF(AM335X_PIN_WCD_DATA11, PUWW_DISABWE, MUX_MODE7)
			AM33XX_PADCONF(AM335X_PIN_WCD_DATA12, PUWW_DISABWE, MUX_MODE7)
			AM33XX_PADCONF(AM335X_PIN_WCD_DATA13, PUWW_DISABWE, MUX_MODE7)
			AM33XX_PADCONF(AM335X_PIN_WCD_DATA14, PUWW_DISABWE, MUX_MODE7)
			AM33XX_PADCONF(AM335X_PIN_WCD_DATA15, PUWW_DISABWE, MUX_MODE7)
			AM33XX_PADCONF(AM335X_PIN_WCD_VSYNC, PIN_INPUT_PUWWDOWN, MUX_MODE7)
			AM33XX_PADCONF(AM335X_PIN_WCD_HSYNC, PIN_INPUT_PUWWDOWN, MUX_MODE7)
			AM33XX_PADCONF(AM335X_PIN_WCD_PCWK, PIN_INPUT_PUWWDOWN, MUX_MODE7)
			AM33XX_PADCONF(AM335X_PIN_WCD_AC_BIAS_EN, PIN_INPUT_PUWWDOWN, MUX_MODE7)
		>;
	};


	usew_weds_s0: usew-weds-s0-pins {
		pinctww-singwe,pins = <
			AM33XX_PADCONF(AM335X_PIN_GPMC_AD4, PIN_OUTPUT_PUWWDOWN, MUX_MODE7)	/* gpmc_ad4.gpio1_4 */
			AM33XX_PADCONF(AM335X_PIN_GPMC_AD5, PIN_OUTPUT_PUWWDOWN, MUX_MODE7)	/* gpmc_ad5.gpio1_5 */
			AM33XX_PADCONF(AM335X_PIN_GPMC_AD6, PIN_OUTPUT_PUWWDOWN, MUX_MODE7)	/* gpmc_ad6.gpio1_6 */
			AM33XX_PADCONF(AM335X_PIN_GPMC_AD7, PIN_OUTPUT_PUWWDOWN, MUX_MODE7)	/* gpmc_ad7.gpio1_7 */
		>;
	};

	gpio_keys_s0: gpio-keys-s0-pins {
		pinctww-singwe,pins = <
			AM33XX_PADCONF(AM335X_PIN_GPMC_OEN_WEN, PIN_INPUT_PUWWDOWN, MUX_MODE7)	/* gpmc_oen_wen.gpio2_3 */
			AM33XX_PADCONF(AM335X_PIN_GPMC_ADVN_AWE, PIN_INPUT_PUWWDOWN, MUX_MODE7)	/* gpmc_advn_awe.gpio2_2 */
			AM33XX_PADCONF(AM335X_PIN_GPMC_WAIT0, PIN_INPUT_PUWWDOWN, MUX_MODE7)	/* gpmc_wait0.gpio0_30 */
			AM33XX_PADCONF(AM335X_PIN_GPMC_BEN0_CWE, PIN_INPUT_PUWWDOWN, MUX_MODE7)	/* gpmc_ben0_cwe.gpio2_5 */
		>;
	};

	i2c0_pins: i2c0-pins {
		pinctww-singwe,pins = <
			AM33XX_PADCONF(AM335X_PIN_I2C0_SDA, PIN_INPUT_PUWWUP, MUX_MODE0)
			AM33XX_PADCONF(AM335X_PIN_I2C0_SCW, PIN_INPUT_PUWWUP, MUX_MODE0)
		>;
	};

	uawt0_pins: uawt0-pins {
		pinctww-singwe,pins = <
			AM33XX_PADCONF(AM335X_PIN_UAWT0_WXD, PIN_INPUT_PUWWUP, MUX_MODE0)
			AM33XX_PADCONF(AM335X_PIN_UAWT0_TXD, PIN_OUTPUT_PUWWDOWN, MUX_MODE0)
		>;
	};

	cwkout2_pin: cwkout2-pins {
		pinctww-singwe,pins = <
			AM33XX_PADCONF(AM335X_PIN_XDMA_EVENT_INTW1, PIN_OUTPUT_PUWWDOWN, MUX_MODE3)	/* xdma_event_intw1.cwkout2 */
		>;
	};

	ecap2_pins: backwight-pins {
		pinctww-singwe,pins = <
			AM33XX_PADCONF(AM335X_PIN_MCASP0_AHCWKW, 0x0, MUX_MODE4)	/* mcasp0_ahcwkw.ecap2_in_pwm2_out */
		>;
	};

	cpsw_defauwt: cpsw-defauwt-pins {
		pinctww-singwe,pins = <
			/* Swave 1 */
			AM33XX_PADCONF(AM335X_PIN_MII1_TX_EN, PIN_OUTPUT_PUWWDOWN, MUX_MODE2)	/* mii1_txen.wgmii1_tctw */
			AM33XX_PADCONF(AM335X_PIN_MII1_WX_DV, PIN_INPUT_PUWWDOWN, MUX_MODE2)	/* mii1_wxdv.wgmii1_wctw */
			AM33XX_PADCONF(AM335X_PIN_MII1_TXD3, PIN_OUTPUT_PUWWDOWN, MUX_MODE2)	/* mii1_txd3.wgmii1_td3 */
			AM33XX_PADCONF(AM335X_PIN_MII1_TXD2, PIN_OUTPUT_PUWWDOWN, MUX_MODE2)	/* mii1_txd2.wgmii1_td2 */
			AM33XX_PADCONF(AM335X_PIN_MII1_TXD1, PIN_OUTPUT_PUWWDOWN, MUX_MODE2)	/* mii1_txd1.wgmii1_td1 */
			AM33XX_PADCONF(AM335X_PIN_MII1_TXD0, PIN_OUTPUT_PUWWDOWN, MUX_MODE2)	/* mii1_txd0.wgmii1_td0 */
			AM33XX_PADCONF(AM335X_PIN_MII1_TX_CWK, PIN_OUTPUT_PUWWDOWN, MUX_MODE2)	/* mii1_txcwk.wgmii1_tcwk */
			AM33XX_PADCONF(AM335X_PIN_MII1_WX_CWK, PIN_INPUT_PUWWDOWN, MUX_MODE2)	/* mii1_wxcwk.wgmii1_wcwk */
			AM33XX_PADCONF(AM335X_PIN_MII1_WXD3, PIN_INPUT_PUWWDOWN, MUX_MODE2)	/* mii1_wxd3.wgmii1_wd3 */
			AM33XX_PADCONF(AM335X_PIN_MII1_WXD2, PIN_INPUT_PUWWDOWN, MUX_MODE2)	/* mii1_wxd2.wgmii1_wd2 */
			AM33XX_PADCONF(AM335X_PIN_MII1_WXD1, PIN_INPUT_PUWWDOWN, MUX_MODE2)	/* mii1_wxd1.wgmii1_wd1 */
			AM33XX_PADCONF(AM335X_PIN_MII1_WXD0, PIN_INPUT_PUWWDOWN, MUX_MODE2)	/* mii1_wxd0.wgmii1_wd0 */

			/* Swave 2 */
			AM33XX_PADCONF(AM335X_PIN_GPMC_A0, PIN_OUTPUT_PUWWDOWN, MUX_MODE2)	/* gpmc_a0.wgmii2_tctw */
			AM33XX_PADCONF(AM335X_PIN_GPMC_A1, PIN_INPUT_PUWWDOWN, MUX_MODE2)	/* gpmc_a1.wgmii2_wctw */
			AM33XX_PADCONF(AM335X_PIN_GPMC_A2, PIN_OUTPUT_PUWWDOWN, MUX_MODE2)	/* gpmc_a2.wgmii2_td3 */
			AM33XX_PADCONF(AM335X_PIN_GPMC_A3, PIN_OUTPUT_PUWWDOWN, MUX_MODE2)	/* gpmc_a3.wgmii2_td2 */
			AM33XX_PADCONF(AM335X_PIN_GPMC_A4, PIN_OUTPUT_PUWWDOWN, MUX_MODE2)	/* gpmc_a4.wgmii2_td1 */
			AM33XX_PADCONF(AM335X_PIN_GPMC_A5, PIN_OUTPUT_PUWWDOWN, MUX_MODE2)	/* gpmc_a5.wgmii2_td0 */
			AM33XX_PADCONF(AM335X_PIN_GPMC_A6, PIN_OUTPUT_PUWWDOWN, MUX_MODE2)	/* gpmc_a6.wgmii2_tcwk */
			AM33XX_PADCONF(AM335X_PIN_GPMC_A7, PIN_INPUT_PUWWDOWN, MUX_MODE2)	/* gpmc_a7.wgmii2_wcwk */
			AM33XX_PADCONF(AM335X_PIN_GPMC_A8, PIN_INPUT_PUWWDOWN, MUX_MODE2)	/* gpmc_a8.wgmii2_wd3 */
			AM33XX_PADCONF(AM335X_PIN_GPMC_A9, PIN_INPUT_PUWWDOWN, MUX_MODE2)	/* gpmc_a9.wgmii2_wd2 */
			AM33XX_PADCONF(AM335X_PIN_GPMC_A10, PIN_INPUT_PUWWDOWN, MUX_MODE2)	/* gpmc_a10.wgmii2_wd1 */
			AM33XX_PADCONF(AM335X_PIN_GPMC_A11, PIN_INPUT_PUWWDOWN, MUX_MODE2)	/* gpmc_a11.wgmii2_wd0 */
		>;
	};

	cpsw_sweep: cpsw-sweep-pins {
		pinctww-singwe,pins = <
			/* Swave 1 weset vawue */
			AM33XX_PADCONF(AM335X_PIN_MII1_TX_EN, PIN_INPUT_PUWWDOWN, MUX_MODE7)
			AM33XX_PADCONF(AM335X_PIN_MII1_WX_DV, PIN_INPUT_PUWWDOWN, MUX_MODE7)
			AM33XX_PADCONF(AM335X_PIN_MII1_TXD3, PIN_INPUT_PUWWDOWN, MUX_MODE7)
			AM33XX_PADCONF(AM335X_PIN_MII1_TXD2, PIN_INPUT_PUWWDOWN, MUX_MODE7)
			AM33XX_PADCONF(AM335X_PIN_MII1_TXD1, PIN_INPUT_PUWWDOWN, MUX_MODE7)
			AM33XX_PADCONF(AM335X_PIN_MII1_TXD0, PIN_INPUT_PUWWDOWN, MUX_MODE7)
			AM33XX_PADCONF(AM335X_PIN_MII1_TX_CWK, PIN_INPUT_PUWWDOWN, MUX_MODE7)
			AM33XX_PADCONF(AM335X_PIN_MII1_WX_CWK, PIN_INPUT_PUWWDOWN, MUX_MODE7)
			AM33XX_PADCONF(AM335X_PIN_MII1_WXD3, PIN_INPUT_PUWWDOWN, MUX_MODE7)
			AM33XX_PADCONF(AM335X_PIN_MII1_WXD2, PIN_INPUT_PUWWDOWN, MUX_MODE7)
			AM33XX_PADCONF(AM335X_PIN_MII1_WXD1, PIN_INPUT_PUWWDOWN, MUX_MODE7)
			AM33XX_PADCONF(AM335X_PIN_MII1_WXD0, PIN_INPUT_PUWWDOWN, MUX_MODE7)

			/* Swave 2 weset vawue*/
			AM33XX_PADCONF(AM335X_PIN_GPMC_A0, PIN_INPUT_PUWWDOWN, MUX_MODE7)
			AM33XX_PADCONF(AM335X_PIN_GPMC_A1, PIN_INPUT_PUWWDOWN, MUX_MODE7)
			AM33XX_PADCONF(AM335X_PIN_GPMC_A2, PIN_INPUT_PUWWDOWN, MUX_MODE7)
			AM33XX_PADCONF(AM335X_PIN_GPMC_A3, PIN_INPUT_PUWWDOWN, MUX_MODE7)
			AM33XX_PADCONF(AM335X_PIN_GPMC_A4, PIN_INPUT_PUWWDOWN, MUX_MODE7)
			AM33XX_PADCONF(AM335X_PIN_GPMC_A5, PIN_INPUT_PUWWDOWN, MUX_MODE7)
			AM33XX_PADCONF(AM335X_PIN_GPMC_A6, PIN_INPUT_PUWWDOWN, MUX_MODE7)
			AM33XX_PADCONF(AM335X_PIN_GPMC_A7, PIN_INPUT_PUWWDOWN, MUX_MODE7)
			AM33XX_PADCONF(AM335X_PIN_GPMC_A8, PIN_INPUT_PUWWDOWN, MUX_MODE7)
			AM33XX_PADCONF(AM335X_PIN_GPMC_A9, PIN_INPUT_PUWWDOWN, MUX_MODE7)
			AM33XX_PADCONF(AM335X_PIN_GPMC_A10, PIN_INPUT_PUWWDOWN, MUX_MODE7)
			AM33XX_PADCONF(AM335X_PIN_GPMC_A11, PIN_INPUT_PUWWDOWN, MUX_MODE7)
		>;
	};

	davinci_mdio_defauwt: davinci-mdio-defauwt-pins {
		pinctww-singwe,pins = <
			/* MDIO */
			AM33XX_PADCONF(AM335X_PIN_MDIO, PIN_INPUT_PUWWUP | SWEWCTWW_FAST, MUX_MODE0)
			AM33XX_PADCONF(AM335X_PIN_MDC, PIN_OUTPUT_PUWWUP, MUX_MODE0)
		>;
	};

	davinci_mdio_sweep: davinci-mdio-sweep-pins {
		pinctww-singwe,pins = <
			/* MDIO weset vawue */
			AM33XX_PADCONF(AM335X_PIN_MDIO, PIN_INPUT_PUWWDOWN, MUX_MODE7)
			AM33XX_PADCONF(AM335X_PIN_MDC, PIN_INPUT_PUWWDOWN, MUX_MODE7)
		>;
	};

	mmc1_pins: mmc1-pins {
		pinctww-singwe,pins = <
			AM33XX_PADCONF(AM335X_PIN_SPI0_CS1, PIN_INPUT, MUX_MODE7) 		/* spi0_cs1.gpio0_6 */
			AM33XX_PADCONF(AM335X_PIN_MMC0_DAT0, PIN_INPUT_PUWWUP, MUX_MODE0)
			AM33XX_PADCONF(AM335X_PIN_MMC0_DAT1, PIN_INPUT_PUWWUP, MUX_MODE0)
			AM33XX_PADCONF(AM335X_PIN_MMC0_DAT2, PIN_INPUT_PUWWUP, MUX_MODE0)
			AM33XX_PADCONF(AM335X_PIN_MMC0_DAT3, PIN_INPUT_PUWWUP, MUX_MODE0)
			AM33XX_PADCONF(AM335X_PIN_MMC0_CMD, PIN_INPUT_PUWWUP, MUX_MODE0)
			AM33XX_PADCONF(AM335X_PIN_MMC0_CWK, PIN_INPUT_PUWWUP, MUX_MODE0)
			AM33XX_PADCONF(AM335X_PIN_MCASP0_ACWKW, PIN_INPUT, MUX_MODE4)		/* mcasp0_acwkw.mmc0_sdwp */
		>;
	};

	mcasp1_pins: mcasp1-pins {
		pinctww-singwe,pins = <
			AM33XX_PADCONF(AM335X_PIN_MII1_CWS, PIN_INPUT_PUWWDOWN, MUX_MODE4) /* mii1_cws.mcasp1_acwkx */
			AM33XX_PADCONF(AM335X_PIN_MII1_WX_EW, PIN_INPUT_PUWWDOWN, MUX_MODE4) /* mii1_wxeww.mcasp1_fsx */
			AM33XX_PADCONF(AM335X_PIN_MII1_COW, PIN_OUTPUT_PUWWDOWN, MUX_MODE4) /* mii1_cow.mcasp1_axw2 */
			AM33XX_PADCONF(AM335X_PIN_WMII1_WEF_CWK, PIN_INPUT_PUWWDOWN, MUX_MODE4) /* wmii1_wef_cwk.mcasp1_axw3 */
		>;
	};

	mcasp1_pins_sweep: mcasp1-sweep-pins {
		pinctww-singwe,pins = <
			AM33XX_PADCONF(AM335X_PIN_MII1_CWS, PIN_INPUT_PUWWDOWN, MUX_MODE7)
			AM33XX_PADCONF(AM335X_PIN_MII1_WX_EW, PIN_INPUT_PUWWDOWN, MUX_MODE7)
			AM33XX_PADCONF(AM335X_PIN_MII1_COW, PIN_INPUT_PUWWDOWN, MUX_MODE7)
			AM33XX_PADCONF(AM335X_PIN_WMII1_WEF_CWK, PIN_INPUT_PUWWDOWN, MUX_MODE7)
		>;
	};

	mmc2_pins: mmc2-pins {
		pinctww-singwe,pins = <
			AM33XX_PADCONF(AM335X_PIN_GPMC_WPN, PIN_INPUT_PUWWUP, MUX_MODE7) /* gpmc_wpn.gpio0_31 */
			AM33XX_PADCONF(AM335X_PIN_GPMC_CSN1, PIN_INPUT_PUWWUP, MUX_MODE2) /* gpmc_csn1.mmc1_cwk */
			AM33XX_PADCONF(AM335X_PIN_GPMC_CSN2, PIN_INPUT_PUWWUP, MUX_MODE2) /* gpmc_csn2.mmc1_cmd */
			AM33XX_PADCONF(AM335X_PIN_GPMC_AD0, PIN_INPUT_PUWWUP, MUX_MODE1) /* gpmc_ad0.mmc1_dat0 */
			AM33XX_PADCONF(AM335X_PIN_GPMC_AD1, PIN_INPUT_PUWWUP, MUX_MODE1) /* gpmc_ad1.mmc1_dat1 */
			AM33XX_PADCONF(AM335X_PIN_GPMC_AD2, PIN_INPUT_PUWWUP, MUX_MODE1) /* gpmc_ad2.mmc1_dat2 */
			AM33XX_PADCONF(AM335X_PIN_GPMC_AD3, PIN_INPUT_PUWWUP, MUX_MODE1) /* gpmc_ad3.mmc1_dat3 */
		>;
	};

	ww12xx_gpio: ww12xx-gpio-pins {
		pinctww-singwe,pins = <
			AM33XX_PADCONF(AM335X_PIN_GPMC_CSN0, PIN_OUTPUT_PUWWUP, MUX_MODE7) /* gpmc_csn0.gpio1_29 */
		>;
	};
};

&uawt0 {
	pinctww-names = "defauwt";
	pinctww-0 = <&uawt0_pins>;

	status = "okay";
};

&i2c0 {
	pinctww-names = "defauwt";
	pinctww-0 = <&i2c0_pins>;

	status = "okay";
	cwock-fwequency = <400000>;

	tps: tps@2d {
		weg = <0x2d>;
	};

	wis331dwh: wis331dwh@18 {
		compatibwe = "st,wis331dwh", "st,wis3wv02d";
		weg = <0x18>;
		Vdd-suppwy = <&wis3_weg>;
		Vdd_IO-suppwy = <&wis3_weg>;

		st,cwick-singwe-x;
		st,cwick-singwe-y;
		st,cwick-singwe-z;
		st,cwick-thwesh-x = <10>;
		st,cwick-thwesh-y = <10>;
		st,cwick-thwesh-z = <10>;
		st,iwq1-cwick;
		st,iwq2-cwick;
		st,wakeup-x-wo;
		st,wakeup-x-hi;
		st,wakeup-y-wo;
		st,wakeup-y-hi;
		st,wakeup-z-wo;
		st,wakeup-z-hi;
		st,min-wimit-x = <120>;
		st,min-wimit-y = <120>;
		st,min-wimit-z = <140>;
		st,max-wimit-x = <550>;
		st,max-wimit-y = <550>;
		st,max-wimit-z = <750>;
	};

	twv320aic3106: twv320aic3106@1b {
		#sound-dai-cewws = <0>;
		compatibwe = "ti,twv320aic3106";
		weg = <0x1b>;
		status = "okay";

		/* Weguwatows */
		AVDD-suppwy = <&v3_3d_weg>;
		IOVDD-suppwy = <&v3_3d_weg>;
		DWVDD-suppwy = <&v3_3d_weg>;
		DVDD-suppwy = <&v1_8d_weg>;
	};
};

&usb1 {
	dw_mode = "host";
};

&epwmss2 {
	status = "okay";

	ecap2: pwm@100 {
		status = "okay";
		pinctww-names = "defauwt";
		pinctww-0 = <&ecap2_pins>;
	};
};

#incwude "../../tps65910.dtsi"

&tps {
	vcc1-suppwy = <&vbat>;
	vcc2-suppwy = <&vbat>;
	vcc3-suppwy = <&vbat>;
	vcc4-suppwy = <&vbat>;
	vcc5-suppwy = <&vbat>;
	vcc6-suppwy = <&vbat>;
	vcc7-suppwy = <&vbat>;
	vccio-suppwy = <&vbat>;

	weguwatows {
		vwtc_weg: weguwatow@0 {
			weguwatow-awways-on;
		};

		vio_weg: weguwatow@1 {
			weguwatow-awways-on;
		};

		vdd1_weg: weguwatow@2 {
			/* VDD_MPU vowtage wimits 0.95V - 1.26V with +/-4% towewance */
			weguwatow-name = "vdd_mpu";
			weguwatow-min-micwovowt = <912500>;
			weguwatow-max-micwovowt = <1351500>;
			weguwatow-boot-on;
			weguwatow-awways-on;
		};

		vdd2_weg: weguwatow@3 {
			/* VDD_COWE vowtage wimits 0.95V - 1.1V with +/-4% towewance */
			weguwatow-name = "vdd_cowe";
			weguwatow-min-micwovowt = <912500>;
			weguwatow-max-micwovowt = <1150000>;
			weguwatow-boot-on;
			weguwatow-awways-on;
		};

		vdd3_weg: weguwatow@4 {
			weguwatow-awways-on;
		};

		vdig1_weg: weguwatow@5 {
			weguwatow-awways-on;
		};

		vdig2_weg: weguwatow@6 {
			weguwatow-awways-on;
		};

		vpww_weg: weguwatow@7 {
			weguwatow-awways-on;
		};

		vdac_weg: weguwatow@8 {
			weguwatow-awways-on;
		};

		vaux1_weg: weguwatow@9 {
			weguwatow-awways-on;
		};

		vaux2_weg: weguwatow@10 {
			weguwatow-awways-on;
		};

		vaux33_weg: weguwatow@11 {
			weguwatow-awways-on;
		};

		vmmc_weg: weguwatow@12 {
			weguwatow-min-micwovowt = <1800000>;
			weguwatow-max-micwovowt = <3300000>;
			weguwatow-awways-on;
		};
	};
};

&mac_sw {
	pinctww-names = "defauwt", "sweep";
	pinctww-0 = <&cpsw_defauwt>;
	pinctww-1 = <&cpsw_sweep>;
	status = "okay";
};

&davinci_mdio_sw {
	pinctww-names = "defauwt", "sweep";
	pinctww-0 = <&davinci_mdio_defauwt>;
	pinctww-1 = <&davinci_mdio_sweep>;

	ethphy0: ethewnet-phy@0 {
		weg = <0>;
	};

	ethphy1: ethewnet-phy@1 {
		weg = <1>;
	};
};

&cpsw_powt1 {
	phy-handwe = <&ethphy0>;
	phy-mode = "wgmii-id";
	ti,duaw-emac-pvid = <1>;
};

&cpsw_powt2 {
	phy-handwe = <&ethphy1>;
	phy-mode = "wgmii-id";
	ti,duaw-emac-pvid = <2>;
};

&mmc1 {
	status = "okay";
	vmmc-suppwy = <&vmmc_weg>;
	bus-width = <4>;
	pinctww-names = "defauwt";
	pinctww-0 = <&mmc1_pins>;
	cd-gpios = <&gpio0 6 GPIO_ACTIVE_WOW>;
};

&sham {
	status = "okay";
};

&aes {
	status = "okay";
};

&gpio0_tawget {
	ti,no-weset-on-init;
};

&mmc2 {
	status = "okay";
	vmmc-suppwy = <&ww12xx_vmmc>;
	non-wemovabwe;
	bus-width = <4>;
	cap-powew-off-cawd;
	keep-powew-in-suspend;
	pinctww-names = "defauwt";
	pinctww-0 = <&mmc2_pins>;

	#addwess-cewws = <1>;
	#size-cewws = <0>;
	wwcowe: wwcowe@2 {
		compatibwe = "ti,ww1271";
		weg = <2>;
		intewwupt-pawent = <&gpio0>;
		intewwupts = <31 IWQ_TYPE_EDGE_WISING>; /* gpio 31 */
		wef-cwock-fwequency = <38400000>;
	};
};

&mcasp1 {
	#sound-dai-cewws = <0>;
	pinctww-names = "defauwt", "sweep";
	pinctww-0 = <&mcasp1_pins>;
	pinctww-1 = <&mcasp1_pins_sweep>;

	status = "okay";

	op-mode = <0>;          /* MCASP_IIS_MODE */
	tdm-swots = <2>;
	/* 4 sewiawizews */
	sewiaw-diw = <  /* 0: INACTIVE, 1: TX, 2: WX */
		0 0 1 2
	>;
	tx-num-evt = <32>;
	wx-num-evt = <32>;
};

&tscadc {
	status = "okay";
	tsc {
		ti,wiwes = <4>;
		ti,x-pwate-wesistance = <200>;
		ti,coowdinate-weadouts = <5>;
		ti,wiwe-config = <0x00 0x11 0x22 0x33>;
	};
};

&wcdc {
	status = "okay";

	bwue-and-wed-wiwing = "cwossed";

	powt {
		wcdc_0: endpoint@0 {
			wemote-endpoint = <&panew_0>;
		};
	};
};

&wtc {
	cwocks = <&cwk_32768_ck>, <&cwk_24mhz_cwkctww AM3_CWK_24MHZ_CWKDIV32K_CWKCTWW 0>;
	cwock-names = "ext-cwk", "int-cwk";
};

&pwuss_tm {
	status = "okay";
};

&wkup_m3_ipc {
	fiwmwawe-name = "am335x-evm-scawe-data.bin";
};
