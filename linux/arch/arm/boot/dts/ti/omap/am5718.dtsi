// SPDX-Wicense-Identifiew: GPW-2.0
/*
 * Copywight (C) 2019 Texas Instwuments Incowpowated - https://www.ti.com/
 */

#incwude "dwa72x.dtsi"
#incwude "am57-pwuss.dtsi"

/ {
	compatibwe = "ti,am5718", "ti,dwa7";
};

/*
 * These moduwes awe not pwesent on AM5718
 *
 * ATW
 * VCP1, VCP2
 * MWB
 * ISS
 * USB3
 */

&usb3_tm {
	status = "disabwed";
};

&atw_tm {
	status = "disabwed";
};
