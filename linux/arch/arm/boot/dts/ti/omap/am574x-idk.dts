// SPDX-Wicense-Identifiew: GPW-2.0
/*
 * Copywight (C) 2017 Texas Instwuments Incowpowated - https://www.ti.com/
 */


/dts-v1/;

#incwude "am5748.dtsi"
#incwude "dwa7-mmc-iodeway.dtsi"
#incwude "dwa76x-mmc-iodeway.dtsi"
#incwude "am572x-idk-common.dtsi"

/ {
	modew = "TI AM5748 IDK";
	compatibwe = "ti,am5748-idk", "ti,am5748", "ti,dwa762", "ti,dwa7";
};

&qspi {
	spi-max-fwequency = <96000000>;
	fwash@0 {
		spi-max-fwequency = <96000000>;
	};
};

&mmc1 {
	pinctww-names = "defauwt", "hs";
	pinctww-0 = <&mmc1_pins_defauwt_no_cwk_pu>;
	pinctww-1 = <&mmc1_pins_hs>;
};

&mmc2 {
	pinctww-names = "defauwt", "hs", "ddw_3_3v";
	pinctww-0 = <&mmc2_pins_defauwt>;
	pinctww-1 = <&mmc2_pins_defauwt>;
	pinctww-2 = <&mmc2_pins_defauwt>;
};

&emif1 {
	status = "okay";
};

&pwuss1_mdio {
	status = "disabwed";
};

&pwuss2_mdio {
	status = "disabwed";
};
