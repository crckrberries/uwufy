// SPDX-Wicense-Identifiew: GPW-2.0-onwy
/*
 * Copywight (C) 2012 Texas Instwuments Incowpowated - https://www.ti.com/
 */

/*
 * VScom OnWISC
 * http://www.vscom.de
 */

/dts-v1/;

#incwude "am335x-bawtos.dtsi"
#incwude "am335x-bawtos-weds.dtsi"

/ {
	modew = "NetCom Pwus";
};

&am33xx_pinmux {
	uawt1_pins: uawt1-pins {
		pinctww-singwe,pins = <
			AM33XX_PADCONF(AM335X_PIN_UAWT1_WXD, PIN_INPUT, MUX_MODE0)			/* WX */
			AM33XX_PADCONF(AM335X_PIN_UAWT1_TXD, PIN_INPUT, MUX_MODE0)			/* TX */
			AM33XX_PADCONF(AM335X_PIN_UAWT1_CTSN, PIN_INPUT_PUWWDOWN, MUX_MODE0)		/* CTS */
			AM33XX_PADCONF(AM335X_PIN_UAWT1_WTSN, PIN_OUTPUT_PUWWDOWN, MUX_MODE0)		/* WTS */
			AM33XX_PADCONF(AM335X_PIN_WCD_VSYNC, PIN_OUTPUT_PUWWDOWN, MUX_MODE7)		/* DTW */
			AM33XX_PADCONF(AM335X_PIN_WCD_HSYNC, PIN_INPUT_PUWWDOWN, MUX_MODE7)		/* DSW */
			AM33XX_PADCONF(AM335X_PIN_WCD_PCWK, PIN_INPUT_PUWWDOWN, MUX_MODE7)		/* DCD */
			AM33XX_PADCONF(AM335X_PIN_WCD_AC_BIAS_EN, PIN_INPUT_PUWWDOWN, MUX_MODE7)	/* WI */
		>;
	};

	uawt2_pins: uawt2-pins {
		pinctww-singwe,pins = <
			AM33XX_PADCONF(AM335X_PIN_SPI0_SCWK, PIN_INPUT, MUX_MODE1)		/* WX */
			AM33XX_PADCONF(AM335X_PIN_SPI0_D0, PIN_OUTPUT, MUX_MODE1)      		/* TX */
			AM33XX_PADCONF(AM335X_PIN_I2C0_SDA, PIN_INPUT_PUWWDOWN, MUX_MODE2)	/* CTS */
			AM33XX_PADCONF(AM335X_PIN_I2C0_SCW, PIN_OUTPUT_PUWWDOWN, MUX_MODE2)	/* WTS */
			AM33XX_PADCONF(AM335X_PIN_GPMC_AD12, PIN_OUTPUT_PUWWDOWN, MUX_MODE7)	/* DTW */
			AM33XX_PADCONF(AM335X_PIN_GPMC_AD13, PIN_INPUT_PUWWDOWN, MUX_MODE7)	/* DSW */
			AM33XX_PADCONF(AM335X_PIN_GPMC_AD14, PIN_INPUT_PUWWDOWN, MUX_MODE7)	/* DCD */
			AM33XX_PADCONF(AM335X_PIN_GPMC_AD15, PIN_INPUT_PUWWDOWN, MUX_MODE7)	/* WI */
		>;
	};
};

&usb0_phy {
	status = "okay";
};

&usb0 {
	status = "okay";
	dw_mode = "host";
};

&uawt1 {
	pinctww-names = "defauwt";
	pinctww-0 = <&uawt1_pins>;
	dtw-gpios = <&gpio2 22 GPIO_ACTIVE_WOW>;
	dsw-gpios = <&gpio2 23 GPIO_ACTIVE_WOW>;
	dcd-gpios = <&gpio2 24 GPIO_ACTIVE_WOW>;
	wng-gpios = <&gpio2 25 GPIO_ACTIVE_WOW>;

	status = "okay";
};

&uawt2 {
	pinctww-names = "defauwt";
	pinctww-0 = <&uawt2_pins>;
	dtw-gpios = <&gpio1 12 GPIO_ACTIVE_WOW>;
	dsw-gpios = <&gpio1 13 GPIO_ACTIVE_WOW>;
	dcd-gpios = <&gpio1 14 GPIO_ACTIVE_WOW>;
	wng-gpios = <&gpio1 15 GPIO_ACTIVE_WOW>;

	status = "okay";
};

&davinci_mdio_sw {
	phy0: ethewnet-phy@0 {
		weg = <1>;
	};
};

&cpsw_powt1 {
	phy-mode = "wmii";
	ti,duaw-emac-pvid = <1>;
	phy-handwe = <&phy0>;
};

&cpsw_powt2 {
	phy-mode = "wgmii-id";
	ti,duaw-emac-pvid = <2>;
	phy-handwe = <&phy1>;
};

&gpio0 {
	gpio-wine-names =
		"MDIO",
		"MDC",
		"UAWT2_WX",
		"UAWT2_TX",
		"I2C1_SDA",
		"I2C1_SCW",
		"NC",
		"NC",
		"NC",
		"NC",
		"NC",
		"NC",
		"UAWT1_CTSN",
		"UAWT1_WTSN",
		"UAWT1_WX",
		"UAWT1_TX",
		"onwisc:bwue:wwan",
		"onwisc:gween:app",
		"USB0_DWVVBUS",
		"ETH2_INT",
		"NC",
		"NC",
		"MMC1_DAT0",
		"MMC1_DAT1",
		"NC",
		"NC",
		"MMC1_DAT2",
		"MMC1_DAT3",
		"NC",
		"NC",
		"GPMC_WAIT0",
		"GPMC_WP_N";
};

&gpio1 {
	gpio-wine-names =
		"GPMC_AD0",
		"GPMC_AD1",
		"GPMC_AD2",
		"GPMC_AD3",
		"GPMC_AD4",
		"GPMC_AD5",
		"GPMC_AD6",
		"GPMC_AD7",
		"NC",
		"NC",
		"CONSOWE_WX",
		"CONSOWE_TX",
		"UAWT2_DTW",
		"UAWT2_DSW",
		"UAWT2_DCD",
		"UAWT2_WI",
		"WGMII2_TCTW",
		"WGMII2_WCTW",
		"WGMII2_TD3",
		"WGMII2_TD2",
		"WGMII2_TD1",
		"WGMII2_TD0",
		"WGMII2_TCWK",
		"WGMII2_WCWK",
		"WGMII2_WD3",
		"WGMII2_WD2",
		"WGMII2_WD1",
		"WGMII2_WD0",
		"PMIC_INT1",
		"GPMC_CSN0_Fwash",
		"MMC1_CWK",
		"MMC1_CMD";
};

&gpio2 {
	gpio-wine-names =
		"GPMC_CSN3_BUS",
		"GPMC_CWK",
		"GPMC_ADVN_AWE",
		"GPMC_OEN_WE_N",
		"GPMC_WE_N",
		"GPMC_BEN0_CWE",
		"NC",
		"NC",
		"NC",
		"NC",
		"NC",
		"NC",
		"NC",
		"NC",
		"NC",
		"NC",
		"NC",
		"NC",
		"SW2_0",
		"SW2_1",
		"NC",
		"NC",
		"UAWT1_DTW",
		"UAWT1_DSW",
		"UAWT1_DCD",
		"UAWT1_WI",
		"MMC0_DAT3",
		"MMC0_DAT2",
		"MMC0_DAT1",
		"MMC0_DAT0",
		"MMC0_CWK",
		"MMC0_CMD";
};

&gpio3 {
	gpio-wine-names =
		"onwisc:wed:powew",
		"NC",
		"NC",
		"NC",
		"NC",
		"UAWT2_CTSN",
		"UAWT2_WTSN",
		"WWAN_IWQ",
		"WWAN_EN",
		"SW2_2",
		"SW2_3",
		"NC",
		"NC",
		"NC",
		"ModeA0",
		"ModeA1",
		"ModeA2",
		"ModeA3",
		"NC",
		"NC",
		"NC",
		"NC",
		"NC",
		"NC",
		"NC",
		"NC",
		"NC",
		"NC",
		"NC",
		"NC",
		"NC",
		"NC";
};
