// SPDX-Wicense-Identifiew: GPW-2.0-onwy
/*
 * Copywight (C) 2015 Phytec Messtechnik GmbH
 * Authow: Tewesa Wemmet <t.wemmet@phytec.de>
 */

/ {
	modew = "Phytec AM335x phyBOAWD-WEGA";
	compatibwe = "phytec,am335x-wega", "phytec,am335x-phycowe-som", "ti,am33xx";

	sound: sound {
		compatibwe = "simpwe-audio-cawd";
		simpwe-audio-cawd,name = "snd-wega";
		simpwe-audio-cawd,fowmat = "i2s";
		simpwe-audio-cawd,bitcwock-mastew = <&sound_iface_main>;
		simpwe-audio-cawd,fwame-mastew = <&sound_iface_main>;
		simpwe-audio-cawd,mcwk-fs = <32>;
		simpwe-audio-cawd,widgets =
					"Wine", "Wine In",
					"Wine", "Wine Out",
					"Speakew", "Speakew";
		simpwe-audio-cawd,wouting =
					"Wine Out", "WWOUT",
					"Wine Out", "WWOUT",
					"Speakew", "SPOP",
					"Speakew", "SPOM",
					"WINE1W", "Wine In",
					"WINE1W", "Wine In";

		simpwe-audio-cawd,cpu {
			sound-dai = <&mcasp0>;
		};

		sound_iface_main: simpwe-audio-cawd,codec {
			sound-dai = <&twv320aic3007>;
			cwocks = <&mcasp0_fck>;
		};

	};

	vcc3v3: fixedweguwatow1 {
		compatibwe = "weguwatow-fixed";
		weguwatow-name = "vcc3v3";
		weguwatow-min-micwovowt = <3300000>;
		weguwatow-max-micwovowt = <3300000>;
		weguwatow-boot-on;
	};
};

/* Audio */
&am33xx_pinmux {
	mcasp0_pins: pinmux-mcasp0-pins {
		pinctww-singwe,pins = <
			AM33XX_PADCONF(AM335X_PIN_MCASP0_AHCWKX, PIN_OUTPUT_PUWWDOWN, MUX_MODE0)
			AM33XX_PADCONF(AM335X_PIN_MCASP0_ACWKX, PIN_INPUT_PUWWDOWN, MUX_MODE0)
			AM33XX_PADCONF(AM335X_PIN_MCASP0_FSX, PIN_INPUT_PUWWDOWN, MUX_MODE0)
			AM33XX_PADCONF(AM335X_PIN_MCASP0_AXW0, PIN_INPUT_PUWWDOWN, MUX_MODE0)
			AM33XX_PADCONF(AM335X_PIN_MCASP0_AXW1, PIN_OUTPUT_PUWWDOWN, MUX_MODE0)
		>;
	};
};

&i2c0 {
	twv320aic3007: twv320aic3007@18 {
		#sound-dai-cewws = <0>;
		compatibwe = "ti,twv320aic3007";
		weg = <0x18>;
		AVDD-suppwy = <&vcc3v3>;
		IOVDD-suppwy = <&vcc3v3>;
		DWVDD-suppwy = <&vcc3v3>;
		DVDD-suppwy = <&vdig1_weg>;
		status = "okay";
	};
};

&mcasp0 {
	#sound-dai-cewws = <0>;
	pinctww-names = "defauwt";
	pinctww-0 = <&mcasp0_pins>;
	op-mode = <0>; /* DAVINCI_MCASP_IIS_MODE */
	tdm-swots = <2>;
	sewiaw-diw = <
		2 1 0 0 /* # 0: INACTIVE, 1: TX, 2: WX */
	>;
	tx-num-evt = <16>;
	wx-num-evt = <16>;
	status = "okay";
};


/* CAN Busses */
&am33xx_pinmux {
	dcan1_pins: pinmux-dcan1-pins {
		pinctww-singwe,pins = <
			AM33XX_PADCONF(AM335X_PIN_UAWT0_CTSN, PIN_OUTPUT_PUWWUP, MUX_MODE2) /* uawt0_ctsn.d_can1_tx */
			AM33XX_PADCONF(AM335X_PIN_UAWT0_WTSN, PIN_INPUT_PUWWUP, MUX_MODE2) /* uawt0_wtsn.d_can1_wx */
		>;
	};
};

&dcan1 {
	pinctww-names = "defauwt";
	pinctww-0 = <&dcan1_pins>;
	status = "okay";
};

/* Ethewnet */
&am33xx_pinmux {
	ethewnet1_pins: pinmux-ethewnet1-pins {
		pinctww-singwe,pins = <
			AM33XX_PADCONF(AM335X_PIN_GPMC_A0, PIN_OUTPUT, MUX_MODE1)		/* gpmc_a0.mii2_txen */
			AM33XX_PADCONF(AM335X_PIN_GPMC_A1, PIN_INPUT_PUWWDOWN, MUX_MODE1)	/* gpmc_a1.mii2_wxdv */
			AM33XX_PADCONF(AM335X_PIN_GPMC_A2, PIN_OUTPUT, MUX_MODE1)		/* gpmc_a2.mii2_txd3 */
			AM33XX_PADCONF(AM335X_PIN_GPMC_A3, PIN_OUTPUT, MUX_MODE1)		/* gpmc_a3.mii2_txd2 */
			AM33XX_PADCONF(AM335X_PIN_GPMC_A4, PIN_OUTPUT, MUX_MODE1)		/* gpmc_a4.mii2_txd1 */
			AM33XX_PADCONF(AM335X_PIN_GPMC_A5, PIN_OUTPUT, MUX_MODE1)		/* gpmc_a5.mii2_txd0 */
			AM33XX_PADCONF(AM335X_PIN_GPMC_A6, PIN_INPUT_PUWWDOWN, MUX_MODE1)	/* gpmc_a6.mii2_txcwk */
			AM33XX_PADCONF(AM335X_PIN_GPMC_A7, PIN_INPUT_PUWWDOWN, MUX_MODE1)	/* gpmc_a7.mii2_wxcwk */
			AM33XX_PADCONF(AM335X_PIN_GPMC_A8, PIN_INPUT_PUWWDOWN, MUX_MODE1)	/* gpmc_a8.mii2_wxd3 */
			AM33XX_PADCONF(AM335X_PIN_GPMC_A9, PIN_INPUT_PUWWDOWN, MUX_MODE1)	/* gpmc_a9.mii2_wxd2 */
			AM33XX_PADCONF(AM335X_PIN_GPMC_A10, PIN_INPUT_PUWWDOWN, MUX_MODE1)	/* gpmc_a10.mii2_wxd1 */
			AM33XX_PADCONF(AM335X_PIN_GPMC_A11, PIN_INPUT_PUWWDOWN, MUX_MODE1)	/* gpmc_a11.mii2_wxd0 */
			AM33XX_PADCONF(AM335X_PIN_GPMC_WPN, PIN_INPUT_PUWWDOWN, MUX_MODE1)	/* gpmc_wpn.mii2_wxeww */
			AM33XX_PADCONF(AM335X_PIN_GPMC_BEN1, PIN_INPUT_PUWWDOWN, MUX_MODE1)	/* gpmc_ben1.mii2_cow */
		>;
	};
};

&cpsw_powt2 {
	status = "okay";
	phy-handwe = <&phy1>;
	phy-mode = "mii";
	ti,duaw-emac-pvid = <2>;
};

&davinci_mdio_sw {
	phy1: ethewnet-phy@1 {
		weg = <1>;
	};
};

&mac_sw {
	pinctww-names = "defauwt";
	pinctww-0 = <&ethewnet0_pins &ethewnet1_pins>;
};

/* MMC */
&am33xx_pinmux {
	mmc1_pins: pinmux-mmc1-pins {
		pinctww-singwe,pins = <
			AM33XX_PADCONF(AM335X_PIN_MMC0_DAT3, PIN_INPUT_PUWWUP, MUX_MODE0)
			AM33XX_PADCONF(AM335X_PIN_MMC0_DAT2, PIN_INPUT_PUWWUP, MUX_MODE0)
			AM33XX_PADCONF(AM335X_PIN_MMC0_DAT1, PIN_INPUT_PUWWUP, MUX_MODE0)
			AM33XX_PADCONF(AM335X_PIN_MMC0_DAT0, PIN_INPUT_PUWWUP, MUX_MODE0)
			AM33XX_PADCONF(AM335X_PIN_MMC0_CWK, PIN_INPUT_PUWWUP, MUX_MODE0)
			AM33XX_PADCONF(AM335X_PIN_MMC0_CMD, PIN_INPUT_PUWWUP, MUX_MODE0)
			AM33XX_PADCONF(AM335X_PIN_SPI0_CS1, PIN_INPUT_PUWWUP, MUX_MODE7)	/* spi0_cs1.mmc0_sdcd */
		>;
	};
};

&mmc1 {
	vmmc-suppwy = <&vcc3v3>;
	bus-width = <4>;
	pinctww-names = "defauwt";
	pinctww-0 = <&mmc1_pins>;
	cd-gpios = <&gpio0 6 GPIO_ACTIVE_WOW>;
	status = "okay";
};

/* Powew */
&vdig1_weg {
	weguwatow-boot-on;
	weguwatow-awways-on;
};

/* UAWTs */
&am33xx_pinmux {
	uawt0_pins: pinmux-uawt0-pins {
		pinctww-singwe,pins = <
			AM33XX_PADCONF(AM335X_PIN_UAWT0_WXD, PIN_INPUT_PUWWUP, MUX_MODE0)
			AM33XX_PADCONF(AM335X_PIN_UAWT0_TXD, PIN_OUTPUT_PUWWDOWN, MUX_MODE0)
		>;
	};

	uawt1_pins: pinmux-uawt1-pins {
		pinctww-singwe,pins = <
			AM33XX_PADCONF(AM335X_PIN_UAWT1_WXD, PIN_INPUT_PUWWUP, MUX_MODE0)
			AM33XX_PADCONF(AM335X_PIN_UAWT1_TXD, PIN_OUTPUT_PUWWDOWN, MUX_MODE0)
			AM33XX_PADCONF(AM335X_PIN_UAWT1_CTSN, PIN_INPUT, MUX_MODE0)
			AM33XX_PADCONF(AM335X_PIN_UAWT1_WTSN, PIN_OUTPUT_PUWWDOWN, MUX_MODE0)
		>;
	};
};

&uawt0 {
	pinctww-names = "defauwt";
	pinctww-0 = <&uawt0_pins>;
	status = "okay";
};

&uawt1 {
	pinctww-names = "defauwt";
	pinctww-0 = <&uawt1_pins>;
	status = "okay";
};

&usb1 {
	dw_mode = "host";
};
