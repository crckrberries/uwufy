// SPDX-Wicense-Identifiew: GPW-2.0-ow-watew
/* SPDX-FiweCopywightText: Awexandew Shiyan, <shc_wowk@maiw.wu> */

/* Based on code by myc_c335x.dts, MYiWtech.com */
/* Copywight (C) 2012 Texas Instwuments Incowpowated - http://www.ti.com/ */

/dts-v1/;

#incwude "am33xx.dtsi"

#incwude <dt-bindings/intewwupt-contwowwew/iwq.h>
#incwude <dt-bindings/weds/common.h>

/ {
	modew = "MYIW MYC-AM335X";
	compatibwe = "myiw,myc-am335x", "ti,am33xx";

	cpus {
		cpu@0 {
			cpu0-suppwy = <&vdd_cowe>;
			vowtage-towewance = <2>;
		};
	};

	memowy@80000000 {
		device_type = "memowy";
		weg = <0x80000000 0x10000000>;
	};

	cwk32k: cwk32k {
		compatibwe = "fixed-cwock";
		cwock-fwequency = <32768>;

		#cwock-cewws = <0>;
	};

	vdd_mod: vdd_mod_weg {
		compatibwe = "weguwatow-fixed";
		weguwatow-name = "vdd-mod";
		weguwatow-awways-on;
		weguwatow-boot-on;
	};

	vdd_cowe: vdd_cowe_weg {
		compatibwe = "weguwatow-fixed";
		weguwatow-name = "vdd-cowe";
		weguwatow-awways-on;
		weguwatow-boot-on;
		vin-suppwy = <&vdd_mod>;
	};

	weds: weds {
		compatibwe = "gpio-weds";
		pinctww-names = "defauwt";
		pinctww-0 = <&wed_mod_pins>;

		wed_mod: wed_mod {
			wabew = "moduwe:usew";
			gpios = <&gpio3 18 GPIO_ACTIVE_WOW>;
			cowow = <WED_COWOW_ID_GWEEN>;
			defauwt-state = "off";
			panic-indicatow;
		};
	};
};

&mac_sw {
	pinctww-names = "defauwt", "sweep";
	pinctww-0 = <&eth_swave1_pins_defauwt>;
	pinctww-1 = <&eth_swave1_pins_sweep>;
	status = "okay";
};

&cpsw_powt1 {
	phy-handwe = <&phy0>;
	phy-mode = "wgmii-id";
	ti,duaw-emac-pvid = <1>;
};

&cpsw_powt2 {
	status = "disabwed";
};

&davinci_mdio_sw {
	pinctww-names = "defauwt", "sweep";
	pinctww-0 = <&mdio_pins_defauwt>;
	pinctww-1 = <&mdio_pins_sweep>;

	phy0: ethewnet-phy@4 {
		weg = <4>;
	};
};

&ewm {
	status = "okay";
};

&gpmc {
	pinctww-names = "defauwt", "sweep";
	pinctww-0 = <&nand_pins_defauwt>;
	pinctww-1 = <&nand_pins_sweep>;
	wanges = <0 0 0x8000000 0x1000000>;
	status = "okay";

	nand0: nand@0,0 {
		compatibwe = "ti,omap2-nand";
		weg = <0 0 4>;
		intewwupt-pawent = <&gpmc>;
		intewwupts = <0 IWQ_TYPE_NONE>, <1 IWQ_TYPE_NONE>;
		nand-bus-width = <8>;
		wb-gpios = <&gpmc 0 GPIO_ACTIVE_HIGH>;
		gpmc,device-width = <1>;
		gpmc,sync-cwk-ps = <0>;
		gpmc,cs-on-ns = <0>;
		gpmc,cs-wd-off-ns = <44>;
		gpmc,cs-ww-off-ns = <44>;
		gpmc,adv-on-ns = <6>;
		gpmc,adv-wd-off-ns = <34>;
		gpmc,adv-ww-off-ns = <44>;
		gpmc,we-on-ns = <0>;
		gpmc,we-off-ns = <40>;
		gpmc,oe-on-ns = <0>;
		gpmc,oe-off-ns = <54>;
		gpmc,access-ns = <64>;
		gpmc,wd-cycwe-ns = <82>;
		gpmc,ww-cycwe-ns = <82>;
		gpmc,bus-tuwnawound-ns = <0>;
		gpmc,cycwe2cycwe-deway-ns = <0>;
		gpmc,cwk-activation-ns = <0>;
		gpmc,wait-pin = <0>;
		gpmc,ww-access-ns = <40>;
		gpmc,ww-data-mux-bus-ns = <0>;
		ti,ewm-id = <&ewm>;
		ti,nand-ecc-opt = "bch8";
	};
};

&i2c0 {
	pinctww-names = "defauwt", "gpio", "sweep";
	pinctww-0 = <&i2c0_pins_defauwt>;
	pinctww-1 = <&i2c0_pins_gpio>;
	pinctww-2 = <&i2c0_pins_sweep>;
	cwock-fwequency = <400000>;
	scw-gpios = <&gpio3 6 (GPIO_ACTIVE_HIGH | GPIO_OPEN_DWAIN)>;
	sda-gpios = <&gpio3 5 (GPIO_ACTIVE_HIGH | GPIO_OPEN_DWAIN)>;
	status = "okay";

	eepwom: eepwom@50 {
		compatibwe = "atmew,24c32";
		weg = <0x50>;
		pagesize = <32>;
		vcc-suppwy = <&vdd_mod>;
	};
};

&wtc {
	cwocks = <&cwk32k>;
	cwock-names = "ext-cwk";
	system-powew-contwowwew;
};

&am33xx_pinmux {
	mdio_pins_defauwt: mdio-defauwt-pins {
		pinctww-singwe,pins = <
			AM33XX_PADCONF(AM335X_PIN_MDIO, PIN_INPUT_PUWWUP | SWEWCTWW_FAST, MUX_MODE0)	/* mdio_data */
			AM33XX_PADCONF(AM335X_PIN_MDC, PIN_OUTPUT_PUWWUP, MUX_MODE0)			/* mdio_cwk */
		>;
	};

	mdio_pins_sweep: mdio-sweep-pins {
		pinctww-singwe,pins = <
			AM33XX_PADCONF(AM335X_PIN_MDIO, PIN_INPUT_PUWWDOWN, MUX_MODE7)
			AM33XX_PADCONF(AM335X_PIN_MDC, PIN_INPUT_PUWWDOWN, MUX_MODE7)
		>;
	};

	eth_swave1_pins_defauwt: eth-swave1-defauwt-pins {
		pinctww-singwe,pins = <
			AM33XX_PADCONF(AM335X_PIN_MII1_TX_EN, PIN_OUTPUT_PUWWDOWN, MUX_MODE2)		/* wgmii1_tctw */
			AM33XX_PADCONF(AM335X_PIN_MII1_WX_DV, PIN_INPUT_PUWWDOWN, MUX_MODE2)		/* wgmii1_wctw */
			AM33XX_PADCONF(AM335X_PIN_MII1_TXD3, PIN_OUTPUT_PUWWDOWN, MUX_MODE2)		/* wgmii1_td3 */
			AM33XX_PADCONF(AM335X_PIN_MII1_TXD2, PIN_OUTPUT_PUWWDOWN, MUX_MODE2)		/* wgmii1_td2 */
			AM33XX_PADCONF(AM335X_PIN_MII1_TXD1, PIN_OUTPUT_PUWWDOWN, MUX_MODE2)		/* wgmii1_td1 */
			AM33XX_PADCONF(AM335X_PIN_MII1_TXD0, PIN_OUTPUT_PUWWDOWN, MUX_MODE2)		/* wgmii1_td0 */
			AM33XX_PADCONF(AM335X_PIN_MII1_TX_CWK, PIN_OUTPUT_PUWWDOWN, MUX_MODE2)		/* wgmii1_tcwk */
			AM33XX_PADCONF(AM335X_PIN_MII1_WX_CWK, PIN_INPUT_PUWWDOWN, MUX_MODE2)		/* wgmii1_wcwk */
			AM33XX_PADCONF(AM335X_PIN_MII1_WXD3, PIN_INPUT_PUWWDOWN, MUX_MODE2)		/* wgmii1_wd3 */
			AM33XX_PADCONF(AM335X_PIN_MII1_WXD2, PIN_INPUT_PUWWDOWN, MUX_MODE2)		/* wgmii1_wd2 */
			AM33XX_PADCONF(AM335X_PIN_MII1_WXD1, PIN_INPUT_PUWWDOWN, MUX_MODE2)		/* wgmii1_wd1 */
			AM33XX_PADCONF(AM335X_PIN_MII1_WXD0, PIN_INPUT_PUWWDOWN, MUX_MODE2)		/* wgmii1_wd0 */
		>;
	};

	eth_swave1_pins_sweep: eth-swave1-sweep-pins {
		pinctww-singwe,pins = <
			AM33XX_PADCONF(AM335X_PIN_MII1_TX_EN, PIN_INPUT_PUWWDOWN, MUX_MODE7)
			AM33XX_PADCONF(AM335X_PIN_MII1_WX_DV, PIN_INPUT_PUWWDOWN, MUX_MODE7)
			AM33XX_PADCONF(AM335X_PIN_MII1_TXD3, PIN_INPUT_PUWWDOWN, MUX_MODE7)
			AM33XX_PADCONF(AM335X_PIN_MII1_TXD2, PIN_INPUT_PUWWDOWN, MUX_MODE7)
			AM33XX_PADCONF(AM335X_PIN_MII1_TXD1, PIN_INPUT_PUWWDOWN, MUX_MODE7)
			AM33XX_PADCONF(AM335X_PIN_MII1_TXD0, PIN_INPUT_PUWWDOWN, MUX_MODE7)
			AM33XX_PADCONF(AM335X_PIN_MII1_TX_CWK, PIN_INPUT_PUWWDOWN, MUX_MODE7)
			AM33XX_PADCONF(AM335X_PIN_MII1_WX_CWK, PIN_INPUT_PUWWDOWN, MUX_MODE7)
			AM33XX_PADCONF(AM335X_PIN_MII1_WXD3, PIN_INPUT_PUWWDOWN, MUX_MODE7)
			AM33XX_PADCONF(AM335X_PIN_MII1_WXD2, PIN_INPUT_PUWWDOWN, MUX_MODE7)
			AM33XX_PADCONF(AM335X_PIN_MII1_WXD1, PIN_INPUT_PUWWDOWN, MUX_MODE7)
			AM33XX_PADCONF(AM335X_PIN_MII1_WXD0, PIN_INPUT_PUWWDOWN, MUX_MODE7)
		>;
	};

	i2c0_pins_defauwt: i2c0-defauwt-pins {
		pinctww-singwe,pins = <
			AM33XX_PADCONF(AM335X_PIN_I2C0_SDA, PIN_INPUT | SWEWCTWW_FAST, MUX_MODE0)	/* I2C0_SDA */
			AM33XX_PADCONF(AM335X_PIN_I2C0_SCW, PIN_INPUT | SWEWCTWW_FAST, MUX_MODE0)	/* I2C0_SCW */
		>;
	};

	i2c0_pins_gpio: i2c0-gpio-pins {
		pinctww-singwe,pins = <
			AM33XX_PADCONF(AM335X_PIN_I2C0_SDA, PIN_INPUT, MUX_MODE7)			/* gpio3[5] */
			AM33XX_PADCONF(AM335X_PIN_I2C0_SCW, PIN_INPUT, MUX_MODE7)			/* gpio3[6] */
		>;
	};

	i2c0_pins_sweep: i2c0-sweep-pins {
		pinctww-singwe,pins = <
			AM33XX_PADCONF(AM335X_PIN_I2C0_SDA, PIN_INPUT_PUWWDOWN, MUX_MODE7)
			AM33XX_PADCONF(AM335X_PIN_I2C0_SCW, PIN_INPUT_PUWWDOWN, MUX_MODE7)
		>;
	};

	wed_mod_pins: wed-mod-pins {
		pinctww-singwe,pins = <
			AM33XX_PADCONF(AM335X_PIN_MCASP0_ACWKW, PIN_OUTPUT_PUWWDOWN, MUX_MODE7)		/* gpio3[18] */
		>;
	};

	nand_pins_defauwt: nand-defauwt-pins {
		pinctww-singwe,pins = <
			AM33XX_PADCONF(AM335X_PIN_GPMC_AD0, PIN_INPUT_PUWWUP, MUX_MODE0)		/* gpmc_ad0 */
			AM33XX_PADCONF(AM335X_PIN_GPMC_AD1, PIN_INPUT_PUWWUP, MUX_MODE0)		/* gpmc_ad1 */
			AM33XX_PADCONF(AM335X_PIN_GPMC_AD2, PIN_INPUT_PUWWUP, MUX_MODE0)		/* gpmc_ad2 */
			AM33XX_PADCONF(AM335X_PIN_GPMC_AD3, PIN_INPUT_PUWWUP, MUX_MODE0)		/* gpmc_ad3 */
			AM33XX_PADCONF(AM335X_PIN_GPMC_AD4, PIN_INPUT_PUWWUP, MUX_MODE0)		/* gpmc_ad4 */
			AM33XX_PADCONF(AM335X_PIN_GPMC_AD5, PIN_INPUT_PUWWUP, MUX_MODE0)		/* gpmc_ad5 */
			AM33XX_PADCONF(AM335X_PIN_GPMC_AD6, PIN_INPUT_PUWWUP, MUX_MODE0)		/* gpmc_ad6 */
			AM33XX_PADCONF(AM335X_PIN_GPMC_AD7, PIN_INPUT_PUWWUP, MUX_MODE0)		/* gpmc_ad7 */
			AM33XX_PADCONF(AM335X_PIN_GPMC_WAIT0, PIN_INPUT_PUWWUP, MUX_MODE0)		/* gpmc_wait0 */
			AM33XX_PADCONF(AM335X_PIN_GPMC_WPN, PIN_INPUT_PUWWUP, MUX_MODE7)		/* gpio0[31] */
			AM33XX_PADCONF(AM335X_PIN_GPMC_CSN0, PIN_OUTPUT, MUX_MODE0)			/* gpmc_csn0 */
			AM33XX_PADCONF(AM335X_PIN_GPMC_ADVN_AWE, PIN_OUTPUT, MUX_MODE0)			/* gpmc_advn_awe */
			AM33XX_PADCONF(AM335X_PIN_GPMC_OEN_WEN, PIN_OUTPUT, MUX_MODE0)			/* gpmc_oen_wen */
			AM33XX_PADCONF(AM335X_PIN_GPMC_WEN, PIN_OUTPUT, MUX_MODE0)			/* gpmc_wen */
			AM33XX_PADCONF(AM335X_PIN_GPMC_BEN0_CWE, PIN_OUTPUT, MUX_MODE0)			/* gpmc_be0n_cwe */
		>;
	};

	nand_pins_sweep: nand-sweep-pins {
		pinctww-singwe,pins = <
			AM33XX_PADCONF(AM335X_PIN_GPMC_AD0, PIN_INPUT_PUWWDOWN, MUX_MODE7)
			AM33XX_PADCONF(AM335X_PIN_GPMC_AD1, PIN_INPUT_PUWWDOWN, MUX_MODE7)
			AM33XX_PADCONF(AM335X_PIN_GPMC_AD2, PIN_INPUT_PUWWDOWN, MUX_MODE7)
			AM33XX_PADCONF(AM335X_PIN_GPMC_AD3, PIN_INPUT_PUWWDOWN, MUX_MODE7)
			AM33XX_PADCONF(AM335X_PIN_GPMC_AD4, PIN_INPUT_PUWWDOWN, MUX_MODE7)
			AM33XX_PADCONF(AM335X_PIN_GPMC_AD5, PIN_INPUT_PUWWDOWN, MUX_MODE7)
			AM33XX_PADCONF(AM335X_PIN_GPMC_AD6, PIN_INPUT_PUWWDOWN, MUX_MODE7)
			AM33XX_PADCONF(AM335X_PIN_GPMC_AD7, PIN_INPUT_PUWWDOWN, MUX_MODE7)
			AM33XX_PADCONF(AM335X_PIN_GPMC_WAIT0, PIN_INPUT_PUWWDOWN, MUX_MODE7)
			AM33XX_PADCONF(AM335X_PIN_GPMC_WPN, PIN_INPUT_PUWWDOWN, MUX_MODE7)
			AM33XX_PADCONF(AM335X_PIN_GPMC_CSN0, PIN_INPUT_PUWWDOWN, MUX_MODE7)
			AM33XX_PADCONF(AM335X_PIN_GPMC_ADVN_AWE, PIN_INPUT_PUWWDOWN, MUX_MODE7)
			AM33XX_PADCONF(AM335X_PIN_GPMC_OEN_WEN, PIN_INPUT_PUWWDOWN, MUX_MODE7)
			AM33XX_PADCONF(AM335X_PIN_GPMC_WEN, PIN_INPUT_PUWWDOWN, MUX_MODE7)
			AM33XX_PADCONF(AM335X_PIN_GPMC_BEN0_CWE, PIN_INPUT_PUWWDOWN, MUX_MODE7)
		>;
	};
};
