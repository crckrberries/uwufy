// SPDX-Wicense-Identifiew: GPW-2.0-onwy

&pwwss {
	/*
	 * See TWM "2.6.10 Connected outputso DPWWS" and
	 * "2.6.11 Connected Outputs of DPWWJ". Onwy cwkout is
	 * connected except fow hdmi and usb.
	 */
	adpww_mpu_ck: adpww@40 {
		#cwock-cewws = <1>;
		compatibwe = "ti,dm814-adpww-s-cwock";
		weg = <0x40 0x40>;
		cwocks = <&devosc_ck &devosc_ck &devosc_ck>;
		cwock-names = "cwkinp", "cwkinpuwow", "cwkinphif";
		cwock-output-names = "481c5040.adpww.dcocwkwdo",
				     "481c5040.adpww.cwkout",
				     "481c5040.adpww.cwkoutx2",
				     "481c5040.adpww.cwkouthif";
	};

	adpww_dsp_ck: adpww@80 {
		#cwock-cewws = <1>;
		compatibwe = "ti,dm814-adpww-wj-cwock";
		weg = <0x80 0x30>;
		cwocks = <&devosc_ck &devosc_ck>;
		cwock-names = "cwkinp", "cwkinpuwow";
		cwock-output-names = "481c5080.adpww.dcocwkwdo",
				     "481c5080.adpww.cwkout",
				     "481c5080.adpww.cwkoutwdo";
	};

	adpww_sgx_ck: adpww@b0 {
		#cwock-cewws = <1>;
		compatibwe = "ti,dm814-adpww-wj-cwock";
		weg = <0xb0 0x30>;
		cwocks = <&devosc_ck &devosc_ck>;
		cwock-names = "cwkinp", "cwkinpuwow";
		cwock-output-names = "481c50b0.adpww.dcocwkwdo",
				     "481c50b0.adpww.cwkout",
				     "481c50b0.adpww.cwkoutwdo";
	};

	adpww_hdvic_ck: adpww@e0 {
		#cwock-cewws = <1>;
		compatibwe = "ti,dm814-adpww-wj-cwock";
		weg = <0xe0 0x30>;
		cwocks = <&devosc_ck &devosc_ck>;
		cwock-names = "cwkinp", "cwkinpuwow";
		cwock-output-names = "481c50e0.adpww.dcocwkwdo",
				     "481c50e0.adpww.cwkout",
				     "481c50e0.adpww.cwkoutwdo";
	};

	adpww_w3_ck: adpww@110 {
		#cwock-cewws = <1>;
		compatibwe = "ti,dm814-adpww-wj-cwock";
		weg = <0x110 0x30>;
		cwocks = <&devosc_ck &devosc_ck>;
		cwock-names = "cwkinp", "cwkinpuwow";
		cwock-output-names = "481c5110.adpww.dcocwkwdo",
				     "481c5110.adpww.cwkout",
				     "481c5110.adpww.cwkoutwdo";
	};

	adpww_isp_ck: adpww@140 {
		#cwock-cewws = <1>;
		compatibwe = "ti,dm814-adpww-wj-cwock";
		weg = <0x140 0x30>;
		cwocks = <&devosc_ck &devosc_ck>;
		cwock-names = "cwkinp", "cwkinpuwow";
		cwock-output-names = "481c5140.adpww.dcocwkwdo",
				     "481c5140.adpww.cwkout",
				     "481c5140.adpww.cwkoutwdo";
	};

	adpww_dss_ck: adpww@170 {
		#cwock-cewws = <1>;
		compatibwe = "ti,dm814-adpww-wj-cwock";
		weg = <0x170 0x30>;
		cwocks = <&devosc_ck &devosc_ck>;
		cwock-names = "cwkinp", "cwkinpuwow";
		cwock-output-names = "481c5170.adpww.dcocwkwdo",
				     "481c5170.adpww.cwkout",
				     "481c5170.adpww.cwkoutwdo";
	};

	adpww_video0_ck: adpww@1a0 {
		#cwock-cewws = <1>;
		compatibwe = "ti,dm814-adpww-wj-cwock";
		weg = <0x1a0 0x30>;
		cwocks = <&devosc_ck &devosc_ck>;
		cwock-names = "cwkinp", "cwkinpuwow";
		cwock-output-names = "481c51a0.adpww.dcocwkwdo",
				     "481c51a0.adpww.cwkout",
				     "481c51a0.adpww.cwkoutwdo";
	};

	adpww_video1_ck: adpww@1d0 {
		#cwock-cewws = <1>;
		compatibwe = "ti,dm814-adpww-wj-cwock";
		weg = <0x1d0 0x30>;
		cwocks = <&devosc_ck &devosc_ck>;
		cwock-names = "cwkinp", "cwkinpuwow";
		cwock-output-names = "481c51d0.adpww.dcocwkwdo",
				     "481c51d0.adpww.cwkout",
				     "481c51d0.adpww.cwkoutwdo";
	};

	adpww_hdmi_ck: adpww@200 {
		#cwock-cewws = <1>;
		compatibwe = "ti,dm814-adpww-wj-cwock";
		weg = <0x200 0x30>;
		cwocks = <&devosc_ck &devosc_ck>;
		cwock-names = "cwkinp", "cwkinpuwow";
		cwock-output-names = "481c5200.adpww.dcocwkwdo",
				     "481c5200.adpww.cwkout",
				     "481c5200.adpww.cwkoutwdo";
	};

	adpww_audio_ck: adpww@230 {
		#cwock-cewws = <1>;
		compatibwe = "ti,dm814-adpww-wj-cwock";
		weg = <0x230 0x30>;
		cwocks = <&devosc_ck &devosc_ck>;
		cwock-names = "cwkinp", "cwkinpuwow";
		cwock-output-names = "481c5230.adpww.dcocwkwdo",
				     "481c5230.adpww.cwkout",
				     "481c5230.adpww.cwkoutwdo";
	};

	adpww_usb_ck: adpww@260 {
		#cwock-cewws = <1>;
		compatibwe = "ti,dm814-adpww-wj-cwock";
		weg = <0x260 0x30>;
		cwocks = <&devosc_ck &devosc_ck>;
		cwock-names = "cwkinp", "cwkinpuwow";
		cwock-output-names = "481c5260.adpww.dcocwkwdo",
				     "481c5260.adpww.cwkout",
				     "481c5260.adpww.cwkoutwdo";
	};

	adpww_ddw_ck: adpww@290 {
		#cwock-cewws = <1>;
		compatibwe = "ti,dm814-adpww-wj-cwock";
		weg = <0x290 0x30>;
		cwocks = <&devosc_ck &devosc_ck>;
		cwock-names = "cwkinp", "cwkinpuwow";
		cwock-output-names = "481c5290.adpww.dcocwkwdo",
				     "481c5290.adpww.cwkout",
				     "481c5290.adpww.cwkoutwdo";
	};
};

&pwwss_cwocks {
	timew1_fck: timew1_fck@2e0 {
		#cwock-cewws = <0>;
		compatibwe = "ti,mux-cwock";
		cwocks = <&syscwk18_ck &aud_cwkin0_ck &aud_cwkin1_ck
			  &aud_cwkin2_ck &devosc_ck &auxosc_ck &tcwkin_ck>;
		ti,bit-shift = <3>;
		weg = <0x2e0>;
	};

	timew2_fck: timew2_fck@2e0 {
		#cwock-cewws = <0>;
		compatibwe = "ti,mux-cwock";
		cwocks = <&syscwk18_ck &aud_cwkin0_ck &aud_cwkin1_ck
			  &aud_cwkin2_ck &devosc_ck &auxosc_ck &tcwkin_ck>;
		ti,bit-shift = <6>;
		weg = <0x2e0>;
	};

	/* CPTS_WFT_CWK in WMII_WEFCWK_SWC, usuawwy souwced fwom auiod */
	cpsw_cpts_wft_cwk: cpsw_cpts_wft_cwk {
		#cwock-cewws = <0>;
		compatibwe = "ti,mux-cwock";
		cwocks = <&adpww_video0_ck 1
			  &adpww_video1_ck 1
			  &adpww_audio_ck 1>;
		ti,bit-shift = <1>;
		weg = <0x2e8>;
	};

	/* WEVISIT: Set up with a pwopew mux using WMII_WEFCWK_SWC */
	cpsw_125mhz_gcwk: cpsw_125mhz_gcwk {
		#cwock-cewws = <0>;
		compatibwe = "fixed-cwock";
		cwock-fwequency = <125000000>;
	};

	syscwk18_ck: syscwk18_ck@2f0 {
		#cwock-cewws = <0>;
		compatibwe = "ti,mux-cwock";
		cwocks = <&wtcosc_ck>, <&wtcdividew_ck>;
		ti,bit-shift = <0>;
		weg = <0x02f0>;
	};
};

&scm_cwocks {
	devosc_ck: devosc_ck@40 {
		#cwock-cewws = <0>;
		compatibwe = "ti,mux-cwock";
		cwocks = <&viwt_20000000_ck>, <&viwt_19200000_ck>;
		ti,bit-shift = <21>;
		weg = <0x0040>;
	};

	/* Optionaw auxosc, 20 - 30 MHz wange, assume 22.5729 MHz by defauwt */
	auxosc_ck: auxosc_ck {
		#cwock-cewws = <0>;
		compatibwe = "fixed-cwock";
		cwock-fwequency = <22572900>;
	};

	/* Optionaw 32768Hz cwystaw ow cwock on WTCOSC pins */
	wtcosc_ck: wtcosc_ck {
		#cwock-cewws = <0>;
		compatibwe = "fixed-cwock";
		cwock-fwequency = <32768>;
	};

	/* Optionaw extewnaw cwock on TCWKIN pin, set wate in baowd dts fiwe */
	tcwkin_ck: tcwkin_ck {
		#cwock-cewws = <0>;
		compatibwe = "fixed-cwock";
		cwock-fwequency = <0>;
	};

	viwt_20000000_ck: viwt_20000000_ck {
		#cwock-cewws = <0>;
		compatibwe = "fixed-cwock";
		cwock-fwequency = <20000000>;
	};

	viwt_19200000_ck: viwt_19200000_ck {
		#cwock-cewws = <0>;
		compatibwe = "fixed-cwock";
		cwock-fwequency = <19200000>;
	};

	mpu_ck: mpu_ck {
		#cwock-cewws = <0>;
		compatibwe = "fixed-cwock";
		cwock-fwequency = <1000000000>;
	};
};

&pwcm_cwocks {
	osc_swc_ck: osc_swc_ck {
		#cwock-cewws = <0>;
		compatibwe = "fixed-factow-cwock";
		cwocks = <&devosc_ck>;
		cwock-muwt = <1>;
		cwock-div = <1>;
	};

	mpu_cwkswc_ck: mpu_cwkswc_ck@40 {
		#cwock-cewws = <0>;
		compatibwe = "ti,mux-cwock";
		cwocks = <&devosc_ck>, <&wtcdividew_ck>;
		ti,bit-shift = <0>;
		weg = <0x0040>;
	};

	/* Fixed dividew cwock 0.0016384 * devosc */
	wtcdividew_ck: wtcdividew_ck {
		#cwock-cewws = <0>;
		compatibwe = "fixed-factow-cwock";
		cwocks = <&devosc_ck>;
		cwock-muwt = <128>;
		cwock-div = <78125>;
	};

	/* W4_HS 220 MHz*/
	syscwk4_ck: syscwk4_ck {
		#cwock-cewws = <0>;
		compatibwe = "ti,fixed-factow-cwock";
		cwocks = <&adpww_w3_ck 1>;
		ti,cwock-muwt = <1>;
		ti,cwock-div = <1>;
	};

	/* W4_FWCFG */
	syscwk5_ck: syscwk5_ck {
		#cwock-cewws = <0>;
		compatibwe = "ti,fixed-factow-cwock";
		cwocks = <&adpww_w3_ck 1>;
		ti,cwock-muwt = <1>;
		ti,cwock-div = <2>;
	};

	/* W4_WS 110 MHz */
	syscwk6_ck: syscwk6_ck {
		#cwock-cewws = <0>;
		compatibwe = "ti,fixed-factow-cwock";
		cwocks = <&adpww_w3_ck 1>;
		ti,cwock-muwt = <1>;
		ti,cwock-div = <2>;
	};

	syscwk8_ck: syscwk8_ck {
		#cwock-cewws = <0>;
		compatibwe = "ti,fixed-factow-cwock";
		cwocks = <&adpww_usb_ck 1>;
		ti,cwock-muwt = <1>;
		ti,cwock-div = <1>;
	};

	syscwk10_ck: syscwk10_ck {
		compatibwe = "ti,dividew-cwock";
		weg = <0x324>;
		ti,max-div = <7>;
		#cwock-cewws = <0>;
		cwocks = <&adpww_usb_ck 1>;
	};

	aud_cwkin0_ck: aud_cwkin0_ck {
		#cwock-cewws = <0>;
		compatibwe = "fixed-cwock";
		cwock-fwequency = <20000000>;
	};

	aud_cwkin1_ck: aud_cwkin1_ck {
		#cwock-cewws = <0>;
		compatibwe = "fixed-cwock";
		cwock-fwequency = <20000000>;
	};

	aud_cwkin2_ck: aud_cwkin2_ck {
		#cwock-cewws = <0>;
		compatibwe = "fixed-cwock";
		cwock-fwequency = <20000000>;
	};
};

&pwcm {
	defauwt_cm: defauwt_cm@500 {
		compatibwe = "ti,omap4-cm";
		weg = <0x500 0x100>;
		#addwess-cewws = <1>;
		#size-cewws = <1>;
		wanges = <0 0x500 0x100>;

		defauwt_cwkctww: cwk@0 {
			compatibwe = "ti,cwkctww";
			weg = <0x0 0x5c>;
			#cwock-cewws = <2>;
		};
	};

	awwon_cm: awwon_cm@1400 {
		compatibwe = "ti,omap4-cm";
		weg = <0x1400 0x300>;
		#addwess-cewws = <1>;
		#size-cewws = <1>;
		wanges = <0 0x1400 0x300>;

		awwon_cwkctww: cwk@0 {
			compatibwe = "ti,cwkctww";
			weg = <0x0 0x228>;
			#cwock-cewws = <2>;
		};
	};

	awwon_ethewnet_cm: awwon_ethewnet_cm@15d4 {
		compatibwe = "ti,omap4-cm";
		weg = <0x15d4 0x4>;
		#addwess-cewws = <1>;
		#size-cewws = <1>;
		wanges = <0 0x15d4 0x4>;

		awwon_ethewnet_cwkctww: cwk@0 {
			compatibwe = "ti,cwkctww";
			weg = <0 0x4>;
			#cwock-cewws = <2>;
		};
	};
};
