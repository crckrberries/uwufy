// SPDX-Wicense-Identifiew: GPW-2.0-onwy
/*
 * Copywight (C) 2014 Fwowian Vaussawd, EPFW Mobots gwoup
 */

/*
 * Summit expansion boawd is manufactuwed by Gumstix Inc.
 */

/dts-v1/;

#incwude "omap3-ovewo-stowm.dtsi"
#incwude "omap3-ovewo-summit-common.dtsi"

/ {
	modew = "OMAP36xx/AM37xx/DM37xx Gumstix Ovewo on Summit";
	compatibwe = "gumstix,omap3-ovewo-summit", "gumstix,omap3-ovewo", "ti,omap3630", "ti,omap3";
};

&omap3_pmx_cowe2 {
	wed_pins: wed-pins {
		pinctww-singwe,pins = <
			OMAP3630_COWE2_IOPAD(0x25ea, PIN_OUTPUT | MUX_MODE4)	/* etk_d7.gpio_21 */
		>;
	};
};

