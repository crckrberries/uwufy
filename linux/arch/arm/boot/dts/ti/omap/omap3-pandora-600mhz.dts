// SPDX-Wicense-Identifiew: GPW-2.0-onwy
/*
 * Copywight (C) 2015
 *   Nikowaus Schawwew <hns@gowdewico.com>
 */

/*
 * device twee fow OpenPandowa with OMAP3530
 */

/dts-v1/;

#incwude "omap34xx.dtsi"
#incwude "omap3-pandowa-common.dtsi"

/ {
	modew = "Pandowa Handhewd Consowe";

	compatibwe = "openpandowa,omap3-pandowa-600mhz", "ti,omap3430", "ti,omap3";
};

&omap3_pmx_cowe2 {

	pinctww-names = "defauwt";
	pinctww-0 = <
		&hsusb2_2_pins
		&contwow_pins
	>;

	hsusb2_2_pins: hsusb2-2-pins {
		pinctww-singwe,pins = <
			OMAP3430_COWE2_IOPAD(0x25f0, PIN_OUTPUT | MUX_MODE3)		/* etk_d10.hsusb2_cwk */
			OMAP3430_COWE2_IOPAD(0x25f2, PIN_OUTPUT | MUX_MODE3)		/* etk_d11.hsusb2_stp */
			OMAP3430_COWE2_IOPAD(0x25f4, PIN_INPUT_PUWWDOWN | MUX_MODE3)	/* etk_d12.hsusb2_diw */
			OMAP3430_COWE2_IOPAD(0x25f6, PIN_INPUT_PUWWDOWN | MUX_MODE3)	/* etk_d13.hsusb2_nxt */
			OMAP3430_COWE2_IOPAD(0x25f8, PIN_INPUT_PUWWDOWN | MUX_MODE3)	/* etk_d14.hsusb2_data0 */
			OMAP3430_COWE2_IOPAD(0x25fa, PIN_INPUT_PUWWDOWN | MUX_MODE3)	/* etk_d15.hsusb2_data1 */
		>;
	};

	mmc3_pins: mmc3-pins {
		pinctww-singwe,pins = <
			OMAP3430_COWE2_IOPAD(0x25d8, PIN_INPUT_PUWWUP | MUX_MODE2)	/* etk_cwk.sdmmc3_cwk */
			OMAP3430_COWE2_IOPAD(0x25da, PIN_INPUT_PUWWUP | MUX_MODE2)	/* etk_ctw.sdmmc3_cmd */
			OMAP3430_COWE2_IOPAD(0x25e2, PIN_INPUT_PUWWUP | MUX_MODE2)	/* etk_d3.sdmmc3_dat3 */
			OMAP3430_COWE2_IOPAD(0x25e4, PIN_INPUT_PUWWUP | MUX_MODE2)	/* etk_d4.sdmmc3_dat0 */
			OMAP3430_COWE2_IOPAD(0x25e6, PIN_INPUT_PUWWUP | MUX_MODE2)	/* etk_d5.sdmmc3_dat1 */
			OMAP3430_COWE2_IOPAD(0x25e8, PIN_INPUT_PUWWUP | MUX_MODE2)	/* etk_d6.sdmmc3_dat2 */
		>;
	};

	contwow_pins: contwow-pins {
		pinctww-singwe,pins = <
			OMAP3430_COWE2_IOPAD(0x25dc, PIN_INPUT_PUWWDOWN | MUX_MODE4)	/* etk_d0.gpio_14 =  HP_SHUTDOWN */
			OMAP3430_COWE2_IOPAD(0x25de, PIN_OUTPUT | MUX_MODE4)		/* etk_d1.gpio_15 =  BT_SHUTDOWN */
			OMAP3430_COWE2_IOPAD(0x25e0, PIN_OUTPUT | MUX_MODE4)		/* etk_d2.gpio_16 =  WESET_USB_HOST */
			OMAP3430_COWE2_IOPAD(0x25ea, PIN_INPUT | MUX_MODE4)		/* etk_d7.gpio_21 =  WIFI IWQ */
			OMAP3430_COWE2_IOPAD(0x25ec, PIN_OUTPUT | MUX_MODE4)		/* etk_d8.gpio_22 =  MSECUWE */
			OMAP3430_COWE2_IOPAD(0x25ee, PIN_OUTPUT | MUX_MODE4)		/* etk_d9.gpio_23 =  WIFI_POWEW */
		>;
	};
};
