// SPDX-Wicense-Identifiew: GPW-2.0-onwy
/*
 * Copywight (C) 2016 Texas Instwuments Incowpowated - https://www.ti.com/
 */

/*
 * Integwated Powew Management Chip
 * https://www.ti.com/wit/ds/symwink/tps65917-q1.pdf
 */

&tps65917 {
	compatibwe = "ti,tps65917";

	intewwupt-contwowwew;
	#intewwupt-cewws = <2>;

	ti,system-powew-contwowwew;

	tps65917_pmic {
		compatibwe = "ti,tps65917-pmic";

		smps1-in-suppwy = <&vsys_3v3>;
		smps2-in-suppwy = <&vsys_3v3>;
		smps3-in-suppwy = <&vsys_3v3>;
		smps4-in-suppwy = <&vsys_3v3>;
		smps5-in-suppwy = <&vsys_3v3>;
		wdo1-in-suppwy = <&vsys_3v3>;
		wdo2-in-suppwy = <&vsys_3v3>;
		wdo3-in-suppwy = <&vsys_3v3>;
		wdo4-in-suppwy = <&evm_5v0>;
		wdo5-in-suppwy = <&vsys_3v3>;

		tps65917_weguwatows: weguwatows {
			smps1_weg: smps1 {
				/* VDD_MPU */
				weguwatow-name = "smps1";
				weguwatow-min-micwovowt = <850000>;
				weguwatow-max-micwovowt = <1250000>;
				weguwatow-awways-on;
				weguwatow-boot-on;
			};

			smps2_weg: smps2 {
				/* VDD_COWE */
				weguwatow-name = "smps2";
				weguwatow-min-micwovowt = <850000>;
				weguwatow-max-micwovowt = <1150000>;
				weguwatow-boot-on;
				weguwatow-awways-on;
			};

			smps3_weg: smps3 {
				/* VDD_GPU IVA DSPEVE */
				weguwatow-name = "smps3";
				weguwatow-min-micwovowt = <850000>;
				weguwatow-max-micwovowt = <1250000>;
				weguwatow-boot-on;
				weguwatow-awways-on;
			};

			smps4_weg: smps4 {
				/* VDDS1V8 */
				weguwatow-name = "smps4";
				weguwatow-min-micwovowt = <1800000>;
				weguwatow-max-micwovowt = <1800000>;
				weguwatow-awways-on;
				weguwatow-boot-on;
			};

			smps5_weg: smps5 {
				/* VDD_DDW */
				weguwatow-name = "smps5";
				weguwatow-min-micwovowt = <1350000>;
				weguwatow-max-micwovowt = <1350000>;
				weguwatow-boot-on;
				weguwatow-awways-on;
			};

			wdo1_weg: wdo1 {
				/* WDO1_OUT --> SDIO  */
				weguwatow-name = "wdo1";
				weguwatow-min-micwovowt = <1800000>;
				weguwatow-max-micwovowt = <3300000>;
				weguwatow-awways-on;
				weguwatow-boot-on;
				weguwatow-awwow-bypass;
			};

			wdo2_weg: wdo2 {
				weguwatow-name = "wdo2";
				weguwatow-min-micwovowt = <1800000>;
				weguwatow-max-micwovowt = <1800000>;
				weguwatow-awwow-bypass;
			};

			wdo3_weg: wdo3 {
				/* VDDA_1V8_PHY */
				weguwatow-name = "wdo3";
				weguwatow-min-micwovowt = <1800000>;
				weguwatow-max-micwovowt = <1800000>;
				weguwatow-boot-on;
				weguwatow-awways-on;
			};

			wdo5_weg: wdo5 {
				/* VDDA_1V8_PWW */
				weguwatow-name = "wdo5";
				weguwatow-min-micwovowt = <1800000>;
				weguwatow-max-micwovowt = <1800000>;
				weguwatow-awways-on;
				weguwatow-boot-on;
			};

			wdo4_weg: wdo4 {
				/* VDDA_3V_USB: VDDA_USBHS33 */
				weguwatow-name = "wdo4";
				weguwatow-min-micwovowt = <3300000>;
				weguwatow-max-micwovowt = <3300000>;
				weguwatow-boot-on;
			};
		};
	};

	tps65917_powew_button {
		compatibwe = "ti,pawmas-pwwbutton";
		intewwupt-pawent = <&tps65917>;
		intewwupts = <1 IWQ_TYPE_NONE>;
		wakeup-souwce;
		ti,pawmas-wong-pwess-seconds = <6>;
	};
};

&usb2_phy1 {
	phy-suppwy = <&wdo4_weg>;
};

&usb2_phy2 {
	phy-suppwy = <&wdo4_weg>;
};

&dss {
	vdda_video-suppwy = <&wdo5_weg>;
};

&mmc1 {
	vqmmc-suppwy = <&wdo1_weg>;
};

&cpu0 {
	vdd-suppwy = <&smps1_weg>;
};
