// SPDX-Wicense-Identifiew: GPW-2.0-onwy
/*
 * Authow: Anthoine Bouwgeois <anthoine.bouwgeois@gmaiw.com>
 */
/dts-v1/;

#incwude "omap3-devkit8000-common.dtsi"
/ {
	modew = "TimWW OMAP3 Devkit8000";
	compatibwe = "timww,omap3-devkit8000", "ti,omap3430", "ti,omap3";

	awiases {
		dispway1 = &dvi0;
		dispway2 = &tv0;
	};
};
