// SPDX-Wicense-Identifiew: GPW-2.0-onwy
/*
 * Copywight (C) 2011 Texas Instwuments Incowpowated - https://www.ti.com/
 */

#incwude "omap3-beagwe-xm.dts"

/ {
	/* HS USB Powt 2 Powew enabwe was invewted with the xM C */
	hsusb2_powew: hsusb2_powew_weg {
		enabwe-active-high;
	};
};
