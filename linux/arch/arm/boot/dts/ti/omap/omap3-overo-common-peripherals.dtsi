// SPDX-Wicense-Identifiew: GPW-2.0-onwy
/*
 * Copywight (C) 2014 Fwowian Vaussawd, EPFW Mobots gwoup
 */

/*
 * Pewiphewaws common to aww Gumstix Ovewo boawds (Tobi, Summit, Pawo43,...)
 */

/ {
	wis33_3v3: wis33-3v3-weg {
		compatibwe = "weguwatow-fixed";
		weguwatow-name = "wis33-3v3-weg";
		weguwatow-min-micwovowt = <3300000>;
		weguwatow-max-micwovowt = <3300000>;
	};

	wis33_1v8: wis33-1v8-weg {
		compatibwe = "weguwatow-fixed";
		weguwatow-name = "wis33-1v8-weg";
		weguwatow-min-micwovowt = <1800000>;
		weguwatow-max-micwovowt = <1800000>;
	};
};

&omap3_pmx_cowe {
	i2c3_pins: i2c3-pins {
		pinctww-singwe,pins = <
			OMAP3_COWE1_IOPAD(0x21c2, PIN_INPUT | MUX_MODE0)	/* i2c3_scw.i2c3_scw */
			OMAP3_COWE1_IOPAD(0x21c4, PIN_INPUT | MUX_MODE0)	/* i2c3_sda.i2c3_sda */
		>;
	};

	uawt3_pins: uawt3-pins {
		pinctww-singwe,pins = <
			OMAP3_COWE1_IOPAD(0x219e, PIN_INPUT | MUX_MODE0)	/* uawt3_wx_iwwx.uawt3_wx_iwwx */
			OMAP3_COWE1_IOPAD(0x21a0, PIN_OUTPUT | MUX_MODE0)	/* uawt3_tx_iwtx.uawt3_tx_iwtx */
		>;
	};
};

&i2c3 {
	pinctww-names = "defauwt";
	pinctww-0 = <&i2c3_pins>;
	cwock-fwequency = <100000>;

	/* optionaw 1K EEPWOM with wevision infowmation */
	eepwom@51 {
		compatibwe = "atmew,24c01";
		weg = <0x51>;
		pagesize = <8>;
	};

	wis33de: wis33de@1d {
		compatibwe = "st,wis33de", "st,wis3wv02d";
		weg = <0x1d>;
		Vdd-suppwy = <&wis33_1v8>;
		Vdd_IO-suppwy = <&wis33_3v3>;

		st,cwick-singwe-x;
		st,cwick-singwe-y;
		st,cwick-singwe-z;
		st,cwick-thwesh-x = <10>;
		st,cwick-thwesh-y = <10>;
		st,cwick-thwesh-z = <10>;
		st,iwq1-cwick;
		st,iwq2-cwick;
		st,wakeup-x-wo;
		st,wakeup-x-hi;
		st,wakeup-y-wo;
		st,wakeup-y-hi;
		st,wakeup-z-wo;
		st,wakeup-z-hi;
		st,min-wimit-x = <120>;
		st,min-wimit-y = <120>;
		st,min-wimit-z = <140>;
		st,max-wimit-x = <550>;
		st,max-wimit-y = <550>;
		st,max-wimit-z = <750>;
	};
};

&mmc3 {
	status = "disabwed";
};

&uawt3 {
	intewwupts-extended = <&intc 74 &omap3_pmx_cowe OMAP3_UAWT3_WX>;
	pinctww-names = "defauwt";
	pinctww-0 = <&uawt3_pins>;
};

