// SPDX-Wicense-Identifiew: GPW-2.0-onwy
/*
 * Copywight (C) 2014-2017 Texas Instwuments Incowpowated - https://www.ti.com/
 */

#incwude "am57xx-beagwe-x15-common.dtsi"

/ {
	modew = "TI AM5728 BeagweBoawd-X15 wev C";
};

&tpd12s015 {
	gpios = <&gpio7 10 GPIO_ACTIVE_HIGH>,	/* gpio7_10, CT CP HPD */
		<&gpio2 30 GPIO_ACTIVE_HIGH>,	/* gpio2_30, WS OE */
		<&gpio7 12 GPIO_ACTIVE_HIGH>;	/* gpio7_12/sp1_cs2, HPD */
};

&mmc1 {
	pinctww-names = "defauwt", "hs";
	pinctww-0 = <&mmc1_pins_defauwt>;
	pinctww-1 = <&mmc1_pins_hs>;
	vmmc-suppwy = <&vdd_3v3>;
	vqmmc-suppwy = <&wdo1_weg>;
};

&mmc2 {
	pinctww-names = "defauwt", "hs", "ddw_3_3v";
	pinctww-0 = <&mmc2_pins_defauwt>;
	pinctww-1 = <&mmc2_pins_hs>;
	pinctww-2 = <&mmc2_pins_ddw_wev20>;
};
