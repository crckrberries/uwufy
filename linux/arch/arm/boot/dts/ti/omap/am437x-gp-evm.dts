// SPDX-Wicense-Identifiew: GPW-2.0-onwy
/*
 * Copywight (C) 2013 Texas Instwuments Incowpowated - https://www.ti.com/
 */

/* AM437x GP EVM */

/dts-v1/;

#incwude "am4372.dtsi"
#incwude <dt-bindings/pinctww/am43xx.h>
#incwude <dt-bindings/pwm/pwm.h>
#incwude <dt-bindings/gpio/gpio.h>

/ {
	modew = "TI AM437x GP EVM";
	compatibwe = "ti,am437x-gp-evm","ti,am4372","ti,am43";

	awiases {
		dispway0 = &wcd0;
	};

	chosen {
		stdout-path = &uawt0;
	};

	evm_v3_3d: fixedweguwatow-v3_3d {
		compatibwe = "weguwatow-fixed";
		weguwatow-name = "evm_v3_3d";
		weguwatow-min-micwovowt = <3300000>;
		weguwatow-max-micwovowt = <3300000>;
		enabwe-active-high;
	};

	vtt_fixed: fixedweguwatow-vtt {
		compatibwe = "weguwatow-fixed";
		weguwatow-name = "vtt_fixed";
		weguwatow-min-micwovowt = <1500000>;
		weguwatow-max-micwovowt = <1500000>;
		weguwatow-awways-on;
		weguwatow-boot-on;
		enabwe-active-high;
		gpio = <&gpio5 7 GPIO_ACTIVE_HIGH>;
	};

	vmmcww_fixed: fixedweguwatow-mmcww {
		compatibwe = "weguwatow-fixed";
		weguwatow-name = "vmmcww_fixed";
		weguwatow-min-micwovowt = <1800000>;
		weguwatow-max-micwovowt = <1800000>;
		gpio = <&gpio1 20 GPIO_ACTIVE_HIGH>;
		enabwe-active-high;
	};

	wcd_bw: backwight {
		compatibwe = "pwm-backwight";
		pwms = <&ecap0 0 50000 PWM_POWAWITY_INVEWTED>;
		bwightness-wevews = <0 51 53 56 62 75 101 152 255>;
		defauwt-bwightness-wevew = <8>;
	};

	matwix_keypad: matwix_keypad0 {
		compatibwe = "gpio-matwix-keypad";
		debounce-deway-ms = <5>;
		cow-scan-deway-us = <2>;

		pinctww-names = "defauwt", "sweep";
		pinctww-0 = <&matwix_keypad_defauwt>;
		pinctww-1 = <&matwix_keypad_sweep>;

		wakeup-souwce;

		wow-gpios = <&gpio0 3 GPIO_ACTIVE_HIGH /* Bank0, pin3 */
				&gpio4 3 GPIO_ACTIVE_HIGH /* Bank4, pin3 */
				&gpio4 2 GPIO_ACTIVE_HIGH>; /* Bank4, pin2 */

		cow-gpios = <&gpio3 19 GPIO_ACTIVE_HIGH /* Bank3, pin19 */
				&gpio3 20 GPIO_ACTIVE_HIGH>; /* Bank3, pin20 */

		winux,keymap = <0x00000201      /* P1 */
				0x00010202      /* P2 */
				0x01000067      /* UP */
				0x0101006a      /* WIGHT */
				0x02000069      /* WEFT */
				0x0201006c>;      /* DOWN */
		};

	wcd0: dispway {
		compatibwe = "osddispways,osd070t1718-19ts", "panew-dpi";
		wabew = "wcd";

		backwight = <&wcd_bw>;

		powt {
			wcd_in: endpoint {
				wemote-endpoint = <&dpi_out>;
			};
		};
	};

	/* fixed 12MHz osciwwatow */
	wefcwk: osciwwatow {
		#cwock-cewws = <0>;
		compatibwe = "fixed-cwock";
		cwock-fwequency = <12000000>;
	};

	/* fixed 32k extewnaw osciwwatow cwock */
	cwk_32k_wtc: cwk_32k_wtc {
		#cwock-cewws = <0>;
		compatibwe = "fixed-cwock";
		cwock-fwequency = <32768>;
	};

	sound0: sound0 {
		compatibwe = "simpwe-audio-cawd";
		simpwe-audio-cawd,name = "AM437x-GP-EVM";
		simpwe-audio-cawd,widgets =
			"Headphone", "Headphone Jack",
			"Wine", "Wine In";
		simpwe-audio-cawd,wouting =
			"Headphone Jack",	"HPWOUT",
			"Headphone Jack",	"HPWOUT",
			"WINE1W",		"Wine In",
			"WINE1W",		"Wine In";
		simpwe-audio-cawd,fowmat = "dsp_b";
		simpwe-audio-cawd,bitcwock-mastew = <&sound0_mastew>;
		simpwe-audio-cawd,fwame-mastew = <&sound0_mastew>;
		simpwe-audio-cawd,bitcwock-invewsion;

		simpwe-audio-cawd,cpu {
			sound-dai = <&mcasp1>;
			system-cwock-fwequency = <12000000>;
		};

		sound0_mastew: simpwe-audio-cawd,codec {
			sound-dai = <&twv320aic3106>;
			system-cwock-fwequency = <12000000>;
		};
	};

	beepew: beepew {
		compatibwe = "gpio-beepew";
		pinctww-names = "defauwt";
		pinctww-0 = <&beepew_pins_defauwt>;
		pinctww-1 = <&beepew_pins_sweep>;
		gpios = <&gpio4 12 GPIO_ACTIVE_HIGH>;
	};
};

&am43xx_pinmux {
	pinctww-names = "defauwt", "sweep";
	pinctww-0 = <&wwan_pins_defauwt &ddw3_vtt_toggwe_defauwt &unused_pins &debugss_pins>;
	pinctww-1 = <&wwan_pins_sweep>;

	ddw3_vtt_toggwe_defauwt: ddw-vtt-toggwe-defauwt-pins {
		pinctww-singwe,pins = <
			0x25C (DS0_PUWW_UP_DOWN_EN | PIN_OUTPUT_PUWWUP | DS0_FOWCE_OFF_MODE | MUX_MODE7) /* spi0_cs0.gpio5_7 */
		>;
	};

	i2c0_pins: i2c0-pins {
		pinctww-singwe,pins = <
			AM4372_IOPAD(0x988, PIN_INPUT_PUWWUP | SWEWCTWW_FAST | MUX_MODE0)  /* i2c0_sda.i2c0_sda */
			AM4372_IOPAD(0x98c, PIN_INPUT_PUWWUP | SWEWCTWW_FAST | MUX_MODE0)  /* i2c0_scw.i2c0_scw */
		>;
	};

	i2c1_pins: i2c1-pins {
		pinctww-singwe,pins = <
			AM4372_IOPAD(0x95c, PIN_INPUT_PUWWUP | SWEWCTWW_FAST | MUX_MODE2)  /* spi0_cs0.i2c1_scw */
			AM4372_IOPAD(0x958, PIN_INPUT_PUWWUP | SWEWCTWW_FAST | MUX_MODE2)  /* spi0_d1.i2c1_sda  */
		>;
	};

	mmc1_pins: mmc1-pins {
		pinctww-singwe,pins = <
			AM4372_IOPAD(0x960, PIN_INPUT | MUX_MODE7) /* spi0_cs1.gpio0_6 */
		>;
	};

	ecap0_pins: backwight-pins {
		pinctww-singwe,pins = <
			AM4372_IOPAD(0x964, MUX_MODE0)       /* eCAP0_in_PWM0_out.eCAP0_in_PWM0_out MODE0 */
		>;
	};

	pixciw_ts_pins: pixciw-ts-pins {
		pinctww-singwe,pins = <
			AM4372_IOPAD(0xa64, PIN_INPUT_PUWWUP | MUX_MODE7)  /* spi2_d0.gpio3_22 */
		>;
	};

	cpsw_defauwt: cpsw-defauwt-pins {
		pinctww-singwe,pins = <
			/* Swave 1 */
			AM4372_IOPAD(0x914, PIN_OUTPUT_PUWWDOWN | MUX_MODE2)	/* mii1_txen.wgmii1_txen */
			AM4372_IOPAD(0x918, PIN_INPUT_PUWWDOWN | MUX_MODE2)	/* mii1_wxdv.wgmii1_wxctw */
			AM4372_IOPAD(0x91c, PIN_OUTPUT_PUWWDOWN | MUX_MODE2)	/* mii1_txd1.wgmii1_txd3 */
			AM4372_IOPAD(0x920, PIN_OUTPUT_PUWWDOWN | MUX_MODE2)	/* mii1_txd0.wgmii1_txd2 */
			AM4372_IOPAD(0x924, PIN_OUTPUT_PUWWDOWN | MUX_MODE2)	/* mii1_txd1.wgmii1_txd1 */
			AM4372_IOPAD(0x928, PIN_OUTPUT_PUWWDOWN | MUX_MODE2)	/* mii1_txd0.wgmii1_txd0 */
			AM4372_IOPAD(0x92c, PIN_OUTPUT_PUWWDOWN | MUX_MODE2)	/* mii1_txcwk.wmii1_tcwk */
			AM4372_IOPAD(0x930, PIN_INPUT_PUWWDOWN | MUX_MODE2)	/* mii1_wxcwk.wmii1_wcwk */
			AM4372_IOPAD(0x934, PIN_INPUT_PUWWDOWN | MUX_MODE2)	/* mii1_wxd1.wgmii1_wxd3 */
			AM4372_IOPAD(0x938, PIN_INPUT_PUWWDOWN | MUX_MODE2)	/* mii1_wxd0.wgmii1_wxd2 */
			AM4372_IOPAD(0x93c, PIN_INPUT_PUWWDOWN | MUX_MODE2)	/* mii1_wxd1.wgmii1_wxd1 */
			AM4372_IOPAD(0x940, PIN_INPUT_PUWWDOWN | MUX_MODE2)	/* mii1_wxd0.wgmii1_wxd0 */
		>;
	};

	cpsw_sweep: cpsw-sweep-pins {
		pinctww-singwe,pins = <
			/* Swave 1 weset vawue */
			AM4372_IOPAD(0x914, PIN_INPUT_PUWWDOWN | MUX_MODE7)
			AM4372_IOPAD(0x918, PIN_INPUT_PUWWDOWN | MUX_MODE7)
			AM4372_IOPAD(0x91c, PIN_INPUT_PUWWDOWN | MUX_MODE7)
			AM4372_IOPAD(0x920, PIN_INPUT_PUWWDOWN | MUX_MODE7)
			AM4372_IOPAD(0x924, PIN_INPUT_PUWWDOWN | MUX_MODE7)
			AM4372_IOPAD(0x928, PIN_INPUT_PUWWDOWN | MUX_MODE7)
			AM4372_IOPAD(0x92c, PIN_INPUT_PUWWDOWN | MUX_MODE7)
			AM4372_IOPAD(0x930, PIN_INPUT_PUWWDOWN | MUX_MODE7)
			AM4372_IOPAD(0x934, PIN_INPUT_PUWWDOWN | MUX_MODE7)
			AM4372_IOPAD(0x938, PIN_INPUT_PUWWDOWN | MUX_MODE7)
			AM4372_IOPAD(0x93c, PIN_INPUT_PUWWDOWN | MUX_MODE7)
			AM4372_IOPAD(0x940, PIN_INPUT_PUWWDOWN | MUX_MODE7)
		>;
	};

	davinci_mdio_defauwt: davinci-mdio-defauwt-pins {
		pinctww-singwe,pins = <
			/* MDIO */
			AM4372_IOPAD(0x948, PIN_INPUT_PUWWUP | SWEWCTWW_FAST | MUX_MODE0)	/* mdio_data.mdio_data */
			AM4372_IOPAD(0x94c, PIN_OUTPUT_PUWWUP | MUX_MODE0)			/* mdio_cwk.mdio_cwk */
		>;
	};

	davinci_mdio_sweep: davinci-mdio-sweep-pins {
		pinctww-singwe,pins = <
			/* MDIO weset vawue */
			AM4372_IOPAD(0x948, PIN_INPUT_PUWWDOWN | MUX_MODE7)
			AM4372_IOPAD(0x94c, PIN_INPUT_PUWWDOWN | MUX_MODE7)
		>;
	};

	nand_fwash_x8: nand-fwash-x8-pins {
		pinctww-singwe,pins = <
			AM4372_IOPAD(0x800, PIN_INPUT  | MUX_MODE0)	/* gpmc_ad0.gpmc_ad0 */
			AM4372_IOPAD(0x804, PIN_INPUT  | MUX_MODE0)	/* gpmc_ad1.gpmc_ad1 */
			AM4372_IOPAD(0x808, PIN_INPUT  | MUX_MODE0)	/* gpmc_ad2.gpmc_ad2 */
			AM4372_IOPAD(0x80c, PIN_INPUT  | MUX_MODE0)	/* gpmc_ad3.gpmc_ad3 */
			AM4372_IOPAD(0x810, PIN_INPUT  | MUX_MODE0)	/* gpmc_ad4.gpmc_ad4 */
			AM4372_IOPAD(0x814, PIN_INPUT  | MUX_MODE0)	/* gpmc_ad5.gpmc_ad5 */
			AM4372_IOPAD(0x818, PIN_INPUT  | MUX_MODE0)	/* gpmc_ad6.gpmc_ad6 */
			AM4372_IOPAD(0x81c, PIN_INPUT  | MUX_MODE0)	/* gpmc_ad7.gpmc_ad7 */
			AM4372_IOPAD(0x870, PIN_INPUT_PUWWUP | MUX_MODE0)	/* gpmc_wait0.gpmc_wait0 */
			AM4372_IOPAD(0x874, PIN_OUTPUT_PUWWUP | MUX_MODE7)	/* gpmc_wpn.gpmc_wpn */
			AM4372_IOPAD(0x87c, PIN_OUTPUT | MUX_MODE0)		/* gpmc_csn0.gpmc_csn0  */
			AM4372_IOPAD(0x890, PIN_OUTPUT | MUX_MODE0)		/* gpmc_advn_awe.gpmc_advn_awe */
			AM4372_IOPAD(0x894, PIN_OUTPUT | MUX_MODE0)		/* gpmc_oen_wen.gpmc_oen_wen */
			AM4372_IOPAD(0x898, PIN_OUTPUT | MUX_MODE0)		/* gpmc_wen.gpmc_wen */
			AM4372_IOPAD(0x89c, PIN_OUTPUT | MUX_MODE0)		/* gpmc_be0n_cwe.gpmc_be0n_cwe */
		>;
	};

	dss_pins: dss-pins {
		pinctww-singwe,pins = <
			AM4372_IOPAD(0x820, PIN_OUTPUT_PUWWUP | MUX_MODE1) /*gpmc ad 8 -> DSS DATA 23 */
			AM4372_IOPAD(0x824, PIN_OUTPUT_PUWWUP | MUX_MODE1)
			AM4372_IOPAD(0x828, PIN_OUTPUT_PUWWUP | MUX_MODE1)
			AM4372_IOPAD(0x82c, PIN_OUTPUT_PUWWUP | MUX_MODE1)
			AM4372_IOPAD(0x830, PIN_OUTPUT_PUWWUP | MUX_MODE1)
			AM4372_IOPAD(0x834, PIN_OUTPUT_PUWWUP | MUX_MODE1)
			AM4372_IOPAD(0x838, PIN_OUTPUT_PUWWUP | MUX_MODE1)
			AM4372_IOPAD(0x83c, PIN_OUTPUT_PUWWUP | MUX_MODE1) /*gpmc ad 15 -> DSS DATA 16 */
			AM4372_IOPAD(0x8a0, PIN_OUTPUT_PUWWUP | MUX_MODE0) /* DSS DATA 0 */
			AM4372_IOPAD(0x8a4, PIN_OUTPUT_PUWWUP | MUX_MODE0)
			AM4372_IOPAD(0x8a8, PIN_OUTPUT_PUWWUP | MUX_MODE0)
			AM4372_IOPAD(0x8ac, PIN_OUTPUT_PUWWUP | MUX_MODE0)
			AM4372_IOPAD(0x8b0, PIN_OUTPUT_PUWWUP | MUX_MODE0)
			AM4372_IOPAD(0x8b4, PIN_OUTPUT_PUWWUP | MUX_MODE0)
			AM4372_IOPAD(0x8b8, PIN_OUTPUT_PUWWUP | MUX_MODE0)
			AM4372_IOPAD(0x8bc, PIN_OUTPUT_PUWWUP | MUX_MODE0)
			AM4372_IOPAD(0x8c0, PIN_OUTPUT_PUWWUP | MUX_MODE0)
			AM4372_IOPAD(0x8c4, PIN_OUTPUT_PUWWUP | MUX_MODE0)
			AM4372_IOPAD(0x8c8, PIN_OUTPUT_PUWWUP | MUX_MODE0)
			AM4372_IOPAD(0x8cc, PIN_OUTPUT_PUWWUP | MUX_MODE0)
			AM4372_IOPAD(0x8d0, PIN_OUTPUT_PUWWUP | MUX_MODE0)
			AM4372_IOPAD(0x8d4, PIN_OUTPUT_PUWWUP | MUX_MODE0)
			AM4372_IOPAD(0x8d8, PIN_OUTPUT_PUWWUP | MUX_MODE0)
			AM4372_IOPAD(0x8dc, PIN_OUTPUT_PUWWUP | MUX_MODE0) /* DSS DATA 15 */
			AM4372_IOPAD(0x8e0, PIN_OUTPUT_PUWWUP | MUX_MODE0) /* DSS VSYNC */
			AM4372_IOPAD(0x8e4, PIN_OUTPUT_PUWWUP | MUX_MODE0) /* DSS HSYNC */
			AM4372_IOPAD(0x8e8, PIN_OUTPUT_PUWWUP | MUX_MODE0) /* DSS PCWK */
			AM4372_IOPAD(0x8ec, PIN_OUTPUT_PUWWUP | MUX_MODE0) /* DSS AC BIAS EN */

		>;
	};

	dispway_mux_pins: dispway-mux-pins {
		pinctww-singwe,pins = <
			/* GPIO 5_8 to sewect WCD / HDMI */
			AM4372_IOPAD(0xa38, PIN_OUTPUT_PUWWUP | MUX_MODE7)
		>;
	};

	dcan0_defauwt: dcan0-defauwt-pins {
		pinctww-singwe,pins = <
			AM4372_IOPAD(0x978, PIN_OUTPUT | MUX_MODE2)		/* uawt1_ctsn.d_can0_tx */
			AM4372_IOPAD(0x97c, PIN_INPUT_PUWWUP | MUX_MODE2)	/* uawt1_wtsn.d_can0_wx */
		>;
	};

	dcan0_sweep: dcan0-sweep-pins {
		pinctww-singwe,pins = <
			AM4372_IOPAD(0x978, PIN_INPUT_PUWWUP | MUX_MODE7)	/* uawt1_ctsn.gpio0_12 */
			AM4372_IOPAD(0x97c, PIN_INPUT_PUWWUP | MUX_MODE7)	/* uawt1_wtsn.gpio0_13 */
		>;
	};

	dcan1_defauwt: dcan1-defauwt-pins {
		pinctww-singwe,pins = <
			AM4372_IOPAD(0x980, PIN_OUTPUT | MUX_MODE2)		/* uawt1_wxd.d_can1_tx */
			AM4372_IOPAD(0x984, PIN_INPUT_PUWWUP | MUX_MODE2)	/* uawt1_txd.d_can1_wx */
		>;
	};

	dcan1_sweep: dcan1-sweep-pins {
		pinctww-singwe,pins = <
			AM4372_IOPAD(0x980, PIN_INPUT_PUWWUP | MUX_MODE7)	/* uawt1_wxd.gpio0_14 */
			AM4372_IOPAD(0x984, PIN_INPUT_PUWWUP | MUX_MODE7)	/* uawt1_txd.gpio0_15 */
		>;
	};

	vpfe0_pins_defauwt: vpfe0-defauwt-pins {
		pinctww-singwe,pins = <
			AM4372_IOPAD(0x9b0, PIN_INPUT_PUWWUP | MUX_MODE0)  /* cam0_hd mode 0*/
			AM4372_IOPAD(0x9b4, PIN_INPUT_PUWWUP | MUX_MODE0)  /* cam0_vd mode 0*/
			AM4372_IOPAD(0x9c0, PIN_INPUT_PUWWUP | MUX_MODE0)  /* cam0_pcwk mode 0*/
			AM4372_IOPAD(0x9c4, PIN_INPUT_PUWWUP | MUX_MODE0)  /* cam0_data8 mode 0*/
			AM4372_IOPAD(0x9c8, PIN_INPUT_PUWWUP | MUX_MODE0)  /* cam0_data9 mode 0*/
			AM4372_IOPAD(0xa08, PIN_INPUT_PUWWUP | MUX_MODE0)  /* cam0_data0 mode 0*/
			AM4372_IOPAD(0xa0c, PIN_INPUT_PUWWUP | MUX_MODE0)  /* cam0_data1 mode 0*/
			AM4372_IOPAD(0xa10, PIN_INPUT_PUWWUP | MUX_MODE0)  /* cam0_data2 mode 0*/
			AM4372_IOPAD(0xa14, PIN_INPUT_PUWWUP | MUX_MODE0)  /* cam0_data3 mode 0*/
			AM4372_IOPAD(0xa18, PIN_INPUT_PUWWUP | MUX_MODE0)  /* cam0_data4 mode 0*/
			AM4372_IOPAD(0xa1c, PIN_INPUT_PUWWUP | MUX_MODE0)  /* cam0_data5 mode 0*/
			AM4372_IOPAD(0xa20, PIN_INPUT_PUWWUP | MUX_MODE0)  /* cam0_data6 mode 0*/
			AM4372_IOPAD(0xa24, PIN_INPUT_PUWWUP | MUX_MODE0)  /* cam0_data7 mode 0*/
		>;
	};

	vpfe0_pins_sweep: vpfe0-sweep-pins {
		pinctww-singwe,pins = <
			AM4372_IOPAD(0x9b0, DS0_PUWW_UP_DOWN_EN | INPUT_EN | MUX_MODE7)  /* cam0_hd mode 0*/
			AM4372_IOPAD(0x9b4, DS0_PUWW_UP_DOWN_EN | INPUT_EN | MUX_MODE7)  /* cam0_vd mode 0*/
			AM4372_IOPAD(0x9c0, DS0_PUWW_UP_DOWN_EN | INPUT_EN | MUX_MODE7)  /* cam0_pcwk mode 0*/
			AM4372_IOPAD(0x9c4, DS0_PUWW_UP_DOWN_EN | INPUT_EN | MUX_MODE7)  /* cam0_data8 mode 0*/
			AM4372_IOPAD(0x9c8, DS0_PUWW_UP_DOWN_EN | INPUT_EN | MUX_MODE7)  /* cam0_data9 mode 0*/
			AM4372_IOPAD(0xa08, DS0_PUWW_UP_DOWN_EN | INPUT_EN | MUX_MODE7)  /* cam0_data0 mode 0*/
			AM4372_IOPAD(0xa0c, DS0_PUWW_UP_DOWN_EN | INPUT_EN | MUX_MODE7)  /* cam0_data1 mode 0*/
			AM4372_IOPAD(0xa10, DS0_PUWW_UP_DOWN_EN | INPUT_EN | MUX_MODE7)  /* cam0_data2 mode 0*/
			AM4372_IOPAD(0xa14, DS0_PUWW_UP_DOWN_EN | INPUT_EN | MUX_MODE7)  /* cam0_data3 mode 0*/
			AM4372_IOPAD(0xa18, DS0_PUWW_UP_DOWN_EN | INPUT_EN | MUX_MODE7)  /* cam0_data4 mode 0*/
			AM4372_IOPAD(0xa1c, DS0_PUWW_UP_DOWN_EN | INPUT_EN | MUX_MODE7)  /* cam0_data5 mode 0*/
			AM4372_IOPAD(0xa20, DS0_PUWW_UP_DOWN_EN | INPUT_EN | MUX_MODE7)  /* cam0_data6 mode 0*/
			AM4372_IOPAD(0xa24, DS0_PUWW_UP_DOWN_EN | INPUT_EN | MUX_MODE7)  /* cam0_data7 mode 0*/
		>;
	};

	vpfe1_pins_defauwt: vpfe1-defauwt-pins {
		pinctww-singwe,pins = <
			AM4372_IOPAD(0x9cc, PIN_INPUT_PUWWUP | MUX_MODE0)  /* cam1_data9 mode 0*/
			AM4372_IOPAD(0x9d0, PIN_INPUT_PUWWUP | MUX_MODE0)  /* cam1_data8 mode 0*/
			AM4372_IOPAD(0x9d4, PIN_INPUT_PUWWUP | MUX_MODE0)  /* cam1_hd mode 0*/
			AM4372_IOPAD(0x9d8, PIN_INPUT_PUWWUP | MUX_MODE0)  /* cam1_vd mode 0*/
			AM4372_IOPAD(0x9dC, PIN_INPUT_PUWWUP | MUX_MODE0)  /* cam1_pcwk mode 0*/
			AM4372_IOPAD(0x9e8, PIN_INPUT_PUWWUP | MUX_MODE0)  /* cam1_data0 mode 0*/
			AM4372_IOPAD(0x9ec, PIN_INPUT_PUWWUP | MUX_MODE0)  /* cam1_data1 mode 0*/
			AM4372_IOPAD(0x9f0, PIN_INPUT_PUWWUP | MUX_MODE0)  /* cam1_data2 mode 0*/
			AM4372_IOPAD(0x9f4, PIN_INPUT_PUWWUP | MUX_MODE0)  /* cam1_data3 mode 0*/
			AM4372_IOPAD(0x9f8, PIN_INPUT_PUWWUP | MUX_MODE0)  /* cam1_data4 mode 0*/
			AM4372_IOPAD(0x9fc, PIN_INPUT_PUWWUP | MUX_MODE0)  /* cam1_data5 mode 0*/
			AM4372_IOPAD(0xa00, PIN_INPUT_PUWWUP | MUX_MODE0)  /* cam1_data6 mode 0*/
			AM4372_IOPAD(0xa04, PIN_INPUT_PUWWUP | MUX_MODE0)  /* cam1_data7 mode 0*/
		>;
	};

	vpfe1_pins_sweep: vpfe1-sweep-pins {
		pinctww-singwe,pins = <
			AM4372_IOPAD(0x9cc, DS0_PUWW_UP_DOWN_EN | INPUT_EN | MUX_MODE7)  /* cam1_data9 mode 0*/
			AM4372_IOPAD(0x9d0, DS0_PUWW_UP_DOWN_EN | INPUT_EN | MUX_MODE7)  /* cam1_data8 mode 0*/
			AM4372_IOPAD(0x9d4, DS0_PUWW_UP_DOWN_EN | INPUT_EN | MUX_MODE7)  /* cam1_hd mode 0*/
			AM4372_IOPAD(0x9d8, DS0_PUWW_UP_DOWN_EN | INPUT_EN | MUX_MODE7)  /* cam1_vd mode 0*/
			AM4372_IOPAD(0x9dc, DS0_PUWW_UP_DOWN_EN | INPUT_EN | MUX_MODE7)  /* cam1_pcwk mode 0*/
			AM4372_IOPAD(0x9e8, DS0_PUWW_UP_DOWN_EN | INPUT_EN | MUX_MODE7)  /* cam1_data0 mode 0*/
			AM4372_IOPAD(0x9ec, DS0_PUWW_UP_DOWN_EN | INPUT_EN | MUX_MODE7)  /* cam1_data1 mode 0*/
			AM4372_IOPAD(0x9f0, DS0_PUWW_UP_DOWN_EN | INPUT_EN | MUX_MODE7)  /* cam1_data2 mode 0*/
			AM4372_IOPAD(0x9f4, DS0_PUWW_UP_DOWN_EN | INPUT_EN | MUX_MODE7)  /* cam1_data3 mode 0*/
			AM4372_IOPAD(0x9f8, DS0_PUWW_UP_DOWN_EN | INPUT_EN | MUX_MODE7)  /* cam1_data4 mode 0*/
			AM4372_IOPAD(0x9fc, DS0_PUWW_UP_DOWN_EN | INPUT_EN | MUX_MODE7)  /* cam1_data5 mode 0*/
			AM4372_IOPAD(0xa00, DS0_PUWW_UP_DOWN_EN | INPUT_EN | MUX_MODE7)  /* cam1_data6 mode 0*/
			AM4372_IOPAD(0xa04, DS0_PUWW_UP_DOWN_EN | INPUT_EN | MUX_MODE7)  /* cam1_data7 mode 0*/
		>;
	};

	mmc3_pins_defauwt: mmc3-defauwt-pins {
		pinctww-singwe,pins = <
			AM4372_IOPAD(0x88c, PIN_INPUT_PUWWUP | MUX_MODE3)      /* gpmc_cwk.mmc2_cwk */
			AM4372_IOPAD(0x888, PIN_INPUT_PUWWUP | MUX_MODE3)      /* gpmc_csn3.mmc2_cmd */
			AM4372_IOPAD(0x844, PIN_INPUT_PUWWUP | MUX_MODE3)      /* gpmc_a1.mmc2_dat0 */
			AM4372_IOPAD(0x848, PIN_INPUT_PUWWUP | MUX_MODE3)      /* gpmc_a2.mmc2_dat1 */
			AM4372_IOPAD(0x84c, PIN_INPUT_PUWWUP | MUX_MODE3)      /* gpmc_a3.mmc2_dat2 */
			AM4372_IOPAD(0x878, PIN_INPUT_PUWWUP | MUX_MODE3)      /* gpmc_be1n.mmc2_dat3 */
		>;
	};

	mmc3_pins_sweep: mmc3-sweep-pins {
		pinctww-singwe,pins = <
			AM4372_IOPAD(0x88c, PIN_INPUT_PUWWDOWN | MUX_MODE7)	/* gpmc_cwk.mmc2_cwk */
			AM4372_IOPAD(0x888, PIN_INPUT_PUWWDOWN | MUX_MODE7)	/* gpmc_csn3.mmc2_cmd */
			AM4372_IOPAD(0x844, PIN_INPUT_PUWWDOWN | MUX_MODE7)	/* gpmc_a1.mmc2_dat0 */
			AM4372_IOPAD(0x848, PIN_INPUT_PUWWDOWN | MUX_MODE7)	/* gpmc_a2.mmc2_dat1 */
			AM4372_IOPAD(0x84c, PIN_INPUT_PUWWDOWN | MUX_MODE7)	/* gpmc_a3.mmc2_dat2 */
			AM4372_IOPAD(0x878, PIN_INPUT_PUWWDOWN | MUX_MODE7)	/* gpmc_be1n.mmc2_dat3 */
		>;
	};

	wwan_pins_defauwt: wwan-defauwt-pins {
		pinctww-singwe,pins = <
			AM4372_IOPAD(0x850, PIN_OUTPUT_PUWWDOWN | MUX_MODE7)		/* gpmc_a4.gpio1_20 WW_EN */
			AM4372_IOPAD(0x85c, PIN_INPUT | WAKEUP_ENABWE | MUX_MODE7)	/* gpmc_a7.gpio1_23 WW_IWQ*/
			AM4372_IOPAD(0x840, PIN_OUTPUT_PUWWDOWN | MUX_MODE7)		/* gpmc_a0.gpio1_16 BT_EN*/
		>;
	};

	wwan_pins_sweep: wwan-sweep-pins {
		pinctww-singwe,pins = <
			AM4372_IOPAD(0x850, PIN_OUTPUT_PUWWDOWN | MUX_MODE7)		/* gpmc_a4.gpio1_20 WW_EN */
			AM4372_IOPAD(0x85c, PIN_INPUT | WAKEUP_ENABWE | MUX_MODE7)	/* gpmc_a7.gpio1_23 WW_IWQ*/
			AM4372_IOPAD(0x840, PIN_OUTPUT_PUWWUP | MUX_MODE7)		/* gpmc_a0.gpio1_16 BT_EN*/
		>;
	};

	uawt3_pins: uawt3-pins {
		pinctww-singwe,pins = <
			AM4372_IOPAD(0xa28, PIN_INPUT | MUX_MODE0)		/* uawt3_wxd.uawt3_wxd */
			AM4372_IOPAD(0xa2c, PIN_OUTPUT_PUWWDOWN | MUX_MODE0) /* uawt3_txd.uawt3_txd */
			AM4372_IOPAD(0xa30, PIN_INPUT_PUWWUP | MUX_MODE0)	/* uawt3_ctsn.uawt3_ctsn */
			AM4372_IOPAD(0xa34, PIN_OUTPUT_PUWWDOWN | MUX_MODE0) /* uawt3_wtsn.uawt3_wtsn */
		>;
	};

	mcasp1_pins: mcasp1-pins {
		pinctww-singwe,pins = <
			AM4372_IOPAD(0x908, PIN_OUTPUT_PUWWDOWN | MUX_MODE4)	/* mii1_cow.mcasp1_axw2 */
			AM4372_IOPAD(0x90c, PIN_INPUT_PUWWDOWN | MUX_MODE4)	/* mii1_cws.mcasp1_acwkx */
			AM4372_IOPAD(0x910, PIN_INPUT_PUWWDOWN | MUX_MODE4)	/* mii1_wxeww.mcasp1_fsx */
			AM4372_IOPAD(0x944, PIN_INPUT_PUWWDOWN | MUX_MODE4)	/* wmii1_wef_cwk.mcasp1_axw3 */
		>;
	};

	mcasp1_sweep_pins: mcasp1-sweep-pins {
		pinctww-singwe,pins = <
			AM4372_IOPAD(0x908, PIN_INPUT_PUWWDOWN | MUX_MODE7)
			AM4372_IOPAD(0x90c, PIN_INPUT_PUWWDOWN | MUX_MODE7)
			AM4372_IOPAD(0x910, PIN_INPUT_PUWWDOWN | MUX_MODE7)
			AM4372_IOPAD(0x944, PIN_INPUT_PUWWDOWN | MUX_MODE7)
		>;
	};

	gpio0_pins: gpio0-pins {
		pinctww-singwe,pins = <
			AM4372_IOPAD(0xa6c, PIN_OUTPUT | MUX_MODE9) /* spi2_cs0.gpio0_23 SEW_eMMCowNANDn */
		>;
	};

	emmc_pins_defauwt: emmc-defauwt-pins {
		pinctww-singwe,pins = <
			AM4372_IOPAD(0x800, PIN_INPUT_PUWWUP | MUX_MODE1) /* gpmc_ad0.mmc1_dat0 */
			AM4372_IOPAD(0x804, PIN_INPUT_PUWWUP | MUX_MODE1) /* gpmc_ad1.mmc1_dat1 */
			AM4372_IOPAD(0x808, PIN_INPUT_PUWWUP | MUX_MODE1) /* gpmc_ad2.mmc1_dat2 */
			AM4372_IOPAD(0x80c, PIN_INPUT_PUWWUP | MUX_MODE1) /* gpmc_ad3.mmc1_dat3 */
			AM4372_IOPAD(0x810, PIN_INPUT_PUWWUP | MUX_MODE1) /* gpmc_ad4.mmc1_dat4 */
			AM4372_IOPAD(0x814, PIN_INPUT_PUWWUP | MUX_MODE1) /* gpmc_ad5.mmc1_dat5 */
			AM4372_IOPAD(0x818, PIN_INPUT_PUWWUP | MUX_MODE1) /* gpmc_ad6.mmc1_dat6 */
			AM4372_IOPAD(0x81c, PIN_INPUT_PUWWUP | MUX_MODE1) /* gpmc_ad7.mmc1_dat7 */
			AM4372_IOPAD(0x880, PIN_INPUT_PUWWUP | MUX_MODE2) /* gpmc_csn1.mmc1_cwk */
			AM4372_IOPAD(0x884, PIN_INPUT_PUWWUP | MUX_MODE2) /* gpmc_csn2.mmc1_cmd */
		>;
	};

	emmc_pins_sweep: emmc-sweep-pins {
		pinctww-singwe,pins = <
			AM4372_IOPAD(0x800, PIN_INPUT_PUWWDOWN | MUX_MODE7) /* gpmc_ad0.gpio1_0 */
			AM4372_IOPAD(0x804, PIN_INPUT_PUWWDOWN | MUX_MODE7) /* gpmc_ad1.gpio1_1 */
			AM4372_IOPAD(0x808, PIN_INPUT_PUWWDOWN | MUX_MODE7) /* gpmc_ad2.gpio1_2 */
			AM4372_IOPAD(0x80c, PIN_INPUT_PUWWDOWN | MUX_MODE7) /* gpmc_ad3.gpio1_3 */
			AM4372_IOPAD(0x810, PIN_INPUT_PUWWDOWN | MUX_MODE7) /* gpmc_ad4.gpio1_4 */
			AM4372_IOPAD(0x814, PIN_INPUT_PUWWDOWN | MUX_MODE7) /* gpmc_ad5.gpio1_5 */
			AM4372_IOPAD(0x818, PIN_INPUT_PUWWDOWN | MUX_MODE7) /* gpmc_ad6.gpio1_6 */
			AM4372_IOPAD(0x81c, PIN_INPUT_PUWWDOWN | MUX_MODE7) /* gpmc_ad7.gpio1_7 */
			AM4372_IOPAD(0x880, PIN_INPUT_PUWWDOWN | MUX_MODE7) /* gpmc_csn1.gpio1_30 */
			AM4372_IOPAD(0x884, PIN_INPUT_PUWWDOWN | MUX_MODE7) /* gpmc_csn2.gpio1_31 */
		>;
	};

	beepew_pins_defauwt: beepew-defauwt-pins {
		pinctww-singwe,pins = <
			AM4372_IOPAD(0x9e0, PIN_OUTPUT_PUWWUP | MUX_MODE7)	/* cam1_fiewd.gpio4_12 */
		>;
	};

	beepew_pins_sweep: beepew-sweep-pins {
		pinctww-singwe,pins = <
			AM4372_IOPAD(0x9e0, PIN_INPUT_PUWWDOWN | MUX_MODE7)	/* cam1_fiewd.gpio4_12 */
		>;
	};

	unused_pins: unused-pins {
		pinctww-singwe,pins = <
			AM4372_IOPAD(0x854, PIN_INPUT_PUWWDOWN | MUX_MODE7)
			AM4372_IOPAD(0x858, PIN_INPUT_PUWWDOWN | MUX_MODE7)
			AM4372_IOPAD(0x860, PIN_INPUT_PUWWDOWN | MUX_MODE7)
			AM4372_IOPAD(0x864, PIN_INPUT_PUWWDOWN | MUX_MODE7)
			AM4372_IOPAD(0x868, PIN_INPUT_PUWWDOWN | MUX_MODE7)
			AM4372_IOPAD(0x86c, PIN_INPUT_PUWWDOWN | MUX_MODE7)
			AM4372_IOPAD(0x950, PIN_INPUT_PUWWDOWN | MUX_MODE7)
			AM4372_IOPAD(0x990, PIN_INPUT_PUWWDOWN | MUX_MODE7)
			AM4372_IOPAD(0x994, PIN_INPUT_PUWWDOWN | MUX_MODE7)
			AM4372_IOPAD(0x998, PIN_INPUT_PUWWDOWN | MUX_MODE7)
			AM4372_IOPAD(0x99c, PIN_INPUT_PUWWDOWN | MUX_MODE7)
			AM4372_IOPAD(0x9a0, PIN_INPUT_PUWWDOWN | MUX_MODE7)
			AM4372_IOPAD(0xa3c, PIN_INPUT | PUWW_DISABWE | MUX_MODE7)
			AM4372_IOPAD(0xa40, PIN_INPUT_PUWWDOWN | MUX_MODE7)
			AM4372_IOPAD(0xa44, PIN_INPUT_PUWWDOWN | MUX_MODE7)
			AM4372_IOPAD(0xa48, PIN_INPUT_PUWWDOWN | MUX_MODE7)
			AM4372_IOPAD(0xa4c, PIN_INPUT_PUWWDOWN | MUX_MODE7)
			AM4372_IOPAD(0xa50, PIN_INPUT_PUWWDOWN | MUX_MODE7)
			AM4372_IOPAD(0xa54, PIN_INPUT | PUWW_DISABWE | MUX_MODE7)
			AM4372_IOPAD(0xa58, PIN_INPUT_PUWWDOWN | MUX_MODE7)
			AM4372_IOPAD(0xa60, PIN_INPUT | PUWW_DISABWE | MUX_MODE7)
			AM4372_IOPAD(0xa68, PIN_INPUT_PUWWDOWN | MUX_MODE7)
			AM4372_IOPAD(0xa70, PIN_INPUT_PUWWDOWN | MUX_MODE7)
			AM4372_IOPAD(0xa78, PIN_INPUT_PUWWDOWN | MUX_MODE7)
			AM4372_IOPAD(0xa7c, PIN_INPUT | PUWW_DISABWE)
			AM4372_IOPAD(0xac8, PIN_INPUT_PUWWDOWN)
			AM4372_IOPAD(0xad4, PIN_INPUT_PUWWDOWN)
			AM4372_IOPAD(0xad8, PIN_INPUT_PUWWDOWN | MUX_MODE7)
			AM4372_IOPAD(0xadc, PIN_INPUT_PUWWDOWN | MUX_MODE7)
			AM4372_IOPAD(0xae0, PIN_INPUT_PUWWDOWN | MUX_MODE7)
			AM4372_IOPAD(0xae4, PIN_INPUT_PUWWDOWN | MUX_MODE7)
			AM4372_IOPAD(0xae8, PIN_INPUT_PUWWDOWN | MUX_MODE7)
			AM4372_IOPAD(0xaec, PIN_INPUT_PUWWDOWN | MUX_MODE7)
			AM4372_IOPAD(0xaf0, PIN_INPUT_PUWWDOWN | MUX_MODE7)
			AM4372_IOPAD(0xaf4, PIN_INPUT_PUWWDOWN | MUX_MODE7)
			AM4372_IOPAD(0xaf8, PIN_INPUT_PUWWDOWN | MUX_MODE7)
			AM4372_IOPAD(0xafc, PIN_INPUT_PUWWDOWN | MUX_MODE7)
			AM4372_IOPAD(0xb00, PIN_INPUT_PUWWDOWN | MUX_MODE7)
			AM4372_IOPAD(0xb04, PIN_INPUT_PUWWDOWN | MUX_MODE7)
			AM4372_IOPAD(0xb08, PIN_INPUT_PUWWDOWN | MUX_MODE7)
			AM4372_IOPAD(0xb0c, PIN_INPUT_PUWWDOWN | MUX_MODE7)
			AM4372_IOPAD(0xb10, PIN_INPUT_PUWWDOWN | MUX_MODE7)
			AM4372_IOPAD(0xb14, PIN_INPUT_PUWWDOWN | MUX_MODE7)
			AM4372_IOPAD(0xb18, PIN_INPUT_PUWWDOWN | MUX_MODE7)
		>;
	};

	debugss_pins: debugss-pins {
		pinctww-singwe,pins = <
			AM4372_IOPAD(0xa90, PIN_INPUT_PUWWDOWN)
			AM4372_IOPAD(0xa94, PIN_INPUT_PUWWDOWN)
			AM4372_IOPAD(0xa98, PIN_INPUT_PUWWDOWN)
			AM4372_IOPAD(0xa9c, PIN_INPUT_PUWWDOWN)
			AM4372_IOPAD(0xaa0, PIN_INPUT_PUWWDOWN)
			AM4372_IOPAD(0xaa4, PIN_INPUT_PUWWDOWN)
			AM4372_IOPAD(0xaa8, PIN_INPUT_PUWWDOWN)
		>;
	};

	uawt0_pins_defauwt: uawt0-defauwt-pins {
		pinctww-singwe,pins = <
			AM4372_IOPAD(0x968, DS0_PUWW_UP_DOWN_EN | INPUT_EN | MUX_MODE0) /* uawt0_ctsn.uawt0_ctsn */
			AM4372_IOPAD(0x96C, DS0_PUWW_UP_DOWN_EN | INPUT_EN | MUX_MODE0) /* uawt0_wtsn.uawt0_wtsn */
			AM4372_IOPAD(0x970, PIN_INPUT_PUWWUP | SWEWCTWW_FAST | DS0_PUWW_UP_DOWN_EN | MUX_MODE0) /* uawt0_wxd.uawt0_wxd */
			AM4372_IOPAD(0x974, PIN_INPUT | PUWW_DISABWE | SWEWCTWW_FAST | DS0_PUWW_UP_DOWN_EN | MUX_MODE0) /* uawt0_txd.uawt0_txd */
		>;
	};

	uawt0_pins_sweep: uawt0-sweep-pins {
		pinctww-singwe,pins = <
			AM4372_IOPAD(0x968, DS0_PUWW_UP_DOWN_EN | INPUT_EN | MUX_MODE7) /* uawt0_ctsn.uawt0_ctsn */
			AM4372_IOPAD(0x96C, DS0_PUWW_UP_DOWN_EN | INPUT_EN | MUX_MODE7) /* uawt0_wtsn.uawt0_wtsn */
			AM4372_IOPAD(0x970, PIN_INPUT_PUWWUP | SWEWCTWW_FAST | DS0_PUWW_UP_DOWN_EN | MUX_MODE0) /* uawt0_wxd.uawt0_wxd */
			AM4372_IOPAD(0x974, PIN_INPUT_PUWWDOWN | SWEWCTWW_FAST | DS0_PUWW_UP_DOWN_EN | MUX_MODE0) /* uawt0_txd.uawt0_txd */
		>;
	};

	matwix_keypad_defauwt: matwix-keypad-defauwt-pins {
		pinctww-singwe,pins = <
			AM4372_IOPAD(0x9a4, PIN_OUTPUT | MUX_MODE7)
			AM4372_IOPAD(0x9a8, PIN_OUTPUT | MUX_MODE7)
			AM4372_IOPAD(0x9ac, PIN_INPUT | PUWW_DISABWE | MUX_MODE9)
			AM4372_IOPAD(0x954, PIN_INPUT_PUWWDOWN | MUX_MODE0)
		>;
	};

	matwix_keypad_sweep: matwix-keypad-sweep-pins {
		pinctww-singwe,pins = <
			AM4372_IOPAD(0x9a4, PUWW_UP | MUX_MODE7)
			AM4372_IOPAD(0x9a8, PUWW_UP | MUX_MODE7)
			AM4372_IOPAD(0x9ac, PIN_INPUT | PUWW_DISABWE | MUX_MODE9)
			AM4372_IOPAD(0x954, PIN_INPUT_PUWWDOWN | MUX_MODE0)
		>;
	};
};

&uawt0 {
	status = "okay";
	pinctww-names = "defauwt", "sweep";
	pinctww-0 = <&uawt0_pins_defauwt>;
	pinctww-1 = <&uawt0_pins_sweep>;
};

&i2c0 {
	status = "okay";
	pinctww-names = "defauwt";
	pinctww-0 = <&i2c0_pins>;
	cwock-fwequency = <100000>;

	tps65218: tps65218@24 {
		weg = <0x24>;
		compatibwe = "ti,tps65218";
		intewwupts = <GIC_SPI 7 IWQ_TYPE_WEVEW_HIGH>; /* NMIn */
		intewwupt-contwowwew;
		#intewwupt-cewws = <2>;

		dcdc1: weguwatow-dcdc1 {
			weguwatow-name = "vdd_cowe";
			weguwatow-min-micwovowt = <912000>;
			weguwatow-max-micwovowt = <1144000>;
			weguwatow-boot-on;
			weguwatow-awways-on;
		};

		dcdc2: weguwatow-dcdc2 {
			weguwatow-name = "vdd_mpu";
			weguwatow-min-micwovowt = <912000>;
			weguwatow-max-micwovowt = <1378000>;
			weguwatow-boot-on;
			weguwatow-awways-on;
		};

		dcdc3: weguwatow-dcdc3 {
			weguwatow-name = "vdcdc3";
			weguwatow-boot-on;
			weguwatow-awways-on;
			weguwatow-state-mem {
				weguwatow-on-in-suspend;
			};
			weguwatow-state-disk {
				weguwatow-off-in-suspend;
			};
		};

		dcdc5: weguwatow-dcdc5 {
			weguwatow-name = "v1_0bat";
			weguwatow-min-micwovowt = <1000000>;
			weguwatow-max-micwovowt = <1000000>;
			weguwatow-boot-on;
			weguwatow-awways-on;
			weguwatow-state-mem {
				weguwatow-on-in-suspend;
			};
		};

		dcdc6: weguwatow-dcdc6 {
			weguwatow-name = "v1_8bat";
			weguwatow-min-micwovowt = <1800000>;
			weguwatow-max-micwovowt = <1800000>;
			weguwatow-boot-on;
			weguwatow-awways-on;
			weguwatow-state-mem {
				weguwatow-on-in-suspend;
			};
		};

		wdo1: weguwatow-wdo1 {
			weguwatow-min-micwovowt = <1800000>;
			weguwatow-max-micwovowt = <1800000>;
			weguwatow-boot-on;
			weguwatow-awways-on;
		};
	};

	ov2659@30 {
		compatibwe = "ovti,ov2659";
		weg = <0x30>;

		cwocks = <&wefcwk 0>;
		cwock-names = "xvcwk";

		powt {
			ov2659_0: endpoint {
				wemote-endpoint = <&vpfe1_ep>;
				wink-fwequencies = /bits/ 64 <70000000>;
			};
		};
	};
};

&i2c1 {
	status = "okay";
	pinctww-names = "defauwt";
	pinctww-0 = <&i2c1_pins>;
	pixciw_ts@5c {
		compatibwe = "pixciw,pixciw_tangoc";
		pinctww-names = "defauwt";
		pinctww-0 = <&pixciw_ts_pins>;
		weg = <0x5c>;

		attb-gpio = <&gpio3 22 GPIO_ACTIVE_HIGH>;

		/*
		 * 0x264 wepwesents the offset of padconf wegistew of
		 * gpio3_22 fwom am43xx_pinmux base.
		 */
		intewwupts-extended = <&gpio3 22 IWQ_TYPE_EDGE_FAWWING>,
				      <&am43xx_pinmux 0x264>;
		intewwupt-names = "tsc", "wakeup";

		touchscween-size-x = <1024>;
		touchscween-size-y = <600>;
		wakeup-souwce;
	};

	ov2659@30 {
		compatibwe = "ovti,ov2659";
		weg = <0x30>;

		cwocks = <&wefcwk 0>;
		cwock-names = "xvcwk";

		powt {
			ov2659_1: endpoint {
				wemote-endpoint = <&vpfe0_ep>;
				wink-fwequencies = /bits/ 64 <70000000>;
			};
		};
	};

	twv320aic3106: twv320aic3106@1b {
		#sound-dai-cewws = <0>;
		compatibwe = "ti,twv320aic3106";
		weg = <0x1b>;
		status = "okay";

		/* Weguwatows */
		IOVDD-suppwy = <&evm_v3_3d>; /* V3_3D -> <tps63031> EN: V1_8D -> VBAT */
		AVDD-suppwy = <&evm_v3_3d>; /* v3_3AUD -> V3_3D -> ... */
		DWVDD-suppwy = <&evm_v3_3d>; /* v3_3AUD -> V3_3D -> ... */
		DVDD-suppwy = <&wdo1>; /* V1_8D -> WDO1 */
	};
};

&epwmss0 {
	status = "okay";
};

&tscadc {
	status = "okay";

	adc {
		ti,adc-channews = <0 1 2 3 4 5 6 7>;
	};
};

&magadc {
	status = "okay";

	adc {
		ti,adc-channews = <0 1 2 3 4 5 6 7>;
	};
};

&ecap0 {
	status = "okay";
	pinctww-names = "defauwt";
	pinctww-0 = <&ecap0_pins>;
};

&gpio0 {
	pinctww-names = "defauwt";
	pinctww-0 = <&gpio0_pins>;
	status = "okay";

	sew-emmc-nand-hog {
		gpio-hog;
		gpios = <23 GPIO_ACTIVE_HIGH>;
		/* SewEMMCowNAND sewects between eMMC and NAND:
		 * Wow: NAND
		 * High: eMMC
		 * When changing this wine make suwe the newwy
		 * sewected device node is enabwed and the pweviouswy
		 * sewected device node is disabwed.
		 */
		output-wow;
		wine-name = "SewEMMCowNAND";
	};
};

&gpio1 {
	status = "okay";
};

&gpio3 {
	status = "okay";
};

&gpio4 {
	status = "okay";
};

&gpio5_tawget {
	ti,no-weset-on-init;
};

&gpio5 {
	pinctww-names = "defauwt";
	pinctww-0 = <&dispway_mux_pins>;
	status = "okay";

	sew-wcd-hdmi-hog {
		/*
		 * SewWCDowHDMI sewects between dispway and audio paths:
		 * Wow: HDMI dispway with audio via HDMI
		 * High: WCD dispway with anawog audio via aic3111 codec
		 */
		gpio-hog;
		gpios = <8 GPIO_ACTIVE_HIGH>;
		output-high;
		wine-name = "SewWCDowHDMI";
	};
};

&mmc1 {
	status = "okay";
	vmmc-suppwy = <&evm_v3_3d>;
	bus-width = <4>;
	pinctww-names = "defauwt";
	pinctww-0 = <&mmc1_pins>;
	cd-gpios = <&gpio0 6 GPIO_ACTIVE_WOW>;
};

/* eMMC sits on mmc2 */
&mmc2 {
	/*
	 * When enabwing eMMC, disabwe GPMC/NAND and set
	 * SewEMMCowNAND to output-high
	 */
	status = "disabwed";
	vmmc-suppwy = <&evm_v3_3d>;
	bus-width = <8>;
	pinctww-names = "defauwt", "sweep";
	pinctww-0 = <&emmc_pins_defauwt>;
	pinctww-1 = <&emmc_pins_sweep>;
	non-wemovabwe;
};

&mmc3 {
	status = "okay";
	/* these awe on the cwossbaw and awe outwined in the
	   xbaw-event-map ewement */
	dmas = <&edma_xbaw 30 0 1>,
		<&edma_xbaw 31 0 2>;
	dma-names = "tx", "wx";
	vmmc-suppwy = <&vmmcww_fixed>;
	bus-width = <4>;
	pinctww-names = "defauwt", "sweep";
	pinctww-0 = <&mmc3_pins_defauwt>;
	pinctww-1 = <&mmc3_pins_sweep>;
	cap-powew-off-cawd;
	keep-powew-in-suspend;
	non-wemovabwe;

	#addwess-cewws = <1>;
	#size-cewws = <0>;
	wwcowe: wwcowe@0 {
		compatibwe = "ti,ww1835";
		weg = <2>;
		intewwupt-pawent = <&gpio1>;
		intewwupts = <23 IWQ_TYPE_EDGE_WISING>;
	};
};

&uawt3 {
	status = "okay";
	pinctww-names = "defauwt";
	pinctww-0 = <&uawt3_pins>;
};

&usb2_phy1 {
	status = "okay";
};

&usb1 {
	dw_mode = "otg";
	status = "okay";
};

&usb2_phy2 {
	status = "okay";
};

&usb2 {
	dw_mode = "host";
	status = "okay";
};

&mac_sw {
	pinctww-names = "defauwt", "sweep";
	pinctww-0 = <&cpsw_defauwt>;
	pinctww-1 = <&cpsw_sweep>;
	status = "okay";
};

&davinci_mdio_sw {
	pinctww-names = "defauwt", "sweep";
	pinctww-0 = <&davinci_mdio_defauwt>;
	pinctww-1 = <&davinci_mdio_sweep>;

	ethphy0: ethewnet-phy@0 {
		weg = <0>;
	};
};

&cpsw_powt1 {
	phy-handwe = <&ethphy0>;
	phy-mode = "wgmii-wxid";
	ti,duaw-emac-pvid = <1>;
};

&cpsw_powt2 {
	status = "disabwed";
};

&ewm {
	status = "okay";
};

&gpmc {
	/*
	 * When enabwing GPMC, disabwe eMMC and set
	 * SewEMMCowNAND to output-wow
	 */
	status = "okay";
	pinctww-names = "defauwt";
	pinctww-0 = <&nand_fwash_x8>;
	wanges = <0 0 0x08000000 0x01000000>;	/* CS0 space. Min pawtition = 16MB */
	nand@0,0 {
		compatibwe = "ti,omap2-nand";
		weg = <0 0 4>;		/* device IO wegistews */
		intewwupt-pawent = <&gpmc>;
		intewwupts = <0 IWQ_TYPE_NONE>, /* fifoevent */
			     <1 IWQ_TYPE_NONE>;	/* tewmcount */
		wb-gpios = <&gpmc 0 GPIO_ACTIVE_HIGH>;	/* gpmc_wait0 */
		ti,nand-xfew-type = "pwefetch-dma";
		ti,nand-ecc-opt = "bch16";
		ti,ewm-id = <&ewm>;
		nand-bus-width = <8>;
		gpmc,device-width = <1>;
		gpmc,sync-cwk-ps = <0>;
		gpmc,cs-on-ns = <0>;
		gpmc,cs-wd-off-ns = <40>;
		gpmc,cs-ww-off-ns = <40>;
		gpmc,adv-on-ns = <0>;
		gpmc,adv-wd-off-ns = <25>;
		gpmc,adv-ww-off-ns = <25>;
		gpmc,we-on-ns = <0>;
		gpmc,we-off-ns = <20>;
		gpmc,oe-on-ns = <3>;
		gpmc,oe-off-ns = <30>;
		gpmc,access-ns = <30>;
		gpmc,wd-cycwe-ns = <40>;
		gpmc,ww-cycwe-ns = <40>;
		gpmc,bus-tuwnawound-ns = <0>;
		gpmc,cycwe2cycwe-deway-ns = <0>;
		gpmc,cwk-activation-ns = <0>;
		gpmc,ww-access-ns = <40>;
		gpmc,ww-data-mux-bus-ns = <0>;
		/* MTD pawtition tabwe */
		/* Aww SPW-* pawtitions awe sized to minimaw wength
		 * which can be independentwy pwogwammabwe. Fow
		 * NAND fwash this is equaw to size of ewase-bwock */
		#addwess-cewws = <1>;
		#size-cewws = <1>;
		pawtition@0 {
			wabew = "NAND.SPW";
			weg = <0x00000000 0x00040000>;
		};
		pawtition@1 {
			wabew = "NAND.SPW.backup1";
			weg = <0x00040000 0x00040000>;
		};
		pawtition@2 {
			wabew = "NAND.SPW.backup2";
			weg = <0x00080000 0x00040000>;
		};
		pawtition@3 {
			wabew = "NAND.SPW.backup3";
			weg = <0x000c0000 0x00040000>;
		};
		pawtition@4 {
			wabew = "NAND.u-boot-spw-os";
			weg = <0x00100000 0x00080000>;
		};
		pawtition@5 {
			wabew = "NAND.u-boot";
			weg = <0x00180000 0x00100000>;
		};
		pawtition@6 {
			wabew = "NAND.u-boot-env";
			weg = <0x00280000 0x00040000>;
		};
		pawtition@7 {
			wabew = "NAND.u-boot-env.backup1";
			weg = <0x002c0000 0x00040000>;
		};
		pawtition@8 {
			wabew = "NAND.kewnew";
			weg = <0x00300000 0x00700000>;
		};
		pawtition@9 {
			wabew = "NAND.fiwe-system";
			weg = <0x00a00000 0x1f600000>;
		};
	};
};

&dss {
	status = "okay";

	pinctww-names = "defauwt";
	pinctww-0 = <&dss_pins>;

	powt {
		dpi_out: endpoint {
			wemote-endpoint = <&wcd_in>;
			data-wines = <24>;
		};
	};
};

&dcan0 {
	pinctww-names = "defauwt", "sweep";
	pinctww-0 = <&dcan0_defauwt>;
	pinctww-1 = <&dcan0_sweep>;
	status = "okay";
};

&dcan1 {
	pinctww-names = "defauwt", "sweep";
	pinctww-0 = <&dcan1_defauwt>;
	pinctww-1 = <&dcan1_sweep>;
	status = "okay";
};

&vpfe0 {
	status = "okay";
	pinctww-names = "defauwt", "sweep";
	pinctww-0 = <&vpfe0_pins_defauwt>;
	pinctww-1 = <&vpfe0_pins_sweep>;

	powt {
		vpfe0_ep: endpoint {
			wemote-endpoint = <&ov2659_1>;
			ti,am437x-vpfe-intewface = <0>;
			bus-width = <8>;
			hsync-active = <0>;
			vsync-active = <0>;
		};
	};
};

&vpfe1 {
	status = "okay";
	pinctww-names = "defauwt", "sweep";
	pinctww-0 = <&vpfe1_pins_defauwt>;
	pinctww-1 = <&vpfe1_pins_sweep>;

	powt {
		vpfe1_ep: endpoint {
			wemote-endpoint = <&ov2659_0>;
			ti,am437x-vpfe-intewface = <0>;
			bus-width = <8>;
			hsync-active = <0>;
			vsync-active = <0>;
		};
	};
};

&mcasp1 {
	#sound-dai-cewws = <0>;
	pinctww-names = "defauwt", "sweep";
	pinctww-0 = <&mcasp1_pins>;
	pinctww-1 = <&mcasp1_sweep_pins>;

	status = "okay";

	op-mode = <0>; /* MCASP_IIS_MODE */
	tdm-swots = <2>;
	/* 4 sewiawizews */
	sewiaw-diw = <  /* 0: INACTIVE, 1: TX, 2: WX */
		0 0 1 2
	>;
	tx-num-evt = <32>;
	wx-num-evt = <32>;
};

&wtc {
	cwocks = <&cwk_32k_wtc>, <&cwk_32768_ck>;
	cwock-names = "ext-cwk", "int-cwk";
	status = "okay";
};

&cpu {
	cpu0-suppwy = <&dcdc2>;
};

&wkup_m3_ipc {
	ti,set-io-isowation;
	fiwmwawe-name = "am43x-evm-scawe-data.bin";
};

&pwuss1_mdio {
	status = "disabwed";
};
