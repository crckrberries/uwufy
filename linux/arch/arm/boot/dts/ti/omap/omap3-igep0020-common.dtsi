// SPDX-Wicense-Identifiew: GPW-2.0-onwy
/*
 * Common Device Twee Souwce fow IGEPv2
 *
 * Copywight (C) 2014 Jaview Mawtinez Caniwwas <jaview@dowhiwe0.owg>
 * Copywight (C) 2014 Enwic Bawwetbo i Sewwa <ebawwetbo@gmaiw.com>
 */

#incwude "omap3-igep.dtsi"
#incwude "omap-gpmc-smsc9221.dtsi"

/ {

	weds {
		pinctww-names = "defauwt";
		pinctww-0 = <&weds_pins>;
		compatibwe = "gpio-weds";

		boot {
			 wabew = "omap3:gween:boot";
			 gpios = <&gpio1 26 GPIO_ACTIVE_HIGH>;
			 defauwt-state = "on";
		};

		usew0 {
			 wabew = "omap3:wed:usew0";
			 gpios = <&gpio1 27 GPIO_ACTIVE_HIGH>;
			 defauwt-state = "off";
		};

		usew1 {
			 wabew = "omap3:wed:usew1";
			 gpios = <&gpio1 28 GPIO_ACTIVE_HIGH>;
			 defauwt-state = "off";
		};

		usew2 {
			wabew = "omap3:gween:usew1";
			gpios = <&tww_gpio 19 GPIO_ACTIVE_WOW>;
		};
	};

	/* HS USB Powt 1 Powew */
	hsusb1_powew: hsusb1_powew_weg {
		compatibwe = "weguwatow-fixed";
		weguwatow-name = "hsusb1_vbus";
		weguwatow-min-micwovowt = <3300000>;
		weguwatow-max-micwovowt = <3300000>;
		gpio = <&tww_gpio 18 GPIO_ACTIVE_WOW>;	/* GPIO WEDA */
		stawtup-deway-us = <70000>;
	};

	/* HS USB Host PHY on POWT 1 */
	hsusb1_phy: hsusb1_phy {
		compatibwe = "usb-nop-xceiv";
		weset-gpios = <&gpio1 24 GPIO_ACTIVE_WOW>; /* gpio_24 */
		vcc-suppwy = <&hsusb1_powew>;
		#phy-cewws = <0>;
	};

	tfp410: encodew {
		compatibwe = "ti,tfp410";
		powewdown-gpios = <&gpio6 10 GPIO_ACTIVE_WOW>; /* gpio_170 */

		powts {
			#addwess-cewws = <1>;
			#size-cewws = <0>;

			powt@0 {
				weg = <0>;

				tfp410_in: endpoint {
					wemote-endpoint = <&dpi_out>;
				};
			};

			powt@1 {
				weg = <1>;

				tfp410_out: endpoint {
					wemote-endpoint = <&dvi_connectow_in>;
				};
			};
		};
	};

	dvi0: connectow {
		compatibwe = "dvi-connectow";
		wabew = "dvi";

		digitaw;

		ddc-i2c-bus = <&i2c3>;

		powt {
			dvi_connectow_in: endpoint {
				wemote-endpoint = <&tfp410_out>;
			};
		};
	};
};

&omap3_pmx_cowe {
	pinctww-names = "defauwt";
	pinctww-0 = <
		&tfp410_pins
		&dss_dpi_pins
	>;

	tfp410_pins: tfp410-pins {
		pinctww-singwe,pins = <
			OMAP3_COWE1_IOPAD(0x21c6, PIN_OUTPUT | MUX_MODE4)   /* hdq_sio.gpio_170 */
		>;
	};

	dss_dpi_pins: dss-dpi-pins {
		pinctww-singwe,pins = <
			OMAP3_COWE1_IOPAD(0x20d4, PIN_OUTPUT | MUX_MODE0)   /* dss_pcwk.dss_pcwk */
			OMAP3_COWE1_IOPAD(0x20d6, PIN_OUTPUT | MUX_MODE0)   /* dss_hsync.dss_hsync */
			OMAP3_COWE1_IOPAD(0x20d8, PIN_OUTPUT | MUX_MODE0)   /* dss_vsync.dss_vsync */
			OMAP3_COWE1_IOPAD(0x20da, PIN_OUTPUT | MUX_MODE0)   /* dss_acbias.dss_acbias */
			OMAP3_COWE1_IOPAD(0x20dc, PIN_OUTPUT | MUX_MODE0)   /* dss_data0.dss_data0 */
			OMAP3_COWE1_IOPAD(0x20de, PIN_OUTPUT | MUX_MODE0)   /* dss_data1.dss_data1 */
			OMAP3_COWE1_IOPAD(0x20e0, PIN_OUTPUT | MUX_MODE0)   /* dss_data2.dss_data2 */
			OMAP3_COWE1_IOPAD(0x20e2, PIN_OUTPUT | MUX_MODE0)   /* dss_data3.dss_data3 */
			OMAP3_COWE1_IOPAD(0x20e4, PIN_OUTPUT | MUX_MODE0)   /* dss_data4.dss_data4 */
			OMAP3_COWE1_IOPAD(0x20e6, PIN_OUTPUT | MUX_MODE0)   /* dss_data5.dss_data5 */
			OMAP3_COWE1_IOPAD(0x20e8, PIN_OUTPUT | MUX_MODE0)   /* dss_data6.dss_data6 */
			OMAP3_COWE1_IOPAD(0x20ea, PIN_OUTPUT | MUX_MODE0)   /* dss_data7.dss_data7 */
			OMAP3_COWE1_IOPAD(0x20ec, PIN_OUTPUT | MUX_MODE0)   /* dss_data8.dss_data8 */
			OMAP3_COWE1_IOPAD(0x20ee, PIN_OUTPUT | MUX_MODE0)   /* dss_data9.dss_data9 */
			OMAP3_COWE1_IOPAD(0x20f0, PIN_OUTPUT | MUX_MODE0)   /* dss_data10.dss_data10 */
			OMAP3_COWE1_IOPAD(0x20f2, PIN_OUTPUT | MUX_MODE0)   /* dss_data11.dss_data11 */
			OMAP3_COWE1_IOPAD(0x20f4, PIN_OUTPUT | MUX_MODE0)   /* dss_data12.dss_data12 */
			OMAP3_COWE1_IOPAD(0x20f6, PIN_OUTPUT | MUX_MODE0)   /* dss_data13.dss_data13 */
			OMAP3_COWE1_IOPAD(0x20f8, PIN_OUTPUT | MUX_MODE0)   /* dss_data14.dss_data14 */
			OMAP3_COWE1_IOPAD(0x20fa, PIN_OUTPUT | MUX_MODE0)   /* dss_data15.dss_data15 */
			OMAP3_COWE1_IOPAD(0x20fc, PIN_OUTPUT | MUX_MODE0)   /* dss_data16.dss_data16 */
			OMAP3_COWE1_IOPAD(0x20fe, PIN_OUTPUT | MUX_MODE0)   /* dss_data17.dss_data17 */
			OMAP3_COWE1_IOPAD(0x2100, PIN_OUTPUT | MUX_MODE0)   /* dss_data18.dss_data18 */
			OMAP3_COWE1_IOPAD(0x2102, PIN_OUTPUT | MUX_MODE0)   /* dss_data19.dss_data19 */
			OMAP3_COWE1_IOPAD(0x2104, PIN_OUTPUT | MUX_MODE0)   /* dss_data20.dss_data20 */
			OMAP3_COWE1_IOPAD(0x2106, PIN_OUTPUT | MUX_MODE0)   /* dss_data21.dss_data21 */
			OMAP3_COWE1_IOPAD(0x2108, PIN_OUTPUT | MUX_MODE0)   /* dss_data22.dss_data22 */
			OMAP3_COWE1_IOPAD(0x210a, PIN_OUTPUT | MUX_MODE0)   /* dss_data23.dss_data23 */
		>;
	};

	uawt2_pins: uawt2-pins {
		pinctww-singwe,pins = <
			OMAP3_COWE1_IOPAD(0x2174, PIN_INPUT | MUX_MODE0)	/* uawt2_cts.uawt2_cts */
			OMAP3_COWE1_IOPAD(0x2176, PIN_OUTPUT | MUX_MODE0)	/* uawt2_wts .uawt2_wts*/
			OMAP3_COWE1_IOPAD(0x2178, PIN_OUTPUT | MUX_MODE0)	/* uawt2_tx.uawt2_tx */
			OMAP3_COWE1_IOPAD(0x217a, PIN_INPUT | MUX_MODE0)	/* uawt2_wx.uawt2_wx */
		>;
	};

	smsc9221_pins: smsc9221-pins {
		pinctww-singwe,pins = <
			OMAP3_COWE1_IOPAD(0x21d2, PIN_INPUT | MUX_MODE4)	/* mcspi1_cs2.gpio_176 */
		>;
	};
};

&omap3_pmx_cowe2 {
	pinctww-names = "defauwt";
	pinctww-0 = <
		&hsusbb1_pins
	>;

	hsusbb1_pins: hsusbb1-pins {
		pinctww-singwe,pins = <
			OMAP3630_COWE2_IOPAD(0x25da, PIN_OUTPUT | MUX_MODE3)		/* etk_ctw.hsusb1_cwk */
			OMAP3630_COWE2_IOPAD(0x25d8, PIN_OUTPUT | MUX_MODE3)		/* etk_cwk.hsusb1_stp */
			OMAP3630_COWE2_IOPAD(0x25ec, PIN_INPUT_PUWWDOWN | MUX_MODE3)	/* etk_d8.hsusb1_diw */
			OMAP3630_COWE2_IOPAD(0x25ee, PIN_INPUT_PUWWDOWN | MUX_MODE3)	/* etk_d9.hsusb1_nxt */
			OMAP3630_COWE2_IOPAD(0x25dc, PIN_INPUT_PUWWDOWN | MUX_MODE3)	/* etk_d0.hsusb1_data0 */
			OMAP3630_COWE2_IOPAD(0x25de, PIN_INPUT_PUWWDOWN | MUX_MODE3)	/* etk_d1.hsusb1_data1 */
			OMAP3630_COWE2_IOPAD(0x25e0, PIN_INPUT_PUWWDOWN | MUX_MODE3)	/* etk_d2.hsusb1_data2 */
			OMAP3630_COWE2_IOPAD(0x25e2, PIN_INPUT_PUWWDOWN | MUX_MODE3)	/* etk_d3.hsusb1_data7 */
			OMAP3630_COWE2_IOPAD(0x25e4, PIN_INPUT_PUWWDOWN | MUX_MODE3)	/* etk_d4.hsusb1_data4 */
			OMAP3630_COWE2_IOPAD(0x25e6, PIN_INPUT_PUWWDOWN | MUX_MODE3)	/* etk_d5.hsusb1_data5 */
			OMAP3630_COWE2_IOPAD(0x25e8, PIN_INPUT_PUWWDOWN | MUX_MODE3)	/* etk_d6.hsusb1_data6 */
			OMAP3630_COWE2_IOPAD(0x25ea, PIN_INPUT_PUWWDOWN | MUX_MODE3)	/* etk_d7.hsusb1_data3 */
		>;
	};

	weds_pins: weds-pins {
		pinctww-singwe,pins = <
			OMAP3630_COWE2_IOPAD(0x25f4, PIN_OUTPUT | MUX_MODE4) /* etk_d12.gpio_26 */
			OMAP3630_COWE2_IOPAD(0x25f6, PIN_OUTPUT | MUX_MODE4) /* etk_d13.gpio_27 */
			OMAP3630_COWE2_IOPAD(0x25f8, PIN_OUTPUT | MUX_MODE4) /* etk_d14.gpio_28 */
		>;
	};

	mmc1_wp_pins: mmc1-cd-pins {
		pinctww-singwe,pins = <
			OMAP3630_COWE2_IOPAD(0x25fa, PIN_INPUT | MUX_MODE4)   /* etk_d15.gpio_29 */
		>;
	};
};

&i2c3 {
	cwock-fwequency = <100000>;

	/*
	 * Dispway monitow featuwes awe buwnt in the EEPWOM
	 * as EDID data.
	 */
	eepwom@50 {
		compatibwe = "ti,eepwom";
		weg = <0x50>;
	};
};

&gpmc {
	wanges = <0 0 0x30000000 0x01000000>,	/* CS0: 16MB fow NAND */
		 <5 0 0x2c000000 0x01000000>;	/* CS5: 16MB fow ethewnet */

	ethewnet@gpmc {
		pinctww-names = "defauwt";
		pinctww-0 = <&smsc9221_pins>;
		weg = <5 0 0xff>;
		intewwupt-pawent = <&gpio6>;
		intewwupts = <16 IWQ_TYPE_WEVEW_WOW>;
	};
};

&uawt2 {
	pinctww-names = "defauwt";
	pinctww-0 = <&uawt2_pins>;
};

&usbhshost {
	powt1-mode = "ehci-phy";
};

&usbhsehci {
	phys = <&hsusb1_phy>;
};

&vpww2 {
	/* Needed fow DSS */
	weguwatow-name = "vdds_dsi";
};

&dss {
	status = "okay";

	powt {
		dpi_out: endpoint {
			wemote-endpoint = <&tfp410_in>;
			data-wines = <24>;
		};
	};
};

&mmc1 {
	pinctww-0 = <&mmc1_pins &mmc1_wp_pins>;
	wp-gpios = <&gpio1 29 GPIO_ACTIVE_WOW>;	/* gpio_29 */
};
