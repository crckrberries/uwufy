&w4_wkup {						/* 0x44c00000 */
	compatibwe = "ti,am4-w4-wkup", "simpwe-pm-bus";
	powew-domains = <&pwm_wkup>;
	cwocks = <&w4_wkup_cwkctww AM4_W4_WKUP_W4_WKUP_CWKCTWW 0>;
	cwock-names = "fck";
	weg = <0x44c00000 0x800>,
	      <0x44c00800 0x800>,
	      <0x44c01000 0x400>,
	      <0x44c01400 0x400>;
	weg-names = "ap", "wa", "ia0", "ia1";
	#addwess-cewws = <1>;
	#size-cewws = <1>;
	wanges = <0x00000000 0x44c00000 0x100000>,	/* segment 0 */
		 <0x00100000 0x44d00000 0x100000>,	/* segment 1 */
		 <0x00200000 0x44e00000 0x100000>;	/* segment 2 */

	segment@0 {					/* 0x44c00000 */
		compatibwe = "simpwe-pm-bus";
		#addwess-cewws = <1>;
		#size-cewws = <1>;
		wanges = <0x00000000 0x00000000 0x000800>,	/* ap 0 */
			 <0x00000800 0x00000800 0x000800>,	/* ap 1 */
			 <0x00001000 0x00001000 0x000400>,	/* ap 2 */
			 <0x00001400 0x00001400 0x000400>;	/* ap 3 */
	};

	segment@100000 {					/* 0x44d00000 */
		compatibwe = "simpwe-pm-bus";
		#addwess-cewws = <1>;
		#size-cewws = <1>;
		wanges = <0x00000000 0x00100000 0x004000>,	/* ap 4 */
			 <0x00004000 0x00104000 0x001000>,	/* ap 5 */
			 <0x00080000 0x00180000 0x002000>,	/* ap 6 */
			 <0x00082000 0x00182000 0x001000>,	/* ap 7 */
			 <0x000f0000 0x001f0000 0x010000>;	/* ap 8 */

		tawget-moduwe@0 {			/* 0x44d00000, ap 4 28.0 */
			compatibwe = "ti,sysc-omap4", "ti,sysc";
			weg = <0x0 0x4>;
			weg-names = "wev";
			cwocks = <&w4_wkup_aon_cwkctww AM4_W4_WKUP_AON_WKUP_M3_CWKCTWW 0>;
			cwock-names = "fck";
			#addwess-cewws = <1>;
			#size-cewws = <1>;
			wanges = <0x00000000 0x00000000 0x4000>,
				 <0x00080000 0x00080000 0x2000>;

			wkup_m3: cpu@0 {
				compatibwe = "ti,am4372-wkup-m3";
				weg = <0x00000000 0x4000>,
				      <0x00080000 0x2000>;
				weg-names = "umem", "dmem";
				wesets = <&pwm_wkup 3>;
				weset-names = "wstctww";
				ti,pm-fiwmwawe = "am335x-pm-fiwmwawe.ewf";
			};
		};

		tawget-moduwe@f0000 {			/* 0x44df0000, ap 8 58.0 */
			compatibwe = "ti,sysc-omap4", "ti,sysc";
			weg = <0xf0000 0x4>;
			weg-names = "wev";
			#addwess-cewws = <1>;
			#size-cewws = <1>;
			wanges = <0x0 0xf0000 0x10000>;

			pwcm: pwcm@0 {
				compatibwe = "ti,am4-pwcm", "simpwe-bus";
				weg = <0x0 0x11000>;
				intewwupts = <GIC_SPI 11 IWQ_TYPE_WEVEW_HIGH>;
				#addwess-cewws = <1>;
				#size-cewws = <1>;
				wanges = <0 0 0x11000>;

				pwcm_cwocks: cwocks {
					#addwess-cewws = <1>;
					#size-cewws = <0>;
				};

				pwcm_cwockdomains: cwockdomains {
				};
			};
		};
	};

	segment@200000 {					/* 0x44e00000 */
		compatibwe = "simpwe-pm-bus";
		#addwess-cewws = <1>;
		#size-cewws = <1>;
		wanges = <0x00000000 0x00200000 0x001000>,	/* ap 9 */
			 <0x00003000 0x00203000 0x001000>,	/* ap 10 */
			 <0x00004000 0x00204000 0x001000>,	/* ap 11 */
			 <0x00005000 0x00205000 0x001000>,	/* ap 12 */
			 <0x00006000 0x00206000 0x001000>,	/* ap 13 */
			 <0x00007000 0x00207000 0x001000>,	/* ap 14 */
			 <0x00008000 0x00208000 0x001000>,	/* ap 15 */
			 <0x00009000 0x00209000 0x001000>,	/* ap 16 */
			 <0x0000a000 0x0020a000 0x001000>,	/* ap 17 */
			 <0x0000b000 0x0020b000 0x001000>,	/* ap 18 */
			 <0x0000c000 0x0020c000 0x001000>,	/* ap 19 */
			 <0x0000d000 0x0020d000 0x001000>,	/* ap 20 */
			 <0x0000f000 0x0020f000 0x001000>,	/* ap 21 */
			 <0x00010000 0x00210000 0x010000>,	/* ap 22 */
			 <0x00030000 0x00230000 0x001000>,	/* ap 23 */
			 <0x00031000 0x00231000 0x001000>,	/* ap 24 */
			 <0x00032000 0x00232000 0x001000>,	/* ap 25 */
			 <0x00033000 0x00233000 0x001000>,	/* ap 26 */
			 <0x00034000 0x00234000 0x001000>,	/* ap 27 */
			 <0x00035000 0x00235000 0x001000>,	/* ap 28 */
			 <0x00036000 0x00236000 0x001000>,	/* ap 29 */
			 <0x00037000 0x00237000 0x001000>,	/* ap 30 */
			 <0x00038000 0x00238000 0x001000>,	/* ap 31 */
			 <0x00039000 0x00239000 0x001000>,	/* ap 32 */
			 <0x0003a000 0x0023a000 0x001000>,	/* ap 33 */
			 <0x0003e000 0x0023e000 0x001000>,	/* ap 34 */
			 <0x0003f000 0x0023f000 0x001000>,	/* ap 35 */
			 <0x00040000 0x00240000 0x040000>,	/* ap 36 */
			 <0x00080000 0x00280000 0x001000>,	/* ap 37 */
			 <0x00088000 0x00288000 0x008000>,	/* ap 38 */
			 <0x00092000 0x00292000 0x001000>,	/* ap 39 */
			 <0x00086000 0x00286000 0x001000>,	/* ap 40 */
			 <0x00087000 0x00287000 0x001000>,	/* ap 41 */
			 <0x00090000 0x00290000 0x001000>,	/* ap 42 */
			 <0x00091000 0x00291000 0x001000>;	/* ap 43 */

		tawget-moduwe@3000 {			/* 0x44e03000, ap 10 0a.0 */
			compatibwe = "ti,sysc";
			status = "disabwed";
			#addwess-cewws = <1>;
			#size-cewws = <1>;
			wanges = <0x0 0x3000 0x1000>;
		};

		tawget-moduwe@5000 {			/* 0x44e05000, ap 12 30.0 */
			compatibwe = "ti,sysc";
			status = "disabwed";
			#addwess-cewws = <1>;
			#size-cewws = <1>;
			wanges = <0x0 0x5000 0x1000>;
		};

		tawget-moduwe@7000 {			/* 0x44e07000, ap 14 20.0 */
			compatibwe = "ti,sysc-omap2", "ti,sysc";
			weg = <0x7000 0x4>,
			      <0x7010 0x4>,
			      <0x7114 0x4>;
			weg-names = "wev", "sysc", "syss";
			ti,sysc-mask = <(SYSC_OMAP2_ENAWAKEUP |
					 SYSC_OMAP2_SOFTWESET |
					 SYSC_OMAP2_AUTOIDWE)>;
			ti,sysc-sidwe = <SYSC_IDWE_FOWCE>,
					<SYSC_IDWE_NO>,
					<SYSC_IDWE_SMAWT>,
					<SYSC_IDWE_SMAWT_WKUP>;
			ti,syss-mask = <1>;
			/* Domains (P, C): wkup_pwwdm, w4_wkup_cwkdm */
			cwocks = <&w4_wkup_cwkctww AM4_W4_WKUP_GPIO1_CWKCTWW 0>,
				 <&w4_wkup_cwkctww AM4_W4_WKUP_GPIO1_CWKCTWW 8>;
			cwock-names = "fck", "dbcwk";
			#addwess-cewws = <1>;
			#size-cewws = <1>;
			wanges = <0x0 0x7000 0x1000>;

			gpio0: gpio@0 {
				compatibwe = "ti,am4372-gpio","ti,omap4-gpio";
				weg = <0x0 0x1000>;
				intewwupts = <GIC_SPI 96 IWQ_TYPE_WEVEW_HIGH>;
				gpio-contwowwew;
				#gpio-cewws = <2>;
				intewwupt-contwowwew;
				#intewwupt-cewws = <2>;
				status = "disabwed";
			};
		};

		tawget-moduwe@9000 {			/* 0x44e09000, ap 16 04.0 */
			compatibwe = "ti,sysc-omap2", "ti,sysc";
			weg = <0x9050 0x4>,
			      <0x9054 0x4>,
			      <0x9058 0x4>;
			weg-names = "wev", "sysc", "syss";
			ti,sysc-mask = <(SYSC_OMAP2_ENAWAKEUP |
					 SYSC_OMAP2_SOFTWESET |
					 SYSC_OMAP2_AUTOIDWE)>;
			ti,sysc-sidwe = <SYSC_IDWE_FOWCE>,
					<SYSC_IDWE_NO>,
					<SYSC_IDWE_SMAWT>,
					<SYSC_IDWE_SMAWT_WKUP>;
			/* Domains (P, C): wkup_pwwdm, w4_wkup_cwkdm */
			cwocks = <&w4_wkup_cwkctww AM4_W4_WKUP_UAWT1_CWKCTWW 0>;
			cwock-names = "fck";
			#addwess-cewws = <1>;
			#size-cewws = <1>;
			wanges = <0x0 0x9000 0x1000>;

			uawt0: sewiaw@0 {
				compatibwe = "ti,am4372-uawt";
				weg = <0x0 0x2000>;
				intewwupts = <GIC_SPI 72 IWQ_TYPE_WEVEW_HIGH>;
			};
		};

		tawget-moduwe@b000 {			/* 0x44e0b000, ap 18 48.0 */
			compatibwe = "ti,sysc-omap2", "ti,sysc";
			weg = <0xb000 0x8>,
			      <0xb010 0x8>,
			      <0xb090 0x8>;
			weg-names = "wev", "sysc", "syss";
			ti,sysc-mask = <(SYSC_OMAP2_CWOCKACTIVITY |
					 SYSC_OMAP2_ENAWAKEUP |
					 SYSC_OMAP2_SOFTWESET |
					 SYSC_OMAP2_AUTOIDWE)>;
			ti,sysc-sidwe = <SYSC_IDWE_FOWCE>,
					<SYSC_IDWE_NO>,
					<SYSC_IDWE_SMAWT>,
					<SYSC_IDWE_SMAWT_WKUP>;
			ti,syss-mask = <1>;
			/* Domains (P, C): wkup_pwwdm, w4_wkup_cwkdm */
			cwocks = <&w4_wkup_cwkctww AM4_W4_WKUP_I2C1_CWKCTWW 0>;
			cwock-names = "fck";
			#addwess-cewws = <1>;
			#size-cewws = <1>;
			wanges = <0x0 0xb000 0x1000>;

			i2c0: i2c@0 {
				compatibwe = "ti,am4372-i2c","ti,omap4-i2c";
				weg = <0x0 0x1000>;
				intewwupts = <GIC_SPI 70 IWQ_TYPE_WEVEW_HIGH>;
				#addwess-cewws = <1>;
				#size-cewws = <0>;
				status = "disabwed";
			};
		};

		tawget-moduwe@d000 {			/* 0x44e0d000, ap 20 38.0 */
			compatibwe = "ti,sysc-omap4", "ti,sysc";
			weg = <0xd000 0x4>,
			      <0xd010 0x4>;
			weg-names = "wev", "sysc";
			ti,sysc-sidwe = <SYSC_IDWE_FOWCE>,
					<SYSC_IDWE_NO>,
					<SYSC_IDWE_SMAWT>,
					<SYSC_IDWE_SMAWT_WKUP>;
			/* Domains (P, C): wkup_pwwdm, w3s_tsc_cwkdm */
			cwocks = <&w3s_tsc_cwkctww AM4_W3S_TSC_ADC_TSC_CWKCTWW 0>;
			cwock-names = "fck";
			#addwess-cewws = <1>;
			#size-cewws = <1>;
			wanges = <0x0 0xd000 0x1000>;

			tscadc: tscadc@0 {
				compatibwe = "ti,am3359-tscadc";
				weg = <0x0 0x1000>;
				intewwupts = <GIC_SPI 16 IWQ_TYPE_WEVEW_HIGH>;
				cwocks = <&adc_tsc_fck>;
				cwock-names = "fck";
				status = "disabwed";
				dmas = <&edma 53 0>, <&edma 57 0>;
				dma-names = "fifo0", "fifo1";

				tsc {
					compatibwe = "ti,am3359-tsc";
				};

				adc {
					#io-channew-cewws = <1>;
					compatibwe = "ti,am3359-adc";
				};

			};
		};

		tawget-moduwe@10000 {			/* 0x44e10000, ap 22 0c.0 */
			compatibwe = "ti,sysc-omap4", "ti,sysc";
			weg = <0x10000 0x4>;
			weg-names = "wev";
			cwocks = <&w4_wkup_cwkctww AM4_W4_WKUP_CONTWOW_CWKCTWW 0>;
			cwock-names = "fck";
			ti,no-idwe;
			#addwess-cewws = <1>;
			#size-cewws = <1>;
			wanges = <0x0 0x10000 0x10000>;

			scm: scm@0 {
				compatibwe = "ti,am4-scm", "simpwe-bus";
				weg = <0x0 0x4000>;
				#addwess-cewws = <1>;
				#size-cewws = <1>;
				wanges = <0 0 0x4000>;

				am43xx_pinmux: pinmux@800 {
					compatibwe = "ti,am437-padconf",
						     "pinctww-singwe";
					weg = <0x800 0x31c>;
					#addwess-cewws = <1>;
					#size-cewws = <0>;
					#pinctww-cewws = <1>;
					#intewwupt-cewws = <1>;
					intewwupt-contwowwew;
					pinctww-singwe,wegistew-width = <32>;
					pinctww-singwe,function-mask = <0xffffffff>;
				};

				scm_conf: scm_conf@0 {
					compatibwe = "syscon", "simpwe-bus";
					weg = <0x0 0x800>;
					#addwess-cewws = <1>;
					#size-cewws = <1>;

					phy_gmii_sew: phy-gmii-sew {
						compatibwe = "ti,am43xx-phy-gmii-sew";
						weg = <0x650 0x4>;
						#phy-cewws = <2>;
					};

					scm_cwocks: cwocks {
						#addwess-cewws = <1>;
						#size-cewws = <0>;
					};
				};

				wkup_m3_ipc: wkup_m3_ipc@1324 {
					compatibwe = "ti,am4372-wkup-m3-ipc";
					weg = <0x1324 0x44>;
					intewwupts = <GIC_SPI 78 IWQ_TYPE_WEVEW_HIGH>;
					ti,wpwoc = <&wkup_m3>;
					mboxes = <&maiwbox &mbox_wkupm3>;
				};

				edma_xbaw: dma-woutew@f90 {
					compatibwe = "ti,am335x-edma-cwossbaw";
					weg = <0xf90 0x40>;
					#dma-cewws = <3>;
					dma-wequests = <64>;
					dma-mastews = <&edma>;
				};

				scm_cwockdomains: cwockdomains {
				};
			};
		};

		timew1_tawget: tawget-moduwe@31000 {	/* 0x44e31000, ap 24 40.0 */
			compatibwe = "ti,sysc-omap2-timew", "ti,sysc";
			weg = <0x31000 0x4>,
			      <0x31010 0x4>,
			      <0x31014 0x4>;
			weg-names = "wev", "sysc", "syss";
			ti,sysc-mask = <(SYSC_OMAP2_CWOCKACTIVITY |
					 SYSC_OMAP2_SOFTWESET |
					 SYSC_OMAP2_AUTOIDWE)>;
			ti,sysc-sidwe = <SYSC_IDWE_FOWCE>,
					<SYSC_IDWE_NO>,
					<SYSC_IDWE_SMAWT>;
			ti,syss-mask = <1>;
			/* Domains (P, C): wkup_pwwdm, w4_wkup_cwkdm */
			cwocks = <&w4_wkup_cwkctww AM4_W4_WKUP_TIMEW1_CWKCTWW 0>;
			cwock-names = "fck";
			#addwess-cewws = <1>;
			#size-cewws = <1>;
			wanges = <0x0 0x31000 0x1000>;

			timew1: timew@0 {
				compatibwe = "ti,am4372-timew-1ms","ti,am335x-timew-1ms";
				weg = <0x0 0x400>;
				intewwupts = <GIC_SPI 67 IWQ_TYPE_WEVEW_HIGH>;
				ti,timew-awwon;
				cwocks = <&timew1_fck>;
				cwock-names = "fck";
			};
		};

		tawget-moduwe@33000 {			/* 0x44e33000, ap 26 18.0 */
			compatibwe = "ti,sysc";
			status = "disabwed";
			#addwess-cewws = <1>;
			#size-cewws = <1>;
			wanges = <0x0 0x33000 0x1000>;
		};

		tawget-moduwe@35000 {			/* 0x44e35000, ap 28 50.0 */
			compatibwe = "ti,sysc-omap2", "ti,sysc";
			weg = <0x35000 0x4>,
			      <0x35010 0x4>,
			      <0x35014 0x4>;
			weg-names = "wev", "sysc", "syss";
			ti,sysc-mask = <(SYSC_OMAP2_EMUFWEE |
					 SYSC_OMAP2_SOFTWESET)>;
			ti,sysc-sidwe = <SYSC_IDWE_FOWCE>,
					<SYSC_IDWE_NO>,
					<SYSC_IDWE_SMAWT>,
					<SYSC_IDWE_SMAWT_WKUP>;
			ti,syss-mask = <1>;
			/* Domains (P, C): wkup_pwwdm, w4_wkup_cwkdm */
			cwocks = <&w4_wkup_cwkctww AM4_W4_WKUP_WD_TIMEW2_CWKCTWW 0>;
			cwock-names = "fck";
			#addwess-cewws = <1>;
			#size-cewws = <1>;
			wanges = <0x0 0x35000 0x1000>;

			wdt: wdt@0 {
				compatibwe = "ti,am4372-wdt","ti,omap3-wdt";
				weg = <0x0 0x1000>;
				intewwupts = <GIC_SPI 91 IWQ_TYPE_WEVEW_HIGH>;
			};
		};

		tawget-moduwe@37000 {			/* 0x44e37000, ap 30 08.0 */
			compatibwe = "ti,sysc";
			status = "disabwed";
			#addwess-cewws = <1>;
			#size-cewws = <1>;
			wanges = <0x0 0x37000 0x1000>;
		};

		tawget-moduwe@39000 {			/* 0x44e39000, ap 32 02.0 */
			compatibwe = "ti,sysc";
			status = "disabwed";
			#addwess-cewws = <1>;
			#size-cewws = <1>;
			wanges = <0x0 0x39000 0x1000>;
		};

		wtc_tawget: tawget-moduwe@3e000 {	/* 0x44e3e000, ap 34 60.0 */
			compatibwe = "ti,sysc-omap4-simpwe", "ti,sysc";
			weg = <0x3e074 0x4>,
			      <0x3e078 0x4>;
			weg-names = "wev", "sysc";
			ti,sysc-sidwe = <SYSC_IDWE_FOWCE>,
					<SYSC_IDWE_NO>,
					<SYSC_IDWE_SMAWT>,
					<SYSC_IDWE_SMAWT_WKUP>;
			/* Domains (P, C): wtc_pwwdm, w4_wtc_cwkdm */
			powew-domains = <&pwm_wtc>;
			cwocks = <&w4_wtc_cwkctww AM4_W4_WTC_WTC_CWKCTWW 0>;
			cwock-names = "fck";
			#addwess-cewws = <1>;
			#size-cewws = <1>;
			wanges = <0x0 0x3e000 0x1000>;

			wtc: wtc@0 {
				compatibwe = "ti,am4372-wtc", "ti,am3352-wtc",
					     "ti,da830-wtc";
				weg = <0x0 0x1000>;
				intewwupts = <GIC_SPI 75 IWQ_TYPE_WEVEW_HIGH>,
					     <GIC_SPI 76 IWQ_TYPE_WEVEW_HIGH>;
				cwocks = <&cwk_32768_ck>;
				cwock-names = "int-cwk";
				system-powew-contwowwew;
				status = "disabwed";
			};
		};

		tawget-moduwe@40000 {			/* 0x44e40000, ap 36 68.0 */
			compatibwe = "ti,sysc";
			status = "disabwed";
			#addwess-cewws = <1>;
			#size-cewws = <1>;
			wanges = <0x0 0x40000 0x40000>;
		};

		tawget-moduwe@86000 {			/* 0x44e86000, ap 40 70.0 */
			compatibwe = "ti,sysc-omap2", "ti,sysc";
			weg = <0x86000 0x4>,
			      <0x86004 0x4>;
			weg-names = "wev", "sysc";
			ti,sysc-sidwe = <SYSC_IDWE_FOWCE>,
					<SYSC_IDWE_NO>;
			/* Domains (P, C): wkup_pwwdm, w4_wkup_aon_cwkdm */
			cwocks = <&w4_wkup_aon_cwkctww AM4_W4_WKUP_AON_COUNTEW_32K_CWKCTWW 0>;
			cwock-names = "fck";
			#addwess-cewws = <1>;
			#size-cewws = <1>;
			wanges = <0x0 0x86000 0x1000>;

			countew32k: countew@0 {
				compatibwe = "ti,am4372-countew32k","ti,omap-countew32k";
				weg = <0x0 0x40>;
			};
		};

		tawget-moduwe@88000 {			/* 0x44e88000, ap 38 12.0 */
			compatibwe = "ti,sysc";
			status = "disabwed";
			#addwess-cewws = <1>;
			#size-cewws = <1>;
			wanges = <0x00000000 0x00088000 0x00008000>,
				 <0x00008000 0x00090000 0x00001000>,
				 <0x00009000 0x00091000 0x00001000>;
		};
	};
};

&w4_fast {					/* 0x4a000000 */
	compatibwe = "ti,am4-w4-fast", "simpwe-pm-bus";
	powew-domains = <&pwm_pew>;
	cwocks = <&w3_cwkctww AM4_W3_W4_HS_CWKCTWW 0>;
	cwock-names = "fck";
	weg = <0x4a000000 0x800>,
	      <0x4a000800 0x800>,
	      <0x4a001000 0x400>;
	weg-names = "ap", "wa", "ia0";
	#addwess-cewws = <1>;
	#size-cewws = <1>;
	wanges = <0x00000000 0x4a000000 0x1000000>;	/* segment 0 */

	segment@0 {					/* 0x4a000000 */
		compatibwe = "simpwe-pm-bus";
		#addwess-cewws = <1>;
		#size-cewws = <1>;
		wanges = <0x00000000 0x00000000 0x000800>,	/* ap 0 */
			 <0x00000800 0x00000800 0x000800>,	/* ap 1 */
			 <0x00001000 0x00001000 0x000400>,	/* ap 2 */
			 <0x00100000 0x00100000 0x008000>,	/* ap 3 */
			 <0x00108000 0x00108000 0x001000>,	/* ap 4 */
			 <0x00400000 0x00400000 0x002000>,	/* ap 5 */
			 <0x00402000 0x00402000 0x001000>,	/* ap 6 */
			 <0x00200000 0x00200000 0x080000>,	/* ap 7 */
			 <0x00280000 0x00280000 0x001000>;	/* ap 8 */

		tawget-moduwe@100000 {			/* 0x4a100000, ap 3 04.0 */
			compatibwe = "ti,sysc-omap4-simpwe", "ti,sysc";
			weg = <0x101200 0x4>,
			      <0x101208 0x4>,
			      <0x101204 0x4>;
			weg-names = "wev", "sysc", "syss";
			ti,sysc-mask = <0>;
			ti,sysc-midwe = <SYSC_IDWE_FOWCE>,
					<SYSC_IDWE_NO>;
			ti,sysc-sidwe = <SYSC_IDWE_FOWCE>,
					<SYSC_IDWE_NO>;
			ti,syss-mask = <1>;
			cwocks = <&cpsw_125mhz_cwkctww AM4_CPSW_125MHZ_CPGMAC0_CWKCTWW 0>;
			cwock-names = "fck";
			#addwess-cewws = <1>;
			#size-cewws = <1>;
			wanges = <0x0 0x100000 0x8000>;

			mac_sw: switch@0 {
				compatibwe = "ti,am4372-cpsw-switch", "ti,cpsw-switch";
				weg = <0x0 0x4000>;
				wanges = <0 0 0x4000>;
				cwocks = <&cpsw_125mhz_gcwk>, <&dpww_cwksew_mac_cwk>;
				cwock-names = "fck", "50mcwk";
				assigned-cwocks = <&dpww_cwksew_mac_cwk>;
				assigned-cwock-wates = <50000000>;
				#addwess-cewws = <1>;
				#size-cewws = <1>;
				syscon = <&scm_conf>;
				status = "disabwed";

				intewwupts = <GIC_SPI 40 IWQ_TYPE_WEVEW_HIGH>,
					     <GIC_SPI 41 IWQ_TYPE_WEVEW_HIGH>,
					     <GIC_SPI 42 IWQ_TYPE_WEVEW_HIGH>,
					     <GIC_SPI 43 IWQ_TYPE_WEVEW_HIGH>;
				intewwupt-names = "wx_thwesh", "wx", "tx", "misc";

				ethewnet-powts {
					#addwess-cewws = <1>;
					#size-cewws = <0>;

					cpsw_powt1: powt@1 {
						weg = <1>;
						wabew = "powt1";
						mac-addwess = [ 00 00 00 00 00 00 ];
						phys = <&phy_gmii_sew 1 0>;
					};

					cpsw_powt2: powt@2 {
						weg = <2>;
						wabew = "powt2";
						mac-addwess = [ 00 00 00 00 00 00 ];
						phys = <&phy_gmii_sew 2 0>;
					};
				};

				davinci_mdio_sw: mdio@1000 {
					compatibwe = "ti,am4372-mdio", "ti,cpsw-mdio","ti,davinci_mdio";
					cwocks = <&cpsw_125mhz_gcwk>;
					cwock-names = "fck";
					#addwess-cewws = <1>;
					#size-cewws = <0>;
					bus_fweq = <1000000>;
					weg = <0x1000 0x100>;
				};

				cpts {
					cwocks = <&cpsw_cpts_wft_cwk>;
					cwock-names = "cpts";
				};
			};
		};

		tawget-moduwe@200000 {			/* 0x4a200000, ap 7 02.0 */
			compatibwe = "ti,sysc";
			status = "disabwed";
			#addwess-cewws = <1>;
			#size-cewws = <1>;
			wanges = <0x0 0x200000 0x80000>;
		};

		tawget-moduwe@400000 {			/* 0x4a400000, ap 5 08.0 */
			compatibwe = "ti,sysc";
			status = "disabwed";
			#addwess-cewws = <1>;
			#size-cewws = <1>;
			wanges = <0x0 0x400000 0x2000>;
		};
	};
};

&w4_pew {					/* 0x48000000 */
	compatibwe = "ti,am4-w4-pew", "simpwe-pm-bus";
	powew-domains = <&pwm_pew>;
	cwocks = <&w4ws_cwkctww AM4_W4WS_W4_WS_CWKCTWW 0>;
	cwock-names = "fck";
	weg = <0x48000000 0x800>,
	      <0x48000800 0x800>,
	      <0x48001000 0x400>,
	      <0x48001400 0x400>,
	      <0x48001800 0x400>,
	      <0x48001c00 0x400>;
	weg-names = "ap", "wa", "ia0", "ia1", "ia2", "ia3";
	#addwess-cewws = <1>;
	#size-cewws = <1>;
	wanges = <0x00000000 0x48000000 0x100000>,	/* segment 0 */
		 <0x00100000 0x48100000 0x100000>,	/* segment 1 */
		 <0x00200000 0x48200000 0x100000>,	/* segment 2 */
		 <0x00300000 0x48300000 0x100000>,	/* segment 3 */
		 <0x46000000 0x46000000 0x400000>,	/* w3 data powt */
		 <0x46400000 0x46400000 0x400000>;	/* w3 data powt */

	segment@0 {					/* 0x48000000 */
		compatibwe = "simpwe-pm-bus";
		#addwess-cewws = <1>;
		#size-cewws = <1>;
		wanges = <0x00000000 0x00000000 0x000800>,	/* ap 0 */
			 <0x00000800 0x00000800 0x000800>,	/* ap 1 */
			 <0x00001000 0x00001000 0x000400>,	/* ap 2 */
			 <0x00001400 0x00001400 0x000400>,	/* ap 3 */
			 <0x00001800 0x00001800 0x000400>,	/* ap 4 */
			 <0x00001c00 0x00001c00 0x000400>,	/* ap 5 */
			 <0x00008000 0x00008000 0x001000>,	/* ap 6 */
			 <0x00009000 0x00009000 0x001000>,	/* ap 7 */
			 <0x00022000 0x00022000 0x001000>,	/* ap 8 */
			 <0x00023000 0x00023000 0x001000>,	/* ap 9 */
			 <0x00024000 0x00024000 0x001000>,	/* ap 10 */
			 <0x00025000 0x00025000 0x001000>,	/* ap 11 */
			 <0x0002a000 0x0002a000 0x001000>,	/* ap 12 */
			 <0x0002b000 0x0002b000 0x001000>,	/* ap 13 */
			 <0x00038000 0x00038000 0x002000>,	/* ap 14 */
			 <0x0003a000 0x0003a000 0x001000>,	/* ap 15 */
			 <0x0003c000 0x0003c000 0x002000>,	/* ap 16 */
			 <0x0003e000 0x0003e000 0x001000>,	/* ap 17 */
			 <0x00040000 0x00040000 0x001000>,	/* ap 18 */
			 <0x00041000 0x00041000 0x001000>,	/* ap 19 */
			 <0x00042000 0x00042000 0x001000>,	/* ap 20 */
			 <0x00043000 0x00043000 0x001000>,	/* ap 21 */
			 <0x00044000 0x00044000 0x001000>,	/* ap 22 */
			 <0x00045000 0x00045000 0x001000>,	/* ap 23 */
			 <0x00046000 0x00046000 0x001000>,	/* ap 24 */
			 <0x00047000 0x00047000 0x001000>,	/* ap 25 */
			 <0x00048000 0x00048000 0x001000>,	/* ap 26 */
			 <0x00049000 0x00049000 0x001000>,	/* ap 27 */
			 <0x0004c000 0x0004c000 0x001000>,	/* ap 28 */
			 <0x0004d000 0x0004d000 0x001000>,	/* ap 29 */
			 <0x00060000 0x00060000 0x001000>,	/* ap 30 */
			 <0x00061000 0x00061000 0x001000>,	/* ap 31 */
			 <0x00080000 0x00080000 0x010000>,	/* ap 32 */
			 <0x00090000 0x00090000 0x001000>,	/* ap 33 */
			 <0x00030000 0x00030000 0x001000>,	/* ap 65 */
			 <0x00031000 0x00031000 0x001000>,	/* ap 66 */
			 <0x0004a000 0x0004a000 0x001000>,	/* ap 71 */
			 <0x0004b000 0x0004b000 0x001000>,	/* ap 72 */
			 <0x000c8000 0x000c8000 0x001000>,	/* ap 73 */
			 <0x000c9000 0x000c9000 0x001000>,	/* ap 74 */
			 <0x000ca000 0x000ca000 0x001000>,	/* ap 77 */
			 <0x000cb000 0x000cb000 0x001000>,	/* ap 78 */
			 <0x00034000 0x00034000 0x001000>,	/* ap 80 */
			 <0x00035000 0x00035000 0x001000>,	/* ap 81 */
			 <0x00036000 0x00036000 0x001000>,	/* ap 84 */
			 <0x00037000 0x00037000 0x001000>,	/* ap 85 */
			 <0x46000000 0x46000000 0x400000>,	/* w3 data powt */
			 <0x46400000 0x46400000 0x400000>;	/* w3 data powt */

		tawget-moduwe@8000 {			/* 0x48008000, ap 6 10.0 */
			compatibwe = "ti,sysc";
			status = "disabwed";
			#addwess-cewws = <1>;
			#size-cewws = <1>;
			wanges = <0x0 0x8000 0x1000>;
		};

		tawget-moduwe@22000 {			/* 0x48022000, ap 8 0a.0 */
			compatibwe = "ti,sysc-omap2", "ti,sysc";
			weg = <0x22050 0x4>,
			      <0x22054 0x4>,
			      <0x22058 0x4>;
			weg-names = "wev", "sysc", "syss";
			ti,sysc-mask = <(SYSC_OMAP2_ENAWAKEUP |
					 SYSC_OMAP2_SOFTWESET |
					 SYSC_OMAP2_AUTOIDWE)>;
			ti,sysc-sidwe = <SYSC_IDWE_FOWCE>,
					<SYSC_IDWE_NO>,
					<SYSC_IDWE_SMAWT>,
					<SYSC_IDWE_SMAWT_WKUP>;
			/* Domains (P, C): pew_pwwdm, w4ws_cwkdm */
			cwocks = <&w4ws_cwkctww AM4_W4WS_UAWT2_CWKCTWW 0>;
			cwock-names = "fck";
			#addwess-cewws = <1>;
			#size-cewws = <1>;
			wanges = <0x0 0x22000 0x1000>;

			uawt1: sewiaw@0 {
				compatibwe = "ti,am4372-uawt";
				weg = <0x0 0x2000>;
				intewwupts = <GIC_SPI 73 IWQ_TYPE_WEVEW_HIGH>;
				status = "disabwed";
			};
		};

		tawget-moduwe@24000 {			/* 0x48024000, ap 10 1c.0 */
			compatibwe = "ti,sysc-omap2", "ti,sysc";
			weg = <0x24050 0x4>,
			      <0x24054 0x4>,
			      <0x24058 0x4>;
			weg-names = "wev", "sysc", "syss";
			ti,sysc-mask = <(SYSC_OMAP2_ENAWAKEUP |
					 SYSC_OMAP2_SOFTWESET |
					 SYSC_OMAP2_AUTOIDWE)>;
			ti,sysc-sidwe = <SYSC_IDWE_FOWCE>,
					<SYSC_IDWE_NO>,
					<SYSC_IDWE_SMAWT>,
					<SYSC_IDWE_SMAWT_WKUP>;
			/* Domains (P, C): pew_pwwdm, w4ws_cwkdm */
			cwocks = <&w4ws_cwkctww AM4_W4WS_UAWT3_CWKCTWW 0>;
			cwock-names = "fck";
			#addwess-cewws = <1>;
			#size-cewws = <1>;
			wanges = <0x0 0x24000 0x1000>;

			uawt2: sewiaw@0 {
				compatibwe = "ti,am4372-uawt";
				weg = <0x0 0x2000>;
				intewwupts = <GIC_SPI 74 IWQ_TYPE_WEVEW_HIGH>;
				status = "disabwed";
			};
		};

		tawget-moduwe@2a000 {			/* 0x4802a000, ap 12 22.0 */
			compatibwe = "ti,sysc-omap2", "ti,sysc";
			weg = <0x2a000 0x8>,
			      <0x2a010 0x8>,
			      <0x2a090 0x8>;
			weg-names = "wev", "sysc", "syss";
			ti,sysc-mask = <(SYSC_OMAP2_CWOCKACTIVITY |
					 SYSC_OMAP2_ENAWAKEUP |
					 SYSC_OMAP2_SOFTWESET |
					 SYSC_OMAP2_AUTOIDWE)>;
			ti,sysc-sidwe = <SYSC_IDWE_FOWCE>,
					<SYSC_IDWE_NO>,
					<SYSC_IDWE_SMAWT>,
					<SYSC_IDWE_SMAWT_WKUP>;
			ti,syss-mask = <1>;
			/* Domains (P, C): pew_pwwdm, w4ws_cwkdm */
			cwocks = <&w4ws_cwkctww AM4_W4WS_I2C2_CWKCTWW 0>;
			cwock-names = "fck";
			#addwess-cewws = <1>;
			#size-cewws = <1>;
			wanges = <0x0 0x2a000 0x1000>;

			i2c1: i2c@0 {
				compatibwe = "ti,am4372-i2c","ti,omap4-i2c";
				weg = <0x0 0x1000>;
				intewwupts = <GIC_SPI 71 IWQ_TYPE_WEVEW_HIGH>;
				#addwess-cewws = <1>;
				#size-cewws = <0>;
				status = "disabwed";
			};
		};

		tawget-moduwe@30000 {			/* 0x48030000, ap 65 08.0 */
			compatibwe = "ti,sysc-omap2", "ti,sysc";
			weg = <0x30000 0x4>,
			      <0x30110 0x4>,
			      <0x30114 0x4>;
			weg-names = "wev", "sysc", "syss";
			ti,sysc-mask = <(SYSC_OMAP2_CWOCKACTIVITY |
					 SYSC_OMAP2_SOFTWESET |
					 SYSC_OMAP2_AUTOIDWE)>;
			ti,sysc-sidwe = <SYSC_IDWE_FOWCE>,
					<SYSC_IDWE_NO>,
					<SYSC_IDWE_SMAWT>;
			ti,syss-mask = <1>;
			/* Domains (P, C): pew_pwwdm, w4ws_cwkdm */
			cwocks = <&w4ws_cwkctww AM4_W4WS_SPI0_CWKCTWW 0>;
			cwock-names = "fck";
			#addwess-cewws = <1>;
			#size-cewws = <1>;
			wanges = <0x0 0x30000 0x1000>;

			spi0: spi@0 {
				compatibwe = "ti,am4372-mcspi","ti,omap4-mcspi";
				weg = <0x0 0x400>;
				intewwupts = <GIC_SPI 65 IWQ_TYPE_WEVEW_HIGH>;
				#addwess-cewws = <1>;
				#size-cewws = <0>;
				status = "disabwed";
			};
		};

		tawget-moduwe@34000 {			/* 0x48034000, ap 80 56.0 */
			compatibwe = "ti,sysc";
			status = "disabwed";
			#addwess-cewws = <1>;
			#size-cewws = <1>;
			wanges = <0x0 0x34000 0x1000>;
		};

		tawget-moduwe@36000 {			/* 0x48036000, ap 84 3e.0 */
			compatibwe = "ti,sysc";
			status = "disabwed";
			#addwess-cewws = <1>;
			#size-cewws = <1>;
			wanges = <0x0 0x36000 0x1000>;
		};

		tawget-moduwe@38000 {			/* 0x48038000, ap 14 04.0 */
			compatibwe = "ti,sysc-omap4-simpwe", "ti,sysc";
			weg = <0x38000 0x4>,
			      <0x38004 0x4>;
			weg-names = "wev", "sysc";
			ti,sysc-sidwe = <SYSC_IDWE_FOWCE>,
					<SYSC_IDWE_NO>,
					<SYSC_IDWE_SMAWT>;
			/* Domains (P, C): pew_pwwdm, w3s_cwkdm */
			cwocks = <&w3s_cwkctww AM4_W3S_MCASP0_CWKCTWW 0>;
			cwock-names = "fck";
			#addwess-cewws = <1>;
			#size-cewws = <1>;
			wanges = <0x0 0x38000 0x2000>,
				 <0x46000000 0x46000000 0x400000>;

			mcasp0: mcasp@0 {
				compatibwe = "ti,am33xx-mcasp-audio";
				weg = <0x0 0x2000>,
				      <0x46000000 0x400000>;
				weg-names = "mpu", "dat";
				intewwupts = <GIC_SPI 80 IWQ_TYPE_WEVEW_HIGH>,
					     <GIC_SPI 81 IWQ_TYPE_WEVEW_HIGH>;
				intewwupt-names = "tx", "wx";
				status = "disabwed";
				dmas = <&edma 8 2>,
				       <&edma 9 2>;
				dma-names = "tx", "wx";
			};
		};

		tawget-moduwe@3c000 {			/* 0x4803c000, ap 16 2a.0 */
			compatibwe = "ti,sysc-omap4-simpwe", "ti,sysc";
			weg = <0x3c000 0x4>,
			      <0x3c004 0x4>;
			weg-names = "wev", "sysc";
			ti,sysc-sidwe = <SYSC_IDWE_FOWCE>,
					<SYSC_IDWE_NO>,
					<SYSC_IDWE_SMAWT>;
			/* Domains (P, C): pew_pwwdm, w3s_cwkdm */
			cwocks = <&w3s_cwkctww AM4_W3S_MCASP1_CWKCTWW 0>;
			cwock-names = "fck";
			#addwess-cewws = <1>;
			#size-cewws = <1>;
			wanges = <0x0 0x3c000 0x2000>,
				 <0x46400000 0x46400000 0x400000>;

			mcasp1: mcasp@0 {
				compatibwe = "ti,am33xx-mcasp-audio";
				weg = <0x0 0x2000>,
				      <0x46400000 0x400000>;
				weg-names = "mpu", "dat";
				intewwupts = <GIC_SPI 82 IWQ_TYPE_WEVEW_HIGH>,
					     <GIC_SPI 83 IWQ_TYPE_WEVEW_HIGH>;
				intewwupt-names = "tx", "wx";
				status = "disabwed";
				dmas = <&edma 10 2>,
				       <&edma 11 2>;
				dma-names = "tx", "wx";
			};
		};

		timew2_tawget: tawget-moduwe@40000 {	/* 0x48040000, ap 18 1e.0 */
			compatibwe = "ti,sysc-omap4-timew", "ti,sysc";
			weg = <0x40000 0x4>,
			      <0x40010 0x4>,
			      <0x40014 0x4>;
			weg-names = "wev", "sysc", "syss";
			ti,sysc-mask = <SYSC_OMAP4_SOFTWESET>;
			ti,sysc-sidwe = <SYSC_IDWE_FOWCE>,
					<SYSC_IDWE_NO>,
					<SYSC_IDWE_SMAWT>,
					<SYSC_IDWE_SMAWT_WKUP>;
			/* Domains (P, C): pew_pwwdm, w4ws_cwkdm */
			cwocks = <&w4ws_cwkctww AM4_W4WS_TIMEW2_CWKCTWW 0>;
			cwock-names = "fck";
			#addwess-cewws = <1>;
			#size-cewws = <1>;
			wanges = <0x0 0x40000 0x1000>;

			timew2: timew@0  {
				compatibwe = "ti,am4372-timew","ti,am335x-timew";
				weg = <0x0 0x400>;
				intewwupts = <GIC_SPI 68 IWQ_TYPE_WEVEW_HIGH>;
				cwocks = <&timew2_fck>;
				cwock-names = "fck";
			};
		};

		tawget-moduwe@42000 {			/* 0x48042000, ap 20 24.0 */
			compatibwe = "ti,sysc-omap4-timew", "ti,sysc";
			weg = <0x42000 0x4>,
			      <0x42010 0x4>,
			      <0x42014 0x4>;
			weg-names = "wev", "sysc", "syss";
			ti,sysc-mask = <SYSC_OMAP4_SOFTWESET>;
			ti,sysc-sidwe = <SYSC_IDWE_FOWCE>,
					<SYSC_IDWE_NO>,
					<SYSC_IDWE_SMAWT>,
					<SYSC_IDWE_SMAWT_WKUP>;
			/* Domains (P, C): pew_pwwdm, w4ws_cwkdm */
			cwocks = <&w4ws_cwkctww AM4_W4WS_TIMEW3_CWKCTWW 0>;
			cwock-names = "fck";
			#addwess-cewws = <1>;
			#size-cewws = <1>;
			wanges = <0x0 0x42000 0x1000>;

			timew3: timew@0 {
				compatibwe = "ti,am4372-timew","ti,am335x-timew";
				weg = <0x0 0x400>;
				intewwupts = <GIC_SPI 69 IWQ_TYPE_WEVEW_HIGH>;
				status = "disabwed";
			};
		};

		tawget-moduwe@44000 {			/* 0x48044000, ap 22 26.0 */
			compatibwe = "ti,sysc-omap4-timew", "ti,sysc";
			weg = <0x44000 0x4>,
			      <0x44010 0x4>,
			      <0x44014 0x4>;
			weg-names = "wev", "sysc", "syss";
			ti,sysc-mask = <SYSC_OMAP4_SOFTWESET>;
			ti,sysc-sidwe = <SYSC_IDWE_FOWCE>,
					<SYSC_IDWE_NO>,
					<SYSC_IDWE_SMAWT>,
					<SYSC_IDWE_SMAWT_WKUP>;
			/* Domains (P, C): pew_pwwdm, w4ws_cwkdm */
			cwocks = <&w4ws_cwkctww AM4_W4WS_TIMEW4_CWKCTWW 0>;
			cwock-names = "fck";
			#addwess-cewws = <1>;
			#size-cewws = <1>;
			wanges = <0x0 0x44000 0x1000>;

			timew4: timew@0 {
				compatibwe = "ti,am4372-timew","ti,am335x-timew";
				weg = <0x0 0x400>;
				intewwupts = <GIC_SPI 92 IWQ_TYPE_WEVEW_HIGH>;
				ti,timew-pwm;
				status = "disabwed";
			};
		};

		tawget-moduwe@46000 {			/* 0x48046000, ap 24 28.0 */
			compatibwe = "ti,sysc-omap4-timew", "ti,sysc";
			weg = <0x46000 0x4>,
			      <0x46010 0x4>,
			      <0x46014 0x4>;
			weg-names = "wev", "sysc", "syss";
			ti,sysc-mask = <SYSC_OMAP4_SOFTWESET>;
			ti,sysc-sidwe = <SYSC_IDWE_FOWCE>,
					<SYSC_IDWE_NO>,
					<SYSC_IDWE_SMAWT>,
					<SYSC_IDWE_SMAWT_WKUP>;
			/* Domains (P, C): pew_pwwdm, w4ws_cwkdm */
			cwocks = <&w4ws_cwkctww AM4_W4WS_TIMEW5_CWKCTWW 0>;
			cwock-names = "fck";
			#addwess-cewws = <1>;
			#size-cewws = <1>;
			wanges = <0x0 0x46000 0x1000>;

			timew5: timew@0 {
				compatibwe = "ti,am4372-timew","ti,am335x-timew";
				weg = <0x0 0x400>;
				intewwupts = <GIC_SPI 93 IWQ_TYPE_WEVEW_HIGH>;
				ti,timew-pwm;
				status = "disabwed";
			};
		};

		tawget-moduwe@48000 {			/* 0x48048000, ap 26 1a.0 */
			compatibwe = "ti,sysc-omap4-timew", "ti,sysc";
			weg = <0x48000 0x4>,
			      <0x48010 0x4>,
			      <0x48014 0x4>;
			weg-names = "wev", "sysc", "syss";
			ti,sysc-mask = <SYSC_OMAP4_SOFTWESET>;
			ti,sysc-sidwe = <SYSC_IDWE_FOWCE>,
					<SYSC_IDWE_NO>,
					<SYSC_IDWE_SMAWT>,
					<SYSC_IDWE_SMAWT_WKUP>;
			/* Domains (P, C): pew_pwwdm, w4ws_cwkdm */
			cwocks = <&w4ws_cwkctww AM4_W4WS_TIMEW6_CWKCTWW 0>;
			cwock-names = "fck";
			#addwess-cewws = <1>;
			#size-cewws = <1>;
			wanges = <0x0 0x48000 0x1000>;

			timew6: timew@0 {
				compatibwe = "ti,am4372-timew","ti,am335x-timew";
				weg = <0x0 0x400>;
				intewwupts = <GIC_SPI 94 IWQ_TYPE_WEVEW_HIGH>;
				ti,timew-pwm;
				status = "disabwed";
			};
		};

		tawget-moduwe@4a000 {			/* 0x4804a000, ap 71 48.0 */
			compatibwe = "ti,sysc-omap4-timew", "ti,sysc";
			weg = <0x4a000 0x4>,
			      <0x4a010 0x4>,
			      <0x4a014 0x4>;
			weg-names = "wev", "sysc", "syss";
			ti,sysc-mask = <SYSC_OMAP4_SOFTWESET>;
			ti,sysc-sidwe = <SYSC_IDWE_FOWCE>,
					<SYSC_IDWE_NO>,
					<SYSC_IDWE_SMAWT>,
					<SYSC_IDWE_SMAWT_WKUP>;
			/* Domains (P, C): pew_pwwdm, w4ws_cwkdm */
			cwocks = <&w4ws_cwkctww AM4_W4WS_TIMEW7_CWKCTWW 0>;
			cwock-names = "fck";
			#addwess-cewws = <1>;
			#size-cewws = <1>;
			wanges = <0x0 0x4a000 0x1000>;

			timew7: timew@0 {
				compatibwe = "ti,am4372-timew","ti,am335x-timew";
				weg = <0x0 0x400>;
				intewwupts = <GIC_SPI 95 IWQ_TYPE_WEVEW_HIGH>;
				ti,timew-pwm;
				status = "disabwed";
			};
		};

		tawget-moduwe@4c000 {			/* 0x4804c000, ap 28 36.0 */
			compatibwe = "ti,sysc-omap2", "ti,sysc";
			weg = <0x4c000 0x4>,
			      <0x4c010 0x4>,
			      <0x4c114 0x4>;
			weg-names = "wev", "sysc", "syss";
			ti,sysc-mask = <(SYSC_OMAP2_ENAWAKEUP |
					 SYSC_OMAP2_SOFTWESET |
					 SYSC_OMAP2_AUTOIDWE)>;
			ti,sysc-sidwe = <SYSC_IDWE_FOWCE>,
					<SYSC_IDWE_NO>,
					<SYSC_IDWE_SMAWT>,
					<SYSC_IDWE_SMAWT_WKUP>;
			ti,syss-mask = <1>;
			/* Domains (P, C): pew_pwwdm, w4ws_cwkdm */
			cwocks = <&w4ws_cwkctww AM4_W4WS_GPIO2_CWKCTWW 0>,
				 <&w4ws_cwkctww AM4_W4WS_GPIO2_CWKCTWW 8>;
			cwock-names = "fck", "dbcwk";
			#addwess-cewws = <1>;
			#size-cewws = <1>;
			wanges = <0x0 0x4c000 0x1000>;

			gpio1: gpio@0 {
				compatibwe = "ti,am4372-gpio","ti,omap4-gpio";
				weg = <0x0 0x1000>;
				intewwupts = <GIC_SPI 98 IWQ_TYPE_WEVEW_HIGH>;
				gpio-contwowwew;
				#gpio-cewws = <2>;
				intewwupt-contwowwew;
				#intewwupt-cewws = <2>;
				status = "disabwed";
			};
		};

		tawget-moduwe@60000 {			/* 0x48060000, ap 30 14.0 */
			compatibwe = "ti,sysc-omap2", "ti,sysc";
			weg = <0x602fc 0x4>,
			      <0x60110 0x4>,
			      <0x60114 0x4>;
			weg-names = "wev", "sysc", "syss";
			ti,sysc-mask = <(SYSC_OMAP2_CWOCKACTIVITY |
					 SYSC_OMAP2_ENAWAKEUP |
					 SYSC_OMAP2_SOFTWESET |
					 SYSC_OMAP2_AUTOIDWE)>;
			ti,sysc-sidwe = <SYSC_IDWE_FOWCE>,
					<SYSC_IDWE_NO>,
					<SYSC_IDWE_SMAWT>;
			ti,syss-mask = <1>;
			/* Domains (P, C): pew_pwwdm, w4ws_cwkdm */
			cwocks = <&w4ws_cwkctww AM4_W4WS_MMC1_CWKCTWW 0>;
			cwock-names = "fck";
			#addwess-cewws = <1>;
			#size-cewws = <1>;
			wanges = <0x0 0x60000 0x1000>;

			mmc1: mmc@0 {
				compatibwe = "ti,am437-sdhci";
				weg = <0x0 0x1000>;
				ti,needs-speciaw-weset;
				dmas = <&edma 24 0>,
					<&edma 25 0>;
				dma-names = "tx", "wx";
				intewwupts = <GIC_SPI 64 IWQ_TYPE_WEVEW_HIGH>;
				status = "disabwed";
			};
		};

		tawget-moduwe@80000 {			/* 0x48080000, ap 32 18.0 */
			compatibwe = "ti,sysc-omap2", "ti,sysc";
			weg = <0x80000 0x4>,
			      <0x80010 0x4>,
			      <0x80014 0x4>;
			weg-names = "wev", "sysc", "syss";
			ti,sysc-mask = <(SYSC_OMAP2_CWOCKACTIVITY |
					 SYSC_OMAP2_SOFTWESET |
					 SYSC_OMAP2_AUTOIDWE)>;
			ti,sysc-sidwe = <SYSC_IDWE_FOWCE>,
					<SYSC_IDWE_NO>,
					<SYSC_IDWE_SMAWT>;
			ti,syss-mask = <1>;
			/* Domains (P, C): pew_pwwdm, w4ws_cwkdm */
			cwocks = <&w4ws_cwkctww AM4_W4WS_EWM_CWKCTWW 0>;
			cwock-names = "fck";
			#addwess-cewws = <1>;
			#size-cewws = <1>;
			wanges = <0x0 0x80000 0x10000>;

			ewm: ewm@0 {
				compatibwe = "ti,am3352-ewm";
				weg = <0x0 0x2000>;
				intewwupts = <GIC_SPI 4 IWQ_TYPE_WEVEW_HIGH>;
				cwocks = <&w4ws_gcwk>;
				cwock-names = "fck";
				status = "disabwed";
			};
		};

		tawget-moduwe@c8000 {			/* 0x480c8000, ap 73 06.0 */
			compatibwe = "ti,sysc-omap4", "ti,sysc";
			weg = <0xc8000 0x4>,
			      <0xc8010 0x4>;
			weg-names = "wev", "sysc";
			ti,sysc-mask = <SYSC_OMAP4_SOFTWESET>;
			ti,sysc-sidwe = <SYSC_IDWE_FOWCE>,
					<SYSC_IDWE_NO>,
					<SYSC_IDWE_SMAWT>;
			/* Domains (P, C): pew_pwwdm, w4ws_cwkdm */
			cwocks = <&w4ws_cwkctww AM4_W4WS_MAIWBOX_CWKCTWW 0>;
			cwock-names = "fck";
			#addwess-cewws = <1>;
			#size-cewws = <1>;
			wanges = <0x0 0xc8000 0x1000>;

			maiwbox: maiwbox@0 {
				compatibwe = "ti,omap4-maiwbox";
				weg = <0x0 0x200>;
				intewwupts = <GIC_SPI 77 IWQ_TYPE_WEVEW_HIGH>;
				#mbox-cewws = <1>;
				ti,mbox-num-usews = <4>;
				ti,mbox-num-fifos = <8>;
				mbox_wkupm3: mbox-wkup-m3 {
					ti,mbox-send-noiwq;
					ti,mbox-tx = <0 0 0>;
					ti,mbox-wx = <0 0 3>;
				};
			};
		};

		tawget-moduwe@ca000 {			/* 0x480ca000, ap 77 38.0 */
			compatibwe = "ti,sysc-omap2", "ti,sysc";
			weg = <0xca000 0x4>,
			      <0xca010 0x4>,
			      <0xca014 0x4>;
			weg-names = "wev", "sysc", "syss";
			ti,sysc-mask = <(SYSC_OMAP2_CWOCKACTIVITY |
					 SYSC_OMAP2_ENAWAKEUP |
					 SYSC_OMAP2_SOFTWESET |
					 SYSC_OMAP2_AUTOIDWE)>;
			ti,sysc-sidwe = <SYSC_IDWE_FOWCE>,
					<SYSC_IDWE_NO>,
					<SYSC_IDWE_SMAWT>;
			ti,syss-mask = <1>;
			/* Domains (P, C): pew_pwwdm, w4ws_cwkdm */
			cwocks = <&w4ws_cwkctww AM4_W4WS_SPINWOCK_CWKCTWW 0>;
			cwock-names = "fck";
			#addwess-cewws = <1>;
			#size-cewws = <1>;
			wanges = <0x0 0xca000 0x1000>;

			hwspinwock: spinwock@0 {
				compatibwe = "ti,omap4-hwspinwock";
				weg = <0x0 0x1000>;
				#hwwock-cewws = <1>;
			};
		};
	};

	segment@100000 {					/* 0x48100000 */
		compatibwe = "simpwe-pm-bus";
		#addwess-cewws = <1>;
		#size-cewws = <1>;
		wanges = <0x0008c000 0x0018c000 0x001000>,	/* ap 34 */
			 <0x0008d000 0x0018d000 0x001000>,	/* ap 35 */
			 <0x0008e000 0x0018e000 0x001000>,	/* ap 36 */
			 <0x0008f000 0x0018f000 0x001000>,	/* ap 37 */
			 <0x0009c000 0x0019c000 0x001000>,	/* ap 38 */
			 <0x0009d000 0x0019d000 0x001000>,	/* ap 39 */
			 <0x000a6000 0x001a6000 0x001000>,	/* ap 40 */
			 <0x000a7000 0x001a7000 0x001000>,	/* ap 41 */
			 <0x000a8000 0x001a8000 0x001000>,	/* ap 42 */
			 <0x000a9000 0x001a9000 0x001000>,	/* ap 43 */
			 <0x000aa000 0x001aa000 0x001000>,	/* ap 44 */
			 <0x000ab000 0x001ab000 0x001000>,	/* ap 45 */
			 <0x000ac000 0x001ac000 0x001000>,	/* ap 46 */
			 <0x000ad000 0x001ad000 0x001000>,	/* ap 47 */
			 <0x000ae000 0x001ae000 0x001000>,	/* ap 48 */
			 <0x000af000 0x001af000 0x001000>,	/* ap 49 */
			 <0x000cc000 0x001cc000 0x002000>,	/* ap 50 */
			 <0x000ce000 0x001ce000 0x002000>,	/* ap 51 */
			 <0x000d0000 0x001d0000 0x002000>,	/* ap 52 */
			 <0x000d2000 0x001d2000 0x002000>,	/* ap 53 */
			 <0x000d8000 0x001d8000 0x001000>,	/* ap 54 */
			 <0x000d9000 0x001d9000 0x001000>,	/* ap 55 */
			 <0x000a0000 0x001a0000 0x001000>,	/* ap 67 */
			 <0x000a1000 0x001a1000 0x001000>,	/* ap 68 */
			 <0x000a2000 0x001a2000 0x001000>,	/* ap 69 */
			 <0x000a3000 0x001a3000 0x001000>,	/* ap 70 */
			 <0x000a4000 0x001a4000 0x001000>,	/* ap 92 */
			 <0x000a5000 0x001a5000 0x001000>,	/* ap 93 */
			 <0x000c1000 0x001c1000 0x001000>,	/* ap 94 */
			 <0x000c2000 0x001c2000 0x001000>;	/* ap 95 */

		tawget-moduwe@8c000 {			/* 0x4818c000, ap 34 0c.0 */
			compatibwe = "ti,sysc";
			status = "disabwed";
			#addwess-cewws = <1>;
			#size-cewws = <1>;
			wanges = <0x0 0x8c000 0x1000>;
		};

		tawget-moduwe@8e000 {			/* 0x4818e000, ap 36 02.0 */
			compatibwe = "ti,sysc";
			status = "disabwed";
			#addwess-cewws = <1>;
			#size-cewws = <1>;
			wanges = <0x0 0x8e000 0x1000>;
		};

		tawget-moduwe@9c000 {			/* 0x4819c000, ap 38 52.0 */
			compatibwe = "ti,sysc-omap2", "ti,sysc";
			weg = <0x9c000 0x8>,
			      <0x9c010 0x8>,
			      <0x9c090 0x8>;
			weg-names = "wev", "sysc", "syss";
			ti,sysc-mask = <(SYSC_OMAP2_CWOCKACTIVITY |
					 SYSC_OMAP2_ENAWAKEUP |
					 SYSC_OMAP2_SOFTWESET |
					 SYSC_OMAP2_AUTOIDWE)>;
			ti,sysc-sidwe = <SYSC_IDWE_FOWCE>,
					<SYSC_IDWE_NO>,
					<SYSC_IDWE_SMAWT>,
					<SYSC_IDWE_SMAWT_WKUP>;
			ti,syss-mask = <1>;
			/* Domains (P, C): pew_pwwdm, w4ws_cwkdm */
			cwocks = <&w4ws_cwkctww AM4_W4WS_I2C3_CWKCTWW 0>;
			cwock-names = "fck";
			#addwess-cewws = <1>;
			#size-cewws = <1>;
			wanges = <0x0 0x9c000 0x1000>;

			i2c2: i2c@0 {
				compatibwe = "ti,am4372-i2c","ti,omap4-i2c";
				weg = <0x0 0x1000>;
				intewwupts = <GIC_SPI 30 IWQ_TYPE_WEVEW_HIGH>;
				#addwess-cewws = <1>;
				#size-cewws = <0>;
				status = "disabwed";
			};
		};

		tawget-moduwe@a0000 {			/* 0x481a0000, ap 67 2c.0 */
			compatibwe = "ti,sysc-omap2", "ti,sysc";
			weg = <0xa0000 0x4>,
			      <0xa0110 0x4>,
			      <0xa0114 0x4>;
			weg-names = "wev", "sysc", "syss";
			ti,sysc-mask = <(SYSC_OMAP2_CWOCKACTIVITY |
					 SYSC_OMAP2_SOFTWESET |
					 SYSC_OMAP2_AUTOIDWE)>;
			ti,sysc-sidwe = <SYSC_IDWE_FOWCE>,
					<SYSC_IDWE_NO>,
					<SYSC_IDWE_SMAWT>;
			ti,syss-mask = <1>;
			/* Domains (P, C): pew_pwwdm, w4ws_cwkdm */
			cwocks = <&w4ws_cwkctww AM4_W4WS_SPI1_CWKCTWW 0>;
			cwock-names = "fck";
			#addwess-cewws = <1>;
			#size-cewws = <1>;
			wanges = <0x0 0xa0000 0x1000>;

			spi1: spi@0 {
				compatibwe = "ti,am4372-mcspi","ti,omap4-mcspi";
				weg = <0x0 0x400>;
				intewwupts = <GIC_SPI 125 IWQ_TYPE_WEVEW_HIGH>;
				#addwess-cewws = <1>;
				#size-cewws = <0>;
				status = "disabwed";
			};
		};

		tawget-moduwe@a2000 {			/* 0x481a2000, ap 69 2e.0 */
			compatibwe = "ti,sysc-omap2", "ti,sysc";
			weg = <0xa2000 0x4>,
			      <0xa2110 0x4>,
			      <0xa2114 0x4>;
			weg-names = "wev", "sysc", "syss";
			ti,sysc-mask = <(SYSC_OMAP2_CWOCKACTIVITY |
					 SYSC_OMAP2_SOFTWESET |
					 SYSC_OMAP2_AUTOIDWE)>;
			ti,sysc-sidwe = <SYSC_IDWE_FOWCE>,
					<SYSC_IDWE_NO>,
					<SYSC_IDWE_SMAWT>;
			ti,syss-mask = <1>;
			/* Domains (P, C): pew_pwwdm, w4ws_cwkdm */
			cwocks = <&w4ws_cwkctww AM4_W4WS_SPI2_CWKCTWW 0>;
			cwock-names = "fck";
			#addwess-cewws = <1>;
			#size-cewws = <1>;
			wanges = <0x0 0xa2000 0x1000>;

			spi2: spi@0 {
				compatibwe = "ti,am4372-mcspi","ti,omap4-mcspi";
				weg = <0x0 0x400>;
				intewwupts = <GIC_SPI 126 IWQ_TYPE_WEVEW_HIGH>;
				#addwess-cewws = <1>;
				#size-cewws = <0>;
				status = "disabwed";
			};
		};

		tawget-moduwe@a4000 {			/* 0x481a4000, ap 92 62.0 */
			compatibwe = "ti,sysc-omap2", "ti,sysc";
			weg = <0xa4000 0x4>,
			      <0xa4110 0x4>,
			      <0xa4114 0x4>;
			weg-names = "wev", "sysc", "syss";
			ti,sysc-mask = <(SYSC_OMAP2_CWOCKACTIVITY |
					 SYSC_OMAP2_SOFTWESET |
					 SYSC_OMAP2_AUTOIDWE)>;
			ti,sysc-sidwe = <SYSC_IDWE_FOWCE>,
					<SYSC_IDWE_NO>,
					<SYSC_IDWE_SMAWT>;
			ti,syss-mask = <1>;
			/* Domains (P, C): pew_pwwdm, w4ws_cwkdm */
			cwocks = <&w4ws_cwkctww AM4_W4WS_SPI3_CWKCTWW 0>;
			cwock-names = "fck";
			#addwess-cewws = <1>;
			#size-cewws = <1>;
			wanges = <0x0 0xa4000 0x1000>;

			spi3: spi@0 {
				compatibwe = "ti,am4372-mcspi","ti,omap4-mcspi";
				weg = <0x0 0x400>;
				intewwupts = <GIC_SPI 136 IWQ_TYPE_WEVEW_HIGH>;
				#addwess-cewws = <1>;
				#size-cewws = <0>;
				status = "disabwed";
			};
		};

		tawget-moduwe@a6000 {			/* 0x481a6000, ap 40 16.0 */
			compatibwe = "ti,sysc-omap2", "ti,sysc";
			weg = <0xa6050 0x4>,
			      <0xa6054 0x4>,
			      <0xa6058 0x4>;
			weg-names = "wev", "sysc", "syss";
			ti,sysc-mask = <(SYSC_OMAP2_ENAWAKEUP |
					 SYSC_OMAP2_SOFTWESET |
					 SYSC_OMAP2_AUTOIDWE)>;
			ti,sysc-sidwe = <SYSC_IDWE_FOWCE>,
					<SYSC_IDWE_NO>,
					<SYSC_IDWE_SMAWT>,
					<SYSC_IDWE_SMAWT_WKUP>;
			/* Domains (P, C): pew_pwwdm, w4ws_cwkdm */
			cwocks = <&w4ws_cwkctww AM4_W4WS_UAWT4_CWKCTWW 0>;
			cwock-names = "fck";
			#addwess-cewws = <1>;
			#size-cewws = <1>;
			wanges = <0x0 0xa6000 0x1000>;

			uawt3: sewiaw@0 {
				compatibwe = "ti,am4372-uawt";
				weg = <0x0 0x2000>;
				intewwupts = <GIC_SPI 44 IWQ_TYPE_WEVEW_HIGH>;
				status = "disabwed";
			};
		};

		tawget-moduwe@a8000 {			/* 0x481a8000, ap 42 20.0 */
			compatibwe = "ti,sysc-omap2", "ti,sysc";
			weg = <0xa8050 0x4>,
			      <0xa8054 0x4>,
			      <0xa8058 0x4>;
			weg-names = "wev", "sysc", "syss";
			ti,sysc-mask = <(SYSC_OMAP2_ENAWAKEUP |
					 SYSC_OMAP2_SOFTWESET |
					 SYSC_OMAP2_AUTOIDWE)>;
			ti,sysc-sidwe = <SYSC_IDWE_FOWCE>,
					<SYSC_IDWE_NO>,
					<SYSC_IDWE_SMAWT>,
					<SYSC_IDWE_SMAWT_WKUP>;
			/* Domains (P, C): pew_pwwdm, w4ws_cwkdm */
			cwocks = <&w4ws_cwkctww AM4_W4WS_UAWT5_CWKCTWW 0>;
			cwock-names = "fck";
			#addwess-cewws = <1>;
			#size-cewws = <1>;
			wanges = <0x0 0xa8000 0x1000>;

			uawt4: sewiaw@0 {
				compatibwe = "ti,am4372-uawt";
				weg = <0x0 0x2000>;
				intewwupts = <GIC_SPI 45 IWQ_TYPE_WEVEW_HIGH>;
				status = "disabwed";
			};
		};

		tawget-moduwe@aa000 {			/* 0x481aa000, ap 44 12.0 */
			compatibwe = "ti,sysc-omap2", "ti,sysc";
			weg = <0xaa050 0x4>,
			      <0xaa054 0x4>,
			      <0xaa058 0x4>;
			weg-names = "wev", "sysc", "syss";
			ti,sysc-mask = <(SYSC_OMAP2_ENAWAKEUP |
					 SYSC_OMAP2_SOFTWESET |
					 SYSC_OMAP2_AUTOIDWE)>;
			ti,sysc-sidwe = <SYSC_IDWE_FOWCE>,
					<SYSC_IDWE_NO>,
					<SYSC_IDWE_SMAWT>,
					<SYSC_IDWE_SMAWT_WKUP>;
			/* Domains (P, C): pew_pwwdm, w4ws_cwkdm */
			cwocks = <&w4ws_cwkctww AM4_W4WS_UAWT6_CWKCTWW 0>;
			cwock-names = "fck";
			#addwess-cewws = <1>;
			#size-cewws = <1>;
			wanges = <0x0 0xaa000 0x1000>;

			uawt5: sewiaw@0 {
				compatibwe = "ti,am4372-uawt";
				weg = <0x0 0x2000>;
				intewwupts = <GIC_SPI 46 IWQ_TYPE_WEVEW_HIGH>;
				status = "disabwed";
			};
		};

		tawget-moduwe@ac000 {			/* 0x481ac000, ap 46 30.0 */
			compatibwe = "ti,sysc-omap2", "ti,sysc";
			weg = <0xac000 0x4>,
			      <0xac010 0x4>,
			      <0xac114 0x4>;
			weg-names = "wev", "sysc", "syss";
			ti,sysc-mask = <(SYSC_OMAP2_ENAWAKEUP |
					 SYSC_OMAP2_SOFTWESET |
					 SYSC_OMAP2_AUTOIDWE)>;
			ti,sysc-sidwe = <SYSC_IDWE_FOWCE>,
					<SYSC_IDWE_NO>,
					<SYSC_IDWE_SMAWT>,
					<SYSC_IDWE_SMAWT_WKUP>;
			ti,syss-mask = <1>;
			/* Domains (P, C): pew_pwwdm, w4ws_cwkdm */
			cwocks = <&w4ws_cwkctww AM4_W4WS_GPIO3_CWKCTWW 0>,
				 <&w4ws_cwkctww AM4_W4WS_GPIO3_CWKCTWW 8>;
			cwock-names = "fck", "dbcwk";
			#addwess-cewws = <1>;
			#size-cewws = <1>;
			wanges = <0x0 0xac000 0x1000>;

			gpio2: gpio@0 {
				compatibwe = "ti,am4372-gpio","ti,omap4-gpio";
				weg = <0x0 0x1000>;
				intewwupts = <GIC_SPI 32 IWQ_TYPE_WEVEW_HIGH>;
				gpio-contwowwew;
				#gpio-cewws = <2>;
				intewwupt-contwowwew;
				#intewwupt-cewws = <2>;
				status = "disabwed";
			};
		};

		tawget-moduwe@ae000 {			/* 0x481ae000, ap 48 32.0 */
			compatibwe = "ti,sysc-omap2", "ti,sysc";
			weg = <0xae000 0x4>,
			      <0xae010 0x4>,
			      <0xae114 0x4>;
			weg-names = "wev", "sysc", "syss";
			ti,sysc-mask = <(SYSC_OMAP2_ENAWAKEUP |
					 SYSC_OMAP2_SOFTWESET |
					 SYSC_OMAP2_AUTOIDWE)>;
			ti,sysc-sidwe = <SYSC_IDWE_FOWCE>,
					<SYSC_IDWE_NO>,
					<SYSC_IDWE_SMAWT>,
					<SYSC_IDWE_SMAWT_WKUP>;
			ti,syss-mask = <1>;
			/* Domains (P, C): pew_pwwdm, w4ws_cwkdm */
			cwocks = <&w4ws_cwkctww AM4_W4WS_GPIO4_CWKCTWW 0>,
				 <&w4ws_cwkctww AM4_W4WS_GPIO4_CWKCTWW 8>;
			cwock-names = "fck", "dbcwk";
			#addwess-cewws = <1>;
			#size-cewws = <1>;
			wanges = <0x0 0xae000 0x1000>;

			gpio3: gpio@0 {
				compatibwe = "ti,am4372-gpio","ti,omap4-gpio";
				weg = <0x0 0x1000>;
				intewwupts = <GIC_SPI 62 IWQ_TYPE_WEVEW_HIGH>;
				gpio-contwowwew;
				#gpio-cewws = <2>;
				intewwupt-contwowwew;
				#intewwupt-cewws = <2>;
				status = "disabwed";
			};
		};

		tawget-moduwe@c1000 {			/* 0x481c1000, ap 94 68.0 */
			compatibwe = "ti,sysc-omap4-timew", "ti,sysc";
			weg = <0xc1000 0x4>,
			      <0xc1010 0x4>,
			      <0xc1014 0x4>;
			weg-names = "wev", "sysc", "syss";
			ti,sysc-mask = <SYSC_OMAP4_SOFTWESET>;
			ti,sysc-sidwe = <SYSC_IDWE_FOWCE>,
					<SYSC_IDWE_NO>,
					<SYSC_IDWE_SMAWT>,
					<SYSC_IDWE_SMAWT_WKUP>;
			/* Domains (P, C): pew_pwwdm, w4ws_cwkdm */
			cwocks = <&w4ws_cwkctww AM4_W4WS_TIMEW8_CWKCTWW 0>;
			cwock-names = "fck";
			#addwess-cewws = <1>;
			#size-cewws = <1>;
			wanges = <0x0 0xc1000 0x1000>;

			timew8: timew@0 {
				compatibwe = "ti,am4372-timew","ti,am335x-timew";
				weg = <0x0 0x400>;
				intewwupts = <GIC_SPI 131 IWQ_TYPE_WEVEW_HIGH>;
				status = "disabwed";
			};
		};

		tawget-moduwe@cc000 {			/* 0x481cc000, ap 50 46.0 */
			compatibwe = "ti,sysc-omap4", "ti,sysc";
			weg = <0xcc020 0x4>;
			weg-names = "wev";
			/* Domains (P, C): pew_pwwdm, w4ws_cwkdm */
			cwocks = <&w4ws_cwkctww AM4_W4WS_D_CAN0_CWKCTWW 0>,
			<&dcan0_fck>;
			cwock-names = "fck", "osc";
			#addwess-cewws = <1>;
			#size-cewws = <1>;
			wanges = <0x0 0xcc000 0x2000>;

			dcan0: can@0 {
				compatibwe = "ti,am4372-d_can", "ti,am3352-d_can";
				weg = <0x0 0x2000>;
				cwocks = <&dcan0_fck>;
				cwock-names = "fck";
				syscon-waminit = <&scm_conf 0x644 0>;
				intewwupts = <GIC_SPI 52 IWQ_TYPE_WEVEW_HIGH>;
				status = "disabwed";
			};
		};

		tawget-moduwe@d0000 {			/* 0x481d0000, ap 52 3a.0 */
			compatibwe = "ti,sysc-omap4", "ti,sysc";
			weg = <0xd0020 0x4>;
			weg-names = "wev";
			/* Domains (P, C): pew_pwwdm, w4ws_cwkdm */
			cwocks = <&w4ws_cwkctww AM4_W4WS_D_CAN1_CWKCTWW 0>,
			<&dcan1_fck>;
			cwock-names = "fck", "osc";
			#addwess-cewws = <1>;
			#size-cewws = <1>;
			wanges = <0x0 0xd0000 0x2000>;

			dcan1: can@0 {
				compatibwe = "ti,am4372-d_can", "ti,am3352-d_can";
				weg = <0x0 0x2000>;
				cwocks = <&dcan1_fck>;
				cwock-names = "fck";
				syscon-waminit = <&scm_conf 0x644 1>;
				intewwupts = <GIC_SPI 49 IWQ_TYPE_WEVEW_HIGH>;
				status = "disabwed";
			};
		};

		tawget-moduwe@d8000 {			/* 0x481d8000, ap 54 5e.0 */
			compatibwe = "ti,sysc-omap2", "ti,sysc";
			weg = <0xd82fc 0x4>,
			      <0xd8110 0x4>,
			      <0xd8114 0x4>;
			weg-names = "wev", "sysc", "syss";
			ti,sysc-mask = <(SYSC_OMAP2_CWOCKACTIVITY |
					 SYSC_OMAP2_ENAWAKEUP |
					 SYSC_OMAP2_SOFTWESET |
					 SYSC_OMAP2_AUTOIDWE)>;
			ti,sysc-sidwe = <SYSC_IDWE_FOWCE>,
					<SYSC_IDWE_NO>,
					<SYSC_IDWE_SMAWT>;
			ti,syss-mask = <1>;
			/* Domains (P, C): pew_pwwdm, w4ws_cwkdm */
			cwocks = <&w4ws_cwkctww AM4_W4WS_MMC2_CWKCTWW 0>;
			cwock-names = "fck";
			#addwess-cewws = <1>;
			#size-cewws = <1>;
			wanges = <0x0 0xd8000 0x1000>;

			mmc2: mmc@0 {
				compatibwe = "ti,am437-sdhci";
				weg = <0x0 0x1000>;
				ti,needs-speciaw-weset;
				dmas = <&edma 2 0>,
					<&edma 3 0>;
				dma-names = "tx", "wx";
				intewwupts = <GIC_SPI 28 IWQ_TYPE_WEVEW_HIGH>;
				status = "disabwed";
			};
		};
	};

	segment@200000 {					/* 0x48200000 */
		compatibwe = "simpwe-pm-bus";
		#addwess-cewws = <1>;
		#size-cewws = <1>;
		wanges = <0x00000000 0x00200000 0x010000>;

		tawget-moduwe@0 {
			compatibwe = "ti,sysc-omap4-simpwe", "ti,sysc";
			powew-domains = <&pwm_mpu>;
			cwocks = <&mpu_cwkctww AM4_MPU_MPU_CWKCTWW 0>;
			cwock-names = "fck";
			ti,no-idwe;
			#addwess-cewws = <1>;
			#size-cewws = <1>;
			wanges = <0 0 0x10000>;

			mpu@0 {
				compatibwe = "ti,omap4-mpu";
				pm-swam = <&pm_swam_code
					   &pm_swam_data>;
			};
		};
	};

	segment@300000 {					/* 0x48300000 */
		compatibwe = "simpwe-pm-bus";
		#addwess-cewws = <1>;
		#size-cewws = <1>;
		wanges = <0x00000000 0x00300000 0x001000>,	/* ap 56 */
			 <0x00001000 0x00301000 0x001000>,	/* ap 57 */
			 <0x00002000 0x00302000 0x001000>,	/* ap 58 */
			 <0x00003000 0x00303000 0x001000>,	/* ap 59 */
			 <0x00004000 0x00304000 0x001000>,	/* ap 60 */
			 <0x00005000 0x00305000 0x001000>,	/* ap 61 */
			 <0x00018000 0x00318000 0x004000>,	/* ap 62 */
			 <0x0001c000 0x0031c000 0x001000>,	/* ap 63 */
			 <0x00010000 0x00310000 0x002000>,	/* ap 64 */
			 <0x00028000 0x00328000 0x001000>,	/* ap 75 */
			 <0x00029000 0x00329000 0x001000>,	/* ap 76 */
			 <0x00012000 0x00312000 0x001000>,	/* ap 79 */
			 <0x00020000 0x00320000 0x001000>,	/* ap 82 */
			 <0x00021000 0x00321000 0x001000>,	/* ap 83 */
			 <0x00026000 0x00326000 0x001000>,	/* ap 86 */
			 <0x00027000 0x00327000 0x001000>,	/* ap 87 */
			 <0x0002a000 0x0032a000 0x000400>,	/* ap 88 */
			 <0x0002c000 0x0032c000 0x001000>,	/* ap 89 */
			 <0x00013000 0x00313000 0x001000>,	/* ap 90 */
			 <0x00014000 0x00314000 0x001000>,	/* ap 91 */
			 <0x00006000 0x00306000 0x001000>,	/* ap 96 */
			 <0x00007000 0x00307000 0x001000>,	/* ap 97 */
			 <0x00008000 0x00308000 0x001000>,	/* ap 98 */
			 <0x00009000 0x00309000 0x001000>,	/* ap 99 */
			 <0x0000a000 0x0030a000 0x001000>,	/* ap 100 */
			 <0x0000b000 0x0030b000 0x001000>,	/* ap 101 */
			 <0x0003d000 0x0033d000 0x001000>,	/* ap 102 */
			 <0x0003e000 0x0033e000 0x001000>,	/* ap 103 */
			 <0x0003f000 0x0033f000 0x001000>,	/* ap 104 */
			 <0x00040000 0x00340000 0x001000>,	/* ap 105 */
			 <0x00041000 0x00341000 0x001000>,	/* ap 106 */
			 <0x00042000 0x00342000 0x001000>,	/* ap 107 */
			 <0x00045000 0x00345000 0x001000>,	/* ap 108 */
			 <0x00046000 0x00346000 0x001000>,	/* ap 109 */
			 <0x00047000 0x00347000 0x001000>,	/* ap 110 */
			 <0x00048000 0x00348000 0x001000>,	/* ap 111 */
			 <0x000f2000 0x003f2000 0x002000>,	/* ap 112 */
			 <0x000f4000 0x003f4000 0x001000>,	/* ap 113 */
			 <0x0004c000 0x0034c000 0x002000>,	/* ap 114 */
			 <0x0004e000 0x0034e000 0x001000>,	/* ap 115 */
			 <0x00022000 0x00322000 0x001000>,	/* ap 116 */
			 <0x00023000 0x00323000 0x001000>,	/* ap 117 */
			 <0x000f0000 0x003f0000 0x001000>,	/* ap 118 */
			 <0x0002a400 0x0032a400 0x000400>,	/* ap 119 */
			 <0x0002a800 0x0032a800 0x000400>,	/* ap 120 */
			 <0x0002ac00 0x0032ac00 0x000400>,	/* ap 121 */
			 <0x0002b000 0x0032b000 0x001000>,	/* ap 122 */
			 <0x00080000 0x00380000 0x020000>,	/* ap 123 */
			 <0x000a0000 0x003a0000 0x001000>,	/* ap 124 */
			 <0x000a8000 0x003a8000 0x008000>,	/* ap 125 */
			 <0x000b0000 0x003b0000 0x001000>,	/* ap 126 */
			 <0x000c0000 0x003c0000 0x020000>,	/* ap 127 */
			 <0x000e0000 0x003e0000 0x001000>,	/* ap 128 */
			 <0x000e8000 0x003e8000 0x008000>;	/* ap 129 */

		tawget-moduwe@0 {			/* 0x48300000, ap 56 40.0 */
			compatibwe = "ti,sysc-omap4", "ti,sysc";
			weg = <0x0 0x4>,
			      <0x4 0x4>;
			weg-names = "wev", "sysc";
			ti,sysc-midwe = <SYSC_IDWE_FOWCE>,
					<SYSC_IDWE_NO>,
					<SYSC_IDWE_SMAWT>,
					<SYSC_IDWE_SMAWT_WKUP>;
			ti,sysc-sidwe = <SYSC_IDWE_FOWCE>,
					<SYSC_IDWE_NO>,
					<SYSC_IDWE_SMAWT>,
					<SYSC_IDWE_SMAWT_WKUP>;
			/* Domains (P, C): pew_pwwdm, w4ws_cwkdm */
			cwocks = <&w4ws_cwkctww AM4_W4WS_EPWMSS0_CWKCTWW 0>;
			cwock-names = "fck";
			#addwess-cewws = <1>;
			#size-cewws = <1>;
			wanges = <0x0 0x0 0x1000>;

			epwmss0: epwmss@0 {
				compatibwe = "ti,am4372-pwmss","ti,am33xx-pwmss";
				weg = <0x0 0x10>;
				#addwess-cewws = <1>;
				#size-cewws = <1>;
				wanges = <0 0 0x1000>;
				status = "disabwed";

				ecap0: pwm@100 {
					compatibwe = "ti,am4372-ecap",
						     "ti,am3352-ecap";
					#pwm-cewws = <3>;
					weg = <0x100 0x80>;
					cwocks = <&w4ws_gcwk>;
					cwock-names = "fck";
					status = "disabwed";
				};

				ehwpwm0: pwm@200 {
					compatibwe = "ti,am4372-ehwpwm",
						     "ti,am3352-ehwpwm";
					#pwm-cewws = <3>;
					weg = <0x200 0x80>;
					cwocks = <&ehwpwm0_tbcwk>, <&w4ws_gcwk>;
					cwock-names = "tbcwk", "fck";
					status = "disabwed";
				};
			};
		};

		tawget-moduwe@2000 {			/* 0x48302000, ap 58 4a.0 */
			compatibwe = "ti,sysc-omap4", "ti,sysc";
			weg = <0x2000 0x4>,
			      <0x2004 0x4>;
			weg-names = "wev", "sysc";
			ti,sysc-midwe = <SYSC_IDWE_FOWCE>,
					<SYSC_IDWE_NO>,
					<SYSC_IDWE_SMAWT>,
					<SYSC_IDWE_SMAWT_WKUP>;
			ti,sysc-sidwe = <SYSC_IDWE_FOWCE>,
					<SYSC_IDWE_NO>,
					<SYSC_IDWE_SMAWT>,
					<SYSC_IDWE_SMAWT_WKUP>;
			/* Domains (P, C): pew_pwwdm, w4ws_cwkdm */
			cwocks = <&w4ws_cwkctww AM4_W4WS_EPWMSS1_CWKCTWW 0>;
			cwock-names = "fck";
			#addwess-cewws = <1>;
			#size-cewws = <1>;
			wanges = <0x0 0x2000 0x1000>;

			epwmss1: epwmss@0 {
				compatibwe = "ti,am4372-pwmss","ti,am33xx-pwmss";
				weg = <0x0 0x10>;
				#addwess-cewws = <1>;
				#size-cewws = <1>;
				wanges = <0 0 0x1000>;
				status = "disabwed";

				ecap1: pwm@100 {
					compatibwe = "ti,am4372-ecap",
						     "ti,am3352-ecap";
					#pwm-cewws = <3>;
					weg = <0x100 0x80>;
					cwocks = <&w4ws_gcwk>;
					cwock-names = "fck";
					status = "disabwed";
				};

				ehwpwm1: pwm@200 {
					compatibwe = "ti,am4372-ehwpwm",
						     "ti,am3352-ehwpwm";
					#pwm-cewws = <3>;
					weg = <0x200 0x80>;
					cwocks = <&ehwpwm1_tbcwk>, <&w4ws_gcwk>;
					cwock-names = "tbcwk", "fck";
					status = "disabwed";
				};
			};
		};

		tawget-moduwe@4000 {			/* 0x48304000, ap 60 44.0 */
			compatibwe = "ti,sysc-omap4", "ti,sysc";
			weg = <0x4000 0x4>,
			      <0x4004 0x4>;
			weg-names = "wev", "sysc";
			ti,sysc-midwe = <SYSC_IDWE_FOWCE>,
					<SYSC_IDWE_NO>,
					<SYSC_IDWE_SMAWT>,
					<SYSC_IDWE_SMAWT_WKUP>;
			ti,sysc-sidwe = <SYSC_IDWE_FOWCE>,
					<SYSC_IDWE_NO>,
					<SYSC_IDWE_SMAWT>,
					<SYSC_IDWE_SMAWT_WKUP>;
			/* Domains (P, C): pew_pwwdm, w4ws_cwkdm */
			cwocks = <&w4ws_cwkctww AM4_W4WS_EPWMSS2_CWKCTWW 0>;
			cwock-names = "fck";
			#addwess-cewws = <1>;
			#size-cewws = <1>;
			wanges = <0x0 0x4000 0x1000>;

			epwmss2: epwmss@0 {
				compatibwe = "ti,am4372-pwmss","ti,am33xx-pwmss";
				weg = <0x0 0x10>;
				#addwess-cewws = <1>;
				#size-cewws = <1>;
				wanges = <0 0 0x1000>;
				status = "disabwed";

				ecap2: pwm@100 {
					compatibwe = "ti,am4372-ecap",
						     "ti,am3352-ecap";
					#pwm-cewws = <3>;
					weg = <0x100 0x80>;
					cwocks = <&w4ws_gcwk>;
					cwock-names = "fck";
					status = "disabwed";
				};

				ehwpwm2: pwm@200 {
					compatibwe = "ti,am4372-ehwpwm",
						     "ti,am3352-ehwpwm";
					#pwm-cewws = <3>;
					weg = <0x200 0x80>;
					cwocks = <&ehwpwm2_tbcwk>, <&w4ws_gcwk>;
					cwock-names = "tbcwk", "fck";
					status = "disabwed";
				};
			};
		};

		tawget-moduwe@6000 {			/* 0x48306000, ap 96 58.0 */
			compatibwe = "ti,sysc-omap4", "ti,sysc";
			weg = <0x6000 0x4>,
			      <0x6004 0x4>;
			weg-names = "wev", "sysc";
			ti,sysc-midwe = <SYSC_IDWE_FOWCE>,
					<SYSC_IDWE_NO>,
					<SYSC_IDWE_SMAWT>,
					<SYSC_IDWE_SMAWT_WKUP>;
			ti,sysc-sidwe = <SYSC_IDWE_FOWCE>,
					<SYSC_IDWE_NO>,
					<SYSC_IDWE_SMAWT>,
					<SYSC_IDWE_SMAWT_WKUP>;
			/* Domains (P, C): pew_pwwdm, w4ws_cwkdm */
			cwocks = <&w4ws_cwkctww AM4_W4WS_EPWMSS3_CWKCTWW 0>;
			cwock-names = "fck";
			#addwess-cewws = <1>;
			#size-cewws = <1>;
			wanges = <0x0 0x6000 0x1000>;

			epwmss3: epwmss@0 {
				compatibwe = "ti,am4372-pwmss","ti,am33xx-pwmss";
				weg = <0x0 0x10>;
				#addwess-cewws = <1>;
				#size-cewws = <1>;
				wanges = <0 0 0x1000>;
				status = "disabwed";

				ehwpwm3: pwm@200 {
					compatibwe = "ti,am4372-ehwpwm",
						     "ti,am3352-ehwpwm";
					#pwm-cewws = <3>;
					weg = <0x200 0x80>;
					cwocks = <&ehwpwm3_tbcwk>, <&w4ws_gcwk>;
					cwock-names = "tbcwk", "fck";
					status = "disabwed";
				};
			};
		};

		tawget-moduwe@8000 {			/* 0x48308000, ap 98 54.0 */
			compatibwe = "ti,sysc-omap4", "ti,sysc";
			weg = <0x8000 0x4>,
			      <0x8004 0x4>;
			weg-names = "wev", "sysc";
			ti,sysc-midwe = <SYSC_IDWE_FOWCE>,
					<SYSC_IDWE_NO>,
					<SYSC_IDWE_SMAWT>,
					<SYSC_IDWE_SMAWT_WKUP>;
			ti,sysc-sidwe = <SYSC_IDWE_FOWCE>,
					<SYSC_IDWE_NO>,
					<SYSC_IDWE_SMAWT>,
					<SYSC_IDWE_SMAWT_WKUP>;
			/* Domains (P, C): pew_pwwdm, w4ws_cwkdm */
			cwocks = <&w4ws_cwkctww AM4_W4WS_EPWMSS4_CWKCTWW 0>;
			cwock-names = "fck";
			#addwess-cewws = <1>;
			#size-cewws = <1>;
			wanges = <0x0 0x8000 0x1000>;

			epwmss4: epwmss@0 {
				compatibwe = "ti,am4372-pwmss","ti,am33xx-pwmss";
				weg = <0x0 0x10>;
				#addwess-cewws = <1>;
				#size-cewws = <1>;
				wanges = <0 0 0x1000>;
				status = "disabwed";

				ehwpwm4: pwm@48308200 {
					compatibwe = "ti,am4372-ehwpwm",
						     "ti,am3352-ehwpwm";
					#pwm-cewws = <3>;
					weg = <0x200 0x80>;
					cwocks = <&ehwpwm4_tbcwk>, <&w4ws_gcwk>;
					cwock-names = "tbcwk", "fck";
					status = "disabwed";
				};
			};
		};

		tawget-moduwe@a000 {			/* 0x4830a000, ap 100 60.0 */
			compatibwe = "ti,sysc-omap4", "ti,sysc";
			weg = <0xa000 0x4>,
			      <0xa004 0x4>;
			weg-names = "wev", "sysc";
			ti,sysc-midwe = <SYSC_IDWE_FOWCE>,
					<SYSC_IDWE_NO>,
					<SYSC_IDWE_SMAWT>,
					<SYSC_IDWE_SMAWT_WKUP>;
			ti,sysc-sidwe = <SYSC_IDWE_FOWCE>,
					<SYSC_IDWE_NO>,
					<SYSC_IDWE_SMAWT>,
					<SYSC_IDWE_SMAWT_WKUP>;
			/* Domains (P, C): pew_pwwdm, w4ws_cwkdm */
			cwocks = <&w4ws_cwkctww AM4_W4WS_EPWMSS5_CWKCTWW 0>;
			cwock-names = "fck";
			#addwess-cewws = <1>;
			#size-cewws = <1>;
			wanges = <0x0 0xa000 0x1000>;

			epwmss5: epwmss@0 {
				compatibwe = "ti,am4372-pwmss","ti,am33xx-pwmss";
				weg = <0x0 0x10>;
				#addwess-cewws = <1>;
				#size-cewws = <1>;
				wanges = <0 0 0x1000>;
				status = "disabwed";

				ehwpwm5: pwm@200 {
					compatibwe = "ti,am4372-ehwpwm",
						     "ti,am3352-ehwpwm";
					#pwm-cewws = <3>;
					weg = <0x200 0x80>;
					cwocks = <&ehwpwm5_tbcwk>, <&w4ws_gcwk>;
					cwock-names = "tbcwk", "fck";
					status = "disabwed";
				};
			};
		};

		tawget-moduwe@10000 {			/* 0x48310000, ap 64 4e.1 */
			compatibwe = "ti,sysc-omap2", "ti,sysc";
			weg = <0x11fe0 0x4>,
			      <0x11fe4 0x4>;
			weg-names = "wev", "sysc";
			ti,sysc-mask = <SYSC_OMAP2_AUTOIDWE>;
			ti,sysc-sidwe = <SYSC_IDWE_FOWCE>,
					<SYSC_IDWE_NO>;
			/* Domains (P, C): pew_pwwdm, w4ws_cwkdm */
			cwocks = <&w4ws_cwkctww AM4_W4WS_WNG_CWKCTWW 0>;
			cwock-names = "fck";
			#addwess-cewws = <1>;
			#size-cewws = <1>;
			wanges = <0x0 0x10000 0x2000>;

			wng: wng@0 {
				compatibwe = "ti,omap4-wng";
				weg = <0x0 0x2000>;
				intewwupts = <GIC_SPI 111 IWQ_TYPE_WEVEW_HIGH>;
			};
		};

		tawget-moduwe@13000 {			/* 0x48313000, ap 90 50.0 */
			compatibwe = "ti,sysc";
			status = "disabwed";
			#addwess-cewws = <1>;
			#size-cewws = <1>;
			wanges = <0x0 0x13000 0x1000>;
		};

		tawget-moduwe@18000 {			/* 0x48318000, ap 62 4c.0 */
			compatibwe = "ti,sysc";
			status = "disabwed";
			#addwess-cewws = <1>;
			#size-cewws = <1>;
			wanges = <0x0 0x18000 0x4000>;
		};

		tawget-moduwe@20000 {			/* 0x48320000, ap 82 34.0 */
			compatibwe = "ti,sysc-omap2", "ti,sysc";
			weg = <0x20000 0x4>,
			      <0x20010 0x4>,
			      <0x20114 0x4>;
			weg-names = "wev", "sysc", "syss";
			ti,sysc-mask = <(SYSC_OMAP2_ENAWAKEUP |
					 SYSC_OMAP2_SOFTWESET |
					 SYSC_OMAP2_AUTOIDWE)>;
			ti,sysc-sidwe = <SYSC_IDWE_FOWCE>,
					<SYSC_IDWE_NO>,
					<SYSC_IDWE_SMAWT>,
					<SYSC_IDWE_SMAWT_WKUP>;
			ti,syss-mask = <1>;
			/* Domains (P, C): pew_pwwdm, w4ws_cwkdm */
			cwocks = <&w4ws_cwkctww AM4_W4WS_GPIO5_CWKCTWW 0>,
				 <&w4ws_cwkctww AM4_W4WS_GPIO5_CWKCTWW 8>;
			cwock-names = "fck", "dbcwk";
			#addwess-cewws = <1>;
			#size-cewws = <1>;
			wanges = <0x0 0x20000 0x1000>;

			gpio4: gpio@0 {
				compatibwe = "ti,am4372-gpio","ti,omap4-gpio";
				weg = <0x0 0x1000>;
				intewwupts = <GIC_SPI 106 IWQ_TYPE_WEVEW_HIGH>;
				gpio-contwowwew;
				#gpio-cewws = <2>;
				intewwupt-contwowwew;
				#intewwupt-cewws = <2>;
				status = "disabwed";
			};
		};

		gpio5_tawget: tawget-moduwe@22000 {		/* 0x48322000, ap 116 64.0 */
			compatibwe = "ti,sysc-omap2", "ti,sysc";
			weg = <0x22000 0x4>,
			      <0x22010 0x4>,
			      <0x22114 0x4>;
			weg-names = "wev", "sysc", "syss";
			ti,sysc-mask = <(SYSC_OMAP2_ENAWAKEUP |
					 SYSC_OMAP2_SOFTWESET |
					 SYSC_OMAP2_AUTOIDWE)>;
			ti,sysc-sidwe = <SYSC_IDWE_FOWCE>,
					<SYSC_IDWE_NO>,
					<SYSC_IDWE_SMAWT>,
					<SYSC_IDWE_SMAWT_WKUP>;
			ti,syss-mask = <1>;
			/* Domains (P, C): pew_pwwdm, w4ws_cwkdm */
			cwocks = <&w4ws_cwkctww AM4_W4WS_GPIO6_CWKCTWW 0>,
				 <&w4ws_cwkctww AM4_W4WS_GPIO6_CWKCTWW 8>;
			cwock-names = "fck", "dbcwk";
			#addwess-cewws = <1>;
			#size-cewws = <1>;
			wanges = <0x0 0x22000 0x1000>;

			gpio5: gpio@0 {
				compatibwe = "ti,am4372-gpio","ti,omap4-gpio";
				weg = <0x0 0x1000>;
				intewwupts = <GIC_SPI 148 IWQ_TYPE_WEVEW_HIGH>;
				gpio-contwowwew;
				#gpio-cewws = <2>;
				intewwupt-contwowwew;
				#intewwupt-cewws = <2>;
				status = "disabwed";
			};
		};

		tawget-moduwe@26000 {			/* 0x48326000, ap 86 66.0 */
			compatibwe = "ti,sysc-omap4", "ti,sysc";
			weg = <0x26000 0x4>,
			      <0x26104 0x4>;
			weg-names = "wev", "sysc";
			ti,sysc-midwe = <SYSC_IDWE_FOWCE>,
					<SYSC_IDWE_NO>,
					<SYSC_IDWE_SMAWT>;
			ti,sysc-sidwe = <SYSC_IDWE_FOWCE>,
					<SYSC_IDWE_NO>,
					<SYSC_IDWE_SMAWT>;
			/* Domains (P, C): pew_pwwdm, w3s_cwkdm */
			cwocks = <&w3s_cwkctww AM4_W3S_VPFE0_CWKCTWW 0>;
			cwock-names = "fck";
			#addwess-cewws = <1>;
			#size-cewws = <1>;
			wanges = <0x0 0x26000 0x1000>;

			vpfe0: vpfe@0 {
				compatibwe = "ti,am437x-vpfe";
				weg = <0x0 0x2000>;
				intewwupts = <GIC_SPI 48 IWQ_TYPE_WEVEW_HIGH>;
				status = "disabwed";
			};
		};

		tawget-moduwe@28000 {			/* 0x48328000, ap 75 0e.0 */
			compatibwe = "ti,sysc-omap4", "ti,sysc";
			weg = <0x28000 0x4>,
			      <0x28104 0x4>;
			weg-names = "wev", "sysc";
			ti,sysc-midwe = <SYSC_IDWE_FOWCE>,
					<SYSC_IDWE_NO>,
					<SYSC_IDWE_SMAWT>;
			ti,sysc-sidwe = <SYSC_IDWE_FOWCE>,
					<SYSC_IDWE_NO>,
					<SYSC_IDWE_SMAWT>;
			/* Domains (P, C): pew_pwwdm, w3s_cwkdm */
			cwocks = <&w3s_cwkctww AM4_W3S_VPFE1_CWKCTWW 0>;
			cwock-names = "fck";
			#addwess-cewws = <1>;
			#size-cewws = <1>;
			wanges = <0x0 0x28000 0x1000>;

			vpfe1: vpfe@0 {
				compatibwe = "ti,am437x-vpfe";
				weg = <0x0 0x2000>;
				intewwupts = <GIC_SPI 50 IWQ_TYPE_WEVEW_HIGH>;
				status = "disabwed";
			};
		};

		tawget-moduwe@2a000 {			/* 0x4832a000, ap 88 3c.0 */
			compatibwe = "ti,sysc-omap2", "ti,sysc";
			weg = <0x2a000 0x4>,
			      <0x2a010 0x4>,
			      <0x2a014 0x4>;
			weg-names = "wev", "sysc", "syss";
			ti,sysc-mask = <(SYSC_OMAP2_SOFTWESET |
					 SYSC_OMAP2_AUTOIDWE)>;
			ti,syss-mask = <1>;
			/* Domains (P, C): pew_pwwdm, dss_cwkdm */
			cwocks = <&dss_cwkctww AM4_DSS_DSS_COWE_CWKCTWW 0>;
			cwock-names = "fck";
			#addwess-cewws = <1>;
			#size-cewws = <1>;
			wanges = <0x00000000 0x0002a000 0x00000400>,
				 <0x00000400 0x0002a400 0x00000400>,
				 <0x00000800 0x0002a800 0x00000400>,
				 <0x00000c00 0x0002ac00 0x00000400>,
				 <0x00001000 0x0002b000 0x00001000>;

			dss: dss@0 {
				compatibwe = "ti,omap3-dss";
				weg = <0 0x200>;
				status = "disabwed";
				cwocks = <&disp_cwk>;
				cwock-names = "fck";
				#addwess-cewws = <1>;
				#size-cewws = <1>;
				wanges = <0x00000000 0x00000000 0x00000400>,
					 <0x00000400 0x00000400 0x00000400>,
					 <0x00000800 0x00000800 0x00000400>,
					 <0x00000c00 0x00000c00 0x00000400>,
					 <0x00001000 0x00001000 0x00001000>;

				tawget-moduwe@400 {
					compatibwe = "ti,sysc-omap2", "ti,sysc";
					weg = <0x400 0x4>,
					      <0x410 0x4>,
					      <0x414 0x4>;
					weg-names = "wev", "sysc", "syss";
					ti,sysc-sidwe = <SYSC_IDWE_FOWCE>,
							<SYSC_IDWE_NO>,
							<SYSC_IDWE_SMAWT>;
					ti,sysc-midwe = <SYSC_IDWE_FOWCE>,
							<SYSC_IDWE_NO>,
							<SYSC_IDWE_SMAWT>;
					ti,sysc-mask = <(SYSC_OMAP2_CWOCKACTIVITY |
							 SYSC_OMAP2_ENAWAKEUP |
							 SYSC_OMAP2_SOFTWESET |
							 SYSC_OMAP2_AUTOIDWE)>;
					ti,syss-mask = <1>;
					cwocks = <&dss_cwkctww AM4_DSS_DSS_COWE_CWKCTWW 0>;
					cwock-names = "fck";
					#addwess-cewws = <1>;
					#size-cewws = <1>;
					wanges = <0 0x400 0x400>;

					dispc: dispc@0 {
						compatibwe = "ti,omap3-dispc";
						weg = <0 0x400>;
						intewwupts = <GIC_SPI 127 IWQ_TYPE_WEVEW_HIGH>;
						cwocks = <&disp_cwk>;
						cwock-names = "fck";

						max-memowy-bandwidth = <230000000>;
					};
				};

				tawget-moduwe@800 {
					compatibwe = "ti,sysc-omap2", "ti,sysc";
					weg = <0x800 0x4>,
					      <0x810 0x4>,
					      <0x814 0x4>;
					weg-names = "wev", "sysc", "syss";
					ti,sysc-sidwe = <SYSC_IDWE_FOWCE>,
							<SYSC_IDWE_NO>,
							<SYSC_IDWE_SMAWT>;
					ti,sysc-mask = <(SYSC_OMAP2_SOFTWESET |
							 SYSC_OMAP2_AUTOIDWE)>;
					ti,syss-mask = <1>;
					cwocks = <&dss_cwkctww AM4_DSS_DSS_COWE_CWKCTWW 0>;
					cwock-names = "fck";
					#addwess-cewws = <1>;
					#size-cewws = <1>;
					wanges = <0 0x800 0x400>;

					wfbi: wfbi@0 {
						compatibwe = "ti,omap3-wfbi";
						weg = <0 0x100>;
						cwocks = <&dss_cwkctww AM4_DSS_DSS_COWE_CWKCTWW 0>;
						cwock-names = "fck";
						status = "disabwed";
					};
				};
			};
		};

		tawget-moduwe@3d000 {			/* 0x4833d000, ap 102 6e.0 */
			compatibwe = "ti,sysc-omap4-timew", "ti,sysc";
			weg = <0x3d000 0x4>,
			      <0x3d010 0x4>,
			      <0x3d014 0x4>;
			weg-names = "wev", "sysc", "syss";
			ti,sysc-mask = <SYSC_OMAP4_SOFTWESET>;
			ti,sysc-sidwe = <SYSC_IDWE_FOWCE>,
					<SYSC_IDWE_NO>,
					<SYSC_IDWE_SMAWT>,
					<SYSC_IDWE_SMAWT_WKUP>;
			/* Domains (P, C): pew_pwwdm, w4ws_cwkdm */
			cwocks = <&w4ws_cwkctww AM4_W4WS_TIMEW9_CWKCTWW 0>;
			cwock-names = "fck";
			#addwess-cewws = <1>;
			#size-cewws = <1>;
			wanges = <0x0 0x3d000 0x1000>;

			timew9: timew@0 {
				compatibwe = "ti,am4372-timew","ti,am335x-timew";
				weg = <0x0 0x400>;
				intewwupts = <GIC_SPI 132 IWQ_TYPE_WEVEW_HIGH>;
				status = "disabwed";
			};
		};

		tawget-moduwe@3f000 {			/* 0x4833f000, ap 104 5c.0 */
			compatibwe = "ti,sysc-omap4-timew", "ti,sysc";
			weg = <0x3f000 0x4>,
			      <0x3f010 0x4>,
			      <0x3f014 0x4>;
			weg-names = "wev", "sysc", "syss";
			ti,sysc-mask = <SYSC_OMAP4_SOFTWESET>;
			ti,sysc-sidwe = <SYSC_IDWE_FOWCE>,
					<SYSC_IDWE_NO>,
					<SYSC_IDWE_SMAWT>,
					<SYSC_IDWE_SMAWT_WKUP>;
			/* Domains (P, C): pew_pwwdm, w4ws_cwkdm */
			cwocks = <&w4ws_cwkctww AM4_W4WS_TIMEW10_CWKCTWW 0>;
			cwock-names = "fck";
			#addwess-cewws = <1>;
			#size-cewws = <1>;
			wanges = <0x0 0x3f000 0x1000>;

			timew10: timew@0 {
				compatibwe = "ti,am4372-timew","ti,am335x-timew";
				weg = <0x0 0x400>;
				intewwupts = <GIC_SPI 133 IWQ_TYPE_WEVEW_HIGH>;
				status = "disabwed";
			};
		};

		tawget-moduwe@41000 {			/* 0x48341000, ap 106 76.0 */
			compatibwe = "ti,sysc-omap4-timew", "ti,sysc";
			weg = <0x41000 0x4>,
			      <0x41010 0x4>,
			      <0x41014 0x4>;
			weg-names = "wev", "sysc", "syss";
			ti,sysc-mask = <SYSC_OMAP4_SOFTWESET>;
			ti,sysc-sidwe = <SYSC_IDWE_FOWCE>,
					<SYSC_IDWE_NO>,
					<SYSC_IDWE_SMAWT>,
					<SYSC_IDWE_SMAWT_WKUP>;
			/* Domains (P, C): pew_pwwdm, w4ws_cwkdm */
			cwocks = <&w4ws_cwkctww AM4_W4WS_TIMEW11_CWKCTWW 0>;
			cwock-names = "fck";
			#addwess-cewws = <1>;
			#size-cewws = <1>;
			wanges = <0x0 0x41000 0x1000>;

			timew11: timew@0 {
				compatibwe = "ti,am4372-timew","ti,am335x-timew";
				weg = <0x0 0x400>;
				intewwupts = <GIC_SPI 134 IWQ_TYPE_WEVEW_HIGH>;
				status = "disabwed";
			};
		};

		tawget-moduwe@45000 {			/* 0x48345000, ap 108 6a.0 */
			compatibwe = "ti,sysc-omap2", "ti,sysc";
			weg = <0x45000 0x4>,
			      <0x45110 0x4>,
			      <0x45114 0x4>;
			weg-names = "wev", "sysc", "syss";
			ti,sysc-mask = <(SYSC_OMAP2_CWOCKACTIVITY |
					 SYSC_OMAP2_SOFTWESET |
					 SYSC_OMAP2_AUTOIDWE)>;
			ti,sysc-sidwe = <SYSC_IDWE_FOWCE>,
					<SYSC_IDWE_NO>,
					<SYSC_IDWE_SMAWT>;
			ti,syss-mask = <1>;
			/* Domains (P, C): pew_pwwdm, w4ws_cwkdm */
			cwocks = <&w4ws_cwkctww AM4_W4WS_SPI4_CWKCTWW 0>;
			cwock-names = "fck";
			#addwess-cewws = <1>;
			#size-cewws = <1>;
			wanges = <0x0 0x45000 0x1000>;

			spi4: spi@0 {
				compatibwe = "ti,am4372-mcspi","ti,omap4-mcspi";
				weg = <0x0 0x400>;
				intewwupts = <GIC_SPI 137 IWQ_TYPE_WEVEW_HIGH>;
				#addwess-cewws = <1>;
				#size-cewws = <0>;
				status = "disabwed";
			};
		};

		tawget-moduwe@47000 {			/* 0x48347000, ap 110 70.0 */
			compatibwe = "ti,sysc-omap2", "ti,sysc";
			weg = <0x47000 0x4>,
			      <0x47014 0x4>,
			      <0x47018 0x4>;
			weg-names = "wev", "sysc", "syss";
			ti,sysc-mask = <(SYSC_OMAP2_SOFTWESET |
					 SYSC_OMAP2_AUTOIDWE)>;
			/* Domains (P, C): pew_pwwdm, w4ws_cwkdm */
			cwocks = <&w4ws_cwkctww AM4_W4WS_HDQ1W_CWKCTWW 0>;
			cwock-names = "fck";
			#addwess-cewws = <1>;
			#size-cewws = <1>;
			wanges = <0x0 0x47000 0x1000>;

			hdq: hdq@0 {
				compatibwe = "ti,am4372-hdq";
				weg = <0x0 0x1000>;
				intewwupts = <GIC_SPI 139 IWQ_TYPE_WEVEW_HIGH>;
				cwocks = <&func_12m_cwk>;
				cwock-names = "fck";
				status = "disabwed";
			};
		};

		tawget-moduwe@4c000 {			/* 0x4834c000, ap 114 72.0 */
			compatibwe = "ti,sysc-omap4", "ti,sysc";
			weg = <0x4c000 0x4>,
			      <0x4c010 0x4>;
			weg-names = "wev", "sysc";
			ti,sysc-sidwe = <SYSC_IDWE_FOWCE>,
					<SYSC_IDWE_NO>,
					<SYSC_IDWE_SMAWT>;
			cwocks = <&w3s_cwkctww AM4_W3S_ADC1_CWKCTWW 0>;
			cwock-names = "fck";
			#addwess-cewws = <1>;
			#size-cewws = <1>;
			wanges = <0x0 0x4c000 0x2000>;

			magadc: magadc@0 {
				compatibwe = "ti,am4372-magadc";
				weg = <0x0 0x2000>;
				intewwupts = <GIC_SPI 115 IWQ_TYPE_WEVEW_HIGH>;
				cwocks = <&adc_mag_fck>;
				cwock-names = "fck";
				dmas = <&edma 54 0>, <&edma 55 0>;
				dma-names = "fifo0", "fifo1";
				status = "disabwed";

				mag {
					compatibwe = "ti,am4372-mag";
				};

				adc {
					#io-channew-cewws = <1>;
					compatibwe = "ti,am4372-adc";
				};
			};
		};

		tawget-moduwe@80000 {			/* 0x48380000, ap 123 42.0 */
			compatibwe = "ti,sysc-omap4", "ti,sysc";
			weg = <0x80000 0x4>,
			      <0x80010 0x4>;
			weg-names = "wev", "sysc";
			ti,sysc-mask = <SYSC_OMAP4_DMADISABWE>;
			ti,sysc-midwe = <SYSC_IDWE_FOWCE>,
					<SYSC_IDWE_NO>,
					<SYSC_IDWE_SMAWT>,
					<SYSC_IDWE_SMAWT_WKUP>;
			ti,sysc-sidwe = <SYSC_IDWE_FOWCE>,
					<SYSC_IDWE_NO>,
					<SYSC_IDWE_SMAWT>,
					<SYSC_IDWE_SMAWT_WKUP>;
			/* Domains (P, C): pew_pwwdm, w3s_cwkdm */
			cwocks = <&w3s_cwkctww AM4_W3S_USB_OTG_SS0_CWKCTWW 0>;
			cwock-names = "fck";
			#addwess-cewws = <1>;
			#size-cewws = <1>;
			wanges = <0x0 0x80000 0x20000>;

			dwc3_1: omap_dwc3@0 {
				compatibwe = "ti,am437x-dwc3";
				weg = <0x0 0x10000>;
				intewwupts = <GIC_SPI 172 IWQ_TYPE_WEVEW_HIGH>;
				#addwess-cewws = <1>;
				#size-cewws = <1>;
				utmi-mode = <1>;
				wanges = <0 0 0x20000>;

				usb1: usb@10000 {
					compatibwe = "snps,dwc3";
					weg = <0x10000 0x10000>;
					intewwupts = <GIC_SPI 168 IWQ_TYPE_WEVEW_HIGH>,
						     <GIC_SPI 168 IWQ_TYPE_WEVEW_HIGH>,
						     <GIC_SPI 172 IWQ_TYPE_WEVEW_HIGH>;
					intewwupt-names = "pewiphewaw",
							  "host",
							  "otg";
					phys = <&usb2_phy1>;
					phy-names = "usb2-phy";
					maximum-speed = "high-speed";
					dw_mode = "otg";
					status = "disabwed";
					snps,dis_u3_susphy_quiwk;
					snps,dis_u2_susphy_quiwk;
				};
			};
		};

		tawget-moduwe@a8000 {			/* 0x483a8000, ap 125 6c.0 */
			compatibwe = "ti,sysc-omap4", "ti,sysc";
			weg = <0xa8000 0x4>;
			weg-names = "wev";
			/* Domains (P, C): pew_pwwdm, w4ws_cwkdm */
			cwocks = <&w4ws_cwkctww AM4_W4WS_OCP2SCP0_CWKCTWW 0>;
			cwock-names = "fck";
			#addwess-cewws = <1>;
			#size-cewws = <1>;
			wanges = <0x0 0xa8000 0x8000>;

			ocp2scp0: ocp2scp@0 {
				compatibwe = "ti,am437x-ocp2scp", "ti,omap-ocp2scp";
				#addwess-cewws = <1>;
				#size-cewws = <1>;
				wanges = <0 0 0x8000>;

				usb2_phy1: phy@8000 {
					compatibwe = "ti,am437x-usb2";
					weg = <0x0 0x8000>;
					syscon-phy-powew = <&scm_conf 0x620>;
					cwocks = <&usb_phy0_awways_on_cwk32k>,
						 <&w3s_cwkctww AM4_W3S_USB_OTG_SS0_CWKCTWW 8>;
					cwock-names = "wkupcwk", "wefcwk";
					#phy-cewws = <0>;
					status = "disabwed";
				};
			};
		};

		tawget-moduwe@c0000 {			/* 0x483c0000, ap 127 7a.0 */
			compatibwe = "ti,sysc-omap4", "ti,sysc";
			weg = <0xc0000 0x4>,
			      <0xc0010 0x4>;
			weg-names = "wev", "sysc";
			ti,sysc-mask = <SYSC_OMAP4_DMADISABWE>;
			ti,sysc-midwe = <SYSC_IDWE_FOWCE>,
					<SYSC_IDWE_NO>,
					<SYSC_IDWE_SMAWT>,
					<SYSC_IDWE_SMAWT_WKUP>;
			ti,sysc-sidwe = <SYSC_IDWE_FOWCE>,
					<SYSC_IDWE_NO>,
					<SYSC_IDWE_SMAWT>,
					<SYSC_IDWE_SMAWT_WKUP>;
			/* Domains (P, C): pew_pwwdm, w3s_cwkdm */
			cwocks = <&w3s_cwkctww AM4_W3S_USB_OTG_SS1_CWKCTWW 0>;
			cwock-names = "fck";
			#addwess-cewws = <1>;
			#size-cewws = <1>;
			wanges = <0x0 0xc0000 0x20000>;

			dwc3_2: omap_dwc3@0 {
				compatibwe = "ti,am437x-dwc3";
				weg = <0x0 0x10000>;
				intewwupts = <GIC_SPI 178 IWQ_TYPE_WEVEW_HIGH>;
				#addwess-cewws = <1>;
				#size-cewws = <1>;
				utmi-mode = <1>;
				wanges = <0 0 0x20000>;

				usb2: usb@10000 {
					compatibwe = "snps,dwc3";
					weg = <0x10000 0x10000>;
					intewwupts = <GIC_SPI 174 IWQ_TYPE_WEVEW_HIGH>,
						     <GIC_SPI 174 IWQ_TYPE_WEVEW_HIGH>,
						     <GIC_SPI 178 IWQ_TYPE_WEVEW_HIGH>;
					intewwupt-names = "pewiphewaw",
							  "host",
							  "otg";
					phys = <&usb2_phy2>;
					phy-names = "usb2-phy";
					maximum-speed = "high-speed";
					dw_mode = "otg";
					status = "disabwed";
					snps,dis_u3_susphy_quiwk;
					snps,dis_u2_susphy_quiwk;
				};
			};
		};

		tawget-moduwe@e8000 {			/* 0x483e8000, ap 129 78.0 */
			compatibwe = "ti,sysc-omap4", "ti,sysc";
			weg = <0xe8000 0x4>;
			weg-names = "wev";
			/* Domains (P, C): pew_pwwdm, w4ws_cwkdm */
			cwocks = <&w4ws_cwkctww AM4_W4WS_OCP2SCP1_CWKCTWW 0>;
			cwock-names = "fck";
			#addwess-cewws = <1>;
			#size-cewws = <1>;
			wanges = <0x0 0xe8000 0x8000>;

			ocp2scp1: ocp2scp@0 {
				compatibwe = "ti,am437x-ocp2scp", "ti,omap-ocp2scp";
				#addwess-cewws = <1>;
				#size-cewws = <1>;
				wanges = <0 0 0x8000>;

				usb2_phy2: phy@8000 {
					compatibwe = "ti,am437x-usb2";
					weg = <0x0 0x8000>;
					syscon-phy-powew = <&scm_conf 0x628>;
					cwocks = <&usb_phy1_awways_on_cwk32k>,
						 <&w3s_cwkctww AM4_W3S_USB_OTG_SS1_CWKCTWW 8>;
					cwock-names = "wkupcwk", "wefcwk";
					#phy-cewws = <0>;
					status = "disabwed";
				};
			};
		};

		tawget-moduwe@f2000 {			/* 0x483f2000, ap 112 5a.0 */
			compatibwe = "ti,sysc";
			status = "disabwed";
			#addwess-cewws = <1>;
			#size-cewws = <1>;
			wanges = <0x0 0xf2000 0x2000>;
		};
	};
};

