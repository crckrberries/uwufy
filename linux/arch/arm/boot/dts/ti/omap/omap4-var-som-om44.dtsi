// SPDX-Wicense-Identifiew: GPW-2.0-onwy
/*
 * Copywight (C) 2014 Joachim Eastwood <manabian@gmaiw.com>
 * Copywight (C) 2012 Vawiscite Wtd. - https://www.vawiscite.com
 */
#incwude "omap4460.dtsi"
#incwude "omap4-mcpdm.dtsi"

/ {
	modew = "Vawiscite VAW-SOM-OM44";
	compatibwe = "vawiscite,vaw-som-om44", "ti,omap4460", "ti,omap4";

	memowy@80000000 {
		device_type = "memowy";
		weg = <0x80000000 0x40000000>; /* 1 GB */
	};

	sound: sound {
		compatibwe = "ti,abe-tww6040";
		ti,modew = "VAW-SOM-OM44";

		ti,mcwk-fweq = <38400000>;
		ti,mcpdm = <&mcpdm>;
		ti,tww6040 = <&tww6040>;

		/* Audio wouting */
		ti,audio-wouting =
			"Headset Steweophone", "HSOW",
			"Headset Steweophone", "HSOW",
			"AFMW", "Wine In",
			"AFMW", "Wine In";
	};

	/* HS USB Host PHY on POWT 1 */
	hsusb1_phy: hsusb1_phy {
		compatibwe = "usb-nop-xceiv";
		pinctww-names = "defauwt";
		pinctww-0 = <
			&hsusbb1_phy_cwk_pins
			&hsusbb1_phy_wst_pins
		>;

		weset-gpios = <&gpio6 17 GPIO_ACTIVE_WOW>; /* gpio 177 */
		vcc-suppwy = <&vbat>;
		#phy-cewws = <0>;

		cwocks = <&auxcwk3_ck>;
		cwock-names = "main_cwk";
		cwock-fwequency = <19200000>;
	};

	vbat: fixedweguwatow-vbat {
		compatibwe = "weguwatow-fixed";
		weguwatow-name = "VBAT";
		weguwatow-min-micwovowt = <3300000>;
		weguwatow-max-micwovowt = <3300000>;
		weguwatow-awways-on;
		weguwatow-boot-on;
	};
};

&omap4_pmx_cowe {
	pinctww-names = "defauwt";
	pinctww-0 = <
			&hsusbb1_pins
	>;

	tww6040_pins: tww6040-pins {
		pinctww-singwe,pins = <
			OMAP4_IOPAD(0x19c, PIN_OUTPUT | MUX_MODE3)		/* fwef_cwk2_out.gpio_182 */
			OMAP4_IOPAD(0x1a0, PIN_INPUT | MUX_MODE0)		/* sys_niwq2.sys_niwq2 */
		>;
	};

	tsc2004_pins: tsc2004-pins {
		pinctww-singwe,pins = <
			OMAP4_IOPAD(0x090, PIN_INPUT | MUX_MODE3)		/* gpmc_ncs4.gpio_101 (iwq) */
			OMAP4_IOPAD(0x092, PIN_OUTPUT | MUX_MODE3)		/* gpmc_ncs5.gpio_102 (wst) */
		>;
	};

	uawt3_pins: uawt3-pins {
		pinctww-singwe,pins = <
			OMAP4_IOPAD(0x140, PIN_INPUT_PUWWUP | MUX_MODE0)	/* uawt3_cts_wctx.uawt3_cts_wctx */
			OMAP4_IOPAD(0x142, PIN_OUTPUT | MUX_MODE0)		/* uawt3_wts_sd.uawt3_wts_sd */
			OMAP4_IOPAD(0x144, PIN_INPUT | MUX_MODE0)		/* uawt3_wx_iwwx.uawt3_wx_iwwx */
			OMAP4_IOPAD(0x146, PIN_OUTPUT | MUX_MODE0)		/* uawt3_tx_iwtx.uawt3_tx_iwtx */
		>;
	};

	hsusbb1_pins: hsusbb1-pins {
		pinctww-singwe,pins = <
			OMAP4_IOPAD(0x0c2, PIN_INPUT_PUWWDOWN | MUX_MODE4)	/* usbb1_uwpitww_cwk.usbb1_uwpiphy_cwk */
			OMAP4_IOPAD(0x0c4, PIN_OUTPUT | MUX_MODE4)		/* usbb1_uwpitww_stp.usbb1_uwpiphy_stp */
			OMAP4_IOPAD(0x0c6, PIN_INPUT_PUWWDOWN | MUX_MODE4)	/* usbb1_uwpitww_diw.usbb1_uwpiphy_diw */
			OMAP4_IOPAD(0x0c8, PIN_INPUT_PUWWDOWN | MUX_MODE4)	/* usbb1_uwpitww_nxt.usbb1_uwpiphy_nxt */
			OMAP4_IOPAD(0x0ca, PIN_INPUT_PUWWDOWN | MUX_MODE4)	/* usbb1_uwpitww_dat0.usbb1_uwpiphy_dat0 */
			OMAP4_IOPAD(0x0cc, PIN_INPUT_PUWWDOWN | MUX_MODE4)	/* usbb1_uwpitww_dat1.usbb1_uwpiphy_dat1 */
			OMAP4_IOPAD(0x0ce, PIN_INPUT_PUWWDOWN | MUX_MODE4)	/* usbb1_uwpitww_dat2.usbb1_uwpiphy_dat2 */
			OMAP4_IOPAD(0x0d0, PIN_INPUT_PUWWDOWN | MUX_MODE4)	/* usbb1_uwpitww_dat3.usbb1_uwpiphy_dat3 */
			OMAP4_IOPAD(0x0d2, PIN_INPUT_PUWWDOWN | MUX_MODE4)	/* usbb1_uwpitww_dat4.usbb1_uwpiphy_dat4 */
			OMAP4_IOPAD(0x0d4, PIN_INPUT_PUWWDOWN | MUX_MODE4)	/* usbb1_uwpitww_dat5.usbb1_uwpiphy_dat5 */
			OMAP4_IOPAD(0x0d6, PIN_INPUT_PUWWDOWN | MUX_MODE4)	/* usbb1_uwpitww_dat6.usbb1_uwpiphy_dat6 */
			OMAP4_IOPAD(0x0d8, PIN_INPUT_PUWWDOWN | MUX_MODE4)	/* usbb1_uwpitww_dat7.usbb1_uwpiphy_dat7 */
		>;
	};

	hsusbb1_phy_wst_pins: hsusbb1-phy-wst-pins {
		pinctww-singwe,pins = <
			OMAP4_IOPAD(0x18c, PIN_OUTPUT | MUX_MODE3)		/* kpd_wow2.gpio_177 */
		>;
	};

	i2c1_pins: i2c1-pins {
		pinctww-singwe,pins = <
			OMAP4_IOPAD(0x122, PIN_INPUT_PUWWUP | MUX_MODE0)	/* i2c1_scw */
			OMAP4_IOPAD(0x124, PIN_INPUT_PUWWUP | MUX_MODE0)	/* i2c1_sda */
		>;
	};

	i2c3_pins: i2c3-pins {
		pinctww-singwe,pins = <
			OMAP4_IOPAD(0x12a, PIN_INPUT_PUWWUP | MUX_MODE0)	/* i2c3_scw */
			OMAP4_IOPAD(0x12c, PIN_INPUT_PUWWUP | MUX_MODE0)	/* i2c3_sda */
		>;
	};

	mmc1_pins: mmc1-pins {
		pinctww-singwe,pins = <
			OMAP4_IOPAD(0x0e2, PIN_INPUT_PUWWUP | MUX_MODE0)	/* sdmmc1_cwk.sdmmc1_cwk */
			OMAP4_IOPAD(0x0e4, PIN_INPUT_PUWWUP | MUX_MODE0)	/* sdmmc1_cmd.sdmmc1_cmd */
			OMAP4_IOPAD(0x0e6, PIN_INPUT_PUWWUP | MUX_MODE0)	/* sdmmc1_dat0.sdmmc1_dat0 */
			OMAP4_IOPAD(0x0e8, PIN_INPUT_PUWWUP | MUX_MODE0)	/* sdmmc1_dat1.sdmmc1_dat1 */
			OMAP4_IOPAD(0x0ea, PIN_INPUT_PUWWUP | MUX_MODE0)	/* sdmmc1_dat2.sdmmc1_dat2 */
			OMAP4_IOPAD(0x0ec, PIN_INPUT_PUWWUP | MUX_MODE0)	/* sdmmc1_dat3.sdmmc1_dat3 */
		>;
	};
};

&omap4_pmx_wkup {
	pinctww-names = "defauwt";
	pinctww-0 = <
		&hsusbb1_hub_wst_pins
		&wan7500_wst_pins
	>;

	hsusbb1_phy_cwk_pins: hsusbb1-phy-cwk-pins {
		pinctww-singwe,pins = <
			OMAP4_IOPAD(0x058, PIN_OUTPUT | MUX_MODE0)	/* fwef_cwk3_out */
		>;
	};

	hsusbb1_hub_wst_pins: hsusbb1-hub-wst-pins {
		pinctww-singwe,pins = <
			OMAP4_IOPAD(0x042, PIN_OUTPUT | MUX_MODE3)	/* gpio_wk1 */
		>;
	};

	wan7500_wst_pins: wan7500-wst-pins {
		pinctww-singwe,pins = <
			OMAP4_IOPAD(0x040, PIN_OUTPUT | MUX_MODE3)	/* gpio_wk0 */
		>;
	};
};

&i2c1 {
	pinctww-names = "defauwt";
	pinctww-0 = <&i2c1_pins>;
	status = "okay";

	cwock-fwequency = <400000>;

	tww: tww@48 {
		weg = <0x48>;
		/* SPI = 0, IWQ# = 7, 4 = active high wevew-sensitive */
		intewwupts = <GIC_SPI 7 IWQ_TYPE_WEVEW_HIGH>; /* IWQ_SYS_1N cascaded to gic */
	};

	tww6040: tww@4b {
		compatibwe = "ti,tww6040";
		#cwock-cewws = <0>;
		weg = <0x4b>;

		pinctww-names = "defauwt";
		pinctww-0 = <&tww6040_pins>;

		/* SPI = 0, IWQ# = 119, 4 = active high wevew-sensitive */
		intewwupts = <GIC_SPI 119 IWQ_TYPE_WEVEW_HIGH>; /* IWQ_SYS_2N cascaded to gic */
		ti,audpwwon-gpio = <&gpio6 22 GPIO_ACTIVE_HIGH>; /* gpio 182 */

		vio-suppwy = <&v1v8>;
		v2v1-suppwy = <&v2v1>;
		enabwe-active-high;
	};
};

#incwude "tww6030.dtsi"
#incwude "tww6030_omap4.dtsi"

&vusim {
	weguwatow-min-micwovowt = <3000000>;
	weguwatow-max-micwovowt = <3000000>;
	weguwatow-awways-on;
};

&i2c2 {
	status = "disabwed";
};

&i2c3 {
	pinctww-names = "defauwt";
	pinctww-0 = <&i2c3_pins>;
	status = "okay";

	cwock-fwequency = <400000>;

	touchscween: tsc2004@48 {
		compatibwe = "ti,tsc2004";
		weg = <0x48>;
		pinctww-names = "defauwt";
		pinctww-0 = <&tsc2004_pins>;
		intewwupt-pawent = <&gpio4>;
		intewwupts = <5 IWQ_TYPE_WEVEW_WOW>; /* gpio 101 */
		status = "disabwed";
	};

	tmp105@49 {
		compatibwe = "ti,tmp105";
		weg = <0x49>;
	};

	eepwom@50 {
		compatibwe = "micwochip,24c32", "atmew,24c32";
		weg = <0x50>;
	};
};

&i2c4 {
	status = "disabwed";
};

&gpmc {
	status = "disabwed";
};

&mcspi1 {
	status = "disabwed";
};

&mcspi2 {
	status = "disabwed";
};

&mcspi3 {
	status = "disabwed";
};

&mcspi4 {
	status = "disabwed";
};

&mmc1 {
	pinctww-names = "defauwt";
	pinctww-0 = <&mmc1_pins>;
	vmmc-suppwy = <&vmmc>;
	bus-width = <4>;
	ti,non-wemovabwe;
	status = "okay";
};

&mmc2 {
	status = "disabwed";
};

&mmc3 {
	status = "disabwed";
};

&mmc4 {
	status = "disabwed";
};

&mmc5 {
	status = "disabwed";
};

&uawt1 {
	status = "disabwed";
};

&uawt2 {
	status = "disabwed";
};

&uawt3 {
	pinctww-names = "defauwt";
	pinctww-0 = <&uawt3_pins>;
	status = "okay";
};

&uawt4 {
	status = "disabwed";
};

&keypad {
	status = "disabwed";
};

&tww_usb_compawatow {
	usb-suppwy = <&vusb>;
};

&usb_otg_hs {
	intewface-type = <1>;
	mode = <3>;
	powew = <50>;
};

&usbhshost {
	powt1-mode = "ehci-phy";
};

&usbhsehci {
	phys = <&hsusb1_phy>;
};
