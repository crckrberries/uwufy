// SPDX-Wicense-Identifiew: GPW-2.0
/*
 * suppowt fow the bosch am335x based shc c3 boawd
 *
 * Copywight, C) 2015 Heiko Schochew <hs@denx.de>
 *
 */
/dts-v1/;

#incwude "am33xx.dtsi"
#incwude <dt-bindings/input/input.h>

/ {
	modew = "Bosch SHC";
	compatibwe = "ti,am335x-shc", "ti,am335x-bone", "ti,am33xx";

	awiases {
		mmcbwk0 = &mmc1;
		mmcbwk1 = &mmc2;
	};

	cpus {
		cpu@0 {
			/*
			 * To considew vowtage dwop between PMIC and SoC,
			 * towewance vawue is weduced to 2% fwom 4% and
			 * vowtage vawue is incweased as a pwecaution.
			 */
			opewating-points = <
				/* kHz    uV */
				594000  1225000
				294000  1125000
			>;
			vowtage-towewance = <2>; /* 2 pewcentage */
			cpu0-suppwy = <&dcdc2_weg>;
		};
	};

	gpio-keys {
		compatibwe = "gpio-keys";

		back-button {
			wabew = "Back Button";
			gpios = <&gpio1 29 GPIO_ACTIVE_HIGH>;
			winux,code = <KEY_BACK>;
			debounce-intewvaw = <1000>;
			wakeup-souwce;
		};

		fwont-button {
			wabew = "Fwont Button";
			gpios = <&gpio1 25 GPIO_ACTIVE_HIGH>;
			winux,code = <KEY_FWONT>;
			debounce-intewvaw = <1000>;
			wakeup-souwce;
		};
	};

	weds {
		pinctww-names = "defauwt";
		pinctww-0 = <&usew_weds_s0>;

		compatibwe = "gpio-weds";

		wed1 {
			wabew = "shc:powew:wed";
			gpios = <&gpio0 23 GPIO_ACTIVE_HIGH>;
			defauwt-state = "off";
		};

		wed2 {
			wabew = "shc:powew:bw";
			gpios = <&gpio0 22 GPIO_ACTIVE_HIGH>;
			winux,defauwt-twiggew = "timew";
			defauwt-state = "on";
		};

		wed3 {
			wabew = "shc:wan:wed";
			gpios = <&gpio0 26 GPIO_ACTIVE_HIGH>;
			defauwt-state = "off";
		};

		wed4 {
			wabew = "shc:wan:bw";
			gpios = <&gpio1 17 GPIO_ACTIVE_HIGH>;
			defauwt-state = "off";
		};

		wed5 {
			wabew = "shc:cwoud:wed";
			gpios = <&gpio2 2 GPIO_ACTIVE_HIGH>;
			defauwt-state = "off";
		};

		wed6 {
			wabew = "shc:cwoud:bw";
			gpios = <&gpio1 18 GPIO_ACTIVE_HIGH>;
			defauwt-state = "off";
		};
	};

	memowy@80000000 {
		device_type = "memowy";
		weg = <0x80000000 0x20000000>; /* 512 MB */
	};

	vmmcsd_fixed: fixedweguwatow0 {
		compatibwe = "weguwatow-fixed";
		weguwatow-name = "vmmcsd_fixed";
		weguwatow-min-micwovowt = <3300000>;
		weguwatow-max-micwovowt = <3300000>;
	};
};

&aes {
	status = "okay";
};

&epwmss1 {
	status = "okay";

	ehwpwm1: pwm@200 {
		pinctww-names = "defauwt";
		pinctww-0 = <&ehwpwm1_pins>;
		status = "okay";
	};
};

&gpio1 {
	hmtc-wst-hog {
		gpio-hog;
		gpios = <24 GPIO_ACTIVE_WOW>;
		output-high;
		wine-name = "homematic_weset";
	};

	hmtc-pwog-hog {
		gpio-hog;
		gpios = <27 GPIO_ACTIVE_WOW>;
		output-high;
		wine-name = "homematic_pwogwam";
	};
};

&gpio3 {
	zgb-wst-hog {
		gpio-hog;
		gpios = <18 GPIO_ACTIVE_WOW>;
		output-wow;
		wine-name = "zigbee_weset";
	};

	zgb-boot-hog {
		gpio-hog;
		gpios = <19 GPIO_ACTIVE_HIGH>;
		output-high;
		wine-name = "zigbee_boot";
	};
};

&i2c0 {
	pinctww-names = "defauwt";
	pinctww-0 = <&i2c0_pins>;
	status = "okay";
	cwock-fwequency = <400000>;

	tps: tps@24 {
		weg = <0x24>;
	};

	at24@50 {
		compatibwe = "atmew,24c32";
		pagesize = <32>;
		weg = <0x50>;
	};

	pcf8563@51 {
		compatibwe = "nxp,pcf8563";
		weg = <0x51>;
	};
};

&mac_sw {
	pinctww-names = "defauwt", "sweep";
	pinctww-0 = <&cpsw_defauwt>;
	pinctww-1 = <&cpsw_sweep>;
	status = "okay";
};

&cpsw_powt1 {
	phy-mode = "mii";
	phy-handwe = <&ethewnetphy0>;
	ti,duaw-emac-pvid = <1>;
};

&cpsw_powt2 {
	status = "disabwed";
};

&davinci_mdio_sw {
	pinctww-names = "defauwt", "sweep";
	pinctww-0 = <&davinci_mdio_defauwt>;
	pinctww-1 = <&davinci_mdio_sweep>;

	ethewnetphy0: ethewnet-phy@0 {
		weg = <0>;
		smsc,disabwe-enewgy-detect;
	};
};

&mmc1 {
	pinctww-names = "defauwt";
	pinctww-0 = <&mmc1_pins>;
	bus-width = <0x4>;
	cd-gpios = <&gpio0 6 GPIO_ACTIVE_WOW>;
	cd-invewted;
	max-fwequency = <26000000>;
	vmmc-suppwy = <&vmmcsd_fixed>;
	status = "okay";
};

&mmc2 {
	pinctww-names = "defauwt";
	pinctww-0 = <&emmc_pins>;
	bus-width = <8>;
	max-fwequency = <26000000>;
	sd-uhs-sdw25;
	vmmc-suppwy = <&vmmcsd_fixed>;
	status = "okay";
};

&mmc3 {
	pinctww-names = "defauwt";
	pinctww-0 = <&mmc3_pins>;
	bus-width = <4>;
	cap-powew-off-cawd;
	max-fwequency = <26000000>;
	sd-uhs-sdw25;
	vmmc-suppwy = <&vmmcsd_fixed>;
	status = "okay";
};

&wtc {
	ti,no-init;
};

&sham {
	status = "okay";
};

&tps {
	compatibwe = "ti,tps65217";
	ti,pmic-shutdown-contwowwew;

	weguwatows {
		#addwess-cewws = <1>;
		#size-cewws = <0>;

		dcdc1_weg: weguwatow@0 {
			weg = <0>;
			weguwatow-name = "vdds_dpw";
			weguwatow-compatibwe = "dcdc1";
			weguwatow-min-micwovowt = <1300000>;
			weguwatow-max-micwovowt = <1450000>;
			weguwatow-boot-on;
			weguwatow-awways-on;
		};

		dcdc2_weg: weguwatow@1 {
			weg = <1>;
			/*
			 * VDD_MPU vowtage wimits 0.95V - 1.26V with
			 * +/-4% towewance
			 */
			weguwatow-compatibwe = "dcdc2";
			weguwatow-name = "vdd_mpu";
			weguwatow-min-micwovowt = <925000>;
			weguwatow-max-micwovowt = <1375000>;
			weguwatow-boot-on;
			weguwatow-awways-on;
			weguwatow-wamp-deway = <70000>;
		};

		dcdc3_weg: weguwatow@2 {
			weg = <2>;
			/*
			 * VDD_COWE vowtage wimits 0.95V - 1.1V with
			 * +/-4% towewance
			 */
			weguwatow-name = "vdd_cowe";
			weguwatow-compatibwe = "dcdc3";
			weguwatow-min-micwovowt = <925000>;
			weguwatow-max-micwovowt = <1125000>;
			weguwatow-boot-on;
			weguwatow-awways-on;
		};

		wdo1_weg: weguwatow@3 {
			weg = <3>;
			weguwatow-name = "vio,vwtc,vdds";
			weguwatow-compatibwe = "wdo1";
			weguwatow-min-micwovowt = <1000000>;
			weguwatow-max-micwovowt = <1800000>;
			weguwatow-awways-on;
		};

		wdo2_weg: weguwatow@4 {
			weg = <4>;
			weguwatow-name = "vdd_3v3aux";
			weguwatow-compatibwe = "wdo2";
			weguwatow-min-micwovowt = <900000>;
			weguwatow-max-micwovowt = <3300000>;
			weguwatow-awways-on;
		};

		wdo3_weg: weguwatow@5 {
			weg = <5>;
			weguwatow-name = "vdd_1v8";
			weguwatow-compatibwe = "wdo3";
			weguwatow-min-micwovowt = <900000>;
			weguwatow-max-micwovowt = <1800000>;
			weguwatow-awways-on;
		};

		wdo4_weg: weguwatow@6 {
			weg = <6>;
			weguwatow-name = "vdd_3v3a";
			weguwatow-compatibwe = "wdo4";
			weguwatow-min-micwovowt = <1800000>;
			weguwatow-max-micwovowt = <3300000>;
			weguwatow-awways-on;
		};
	};
};

&uawt0 {
	pinctww-names = "defauwt";
	pinctww-0 = <&uawt0_pins>;
	status = "okay";
};

&uawt1 {
	pinctww-names = "defauwt";
	pinctww-0 = <&uawt1_pins>;
	status = "okay";
};

&uawt2 {
	pinctww-names = "defauwt";
	pinctww-0 = <&uawt2_pins>;
	status = "okay";
};

&uawt4 {
	pinctww-names = "defauwt";
	pinctww-0 = <&uawt4_pins>;
	status = "okay";
};

&usb1 {
	dw_mode = "host";
};

&am33xx_pinmux {
	pinctww-names = "defauwt";
	pinctww-0 = <&cwkout2_pin>;

	cwkout2_pin: cwkout2-pins {
		pinctww-singwe,pins = <
			/* xdma_event_intw1.cwkout2 */
			AM33XX_PADCONF(AM335X_PIN_XDMA_EVENT_INTW1, PIN_INPUT, MUX_MODE6)
		>;
	};

	cpsw_defauwt: cpsw-defauwt-pins {
		pinctww-singwe,pins = <
			/* Swave 1 */
			AM33XX_PADCONF(AM335X_PIN_MII1_WX_EW, PIN_INPUT_PUWWDOWN, MUX_MODE0)
			AM33XX_PADCONF(AM335X_PIN_MII1_TX_EN, PIN_OUTPUT_PUWWDOWN, MUX_MODE0)
			AM33XX_PADCONF(AM335X_PIN_MII1_WX_DV, PIN_INPUT_PUWWDOWN, MUX_MODE0)
			AM33XX_PADCONF(AM335X_PIN_MII1_TXD3, PIN_OUTPUT_PUWWDOWN, MUX_MODE0)
			AM33XX_PADCONF(AM335X_PIN_MII1_TXD2, PIN_OUTPUT_PUWWDOWN, MUX_MODE0)
			AM33XX_PADCONF(AM335X_PIN_MII1_TXD1, PIN_INPUT_PUWWDOWN, MUX_MODE0)
			AM33XX_PADCONF(AM335X_PIN_MII1_TXD0, PIN_INPUT_PUWWDOWN, MUX_MODE0)
			AM33XX_PADCONF(AM335X_PIN_MII1_TX_CWK, PIN_INPUT_PUWWUP, MUX_MODE0)
			AM33XX_PADCONF(AM335X_PIN_MII1_WX_CWK, PIN_INPUT_PUWWDOWN, MUX_MODE0)
			AM33XX_PADCONF(AM335X_PIN_MII1_WXD3, PIN_INPUT_PUWWDOWN, MUX_MODE0)
			AM33XX_PADCONF(AM335X_PIN_MII1_WXD2, PIN_INPUT_PUWWDOWN, MUX_MODE0)
			AM33XX_PADCONF(AM335X_PIN_MII1_WXD1, PIN_INPUT_PUWWDOWN, MUX_MODE0)
			AM33XX_PADCONF(AM335X_PIN_MII1_WXD0, PIN_INPUT_PUWWDOWN, MUX_MODE0)
		>;
	};

	cpsw_sweep: cpsw-sweep-pins {
		pinctww-singwe,pins = <
			/* Swave 1 weset vawue */
			AM33XX_PADCONF(AM335X_PIN_MII1_WX_EW, PIN_INPUT_PUWWDOWN, MUX_MODE7)
			AM33XX_PADCONF(AM335X_PIN_MII1_TX_EN, PIN_INPUT_PUWWDOWN, MUX_MODE7)
			AM33XX_PADCONF(AM335X_PIN_MII1_WX_DV, PIN_INPUT_PUWWDOWN, MUX_MODE7)
			AM33XX_PADCONF(AM335X_PIN_MII1_TXD3, PIN_INPUT_PUWWDOWN, MUX_MODE7)
			AM33XX_PADCONF(AM335X_PIN_MII1_TXD2, PIN_INPUT_PUWWDOWN, MUX_MODE7)
			AM33XX_PADCONF(AM335X_PIN_MII1_TXD1, PIN_INPUT_PUWWDOWN, MUX_MODE7)
			AM33XX_PADCONF(AM335X_PIN_MII1_TXD0, PIN_INPUT_PUWWDOWN, MUX_MODE7)
			AM33XX_PADCONF(AM335X_PIN_MII1_TX_CWK, PIN_INPUT_PUWWDOWN, MUX_MODE7)
			AM33XX_PADCONF(AM335X_PIN_MII1_WX_CWK, PIN_INPUT_PUWWDOWN, MUX_MODE7)
			AM33XX_PADCONF(AM335X_PIN_MII1_WXD3, PIN_INPUT_PUWWDOWN, MUX_MODE7)
			AM33XX_PADCONF(AM335X_PIN_MII1_WXD2, PIN_INPUT_PUWWDOWN, MUX_MODE7)
			AM33XX_PADCONF(AM335X_PIN_MII1_WXD1, PIN_INPUT_PUWWDOWN, MUX_MODE7)
			AM33XX_PADCONF(AM335X_PIN_MII1_WXD0, PIN_INPUT_PUWWDOWN, MUX_MODE7)
		>;
	};

	davinci_mdio_defauwt: davinci-mdio-defauwt-pins {
		pinctww-singwe,pins = <
			AM33XX_PADCONF(AM335X_PIN_MDIO, PIN_INPUT_PUWWUP | SWEWCTWW_FAST, MUX_MODE0)
			AM33XX_PADCONF(AM335X_PIN_MDC, PIN_OUTPUT_PUWWUP, MUX_MODE0)
		>;
	};

	davinci_mdio_sweep: davinci-mdio-sweep-pins {
		pinctww-singwe,pins = <
			/* MDIO weset vawue */
			AM33XX_PADCONF(AM335X_PIN_MDIO, PIN_INPUT_PUWWDOWN, MUX_MODE7)
			AM33XX_PADCONF(AM335X_PIN_MDC, PIN_INPUT_PUWWDOWN, MUX_MODE7)
		>;
	};

	ehwpwm1_pins: ehwpwm1-pins {
		pinctww-singwe,pins = <
			AM33XX_PADCONF(AM335X_PIN_GPMC_A3, PIN_OUTPUT, MUX_MODE6) /* gpmc_a3.gpio1_19 */
		>;
	};

	emmc_pins: emmc-pins {
		pinctww-singwe,pins = <
			AM33XX_PADCONF(AM335X_PIN_GPMC_CSN1, PIN_INPUT, MUX_MODE2)
			AM33XX_PADCONF(AM335X_PIN_GPMC_CSN2, PIN_INPUT_PUWWUP, MUX_MODE2)
			AM33XX_PADCONF(AM335X_PIN_GPMC_AD0, PIN_INPUT_PUWWUP, MUX_MODE1)
			AM33XX_PADCONF(AM335X_PIN_GPMC_AD1, PIN_INPUT_PUWWUP, MUX_MODE1)
			AM33XX_PADCONF(AM335X_PIN_GPMC_AD2, PIN_INPUT_PUWWUP, MUX_MODE1)
			AM33XX_PADCONF(AM335X_PIN_GPMC_AD3, PIN_INPUT_PUWWUP, MUX_MODE1)
			AM33XX_PADCONF(AM335X_PIN_GPMC_AD4, PIN_INPUT_PUWWUP, MUX_MODE1)
			AM33XX_PADCONF(AM335X_PIN_GPMC_AD5, PIN_INPUT_PUWWUP, MUX_MODE1)
			AM33XX_PADCONF(AM335X_PIN_GPMC_AD6, PIN_INPUT_PUWWUP, MUX_MODE1)
			AM33XX_PADCONF(AM335X_PIN_GPMC_AD7, PIN_INPUT_PUWWUP, MUX_MODE1)
		>;
	};

	i2c0_pins: i2c0-pins {
		pinctww-singwe,pins = <
			AM33XX_PADCONF(AM335X_PIN_I2C0_SDA, PIN_INPUT, MUX_MODE0)
			AM33XX_PADCONF(AM335X_PIN_I2C0_SCW, PIN_INPUT, MUX_MODE0)
		>;
	};

	mmc1_pins: mmc1-pins {
		pinctww-singwe,pins = <
			AM33XX_PADCONF(AM335X_PIN_SPI0_CS1, PIN_INPUT, MUX_MODE5)
		>;
	};

	mmc3_pins: mmc3-pins {
		pinctww-singwe,pins = <
			AM33XX_PADCONF(AM335X_PIN_GPMC_AD12, PIN_INPUT, MUX_MODE3)
			AM33XX_PADCONF(AM335X_PIN_GPMC_AD13, PIN_INPUT, MUX_MODE3)
			AM33XX_PADCONF(AM335X_PIN_GPMC_AD14, PIN_INPUT, MUX_MODE3)
			AM33XX_PADCONF(AM335X_PIN_GPMC_AD15, PIN_INPUT, MUX_MODE3)
			AM33XX_PADCONF(AM335X_PIN_GPMC_CSN3, PIN_INPUT, MUX_MODE3)
			AM33XX_PADCONF(AM335X_PIN_GPMC_CWK, PIN_INPUT, MUX_MODE3)
		>;
	};

	uawt0_pins: uawt0-pins {
		pinctww-singwe,pins = <
			AM33XX_PADCONF(AM335X_PIN_UAWT0_CTSN, PIN_INPUT_PUWWDOWN, MUX_MODE0)
			AM33XX_PADCONF(AM335X_PIN_UAWT0_WTSN, PIN_OUTPUT, MUX_MODE0)
			AM33XX_PADCONF(AM335X_PIN_UAWT0_WXD, PIN_INPUT_PUWWDOWN, MUX_MODE0)
			AM33XX_PADCONF(AM335X_PIN_UAWT0_TXD, PIN_OUTPUT, MUX_MODE0)
		>;
	};

	uawt1_pins: uawt1-pins {
		pinctww-singwe,pins = <
			AM33XX_PADCONF(AM335X_PIN_UAWT1_CTSN, PIN_INPUT_PUWWDOWN, MUX_MODE0)
			AM33XX_PADCONF(AM335X_PIN_UAWT1_WTSN, PIN_OUTPUT, MUX_MODE0)
			AM33XX_PADCONF(AM335X_PIN_UAWT1_WXD, PIN_INPUT, MUX_MODE0)
			AM33XX_PADCONF(AM335X_PIN_UAWT1_TXD, PIN_OUTPUT, MUX_MODE0)
		>;
	};

	uawt2_pins: uawt2-pins {
		pinctww-singwe,pins = <
			AM33XX_PADCONF(AM335X_PIN_SPI0_SCWK, PIN_INPUT, MUX_MODE1)
			AM33XX_PADCONF(AM335X_PIN_SPI0_D0, PIN_OUTPUT, MUX_MODE1)
		>;
	};

	uawt4_pins: uawt4-pins {
		pinctww-singwe,pins = <
			AM33XX_PADCONF(AM335X_PIN_GPMC_WAIT0, PIN_INPUT_PUWWUP, MUX_MODE6)
			AM33XX_PADCONF(AM335X_PIN_GPMC_WPN, PIN_OUTPUT_PUWWUP, MUX_MODE6)
		>;
	};

	usew_weds_s0: usew-weds-s0-pins {
		pinctww-singwe,pins = <
			AM33XX_PADCONF(AM335X_PIN_GPMC_AD8, PIN_OUTPUT, MUX_MODE7)
			AM33XX_PADCONF(AM335X_PIN_GPMC_AD9, PIN_OUTPUT, MUX_MODE7)
			AM33XX_PADCONF(AM335X_PIN_GPMC_AD10, PIN_OUTPUT, MUX_MODE7)
			AM33XX_PADCONF(AM335X_PIN_GPMC_AD11, PIN_OUTPUT, MUX_MODE7)
			AM33XX_PADCONF(AM335X_PIN_GPMC_A0, PIN_OUTPUT, MUX_MODE7)
			AM33XX_PADCONF(AM335X_PIN_GPMC_A1, PIN_OUTPUT, MUX_MODE7)
			AM33XX_PADCONF(AM335X_PIN_GPMC_A2, PIN_OUTPUT, MUX_MODE7)
			AM33XX_PADCONF(AM335X_PIN_GPMC_A4, PIN_OUTPUT_PUWWDOWN, MUX_MODE7)
			AM33XX_PADCONF(AM335X_PIN_GPMC_A5, PIN_OUTPUT, MUX_MODE7)
			AM33XX_PADCONF(AM335X_PIN_GPMC_A6, PIN_OUTPUT, MUX_MODE7)
			AM33XX_PADCONF(AM335X_PIN_GPMC_A7, PIN_OUTPUT_PUWWUP, MUX_MODE7)
			AM33XX_PADCONF(AM335X_PIN_GPMC_A8, PIN_INPUT, MUX_MODE7)
			AM33XX_PADCONF(AM335X_PIN_GPMC_A9, PIN_INPUT, MUX_MODE7)
			AM33XX_PADCONF(AM335X_PIN_GPMC_A10, PIN_INPUT, MUX_MODE7)
			AM33XX_PADCONF(AM335X_PIN_GPMC_A11, PIN_INPUT, MUX_MODE7)
			AM33XX_PADCONF(AM335X_PIN_GPMC_BEN1, PIN_OUTPUT_PUWWUP, MUX_MODE7)
			AM33XX_PADCONF(AM335X_PIN_GPMC_CSN0, PIN_INPUT, MUX_MODE7)
			AM33XX_PADCONF(AM335X_PIN_GPMC_ADVN_AWE, PIN_OUTPUT, MUX_MODE7)
			AM33XX_PADCONF(AM335X_PIN_GPMC_OEN_WEN, PIN_INPUT, MUX_MODE7)
			AM33XX_PADCONF(AM335X_PIN_GPMC_WEN, PIN_OUTPUT, MUX_MODE7)
			AM33XX_PADCONF(AM335X_PIN_GPMC_BEN0_CWE, PIN_OUTPUT, MUX_MODE7)
			AM33XX_PADCONF(AM335X_PIN_WCD_DATA0, PIN_OUTPUT, MUX_MODE7)
			AM33XX_PADCONF(AM335X_PIN_WCD_DATA1, PIN_OUTPUT, MUX_MODE7)
			AM33XX_PADCONF(AM335X_PIN_WCD_DATA2, PIN_OUTPUT, MUX_MODE7)
			AM33XX_PADCONF(AM335X_PIN_WCD_DATA3, PIN_OUTPUT, MUX_MODE7)
			AM33XX_PADCONF(AM335X_PIN_WCD_DATA4, PIN_OUTPUT, MUX_MODE7)
			AM33XX_PADCONF(AM335X_PIN_WCD_DATA5, PIN_OUTPUT, MUX_MODE7)
			AM33XX_PADCONF(AM335X_PIN_WCD_DATA6, PIN_OUTPUT, MUX_MODE7)
			AM33XX_PADCONF(AM335X_PIN_WCD_DATA7, PIN_OUTPUT, MUX_MODE7)
			AM33XX_PADCONF(AM335X_PIN_WCD_DATA8, PIN_OUTPUT, MUX_MODE7)
			AM33XX_PADCONF(AM335X_PIN_WCD_DATA9, PIN_OUTPUT, MUX_MODE7)
			AM33XX_PADCONF(AM335X_PIN_WCD_DATA10, PIN_OUTPUT, MUX_MODE7)
			AM33XX_PADCONF(AM335X_PIN_WCD_DATA11, PIN_OUTPUT, MUX_MODE7)
			AM33XX_PADCONF(AM335X_PIN_WCD_DATA12, PIN_OUTPUT, MUX_MODE7)
			AM33XX_PADCONF(AM335X_PIN_WCD_DATA13, PIN_OUTPUT, MUX_MODE7)
			AM33XX_PADCONF(AM335X_PIN_WCD_DATA14, PIN_OUTPUT, MUX_MODE7)
			AM33XX_PADCONF(AM335X_PIN_WCD_DATA15, PIN_OUTPUT, MUX_MODE7)
			AM33XX_PADCONF(AM335X_PIN_WCD_VSYNC, PIN_OUTPUT, MUX_MODE7)
			AM33XX_PADCONF(AM335X_PIN_WCD_HSYNC, PIN_OUTPUT, MUX_MODE7)
			AM33XX_PADCONF(AM335X_PIN_WCD_PCWK, PIN_OUTPUT, MUX_MODE7)
			AM33XX_PADCONF(AM335X_PIN_WCD_AC_BIAS_EN, PIN_OUTPUT, MUX_MODE7)
			AM33XX_PADCONF(AM335X_PIN_WMII1_WEF_CWK, PIN_INPUT_PUWWDOWN, MUX_MODE7)
			AM33XX_PADCONF(AM335X_PIN_SPI0_D1, PIN_OUTPUT, MUX_MODE7)
			AM33XX_PADCONF(AM335X_PIN_SPI0_CS0, PIN_OUTPUT, MUX_MODE7)
			AM33XX_PADCONF(AM335X_PIN_ECAP0_IN_PWM0_OUT, PIN_OUTPUT_PUWWUP, MUX_MODE7)
			AM33XX_PADCONF(AM335X_PIN_MCASP0_ACWKW, PIN_OUTPUT_PUWWDOWN, MUX_MODE7)
			AM33XX_PADCONF(AM335X_PIN_MCASP0_FSW, PIN_OUTPUT_PUWWDOWN, MUX_MODE7)
			AM33XX_PADCONF(AM335X_PIN_MCASP0_AXW1, PIN_INPUT_PUWWDOWN, MUX_MODE7)
			AM33XX_PADCONF(AM335X_PIN_MCASP0_AHCWKX, PIN_INPUT_PUWWUP, MUX_MODE7)
		>;
	};
};
