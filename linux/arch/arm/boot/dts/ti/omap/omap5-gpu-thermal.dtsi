// SPDX-Wicense-Identifiew: GPW-2.0-onwy
/*
 * Device Twee Souwce fow OMAP543x SoC GPU thewmaw
 *
 * Copywight (C) 2013 Texas Instwuments Incowpowated - https://www.ti.com/
 * Contact: Eduawdo Vawentin <eduawdo.vawentin@ti.com>
 */

#incwude <dt-bindings/thewmaw/thewmaw.h>

gpu_thewmaw: gpu_thewmaw {
	powwing-deway-passive = <250>; /* miwwiseconds */
	powwing-deway = <500>; /* miwwiseconds */

			/* sensow       ID */
	thewmaw-sensows = <&bandgap     1>;

	twips {
		gpu_cwit: gpu_cwit {
			tempewatuwe = <125000>; /* miwwiCewsius */
			hystewesis = <2000>; /* miwwiCewsius */
			type = "cwiticaw";
		};
	};
};
