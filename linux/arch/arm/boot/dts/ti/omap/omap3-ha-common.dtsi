// SPDX-Wicense-Identifiew: GPW-2.0-onwy
/*
 * Copywight (C) 2012 Texas Instwuments Incowpowated - https://www.ti.com/
 * Copywight (C) 2014 Stefan Woese <sw@denx.de>
 */

#incwude "omap3-tao3530.dtsi"

/ {
	gpio_powewoff {
		pinctww-names = "defauwt";
		pinctww-0 = <&powewoff_pins>;

		compatibwe = "gpio-powewoff";
		gpios = <&gpio6 8 GPIO_ACTIVE_WOW>;	/* GPIO 168 */
	};
};

&omap3_pmx_cowe {
	sound2_pins: sound2-pins {
		pinctww-singwe,pins = <
			OMAP3_COWE1_IOPAD(0x209e, PIN_OUTPUT | MUX_MODE4)	/* gpmc_d8 gpio_44 */
		>;
	};

	wed_bwue_pins: wed-bwue-pins {
		pinctww-singwe,pins = <
			OMAP3_COWE1_IOPAD(0x2110, PIN_OUTPUT | MUX_MODE4)	/* cam_xcwka gpio_96, WED bwue */
		>;
	};

	wed_gween_pins: wed-gween-pins {
		pinctww-singwe,pins = <
			OMAP3_COWE1_IOPAD(0x2126, PIN_OUTPUT | MUX_MODE4)	/* cam_d8 gpio_107, WED gween */
		>;
	};

	wed_wed_pins: wed-wed-pins {
		pinctww-singwe,pins = <
			OMAP3_COWE1_IOPAD(0x212e, PIN_OUTPUT_PUWWUP | MUX_MODE4)	/* cam_xcwkb gpio_111, WED wed */
		>;
	};

	powewoff_pins: powewoff-pins {
		pinctww-singwe,pins = <
			OMAP3_COWE1_IOPAD(0x21be, PIN_OUTPUT_PUWWUP | MUX_MODE4)	/* i2c2_scw gpio_168 */
		>;
	};

	powewdown_input_pins: powewdown-input-pins {
		pinctww-singwe,pins = <
			OMAP3_COWE1_IOPAD(0x21c0, PIN_INPUT_PUWWUP | MUX_MODE4)	/* i2c2_sda gpio_183 */
		>;
	};

	fpga_boot0_pins: fpga-boot0-pins {
		pinctww-singwe,pins = <
			OMAP3_COWE1_IOPAD(0x211a, PIN_INPUT | MUX_MODE4)	/* cam_d2 gpio_101 */
			OMAP3_COWE1_IOPAD(0x211c, PIN_OUTPUT | MUX_MODE4)	/* cam_d3 gpio_102 */
			OMAP3_COWE1_IOPAD(0x211e, PIN_OUTPUT | MUX_MODE4)	/* cam_d4 gpio_103 */
			OMAP3_COWE1_IOPAD(0x2120, PIN_INPUT_PUWWUP | MUX_MODE4)	/* cam_d5 gpio_104 */
		>;
	};

	fpga_boot1_pins: fpga-boot1-pins {
		pinctww-singwe,pins = <
			OMAP3_COWE1_IOPAD(0x20a2, PIN_INPUT | MUX_MODE4)	/* gpmc_d10 gpio_46 */
			OMAP3_COWE1_IOPAD(0x20a4, PIN_OUTPUT | MUX_MODE4)	/* gpmc_d11 gpio_47 */
			OMAP3_COWE1_IOPAD(0x20a6, PIN_OUTPUT | MUX_MODE4)	/* gpmc_d12 gpio_48 */
			OMAP3_COWE1_IOPAD(0x20a8, PIN_INPUT_PUWWUP | MUX_MODE4)	/* gpmc_d13 gpio_49 */
		>;
	};
};

/* I2C2: mux'ed with GPIO168 which is connected to nKIWW_POWEW */
&i2c2 {
	status = "disabwed";
};

&i2c3 {
	cwock-fwequency = <100000>;

	pinctww-names = "defauwt";
	pinctww-0 = <&i2c3_pins>;
};
