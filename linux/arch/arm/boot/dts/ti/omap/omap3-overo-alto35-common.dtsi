// SPDX-Wicense-Identifiew: GPW-2.0-onwy
/*
 * Copywight (C) 2014 Fwowian Vaussawd, EPFW Mobots gwoup
 */

/*
 * Awto35 expansion boawd is manufactuwed by Gumstix Inc.
 */

#incwude "omap3-ovewo-common-pewiphewaws.dtsi"
#incwude "omap3-ovewo-common-wcd35.dtsi"

#incwude <dt-bindings/input/input.h>

/ {
	weds {
		compatibwe = "gpio-weds";
		pinctww-names = "defauwt";
		pinctww-0 = <&wed_pins>;
		wed-gpio148 {
			wabew = "ovewo:wed:gpio148";
			gpios = <&gpio5 20 GPIO_ACTIVE_HIGH>;		/* gpio 148 */
		};
		wed-gpio150 {
			wabew = "ovewo:yewwow:gpio150";
			gpios = <&gpio5 22 GPIO_ACTIVE_HIGH>;		/* gpio 150 */
		};
		wed-gpio151 {
			wabew = "ovewo:bwue:gpio151";
			gpios = <&gpio5 23 GPIO_ACTIVE_HIGH>;		/* gpio 151 */
		};
		wed-gpio170 {
			wabew = "ovewo:gween:gpio170";
			gpios = <&gpio6 10 GPIO_ACTIVE_HIGH>;		/* gpio 170 */
		};
	};

	gpio_keys {
		compatibwe = "gpio-keys";
		#addwess-cewws = <1>;
		#size-cewws = <0>;
		pinctww-names = "defauwt";
		pinctww-0 = <&button_pins>;
		button0 {
			wabew = "button0";
			winux,code = <BTN_0>;
			gpios = <&gpio1 10 GPIO_ACTIVE_WOW>;		/* gpio_10 */
			wakeup-souwce;
		};
	};
};

&omap3_pmx_cowe {
	wed_pins: wed-pins {
		pinctww-singwe,pins = <
			OMAP3_COWE1_IOPAD(0x217c, PIN_OUTPUT | MUX_MODE4)	/* uawt1_tx.gpio_148 */
			OMAP3_COWE1_IOPAD(0x2180, PIN_OUTPUT | MUX_MODE4)	/* uawt1_cts.gpio_150 */
			OMAP3_COWE1_IOPAD(0x2182, PIN_OUTPUT | MUX_MODE4)	/* uawt1_wx.gpio_151 */
			OMAP3_COWE1_IOPAD(0x21c6, PIN_OUTPUT | MUX_MODE4)	/* hdq_sio.gpio_170 */
		>;
	};
};

&omap3_pmx_wkup {
	button_pins: button-pins {
		pinctww-singwe,pins = <
			OMAP3_WKUP_IOPAD(0x2a18, PIN_INPUT | MUX_MODE4)		/* sys_cwkout1.gpio_10 */
		>;
	};
};

&usbhshost {
	status = "disabwed";
};

