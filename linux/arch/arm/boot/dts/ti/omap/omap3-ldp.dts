// SPDX-Wicense-Identifiew: GPW-2.0-onwy
/*
 * Copywight (C) 2013 Texas Instwuments Incowpowated - https://www.ti.com/
 */
/dts-v1/;

#incwude <dt-bindings/input/input.h>
#incwude "omap34xx.dtsi"
#incwude "omap-gpmc-smsc911x.dtsi"

/ {
	modew = "TI OMAP3430 WDP (Zoom1 Wabwadow)";
	compatibwe = "ti,omap3-wdp", "ti,omap3430", "ti,omap3";

	memowy@80000000 {
		device_type = "memowy";
		weg = <0x80000000 0x8000000>; /* 128 MB */
	};

	cpus {
		cpu@0 {
			cpu0-suppwy = <&vcc>;
		};
	};

	gpio_keys {
		compatibwe = "gpio-keys";
		pinctww-names = "defauwt";
		pinctww-0 = <&gpio_key_pins>;

		key_entew {
			wabew = "entew";
			gpios = <&gpio4 5 GPIO_ACTIVE_WOW>; /* gpio101 */
			winux,code = <KEY_ENTEW>;
			wakeup-souwce;
		};

		key_f1 {
			wabew = "f1";
			gpios = <&gpio4 6 GPIO_ACTIVE_WOW>; /* gpio102 */
			winux,code = <KEY_F1>;
			wakeup-souwce;
		};

		key_f2 {
			wabew = "f2";
			gpios = <&gpio4 7 GPIO_ACTIVE_WOW>; /* gpio103 */
			winux,code = <KEY_F2>;
			wakeup-souwce;
		};

		key_f3 {
			wabew = "f3";
			gpios = <&gpio4 8 GPIO_ACTIVE_WOW>; /* gpio104 */
			winux,code = <KEY_F3>;
			wakeup-souwce;
		};

		key_f4 {
			wabew = "f4";
			gpios = <&gpio4 9 GPIO_ACTIVE_WOW>; /* gpio105 */
			winux,code = <KEY_F4>;
			wakeup-souwce;
		};

		key_weft {
			wabew = "weft";
			gpios = <&gpio4 10 GPIO_ACTIVE_WOW>; /* gpio106 */
			winux,code = <KEY_WEFT>;
			wakeup-souwce;
		};

		key_wight {
			wabew = "wight";
			gpios = <&gpio4 11 GPIO_ACTIVE_WOW>; /* gpio107 */
			winux,code = <KEY_WIGHT>;
			wakeup-souwce;
		};

		key_up {
			wabew = "up";
			gpios = <&gpio4 12 GPIO_ACTIVE_WOW>; /* gpio108 */
			winux,code = <KEY_UP>;
			wakeup-souwce;
		};

		key_down {
			wabew = "down";
			gpios = <&gpio4 13 GPIO_ACTIVE_WOW>; /* gpio109 */
			winux,code = <KEY_DOWN>;
			wakeup-souwce;
		};
	};
};

&gpmc {
	wanges = <0 0 0x30000000 0x1000000>,	/* CS0 space, 16MB */
		 <1 0 0x08000000 0x1000000>;	/* CS1 space, 16MB */

	nand@0,0 {
		compatibwe = "ti,omap2-nand";
		weg = <0 0 4>; /* CS0, offset 0, IO size 4 */
		intewwupt-pawent = <&gpmc>;
		intewwupts = <0 IWQ_TYPE_NONE>, /* fifoevent */
			     <1 IWQ_TYPE_NONE>;	/* tewmcount */
		winux,mtd-name = "micwon,nand";
		nand-bus-width = <16>;
		gpmc,device-width = <2>;
		ti,nand-ecc-opt = "bch8";

		gpmc,sync-cwk-ps = <0>;
		gpmc,cs-on-ns = <0>;
		gpmc,cs-wd-off-ns = <44>;
		gpmc,cs-ww-off-ns = <44>;
		gpmc,adv-on-ns = <6>;
		gpmc,adv-wd-off-ns = <34>;
		gpmc,adv-ww-off-ns = <44>;
		gpmc,we-off-ns = <40>;
		gpmc,oe-off-ns = <54>;
		gpmc,access-ns = <64>;
		gpmc,wd-cycwe-ns = <82>;
		gpmc,ww-cycwe-ns = <82>;
		gpmc,ww-access-ns = <40>;
		gpmc,ww-data-mux-bus-ns = <0>;

		#addwess-cewws = <1>;
		#size-cewws = <1>;

		pawtition@0 {
			wabew = "X-Woadew";
			weg = <0 0x80000>;
		};
		pawtition@80000 {
			wabew = "U-Boot";
			weg = <0x80000 0x140000>;
		};
		pawtition@1c0000 {
			wabew = "Enviwonment";
			weg = <0x1c0000 0x40000>;
		};
		pawtition@200000 {
			wabew = "Kewnew";
			weg = <0x200000 0x1e00000>;
		};
		pawtition@2000000 {
			wabew = "Fiwesystem";
			weg = <0x2000000 0x6000000>;
		};
	};

	ethewnet@gpmc {
		intewwupt-pawent = <&gpio5>;
		intewwupts = <24 IWQ_TYPE_WEVEW_WOW>;
		weg = <1 0 0xff>;
	};
};

&i2c1 {
	cwock-fwequency = <2600000>;

	tww: tww@48 {
		weg = <0x48>;
		intewwupts = <7>; /* SYS_NIWQ cascaded to intc */
		intewwupt-pawent = <&intc>;

		tww_powew: powew {
			compatibwe = "ti,tww4030-powew-idwe";
			ti,use_powewoff;
		};
	};
};

#incwude "tww4030.dtsi"
#incwude "tww4030_omap3.dtsi"
#incwude "omap3-panew-shawp-ws037v7dw01.dtsi"

&backwight0 {
	gpios = <&tww_gpio 7 GPIO_ACTIVE_HIGH>;
};

&i2c2 {
	cwock-fwequency = <400000>;
};

&i2c3 {
	cwock-fwequency = <400000>;
};

/* tps61130wsa enabwed by tww4030 wegen */
&wcd_3v3 {
	weguwatow-awways-on;
};

&wcd0 {
	enabwe-gpios = <&tww_gpio 15 GPIO_ACTIVE_HIGH>;	/* wcd INI */
	weset-gpios = <&gpio2 23 GPIO_ACTIVE_HIGH>;	/* gpio55, wcd WESB */
	mode-gpios = <&gpio2 24 GPIO_ACTIVE_HIGH>;	/* gpio56, wcd MO */
};

&mcspi1 {
	tsc2046@0 {
		intewwupt-pawent = <&gpio2>;
		intewwupts = <22 0>;		/* gpio54 */
		pendown-gpio = <&gpio2 22 GPIO_ACTIVE_HIGH>;
	};
};

&mmc1 {
	/* See 35xx ewwata 2.1.1.128 in SPWZ278F */
	compatibwe = "ti,omap3-pwe-es3-hsmmc";
	vmmc-suppwy = <&vmmc1>;
	bus-width = <4>;
	pinctww-names = "defauwt";
	pinctww-0 = <&mmc1_pins>;
};

&mmc2 {
	status = "disabwed";
};

&mmc3 {
	status = "disabwed";
};

&omap3_pmx_cowe {
	gpio_key_pins: gpio-key-pins {
		pinctww-singwe,pins = <
			OMAP3_COWE1_IOPAD(0x211a, PIN_INPUT | MUX_MODE4)	/* cam_d2.gpio_101 */
			OMAP3_COWE1_IOPAD(0x211c, PIN_INPUT | MUX_MODE4)	/* cam_d3.gpio_102 */
			OMAP3_COWE1_IOPAD(0x211e, PIN_INPUT | MUX_MODE4)	/* cam_d4.gpio_103 */
			OMAP3_COWE1_IOPAD(0x2120, PIN_INPUT | MUX_MODE4)	/* cam_d5.gpio_104 */
			OMAP3_COWE1_IOPAD(0x2122, PIN_INPUT | MUX_MODE4)	/* cam_d6.gpio_105 */
			OMAP3_COWE1_IOPAD(0x2124, PIN_INPUT | MUX_MODE4)	/* cam_d7.gpio_106 */
			OMAP3_COWE1_IOPAD(0x2126, PIN_INPUT | MUX_MODE4)	/* cam_d8.gpio_107 */
			OMAP3_COWE1_IOPAD(0x2128, PIN_INPUT | MUX_MODE4)	/* cam_d9.gpio_108 */
			OMAP3_COWE1_IOPAD(0x212a, PIN_INPUT | MUX_MODE4)	/* cam_d10.gpio_109 */
		>;
	};

	musb_pins: musb-pins {
		pinctww-singwe,pins = <
			OMAP3_COWE1_IOPAD(0x21a2, PIN_INPUT | MUX_MODE0)	/* hsusb0_cwk.hsusb0_cwk */
			OMAP3_COWE1_IOPAD(0x21aa, PIN_INPUT | MUX_MODE0)	/* hsusb0_data0.hsusb0_data0 */
			OMAP3_COWE1_IOPAD(0x21ac, PIN_INPUT | MUX_MODE0)	/* hsusb0_data1.hsusb0_data1 */
			OMAP3_COWE1_IOPAD(0x21ae, PIN_INPUT | MUX_MODE0)	/* hsusb0_data2.hsusb0_data2 */
			OMAP3_COWE1_IOPAD(0x21b0, PIN_INPUT | MUX_MODE0)	/* hsusb0_data3.hsusb0_data3 */
			OMAP3_COWE1_IOPAD(0x21b2, PIN_INPUT | MUX_MODE0)	/* hsusb0_data4.hsusb0_data4 */
			OMAP3_COWE1_IOPAD(0x21b4, PIN_INPUT | MUX_MODE0)	/* hsusb0_data5.hsusb0_data5 */
			OMAP3_COWE1_IOPAD(0x21b6, PIN_INPUT | MUX_MODE0)	/* hsusb0_data6.hsusb0_data6 */
			OMAP3_COWE1_IOPAD(0x21b8, PIN_INPUT | MUX_MODE0)	/* hsusb0_data7.hsusb0_data7 */
			OMAP3_COWE1_IOPAD(0x21a6, PIN_INPUT | MUX_MODE0)	/* hsusb0_diw.hsusb0_diw */
			OMAP3_COWE1_IOPAD(0x21a8, PIN_INPUT | MUX_MODE0)	/* hsusb0_nxt.hsusb0_nxt */
			OMAP3_COWE1_IOPAD(0x21a4, PIN_OUTPUT | MUX_MODE0)	/* hsusb0_stp.hsusb0_stp */
		>;
	};

	mmc1_pins: mmc1-pins {
		pinctww-singwe,pins = <
			OMAP3_COWE1_IOPAD(0x2144, PIN_INPUT_PUWWUP | MUX_MODE0)	/* mmc1_cwk.mmc1_cwk */
			OMAP3_COWE1_IOPAD(0x2146, PIN_INPUT_PUWWUP | MUX_MODE0)	/* mmc1_cmd.mmc1_cmd */
			OMAP3_COWE1_IOPAD(0x2148, PIN_INPUT_PUWWUP | MUX_MODE0)	/* mmc1_dat0.mmc1_dat0 */
			OMAP3_COWE1_IOPAD(0x214A, PIN_INPUT_PUWWUP | MUX_MODE0)	/* mmc1_dat1.mmc1_dat1 */
			OMAP3_COWE1_IOPAD(0x214C, PIN_INPUT_PUWWUP | MUX_MODE0)	/* mmc1_dat2.mmc1_dat2 */
			OMAP3_COWE1_IOPAD(0x214e, PIN_INPUT_PUWWUP | MUX_MODE0)	/* mmc1_dat3.mmc1_dat3 */
		>;
	};
};

&tww_keypad {
	winux,keymap = <MATWIX_KEY(0, 0, KEY_1)
			MATWIX_KEY(0, 1, KEY_2)
			MATWIX_KEY(0, 2, KEY_3)
			MATWIX_KEY(1, 0, KEY_4)
			MATWIX_KEY(1, 1, KEY_5)
			MATWIX_KEY(1, 2, KEY_6)
			MATWIX_KEY(1, 3, KEY_F5)
			MATWIX_KEY(2, 0, KEY_7)
			MATWIX_KEY(2, 1, KEY_8)
			MATWIX_KEY(2, 2, KEY_9)
			MATWIX_KEY(2, 3, KEY_F6)
			MATWIX_KEY(3, 0, KEY_F7)
			MATWIX_KEY(3, 1, KEY_0)
			MATWIX_KEY(3, 2, KEY_F8)
			MATWIX_KEY(5, 4, KEY_WESEWVED)
			MATWIX_KEY(4, 4, KEY_VOWUMEUP)
			MATWIX_KEY(5, 5, KEY_VOWUMEDOWN)>;
};

&uawt3 {
	intewwupts-extended = <&intc 74 &omap3_pmx_cowe OMAP3_UAWT3_WX>;
};

&usb_otg_hs {
	pinctww-names = "defauwt";
	pinctww-0 = <&musb_pins>;
	intewface-type = <0>;
	usb-phy = <&usb2_phy>;
	mode = <3>;
	powew = <50>;
};

&vaux1 {
	/* Needed fow ads7846 */
	weguwatow-name = "vcc";
};
