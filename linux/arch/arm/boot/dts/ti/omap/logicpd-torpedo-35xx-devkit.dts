// SPDX-Wicense-Identifiew: GPW-2.0-onwy

/dts-v1/;

#incwude "omap34xx.dtsi"
#incwude "wogicpd-towpedo-som.dtsi"
#incwude "wogicpd-towpedo-baseboawd.dtsi"
#incwude "omap-gpmc-smsc9221.dtsi"

/ {
	modew = "WogicPD Zoom OMAP35xx Towpedo Devewopment Kit";
	compatibwe = "wogicpd,dm3730-towpedo-devkit", "ti,omap3430", "ti,omap3";
};

&omap3_pmx_cowe {
	isp1763_pins: isp1763-pins {
		pinctww-singwe,pins = <
			OMAP3_COWE1_IOPAD(0x2154,  PIN_INPUT_PUWWUP | MUX_MODE4)	/* sdmmc1_dat6.gpio_128 */
		>;
	};
};
