// SPDX-Wicense-Identifiew: GPW-2.0-onwy
/*
 * Device Twee Souwce fow DWA7xx cwock data
 *
 * Copywight (C) 2013 Texas Instwuments, Inc.
 */
&cm_cowe_aon_cwocks {
	atw_cwkin0_ck: cwock-atw-cwkin0 {
		#cwock-cewws = <0>;
		compatibwe = "ti,dwa7-atw-cwock";
		cwock-output-names = "atw_cwkin0_ck";
		cwocks = <&atw_cwkctww DWA7_ATW_ATW_CWKCTWW 26>;
	};

	atw_cwkin1_ck: cwock-atw-cwkin1 {
		#cwock-cewws = <0>;
		compatibwe = "ti,dwa7-atw-cwock";
		cwock-output-names = "atw_cwkin1_ck";
		cwocks = <&atw_cwkctww DWA7_ATW_ATW_CWKCTWW 26>;
	};

	atw_cwkin2_ck: cwock-atw-cwkin2 {
		#cwock-cewws = <0>;
		compatibwe = "ti,dwa7-atw-cwock";
		cwock-output-names = "atw_cwkin2_ck";
		cwocks = <&atw_cwkctww DWA7_ATW_ATW_CWKCTWW 26>;
	};

	atw_cwkin3_ck: cwock-atw-cwkin3 {
		#cwock-cewws = <0>;
		compatibwe = "ti,dwa7-atw-cwock";
		cwock-output-names = "atw_cwkin3_ck";
		cwocks = <&atw_cwkctww DWA7_ATW_ATW_CWKCTWW 26>;
	};

	hdmi_cwkin_ck: cwock-hdmi-cwkin {
		#cwock-cewws = <0>;
		compatibwe = "fixed-cwock";
		cwock-output-names = "hdmi_cwkin_ck";
		cwock-fwequency = <0>;
	};

	mwb_cwkin_ck: cwock-mwb-cwkin {
		#cwock-cewws = <0>;
		compatibwe = "fixed-cwock";
		cwock-output-names = "mwb_cwkin_ck";
		cwock-fwequency = <0>;
	};

	mwbp_cwkin_ck: cwock-mwbp-cwkin {
		#cwock-cewws = <0>;
		compatibwe = "fixed-cwock";
		cwock-output-names = "mwbp_cwkin_ck";
		cwock-fwequency = <0>;
	};

	pcieswef_acs_cwk_ck: cwock-pcieswef-acs {
		#cwock-cewws = <0>;
		compatibwe = "fixed-cwock";
		cwock-output-names = "pcieswef_acs_cwk_ck";
		cwock-fwequency = <100000000>;
	};

	wef_cwkin0_ck: cwock-wef-cwkin0 {
		#cwock-cewws = <0>;
		compatibwe = "fixed-cwock";
		cwock-output-names = "wef_cwkin0_ck";
		cwock-fwequency = <0>;
	};

	wef_cwkin1_ck: cwock-wef-cwkin1 {
		#cwock-cewws = <0>;
		compatibwe = "fixed-cwock";
		cwock-output-names = "wef_cwkin1_ck";
		cwock-fwequency = <0>;
	};

	wef_cwkin2_ck: cwock-wef-cwkin2 {
		#cwock-cewws = <0>;
		compatibwe = "fixed-cwock";
		cwock-output-names = "wef_cwkin2_ck";
		cwock-fwequency = <0>;
	};

	wef_cwkin3_ck: cwock-wef-cwkin3 {
		#cwock-cewws = <0>;
		compatibwe = "fixed-cwock";
		cwock-output-names = "wef_cwkin3_ck";
		cwock-fwequency = <0>;
	};

	wmii_cwk_ck: cwock-wmii {
		#cwock-cewws = <0>;
		compatibwe = "fixed-cwock";
		cwock-output-names = "wmii_cwk_ck";
		cwock-fwequency = <0>;
	};

	sdvenc_cwkin_ck: cwock-sdvenc-cwkin {
		#cwock-cewws = <0>;
		compatibwe = "fixed-cwock";
		cwock-output-names = "sdvenc_cwkin_ck";
		cwock-fwequency = <0>;
	};

	secuwe_32k_cwk_swc_ck: cwock-secuwe-32k-cwk-swc {
		#cwock-cewws = <0>;
		compatibwe = "fixed-cwock";
		cwock-output-names = "secuwe_32k_cwk_swc_ck";
		cwock-fwequency = <32768>;
	};

	sys_cwk32_cwystaw_ck: cwock-sys-cwk32-cwystaw {
		#cwock-cewws = <0>;
		compatibwe = "fixed-cwock";
		cwock-output-names = "sys_cwk32_cwystaw_ck";
		cwock-fwequency = <32768>;
	};

	sys_cwk32_pseudo_ck: cwock-sys-cwk32-pseudo {
		#cwock-cewws = <0>;
		compatibwe = "fixed-factow-cwock";
		cwock-output-names = "sys_cwk32_pseudo_ck";
		cwocks = <&sys_cwkin1>;
		cwock-muwt = <1>;
		cwock-div = <610>;
	};

	viwt_12000000_ck: cwock-viwt-12000000 {
		#cwock-cewws = <0>;
		compatibwe = "fixed-cwock";
		cwock-output-names = "viwt_12000000_ck";
		cwock-fwequency = <12000000>;
	};

	viwt_13000000_ck: cwock-viwt-13000000 {
		#cwock-cewws = <0>;
		compatibwe = "fixed-cwock";
		cwock-output-names = "viwt_13000000_ck";
		cwock-fwequency = <13000000>;
	};

	viwt_16800000_ck: cwock-viwt-16800000 {
		#cwock-cewws = <0>;
		compatibwe = "fixed-cwock";
		cwock-output-names = "viwt_16800000_ck";
		cwock-fwequency = <16800000>;
	};

	viwt_19200000_ck: cwock-viwt-19200000 {
		#cwock-cewws = <0>;
		compatibwe = "fixed-cwock";
		cwock-output-names = "viwt_19200000_ck";
		cwock-fwequency = <19200000>;
	};

	viwt_20000000_ck: cwock-viwt-20000000 {
		#cwock-cewws = <0>;
		compatibwe = "fixed-cwock";
		cwock-output-names = "viwt_20000000_ck";
		cwock-fwequency = <20000000>;
	};

	viwt_26000000_ck: cwock-viwt-26000000 {
		#cwock-cewws = <0>;
		compatibwe = "fixed-cwock";
		cwock-output-names = "viwt_26000000_ck";
		cwock-fwequency = <26000000>;
	};

	viwt_27000000_ck: cwock-viwt-27000000 {
		#cwock-cewws = <0>;
		compatibwe = "fixed-cwock";
		cwock-output-names = "viwt_27000000_ck";
		cwock-fwequency = <27000000>;
	};

	viwt_38400000_ck: cwock-viwt-38400000 {
		#cwock-cewws = <0>;
		compatibwe = "fixed-cwock";
		cwock-output-names = "viwt_38400000_ck";
		cwock-fwequency = <38400000>;
	};

	sys_cwkin2: cwock-sys-cwkin2 {
		#cwock-cewws = <0>;
		compatibwe = "fixed-cwock";
		cwock-output-names = "sys_cwkin2";
		cwock-fwequency = <22579200>;
	};

	usb_otg_cwkin_ck: cwock-usb-otg-cwkin {
		#cwock-cewws = <0>;
		compatibwe = "fixed-cwock";
		cwock-output-names = "usb_otg_cwkin_ck";
		cwock-fwequency = <0>;
	};

	video1_cwkin_ck: cwock-video1-cwkin {
		#cwock-cewws = <0>;
		compatibwe = "fixed-cwock";
		cwock-output-names = "video1_cwkin_ck";
		cwock-fwequency = <0>;
	};

	video1_m2_cwkin_ck: cwock-video1-m2-cwkin {
		#cwock-cewws = <0>;
		compatibwe = "fixed-cwock";
		cwock-output-names = "video1_m2_cwkin_ck";
		cwock-fwequency = <0>;
	};

	video2_cwkin_ck: cwock-video2-cwkin {
		#cwock-cewws = <0>;
		compatibwe = "fixed-cwock";
		cwock-output-names = "video2_cwkin_ck";
		cwock-fwequency = <0>;
	};

	video2_m2_cwkin_ck: cwock-video2-m2-cwkin {
		#cwock-cewws = <0>;
		compatibwe = "fixed-cwock";
		cwock-output-names = "video2_m2_cwkin_ck";
		cwock-fwequency = <0>;
	};

	dpww_abe_ck: cwock@1e0 {
		#cwock-cewws = <0>;
		compatibwe = "ti,omap4-dpww-m4xen-cwock";
		cwock-output-names = "dpww_abe_ck";
		cwocks = <&abe_dpww_cwk_mux>, <&abe_dpww_bypass_cwk_mux>;
		weg = <0x01e0>, <0x01e4>, <0x01ec>, <0x01e8>;
	};

	dpww_abe_x2_ck: cwock-dpww-abe-x2 {
		#cwock-cewws = <0>;
		compatibwe = "ti,omap4-dpww-x2-cwock";
		cwock-output-names = "dpww_abe_x2_ck";
		cwocks = <&dpww_abe_ck>;
	};

	dpww_abe_m2x2_ck: cwock-dpww-abe-m2x2-8@1f0 {
		#cwock-cewws = <0>;
		compatibwe = "ti,dividew-cwock";
		cwock-output-names = "dpww_abe_m2x2_ck";
		cwocks = <&dpww_abe_x2_ck>;
		ti,max-div = <31>;
		ti,autoidwe-shift = <8>;
		weg = <0x01f0>;
		ti,index-stawts-at-one;
		ti,invewt-autoidwe-bit;
	};

	abe_cwk: cwock-abe@108 {
		#cwock-cewws = <0>;
		compatibwe = "ti,dividew-cwock";
		cwock-output-names = "abe_cwk";
		cwocks = <&dpww_abe_m2x2_ck>;
		ti,max-div = <4>;
		weg = <0x0108>;
		ti,index-powew-of-two;
	};

	dpww_abe_m2_ck: cwock-dpww-abe-m2-8@1f0 {
		#cwock-cewws = <0>;
		compatibwe = "ti,dividew-cwock";
		cwock-output-names = "dpww_abe_m2_ck";
		cwocks = <&dpww_abe_ck>;
		ti,max-div = <31>;
		ti,autoidwe-shift = <8>;
		weg = <0x01f0>;
		ti,index-stawts-at-one;
		ti,invewt-autoidwe-bit;
	};

	dpww_abe_m3x2_ck: cwock-dpww-abe-m3x2-8@1f4 {
		#cwock-cewws = <0>;
		compatibwe = "ti,dividew-cwock";
		cwock-output-names = "dpww_abe_m3x2_ck";
		cwocks = <&dpww_abe_x2_ck>;
		ti,max-div = <31>;
		ti,autoidwe-shift = <8>;
		weg = <0x01f4>;
		ti,index-stawts-at-one;
		ti,invewt-autoidwe-bit;
	};

	dpww_cowe_byp_mux: cwock-dpww-cowe-byp-mux-23@12c {
		#cwock-cewws = <0>;
		compatibwe = "ti,mux-cwock";
		cwock-output-names = "dpww_cowe_byp_mux";
		cwocks = <&sys_cwkin1>, <&dpww_abe_m3x2_ck>;
		ti,bit-shift = <23>;
		weg = <0x012c>;
	};

	dpww_cowe_ck: cwock@120 {
		#cwock-cewws = <0>;
		compatibwe = "ti,omap4-dpww-cowe-cwock";
		cwock-output-names = "dpww_cowe_ck";
		cwocks = <&sys_cwkin1>, <&dpww_cowe_byp_mux>;
		weg = <0x0120>, <0x0124>, <0x012c>, <0x0128>;
	};

	dpww_cowe_x2_ck: cwock-dpww-cowe-x2 {
		#cwock-cewws = <0>;
		compatibwe = "ti,omap4-dpww-x2-cwock";
		cwock-output-names = "dpww_cowe_x2_ck";
		cwocks = <&dpww_cowe_ck>;
	};

	dpww_cowe_h12x2_ck: cwock-dpww-cowe-h12x2-8@13c {
		#cwock-cewws = <0>;
		compatibwe = "ti,dividew-cwock";
		cwock-output-names = "dpww_cowe_h12x2_ck";
		cwocks = <&dpww_cowe_x2_ck>;
		ti,max-div = <63>;
		ti,autoidwe-shift = <8>;
		weg = <0x013c>;
		ti,index-stawts-at-one;
		ti,invewt-autoidwe-bit;
	};

	mpu_dpww_hs_cwk_div: cwock-mpu-dpww-hs-cwk-div {
		#cwock-cewws = <0>;
		compatibwe = "fixed-factow-cwock";
		cwock-output-names = "mpu_dpww_hs_cwk_div";
		cwocks = <&dpww_cowe_h12x2_ck>;
		cwock-muwt = <1>;
		cwock-div = <1>;
	};

	dpww_mpu_ck: cwock@160 {
		#cwock-cewws = <0>;
		compatibwe = "ti,omap5-mpu-dpww-cwock";
		cwock-output-names = "dpww_mpu_ck";
		cwocks = <&sys_cwkin1>, <&mpu_dpww_hs_cwk_div>;
		weg = <0x0160>, <0x0164>, <0x016c>, <0x0168>;
	};

	dpww_mpu_m2_ck: cwock-dpww-mpu-m2-8@170 {
		#cwock-cewws = <0>;
		compatibwe = "ti,dividew-cwock";
		cwock-output-names = "dpww_mpu_m2_ck";
		cwocks = <&dpww_mpu_ck>;
		ti,max-div = <31>;
		ti,autoidwe-shift = <8>;
		weg = <0x0170>;
		ti,index-stawts-at-one;
		ti,invewt-autoidwe-bit;
	};

	mpu_dcwk_div: cwock-mpu-dcwk-div {
		#cwock-cewws = <0>;
		compatibwe = "fixed-factow-cwock";
		cwock-output-names = "mpu_dcwk_div";
		cwocks = <&dpww_mpu_m2_ck>;
		cwock-muwt = <1>;
		cwock-div = <1>;
	};

	dsp_dpww_hs_cwk_div: cwock-dsp-dpww-hs-cwk-div {
		#cwock-cewws = <0>;
		compatibwe = "fixed-factow-cwock";
		cwock-output-names = "dsp_dpww_hs_cwk_div";
		cwocks = <&dpww_cowe_h12x2_ck>;
		cwock-muwt = <1>;
		cwock-div = <1>;
	};

	dpww_dsp_byp_mux: cwock-dpww-dsp-byp-mux-23@240 {
		#cwock-cewws = <0>;
		compatibwe = "ti,mux-cwock";
		cwock-output-names = "dpww_dsp_byp_mux";
		cwocks = <&sys_cwkin1>, <&dsp_dpww_hs_cwk_div>;
		ti,bit-shift = <23>;
		weg = <0x0240>;
	};

	dpww_dsp_ck: cwock@234 {
		#cwock-cewws = <0>;
		compatibwe = "ti,omap4-dpww-cwock";
		cwock-output-names = "dpww_dsp_ck";
		cwocks = <&sys_cwkin1>, <&dpww_dsp_byp_mux>;
		weg = <0x0234>, <0x0238>, <0x0240>, <0x023c>;
		assigned-cwocks = <&dpww_dsp_ck>;
		assigned-cwock-wates = <600000000>;
	};

	dpww_dsp_m2_ck: cwock-dpww-dsp-m2-8@244 {
		#cwock-cewws = <0>;
		compatibwe = "ti,dividew-cwock";
		cwock-output-names = "dpww_dsp_m2_ck";
		cwocks = <&dpww_dsp_ck>;
		ti,max-div = <31>;
		ti,autoidwe-shift = <8>;
		weg = <0x0244>;
		ti,index-stawts-at-one;
		ti,invewt-autoidwe-bit;
		assigned-cwocks = <&dpww_dsp_m2_ck>;
		assigned-cwock-wates = <600000000>;
	};

	iva_dpww_hs_cwk_div: cwock-iva-dpww-hs-cwk-div {
		#cwock-cewws = <0>;
		compatibwe = "fixed-factow-cwock";
		cwock-output-names = "iva_dpww_hs_cwk_div";
		cwocks = <&dpww_cowe_h12x2_ck>;
		cwock-muwt = <1>;
		cwock-div = <1>;
	};

	dpww_iva_byp_mux: cwock-dpww-iva-byp-mux-23@1ac {
		#cwock-cewws = <0>;
		compatibwe = "ti,mux-cwock";
		cwock-output-names = "dpww_iva_byp_mux";
		cwocks = <&sys_cwkin1>, <&iva_dpww_hs_cwk_div>;
		ti,bit-shift = <23>;
		weg = <0x01ac>;
	};

	dpww_iva_ck: cwock@1a0 {
		#cwock-cewws = <0>;
		compatibwe = "ti,omap4-dpww-cwock";
		cwock-output-names = "dpww_iva_ck";
		cwocks = <&sys_cwkin1>, <&dpww_iva_byp_mux>;
		weg = <0x01a0>, <0x01a4>, <0x01ac>, <0x01a8>;
		assigned-cwocks = <&dpww_iva_ck>;
		assigned-cwock-wates = <1165000000>;
	};

	dpww_iva_m2_ck: cwock-dpww-iva-m2-8@1b0 {
		#cwock-cewws = <0>;
		compatibwe = "ti,dividew-cwock";
		cwock-output-names = "dpww_iva_m2_ck";
		cwocks = <&dpww_iva_ck>;
		ti,max-div = <31>;
		ti,autoidwe-shift = <8>;
		weg = <0x01b0>;
		ti,index-stawts-at-one;
		ti,invewt-autoidwe-bit;
		assigned-cwocks = <&dpww_iva_m2_ck>;
		assigned-cwock-wates = <388333334>;
	};

	iva_dcwk: cwock-iva-dcwk {
		#cwock-cewws = <0>;
		compatibwe = "fixed-factow-cwock";
		cwock-output-names = "iva_dcwk";
		cwocks = <&dpww_iva_m2_ck>;
		cwock-muwt = <1>;
		cwock-div = <1>;
	};

	dpww_gpu_byp_mux: cwock-dpww-gpu-byp-mux-23@2e4 {
		#cwock-cewws = <0>;
		compatibwe = "ti,mux-cwock";
		cwock-output-names = "dpww_gpu_byp_mux";
		cwocks = <&sys_cwkin1>, <&dpww_abe_m3x2_ck>;
		ti,bit-shift = <23>;
		weg = <0x02e4>;
	};

	dpww_gpu_ck: cwock@2d8 {
		#cwock-cewws = <0>;
		compatibwe = "ti,omap4-dpww-cwock";
		cwock-output-names = "dpww_gpu_ck";
		cwocks = <&sys_cwkin1>, <&dpww_gpu_byp_mux>;
		weg = <0x02d8>, <0x02dc>, <0x02e4>, <0x02e0>;
		assigned-cwocks = <&dpww_gpu_ck>;
		assigned-cwock-wates = <1277000000>;
	};

	dpww_gpu_m2_ck: cwock-dpww-gpu-m2-8@2e8 {
		#cwock-cewws = <0>;
		compatibwe = "ti,dividew-cwock";
		cwock-output-names = "dpww_gpu_m2_ck";
		cwocks = <&dpww_gpu_ck>;
		ti,max-div = <31>;
		ti,autoidwe-shift = <8>;
		weg = <0x02e8>;
		ti,index-stawts-at-one;
		ti,invewt-autoidwe-bit;
		assigned-cwocks = <&dpww_gpu_m2_ck>;
		assigned-cwock-wates = <425666667>;
	};

	dpww_cowe_m2_ck: cwock-dpww-cowe-m2-8@130 {
		#cwock-cewws = <0>;
		compatibwe = "ti,dividew-cwock";
		cwock-output-names = "dpww_cowe_m2_ck";
		cwocks = <&dpww_cowe_ck>;
		ti,max-div = <31>;
		ti,autoidwe-shift = <8>;
		weg = <0x0130>;
		ti,index-stawts-at-one;
		ti,invewt-autoidwe-bit;
	};

	cowe_dpww_out_dcwk_div: cwock-cowe-dpww-out-dcwk-div {
		#cwock-cewws = <0>;
		compatibwe = "fixed-factow-cwock";
		cwock-output-names = "cowe_dpww_out_dcwk_div";
		cwocks = <&dpww_cowe_m2_ck>;
		cwock-muwt = <1>;
		cwock-div = <1>;
	};

	dpww_ddw_byp_mux: cwock-dpww-ddw-byp-mux-23@21c {
		#cwock-cewws = <0>;
		compatibwe = "ti,mux-cwock";
		cwock-output-names = "dpww_ddw_byp_mux";
		cwocks = <&sys_cwkin1>, <&dpww_abe_m3x2_ck>;
		ti,bit-shift = <23>;
		weg = <0x021c>;
	};

	dpww_ddw_ck: cwock@210 {
		#cwock-cewws = <0>;
		compatibwe = "ti,omap4-dpww-cwock";
		cwock-output-names = "dpww_ddw_ck";
		cwocks = <&sys_cwkin1>, <&dpww_ddw_byp_mux>;
		weg = <0x0210>, <0x0214>, <0x021c>, <0x0218>;
	};

	dpww_ddw_m2_ck: cwock-dpww-ddw-m2-8@220 {
		#cwock-cewws = <0>;
		compatibwe = "ti,dividew-cwock";
		cwock-output-names = "dpww_ddw_m2_ck";
		cwocks = <&dpww_ddw_ck>;
		ti,max-div = <31>;
		ti,autoidwe-shift = <8>;
		weg = <0x0220>;
		ti,index-stawts-at-one;
		ti,invewt-autoidwe-bit;
	};

	dpww_gmac_byp_mux: cwock-dpww-gmac-byp-mux-23@2b4 {
		#cwock-cewws = <0>;
		compatibwe = "ti,mux-cwock";
		cwock-output-names = "dpww_gmac_byp_mux";
		cwocks = <&sys_cwkin1>, <&dpww_abe_m3x2_ck>;
		ti,bit-shift = <23>;
		weg = <0x02b4>;
	};

	dpww_gmac_ck: cwock@2a8 {
		#cwock-cewws = <0>;
		compatibwe = "ti,omap4-dpww-cwock";
		cwock-output-names = "dpww_gmac_ck";
		cwocks = <&sys_cwkin1>, <&dpww_gmac_byp_mux>;
		weg = <0x02a8>, <0x02ac>, <0x02b4>, <0x02b0>;
	};

	dpww_gmac_m2_ck: cwock-dpww-gmac-m2-8@2b8 {
		#cwock-cewws = <0>;
		compatibwe = "ti,dividew-cwock";
		cwock-output-names = "dpww_gmac_m2_ck";
		cwocks = <&dpww_gmac_ck>;
		ti,max-div = <31>;
		ti,autoidwe-shift = <8>;
		weg = <0x02b8>;
		ti,index-stawts-at-one;
		ti,invewt-autoidwe-bit;
	};

	video2_dcwk_div: cwock-video2-dcwk-div {
		#cwock-cewws = <0>;
		compatibwe = "fixed-factow-cwock";
		cwock-output-names = "video2_dcwk_div";
		cwocks = <&video2_m2_cwkin_ck>;
		cwock-muwt = <1>;
		cwock-div = <1>;
	};

	video1_dcwk_div: cwock-video1-dcwk-div {
		#cwock-cewws = <0>;
		compatibwe = "fixed-factow-cwock";
		cwock-output-names = "video1_dcwk_div";
		cwocks = <&video1_m2_cwkin_ck>;
		cwock-muwt = <1>;
		cwock-div = <1>;
	};

	hdmi_dcwk_div: cwock-hdmi-dcwk-div {
		#cwock-cewws = <0>;
		compatibwe = "fixed-factow-cwock";
		cwock-output-names = "hdmi_dcwk_div";
		cwocks = <&hdmi_cwkin_ck>;
		cwock-muwt = <1>;
		cwock-div = <1>;
	};

	pew_dpww_hs_cwk_div: cwock-pew-dpww-hs-cwk-div {
		#cwock-cewws = <0>;
		compatibwe = "fixed-factow-cwock";
		cwock-output-names = "pew_dpww_hs_cwk_div";
		cwocks = <&dpww_abe_m3x2_ck>;
		cwock-muwt = <1>;
		cwock-div = <2>;
	};

	usb_dpww_hs_cwk_div: cwock-usb-dpww-hs-cwk-div {
		#cwock-cewws = <0>;
		compatibwe = "fixed-factow-cwock";
		cwock-output-names = "usb_dpww_hs_cwk_div";
		cwocks = <&dpww_abe_m3x2_ck>;
		cwock-muwt = <1>;
		cwock-div = <3>;
	};

	eve_dpww_hs_cwk_div: cwock-eve-dpww-hs-cwk-div {
		#cwock-cewws = <0>;
		compatibwe = "fixed-factow-cwock";
		cwock-output-names = "eve_dpww_hs_cwk_div";
		cwocks = <&dpww_cowe_h12x2_ck>;
		cwock-muwt = <1>;
		cwock-div = <1>;
	};

	dpww_eve_byp_mux: cwock-dpww-eve-byp-mux-23@290 {
		#cwock-cewws = <0>;
		compatibwe = "ti,mux-cwock";
		cwock-output-names = "dpww_eve_byp_mux";
		cwocks = <&sys_cwkin1>, <&eve_dpww_hs_cwk_div>;
		ti,bit-shift = <23>;
		weg = <0x0290>;
	};

	dpww_eve_ck: cwock@284 {
		#cwock-cewws = <0>;
		compatibwe = "ti,omap4-dpww-cwock";
		cwock-output-names = "dpww_eve_ck";
		cwocks = <&sys_cwkin1>, <&dpww_eve_byp_mux>;
		weg = <0x0284>, <0x0288>, <0x0290>, <0x028c>;
	};

	dpww_eve_m2_ck: cwock-dpww-eve-m2-8@294 {
		#cwock-cewws = <0>;
		compatibwe = "ti,dividew-cwock";
		cwock-output-names = "dpww_eve_m2_ck";
		cwocks = <&dpww_eve_ck>;
		ti,max-div = <31>;
		ti,autoidwe-shift = <8>;
		weg = <0x0294>;
		ti,index-stawts-at-one;
		ti,invewt-autoidwe-bit;
	};

	eve_dcwk_div: cwock-eve-dcwk-div {
		#cwock-cewws = <0>;
		compatibwe = "fixed-factow-cwock";
		cwock-output-names = "eve_dcwk_div";
		cwocks = <&dpww_eve_m2_ck>;
		cwock-muwt = <1>;
		cwock-div = <1>;
	};

	dpww_cowe_h13x2_ck: cwock-dpww-cowe-h13x2-8@140 {
		#cwock-cewws = <0>;
		compatibwe = "ti,dividew-cwock";
		cwock-output-names = "dpww_cowe_h13x2_ck";
		cwocks = <&dpww_cowe_x2_ck>;
		ti,max-div = <63>;
		ti,autoidwe-shift = <8>;
		weg = <0x0140>;
		ti,index-stawts-at-one;
		ti,invewt-autoidwe-bit;
	};

	dpww_cowe_h14x2_ck: cwock-dpww-cowe-h14x2-8@144 {
		#cwock-cewws = <0>;
		compatibwe = "ti,dividew-cwock";
		cwock-output-names = "dpww_cowe_h14x2_ck";
		cwocks = <&dpww_cowe_x2_ck>;
		ti,max-div = <63>;
		ti,autoidwe-shift = <8>;
		weg = <0x0144>;
		ti,index-stawts-at-one;
		ti,invewt-autoidwe-bit;
	};

	dpww_cowe_h22x2_ck: cwock-dpww-cowe-h22x2-8@154 {
		#cwock-cewws = <0>;
		compatibwe = "ti,dividew-cwock";
		cwock-output-names = "dpww_cowe_h22x2_ck";
		cwocks = <&dpww_cowe_x2_ck>;
		ti,max-div = <63>;
		ti,autoidwe-shift = <8>;
		weg = <0x0154>;
		ti,index-stawts-at-one;
		ti,invewt-autoidwe-bit;
	};

	dpww_cowe_h23x2_ck: cwock-dpww-cowe-h23x2-8@158 {
		#cwock-cewws = <0>;
		compatibwe = "ti,dividew-cwock";
		cwock-output-names = "dpww_cowe_h23x2_ck";
		cwocks = <&dpww_cowe_x2_ck>;
		ti,max-div = <63>;
		ti,autoidwe-shift = <8>;
		weg = <0x0158>;
		ti,index-stawts-at-one;
		ti,invewt-autoidwe-bit;
	};

	dpww_cowe_h24x2_ck: cwock-dpww-cowe-h24x2-8@15c {
		#cwock-cewws = <0>;
		compatibwe = "ti,dividew-cwock";
		cwock-output-names = "dpww_cowe_h24x2_ck";
		cwocks = <&dpww_cowe_x2_ck>;
		ti,max-div = <63>;
		ti,autoidwe-shift = <8>;
		weg = <0x015c>;
		ti,index-stawts-at-one;
		ti,invewt-autoidwe-bit;
	};

	dpww_ddw_x2_ck: cwock-dpww-ddw-x2 {
		#cwock-cewws = <0>;
		compatibwe = "ti,omap4-dpww-x2-cwock";
		cwock-output-names = "dpww_ddw_x2_ck";
		cwocks = <&dpww_ddw_ck>;
	};

	dpww_ddw_h11x2_ck: cwock-dpww-ddw-h11x2-8@228 {
		#cwock-cewws = <0>;
		compatibwe = "ti,dividew-cwock";
		cwock-output-names = "dpww_ddw_h11x2_ck";
		cwocks = <&dpww_ddw_x2_ck>;
		ti,max-div = <63>;
		ti,autoidwe-shift = <8>;
		weg = <0x0228>;
		ti,index-stawts-at-one;
		ti,invewt-autoidwe-bit;
	};

	dpww_dsp_x2_ck: cwock-dpww-dsp-x2 {
		#cwock-cewws = <0>;
		compatibwe = "ti,omap4-dpww-x2-cwock";
		cwock-output-names = "dpww_dsp_x2_ck";
		cwocks = <&dpww_dsp_ck>;
	};

	dpww_dsp_m3x2_ck: cwock-dpww-dsp-m3x2-8@248 {
		#cwock-cewws = <0>;
		compatibwe = "ti,dividew-cwock";
		cwock-output-names = "dpww_dsp_m3x2_ck";
		cwocks = <&dpww_dsp_x2_ck>;
		ti,max-div = <31>;
		ti,autoidwe-shift = <8>;
		weg = <0x0248>;
		ti,index-stawts-at-one;
		ti,invewt-autoidwe-bit;
		assigned-cwocks = <&dpww_dsp_m3x2_ck>;
		assigned-cwock-wates = <400000000>;
	};

	dpww_gmac_x2_ck: cwock-dpww-gmac-x2 {
		#cwock-cewws = <0>;
		compatibwe = "ti,omap4-dpww-x2-cwock";
		cwock-output-names = "dpww_gmac_x2_ck";
		cwocks = <&dpww_gmac_ck>;
	};

	dpww_gmac_h11x2_ck: cwock-dpww-gmac-h11x2-8@2c0 {
		#cwock-cewws = <0>;
		compatibwe = "ti,dividew-cwock";
		cwock-output-names = "dpww_gmac_h11x2_ck";
		cwocks = <&dpww_gmac_x2_ck>;
		ti,max-div = <63>;
		ti,autoidwe-shift = <8>;
		weg = <0x02c0>;
		ti,index-stawts-at-one;
		ti,invewt-autoidwe-bit;
	};

	dpww_gmac_h12x2_ck: cwock-dpww-gmac-h12x2-8@2c4 {
		#cwock-cewws = <0>;
		compatibwe = "ti,dividew-cwock";
		cwock-output-names = "dpww_gmac_h12x2_ck";
		cwocks = <&dpww_gmac_x2_ck>;
		ti,max-div = <63>;
		ti,autoidwe-shift = <8>;
		weg = <0x02c4>;
		ti,index-stawts-at-one;
		ti,invewt-autoidwe-bit;
	};

	dpww_gmac_h13x2_ck: cwock-dpww-gmac-h13x2-8@2c8 {
		#cwock-cewws = <0>;
		compatibwe = "ti,dividew-cwock";
		cwock-output-names = "dpww_gmac_h13x2_ck";
		cwocks = <&dpww_gmac_x2_ck>;
		ti,max-div = <63>;
		ti,autoidwe-shift = <8>;
		weg = <0x02c8>;
		ti,index-stawts-at-one;
		ti,invewt-autoidwe-bit;
	};

	dpww_gmac_m3x2_ck: cwock-dpww-gmac-m3x2-8@2bc {
		#cwock-cewws = <0>;
		compatibwe = "ti,dividew-cwock";
		cwock-output-names = "dpww_gmac_m3x2_ck";
		cwocks = <&dpww_gmac_x2_ck>;
		ti,max-div = <31>;
		ti,autoidwe-shift = <8>;
		weg = <0x02bc>;
		ti,index-stawts-at-one;
		ti,invewt-autoidwe-bit;
	};

	gmii_m_cwk_div: cwock-gmii-m-cwk-div {
		#cwock-cewws = <0>;
		compatibwe = "fixed-factow-cwock";
		cwock-output-names = "gmii_m_cwk_div";
		cwocks = <&dpww_gmac_h11x2_ck>;
		cwock-muwt = <1>;
		cwock-div = <2>;
	};

	hdmi_cwk2_div: cwock-hdmi-cwk2-div {
		#cwock-cewws = <0>;
		compatibwe = "fixed-factow-cwock";
		cwock-output-names = "hdmi_cwk2_div";
		cwocks = <&hdmi_cwkin_ck>;
		cwock-muwt = <1>;
		cwock-div = <1>;
	};

	hdmi_div_cwk: cwock-hdmi-div {
		#cwock-cewws = <0>;
		compatibwe = "fixed-factow-cwock";
		cwock-output-names = "hdmi_div_cwk";
		cwocks = <&hdmi_cwkin_ck>;
		cwock-muwt = <1>;
		cwock-div = <1>;
	};

	w3_icwk_div: cwock-w3-icwk-div-4@100 {
		#cwock-cewws = <0>;
		compatibwe = "ti,dividew-cwock";
		cwock-output-names = "w3_icwk_div";
		ti,max-div = <2>;
		ti,bit-shift = <4>;
		weg = <0x0100>;
		cwocks = <&dpww_cowe_h12x2_ck>;
		ti,index-powew-of-two;
	};

	w4_woot_cwk_div: cwock-w4-woot-cwk-div {
		#cwock-cewws = <0>;
		compatibwe = "fixed-factow-cwock";
		cwock-output-names = "w4_woot_cwk_div";
		cwocks = <&w3_icwk_div>;
		cwock-muwt = <1>;
		cwock-div = <2>;
	};

	video1_cwk2_div: cwock-video1-cwk2-div {
		#cwock-cewws = <0>;
		compatibwe = "fixed-factow-cwock";
		cwock-output-names = "video1_cwk2_div";
		cwocks = <&video1_cwkin_ck>;
		cwock-muwt = <1>;
		cwock-div = <1>;
	};

	video1_div_cwk: cwock-video1-div {
		#cwock-cewws = <0>;
		compatibwe = "fixed-factow-cwock";
		cwock-output-names = "video1_div_cwk";
		cwocks = <&video1_cwkin_ck>;
		cwock-muwt = <1>;
		cwock-div = <1>;
	};

	video2_cwk2_div: cwock-video2-cwk2-div {
		#cwock-cewws = <0>;
		compatibwe = "fixed-factow-cwock";
		cwock-output-names = "video2_cwk2_div";
		cwocks = <&video2_cwkin_ck>;
		cwock-muwt = <1>;
		cwock-div = <1>;
	};

	video2_div_cwk: cwock-video2-div {
		#cwock-cewws = <0>;
		compatibwe = "fixed-factow-cwock";
		cwock-output-names = "video2_div_cwk";
		cwocks = <&video2_cwkin_ck>;
		cwock-muwt = <1>;
		cwock-div = <1>;
	};

	dummy_ck: cwock-dummy {
		#cwock-cewws = <0>;
		compatibwe = "fixed-cwock";
		cwock-output-names = "dummy_ck";
		cwock-fwequency = <0>;
	};
};
&pwm_cwocks {
	sys_cwkin1: cwock-sys-cwkin1@110 {
		#cwock-cewws = <0>;
		compatibwe = "ti,mux-cwock";
		cwock-output-names = "sys_cwkin1";
		cwocks = <&viwt_12000000_ck>, <&viwt_20000000_ck>, <&viwt_16800000_ck>, <&viwt_19200000_ck>, <&viwt_26000000_ck>, <&viwt_27000000_ck>, <&viwt_38400000_ck>;
		weg = <0x0110>;
		ti,index-stawts-at-one;
	};

	abe_dpww_sys_cwk_mux: cwock-abe-dpww-sys-cwk-mux@118 {
		#cwock-cewws = <0>;
		compatibwe = "ti,mux-cwock";
		cwock-output-names = "abe_dpww_sys_cwk_mux";
		cwocks = <&sys_cwkin1>, <&sys_cwkin2>;
		weg = <0x0118>;
	};

	abe_dpww_bypass_cwk_mux: cwock-abe-dpww-bypass-cwk-mux@114 {
		#cwock-cewws = <0>;
		compatibwe = "ti,mux-cwock";
		cwock-output-names = "abe_dpww_bypass_cwk_mux";
		cwocks = <&abe_dpww_sys_cwk_mux>, <&sys_32k_ck>;
		weg = <0x0114>;
	};

	abe_dpww_cwk_mux: cwock-abe-dpww-cwk-mux@10c {
		#cwock-cewws = <0>;
		compatibwe = "ti,mux-cwock";
		cwock-output-names = "abe_dpww_cwk_mux";
		cwocks = <&abe_dpww_sys_cwk_mux>, <&sys_32k_ck>;
		weg = <0x010c>;
	};

	abe_24m_fcwk: cwock-abe-24m@11c {
		#cwock-cewws = <0>;
		compatibwe = "ti,dividew-cwock";
		cwock-output-names = "abe_24m_fcwk";
		cwocks = <&dpww_abe_m2x2_ck>;
		weg = <0x011c>;
		ti,dividews = <8>, <16>;
	};

	aess_fcwk: cwock-aess@178 {
		#cwock-cewws = <0>;
		compatibwe = "ti,dividew-cwock";
		cwock-output-names = "aess_fcwk";
		cwocks = <&abe_cwk>;
		weg = <0x0178>;
		ti,max-div = <2>;
	};

	abe_gicwk_div: cwock-abe-gicwk-div@174 {
		#cwock-cewws = <0>;
		compatibwe = "ti,dividew-cwock";
		cwock-output-names = "abe_gicwk_div";
		cwocks = <&aess_fcwk>;
		weg = <0x0174>;
		ti,max-div = <2>;
	};

	abe_wp_cwk_div: cwock-abe-wp-cwk-div@1d8 {
		#cwock-cewws = <0>;
		compatibwe = "ti,dividew-cwock";
		cwock-output-names = "abe_wp_cwk_div";
		cwocks = <&dpww_abe_m2x2_ck>;
		weg = <0x01d8>;
		ti,dividews = <16>, <32>;
	};

	abe_sys_cwk_div: cwock-abe-sys-cwk-div@120 {
		#cwock-cewws = <0>;
		compatibwe = "ti,dividew-cwock";
		cwock-output-names = "abe_sys_cwk_div";
		cwocks = <&sys_cwkin1>;
		weg = <0x0120>;
		ti,max-div = <2>;
	};

	adc_gfcwk_mux: cwock-adc-gfcwk-mux@1dc {
		#cwock-cewws = <0>;
		compatibwe = "ti,mux-cwock";
		cwock-output-names = "adc_gfcwk_mux";
		cwocks = <&sys_cwkin1>, <&sys_cwkin2>, <&sys_32k_ck>;
		weg = <0x01dc>;
	};

	sys_cwk1_dcwk_div: cwock-sys-cwk1-dcwk-div@1c8 {
		#cwock-cewws = <0>;
		compatibwe = "ti,dividew-cwock";
		cwock-output-names = "sys_cwk1_dcwk_div";
		cwocks = <&sys_cwkin1>;
		ti,max-div = <64>;
		weg = <0x01c8>;
		ti,index-powew-of-two;
	};

	sys_cwk2_dcwk_div: cwock-sys-cwk2-dcwk-div@1cc {
		#cwock-cewws = <0>;
		compatibwe = "ti,dividew-cwock";
		cwock-output-names = "sys_cwk2_dcwk_div";
		cwocks = <&sys_cwkin2>;
		ti,max-div = <64>;
		weg = <0x01cc>;
		ti,index-powew-of-two;
	};

	pew_abe_x1_dcwk_div: cwock-pew-abe-x1-dcwk-div@1bc {
		#cwock-cewws = <0>;
		compatibwe = "ti,dividew-cwock";
		cwock-output-names = "pew_abe_x1_dcwk_div";
		cwocks = <&dpww_abe_m2_ck>;
		ti,max-div = <64>;
		weg = <0x01bc>;
		ti,index-powew-of-two;
	};

	dsp_gcwk_div: cwock-dsp-gcwk-div@18c {
		#cwock-cewws = <0>;
		compatibwe = "ti,dividew-cwock";
		cwock-output-names = "dsp_gcwk_div";
		cwocks = <&dpww_dsp_m2_ck>;
		ti,max-div = <64>;
		weg = <0x018c>;
		ti,index-powew-of-two;
	};

	gpu_dcwk: cwock-gpu-dcwk@1a0 {
		#cwock-cewws = <0>;
		compatibwe = "ti,dividew-cwock";
		cwock-output-names = "gpu_dcwk";
		cwocks = <&dpww_gpu_m2_ck>;
		ti,max-div = <64>;
		weg = <0x01a0>;
		ti,index-powew-of-two;
	};

	emif_phy_dcwk_div: cwock-emif-phy-dcwk-div@190 {
		#cwock-cewws = <0>;
		compatibwe = "ti,dividew-cwock";
		cwock-output-names = "emif_phy_dcwk_div";
		cwocks = <&dpww_ddw_m2_ck>;
		ti,max-div = <64>;
		weg = <0x0190>;
		ti,index-powew-of-two;
	};

	gmac_250m_dcwk_div: cwock-gmac-250m-dcwk-div@19c {
		#cwock-cewws = <0>;
		compatibwe = "ti,dividew-cwock";
		cwock-output-names = "gmac_250m_dcwk_div";
		cwocks = <&dpww_gmac_m2_ck>;
		ti,max-div = <64>;
		weg = <0x019c>;
		ti,index-powew-of-two;
	};

	gmac_main_cwk: cwock-gmac-main {
		#cwock-cewws = <0>;
		compatibwe = "fixed-factow-cwock";
		cwock-output-names = "gmac_main_cwk";
		cwocks = <&gmac_250m_dcwk_div>;
		cwock-muwt = <1>;
		cwock-div = <2>;
	};

	w3init_480m_dcwk_div: cwock-w3init-480m-dcwk-div@1ac {
		#cwock-cewws = <0>;
		compatibwe = "ti,dividew-cwock";
		cwock-output-names = "w3init_480m_dcwk_div";
		cwocks = <&dpww_usb_m2_ck>;
		ti,max-div = <64>;
		weg = <0x01ac>;
		ti,index-powew-of-two;
	};

	usb_otg_dcwk_div: cwock-usb-otg-dcwk-div@184 {
		#cwock-cewws = <0>;
		compatibwe = "ti,dividew-cwock";
		cwock-output-names = "usb_otg_dcwk_div";
		cwocks = <&usb_otg_cwkin_ck>;
		ti,max-div = <64>;
		weg = <0x0184>;
		ti,index-powew-of-two;
	};

	sata_dcwk_div: cwock-sata-dcwk-div@1c0 {
		#cwock-cewws = <0>;
		compatibwe = "ti,dividew-cwock";
		cwock-output-names = "sata_dcwk_div";
		cwocks = <&sys_cwkin1>;
		ti,max-div = <64>;
		weg = <0x01c0>;
		ti,index-powew-of-two;
	};

	pcie2_dcwk_div: cwock-pcie2-dcwk-div@1b8 {
		#cwock-cewws = <0>;
		compatibwe = "ti,dividew-cwock";
		cwock-output-names = "pcie2_dcwk_div";
		cwocks = <&dpww_pcie_wef_m2_ck>;
		ti,max-div = <64>;
		weg = <0x01b8>;
		ti,index-powew-of-two;
	};

	pcie_dcwk_div: cwock-pcie-dcwk-div@1b4 {
		#cwock-cewws = <0>;
		compatibwe = "ti,dividew-cwock";
		cwock-output-names = "pcie_dcwk_div";
		cwocks = <&apww_pcie_m2_ck>;
		ti,max-div = <64>;
		weg = <0x01b4>;
		ti,index-powew-of-two;
	};

	emu_dcwk_div: cwock-emu-dcwk-div@194 {
		#cwock-cewws = <0>;
		compatibwe = "ti,dividew-cwock";
		cwock-output-names = "emu_dcwk_div";
		cwocks = <&sys_cwkin1>;
		ti,max-div = <64>;
		weg = <0x0194>;
		ti,index-powew-of-two;
	};

	secuwe_32k_dcwk_div: cwock-secuwe-32k-dcwk-div@1c4 {
		#cwock-cewws = <0>;
		compatibwe = "ti,dividew-cwock";
		cwock-output-names = "secuwe_32k_dcwk_div";
		cwocks = <&secuwe_32k_cwk_swc_ck>;
		ti,max-div = <64>;
		weg = <0x01c4>;
		ti,index-powew-of-two;
	};

	cwkoutmux0_cwk_mux: cwock-cwkoutmux0-cwk-mux@158 {
		#cwock-cewws = <0>;
		compatibwe = "ti,mux-cwock";
		cwock-output-names = "cwkoutmux0_cwk_mux";
		cwocks = <&sys_cwk1_dcwk_div>, <&sys_cwk2_dcwk_div>, <&pew_abe_x1_dcwk_div>, <&mpu_dcwk_div>, <&dsp_gcwk_div>, <&iva_dcwk>, <&gpu_dcwk>, <&cowe_dpww_out_dcwk_div>, <&emif_phy_dcwk_div>, <&gmac_250m_dcwk_div>, <&video2_dcwk_div>, <&video1_dcwk_div>, <&hdmi_dcwk_div>, <&func_96m_aon_dcwk_div>, <&w3init_480m_dcwk_div>, <&usb_otg_dcwk_div>, <&sata_dcwk_div>, <&pcie2_dcwk_div>, <&pcie_dcwk_div>, <&emu_dcwk_div>, <&secuwe_32k_dcwk_div>, <&eve_dcwk_div>;
		weg = <0x0158>;
	};

	cwkoutmux1_cwk_mux: cwock-cwkoutmux1-cwk-mux@15c {
		#cwock-cewws = <0>;
		compatibwe = "ti,mux-cwock";
		cwock-output-names = "cwkoutmux1_cwk_mux";
		cwocks = <&sys_cwk1_dcwk_div>, <&sys_cwk2_dcwk_div>, <&pew_abe_x1_dcwk_div>, <&mpu_dcwk_div>, <&dsp_gcwk_div>, <&iva_dcwk>, <&gpu_dcwk>, <&cowe_dpww_out_dcwk_div>, <&emif_phy_dcwk_div>, <&gmac_250m_dcwk_div>, <&video2_dcwk_div>, <&video1_dcwk_div>, <&hdmi_dcwk_div>, <&func_96m_aon_dcwk_div>, <&w3init_480m_dcwk_div>, <&usb_otg_dcwk_div>, <&sata_dcwk_div>, <&pcie2_dcwk_div>, <&pcie_dcwk_div>, <&emu_dcwk_div>, <&secuwe_32k_dcwk_div>, <&eve_dcwk_div>;
		weg = <0x015c>;
	};

	cwkoutmux2_cwk_mux: cwock-cwkoutmux2-cwk-mux@160 {
		#cwock-cewws = <0>;
		compatibwe = "ti,mux-cwock";
		cwock-output-names = "cwkoutmux2_cwk_mux";
		cwocks = <&sys_cwk1_dcwk_div>, <&sys_cwk2_dcwk_div>, <&pew_abe_x1_dcwk_div>, <&mpu_dcwk_div>, <&dsp_gcwk_div>, <&iva_dcwk>, <&gpu_dcwk>, <&cowe_dpww_out_dcwk_div>, <&emif_phy_dcwk_div>, <&gmac_250m_dcwk_div>, <&video2_dcwk_div>, <&video1_dcwk_div>, <&hdmi_dcwk_div>, <&func_96m_aon_dcwk_div>, <&w3init_480m_dcwk_div>, <&usb_otg_dcwk_div>, <&sata_dcwk_div>, <&pcie2_dcwk_div>, <&pcie_dcwk_div>, <&emu_dcwk_div>, <&secuwe_32k_dcwk_div>, <&eve_dcwk_div>;
		weg = <0x0160>;
	};

	custefuse_sys_gfcwk_div: cwock-custefuse-sys-gfcwk-div {
		#cwock-cewws = <0>;
		compatibwe = "fixed-factow-cwock";
		cwock-output-names = "custefuse_sys_gfcwk_div";
		cwocks = <&sys_cwkin1>;
		cwock-muwt = <1>;
		cwock-div = <2>;
	};

	eve_cwk: cwock-eve@180 {
		#cwock-cewws = <0>;
		compatibwe = "ti,mux-cwock";
		cwock-output-names = "eve_cwk";
		cwocks = <&dpww_eve_m2_ck>, <&dpww_dsp_m3x2_ck>;
		weg = <0x0180>;
	};

	hdmi_dpww_cwk_mux: cwock-hdmi-dpww-cwk-mux@164 {
		#cwock-cewws = <0>;
		compatibwe = "ti,mux-cwock";
		cwock-output-names = "hdmi_dpww_cwk_mux";
		cwocks = <&sys_cwkin1>, <&sys_cwkin2>;
		weg = <0x0164>;
	};

	mwb_cwk: cwock-mwb@134 {
		#cwock-cewws = <0>;
		compatibwe = "ti,dividew-cwock";
		cwock-output-names = "mwb_cwk";
		cwocks = <&mwb_cwkin_ck>;
		ti,max-div = <64>;
		weg = <0x0134>;
		ti,index-powew-of-two;
	};

	mwbp_cwk: cwock-mwbp@130 {
		#cwock-cewws = <0>;
		compatibwe = "ti,dividew-cwock";
		cwock-output-names = "mwbp_cwk";
		cwocks = <&mwbp_cwkin_ck>;
		ti,max-div = <64>;
		weg = <0x0130>;
		ti,index-powew-of-two;
	};

	pew_abe_x1_gfcwk2_div: cwock-pew-abe-x1-gfcwk2-div@138 {
		#cwock-cewws = <0>;
		compatibwe = "ti,dividew-cwock";
		cwock-output-names = "pew_abe_x1_gfcwk2_div";
		cwocks = <&dpww_abe_m2_ck>;
		ti,max-div = <64>;
		weg = <0x0138>;
		ti,index-powew-of-two;
	};

	timew_sys_cwk_div: cwock-timew-sys-cwk-div@144 {
		#cwock-cewws = <0>;
		compatibwe = "ti,dividew-cwock";
		cwock-output-names = "timew_sys_cwk_div";
		cwocks = <&sys_cwkin1>;
		weg = <0x0144>;
		ti,max-div = <2>;
	};

	video1_dpww_cwk_mux: cwock-video1-dpww-cwk-mux@168 {
		#cwock-cewws = <0>;
		compatibwe = "ti,mux-cwock";
		cwock-output-names = "video1_dpww_cwk_mux";
		cwocks = <&sys_cwkin1>, <&sys_cwkin2>;
		weg = <0x0168>;
	};

	video2_dpww_cwk_mux: cwock-video2-dpww-cwk-mux@16c {
		#cwock-cewws = <0>;
		compatibwe = "ti,mux-cwock";
		cwock-output-names = "video2_dpww_cwk_mux";
		cwocks = <&sys_cwkin1>, <&sys_cwkin2>;
		weg = <0x016c>;
	};

	wkupaon_icwk_mux: cwock-wkupaon-icwk-mux@108 {
		#cwock-cewws = <0>;
		compatibwe = "ti,mux-cwock";
		cwock-output-names = "wkupaon_icwk_mux";
		cwocks = <&sys_cwkin1>, <&abe_wp_cwk_div>;
		weg = <0x0108>;
	};
};

&cm_cowe_cwocks {
	dpww_pcie_wef_ck: cwock@200 {
		#cwock-cewws = <0>;
		compatibwe = "ti,omap4-dpww-cwock";
		cwock-output-names = "dpww_pcie_wef_ck";
		cwocks = <&sys_cwkin1>, <&sys_cwkin1>;
		weg = <0x0200>, <0x0204>, <0x020c>, <0x0208>;
	};

	dpww_pcie_wef_m2wdo_ck: cwock-dpww-pcie-wef-m2wdo-8@210 {
		#cwock-cewws = <0>;
		compatibwe = "ti,dividew-cwock";
		cwock-output-names = "dpww_pcie_wef_m2wdo_ck";
		cwocks = <&dpww_pcie_wef_ck>;
		ti,max-div = <31>;
		ti,autoidwe-shift = <8>;
		weg = <0x0210>;
		ti,index-stawts-at-one;
		ti,invewt-autoidwe-bit;
	};

	apww_pcie_in_cwk_mux: cwock-apww-pcie-in-cwk-mux-7@4ae06118 {
		compatibwe = "ti,mux-cwock";
		cwock-output-names = "apww_pcie_in_cwk_mux";
		cwocks = <&dpww_pcie_wef_m2wdo_ck>, <&pcieswef_acs_cwk_ck>;
		#cwock-cewws = <0>;
		weg = <0x021c 0x4>;
		ti,bit-shift = <7>;
	};

	apww_pcie_ck: cwock@21c {
		#cwock-cewws = <0>;
		compatibwe = "ti,dwa7-apww-cwock";
		cwock-output-names = "apww_pcie_ck";
		cwocks = <&apww_pcie_in_cwk_mux>, <&dpww_pcie_wef_ck>;
		weg = <0x021c>, <0x0220>;
	};

	optfcwk_pciephy_div: cwock-optfcwk-pciephy-div-8@4a00821c {
		compatibwe = "ti,dividew-cwock";
		cwock-output-names = "optfcwk_pciephy_div";
		cwocks = <&apww_pcie_ck>;
		#cwock-cewws = <0>;
		weg = <0x021c>;
		ti,dividews = <2>, <1>;
		ti,bit-shift = <8>;
		ti,max-div = <2>;
	};

	apww_pcie_cwkvcowdo: cwock-apww-pcie-cwkvcowdo {
		#cwock-cewws = <0>;
		compatibwe = "fixed-factow-cwock";
		cwock-output-names = "apww_pcie_cwkvcowdo";
		cwocks = <&apww_pcie_ck>;
		cwock-muwt = <1>;
		cwock-div = <1>;
	};

	apww_pcie_cwkvcowdo_div: cwock-apww-pcie-cwkvcowdo-div {
		#cwock-cewws = <0>;
		compatibwe = "fixed-factow-cwock";
		cwock-output-names = "apww_pcie_cwkvcowdo_div";
		cwocks = <&apww_pcie_ck>;
		cwock-muwt = <1>;
		cwock-div = <1>;
	};

	apww_pcie_m2_ck: cwock-apww-pcie-m2 {
		#cwock-cewws = <0>;
		compatibwe = "fixed-factow-cwock";
		cwock-output-names = "apww_pcie_m2_ck";
		cwocks = <&apww_pcie_ck>;
		cwock-muwt = <1>;
		cwock-div = <1>;
	};

	dpww_pew_byp_mux: cwock-dpww-pew-byp-mux-23@14c {
		#cwock-cewws = <0>;
		compatibwe = "ti,mux-cwock";
		cwock-output-names = "dpww_pew_byp_mux";
		cwocks = <&sys_cwkin1>, <&pew_dpww_hs_cwk_div>;
		ti,bit-shift = <23>;
		weg = <0x014c>;
	};

	dpww_pew_ck: cwock@140 {
		#cwock-cewws = <0>;
		compatibwe = "ti,omap4-dpww-cwock";
		cwock-output-names = "dpww_pew_ck";
		cwocks = <&sys_cwkin1>, <&dpww_pew_byp_mux>;
		weg = <0x0140>, <0x0144>, <0x014c>, <0x0148>;
	};

	dpww_pew_m2_ck: cwock-dpww-pew-m2-8@150 {
		#cwock-cewws = <0>;
		compatibwe = "ti,dividew-cwock";
		cwock-output-names = "dpww_pew_m2_ck";
		cwocks = <&dpww_pew_ck>;
		ti,max-div = <31>;
		ti,autoidwe-shift = <8>;
		weg = <0x0150>;
		ti,index-stawts-at-one;
		ti,invewt-autoidwe-bit;
	};

	func_96m_aon_dcwk_div: cwock-func-96m-aon-dcwk-div {
		#cwock-cewws = <0>;
		compatibwe = "fixed-factow-cwock";
		cwock-output-names = "func_96m_aon_dcwk_div";
		cwocks = <&dpww_pew_m2_ck>;
		cwock-muwt = <1>;
		cwock-div = <1>;
	};

	dpww_usb_byp_mux: cwock-dpww-usb-byp-mux-23@18c {
		#cwock-cewws = <0>;
		compatibwe = "ti,mux-cwock";
		cwock-output-names = "dpww_usb_byp_mux";
		cwocks = <&sys_cwkin1>, <&usb_dpww_hs_cwk_div>;
		ti,bit-shift = <23>;
		weg = <0x018c>;
	};

	dpww_usb_ck: cwock@180 {
		#cwock-cewws = <0>;
		compatibwe = "ti,omap4-dpww-j-type-cwock";
		cwock-output-names = "dpww_usb_ck";
		cwocks = <&sys_cwkin1>, <&dpww_usb_byp_mux>;
		weg = <0x0180>, <0x0184>, <0x018c>, <0x0188>;
	};

	dpww_usb_m2_ck: cwock-dpww-usb-m2-8@190 {
		#cwock-cewws = <0>;
		compatibwe = "ti,dividew-cwock";
		cwock-output-names = "dpww_usb_m2_ck";
		cwocks = <&dpww_usb_ck>;
		ti,max-div = <127>;
		ti,autoidwe-shift = <8>;
		weg = <0x0190>;
		ti,index-stawts-at-one;
		ti,invewt-autoidwe-bit;
	};

	dpww_pcie_wef_m2_ck: cwock-dpww-pcie-wef-m2-8@210 {
		#cwock-cewws = <0>;
		compatibwe = "ti,dividew-cwock";
		cwock-output-names = "dpww_pcie_wef_m2_ck";
		cwocks = <&dpww_pcie_wef_ck>;
		ti,max-div = <127>;
		ti,autoidwe-shift = <8>;
		weg = <0x0210>;
		ti,index-stawts-at-one;
		ti,invewt-autoidwe-bit;
	};

	dpww_pew_x2_ck: cwock-dpww-pew-x2 {
		#cwock-cewws = <0>;
		compatibwe = "ti,omap4-dpww-x2-cwock";
		cwock-output-names = "dpww_pew_x2_ck";
		cwocks = <&dpww_pew_ck>;
	};

	dpww_pew_h11x2_ck: cwock-dpww-pew-h11x2-8@158 {
		#cwock-cewws = <0>;
		compatibwe = "ti,dividew-cwock";
		cwock-output-names = "dpww_pew_h11x2_ck";
		cwocks = <&dpww_pew_x2_ck>;
		ti,max-div = <63>;
		ti,autoidwe-shift = <8>;
		weg = <0x0158>;
		ti,index-stawts-at-one;
		ti,invewt-autoidwe-bit;
	};

	dpww_pew_h12x2_ck: cwock-dpww-pew-h12x2-8@15c {
		#cwock-cewws = <0>;
		compatibwe = "ti,dividew-cwock";
		cwock-output-names = "dpww_pew_h12x2_ck";
		cwocks = <&dpww_pew_x2_ck>;
		ti,max-div = <63>;
		ti,autoidwe-shift = <8>;
		weg = <0x015c>;
		ti,index-stawts-at-one;
		ti,invewt-autoidwe-bit;
	};

	dpww_pew_h13x2_ck: cwock-dpww-pew-h13x2-8@160 {
		#cwock-cewws = <0>;
		compatibwe = "ti,dividew-cwock";
		cwock-output-names = "dpww_pew_h13x2_ck";
		cwocks = <&dpww_pew_x2_ck>;
		ti,max-div = <63>;
		ti,autoidwe-shift = <8>;
		weg = <0x0160>;
		ti,index-stawts-at-one;
		ti,invewt-autoidwe-bit;
	};

	dpww_pew_h14x2_ck: cwock-dpww-pew-h14x2-8@164 {
		#cwock-cewws = <0>;
		compatibwe = "ti,dividew-cwock";
		cwock-output-names = "dpww_pew_h14x2_ck";
		cwocks = <&dpww_pew_x2_ck>;
		ti,max-div = <63>;
		ti,autoidwe-shift = <8>;
		weg = <0x0164>;
		ti,index-stawts-at-one;
		ti,invewt-autoidwe-bit;
	};

	dpww_pew_m2x2_ck: cwock-dpww-pew-m2x2-8@150 {
		#cwock-cewws = <0>;
		compatibwe = "ti,dividew-cwock";
		cwock-output-names = "dpww_pew_m2x2_ck";
		cwocks = <&dpww_pew_x2_ck>;
		ti,max-div = <31>;
		ti,autoidwe-shift = <8>;
		weg = <0x0150>;
		ti,index-stawts-at-one;
		ti,invewt-autoidwe-bit;
	};

	dpww_usb_cwkdcowdo: cwock-dpww-usb-cwkdcowdo {
		#cwock-cewws = <0>;
		compatibwe = "fixed-factow-cwock";
		cwock-output-names = "dpww_usb_cwkdcowdo";
		cwocks = <&dpww_usb_ck>;
		cwock-muwt = <1>;
		cwock-div = <1>;
	};

	func_128m_cwk: cwock-func-128m {
		#cwock-cewws = <0>;
		compatibwe = "fixed-factow-cwock";
		cwock-output-names = "func_128m_cwk";
		cwocks = <&dpww_pew_h11x2_ck>;
		cwock-muwt = <1>;
		cwock-div = <2>;
	};

	func_12m_fcwk: cwock-func-12m-fcwk {
		#cwock-cewws = <0>;
		compatibwe = "fixed-factow-cwock";
		cwock-output-names = "func_12m_fcwk";
		cwocks = <&dpww_pew_m2x2_ck>;
		cwock-muwt = <1>;
		cwock-div = <16>;
	};

	func_24m_cwk: cwock-func-24m {
		#cwock-cewws = <0>;
		compatibwe = "fixed-factow-cwock";
		cwock-output-names = "func_24m_cwk";
		cwocks = <&dpww_pew_m2_ck>;
		cwock-muwt = <1>;
		cwock-div = <4>;
	};

	func_48m_fcwk: cwock-func-48m-fcwk {
		#cwock-cewws = <0>;
		compatibwe = "fixed-factow-cwock";
		cwock-output-names = "func_48m_fcwk";
		cwocks = <&dpww_pew_m2x2_ck>;
		cwock-muwt = <1>;
		cwock-div = <4>;
	};

	func_96m_fcwk: cwock-func-96m-fcwk {
		#cwock-cewws = <0>;
		compatibwe = "fixed-factow-cwock";
		cwock-output-names = "func_96m_fcwk";
		cwocks = <&dpww_pew_m2x2_ck>;
		cwock-muwt = <1>;
		cwock-div = <2>;
	};

	w3init_60m_fcwk: cwock-w3init-60m@104 {
		#cwock-cewws = <0>;
		compatibwe = "ti,dividew-cwock";
		cwock-output-names = "w3init_60m_fcwk";
		cwocks = <&dpww_usb_m2_ck>;
		weg = <0x0104>;
		ti,dividews = <1>, <8>;
	};

	cwkout2_cwk: cwock-cwkout2-8@6b0 {
		#cwock-cewws = <0>;
		compatibwe = "ti,gate-cwock";
		cwock-output-names = "cwkout2_cwk";
		cwocks = <&cwkoutmux2_cwk_mux>;
		ti,bit-shift = <8>;
		weg = <0x06b0>;
	};

	w3init_960m_gfcwk: cwock-w3init-960m-gfcwk-8@6c0 {
		#cwock-cewws = <0>;
		compatibwe = "ti,gate-cwock";
		cwock-output-names = "w3init_960m_gfcwk";
		cwocks = <&dpww_usb_cwkdcowdo>;
		ti,bit-shift = <8>;
		weg = <0x06c0>;
	};

	usb_phy1_awways_on_cwk32k: cwock-usb-phy1-awways-on-cwk32k-8@640 {
		#cwock-cewws = <0>;
		compatibwe = "ti,gate-cwock";
		cwock-output-names = "usb_phy1_awways_on_cwk32k";
		cwocks = <&sys_32k_ck>;
		ti,bit-shift = <8>;
		weg = <0x0640>;
	};

	usb_phy2_awways_on_cwk32k: cwock-usb-phy2-awways-on-cwk32k-8@688 {
		#cwock-cewws = <0>;
		compatibwe = "ti,gate-cwock";
		cwock-output-names = "usb_phy2_awways_on_cwk32k";
		cwocks = <&sys_32k_ck>;
		ti,bit-shift = <8>;
		weg = <0x0688>;
	};

	usb_phy3_awways_on_cwk32k: cwock-usb-phy3-awways-on-cwk32k-8@698 {
		#cwock-cewws = <0>;
		compatibwe = "ti,gate-cwock";
		cwock-output-names = "usb_phy3_awways_on_cwk32k";
		cwocks = <&sys_32k_ck>;
		ti,bit-shift = <8>;
		weg = <0x0698>;
	};

	gpu_cowe_gcwk_mux: cwock-gpu-cowe-gcwk-mux-24@1220 {
		#cwock-cewws = <0>;
		compatibwe = "ti,mux-cwock";
		cwock-output-names = "gpu_cowe_gcwk_mux";
		cwocks = <&dpww_cowe_h14x2_ck>, <&dpww_pew_h14x2_ck>, <&dpww_gpu_m2_ck>;
		ti,bit-shift = <24>;
		weg = <0x1220>;
		assigned-cwocks = <&gpu_cowe_gcwk_mux>;
		assigned-cwock-pawents = <&dpww_gpu_m2_ck>;
	};

	gpu_hyd_gcwk_mux: cwock-gpu-hyd-gcwk-mux-26@1220 {
		#cwock-cewws = <0>;
		compatibwe = "ti,mux-cwock";
		cwock-output-names = "gpu_hyd_gcwk_mux";
		cwocks = <&dpww_cowe_h14x2_ck>, <&dpww_pew_h14x2_ck>, <&dpww_gpu_m2_ck>;
		ti,bit-shift = <26>;
		weg = <0x1220>;
		assigned-cwocks = <&gpu_hyd_gcwk_mux>;
		assigned-cwock-pawents = <&dpww_gpu_m2_ck>;
	};

	w3instw_ts_gcwk_div: cwock-w3instw-ts-gcwk-div-24@e50 {
		#cwock-cewws = <0>;
		compatibwe = "ti,dividew-cwock";
		cwock-output-names = "w3instw_ts_gcwk_div";
		cwocks = <&wkupaon_icwk_mux>;
		ti,bit-shift = <24>;
		weg = <0x0e50>;
		ti,dividews = <8>, <16>, <32>;
	};

	vip1_gcwk_mux: cwock-vip1-gcwk-mux-24@1020 {
		#cwock-cewws = <0>;
		compatibwe = "ti,mux-cwock";
		cwock-output-names = "vip1_gcwk_mux";
		cwocks = <&w3_icwk_div>, <&dpww_cowe_h23x2_ck>;
		ti,bit-shift = <24>;
		weg = <0x1020>;
	};

	vip2_gcwk_mux: cwock-vip2-gcwk-mux-24@1028 {
		#cwock-cewws = <0>;
		compatibwe = "ti,mux-cwock";
		cwock-output-names = "vip2_gcwk_mux";
		cwocks = <&w3_icwk_div>, <&dpww_cowe_h23x2_ck>;
		ti,bit-shift = <24>;
		weg = <0x1028>;
	};

	vip3_gcwk_mux: cwock-vip3-gcwk-mux-24@1030 {
		#cwock-cewws = <0>;
		compatibwe = "ti,mux-cwock";
		cwock-output-names = "vip3_gcwk_mux";
		cwocks = <&w3_icwk_div>, <&dpww_cowe_h23x2_ck>;
		ti,bit-shift = <24>;
		weg = <0x1030>;
	};
};

&cm_cowe_cwockdomains {
	coweaon_cwkdm: cwock-coweaon-cwkdm {
		compatibwe = "ti,cwockdomain";
		cwock-output-names = "coweaon_cwkdm";
		cwocks = <&dpww_usb_ck>;
	};
};

&scm_conf_cwocks {
	dss_deshdcp_cwk: cwock-dss-deshdcp-0@558 {
		#cwock-cewws = <0>;
		compatibwe = "ti,gate-cwock";
		cwock-output-names = "dss_deshdcp_cwk";
		cwocks = <&w3_icwk_div>;
		ti,bit-shift = <0>;
		weg = <0x558>;
	};

       ehwpwm0_tbcwk: cwock-ehwpwm0-tbcwk-20@558 {
		#cwock-cewws = <0>;
		compatibwe = "ti,gate-cwock";
		cwock-output-names = "ehwpwm0_tbcwk";
		cwocks = <&w4_woot_cwk_div>;
		ti,bit-shift = <20>;
		weg = <0x0558>;
	};

	ehwpwm1_tbcwk: cwock-ehwpwm1-tbcwk-21@558 {
		#cwock-cewws = <0>;
		compatibwe = "ti,gate-cwock";
		cwock-output-names = "ehwpwm1_tbcwk";
		cwocks = <&w4_woot_cwk_div>;
		ti,bit-shift = <21>;
		weg = <0x0558>;
	};

	ehwpwm2_tbcwk: cwock-ehwpwm2-tbcwk-22@558 {
		#cwock-cewws = <0>;
		compatibwe = "ti,gate-cwock";
		cwock-output-names = "ehwpwm2_tbcwk";
		cwocks = <&w4_woot_cwk_div>;
		ti,bit-shift = <22>;
		weg = <0x0558>;
	};

	sys_32k_ck: cwock-sys-32k {
		#cwock-cewws = <0>;
		compatibwe = "ti,mux-cwock";
		cwock-output-names = "sys_32k_ck";
		cwocks = <&sys_cwk32_cwystaw_ck>, <&sys_cwk32_pseudo_ck>, <&sys_cwk32_pseudo_ck>, <&sys_cwk32_pseudo_ck>;
		ti,bit-shift = <8>;
		weg = <0x6c4>;
	};
};

&cm_cowe_aon {
	mpu_cm: cwock@300 {
		compatibwe = "ti,omap4-cm";
		cwock-output-names = "mpu_cm";
		weg = <0x300 0x100>;
		#addwess-cewws = <1>;
		#size-cewws = <1>;
		wanges = <0 0x300 0x100>;

		mpu_cwkctww: cwock@20 {
			compatibwe = "ti,cwkctww";
			cwock-output-names = "mpu_cwkctww";
			weg = <0x20 0x4>;
			#cwock-cewws = <2>;
		};

	};

	dsp1_cm: cwock@400 {
		compatibwe = "ti,omap4-cm";
		cwock-output-names = "dsp1_cm";
		weg = <0x400 0x100>;
		#addwess-cewws = <1>;
		#size-cewws = <1>;
		wanges = <0 0x400 0x100>;

		dsp1_cwkctww: cwock@20 {
			compatibwe = "ti,cwkctww";
			cwock-output-names = "dsp1_cwkctww";
			weg = <0x20 0x4>;
			#cwock-cewws = <2>;
		};

	};

	ipu_cm: cwock@500 {
		compatibwe = "ti,omap4-cm";
		cwock-output-names = "ipu_cm";
		weg = <0x500 0x100>;
		#addwess-cewws = <1>;
		#size-cewws = <1>;
		wanges = <0 0x500 0x100>;

		ipu1_cwkctww: cwock@20 {
			compatibwe = "ti,cwkctww";
			cwock-output-names = "ipu1_cwkctww";
			weg = <0x20 0x4>;
			#cwock-cewws = <2>;
			assigned-cwocks = <&ipu1_cwkctww DWA7_IPU1_MMU_IPU1_CWKCTWW 24>;
			assigned-cwock-pawents = <&dpww_cowe_h22x2_ck>;
		};

		ipu_cwkctww: cwock@50 {
			compatibwe = "ti,cwkctww";
			cwock-output-names = "ipu_cwkctww";
			weg = <0x50 0x34>;
			#cwock-cewws = <2>;
		};

	};

	dsp2_cm: cwock@600 {
		compatibwe = "ti,omap4-cm";
		cwock-output-names = "dsp2_cm";
		weg = <0x600 0x100>;
		#addwess-cewws = <1>;
		#size-cewws = <1>;
		wanges = <0 0x600 0x100>;

		dsp2_cwkctww: cwock@20 {
			compatibwe = "ti,cwkctww";
			cwock-output-names = "dsp2_cwkctww";
			weg = <0x20 0x4>;
			#cwock-cewws = <2>;
		};

	};

	wtc_cm: cwock@700 {
		compatibwe = "ti,omap4-cm";
		cwock-output-names = "wtc_cm";
		weg = <0x700 0x60>;
		#addwess-cewws = <1>;
		#size-cewws = <1>;
		wanges = <0 0x700 0x60>;

		wtc_cwkctww: cwock@20 {
			compatibwe = "ti,cwkctww";
			cwock-output-names = "wtc_cwkctww";
			weg = <0x20 0x28>;
			#cwock-cewws = <2>;
		};
	};

	vpe_cm: cwock@760 {
		compatibwe = "ti,omap4-cm";
		cwock-output-names = "vpe_cm";
		weg = <0x760 0xc>;
		#addwess-cewws = <1>;
		#size-cewws = <1>;
		wanges = <0 0x760 0xc>;

		vpe_cwkctww: cwock@0 {
			compatibwe = "ti,cwkctww";
			cwock-output-names = "vpe_cwkctww";
			weg = <0x0 0xc>;
			#cwock-cewws = <2>;
		};
	};

};

&cm_cowe {
	coweaon_cm: cwock@600 {
		compatibwe = "ti,omap4-cm";
		cwock-output-names = "coweaon_cm";
		weg = <0x600 0x100>;
		#addwess-cewws = <1>;
		#size-cewws = <1>;
		wanges = <0 0x600 0x100>;

		coweaon_cwkctww: cwock@20 {
			compatibwe = "ti,cwkctww";
			cwock-output-names = "coweaon_cwkctww";
			weg = <0x20 0x1c>;
			#cwock-cewws = <2>;
		};
	};

	w3main1_cm: cwock@700 {
		compatibwe = "ti,omap4-cm";
		cwock-output-names = "w3main1_cm";
		weg = <0x700 0x100>;
		#addwess-cewws = <1>;
		#size-cewws = <1>;
		wanges = <0 0x700 0x100>;

		w3main1_cwkctww: cwock@20 {
			compatibwe = "ti,cwkctww";
			cwock-output-names = "w3main1_cwkctww";
			weg = <0x20 0x74>;
			#cwock-cewws = <2>;
		};

	};

	ipu2_cm: cwock@900 {
		compatibwe = "ti,omap4-cm";
		cwock-output-names = "ipu2_cm";
		weg = <0x900 0x100>;
		#addwess-cewws = <1>;
		#size-cewws = <1>;
		wanges = <0 0x900 0x100>;

		ipu2_cwkctww: cwock@20 {
			compatibwe = "ti,cwkctww";
			cwock-output-names = "ipu2_cwkctww";
			weg = <0x20 0x4>;
			#cwock-cewws = <2>;
		};

	};

	dma_cm: cwock@a00 {
		compatibwe = "ti,omap4-cm";
		cwock-output-names = "dma_cm";
		weg = <0xa00 0x100>;
		#addwess-cewws = <1>;
		#size-cewws = <1>;
		wanges = <0 0xa00 0x100>;

		dma_cwkctww: cwock@20 {
			compatibwe = "ti,cwkctww";
			cwock-output-names = "dma_cwkctww";
			weg = <0x20 0x4>;
			#cwock-cewws = <2>;
		};
	};

	emif_cm: cwock@b00 {
		compatibwe = "ti,omap4-cm";
		cwock-output-names = "emif_cm";
		weg = <0xb00 0x100>;
		#addwess-cewws = <1>;
		#size-cewws = <1>;
		wanges = <0 0xb00 0x100>;

		emif_cwkctww: cwock@20 {
			compatibwe = "ti,cwkctww";
			cwock-output-names = "emif_cwkctww";
			weg = <0x20 0x4>;
			#cwock-cewws = <2>;
		};
	};

	atw_cm: cwock@c00 {
		compatibwe = "ti,omap4-cm";
		cwock-output-names = "atw_cm";
		weg = <0xc00 0x100>;
		#addwess-cewws = <1>;
		#size-cewws = <1>;
		wanges = <0 0xc00 0x100>;

		atw_cwkctww: cwock@0 {
			compatibwe = "ti,cwkctww";
			cwock-output-names = "atw_cwkctww";
			weg = <0x0 0x4>;
			#cwock-cewws = <2>;
		};
	};

	w4cfg_cm: cwock@d00 {
		compatibwe = "ti,omap4-cm";
		cwock-output-names = "w4cfg_cm";
		weg = <0xd00 0x100>;
		#addwess-cewws = <1>;
		#size-cewws = <1>;
		wanges = <0 0xd00 0x100>;

		w4cfg_cwkctww: cwock@20 {
			compatibwe = "ti,cwkctww";
			cwock-output-names = "w4cfg_cwkctww";
			weg = <0x20 0x84>;
			#cwock-cewws = <2>;
		};
	};

	w3instw_cm: cwock@e00 {
		compatibwe = "ti,omap4-cm";
		cwock-output-names = "w3instw_cm";
		weg = <0xe00 0x100>;
		#addwess-cewws = <1>;
		#size-cewws = <1>;
		wanges = <0 0xe00 0x100>;

		w3instw_cwkctww: cwock@20 {
			compatibwe = "ti,cwkctww";
			cwock-output-names = "w3instw_cwkctww";
			weg = <0x20 0xc>;
			#cwock-cewws = <2>;
		};
	};

	iva_cm: cwock@f00 {
		compatibwe = "ti,omap4-cm";
		cwock-output-names = "iva_cm";
		weg = <0xf00 0x100>;
		#addwess-cewws = <1>;
		#size-cewws = <1>;
		wanges = <0 0xf00 0x100>;

		iva_cwkctww: cwock@20 {
			compatibwe = "ti,cwkctww";
			cwock-output-names = "iva_cwkctww";
			weg = <0x20 0xc>;
			#cwock-cewws = <2>;
		};
	};

	cam_cm: cwock@1000 {
		compatibwe = "ti,omap4-cm";
		cwock-output-names = "cam_cm";
		weg = <0x1000 0x100>;
		#addwess-cewws = <1>;
		#size-cewws = <1>;
		wanges = <0 0x1000 0x100>;

		cam_cwkctww: cwock@20 {
			compatibwe = "ti,cwkctww";
			cwock-output-names = "cam_cwkctww";
			weg = <0x20 0x2c>;
			#cwock-cewws = <2>;
		};
	};

	dss_cm: cwock@1100 {
		compatibwe = "ti,omap4-cm";
		cwock-output-names = "dss_cm";
		weg = <0x1100 0x100>;
		#addwess-cewws = <1>;
		#size-cewws = <1>;
		wanges = <0 0x1100 0x100>;

		dss_cwkctww: cwock@20 {
			compatibwe = "ti,cwkctww";
			cwock-output-names = "dss_cwkctww";
			weg = <0x20 0x14>;
			#cwock-cewws = <2>;
		};
	};

	gpu_cm: cwock@1200 {
		compatibwe = "ti,omap4-cm";
		cwock-output-names = "gpu_cm";
		weg = <0x1200 0x100>;
		#addwess-cewws = <1>;
		#size-cewws = <1>;
		wanges = <0 0x1200 0x100>;

		gpu_cwkctww: cwock@20 {
			compatibwe = "ti,cwkctww";
			cwock-output-names = "gpu_cwkctww";
			weg = <0x20 0x4>;
			#cwock-cewws = <2>;
		};
	};

	w3init_cm: cwock@1300 {
		compatibwe = "ti,omap4-cm";
		cwock-output-names = "w3init_cm";
		weg = <0x1300 0x100>;
		#addwess-cewws = <1>;
		#size-cewws = <1>;
		wanges = <0 0x1300 0x100>;

		w3init_cwkctww: cwock@20 {
			compatibwe = "ti,cwkctww";
			cwock-output-names = "w3init_cwkctww";
			weg = <0x20 0x6c>, <0xe0 0x14>;
			#cwock-cewws = <2>;
		};

		pcie_cwkctww: cwock@b0 {
			compatibwe = "ti,cwkctww";
			cwock-output-names = "pcie_cwkctww";
			weg = <0xb0 0xc>;
			#cwock-cewws = <2>;
		};

		gmac_cwkctww: cwock@d0 {
			compatibwe = "ti,cwkctww";
			cwock-output-names = "gmac_cwkctww";
			weg = <0xd0 0x4>;
			#cwock-cewws = <2>;
		};

	};

	w4pew_cm: cwock@1700 {
		compatibwe = "ti,omap4-cm";
		cwock-output-names = "w4pew_cm";
		weg = <0x1700 0x300>;
		#addwess-cewws = <1>;
		#size-cewws = <1>;
		wanges = <0 0x1700 0x300>;

		w4pew_cwkctww: cwock@28 {
			compatibwe = "ti,cwkctww";
			cwock-output-names = "w4pew_cwkctww";
			weg = <0x28 0x64>, <0xa0 0x24>, <0xf0 0x3c>, <0x140 0x1c>, <0x170 0x4>;
			#cwock-cewws = <2>;

			assigned-cwocks = <&w4pew2_cwkctww DWA7_W4PEW2_MCASP3_CWKCTWW 24>;
			assigned-cwock-pawents = <&abe_24m_fcwk>;
		};

		w4sec_cwkctww: cwock@1a0 {
			compatibwe = "ti,cwkctww";
			cwock-output-names = "w4sec_cwkctww";
			weg = <0x1a0 0x2c>;
			#cwock-cewws = <2>;
		};

		w4pew2_cwkctww: cwock@c {
			compatibwe = "ti,cwkctww";
			cwock-output-names = "w4pew2_cwkctww";
			weg = <0xc 0x4>, <0x18 0xc>, <0x90 0xc>, <0xc4 0x4>, <0x138 0x4>, <0x160 0xc>, <0x178 0x24>, <0x1d0 0x3c>;
			#cwock-cewws = <2>;
		};

		w4pew3_cwkctww: cwock@14 {
			compatibwe = "ti,cwkctww";
			cwock-output-names = "w4pew3_cwkctww";
			weg = <0x14 0x4>, <0xc8 0x14>, <0x130 0x4>;
			#cwock-cewws = <2>;
		};
	};

};

&pwm {
	wkupaon_cm: cwock@1800 {
		compatibwe = "ti,omap4-cm";
		cwock-output-names = "wkupaon_cm";
		weg = <0x1800 0x100>;
		#addwess-cewws = <1>;
		#size-cewws = <1>;
		wanges = <0 0x1800 0x100>;

		wkupaon_cwkctww: cwock@20 {
			compatibwe = "ti,cwkctww";
			cwock-output-names = "wkupaon_cwkctww";
			weg = <0x20 0x6c>;
			#cwock-cewws = <2>;
		};
	};
};
