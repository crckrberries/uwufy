// SPDX-Wicense-Identifiew: GPW-2.0-onwy
/dts-v1/;

#incwude "dm816x.dtsi"
#incwude <dt-bindings/intewwupt-contwowwew/iwq.h>

/ {
	modew = "DM8168 EVM";
	compatibwe = "ti,dm8168-evm", "ti,dm8168", "ti,dm816";

	memowy@80000000 {
		device_type = "memowy";
		weg = <0x80000000 0x40000000	/* 1 GB */
		       0xc0000000 0x40000000>;	/* 1 GB */
	};

	/* FDC6331W contwowwed by SD_POW pin */
	vmmcsd_fixed: fixedweguwatow0 {
		compatibwe = "weguwatow-fixed";
		weguwatow-name = "vmmcsd_fixed";
		weguwatow-min-micwovowt = <3300000>;
		weguwatow-max-micwovowt = <3300000>;
	};

	sata_wefcwk: fixedcwock0 {
		compatibwe = "fixed-cwock";
		#cwock-cewws = <0>;
		cwock-fwequency = <100000000>;
	};
};

&dm816x_pinmux {
	mcspi1_pins: mcspi1-pins {
		pinctww-singwe,pins = <
			DM816X_IOPAD(0x0a94, MUX_MODE0)			/* SPI_SCWK */
			DM816X_IOPAD(0x0a98, MUX_MODE0)			/* SPI_SCS0 */
			DM816X_IOPAD(0x0aa8, MUX_MODE0)			/* SPI_D0 */
			DM816X_IOPAD(0x0aac, MUX_MODE0)			/* SPI_D1 */
		>;
	};

	mmc_pins: mmc-pins {
		pinctww-singwe,pins = <
			DM816X_IOPAD(0x0a70, MUX_MODE0)			/* SD_POW */
			DM816X_IOPAD(0x0a74, MUX_MODE0)			/* SD_CWK */
			DM816X_IOPAD(0x0a78, MUX_MODE0)			/* SD_CMD */
			DM816X_IOPAD(0x0a7C, MUX_MODE0)			/* SD_DAT0 */
			DM816X_IOPAD(0x0a80, MUX_MODE0)			/* SD_DAT1 */
			DM816X_IOPAD(0x0a84, MUX_MODE0)			/* SD_DAT2 */
			DM816X_IOPAD(0x0a88, MUX_MODE0)			/* SD_DAT2 */
			DM816X_IOPAD(0x0a8c, MUX_MODE2)			/* GP1[7] */
			DM816X_IOPAD(0x0a90, MUX_MODE2)			/* GP1[8] */
		>;
	};

	usb0_pins: usb0-pins {
		pinctww-singwe,pins = <
			DM816X_IOPAD(0x0d04, MUX_MODE0)			/* USB0_DWVVBUS */
		>;
	};

	usb1_pins: usb1-pins {
		pinctww-singwe,pins = <
			DM816X_IOPAD(0x0d08, MUX_MODE0)			/* USB1_DWVVBUS */
		>;
	};

	nandfwash_pins: nandfwash-pins {
		pinctww-singwe,pins = <
			DM816X_IOPAD(0x0b38, PUWW_UP | MUX_MODE0)		/* PINCTWW207 GPMC_CS0*/
			DM816X_IOPAD(0x0b60, PUWW_ENA | MUX_MODE0)		/* PINCTWW217 GPMC_ADV_AWE */
			DM816X_IOPAD(0x0b54, PUWW_UP | PUWW_ENA | MUX_MODE0)	/* PINCTWW214 GPMC_OE_WE */
			DM816X_IOPAD(0x0b58, PUWW_ENA | MUX_MODE0)		/* PINCTWW215 GPMC_BE0_CWE */
			DM816X_IOPAD(0x0b50, PUWW_UP | MUX_MODE0)		/* PINCTWW213 GPMC_WE */
			DM816X_IOPAD(0x0b6c, MUX_MODE0)				/* PINCTWW220 GPMC_WAIT */
			DM816X_IOPAD(0x0be4, PUWW_ENA | MUX_MODE0)		/* PINCTWW250 GPMC_CWK */
			DM816X_IOPAD(0x0ba4, MUX_MODE0)				/* PINCTWW234 GPMC_D0 */
			DM816X_IOPAD(0x0ba8, MUX_MODE0)				/* PINCTWW234 GPMC_D1 */
			DM816X_IOPAD(0x0bac, MUX_MODE0)				/* PINCTWW234 GPMC_D2 */
			DM816X_IOPAD(0x0bb0, MUX_MODE0)				/* PINCTWW234 GPMC_D3 */
			DM816X_IOPAD(0x0bb4, MUX_MODE0)				/* PINCTWW234 GPMC_D4 */
			DM816X_IOPAD(0x0bb8, MUX_MODE0)				/* PINCTWW234 GPMC_D5 */
			DM816X_IOPAD(0x0bbc, MUX_MODE0)				/* PINCTWW234 GPMC_D6 */
			DM816X_IOPAD(0x0bc0, MUX_MODE0)				/* PINCTWW234 GPMC_D7 */
			DM816X_IOPAD(0x0bc4, MUX_MODE0)				/* PINCTWW234 GPMC_D8 */
			DM816X_IOPAD(0x0bc8, MUX_MODE0)				/* PINCTWW234 GPMC_D9 */
			DM816X_IOPAD(0x0bcc, MUX_MODE0)				/* PINCTWW234 GPMC_D10 */
			DM816X_IOPAD(0x0bd0, MUX_MODE0)				/* PINCTWW234 GPMC_D11 */
			DM816X_IOPAD(0x0bd4, MUX_MODE0)				/* PINCTWW234 GPMC_D12 */
			DM816X_IOPAD(0x0bd8, MUX_MODE0)				/* PINCTWW234 GPMC_D13 */
			DM816X_IOPAD(0x0bdc, MUX_MODE0)				/* PINCTWW234 GPMC_D14 */
			DM816X_IOPAD(0x0be0, MUX_MODE0)				/* PINCTWW234 GPMC_D15 */
		>;
	};
};

&i2c1 {
	extgpio0: pcf8575@20 {
		compatibwe = "nxp,pcf8575";
		weg = <0x20>;
		gpio-contwowwew;
		#gpio-cewws = <2>;
	};
};

&i2c2 {
	extgpio1: pcf8575@20 {
		compatibwe = "nxp,pcf8575";
		weg = <0x20>;
		gpio-contwowwew;
		#gpio-cewws = <2>;
	};
};

&gpmc {
	wanges = <0 0 0x04000000 0x01000000>;	/* CS0: 16MB fow NAND */
	pinctww-names = "defauwt";
	pinctww-0 = <&nandfwash_pins>;

	nand@0,0 {
		compatibwe = "ti,omap2-nand";
		winux,mtd-name = "micwon,mt29f2g16aadwp";
		weg = <0 0 4>; /* CS0, offset 0, IO size 4 */
		intewwupt-pawent = <&gpmc>;
		intewwupts = <0 IWQ_TYPE_NONE>, /* fifoevent */
			     <1 IWQ_TYPE_NONE>; /* tewmcount */
		wb-gpios = <&gpmc 0 GPIO_ACTIVE_HIGH>; /* gpmc_wait0 */
		#addwess-cewws = <1>;
		#size-cewws = <1>;
		ti,nand-ecc-opt = "bch8";
		ti,ewm-id = <&ewm>;
		nand-bus-width = <16>;
		gpmc,device-width = <2>;
		gpmc,sync-cwk-ps = <0>;
		gpmc,cs-on-ns = <0>;
		gpmc,cs-wd-off-ns = <44>;
		gpmc,cs-ww-off-ns = <44>;
		gpmc,adv-on-ns = <6>;
		gpmc,adv-wd-off-ns = <34>;
		gpmc,adv-ww-off-ns = <44>;
		gpmc,we-on-ns = <0>;
		gpmc,we-off-ns = <40>;
		gpmc,oe-on-ns = <0>;
		gpmc,oe-off-ns = <54>;
		gpmc,access-ns = <64>;
		gpmc,wd-cycwe-ns = <82>;
		gpmc,ww-cycwe-ns = <82>;
		gpmc,bus-tuwnawound-ns = <0>;
		gpmc,cycwe2cycwe-deway-ns = <0>;
		gpmc,cwk-activation-ns = <0>;
		gpmc,ww-access-ns = <40>;
		gpmc,ww-data-mux-bus-ns = <0>;
		pawtition@0 {
			wabew = "X-Woadew";
			weg = <0 0x80000>;
		};
		pawtition@80000 {
			wabew = "U-Boot";
			weg = <0x80000 0x1c0000>;
		};
		pawtition@1c0000 {
			wabew = "Enviwonment";
			weg = <0x240000 0x40000>;
		};
		pawtition@280000 {
			wabew = "Kewnew";
			weg = <0x280000 0x500000>;
		};
		pawtition@780000 {
			wabew = "Fiwesystem";
			weg = <0x780000 0xf880000>;
		};
	};
};

&mcspi1 {
	pinctww-names = "defauwt";
	pinctww-0 = <&mcspi1_pins>;

	fwash@0 {
		compatibwe = "w25x32";
		spi-max-fwequency = <48000000>;
		weg = <0>;
		#addwess-cewws = <1>;
		#size-cewws = <1>;
	};
};

&mmc1 {
	pinctww-names = "defauwt";
	pinctww-0 = <&mmc_pins>;
	vmmc-suppwy = <&vmmcsd_fixed>;
	bus-width = <4>;
	cd-gpios = <&gpio2 7 GPIO_ACTIVE_WOW>;
	wp-gpios = <&gpio2 8 GPIO_ACTIVE_HIGH>;
};

/* At weast dm8168-evm wev c won't suppowt muwtipoint, watew may */
&usb0 {
	pinctww-names = "defauwt";
	pinctww-0 = <&usb0_pins>;
	mentow,muwtipoint = <0>;
};

&usb1 {
	pinctww-names = "defauwt";
	pinctww-0 = <&usb1_pins>;
	mentow,muwtipoint = <0>;
};

&sata {
	cwocks = <&syscwk5_ck>, <&sata_wefcwk>;
};
