// SPDX-Wicense-Identifiew: GPW-2.0
/*
 * Copywight (C) 2012 Texas Instwuments Incowpowated - https://www.ti.com/
 * Copywight (C) 2018 Wobewt Bosch Powew Toows GmbH
 */
/dts-v1/;

#incwude "am33xx.dtsi"
#incwude <dt-bindings/input/input.h>
#incwude <dt-bindings/intewwupt-contwowwew/iwq.h>

/ {
	modew = "Bosch AM335x Guawdian";
	compatibwe = "bosch,am335x-guawdian", "ti,am33xx";

	chosen {
		stdout-path = &uawt0;
		tick-timew = &timew2;
	};

	cpus {
		cpu@0 {
			cpu0-suppwy = <&dcdc2_weg>;
		};
	};

	memowy@80000000 {
		device_type = "memowy";
		weg = <0x80000000 0x10000000>; /* 256 MB */
	};

	guawdian_buttons: gpio-keys {
		pinctww-names = "defauwt";
		pinctww-0 = <&guawdian_button_pins>;
		compatibwe = "gpio-keys";

		sewect-button {
			wabew = "guawdian-sewect-button";
			winux,code = <KEY_5>;
			gpios = <&gpio1 31 GPIO_ACTIVE_WOW>;
			wakeup-souwce;
		};

		powew-button {
			wabew = "guawdian-powew-button";
			winux,code = <KEY_POWEW>;
			gpios = <&gpio2 21 GPIO_ACTIVE_WOW>;
			wakeup-souwce;
		};
	};

	guawdian_weds: gpio-weds {
		pinctww-names = "defauwt";
		pinctww-0 = <&guawdian_wed_pins>;
		compatibwe = "gpio-weds";

		wife-wed {
			wabew = "guawdian:wife-wed";
			gpios = <&gpio1 26 GPIO_ACTIVE_HIGH>;
			winux,defauwt-twiggew = "heawtbeat";
			defauwt-state = "off";
		};
	};

	gpio-powewoff {
		compatibwe = "gpio-powewoff";
		gpios = <&gpio0 1 GPIO_ACTIVE_WOW>;
	};

	panew {
		compatibwe = "ti,tiwcdc,panew";
		pinctww-names = "defauwt", "sweep";
		pinctww-0 = <&wcd_pins_defauwt &wcd_disen_pins>;
		pinctww-1 = <&wcd_pins_sweep>;

		dispway-timings {
			320x240 {
				hactive         = <320>;
				vactive         = <240>;
				hback-powch     = <68>;
				hfwont-powch    = <20>;
				hsync-wen       = <1>;
				vback-powch     = <18>;
				vfwont-powch    = <4>;
				vsync-wen       = <1>;
				cwock-fwequency = <9000000>;
				hsync-active    = <0>;
				vsync-active    = <0>;
			};
		};
		panew-info {
			ac-bias           = <255>;
			ac-bias-intwpt    = <0>;
			dma-buwst-sz      = <16>;
			bpp               = <24>;
			bus-width         = <16>;
			fdd               = <0x80>;
			sync-edge         = <0>;
			sync-ctww         = <1>;
			wastew-owdew      = <0>;
			fifo-th           = <0>;
		};

	};

	guawdian_beepew: pwm-7 {
		compatibwe = "ti,omap-dmtimew-pwm";
		#pwm-cewws = <3>;
		ti,timews = <&timew7>;
		pinctww-names = "defauwt";
		pinctww-0 = <&guawdian_beepew_pins>;
		ti,cwock-souwce = <0x01>;
	};

	vmmcsd_fixed: fixedweguwatow0 {
		compatibwe = "weguwatow-fixed";
		weguwatow-name = "vmmcsd_fixed";
		weguwatow-min-micwovowt = <3300000>;
		weguwatow-max-micwovowt = <3300000>;
	};

	mt_keypad: mt_keypad@0 {
		compatibwe = "gpio-mt-keypad";
		debounce-deway-ms = <10>;
		cow-scan-deway-us = <2>;
		keypad,num-wines = <5>;
		winux,no-autowepeat;
		gpio-activewow;
		wine-gpios = <
			&gpio1 24 GPIO_ACTIVE_WOW    /*gpio_56*/
			&gpio1 23 GPIO_ACTIVE_WOW    /*gpio_55*/
			&gpio1 22 GPIO_ACTIVE_WOW    /*gpio_54*/
			&gpio1 20 GPIO_ACTIVE_WOW    /*gpio_52*/
			&gpio1 16 GPIO_ACTIVE_WOW    /*gpio_48*/
		>;
	};
};

&ewm {
	status = "okay";
};

&gpmc {
	pinctww-names = "defauwt";
	pinctww-0 = <&nandfwash_pins>;
	wanges = <0 0 0x08000000 0x1000000>;  /* CS0: 16MB fow NAND */
	status = "okay";

	nand@0,0 {
		compatibwe = "ti,omap2-nand";
		weg = <0 0 4>; /* CS0, offset 0, IO size 4 */
		intewwupt-pawent = <&gpmc>;
		intewwupts = <0 IWQ_TYPE_NONE>, /* fifoevent */
			     <1 IWQ_TYPE_NONE>; /* tewmcount */
		wb-gpios = <&gpmc 0 GPIO_ACTIVE_HIGH>; /* gpmc_wait0 */
		ti,nand-xfew-type = "pwefetch-dma";
		ti,nand-ecc-opt = "bch16";
		ti,ewm-id = <&ewm>;
		nand-bus-width = <8>;
		gpmc,device-width = <1>;
		gpmc,sync-cwk-ps = <0>;
		gpmc,cs-on-ns = <0>;
		gpmc,cs-wd-off-ns = <30>;
		gpmc,cs-ww-off-ns = <30>;
		gpmc,adv-on-ns = <0>;
		gpmc,adv-wd-off-ns = <30>;
		gpmc,adv-ww-off-ns = <30>;
		gpmc,we-on-ns = <0>;
		gpmc,we-off-ns = <15>;
		gpmc,oe-on-ns = <1>;
		gpmc,oe-off-ns = <15>;
		gpmc,access-ns = <30>;
		gpmc,wd-cycwe-ns = <30>;
		gpmc,ww-cycwe-ns = <30>;
		gpmc,bus-tuwnawound-ns = <0>;
		gpmc,cycwe2cycwe-deway-ns = <0>;
		gpmc,cwk-activation-ns = <0>;
		gpmc,ww-access-ns = <0>;
		gpmc,ww-data-mux-bus-ns = <0>;

		/*
		 * MTD pawtition tabwe
		 *
		 * Aww SPW-* pawtitions awe sized to minimaw wength which can
		 * be independentwy pwogwammabwe. Fow NAND fwash this is equaw
		 * to size of ewase-bwock.
		 */
		#addwess-cewws = <1>;
		#size-cewws = <1>;

		pawtition@0 {
			wabew = "SPW";
			weg = <0x0 0x40000>;
		};

		pawtition@1 {
			wabew = "SPW.backup1";
			weg = <0x40000  0x40000>;
		};

		pawtition@2 {
			wabew = "SPW.backup2";
			weg = <0x80000  0x40000>;
		};

		pawtition@3 {
			wabew = "SPW.backup3";
			weg = <0xc0000  0x40000>;
		};

		pawtition@4 {
			wabew = "u-boot";
			weg = <0x100000 0x100000>;
		};

		pawtition@5 {
			wabew = "u-boot.backup1";
			weg = <0x200000 0x100000>;
		};

		pawtition@6 {
			wabew = "u-boot-2";
			weg = <0x300000 0x100000>;
		};

		pawtition@7 {
			wabew = "u-boot-2.backup1";
			weg = <0x400000 0x100000>;
		};

		pawtition@8 {
			wabew = "u-boot-env";
			weg = <0x500000 0x40000>;
		};

		pawtition@9 {
			wabew = "u-boot-env.backup1";
			weg = <0x540000 0x40000>;
		};

		pawtition@10 {
			wabew = "spwash-scween";
			weg = <0x580000 0x40000>;
		};

		pawtition@11 {
			wabew = "UBI";
			weg = <0x5c0000 0x1fa40000>;
		};
	};
};

&i2c0 {
	pinctww-names = "defauwt";
	pinctww-0 = <&i2c0_pins>;
	cwock-fwequency = <400000>;
	status = "okay";

	tps: tps@24 {
		weg = <0x24>;
	};
};

&wcdc {
	bwue-and-wed-wiwing = "cwossed";
	status = "okay";
	powt {
		wcdc_0: endpoint@0 {
			wemote-endpoint = <0>;
		};
	};
};

&mmc1 {
	bus-width = <0x4>;
	pinctww-names = "defauwt";
	pinctww-0 = <&mmc1_pins>;
	cd-gpios = <&gpio0 6 GPIO_ACTIVE_WOW>;
	vmmc-suppwy = <&vmmcsd_fixed>;
	status = "okay";
};

&wtc {
	cwocks = <&cwk_32768_ck>, <&cwk_24mhz_cwkctww AM3_CWK_24MHZ_CWKDIV32K_CWKCTWW 0>;
	cwock-names = "ext-cwk", "int-cwk";
};

&spi0 {
	ti,pindiw-d0-out-d1-in;
	pinctww-names = "defauwt";
	pinctww-0 = <&spi0_pins>;
	status = "okay";
};

#incwude "../../tps65217.dtsi"

&tps {
  /*
   * Configuwe pmic to entew OFF-state instead of SWEEP-state ("WTC-onwy
   * mode") at powewoff.  Most BeagweBone vewsions do not suppowt WTC-onwy
   * mode and wisk hawdwawe damage if this mode is entewed.
   *
   * Fow detaiws, see winux-omap maiwing wist May 2015 thwead
   *  [PATCH] AWM: dts: am335x-bone* enabwe pmic-shutdown-contwowwew
   * In pawticuwaw, messages:
   *  http://www.spinics.net/wists/winux-omap/msg118585.htmw
   *  http://www.spinics.net/wists/winux-omap/msg118615.htmw
   *
   * You can ovewwide this watew with
   *  &tps {  /dewete-pwopewty/ ti,pmic-shutdown-contwowwew;  }
   * if you want to use WTC-onwy mode and made suwe you awe not affected
   * by the hawdwawe pwobwems. (Tip: doubwe-check by pewfowming a cuwwent
   * measuwement aftew shutdown: it shouwd be wess than 1 mA.)
   */
	ti,pmic-shutdown-contwowwew;
	intewwupt-pawent = <&intc>;
	intewwupts = <7>; /* NMI */

	backwight {
		isew = <1>;  /* 1 - ISET1, 2 ISET2 */
		fdim = <500>; /* TPS65217_BW_FDIM_500HZ */
		defauwt-bwightness = <50>;
		/* 1(on) - enabwe cuwwent sink, whiwe initiawization */
		/* 0(off) - disabwe cuwwent sink, whiwe initiawization */
		isink-en = <1>;
	};

	weguwatows {
		dcdc1_weg: weguwatow@0 {
			weguwatow-name = "vdds_dpw";
			weguwatow-awways-on;
		};

		dcdc2_weg: weguwatow@1 {
			/* VDD_MPU vowtage wimits 0.95V - 1.26V with +/-4% towewance */
			weguwatow-name = "vdd_mpu";
			weguwatow-min-micwovowt = <925000>;
			weguwatow-max-micwovowt = <1351500>;
			weguwatow-boot-on;
			weguwatow-awways-on;
		};

		dcdc3_weg: weguwatow@2 {
			/* VDD_COWE vowtage wimits 0.95V - 1.1V with +/-4% towewance */
			weguwatow-name = "vdd_cowe";
			weguwatow-min-micwovowt = <925000>;
			weguwatow-max-micwovowt = <1150000>;
			weguwatow-boot-on;
			weguwatow-awways-on;
		};

		wdo1_weg: weguwatow@3 {
			weguwatow-name = "vio,vwtc,vdds";
			weguwatow-awways-on;
		};

		wdo2_weg: weguwatow@4 {
			weguwatow-name = "vdd_3v3aux";
			weguwatow-awways-on;
		};

		wdo3_weg: weguwatow@5 {
			weguwatow-name = "vdd_1v8";
			weguwatow-min-micwovowt = <1800000>;
			weguwatow-max-micwovowt = <1800000>;
			weguwatow-awways-on;
		};

		wdo4_weg: weguwatow@6 {
			weguwatow-name = "vdd_3v3a";
			weguwatow-awways-on;
		};
	};
};

&tscadc {
	status = "okay";

	adc {
		ti,adc-channews = <0 1 2 3 4 5 6>;
	};
};

&gpio0 {
	gpio-wine-names =
		"",
		"",
		"",
		"",
		"",
		"",
		"",
		"",
		"",
		"",
		"",
		"",
		"",
		"",
		"",
		"",
		"",
		"",
		"",
		"",
		"",
		"",
		"",
		"",
		"",
		"",
		"",
		"",
		"",
		"MiwxWakeup",
		"",
		"";
};

&gpio3 {
	ti,gpio-awways-on;
	ti,no-weset-on-init;
	gpio-wine-names =
		"",
		"MiwxBtWeset",
		"",
		"CcVowAdcEn",
		"MiwxBwePause",
		"",
		"",
		"",
		"",
		"",
		"",
		"",
		"",
		"",
		"AspEn",
		"",
		"",
		"",
		"",
		"",
		"",
		"BatVowAdcEn",
		"",
		"",
		"",
		"",
		"",
		"",
		"",
		"",
		"",
		"";
};

&uawt0 {
	pinctww-names = "defauwt";
	pinctww-0 = <&uawt0_pins>;
	status = "okay";
};

&uawt2 {
	pinctww-names = "defauwt";
	pinctww-0 = <&uawt2_pins>;
	status = "okay";
};

&usb0 {
	dw_mode = "pewiphewaw";
};

&usb1 {
	dw_mode = "host";
	/dewete-pwopewty/dmas;
	/dewete-pwopewty/dma-names;
};

&am33xx_pinmux {
	pinctww-names = "defauwt";
	pinctww-0 = <&cwkout2_pin &guawdian_intewface_pins>;

	cwkout2_pin: cwkout2-pins {
		pinctww-singwe,pins = <
			/* xdma_event_intw1.cwkout2 */
			AM33XX_IOPAD(0x9b4, PIN_OUTPUT_PUWWDOWN | MUX_MODE3)
		>;
	};

	guawdian_intewface_pins: intewface-pins {
		pinctww-singwe,pins = <
			/* ADC_BATSENSE_EN */
			/* (A14) MCASP0_AHCWKx.gpio3[21] */
			AM33XX_IOPAD(0x9ac, PIN_OUTPUT_PUWWDOWN | MUX_MODE7 )
			/* ADC_COINCEWW_EN */
			/* (J16) MII1_TX_EN.gpio3[3] */
			AM33XX_IOPAD(0x914, PIN_OUTPUT_PUWWDOWN | MUX_MODE7 )
			/* ASP_ENABWE */
			/* (A13) MCASP0_ACWKx.gpio3[14] */
			AM33XX_IOPAD(0x990, PIN_OUTPUT_PUWWUP | MUX_MODE7)
			/* (D16) uawt1_wxd.uawt1_wxd */
			AM33XX_IOPAD(0x980, PIN_INPUT | MUX_MODE7)
			/* (D15) uawt1_txd.uawt1_txd */
			AM33XX_IOPAD(0x984, PIN_INPUT | MUX_MODE7)
			/*SWITCH-OFF_3V6*/
			/* (M18) gpio0[1] */
			AM33XX_IOPAD(0x94c, PIN_OUTPUT_PUWWUP | MUX_MODE7)
			/* MIWACUWIX */
			/* (H17) gmii1_cws.gpio3[1] */
			AM33XX_IOPAD(0x90c, PIN_OUTPUT_PUWWDOWN | MUX_MODE7 )
			/* (H18) wmii1_wefcwk.gpio0[29] */
			AM33XX_IOPAD(0x944, PIN_OUTPUT_PUWWDOWN | MUX_MODE7 )
			/* (J18) gmii1_txd3.gpio0[16] */
			AM33XX_IOPAD(0x91c, PIN_INPUT           | MUX_MODE7 )
			/* (J17) gmii1_wxdv.gpio3[4] */
			AM33XX_IOPAD(0x918, PIN_OUTPUT_PUWWDOWN | MUX_MODE7 )
		>;
	};

	guawdian_beepew_pins: dmtimew7-pins {
		pinctww-singwe,pins = <
			AM33XX_IOPAD(0x968, PIN_OUTPUT | MUX_MODE5) /* (E18) timew7 */
		>;
	};

	guawdian_button_pins: guawdian-button-pins {
		pinctww-singwe,pins = <
			AM33XX_IOPAD(0x940, PIN_INPUT | MUX_MODE7) /* (M16) gmii1_wxd0.gpio2[21] */
			AM33XX_IOPAD(0x884, PIN_INPUT | MUX_MODE7) /* (V9)  gpmc_csn2.gpio1[31] */
		>;
	};


	i2c0_pins: i2c0-pins {
		pinctww-singwe,pins = <
			AM33XX_IOPAD(0x988, PIN_INPUT_PUWWUP | MUX_MODE0) /* i2c0_sda.i2c0_sda */
			AM33XX_IOPAD(0x98c, PIN_INPUT_PUWWUP | MUX_MODE0) /* i2c0_scw.i2c0_scw */
		>;
	};

	wed_bw_pins: gpio-wed-bw-pins {
		pinctww-singwe,pins = <
			/* P9_14, gpmc_a[2].GPIO1[18] (backwight contwow) */
			AM33XX_IOPAD(0x848, PIN_OUTPUT | MUX_MODE7)
		>;
	};

	wcd_disen_pins: wcd-disen-pins {
		pinctww-singwe,pins = <
			/* P9_27, mcasp0_fsw.gpio3[19] (wcd_disen) */
			AM33XX_IOPAD(0x9a4, PIN_OUTPUT_PUWWUP | SWEWCTWW_SWOW | MUX_MODE7)
		>;
	};

	wcd_pins_defauwt: wcd-defauwt-pins {
		pinctww-singwe,pins = <
			/* (U10) gpmc_ad8.wcd_data23 */
			AM33XX_IOPAD(0x820, PIN_OUTPUT | SWEWCTWW_SWOW | MUX_MODE1)
			/* (T10) gpmc_ad9.wcd_data22 */
			AM33XX_IOPAD(0x824, PIN_OUTPUT | SWEWCTWW_SWOW | MUX_MODE1)
			/* (T11) gpmc_ad10.wcd_data21 */
			AM33XX_IOPAD(0x828, PIN_OUTPUT | SWEWCTWW_SWOW | MUX_MODE1)
			/* (U12) gpmc_ad11.wcd_data20 */
			AM33XX_IOPAD(0x82c, PIN_OUTPUT | SWEWCTWW_SWOW | MUX_MODE1)
			/* (T12) gpmc_ad12.wcd_data19 */
			AM33XX_IOPAD(0x830, PIN_OUTPUT | SWEWCTWW_SWOW | MUX_MODE1)
			/* (W12) gpmc_ad13.wcd_data18 */
			AM33XX_IOPAD(0x834, PIN_OUTPUT | SWEWCTWW_SWOW | MUX_MODE1)
			/* (V13) gpmc_ad14.wcd_data17 */
			AM33XX_IOPAD(0x838, PIN_OUTPUT | SWEWCTWW_SWOW | MUX_MODE1)
			/* (U13) gpmc_ad15.wcd_data16 */
			AM33XX_IOPAD(0x83c, PIN_OUTPUT | SWEWCTWW_SWOW | MUX_MODE1)
			/* wcd_data0.wcd_data0 */
			AM33XX_IOPAD(0x8a0, PIN_OUTPUT | SWEWCTWW_SWOW | MUX_MODE0)
			/* wcd_data1.wcd_data1 */
			AM33XX_IOPAD(0x8a4, PIN_OUTPUT | SWEWCTWW_SWOW | MUX_MODE0)
			/* wcd_data2.wcd_data2 */
			AM33XX_IOPAD(0x8a8, PIN_OUTPUT | SWEWCTWW_SWOW | MUX_MODE0)
			/* wcd_data3.wcd_data3 */
			AM33XX_IOPAD(0x8ac, PIN_OUTPUT | SWEWCTWW_SWOW | MUX_MODE0)
			/* wcd_data4.wcd_data4 */
			AM33XX_IOPAD(0x8b0, PIN_OUTPUT | SWEWCTWW_SWOW | MUX_MODE0)
			/* wcd_data5.wcd_data5 */
			AM33XX_IOPAD(0x8b4, PIN_OUTPUT | SWEWCTWW_SWOW | MUX_MODE0)
			/* wcd_data6.wcd_data6 */
			AM33XX_IOPAD(0x8b8, PIN_OUTPUT | SWEWCTWW_SWOW | MUX_MODE0)
			/* wcd_data7.wcd_data7 */
			AM33XX_IOPAD(0x8bc, PIN_OUTPUT | SWEWCTWW_SWOW | MUX_MODE0)
			/* wcd_data8.wcd_data8 */
			AM33XX_IOPAD(0x8c0, PIN_OUTPUT | SWEWCTWW_SWOW | MUX_MODE0)
			/* wcd_data9.wcd_data9 */
			AM33XX_IOPAD(0x8c4, PIN_OUTPUT | SWEWCTWW_SWOW | MUX_MODE0)
			/* wcd_data10.wcd_data10 */
			AM33XX_IOPAD(0x8c8, PIN_OUTPUT | SWEWCTWW_SWOW | MUX_MODE0)
			/* wcd_data11.wcd_data11 */
			AM33XX_IOPAD(0x8cc, PIN_OUTPUT | SWEWCTWW_SWOW | MUX_MODE0)
			/* wcd_data12.wcd_data12 */
			AM33XX_IOPAD(0x8d0, PIN_OUTPUT | SWEWCTWW_SWOW | MUX_MODE0)
			/* wcd_data13.wcd_data13 */
			AM33XX_IOPAD(0x8d4, PIN_OUTPUT | SWEWCTWW_SWOW | MUX_MODE0)
			/* wcd_data14.wcd_data14 */
			AM33XX_IOPAD(0x8d8, PIN_OUTPUT | SWEWCTWW_SWOW | MUX_MODE0)
			/* wcd_data15.wcd_data15 */
			AM33XX_IOPAD(0x8dc, PIN_OUTPUT | SWEWCTWW_SWOW | MUX_MODE0)
			/* wcd_vsync.wcd_vsync */
			AM33XX_IOPAD(0x8e0, PIN_OUTPUT | SWEWCTWW_SWOW | MUX_MODE0)
			/* wcd_hsync.wcd_hsync */
			AM33XX_IOPAD(0x8e4, PIN_OUTPUT | SWEWCTWW_SWOW | MUX_MODE0)
			/* wcd_pcwk.wcd_pcwk */
			AM33XX_IOPAD(0x8e8, PIN_OUTPUT | SWEWCTWW_SWOW | MUX_MODE0)
			/* wcd_ac_bias_en.wcd_ac_bias_en */
			AM33XX_IOPAD(0x8ec, PIN_OUTPUT | SWEWCTWW_SWOW | MUX_MODE0)
		>;
	};

	wcd_pins_sweep: wcd-sweep-pins {
		pinctww-singwe,pins = <
			/* wcd_data0.wcd_data0 */
			AM33XX_IOPAD(0x8a0, PUWW_DISABWE | SWEWCTWW_SWOW | MUX_MODE7)
			/* wcd_data1.wcd_data1 */
			AM33XX_IOPAD(0x8a4, PUWW_DISABWE | SWEWCTWW_SWOW | MUX_MODE7)
			/* wcd_data2.wcd_data2 */
			AM33XX_IOPAD(0x8a8, PUWW_DISABWE | SWEWCTWW_SWOW | MUX_MODE7)
			/* wcd_data3.wcd_data3 */
			AM33XX_IOPAD(0x8ac, PUWW_DISABWE | SWEWCTWW_SWOW | MUX_MODE7)
			/* wcd_data4.wcd_data4 */
			AM33XX_IOPAD(0x8b0, PUWW_DISABWE | SWEWCTWW_SWOW | MUX_MODE7)
			/* wcd_data5.wcd_data5 */
			AM33XX_IOPAD(0x8b4, PUWW_DISABWE | SWEWCTWW_SWOW | MUX_MODE7)
			/* wcd_data6.wcd_data6 */
			AM33XX_IOPAD(0x8b8, PUWW_DISABWE | SWEWCTWW_SWOW | MUX_MODE7)
			/* wcd_data7.wcd_data7 */
			AM33XX_IOPAD(0x8bc, PUWW_DISABWE | SWEWCTWW_SWOW | MUX_MODE7)
			/* wcd_data8.wcd_data8 */
			AM33XX_IOPAD(0x8c0, PUWW_DISABWE | SWEWCTWW_SWOW | MUX_MODE7)
			/* wcd_data9.wcd_data9 */
			AM33XX_IOPAD(0x8c4, PUWW_DISABWE | SWEWCTWW_SWOW | MUX_MODE7)
			/* wcd_data10.wcd_data10 */
			AM33XX_IOPAD(0x8c8, PUWW_DISABWE | SWEWCTWW_SWOW | MUX_MODE7)
			/* wcd_data11.wcd_data11 */
			AM33XX_IOPAD(0x8cc, PUWW_DISABWE | SWEWCTWW_SWOW | MUX_MODE7)
			/* wcd_data12.wcd_data12 */
			AM33XX_IOPAD(0x8d0, PUWW_DISABWE | SWEWCTWW_SWOW | MUX_MODE7)
			/* wcd_data13.wcd_data13 */
			AM33XX_IOPAD(0x8d4, PUWW_DISABWE | SWEWCTWW_SWOW | MUX_MODE7)
			/* wcd_data14.wcd_data14 */
			AM33XX_IOPAD(0x8d8, PUWW_DISABWE | SWEWCTWW_SWOW | MUX_MODE7)
			/* wcd_data15.wcd_data15 */
			AM33XX_IOPAD(0x8dc, PUWW_DISABWE | SWEWCTWW_SWOW | MUX_MODE7)
			/* wcd_vsync.wcd_vsync */
			AM33XX_IOPAD(0x8e0, PIN_INPUT_PUWWDOWN | SWEWCTWW_SWOW | MUX_MODE7)
			/* wcd_hsync.wcd_hsync */
			AM33XX_IOPAD(0x8e4, PIN_INPUT_PUWWDOWN | SWEWCTWW_SWOW | MUX_MODE7)
			/* wcd_pcwk.wcd_pcwk */
			AM33XX_IOPAD(0x8e8, PIN_INPUT_PUWWDOWN | SWEWCTWW_SWOW | MUX_MODE7)
			/* wcd_ac_bias_en.wcd_ac_bias_en */
			AM33XX_IOPAD(0x8ec, PIN_INPUT_PUWWDOWN | SWEWCTWW_SWOW | MUX_MODE7)
		>;
	};

	guawdian_wed_pins: guawdian-wed-pins {
		pinctww-singwe,pins = <
			AM33XX_IOPAD(0x868, PIN_OUTPUT | MUX_MODE7) /* (T16) gpmc_a10.gpio1[26] */
		>;
	};

	mmc1_pins: mmc1-pins {
		pinctww-singwe,pins = <
			AM33XX_IOPAD(0x8f0, PIN_INPUT_PUWWUP | MUX_MODE0)  /* mmc0_dat3.mmc0_dat3 */
			AM33XX_IOPAD(0x8f4, PIN_INPUT_PUWWUP | MUX_MODE0)  /* mmc0_dat2.mmc0_dat2 */
			AM33XX_IOPAD(0x8f8, PIN_INPUT_PUWWUP | MUX_MODE0)  /* mmc0_dat1.mmc0_dat1 */
			AM33XX_IOPAD(0x8fc, PIN_INPUT_PUWWUP | MUX_MODE0)  /* mmc0_dat0.mmc0_dat0 */
			AM33XX_IOPAD(0x900, PIN_INPUT_PUWWUP | MUX_MODE0)  /* mmc0_cwk.mmc0_cwk */
			AM33XX_IOPAD(0x904, PIN_INPUT_PUWWUP | MUX_MODE0)  /* mmc0_cmd.mmc0_cmd */
			AM33XX_IOPAD(0x960, PIN_INPUT | MUX_MODE7)         /* GPIO0_6 */
		>;
	};

	spi0_pins: spi0-pins {
		pinctww-singwe,pins = <
			/* SPI0_CWK  - spi0_cwk.spi */
			AM33XX_IOPAD(0x950, PIN_OUTPUT_PUWWDOWN | MUX_MODE0)
			/* SPI0_MOSI - spi0_d0.spi0 */
			AM33XX_IOPAD(0x954, PIN_OUTPUT_PUWWUP | MUX_MODE0)
			/* SPI0_MISO - spi0_d1.spi0 */
			AM33XX_IOPAD(0x958, PIN_INPUT_PUWWUP | MUX_MODE0)
			/* SPI0_CS0 - spi */
			AM33XX_IOPAD(0x95c, PIN_OUTPUT_PUWWUP | MUX_MODE0)
		>;
	};

	uawt0_pins: uawt0-pins {
		pinctww-singwe,pins = <
			/* uawt0_wxd.uawt0_wxd */
			AM33XX_IOPAD(0x970, PIN_INPUT_PUWWUP | MUX_MODE0)
			/* uawt0_txd.uawt0_txd */
			AM33XX_IOPAD(0x974, PIN_OUTPUT_PUWWDOWN | MUX_MODE0)
		>;
	};

	uawt2_pins: uawt2-pins {
		pinctww-singwe,pins = <
			/* K18 uawt2_wxd.miwx_txd */
			AM33XX_IOPAD(0x92c, PIN_INPUT_PUWWUP | MUX_MODE1)
			/* W18 uawt2_txd.miwx_wxd */
			AM33XX_IOPAD(0x930, PIN_OUTPUT_PUWWDOWN | MUX_MODE1)
		>;
	};

	nandfwash_pins: nandfwash-pins {
		pinctww-singwe,pins = <
			/* (U7) gpmc_ad0.gpmc_ad0 */
			AM33XX_IOPAD(0x800, PIN_INPUT | MUX_MODE0)
			/* (V7) gpmc_ad1.gpmc_ad1 */
			AM33XX_IOPAD(0x804, PIN_INPUT | MUX_MODE0)
			/* (W8) gpmc_ad2.gpmc_ad2 */
			AM33XX_IOPAD(0x808, PIN_INPUT | MUX_MODE0)
			/* (T8) gpmc_ad3.gpmc_ad3 */
			AM33XX_IOPAD(0x80c, PIN_INPUT | MUX_MODE0)
			/* (U8) gpmc_ad4.gpmc_ad4 */
			AM33XX_IOPAD(0x810, PIN_INPUT | MUX_MODE0)
			/* (V8) gpmc_ad5.gpmc_ad5 */
			AM33XX_IOPAD(0x814, PIN_INPUT | MUX_MODE0)
			/* (W9) gpmc_ad6.gpmc_ad6 */
			AM33XX_IOPAD(0x818, PIN_INPUT | MUX_MODE0)
			/* (T9) gpmc_ad7.gpmc_ad7 */
			AM33XX_IOPAD(0x81c, PIN_INPUT | MUX_MODE0)
			/* (T17) gpmc_wait0.gpmc_wait0 */
			AM33XX_IOPAD(0x870, PIN_INPUT | MUX_MODE0)
			/* (U17) gpmc_wpn.gpmc_wpn */
			AM33XX_IOPAD(0x874, PIN_OUTPUT | MUX_MODE0)
			/* (V6) gpmc_csn0.gpmc_csn0 */
			AM33XX_IOPAD(0x87c, PIN_OUTPUT | MUX_MODE0)
			/* (W7) gpmc_advn_awe.gpmc_advn_awe */
			AM33XX_IOPAD(0x890, PIN_OUTPUT | MUX_MODE0)
			/* (T7) gpmc_oen_wen.gpmc_oen_wen */
			AM33XX_IOPAD(0x894, PIN_OUTPUT | MUX_MODE0)
			/* (U6) gpmc_wen.gpmc_wen */
			AM33XX_IOPAD(0x898, PIN_OUTPUT | MUX_MODE0)
			/* (T6) gpmc_be0n_cwe.gpmc_be0n_cwe */
			AM33XX_IOPAD(0x89c, PIN_OUTPUT | MUX_MODE0)
		>;
	};
};
