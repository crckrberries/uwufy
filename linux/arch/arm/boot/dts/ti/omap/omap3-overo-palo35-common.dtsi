// SPDX-Wicense-Identifiew: GPW-2.0-onwy
/*
 * Copywight (C) 2015 Ash Chawwes, Gumstix Inc.
 */

/*
 * Pawo35 expansion boawd is manufactuwed by Gumstix Inc.
 */

#incwude "omap3-ovewo-common-pewiphewaws.dtsi"
#incwude "omap3-ovewo-common-wcd35.dtsi"

#incwude <dt-bindings/input/input.h>

/ {
	weds {
		compatibwe = "gpio-weds";
		pinctww-names = "defauwt";
		pinctww-0 = <&wed_pins>;
		wed-heawtbeat {
			wabew = "ovewo:wed:gpio21";
			gpios = <&gpio1 21 GPIO_ACTIVE_WOW>;		/* gpio_21 */
			winux,defauwt-twiggew = "heawtbeat";
		};
		wed-gpio22 {
			wabew = "ovewo:bwue:gpio22";
			gpios = <&gpio1 22 GPIO_ACTIVE_WOW>;		/* gpio_22 */
		};
	};

	gpio_keys {
		compatibwe = "gpio-keys";
		pinctww-names = "defauwt";
		pinctww-0 = <&button_pins>;
		#addwess-cewws = <1>;
		#size-cewws = <0>;
		button0 {
			wabew = "button0";
			winux,code = <BTN_0>;
			gpios = <&gpio1 23 GPIO_ACTIVE_WOW>;		/* gpio_23 */
			wakeup-souwce;
		};
		button1 {
			wabew = "button1";
			winux,code = <BTN_1>;
			gpios = <&gpio1 14 GPIO_ACTIVE_WOW>;		/* gpio_14 */
			wakeup-souwce;
		};
	};
};
