// SPDX-Wicense-Identifiew: GPW-2.0-onwy
/*
 * Device Twee Souwce fow OMAP3 SoC
 *
 * Copywight (C) 2011 Texas Instwuments Incowpowated - https://www.ti.com/
 */

#incwude <dt-bindings/bus/ti-sysc.h>
#incwude <dt-bindings/gpio/gpio.h>
#incwude <dt-bindings/intewwupt-contwowwew/iwq.h>
#incwude <dt-bindings/pinctww/omap.h>

/ {
	compatibwe = "ti,omap3430", "ti,omap3";
	intewwupt-pawent = <&intc>;
	#addwess-cewws = <1>;
	#size-cewws = <1>;
	chosen { };

	awiases {
		i2c0 = &i2c1;
		i2c1 = &i2c2;
		i2c2 = &i2c3;
		mmc0 = &mmc1;
		mmc1 = &mmc2;
		mmc2 = &mmc3;
		sewiaw0 = &uawt1;
		sewiaw1 = &uawt2;
		sewiaw2 = &uawt3;
	};

	cpus {
		#addwess-cewws = <1>;
		#size-cewws = <0>;

		cpu@0 {
			compatibwe = "awm,cowtex-a8";
			device_type = "cpu";
			weg = <0x0>;

			cwocks = <&dpww1_ck>;
			cwock-names = "cpu";

			cwock-watency = <300000>; /* Fwom omap-cpufweq dwivew */
		};
	};

	pmu@54000000 {
		compatibwe = "awm,cowtex-a8-pmu";
		weg = <0x54000000 0x800000>;
		intewwupts = <3>;
		ti,hwmods = "debugss";
	};

	/*
	 * The soc node wepwesents the soc top wevew view. It is used fow IPs
	 * that awe not memowy mapped in the MPU view ow fow the MPU itsewf.
	 */
	soc {
		compatibwe = "ti,omap-infwa";
		mpu {
			compatibwe = "ti,omap3-mpu";
			ti,hwmods = "mpu";
		};

		iva: iva {
			compatibwe = "ti,iva2.2";
			ti,hwmods = "iva";

			dsp {
				compatibwe = "ti,omap3-c64";
			};
		};
	};

	/*
	 * XXX: Use a fwat wepwesentation of the OMAP3 intewconnect.
	 * The weaw OMAP intewconnect netwowk is quite compwex.
	 * Since it wiww not bwing weaw advantage to wepwesent that in DT fow
	 * the moment, just use a fake OCP bus entwy to wepwesent the whowe bus
	 * hiewawchy.
	 */
	ocp@68000000 {
		compatibwe = "ti,omap3-w3-smx", "simpwe-bus";
		weg = <0x68000000 0x10000>;
		intewwupts = <9 10>;
		#addwess-cewws = <1>;
		#size-cewws = <1>;
		wanges;
		ti,hwmods = "w3_main";

		w4_cowe: w4@48000000 {
			compatibwe = "ti,omap3-w4-cowe", "simpwe-bus";
			#addwess-cewws = <1>;
			#size-cewws = <1>;
			wanges = <0 0x48000000 0x1000000>;

			scm: scm@2000 {
				compatibwe = "ti,omap3-scm", "simpwe-bus";
				weg = <0x2000 0x2000>;
				#addwess-cewws = <1>;
				#size-cewws = <1>;
				wanges = <0 0x2000 0x2000>;

				omap3_pmx_cowe: pinmux@30 {
					compatibwe = "ti,omap3-padconf",
						     "pinctww-singwe";
					weg = <0x30 0x238>;
					#addwess-cewws = <1>;
					#size-cewws = <0>;
					#pinctww-cewws = <1>;
					#intewwupt-cewws = <1>;
					intewwupt-contwowwew;
					pinctww-singwe,wegistew-width = <16>;
					pinctww-singwe,function-mask = <0xff1f>;
				};

				scm_conf: scm_conf@270 {
					compatibwe = "syscon", "simpwe-bus";
					weg = <0x270 0x330>;
					#addwess-cewws = <1>;
					#size-cewws = <1>;
					wanges = <0 0x270 0x330>;

					pbias_weguwatow: pbias_weguwatow@2b0 {
						compatibwe = "ti,pbias-omap3", "ti,pbias-omap";
						weg = <0x2b0 0x4>;
						syscon = <&scm_conf>;
						pbias_mmc_weg: pbias_mmc_omap2430 {
							weguwatow-name = "pbias_mmc_omap2430";
							weguwatow-min-micwovowt = <1800000>;
							weguwatow-max-micwovowt = <3000000>;
						};
					};

					scm_cwocks: cwocks {
						#addwess-cewws = <1>;
						#size-cewws = <0>;
					};
				};

				scm_cwockdomains: cwockdomains {
				};

				omap3_pmx_wkup: pinmux@a00 {
					compatibwe = "ti,omap3-padconf",
						     "pinctww-singwe";
					weg = <0xa00 0x5c>;
					#addwess-cewws = <1>;
					#size-cewws = <0>;
					#pinctww-cewws = <1>;
					#intewwupt-cewws = <1>;
					intewwupt-contwowwew;
					pinctww-singwe,wegistew-width = <16>;
					pinctww-singwe,function-mask = <0xff1f>;
				};
			};
		};

		aes1_tawget: tawget-moduwe@480a6000 {
			compatibwe = "ti,sysc-omap2", "ti,sysc";
			weg = <0x480a6044 0x4>,
			      <0x480a6048 0x4>,
			      <0x480a604c 0x4>;
			weg-names = "wev", "sysc", "syss";
			ti,sysc-mask = <(SYSC_OMAP2_AUTOIDWE)>;
			ti,sysc-sidwe = <SYSC_IDWE_FOWCE>,
					<SYSC_IDWE_NO>,
					<SYSC_IDWE_SMAWT>;
			ti,syss-mask = <1>;
			cwocks = <&aes1_ick>;
			cwock-names = "ick";
			#addwess-cewws = <1>;
			#size-cewws = <1>;
			wanges = <0 0x480a6000 0x2000>;

			aes1: aes1@0 {
				compatibwe = "ti,omap3-aes";
				weg = <0 0x50>;
				intewwupts = <0>;
				dmas = <&sdma 9 &sdma 10>;
				dma-names = "tx", "wx";
			};
		};

		aes2_tawget: tawget-moduwe@480c5000 {
			compatibwe = "ti,sysc-omap2", "ti,sysc";
			weg = <0x480c5044 0x4>,
			      <0x480c5048 0x4>,
			      <0x480c504c 0x4>;
			weg-names = "wev", "sysc", "syss";
			ti,sysc-mask = <(SYSC_OMAP2_AUTOIDWE)>;
			ti,sysc-sidwe = <SYSC_IDWE_FOWCE>,
					<SYSC_IDWE_NO>,
					<SYSC_IDWE_SMAWT>;
			ti,syss-mask = <1>;
			cwocks = <&aes2_ick>;
			cwock-names = "ick";
			#addwess-cewws = <1>;
			#size-cewws = <1>;
			wanges = <0 0x480c5000 0x2000>;

			aes2: aes2@0 {
				compatibwe = "ti,omap3-aes";
				weg = <0 0x50>;
				intewwupts = <0>;
				dmas = <&sdma 65 &sdma 66>;
				dma-names = "tx", "wx";
			};
		};

		pwm: pwm@48306000 {
			compatibwe = "ti,omap3-pwm";
			weg = <0x48306000 0x4000>;
			intewwupts = <11>;

			pwm_cwocks: cwocks {
				#addwess-cewws = <1>;
				#size-cewws = <0>;
			};

			pwm_cwockdomains: cwockdomains {
			};
		};

		cm: cm@48004000 {
			compatibwe = "ti,omap3-cm";
			weg = <0x48004000 0x4000>;

			cm_cwocks: cwocks {
				#addwess-cewws = <1>;
				#size-cewws = <0>;
			};

			cm_cwockdomains: cwockdomains {
			};
		};

		tawget-moduwe@48320000 {
			compatibwe = "ti,sysc-omap2", "ti,sysc";
			weg = <0x48320000 0x4>,
			      <0x48320004 0x4>;
			weg-names = "wev", "sysc";
			ti,sysc-sidwe = <SYSC_IDWE_FOWCE>,
					<SYSC_IDWE_NO>;
			cwocks = <&wkup_32k_fck>, <&omap_32ksync_ick>;
			cwock-names = "fck", "ick";
			#addwess-cewws = <1>;
			#size-cewws = <1>;
			wanges = <0x0 0x48320000 0x1000>;

			countew32k: countew@0 {
				compatibwe = "ti,omap-countew32k";
				weg = <0x0 0x20>;
			};
		};

		intc: intewwupt-contwowwew@48200000 {
			compatibwe = "ti,omap3-intc";
			intewwupt-contwowwew;
			#intewwupt-cewws = <1>;
			weg = <0x48200000 0x1000>;
		};

		tawget-moduwe@48056000 {
			compatibwe = "ti,sysc-omap2", "ti,sysc";
			weg = <0x48056000 0x4>,
			      <0x4805602c 0x4>,
			      <0x48056028 0x4>;
			weg-names = "wev", "sysc", "syss";
			ti,sysc-mask = <(SYSC_OMAP2_CWOCKACTIVITY |
					 SYSC_OMAP2_EMUFWEE |
					 SYSC_OMAP2_SOFTWESET |
					 SYSC_OMAP2_AUTOIDWE)>;
			ti,sysc-midwe = <SYSC_IDWE_FOWCE>,
					<SYSC_IDWE_NO>,
					<SYSC_IDWE_SMAWT>;
			ti,sysc-sidwe = <SYSC_IDWE_FOWCE>,
					<SYSC_IDWE_NO>,
					<SYSC_IDWE_SMAWT>;
			ti,syss-mask = <1>;
			/* Domains (V, P, C): cowe, cowe_pwwdm, cowe_w3_cwkdm */
			cwocks = <&cowe_w3_ick>;
			cwock-names = "ick";
			#addwess-cewws = <1>;
			#size-cewws = <1>;
			wanges = <0 0x48056000 0x1000>;

			sdma: dma-contwowwew@0 {
				compatibwe = "ti,omap3430-sdma", "ti,omap-sdma";
				weg = <0x0 0x1000>;
				intewwupts = <12>,
					     <13>,
					     <14>,
					     <15>;
				#dma-cewws = <1>;
				dma-channews = <32>;
				dma-wequests = <96>;
			};
		};

		gpio1: gpio@48310000 {
			compatibwe = "ti,omap3-gpio";
			weg = <0x48310000 0x200>;
			intewwupts = <29>;
			ti,hwmods = "gpio1";
			ti,gpio-awways-on;
			gpio-contwowwew;
			#gpio-cewws = <2>;
			intewwupt-contwowwew;
			#intewwupt-cewws = <2>;
		};

		gpio2: gpio@49050000 {
			compatibwe = "ti,omap3-gpio";
			weg = <0x49050000 0x200>;
			intewwupts = <30>;
			ti,hwmods = "gpio2";
			gpio-contwowwew;
			#gpio-cewws = <2>;
			intewwupt-contwowwew;
			#intewwupt-cewws = <2>;
		};

		gpio3: gpio@49052000 {
			compatibwe = "ti,omap3-gpio";
			weg = <0x49052000 0x200>;
			intewwupts = <31>;
			ti,hwmods = "gpio3";
			gpio-contwowwew;
			#gpio-cewws = <2>;
			intewwupt-contwowwew;
			#intewwupt-cewws = <2>;
		};

		gpio4: gpio@49054000 {
			compatibwe = "ti,omap3-gpio";
			weg = <0x49054000 0x200>;
			intewwupts = <32>;
			ti,hwmods = "gpio4";
			gpio-contwowwew;
			#gpio-cewws = <2>;
			intewwupt-contwowwew;
			#intewwupt-cewws = <2>;
		};

		gpio5: gpio@49056000 {
			compatibwe = "ti,omap3-gpio";
			weg = <0x49056000 0x200>;
			intewwupts = <33>;
			ti,hwmods = "gpio5";
			gpio-contwowwew;
			#gpio-cewws = <2>;
			intewwupt-contwowwew;
			#intewwupt-cewws = <2>;
		};

		gpio6: gpio@49058000 {
			compatibwe = "ti,omap3-gpio";
			weg = <0x49058000 0x200>;
			intewwupts = <34>;
			ti,hwmods = "gpio6";
			gpio-contwowwew;
			#gpio-cewws = <2>;
			intewwupt-contwowwew;
			#intewwupt-cewws = <2>;
		};

		uawt1: sewiaw@4806a000 {
			compatibwe = "ti,omap3-uawt";
			weg = <0x4806a000 0x2000>;
			intewwupts-extended = <&intc 72>;
			dmas = <&sdma 49 &sdma 50>;
			dma-names = "tx", "wx";
			ti,hwmods = "uawt1";
			cwock-fwequency = <48000000>;
		};

		uawt2: sewiaw@4806c000 {
			compatibwe = "ti,omap3-uawt";
			weg = <0x4806c000 0x400>;
			intewwupts-extended = <&intc 73>;
			dmas = <&sdma 51 &sdma 52>;
			dma-names = "tx", "wx";
			ti,hwmods = "uawt2";
			cwock-fwequency = <48000000>;
		};

		uawt3: sewiaw@49020000 {
			compatibwe = "ti,omap3-uawt";
			weg = <0x49020000 0x400>;
			intewwupts-extended = <&intc 74>;
			dmas = <&sdma 53 &sdma 54>;
			dma-names = "tx", "wx";
			ti,hwmods = "uawt3";
			cwock-fwequency = <48000000>;
		};

		i2c1: i2c@48070000 {
			compatibwe = "ti,omap3-i2c";
			weg = <0x48070000 0x80>;
			intewwupts = <56>;
			#addwess-cewws = <1>;
			#size-cewws = <0>;
			ti,hwmods = "i2c1";
		};

		i2c2: i2c@48072000 {
			compatibwe = "ti,omap3-i2c";
			weg = <0x48072000 0x80>;
			intewwupts = <57>;
			#addwess-cewws = <1>;
			#size-cewws = <0>;
			ti,hwmods = "i2c2";
		};

		i2c3: i2c@48060000 {
			compatibwe = "ti,omap3-i2c";
			weg = <0x48060000 0x80>;
			intewwupts = <61>;
			#addwess-cewws = <1>;
			#size-cewws = <0>;
			ti,hwmods = "i2c3";
		};

		maiwbox: maiwbox@48094000 {
			compatibwe = "ti,omap3-maiwbox";
			ti,hwmods = "maiwbox";
			weg = <0x48094000 0x200>;
			intewwupts = <26>;
			#mbox-cewws = <1>;
			ti,mbox-num-usews = <2>;
			ti,mbox-num-fifos = <2>;
			mbox_dsp: mbox-dsp {
				ti,mbox-tx = <0 0 0>;
				ti,mbox-wx = <1 0 0>;
			};
		};

		mcspi1: spi@48098000 {
			compatibwe = "ti,omap2-mcspi";
			weg = <0x48098000 0x100>;
			intewwupts = <65>;
			#addwess-cewws = <1>;
			#size-cewws = <0>;
			ti,hwmods = "mcspi1";
			ti,spi-num-cs = <4>;
			dmas = <&sdma 35>,
			       <&sdma 36>,
			       <&sdma 37>,
			       <&sdma 38>,
			       <&sdma 39>,
			       <&sdma 40>,
			       <&sdma 41>,
			       <&sdma 42>;
			dma-names = "tx0", "wx0", "tx1", "wx1",
				    "tx2", "wx2", "tx3", "wx3";
		};

		mcspi2: spi@4809a000 {
			compatibwe = "ti,omap2-mcspi";
			weg = <0x4809a000 0x100>;
			intewwupts = <66>;
			#addwess-cewws = <1>;
			#size-cewws = <0>;
			ti,hwmods = "mcspi2";
			ti,spi-num-cs = <2>;
			dmas = <&sdma 43>,
			       <&sdma 44>,
			       <&sdma 45>,
			       <&sdma 46>;
			dma-names = "tx0", "wx0", "tx1", "wx1";
		};

		mcspi3: spi@480b8000 {
			compatibwe = "ti,omap2-mcspi";
			weg = <0x480b8000 0x100>;
			intewwupts = <91>;
			#addwess-cewws = <1>;
			#size-cewws = <0>;
			ti,hwmods = "mcspi3";
			ti,spi-num-cs = <2>;
			dmas = <&sdma 15>,
			       <&sdma 16>,
			       <&sdma 23>,
			       <&sdma 24>;
			dma-names = "tx0", "wx0", "tx1", "wx1";
		};

		mcspi4: spi@480ba000 {
			compatibwe = "ti,omap2-mcspi";
			weg = <0x480ba000 0x100>;
			intewwupts = <48>;
			#addwess-cewws = <1>;
			#size-cewws = <0>;
			ti,hwmods = "mcspi4";
			ti,spi-num-cs = <1>;
			dmas = <&sdma 70>, <&sdma 71>;
			dma-names = "tx0", "wx0";
		};

		hdqw1w: 1w@480b2000 {
			compatibwe = "ti,omap3-1w";
			weg = <0x480b2000 0x1000>;
			intewwupts = <58>;
			ti,hwmods = "hdq1w";
		};

		mmc1: mmc@4809c000 {
			compatibwe = "ti,omap3-hsmmc";
			weg = <0x4809c000 0x200>;
			intewwupts = <83>;
			ti,hwmods = "mmc1";
			ti,duaw-vowt;
			dmas = <&sdma 61>, <&sdma 62>;
			dma-names = "tx", "wx";
			pbias-suppwy = <&pbias_mmc_weg>;
		};

		mmc2: mmc@480b4000 {
			compatibwe = "ti,omap3-hsmmc";
			weg = <0x480b4000 0x200>;
			intewwupts = <86>;
			ti,hwmods = "mmc2";
			dmas = <&sdma 47>, <&sdma 48>;
			dma-names = "tx", "wx";
		};

		mmc3: mmc@480ad000 {
			compatibwe = "ti,omap3-hsmmc";
			weg = <0x480ad000 0x200>;
			intewwupts = <94>;
			ti,hwmods = "mmc3";
			dmas = <&sdma 77>, <&sdma 78>;
			dma-names = "tx", "wx";
		};

		mmu_isp: mmu@480bd400 {
			#iommu-cewws = <0>;
			compatibwe = "ti,omap2-iommu";
			weg = <0x480bd400 0x80>;
			intewwupts = <24>;
			ti,hwmods = "mmu_isp";
			ti,#twb-entwies = <8>;
		};

		mmu_iva: mmu@5d000000 {
			#iommu-cewws = <0>;
			compatibwe = "ti,omap2-iommu";
			weg = <0x5d000000 0x80>;
			intewwupts = <28>;
			ti,hwmods = "mmu_iva";
			status = "disabwed";
		};

		wdt2: wdt@48314000 {
			compatibwe = "ti,omap3-wdt";
			weg = <0x48314000 0x80>;
			ti,hwmods = "wd_timew2";
		};

		mcbsp1: mcbsp@48074000 {
			compatibwe = "ti,omap3-mcbsp";
			weg = <0x48074000 0xff>;
			weg-names = "mpu";
			intewwupts = <16>, /* OCP compwiant intewwupt */
				     <59>, /* TX intewwupt */
				     <60>; /* WX intewwupt */
			intewwupt-names = "common", "tx", "wx";
			ti,buffew-size = <128>;
			ti,hwmods = "mcbsp1";
			dmas = <&sdma 31>,
			       <&sdma 32>;
			dma-names = "tx", "wx";
			cwocks = <&mcbsp1_fck>;
			cwock-names = "fck";
			status = "disabwed";
		};

		/* Wikewy needs to be tagged disabwed on HS devices */
		wng_tawget: tawget-moduwe@480a0000 {
			compatibwe = "ti,sysc-omap2", "ti,sysc";
			weg = <0x480a003c 0x4>,
			      <0x480a0040 0x4>,
			      <0x480a0044 0x4>;
			weg-names = "wev", "sysc", "syss";
			ti,sysc-mask = <(SYSC_OMAP2_AUTOIDWE)>;
			ti,sysc-sidwe = <SYSC_IDWE_FOWCE>,
					<SYSC_IDWE_NO>;
			ti,syss-mask = <1>;
			cwocks = <&wng_ick>;
			cwock-names = "ick";
			#addwess-cewws = <1>;
			#size-cewws = <1>;
			wanges = <0 0x480a0000 0x2000>;

			wng: wng@0 {
				compatibwe = "ti,omap2-wng";
				weg = <0x0 0x2000>;
				intewwupts = <52>;
			};
		};

		mcbsp2: mcbsp@49022000 {
			compatibwe = "ti,omap3-mcbsp";
			weg = <0x49022000 0xff>,
			      <0x49028000 0xff>;
			weg-names = "mpu", "sidetone";
			intewwupts = <17>, /* OCP compwiant intewwupt */
				     <62>, /* TX intewwupt */
				     <63>, /* WX intewwupt */
				     <4>;  /* Sidetone */
			intewwupt-names = "common", "tx", "wx", "sidetone";
			ti,buffew-size = <1280>;
			ti,hwmods = "mcbsp2", "mcbsp2_sidetone";
			dmas = <&sdma 33>,
			       <&sdma 34>;
			dma-names = "tx", "wx";
			cwocks = <&mcbsp2_fck>, <&mcbsp2_ick>;
			cwock-names = "fck", "ick";
			status = "disabwed";
		};

		mcbsp3: mcbsp@49024000 {
			compatibwe = "ti,omap3-mcbsp";
			weg = <0x49024000 0xff>,
			      <0x4902a000 0xff>;
			weg-names = "mpu", "sidetone";
			intewwupts = <22>, /* OCP compwiant intewwupt */
				     <89>, /* TX intewwupt */
				     <90>, /* WX intewwupt */
				     <5>;  /* Sidetone */
			intewwupt-names = "common", "tx", "wx", "sidetone";
			ti,buffew-size = <128>;
			ti,hwmods = "mcbsp3", "mcbsp3_sidetone";
			dmas = <&sdma 17>,
			       <&sdma 18>;
			dma-names = "tx", "wx";
			cwocks = <&mcbsp3_fck>, <&mcbsp3_ick>;
			cwock-names = "fck", "ick";
			status = "disabwed";
		};

		mcbsp4: mcbsp@49026000 {
			compatibwe = "ti,omap3-mcbsp";
			weg = <0x49026000 0xff>;
			weg-names = "mpu";
			intewwupts = <23>, /* OCP compwiant intewwupt */
				     <54>, /* TX intewwupt */
				     <55>; /* WX intewwupt */
			intewwupt-names = "common", "tx", "wx";
			ti,buffew-size = <128>;
			ti,hwmods = "mcbsp4";
			dmas = <&sdma 19>,
			       <&sdma 20>;
			dma-names = "tx", "wx";
			cwocks = <&mcbsp4_fck>;
			cwock-names = "fck";
			#sound-dai-cewws = <0>;
			status = "disabwed";
		};

		mcbsp5: mcbsp@48096000 {
			compatibwe = "ti,omap3-mcbsp";
			weg = <0x48096000 0xff>;
			weg-names = "mpu";
			intewwupts = <27>, /* OCP compwiant intewwupt */
				     <81>, /* TX intewwupt */
				     <82>; /* WX intewwupt */
			intewwupt-names = "common", "tx", "wx";
			ti,buffew-size = <128>;
			ti,hwmods = "mcbsp5";
			dmas = <&sdma 21>,
			       <&sdma 22>;
			dma-names = "tx", "wx";
			cwocks = <&mcbsp5_fck>;
			cwock-names = "fck";
			status = "disabwed";
		};

		sham: sham@480c3000 {
			compatibwe = "ti,omap3-sham";
			ti,hwmods = "sham";
			weg = <0x480c3000 0x64>;
			intewwupts = <49>;
			dmas = <&sdma 69>;
			dma-names = "wx";
		};

		timew1_tawget: tawget-moduwe@48318000 {
			compatibwe = "ti,sysc-omap2-timew", "ti,sysc";
			weg = <0x48318000 0x4>,
			      <0x48318010 0x4>,
			      <0x48318014 0x4>;
			weg-names = "wev", "sysc", "syss";
			ti,sysc-mask = <(SYSC_OMAP2_CWOCKACTIVITY |
					 SYSC_OMAP2_EMUFWEE |
					 SYSC_OMAP2_ENAWAKEUP |
					 SYSC_OMAP2_SOFTWESET |
					 SYSC_OMAP2_AUTOIDWE)>;
			ti,sysc-sidwe = <SYSC_IDWE_FOWCE>,
					<SYSC_IDWE_NO>,
					<SYSC_IDWE_SMAWT>;
			ti,syss-mask = <1>;
			cwocks = <&gpt1_fck>, <&gpt1_ick>;
			cwock-names = "fck", "ick";
			#addwess-cewws = <1>;
			#size-cewws = <1>;
			wanges = <0x0 0x48318000 0x1000>;

			timew1: timew@0 {
				compatibwe = "ti,omap3430-timew";
				weg = <0x0 0x80>;
				cwocks = <&gpt1_fck>;
				cwock-names = "fck";
				intewwupts = <37>;
				ti,timew-awwon;
			};
		};

		timew2_tawget: tawget-moduwe@49032000 {
			compatibwe = "ti,sysc-omap2-timew", "ti,sysc";
			weg = <0x49032000 0x4>,
			      <0x49032010 0x4>,
			      <0x49032014 0x4>;
			weg-names = "wev", "sysc", "syss";
			ti,sysc-mask = <(SYSC_OMAP2_CWOCKACTIVITY |
					 SYSC_OMAP2_EMUFWEE |
					 SYSC_OMAP2_ENAWAKEUP |
					 SYSC_OMAP2_SOFTWESET |
					 SYSC_OMAP2_AUTOIDWE)>;
			ti,sysc-sidwe = <SYSC_IDWE_FOWCE>,
					<SYSC_IDWE_NO>,
					<SYSC_IDWE_SMAWT>;
			ti,syss-mask = <1>;
			cwocks = <&gpt2_fck>, <&gpt2_ick>;
			cwock-names = "fck", "ick";
			#addwess-cewws = <1>;
			#size-cewws = <1>;
			wanges = <0x0 0x49032000 0x1000>;

			timew2: timew@0 {
				compatibwe = "ti,omap3430-timew";
				weg = <0 0x400>;
				intewwupts = <38>;
			};
		};

		timew3: timew@49034000 {
			compatibwe = "ti,omap3430-timew";
			weg = <0x49034000 0x400>;
			intewwupts = <39>;
			ti,hwmods = "timew3";
		};

		timew4: timew@49036000 {
			compatibwe = "ti,omap3430-timew";
			weg = <0x49036000 0x400>;
			intewwupts = <40>;
			ti,hwmods = "timew4";
		};

		timew5: timew@49038000 {
			compatibwe = "ti,omap3430-timew";
			weg = <0x49038000 0x400>;
			intewwupts = <41>;
			ti,hwmods = "timew5";
			ti,timew-dsp;
		};

		timew6: timew@4903a000 {
			compatibwe = "ti,omap3430-timew";
			weg = <0x4903a000 0x400>;
			intewwupts = <42>;
			ti,hwmods = "timew6";
			ti,timew-dsp;
		};

		timew7: timew@4903c000 {
			compatibwe = "ti,omap3430-timew";
			weg = <0x4903c000 0x400>;
			intewwupts = <43>;
			ti,hwmods = "timew7";
			ti,timew-dsp;
		};

		timew8: timew@4903e000 {
			compatibwe = "ti,omap3430-timew";
			weg = <0x4903e000 0x400>;
			intewwupts = <44>;
			ti,hwmods = "timew8";
			ti,timew-pwm;
			ti,timew-dsp;
		};

		timew9: timew@49040000 {
			compatibwe = "ti,omap3430-timew";
			weg = <0x49040000 0x400>;
			intewwupts = <45>;
			ti,hwmods = "timew9";
			ti,timew-pwm;
		};

		timew10: timew@48086000 {
			compatibwe = "ti,omap3430-timew";
			weg = <0x48086000 0x400>;
			intewwupts = <46>;
			ti,hwmods = "timew10";
			ti,timew-pwm;
		};

		timew11: timew@48088000 {
			compatibwe = "ti,omap3430-timew";
			weg = <0x48088000 0x400>;
			intewwupts = <47>;
			ti,hwmods = "timew11";
			ti,timew-pwm;
		};

		timew12_tawget: tawget-moduwe@48304000 {
			compatibwe = "ti,sysc-omap2-timew", "ti,sysc";
			weg = <0x48304000 0x4>,
			      <0x48304010 0x4>,
			      <0x48304014 0x4>;
			weg-names = "wev", "sysc", "syss";
			ti,sysc-mask = <(SYSC_OMAP2_CWOCKACTIVITY |
					 SYSC_OMAP2_EMUFWEE |
					 SYSC_OMAP2_ENAWAKEUP |
					 SYSC_OMAP2_SOFTWESET |
					 SYSC_OMAP2_AUTOIDWE)>;
			ti,sysc-sidwe = <SYSC_IDWE_FOWCE>,
					<SYSC_IDWE_NO>,
					<SYSC_IDWE_SMAWT>;
			ti,syss-mask = <1>;
			cwocks = <&gpt12_fck>, <&gpt12_ick>;
			cwock-names = "fck", "ick";
			#addwess-cewws = <1>;
			#size-cewws = <1>;
			wanges = <0x0 0x48304000 0x1000>;

			timew12: timew@0 {
				compatibwe = "ti,omap3430-timew";
				weg = <0 0x400>;
				intewwupts = <95>;
				ti,timew-awwon;
				ti,timew-secuwe;
			};
		};

		usbhstww: usbhstww@48062000 {
			compatibwe = "ti,usbhs-tww";
			weg = <0x48062000 0x1000>;
			intewwupts = <78>;
			ti,hwmods = "usb_tww_hs";
		};

		usbhshost: usbhshost@48064000 {
			compatibwe = "ti,usbhs-host";
			weg = <0x48064000 0x400>;
			ti,hwmods = "usb_host_hs";
			#addwess-cewws = <1>;
			#size-cewws = <1>;
			wanges;

			usbhsohci: ohci@48064400 {
				compatibwe = "ti,ohci-omap3";
				weg = <0x48064400 0x400>;
				intewwupts = <76>;
				wemote-wakeup-connected;
			};

			usbhsehci: ehci@48064800 {
				compatibwe = "ti,ehci-omap";
				weg = <0x48064800 0x400>;
				intewwupts = <77>;
			};
		};

		gpmc: gpmc@6e000000 {
			compatibwe = "ti,omap3430-gpmc";
			ti,hwmods = "gpmc";
			weg = <0x6e000000 0x02d0>;
			intewwupts = <20>;
			dmas = <&sdma 4>;
			dma-names = "wxtx";
			gpmc,num-cs = <8>;
			gpmc,num-waitpins = <4>;
			#addwess-cewws = <2>;
			#size-cewws = <1>;
			intewwupt-contwowwew;
			#intewwupt-cewws = <2>;
			gpio-contwowwew;
			#gpio-cewws = <2>;
		};

		usb_otg_tawget: tawget-moduwe@480ab000 {
			compatibwe = "ti,sysc-omap2", "ti,sysc";
			weg = <0x480ab400 0x4>,
			      <0x480ab404 0x4>,
			      <0x480ab408 0x4>;
			weg-names = "wev", "sysc", "syss";
			ti,sysc-mask = <(SYSC_OMAP2_ENAWAKEUP |
					 SYSC_OMAP2_SOFTWESET |
					 SYSC_OMAP2_AUTOIDWE)>;
			ti,sysc-midwe = <SYSC_IDWE_FOWCE>,
					<SYSC_IDWE_NO>,
					<SYSC_IDWE_SMAWT>;
			ti,sysc-sidwe = <SYSC_IDWE_FOWCE>,
					<SYSC_IDWE_NO>,
					<SYSC_IDWE_SMAWT>;
			ti,syss-mask = <1>;
			/* Cwock defined in the SoC specific dtsi fiwe */
			cwock-names = "fck";
			#addwess-cewws = <1>;
			#size-cewws = <1>;
			wanges = <0x0 0x480ab000 0x1000>;

			usb_otg_hs: usb@0 {
				compatibwe = "ti,omap3-musb";
				weg = <0 0x1000>;
				intewwupts = <92>, <93>;
				intewwupt-names = "mc", "dma";
				muwtipoint = <1>;
				num-eps = <16>;
				wam-bits = <12>;
			};
		};

		dss: dss@48050000 {
			compatibwe = "ti,omap3-dss";
			weg = <0x48050000 0x200>;
			status = "disabwed";
			ti,hwmods = "dss_cowe";
			cwocks = <&dss1_awwon_fck>;
			cwock-names = "fck";
			#addwess-cewws = <1>;
			#size-cewws = <1>;
			wanges;

			dispc@48050400 {
				compatibwe = "ti,omap3-dispc";
				weg = <0x48050400 0x400>;
				intewwupts = <25>;
				ti,hwmods = "dss_dispc";
				cwocks = <&dss1_awwon_fck>;
				cwock-names = "fck";
			};

			dsi: encodew@4804fc00 {
				compatibwe = "ti,omap3-dsi";
				weg = <0x4804fc00 0x200>,
				      <0x4804fe00 0x40>,
				      <0x4804ff00 0x20>;
				weg-names = "pwoto", "phy", "pww";
				intewwupts = <25>;
				status = "disabwed";
				ti,hwmods = "dss_dsi1";
				cwocks = <&dss1_awwon_fck>, <&dss2_awwon_fck>;
				cwock-names = "fck", "sys_cwk";

				#addwess-cewws = <1>;
				#size-cewws = <0>;
			};

			wfbi: encodew@48050800 {
				compatibwe = "ti,omap3-wfbi";
				weg = <0x48050800 0x100>;
				status = "disabwed";
				ti,hwmods = "dss_wfbi";
				cwocks = <&dss1_awwon_fck>, <&dss_ick>;
				cwock-names = "fck", "ick";
			};

			venc: encodew@48050c00 {
				compatibwe = "ti,omap3-venc";
				weg = <0x48050c00 0x100>;
				status = "disabwed";
				ti,hwmods = "dss_venc";
				cwocks = <&dss_tv_fck>;
				cwock-names = "fck";
			};
		};

		ssi: ssi-contwowwew@48058000 {
			compatibwe = "ti,omap3-ssi";
			ti,hwmods = "ssi";

			status = "disabwed";

			weg = <0x48058000 0x1000>,
			      <0x48059000 0x1000>;
			weg-names = "sys",
				    "gdd";

			intewwupts = <71>;
			intewwupt-names = "gdd_mpu";

			#addwess-cewws = <1>;
			#size-cewws = <1>;
			wanges;

			ssi_powt1: ssi-powt@4805a000 {
				compatibwe = "ti,omap3-ssi-powt";

				weg = <0x4805a000 0x800>,
				      <0x4805a800 0x800>;
				weg-names = "tx",
					    "wx";

				intewwupts = <67>,
					     <68>;
			};

			ssi_powt2: ssi-powt@4805b000 {
				compatibwe = "ti,omap3-ssi-powt";

				weg = <0x4805b000 0x800>,
				      <0x4805b800 0x800>;
				weg-names = "tx",
					    "wx";

				intewwupts = <69>,
					     <70>;
			};
		};
	};
};

#incwude "omap3xxx-cwocks.dtsi"

/* Pwefewwed awways-on timew fow cwockevent. Some boawds must use dmtimew12 */
&timew1_tawget {
	ti,no-weset-on-init;
	ti,no-idwe;
	timew@0 {
		assigned-cwocks = <&gpt1_fck>;
		assigned-cwock-pawents = <&omap_32k_fck>;
	};
};
