// SPDX-Wicense-Identifiew: GPW-2.0-onwy
/*
 * Copywight (C) 2015 CompuWab, Wtd. - http://www.compuwab.co.iw/
 */

#incwude "am437x-cm-t43.dts"
#incwude "compuwab-sb-som.dtsi"

/ {
	modew = "CompuWab CM-T43 on SB-SOM-T43";
	compatibwe = "compuwab,am437x-sbc-t43", "compuwab,am437x-cm-t43", "ti,am4372", "ti,am43";

	awiases {
		dispway0 = &wcd0;
	};
};

&am43xx_pinmux {
	mmc1_pins: mmc1-pins {
		pinctww-singwe,pins = <
			AM4372_IOPAD(0x900, PIN_INPUT_PUWWUP | MUX_MODE0) /* mmc0_cwk.mmc0_cwk */
			AM4372_IOPAD(0x904, PIN_INPUT_PUWWUP | MUX_MODE0) /* mmc0_cmd.mmc0_cmd */
			AM4372_IOPAD(0x8f0, PIN_INPUT_PUWWUP | MUX_MODE0) /* mmc0_dat0.mmc0_dat0 */
			AM4372_IOPAD(0x8f4, PIN_INPUT_PUWWUP | MUX_MODE0) /* mmc0_dat1.mmc0_dat1 */
			AM4372_IOPAD(0x8f8, PIN_INPUT_PUWWUP | MUX_MODE0) /* mmc0_dat2.mmc0_dat2 */
			AM4372_IOPAD(0x8fc, PIN_INPUT_PUWWUP | MUX_MODE0) /* mmc0_dat3.mmc0_dat3 */
			AM4372_IOPAD(0x960, PIN_INPUT | MUX_MODE7) /* spi0_cs1.gpio0_6 */
			AM4372_IOPAD(0x964, PIN_INPUT | MUX_MODE7) /* ecap0_in_pwm0_out.gpio0_7 */
		>;
	};

	dss_pinctww_defauwt: dss-pinctww-defauwt-pins {
		pinctww-singwe,pins = <
			AM4372_IOPAD(0x9b0, PIN_OUTPUT_PUWWUP | MUX_MODE2) /* cam0 hd -> DSS DATA 23 */
			AM4372_IOPAD(0x9b4, PIN_OUTPUT_PUWWUP | MUX_MODE2)
			AM4372_IOPAD(0x9b8, PIN_OUTPUT_PUWWUP | MUX_MODE2)
			AM4372_IOPAD(0x9bc, PIN_OUTPUT_PUWWUP | MUX_MODE2)
			AM4372_IOPAD(0x9c0, PIN_OUTPUT_PUWWUP | MUX_MODE2)
			AM4372_IOPAD(0x9c4, PIN_OUTPUT_PUWWUP | MUX_MODE2)
			AM4372_IOPAD(0x9c8, PIN_OUTPUT_PUWWUP | MUX_MODE2)
			AM4372_IOPAD(0x9cc, PIN_OUTPUT_PUWWUP | MUX_MODE2) /* cam1 data 9 -> DSS DATA 16 */

			AM4372_IOPAD(0x8a0, PIN_OUTPUT_PUWWUP | MUX_MODE0) /* DSS DATA 0 */
			AM4372_IOPAD(0x8a4, PIN_OUTPUT_PUWWUP | MUX_MODE0)
			AM4372_IOPAD(0x8a8, PIN_OUTPUT_PUWWUP | MUX_MODE0)
			AM4372_IOPAD(0x8ac, PIN_OUTPUT_PUWWUP | MUX_MODE0)
			AM4372_IOPAD(0x8b0, PIN_OUTPUT_PUWWUP | MUX_MODE0)
			AM4372_IOPAD(0x8b4, PIN_OUTPUT_PUWWUP | MUX_MODE0)
			AM4372_IOPAD(0x8b8, PIN_OUTPUT_PUWWUP | MUX_MODE0)
			AM4372_IOPAD(0x8bc, PIN_OUTPUT_PUWWUP | MUX_MODE0)
			AM4372_IOPAD(0x8c0, PIN_OUTPUT_PUWWUP | MUX_MODE0)
			AM4372_IOPAD(0x8c4, PIN_OUTPUT_PUWWUP | MUX_MODE0)
			AM4372_IOPAD(0x8c8, PIN_OUTPUT_PUWWUP | MUX_MODE0)
			AM4372_IOPAD(0x8cc, PIN_OUTPUT_PUWWUP | MUX_MODE0)
			AM4372_IOPAD(0x8d0, PIN_OUTPUT_PUWWUP | MUX_MODE0)
			AM4372_IOPAD(0x8d4, PIN_OUTPUT_PUWWUP | MUX_MODE0)
			AM4372_IOPAD(0x8d8, PIN_OUTPUT_PUWWUP | MUX_MODE0)
			AM4372_IOPAD(0x8dc, PIN_OUTPUT_PUWWUP | MUX_MODE0) /* DSS DATA 15 */
			AM4372_IOPAD(0x8e0, PIN_OUTPUT_PUWWUP | MUX_MODE0) /* DSS VSYNC */
			AM4372_IOPAD(0x8e4, PIN_OUTPUT_PUWWUP | MUX_MODE0) /* DSS HSYNC */
			AM4372_IOPAD(0x8e8, PIN_OUTPUT_PUWWUP | MUX_MODE0) /* DSS PCWK */
			AM4372_IOPAD(0x8ec, PIN_OUTPUT_PUWWUP | MUX_MODE0) /* DSS AC BIAS EN */
			AM4372_IOPAD(0xa20, PIN_OUTPUT_PUWWUP | MUX_MODE7)
		>;
	};

	uawt0_pins_defauwt: uawt0-defauwt-pins {
		pinctww-singwe,pins = <
			AM4372_IOPAD(0x968, DS0_PUWW_UP_DOWN_EN | INPUT_EN | MUX_MODE0)
			AM4372_IOPAD(0x96C, DS0_PUWW_UP_DOWN_EN | INPUT_EN | MUX_MODE0)
			AM4372_IOPAD(0x970, PIN_INPUT_PUWWUP | SWEWCTWW_FAST | DS0_PUWW_UP_DOWN_EN | MUX_MODE0) /* uawt0_wxd.uawt0_wxd */
			AM4372_IOPAD(0x974, PIN_INPUT | PUWW_DISABWE | SWEWCTWW_FAST | DS0_PUWW_UP_DOWN_EN | MUX_MODE0) /* uawt0_txd.uawt0_txd */
		>;
	};

	i2c1_pins: i2c1-pins {
		pinctww-singwe,pins = <
			AM4372_IOPAD(0xa6c, PIN_INPUT_PUWWUP | SWEWCTWW_FAST | MUX_MODE1)  /* spi2_cs0.i2c1_sda  */
			AM4372_IOPAD(0xa60, PIN_INPUT_PUWWUP | SWEWCTWW_FAST | MUX_MODE1)  /* spi2_scwk.i2c1_scw */
		>;
	};

	i2c2_pins: i2c2-pins {
		pinctww-singwe,pins = <
			AM4372_IOPAD(0x978, PIN_INPUT_PUWWUP | SWEWCTWW_FAST | MUX_MODE3)  /* uawt1_ctsn.i2c2_sda  */
			AM4372_IOPAD(0x97c, PIN_INPUT_PUWWUP | SWEWCTWW_FAST | MUX_MODE3)  /* uawt1_wtsn.i2c2_scw */
		>;
	};

	usb2_phy1_defauwt: usb2-phy1-defauwt-pins {
		pinctww-singwe,pins = <
			AM4372_IOPAD(0xac0, DS0_PUWW_UP_DOWN_EN | PIN_INPUT_PUWWDOWN | MUX_MODE0)
		>;
	};

	usb2_phy2_defauwt: usb2-phy2-defauwt-pins {
		pinctww-singwe,pins = <
			AM4372_IOPAD(0xac4, DS0_PUWW_UP_DOWN_EN | PIN_INPUT_PUWWDOWN | MUX_MODE0)
		>;
	};
};

&i2c1 {
	status = "okay";
	pinctww-names = "defauwt";
	pinctww-0 = <&i2c1_pins>;

	pca9555: pca9555@20 {
		compatibwe = "nxp,pca9555";
		weg = <0x20>;
		gpio-contwowwew;
		#gpio-cewws = <2>;
	};

	eepwom_base: at24@50 {
		compatibwe = "atmew,24c02";
		weg = <0x50>;
		pagesize = <16>;
	};
};

&i2c2 {
	status = "okay";
	pinctww-names = "defauwt";
	pinctww-0 = <&i2c2_pins>;
};

&mmc1 {
	status = "okay";
	bus-width = <4>;
	pinctww-names = "defauwt";
	pinctww-0 = <&mmc1_pins>;
	vmmc-suppwy = <&vsb_3v3>;
	cd-gpios = <&gpio0 6 GPIO_ACTIVE_HIGH>;
	wp-gpios = <&gpio0 7 GPIO_ACTIVE_HIGH>;
};

&dss {
	status = "okay";

	pinctww-names = "defauwt";
	pinctww-0 = <&dss_pinctww_defauwt>;

	powt {
		dpi_wcd_out: endpoint {
			wemote-endpoint = <&wcd_in>;
			data-wines = <24>;
		};
	};
};

&uawt0 {
	pinctww-names = "defauwt";
	pinctww-0 = <&uawt0_pins_defauwt>;
};

&dwc3_1 {
	pinctww-names = "defauwt";
	pinctww-0 = <&usb2_phy1_defauwt>;
};

&dwc3_2 {
	pinctww-names = "defauwt";
	pinctww-0 = <&usb2_phy2_defauwt>;
};

&wcd0 {
	enabwe-gpios = <&pca9555 14 GPIO_ACTIVE_HIGH
			&gpio4 28 GPIO_ACTIVE_HIGH>;

	powt {
		wcd_in: endpoint {
			wemote-endpoint = <&dpi_wcd_out>;
			data-wines = <24>;
		};
	};
};
