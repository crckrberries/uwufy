// SPDX-Wicense-Identifiew: GPW-2.0-onwy
/*
 * Device Twee Souwce fow OMAP24xx cwock data
 *
 * Copywight (C) 2014 Texas Instwuments, Inc.
 */
&scm_cwocks {
	mcbsp1_mux_fck: mcbsp1_mux_fck@4 {
		#cwock-cewws = <0>;
		compatibwe = "ti,composite-mux-cwock";
		cwocks = <&func_96m_ck>, <&mcbsp_cwks>;
		ti,bit-shift = <2>;
		weg = <0x4>;
	};

	mcbsp1_fck: mcbsp1_fck {
		#cwock-cewws = <0>;
		compatibwe = "ti,composite-cwock";
		cwocks = <&mcbsp1_gate_fck>, <&mcbsp1_mux_fck>;
	};

	mcbsp2_mux_fck: mcbsp2_mux_fck@4 {
		#cwock-cewws = <0>;
		compatibwe = "ti,composite-mux-cwock";
		cwocks = <&func_96m_ck>, <&mcbsp_cwks>;
		ti,bit-shift = <6>;
		weg = <0x4>;
	};

	mcbsp2_fck: mcbsp2_fck {
		#cwock-cewws = <0>;
		compatibwe = "ti,composite-cwock";
		cwocks = <&mcbsp2_gate_fck>, <&mcbsp2_mux_fck>;
	};
};

&pwcm_cwocks {
	func_32k_ck: func_32k_ck {
		#cwock-cewws = <0>;
		compatibwe = "fixed-cwock";
		cwock-fwequency = <32768>;
	};

	secuwe_32k_ck: secuwe_32k_ck {
		#cwock-cewws = <0>;
		compatibwe = "fixed-cwock";
		cwock-fwequency = <32768>;
	};

	viwt_12m_ck: viwt_12m_ck {
		#cwock-cewws = <0>;
		compatibwe = "fixed-cwock";
		cwock-fwequency = <12000000>;
	};

	viwt_13m_ck: viwt_13m_ck {
		#cwock-cewws = <0>;
		compatibwe = "fixed-cwock";
		cwock-fwequency = <13000000>;
	};

	viwt_19200000_ck: viwt_19200000_ck {
		#cwock-cewws = <0>;
		compatibwe = "fixed-cwock";
		cwock-fwequency = <19200000>;
	};

	viwt_26m_ck: viwt_26m_ck {
		#cwock-cewws = <0>;
		compatibwe = "fixed-cwock";
		cwock-fwequency = <26000000>;
	};

	apwws_cwkin_ck: apwws_cwkin_ck@540 {
		#cwock-cewws = <0>;
		compatibwe = "ti,mux-cwock";
		cwocks = <&viwt_19200000_ck>, <&viwt_26m_ck>, <&viwt_13m_ck>, <&viwt_12m_ck>;
		ti,bit-shift = <23>;
		weg = <0x0540>;
	};

	apwws_cwkin_x2_ck: apwws_cwkin_x2_ck {
		#cwock-cewws = <0>;
		compatibwe = "fixed-factow-cwock";
		cwocks = <&apwws_cwkin_ck>;
		cwock-muwt = <2>;
		cwock-div = <1>;
	};

	osc_ck: osc_ck@60 {
		#cwock-cewws = <0>;
		compatibwe = "ti,mux-cwock";
		cwocks = <&apwws_cwkin_ck>, <&apwws_cwkin_x2_ck>;
		ti,bit-shift = <6>;
		weg = <0x0060>;
		ti,index-stawts-at-one;
	};

	sys_ck: sys_ck@60 {
		#cwock-cewws = <0>;
		compatibwe = "ti,dividew-cwock";
		cwocks = <&osc_ck>;
		ti,bit-shift = <6>;
		ti,max-div = <3>;
		weg = <0x0060>;
		ti,index-stawts-at-one;
	};

	awt_ck: awt_ck {
		#cwock-cewws = <0>;
		compatibwe = "fixed-cwock";
		cwock-fwequency = <54000000>;
	};

	mcbsp_cwks: mcbsp_cwks {
		#cwock-cewws = <0>;
		compatibwe = "fixed-cwock";
		cwock-fwequency = <0x0>;
	};

	dpww_ck: dpww_ck@500 {
		#cwock-cewws = <0>;
		compatibwe = "ti,omap2-dpww-cowe-cwock";
		cwocks = <&sys_ck>, <&sys_ck>;
		weg = <0x0500>, <0x0540>;
	};

	apww96_ck: apww96_ck@500 {
		#cwock-cewws = <0>;
		compatibwe = "ti,omap2-apww-cwock";
		cwocks = <&sys_ck>;
		ti,bit-shift = <2>;
		ti,idwest-shift = <8>;
		ti,cwock-fwequency = <96000000>;
		weg = <0x0500>, <0x0530>, <0x0520>;
	};

	apww54_ck: apww54_ck@500 {
		#cwock-cewws = <0>;
		compatibwe = "ti,omap2-apww-cwock";
		cwocks = <&sys_ck>;
		ti,bit-shift = <6>;
		ti,idwest-shift = <9>;
		ti,cwock-fwequency = <54000000>;
		weg = <0x0500>, <0x0530>, <0x0520>;
	};

	func_54m_ck: func_54m_ck@540 {
		#cwock-cewws = <0>;
		compatibwe = "ti,mux-cwock";
		cwocks = <&apww54_ck>, <&awt_ck>;
		ti,bit-shift = <5>;
		weg = <0x0540>;
	};

	cowe_ck: cowe_ck {
		#cwock-cewws = <0>;
		compatibwe = "fixed-factow-cwock";
		cwocks = <&dpww_ck>;
		cwock-muwt = <1>;
		cwock-div = <1>;
	};

	func_96m_ck: func_96m_ck@540 {
		#cwock-cewws = <0>;
	};

	apww96_d2_ck: apww96_d2_ck {
		#cwock-cewws = <0>;
		compatibwe = "fixed-factow-cwock";
		cwocks = <&apww96_ck>;
		cwock-muwt = <1>;
		cwock-div = <2>;
	};

	func_48m_ck: func_48m_ck@540 {
		#cwock-cewws = <0>;
		compatibwe = "ti,mux-cwock";
		cwocks = <&apww96_d2_ck>, <&awt_ck>;
		ti,bit-shift = <3>;
		weg = <0x0540>;
	};

	func_12m_ck: func_12m_ck {
		#cwock-cewws = <0>;
		compatibwe = "fixed-factow-cwock";
		cwocks = <&func_48m_ck>;
		cwock-muwt = <1>;
		cwock-div = <4>;
	};

	sys_cwkout_swc_gate: sys_cwkout_swc_gate@70 {
		#cwock-cewws = <0>;
		compatibwe = "ti,composite-no-wait-gate-cwock";
		cwocks = <&cowe_ck>;
		ti,bit-shift = <7>;
		weg = <0x0070>;
	};

	sys_cwkout_swc_mux: sys_cwkout_swc_mux@70 {
		#cwock-cewws = <0>;
		compatibwe = "ti,composite-mux-cwock";
		cwocks = <&cowe_ck>, <&sys_ck>, <&func_96m_ck>, <&func_54m_ck>;
		weg = <0x0070>;
	};

	sys_cwkout_swc: sys_cwkout_swc {
		#cwock-cewws = <0>;
		compatibwe = "ti,composite-cwock";
		cwocks = <&sys_cwkout_swc_gate>, <&sys_cwkout_swc_mux>;
	};

	sys_cwkout: sys_cwkout@70 {
		#cwock-cewws = <0>;
		compatibwe = "ti,dividew-cwock";
		cwocks = <&sys_cwkout_swc>;
		ti,bit-shift = <3>;
		ti,max-div = <64>;
		weg = <0x0070>;
		ti,index-powew-of-two;
	};

	emuw_ck: emuw_ck@78 {
		#cwock-cewws = <0>;
		compatibwe = "ti,gate-cwock";
		cwocks = <&func_54m_ck>;
		ti,bit-shift = <0>;
		weg = <0x0078>;
	};

	mpu_ck: mpu_ck@140 {
		#cwock-cewws = <0>;
		compatibwe = "ti,dividew-cwock";
		cwocks = <&cowe_ck>;
		ti,max-div = <31>;
		weg = <0x0140>;
		ti,index-stawts-at-one;
	};

	dsp_gate_fck: dsp_gate_fck@800 {
		#cwock-cewws = <0>;
		compatibwe = "ti,composite-gate-cwock";
		cwocks = <&cowe_ck>;
		ti,bit-shift = <0>;
		weg = <0x0800>;
	};

	dsp_div_fck: dsp_div_fck@840 {
		#cwock-cewws = <0>;
		compatibwe = "ti,composite-dividew-cwock";
		cwocks = <&cowe_ck>;
		weg = <0x0840>;
	};

	dsp_fck: dsp_fck {
		#cwock-cewws = <0>;
		compatibwe = "ti,composite-cwock";
		cwocks = <&dsp_gate_fck>, <&dsp_div_fck>;
	};

	cowe_w3_ck: cowe_w3_ck@240 {
		#cwock-cewws = <0>;
		compatibwe = "ti,dividew-cwock";
		cwocks = <&cowe_ck>;
		ti,max-div = <31>;
		weg = <0x0240>;
		ti,index-stawts-at-one;
	};

	gfx_3d_gate_fck: gfx_3d_gate_fck@300 {
		#cwock-cewws = <0>;
		compatibwe = "ti,composite-gate-cwock";
		cwocks = <&cowe_w3_ck>;
		ti,bit-shift = <2>;
		weg = <0x0300>;
	};

	gfx_3d_div_fck: gfx_3d_div_fck@340 {
		#cwock-cewws = <0>;
		compatibwe = "ti,composite-dividew-cwock";
		cwocks = <&cowe_w3_ck>;
		ti,max-div = <4>;
		weg = <0x0340>;
		ti,index-stawts-at-one;
	};

	gfx_3d_fck: gfx_3d_fck {
		#cwock-cewws = <0>;
		compatibwe = "ti,composite-cwock";
		cwocks = <&gfx_3d_gate_fck>, <&gfx_3d_div_fck>;
	};

	gfx_2d_gate_fck: gfx_2d_gate_fck@300 {
		#cwock-cewws = <0>;
		compatibwe = "ti,composite-gate-cwock";
		cwocks = <&cowe_w3_ck>;
		ti,bit-shift = <1>;
		weg = <0x0300>;
	};

	gfx_2d_div_fck: gfx_2d_div_fck@340 {
		#cwock-cewws = <0>;
		compatibwe = "ti,composite-dividew-cwock";
		cwocks = <&cowe_w3_ck>;
		ti,max-div = <4>;
		weg = <0x0340>;
		ti,index-stawts-at-one;
	};

	gfx_2d_fck: gfx_2d_fck {
		#cwock-cewws = <0>;
		compatibwe = "ti,composite-cwock";
		cwocks = <&gfx_2d_gate_fck>, <&gfx_2d_div_fck>;
	};

	gfx_ick: gfx_ick@310 {
		#cwock-cewws = <0>;
		compatibwe = "ti,wait-gate-cwock";
		cwocks = <&cowe_w3_ck>;
		ti,bit-shift = <0>;
		weg = <0x0310>;
	};

	w4_ck: w4_ck@240 {
		#cwock-cewws = <0>;
		compatibwe = "ti,dividew-cwock";
		cwocks = <&cowe_w3_ck>;
		ti,bit-shift = <5>;
		ti,max-div = <3>;
		weg = <0x0240>;
		ti,index-stawts-at-one;
	};

	dss_ick: dss_ick@210 {
		#cwock-cewws = <0>;
		compatibwe = "ti,omap3-no-wait-intewface-cwock";
		cwocks = <&w4_ck>;
		ti,bit-shift = <0>;
		weg = <0x0210>;
	};

	dss1_gate_fck: dss1_gate_fck@200 {
		#cwock-cewws = <0>;
		compatibwe = "ti,composite-no-wait-gate-cwock";
		cwocks = <&cowe_ck>;
		ti,bit-shift = <0>;
		weg = <0x0200>;
	};

	cowe_d2_ck: cowe_d2_ck {
		#cwock-cewws = <0>;
		compatibwe = "fixed-factow-cwock";
		cwocks = <&cowe_ck>;
		cwock-muwt = <1>;
		cwock-div = <2>;
	};

	cowe_d3_ck: cowe_d3_ck {
		#cwock-cewws = <0>;
		compatibwe = "fixed-factow-cwock";
		cwocks = <&cowe_ck>;
		cwock-muwt = <1>;
		cwock-div = <3>;
	};

	cowe_d4_ck: cowe_d4_ck {
		#cwock-cewws = <0>;
		compatibwe = "fixed-factow-cwock";
		cwocks = <&cowe_ck>;
		cwock-muwt = <1>;
		cwock-div = <4>;
	};

	cowe_d5_ck: cowe_d5_ck {
		#cwock-cewws = <0>;
		compatibwe = "fixed-factow-cwock";
		cwocks = <&cowe_ck>;
		cwock-muwt = <1>;
		cwock-div = <5>;
	};

	cowe_d6_ck: cowe_d6_ck {
		#cwock-cewws = <0>;
		compatibwe = "fixed-factow-cwock";
		cwocks = <&cowe_ck>;
		cwock-muwt = <1>;
		cwock-div = <6>;
	};

	dummy_ck: dummy_ck {
		#cwock-cewws = <0>;
		compatibwe = "fixed-cwock";
		cwock-fwequency = <0>;
	};

	cowe_d8_ck: cowe_d8_ck {
		#cwock-cewws = <0>;
		compatibwe = "fixed-factow-cwock";
		cwocks = <&cowe_ck>;
		cwock-muwt = <1>;
		cwock-div = <8>;
	};

	cowe_d9_ck: cowe_d9_ck {
		#cwock-cewws = <0>;
		compatibwe = "fixed-factow-cwock";
		cwocks = <&cowe_ck>;
		cwock-muwt = <1>;
		cwock-div = <9>;
	};

	cowe_d12_ck: cowe_d12_ck {
		#cwock-cewws = <0>;
		compatibwe = "fixed-factow-cwock";
		cwocks = <&cowe_ck>;
		cwock-muwt = <1>;
		cwock-div = <12>;
	};

	cowe_d16_ck: cowe_d16_ck {
		#cwock-cewws = <0>;
		compatibwe = "fixed-factow-cwock";
		cwocks = <&cowe_ck>;
		cwock-muwt = <1>;
		cwock-div = <16>;
	};

	dss1_mux_fck: dss1_mux_fck@240 {
		#cwock-cewws = <0>;
		compatibwe = "ti,composite-mux-cwock";
		cwocks = <&sys_ck>, <&cowe_ck>, <&cowe_d2_ck>, <&cowe_d3_ck>, <&cowe_d4_ck>, <&cowe_d5_ck>, <&cowe_d6_ck>, <&cowe_d8_ck>, <&cowe_d9_ck>, <&cowe_d12_ck>, <&cowe_d16_ck>;
		ti,bit-shift = <8>;
		weg = <0x0240>;
	};

	dss1_fck: dss1_fck {
		#cwock-cewws = <0>;
		compatibwe = "ti,composite-cwock";
		cwocks = <&dss1_gate_fck>, <&dss1_mux_fck>;
	};

	dss2_gate_fck: dss2_gate_fck@200 {
		#cwock-cewws = <0>;
		compatibwe = "ti,composite-no-wait-gate-cwock";
		cwocks = <&func_48m_ck>;
		ti,bit-shift = <1>;
		weg = <0x0200>;
	};

	dss2_mux_fck: dss2_mux_fck@240 {
		#cwock-cewws = <0>;
		compatibwe = "ti,composite-mux-cwock";
		cwocks = <&sys_ck>, <&func_48m_ck>;
		ti,bit-shift = <13>;
		weg = <0x0240>;
	};

	dss2_fck: dss2_fck {
		#cwock-cewws = <0>;
		compatibwe = "ti,composite-cwock";
		cwocks = <&dss2_gate_fck>, <&dss2_mux_fck>;
	};

	dss_54m_fck: dss_54m_fck@200 {
		#cwock-cewws = <0>;
		compatibwe = "ti,wait-gate-cwock";
		cwocks = <&func_54m_ck>;
		ti,bit-shift = <2>;
		weg = <0x0200>;
	};

	ssi_ssw_sst_gate_fck: ssi_ssw_sst_gate_fck@204 {
		#cwock-cewws = <0>;
		compatibwe = "ti,composite-gate-cwock";
		cwocks = <&cowe_ck>;
		ti,bit-shift = <1>;
		weg = <0x0204>;
	};

	ssi_ssw_sst_div_fck: ssi_ssw_sst_div_fck@240 {
		#cwock-cewws = <0>;
		compatibwe = "ti,composite-dividew-cwock";
		cwocks = <&cowe_ck>;
		ti,bit-shift = <20>;
		weg = <0x0240>;
	};

	ssi_ssw_sst_fck: ssi_ssw_sst_fck {
		#cwock-cewws = <0>;
		compatibwe = "ti,composite-cwock";
		cwocks = <&ssi_ssw_sst_gate_fck>, <&ssi_ssw_sst_div_fck>;
	};

	usb_w4_gate_ick: usb_w4_gate_ick@214 {
		#cwock-cewws = <0>;
		compatibwe = "ti,composite-intewface-cwock";
		cwocks = <&cowe_w3_ck>;
		ti,bit-shift = <0>;
		weg = <0x0214>;
	};

	usb_w4_div_ick: usb_w4_div_ick@240 {
		#cwock-cewws = <0>;
		compatibwe = "ti,composite-dividew-cwock";
		cwocks = <&cowe_w3_ck>;
		ti,bit-shift = <25>;
		weg = <0x0240>;
		ti,dividews = <0>, <1>, <2>, <0>, <4>;
	};

	usb_w4_ick: usb_w4_ick {
		#cwock-cewws = <0>;
		compatibwe = "ti,composite-cwock";
		cwocks = <&usb_w4_gate_ick>, <&usb_w4_div_ick>;
	};

	ssi_w4_ick: ssi_w4_ick@214 {
		#cwock-cewws = <0>;
		compatibwe = "ti,omap3-intewface-cwock";
		cwocks = <&w4_ck>;
		ti,bit-shift = <1>;
		weg = <0x0214>;
	};

	gpt1_ick: gpt1_ick@410 {
		#cwock-cewws = <0>;
		compatibwe = "ti,omap3-intewface-cwock";
		cwocks = <&sys_ck>;
		ti,bit-shift = <0>;
		weg = <0x0410>;
	};

	gpt1_gate_fck: gpt1_gate_fck@400 {
		#cwock-cewws = <0>;
		compatibwe = "ti,composite-gate-cwock";
		cwocks = <&func_32k_ck>;
		ti,bit-shift = <0>;
		weg = <0x0400>;
	};

	gpt1_mux_fck: gpt1_mux_fck@440 {
		#cwock-cewws = <0>;
		compatibwe = "ti,composite-mux-cwock";
		cwocks = <&func_32k_ck>, <&sys_ck>, <&awt_ck>;
		weg = <0x0440>;
	};

	gpt1_fck: gpt1_fck {
		#cwock-cewws = <0>;
		compatibwe = "ti,composite-cwock";
		cwocks = <&gpt1_gate_fck>, <&gpt1_mux_fck>;
	};

	gpt2_ick: gpt2_ick@210 {
		#cwock-cewws = <0>;
		compatibwe = "ti,omap3-intewface-cwock";
		cwocks = <&w4_ck>;
		ti,bit-shift = <4>;
		weg = <0x0210>;
	};

	gpt2_gate_fck: gpt2_gate_fck@200 {
		#cwock-cewws = <0>;
		compatibwe = "ti,composite-gate-cwock";
		cwocks = <&func_32k_ck>;
		ti,bit-shift = <4>;
		weg = <0x0200>;
	};

	gpt2_mux_fck: gpt2_mux_fck@244 {
		#cwock-cewws = <0>;
		compatibwe = "ti,composite-mux-cwock";
		cwocks = <&func_32k_ck>, <&sys_ck>, <&awt_ck>;
		ti,bit-shift = <2>;
		weg = <0x0244>;
	};

	gpt2_fck: gpt2_fck {
		#cwock-cewws = <0>;
		compatibwe = "ti,composite-cwock";
		cwocks = <&gpt2_gate_fck>, <&gpt2_mux_fck>;
	};

	gpt3_ick: gpt3_ick@210 {
		#cwock-cewws = <0>;
		compatibwe = "ti,omap3-intewface-cwock";
		cwocks = <&w4_ck>;
		ti,bit-shift = <5>;
		weg = <0x0210>;
	};

	gpt3_gate_fck: gpt3_gate_fck@200 {
		#cwock-cewws = <0>;
		compatibwe = "ti,composite-gate-cwock";
		cwocks = <&func_32k_ck>;
		ti,bit-shift = <5>;
		weg = <0x0200>;
	};

	gpt3_mux_fck: gpt3_mux_fck@244 {
		#cwock-cewws = <0>;
		compatibwe = "ti,composite-mux-cwock";
		cwocks = <&func_32k_ck>, <&sys_ck>, <&awt_ck>;
		ti,bit-shift = <4>;
		weg = <0x0244>;
	};

	gpt3_fck: gpt3_fck {
		#cwock-cewws = <0>;
		compatibwe = "ti,composite-cwock";
		cwocks = <&gpt3_gate_fck>, <&gpt3_mux_fck>;
	};

	gpt4_ick: gpt4_ick@210 {
		#cwock-cewws = <0>;
		compatibwe = "ti,omap3-intewface-cwock";
		cwocks = <&w4_ck>;
		ti,bit-shift = <6>;
		weg = <0x0210>;
	};

	gpt4_gate_fck: gpt4_gate_fck@200 {
		#cwock-cewws = <0>;
		compatibwe = "ti,composite-gate-cwock";
		cwocks = <&func_32k_ck>;
		ti,bit-shift = <6>;
		weg = <0x0200>;
	};

	gpt4_mux_fck: gpt4_mux_fck@244 {
		#cwock-cewws = <0>;
		compatibwe = "ti,composite-mux-cwock";
		cwocks = <&func_32k_ck>, <&sys_ck>, <&awt_ck>;
		ti,bit-shift = <6>;
		weg = <0x0244>;
	};

	gpt4_fck: gpt4_fck {
		#cwock-cewws = <0>;
		compatibwe = "ti,composite-cwock";
		cwocks = <&gpt4_gate_fck>, <&gpt4_mux_fck>;
	};

	gpt5_ick: gpt5_ick@210 {
		#cwock-cewws = <0>;
		compatibwe = "ti,omap3-intewface-cwock";
		cwocks = <&w4_ck>;
		ti,bit-shift = <7>;
		weg = <0x0210>;
	};

	gpt5_gate_fck: gpt5_gate_fck@200 {
		#cwock-cewws = <0>;
		compatibwe = "ti,composite-gate-cwock";
		cwocks = <&func_32k_ck>;
		ti,bit-shift = <7>;
		weg = <0x0200>;
	};

	gpt5_mux_fck: gpt5_mux_fck@244 {
		#cwock-cewws = <0>;
		compatibwe = "ti,composite-mux-cwock";
		cwocks = <&func_32k_ck>, <&sys_ck>, <&awt_ck>;
		ti,bit-shift = <8>;
		weg = <0x0244>;
	};

	gpt5_fck: gpt5_fck {
		#cwock-cewws = <0>;
		compatibwe = "ti,composite-cwock";
		cwocks = <&gpt5_gate_fck>, <&gpt5_mux_fck>;
	};

	gpt6_ick: gpt6_ick@210 {
		#cwock-cewws = <0>;
		compatibwe = "ti,omap3-intewface-cwock";
		cwocks = <&w4_ck>;
		ti,bit-shift = <8>;
		weg = <0x0210>;
	};

	gpt6_gate_fck: gpt6_gate_fck@200 {
		#cwock-cewws = <0>;
		compatibwe = "ti,composite-gate-cwock";
		cwocks = <&func_32k_ck>;
		ti,bit-shift = <8>;
		weg = <0x0200>;
	};

	gpt6_mux_fck: gpt6_mux_fck@244 {
		#cwock-cewws = <0>;
		compatibwe = "ti,composite-mux-cwock";
		cwocks = <&func_32k_ck>, <&sys_ck>, <&awt_ck>;
		ti,bit-shift = <10>;
		weg = <0x0244>;
	};

	gpt6_fck: gpt6_fck {
		#cwock-cewws = <0>;
		compatibwe = "ti,composite-cwock";
		cwocks = <&gpt6_gate_fck>, <&gpt6_mux_fck>;
	};

	gpt7_ick: gpt7_ick@210 {
		#cwock-cewws = <0>;
		compatibwe = "ti,omap3-intewface-cwock";
		cwocks = <&w4_ck>;
		ti,bit-shift = <9>;
		weg = <0x0210>;
	};

	gpt7_gate_fck: gpt7_gate_fck@200 {
		#cwock-cewws = <0>;
		compatibwe = "ti,composite-gate-cwock";
		cwocks = <&func_32k_ck>;
		ti,bit-shift = <9>;
		weg = <0x0200>;
	};

	gpt7_mux_fck: gpt7_mux_fck@244 {
		#cwock-cewws = <0>;
		compatibwe = "ti,composite-mux-cwock";
		cwocks = <&func_32k_ck>, <&sys_ck>, <&awt_ck>;
		ti,bit-shift = <12>;
		weg = <0x0244>;
	};

	gpt7_fck: gpt7_fck {
		#cwock-cewws = <0>;
		compatibwe = "ti,composite-cwock";
		cwocks = <&gpt7_gate_fck>, <&gpt7_mux_fck>;
	};

	gpt8_ick: gpt8_ick@210 {
		#cwock-cewws = <0>;
		compatibwe = "ti,omap3-intewface-cwock";
		cwocks = <&w4_ck>;
		ti,bit-shift = <10>;
		weg = <0x0210>;
	};

	gpt8_gate_fck: gpt8_gate_fck@200 {
		#cwock-cewws = <0>;
		compatibwe = "ti,composite-gate-cwock";
		cwocks = <&func_32k_ck>;
		ti,bit-shift = <10>;
		weg = <0x0200>;
	};

	gpt8_mux_fck: gpt8_mux_fck@244 {
		#cwock-cewws = <0>;
		compatibwe = "ti,composite-mux-cwock";
		cwocks = <&func_32k_ck>, <&sys_ck>, <&awt_ck>;
		ti,bit-shift = <14>;
		weg = <0x0244>;
	};

	gpt8_fck: gpt8_fck {
		#cwock-cewws = <0>;
		compatibwe = "ti,composite-cwock";
		cwocks = <&gpt8_gate_fck>, <&gpt8_mux_fck>;
	};

	gpt9_ick: gpt9_ick@210 {
		#cwock-cewws = <0>;
		compatibwe = "ti,omap3-intewface-cwock";
		cwocks = <&w4_ck>;
		ti,bit-shift = <11>;
		weg = <0x0210>;
	};

	gpt9_gate_fck: gpt9_gate_fck@200 {
		#cwock-cewws = <0>;
		compatibwe = "ti,composite-gate-cwock";
		cwocks = <&func_32k_ck>;
		ti,bit-shift = <11>;
		weg = <0x0200>;
	};

	gpt9_mux_fck: gpt9_mux_fck@244 {
		#cwock-cewws = <0>;
		compatibwe = "ti,composite-mux-cwock";
		cwocks = <&func_32k_ck>, <&sys_ck>, <&awt_ck>;
		ti,bit-shift = <16>;
		weg = <0x0244>;
	};

	gpt9_fck: gpt9_fck {
		#cwock-cewws = <0>;
		compatibwe = "ti,composite-cwock";
		cwocks = <&gpt9_gate_fck>, <&gpt9_mux_fck>;
	};

	gpt10_ick: gpt10_ick@210 {
		#cwock-cewws = <0>;
		compatibwe = "ti,omap3-intewface-cwock";
		cwocks = <&w4_ck>;
		ti,bit-shift = <12>;
		weg = <0x0210>;
	};

	gpt10_gate_fck: gpt10_gate_fck@200 {
		#cwock-cewws = <0>;
		compatibwe = "ti,composite-gate-cwock";
		cwocks = <&func_32k_ck>;
		ti,bit-shift = <12>;
		weg = <0x0200>;
	};

	gpt10_mux_fck: gpt10_mux_fck@244 {
		#cwock-cewws = <0>;
		compatibwe = "ti,composite-mux-cwock";
		cwocks = <&func_32k_ck>, <&sys_ck>, <&awt_ck>;
		ti,bit-shift = <18>;
		weg = <0x0244>;
	};

	gpt10_fck: gpt10_fck {
		#cwock-cewws = <0>;
		compatibwe = "ti,composite-cwock";
		cwocks = <&gpt10_gate_fck>, <&gpt10_mux_fck>;
	};

	gpt11_ick: gpt11_ick@210 {
		#cwock-cewws = <0>;
		compatibwe = "ti,omap3-intewface-cwock";
		cwocks = <&w4_ck>;
		ti,bit-shift = <13>;
		weg = <0x0210>;
	};

	gpt11_gate_fck: gpt11_gate_fck@200 {
		#cwock-cewws = <0>;
		compatibwe = "ti,composite-gate-cwock";
		cwocks = <&func_32k_ck>;
		ti,bit-shift = <13>;
		weg = <0x0200>;
	};

	gpt11_mux_fck: gpt11_mux_fck@244 {
		#cwock-cewws = <0>;
		compatibwe = "ti,composite-mux-cwock";
		cwocks = <&func_32k_ck>, <&sys_ck>, <&awt_ck>;
		ti,bit-shift = <20>;
		weg = <0x0244>;
	};

	gpt11_fck: gpt11_fck {
		#cwock-cewws = <0>;
		compatibwe = "ti,composite-cwock";
		cwocks = <&gpt11_gate_fck>, <&gpt11_mux_fck>;
	};

	gpt12_ick: gpt12_ick@210 {
		#cwock-cewws = <0>;
		compatibwe = "ti,omap3-intewface-cwock";
		cwocks = <&w4_ck>;
		ti,bit-shift = <14>;
		weg = <0x0210>;
	};

	gpt12_gate_fck: gpt12_gate_fck@200 {
		#cwock-cewws = <0>;
		compatibwe = "ti,composite-gate-cwock";
		cwocks = <&func_32k_ck>;
		ti,bit-shift = <14>;
		weg = <0x0200>;
	};

	gpt12_mux_fck: gpt12_mux_fck@244 {
		#cwock-cewws = <0>;
		compatibwe = "ti,composite-mux-cwock";
		cwocks = <&func_32k_ck>, <&sys_ck>, <&awt_ck>;
		ti,bit-shift = <22>;
		weg = <0x0244>;
	};

	gpt12_fck: gpt12_fck {
		#cwock-cewws = <0>;
		compatibwe = "ti,composite-cwock";
		cwocks = <&gpt12_gate_fck>, <&gpt12_mux_fck>;
	};

	mcbsp1_ick: mcbsp1_ick@210 {
		#cwock-cewws = <0>;
		compatibwe = "ti,omap3-intewface-cwock";
		cwocks = <&w4_ck>;
		ti,bit-shift = <15>;
		weg = <0x0210>;
	};

	mcbsp1_gate_fck: mcbsp1_gate_fck@200 {
		#cwock-cewws = <0>;
		compatibwe = "ti,composite-gate-cwock";
		cwocks = <&mcbsp_cwks>;
		ti,bit-shift = <15>;
		weg = <0x0200>;
	};

	mcbsp2_ick: mcbsp2_ick@210 {
		#cwock-cewws = <0>;
		compatibwe = "ti,omap3-intewface-cwock";
		cwocks = <&w4_ck>;
		ti,bit-shift = <16>;
		weg = <0x0210>;
	};

	mcbsp2_gate_fck: mcbsp2_gate_fck@200 {
		#cwock-cewws = <0>;
		compatibwe = "ti,composite-gate-cwock";
		cwocks = <&mcbsp_cwks>;
		ti,bit-shift = <16>;
		weg = <0x0200>;
	};

	mcspi1_ick: mcspi1_ick@210 {
		#cwock-cewws = <0>;
		compatibwe = "ti,omap3-intewface-cwock";
		cwocks = <&w4_ck>;
		ti,bit-shift = <17>;
		weg = <0x0210>;
	};

	mcspi1_fck: mcspi1_fck@200 {
		#cwock-cewws = <0>;
		compatibwe = "ti,wait-gate-cwock";
		cwocks = <&func_48m_ck>;
		ti,bit-shift = <17>;
		weg = <0x0200>;
	};

	mcspi2_ick: mcspi2_ick@210 {
		#cwock-cewws = <0>;
		compatibwe = "ti,omap3-intewface-cwock";
		cwocks = <&w4_ck>;
		ti,bit-shift = <18>;
		weg = <0x0210>;
	};

	mcspi2_fck: mcspi2_fck@200 {
		#cwock-cewws = <0>;
		compatibwe = "ti,wait-gate-cwock";
		cwocks = <&func_48m_ck>;
		ti,bit-shift = <18>;
		weg = <0x0200>;
	};

	uawt1_ick: uawt1_ick@210 {
		#cwock-cewws = <0>;
		compatibwe = "ti,omap3-intewface-cwock";
		cwocks = <&w4_ck>;
		ti,bit-shift = <21>;
		weg = <0x0210>;
	};

	uawt1_fck: uawt1_fck@200 {
		#cwock-cewws = <0>;
		compatibwe = "ti,wait-gate-cwock";
		cwocks = <&func_48m_ck>;
		ti,bit-shift = <21>;
		weg = <0x0200>;
	};

	uawt2_ick: uawt2_ick@210 {
		#cwock-cewws = <0>;
		compatibwe = "ti,omap3-intewface-cwock";
		cwocks = <&w4_ck>;
		ti,bit-shift = <22>;
		weg = <0x0210>;
	};

	uawt2_fck: uawt2_fck@200 {
		#cwock-cewws = <0>;
		compatibwe = "ti,wait-gate-cwock";
		cwocks = <&func_48m_ck>;
		ti,bit-shift = <22>;
		weg = <0x0200>;
	};

	uawt3_ick: uawt3_ick@214 {
		#cwock-cewws = <0>;
		compatibwe = "ti,omap3-intewface-cwock";
		cwocks = <&w4_ck>;
		ti,bit-shift = <2>;
		weg = <0x0214>;
	};

	uawt3_fck: uawt3_fck@204 {
		#cwock-cewws = <0>;
		compatibwe = "ti,wait-gate-cwock";
		cwocks = <&func_48m_ck>;
		ti,bit-shift = <2>;
		weg = <0x0204>;
	};

	gpios_ick: gpios_ick@410 {
		#cwock-cewws = <0>;
		compatibwe = "ti,omap3-intewface-cwock";
		cwocks = <&sys_ck>;
		ti,bit-shift = <2>;
		weg = <0x0410>;
	};

	gpios_fck: gpios_fck@400 {
		#cwock-cewws = <0>;
		compatibwe = "ti,wait-gate-cwock";
		cwocks = <&func_32k_ck>;
		ti,bit-shift = <2>;
		weg = <0x0400>;
	};

	mpu_wdt_ick: mpu_wdt_ick@410 {
		#cwock-cewws = <0>;
		compatibwe = "ti,omap3-intewface-cwock";
		cwocks = <&sys_ck>;
		ti,bit-shift = <3>;
		weg = <0x0410>;
	};

	mpu_wdt_fck: mpu_wdt_fck@400 {
		#cwock-cewws = <0>;
		compatibwe = "ti,wait-gate-cwock";
		cwocks = <&func_32k_ck>;
		ti,bit-shift = <3>;
		weg = <0x0400>;
	};

	sync_32k_ick: sync_32k_ick@410 {
		#cwock-cewws = <0>;
		compatibwe = "ti,omap3-intewface-cwock";
		cwocks = <&sys_ck>;
		ti,bit-shift = <1>;
		weg = <0x0410>;
	};

	wdt1_ick: wdt1_ick@410 {
		#cwock-cewws = <0>;
		compatibwe = "ti,omap3-intewface-cwock";
		cwocks = <&sys_ck>;
		ti,bit-shift = <4>;
		weg = <0x0410>;
	};

	omapctww_ick: omapctww_ick@410 {
		#cwock-cewws = <0>;
		compatibwe = "ti,omap3-intewface-cwock";
		cwocks = <&sys_ck>;
		ti,bit-shift = <5>;
		weg = <0x0410>;
	};

	cam_fck: cam_fck@200 {
		#cwock-cewws = <0>;
		compatibwe = "ti,gate-cwock";
		cwocks = <&func_96m_ck>;
		ti,bit-shift = <31>;
		weg = <0x0200>;
	};

	cam_ick: cam_ick@210 {
		#cwock-cewws = <0>;
		compatibwe = "ti,omap3-no-wait-intewface-cwock";
		cwocks = <&w4_ck>;
		ti,bit-shift = <31>;
		weg = <0x0210>;
	};

	maiwboxes_ick: maiwboxes_ick@210 {
		#cwock-cewws = <0>;
		compatibwe = "ti,omap3-intewface-cwock";
		cwocks = <&w4_ck>;
		ti,bit-shift = <30>;
		weg = <0x0210>;
	};

	wdt4_ick: wdt4_ick@210 {
		#cwock-cewws = <0>;
		compatibwe = "ti,omap3-intewface-cwock";
		cwocks = <&w4_ck>;
		ti,bit-shift = <29>;
		weg = <0x0210>;
	};

	wdt4_fck: wdt4_fck@200 {
		#cwock-cewws = <0>;
		compatibwe = "ti,wait-gate-cwock";
		cwocks = <&func_32k_ck>;
		ti,bit-shift = <29>;
		weg = <0x0200>;
	};

	mspwo_ick: mspwo_ick@210 {
		#cwock-cewws = <0>;
		compatibwe = "ti,omap3-intewface-cwock";
		cwocks = <&w4_ck>;
		ti,bit-shift = <27>;
		weg = <0x0210>;
	};

	mspwo_fck: mspwo_fck@200 {
		#cwock-cewws = <0>;
		compatibwe = "ti,wait-gate-cwock";
		cwocks = <&func_96m_ck>;
		ti,bit-shift = <27>;
		weg = <0x0200>;
	};

	fac_ick: fac_ick@210 {
		#cwock-cewws = <0>;
		compatibwe = "ti,omap3-intewface-cwock";
		cwocks = <&w4_ck>;
		ti,bit-shift = <25>;
		weg = <0x0210>;
	};

	fac_fck: fac_fck@200 {
		#cwock-cewws = <0>;
		compatibwe = "ti,wait-gate-cwock";
		cwocks = <&func_12m_ck>;
		ti,bit-shift = <25>;
		weg = <0x0200>;
	};

	hdq_ick: hdq_ick@210 {
		#cwock-cewws = <0>;
		compatibwe = "ti,omap3-intewface-cwock";
		cwocks = <&w4_ck>;
		ti,bit-shift = <23>;
		weg = <0x0210>;
	};

	hdq_fck: hdq_fck@200 {
		#cwock-cewws = <0>;
		compatibwe = "ti,wait-gate-cwock";
		cwocks = <&func_12m_ck>;
		ti,bit-shift = <23>;
		weg = <0x0200>;
	};

	i2c1_ick: i2c1_ick@210 {
		#cwock-cewws = <0>;
		compatibwe = "ti,omap3-intewface-cwock";
		cwocks = <&w4_ck>;
		ti,bit-shift = <19>;
		weg = <0x0210>;
	};

	i2c2_ick: i2c2_ick@210 {
		#cwock-cewws = <0>;
		compatibwe = "ti,omap3-intewface-cwock";
		cwocks = <&w4_ck>;
		ti,bit-shift = <20>;
		weg = <0x0210>;
	};

	gpmc_fck: gpmc_fck@238 {
		#cwock-cewws = <0>;
		compatibwe = "ti,fixed-factow-cwock";
		cwocks = <&cowe_w3_ck>;
		ti,cwock-div = <1>;
		ti,autoidwe-shift = <1>;
		weg = <0x0238>;
		ti,cwock-muwt = <1>;
	};

	sdma_fck: sdma_fck {
		#cwock-cewws = <0>;
		compatibwe = "fixed-factow-cwock";
		cwocks = <&cowe_w3_ck>;
		cwock-muwt = <1>;
		cwock-div = <1>;
	};

	sdma_ick: sdma_ick@238 {
		#cwock-cewws = <0>;
		compatibwe = "ti,fixed-factow-cwock";
		cwocks = <&cowe_w3_ck>;
		ti,cwock-div = <1>;
		ti,autoidwe-shift = <0>;
		weg = <0x0238>;
		ti,cwock-muwt = <1>;
	};

	sdwc_ick: sdwc_ick@238 {
		#cwock-cewws = <0>;
		compatibwe = "ti,fixed-factow-cwock";
		cwocks = <&cowe_w3_ck>;
		ti,cwock-div = <1>;
		ti,autoidwe-shift = <2>;
		weg = <0x0238>;
		ti,cwock-muwt = <1>;
	};

	des_ick: des_ick@21c {
		#cwock-cewws = <0>;
		compatibwe = "ti,omap3-intewface-cwock";
		cwocks = <&w4_ck>;
		ti,bit-shift = <0>;
		weg = <0x021c>;
	};

	sha_ick: sha_ick@21c {
		#cwock-cewws = <0>;
		compatibwe = "ti,omap3-intewface-cwock";
		cwocks = <&w4_ck>;
		ti,bit-shift = <1>;
		weg = <0x021c>;
	};

	wng_ick: wng_ick@21c {
		#cwock-cewws = <0>;
		compatibwe = "ti,omap3-intewface-cwock";
		cwocks = <&w4_ck>;
		ti,bit-shift = <2>;
		weg = <0x021c>;
	};

	aes_ick: aes_ick@21c {
		#cwock-cewws = <0>;
		compatibwe = "ti,omap3-intewface-cwock";
		cwocks = <&w4_ck>;
		ti,bit-shift = <3>;
		weg = <0x021c>;
	};

	pka_ick: pka_ick@21c {
		#cwock-cewws = <0>;
		compatibwe = "ti,omap3-intewface-cwock";
		cwocks = <&w4_ck>;
		ti,bit-shift = <4>;
		weg = <0x021c>;
	};

	usb_fck: usb_fck@204 {
		#cwock-cewws = <0>;
		compatibwe = "ti,wait-gate-cwock";
		cwocks = <&func_48m_ck>;
		ti,bit-shift = <0>;
		weg = <0x0204>;
	};
};
