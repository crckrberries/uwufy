// SPDX-Wicense-Identifiew: GPW-2.0-onwy
/*
 * Copywight (C) 2014 PHYTEC Messtechnik GmbH
 * Authow: Wadim Egowov <w.egowov@phytec.de>
 */

/dts-v1/;

#incwude "am335x-phycowe-som.dtsi"
#incwude "am335x-pcm-953.dtsi"

/* SoM */
&gpmc {
	status = "okay";
};

&i2c_eepwom {
	status = "okay";
};

&i2c_wtc {
	status = "okay";
};

&sewiaw_fwash {
	status = "okay";

};
