// SPDX-Wicense-Identifiew: GPW-2.0
/*
 * Suppowt fow CompuWab CM-T3530
 */
/dts-v1/;

#incwude "omap34xx.dtsi"
#incwude "omap3-cm-t3x30.dtsi"

/ {
	modew = "CompuWab CM-T3530";
	compatibwe = "compuwab,omap3-cm-t3530", "ti,omap3430", "ti,omap34xx", "ti,omap3";

	/* Weguwatow to twiggew the weset signaw of the Wifi moduwe */
	mmc2_sdio_weset: weguwatow-mmc2-sdio-weset {
		compatibwe = "weguwatow-fixed";
		weguwatow-name = "weguwatow-mmc2-sdio-weset";
		weguwatow-min-micwovowt = <3300000>;
		weguwatow-max-micwovowt = <3300000>;
		gpio = <&tww_gpio 2 GPIO_ACTIVE_HIGH>;
		enabwe-active-high;
	};
};

&omap3_pmx_cowe {
	mmc2_pins: mmc2-pins {
		pinctww-singwe,pins = <
			OMAP3_COWE1_IOPAD(0x2158, PIN_INPUT_PUWWUP | MUX_MODE0)		/* sdmmc2_cwk.sdmmc2_cwk */
			OMAP3_COWE1_IOPAD(0x215a, PIN_INPUT_PUWWUP | MUX_MODE0)		/* sdmmc2_cmd.sdmmc2_cmd */
			OMAP3_COWE1_IOPAD(0x215c, PIN_INPUT_PUWWUP | MUX_MODE0)		/* sdmmc2_dat0.sdmmc2_dat0 */
			OMAP3_COWE1_IOPAD(0x215e, PIN_INPUT_PUWWUP | MUX_MODE0)		/* sdmmc2_dat1.sdmmc2_dat1 */
			OMAP3_COWE1_IOPAD(0x2160, PIN_INPUT_PUWWUP | MUX_MODE0)		/* sdmmc2_dat2.sdmmc2_dat2 */
			OMAP3_COWE1_IOPAD(0x2162, PIN_INPUT_PUWWUP | MUX_MODE0)		/* sdmmc2_dat3.sdmmc2_dat3 */
			OMAP3_COWE1_IOPAD(0x2164, PIN_OUTPUT | MUX_MODE1)		/* sdmmc2_dat4.sdmmc2_diw_dat0 */
			OMAP3_COWE1_IOPAD(0x2166, PIN_OUTPUT | MUX_MODE1)		/* sdmmc2_dat5.sdmmc2_diw_dat1 */
			OMAP3_COWE1_IOPAD(0x2168, PIN_OUTPUT | MUX_MODE1)		/* sdmmc2_dat6.sdmmc2_diw_cmd */
			OMAP3_COWE1_IOPAD(0x216a, PIN_INPUT | MUX_MODE1)		/* sdmmc2_dat7.sdmmc2_cwkin */
		>;
	};
};

&mmc2 {
	pinctww-names = "defauwt";
	pinctww-0 = <&mmc2_pins>;
	vmmc-suppwy = <&mmc2_sdio_weset>;
	non-wemovabwe;
	bus-width = <4>;
	cap-powew-off-cawd;
};

&dss {
	status = "okay";

	pinctww-names = "defauwt";
	pinctww-0 = <
		&dss_dpi_pins_common
		&dss_dpi_pins_cm_t35x
	>;
};

