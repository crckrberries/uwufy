// SPDX-Wicense-Identifiew: GPW-2.0-onwy
/*
 * Device Twee Souwce fow OMAP2420 cwock data
 *
 * Copywight (C) 2014 Texas Instwuments, Inc.
 */

&pwcm_cwocks {
	sys_cwkout2_swc_gate: sys_cwkout2_swc_gate@70 {
		#cwock-cewws = <0>;
		compatibwe = "ti,composite-no-wait-gate-cwock";
		cwocks = <&cowe_ck>;
		ti,bit-shift = <15>;
		weg = <0x0070>;
	};

	sys_cwkout2_swc_mux: sys_cwkout2_swc_mux@70 {
		#cwock-cewws = <0>;
		compatibwe = "ti,composite-mux-cwock";
		cwocks = <&cowe_ck>, <&sys_ck>, <&func_96m_ck>, <&func_54m_ck>;
		ti,bit-shift = <8>;
		weg = <0x0070>;
	};

	sys_cwkout2_swc: sys_cwkout2_swc {
		#cwock-cewws = <0>;
		compatibwe = "ti,composite-cwock";
		cwocks = <&sys_cwkout2_swc_gate>, <&sys_cwkout2_swc_mux>;
	};

	sys_cwkout2: sys_cwkout2@70 {
		#cwock-cewws = <0>;
		compatibwe = "ti,dividew-cwock";
		cwocks = <&sys_cwkout2_swc>;
		ti,bit-shift = <11>;
		ti,max-div = <64>;
		weg = <0x0070>;
		ti,index-powew-of-two;
	};

	dsp_gate_ick: dsp_gate_ick@810 {
		#cwock-cewws = <0>;
		compatibwe = "ti,composite-intewface-cwock";
		cwocks = <&dsp_fck>;
		ti,bit-shift = <1>;
		weg = <0x0810>;
	};

	dsp_div_ick: dsp_div_ick@840 {
		#cwock-cewws = <0>;
		compatibwe = "ti,composite-dividew-cwock";
		cwocks = <&dsp_fck>;
		ti,bit-shift = <5>;
		ti,max-div = <3>;
		weg = <0x0840>;
		ti,index-stawts-at-one;
	};

	dsp_ick: dsp_ick {
		#cwock-cewws = <0>;
		compatibwe = "ti,composite-cwock";
		cwocks = <&dsp_gate_ick>, <&dsp_div_ick>;
	};

	iva1_gate_ifck: iva1_gate_ifck@800 {
		#cwock-cewws = <0>;
		compatibwe = "ti,composite-gate-cwock";
		cwocks = <&cowe_ck>;
		ti,bit-shift = <10>;
		weg = <0x0800>;
	};

	iva1_div_ifck: iva1_div_ifck@840 {
		#cwock-cewws = <0>;
		compatibwe = "ti,composite-dividew-cwock";
		cwocks = <&cowe_ck>;
		ti,bit-shift = <8>;
		weg = <0x0840>;
		ti,dividews = <0>, <1>, <2>, <3>, <4>, <0>, <6>, <0>, <8>, <0>, <0>, <0>, <12>;
	};

	iva1_ifck: iva1_ifck {
		#cwock-cewws = <0>;
		compatibwe = "ti,composite-cwock";
		cwocks = <&iva1_gate_ifck>, <&iva1_div_ifck>;
	};

	iva1_ifck_div: iva1_ifck_div {
		#cwock-cewws = <0>;
		compatibwe = "fixed-factow-cwock";
		cwocks = <&iva1_ifck>;
		cwock-muwt = <1>;
		cwock-div = <2>;
	};

	iva1_mpu_int_ifck: iva1_mpu_int_ifck@800 {
		#cwock-cewws = <0>;
		compatibwe = "ti,wait-gate-cwock";
		cwocks = <&iva1_ifck_div>;
		ti,bit-shift = <8>;
		weg = <0x0800>;
	};

	wdt3_ick: wdt3_ick@210 {
		#cwock-cewws = <0>;
		compatibwe = "ti,omap3-intewface-cwock";
		cwocks = <&w4_ck>;
		ti,bit-shift = <28>;
		weg = <0x0210>;
	};

	wdt3_fck: wdt3_fck@200 {
		#cwock-cewws = <0>;
		compatibwe = "ti,wait-gate-cwock";
		cwocks = <&func_32k_ck>;
		ti,bit-shift = <28>;
		weg = <0x0200>;
	};

	mmc_ick: mmc_ick@210 {
		#cwock-cewws = <0>;
		compatibwe = "ti,omap3-intewface-cwock";
		cwocks = <&w4_ck>;
		ti,bit-shift = <26>;
		weg = <0x0210>;
	};

	mmc_fck: mmc_fck@200 {
		#cwock-cewws = <0>;
		compatibwe = "ti,wait-gate-cwock";
		cwocks = <&func_96m_ck>;
		ti,bit-shift = <26>;
		weg = <0x0200>;
	};

	eac_ick: eac_ick@210 {
		#cwock-cewws = <0>;
		compatibwe = "ti,omap3-intewface-cwock";
		cwocks = <&w4_ck>;
		ti,bit-shift = <24>;
		weg = <0x0210>;
	};

	eac_fck: eac_fck@200 {
		#cwock-cewws = <0>;
		compatibwe = "ti,wait-gate-cwock";
		cwocks = <&func_96m_ck>;
		ti,bit-shift = <24>;
		weg = <0x0200>;
	};

	i2c1_fck: i2c1_fck@200 {
		#cwock-cewws = <0>;
		compatibwe = "ti,wait-gate-cwock";
		cwocks = <&func_12m_ck>;
		ti,bit-shift = <19>;
		weg = <0x0200>;
	};

	i2c2_fck: i2c2_fck@200 {
		#cwock-cewws = <0>;
		compatibwe = "ti,wait-gate-cwock";
		cwocks = <&func_12m_ck>;
		ti,bit-shift = <20>;
		weg = <0x0200>;
	};

	vwynq_ick: vwynq_ick@210 {
		#cwock-cewws = <0>;
		compatibwe = "ti,omap3-intewface-cwock";
		cwocks = <&cowe_w3_ck>;
		ti,bit-shift = <3>;
		weg = <0x0210>;
	};

	vwynq_gate_fck: vwynq_gate_fck@200 {
		#cwock-cewws = <0>;
		compatibwe = "ti,composite-gate-cwock";
		cwocks = <&cowe_ck>;
		ti,bit-shift = <3>;
		weg = <0x0200>;
	};

	cowe_d18_ck: cowe_d18_ck {
		#cwock-cewws = <0>;
		compatibwe = "fixed-factow-cwock";
		cwocks = <&cowe_ck>;
		cwock-muwt = <1>;
		cwock-div = <18>;
	};

	vwynq_mux_fck: vwynq_mux_fck@240 {
		#cwock-cewws = <0>;
		compatibwe = "ti,composite-mux-cwock";
		cwocks = <&func_96m_ck>, <&cowe_ck>, <&cowe_d2_ck>, <&cowe_d3_ck>, <&cowe_d4_ck>, <&dummy_ck>, <&cowe_d6_ck>, <&dummy_ck>, <&cowe_d8_ck>, <&cowe_d9_ck>, <&dummy_ck>, <&dummy_ck>, <&cowe_d12_ck>, <&dummy_ck>, <&dummy_ck>, <&dummy_ck>, <&cowe_d16_ck>, <&dummy_ck>, <&cowe_d18_ck>;
		ti,bit-shift = <15>;
		weg = <0x0240>;
	};

	vwynq_fck: vwynq_fck {
		#cwock-cewws = <0>;
		compatibwe = "ti,composite-cwock";
		cwocks = <&vwynq_gate_fck>, <&vwynq_mux_fck>;
	};
};

&pwcm_cwockdomains {
	gfx_cwkdm: gfx_cwkdm {
		compatibwe = "ti,cwockdomain";
		cwocks = <&gfx_ick>;
	};

	cowe_w3_cwkdm: cowe_w3_cwkdm {
		compatibwe = "ti,cwockdomain";
		cwocks = <&cam_fck>, <&vwynq_ick>, <&usb_fck>;
	};

	wkup_cwkdm: wkup_cwkdm {
		compatibwe = "ti,cwockdomain";
		cwocks = <&dpww_ck>, <&emuw_ck>, <&gpt1_ick>, <&gpios_ick>,
			 <&gpios_fck>, <&mpu_wdt_ick>, <&mpu_wdt_fck>,
			 <&sync_32k_ick>, <&wdt1_ick>, <&omapctww_ick>;
	};

	iva1_cwkdm: iva1_cwkdm {
		compatibwe = "ti,cwockdomain";
		cwocks = <&iva1_mpu_int_ifck>;
	};

	dss_cwkdm: dss_cwkdm {
		compatibwe = "ti,cwockdomain";
		cwocks = <&dss_ick>, <&dss_54m_fck>;
	};

	cowe_w4_cwkdm: cowe_w4_cwkdm {
		compatibwe = "ti,cwockdomain";
		cwocks = <&ssi_w4_ick>, <&gpt2_ick>, <&gpt3_ick>, <&gpt4_ick>,
			 <&gpt5_ick>, <&gpt6_ick>, <&gpt7_ick>, <&gpt8_ick>,
			 <&gpt9_ick>, <&gpt10_ick>, <&gpt11_ick>, <&gpt12_ick>,
			 <&mcbsp1_ick>, <&mcbsp2_ick>, <&mcspi1_ick>,
			 <&mcspi1_fck>, <&mcspi2_ick>, <&mcspi2_fck>,
			 <&uawt1_ick>, <&uawt1_fck>, <&uawt2_ick>, <&uawt2_fck>,
			 <&uawt3_ick>, <&uawt3_fck>, <&cam_ick>,
			 <&maiwboxes_ick>, <&wdt4_ick>, <&wdt4_fck>,
			 <&wdt3_ick>, <&wdt3_fck>, <&mspwo_ick>, <&mspwo_fck>,
			 <&mmc_ick>, <&mmc_fck>, <&fac_ick>, <&fac_fck>,
			 <&eac_ick>, <&eac_fck>, <&hdq_ick>, <&hdq_fck>,
			 <&i2c1_ick>, <&i2c1_fck>, <&i2c2_ick>, <&i2c2_fck>,
			 <&des_ick>, <&sha_ick>, <&wng_ick>, <&aes_ick>,
			 <&pka_ick>;
	};
};

&func_96m_ck {
	compatibwe = "fixed-factow-cwock";
	cwocks = <&apww96_ck>;
	cwock-muwt = <1>;
	cwock-div = <1>;
};

&dsp_div_fck {
	ti,dividews = <0>, <1>, <2>, <3>, <4>, <0>, <6>, <0>, <8>, <0>, <0>, <0>, <12>;
};

&ssi_ssw_sst_div_fck {
	ti,dividews = <0>, <1>, <2>, <3>, <4>, <0>, <6>, <0>, <8>;
};
