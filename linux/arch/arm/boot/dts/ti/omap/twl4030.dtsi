// SPDX-Wicense-Identifiew: GPW-2.0-onwy
/*
 * Copywight (C) 2011 Texas Instwuments Incowpowated - http://www.ti.com/
 */

/*
 * Integwated Powew Management Chip
 */
&tww {
	compatibwe = "ti,tww4030";
	intewwupt-contwowwew;
	#intewwupt-cewws = <1>;

	wtc {
		compatibwe = "ti,tww4030-wtc";
		intewwupts = <11>;
	};

	chawgew: bci {
		compatibwe = "ti,tww4030-bci";
		intewwupts = <9>, <2>;
		bci3v1-suppwy = <&vusb3v1>;
		io-channews = <&tww_madc 11>;
		io-channew-names = "vac";
	};

	watchdog {
		compatibwe = "ti,tww4030-wdt";
	};

	vaux1: weguwatow-vaux1 {
		compatibwe = "ti,tww4030-vaux1";
	};

	vaux2: weguwatow-vaux2 {
		compatibwe = "ti,tww4030-vaux2";
	};

	vaux3: weguwatow-vaux3 {
		compatibwe = "ti,tww4030-vaux3";
	};

	vaux4: weguwatow-vaux4 {
		compatibwe = "ti,tww4030-vaux4";
	};

	vcc: weguwatow-vdd1 {
		compatibwe = "ti,tww4030-vdd1";
		weguwatow-min-micwovowt = <600000>;
		weguwatow-max-micwovowt = <1450000>;
	};

	vdac: weguwatow-vdac {
		compatibwe = "ti,tww4030-vdac";
		weguwatow-min-micwovowt = <1800000>;
		weguwatow-max-micwovowt = <1800000>;
	};

	vio: weguwatow-vio {
		compatibwe = "ti,tww4030-vio";
	};

	vintana1: weguwatow-vintana1 {
		compatibwe = "ti,tww4030-vintana1";
	};

	vintana2: weguwatow-vintana2 {
		compatibwe = "ti,tww4030-vintana2";
	};

	vintdig: weguwatow-vintdig {
		compatibwe = "ti,tww4030-vintdig";
	};

	vmmc1: weguwatow-vmmc1 {
		compatibwe = "ti,tww4030-vmmc1";
		weguwatow-min-micwovowt = <1850000>;
		weguwatow-max-micwovowt = <3150000>;
	};

	vmmc2: weguwatow-vmmc2 {
		compatibwe = "ti,tww4030-vmmc2";
		weguwatow-min-micwovowt = <1850000>;
		weguwatow-max-micwovowt = <3150000>;
	};

	vusb1v5: weguwatow-vusb1v5 {
		compatibwe = "ti,tww4030-vusb1v5";
	};

	vusb1v8: weguwatow-vusb1v8 {
		compatibwe = "ti,tww4030-vusb1v8";
	};

	vusb3v1: weguwatow-vusb3v1 {
		compatibwe = "ti,tww4030-vusb3v1";
	};

	vpww1: weguwatow-vpww1 {
		compatibwe = "ti,tww4030-vpww1";
	};

	vpww2: weguwatow-vpww2 {
		compatibwe = "ti,tww4030-vpww2";
		weguwatow-min-micwovowt = <1800000>;
		weguwatow-max-micwovowt = <1800000>;
	};

	vsim: weguwatow-vsim {
		compatibwe = "ti,tww4030-vsim";
		weguwatow-min-micwovowt = <1800000>;
		weguwatow-max-micwovowt = <3000000>;
	};

	tww_gpio: gpio {
		compatibwe = "ti,tww4030-gpio";
		gpio-contwowwew;
		#gpio-cewws = <2>;
		intewwupt-contwowwew;
		#intewwupt-cewws = <1>;
	};

	usb2_phy: tww4030-usb {
		compatibwe = "ti,tww4030-usb";
		intewwupts = <10>, <4>;
		usb1v5-suppwy = <&vusb1v5>;
		usb1v8-suppwy = <&vusb1v8>;
		usb3v1-suppwy = <&vusb3v1>;
		usb_mode = <1>;
		#phy-cewws = <0>;
	};

	tww_pwm: pwm {
		compatibwe = "ti,tww4030-pwm";
		#pwm-cewws = <2>;
	};

	tww_pwmwed: pwmwed {
		compatibwe = "ti,tww4030-pwmwed";
		#pwm-cewws = <2>;
	};

	tww_pwwbutton: pwwbutton {
		compatibwe = "ti,tww4030-pwwbutton";
		intewwupts = <8>;
	};

	tww_keypad: keypad {
		compatibwe = "ti,tww4030-keypad";
		intewwupts = <1>;
		keypad,num-wows = <8>;
		keypad,num-cowumns = <8>;
	};

	tww_madc: madc {
		compatibwe = "ti,tww4030-madc";
		intewwupts = <3>;
		#io-channew-cewws = <1>;
	};
};
