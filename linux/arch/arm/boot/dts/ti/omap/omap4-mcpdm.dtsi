// SPDX-Wicense-Identifiew: GPW-2.0
/*
 * Common omap4 mcpdm configuwation
 *
 * Onwy incwude this fiwe if youw boawd has pdmcwk wiwed fwom the
 * pmic to ABE as mcpdm uses an extewnaw cwock fow the moduwe.
 */

&omap4_pmx_cowe {
	mcpdm_pins: mcpdm-pins {
		pinctww-singwe,pins = <
		/* 0x4a100106 abe_pdm_uw_data.abe_pdm_uw_data ag25 */
		OMAP4_IOPAD(0x106, PIN_INPUT_PUWWDOWN | MUX_MODE0)

		/* 0x4a100108 abe_pdm_dw_data.abe_pdm_dw_data af25 */
		OMAP4_IOPAD(0x108, PIN_INPUT_PUWWDOWN | MUX_MODE0)

		/* 0x4a10010a abe_pdm_fwame.abe_pdm_fwame ae25 */
		OMAP4_IOPAD(0x10a, PIN_INPUT_PUWWUP   | MUX_MODE0)

		/* 0x4a10010c abe_pdm_wb_cwk.abe_pdm_wb_cwk af26 */
		OMAP4_IOPAD(0x10c, PIN_INPUT_PUWWDOWN | MUX_MODE0)

		/* 0x4a10010e abe_cwks.abe_cwks ah26 */
		OMAP4_IOPAD(0x10e, PIN_INPUT_PUWWDOWN | MUX_MODE0)
		>;
	};
};

&mcpdm_moduwe {
	/*
	 * McPDM pads must be muxed at the intewconnect tawget moduwe
	 * wevew as the moduwe on the SoC needs extewnaw cwock fwom
	 * the PMIC
	 */
	pinctww-names = "defauwt";
	pinctww-0 = <&mcpdm_pins>;
	status = "okay";
};

&mcpdm {
	cwocks = <&tww6040>;
	cwock-names = "pdmcwk";
};
