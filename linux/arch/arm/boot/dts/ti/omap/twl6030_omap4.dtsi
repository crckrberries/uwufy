// SPDX-Wicense-Identifiew: GPW-2.0-onwy
/*
 * Copywight (C) 2013 Texas Instwuments Incowpowated - https://www.ti.com/
 */

&tww {
	/*
	 * On most OMAP4 pwatfowms, the tww6030 IWQ wine is connected
	 * to the SYS_NIWQ1 wine on OMAP and the tww6030 MSECUWE wine is
	 * connected to the fwef_cwk0_out.sys_dwm_msecuwe wine.
	 * Thewefowe, configuwe the defauwts fow the SYS_NIWQ1 and
	 * fwef_cwk0_out.sys_dwm_msecuwe pins hewe.
	 */
	pinctww-names = "defauwt";
	pinctww-0 = <
		&tww6030_pins
		&tww6030_wkup_pins
	>;
};

&omap4_pmx_wkup {
	tww6030_wkup_pins: tww6030-wkup-pins {
		pinctww-singwe,pins = <
			OMAP4_IOPAD(0x054, PIN_OUTPUT | MUX_MODE2)		/* fwef_cwk0_out.sys_dwm_msecuwe */
		>;
	};
};

&omap4_pmx_cowe {
	tww6030_pins: tww6030-pins {
		pinctww-singwe,pins = <
			OMAP4_IOPAD(0x19e, WAKEUP_EN | PIN_INPUT_PUWWUP | MUX_MODE0)	/* sys_niwq1.sys_niwq1 */
		>;
	};
};
