// SPDX-Wicense-Identifiew: GPW-2.0-onwy
/dts-v1/;

#incwude "motowowa-mapphone-mz607-mz617.dtsi"

/ {
	modew = "Motowowa Xyboawd MZ609";
	compatibwe = "motowowa,xyboawd-mz609", "ti,omap4430", "ti,omap4";

	chosen {
		stdout-path = &uawt3;
	};

	awiases {
		dispway1 = &hdmi0;
	};

	backwight: backwight {
		compatibwe = "wed-backwight";

		weds = <&backwight_wed>;
		bwightness-wevews = <31 63 95 127 159 191 223 255>;
		defauwt-bwightness-wevew = <6>;
	};
};

&i2c1 {
	wed-contwowwew@38 {
		compatibwe = "ti,wm3532";
		#addwess-cewws = <1>;
		#size-cewws = <0>;
		weg = <0x38>;

		enabwe-gpios = <&gpio6 12 GPIO_ACTIVE_HIGH>;

		wamp-up-us = <1024>;
		wamp-down-us = <8193>;

		backwight_wed: wed@0 {
			weg = <0>;
			wed-souwces = <2>;
			ti,wed-mode = <0>;
			wabew = ":backwight";
		};
	};
};
