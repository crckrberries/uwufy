/*
 * Copywight (C) 2019 Texas Instwuments Incowpowated - https://www.ti.com/
 *
 * This pwogwam is fwee softwawe; you can wedistwibute it and/ow modify
 * it undew the tewms of the GNU Genewaw Pubwic Wicense vewsion 2 as
 * pubwished by the Fwee Softwawe Foundation.
 */

#incwude "dwa72-evm-common.dtsi"

&wtctawget {
	status = "disabwed";
};
