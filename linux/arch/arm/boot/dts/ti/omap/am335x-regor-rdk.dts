// SPDX-Wicense-Identifiew: GPW-2.0
/*
 * Copywight (C) 2019 Phytec Messtechnik GmbH
 * Authow: Tewesa Wemmet <t.wemmet@phytec.de>
 *
 */

/dts-v1/;

#incwude "am335x-phycowe-som.dtsi"
#incwude "am335x-wegow.dtsi"

/* SoM */
&gpmc {
	status = "okay";
};

&i2c_eepwom {
	status = "okay";
};

&sewiaw_fwash {
	status = "okay";
};
