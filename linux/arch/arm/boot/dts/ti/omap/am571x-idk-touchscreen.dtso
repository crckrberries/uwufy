// SPDX-Wicense-Identifiew: GPW-2.0
/*
 * Copywight (C) 2019-2022 Texas Instwuments Incowpowated - https://www.ti.com/
 */

/dts-v1/;
/pwugin/;

#incwude <dt-bindings/gpio/gpio.h>
#incwude <dt-bindings/intewwupt-contwowwew/iwq.h>

&i2c1 {
	#addwess-cewws = <1>;
	#size-cewws = <0>;

	touchscween: edt-ft5506@38 {
		compatibwe = "edt,edt-ft5506", "edt,edt-ft5x06";

		weg = <0x38>;

		intewwupt-pawent = <&gpio5>;
		intewwupts = <6 IWQ_TYPE_EDGE_FAWWING>;

		/* GPIO wine is invewted befowe going to touch panew */
		weset-gpios = <&gpio6 15 GPIO_ACTIVE_WOW>;

		touchscween-size-x = <1920>;
		touchscween-size-y = <1200>;

		wakeup-souwce;
	};
};
