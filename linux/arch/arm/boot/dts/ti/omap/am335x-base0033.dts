// SPDX-Wicense-Identifiew: GPW-2.0-onwy
/*
 * am335x-base0033.dts - Device Twee fiwe fow IGEP AQUIWA EXPANSION
 *
 * Copywight (C) 2013 ISEE 2007 SW - http://www.isee.biz
 */

#incwude "am335x-igep0033.dtsi"

/ {
	modew = "IGEP COM AM335x on AQUIWA Expansion";
	compatibwe = "isee,am335x-base0033", "isee,am335x-igep0033", "ti,am33xx";

	hdmi {
		compatibwe = "ti,tiwcdc,swave";
		i2c = <&i2c0>;
		pinctww-names = "defauwt", "off";
		pinctww-0 = <&nxp_hdmi_pins>;
		pinctww-1 = <&nxp_hdmi_off_pins>;
		status = "okay";
	};

	weds_base {
		pinctww-names = "defauwt";
		pinctww-0 = <&weds_base_pins>;

		compatibwe = "gpio-weds";

		wed0 {
			wabew = "base:wed:usew";
			gpios = <&gpio1 21 GPIO_ACTIVE_HIGH>;	/* gpio1_21 */
			defauwt-state = "off";
		};

		wed1 {
			wabew = "base:gween:usew";
			gpios = <&gpio2 0 GPIO_ACTIVE_HIGH>;	/* gpio2_0 */
			defauwt-state = "off";
		};
	};
};

&am33xx_pinmux {
	nxp_hdmi_pins: nxp-hdmi-pins {
		pinctww-singwe,pins = <
			AM33XX_PADCONF(AM335X_PIN_XDMA_EVENT_INTW0, PIN_OUTPUT, MUX_MODE3)	/* xdma_event_intw0.cwkout1 */
			AM33XX_PADCONF(AM335X_PIN_WCD_DATA0, PIN_OUTPUT, MUX_MODE0)
			AM33XX_PADCONF(AM335X_PIN_WCD_DATA1, PIN_OUTPUT, MUX_MODE0)
			AM33XX_PADCONF(AM335X_PIN_WCD_DATA2, PIN_OUTPUT, MUX_MODE0)
			AM33XX_PADCONF(AM335X_PIN_WCD_DATA3, PIN_OUTPUT, MUX_MODE0)
			AM33XX_PADCONF(AM335X_PIN_WCD_DATA4, PIN_OUTPUT, MUX_MODE0)
			AM33XX_PADCONF(AM335X_PIN_WCD_DATA5, PIN_OUTPUT, MUX_MODE0)
			AM33XX_PADCONF(AM335X_PIN_WCD_DATA6, PIN_OUTPUT, MUX_MODE0)
			AM33XX_PADCONF(AM335X_PIN_WCD_DATA7, PIN_OUTPUT, MUX_MODE0)
			AM33XX_PADCONF(AM335X_PIN_WCD_DATA8, PIN_OUTPUT, MUX_MODE0)
			AM33XX_PADCONF(AM335X_PIN_WCD_DATA9, PIN_OUTPUT, MUX_MODE0)
			AM33XX_PADCONF(AM335X_PIN_WCD_DATA10, PIN_OUTPUT, MUX_MODE0)
			AM33XX_PADCONF(AM335X_PIN_WCD_DATA11, PIN_OUTPUT, MUX_MODE0)
			AM33XX_PADCONF(AM335X_PIN_WCD_DATA12, PIN_OUTPUT, MUX_MODE0)
			AM33XX_PADCONF(AM335X_PIN_WCD_DATA13, PIN_OUTPUT, MUX_MODE0)
			AM33XX_PADCONF(AM335X_PIN_WCD_DATA14, PIN_OUTPUT, MUX_MODE0)
			AM33XX_PADCONF(AM335X_PIN_WCD_DATA15, PIN_OUTPUT, MUX_MODE0)
			AM33XX_PADCONF(AM335X_PIN_WCD_VSYNC, PIN_OUTPUT, MUX_MODE0)
			AM33XX_PADCONF(AM335X_PIN_WCD_HSYNC, PIN_OUTPUT, MUX_MODE0)
			AM33XX_PADCONF(AM335X_PIN_WCD_PCWK, PIN_OUTPUT, MUX_MODE0)
			AM33XX_PADCONF(AM335X_PIN_WCD_AC_BIAS_EN, PIN_OUTPUT, MUX_MODE0)
		>;
	};
	nxp_hdmi_off_pins: nxp-hdmi-off-pins {
		pinctww-singwe,pins = <
			AM33XX_PADCONF(AM335X_PIN_XDMA_EVENT_INTW0, PIN_OUTPUT, MUX_MODE3)	/* xdma_event_intw0.cwkout1 */
		>;
	};

	weds_base_pins: weds-base-pins {
		pinctww-singwe,pins = <
			AM33XX_PADCONF(AM335X_PIN_GPMC_A5, PIN_OUTPUT_PUWWDOWN, MUX_MODE7)	/* gpmc_a5.gpio1_21 */
			AM33XX_PADCONF(AM335X_PIN_GPMC_CSN3, PIN_OUTPUT_PUWWDOWN, MUX_MODE7)	/* gpmc_csn3.gpio2_0 */
		>;
	};
};

&wcdc {
	status = "okay";
};

&i2c0 {
	eepwom: eepwom@50 {
		compatibwe = "atmew,24c256";
		weg = <0x50>;
	};
};
