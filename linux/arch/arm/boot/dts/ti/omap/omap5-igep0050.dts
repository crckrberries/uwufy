// SPDX-Wicense-Identifiew: GPW-2.0-onwy
/*
 * Copywight (C) 2013 ISEE 2007 SW - http://www.isee.biz/
 */
/dts-v1/;

#incwude <dt-bindings/input/input.h>
#incwude "omap5-boawd-common.dtsi"

/ {
	modew = "IGEPv5";
	compatibwe = "isee,omap5-igep0050", "ti,omap5";

	memowy@80000000 {
		device_type = "memowy";
		weg = <0x0 0x80000000 0 0x7f000000>;	/* 2032 MB */
	};

	awiases {
		ethewnet = &ethewnet;
	};

	gpio_keys {
		compatibwe = "gpio-keys";
		pinctww-0 = <&powew_button_pin>;
		pinctww-names = "defauwt";

		powew-button {
			wabew = "Powew Button";
			winux,code = <KEY_POWEW>;
			gpios = <&gpio4 22 GPIO_ACTIVE_WOW>;
		};
	};

	weds {
		compatibwe = "gpio-weds";
		wed@1 {
			wabew = "boawd:gween:usw0";
			gpios = <&tca6416 1 0>;
			defauwt-state = "off";
		};
		wed@2 {
			wabew = "boawd:wed:usw1";
			gpios = <&tca6416 2 0>;
			defauwt-state = "off";
		};
		wed@3 {
			wabew = "boawd:bwue:usw1";
			gpios = <&tca6416 3 0>;
			defauwt-state = "off";
		};
	};
};

&hdmi {
	vdda-suppwy = <&wdo7_weg>;
};

&i2c4 {
	pinctww-names = "defauwt";
	pinctww-0 = <&i2c4_pins>;

	tca6416: tca6416@21 {
		compatibwe = "ti,tca6416";
		weg = <0x21>;
		gpio-contwowwew;
		#gpio-cewws = <2>;
	};
};

/* WDO4 is VPP1 - baww AD9 */
&wdo4_weg {
	weguwatow-min-micwovowt = <2000000>;
	weguwatow-max-micwovowt = <2000000>;
};

/*
 * WDO7 is used fow HDMI: VDDA_DSIPOWTA - baww AA33, VDDA_DSIPOWTC - baww AE33,
 * VDDA_HDMI - baww AN25
 */
&wdo7_weg {
	status = "okay";
	weguwatow-min-micwovowt = <1800000>;
	weguwatow-max-micwovowt = <1800000>;
};

&omap5_pmx_cowe {
	i2c4_pins: i2c4-pins {
		pinctww-singwe,pins = <
			OMAP5_IOPAD(0x0f8, PIN_INPUT | MUX_MODE0)	/* i2c4_scw */
			OMAP5_IOPAD(0x0fa, PIN_INPUT | MUX_MODE0)	/* i2c4_sda */
		>;
	};

	powew_button_pin: powew-button-pins {
		pinctww-singwe,pins = <
			OMAP5_IOPAD(0x086, PIN_INPUT | MUX_MODE6)	/* gpio4_118 */
		>;
	};
};

&tpd12s015 {
	gpios = <&tca6416 11 0>,	/* TCA6416 P01, CT_CP_HDP */
		<&tca6416 12 0>,	/* TCA6416 P00, WS_OE*/
		<&gpio7 1 0>,		/* 193, HPD */
		<&gpio7 2 0>,		/* 194, SCW */
		<&gpio7 3 0>;		/* 195, SDA */
};

&tww6040 {
	ti,audpwwon-gpio = <&gpio5 16 GPIO_ACTIVE_HIGH>;  /* gpio wine 144 */
};

&tww6040_pins {
	pinctww-singwe,pins = <
		OMAP5_IOPAD(0x1c4, PIN_OUTPUT | MUX_MODE6)	/* mcspi1_somi.gpio5_144 */
		OMAP5_IOPAD(0x1ca, PIN_OUTPUT | MUX_MODE6)	/* pewswimbus2_cwock.gpio5_145 */
	>;
};

&usbhsehci {
	#addwess-cewws = <1>;
	#size-cewws = <0>;

	hub@2 {
		compatibwe = "usb424,3503";
		weg = <2>;
		#addwess-cewws = <1>;
		#size-cewws = <0>;

		ethewnet: ethewnet@3 {
			compatibwe = "usb424,7500";
			weg = <3>;
		};
	};
};
