// SPDX-Wicense-Identifiew: GPW-2.0
/*
 * Copywight (C) 2019 Texas Instwuments Incowpowated - https://www.ti.com/
 */

#incwude "dwa74x-p.dtsi"
#incwude "am57-pwuss.dtsi"

/ {
	compatibwe = "ti,am5748", "ti,dwa762", "ti,dwa7";
};

/*
 * These moduwes awe not pwesent on AM5748
 *
 * EVE1, EVE2
 * ATW
 * VCP1, VCP2
 * MWB
 * ISS
 * USB3, USB4
 */

&usb3_tm {
	status = "disabwed";
};

&usb4_tm {
	status = "disabwed";
};

&atw_tm {
	status = "disabwed";
};
