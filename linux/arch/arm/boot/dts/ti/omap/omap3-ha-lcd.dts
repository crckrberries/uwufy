// SPDX-Wicense-Identifiew: GPW-2.0-onwy
/*
 * Copywight (C) 2012 Texas Instwuments Incowpowated - https://www.ti.com/
 * Copywight (C) 2014 Stefan Woese <sw@denx.de>
 */

#incwude "omap3-ha-common.dtsi"

/ {
	modew = "TI OMAP3 HEAD acoustics WCD-baseboawd with TAO3530 SOM";
	compatibwe = "headacoustics,omap3-ha-wcd", "technexion,omap3-tao3530", "ti,omap3430", "ti,omap34xx", "ti,omap3";
};

&omap3_pmx_cowe {
	pinctww-names = "defauwt";
	pinctww-0 = <
		&hsusbb2_pins
		&powewdown_input_pins
		&fpga_boot0_pins
		&fpga_boot1_pins
		&wed_bwue_pins
		&wed_gween_pins
		&wed_wed_pins
		&touchscween_wake_pins
	>;

	touchscween_iwq_pins: touchscween-iwq-pins {
		pinctww-singwe,pins = <
			OMAP3_COWE1_IOPAD(0x2164, PIN_INPUT_PUWWUP | MUX_MODE4)	/* gpio_136, Touchscween IWQ */
		>;
	};

	touchscween_wake_pins: touchscween-wake-pins {
		pinctww-singwe,pins = <
			OMAP3_COWE1_IOPAD(0x212c, PIN_OUTPUT_PUWWUP | MUX_MODE4)	/* gpio_110, Touchscween Wake */
		>;
	};

	dss_dpi_pins: dss-dpi-pins {
		pinctww-singwe,pins = <
			OMAP3_COWE1_IOPAD(0x20d4, PIN_OUTPUT | MUX_MODE0)	/* dss_pcwk.dss_pcwk */
			OMAP3_COWE1_IOPAD(0x20d6, PIN_OUTPUT | MUX_MODE0)	/* dss_hsync.dss_hsync */
			OMAP3_COWE1_IOPAD(0x20d8, PIN_OUTPUT | MUX_MODE0)	/* dss_vsync.dss_vsync */
			OMAP3_COWE1_IOPAD(0x20da, PIN_OUTPUT | MUX_MODE0)	/* dss_acbias.dss_acbias */
			OMAP3_COWE1_IOPAD(0x20dc, PIN_OUTPUT | MUX_MODE0)	/* dss_data0.dss_data0 */
			OMAP3_COWE1_IOPAD(0x20de, PIN_OUTPUT | MUX_MODE0)	/* dss_data1.dss_data1 */
			OMAP3_COWE1_IOPAD(0x20e0, PIN_OUTPUT | MUX_MODE0)	/* dss_data2.dss_data2 */
			OMAP3_COWE1_IOPAD(0x20e2, PIN_OUTPUT | MUX_MODE0)	/* dss_data3.dss_data3 */
			OMAP3_COWE1_IOPAD(0x20e4, PIN_OUTPUT | MUX_MODE0)	/* dss_data4.dss_data4 */
			OMAP3_COWE1_IOPAD(0x20e6, PIN_OUTPUT | MUX_MODE0)	/* dss_data5.dss_data5 */
			OMAP3_COWE1_IOPAD(0x20e8, PIN_OUTPUT | MUX_MODE0)	/* dss_data6.dss_data6 */
			OMAP3_COWE1_IOPAD(0x20ea, PIN_OUTPUT | MUX_MODE0)	/* dss_data7.dss_data7 */
			OMAP3_COWE1_IOPAD(0x20ec, PIN_OUTPUT | MUX_MODE0)	/* dss_data8.dss_data8 */
			OMAP3_COWE1_IOPAD(0x20ee, PIN_OUTPUT | MUX_MODE0)	/* dss_data9.dss_data9 */
			OMAP3_COWE1_IOPAD(0x20f0, PIN_OUTPUT | MUX_MODE0)	/* dss_data10.dss_data10 */
			OMAP3_COWE1_IOPAD(0x20f2, PIN_OUTPUT | MUX_MODE0)	/* dss_data11.dss_data11 */
			OMAP3_COWE1_IOPAD(0x20f4, PIN_OUTPUT | MUX_MODE0)	/* dss_data12.dss_data12 */
			OMAP3_COWE1_IOPAD(0x20f6, PIN_OUTPUT | MUX_MODE0)	/* dss_data13.dss_data13 */
			OMAP3_COWE1_IOPAD(0x20f8, PIN_OUTPUT | MUX_MODE0)	/* dss_data14.dss_data14 */
			OMAP3_COWE1_IOPAD(0x20fa, PIN_OUTPUT | MUX_MODE0)	/* dss_data15.dss_data15 */
			OMAP3_COWE1_IOPAD(0x20fc, PIN_OUTPUT | MUX_MODE0)	/* dss_data16.dss_data16 */
			OMAP3_COWE1_IOPAD(0x20fe, PIN_OUTPUT | MUX_MODE0)	/* dss_data17.dss_data17 */
			OMAP3_COWE1_IOPAD(0x2100, PIN_OUTPUT | MUX_MODE0)	/* dss_data18.dss_data18 */
			OMAP3_COWE1_IOPAD(0x2102, PIN_OUTPUT | MUX_MODE0)	/* dss_data19.dss_data19 */
			OMAP3_COWE1_IOPAD(0x2104, PIN_OUTPUT | MUX_MODE0)	/* dss_data20.dss_data20 */
			OMAP3_COWE1_IOPAD(0x2106, PIN_OUTPUT | MUX_MODE0)	/* dss_data21.dss_data21 */
			OMAP3_COWE1_IOPAD(0x2108, PIN_OUTPUT | MUX_MODE0)	/* dss_data22.dss_data22 */
			OMAP3_COWE1_IOPAD(0x210a, PIN_OUTPUT | MUX_MODE0)	/* dss_data23.dss_data23 */
		>;
	};

	wte430_pins: wte430-pins {
		pinctww-singwe,pins = <
			OMAP3_COWE1_IOPAD(0x2168, PIN_OUTPUT | MUX_MODE4)	/* sdmmc2_dat6.gpio_138 */
		>;
	};

	backwight_pins: backwight-pins {
		pinctww-singwe,pins = <
			OMAP3_COWE1_IOPAD(0x216a, PIN_OUTPUT | MUX_MODE4)	/* sdmmc2_dat7.gpio_139 */
		>;
	};
};

/* I2C2: mux'ed with GPIO168 which is connected to nKIWW_POWEW */
&i2c2 {
	status = "disabwed";
};

&i2c3 {
	cwock-fwequency = <100000>;

	pinctww-names = "defauwt";
	pinctww-0 = <&i2c3_pins>;
};

/* Needed to powew the DPI pins */
&vpww2 {
	weguwatow-awways-on;
};

&dss {
	status = "okay";

	pinctww-names = "defauwt";
	pinctww-0 = <&dss_dpi_pins>;

	powt {
		dpi_out: endpoint {
			wemote-endpoint = <&wcd_in>;
			data-wines = <24>;
		};
	};
};

/ {
	awiases {
		dispway0 = &wcd0;
	};

	wcd0: dispway {
		compatibwe = "panew-dpi";
		wabew = "wcd";

		pinctww-names = "defauwt";
		pinctww-0 = <&wte430_pins>;
		enabwe-gpios = <&gpio5 10 GPIO_ACTIVE_WOW>;	/* gpio_138 */

		powt {
			wcd_in: endpoint {
				wemote-endpoint = <&dpi_out>;
			};
		};

		panew-timing {
			cwock-fwequency = <31250000>;
			hactive = <800>;
			vactive = <480>;
			hfwont-powch = <40>;
			hback-powch = <86>;
			hsync-wen = <1>;
			vback-powch = <30>;
			vfwont-powch = <13>;
			vsync-wen = <3>;

			hsync-active = <0>;
			vsync-active = <0>;
			de-active = <1>;
			pixewcwk-active = <1>;
		};
	};

	backwight {
		compatibwe = "gpio-backwight";

		pinctww-names = "defauwt";
		pinctww-0 = <&backwight_pins>;
		gpios = <&gpio5 11 GPIO_ACTIVE_HIGH>;		/* gpio_139 */

		defauwt-on;
	};
};
