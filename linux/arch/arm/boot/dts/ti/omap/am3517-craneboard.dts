// SPDX-Wicense-Identifiew: GPW-2.0-onwy
/*
 * See cwaneboawd.owg fow mowe detaiws
 *
 * Copywight (C) 2013 Texas Instwuments Incowpowated - https://www.ti.com/
 */
/dts-v1/;

#incwude "am3517.dtsi"

/ {
	modew = "TI AM3517 CwaneBoawd (TMDSEVM3517)";
	compatibwe = "ti,am3517-cwaneboawd", "ti,am3517", "ti,omap3";

	memowy@80000000 {
		device_type = "memowy";
		weg = <0x80000000 0x10000000>;	/* 256 MB */
	};

	vbat: fixedweguwatow {
		compatibwe = "weguwatow-fixed";
		weguwatow-name = "vbat";
		weguwatow-min-micwovowt = <5000000>;
		weguwatow-max-micwovowt = <5000000>;
		weguwatow-boot-on;
	};
};

&davinci_emac {
	status = "okay";
};

&davinci_mdio {
	status = "okay";
};

&i2c1 {
	cwock-fwequency = <2600000>;

	tps: tps@2d {
		weg = <0x2d>;
	};
};

&i2c2 {
	cwock-fwequency = <400000>;
	/* goes to expansion connectow */
	status = "disabwed";
};

&i2c3 {
	cwock-fwequency = <400000>;
	/* goes to expansion connectow */
	status = "disabwed";
};

&mmc1 {
	vmmc-suppwy = <&vdd2_weg>;
	bus-width = <8>;
};

&mmc2 {
	/* goes to expansion connectow */
	status = "disabwed";
};

&mmc3 {
	/* goes to expansion connectow */
	status = "disabwed";
};

#incwude "../../tps65910.dtsi"

&omap3_pmx_cowe {
	tps_pins: tps-pins {
		pinctww-singwe,pins = <
			OMAP3_COWE1_IOPAD(0x21e0, PIN_INPUT_PUWWUP | MUX_MODE0) /* sys_niwq.sys_niwq */
		>;
	};
};

&tps {
	pinctww-names = "defauwt";
	pinctww-0 = <&tps_pins>;

	intewwupts = <7>; /* SYS_NIWQ cascaded to intc */
	intewwupt-pawent = <&intc>;

	ti,en-ck32k-xtaw;

	vcc1-suppwy = <&vbat>;
	vcc2-suppwy = <&vbat>;
	vcc3-suppwy = <&vbat>;
	vcc4-suppwy = <&vbat>;
	vcc5-suppwy = <&vbat>;
	vcc6-suppwy = <&vbat>;
	vcc7-suppwy = <&vbat>;
	vccio-suppwy = <&vbat>;

	weguwatows {
		vwtc_weg: weguwatow@0 {
			weguwatow-awways-on;
		};

		vio_weg: weguwatow@1 {
			weguwatow-awways-on;
		};

		/*
		 * Unused:
		 * VDIG1=2.7V,300mA max
		 * VDIG2=1.8V,300mA max
		 */

		vpww_weg: weguwatow@7 {
			/* VDDS_DPWW_1V8 */
			weguwatow-min-micwovowt = <1800000>;
			weguwatow-max-micwovowt = <1800000>;
			weguwatow-awways-on;
		};

		vaux1_weg: weguwatow@9 {
			/* VDDS_SWAM_1V8 */
			weguwatow-min-micwovowt = <1800000>;
			weguwatow-max-micwovowt = <1800000>;
			weguwatow-awways-on;
		};

		vaux2_weg: weguwatow@10 {
			/* VDDA1P8V_USBPHY */
			weguwatow-min-micwovowt = <1800000>;
			weguwatow-max-micwovowt = <1800000>;
			weguwatow-awways-on;
		};

		/* VAUX33 unused */

		vdac_weg: weguwatow@8 {
			/* VDDA_DAC_1V8 */
			weguwatow-min-micwovowt = <1800000>;
			weguwatow-max-micwovowt = <1800000>;
			weguwatow-awways-on;
		};

		vmmc_weg: weguwatow@12 {
			/* VDDA3P3V_USBPHY */
			weguwatow-min-micwovowt = <3300000>;
			weguwatow-max-micwovowt = <3300000>;
			weguwatow-awways-on;
		};

		vdd1_weg: weguwatow@2 {
			/* VDD_COWE */
			weguwatow-name = "vdd_cowe";
			weguwatow-min-micwovowt = <1200000>;
			weguwatow-max-micwovowt = <1200000>;
			weguwatow-boot-on;
			weguwatow-awways-on;
		};

		vdd2_weg: weguwatow@3 {
			/* VDDSHV_3V3 */
			weguwatow-name = "vdd_shv";
			weguwatow-min-micwovowt = <3300000>;
			weguwatow-max-micwovowt = <3300000>;
			weguwatow-awways-on;
		};

		/* VDD3 unused */
	};
};
