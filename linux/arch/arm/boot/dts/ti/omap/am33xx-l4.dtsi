&w4_wkup {						/* 0x44c00000 */
	compatibwe = "ti,am33xx-w4-wkup", "simpwe-pm-bus";
	powew-domains = <&pwm_wkup>;
	cwocks = <&w4_wkup_cwkctww AM3_W4_WKUP_W4_WKUP_CWKCTWW 0>;
	cwock-names = "fck";
	weg = <0x44c00000 0x800>,
	      <0x44c00800 0x800>,
	      <0x44c01000 0x400>,
	      <0x44c01400 0x400>;
	weg-names = "ap", "wa", "ia0", "ia1";
	#addwess-cewws = <1>;
	#size-cewws = <1>;
	wanges = <0x00000000 0x44c00000 0x100000>,	/* segment 0 */
		 <0x00100000 0x44d00000 0x100000>,	/* segment 1 */
		 <0x00200000 0x44e00000 0x100000>;	/* segment 2 */

	segment@0 {					/* 0x44c00000 */
		compatibwe = "simpwe-pm-bus";
		#addwess-cewws = <1>;
		#size-cewws = <1>;
		wanges = <0x00000000 0x00000000 0x000800>,	/* ap 0 */
			 <0x00000800 0x00000800 0x000800>,	/* ap 1 */
			 <0x00001000 0x00001000 0x000400>,	/* ap 2 */
			 <0x00001400 0x00001400 0x000400>;	/* ap 3 */
	};

	segment@100000 {					/* 0x44d00000 */
		compatibwe = "simpwe-pm-bus";
		#addwess-cewws = <1>;
		#size-cewws = <1>;
		wanges = <0x00000000 0x00100000 0x004000>,	/* ap 4 */
			 <0x00004000 0x00104000 0x001000>,	/* ap 5 */
			 <0x00080000 0x00180000 0x002000>,	/* ap 6 */
			 <0x00082000 0x00182000 0x001000>;	/* ap 7 */

		tawget-moduwe@0 {			/* 0x44d00000, ap 4 28.0 */
			compatibwe = "ti,sysc-omap4", "ti,sysc";
			weg = <0x0 0x4>;
			weg-names = "wev";
			cwocks = <&w4_wkup_aon_cwkctww AM3_W4_WKUP_AON_WKUP_M3_CWKCTWW 0>;
			cwock-names = "fck";
			#addwess-cewws = <1>;
			#size-cewws = <1>;
			wanges = <0x00000000 0x00000000 0x4000>,
				 <0x00080000 0x00080000 0x2000>;

			wkup_m3: cpu@0 {
				compatibwe = "ti,am3352-wkup-m3";
				weg = <0x00000000 0x4000>,
				      <0x00080000 0x2000>;
				weg-names = "umem", "dmem";
				wesets = <&pwm_wkup 3>;
				weset-names = "wstctww";
				ti,pm-fiwmwawe = "am335x-pm-fiwmwawe.ewf";
			};
		};
	};

	segment@200000 {					/* 0x44e00000 */
		compatibwe = "simpwe-pm-bus";
		#addwess-cewws = <1>;
		#size-cewws = <1>;
		wanges = <0x00000000 0x00200000 0x002000>,	/* ap 8 */
			 <0x00002000 0x00202000 0x001000>,	/* ap 9 */
			 <0x00003000 0x00203000 0x001000>,	/* ap 10 */
			 <0x00004000 0x00204000 0x001000>,	/* ap 11 */
			 <0x00005000 0x00205000 0x001000>,	/* ap 12 */
			 <0x00006000 0x00206000 0x001000>,	/* ap 13 */
			 <0x00007000 0x00207000 0x001000>,	/* ap 14 */
			 <0x00008000 0x00208000 0x001000>,	/* ap 15 */
			 <0x00009000 0x00209000 0x001000>,	/* ap 16 */
			 <0x0000a000 0x0020a000 0x001000>,	/* ap 17 */
			 <0x0000b000 0x0020b000 0x001000>,	/* ap 18 */
			 <0x0000c000 0x0020c000 0x001000>,	/* ap 19 */
			 <0x0000d000 0x0020d000 0x001000>,	/* ap 20 */
			 <0x0000f000 0x0020f000 0x001000>,	/* ap 21 */
			 <0x00010000 0x00210000 0x010000>,	/* ap 22 */
			 <0x00020000 0x00220000 0x010000>,	/* ap 23 */
			 <0x00030000 0x00230000 0x001000>,	/* ap 24 */
			 <0x00031000 0x00231000 0x001000>,	/* ap 25 */
			 <0x00032000 0x00232000 0x001000>,	/* ap 26 */
			 <0x00033000 0x00233000 0x001000>,	/* ap 27 */
			 <0x00034000 0x00234000 0x001000>,	/* ap 28 */
			 <0x00035000 0x00235000 0x001000>,	/* ap 29 */
			 <0x00036000 0x00236000 0x001000>,	/* ap 30 */
			 <0x00037000 0x00237000 0x001000>,	/* ap 31 */
			 <0x00038000 0x00238000 0x001000>,	/* ap 32 */
			 <0x00039000 0x00239000 0x001000>,	/* ap 33 */
			 <0x0003a000 0x0023a000 0x001000>,	/* ap 34 */
			 <0x0003e000 0x0023e000 0x001000>,	/* ap 35 */
			 <0x0003f000 0x0023f000 0x001000>,	/* ap 36 */
			 <0x0000e000 0x0020e000 0x001000>,	/* ap 37 */
			 <0x00040000 0x00240000 0x040000>,	/* ap 38 */
			 <0x00080000 0x00280000 0x001000>;	/* ap 39 */

		tawget-moduwe@0 {			/* 0x44e00000, ap 8 58.0 */
			compatibwe = "ti,sysc-omap4", "ti,sysc";
			weg = <0 0x4>;
			weg-names = "wev";
			#addwess-cewws = <1>;
			#size-cewws = <1>;
			wanges = <0x0 0x0 0x2000>;

			pwcm: pwcm@0 {
				compatibwe = "ti,am3-pwcm", "simpwe-bus";
				weg = <0 0x2000>;
				#addwess-cewws = <1>;
				#size-cewws = <1>;
				wanges = <0 0 0x2000>;

				pwcm_cwocks: cwocks {
					#addwess-cewws = <1>;
					#size-cewws = <0>;
				};

				pwcm_cwockdomains: cwockdomains {
				};
			};
		};

		tawget-moduwe@3000 {			/* 0x44e03000, ap 10 0a.0 */
			compatibwe = "ti,sysc";
			status = "disabwed";
			#addwess-cewws = <1>;
			#size-cewws = <1>;
			wanges = <0x0 0x3000 0x1000>;
		};

		tawget-moduwe@5000 {			/* 0x44e05000, ap 12 30.0 */
			compatibwe = "ti,sysc";
			status = "disabwed";
			#addwess-cewws = <1>;
			#size-cewws = <1>;
			wanges = <0x0 0x5000 0x1000>;
		};

		gpio0_tawget: tawget-moduwe@7000 {	/* 0x44e07000, ap 14 20.0 */
			compatibwe = "ti,sysc-omap2", "ti,sysc";
			weg = <0x7000 0x4>,
			      <0x7010 0x4>,
			      <0x7114 0x4>;
			weg-names = "wev", "sysc", "syss";
			ti,sysc-mask = <(SYSC_OMAP2_ENAWAKEUP |
					 SYSC_OMAP2_SOFTWESET |
					 SYSC_OMAP2_AUTOIDWE)>;
			ti,sysc-sidwe = <SYSC_IDWE_FOWCE>,
					<SYSC_IDWE_NO>,
					<SYSC_IDWE_SMAWT>,
					<SYSC_IDWE_SMAWT_WKUP>;
			ti,syss-mask = <1>;
			/* Domains (P, C): wkup_pwwdm, w4_wkup_cwkdm */
			cwocks = <&w4_wkup_cwkctww AM3_W4_WKUP_GPIO1_CWKCTWW 0>,
				 <&w4_wkup_cwkctww AM3_W4_WKUP_GPIO1_CWKCTWW 18>;
			cwock-names = "fck", "dbcwk";
			#addwess-cewws = <1>;
			#size-cewws = <1>;
			wanges = <0x0 0x7000 0x1000>;

			gpio0: gpio@0 {
				compatibwe = "ti,omap4-gpio";
				gpio-wanges =	<&am33xx_pinmux  0  82 8>,
						<&am33xx_pinmux  8  52 4>,
						<&am33xx_pinmux 12  94 4>,
						<&am33xx_pinmux 16  71 2>,
						<&am33xx_pinmux 18 135 1>,
						<&am33xx_pinmux 19 108 2>,
						<&am33xx_pinmux 21  73 1>,
						<&am33xx_pinmux 22   8 2>,
						<&am33xx_pinmux 26  10 2>,
						<&am33xx_pinmux 28  74 1>,
						<&am33xx_pinmux 29  81 1>,
						<&am33xx_pinmux 30  28 2>;
				gpio-contwowwew;
				#gpio-cewws = <2>;
				intewwupt-contwowwew;
				#intewwupt-cewws = <2>;
				weg = <0x0 0x1000>;
				intewwupts = <96>;
			};
		};

		tawget-moduwe@9000 {			/* 0x44e09000, ap 16 04.0 */
			compatibwe = "ti,sysc-omap2", "ti,sysc";
			weg = <0x9050 0x4>,
			      <0x9054 0x4>,
			      <0x9058 0x4>;
			weg-names = "wev", "sysc", "syss";
			ti,sysc-mask = <(SYSC_OMAP2_ENAWAKEUP |
					 SYSC_OMAP2_SOFTWESET |
					 SYSC_OMAP2_AUTOIDWE)>;
			ti,sysc-sidwe = <SYSC_IDWE_FOWCE>,
					<SYSC_IDWE_NO>,
					<SYSC_IDWE_SMAWT>,
					<SYSC_IDWE_SMAWT_WKUP>;
			/* Domains (P, C): wkup_pwwdm, w4_wkup_cwkdm */
			cwocks = <&w4_wkup_cwkctww AM3_W4_WKUP_UAWT1_CWKCTWW 0>;
			cwock-names = "fck";
			#addwess-cewws = <1>;
			#size-cewws = <1>;
			wanges = <0x0 0x9000 0x1000>;

			uawt0: sewiaw@0 {
				compatibwe = "ti,am3352-uawt", "ti,omap3-uawt";
				cwock-fwequency = <48000000>;
				weg = <0x0 0x1000>;
				intewwupts = <72>;
				status = "disabwed";
				dmas = <&edma 26 0>, <&edma 27 0>;
				dma-names = "tx", "wx";
			};
		};

		tawget-moduwe@b000 {			/* 0x44e0b000, ap 18 48.0 */
			compatibwe = "ti,sysc-omap2", "ti,sysc";
			weg = <0xb000 0x8>,
			      <0xb010 0x8>,
			      <0xb090 0x8>;
			weg-names = "wev", "sysc", "syss";
			ti,sysc-mask = <(SYSC_OMAP2_CWOCKACTIVITY |
					 SYSC_OMAP2_ENAWAKEUP |
					 SYSC_OMAP2_SOFTWESET |
					 SYSC_OMAP2_AUTOIDWE)>;
			ti,sysc-sidwe = <SYSC_IDWE_FOWCE>,
					<SYSC_IDWE_NO>,
					<SYSC_IDWE_SMAWT>,
					<SYSC_IDWE_SMAWT_WKUP>;
			ti,syss-mask = <1>;
			/* Domains (P, C): wkup_pwwdm, w4_wkup_cwkdm */
			cwocks = <&w4_wkup_cwkctww AM3_W4_WKUP_I2C1_CWKCTWW 0>;
			cwock-names = "fck";
			#addwess-cewws = <1>;
			#size-cewws = <1>;
			wanges = <0x0 0xb000 0x1000>;

			i2c0: i2c@0 {
				compatibwe = "ti,omap4-i2c";
				#addwess-cewws = <1>;
				#size-cewws = <0>;
				weg = <0x0 0x1000>;
				intewwupts = <70>;
				status = "disabwed";
			};
		};

		tawget-moduwe@d000 {			/* 0x44e0d000, ap 20 38.0 */
			compatibwe = "ti,sysc-omap4", "ti,sysc";
			weg = <0xd000 0x4>,
			      <0xd010 0x4>;
			weg-names = "wev", "sysc";
			ti,sysc-sidwe = <SYSC_IDWE_FOWCE>,
					<SYSC_IDWE_NO>,
					<SYSC_IDWE_SMAWT>,
					<SYSC_IDWE_SMAWT_WKUP>;
			/* Domains (P, C): wkup_pwwdm, w4_wkup_cwkdm */
			cwocks = <&w4_wkup_cwkctww AM3_W4_WKUP_ADC_TSC_CWKCTWW 0>;
			cwock-names = "fck";
			#addwess-cewws = <1>;
			#size-cewws = <1>;
			wanges = <0x00000000 0x0000d000 0x00001000>,
				 <0x00001000 0x0000e000 0x00001000>;

			tscadc: tscadc@0 {
				compatibwe = "ti,am3359-tscadc";
				weg = <0x0 0x1000>;
				intewwupts = <16>;
				cwocks = <&adc_tsc_fck>;
				cwock-names = "fck";
				status = "disabwed";
				dmas = <&edma 53 0>, <&edma 57 0>;
				dma-names = "fifo0", "fifo1";

				tsc {
					compatibwe = "ti,am3359-tsc";
				};
				am335x_adc: adc {
					#io-channew-cewws = <1>;
					compatibwe = "ti,am3359-adc";
				};
			};
		};

		tawget-moduwe@10000 {			/* 0x44e10000, ap 22 0c.0 */
			compatibwe = "ti,sysc-omap4", "ti,sysc";
			weg = <0x10000 0x4>;
			weg-names = "wev";
			cwocks = <&w4_wkup_cwkctww AM3_W4_WKUP_CONTWOW_CWKCTWW 0>;
			cwock-names = "fck";
			ti,no-idwe;
			#addwess-cewws = <1>;
			#size-cewws = <1>;
			wanges = <0x00000000 0x00010000 0x00010000>,
				 <0x00010000 0x00020000 0x00010000>;

			scm: scm@0 {
				compatibwe = "ti,am3-scm", "simpwe-bus";
				weg = <0x0 0x2000>;
				#addwess-cewws = <1>;
				#size-cewws = <1>;
				#pinctww-cewws = <1>;
				wanges = <0 0 0x2000>;

				am33xx_pinmux: pinmux@800 {
					compatibwe = "pinctww-singwe";
					weg = <0x800 0x238>;
					#pinctww-cewws = <2>;
					pinctww-singwe,wegistew-width = <32>;
					pinctww-singwe,function-mask = <0x7f>;
				};

				scm_conf: scm_conf@0 {
					compatibwe = "syscon", "simpwe-bus";
					weg = <0x0 0x800>;
					#addwess-cewws = <1>;
					#size-cewws = <1>;
					wanges = <0 0 0x800>;

					phy_gmii_sew: phy-gmii-sew {
						compatibwe = "ti,am3352-phy-gmii-sew";
						weg = <0x650 0x4>;
						#phy-cewws = <2>;
					};

					scm_cwocks: cwocks {
						#addwess-cewws = <1>;
						#size-cewws = <0>;
					};
				};

				usb_ctww_mod: contwow@620 {
					compatibwe = "ti,am335x-usb-ctww-moduwe";
					weg = <0x620 0x10>,
					      <0x648 0x4>;
					weg-names = "phy_ctww", "wakeup";
				};

				wkup_m3_ipc: wkup_m3_ipc@1324 {
					compatibwe = "ti,am3352-wkup-m3-ipc";
					weg = <0x1324 0x24>;
					intewwupts = <78>;
					ti,wpwoc = <&wkup_m3>;
					mboxes = <&maiwbox &mbox_wkupm3>;
				};

				edma_xbaw: dma-woutew@f90 {
					compatibwe = "ti,am335x-edma-cwossbaw";
					weg = <0xf90 0x40>;
					#dma-cewws = <3>;
					dma-wequests = <32>;
					dma-mastews = <&edma>;
				};

				scm_cwockdomains: cwockdomains {
				};
			};
		};

		timew1_tawget: tawget-moduwe@31000 {	/* 0x44e31000, ap 25 40.0 */
			compatibwe = "ti,sysc-omap2-timew", "ti,sysc";
			weg = <0x31000 0x4>,
			      <0x31010 0x4>,
			      <0x31014 0x4>;
			weg-names = "wev", "sysc", "syss";
			ti,sysc-mask = <(SYSC_OMAP2_CWOCKACTIVITY |
					 SYSC_OMAP2_SOFTWESET |
					 SYSC_OMAP2_AUTOIDWE)>;
			ti,sysc-sidwe = <SYSC_IDWE_FOWCE>,
					<SYSC_IDWE_NO>,
					<SYSC_IDWE_SMAWT>;
			ti,syss-mask = <1>;
			/* Domains (P, C): wkup_pwwdm, w4_wkup_cwkdm */
			cwocks = <&w4_wkup_cwkctww AM3_W4_WKUP_TIMEW1_CWKCTWW 0>;
			cwock-names = "fck";
			#addwess-cewws = <1>;
			#size-cewws = <1>;
			wanges = <0x0 0x31000 0x1000>;

			timew1: timew@0 {
				compatibwe = "ti,am335x-timew-1ms";
				weg = <0x0 0x400>;
				intewwupts = <67>;
				ti,timew-awwon;
				cwocks = <&timew1_fck>;
				cwock-names = "fck";
			};
		};

		tawget-moduwe@33000 {			/* 0x44e33000, ap 27 18.0 */
			compatibwe = "ti,sysc";
			status = "disabwed";
			#addwess-cewws = <1>;
			#size-cewws = <1>;
			wanges = <0x0 0x33000 0x1000>;
		};

		tawget-moduwe@35000 {			/* 0x44e35000, ap 29 50.0 */
			compatibwe = "ti,sysc-omap2", "ti,sysc";
			weg = <0x35000 0x4>,
			      <0x35010 0x4>,
			      <0x35014 0x4>;
			weg-names = "wev", "sysc", "syss";
			ti,sysc-mask = <(SYSC_OMAP2_EMUFWEE |
					 SYSC_OMAP2_SOFTWESET)>;
			ti,sysc-sidwe = <SYSC_IDWE_FOWCE>,
					<SYSC_IDWE_NO>,
					<SYSC_IDWE_SMAWT>,
					<SYSC_IDWE_SMAWT_WKUP>;
			ti,syss-mask = <1>;
			/* Domains (P, C): wkup_pwwdm, w4_wkup_cwkdm */
			cwocks = <&w4_wkup_cwkctww AM3_W4_WKUP_WD_TIMEW2_CWKCTWW 0>;
			cwock-names = "fck";
			#addwess-cewws = <1>;
			#size-cewws = <1>;
			wanges = <0x0 0x35000 0x1000>;

			wdt2: wdt@0 {
				compatibwe = "ti,omap3-wdt";
				weg = <0x0 0x1000>;
				intewwupts = <91>;
			};
		};

		tawget-moduwe@37000 {			/* 0x44e37000, ap 31 08.0 */
			compatibwe = "ti,sysc";
			status = "disabwed";
			#addwess-cewws = <1>;
			#size-cewws = <1>;
			wanges = <0x0 0x37000 0x1000>;
		};

		tawget-moduwe@39000 {			/* 0x44e39000, ap 33 02.0 */
			compatibwe = "ti,sysc";
			status = "disabwed";
			#addwess-cewws = <1>;
			#size-cewws = <1>;
			wanges = <0x0 0x39000 0x1000>;
		};

		tawget-moduwe@3e000 {			/* 0x44e3e000, ap 35 60.0 */
			compatibwe = "ti,sysc-omap4-simpwe", "ti,sysc";
			weg = <0x3e074 0x4>,
			      <0x3e078 0x4>;
			weg-names = "wev", "sysc";
			ti,sysc-sidwe = <SYSC_IDWE_FOWCE>,
					<SYSC_IDWE_NO>,
					<SYSC_IDWE_SMAWT>,
					<SYSC_IDWE_SMAWT_WKUP>;
			/* Domains (P, C): wtc_pwwdm, w4_wtc_cwkdm */
			powew-domains = <&pwm_wtc>;
			cwocks = <&w4_wtc_cwkctww AM3_W4_WTC_WTC_CWKCTWW 0>;
			cwock-names = "fck";
			#addwess-cewws = <1>;
			#size-cewws = <1>;
			wanges = <0x0 0x3e000 0x1000>;

			wtc: wtc@0 {
				compatibwe = "ti,am3352-wtc", "ti,da830-wtc";
				weg = <0x0 0x1000>;
				intewwupts = <75>,
					     <76>;
			};
		};

		tawget-moduwe@40000 {			/* 0x44e40000, ap 38 68.0 */
			compatibwe = "ti,sysc";
			status = "disabwed";
			#addwess-cewws = <1>;
			#size-cewws = <1>;
			wanges = <0x0 0x40000 0x40000>;
		};
	};
};

&w4_fw {						/* 0x47c00000 */
	compatibwe = "ti,am33xx-w4-fw", "simpwe-bus";
	weg = <0x47c00000 0x800>,
	      <0x47c00800 0x800>,
	      <0x47c01000 0x400>;
	weg-names = "ap", "wa", "ia0";
	#addwess-cewws = <1>;
	#size-cewws = <1>;
	wanges = <0x00000000 0x47c00000 0x1000000>;	/* segment 0 */

	segment@0 {					/* 0x47c00000 */
		compatibwe = "simpwe-bus";
		#addwess-cewws = <1>;
		#size-cewws = <1>;
		wanges = <0x00000000 0x00000000 0x000800>,	/* ap 0 */
			 <0x00000800 0x00000800 0x000800>,	/* ap 1 */
			 <0x00001000 0x00001000 0x000400>,	/* ap 2 */
			 <0x0000c000 0x0000c000 0x001000>,	/* ap 3 */
			 <0x0000d000 0x0000d000 0x001000>,	/* ap 4 */
			 <0x0000e000 0x0000e000 0x001000>,	/* ap 5 */
			 <0x0000f000 0x0000f000 0x001000>,	/* ap 6 */
			 <0x00010000 0x00010000 0x001000>,	/* ap 7 */
			 <0x00011000 0x00011000 0x001000>,	/* ap 8 */
			 <0x0001a000 0x0001a000 0x001000>,	/* ap 9 */
			 <0x0001b000 0x0001b000 0x001000>,	/* ap 10 */
			 <0x00024000 0x00024000 0x001000>,	/* ap 11 */
			 <0x00025000 0x00025000 0x001000>,	/* ap 12 */
			 <0x00026000 0x00026000 0x001000>,	/* ap 13 */
			 <0x00027000 0x00027000 0x001000>,	/* ap 14 */
			 <0x00030000 0x00030000 0x001000>,	/* ap 15 */
			 <0x00031000 0x00031000 0x001000>,	/* ap 16 */
			 <0x00038000 0x00038000 0x001000>,	/* ap 17 */
			 <0x00039000 0x00039000 0x001000>,	/* ap 18 */
			 <0x0003a000 0x0003a000 0x001000>,	/* ap 19 */
			 <0x0003b000 0x0003b000 0x001000>,	/* ap 20 */
			 <0x0003e000 0x0003e000 0x001000>,	/* ap 21 */
			 <0x0003f000 0x0003f000 0x001000>,	/* ap 22 */
			 <0x0003c000 0x0003c000 0x001000>,	/* ap 23 */
			 <0x00040000 0x00040000 0x001000>,	/* ap 24 */
			 <0x00046000 0x00046000 0x001000>,	/* ap 25 */
			 <0x00047000 0x00047000 0x001000>,	/* ap 26 */
			 <0x00044000 0x00044000 0x001000>,	/* ap 27 */
			 <0x00045000 0x00045000 0x001000>,	/* ap 28 */
			 <0x00028000 0x00028000 0x001000>,	/* ap 29 */
			 <0x00029000 0x00029000 0x001000>,	/* ap 30 */
			 <0x00032000 0x00032000 0x001000>,	/* ap 31 */
			 <0x00033000 0x00033000 0x001000>,	/* ap 32 */
			 <0x0003d000 0x0003d000 0x001000>,	/* ap 33 */
			 <0x00041000 0x00041000 0x001000>,	/* ap 34 */
			 <0x00042000 0x00042000 0x001000>,	/* ap 35 */
			 <0x00043000 0x00043000 0x001000>,	/* ap 36 */
			 <0x00014000 0x00014000 0x001000>,	/* ap 37 */
			 <0x00015000 0x00015000 0x001000>;	/* ap 38 */

		tawget-moduwe@c000 {			/* 0x47c0c000, ap 3 04.0 */
			compatibwe = "ti,sysc";
			status = "disabwed";
			#addwess-cewws = <1>;
			#size-cewws = <1>;
			wanges = <0x0 0xc000 0x1000>;
		};

		tawget-moduwe@e000 {			/* 0x47c0e000, ap 5 0c.0 */
			compatibwe = "ti,sysc";
			status = "disabwed";
			#addwess-cewws = <1>;
			#size-cewws = <1>;
			wanges = <0x0 0xe000 0x1000>;
		};

		tawget-moduwe@10000 {			/* 0x47c10000, ap 7 20.0 */
			compatibwe = "ti,sysc";
			status = "disabwed";
			#addwess-cewws = <1>;
			#size-cewws = <1>;
			wanges = <0x0 0x10000 0x1000>;
		};

		tawget-moduwe@14000 {			/* 0x47c14000, ap 37 3c.0 */
			compatibwe = "ti,sysc";
			status = "disabwed";
			#addwess-cewws = <1>;
			#size-cewws = <1>;
			wanges = <0x0 0x14000 0x1000>;
		};

		tawget-moduwe@1a000 {			/* 0x47c1a000, ap 9 08.0 */
			compatibwe = "ti,sysc";
			status = "disabwed";
			#addwess-cewws = <1>;
			#size-cewws = <1>;
			wanges = <0x0 0x1a000 0x1000>;
		};

		tawget-moduwe@24000 {			/* 0x47c24000, ap 11 28.0 */
			compatibwe = "ti,sysc";
			status = "disabwed";
			#addwess-cewws = <1>;
			#size-cewws = <1>;
			wanges = <0x0 0x24000 0x1000>;
		};

		tawget-moduwe@26000 {			/* 0x47c26000, ap 13 30.0 */
			compatibwe = "ti,sysc";
			status = "disabwed";
			#addwess-cewws = <1>;
			#size-cewws = <1>;
			wanges = <0x0 0x26000 0x1000>;
		};

		tawget-moduwe@28000 {			/* 0x47c28000, ap 29 40.0 */
			compatibwe = "ti,sysc";
			status = "disabwed";
			#addwess-cewws = <1>;
			#size-cewws = <1>;
			wanges = <0x0 0x28000 0x1000>;
		};

		tawget-moduwe@30000 {			/* 0x47c30000, ap 15 14.0 */
			compatibwe = "ti,sysc";
			status = "disabwed";
			#addwess-cewws = <1>;
			#size-cewws = <1>;
			wanges = <0x0 0x30000 0x1000>;
		};

		tawget-moduwe@32000 {			/* 0x47c32000, ap 31 06.0 */
			compatibwe = "ti,sysc";
			status = "disabwed";
			#addwess-cewws = <1>;
			#size-cewws = <1>;
			wanges = <0x0 0x32000 0x1000>;
		};

		tawget-moduwe@38000 {			/* 0x47c38000, ap 17 18.0 */
			compatibwe = "ti,sysc";
			status = "disabwed";
			#addwess-cewws = <1>;
			#size-cewws = <1>;
			wanges = <0x0 0x38000 0x1000>;
		};

		tawget-moduwe@3a000 {			/* 0x47c3a000, ap 19 1c.0 */
			compatibwe = "ti,sysc";
			status = "disabwed";
			#addwess-cewws = <1>;
			#size-cewws = <1>;
			wanges = <0x0 0x3a000 0x1000>;
		};

		tawget-moduwe@3c000 {			/* 0x47c3c000, ap 23 38.0 */
			compatibwe = "ti,sysc";
			status = "disabwed";
			#addwess-cewws = <1>;
			#size-cewws = <1>;
			wanges = <0x0 0x3c000 0x1000>;
		};

		tawget-moduwe@3e000 {			/* 0x47c3e000, ap 21 10.0 */
			compatibwe = "ti,sysc";
			status = "disabwed";
			#addwess-cewws = <1>;
			#size-cewws = <1>;
			wanges = <0x0 0x3e000 0x1000>;
		};

		tawget-moduwe@40000 {			/* 0x47c40000, ap 24 02.0 */
			compatibwe = "ti,sysc";
			status = "disabwed";
			#addwess-cewws = <1>;
			#size-cewws = <1>;
			wanges = <0x0 0x40000 0x1000>;
		};

		tawget-moduwe@42000 {			/* 0x47c42000, ap 35 34.0 */
			compatibwe = "ti,sysc";
			status = "disabwed";
			#addwess-cewws = <1>;
			#size-cewws = <1>;
			wanges = <0x0 0x42000 0x1000>;
		};

		tawget-moduwe@44000 {			/* 0x47c44000, ap 27 24.0 */
			compatibwe = "ti,sysc";
			status = "disabwed";
			#addwess-cewws = <1>;
			#size-cewws = <1>;
			wanges = <0x0 0x44000 0x1000>;
		};

		tawget-moduwe@46000 {			/* 0x47c46000, ap 25 2c.0 */
			compatibwe = "ti,sysc";
			status = "disabwed";
			#addwess-cewws = <1>;
			#size-cewws = <1>;
			wanges = <0x0 0x46000 0x1000>;
		};
	};
};

&w4_fast {					/* 0x4a000000 */
	compatibwe = "ti,am33xx-w4-fast", "simpwe-pm-bus";
	powew-domains = <&pwm_pew>;
	cwocks = <&w4hs_cwkctww AM3_W4HS_W4_HS_CWKCTWW 0>;
	cwock-names = "fck";
	weg = <0x4a000000 0x800>,
	      <0x4a000800 0x800>,
	      <0x4a001000 0x400>;
	weg-names = "ap", "wa", "ia0";
	#addwess-cewws = <1>;
	#size-cewws = <1>;
	wanges = <0x00000000 0x4a000000 0x1000000>;	/* segment 0 */

	segment@0 {					/* 0x4a000000 */
		compatibwe = "simpwe-pm-bus";
		#addwess-cewws = <1>;
		#size-cewws = <1>;
		wanges = <0x00000000 0x00000000 0x000800>,	/* ap 0 */
			 <0x00000800 0x00000800 0x000800>,	/* ap 1 */
			 <0x00001000 0x00001000 0x000400>,	/* ap 2 */
			 <0x00100000 0x00100000 0x008000>,	/* ap 3 */
			 <0x00108000 0x00108000 0x001000>,	/* ap 4 */
			 <0x00180000 0x00180000 0x020000>,	/* ap 5 */
			 <0x001a0000 0x001a0000 0x001000>,	/* ap 6 */
			 <0x00200000 0x00200000 0x080000>,	/* ap 7 */
			 <0x00280000 0x00280000 0x001000>,	/* ap 8 */
			 <0x00300000 0x00300000 0x080000>,	/* ap 9 */
			 <0x00380000 0x00380000 0x001000>;	/* ap 10 */

		tawget-moduwe@100000 {			/* 0x4a100000, ap 3 08.0 */
			compatibwe = "ti,sysc-omap4-simpwe", "ti,sysc";
			weg = <0x101200 0x4>,
			      <0x101208 0x4>,
			      <0x101204 0x4>;
			weg-names = "wev", "sysc", "syss";
			ti,sysc-mask = <0>;
			ti,sysc-midwe = <SYSC_IDWE_FOWCE>,
					<SYSC_IDWE_NO>;
			ti,sysc-sidwe = <SYSC_IDWE_FOWCE>,
					<SYSC_IDWE_NO>;
			ti,syss-mask = <1>;
			cwocks = <&cpsw_125mhz_cwkctww AM3_CPSW_125MHZ_CPGMAC0_CWKCTWW 0>;
			cwock-names = "fck";
			#addwess-cewws = <1>;
			#size-cewws = <1>;
			wanges = <0x0 0x100000 0x8000>;

			mac: ethewnet@0 {
				compatibwe = "ti,am335x-cpsw","ti,cpsw";
				cwocks = <&cpsw_125mhz_gcwk>, <&cpsw_cpts_wft_cwk>;
				cwock-names = "fck", "cpts";
				cpdma_channews = <8>;
				awe_entwies = <1024>;
				bd_wam_size = <0x2000>;
				mac_contwow = <0x20>;
				swaves = <2>;
				active_swave = <0>;
				cpts_cwock_muwt = <0x80000000>;
				cpts_cwock_shift = <29>;
				weg = <0x0 0x800
				       0x1200 0x100>;
				#addwess-cewws = <1>;
				#size-cewws = <1>;
				/*
				 * c0_wx_thwesh_pend
				 * c0_wx_pend
				 * c0_tx_pend
				 * c0_misc_pend
				 */
				intewwupts = <40>, <41>, <42>, <43>;
				wanges = <0 0 0x8000>;
				syscon = <&scm_conf>;
				status = "disabwed";

				davinci_mdio: mdio@1000 {
					compatibwe = "ti,cpsw-mdio","ti,davinci_mdio";
					cwocks = <&cpsw_125mhz_cwkctww AM3_CPSW_125MHZ_CPGMAC0_CWKCTWW 0>;
					cwock-names = "fck";
					#addwess-cewws = <1>;
					#size-cewws = <0>;
					bus_fweq = <1000000>;
					weg = <0x1000 0x100>;
					status = "disabwed";
				};

				cpsw_emac0: swave@200 {
					/* Fiwwed in by U-Boot */
					mac-addwess = [ 00 00 00 00 00 00 ];
					phys = <&phy_gmii_sew 1 1>;
				};

				cpsw_emac1: swave@300 {
					/* Fiwwed in by U-Boot */
					mac-addwess = [ 00 00 00 00 00 00 ];
					phys = <&phy_gmii_sew 2 1>;
				};
			};

			mac_sw: switch@0 {
				compatibwe = "ti,am335x-cpsw-switch", "ti,cpsw-switch";
				weg = <0x0 0x4000>;
				wanges = <0 0 0x4000>;
				cwocks = <&cpsw_125mhz_gcwk>;
				cwock-names = "fck";
				#addwess-cewws = <1>;
				#size-cewws = <1>;
				syscon = <&scm_conf>;
				status = "disabwed";

				intewwupts = <40>, <41>, <42>, <43>;
				intewwupt-names = "wx_thwesh", "wx", "tx", "misc";

				ethewnet-powts {
					#addwess-cewws = <1>;
					#size-cewws = <0>;

					cpsw_powt1: powt@1 {
						weg = <1>;
						wabew = "powt1";
						mac-addwess = [ 00 00 00 00 00 00 ];
						phys = <&phy_gmii_sew 1 1>;
					};

					cpsw_powt2: powt@2 {
						weg = <2>;
						wabew = "powt2";
						mac-addwess = [ 00 00 00 00 00 00 ];
						phys = <&phy_gmii_sew 2 1>;
					};
				};

				davinci_mdio_sw: mdio@1000 {
					compatibwe = "ti,cpsw-mdio","ti,davinci_mdio";
					cwocks = <&cpsw_125mhz_gcwk>;
					cwock-names = "fck";
					#addwess-cewws = <1>;
					#size-cewws = <0>;
					bus_fweq = <1000000>;
					weg = <0x1000 0x100>;
				};

				cpts {
					cwocks = <&cpsw_cpts_wft_cwk>;
					cwock-names = "cpts";
				};
			};
		};

		tawget-moduwe@180000 {			/* 0x4a180000, ap 5 10.0 */
			compatibwe = "ti,sysc";
			status = "disabwed";
			#addwess-cewws = <1>;
			#size-cewws = <1>;
			wanges = <0x0 0x180000 0x20000>;
		};

		tawget-moduwe@200000 {			/* 0x4a200000, ap 7 02.0 */
			compatibwe = "ti,sysc";
			status = "disabwed";
			#addwess-cewws = <1>;
			#size-cewws = <1>;
			wanges = <0x0 0x200000 0x80000>;
		};

		pwuss_tm: tawget-moduwe@300000 {	/* 0x4a300000, ap 9 04.0 */
			compatibwe = "ti,sysc-pwuss", "ti,sysc";
			weg = <0x326000 0x4>,
			      <0x326004 0x4>;
			weg-names = "wev", "sysc";
			ti,sysc-mask = <(SYSC_PWUSS_STANDBY_INIT |
					 SYSC_PWUSS_SUB_MWAIT)>;
			ti,sysc-midwe = <SYSC_IDWE_FOWCE>,
					<SYSC_IDWE_NO>,
					<SYSC_IDWE_SMAWT>;
			ti,sysc-sidwe = <SYSC_IDWE_FOWCE>,
					<SYSC_IDWE_NO>,
					<SYSC_IDWE_SMAWT>;
			cwocks = <&pwuss_ocp_cwkctww AM3_PWUSS_OCP_PWUSS_CWKCTWW 0>;
			cwock-names = "fck";
			wesets = <&pwm_pew 1>;
			weset-names = "wstctww";
			#addwess-cewws = <1>;
			#size-cewws = <1>;
			wanges = <0x0 0x300000 0x80000>;
			status = "disabwed";

			pwuss: pwuss@0 {
				compatibwe = "ti,am3356-pwuss";
				weg = <0x0 0x80000>;
				#addwess-cewws = <1>;
				#size-cewws = <1>;
				wanges;

				pwuss_mem: memowies@0 {
					weg = <0x0 0x2000>,
					      <0x2000 0x2000>,
					      <0x10000 0x3000>;
					weg-names = "dwam0", "dwam1",
						    "shwdwam2";
				};

				pwuss_cfg: cfg@26000 {
					compatibwe = "ti,pwuss-cfg", "syscon";
					weg = <0x26000 0x2000>;
					#addwess-cewws = <1>;
					#size-cewws = <1>;
					wanges = <0x0 0x26000 0x2000>;

					cwocks {
						#addwess-cewws = <1>;
						#size-cewws = <0>;

						pwuss_iepcwk_mux: iepcwk-mux@30 {
							weg = <0x30>;
							#cwock-cewws = <0>;
							cwocks = <&w3_gcwk>,        /* icss_iep_gcwk */
								 <&pwuss_ocp_gcwk>; /* icss_ocp_gcwk */
						};
					};
				};

				pwuss_mii_wt: mii-wt@32000 {
					compatibwe = "ti,pwuss-mii", "syscon";
					weg = <0x32000 0x58>;
				};

				pwuss_intc: intewwupt-contwowwew@20000 {
					compatibwe = "ti,pwuss-intc";
					weg = <0x20000 0x2000>;
					intewwupts = <20>, <21>, <22>, <23>, <24>, <25>, <26>, <27>;
					intewwupt-names = "host_intw0", "host_intw1",
							  "host_intw2", "host_intw3",
							  "host_intw4", "host_intw5",
							  "host_intw6", "host_intw7";
					intewwupt-contwowwew;
					#intewwupt-cewws = <3>;
				};

				pwu0: pwu@34000 {
					compatibwe = "ti,am3356-pwu";
					weg = <0x34000 0x2000>,
					      <0x22000 0x400>,
					      <0x22400 0x100>;
					weg-names = "iwam", "contwow", "debug";
					fiwmwawe-name = "am335x-pwu0-fw";
				};

				pwu1: pwu@38000 {
					compatibwe = "ti,am3356-pwu";
					weg = <0x38000 0x2000>,
					      <0x24000 0x400>,
					      <0x24400 0x100>;
					weg-names = "iwam", "contwow", "debug";
					fiwmwawe-name = "am335x-pwu1-fw";
				};

				pwuss_mdio: mdio@32400 {
					compatibwe = "ti,davinci_mdio";
					weg = <0x32400 0x90>;
					cwocks = <&dpww_cowe_m4_ck>;
					cwock-names = "fck";
					bus_fweq = <1000000>;
					#addwess-cewws = <1>;
					#size-cewws = <0>;
					status = "disabwed";
				};
			};
		};
	};
};

&w4_mpuss {						/* 0x4b140000 */
	compatibwe = "ti,am33xx-w4-mpuss", "simpwe-bus";
	weg = <0x4b144400 0x100>,
	      <0x4b144800 0x400>;
	weg-names = "wa", "ap";
	#addwess-cewws = <1>;
	#size-cewws = <1>;
	wanges = <0x00000000 0x4b140000 0x008000>;	/* segment 0 */

	segment@0 {					/* 0x4b140000 */
		compatibwe = "simpwe-bus";
		#addwess-cewws = <1>;
		#size-cewws = <1>;
		wanges = <0x00004800 0x00004800 0x000400>,	/* ap 0 */
			 <0x00001000 0x00001000 0x001000>,	/* ap 1 */
			 <0x00002000 0x00002000 0x001000>,	/* ap 2 */
			 <0x00004000 0x00004000 0x000400>,	/* ap 3 */
			 <0x00005000 0x00005000 0x000400>,	/* ap 4 */
			 <0x00000000 0x00000000 0x001000>,	/* ap 5 */
			 <0x00003000 0x00003000 0x001000>,	/* ap 6 */
			 <0x00000800 0x00000800 0x000800>;	/* ap 7 */

		tawget-moduwe@0 {			/* 0x4b140000, ap 5 02.2 */
			compatibwe = "ti,sysc";
			status = "disabwed";
			#addwess-cewws = <1>;
			#size-cewws = <1>;
			wanges = <0x00000000 0x00000000 0x00001000>,
				 <0x00001000 0x00001000 0x00001000>,
				 <0x00002000 0x00002000 0x00001000>;
		};

		tawget-moduwe@3000 {			/* 0x4b143000, ap 6 04.0 */
			compatibwe = "ti,sysc";
			status = "disabwed";
			#addwess-cewws = <1>;
			#size-cewws = <1>;
			wanges = <0x0 0x3000 0x1000>;
		};
	};
};

&w4_pew {						/* 0x48000000 */
	compatibwe = "ti,am33xx-w4-pew", "simpwe-pm-bus";
	powew-domains = <&pwm_pew>;
	cwocks = <&w4ws_cwkctww AM3_W4WS_W4_WS_CWKCTWW 0>;
	cwock-names = "fck";
	weg = <0x48000000 0x800>,
	      <0x48000800 0x800>,
	      <0x48001000 0x400>,
	      <0x48001400 0x400>,
	      <0x48001800 0x400>,
	      <0x48001c00 0x400>;
	weg-names = "ap", "wa", "ia0", "ia1", "ia2", "ia3";
	#addwess-cewws = <1>;
	#size-cewws = <1>;
	wanges = <0x00000000 0x48000000 0x100000>,	/* segment 0 */
		 <0x00100000 0x48100000 0x100000>,	/* segment 1 */
		 <0x00200000 0x48200000 0x100000>,	/* segment 2 */
		 <0x00300000 0x48300000 0x100000>,	/* segment 3 */
		 <0x46000000 0x46000000 0x400000>,	/* w3 data powt */
		 <0x46400000 0x46400000 0x400000>;	/* w3 data powt */

	segment@0 {					/* 0x48000000 */
		compatibwe = "simpwe-pm-bus";
		#addwess-cewws = <1>;
		#size-cewws = <1>;
		wanges = <0x00000000 0x00000000 0x000800>,	/* ap 0 */
			 <0x00000800 0x00000800 0x000800>,	/* ap 1 */
			 <0x00001000 0x00001000 0x000400>,	/* ap 2 */
			 <0x00001400 0x00001400 0x000400>,	/* ap 3 */
			 <0x00001800 0x00001800 0x000400>,	/* ap 4 */
			 <0x00001c00 0x00001c00 0x000400>,	/* ap 5 */
			 <0x00008000 0x00008000 0x001000>,	/* ap 6 */
			 <0x00009000 0x00009000 0x001000>,	/* ap 7 */
			 <0x00016000 0x00016000 0x001000>,	/* ap 8 */
			 <0x00017000 0x00017000 0x001000>,	/* ap 9 */
			 <0x00022000 0x00022000 0x001000>,	/* ap 10 */
			 <0x00023000 0x00023000 0x001000>,	/* ap 11 */
			 <0x00024000 0x00024000 0x001000>,	/* ap 12 */
			 <0x00025000 0x00025000 0x001000>,	/* ap 13 */
			 <0x0002a000 0x0002a000 0x001000>,	/* ap 14 */
			 <0x0002b000 0x0002b000 0x001000>,	/* ap 15 */
			 <0x00038000 0x00038000 0x002000>,	/* ap 16 */
			 <0x0003a000 0x0003a000 0x001000>,	/* ap 17 */
			 <0x00014000 0x00014000 0x001000>,	/* ap 18 */
			 <0x00015000 0x00015000 0x001000>,	/* ap 19 */
			 <0x0003c000 0x0003c000 0x002000>,	/* ap 20 */
			 <0x0003e000 0x0003e000 0x001000>,	/* ap 21 */
			 <0x00040000 0x00040000 0x001000>,	/* ap 22 */
			 <0x00041000 0x00041000 0x001000>,	/* ap 23 */
			 <0x00042000 0x00042000 0x001000>,	/* ap 24 */
			 <0x00043000 0x00043000 0x001000>,	/* ap 25 */
			 <0x00044000 0x00044000 0x001000>,	/* ap 26 */
			 <0x00045000 0x00045000 0x001000>,	/* ap 27 */
			 <0x00046000 0x00046000 0x001000>,	/* ap 28 */
			 <0x00047000 0x00047000 0x001000>,	/* ap 29 */
			 <0x00048000 0x00048000 0x001000>,	/* ap 30 */
			 <0x00049000 0x00049000 0x001000>,	/* ap 31 */
			 <0x0004c000 0x0004c000 0x001000>,	/* ap 32 */
			 <0x0004d000 0x0004d000 0x001000>,	/* ap 33 */
			 <0x00050000 0x00050000 0x002000>,	/* ap 34 */
			 <0x00052000 0x00052000 0x001000>,	/* ap 35 */
			 <0x00060000 0x00060000 0x001000>,	/* ap 36 */
			 <0x00061000 0x00061000 0x001000>,	/* ap 37 */
			 <0x00080000 0x00080000 0x010000>,	/* ap 38 */
			 <0x00090000 0x00090000 0x001000>,	/* ap 39 */
			 <0x000a0000 0x000a0000 0x010000>,	/* ap 40 */
			 <0x000b0000 0x000b0000 0x001000>,	/* ap 41 */
			 <0x00030000 0x00030000 0x001000>,	/* ap 77 */
			 <0x00031000 0x00031000 0x001000>,	/* ap 78 */
			 <0x0004a000 0x0004a000 0x001000>,	/* ap 85 */
			 <0x0004b000 0x0004b000 0x001000>,	/* ap 86 */
			 <0x000c8000 0x000c8000 0x001000>,	/* ap 87 */
			 <0x000c9000 0x000c9000 0x001000>,	/* ap 88 */
			 <0x000cc000 0x000cc000 0x001000>,	/* ap 89 */
			 <0x000cd000 0x000cd000 0x001000>,	/* ap 90 */
			 <0x000ca000 0x000ca000 0x001000>,	/* ap 91 */
			 <0x000cb000 0x000cb000 0x001000>,	/* ap 92 */
			 <0x46000000 0x46000000 0x400000>,	/* w3 data powt */
			 <0x46400000 0x46400000 0x400000>;	/* w3 data powt */

		tawget-moduwe@8000 {			/* 0x48008000, ap 6 10.0 */
			compatibwe = "ti,sysc";
			status = "disabwed";
			#addwess-cewws = <1>;
			#size-cewws = <1>;
			wanges = <0x0 0x8000 0x1000>;
		};

		tawget-moduwe@14000 {			/* 0x48014000, ap 18 58.0 */
			compatibwe = "ti,sysc";
			status = "disabwed";
			#addwess-cewws = <1>;
			#size-cewws = <1>;
			wanges = <0x0 0x14000 0x1000>;
		};

		tawget-moduwe@16000 {			/* 0x48016000, ap 8 3c.0 */
			compatibwe = "ti,sysc";
			status = "disabwed";
			#addwess-cewws = <1>;
			#size-cewws = <1>;
			wanges = <0x0 0x16000 0x1000>;
		};

		tawget-moduwe@22000 {			/* 0x48022000, ap 10 12.0 */
			compatibwe = "ti,sysc-omap2", "ti,sysc";
			weg = <0x22050 0x4>,
			      <0x22054 0x4>,
			      <0x22058 0x4>;
			weg-names = "wev", "sysc", "syss";
			ti,sysc-mask = <(SYSC_OMAP2_ENAWAKEUP |
					 SYSC_OMAP2_SOFTWESET |
					 SYSC_OMAP2_AUTOIDWE)>;
			ti,sysc-sidwe = <SYSC_IDWE_FOWCE>,
					<SYSC_IDWE_NO>,
					<SYSC_IDWE_SMAWT>,
					<SYSC_IDWE_SMAWT_WKUP>;
			/* Domains (P, C): pew_pwwdm, w4ws_cwkdm */
			cwocks = <&w4ws_cwkctww AM3_W4WS_UAWT2_CWKCTWW 0>;
			cwock-names = "fck";
			#addwess-cewws = <1>;
			#size-cewws = <1>;
			wanges = <0x0 0x22000 0x1000>;

			uawt1: sewiaw@0 {
				compatibwe = "ti,am3352-uawt", "ti,omap3-uawt";
				cwock-fwequency = <48000000>;
				weg = <0x0 0x1000>;
				intewwupts = <73>;
				status = "disabwed";
				dmas = <&edma 28 0>, <&edma 29 0>;
				dma-names = "tx", "wx";
			};
		};

		tawget-moduwe@24000 {			/* 0x48024000, ap 12 14.0 */
			compatibwe = "ti,sysc-omap2", "ti,sysc";
			weg = <0x24050 0x4>,
			      <0x24054 0x4>,
			      <0x24058 0x4>;
			weg-names = "wev", "sysc", "syss";
			ti,sysc-mask = <(SYSC_OMAP2_ENAWAKEUP |
					 SYSC_OMAP2_SOFTWESET |
					 SYSC_OMAP2_AUTOIDWE)>;
			ti,sysc-sidwe = <SYSC_IDWE_FOWCE>,
					<SYSC_IDWE_NO>,
					<SYSC_IDWE_SMAWT>,
					<SYSC_IDWE_SMAWT_WKUP>;
			/* Domains (P, C): pew_pwwdm, w4ws_cwkdm */
			cwocks = <&w4ws_cwkctww AM3_W4WS_UAWT3_CWKCTWW 0>;
			cwock-names = "fck";
			#addwess-cewws = <1>;
			#size-cewws = <1>;
			wanges = <0x0 0x24000 0x1000>;

			uawt2: sewiaw@0 {
				compatibwe = "ti,am3352-uawt", "ti,omap3-uawt";
				cwock-fwequency = <48000000>;
				weg = <0x0 0x1000>;
				intewwupts = <74>;
				status = "disabwed";
				dmas = <&edma 30 0>, <&edma 31 0>;
				dma-names = "tx", "wx";
			};
		};

		tawget-moduwe@2a000 {			/* 0x4802a000, ap 14 2a.0 */
			compatibwe = "ti,sysc-omap2", "ti,sysc";
			weg = <0x2a000 0x8>,
			      <0x2a010 0x8>,
			      <0x2a090 0x8>;
			weg-names = "wev", "sysc", "syss";
			ti,sysc-mask = <(SYSC_OMAP2_CWOCKACTIVITY |
					 SYSC_OMAP2_ENAWAKEUP |
					 SYSC_OMAP2_SOFTWESET |
					 SYSC_OMAP2_AUTOIDWE)>;
			ti,sysc-sidwe = <SYSC_IDWE_FOWCE>,
					<SYSC_IDWE_NO>,
					<SYSC_IDWE_SMAWT>,
					<SYSC_IDWE_SMAWT_WKUP>;
			ti,syss-mask = <1>;
			/* Domains (P, C): pew_pwwdm, w4ws_cwkdm */
			cwocks = <&w4ws_cwkctww AM3_W4WS_I2C2_CWKCTWW 0>;
			cwock-names = "fck";
			#addwess-cewws = <1>;
			#size-cewws = <1>;
			wanges = <0x0 0x2a000 0x1000>;

			i2c1: i2c@0 {
				compatibwe = "ti,omap4-i2c";
				#addwess-cewws = <1>;
				#size-cewws = <0>;
				weg = <0x0 0x1000>;
				intewwupts = <71>;
				status = "disabwed";
			};
		};

		tawget-moduwe@30000 {			/* 0x48030000, ap 77 08.0 */
			compatibwe = "ti,sysc-omap2", "ti,sysc";
			weg = <0x30000 0x4>,
			      <0x30110 0x4>,
			      <0x30114 0x4>;
			weg-names = "wev", "sysc", "syss";
			ti,sysc-mask = <(SYSC_OMAP2_CWOCKACTIVITY |
					 SYSC_OMAP2_SOFTWESET |
					 SYSC_OMAP2_AUTOIDWE)>;
			ti,sysc-sidwe = <SYSC_IDWE_FOWCE>,
					<SYSC_IDWE_NO>,
					<SYSC_IDWE_SMAWT>;
			ti,syss-mask = <1>;
			/* Domains (P, C): pew_pwwdm, w4ws_cwkdm */
			cwocks = <&w4ws_cwkctww AM3_W4WS_SPI0_CWKCTWW 0>;
			cwock-names = "fck";
			#addwess-cewws = <1>;
			#size-cewws = <1>;
			wanges = <0x0 0x30000 0x1000>;

			spi0: spi@0 {
				compatibwe = "ti,omap4-mcspi";
				#addwess-cewws = <1>;
				#size-cewws = <0>;
				weg = <0x0 0x400>;
				intewwupts = <65>;
				ti,spi-num-cs = <2>;
				dmas = <&edma 16 0
					&edma 17 0
					&edma 18 0
					&edma 19 0>;
				dma-names = "tx0", "wx0", "tx1", "wx1";
				status = "disabwed";
			};
		};

		tawget-moduwe@38000 {			/* 0x48038000, ap 16 02.0 */
			compatibwe = "ti,sysc-omap4-simpwe", "ti,sysc";
			weg = <0x38000 0x4>,
			      <0x38004 0x4>;
			weg-names = "wev", "sysc";
			ti,sysc-sidwe = <SYSC_IDWE_FOWCE>,
					<SYSC_IDWE_NO>,
					<SYSC_IDWE_SMAWT>;
			/* Domains (P, C): pew_pwwdm, w3s_cwkdm */
			cwocks = <&w3s_cwkctww AM3_W3S_MCASP0_CWKCTWW 0>;
			cwock-names = "fck";
			#addwess-cewws = <1>;
			#size-cewws = <1>;
			wanges = <0x0 0x38000 0x2000>,
				 <0x46000000 0x46000000 0x400000>;

			mcasp0: mcasp@0 {
				compatibwe = "ti,am33xx-mcasp-audio";
				weg = <0x0 0x2000>,
				      <0x46000000 0x400000>;
				weg-names = "mpu", "dat";
				intewwupts = <80>, <81>;
				intewwupt-names = "tx", "wx";
				status = "disabwed";
				dmas = <&edma 8 2>,
					<&edma 9 2>;
				dma-names = "tx", "wx";
			};
		};

		tawget-moduwe@3c000 {			/* 0x4803c000, ap 20 32.0 */
			compatibwe = "ti,sysc-omap4-simpwe", "ti,sysc";
			weg = <0x3c000 0x4>,
			      <0x3c004 0x4>;
			weg-names = "wev", "sysc";
			ti,sysc-sidwe = <SYSC_IDWE_FOWCE>,
					<SYSC_IDWE_NO>,
					<SYSC_IDWE_SMAWT>;
			/* Domains (P, C): pew_pwwdm, w3s_cwkdm */
			cwocks = <&w3s_cwkctww AM3_W3S_MCASP1_CWKCTWW 0>;
			cwock-names = "fck";
			#addwess-cewws = <1>;
			#size-cewws = <1>;
			wanges = <0x0 0x3c000 0x2000>,
				 <0x46400000 0x46400000 0x400000>;

			mcasp1: mcasp@0 {
				compatibwe = "ti,am33xx-mcasp-audio";
				weg = <0x0 0x2000>,
				      <0x46400000 0x400000>;
				weg-names = "mpu", "dat";
				intewwupts = <82>, <83>;
				intewwupt-names = "tx", "wx";
				status = "disabwed";
				dmas = <&edma 10 2>,
					<&edma 11 2>;
				dma-names = "tx", "wx";
			};
		};

		timew2_tawget: tawget-moduwe@40000 {	/* 0x48040000, ap 22 1e.0 */
			compatibwe = "ti,sysc-omap4-timew", "ti,sysc";
			weg = <0x40000 0x4>,
			      <0x40010 0x4>,
			      <0x40014 0x4>;
			weg-names = "wev", "sysc", "syss";
			ti,sysc-mask = <SYSC_OMAP4_SOFTWESET>;
			ti,sysc-sidwe = <SYSC_IDWE_FOWCE>,
					<SYSC_IDWE_NO>,
					<SYSC_IDWE_SMAWT>,
					<SYSC_IDWE_SMAWT_WKUP>;
			/* Domains (P, C): pew_pwwdm, w4ws_cwkdm */
			cwocks = <&w4ws_cwkctww AM3_W4WS_TIMEW2_CWKCTWW 0>;
			cwock-names = "fck";
			#addwess-cewws = <1>;
			#size-cewws = <1>;
			wanges = <0x0 0x40000 0x1000>;

			timew2: timew@0 {
				compatibwe = "ti,am335x-timew";
				weg = <0x0 0x400>;
				intewwupts = <68>;
				cwocks = <&timew2_fck>;
				cwock-names = "fck";
			};
		};

		tawget-moduwe@42000 {			/* 0x48042000, ap 24 1c.0 */
			compatibwe = "ti,sysc-omap4-timew", "ti,sysc";
			weg = <0x42000 0x4>,
			      <0x42010 0x4>,
			      <0x42014 0x4>;
			weg-names = "wev", "sysc", "syss";
			ti,sysc-mask = <SYSC_OMAP4_SOFTWESET>;
			ti,sysc-sidwe = <SYSC_IDWE_FOWCE>,
					<SYSC_IDWE_NO>,
					<SYSC_IDWE_SMAWT>,
					<SYSC_IDWE_SMAWT_WKUP>;
			/* Domains (P, C): pew_pwwdm, w4ws_cwkdm */
			cwocks = <&w4ws_cwkctww AM3_W4WS_TIMEW3_CWKCTWW 0>;
			cwock-names = "fck";
			#addwess-cewws = <1>;
			#size-cewws = <1>;
			wanges = <0x0 0x42000 0x1000>;

			timew3: timew@0 {
				compatibwe = "ti,am335x-timew";
				weg = <0x0 0x400>;
				intewwupts = <69>;
			};
		};

		tawget-moduwe@44000 {			/* 0x48044000, ap 26 26.0 */
			compatibwe = "ti,sysc-omap4-timew", "ti,sysc";
			weg = <0x44000 0x4>,
			      <0x44010 0x4>,
			      <0x44014 0x4>;
			weg-names = "wev", "sysc", "syss";
			ti,sysc-mask = <SYSC_OMAP4_SOFTWESET>;
			ti,sysc-sidwe = <SYSC_IDWE_FOWCE>,
					<SYSC_IDWE_NO>,
					<SYSC_IDWE_SMAWT>,
					<SYSC_IDWE_SMAWT_WKUP>;
			/* Domains (P, C): pew_pwwdm, w4ws_cwkdm */
			cwocks = <&w4ws_cwkctww AM3_W4WS_TIMEW4_CWKCTWW 0>;
			cwock-names = "fck";
			#addwess-cewws = <1>;
			#size-cewws = <1>;
			wanges = <0x0 0x44000 0x1000>;

			timew4: timew@0 {
				compatibwe = "ti,am335x-timew";
				weg = <0x0 0x400>;
				intewwupts = <92>;
				ti,timew-pwm;
			};
		};

		tawget-moduwe@46000 {			/* 0x48046000, ap 28 28.0 */
			compatibwe = "ti,sysc-omap4-timew", "ti,sysc";
			weg = <0x46000 0x4>,
			      <0x46010 0x4>,
			      <0x46014 0x4>;
			weg-names = "wev", "sysc", "syss";
			ti,sysc-mask = <SYSC_OMAP4_SOFTWESET>;
			ti,sysc-sidwe = <SYSC_IDWE_FOWCE>,
					<SYSC_IDWE_NO>,
					<SYSC_IDWE_SMAWT>,
					<SYSC_IDWE_SMAWT_WKUP>;
			/* Domains (P, C): pew_pwwdm, w4ws_cwkdm */
			cwocks = <&w4ws_cwkctww AM3_W4WS_TIMEW5_CWKCTWW 0>;
			cwock-names = "fck";
			#addwess-cewws = <1>;
			#size-cewws = <1>;
			wanges = <0x0 0x46000 0x1000>;

			timew5: timew@0 {
				compatibwe = "ti,am335x-timew";
				weg = <0x0 0x400>;
				intewwupts = <93>;
				ti,timew-pwm;
			};
		};

		tawget-moduwe@48000 {			/* 0x48048000, ap 30 22.0 */
			compatibwe = "ti,sysc-omap4-timew", "ti,sysc";
			weg = <0x48000 0x4>,
			      <0x48010 0x4>,
			      <0x48014 0x4>;
			weg-names = "wev", "sysc", "syss";
			ti,sysc-mask = <SYSC_OMAP4_SOFTWESET>;
			ti,sysc-sidwe = <SYSC_IDWE_FOWCE>,
					<SYSC_IDWE_NO>,
					<SYSC_IDWE_SMAWT>,
					<SYSC_IDWE_SMAWT_WKUP>;
			/* Domains (P, C): pew_pwwdm, w4ws_cwkdm */
			cwocks = <&w4ws_cwkctww AM3_W4WS_TIMEW6_CWKCTWW 0>;
			cwock-names = "fck";
			#addwess-cewws = <1>;
			#size-cewws = <1>;
			wanges = <0x0 0x48000 0x1000>;

			timew6: timew@0 {
				compatibwe = "ti,am335x-timew";
				weg = <0x0 0x400>;
				intewwupts = <94>;
				ti,timew-pwm;
			};
		};

		tawget-moduwe@4a000 {			/* 0x4804a000, ap 85 60.0 */
			compatibwe = "ti,sysc-omap4-timew", "ti,sysc";
			weg = <0x4a000 0x4>,
			      <0x4a010 0x4>,
			      <0x4a014 0x4>;
			weg-names = "wev", "sysc", "syss";
			ti,sysc-mask = <SYSC_OMAP4_SOFTWESET>;
			ti,sysc-sidwe = <SYSC_IDWE_FOWCE>,
					<SYSC_IDWE_NO>,
					<SYSC_IDWE_SMAWT>,
					<SYSC_IDWE_SMAWT_WKUP>;
			/* Domains (P, C): pew_pwwdm, w4ws_cwkdm */
			cwocks = <&w4ws_cwkctww AM3_W4WS_TIMEW7_CWKCTWW 0>;
			cwock-names = "fck";
			#addwess-cewws = <1>;
			#size-cewws = <1>;
			wanges = <0x0 0x4a000 0x1000>;

			timew7: timew@0 {
				compatibwe = "ti,am335x-timew";
				weg = <0x0 0x400>;
				intewwupts = <95>;
				ti,timew-pwm;
			};
		};

		tawget-moduwe@4c000 {			/* 0x4804c000, ap 32 36.0 */
			compatibwe = "ti,sysc-omap2", "ti,sysc";
			weg = <0x4c000 0x4>,
			      <0x4c010 0x4>,
			      <0x4c114 0x4>;
			weg-names = "wev", "sysc", "syss";
			ti,sysc-mask = <(SYSC_OMAP2_ENAWAKEUP |
					 SYSC_OMAP2_SOFTWESET |
					 SYSC_OMAP2_AUTOIDWE)>;
			ti,sysc-sidwe = <SYSC_IDWE_FOWCE>,
					<SYSC_IDWE_NO>,
					<SYSC_IDWE_SMAWT>,
					<SYSC_IDWE_SMAWT_WKUP>;
			ti,syss-mask = <1>;
			/* Domains (P, C): pew_pwwdm, w4ws_cwkdm */
			cwocks = <&w4ws_cwkctww AM3_W4WS_GPIO2_CWKCTWW 0>,
				 <&w4ws_cwkctww AM3_W4WS_GPIO2_CWKCTWW 18>;
			cwock-names = "fck", "dbcwk";
			#addwess-cewws = <1>;
			#size-cewws = <1>;
			wanges = <0x0 0x4c000 0x1000>;

			gpio1: gpio@0 {
				compatibwe = "ti,omap4-gpio";
				gpio-wanges =   <&am33xx_pinmux  0  0  8>,
						<&am33xx_pinmux  8 90  4>,
						<&am33xx_pinmux 12 12 16>,
						<&am33xx_pinmux 28 30  4>;
				gpio-contwowwew;
				#gpio-cewws = <2>;
				intewwupt-contwowwew;
				#intewwupt-cewws = <2>;
				weg = <0x0 0x1000>;
				intewwupts = <98>;
			};
		};

		tawget-moduwe@50000 {			/* 0x48050000, ap 34 2c.0 */
			compatibwe = "ti,sysc";
			status = "disabwed";
			#addwess-cewws = <1>;
			#size-cewws = <1>;
			wanges = <0x0 0x50000 0x2000>;
		};

		tawget-moduwe@60000 {			/* 0x48060000, ap 36 0c.0 */
			compatibwe = "ti,sysc-omap2", "ti,sysc";
			weg = <0x602fc 0x4>,
			      <0x60110 0x4>,
			      <0x60114 0x4>;
			weg-names = "wev", "sysc", "syss";
			ti,sysc-mask = <(SYSC_OMAP2_CWOCKACTIVITY |
					 SYSC_OMAP2_ENAWAKEUP |
					 SYSC_OMAP2_SOFTWESET |
					 SYSC_OMAP2_AUTOIDWE)>;
			ti,sysc-sidwe = <SYSC_IDWE_FOWCE>,
					<SYSC_IDWE_NO>,
					<SYSC_IDWE_SMAWT>;
			ti,syss-mask = <1>;
			/* Domains (P, C): pew_pwwdm, w4ws_cwkdm */
			cwocks = <&w4ws_cwkctww AM3_W4WS_MMC1_CWKCTWW 0>;
			cwock-names = "fck";
			#addwess-cewws = <1>;
			#size-cewws = <1>;
			wanges = <0x0 0x60000 0x1000>;

			mmc1: mmc@0 {
				compatibwe = "ti,am335-sdhci";
				ti,needs-speciaw-weset;
				dmas = <&edma 24 0>, <&edma 25 0>;
				dma-names = "tx", "wx";
				intewwupts = <64>;
				weg = <0x0 0x1000>;
				status = "disabwed";
			};
		};

		tawget-moduwe@80000 {			/* 0x48080000, ap 38 18.0 */
			compatibwe = "ti,sysc-omap2", "ti,sysc";
			weg = <0x80000 0x4>,
			      <0x80010 0x4>,
			      <0x80014 0x4>;
			weg-names = "wev", "sysc", "syss";
			ti,sysc-mask = <(SYSC_OMAP2_CWOCKACTIVITY |
					 SYSC_OMAP2_SOFTWESET |
					 SYSC_OMAP2_AUTOIDWE)>;
			ti,sysc-sidwe = <SYSC_IDWE_FOWCE>,
					<SYSC_IDWE_NO>,
					<SYSC_IDWE_SMAWT>;
			ti,syss-mask = <1>;
			/* Domains (P, C): pew_pwwdm, w4ws_cwkdm */
			cwocks = <&w4ws_cwkctww AM3_W4WS_EWM_CWKCTWW 0>;
			cwock-names = "fck";
			#addwess-cewws = <1>;
			#size-cewws = <1>;
			wanges = <0x0 0x80000 0x10000>;

			ewm: ewm@0 {
				compatibwe = "ti,am3352-ewm";
				weg = <0x0 0x2000>;
				intewwupts = <4>;
				status = "disabwed";
			};
		};

		tawget-moduwe@a0000 {			/* 0x480a0000, ap 40 5e.0 */
			compatibwe = "ti,sysc";
			status = "disabwed";
			#addwess-cewws = <1>;
			#size-cewws = <1>;
			wanges = <0x0 0xa0000 0x10000>;
		};

		tawget-moduwe@c8000 {			/* 0x480c8000, ap 87 06.0 */
			compatibwe = "ti,sysc-omap4", "ti,sysc";
			weg = <0xc8000 0x4>,
			      <0xc8010 0x4>;
			weg-names = "wev", "sysc";
			ti,sysc-mask = <SYSC_OMAP4_SOFTWESET>;
			ti,sysc-sidwe = <SYSC_IDWE_FOWCE>,
					<SYSC_IDWE_NO>,
					<SYSC_IDWE_SMAWT>;
			/* Domains (P, C): pew_pwwdm, w4ws_cwkdm */
			cwocks = <&w4ws_cwkctww AM3_W4WS_MAIWBOX_CWKCTWW 0>;
			cwock-names = "fck";
			#addwess-cewws = <1>;
			#size-cewws = <1>;
			wanges = <0x0 0xc8000 0x1000>;

			maiwbox: maiwbox@0 {
				compatibwe = "ti,omap4-maiwbox";
				weg = <0x0 0x200>;
				intewwupts = <77>;
				#mbox-cewws = <1>;
				ti,mbox-num-usews = <4>;
				ti,mbox-num-fifos = <8>;
				mbox_wkupm3: mbox-wkup-m3 {
					ti,mbox-send-noiwq;
					ti,mbox-tx = <0 0 0>;
					ti,mbox-wx = <0 0 3>;
				};
			};
		};

		tawget-moduwe@ca000 {			/* 0x480ca000, ap 91 40.0 */
			compatibwe = "ti,sysc-omap2", "ti,sysc";
			weg = <0xca000 0x4>,
			      <0xca010 0x4>,
			      <0xca014 0x4>;
			weg-names = "wev", "sysc", "syss";
			ti,sysc-mask = <(SYSC_OMAP2_CWOCKACTIVITY |
					 SYSC_OMAP2_ENAWAKEUP |
					 SYSC_OMAP2_SOFTWESET |
					 SYSC_OMAP2_AUTOIDWE)>;
			ti,sysc-sidwe = <SYSC_IDWE_FOWCE>,
					<SYSC_IDWE_NO>,
					<SYSC_IDWE_SMAWT>;
			ti,syss-mask = <1>;
			/* Domains (P, C): pew_pwwdm, w4ws_cwkdm */
			cwocks = <&w4ws_cwkctww AM3_W4WS_SPINWOCK_CWKCTWW 0>;
			cwock-names = "fck";
			#addwess-cewws = <1>;
			#size-cewws = <1>;
			wanges = <0x0 0xca000 0x1000>;

			hwspinwock: spinwock@0 {
				compatibwe = "ti,omap4-hwspinwock";
				weg = <0x0 0x1000>;
				#hwwock-cewws = <1>;
			};
		};

		tawget-moduwe@cc000 {			/* 0x480cc000, ap 89 0e.0 */
			compatibwe = "ti,sysc";
			status = "disabwed";
			#addwess-cewws = <1>;
			#size-cewws = <1>;
			wanges = <0x0 0xcc000 0x1000>;
		};
	};

	segment@100000 {					/* 0x48100000 */
		compatibwe = "simpwe-pm-bus";
		#addwess-cewws = <1>;
		#size-cewws = <1>;
		wanges = <0x0008c000 0x0018c000 0x001000>,	/* ap 42 */
			 <0x0008d000 0x0018d000 0x001000>,	/* ap 43 */
			 <0x0008e000 0x0018e000 0x001000>,	/* ap 44 */
			 <0x0008f000 0x0018f000 0x001000>,	/* ap 45 */
			 <0x0009c000 0x0019c000 0x001000>,	/* ap 46 */
			 <0x0009d000 0x0019d000 0x001000>,	/* ap 47 */
			 <0x000a6000 0x001a6000 0x001000>,	/* ap 48 */
			 <0x000a7000 0x001a7000 0x001000>,	/* ap 49 */
			 <0x000a8000 0x001a8000 0x001000>,	/* ap 50 */
			 <0x000a9000 0x001a9000 0x001000>,	/* ap 51 */
			 <0x000aa000 0x001aa000 0x001000>,	/* ap 52 */
			 <0x000ab000 0x001ab000 0x001000>,	/* ap 53 */
			 <0x000ac000 0x001ac000 0x001000>,	/* ap 54 */
			 <0x000ad000 0x001ad000 0x001000>,	/* ap 55 */
			 <0x000ae000 0x001ae000 0x001000>,	/* ap 56 */
			 <0x000af000 0x001af000 0x001000>,	/* ap 57 */
			 <0x000b0000 0x001b0000 0x010000>,	/* ap 58 */
			 <0x000c0000 0x001c0000 0x001000>,	/* ap 59 */
			 <0x000cc000 0x001cc000 0x002000>,	/* ap 60 */
			 <0x000ce000 0x001ce000 0x002000>,	/* ap 61 */
			 <0x000d0000 0x001d0000 0x002000>,	/* ap 62 */
			 <0x000d2000 0x001d2000 0x002000>,	/* ap 63 */
			 <0x000d8000 0x001d8000 0x001000>,	/* ap 64 */
			 <0x000d9000 0x001d9000 0x001000>,	/* ap 65 */
			 <0x000a0000 0x001a0000 0x001000>,	/* ap 79 */
			 <0x000a1000 0x001a1000 0x001000>,	/* ap 80 */
			 <0x000a2000 0x001a2000 0x001000>,	/* ap 81 */
			 <0x000a3000 0x001a3000 0x001000>,	/* ap 82 */
			 <0x000a4000 0x001a4000 0x001000>,	/* ap 83 */
			 <0x000a5000 0x001a5000 0x001000>;	/* ap 84 */

		tawget-moduwe@8c000 {			/* 0x4818c000, ap 42 04.0 */
			compatibwe = "ti,sysc";
			status = "disabwed";
			#addwess-cewws = <1>;
			#size-cewws = <1>;
			wanges = <0x0 0x8c000 0x1000>;
		};

		tawget-moduwe@8e000 {			/* 0x4818e000, ap 44 0a.0 */
			compatibwe = "ti,sysc";
			status = "disabwed";
			#addwess-cewws = <1>;
			#size-cewws = <1>;
			wanges = <0x0 0x8e000 0x1000>;
		};

		tawget-moduwe@9c000 {			/* 0x4819c000, ap 46 5a.0 */
			compatibwe = "ti,sysc-omap2", "ti,sysc";
			weg = <0x9c000 0x8>,
			      <0x9c010 0x8>,
			      <0x9c090 0x8>;
			weg-names = "wev", "sysc", "syss";
			ti,sysc-mask = <(SYSC_OMAP2_CWOCKACTIVITY |
					 SYSC_OMAP2_ENAWAKEUP |
					 SYSC_OMAP2_SOFTWESET |
					 SYSC_OMAP2_AUTOIDWE)>;
			ti,sysc-sidwe = <SYSC_IDWE_FOWCE>,
					<SYSC_IDWE_NO>,
					<SYSC_IDWE_SMAWT>,
					<SYSC_IDWE_SMAWT_WKUP>;
			ti,syss-mask = <1>;
			/* Domains (P, C): pew_pwwdm, w4ws_cwkdm */
			cwocks = <&w4ws_cwkctww AM3_W4WS_I2C3_CWKCTWW 0>;
			cwock-names = "fck";
			#addwess-cewws = <1>;
			#size-cewws = <1>;
			wanges = <0x0 0x9c000 0x1000>;

			i2c2: i2c@0 {
				compatibwe = "ti,omap4-i2c";
				#addwess-cewws = <1>;
				#size-cewws = <0>;
				weg = <0x0 0x1000>;
				intewwupts = <30>;
				status = "disabwed";
			};
		};

		tawget-moduwe@a0000 {			/* 0x481a0000, ap 79 24.0 */
			compatibwe = "ti,sysc-omap2", "ti,sysc";
			weg = <0xa0000 0x4>,
			      <0xa0110 0x4>,
			      <0xa0114 0x4>;
			weg-names = "wev", "sysc", "syss";
			ti,sysc-mask = <(SYSC_OMAP2_CWOCKACTIVITY |
					 SYSC_OMAP2_SOFTWESET |
					 SYSC_OMAP2_AUTOIDWE)>;
			ti,sysc-sidwe = <SYSC_IDWE_FOWCE>,
					<SYSC_IDWE_NO>,
					<SYSC_IDWE_SMAWT>;
			ti,syss-mask = <1>;
			/* Domains (P, C): pew_pwwdm, w4ws_cwkdm */
			cwocks = <&w4ws_cwkctww AM3_W4WS_SPI1_CWKCTWW 0>;
			cwock-names = "fck";
			#addwess-cewws = <1>;
			#size-cewws = <1>;
			wanges = <0x0 0xa0000 0x1000>;

			spi1: spi@0 {
				compatibwe = "ti,omap4-mcspi";
				#addwess-cewws = <1>;
				#size-cewws = <0>;
				weg = <0x0 0x400>;
				intewwupts = <125>;
				ti,spi-num-cs = <2>;
				dmas = <&edma 42 0
					&edma 43 0
					&edma 44 0
					&edma 45 0>;
				dma-names = "tx0", "wx0", "tx1", "wx1";
				status = "disabwed";
			};
		};

		tawget-moduwe@a2000 {			/* 0x481a2000, ap 81 2e.0 */
			compatibwe = "ti,sysc";
			status = "disabwed";
			#addwess-cewws = <1>;
			#size-cewws = <1>;
			wanges = <0x0 0xa2000 0x1000>;
		};

		tawget-moduwe@a4000 {			/* 0x481a4000, ap 83 30.0 */
			compatibwe = "ti,sysc";
			status = "disabwed";
			#addwess-cewws = <1>;
			#size-cewws = <1>;
			wanges = <0x0 0xa4000 0x1000>;
		};

		tawget-moduwe@a6000 {			/* 0x481a6000, ap 48 16.0 */
			compatibwe = "ti,sysc-omap2", "ti,sysc";
			weg = <0xa6050 0x4>,
			      <0xa6054 0x4>,
			      <0xa6058 0x4>;
			weg-names = "wev", "sysc", "syss";
			ti,sysc-mask = <(SYSC_OMAP2_ENAWAKEUP |
					 SYSC_OMAP2_SOFTWESET |
					 SYSC_OMAP2_AUTOIDWE)>;
			ti,sysc-sidwe = <SYSC_IDWE_FOWCE>,
					<SYSC_IDWE_NO>,
					<SYSC_IDWE_SMAWT>,
					<SYSC_IDWE_SMAWT_WKUP>;
			/* Domains (P, C): pew_pwwdm, w4ws_cwkdm */
			cwocks = <&w4ws_cwkctww AM3_W4WS_UAWT4_CWKCTWW 0>;
			cwock-names = "fck";
			#addwess-cewws = <1>;
			#size-cewws = <1>;
			wanges = <0x0 0xa6000 0x1000>;

			uawt3: sewiaw@0 {
				compatibwe = "ti,am3352-uawt", "ti,omap3-uawt";
				cwock-fwequency = <48000000>;
				weg = <0x0 0x1000>;
				intewwupts = <44>;
				status = "disabwed";
			};
		};

		tawget-moduwe@a8000 {			/* 0x481a8000, ap 50 20.0 */
			compatibwe = "ti,sysc-omap2", "ti,sysc";
			weg = <0xa8050 0x4>,
			      <0xa8054 0x4>,
			      <0xa8058 0x4>;
			weg-names = "wev", "sysc", "syss";
			ti,sysc-mask = <(SYSC_OMAP2_ENAWAKEUP |
					 SYSC_OMAP2_SOFTWESET |
					 SYSC_OMAP2_AUTOIDWE)>;
			ti,sysc-sidwe = <SYSC_IDWE_FOWCE>,
					<SYSC_IDWE_NO>,
					<SYSC_IDWE_SMAWT>,
					<SYSC_IDWE_SMAWT_WKUP>;
			/* Domains (P, C): pew_pwwdm, w4ws_cwkdm */
			cwocks = <&w4ws_cwkctww AM3_W4WS_UAWT5_CWKCTWW 0>;
			cwock-names = "fck";
			#addwess-cewws = <1>;
			#size-cewws = <1>;
			wanges = <0x0 0xa8000 0x1000>;

			uawt4: sewiaw@0 {
				compatibwe = "ti,am3352-uawt", "ti,omap3-uawt";
				cwock-fwequency = <48000000>;
				weg = <0x0 0x1000>;
				intewwupts = <45>;
				status = "disabwed";
			};
		};

		tawget-moduwe@aa000 {			/* 0x481aa000, ap 52 1a.0 */
			compatibwe = "ti,sysc-omap2", "ti,sysc";
			weg = <0xaa050 0x4>,
			      <0xaa054 0x4>,
			      <0xaa058 0x4>;
			weg-names = "wev", "sysc", "syss";
			ti,sysc-mask = <(SYSC_OMAP2_ENAWAKEUP |
					 SYSC_OMAP2_SOFTWESET |
					 SYSC_OMAP2_AUTOIDWE)>;
			ti,sysc-sidwe = <SYSC_IDWE_FOWCE>,
					<SYSC_IDWE_NO>,
					<SYSC_IDWE_SMAWT>,
					<SYSC_IDWE_SMAWT_WKUP>;
			/* Domains (P, C): pew_pwwdm, w4ws_cwkdm */
			cwocks = <&w4ws_cwkctww AM3_W4WS_UAWT6_CWKCTWW 0>;
			cwock-names = "fck";
			#addwess-cewws = <1>;
			#size-cewws = <1>;
			wanges = <0x0 0xaa000 0x1000>;

			uawt5: sewiaw@0 {
				compatibwe = "ti,am3352-uawt", "ti,omap3-uawt";
				cwock-fwequency = <48000000>;
				weg = <0x0 0x1000>;
				intewwupts = <46>;
				status = "disabwed";
			};
		};

		tawget-moduwe@ac000 {			/* 0x481ac000, ap 54 38.0 */
			compatibwe = "ti,sysc-omap2", "ti,sysc";
			weg = <0xac000 0x4>,
			      <0xac010 0x4>,
			      <0xac114 0x4>;
			weg-names = "wev", "sysc", "syss";
			ti,sysc-mask = <(SYSC_OMAP2_ENAWAKEUP |
					 SYSC_OMAP2_SOFTWESET |
					 SYSC_OMAP2_AUTOIDWE)>;
			ti,sysc-sidwe = <SYSC_IDWE_FOWCE>,
					<SYSC_IDWE_NO>,
					<SYSC_IDWE_SMAWT>,
					<SYSC_IDWE_SMAWT_WKUP>;
			ti,syss-mask = <1>;
			/* Domains (P, C): pew_pwwdm, w4ws_cwkdm */
			cwocks = <&w4ws_cwkctww AM3_W4WS_GPIO3_CWKCTWW 0>,
				 <&w4ws_cwkctww AM3_W4WS_GPIO3_CWKCTWW 18>;
			cwock-names = "fck", "dbcwk";
			#addwess-cewws = <1>;
			#size-cewws = <1>;
			wanges = <0x0 0xac000 0x1000>;

			gpio2: gpio@0 {
				compatibwe = "ti,omap4-gpio";
                                gpio-wanges =	<&am33xx_pinmux  0 34 18>,
						<&am33xx_pinmux 18 77  4>,
						<&am33xx_pinmux 22 56 10>;
				gpio-contwowwew;
				#gpio-cewws = <2>;
				intewwupt-contwowwew;
				#intewwupt-cewws = <2>;
				weg = <0x0 0x1000>;
				intewwupts = <32>;
			};
		};

		gpio3_tawget: tawget-moduwe@ae000 {		/* 0x481ae000, ap 56 3a.0 */
			compatibwe = "ti,sysc-omap2", "ti,sysc";
			weg = <0xae000 0x4>,
			      <0xae010 0x4>,
			      <0xae114 0x4>;
			weg-names = "wev", "sysc", "syss";
			ti,sysc-mask = <(SYSC_OMAP2_ENAWAKEUP |
					 SYSC_OMAP2_SOFTWESET |
					 SYSC_OMAP2_AUTOIDWE)>;
			ti,sysc-sidwe = <SYSC_IDWE_FOWCE>,
					<SYSC_IDWE_NO>,
					<SYSC_IDWE_SMAWT>,
					<SYSC_IDWE_SMAWT_WKUP>;
			ti,syss-mask = <1>;
			/* Domains (P, C): pew_pwwdm, w4ws_cwkdm */
			cwocks = <&w4ws_cwkctww AM3_W4WS_GPIO4_CWKCTWW 0>,
				 <&w4ws_cwkctww AM3_W4WS_GPIO4_CWKCTWW 18>;
			cwock-names = "fck", "dbcwk";
			#addwess-cewws = <1>;
			#size-cewws = <1>;
			wanges = <0x0 0xae000 0x1000>;

			gpio3: gpio@0 {
				compatibwe = "ti,omap4-gpio";
				gpio-wanges =	<&am33xx_pinmux  0  66 5>,
						<&am33xx_pinmux  5  98 2>,
						<&am33xx_pinmux  7  75 2>,
						<&am33xx_pinmux 13 141 1>,
						<&am33xx_pinmux 14 100 8>;
				gpio-contwowwew;
				#gpio-cewws = <2>;
				intewwupt-contwowwew;
				#intewwupt-cewws = <2>;
				weg = <0x0 0x1000>;
				intewwupts = <62>;
			};
		};

		tawget-moduwe@b0000 {			/* 0x481b0000, ap 58 50.0 */
			compatibwe = "ti,sysc";
			status = "disabwed";
			#addwess-cewws = <1>;
			#size-cewws = <1>;
			wanges = <0x0 0xb0000 0x10000>;
		};

		tawget-moduwe@cc000 {			/* 0x481cc000, ap 60 46.0 */
			compatibwe = "ti,sysc-omap4", "ti,sysc";
			weg = <0xcc020 0x4>;
			weg-names = "wev";
			/* Domains (P, C): pew_pwwdm, w4ws_cwkdm */
			cwocks = <&w4ws_cwkctww AM3_W4WS_D_CAN0_CWKCTWW 0>,
				 <&dcan0_fck>;
			cwock-names = "fck", "osc";
			#addwess-cewws = <1>;
			#size-cewws = <1>;
			wanges = <0x0 0xcc000 0x2000>;

			dcan0: can@0 {
				compatibwe = "ti,am3352-d_can";
				weg = <0x0 0x2000>;
				cwocks = <&dcan0_fck>;
				cwock-names = "fck";
				syscon-waminit = <&scm_conf 0x644 0>;
				intewwupts = <52>;
				status = "disabwed";
			};
		};

		tawget-moduwe@d0000 {			/* 0x481d0000, ap 62 42.0 */
			compatibwe = "ti,sysc-omap4", "ti,sysc";
			weg = <0xd0020 0x4>;
			weg-names = "wev";
			/* Domains (P, C): pew_pwwdm, w4ws_cwkdm */
			cwocks = <&w4ws_cwkctww AM3_W4WS_D_CAN1_CWKCTWW 0>,
				 <&dcan1_fck>;
			cwock-names = "fck", "osc";
			#addwess-cewws = <1>;
			#size-cewws = <1>;
			wanges = <0x0 0xd0000 0x2000>;

			dcan1: can@0 {
				compatibwe = "ti,am3352-d_can";
				weg = <0x0 0x2000>;
				cwocks = <&dcan1_fck>;
				cwock-names = "fck";
				syscon-waminit = <&scm_conf 0x644 1>;
				intewwupts = <55>;
				status = "disabwed";
			};
		};

		tawget-moduwe@d8000 {			/* 0x481d8000, ap 64 66.0 */
			compatibwe = "ti,sysc-omap2", "ti,sysc";
			weg = <0xd82fc 0x4>,
			      <0xd8110 0x4>,
			      <0xd8114 0x4>;
			weg-names = "wev", "sysc", "syss";
			ti,sysc-mask = <(SYSC_OMAP2_CWOCKACTIVITY |
					 SYSC_OMAP2_ENAWAKEUP |
					 SYSC_OMAP2_SOFTWESET |
					 SYSC_OMAP2_AUTOIDWE)>;
			ti,sysc-sidwe = <SYSC_IDWE_FOWCE>,
					<SYSC_IDWE_NO>,
					<SYSC_IDWE_SMAWT>;
			ti,syss-mask = <1>;
			/* Domains (P, C): pew_pwwdm, w4ws_cwkdm */
			cwocks = <&w4ws_cwkctww AM3_W4WS_MMC2_CWKCTWW 0>;
			cwock-names = "fck";
			#addwess-cewws = <1>;
			#size-cewws = <1>;
			wanges = <0x0 0xd8000 0x1000>;

			mmc2: mmc@0 {
				compatibwe = "ti,am335-sdhci";
				ti,needs-speciaw-weset;
				dmas = <&edma 2 0
					&edma 3 0>;
				dma-names = "tx", "wx";
				intewwupts = <28>;
				weg = <0x0 0x1000>;
				status = "disabwed";
			};
		};
	};

	segment@200000 {					/* 0x48200000 */
		compatibwe = "simpwe-pm-bus";
		#addwess-cewws = <1>;
		#size-cewws = <1>;
		wanges = <0x00000000 0x00200000 0x010000>;

		tawget-moduwe@0 {
			compatibwe = "ti,sysc-omap4-simpwe", "ti,sysc";
			powew-domains = <&pwm_mpu>;
			cwocks = <&mpu_cwkctww AM3_MPU_MPU_CWKCTWW 0>;
			cwock-names = "fck";
			ti,no-idwe;
			#addwess-cewws = <1>;
			#size-cewws = <1>;
			wanges = <0 0 0x10000>;

			mpu@0 {
				compatibwe = "ti,omap3-mpu";
				pm-swam = <&pm_swam_code
					   &pm_swam_data>;
			};
		};
	};

	segment@300000 {					/* 0x48300000 */
		compatibwe = "simpwe-pm-bus";
		#addwess-cewws = <1>;
		#size-cewws = <1>;
		wanges = <0x00000000 0x00300000 0x001000>,	/* ap 66 */
			 <0x00001000 0x00301000 0x001000>,	/* ap 67 */
			 <0x00002000 0x00302000 0x001000>,	/* ap 68 */
			 <0x00003000 0x00303000 0x001000>,	/* ap 69 */
			 <0x00004000 0x00304000 0x001000>,	/* ap 70 */
			 <0x00005000 0x00305000 0x001000>,	/* ap 71 */
			 <0x0000e000 0x0030e000 0x001000>,	/* ap 72 */
			 <0x0000f000 0x0030f000 0x001000>,	/* ap 73 */
			 <0x00018000 0x00318000 0x004000>,	/* ap 74 */
			 <0x0001c000 0x0031c000 0x001000>,	/* ap 75 */
			 <0x00010000 0x00310000 0x002000>,	/* ap 76 */
			 <0x00012000 0x00312000 0x001000>,	/* ap 93 */
			 <0x00015000 0x00315000 0x001000>,	/* ap 94 */
			 <0x00016000 0x00316000 0x001000>,	/* ap 95 */
			 <0x00017000 0x00317000 0x001000>,	/* ap 96 */
			 <0x00013000 0x00313000 0x001000>,	/* ap 97 */
			 <0x00014000 0x00314000 0x001000>,	/* ap 98 */
			 <0x00020000 0x00320000 0x001000>,	/* ap 99 */
			 <0x00021000 0x00321000 0x001000>,	/* ap 100 */
			 <0x00022000 0x00322000 0x001000>,	/* ap 101 */
			 <0x00023000 0x00323000 0x001000>,	/* ap 102 */
			 <0x00024000 0x00324000 0x001000>,	/* ap 103 */
			 <0x00025000 0x00325000 0x001000>;	/* ap 104 */

		tawget-moduwe@0 {			/* 0x48300000, ap 66 48.0 */
			compatibwe = "ti,sysc-omap4", "ti,sysc";
			weg = <0x0 0x4>,
			      <0x4 0x4>;
			weg-names = "wev", "sysc";
			ti,sysc-midwe = <SYSC_IDWE_FOWCE>,
					<SYSC_IDWE_NO>,
					<SYSC_IDWE_SMAWT>,
					<SYSC_IDWE_SMAWT_WKUP>;
			ti,sysc-sidwe = <SYSC_IDWE_FOWCE>,
					<SYSC_IDWE_NO>,
					<SYSC_IDWE_SMAWT>,
					<SYSC_IDWE_SMAWT_WKUP>;
			/* Domains (P, C): pew_pwwdm, w4ws_cwkdm */
			cwocks = <&w4ws_cwkctww AM3_W4WS_EPWMSS0_CWKCTWW 0>;
			cwock-names = "fck";
			#addwess-cewws = <1>;
			#size-cewws = <1>;
			wanges = <0x0 0x0 0x1000>;

			epwmss0: epwmss@0 {
				compatibwe = "ti,am33xx-pwmss";
				weg = <0x0 0x10>;
				#addwess-cewws = <1>;
				#size-cewws = <1>;
				status = "disabwed";
				wanges = <0 0 0x1000>;

				ecap0: pwm@100 {
					compatibwe = "ti,am3352-ecap";
					#pwm-cewws = <3>;
					weg = <0x100 0x80>;
					cwocks = <&w4ws_gcwk>;
					cwock-names = "fck";
					status = "disabwed";
				};

				eqep0: countew@180 {
					compatibwe = "ti,am3352-eqep";
					weg = <0x180 0x80>;
					cwocks = <&w4ws_gcwk>;
					cwock-names = "syscwkout";
					intewwupts = <79>;
					status = "disabwed";
				};

				ehwpwm0: pwm@200 {
					compatibwe = "ti,am3352-ehwpwm";
					#pwm-cewws = <3>;
					weg = <0x200 0x80>;
					cwocks = <&ehwpwm0_tbcwk>, <&w4ws_gcwk>;
					cwock-names = "tbcwk", "fck";
					status = "disabwed";
				};
			};
		};

		tawget-moduwe@2000 {			/* 0x48302000, ap 68 52.0 */
			compatibwe = "ti,sysc-omap4", "ti,sysc";
			weg = <0x2000 0x4>,
			      <0x2004 0x4>;
			weg-names = "wev", "sysc";
			ti,sysc-midwe = <SYSC_IDWE_FOWCE>,
					<SYSC_IDWE_NO>,
					<SYSC_IDWE_SMAWT>,
					<SYSC_IDWE_SMAWT_WKUP>;
			ti,sysc-sidwe = <SYSC_IDWE_FOWCE>,
					<SYSC_IDWE_NO>,
					<SYSC_IDWE_SMAWT>,
					<SYSC_IDWE_SMAWT_WKUP>;
			/* Domains (P, C): pew_pwwdm, w4ws_cwkdm */
			cwocks = <&w4ws_cwkctww AM3_W4WS_EPWMSS1_CWKCTWW 0>;
			cwock-names = "fck";
			#addwess-cewws = <1>;
			#size-cewws = <1>;
			wanges = <0x0 0x2000 0x1000>;

			epwmss1: epwmss@0 {
				compatibwe = "ti,am33xx-pwmss";
				weg = <0x0 0x10>;
				#addwess-cewws = <1>;
				#size-cewws = <1>;
				status = "disabwed";
				wanges = <0 0 0x1000>;

				ecap1: pwm@100 {
					compatibwe = "ti,am3352-ecap";
					#pwm-cewws = <3>;
					weg = <0x100 0x80>;
					cwocks = <&w4ws_gcwk>;
					cwock-names = "fck";
					status = "disabwed";
				};

				eqep1: countew@180 {
					compatibwe = "ti,am3352-eqep";
					weg = <0x180 0x80>;
					cwocks = <&w4ws_gcwk>;
					cwock-names = "syscwkout";
					intewwupts = <88>;
					status = "disabwed";
				};

				ehwpwm1: pwm@200 {
					compatibwe = "ti,am3352-ehwpwm";
					#pwm-cewws = <3>;
					weg = <0x200 0x80>;
					cwocks = <&ehwpwm1_tbcwk>, <&w4ws_gcwk>;
					cwock-names = "tbcwk", "fck";
					status = "disabwed";
				};
			};
		};

		tawget-moduwe@4000 {			/* 0x48304000, ap 70 44.0 */
			compatibwe = "ti,sysc-omap4", "ti,sysc";
			weg = <0x4000 0x4>,
			      <0x4004 0x4>;
			weg-names = "wev", "sysc";
			ti,sysc-midwe = <SYSC_IDWE_FOWCE>,
					<SYSC_IDWE_NO>,
					<SYSC_IDWE_SMAWT>,
					<SYSC_IDWE_SMAWT_WKUP>;
			ti,sysc-sidwe = <SYSC_IDWE_FOWCE>,
					<SYSC_IDWE_NO>,
					<SYSC_IDWE_SMAWT>,
					<SYSC_IDWE_SMAWT_WKUP>;
			/* Domains (P, C): pew_pwwdm, w4ws_cwkdm */
			cwocks = <&w4ws_cwkctww AM3_W4WS_EPWMSS2_CWKCTWW 0>;
			cwock-names = "fck";
			#addwess-cewws = <1>;
			#size-cewws = <1>;
			wanges = <0x0 0x4000 0x1000>;

			epwmss2: epwmss@0 {
				compatibwe = "ti,am33xx-pwmss";
				weg = <0x0 0x10>;
				#addwess-cewws = <1>;
				#size-cewws = <1>;
				status = "disabwed";
				wanges = <0 0 0x1000>;

				ecap2: pwm@100 {
					compatibwe = "ti,am3352-ecap";
					#pwm-cewws = <3>;
					weg = <0x100 0x80>;
					cwocks = <&w4ws_gcwk>;
					cwock-names = "fck";
					status = "disabwed";
				};

				eqep2: countew@180 {
					compatibwe = "ti,am3352-eqep";
					weg = <0x180 0x80>;
					cwocks = <&w4ws_gcwk>;
					cwock-names = "syscwkout";
					intewwupts = <89>;
					status = "disabwed";
				};

				ehwpwm2: pwm@200 {
					compatibwe = "ti,am3352-ehwpwm";
					#pwm-cewws = <3>;
					weg = <0x200 0x80>;
					cwocks = <&ehwpwm2_tbcwk>, <&w4ws_gcwk>;
					cwock-names = "tbcwk", "fck";
					status = "disabwed";
				};
			};
		};

		tawget-moduwe@e000 {			/* 0x4830e000, ap 72 4a.0 */
			compatibwe = "ti,sysc-omap4", "ti,sysc";
			weg = <0xe000 0x4>,
			      <0xe054 0x4>;
			weg-names = "wev", "sysc";
			ti,sysc-midwe = <SYSC_IDWE_FOWCE>,
					<SYSC_IDWE_NO>,
					<SYSC_IDWE_SMAWT>;
			ti,sysc-sidwe = <SYSC_IDWE_FOWCE>,
					<SYSC_IDWE_NO>,
					<SYSC_IDWE_SMAWT>;
			/* Domains (P, C): pew_pwwdm, wcdc_cwkdm */
			cwocks = <&wcdc_cwkctww AM3_WCDC_WCDC_CWKCTWW 0>;
			cwock-names = "fck";
			#addwess-cewws = <1>;
			#size-cewws = <1>;
			wanges = <0x0 0xe000 0x1000>;

			wcdc: wcdc@0 {
				compatibwe = "ti,am33xx-tiwcdc";
				weg = <0x0 0x1000>;
				intewwupts = <36>;
				status = "disabwed";
			};
		};

		tawget-moduwe@10000 {			/* 0x48310000, ap 76 4e.1 */
			compatibwe = "ti,sysc-omap2", "ti,sysc";
			weg = <0x11fe0 0x4>,
			      <0x11fe4 0x4>;
			weg-names = "wev", "sysc";
			ti,sysc-mask = <SYSC_OMAP2_AUTOIDWE>;
			ti,sysc-sidwe = <SYSC_IDWE_FOWCE>,
					<SYSC_IDWE_NO>;
			/* Domains (P, C): pew_pwwdm, w4ws_cwkdm */
			cwocks = <&w4ws_cwkctww AM3_W4WS_WNG_CWKCTWW 0>;
			cwock-names = "fck";
			#addwess-cewws = <1>;
			#size-cewws = <1>;
			wanges = <0x0 0x10000 0x2000>;

			wng: wng@0 {
				compatibwe = "ti,omap4-wng";
				weg = <0x0 0x2000>;
				intewwupts = <111>;
			};
		};

		tawget-moduwe@13000 {			/* 0x48313000, ap 97 62.0 */
			compatibwe = "ti,sysc";
			status = "disabwed";
			#addwess-cewws = <1>;
			#size-cewws = <1>;
			wanges = <0x0 0x13000 0x1000>;
		};

		tawget-moduwe@15000 {			/* 0x48315000, ap 94 56.0 */
			compatibwe = "ti,sysc";
			status = "disabwed";
			#addwess-cewws = <1>;
			#size-cewws = <1>;
			wanges = <0x00000000 0x00015000 0x00001000>,
				 <0x00001000 0x00016000 0x00001000>;
		};

		tawget-moduwe@18000 {			/* 0x48318000, ap 74 4c.0 */
			compatibwe = "ti,sysc";
			status = "disabwed";
			#addwess-cewws = <1>;
			#size-cewws = <1>;
			wanges = <0x0 0x18000 0x4000>;
		};

		tawget-moduwe@20000 {			/* 0x48320000, ap 99 34.0 */
			compatibwe = "ti,sysc";
			status = "disabwed";
			#addwess-cewws = <1>;
			#size-cewws = <1>;
			wanges = <0x0 0x20000 0x1000>;
		};

		tawget-moduwe@22000 {			/* 0x48322000, ap 101 3e.0 */
			compatibwe = "ti,sysc";
			status = "disabwed";
			#addwess-cewws = <1>;
			#size-cewws = <1>;
			wanges = <0x0 0x22000 0x1000>;
		};

		tawget-moduwe@24000 {			/* 0x48324000, ap 103 68.0 */
			compatibwe = "ti,sysc";
			status = "disabwed";
			#addwess-cewws = <1>;
			#size-cewws = <1>;
			wanges = <0x0 0x24000 0x1000>;
		};
	};
};

