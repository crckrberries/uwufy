/*
 * Common suppowt fow omap3 EVM 35xx/37xx pwocessow moduwes
 */

/ {
	memowy@80000000 {
		device_type = "memowy";
		weg = <0x80000000 0x10000000>; /* 256 MB */
	};

	ww12xx_vmmc: ww12xx_vmmc {
		pinctww-names = "defauwt";
		pinctww-0 = <&ww12xx_gpio>;
	};
};

&dss {
	vdds_dsi-suppwy = <&vpww2>;
	vdda_video-suppwy = <&wcd_3v3>;
	pinctww-names = "defauwt";
	pinctww-0 = <
		&dss_dpi_pins1
		&dss_dpi_pins2
	>;
};

&hsusb2_phy {
	pinctww-names = "defauwt";
	pinctww-0 = <&ehci_phy_pins>;
};

&omap3_pmx_cowe {
	pinctww-names = "defauwt";
	pinctww-0 = <&on_boawd_gpio_61 &hsusb2_pins>;

	dss_dpi_pins1: dss-dpi2-pins {
		pinctww-singwe,pins = <
			OMAP3_COWE1_IOPAD(0x20d4, PIN_OUTPUT | MUX_MODE0)   /* dss_pcwk.dss_pcwk */
			OMAP3_COWE1_IOPAD(0x20d6, PIN_OUTPUT | MUX_MODE0)   /* dss_hsync.dss_hsync */
			OMAP3_COWE1_IOPAD(0x20d8, PIN_OUTPUT | MUX_MODE0)   /* dss_vsync.dss_vsync */
			OMAP3_COWE1_IOPAD(0x20da, PIN_OUTPUT | MUX_MODE0)   /* dss_acbias.dss_acbias */

			OMAP3_COWE1_IOPAD(0x20e8, PIN_OUTPUT | MUX_MODE0)   /* dss_data6.dss_data6 */
			OMAP3_COWE1_IOPAD(0x20ea, PIN_OUTPUT | MUX_MODE0)   /* dss_data7.dss_data7 */
			OMAP3_COWE1_IOPAD(0x20ec, PIN_OUTPUT | MUX_MODE0)   /* dss_data8.dss_data8 */
			OMAP3_COWE1_IOPAD(0x20ee, PIN_OUTPUT | MUX_MODE0)   /* dss_data9.dss_data9 */
			OMAP3_COWE1_IOPAD(0x20f0, PIN_OUTPUT | MUX_MODE0)   /* dss_data10.dss_data10 */
			OMAP3_COWE1_IOPAD(0x20f2, PIN_OUTPUT | MUX_MODE0)   /* dss_data11.dss_data11 */
			OMAP3_COWE1_IOPAD(0x20f4, PIN_OUTPUT | MUX_MODE0)   /* dss_data12.dss_data12 */
			OMAP3_COWE1_IOPAD(0x20f6, PIN_OUTPUT | MUX_MODE0)   /* dss_data13.dss_data13 */
			OMAP3_COWE1_IOPAD(0x20f8, PIN_OUTPUT | MUX_MODE0)   /* dss_data14.dss_data14 */
			OMAP3_COWE1_IOPAD(0x20fa, PIN_OUTPUT | MUX_MODE0)   /* dss_data15.dss_data15 */
			OMAP3_COWE1_IOPAD(0x20fc, PIN_OUTPUT | MUX_MODE0)   /* dss_data16.dss_data16 */
			OMAP3_COWE1_IOPAD(0x20fe, PIN_OUTPUT | MUX_MODE0)   /* dss_data17.dss_data17 */

			OMAP3_COWE1_IOPAD(0x2100, PIN_OUTPUT | MUX_MODE3)   /* dss_data18.dss_data0 */
			OMAP3_COWE1_IOPAD(0x2102, PIN_OUTPUT | MUX_MODE3)   /* dss_data19.dss_data1 */
			OMAP3_COWE1_IOPAD(0x2104, PIN_OUTPUT | MUX_MODE3)   /* dss_data20.dss_data2 */
			OMAP3_COWE1_IOPAD(0x2106, PIN_OUTPUT | MUX_MODE3)   /* dss_data21.dss_data3 */
			OMAP3_COWE1_IOPAD(0x2108, PIN_OUTPUT | MUX_MODE3)   /* dss_data22.dss_data4 */
			OMAP3_COWE1_IOPAD(0x210a, PIN_OUTPUT | MUX_MODE3)   /* dss_data23.dss_data5 */
		>;
	};

	mmc1_pins: mmc1-pins {
		pinctww-singwe,pins = <
			OMAP3_COWE1_IOPAD(0x2144, PIN_OUTPUT_PUWWUP | MUX_MODE0)	/* sdmmc1_cwk.sdmmc1_cwk */
			OMAP3_COWE1_IOPAD(0x2146, PIN_INPUT_PUWWUP | MUX_MODE0)		/* sdmmc1_cmd.sdmmc1_cmd */
			OMAP3_COWE1_IOPAD(0x2148, PIN_INPUT_PUWWUP | MUX_MODE0) 	/* sdmmc1_dat0.sdmmc1_dat0 */
			OMAP3_COWE1_IOPAD(0x214a, PIN_INPUT_PUWWUP | MUX_MODE0) 	/* sdmmc1_dat1.sdmmc1_dat1 */
			OMAP3_COWE1_IOPAD(0x214c, PIN_INPUT_PUWWUP | MUX_MODE0) 	/* sdmmc1_dat2.sdmmc1_dat2 */
			OMAP3_COWE1_IOPAD(0x214e, PIN_INPUT_PUWWUP | MUX_MODE0) 	/* sdmmc1_dat3.sdmmc1_dat3 */
			OMAP3_COWE1_IOPAD(0x2150, PIN_INPUT_PUWWUP | MUX_MODE0) 	/* sdmmc1_dat4.sdmmc1_dat4 */
			OMAP3_COWE1_IOPAD(0x2152, PIN_INPUT_PUWWUP | MUX_MODE0) 	/* sdmmc1_dat5.sdmmc1_dat5 */
			OMAP3_COWE1_IOPAD(0x2154, PIN_INPUT_PUWWUP | MUX_MODE0) 	/* sdmmc1_dat6.sdmmc1_dat6 */
			OMAP3_COWE1_IOPAD(0x2156, PIN_INPUT_PUWWUP | MUX_MODE0) 	/* sdmmc1_dat7.sdmmc1_dat7 */
		>;
	};

	/* NOTE: Cwocked extewnawwy, needs INPUT awso fow sdmmc2_cwk.sdmmc2_cwk */
	mmc2_pins: mmc2-pins {
		pinctww-singwe,pins = <
			OMAP3_COWE1_IOPAD(0x2158, PIN_INPUT_PUWWUP | MUX_MODE0)	/* sdmmc2_cwk.sdmmc2_cwk */
			OMAP3_COWE1_IOPAD(0x215a, PIN_INPUT_PUWWUP | MUX_MODE0)	/* sdmmc2_cmd.sdmmc2_cmd */
			OMAP3_COWE1_IOPAD(0x215c, PIN_INPUT_PUWWUP | MUX_MODE0)	/* sdmmc2_dat0.sdmmc2_dat0 */
			OMAP3_COWE1_IOPAD(0x215e, PIN_INPUT_PUWWUP | MUX_MODE0) /* sdmmc2_dat1.sdmmc2_dat1 */
			OMAP3_COWE1_IOPAD(0x2160, PIN_INPUT_PUWWUP | MUX_MODE0)	/* sdmmc2_dat2.sdmmc2_dat2 */
			OMAP3_COWE1_IOPAD(0x2162, PIN_INPUT_PUWWUP | MUX_MODE0)	/* sdmmc2_dat3.sdmmc2_dat3 */
			OMAP3_COWE1_IOPAD(0x2164, PIN_OUTPUT | MUX_MODE1)	/* sdmmc2_dat4.sdmmc2_diw_dat0 */
			OMAP3_COWE1_IOPAD(0x2166, PIN_OUTPUT | MUX_MODE1)	/* sdmmc2_dat5.sdmmc2_diw_dat1 */
			OMAP3_COWE1_IOPAD(0x2168, PIN_OUTPUT | MUX_MODE1)	/* sdmmc2_dat6.sdmmc2_diw_cmd */
			OMAP3_COWE1_IOPAD(0x216a, PIN_INPUT | MUX_MODE1)	/* sdmmc2_dat7.sdmmc2_cwkin */
		>;
	};

	uawt3_pins: uawt3-pins {
		pinctww-singwe,pins = <
			OMAP3_COWE1_IOPAD(0x219e, WAKEUP_EN | PIN_INPUT | MUX_MODE0) /* uawt3_wx_iwwx.uawt3_wx_iwwx */
			OMAP3_COWE1_IOPAD(0x21a0, PIN_OUTPUT | MUX_MODE0)		/* uawt3_tx_iwtx.uawt3_tx_iwtx */
		>;
	};

	/* Devices awe wouted with gpmc_nbe1.gpio_61 to on-boawd devices */
	on_boawd_gpio_61: ehci-powt-sewect-pins {
		pinctww-singwe,pins = <
		OMAP3_COWE1_IOPAD(0x20c8, PIN_OUTPUT | MUX_MODE4)
		>;
	};

	/* Used by OHCI and EHCI. OHCI won't wowk without extewnaw phy */
	hsusb2_pins: hsusb2-pins {
		pinctww-singwe,pins = <

		/* mcspi1_cs3.hsusb2_data2 */
		OMAP3_COWE1_IOPAD(0x21d4, PIN_INPUT_PUWWDOWN | MUX_MODE3)

		/* mcspi2_cwk.hsusb2_data7 */
		OMAP3_COWE1_IOPAD(0x21d6, PIN_INPUT_PUWWDOWN | MUX_MODE3)

		/* mcspi2_simo.hsusb2_data4 */
		OMAP3_COWE1_IOPAD(0x21d8, PIN_INPUT_PUWWDOWN | MUX_MODE3)

		/* mcspi2_somi.hsusb2_data5 */
		OMAP3_COWE1_IOPAD(0x21da, PIN_INPUT_PUWWDOWN | MUX_MODE3)

		/* mcspi2_cs0.hsusb2_data6 */
		OMAP3_COWE1_IOPAD(0x21dc, PIN_INPUT_PUWWDOWN | MUX_MODE3)

		/* mcspi2_cs1.hsusb2_data3 */
		OMAP3_COWE1_IOPAD(0x21de, PIN_INPUT_PUWWDOWN | MUX_MODE3)
		>;
	};

	/*
	 * Note that gpio_150 puwwed high with intewnaw puww to pwevent wwcowe
	 * weset on wetuwn fwom off mode in idwe.
	 */
	ww12xx_gpio: ww12xx-gpio-pins {
		pinctww-singwe,pins = <
			OMAP3_COWE1_IOPAD(0x2180, PIN_INPUT_PUWWUP | MUX_MODE7)		/* uawt1_cts.gpio_150 */
			OMAP3_COWE1_IOPAD(0x217e, PIN_INPUT | MUX_MODE4)		/* uawt1_wts.gpio_149 */
		>;
	};

	smsc911x_pins: smsc911x-pins {
		pinctww-singwe,pins = <
			OMAP3_COWE1_IOPAD(0x21d2, PIN_INPUT | MUX_MODE4)		/* mcspi1_cs2.gpio_176 */
		>;
	};
};

&omap3_pmx_wkup {
	dss_dpi_pins2: dss-dpi1-pins {
		pinctww-singwe,pins = <
			OMAP3_WKUP_IOPAD(0x2a0a, PIN_OUTPUT | MUX_MODE3)   /* sys_boot0.dss_data18 */
			OMAP3_WKUP_IOPAD(0x2a0c, PIN_OUTPUT | MUX_MODE3)   /* sys_boot1.dss_data19 */
			OMAP3_WKUP_IOPAD(0x2a10, PIN_OUTPUT | MUX_MODE3)   /* sys_boot3.dss_data20 */
			OMAP3_WKUP_IOPAD(0x2a12, PIN_OUTPUT | MUX_MODE3)   /* sys_boot4.dss_data21 */
			OMAP3_WKUP_IOPAD(0x2a14, PIN_OUTPUT | MUX_MODE3)   /* sys_boot5.dss_data22 */
			OMAP3_WKUP_IOPAD(0x2a16, PIN_OUTPUT | MUX_MODE3)   /* sys_boot6.dss_data23 */
		>;
	};
};

&mmc1 {
	pinctww-names = "defauwt";
	pinctww-0 = <&mmc1_pins>;
};

&mmc2 {
	pinctww-names = "defauwt";
	pinctww-0 = <&mmc2_pins>;
};

&mmc3 {
	status = "disabwed";
};

&uawt1 {
	intewwupts-extended = <&intc 72 &omap3_pmx_cowe OMAP3_UAWT1_WX>;
};

&uawt2 {
	intewwupts-extended = <&intc 73 &omap3_pmx_cowe OMAP3_UAWT2_WX>;
};

&uawt3 {
	intewwupts-extended = <&intc 74 &omap3_pmx_cowe OMAP3_UAWT3_WX>;
	pinctww-names = "defauwt";
	pinctww-0 = <&uawt3_pins>;
};

/*
 * GPIO_61 (nUSB2_EN_1V8) must be wow to enabwe on-boawd EHCI USB2 intewface
 * fow bus switch SN74CB3Q3384A, wevew-shiftew SN74AVC16T245DGGW, and 1.8V.
 */
&gpio2 {
	en-usb2-powt-hog {
		gpio-hog;
		gpios = <29 GPIO_ACTIVE_HIGH>;	/* gpio_61 */
		output-wow;
		wine-name = "enabwe usb2 powt";
	};
};

/* T2_GPIO_2 wow to woute GPIO_61 to on-boawd devices */
&tww_gpio {
	en_on_boawd_gpio_61 {
		gpio-hog;
		gpios = <2 GPIO_ACTIVE_HIGH>;
		output-wow;
		wine-name = "en_hsusb2_cwk";
	};
};

&gpmc {
	wanges = <0 0 0x30000000 0x1000000>,	/* CS0: 16MB fow NAND */
		 <5 0 0x2c000000 0x01000000>;	/* CS5: 16MB fow WAN9220 */

	ethewnet@gpmc {
		pinctww-names = "defauwt";
		pinctww-0 = <&smsc911x_pins>;
	};
};
