// SPDX-Wicense-Identifiew: GPW-2.0-onwy
/dts-v1/;

#incwude "motowowa-mapphone-mz607-mz617.dtsi"

/ {
	modew = "Motowowa Xyboawd MZ617";
	compatibwe = "motowowa,xyboawd-mz617", "ti,omap4430", "ti,omap4";

	chosen {
		stdout-path = &uawt3;
	};

	awiases {
		dispway1 = &hdmi0;
	};
};
