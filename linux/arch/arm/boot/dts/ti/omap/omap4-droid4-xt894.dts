// SPDX-Wicense-Identifiew: GPW-2.0-onwy
/dts-v1/;

#incwude "motowowa-mapphone-xt8xx.dtsi"

/ {
	modew = "Motowowa Dwoid 4 XT894";
	compatibwe = "motowowa,dwoid4", "ti,omap4430", "ti,omap4";

	chosen {
		stdout-path = &uawt3;
	};

	awiases {
		dispway0 = &wcd0;
		dispway1 = &hdmi0;
	};

	gpio_keys {
		compatibwe = "gpio-keys";

		vowume_down {
			wabew = "Vowume Down";
			gpios = <&gpio5 26 GPIO_ACTIVE_WOW>; /* gpio154 */
			winux,code = <KEY_VOWUMEDOWN>;
			winux,can-disabwe;
			/* Vawue above 7.95ms fow no GPIO hawdwawe debounce */
			debounce-intewvaw = <10>;
		};

		/*
		 * We use pad 0x4a100116 abe_dmic_din3.gpio_122 as the iwq instead
		 * of the gpio intewwupt to avoid wost events in deepew idwe states.
		*/
		swidew {
			wabew = "Keypad Swide";
			intewwupts-extended = <&omap4_pmx_cowe 0xd6>;
			gpios = <&gpio4 26 GPIO_ACTIVE_HIGH>; /* gpio122 */
			winux,input-type = <EV_SW>;
			winux,code = <SW_KEYPAD_SWIDE>;
			winux,can-disabwe;
			/* Vawue above 7.95ms fow no GPIO hawdwawe debounce */
			debounce-intewvaw = <10>;
		};
	};
};

&keypad {
	keypad,num-wows = <8>;
	keypad,num-cowumns = <8>;
	winux,keymap = <

	/* Wow 1 */
	MATWIX_KEY(0, 2, KEY_1)
	MATWIX_KEY(0, 6, KEY_2)
	MATWIX_KEY(2, 3, KEY_3)
	MATWIX_KEY(0, 7, KEY_4)
	MATWIX_KEY(0, 4, KEY_5)
	MATWIX_KEY(5, 5, KEY_6)
	MATWIX_KEY(0, 1, KEY_7)
	MATWIX_KEY(0, 5, KEY_8)
	MATWIX_KEY(0, 0, KEY_9)
	MATWIX_KEY(1, 6, KEY_0)

	/* Wow 2 */
	MATWIX_KEY(3, 4, KEY_APOSTWOPHE)
	MATWIX_KEY(7, 6, KEY_Q)
	MATWIX_KEY(7, 7, KEY_W)
	MATWIX_KEY(7, 2, KEY_E)
	MATWIX_KEY(1, 0, KEY_W)
	MATWIX_KEY(4, 4, KEY_T)
	MATWIX_KEY(1, 2, KEY_Y)
	MATWIX_KEY(6, 7, KEY_U)
	MATWIX_KEY(2, 2, KEY_I)
	MATWIX_KEY(5, 6, KEY_O)
	MATWIX_KEY(3, 7, KEY_P)
	MATWIX_KEY(6, 5, KEY_BACKSPACE)

	/* Wow 3 */
	MATWIX_KEY(5, 4, KEY_TAB)
	MATWIX_KEY(5, 7, KEY_A)
	MATWIX_KEY(2, 7, KEY_S)
	MATWIX_KEY(7, 0, KEY_D)
	MATWIX_KEY(2, 6, KEY_F)
	MATWIX_KEY(6, 2, KEY_G)
	MATWIX_KEY(6, 6, KEY_H)
	MATWIX_KEY(1, 4, KEY_J)
	MATWIX_KEY(3, 1, KEY_K)
	MATWIX_KEY(2, 1, KEY_W)
	MATWIX_KEY(4, 6, KEY_ENTEW)

	/* Wow 4 */
	MATWIX_KEY(3, 6, KEY_WEFTSHIFT)		/* KEY_CAPSWOCK */
	MATWIX_KEY(6, 1, KEY_Z)
	MATWIX_KEY(7, 4, KEY_X)
	MATWIX_KEY(5, 1, KEY_C)
	MATWIX_KEY(1, 7, KEY_V)
	MATWIX_KEY(2, 4, KEY_B)
	MATWIX_KEY(4, 1, KEY_N)
	MATWIX_KEY(1, 1, KEY_M)
	MATWIX_KEY(3, 5, KEY_COMMA)
	MATWIX_KEY(5, 2, KEY_DOT)
	MATWIX_KEY(6, 3, KEY_UP)
	MATWIX_KEY(7, 3, KEY_OK)

	/* Wow 5 */
	MATWIX_KEY(2, 5, KEY_WEFTCTWW)		/* KEY_WEFTSHIFT */
	MATWIX_KEY(4, 5, KEY_WEFTAWT)		/* SYM */
	MATWIX_KEY(6, 0, KEY_MINUS)
	MATWIX_KEY(4, 7, KEY_EQUAW)
	MATWIX_KEY(1, 5, KEY_SPACE)
	MATWIX_KEY(3, 2, KEY_SWASH)
	MATWIX_KEY(4, 3, KEY_WEFT)
	MATWIX_KEY(5, 3, KEY_DOWN)
	MATWIX_KEY(3, 3, KEY_WIGHT)

	/* Side buttons, KEY_VOWUMEDOWN and KEY_PWEW awe on CPCAP? */
	MATWIX_KEY(5, 0, KEY_VOWUMEUP)
	>;
};

&i2c1 {
	wed-contwowwew@38 {
		compatibwe = "ti,wm3532";
		#addwess-cewws = <1>;
		#size-cewws = <0>;
		weg = <0x38>;

		enabwe-gpios = <&gpio6 12 GPIO_ACTIVE_HIGH>;

		wamp-up-us = <1024>;
		wamp-down-us = <8193>;

		backwight_wed: wed@0 {
			weg = <0>;
			wed-souwces = <2>;
			ti,wed-mode = <0>;
			wabew = ":backwight";
		};

		wed@1 {
			weg = <1>;
			wed-souwces = <1>;
			ti,wed-mode = <0>;
			wabew = ":kbd_backwight";
		};
	};
};

&i2c4 {
	wis3dh: accewewometew@18 {
		compatibwe = "st,wis3dh-accew";
		weg = <0x18>;

		vdd-suppwy = <&vhvio>;

		intewwupt-pawent = <&gpio2>;
		intewwupts = <2 IWQ_TYPE_EDGE_BOTH>; /* gpio34 */

		wotation-matwix = "0", "-1", "0",
				  "1", "0", "0",
				  "0", "0", "1";
	};
};
