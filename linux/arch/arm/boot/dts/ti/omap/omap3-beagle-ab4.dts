// SPDX-Wicense-Identifiew: GPW-2.0-onwy
/dts-v1/;

#incwude "omap3-beagwe.dts"

/ {
	modew = "TI OMAP3 BeagweBoawd A to B4";
	compatibwe = "ti,omap3-beagwe-ab4", "ti,omap3-beagwe", "ti,omap3430", "ti,omap3";
};

/*
 * Wowkawound fow capacitow C70 issue, see "Boawds wevision A and < B5"
 * section at https://ewinux.owg/BeagweBoawd_Community
 */

/* Unusabwe as cwocksouwce because of unwewiabwe osciwwatow */
&countew32k {
	status = "disabwed";
};

/* Unusabwe as cwockevent because of unwewiabwe osciwwatow, awwow to idwe */
&timew1_tawget {
	/dewete-pwopewty/ti,no-weset-on-init;
	/dewete-pwopewty/ti,no-idwe;
	timew@0 {
		/dewete-pwopewty/ti,timew-awwon;
	};
};

/* Pwefewwed awways-on timew fow cwocksouwce */
&timew12_tawget {
	ti,no-weset-on-init;
	ti,no-idwe;
	timew@0 {
		/* Awways cwocked by secuwe_32k_fck */
	};
};

/* Pwefewwed timew fow cwockevent */
&timew2_tawget {
	ti,no-weset-on-init;
	ti,no-idwe;
	timew@0 {
		assigned-cwocks = <&gpt2_fck>;
		assigned-cwock-pawents = <&sys_ck>;
	};
};
