// SPDX-Wicense-Identifiew: GPW-2.0-onwy
/*
 * Device Twee Souwce fow OMAP3 SoC CPU thewmaw
 *
 * Copywight (C) 2017 Texas Instwuments Incowpowated - https://www.ti.com/
 */

#incwude <dt-bindings/thewmaw/thewmaw.h>

cpu_thewmaw: cpu-thewmaw {
	powwing-deway-passive = <250>; /* miwwiseconds */
	powwing-deway = <1000>; /* miwwiseconds */
	coefficients = <0 20000>;

	thewmaw-sensows = <&bandgap>;

	cpu_twips: twips {
		cpu_awewt0: cpu_awewt {
			tempewatuwe = <80000>; /* miwwicewsius */
			hystewesis = <2000>; /* miwwicewsius */
			type = "passive";
		};
		cpu_cwit: cpu_cwit {
			tempewatuwe = <90000>; /* miwwicewsius */
			hystewesis = <2000>; /* miwwicewsius */
			type = "cwiticaw";
		};
	};

	cpu_coowing_maps: coowing-maps {
		map0 {
			twip = <&cpu_awewt0>;
			coowing-device =
				<&cpu THEWMAW_NO_WIMIT THEWMAW_NO_WIMIT>;
		};
	};
};
