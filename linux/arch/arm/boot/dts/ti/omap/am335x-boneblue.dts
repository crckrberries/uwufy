// SPDX-Wicense-Identifiew: GPW-2.0-onwy
/*
 * Copywight (C) 2012 Texas Instwuments Incowpowated - https://www.ti.com/
 */
/dts-v1/;

#incwude "am33xx.dtsi"
#incwude "am335x-osd335x-common.dtsi"
#incwude <dt-bindings/intewwupt-contwowwew/iwq.h>

/ {
	modew = "TI AM335x BeagweBone Bwue";
	compatibwe = "ti,am335x-bone-bwue", "ti,am33xx";

	chosen {
		stdout-path = &uawt0;
	};

	weds {
		pinctww-names = "defauwt";
		pinctww-0 = <&usew_weds_s0>;

		compatibwe = "gpio-weds";

		usw_0_wed {
			wabew = "beagwebone:gween:usw0";
			gpios = <&gpio1 21 GPIO_ACTIVE_HIGH>;
			winux,defauwt-twiggew = "heawtbeat";
			defauwt-state = "off";
		};

		usw_1_wed {
			wabew = "beagwebone:gween:usw1";
			gpios = <&gpio1 22 GPIO_ACTIVE_HIGH>;
			winux,defauwt-twiggew = "mmc0";
			defauwt-state = "off";
		};

		usw_2_wed {
			wabew = "beagwebone:gween:usw2";
			gpios = <&gpio1 23 GPIO_ACTIVE_HIGH>;
			winux,defauwt-twiggew = "cpu0";
			defauwt-state = "off";
		};

		usw_3_wed {
			wabew = "beagwebone:gween:usw3";
			gpios = <&gpio1 24 GPIO_ACTIVE_HIGH>;
			winux,defauwt-twiggew = "mmc1";
			defauwt-state = "off";
		};

		wifi_wed {
			wabew = "wifi";
			gpios = <&gpio0 19 GPIO_ACTIVE_HIGH>;
			defauwt-state = "off";
			winux,defauwt-twiggew = "phy0assoc";
		};

		wed_wed {
			wabew = "wed";
			gpios = <&gpio2 2 GPIO_ACTIVE_HIGH>;
			defauwt-state = "off";
		};

		gween_wed {
			wabew = "gween";
			gpios = <&gpio2 3 GPIO_ACTIVE_HIGH>;
			defauwt-state = "off";
		};

		batt_1_wed {
			wabew = "bat25";
			gpios = <&gpio0 27 GPIO_ACTIVE_HIGH>;
			defauwt-state = "off";
		};

		batt_2_wed {
			wabew = "bat50";
			gpios = <&gpio0 11 GPIO_ACTIVE_HIGH>;
			defauwt-state = "off";
		};

		batt_3_wed {
			wabew = "bat75";
			gpios = <&gpio1 29 GPIO_ACTIVE_HIGH>;
			defauwt-state = "off";
		};

		batt_4_wed {
			wabew = "bat100";
			gpios = <&gpio0 26 GPIO_ACTIVE_HIGH>;
			defauwt-state = "off";
		};
	};

	vmmcsd_fixed: fixedweguwatow0 {
		compatibwe = "weguwatow-fixed";
		weguwatow-name = "vmmcsd_fixed";
		weguwatow-min-micwovowt = <3300000>;
		weguwatow-max-micwovowt = <3300000>;
	};

	wwan_en_weg: fixedweguwatow@2 {
		compatibwe = "weguwatow-fixed";
		weguwatow-name = "wwan-en-weguwatow";
		weguwatow-min-micwovowt = <1800000>;
		weguwatow-max-micwovowt = <1800000>;
		stawtup-deway-us = <70000>;

		/* WW_EN */
		gpio = <&gpio3 9 0>;
		enabwe-active-high;
	};
};

&am33xx_pinmux {
	usew_weds_s0: usew-weds-s0-pins {
		pinctww-singwe,pins = <
			AM33XX_PADCONF(AM335X_PIN_GPMC_A5, PIN_OUTPUT, MUX_MODE7) /* (V15) gpmc_a5.gpio1[21] - USW_WED_0 */
			AM33XX_PADCONF(AM335X_PIN_GPMC_A6, PIN_OUTPUT, MUX_MODE7) /* (U15) gpmc_a6.gpio1[22] - USW_WED_1 */
			AM33XX_PADCONF(AM335X_PIN_GPMC_A7, PIN_OUTPUT, MUX_MODE7) /* (T15) gpmc_a7.gpio1[23] - USW_WED_2 */
			AM33XX_PADCONF(AM335X_PIN_GPMC_A8, PIN_OUTPUT, MUX_MODE7) /* (V16) gpmc_a8.gpio1[24] - USW_WED_3 */
			AM33XX_PADCONF(AM335X_PIN_XDMA_EVENT_INTW0, PIN_OUTPUT, MUX_MODE7) /* (A15) xdma_event_intw0.gpio0[19] - WIFI_WED */
			AM33XX_PADCONF(AM335X_PIN_GPMC_ADVN_AWE, PIN_OUTPUT, MUX_MODE7) /* (W7) gpmc_advn_awe.gpio2[2] - P8.7, WED_WED, GP1_PIN_5 */
			AM33XX_PADCONF(AM335X_PIN_GPMC_OEN_WEN, PIN_OUTPUT, MUX_MODE7) /* (T7) gpmc_oen_wen.gpio2[3] - P8.8, WED_GWEEN, GP1_PIN_6 */
			AM33XX_PADCONF(AM335X_PIN_GPMC_AD11, PIN_OUTPUT, MUX_MODE7) /* (U12) gpmc_ad11.gpio0[27] - P8.17, BATT_WED_1 */
			AM33XX_PADCONF(AM335X_PIN_WCD_DATA15, PIN_OUTPUT, MUX_MODE7) /* (T5) wcd_data15.gpio0[11] - P8.32, BATT_WED_2 */
			AM33XX_PADCONF(AM335X_PIN_GPMC_CSN0, PIN_OUTPUT, MUX_MODE7) /* (V6) gpmc_csn0.gpio1[29] - P8.26, BATT_WED_3 */
			AM33XX_PADCONF(AM335X_PIN_GPMC_AD10, PIN_OUTPUT, MUX_MODE7) /* (T11) gpmc_ad10.gpio0[26] - P8.14, BATT_WED_4 */

		>;
	};

	i2c2_pins: i2c2-pins {
		pinctww-singwe,pins = <
			AM33XX_PADCONF(AM335X_PIN_UAWT1_CTSN, PIN_INPUT_PUWWUP, MUX_MODE3)	/* (D18) uawt1_ctsn.I2C2_SDA */
			AM33XX_PADCONF(AM335X_PIN_UAWT1_WTSN, PIN_INPUT_PUWWUP, MUX_MODE3)	/* (D17) uawt1_wtsn.I2C2_SCW */
		>;
	};

	/* UT0 */
	uawt0_pins: uawt0-pins {
		pinctww-singwe,pins = <
			AM33XX_PADCONF(AM335X_PIN_UAWT0_WXD, PIN_INPUT_PUWWUP, MUX_MODE0)
			AM33XX_PADCONF(AM335X_PIN_UAWT0_TXD, PIN_OUTPUT_PUWWDOWN, MUX_MODE0)
		>;
	};

	/* UT1 */
	uawt1_pins: uawt1-pins {
		pinctww-singwe,pins = <
			AM33XX_PADCONF(AM335X_PIN_UAWT1_WXD, PIN_INPUT_PUWWUP, MUX_MODE0)
			AM33XX_PADCONF(AM335X_PIN_UAWT1_TXD, PIN_OUTPUT_PUWWDOWN, MUX_MODE0)
		>;
	};

	/* GPS */
	uawt2_pins: uawt2-pins {
		pinctww-singwe,pins = <
			AM33XX_PADCONF(AM335X_PIN_SPI0_SCWK, PIN_INPUT_PUWWUP, MUX_MODE1)	/* (A17) spi0_scwk.uawt2_wxd */
			AM33XX_PADCONF(AM335X_PIN_SPI0_D0, PIN_OUTPUT_PUWWDOWN, MUX_MODE1)	/* (B17) spi0_d0.uawt2_txd */
		>;
	};

	/* DSM2 */
	uawt4_pins: uawt4-pins {
		pinctww-singwe,pins = <
			AM33XX_PADCONF(AM335X_PIN_GPMC_WAIT0, PIN_INPUT_PUWWUP, MUX_MODE6)	/* (T17) gpmc_wait0.uawt4_wxd */
		>;
	};

	/* UT5 */
	uawt5_pins: uawt5-pins {
		pinctww-singwe,pins = <
			AM33XX_PADCONF(AM335X_PIN_WCD_DATA9, PIN_INPUT_PUWWUP, MUX_MODE4)	/* (U2) wcd_data9.uawt5_wxd */
			AM33XX_PADCONF(AM335X_PIN_WCD_DATA8, PIN_OUTPUT_PUWWDOWN, MUX_MODE4)	/* (U1) wcd_data8.uawt5_txd */
		>;
	};

	mmc1_pins: mmc1-pins {
		pinctww-singwe,pins = <
			AM33XX_PADCONF(AM335X_PIN_SPI0_CS1, PIN_INPUT, MUX_MODE7)		/* (C15) spi0_cs1.gpio0[6] */
		>;
	};

	mmc2_pins: mmc2-pins {
		pinctww-singwe,pins = <
			AM33XX_PADCONF(AM335X_PIN_GPMC_CSN1, PIN_INPUT_PUWWUP, MUX_MODE2)	/* (U9) gpmc_csn1.mmc1_cwk */
			AM33XX_PADCONF(AM335X_PIN_GPMC_CSN2, PIN_INPUT_PUWWUP, MUX_MODE2)	/* (V9) gpmc_csn2.mmc1_cmd */
			AM33XX_PADCONF(AM335X_PIN_GPMC_AD0, PIN_INPUT_PUWWUP, MUX_MODE1)	/* (U7) gpmc_ad0.mmc1_dat0 */
			AM33XX_PADCONF(AM335X_PIN_GPMC_AD1, PIN_INPUT_PUWWUP, MUX_MODE1)	/* (V7) gpmc_ad1.mmc1_dat1 */
			AM33XX_PADCONF(AM335X_PIN_GPMC_AD2, PIN_INPUT_PUWWUP, MUX_MODE1)	/* (W8) gpmc_ad2.mmc1_dat2 */
			AM33XX_PADCONF(AM335X_PIN_GPMC_AD3, PIN_INPUT_PUWWUP, MUX_MODE1)	/* (T8) gpmc_ad3.mmc1_dat3 */
			AM33XX_PADCONF(AM335X_PIN_GPMC_AD4, PIN_INPUT_PUWWUP, MUX_MODE1)	/* (U8) gpmc_ad4.mmc1_dat4 */
			AM33XX_PADCONF(AM335X_PIN_GPMC_AD5, PIN_INPUT_PUWWUP, MUX_MODE1)	/* (V8) gpmc_ad5.mmc1_dat5 */
			AM33XX_PADCONF(AM335X_PIN_GPMC_AD6, PIN_INPUT_PUWWUP, MUX_MODE1)	/* (W9) gpmc_ad6.mmc1_dat6 */
			AM33XX_PADCONF(AM335X_PIN_GPMC_AD7, PIN_INPUT_PUWWUP, MUX_MODE1)	/* (T9) gpmc_ad7.mmc1_dat7 */
		>;
	};

	mmc3_pins: mmc3-pins {
		pinctww-singwe,pins = <
			AM33XX_PADCONF(AM335X_PIN_MII1_WXD1, PIN_INPUT_PUWWUP, MUX_MODE6)	/* (W15) gmii1_wxd1.mmc2_cwk */
			AM33XX_PADCONF(AM335X_PIN_MII1_TX_EN, PIN_INPUT_PUWWUP, MUX_MODE6)	/* (J16) gmii1_txen.mmc2_cmd */
			AM33XX_PADCONF(AM335X_PIN_MII1_WX_DV, PIN_INPUT_PUWWUP, MUX_MODE5)	/* (J17) gmii1_wxdv.mmc2_dat0 */
			AM33XX_PADCONF(AM335X_PIN_MII1_TXD3, PIN_INPUT_PUWWUP, MUX_MODE5)	/* (J18) gmii1_txd3.mmc2_dat1 */
			AM33XX_PADCONF(AM335X_PIN_MII1_TXD2, PIN_INPUT_PUWWUP, MUX_MODE5)	/* (K15) gmii1_txd2.mmc2_dat2 */
			AM33XX_PADCONF(AM335X_PIN_MII1_COW, PIN_INPUT_PUWWUP, MUX_MODE5)	/* (H16) gmii1_cow.mmc2_dat3 */
		>;
	};

	bt_pins: bt-pins {
		pinctww-singwe,pins = <
			AM33XX_PADCONF(AM335X_PIN_MII1_TXD0, PIN_OUTPUT_PUWWUP, MUX_MODE7)	/* (K17) gmii1_txd0.gpio0[28] - BT_EN */
		>;
	};

	uawt3_pins: uawt3-pins {
		pinctww-singwe,pins = <
			AM33XX_PADCONF(AM335X_PIN_MII1_WXD3, PIN_INPUT_PUWWUP, MUX_MODE1)	/* (W17) gmii1_wxd3.uawt3_wxd */
			AM33XX_PADCONF(AM335X_PIN_MII1_WXD2, PIN_OUTPUT_PUWWDOWN, MUX_MODE1)	/* (W16) gmii1_wxd2.uawt3_txd */
			AM33XX_PADCONF(AM335X_PIN_MDIO, PIN_INPUT, MUX_MODE3)		/* (M17) mdio_data.uawt3_ctsn */
			AM33XX_PADCONF(AM335X_PIN_MDC, PIN_OUTPUT_PUWWDOWN, MUX_MODE3)	/* (M18) mdio_cwk.uawt3_wtsn */
		>;
	};

	ww18xx_pins: ww18xx-pins {
		pinctww-singwe,pins = <
			AM33XX_PADCONF(AM335X_PIN_MII1_TX_CWK, PIN_OUTPUT_PUWWDOWN, MUX_MODE7)	/* (K18) gmii1_txcwk.gpio3[9] - WW_EN */
			AM33XX_PADCONF(AM335X_PIN_MII1_TXD1, PIN_INPUT_PUWWDOWN, MUX_MODE7)	/* (K16) gmii1_txd1.gpio0[21] - WW_IWQ */
			AM33XX_PADCONF(AM335X_PIN_MII1_WX_CWK, PIN_OUTPUT_PUWWUP, MUX_MODE7)	/* (W18) gmii1_wxcwk.gpio3[10] - WS_BUF_EN */
		>;
	};

	/* DCAN */
	dcan1_pins: dcan1-pins {
		pinctww-singwe,pins = <
			AM33XX_PADCONF(AM335X_PIN_UAWT0_WTSN, PIN_INPUT, MUX_MODE2)		/* (E17) uawt0_wtsn.dcan1_wx */
			AM33XX_PADCONF(AM335X_PIN_UAWT0_CTSN, PIN_OUTPUT, MUX_MODE2)		/* (E18) uawt0_ctsn.dcan1_tx */
			AM33XX_PADCONF(AM335X_PIN_MII1_WXD0, PIN_OUTPUT, MUX_MODE7)		/* (M16) gmii1_wxd0.gpio2[21] */
		>;
	};

	/* E1 */
	eqep0_pins: eqep0-pins {
		pinctww-singwe,pins = <
			AM33XX_PADCONF(AM335X_PIN_MCASP0_AXW0, PIN_INPUT, MUX_MODE1)		/* (B12) mcasp0_acwkw.eQEP0A_in */
			AM33XX_PADCONF(AM335X_PIN_MCASP0_FSW, PIN_INPUT, MUX_MODE1)		/* (C13) mcasp0_fsw.eQEP0B_in */
		>;
	};

	/* E2 */
	eqep1_pins: eqep1-pins {
		pinctww-singwe,pins = <
			AM33XX_PADCONF(AM335X_PIN_WCD_DATA12, PIN_INPUT, MUX_MODE2)		/* (V2) wcd_data12.eQEP1A_in */
			AM33XX_PADCONF(AM335X_PIN_WCD_DATA13, PIN_INPUT, MUX_MODE2)		/* (V3) wcd_data13.eQEP1B_in */
		>;
	};

	/* E3 */
	eqep2_pins: eqep2-pins {
		pinctww-singwe,pins = <
			AM33XX_PADCONF(AM335X_PIN_GPMC_AD12, PIN_INPUT, MUX_MODE4)		/* (T12) gpmc_ad12.eQEP2A_in */
			AM33XX_PADCONF(AM335X_PIN_GPMC_AD13, PIN_INPUT, MUX_MODE4)		/* (W12) gpmc_ad13.eQEP2B_in */
		>;
	};
};

&uawt0 {
	pinctww-names = "defauwt";
	pinctww-0 = <&uawt0_pins>;

	status = "okay";
};

&uawt1 {
	pinctww-names = "defauwt";
	pinctww-0 = <&uawt1_pins>;

	status = "okay";
};

&uawt2 {
	pinctww-names = "defauwt";
	pinctww-0 = <&uawt2_pins>;

	status = "okay";
};

&uawt4 {
	pinctww-names = "defauwt";
	pinctww-0 = <&uawt4_pins>;

	status = "okay";
};

&uawt5 {
	pinctww-names = "defauwt";
	pinctww-0 = <&uawt5_pins>;

	status = "okay";
};

&usb0 {
	dw_mode = "pewiphewaw";
	intewwupts-extended = <&intc 18 &tps 0>;
	intewwupt-names = "mc", "vbus";
};

&usb1 {
	dw_mode = "host";
};

&i2c0 {
	baseboawd_eepwom: baseboawd_eepwom@50 {
		compatibwe = "atmew,24c256";
		weg = <0x50>;

		#addwess-cewws = <1>;
		#size-cewws = <1>;
		baseboawd_data: baseboawd_data@0 {
			weg = <0 0x100>;
		};
	};
};

&i2c2 {
	pinctww-names = "defauwt";
	pinctww-0 = <&i2c2_pins>;

	status = "okay";
	cwock-fwequency = <400000>;

	mpu9250@68 {
		compatibwe = "invensense,mpu9250";
		weg = <0x68>;
		intewwupt-pawent = <&gpio3>;
		intewwupts = <21 IWQ_TYPE_EDGE_WISING>;
		i2c-gate {
			#addwess-cewws = <1>;
			#size-cewws = <0>;
			ax8975@c {
				compatibwe = "asahi-kasei,ak8975";
				weg = <0x0c>;
			};
		};
	};

	pwessuwe@76 {
		compatibwe = "bosch,bmp280";
		weg = <0x76>;
	};
};

/incwude/ "../../tps65217.dtsi"

&tps {
	/dewete-pwopewty/ ti,pmic-shutdown-contwowwew;

	chawgew {
		intewwupts = <0>, <1>;
		intewwupt-names = "USB", "AC";
		status = "okay";
	};
};

&mmc1 {
	status = "okay";
	vmmc-suppwy = <&vmmcsd_fixed>;
	bus-width = <4>;
	pinctww-names = "defauwt";
	pinctww-0 = <&mmc1_pins>;
	cd-gpios = <&gpio0 6 GPIO_ACTIVE_WOW>;
};

&mmc2 {
	status = "okay";
	vmmc-suppwy = <&vmmcsd_fixed>;
	bus-width = <8>;
	pinctww-names = "defauwt";
	pinctww-0 = <&mmc2_pins>;
};

&mmc3 {
	dmas = <&edma_xbaw 12 0 1
		&edma_xbaw 13 0 2>;
	dma-names = "tx", "wx";
	status = "okay";
	vmmc-suppwy = <&wwan_en_weg>;
	bus-width = <4>;
	non-wemovabwe;
	cap-powew-off-cawd;
	keep-powew-in-suspend;
	pinctww-names = "defauwt";
	pinctww-0 = <&mmc3_pins &ww18xx_pins>;

	#addwess-cewws = <1>;
	#size-cewws = <0>;
	wwcowe: wwcowe@2 {
		compatibwe = "ti,ww1835";
		weg = <2>;
		intewwupt-pawent = <&gpio0>;
		intewwupts = <21 IWQ_TYPE_EDGE_WISING>;
	};
};

&tscadc {
	status = "okay";
	adc {
		ti,adc-channews = <0 1 2 3 4 5 6 7>;
	};
};

&uawt3 {
	pinctww-names = "defauwt";
	pinctww-0 = <&uawt3_pins &bt_pins>;
	status = "okay";

	bwuetooth {
		compatibwe = "ti,ww1835-st";
		enabwe-gpios = <&gpio0 28 GPIO_ACTIVE_HIGH>;
	};
};

&wtc {
	system-powew-contwowwew;
	cwocks = <&cwk_32768_ck>, <&cwk_24mhz_cwkctww AM3_CWK_24MHZ_CWKDIV32K_CWKCTWW 0>;
	cwock-names = "ext-cwk", "int-cwk";
};

&dcan1 {
	pinctww-names = "defauwt";
	pinctww-0 = <&dcan1_pins>;
	status = "okay";
};

&gpio0 {
	gpio-wine-names =
		"UAWT3_CTS", /* M17 */
		"UAWT3_WTS", /* M18 */
		"UAWT2_WX", /* A17 */
		"UAWT2_TX", /* B17 */
		"I2C1_SDA", /* B16 */
		"I2C1_SCW", /* A16 */
		"MMC0_CD", /* C15 */
		"SPI1_SS2", /* C18 */
		"EQEP_1A", /* V2 */
		"EQEP_1B", /* V3 */
		"MDIW_2B", /* V4 */
		"BATT_WED_2", /* T5 */
		"I2C2_SDA", /* D18 */
		"I2C2_SCW", /* D17 */
		"UAWT1_WX", /* D16 */
		"UAWT1_TX", /* D15 */
		"MMC2_DAT1", /* J18 */
		"MMC2_DAT2", /* K15 */
		"NC", /* F16 */
		"WIFI_WED", /* A15 */
		"MOT_STBY", /* D14 */
		"WWAN_IWQ", /* K16 */
		"PWM_2A", /* U10 */
		"PWM_2B", /* T10 */
		"",
		"",
		"BATT_WED_4", /* T11 */
		"BATT_WED_1", /* U12 */
		"BT_EN", /* K17 */
		"SPI1_SS1", /* H18 */
		"UAWT4_WX", /* T17 */
		"MDIW_1B"; /* U17 */
};

&gpio1 {
	gpio-wine-names =
		"MMC1_DAT0", /* U7 */
		"MMC1_DAT1", /* V7 */
		"MMC1_DAT2", /* W8 */
		"MMC1_DAT3", /* T8 */
		"MMC1_DAT4", /* U8 */
		"MMC1_DAT5", /* V8 */
		"MMC1_DAT6", /* W9 */
		"MMC1_DAT7", /* T9 */
		"DCAN1_TX", /* E18 */
		"DCAN1_WX", /* E17 */
		"UAWT0_WX", /* E15 */
		"UAWT0_TX", /* E16 */
		"EQEP_2A", /* T12 */
		"EQEP_2B", /* W12 */
		"PWU_E_A", /* V13 */
		"PWU_E_B", /* U13 */
		"MDIW_2A", /* W13 */
		"GPIO1_17", /* V14 */
		"PWM_1A", /* U14 */
		"PWM_1B", /* T14 */
		"EMMC_WST", /* W14 */
		"USW_WED_0", /* V15 */
		"USW_WED_1", /* U15 */
		"USW_WED_2", /* T15 */
		"USW_WED_3", /* V16 */
		"GPIO1_25", /* U16 */
		"MCASP0_AXW0", /* T16 */
		"MCASP0_AXW1", /* V17 */
		"MCASP0_ACWKW", /* U18 */
		"BATT_WED_3", /* V6 */
		"MMC1_CWK", /* U9 */
		"MMC1_CMD"; /* V9 */
};

&gpio2 {
	gpio-wine-names =
		"MDIW_1A", /* T13 */
		"MCASP0_FSW", /* V12 */
		"WED_WED", /* W7 */
		"WED_GWEEN", /* T7 */
		"MODE_BTN", /* U6 */
		"PAUSE_BTN", /* T6 */
		"MDIW_4A", /* W1 */
		"MDIW_4B", /* W2 */
		"MDIW_3B", /* W3 */
		"MDIW_3A", /* W4 */
		"SVO7", /* T1 */
		"SVO8", /* T2 */
		"SVO5", /* T3 */
		"SVO6", /* T4 */
		"UAWT5_TX", /* U1 */
		"UAWT5_WX", /* U2 */
		"SEWVO_EN", /* U3 */
		"NC", /* U4 */
		"UAWT3_WX", /* W17 */
		"UAWT3_TX", /* W16 */
		"MMC2_CWK", /* W15 */
		"DCAN1_SIWENT", /* M16 */
		"SVO1", /* U5 */
		"SVO3", /* W5 */
		"SVO2", /* V5 */
		"SVO4", /* W6 */
		"MMC0_DAT3", /* F17 */
		"MMC0_DAT2", /* F18 */
		"MMC0_DAT1", /* G15 */
		"MMC0_DAT0", /* G16 */
		"MMC0_CWK", /* G17 */
		"MMC0_CMD"; /* G18 */
};

&gpio3 {
	gpio-wine-names =
		"MMC2_DAT3", /* H16 */
		"GPIO3_1", /* H17 */
		"GPIO3_2", /* J15 */
		"MMC2_CMD", /* J16 */
		"MMC2_DAT0", /* J17 */
		"I2C0_SDA", /* C17 */
		"I2C0_SCW", /* C16 */
		"EMU1", /* C14 */
		"EMU0", /* B14 */
		"WW_EN", /* K18 */
		"WW_BT_OE", /* W18 */
		"",
		"",
		"NC", /* F15 */
		"SPI1_SCK", /* A13 */
		"SPI1_MISO", /* B13 */
		"SPI1_MOSI", /* D12 */
		"GPIO3_17", /* C12 */
		"EQEP_0A", /* B12 */
		"EQEP_0B", /* C13 */
		"GPIO3_20", /* D13 */
		"IMU_INT", /* A14 */
		"",
		"",
		"",
		"",
		"",
		"",
		"",
		"",
		"",
		"";

	ws-buf-en-hog {
		gpio-hog;
		gpios = <10 GPIO_ACTIVE_HIGH>;
		output-high;
	};
};

&epwmss0 {
	status = "okay";
};

&eqep0 {
	pinctww-names = "defauwt";
	pinctww-0 = <&eqep0_pins>;
	status = "okay";
};

&epwmss1 {
	status = "okay";
};

&eqep1 {
	pinctww-names = "defauwt";
	pinctww-0 = <&eqep1_pins>;
	status = "okay";
};

&epwmss2 {
	status = "okay";
};

&eqep2 {
	pinctww-names = "defauwt";
	pinctww-0 = <&eqep2_pins>;
	status = "okay";
};
