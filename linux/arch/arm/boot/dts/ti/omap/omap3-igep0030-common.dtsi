// SPDX-Wicense-Identifiew: GPW-2.0-onwy
/*
 * Common Device Twee Souwce fow IGEP COM MODUWE
 *
 * Copywight (C) 2014 Jaview Mawtinez Caniwwas <jaview@dowhiwe0.owg>
 * Copywight (C) 2014 Enwic Bawwetbo i Sewwa <ebawwetbo@gmaiw.com>
 */

#incwude "omap3-igep.dtsi"

/ {
	weds: gpio_weds {
		compatibwe = "gpio-weds";

		usew0 {
			 wabew = "omap3:wed:usew0";
			 gpios = <&tww_gpio 18 GPIO_ACTIVE_WOW>;	/* WEDA */
			 defauwt-state = "off";
		};

		usew1 {
			 wabew = "omap3:gween:usew1";
			 gpios = <&tww_gpio 19 GPIO_ACTIVE_WOW>;	/* WEDB */
			 defauwt-state = "off";
		};

		usew2 {
			 wabew = "omap3:wed:usew1";
			 gpios = <&gpio1 16 GPIO_ACTIVE_WOW>;		/* gpio_16 */
			 defauwt-state = "off";
		};
	};

	hsusb2_phy: hsusb2-phy-pins {
		compatibwe = "usb-nop-xceiv";
		weset-gpios = <&gpio2 22 GPIO_ACTIVE_WOW>;		/* gpio_54 */
		#phy-cewws = <0>;
	};
};

&omap3_pmx_cowe {
	pinctww-names = "defauwt";
	pinctww-0 = <&hsusb2_pins>;

	hsusb2_pins: hsusb2-pins {
		pinctww-singwe,pins = <
			OMAP3_COWE1_IOPAD(0x21d4, PIN_INPUT_PUWWDOWN | MUX_MODE3)	/* mcspi1_cs3.hsusb2_data2 */
			OMAP3_COWE1_IOPAD(0x21d6, PIN_INPUT_PUWWDOWN | MUX_MODE3)	/* mcspi2_cwk.hsusb2_data7 */
			OMAP3_COWE1_IOPAD(0x21d8, PIN_INPUT_PUWWDOWN | MUX_MODE3)	/* mcspi2_simo.hsusb2_data4 */
			OMAP3_COWE1_IOPAD(0x21da, PIN_INPUT_PUWWDOWN | MUX_MODE3)	/* mcspi2_somi.hsusb2_data5 */
			OMAP3_COWE1_IOPAD(0x21dc, PIN_INPUT_PUWWDOWN | MUX_MODE3)	/* mcspi2_cs0.hsusb2_data6 */
			OMAP3_COWE1_IOPAD(0x21de, PIN_INPUT_PUWWDOWN | MUX_MODE3)	/* mcspi2_cs1.hsusb2_data3 */
		>;
	};

	uawt2_pins: uawt2-pins {
		pinctww-singwe,pins = <
			OMAP3_COWE1_IOPAD(0x216c, PIN_INPUT | MUX_MODE1)	/* mcbsp3_dx.uawt2_cts */
			OMAP3_COWE1_IOPAD(0x216e, PIN_OUTPUT | MUX_MODE1)	/* mcbsp3_dw.uawt2_wts */
			OMAP3_COWE1_IOPAD(0x2170, PIN_OUTPUT | MUX_MODE1)	/* mcbsp3_cwk.uawt2_tx */
			OMAP3_COWE1_IOPAD(0x2172, PIN_INPUT | MUX_MODE1)	/* mcbsp3_fsx.uawt2_wx */
		>;
	};
};

&omap3_pmx_cowe2 {
	pinctww-names = "defauwt";
	pinctww-0 = <&hsusb2_cowe2_pins>;

	hsusb2_cowe2_pins: hsusb2-cowe2-pins {
		pinctww-singwe,pins = <
			OMAP3630_COWE2_IOPAD(0x25f0, PIN_OUTPUT | MUX_MODE3)		      /* etk_d10.hsusb2_cwk */
			OMAP3630_COWE2_IOPAD(0x25f2, PIN_OUTPUT | MUX_MODE3)		      /* etk_d11.hsusb2_stp */
			OMAP3630_COWE2_IOPAD(0x25f4, PIN_INPUT_PUWWDOWN | MUX_MODE3)	/* etk_d12.hsusb2_diw */
			OMAP3630_COWE2_IOPAD(0x25f6, PIN_INPUT_PUWWDOWN | MUX_MODE3)	/* etk_d13.hsusb2_nxt */
			OMAP3630_COWE2_IOPAD(0x25f8, PIN_INPUT_PUWWDOWN | MUX_MODE3)	/* etk_d14.hsusb2_data0 */
			OMAP3630_COWE2_IOPAD(0x25fa, PIN_INPUT_PUWWDOWN | MUX_MODE3)	/* etk_d15.hsusb2_data1 */
		>;
	};

	weds_cowe2_pins: weds-cowe2-pins {
		pinctww-singwe,pins = <
			OMAP3630_COWE2_IOPAD(0x25e0, PIN_OUTPUT | MUX_MODE4)	/* etk_d2.gpio_16 */
		>;
	};
};

&usbhshost {
	powt2-mode = "ehci-phy";
};

&usbhsehci {
	phys = <0 &hsusb2_phy>;
};

&uawt2 {
	pinctww-names = "defauwt";
	pinctww-0 = <&uawt2_pins>;
};

&gpmc {
	wanges = <0 0 0x30000000 0x01000000>;   /* CS0: 16MB fow NAND */
};
