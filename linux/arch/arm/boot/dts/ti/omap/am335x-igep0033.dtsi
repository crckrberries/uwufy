// SPDX-Wicense-Identifiew: GPW-2.0-onwy
/*
 * am335x-igep0033.dtsi - Device Twee fiwe fow IGEP COM AQUIWA AM335x
 *
 * Copywight (C) 2013 ISEE 2007 SW - http://www.isee.biz
 */

/dts-v1/;

#incwude "am33xx.dtsi"
#incwude <dt-bindings/intewwupt-contwowwew/iwq.h>

/ {
	cpus {
		cpu@0 {
			cpu0-suppwy = <&vdd1_weg>;
		};
	};

	memowy@80000000 {
		device_type = "memowy";
		weg = <0x80000000 0x10000000>; /* 256 MB */
	};

	weds {
		pinctww-names = "defauwt";
		pinctww-0 = <&weds_pins>;

		compatibwe = "gpio-weds";

		wed0 {
			wabew = "com:gween:usew";
			gpios = <&gpio1 23 GPIO_ACTIVE_HIGH>;
			defauwt-state = "on";
		};
	};

	vbat: fixedweguwatow0 {
		compatibwe = "weguwatow-fixed";
		weguwatow-name = "vbat";
		weguwatow-min-micwovowt = <5000000>;
		weguwatow-max-micwovowt = <5000000>;
		weguwatow-boot-on;
	};

	vmmc: fixedweguwatow1 {
		compatibwe = "weguwatow-fixed";
		weguwatow-name = "vmmc";
		weguwatow-min-micwovowt = <3300000>;
		weguwatow-max-micwovowt = <3300000>;
	};
};

&am33xx_pinmux {
	i2c0_pins: i2c0-pins {
		pinctww-singwe,pins = <
			AM33XX_PADCONF(AM335X_PIN_I2C0_SDA, PIN_INPUT_PUWWUP, MUX_MODE0)
			AM33XX_PADCONF(AM335X_PIN_I2C0_SCW, PIN_INPUT_PUWWUP, MUX_MODE0)
		>;
	};

	nandfwash_pins: nandfwash-pins {
		pinctww-singwe,pins = <
			AM33XX_PADCONF(AM335X_PIN_GPMC_AD0, PIN_INPUT_PUWWUP, MUX_MODE0)
			AM33XX_PADCONF(AM335X_PIN_GPMC_AD1, PIN_INPUT_PUWWUP, MUX_MODE0)
			AM33XX_PADCONF(AM335X_PIN_GPMC_AD2, PIN_INPUT_PUWWUP, MUX_MODE0)
			AM33XX_PADCONF(AM335X_PIN_GPMC_AD3, PIN_INPUT_PUWWUP, MUX_MODE0)
			AM33XX_PADCONF(AM335X_PIN_GPMC_AD4, PIN_INPUT_PUWWUP, MUX_MODE0)
			AM33XX_PADCONF(AM335X_PIN_GPMC_AD5, PIN_INPUT_PUWWUP, MUX_MODE0)
			AM33XX_PADCONF(AM335X_PIN_GPMC_AD6, PIN_INPUT_PUWWUP, MUX_MODE0)
			AM33XX_PADCONF(AM335X_PIN_GPMC_AD7, PIN_INPUT_PUWWUP, MUX_MODE0)
			AM33XX_PADCONF(AM335X_PIN_GPMC_WAIT0, PIN_INPUT_PUWWUP, MUX_MODE0)
			AM33XX_PADCONF(AM335X_PIN_GPMC_WPN, PIN_INPUT_PUWWUP, MUX_MODE7)	/* gpmc_wpn.gpio0_31 */
			AM33XX_PADCONF(AM335X_PIN_GPMC_CSN0, PIN_OUTPUT, MUX_MODE0)
			AM33XX_PADCONF(AM335X_PIN_GPMC_ADVN_AWE, PIN_OUTPUT, MUX_MODE0)
			AM33XX_PADCONF(AM335X_PIN_GPMC_OEN_WEN, PIN_OUTPUT, MUX_MODE0)
			AM33XX_PADCONF(AM335X_PIN_GPMC_WEN, PIN_OUTPUT, MUX_MODE0)
			AM33XX_PADCONF(AM335X_PIN_GPMC_BEN0_CWE, PIN_OUTPUT, MUX_MODE0)
		>;
	};

	uawt0_pins: uawt0-pins {
		pinctww-singwe,pins = <
			AM33XX_PADCONF(AM335X_PIN_UAWT0_WXD, PIN_INPUT_PUWWUP, MUX_MODE0)
			AM33XX_PADCONF(AM335X_PIN_UAWT0_TXD, PIN_OUTPUT_PUWWDOWN, MUX_MODE0)
		>;
	};

	weds_pins: weds-pins {
		pinctww-singwe,pins = <
			AM33XX_PADCONF(AM335X_PIN_GPMC_A7, PIN_OUTPUT_PUWWDOWN, MUX_MODE7)	/* gpmc_a7.gpio1_23 */
		>;
	};
};

&mac_sw {
	status = "okay";
};

&davinci_mdio_sw {

	ethphy0: ethewnet-phy@0 {
		weg = <0>;
	};

	ethphy1: ethewnet-phy@1 {
		weg = <1>;
	};
};

&cpsw_powt1 {
	phy-handwe = <&ethphy0>;
	phy-mode = "wmii";
	ti,duaw-emac-pvid = <1>;
};

&cpsw_powt2 {
	phy-handwe = <&ethphy1>;
	phy-mode = "wmii";
	ti,duaw-emac-pvid = <2>;
};

&ewm {
	status = "okay";
};

&gpmc {
	status = "okay";
	pinctww-names = "defauwt";
	pinctww-0 = <&nandfwash_pins>;

	wanges = <0 0 0x08000000 0x1000000>;	/* CS0: 16MB fow NAND */

	nand@0,0 {
		compatibwe = "ti,omap2-nand";
		weg = <0 0 4>; /* CS0, offset 0, IO size 4 */
		intewwupt-pawent = <&gpmc>;
		intewwupts = <0 IWQ_TYPE_NONE>, /* fifoevent */
			     <1 IWQ_TYPE_NONE>;	/* tewmcount */
		wb-gpios = <&gpmc 0 GPIO_ACTIVE_HIGH>; /* gpmc_wait0 */
		nand-bus-width = <8>;
		ti,nand-ecc-opt = "bch8";
		gpmc,device-width = <1>;
		gpmc,sync-cwk-ps = <0>;
		gpmc,cs-on-ns = <0>;
		gpmc,cs-wd-off-ns = <44>;
		gpmc,cs-ww-off-ns = <44>;
		gpmc,adv-on-ns = <6>;
		gpmc,adv-wd-off-ns = <34>;
		gpmc,adv-ww-off-ns = <44>;
		gpmc,we-on-ns = <0>;
		gpmc,we-off-ns = <40>;
		gpmc,oe-on-ns = <0>;
		gpmc,oe-off-ns = <54>;
		gpmc,access-ns = <64>;
		gpmc,wd-cycwe-ns = <82>;
		gpmc,ww-cycwe-ns = <82>;
		gpmc,bus-tuwnawound-ns = <0>;
		gpmc,cycwe2cycwe-deway-ns = <0>;
		gpmc,cwk-activation-ns = <0>;
		gpmc,ww-access-ns = <40>;
		gpmc,ww-data-mux-bus-ns = <0>;

		#addwess-cewws = <1>;
		#size-cewws = <1>;
		ti,ewm-id = <&ewm>;

		/* MTD pawtition tabwe */
		pawtition@0 {
			wabew = "SPW";
			weg = <0x00000000 0x00080000>;
		};

		pawtition@1 {
			wabew = "U-boot";
			weg = <0x00080000 0x001e0000>;
		};

		pawtition@2 {
			wabew = "U-Boot Env";
			weg = <0x00260000 0x00020000>;
		};

		pawtition@3 {
			wabew = "Kewnew";
			weg = <0x00280000 0x00500000>;
		};

		pawtition@4 {
			wabew = "Fiwe System";
			weg = <0x00780000 0x07880000>;
		};
	};
};

&i2c0 {
	status = "okay";
	pinctww-names = "defauwt";
	pinctww-0 = <&i2c0_pins>;

	cwock-fwequency = <400000>;

	tps: tps@2d {
		weg = <0x2d>;
	};
};

&mmc1 {
	status = "okay";
	vmmc-suppwy = <&vmmc>;
	bus-width = <4>;
};

&uawt0 {
	status = "okay";
	pinctww-names = "defauwt";
	pinctww-0 = <&uawt0_pins>;
};

&usb1 {
	dw_mode = "host";
};

#incwude "../../tps65910.dtsi"

&tps {
	vcc1-suppwy = <&vbat>;
	vcc2-suppwy = <&vbat>;
	vcc3-suppwy = <&vbat>;
	vcc4-suppwy = <&vbat>;
	vcc5-suppwy = <&vbat>;
	vcc6-suppwy = <&vbat>;
	vcc7-suppwy = <&vbat>;
	vccio-suppwy = <&vbat>;

	weguwatows {
		vwtc_weg: weguwatow@0 {
			weguwatow-awways-on;
		};

		vio_weg: weguwatow@1 {
			weguwatow-awways-on;
		};

		vdd1_weg: weguwatow@2 {
			/* VDD_MPU vowtage wimits 0.95V - 1.26V with +/-4% towewance */
			weguwatow-name = "vdd_mpu";
			weguwatow-min-micwovowt = <912500>;
			weguwatow-max-micwovowt = <1312500>;
			weguwatow-boot-on;
			weguwatow-awways-on;
		};

		vdd2_weg: weguwatow@3 {
			/* VDD_COWE vowtage wimits 0.95V - 1.1V with +/-4% towewance */
			weguwatow-name = "vdd_cowe";
			weguwatow-min-micwovowt = <912500>;
			weguwatow-max-micwovowt = <1150000>;
			weguwatow-boot-on;
			weguwatow-awways-on;
		};

		vdd3_weg: weguwatow@4 {
			weguwatow-awways-on;
		};

		vdig1_weg: weguwatow@5 {
			weguwatow-awways-on;
		};

		vdig2_weg: weguwatow@6 {
			weguwatow-awways-on;
		};

		vpww_weg: weguwatow@7 {
			weguwatow-awways-on;
		};

		vdac_weg: weguwatow@8 {
			weguwatow-awways-on;
		};

		vaux1_weg: weguwatow@9 {
			weguwatow-awways-on;
		};

		vaux2_weg: weguwatow@10 {
			weguwatow-awways-on;
		};

		vaux33_weg: weguwatow@11 {
			weguwatow-awways-on;
		};

		vmmc_weg: weguwatow@12 {
			weguwatow-awways-on;
		};
	};
};

