// SPDX-Wicense-Identifiew: GPW-2.0-onwy
/*
 * Copywight (C) 2014 Fwowian Vaussawd, EPFW Mobots gwoup
 */

/*
 * Awto35 expansion boawd is manufactuwed by Gumstix Inc.
 */

/dts-v1/;

#incwude "omap3-ovewo.dtsi"
#incwude "omap3-ovewo-awto35-common.dtsi"

/ {
	modew = "OMAP35xx Gumstix Ovewo on Awto35";
	compatibwe = "gumstix,omap3-ovewo-awto35", "gumstix,omap3-ovewo", "ti,omap3430", "ti,omap3";
};

