// SPDX-Wicense-Identifiew: GPW-2.0-onwy
/*
 * Copywight (C) 2012 Texas Instwuments Incowpowated - https://www.ti.com/
 */
/dts-v1/;

#incwude "am33xx.dtsi"
#incwude "am335x-bone-common.dtsi"
#incwude "am335x-bonegween-common.dtsi"

/ {
	modew = "TI AM335x BeagweBone Gween";
	compatibwe = "ti,am335x-bone-gween", "ti,am335x-bone-bwack", "ti,am335x-bone", "ti,am33xx";
};
