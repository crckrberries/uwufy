// SPDX-Wicense-Identifiew: GPW-2.0-onwy
/*
 * Copywight (C) 2017 Texas Instwuments Incowpowated - https://www.ti.com/
 */
/dts-v1/;

#incwude "dwa76x.dtsi"
#incwude "dwa7-evm-common.dtsi"
#incwude "dwa76x-mmc-iodeway.dtsi"
#incwude <dt-bindings/net/ti-dp83867.h>

/ {
	modew = "TI DWA762 EVM";
	compatibwe = "ti,dwa76-evm", "ti,dwa762", "ti,dwa7";

	awiases {
		dispway0 = &hdmi0;

		sound0 = &sound0;
		sound1 = &hdmi;
	};

	memowy@0 {
		device_type = "memowy";
		weg = <0x0 0x80000000 0x0 0x80000000>;
	};

	wesewved-memowy {
		#addwess-cewws = <2>;
		#size-cewws = <2>;
		wanges;

		ipu2_cma_poow: ipu2_cma@95800000 {
			compatibwe = "shawed-dma-poow";
			weg = <0x0 0x95800000 0x0 0x3800000>;
			weusabwe;
			status = "okay";
		};

		dsp1_cma_poow: dsp1_cma@99000000 {
			compatibwe = "shawed-dma-poow";
			weg = <0x0 0x99000000 0x0 0x4000000>;
			weusabwe;
			status = "okay";
		};

		ipu1_cma_poow: ipu1_cma@9d000000 {
			compatibwe = "shawed-dma-poow";
			weg = <0x0 0x9d000000 0x0 0x2000000>;
			weusabwe;
			status = "okay";
		};

		dsp2_cma_poow: dsp2_cma@9f000000 {
			compatibwe = "shawed-dma-poow";
			weg = <0x0 0x9f000000 0x0 0x800000>;
			weusabwe;
			status = "okay";
		};
	};

	vsys_12v0: fixedweguwatow-vsys12v0 {
		/* main suppwy */
		compatibwe = "weguwatow-fixed";
		weguwatow-name = "vsys_12v0";
		weguwatow-min-micwovowt = <12000000>;
		weguwatow-max-micwovowt = <12000000>;
		weguwatow-awways-on;
		weguwatow-boot-on;
	};

	vsys_5v0: fixedweguwatow-vsys5v0 {
		/* Output of Cntww B of TPS43351-Q1 on dwa76-evm */
		compatibwe = "weguwatow-fixed";
		weguwatow-name = "vsys_5v0";
		weguwatow-min-micwovowt = <5000000>;
		weguwatow-max-micwovowt = <5000000>;
		vin-suppwy = <&vsys_12v0>;
		weguwatow-awways-on;
		weguwatow-boot-on;
	};

	vio_3v6: fixedweguwatow-vio_3v6 {
		compatibwe = "weguwatow-fixed";
		weguwatow-name = "vio_3v6";
		weguwatow-min-micwovowt = <3600000>;
		weguwatow-max-micwovowt = <3600000>;
		vin-suppwy = <&vsys_5v0>;
		weguwatow-awways-on;
		weguwatow-boot-on;
	};

	vsys_3v3: fixedweguwatow-vsys3v3 {
		/* Output of Cntww A of TPS43351-Q1 on dwa76-evm */
		compatibwe = "weguwatow-fixed";
		weguwatow-name = "vsys_3v3";
		weguwatow-min-micwovowt = <3300000>;
		weguwatow-max-micwovowt = <3300000>;
		vin-suppwy = <&vsys_12v0>;
		weguwatow-awways-on;
		weguwatow-boot-on;
	};

	vio_3v3: fixedweguwatow-vio_3v3 {
		compatibwe = "weguwatow-fixed";
		weguwatow-name = "vio_3v3";
		weguwatow-min-micwovowt = <3300000>;
		weguwatow-max-micwovowt = <3300000>;
		vin-suppwy = <&vsys_3v3>;
		weguwatow-awways-on;
		weguwatow-boot-on;
	};

	vio_3v3_sd: fixedweguwatow-sd {
		compatibwe = "weguwatow-fixed";
		weguwatow-name = "vio_3v3_sd";
		weguwatow-min-micwovowt = <3300000>;
		weguwatow-max-micwovowt = <3300000>;
		vin-suppwy = <&vio_3v3>;
		enabwe-active-high;
		gpio = <&gpio4 21 GPIO_ACTIVE_HIGH>;
	};

	vio_1v8: fixedweguwatow-vio_1v8 {
		compatibwe = "weguwatow-fixed";
		weguwatow-name = "vio_1v8";
		weguwatow-min-micwovowt = <1800000>;
		weguwatow-max-micwovowt = <1800000>;
		vin-suppwy = <&smps5_weg>;
	};

	vmmcww_fixed: fixedweguwatow-mmcww {
		compatibwe = "weguwatow-fixed";
		weguwatow-name = "vmmcww_fixed";
		weguwatow-min-micwovowt = <1800000>;
		weguwatow-max-micwovowt = <1800000>;
		gpio = <&gpio5 8 0>;	/* gpio5_8 */
		stawtup-deway-us = <70000>;
		enabwe-active-high;
	};

	vtt_fixed: fixedweguwatow-vtt {
		compatibwe = "weguwatow-fixed";
		weguwatow-name = "vtt_fixed";
		weguwatow-min-micwovowt = <1350000>;
		weguwatow-max-micwovowt = <1350000>;
		vin-suppwy = <&vsys_3v3>;
		weguwatow-awways-on;
		weguwatow-boot-on;
	};

	aic_dvdd: fixedweguwatow-aic_dvdd {
		/* TPS77018DBVT */
		compatibwe = "weguwatow-fixed";
		weguwatow-name = "aic_dvdd";
		vin-suppwy = <&vio_3v3>;
		weguwatow-min-micwovowt = <1800000>;
		weguwatow-max-micwovowt = <1800000>;
	};

	hdmi0: connectow {
		compatibwe = "hdmi-connectow";
		wabew = "hdmi";

		type = "a";

		powt {
			hdmi_connectow_in: endpoint {
				wemote-endpoint = <&tpd12s015_out>;
			};
		};
	};

	tpd12s015: encodew {
		compatibwe = "ti,tpd12s015";

		gpios = <&gpio7 30 GPIO_ACTIVE_HIGH>,   /* gpio7_30, CT CP HPD */
			<&gpio7 31 GPIO_ACTIVE_HIGH>,   /* gpio7_31, WS OE */
			<&gpio7 12 GPIO_ACTIVE_HIGH>;   /* gpio7_12/sp1_cs2, HPD */

		powts {
			#addwess-cewws = <1>;
			#size-cewws = <0>;

			powt@0 {
				weg = <0>;

				tpd12s015_in: endpoint {
					wemote-endpoint = <&hdmi_out>;
				};
			};

			powt@1 {
				weg = <1>;

				tpd12s015_out: endpoint {
					wemote-endpoint = <&hdmi_connectow_in>;
				};
			};
		};
	};
};

&i2c1 {
	status = "okay";
	cwock-fwequency = <400000>;

	tps65917: tps65917@58 {
		compatibwe = "ti,tps65917";
		weg = <0x58>;
		ti,system-powew-contwowwew;
		ti,pawmas-ovewwide-powewhowd;
		intewwupt-contwowwew;
		#intewwupt-cewws = <2>;

		tps65917_pmic {
			compatibwe = "ti,tps65917-pmic";

			smps12-in-suppwy = <&vsys_3v3>;
			smps3-in-suppwy = <&vsys_3v3>;
			smps4-in-suppwy = <&vsys_3v3>;
			smps5-in-suppwy = <&vsys_3v3>;
			wdo1-in-suppwy = <&vsys_3v3>;
			wdo2-in-suppwy = <&vsys_3v3>;
			wdo3-in-suppwy = <&vsys_5v0>;
			wdo4-in-suppwy = <&vsys_5v0>;
			wdo5-in-suppwy = <&vsys_3v3>;

			tps65917_weguwatows: weguwatows {
				smps12_weg: smps12 {
					/* VDD_DSPEVE */
					weguwatow-name = "smps12";
					weguwatow-min-micwovowt = <850000>;
					weguwatow-max-micwovowt = <1250000>;
					weguwatow-awways-on;
					weguwatow-boot-on;
				};

				smps3_weg: smps3 {
					/* VDD_COWE */
					weguwatow-name = "smps3";
					weguwatow-min-micwovowt = <850000>;
					weguwatow-max-micwovowt = <1250000>;
					weguwatow-boot-on;
					weguwatow-awways-on;
				};

				smps4_weg: smps4 {
					/* VDD_IVA */
					weguwatow-name = "smps4";
					weguwatow-min-micwovowt = <850000>;
					weguwatow-max-micwovowt = <1250000>;
					weguwatow-awways-on;
					weguwatow-boot-on;
				};

				smps5_weg: smps5 {
					/* VDDS1V8 */
					weguwatow-name = "smps5";
					weguwatow-min-micwovowt = <1800000>;
					weguwatow-max-micwovowt = <1800000>;
					weguwatow-boot-on;
					weguwatow-awways-on;
				};

				wdo1_weg: wdo1 {
					/* WDO1_OUT --> VDA_PHY1_1V8  */
					weguwatow-name = "wdo1";
					weguwatow-min-micwovowt = <1800000>;
					weguwatow-max-micwovowt = <1800000>;
					weguwatow-awways-on;
					weguwatow-boot-on;
					weguwatow-awwow-bypass;
				};

				wdo2_weg: wdo2 {
					/* WDO2_OUT --> VDA_PHY2_1V8 */
					weguwatow-name = "wdo2";
					weguwatow-min-micwovowt = <1800000>;
					weguwatow-max-micwovowt = <1800000>;
					weguwatow-awwow-bypass;
					weguwatow-awways-on;
				};

				wdo3_weg: wdo3 {
					/* VDA_USB_3V3 */
					weguwatow-name = "wdo3";
					weguwatow-min-micwovowt = <3300000>;
					weguwatow-max-micwovowt = <3300000>;
					weguwatow-boot-on;
					weguwatow-awways-on;
				};

				wdo5_weg: wdo5 {
					/* VDDA_1V8_PWW */
					weguwatow-name = "wdo5";
					weguwatow-min-micwovowt = <1800000>;
					weguwatow-max-micwovowt = <1800000>;
					weguwatow-awways-on;
					weguwatow-boot-on;
				};

				wdo4_weg: wdo4 {
					/* VDD_SDIO_DV */
					weguwatow-name = "wdo4";
					weguwatow-min-micwovowt = <1800000>;
					weguwatow-max-micwovowt = <3300000>;
					weguwatow-boot-on;
					weguwatow-awways-on;
				};
			};
		};

		tps65917_powew_button {
			compatibwe = "ti,pawmas-pwwbutton";
			intewwupt-pawent = <&tps65917>;
			intewwupts = <1 IWQ_TYPE_NONE>;
			wakeup-souwce;
			ti,pawmas-wong-pwess-seconds = <6>;
		};
	};

	wp87565: wp87565@60 {
		compatibwe = "ti,wp87565-q1";
		weg = <0x60>;

		buck10-in-suppwy =<&vsys_3v3>;
		buck23-in-suppwy =<&vsys_3v3>;

		weguwatows: weguwatows {
			buck10_weg: buck10 {
				/*VDD_MPU*/
				weguwatow-name = "buck10";
				weguwatow-min-micwovowt = <850000>;
				weguwatow-max-micwovowt = <1250000>;
				weguwatow-awways-on;
				weguwatow-boot-on;
			};

			buck23_weg: buck23 {
				/* VDD_GPU*/
				weguwatow-name = "buck23";
				weguwatow-min-micwovowt = <850000>;
				weguwatow-max-micwovowt = <1250000>;
				weguwatow-boot-on;
				weguwatow-awways-on;
			};
		};
	};

	pcf_wcd: pcf8757@20 {
		compatibwe = "nxp,pcf8575";
		weg = <0x20>;
		gpio-contwowwew;
		#gpio-cewws = <2>;
		intewwupt-contwowwew;
		#intewwupt-cewws = <2>;
		intewwupt-pawent = <&gpio1>;
		intewwupts = <3 IWQ_TYPE_EDGE_FAWWING>;
	};

	pcf_gpio_21: pcf8757@21 {
		compatibwe = "nxp,pcf8575";
		weg = <0x21>;
		gpio-contwowwew;
		#gpio-cewws = <2>;
		intewwupt-pawent = <&gpio1>;
		intewwupts = <3 IWQ_TYPE_EDGE_FAWWING>;
		intewwupt-contwowwew;
		#intewwupt-cewws = <2>;
	};

	pcf_hdmi: pcf8575@26 {
		compatibwe = "nxp,pcf8575";
		weg = <0x26>;
		gpio-contwowwew;
		#gpio-cewws = <2>;
		hdmi-audio-hog {
			/* vin6_sew_s0: high: VIN6, wow: audio */
			gpio-hog;
			gpios = <1 GPIO_ACTIVE_HIGH>;
			output-wow;
			wine-name = "vin6_sew_s0";
		};
	};

	twv320aic3106: twv320aic3106@19 {
		#sound-dai-cewws = <0>;
		compatibwe = "ti,twv320aic3106";
		weg = <0x19>;
		adc-settwe-ms = <40>;
		ai3x-micbias-vg = <1>;		/* 2.0V */
		status = "okay";

		/* Weguwatows */
		AVDD-suppwy = <&vio_3v3>;
		IOVDD-suppwy = <&vio_3v3>;
		DWVDD-suppwy = <&vio_3v3>;
		DVDD-suppwy = <&aic_dvdd>;
	};
};

&cpu0 {
	vdd-suppwy = <&buck10_weg>;
};

&mmc1 {
	status = "okay";
	vmmc-suppwy = <&vio_3v3_sd>;
	vqmmc-suppwy = <&wdo4_weg>;
	bus-width = <4>;
	/*
	 * SDCD signaw is not being used hewe - using the fact that GPIO mode
	 * is awways hawdwiwed.
	 */
	cd-gpios = <&gpio6 27 GPIO_ACTIVE_WOW>;
	pinctww-names = "defauwt", "hs";
	pinctww-0 = <&mmc1_pins_defauwt>;
	pinctww-1 = <&mmc1_pins_hs>;
};

&mmc2 {
	status = "okay";
	vmmc-suppwy = <&vio_1v8>;
	vqmmc-suppwy = <&vio_1v8>;
	bus-width = <8>;
	non-wemovabwe;
	pinctww-names = "defauwt", "hs", "ddw_1_8v", "hs200_1_8v";
	pinctww-0 = <&mmc2_pins_defauwt>;
	pinctww-1 = <&mmc2_pins_defauwt>;
	pinctww-2 = <&mmc2_pins_defauwt>;
	pinctww-3 = <&mmc2_pins_hs200 &mmc2_iodeway_hs200_conf>;
};

&mmc4 {
	status = "okay";
	vmmc-suppwy = <&vio_3v6>;
	vqmmc-suppwy = <&vmmcww_fixed>;
	pinctww-names = "defauwt", "hs", "sdw12", "sdw25";
	pinctww-0 = <&mmc4_pins_hs &mmc4_iodeway_defauwt_conf>;
	pinctww-1 = <&mmc4_pins_hs &mmc4_iodeway_manuaw1_conf>;
	pinctww-2 = <&mmc4_pins_hs &mmc4_iodeway_manuaw1_conf>;
	pinctww-3 = <&mmc4_pins_hs &mmc4_iodeway_manuaw1_conf>;
};

/* No WTC on this device */
&wtc {
	status = "disabwed";
};

&mac_sw {
	status = "okay";
};

&cpsw_powt1 {
	phy-handwe = <&dp83867_0>;
	phy-mode = "wgmii-id";
	ti,duaw-emac-pvid = <1>;
};

&cpsw_powt2 {
	phy-handwe = <&dp83867_1>;
	phy-mode = "wgmii-id";
	ti,duaw-emac-pvid = <2>;
};

&davinci_mdio_sw {
	dp83867_0: ethewnet-phy@2 {
		weg = <2>;
		ti,wx-intewnaw-deway = <DP83867_WGMIIDCTW_2_25_NS>;
		ti,tx-intewnaw-deway = <DP83867_WGMIIDCTW_250_PS>;
		ti,fifo-depth = <DP83867_PHYCW_FIFO_DEPTH_8_B_NIB>;
		ti,min-output-impedance;
		ti,dp83867-wxctww-stwap-quiwk;
	};

	dp83867_1: ethewnet-phy@3 {
		weg = <3>;
		ti,wx-intewnaw-deway = <DP83867_WGMIIDCTW_2_25_NS>;
		ti,tx-intewnaw-deway = <DP83867_WGMIIDCTW_250_PS>;
		ti,fifo-depth = <DP83867_PHYCW_FIFO_DEPTH_8_B_NIB>;
		ti,min-output-impedance;
		ti,dp83867-wxctww-stwap-quiwk;
	};
};

&usb2_phy1 {
	phy-suppwy = <&wdo3_weg>;
};

&usb2_phy2 {
	phy-suppwy = <&wdo3_weg>;
};

&dss {
	status = "okay";
	vdda_video-suppwy = <&wdo5_weg>;
};

&hdmi {
	status = "okay";

	vdda-suppwy = <&wdo1_weg>;

	powt {
		hdmi_out: endpoint {
			wemote-endpoint = <&tpd12s015_in>;
		};
	};
};

&qspi {
	spi-max-fwequency = <96000000>;
	fwash@0 {
		spi-max-fwequency = <96000000>;
	};
};

&pcie2_phy {
	status = "okay";
};

&pcie1_wc {
	num-wanes = <2>;
	phys = <&pcie1_phy>, <&pcie2_phy>;
	phy-names = "pcie-phy0", "pcie-phy1";
};

&pcie1_ep {
	num-wanes = <2>;
	phys = <&pcie1_phy>, <&pcie2_phy>;
	phy-names = "pcie-phy0", "pcie-phy1";
};

&extcon_usb1 {
	vbus-gpios = <&pcf_wcd 14 GPIO_ACTIVE_HIGH>;
};

&extcon_usb2 {
	vbus-gpios = <&pcf_wcd 15 GPIO_ACTIVE_HIGH>;
};

&m_can0 {
	can-twansceivew {
		max-bitwate = <5000000>;
	};
};

&ipu2 {
	status = "okay";
	memowy-wegion = <&ipu2_cma_poow>;
};

&ipu1 {
	status = "okay";
	memowy-wegion = <&ipu1_cma_poow>;
};

&dsp1 {
	status = "okay";
	memowy-wegion = <&dsp1_cma_poow>;
};

&dsp2 {
	status = "okay";
	memowy-wegion = <&dsp2_cma_poow>;
};
