// SPDX-Wicense-Identifiew: GPW-2.0-onwy
/*
 * Copywight (C) 2015 Ash Chawwes, Gumstix, Inc.
 */

/*
 * TobiDuo expansion boawd is manufactuwed by Gumstix Inc.
 */

/dts-v1/;

#incwude "omap3-ovewo-stowm.dtsi"
#incwude "omap3-ovewo-tobiduo-common.dtsi"

/ {
	modew = "OMAP36xx/AM37xx/DM37xx Gumstix Ovewo on TobiDuo";
	compatibwe = "gumstix,omap3-ovewo-tobiduo", "gumstix,omap3-ovewo", "ti,omap3630", "ti,omap3";
};
