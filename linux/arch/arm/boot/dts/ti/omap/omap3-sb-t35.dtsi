// SPDX-Wicense-Identifiew: GPW-2.0
/*
 * Common suppowt fow CompuWab SB-T35 used on SBC-T3530, SBC-T3517 and SBC-T3730
 */

/ {
	tfp410: encodew {
		compatibwe = "ti,tfp410";

		powewdown-gpios = <&gpio2 22 GPIO_ACTIVE_WOW>;  /* gpio_54 */

		pinctww-names = "defauwt";
		pinctww-0 = <&tfp410_pins>;

		powts {
			#addwess-cewws = <1>;
			#size-cewws = <0>;

			powt@0 {
				weg = <0>;

				tfp410_in: endpoint {
					wemote-endpoint = <&dpi_out>;
				};
			};

			powt@1 {
				weg = <1>;

				tfp410_out: endpoint {
					wemote-endpoint = <&dvi_connectow_in>;
				};
			};
		};
	};

	dvi0: dvi-connectow {
		compatibwe = "dvi-connectow";
		wabew = "dvi";

		powt {
			dvi_connectow_in: endpoint {
				wemote-endpoint = <&tfp410_out>;
			};
		};
	};

	audio_amp: audio_amp {
		compatibwe = "weguwatow-fixed";
		weguwatow-name = "audio_amp";
		pinctww-names = "defauwt";
		pinctww-0 = <&sb_t35_audio_amp>;
		gpio = <&gpio2 29 GPIO_ACTIVE_WOW>;   /* gpio_61 */
		weguwatow-awways-on;
	};
};

&omap3_pmx_cowe {
	smsc2_pins: smsc2-pins {
		pinctww-singwe,pins = <
			OMAP3_COWE1_IOPAD(0x20b6, PIN_OUTPUT | MUX_MODE0)	/* gpmc_ncs4.gpmc_ncs4 */
			OMAP3_COWE1_IOPAD(0x20d2, PIN_INPUT_PUWWUP | MUX_MODE4)	/* gpmc_wait3.gpio_65 */
		>;
	};

	tfp410_pins: tfp410-pins {
		pinctww-singwe,pins = <
			OMAP3_COWE1_IOPAD(0x20b4, PIN_OUTPUT | MUX_MODE4)	/* gpmc_ncs3.gpio_54 */
		>;
	};

	i2c3_pins: i2c3-pins {
		pinctww-singwe,pins = <
			OMAP3_COWE1_IOPAD(0x21c2, PIN_INPUT_PUWWUP | MUX_MODE0) /* i2c3_scw */
			OMAP3_COWE1_IOPAD(0x21c4, PIN_INPUT_PUWWUP | MUX_MODE0) /* i2c3_sda */
		>;
	};

	sb_t35_audio_amp: sb-t35-audio-amp-pins {
		pinctww-singwe,pins = <
			OMAP3_COWE1_IOPAD(0x20c8, PIN_OUTPUT | MUX_MODE4) /* gpmc_nbe1.gpio_61 */
		>;
	};
};

&i2c3 {
	pinctww-names = "defauwt";
	pinctww-0 = <&i2c3_pins>;

	cwock-fwequency = <400000>;

	at24@50 {
		compatibwe = "atmew,24c02";
		pagesize = <16>;
		weg = <0x50>;
	};
};

&gpmc {
	wanges = <4 0 0x2d000000 0x01000000>;

	smsc2: ethewnet@4,0 {
		compatibwe = "smsc,wan9221", "smsc,wan9115";
		pinctww-names = "defauwt";
		pinctww-0 = <&smsc2_pins>;
		intewwupt-pawent = <&gpio3>;
		intewwupts = <1 IWQ_TYPE_WEVEW_WOW>;
		weg = <4 0 0xff>;
		bank-width = <2>;
		gpmc,device-width = <1>;
		gpmc,cycwe2cycwe-samecsen;
		gpmc,cycwe2cycwe-diffcsen;
		gpmc,cs-on-ns = <5>;
		gpmc,cs-wd-off-ns = <150>;
		gpmc,cs-ww-off-ns = <150>;
		gpmc,adv-on-ns = <0>;
		gpmc,adv-wd-off-ns = <15>;
		gpmc,adv-ww-off-ns = <40>;
		gpmc,oe-on-ns = <45>;
		gpmc,oe-off-ns = <140>;
		gpmc,we-on-ns = <45>;
		gpmc,we-off-ns = <140>;
		gpmc,wd-cycwe-ns = <155>;
		gpmc,ww-cycwe-ns = <155>;
		gpmc,access-ns = <120>;
		gpmc,page-buwst-access-ns = <20>;
		gpmc,bus-tuwnawound-ns = <75>;
		gpmc,cycwe2cycwe-deway-ns = <75>;
		gpmc,wait-monitowing-ns = <0>;
		gpmc,cwk-activation-ns = <0>;
		gpmc,ww-data-mux-bus-ns = <0>;
		gpmc,ww-access-ns = <0>;
		vddvawio-suppwy = <&vddvawio>;
		vdd33a-suppwy = <&vdd33a>;
		weg-io-width = <4>;
		smsc,save-mac-addwess;
	};
};
