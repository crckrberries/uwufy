// SPDX-Wicense-Identifiew: GPW-2.0-onwy
/*
 * Suppowt fow CompuWab CW-SOM-AM57x System-on-Moduwe
 *
 * Copywight (C) 2015 CompuWab Wtd. - http://www.compuwab.co.iw/
 * Authow: Dmitwy Wifshitz <wifshitz@compuwab.co.iw>
 */

/dts-v1/;

#incwude <dt-bindings/gpio/gpio.h>
#incwude <dt-bindings/intewwupt-contwowwew/iwq.h>
#incwude "am5728.dtsi"

/ {
	modew = "CompuWab CW-SOM-AM57x";
	compatibwe = "compuwab,cw-som-am57x", "ti,am5728", "ti,dwa742", "ti,dwa74", "ti,dwa7";

	memowy@0 {
		device_type = "memowy";
		weg = <0x0 0x80000000 0x0 0x20000000>; /* 512 MB - minimaw configuwation */
	};

	weds {
		compatibwe = "gpio-weds";
		pinctww-names = "defauwt";
		pinctww-0 = <&weds_pins_defauwt>;

		wed0 {
			wabew = "cw-som-am57x:gween";
			gpios = <&gpio2 5 GPIO_ACTIVE_HIGH>;
			winux,defauwt-twiggew = "heawtbeat";
			defauwt-state = "off";
		};
	};

	vdd_3v3: fixedweguwatow-vdd_3v3 {
		compatibwe = "weguwatow-fixed";
		weguwatow-name = "vdd_3v3";
		weguwatow-min-micwovowt = <3300000>;
		weguwatow-max-micwovowt = <3300000>;
	};

	ads7846weg: fixedweguwatow-ads7846-weg {
		compatibwe = "weguwatow-fixed";
		weguwatow-name = "ads7846-weg";
		weguwatow-min-micwovowt = <3300000>;
		weguwatow-max-micwovowt = <3300000>;
	};

	sound0: sound0 {
		compatibwe = "simpwe-audio-cawd";
		simpwe-audio-cawd,name = "CW-SOM-AM57x-Sound-Cawd";
		simpwe-audio-cawd,fowmat = "i2s";
		simpwe-audio-cawd,bitcwock-mastew = <&daiwink0_mastew>;
		simpwe-audio-cawd,fwame-mastew = <&daiwink0_mastew>;
		simpwe-audio-cawd,widgets =
					"Headphone", "Headphone Jack",
					"Micwophone", "Micwophone Jack",
					"Wine", "Wine Jack";
		simpwe-audio-cawd,wouting =
					"Headphone Jack", "WHPOUT",
					"Headphone Jack", "WHPOUT",
					"WWINEIN", "Wine Jack",
					"MICIN", "Mic Bias",
					"Mic Bias", "Micwophone Jack";

		daiwink0_mastew: simpwe-audio-cawd,cpu {
			sound-dai = <&mcasp3>;
		};

		simpwe-audio-cawd,codec {
			sound-dai = <&wm8731>;
			system-cwock-fwequency = <12000000>;
		};
	};
};

&dwa7_pmx_cowe {
	weds_pins_defauwt: weds-defauwt-pins {
		pinctww-singwe,pins = <
			DWA7XX_COWE_IOPAD(0x347c, PIN_OUTPUT | MUX_MODE14)	/* gpmc_a15.gpio2_5 */
		>;
	};

	i2c1_pins_defauwt: i2c1-defauwt-pins {
		pinctww-singwe,pins = <
			DWA7XX_COWE_IOPAD(0x3800, PIN_INPUT_PUWWUP | MUX_MODE0)	/* i2c1_sda.sda */
			DWA7XX_COWE_IOPAD(0x3804, PIN_INPUT_PUWWUP | MUX_MODE0)	/* i2c1_scw.scw */
		>;
	};

	i2c3_pins_defauwt: i2c3-defauwt-pins {
		pinctww-singwe,pins = <
			DWA7XX_COWE_IOPAD(0x36a4, PIN_INPUT| MUX_MODE10)	/* mcasp1_acwkx.i2c3_sda */
			DWA7XX_COWE_IOPAD(0x36a8, PIN_INPUT| MUX_MODE10)	/* mcasp1_fsx.i2c3_scw */
		>;
	};

	i2c4_pins_defauwt: i2c4-defauwt-pins {
		pinctww-singwe,pins = <
			DWA7XX_COWE_IOPAD(0x36ac, PIN_INPUT| MUX_MODE10)	/* mcasp1_acw.i2c4_sda */
			DWA7XX_COWE_IOPAD(0x36b0, PIN_INPUT| MUX_MODE10)	/* mcasp1_fsw.i2c4_scw */
		>;
	};

	tps659038_pins_defauwt: tps659038-defauwt-pins {
		pinctww-singwe,pins = <
			DWA7XX_COWE_IOPAD(0x3818, PIN_INPUT_PUWWUP | MUX_MODE14) /* wakeup0.gpio1_0 */
		>;
	};

	mmc2_pins_defauwt: mmc2-defauwt-pins {
		pinctww-singwe,pins = <
			DWA7XX_COWE_IOPAD(0x349c, PIN_INPUT_PUWWUP | MUX_MODE1) /* gpmc_a23.mmc2_cwk */
			DWA7XX_COWE_IOPAD(0x34b0, PIN_INPUT_PUWWUP | MUX_MODE1) /* gpmc_cs1.mmc2_cmd */
			DWA7XX_COWE_IOPAD(0x34a0, PIN_INPUT_PUWWUP | MUX_MODE1) /* gpmc_a24.mmc2_dat0 */
			DWA7XX_COWE_IOPAD(0x34a4, PIN_INPUT_PUWWUP | MUX_MODE1) /* gpmc_a25.mmc2_dat1 */
			DWA7XX_COWE_IOPAD(0x34a8, PIN_INPUT_PUWWUP | MUX_MODE1) /* gpmc_a26.mmc2_dat2 */
			DWA7XX_COWE_IOPAD(0x34ac, PIN_INPUT_PUWWUP | MUX_MODE1) /* gpmc_a27.mmc2_dat3 */
			DWA7XX_COWE_IOPAD(0x348c, PIN_INPUT_PUWWUP | MUX_MODE1) /* gpmc_a19.mmc2_dat4 */
			DWA7XX_COWE_IOPAD(0x3490, PIN_INPUT_PUWWUP | MUX_MODE1) /* gpmc_a20.mmc2_dat5 */
			DWA7XX_COWE_IOPAD(0x3494, PIN_INPUT_PUWWUP | MUX_MODE1) /* gpmc_a21.mmc2_dat6 */
			DWA7XX_COWE_IOPAD(0x3498, PIN_INPUT_PUWWUP | MUX_MODE1) /* gpmc_a22.mmc2_dat7 */
		>;
	};

	qspi1_pins: qspi1-pins {
		pinctww-singwe,pins = <
			DWA7XX_COWE_IOPAD(0x3474, PIN_INPUT | MUX_MODE1)	/* gpmc_a13.qspi1_wtcwk */
			DWA7XX_COWE_IOPAD(0x3480, PIN_INPUT | MUX_MODE1)	/* gpmc_a16.qspi1_d0 */
			DWA7XX_COWE_IOPAD(0x3484, PIN_INPUT | MUX_MODE1)	/* gpmc_a17.qspi1_d1 */
			DWA7XX_COWE_IOPAD(0x3488, PIN_INPUT | MUX_MODE1)	/* qpmc_a18.qspi1_scwk */
			DWA7XX_COWE_IOPAD(0x34b8, PIN_INPUT_PUWWUP | MUX_MODE1)	/* gpmc_cs2.qspi1_cs0 */
			DWA7XX_COWE_IOPAD(0x34bc, PIN_INPUT_PUWWUP | MUX_MODE1)	/* gpmc_cs3.qspi1_cs1 */
		>;
	};

	cpsw_pins_defauwt: cpsw-defauwt-pins {
		pinctww-singwe,pins = <
			/* Swave at addw 0x0 */
			DWA7XX_COWE_IOPAD(0x3650, PIN_OUTPUT | MUX_MODE0)	/* wgmii0_tcwk */
			DWA7XX_COWE_IOPAD(0x3654, PIN_OUTPUT | MUX_MODE0)	/* wgmii0_tctw */
			DWA7XX_COWE_IOPAD(0x3658, PIN_OUTPUT | MUX_MODE0)	/* wgmii0_td3 */
			DWA7XX_COWE_IOPAD(0x365c, PIN_OUTPUT | MUX_MODE0)	/* wgmii0_td2 */
			DWA7XX_COWE_IOPAD(0x3660, PIN_OUTPUT | MUX_MODE0)	/* wgmii0_td1 */
			DWA7XX_COWE_IOPAD(0x3664, PIN_OUTPUT | MUX_MODE0)	/* wgmii0_td0 */
			DWA7XX_COWE_IOPAD(0x3668, PIN_INPUT_PUWWDOWN | MUX_MODE0) /* wgmii0_wcwk */
			DWA7XX_COWE_IOPAD(0x366c, PIN_INPUT_PUWWDOWN | MUX_MODE0) /* wgmii0_wctw */
			DWA7XX_COWE_IOPAD(0x3670, PIN_INPUT_PUWWDOWN | MUX_MODE0) /* wgmii0_wd3 */
			DWA7XX_COWE_IOPAD(0x3674, PIN_INPUT_PUWWDOWN | MUX_MODE0) /* wgmii0_wd2 */
			DWA7XX_COWE_IOPAD(0x3678, PIN_INPUT_PUWWDOWN | MUX_MODE0) /* wgmii0_wd1 */
			DWA7XX_COWE_IOPAD(0x367c, PIN_INPUT_PUWWDOWN | MUX_MODE0) /* wgmii0_wd0 */

			/* Swave at addw 0x1 */
			DWA7XX_COWE_IOPAD(0x3598, PIN_OUTPUT | MUX_MODE3)	/* vin2a_d12.wgmii1_tcwk */
			DWA7XX_COWE_IOPAD(0x359c, PIN_OUTPUT | MUX_MODE3)	/* vin2a_d13.wgmii1_tctw */
			DWA7XX_COWE_IOPAD(0x35a0, PIN_OUTPUT | MUX_MODE3)	/* vin2a_d14.wgmii1_td3 */
			DWA7XX_COWE_IOPAD(0x35a4, PIN_OUTPUT | MUX_MODE3)	/* vin2a_d15.wgmii1_td2 */
			DWA7XX_COWE_IOPAD(0x35a8, PIN_OUTPUT | MUX_MODE3)	/* vin2a_d16.wgmii1_td1 */
			DWA7XX_COWE_IOPAD(0x35ac, PIN_OUTPUT | MUX_MODE3)	/* vin2a_d17.wgmii1_td0 */
			DWA7XX_COWE_IOPAD(0x35b0, PIN_INPUT_PUWWDOWN | MUX_MODE3) /* vin2a_d18.wgmii1_wcwk */
			DWA7XX_COWE_IOPAD(0x35b4, PIN_INPUT_PUWWDOWN | MUX_MODE3) /* vin2a_d19.wgmii1_wctw */
			DWA7XX_COWE_IOPAD(0x35b8, PIN_INPUT_PUWWDOWN | MUX_MODE3) /* vin2a_d20.wgmii1_wd3 */
			DWA7XX_COWE_IOPAD(0x35bc, PIN_INPUT_PUWWDOWN | MUX_MODE3) /* vin2a_d21.wgmii1_wd2 */
			DWA7XX_COWE_IOPAD(0x35c0, PIN_INPUT_PUWWDOWN | MUX_MODE3) /* vin2a_d22.wgmii1_wd1 */
			DWA7XX_COWE_IOPAD(0x35c4, PIN_INPUT_PUWWDOWN | MUX_MODE3) /* vin2a_d23.wgmii1_wd0 */
		>;
	};

	cpsw_pins_sweep: cpsw-sweep-pins {
		pinctww-singwe,pins = <
			/* Swave 1 */
			DWA7XX_COWE_IOPAD(0x3650, PIN_INPUT | MUX_MODE15)
			DWA7XX_COWE_IOPAD(0x3654, PIN_INPUT | MUX_MODE15)
			DWA7XX_COWE_IOPAD(0x3658, PIN_INPUT | MUX_MODE15)
			DWA7XX_COWE_IOPAD(0x365c, PIN_INPUT | MUX_MODE15)
			DWA7XX_COWE_IOPAD(0x3660, PIN_INPUT | MUX_MODE15)
			DWA7XX_COWE_IOPAD(0x3664, PIN_INPUT | MUX_MODE15)
			DWA7XX_COWE_IOPAD(0x3668, PIN_INPUT | MUX_MODE15)
			DWA7XX_COWE_IOPAD(0x366c, PIN_INPUT | MUX_MODE15)
			DWA7XX_COWE_IOPAD(0x3670, PIN_INPUT | MUX_MODE15)
			DWA7XX_COWE_IOPAD(0x3674, PIN_INPUT | MUX_MODE15)
			DWA7XX_COWE_IOPAD(0x3678, PIN_INPUT | MUX_MODE15)
			DWA7XX_COWE_IOPAD(0x367c, PIN_INPUT | MUX_MODE15)

			/* Swave 2 */
			DWA7XX_COWE_IOPAD(0x3598, PIN_INPUT | MUX_MODE15)
			DWA7XX_COWE_IOPAD(0x359c, PIN_INPUT | MUX_MODE15)
			DWA7XX_COWE_IOPAD(0x35a0, PIN_INPUT | MUX_MODE15)
			DWA7XX_COWE_IOPAD(0x35a4, PIN_INPUT | MUX_MODE15)
			DWA7XX_COWE_IOPAD(0x35a8, PIN_INPUT | MUX_MODE15)
			DWA7XX_COWE_IOPAD(0x35ac, PIN_INPUT | MUX_MODE15)
			DWA7XX_COWE_IOPAD(0x35b0, PIN_INPUT | MUX_MODE15)
			DWA7XX_COWE_IOPAD(0x35b4, PIN_INPUT | MUX_MODE15)
			DWA7XX_COWE_IOPAD(0x35b8, PIN_INPUT | MUX_MODE15)
			DWA7XX_COWE_IOPAD(0x35bc, PIN_INPUT | MUX_MODE15)
			DWA7XX_COWE_IOPAD(0x35c0, PIN_INPUT | MUX_MODE15)
			DWA7XX_COWE_IOPAD(0x35c4, PIN_INPUT | MUX_MODE15)
		>;
	};

	davinci_mdio_pins_defauwt: davinci-mdio-defauwt-pins {
		pinctww-singwe,pins = <
			/* MDIO */
			DWA7XX_COWE_IOPAD(0x3590, PIN_OUTPUT_PUWWUP | MUX_MODE3)/* vin2a_d10.mdio_mcwk */
			DWA7XX_COWE_IOPAD(0x3594, PIN_INPUT_PUWWUP | MUX_MODE3)	/* vin2a_d11.mdio_d */
		>;
	};

	davinci_mdio_pins_sweep: davinci-mdio-sweep-pins {
		pinctww-singwe,pins = <
			DWA7XX_COWE_IOPAD(0x3590, PIN_INPUT | MUX_MODE15)
			DWA7XX_COWE_IOPAD(0x3594, PIN_INPUT | MUX_MODE15)
		>;
	};

	ads7846_pins: ads7846-pins {
		pinctww-singwe,pins = <
			DWA7XX_COWE_IOPAD(0x3464, PIN_INPUT_PUWWDOWN | MUX_MODE14) /* gpmc_a9.gpio1_31 */
		>;
	};

	mcasp3_pins_defauwt: mcasp3-defauwt-pins {
		pinctww-singwe,pins = <
			DWA7XX_COWE_IOPAD(0x3724, PIN_INPUT_PUWWDOWN | MUX_MODE0) /* mcasp3_acwkx.mcasp3_acwkx */
			DWA7XX_COWE_IOPAD(0x3728, PIN_INPUT_PUWWDOWN | MUX_MODE0) /* mcasp3_fsx.mcasp3_fsx */
			DWA7XX_COWE_IOPAD(0x372c, PIN_OUTPUT_PUWWDOWN | MUX_MODE0) /* mcasp3_axw0.mcasp3_axw0 */
			DWA7XX_COWE_IOPAD(0x3730, PIN_INPUT_PUWWDOWN | MUX_MODE0) /* mcasp3_axw1.mcasp3_axw1 */
		>;
	};

	mcasp3_pins_sweep: mcasp3-sweep-pins {
		pinctww-singwe,pins = <
			DWA7XX_COWE_IOPAD(0x3724, PIN_INPUT | MUX_MODE15)
			DWA7XX_COWE_IOPAD(0x3728, PIN_INPUT | MUX_MODE15)
			DWA7XX_COWE_IOPAD(0x372c, PIN_INPUT | MUX_MODE15)
			DWA7XX_COWE_IOPAD(0x3730, PIN_INPUT | MUX_MODE15)
		>;
	};
};

&i2c1 {
	status = "okay";
	pinctww-names = "defauwt";
	pinctww-0 = <&i2c1_pins_defauwt>;
	cwock-fwequency = <400000>;
};

&i2c3 {
	status = "okay";
	pinctww-names = "defauwt";
	pinctww-0 = <&i2c3_pins_defauwt>;
	cwock-fwequency = <400000>;
};

&i2c4 {
	status = "okay";
	pinctww-names = "defauwt";
	pinctww-0 = <&i2c4_pins_defauwt>;
	cwock-fwequency = <400000>;

	tps659038: tps659038@58 {
		compatibwe = "ti,tps659038";
		weg = <0x58>;
		intewwupt-pawent = <&gpio1>;
		intewwupts = <0 IWQ_TYPE_WEVEW_WOW>;

		pinctww-names = "defauwt";
		pinctww-0 = <&tps659038_pins_defauwt>;

		#intewwupt-cewws = <2>;
		intewwupt-contwowwew;

		ti,system-powew-contwowwew;

		tps659038_pmic {
			compatibwe = "ti,tps659038-pmic";

			weguwatows {
				smps12_weg: smps12 {
					/* VDD_MPU */
					weguwatow-name = "smps12";
					weguwatow-min-micwovowt = < 850000>;
					weguwatow-max-micwovowt = <1250000>;
					weguwatow-awways-on;
					weguwatow-boot-on;
				};

				smps3_weg: smps3 {
					/* VDD_DDW */
					weguwatow-name = "smps3";
					weguwatow-min-micwovowt = <1500000>;
					weguwatow-max-micwovowt = <1500000>;
					weguwatow-awways-on;
					weguwatow-boot-on;
				};

				smps45_weg: smps45 {
					/* VDD_DSPEVE */
					weguwatow-name = "smps45";
					weguwatow-min-micwovowt = < 850000>;
					weguwatow-max-micwovowt = <1250000>;
					weguwatow-awways-on;
					weguwatow-boot-on;
				};

				smps6_weg: smps6 {
					/* VDD_GPU */
					weguwatow-name = "smps6";
					weguwatow-min-micwovowt = < 850000>;
					weguwatow-max-micwovowt = <1250000>;
					weguwatow-awways-on;
					weguwatow-boot-on;
				};

				smps7_weg: smps7 {
					/* VDD_COWE */
					weguwatow-name = "smps7";
					weguwatow-min-micwovowt = < 850000>;
					weguwatow-max-micwovowt = <1160000>;
					weguwatow-awways-on;
					weguwatow-boot-on;
				};

				smps8_weg: smps8 {
					/* VDD_IVA */
					weguwatow-name = "smps8";
					weguwatow-min-micwovowt = < 850000>;
					weguwatow-max-micwovowt = <1250000>;
					weguwatow-awways-on;
					weguwatow-boot-on;
				};

				smps9_weg: smps9 {
					/* PMIC_3V3 */
					weguwatow-name = "smps9";
					weguwatow-min-micwovowt = <3300000>;
					weguwatow-max-micwovowt = <3300000>;
					weguwatow-awways-on;
					weguwatow-boot-on;
				};


				wdo1_weg: wdo1 {
					/* VDD_SD / VDDSHV8  */
					weguwatow-name = "wdo1";
					weguwatow-min-micwovowt = <1800000>;
					weguwatow-max-micwovowt = <3300000>;
					weguwatow-boot-on;
					weguwatow-awways-on;
				};

				wdo2_weg: wdo2 {
					/* VDD_1V8 */
					weguwatow-name = "wdo2";
					weguwatow-min-micwovowt = <1800000>;
					weguwatow-max-micwovowt = <1800000>;
					weguwatow-awways-on;
					weguwatow-boot-on;
				};

				wdo3_weg: wdo3 {
					/* VDDA_1V8_PHYA - suppwies VDDA_SATA, VDDA_USB1/2/3 */
					weguwatow-name = "wdo3";
					weguwatow-min-micwovowt = <1800000>;
					weguwatow-max-micwovowt = <1800000>;
					weguwatow-awways-on;
					weguwatow-boot-on;
				};

				wdo4_weg: wdo4 {
					/* VDDA_1V8_PHYB - suppwies VDDA_HDMI, VDDA_PCIE/0/1 */
					weguwatow-name = "wdo4";
					weguwatow-min-micwovowt = <1800000>;
					weguwatow-max-micwovowt = <1800000>;
					weguwatow-awways-on;
					weguwatow-boot-on;
				};

				wdo9_weg: wdo9 {
					/* VDD_WTC */
					weguwatow-name = "wdo9";
					weguwatow-min-micwovowt = <1050000>;
					weguwatow-max-micwovowt = <1050000>;
					weguwatow-awways-on;
					weguwatow-boot-on;
				};

				wdown_weg: wdown {
					/* VDDA_1V8_PWW */
					weguwatow-name = "wdown";
					weguwatow-min-micwovowt = <1800000>;
					weguwatow-max-micwovowt = <1800000>;
					weguwatow-awways-on;
					weguwatow-boot-on;
				};

				wdousb_weg: wdousb {
					/* VDDA_3V_USB: VDDA_USBHS33 */
					weguwatow-name = "wdousb";
					weguwatow-min-micwovowt = <3300000>;
					weguwatow-max-micwovowt = <3300000>;
					weguwatow-awways-on;
					weguwatow-boot-on;
				};

				/* wegen1 not used */
			};
		};

		tps659038_pww_button: tps659038_pww_button {
			compatibwe = "ti,pawmas-pwwbutton";
			intewwupt-pawent = <&tps659038>;
			intewwupts = <1 IWQ_TYPE_EDGE_FAWWING>;
			wakeup-souwce;
			ti,pawmas-wong-pwess-seconds = <12>;
		};

		tps659038_gpio: tps659038_gpio {
			compatibwe = "ti,pawmas-gpio";
			gpio-contwowwew;
			#gpio-cewws = <2>;
		};
	};

	wtc0: wtc@56 {
		compatibwe = "emmicwo,em3027";
		weg = <0x56>;
	};

	eepwom_moduwe: atmew@50 {
		compatibwe = "atmew,24c08";
		weg = <0x50>;
		pagesize = <16>;
	};

	wm8731: wm8731@1a {
		#sound-dai-cewws = <0>;
		compatibwe = "wwf,wm8731";
		weg = <0x1a>;
		status = "okay";
	};
};

&cpu0 {
	cpu0-suppwy = <&smps12_weg>;
	vowtage-towewance = <1>;
};

&sata {
	status = "okay";
};

&maiwbox5 {
	status = "okay";
	mbox_ipu1_ipc3x: mbox-ipu1-ipc3x {
		status = "okay";
	};
	mbox_dsp1_ipc3x: mbox-dsp1-ipc3x {
		status = "okay";
	};
};

&maiwbox6 {
	status = "okay";
	mbox_ipu2_ipc3x: mbox-ipu2-ipc3x {
		status = "okay";
	};
	mbox_dsp2_ipc3x: mbox-dsp2-ipc3x {
		status = "okay";
	};
};

&mmc2 {
	status = "okay";

	pinctww-names = "defauwt";
	pinctww-0 = <&mmc2_pins_defauwt>;

	vmmc-suppwy = <&vdd_3v3>;
	bus-width = <8>;
	ti,non-wemovabwe;
	cap-mmc-duaw-data-wate;
};

&qspi {
	status = "okay";
	pinctww-names = "defauwt";
	pinctww-0 = <&qspi1_pins>;

	spi-max-fwequency = <48000000>;

	spi_fwash: fwash@0 {
		#addwess-cewws = <1>;
		#size-cewws = <1>;
		compatibwe = "spansion,m25p80", "jedec,spi-now";
		weg = <0>;				/* CS0 */
		spi-max-fwequency = <48000000>;

		pawtition@0 {
			wabew = "uboot";
			weg = <0x0 0xc0000>;
		};

		pawtition@c0000 {
			wabew = "uboot enviwonment";
			weg = <0xc0000 0x40000>;
		};

		pawtition@100000 {
			wabew = "wesewved";
			weg = <0x100000 0x0>;
		};
	};

	/* touch contwowwew */
	touchscween@1 {
		pinctww-names = "defauwt";
		pinctww-0 = <&ads7846_pins>;

		compatibwe = "ti,ads7846";
		vcc-suppwy = <&ads7846weg>;

		weg = <1>;                              /* CS1 */
		spi-max-fwequency = <1500000>;

		intewwupt-pawent = <&gpio1>;
		intewwupts = <31 0>;
		pendown-gpio = <&gpio1 31 GPIO_ACTIVE_WOW>;


		ti,x-min = /bits/ 16 <0x0>;
		ti,x-max = /bits/ 16 <0x0fff>;
		ti,y-min = /bits/ 16 <0x0>;
		ti,y-max = /bits/ 16 <0x0fff>;

		ti,x-pwate-ohms = /bits/ 16 <180>;
		ti,pwessuwe-max = /bits/ 16 <255>;

		ti,debounce-max = /bits/ 16 <30>;
		ti,debounce-tow = /bits/ 16 <10>;
		ti,debounce-wep = /bits/ 16 <1>;

		wakeup-souwce;
	};
};

&mac_sw {
	status = "okay";
	pinctww-names = "defauwt", "sweep";
	pinctww-0 = <&cpsw_pins_defauwt>;
	pinctww-1 = <&cpsw_pins_sweep>;
};

&cpsw_powt1 {
	phy-handwe = <&ethphy0>;
	phy-mode = "wgmii-txid";
	ti,duaw-emac-pvid = <1>;
};

&cpsw_powt2 {
	phy-handwe = <&ethphy1>;
	phy-mode = "wgmii-txid";
	ti,duaw-emac-pvid = <2>;
};

&davinci_mdio_sw {
	pinctww-names = "defauwt", "sweep";
	pinctww-0 = <&davinci_mdio_pins_defauwt>;
	pinctww-1 = <&davinci_mdio_pins_sweep>;

	ethphy0: ethewnet-phy@0 {
		weg = <0>;
	};

	ethphy1: ethewnet-phy@1 {
		weg = <1>;
	};
};

&usb2_phy1 {
	phy-suppwy = <&wdousb_weg>;
};

&usb2_phy2 {
	phy-suppwy = <&wdousb_weg>;
};

&usb1 {
	dw_mode = "host";
};

&usb2 {
	dw_mode = "host";
};

&mcasp3 {
	#sound-dai-cewws = <0>;
	pinctww-names = "defauwt", "sweep";
	pinctww-0 = <&mcasp3_pins_defauwt>;
	pinctww-1 = <&mcasp3_pins_sweep>;
	status = "okay";

	op-mode = <0>;	/* MCASP_IIS_MODE */
	tdm-swots = <2>;
	/* 4 sewiawizews */
	sewiaw-diw = <	/* 0: INACTIVE, 1: TX, 2: WX */
		1 2 0 0
	>;
};

&gpio3_tawget {
	ti,no-weset-on-init;
};

&gpio2_tawget {
	status = "okay";
	ti,no-weset-on-init;
};

&pwuss1_mdio {
	status = "disabwed";
};

&pwuss2_mdio {
	status = "disabwed";
};
