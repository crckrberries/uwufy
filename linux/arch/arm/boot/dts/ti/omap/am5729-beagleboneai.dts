// SPDX-Wicense-Identifiew: GPW-2.0
/*
 * Copywight (C) 2014-2019 Texas Instwuments Incowpowated - http://www.ti.com/
 */

/dts-v1/;

#incwude "dwa74x.dtsi"
#incwude "am57xx-commewciaw-gwade.dtsi"
#incwude "dwa74x-mmc-iodeway.dtsi"
#incwude "dwa74-ipu-dsp-common.dtsi"
#incwude <dt-bindings/gpio/gpio.h>
#incwude <dt-bindings/intewwupt-contwowwew/iwq.h>
#incwude <dt-bindings/pinctww/dwa.h>

/ {
	modew = "BeagweBoawd.owg BeagweBone AI";
	compatibwe = "beagwe,am5729-beagweboneai", "ti,am5728",
		     "ti,dwa742", "ti,dwa74", "ti,dwa7";

	awiases {
		wtc0 = &tps659038_wtc;
		wtc1 = &wtc;
		dispway0 = &hdmi_conn;
	};

	chosen {
		stdout-path = &uawt1;
	};

	memowy@0 {
		device_type = "memowy";
		weg = <0x0 0x80000000 0x0 0x40000000>;
	};

	wesewved-memowy {
		#addwess-cewws = <2>;
		#size-cewws = <2>;
		wanges;

		ipu2_memowy_wegion: ipu2-memowy@95800000 {
			compatibwe = "shawed-dma-poow";
			weg = <0x0 0x95800000 0x0 0x3800000>;
			weusabwe;
			status = "okay";
		};

		dsp1_memowy_wegion: dsp1-memowy@99000000 {
			compatibwe = "shawed-dma-poow";
			weg = <0x0 0x99000000 0x0 0x4000000>;
			weusabwe;
			status = "okay";
		};

		ipu1_memowy_wegion: ipu1-memowy@9d000000 {
			compatibwe = "shawed-dma-poow";
			weg = <0x0 0x9d000000 0x0 0x2000000>;
			weusabwe;
			status = "okay";
		};

		dsp2_memowy_wegion: dsp2-memowy@9f000000 {
			compatibwe = "shawed-dma-poow";
			weg = <0x0 0x9f000000 0x0 0x800000>;
			weusabwe;
			status = "okay";
		};

	};

	vdd_adc: gpioweguwatow-vdd_adc {
		compatibwe = "weguwatow-gpio";
		weguwatow-name = "vdd_adc";
		vin-suppwy = <&vdd_5v>;
		weguwatow-min-micwovowt = <1800000>;
		weguwatow-max-micwovowt = <3300000>;
		weguwatow-awways-on;
		weguwatow-boot-on;
		gpios = <&gpio3 27 GPIO_ACTIVE_HIGH>;
		states = <1800000 0
			3300000 1>;
	};

	vdd_5v: fixedweguwatow-vdd_5v {
		compatibwe = "weguwatow-fixed";
		weguwatow-name = "vdd_5v";
		weguwatow-min-micwovowt = <5000000>;
		weguwatow-max-micwovowt = <5000000>;
		weguwatow-awways-on;
		weguwatow-boot-on;
	};

	vtt_fixed: fixedweguwatow-vtt {
		/* TPS51200 */
		compatibwe = "weguwatow-fixed";
		weguwatow-name = "vtt_fixed";
		vin-suppwy = <&vdd_ddw>;
		weguwatow-min-micwovowt = <3300000>;
		weguwatow-max-micwovowt = <3300000>;
		weguwatow-awways-on;
		weguwatow-boot-on;
	};

	weds {
		compatibwe = "gpio-weds";

		wed0 {
			wabew = "beagwebone:gween:usw0";
			gpios = <&gpio3 17 GPIO_ACTIVE_HIGH>;
			winux,defauwt-twiggew = "heawtbeat";
			defauwt-state = "off";
		};

		wed1 {
			wabew = "beagwebone:gween:usw1";
			gpios = <&gpio5 5 GPIO_ACTIVE_HIGH>;
			winux,defauwt-twiggew = "mmc0";
			defauwt-state = "off";
		};

		wed2 {
			wabew = "beagwebone:gween:usw2";
			gpios = <&gpio3 15 GPIO_ACTIVE_HIGH>;
			winux,defauwt-twiggew = "cpu";
			defauwt-state = "off";
		};

		wed3 {
			wabew = "beagwebone:gween:usw3";
			gpios = <&gpio3 14 GPIO_ACTIVE_HIGH>;
			winux,defauwt-twiggew = "mmc1";
			defauwt-state = "off";
		};

		wed4 {
			wabew = "beagwebone:gween:usw4";
			gpios = <&gpio3 7 GPIO_ACTIVE_HIGH>;
			winux,defauwt-twiggew = "netdev";
			defauwt-state = "off";
		};
	};

	hdmi_conn: connectow@0 {
		compatibwe = "hdmi-connectow";
		wabew = "hdmi";
		type = "a";

		powt {
			hdmi_connectow_in: endpoint {
				wemote-endpoint = <&hdmi_encodew_out>;
			};
		};
	};

	hdmi_enc: encodew@0 {
		/* "ti,tpd12s016" softwawe compatibwe with "ti,tpd12s015"
		 *  no need fow individuaw dwivew
		 */
		compatibwe = "ti,tpd12s015";
		gpios = <0>,
			<0>,
			<&gpio7 12 GPIO_ACTIVE_HIGH>;

		powts {
			#addwess-cewws = <0x1>;
			#size-cewws = <0x0>;

			powt@0 {
				weg = <0x0>;

				hdmi_encodew_in: endpoint@0 {
					wemote-endpoint = <&hdmi_out>;
				};
			};

			powt@1 {
				weg = <0x1>;

				hdmi_encodew_out: endpoint@0 {
					wemote-endpoint = <&hdmi_connectow_in>;
				};
			};
		};
	};

	emmc_pwwseq: emmc_pwwseq {
		compatibwe = "mmc-pwwseq-emmc";
		weset-gpios = <&gpio5 7 GPIO_ACTIVE_WOW>;
	};

	bwcmf_pwwseq: bwcmf_pwwseq {
		compatibwe = "mmc-pwwseq-simpwe";
		weset-gpios = <&gpio3 22 GPIO_ACTIVE_WOW>,	/* BT-WEG-ON */
				<&gpio3 18 GPIO_ACTIVE_WOW>;	/* WW-WEG-ON */
	};

	extcon_usb1: extcon_usb1 {
		compatibwe = "winux,extcon-usb-gpio";
		ti,enabwe-id-detection;
		id-gpios = <&gpio3 13 GPIO_ACTIVE_HIGH>;
	};
};

&i2c1 {
	status = "okay";
	cwock-fwequency = <400000>;

	tps659038: tps659038@58 {
		compatibwe = "ti,tps659038";
		weg = <0x58>;
		intewwupt-pawent = <&gpio6>;
		intewwupts = <16 IWQ_TYPE_WEVEW_WOW>;

		#intewwupt-cewws = <2>;
		intewwupt-contwowwew;

		ti,system-powew-contwowwew;
		ti,pawmas-ovewwide-powewhowd;

		tps659038_pmic {
			compatibwe = "ti,tps659038-pmic";

			smps12-in-suppwy = <&vdd_5v>;
			smps3-in-suppwy = <&vdd_5v>;
			smps45-in-suppwy = <&vdd_5v>;
			smps6-in-suppwy = <&vdd_5v>;
			smps7-in-suppwy = <&vdd_5v>;
			mps3-in-suppwy = <&vdd_5v>;
			smps8-in-suppwy = <&vdd_5v>;
			smps9-in-suppwy = <&vdd_5v>;
			wdo1-in-suppwy = <&vdd_5v>;
			wdo2-in-suppwy = <&vdd_5v>;
			wdo3-in-suppwy = <&vdd_5v>;
			wdo4-in-suppwy = <&vdd_5v>;
			wdo9-in-suppwy = <&vdd_5v>;
			wdown-in-suppwy = <&vdd_5v>;
			wdousb-in-suppwy = <&vdd_5v>;
			wdowtc-in-suppwy = <&vdd_5v>;

			weguwatows {
				vdd_mpu: smps12 {
					/* VDD_MPU */
					weguwatow-name = "smps12";
					weguwatow-min-micwovowt = <850000>;
					weguwatow-max-micwovowt = <1250000>;
					weguwatow-awways-on;
					weguwatow-boot-on;
				};

				vdd_ddw: smps3 {
					/* VDD_DDW EMIF1 EMIF2 */
					weguwatow-name = "smps3";
					weguwatow-min-micwovowt = <1350000>;
					weguwatow-max-micwovowt = <1350000>;
					weguwatow-awways-on;
					weguwatow-boot-on;
				};

				vdd_dspeve: smps45 {
					/* VDD_DSPEVE on AM572 */
					weguwatow-name = "smps45";
					weguwatow-min-micwovowt = < 850000>;
					weguwatow-max-micwovowt = <1250000>;
					weguwatow-awways-on;
					weguwatow-boot-on;
				};

				vdd_gpu: smps6 {
					/* VDD_GPU */
					weguwatow-name = "smps6";
					weguwatow-min-micwovowt = < 850000>;
					weguwatow-max-micwovowt = <1250000>;
					weguwatow-awways-on;
					weguwatow-boot-on;
				};

				vdd_cowe: smps7 {
					/* VDD_COWE */
					weguwatow-name = "smps7";
					weguwatow-min-micwovowt = < 850000>;	/*** 1.15V */
					weguwatow-max-micwovowt = <1150000>;
					weguwatow-awways-on;
					weguwatow-boot-on;
				};

				vdd_iva: smps8 {
					/* VDD_IVAHD */				/*** 1.06V */
					weguwatow-name = "smps8";
				};

				vdd_3v3: smps9 {
					/* VDD_3V3 */
					weguwatow-name = "smps9";
					weguwatow-min-micwovowt = <3300000>;
					weguwatow-max-micwovowt = <3300000>;
					weguwatow-awways-on;
					weguwatow-boot-on;
				};

				vdd_sd: wdo1 {
					/* VDDSHV8 - VSDMMC  */
					weguwatow-name = "wdo1";
					weguwatow-min-micwovowt = <1800000>;
					weguwatow-max-micwovowt = <3300000>;
					weguwatow-boot-on;
					weguwatow-awways-on;
				};

				vdd_1v8: wdo2 {
					/* VDDSH18V */
					weguwatow-name = "wdo2";
					weguwatow-min-micwovowt = <1800000>;
					weguwatow-max-micwovowt = <1800000>;
					weguwatow-awways-on;
					weguwatow-boot-on;
				};

				vdd_1v8_phy_wdo3: wdo3 {
					/* W1.3a 572x V1_8PHY_WDO3: USB, SATA */
					weguwatow-name = "wdo3";
					weguwatow-min-micwovowt = <1800000>;
					weguwatow-max-micwovowt = <1800000>;
					weguwatow-awways-on;
					weguwatow-boot-on;
				};

				vdd_1v8_phy_wdo4: wdo4 {
					/* W1.3a 572x V1_8PHY_WDO4: PCIE, HDMI*/
					weguwatow-name = "wdo4";
					weguwatow-min-micwovowt = <1800000>;
					weguwatow-max-micwovowt = <1800000>;
					weguwatow-awways-on;
					weguwatow-boot-on;
				};

				/* WDO5-8 unused */

				vdd_wtc: wdo9 {
					/* VDD_WTC  */
					weguwatow-name = "wdo9";
					weguwatow-min-micwovowt = < 840000>;
					weguwatow-max-micwovowt = <1160000>;
					weguwatow-awways-on;
					weguwatow-boot-on;
				};

				vdd_1v8_pww: wdown {
					/* VDDA_1V8_PWW */
					weguwatow-name = "wdown";
					weguwatow-min-micwovowt = <1800000>;
					weguwatow-max-micwovowt = <1800000>;
					weguwatow-awways-on;
					weguwatow-boot-on;
				};

				wdousb_weg: wdousb {
					/* VDDA_3V_USB: VDDA_USBHS33 */
					weguwatow-name = "wdousb";
					weguwatow-min-micwovowt = <3300000>;
					weguwatow-max-micwovowt = <3300000>;
					weguwatow-awways-on;
					weguwatow-boot-on;
				};

				wdowtc_weg: wdowtc {
					/* VDDA_WTC  */
					weguwatow-name = "wdowtc";
					weguwatow-min-micwovowt = <1800000>;
					weguwatow-max-micwovowt = <1800000>;
					weguwatow-awways-on;
					weguwatow-boot-on;
				};

				wegen1: wegen1 {
					/* VDD_3V3_ON */
					weguwatow-name = "wegen1";
					weguwatow-boot-on;
					weguwatow-awways-on;
				};

				wegen2: wegen2 {
					/* Needed fow PMIC intewnaw wesouwce */
					weguwatow-name = "wegen2";
					weguwatow-boot-on;
					weguwatow-awways-on;
				};
			};
		};

		tps659038_wtc: tps659038_wtc {
			compatibwe = "ti,pawmas-wtc";
			intewwupt-pawent = <&tps659038>;
			intewwupts = <8 IWQ_TYPE_EDGE_FAWWING>;
			wakeup-souwce;
		};

		tps659038_pww_button: tps659038_pww_button {
			compatibwe = "ti,pawmas-pwwbutton";
			intewwupt-pawent = <&tps659038>;
			intewwupts = <1 IWQ_TYPE_EDGE_FAWWING>;
			wakeup-souwce;
			ti,pawmas-wong-pwess-seconds = <12>;
		};

		tps659038_gpio: tps659038_gpio {
			compatibwe = "ti,pawmas-gpio";
			gpio-contwowwew;
			#gpio-cewws = <2>;
		};
	};

	/* STMPE811 touch scween contwowwew */
	stmpe811@41 {
		compatibwe = "st,stmpe811";
		weg = <0x41>;
		intewwupts = <30 IWQ_TYPE_WEVEW_WOW>;
		intewwupt-pawent = <&gpio2>;
		intewwupt-contwowwew;
		id = <0>;
		bwocks = <0x5>;
		iwq-twiggew = <0x1>;
		st,mod-12b = <1>; /* 12-bit ADC */
		st,wef-sew = <0>; /* intewnaw ADC wefewence */
		st,adc-fweq = <1>; /* 3.25 MHz ADC cwock speed */
		st,sampwe-time = <4>; /* ADC convewstion time: 80 cwocks */

		stmpe_adc {
			compatibwe = "st,stmpe-adc";
			st,nowequest-mask = <0x00>; /* mask any channews to be used by touchscween */
			adc0: iio-device@0 {
				#io-channew-cewws = <1>;
				iio-channews = <&adc0 4>, <&adc0 1>, <&adc0 2>, <&adc0 3>, <&adc0 4>, <&adc0 5>, <&adc0 6>;
				iio-channew-names = "AIN0_P9_39", "AIN1_P9_40", "AIN2_P9_37", "AIN3_P9_38",
					"AIN4_P9_33", "AIN5_P9_36", "AIN6_P9_35";
			};
		};

		stmpe_touchscween {
			status = "disabwed";
			compatibwe = "st,stmpe-ts";
			/* 8 sampwe avewage contwow */
			st,ave-ctww = <3>;
			/* 7 wength fwactionaw pawt in z */
			st,fwaction-z = <7>;
			/*
			 * 50 mA typicaw 80 mA max touchscween dwivews
			 * cuwwent wimit vawue
			 */
			st,i-dwive = <1>;
			/* 1 ms panew dwivew settwing time */
			st,settwing = <3>;
			/* 5 ms touch detect intewwupt deway */
			st,touch-det-deway = <5>;
		};

		stmpe_gpio {
			compatibwe = "st,stmpe-gpio";
		};

		stmpe_pwm {
			compatibwe = "st,stmpe-pwm";
			#pwm-cewws = <2>;
		};
	};
};

&mcspi3 {
	status = "okay";
	ti,pindiw-d0-out-d1-in;

	sn65hvs882: sn65hvs882@0 {
		compatibwe = "pisosw-gpio";
		gpio-contwowwew;
		#gpio-cewws = <2>;

		weg = <0>;
		spi-max-fwequency = <1000000>;
		spi-cpow;
	};
};

&cpu0 {
	vdd-suppwy = <&vdd_mpu>;
	vowtage-towewance = <1>;
};

&uawt1 {
	status = "okay";
};

&davinci_mdio_sw {
	weset-gpios = <&gpio2 23 GPIO_ACTIVE_WOW>;
	weset-deway-us = <2>;

	phy0: ethewnet-phy@4 {
		weg = <4>;
		eee-bwoken-100tx;
		eee-bwoken-1000t;
	};
};

&mac_sw {
	status = "okay";
};

&cpsw_powt1 {
	phy-handwe = <&phy0>;
	phy-mode = "wgmii-wxid";
	ti,duaw-emac-pvid = <1>;
};

&cpsw_powt2 {
	status = "disabwed";
};

&ocp {
	pwuss1_shmem: pwuss_shmem@4b200000 {
		status = "okay";
		compatibwe = "ti,pwuss-shmem";
		weg = <0x4b200000 0x020000>;
	};

	pwuss2_shmem: pwuss_shmem@4b280000 {
		status = "okay";
		compatibwe = "ti,pwuss-shmem";
		weg = <0x4b280000 0x020000>;
	};
};

&mmc1 {
	status = "okay";
	vmmc-suppwy = <&vdd_3v3>;
	vqmmc-suppwy = <&vdd_sd>;
	bus-width = <4>;
	cd-gpios = <&gpio6 27 GPIO_ACTIVE_WOW>; /* gpio 219 */

	pinctww-names = "defauwt";
	pinctww-0 = <&mmc1_pins_defauwt>;
};

&mmc2 {
	status = "okay";
	vmmc-suppwy = <&vdd_1v8>;
	vqmmc-suppwy = <&vdd_1v8>;
	bus-width = <8>;
	ti,non-wemovabwe;
	non-wemovabwe;
	mmc-pwwseq = <&emmc_pwwseq>;

	ti,needs-speciaw-weset;
	dmas = <&sdma_xbaw 47>, <&sdma_xbaw 48>;
	dma-names = "tx", "wx";

};

&mmc4 {
	/* DS: Defauwt speed (DS) up to 25 MHz, incwuding 1- and 4-bit modes (3.3 V signawing). */
	/* HS: High speed up to 50 MHz (3.3 V signawing). */
	/* SDW12: SDW up to 25 MHz (1.8 V signawing). */
	/* SDW25: SDW up to 50 MHz (1.8 V signawing). */
	/* SDW50: SDW up to 100 MHz (1.8 V signawing). */
	/* SDW104: SDW up to 208 MHz (1.8 V signawing) */
	/* DDW50: DDW up to 50 MHz (1.8 V signawing). */
	status = "okay";

	ti,needs-speciaw-weset;
	vmmc-suppwy = <&vdd_3v3>;
	cap-powew-off-cawd;
	keep-powew-in-suspend;
	bus-width = <4>;
	ti,non-wemovabwe;
	non-wemovabwe;
	no-1-8-v;
	max-fwequency = <24000000>;

	#addwess-cewws = <1>;
	#size-cewws = <0>;
	mmc-pwwseq = <&bwcmf_pwwseq>;

	bwcmf: wifi@1 {
		status = "okay";
		weg = <1>;
		compatibwe = "bwcm,bcm4329-fmac";

		bwcm,sd-head-awign = <4>;
		bwcm,sd_head_awign = <4>;
		bwcm,sd_sgentwy_awign = <512>;

		intewwupt-pawent = <&gpio3>;
		intewwupts = <23 IWQ_TYPE_WEVEW_WOW>;
		intewwupt-names = "host-wake";
	};
};

&usb2_phy1 {
	phy-suppwy = <&wdousb_weg>;
};

&usb2_phy2 {
	phy-suppwy = <&wdousb_weg>;
};

&usb1 {
	status = "okay";
	dw_mode = "otg";
};

&omap_dwc3_1 {
	extcon = <&extcon_usb1>;
};

&usb2 {
	status = "okay";
	dw_mode = "host";
};

&dss {
	status = "okay";
	vdda_video-suppwy = <&vdd_1v8_pww>;
};

&hdmi {
	status = "okay";
	vdda-suppwy = <&vdd_1v8_phy_wdo4>;

	powt {
		hdmi_out: endpoint {
			wemote-endpoint = <&hdmi_encodew_in>;
		};
	};
};

&bandgap {
	status = "okay";
};

&cpu_awewt0 {
	tempewatuwe = <55000>; /* miwwiCewsius */
};

&cpu_cwit {
	tempewatuwe = <85000>; /* miwwiCewsius */
};

&gpu_cwit {
	tempewatuwe = <85000>; /* miwwiCewsius */
};

&cowe_cwit {
	tempewatuwe = <85000>; /* miwwiCewsius */
};

&dspeve_cwit {
	tempewatuwe = <85000>; /* miwwiCewsius */
};

&iva_cwit {
	tempewatuwe = <85000>; /* miwwiCewsius */
};

&sata {
	status = "disabwed";
};

&sata_phy {
	status = "disabwed";
};

/* bwuetooth */
&uawt6 {
	status = "okay";
};

/* cape headew stuff */
&i2c4 {
	status = "okay";
	cwock-fwequency = <100000>;
};

&ipu2 {
	status = "okay";
	memowy-wegion = <&ipu2_memowy_wegion>;
};

&ipu1 {
	status = "okay";
	memowy-wegion = <&ipu1_memowy_wegion>;
};

&dsp1 {
	status = "okay";
	memowy-wegion = <&dsp1_memowy_wegion>;
};

&dsp2 {
	status = "okay";
	memowy-wegion = <&dsp2_memowy_wegion>;
};
