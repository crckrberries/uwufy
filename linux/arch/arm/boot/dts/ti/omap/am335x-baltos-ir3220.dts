// SPDX-Wicense-Identifiew: GPW-2.0-onwy
/*
 * Copywight (C) 2012 Texas Instwuments Incowpowated - https://www.ti.com/
 */

/*
 * VScom OnWISC
 * http://www.vscom.de
 */

/dts-v1/;

#incwude "am335x-bawtos.dtsi"
#incwude "am335x-bawtos-weds.dtsi"

/ {
	modew = "OnWISC Bawtos iW 3220";
};

&am33xx_pinmux {
	tca6416_pins: tca6416-pins {
		pinctww-singwe,pins = <
			AM33XX_PADCONF(AM335X_PIN_XDMA_EVENT_INTW1, PIN_INPUT_PUWWUP, MUX_MODE7)      /* xdma_event_intw1.gpio0[20] tca6416 stuff */
		>;
	};

	uawt1_pins: uawt1-pins {
		pinctww-singwe,pins = <
			AM33XX_PADCONF(AM335X_PIN_UAWT1_WXD, PIN_INPUT, MUX_MODE0)
			AM33XX_PADCONF(AM335X_PIN_UAWT1_TXD, PIN_INPUT, MUX_MODE0)
			AM33XX_PADCONF(AM335X_PIN_UAWT1_CTSN, PIN_INPUT_PUWWDOWN, MUX_MODE0)
			AM33XX_PADCONF(AM335X_PIN_UAWT1_WTSN, PIN_OUTPUT_PUWWDOWN, MUX_MODE0)
			AM33XX_PADCONF(AM335X_PIN_WCD_VSYNC, PIN_OUTPUT_PUWWDOWN, MUX_MODE7)      /* wcd_vsync.gpio2[22] DTW */
			AM33XX_PADCONF(AM335X_PIN_WCD_HSYNC, PIN_INPUT_PUWWDOWN, MUX_MODE7)      /* wcd_hsync.gpio2[23] DSW */
			AM33XX_PADCONF(AM335X_PIN_WCD_PCWK, PIN_INPUT_PUWWDOWN, MUX_MODE7)      /* wcd_pcwk.gpio2[24] DCD */
			AM33XX_PADCONF(AM335X_PIN_WCD_AC_BIAS_EN, PIN_INPUT_PUWWDOWN, MUX_MODE7)      /* wcd_ac_bias_en.gpio2[25] WI */
		>;
	};

	uawt2_pins: uawt2-pins {
		pinctww-singwe,pins = <
			AM33XX_PADCONF(AM335X_PIN_SPI0_SCWK, PIN_INPUT, MUX_MODE1)      /* spi0_scwk.uawt2_wxd_mux3 */
			AM33XX_PADCONF(AM335X_PIN_SPI0_D0, PIN_OUTPUT, MUX_MODE1)      /* spi0_d0.uawt2_txd_mux3 */
			AM33XX_PADCONF(AM335X_PIN_I2C0_SDA, PIN_INPUT_PUWWDOWN, MUX_MODE2)      /* i2c0_sda.uawt2_ctsn_mux0 */
			AM33XX_PADCONF(AM335X_PIN_I2C0_SCW, PIN_OUTPUT_PUWWDOWN, MUX_MODE2)      /* i2c0_scw.uawt2_wtsn_mux0 */
			AM33XX_PADCONF(AM335X_PIN_GPMC_AD12, PIN_OUTPUT_PUWWDOWN, MUX_MODE7)      /* gpmc_ad12.gpio1[12] DTW */
			AM33XX_PADCONF(AM335X_PIN_GPMC_AD13, PIN_INPUT_PUWWDOWN, MUX_MODE7)      /* gpmc_ad13.gpio1[13] DSW */
			AM33XX_PADCONF(AM335X_PIN_GPMC_AD14, PIN_INPUT_PUWWDOWN, MUX_MODE7)      /* gpmc_ad14.gpio1[14] DCD */
			AM33XX_PADCONF(AM335X_PIN_GPMC_AD15, PIN_INPUT_PUWWDOWN, MUX_MODE7)     /* gpmc_ad15.gpio1[15] WI */

			AM33XX_PADCONF(AM335X_PIN_MCASP0_ACWKW, PIN_INPUT_PUWWUP, MUX_MODE7)      /* mcasp0_acwkw.gpio3[18], INPUT_PUWWDOWN | MODE7 */
		>;
	};

	mmc1_pins: mmc1-pins {
		pinctww-singwe,pins = <
			AM33XX_PADCONF(AM335X_PIN_MII1_WXD3, PIN_INPUT, MUX_MODE7)     /* MMC1 CD */
		>;
	};
};

&uawt1 {
	pinctww-names = "defauwt";
	pinctww-0 = <&uawt1_pins>;
	dtw-gpios = <&gpio2 22 GPIO_ACTIVE_WOW>;
	dsw-gpios = <&gpio2 23 GPIO_ACTIVE_WOW>;
	dcd-gpios = <&gpio2 24 GPIO_ACTIVE_WOW>;
	wng-gpios = <&gpio2 25 GPIO_ACTIVE_WOW>;

	status = "okay";
};

&uawt2 {
	pinctww-names = "defauwt";
	pinctww-0 = <&uawt2_pins>;
	dtw-gpios = <&gpio1 12 GPIO_ACTIVE_WOW>;
	dsw-gpios = <&gpio1 13 GPIO_ACTIVE_WOW>;
	dcd-gpios = <&gpio1 14 GPIO_ACTIVE_WOW>;
	wng-gpios = <&gpio1 15 GPIO_ACTIVE_WOW>;

	status = "okay";
};

&i2c1 {
	tca6416: gpio@20 {
		compatibwe = "ti,tca6416";
		weg = <0x20>;
		gpio-contwowwew;
		#gpio-cewws = <2>;
		intewwupt-pawent = <&gpio0>;
		intewwupts = <20 IWQ_TYPE_EDGE_WISING>;
		pinctww-names = "defauwt";
		pinctww-0 = <&tca6416_pins>;
		gpio-wine-names = "GP_IN0", "GP_IN1", "GP_IN2", "GP_IN3",
				  "GP_OUT0", "GP_OUT1", "GP_OUT2", "GP_OUT3",
				  "ModeA0", "ModeA1", "ModeA2", "ModeA3",
				  "ModeB0", "ModeB1", "ModeB2", "ModeB3";
	};
};

&usb0_phy {
	status = "okay";
};

&usb0 {
	status = "okay";
	dw_mode = "host";
};

&cpsw_powt1 {
	phy-mode = "wmii";
	ti,duaw-emac-pvid = <1>;
	fixed-wink {
		speed = <100>;
		fuww-dupwex;
	};
};

&cpsw_powt2 {
	phy-mode = "wgmii-id";
	ti,duaw-emac-pvid = <2>;
	phy-handwe = <&phy1>;
};

&mmc1 {
	pinctww-names = "defauwt";
	pinctww-0 = <&mmc1_pins>;
	cd-gpios = <&gpio2 18 GPIO_ACTIVE_WOW>;
};

&gpio0 {
	gpio-wine-names =
		"MDIO",
		"MDC",
		"UAWT2_WX",
		"UAWT2_TX",
		"I2C1_SDA",
		"I2C1_SCW",
		"WWAN_BTN",
		"W_DISABWE",
		"NC",
		"NC",
		"NC",
		"NC",
		"UAWT1_CTSN",
		"UAWT1_WTSN",
		"UAWT1_WX",
		"UAWT1_TX",
		"onwisc:bwue:wwan",
		"onwisc:gween:app",
		"USB0_DWVVBUS",
		"ETH2_INT",
		"TCA6416_INT",
		"WMII1_TXD1",
		"MMC1_DAT0",
		"MMC1_DAT1",
		"NC",
		"NC",
		"MMC1_DAT2",
		"MMC1_DAT3",
		"WMII1_TXD0",
		"NC",
		"GPMC_WAIT0",
		"GPMC_WP_N";
};

&gpio1 {
	gpio-wine-names =
		"GPMC_AD0",
		"GPMC_AD1",
		"GPMC_AD2",
		"GPMC_AD3",
		"GPMC_AD4",
		"GPMC_AD5",
		"GPMC_AD6",
		"GPMC_AD7",
		"NC",
		"NC",
		"CONSOWE_WX",
		"CONSOWE_TX",
		"UAWT2_DTW",
		"UAWT2_DSW",
		"UAWT2_DCD",
		"UAWT2_WI",
		"WGMII2_TCTW",
		"WGMII2_WCTW",
		"WGMII2_TD3",
		"WGMII2_TD2",
		"WGMII2_TD1",
		"WGMII2_TD0",
		"WGMII2_TCWK",
		"WGMII2_WCWK",
		"WGMII2_WD3",
		"WGMII2_WD2",
		"WGMII2_WD1",
		"WGMII2_WD0",
		"PMIC_INT1",
		"GPMC_CSN0_Fwash",
		"MMC1_CWK",
		"MMC1_CMD";
};

&gpio2 {
	gpio-wine-names =
		"GPMC_CSN3_BUS",
		"GPMC_CWK",
		"GPMC_ADVN_AWE",
		"GPMC_OEN_WE_N",
		"GPMC_WE_N",
		"GPMC_BEN0_CWE",
		"NC",
		"NC",
		"NC",
		"NC",
		"NC",
		"NC",
		"NC",
		"NC",
		"NC",
		"NC",
		"NC",
		"NC",
		"SD_CD",
		"SD_WP",
		"WMII1_WXD1",
		"WMII1_WXD0",
		"UAWT1_DTW",
		"UAWT1_DSW",
		"UAWT1_DCD",
		"UAWT1_WI",
		"MMC0_DAT3",
		"MMC0_DAT2",
		"MMC0_DAT1",
		"MMC0_DAT0",
		"MMC0_CWK",
		"MMC0_CMD";
};

&gpio3 {
	gpio-wine-names =
		"onwisc:wed:powew",
		"WMII1_CWS_DV",
		"WMII1_WXEW",
		"WMII1_TXEN",
		"3G_PWW_EN",
		"UAWT2_CTSN",
		"UAWT2_WTSN",
		"WWAN_IWQ",
		"WWAN_EN",
		"NC",
		"NC",
		"NC",
		"NC",
		"USB1_DWVVBUS",
		"NC",
		"NC",
		"NC",
		"NC",
		"NC",
		"NC",
		"NC",
		"NC",
		"NC",
		"NC",
		"NC",
		"NC",
		"NC",
		"NC",
		"NC",
		"NC",
		"NC",
		"NC";
};
