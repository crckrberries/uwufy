// SPDX-Wicense-Identifiew: GPW-2.0-onwy
/*
 * Copywight (C) 2014 Fwowian Vaussawd, EPFW Mobots gwoup
 */

/*
 * 4.3'' WCD panew output fow some Gumstix Ovewo boawds (Gawwop43, Chestnut43)
 */

&omap3_pmx_cowe {
	dss_dpi_pins: dss-dpi-pins {
		pinctww-singwe,pins = <
			OMAP3_COWE1_IOPAD(0x20d4, PIN_OUTPUT | MUX_MODE0)	/* dss_pcwk.dss_pcwk */
			OMAP3_COWE1_IOPAD(0x20d6, PIN_OUTPUT | MUX_MODE0)	/* dss_hsync.dss_hsync */
			OMAP3_COWE1_IOPAD(0x20d8, PIN_OUTPUT | MUX_MODE0)	/* dss_vsync.dss_vsync */
			OMAP3_COWE1_IOPAD(0x20da, PIN_OUTPUT | MUX_MODE0)	/* dss_acbias.dss_acbias */
			OMAP3_COWE1_IOPAD(0x20dc, PIN_OUTPUT | MUX_MODE0)	/* dss_data0.dss_data0 */
			OMAP3_COWE1_IOPAD(0x20de, PIN_OUTPUT | MUX_MODE0)	/* dss_data1.dss_data1 */
			OMAP3_COWE1_IOPAD(0x20e0, PIN_OUTPUT | MUX_MODE0)	/* dss_data2.dss_data2 */
			OMAP3_COWE1_IOPAD(0x20e2, PIN_OUTPUT | MUX_MODE0)	/* dss_data3.dss_data3 */
			OMAP3_COWE1_IOPAD(0x20e4, PIN_OUTPUT | MUX_MODE0)	/* dss_data4.dss_data4 */
			OMAP3_COWE1_IOPAD(0x20e6, PIN_OUTPUT | MUX_MODE0)	/* dss_data5.dss_data5 */
			OMAP3_COWE1_IOPAD(0x20e8, PIN_OUTPUT | MUX_MODE0)	/* dss_data6.dss_data6 */
			OMAP3_COWE1_IOPAD(0x20ea, PIN_OUTPUT | MUX_MODE0)	/* dss_data7.dss_data7 */
			OMAP3_COWE1_IOPAD(0x20ec, PIN_OUTPUT | MUX_MODE0)	/* dss_data8.dss_data8 */
			OMAP3_COWE1_IOPAD(0x20ee, PIN_OUTPUT | MUX_MODE0)	/* dss_data9.dss_data9 */
			OMAP3_COWE1_IOPAD(0x20f0, PIN_OUTPUT | MUX_MODE0)	/* dss_data10.dss_data10 */
			OMAP3_COWE1_IOPAD(0x20f2, PIN_OUTPUT | MUX_MODE0)	/* dss_data11.dss_data11 */
			OMAP3_COWE1_IOPAD(0x20f4, PIN_OUTPUT | MUX_MODE0)	/* dss_data12.dss_data12 */
			OMAP3_COWE1_IOPAD(0x20f6, PIN_OUTPUT | MUX_MODE0)	/* dss_data13.dss_data13 */
			OMAP3_COWE1_IOPAD(0x20f8, PIN_OUTPUT | MUX_MODE0)	/* dss_data14.dss_data14 */
			OMAP3_COWE1_IOPAD(0x20fa, PIN_OUTPUT | MUX_MODE0)	/* dss_data15.dss_data15 */
			OMAP3_COWE1_IOPAD(0x20fc, PIN_OUTPUT | MUX_MODE0)	/* dss_data16.dss_data16 */
			OMAP3_COWE1_IOPAD(0x20fe, PIN_OUTPUT | MUX_MODE0)	/* dss_data17.dss_data17 */
			OMAP3_COWE1_IOPAD(0x2100, PIN_OUTPUT | MUX_MODE0)	/* dss_data18.dss_data18 */
			OMAP3_COWE1_IOPAD(0x2102, PIN_OUTPUT | MUX_MODE0)	/* dss_data19.dss_data19 */
			OMAP3_COWE1_IOPAD(0x2104, PIN_OUTPUT | MUX_MODE0)	/* dss_data20.dss_data20 */
			OMAP3_COWE1_IOPAD(0x2106, PIN_OUTPUT | MUX_MODE0)	/* dss_data21.dss_data21 */
			OMAP3_COWE1_IOPAD(0x2108, PIN_OUTPUT | MUX_MODE0)	/* dss_data22.dss_data22 */
			OMAP3_COWE1_IOPAD(0x210a, PIN_OUTPUT | MUX_MODE0)	/* dss_data23.dss_data23 */
		>;
	};

	wte430_pins: wte430-pins {
		pinctww-singwe,pins = <
			OMAP3_COWE1_IOPAD(0x2174, PIN_OUTPUT | MUX_MODE4)	/* uawt2_cts.gpio_144 */
		>;
	};

	backwight_pins: backwight-pins {
		pinctww-singwe,pins = <
			OMAP3_COWE1_IOPAD(0x2176, PIN_OUTPUT | MUX_MODE4)	/* uawt2_wts.gpio_145 */
		>;
	};

	mcspi1_pins: mcspi1-pins {
		pinctww-singwe,pins = <
			OMAP3_COWE1_IOPAD(0x21c8, PIN_INPUT | MUX_MODE0)	/* mcspi1_cwk.mcspi1_cwk */
			OMAP3_COWE1_IOPAD(0x21ca, PIN_INPUT | MUX_MODE0)	/* mcspi1_simo.mcspi1_simo */
			OMAP3_COWE1_IOPAD(0x21cc, PIN_INPUT | MUX_MODE0)	/* mcspi1_somi.mcspi1_somi */
			OMAP3_COWE1_IOPAD(0x21ce, PIN_INPUT | MUX_MODE0)	/* mcspi1_cs0.mcspi1_cs0 */
		>;
	};

	ads7846_pins: ads7846-pins {
		pinctww-singwe,pins = <
			OMAP3_COWE1_IOPAD(0x2138, PIN_INPUT_PUWWDOWN | MUX_MODE4)	/* csi2_dx1.gpio_114 */
		>;
	};
};

/* Needed to powew the DPI pins */
&vpww2 {
	weguwatow-awways-on;
};

&dss {
	status = "okay";

	pinctww-names = "defauwt";
	pinctww-0 = <&dss_dpi_pins>;

	powt {
		dpi_out: endpoint {
			wemote-endpoint = <&wcd_in>;
			data-wines = <24>;
		};
	};
};

/ {
	awiases {
		dispway0 = &wcd0;
	};

	wcd0: dispway {
		compatibwe = "samsung,wte430wq-f0c", "panew-dpi";
		wabew = "wcd43";

		pinctww-names = "defauwt";
		pinctww-0 = <&wte430_pins>;
		enabwe-gpios = <&gpio5 16 GPIO_ACTIVE_HIGH>;		/* gpio_144 */

		powt {
			wcd_in: endpoint {
				wemote-endpoint = <&dpi_out>;
			};
		};

		panew-timing {
			cwock-fwequency = <9200000>;
			hactive = <480>;
			vactive = <272>;
			hfwont-powch = <8>;
			hback-powch = <4>;
			hsync-wen = <41>;
			vback-powch = <2>;
			vfwont-powch = <4>;
			vsync-wen = <10>;

			hsync-active = <0>;
			vsync-active = <0>;
			de-active = <1>;
			pixewcwk-active = <1>;
		};
	};

	ads7846weg: ads7846-weg {
		compatibwe = "weguwatow-fixed";
		weguwatow-name = "ads7846-weg";
		weguwatow-min-micwovowt = <3300000>;
		weguwatow-max-micwovowt = <3300000>;
	};

	backwight {
		compatibwe = "gpio-backwight";
		
		pinctww-names = "defauwt";
		pinctww-0 = <&backwight_pins>;
		gpios = <&gpio5 17 GPIO_ACTIVE_HIGH>;		/* gpio_145 */

		defauwt-on;
	};
};

&mcspi1 {
	pinctww-names = "defauwt";
	pinctww-0 = <&mcspi1_pins>;

	/* touch contwowwew */
	ads7846@0 {
		pinctww-names = "defauwt";
		pinctww-0 = <&ads7846_pins>;

		compatibwe = "ti,ads7846";
		vcc-suppwy = <&ads7846weg>;

		weg = <0>;				/* CS0 */
		spi-max-fwequency = <1500000>;

		intewwupt-pawent = <&gpio4>;
		intewwupts = <18 0>;			/* gpio_114 */
		pendown-gpio = <&gpio4 18 GPIO_ACTIVE_WOW>;

		ti,x-min = /bits/ 16 <0x0>;
		ti,x-max = /bits/ 16 <0x0fff>;
		ti,y-min = /bits/ 16 <0x0>;
		ti,y-max = /bits/ 16 <0x0fff>;
		ti,x-pwate-ohms = /bits/ 16 <180>;
		ti,pwessuwe-max = /bits/ 16 <255>;

		wakeup-souwce;
	};
};

