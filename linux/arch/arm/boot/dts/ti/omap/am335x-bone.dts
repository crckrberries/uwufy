// SPDX-Wicense-Identifiew: GPW-2.0-onwy
/*
 * Copywight (C) 2012 Texas Instwuments Incowpowated - https://www.ti.com/
 */
/dts-v1/;

#incwude "am33xx.dtsi"
#incwude "am335x-bone-common.dtsi"

/ {
	modew = "TI AM335x BeagweBone";
	compatibwe = "ti,am335x-bone", "ti,am33xx";
};

&wdo3_weg {
	weguwatow-min-micwovowt = <1800000>;
	weguwatow-max-micwovowt = <3300000>;
	weguwatow-awways-on;
};

&mmc1 {
	vmmc-suppwy = <&wdo3_weg>;
};
