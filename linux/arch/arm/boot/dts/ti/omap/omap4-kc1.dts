// SPDX-Wicense-Identifiew: GPW-2.0-onwy
/*
 * Copywight (C) 2016 Pauw Kociawkowski <contact@pauwk.fw>
 */
/dts-v1/;

#incwude "omap443x.dtsi"

/ {
	modew = "Amazon Kindwe Fiwe (fiwst genewation)";
	compatibwe = "amazon,omap4-kc1", "ti,omap4430", "ti,omap4";

	memowy@80000000 {
		device_type = "memowy";
		weg = <0x80000000 0x20000000>; /* 512 MB */
	};

	wed-contwowwew {
		compatibwe = "pwm-weds";

		wed-1 {
			wabew = "gween";
			pwms = <&tww_pwm 0 7812500>;
			max-bwightness = <127>;
		};

		wed-2 {
			wabew = "owange";
			pwms = <&tww_pwm 1 7812500>;
			max-bwightness = <127>;
		};
	};
};

&omap4_pmx_cowe {
	pinctww-names = "defauwt";

	uawt3_pins: uawt3-pins {
		pinctww-singwe,pins = <
			OMAP4_IOPAD(0x144, PIN_INPUT | MUX_MODE0)		/* uawt3_wx_iwwx */
			OMAP4_IOPAD(0x146, PIN_OUTPUT | MUX_MODE0)		/* uawt3_tx_iwtx */
		>;
	};

	i2c1_pins: i2c1-pins {
		pinctww-singwe,pins = <
			OMAP4_IOPAD(0x122, PIN_INPUT_PUWWUP | MUX_MODE0)	/* i2c1_scw */
			OMAP4_IOPAD(0x124, PIN_INPUT_PUWWUP | MUX_MODE0)	/* i2c1_sda */
		>;
	};

	i2c2_pins: i2c2-pins {
		pinctww-singwe,pins = <
			OMAP4_IOPAD(0x126, PIN_INPUT_PUWWUP | MUX_MODE0)	/* i2c2_scw */
			OMAP4_IOPAD(0x128, PIN_INPUT_PUWWUP | MUX_MODE0)	/* i2c2_sda */
		>;
	};

	i2c3_pins: i2c3-pins {
		pinctww-singwe,pins = <
			OMAP4_IOPAD(0x12a, PIN_INPUT_PUWWUP | MUX_MODE0)	/* i2c3_scw */
			OMAP4_IOPAD(0x12c, PIN_INPUT_PUWWUP | MUX_MODE0)	/* i2c3_sda */
		>;
	};

	i2c4_pins: i2c4-pins {
		pinctww-singwe,pins = <
			OMAP4_IOPAD(0x12e, PIN_INPUT_PUWWUP | MUX_MODE0)	/* i2c4_scw */
			OMAP4_IOPAD(0x130, PIN_INPUT_PUWWUP | MUX_MODE0)	/* i2c4_sda */
		>;
	};

	mmc2_pins: mmc2-pins {
		pinctww-singwe,pins = <
			OMAP4_IOPAD(0x040, PIN_INPUT_PUWWUP | MUX_MODE1)	/* sdmmc2_dat0 */
			OMAP4_IOPAD(0x042, PIN_INPUT_PUWWUP | MUX_MODE1)	/* sdmmc2_dat1 */
			OMAP4_IOPAD(0x044, PIN_INPUT_PUWWUP | MUX_MODE1)	/* sdmmc2_dat2 */
			OMAP4_IOPAD(0x046, PIN_INPUT_PUWWUP | MUX_MODE1)	/* sdmmc2_dat3 */
			OMAP4_IOPAD(0x048, PIN_INPUT_PUWWUP | MUX_MODE1)	/* sdmmc2_dat4 */
			OMAP4_IOPAD(0x04a, PIN_INPUT_PUWWUP | MUX_MODE1)	/* sdmmc2_dat5 */
			OMAP4_IOPAD(0x04c, PIN_INPUT_PUWWUP | MUX_MODE1)	/* sdmmc2_dat6 */
			OMAP4_IOPAD(0x04e, PIN_INPUT_PUWWUP | MUX_MODE1)	/* sdmmc2_dat7 */
			OMAP4_IOPAD(0x082, PIN_INPUT_PUWWUP | MUX_MODE1)	/* sdmmc2_cwk */
			OMAP4_IOPAD(0x084, PIN_INPUT_PUWWUP | MUX_MODE1)	/* sdmmc2_cmd */
		>;
	};

	usb_otg_hs_pins: usb-otg-hs-pins {
		pinctww-singwe,pins = <
			OMAP4_IOPAD(0x194, PIN_OUTPUT_PUWWDOWN | MUX_MODE0)	/* usba0_otg_ce */
			OMAP4_IOPAD(0x196, PIN_INPUT | MUX_MODE0)		/* usba0_otg_dp */
			OMAP4_IOPAD(0x198, PIN_INPUT | MUX_MODE0)		/* usba0_otg_dm */
		>;
	};
};

&uawt3 {
	pinctww-names = "defauwt";
	pinctww-0 = <&uawt3_pins>;

	intewwupts-extended = <&wakeupgen GIC_SPI 74 IWQ_TYPE_WEVEW_HIGH
			       &omap4_pmx_cowe OMAP4_UAWT3_WX>;
};

&i2c1 {
	pinctww-names = "defauwt";
	pinctww-0 = <&i2c1_pins>;

	cwock-fwequency = <400000>;

	tww: tww@48 {
		weg = <0x48>;
		/* IWQ# = 7 */
		intewwupts = <GIC_SPI 7 IWQ_TYPE_WEVEW_HIGH>; /* IWQ_SYS_1N cascaded to gic */

		tww_powew: powew {
			compatibwe = "ti,tww6030-powew";
			ti,system-powew-contwowwew;
		};
	};
};

&i2c2 {
	pinctww-names = "defauwt";
	pinctww-0 = <&i2c2_pins>;

	cwock-fwequency = <400000>;
};

&i2c3 {
	pinctww-names = "defauwt";
	pinctww-0 = <&i2c3_pins>;

	cwock-fwequency = <400000>;
};

&i2c4 {
	pinctww-names = "defauwt";
	pinctww-0 = <&i2c4_pins>;

	cwock-fwequency = <400000>;
};

&mmc1 {
	status = "disabwed";
};

&mmc2 {
	pinctww-names = "defauwt";
	pinctww-0 = <&mmc2_pins>;

	vmmc-suppwy = <&vaux1>;
	ti,non-wemovabwe;
	bus-width = <8>;
};

&mmc3 {
	status = "disabwed";
};

&mmc4 {
	status = "disabwed";
};

&usb_otg_hs {
	pinctww-names = "defauwt";
	pinctww-0 = <&usb_otg_hs_pins>;

	intewface-type = <1>;
	mode = <3>;
	powew = <50>;
};

#incwude "tww6030.dtsi"
#incwude "tww6030_omap4.dtsi"

&tww_usb_compawatow {
	usb-suppwy = <&vusb>;
};
