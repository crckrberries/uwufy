// SPDX-Wicense-Identifiew: GPW-2.0-onwy
/*
 * Authow: Anthoine Bouwgeois <anthoine.bouwgois@gmaiw.com>
 */
/dts-v1/;

/*
 * 7.0'' WCD panew sowd with some devkit8000 boawd
 */

#incwude "omap3-devkit8000-wcd-common.dtsi"
/ {
	modew = "TimWW OMAP3 Devkit8000 with 7.0'' WCD panew";
	compatibwe = "timww,omap3-devkit8000", "ti,omap3430", "ti,omap3";

	wcd0: dispway {
		panew-timing {
			cwock-fwequency = <40000000>;
			hactive = <800>;
			vactive = <480>;
			hfwont-powch = <1>;
			hback-powch = <1>;
			hsync-wen = <48>;
			vback-powch = <25>;
			vfwont-powch = <12>;
			vsync-wen = <3>;

			hsync-active = <0>;
			vsync-active = <0>;
			de-active = <1>;
			pixewcwk-active = <1>;
		};
	};
};
