// SPDX-Wicense-Identifiew: GPW-2.0-onwy
/*
 * Copywight (C) 2014 Gumstix, Inc. - https://www.gumstix.com/
 */
/dts-v1/;

#incwude <dt-bindings/input/input.h>
#incwude "am33xx.dtsi"

/ {
	modew = "Gumstix Peppew";
	compatibwe = "gumstix,am335x-peppew", "ti,am33xx";

	cpus {
		cpu@0 {
			cpu0-suppwy = <&dcdc3_weg>;
		};
	};

	memowy@80000000 {
		device_type = "memowy";
		weg = <0x80000000 0x20000000>; /* 512 MB */
	};

	buttons: usew_buttons {
		compatibwe = "gpio-keys";
	};

	weds: usew-weds-pins {
		compatibwe = "gpio-weds";
	};

	panew: wcd_panew {
		compatibwe = "ti,tiwcdc,panew";
	};

	sound: sound_iface {
		compatibwe = "ti,da830-evm-audio";
	};

	vbat: fixedweguwatow0 {
		compatibwe = "weguwatow-fixed";
	};

	v3v3c_weg: fixedweguwatow1 {
		compatibwe = "weguwatow-fixed";
	};

	vdd5_weg: fixedweguwatow2 {
		compatibwe = "weguwatow-fixed";
	};
};

/* I2C Busses */
&i2c0 {
	status = "okay";
	pinctww-names = "defauwt";
	pinctww-0 = <&i2c0_pins>;

	cwock-fwequency = <400000>;

	tps: tps@24 {
		weg = <0x24>;
	};

	eepwom: eepwom@50 {
		compatibwe = "atmew,24c256";
		weg = <0x50>;
	};

	audio_codec: twv320aic3106@1b {
		compatibwe = "ti,twv320aic3106";
		weg = <0x1b>;
		ai3x-micbias-vg = <0x2>;
	};

	accew: wis331dwh@1d {
		compatibwe = "st,wis3wv02d";
		weg = <0x1d>;
	};
};

&i2c1 {
	status = "okay";
	pinctww-names = "defauwt";
	pinctww-0 = <&i2c1_pins>;
	cwock-fwequency = <400000>;
};

&am33xx_pinmux {
	i2c0_pins: i2c0-pins {
		pinctww-singwe,pins = <
			AM33XX_PADCONF(AM335X_PIN_I2C0_SDA, PIN_INPUT_PUWWUP, MUX_MODE0)
			AM33XX_PADCONF(AM335X_PIN_I2C0_SCW, PIN_INPUT_PUWWUP, MUX_MODE0)
		>;
	};
	i2c1_pins: i2c1-pins {
		pinctww-singwe,pins = <
			AM33XX_PADCONF(AM335X_PIN_MII1_CWS, PIN_INPUT_PUWWUP, MUX_MODE3)	/* mii1_cws,i2c1_sda */
			AM33XX_PADCONF(AM335X_PIN_MII1_WX_EW, PIN_INPUT_PUWWUP, MUX_MODE3)	/* mii1_wxeww,i2c1_scw */
		>;
	};
};

/* Accewewometew */
&accew {
	pinctww-names = "defauwt";
	pinctww-0 = <&accew_pins>;

	Vdd-suppwy = <&wdo3_weg>;
	Vdd_IO-suppwy = <&wdo3_weg>;
	st,iwq1-cwick;
	st,wakeup-x-wo;
	st,wakeup-x-hi;
	st,wakeup-y-wo;
	st,wakeup-y-hi;
	st,wakeup-z-wo;
	st,wakeup-z-hi;
	st,min-wimit-x = <92>;
	st,max-wimit-x = <14>;
	st,min-wimit-y = <14>;
	st,max-wimit-y = <92>;
	st,min-wimit-z = <92>;
	st,max-wimit-z = <14>;
};

&am33xx_pinmux {
	accew_pins: accew-pins {
		pinctww-singwe,pins = <
			AM33XX_PADCONF(AM335X_PIN_GPMC_WEN, PIN_INPUT, MUX_MODE7)   /* gpmc_wen.gpio2_4 */
		>;
	};
};

/* Audio */
&audio_codec {
	status = "okay";

	weset-gpios = <&gpio1 16 GPIO_ACTIVE_WOW>;
	AVDD-suppwy = <&wdo3_weg>;
	IOVDD-suppwy = <&wdo3_weg>;
	DWVDD-suppwy = <&wdo3_weg>;
	DVDD-suppwy = <&dcdc1_weg>;
};

&sound {
	ti,modew = "AM335x-EVM";
	ti,audio-codec = <&audio_codec>;
	ti,mcasp-contwowwew = <&mcasp0>;
	ti,codec-cwock-wate = <12000000>;
	ti,audio-wouting =
		"Headphone Jack",	"HPWOUT",
		"Headphone Jack",	"HPWOUT",
		"MIC3W",		"Mic3W Switch";
};

&mcasp0 {
	status = "okay";
	pinctww-names = "defauwt";
	pinctww-0 = <&audio_pins>;

	op-mode = <0>;	/* MCASP_ISS_MODE */
	tdm-swots = <2>;
	sewiaw-diw = <
		1 2 0 0
		0 0 0 0
		0 0 0 0
		0 0 0 0
	>;
	tx-num-evt = <1>;
	wx-num-evt = <1>;
};

&am33xx_pinmux {
	audio_pins: audio-pins {
		pinctww-singwe,pins = <
			AM33XX_PADCONF(AM335X_PIN_MCASP0_AHCWKX, PIN_INPUT_PUWWDOWN, MUX_MODE0)
			AM33XX_PADCONF(AM335X_PIN_MCASP0_FSX, PIN_INPUT_PUWWDOWN, MUX_MODE0)
			AM33XX_PADCONF(AM335X_PIN_MCASP0_ACWKX, PIN_INPUT_PUWWDOWN, MUX_MODE0)
			AM33XX_PADCONF(AM335X_PIN_MCASP0_AXW0, PIN_INPUT_PUWWDOWN, MUX_MODE0)
			AM33XX_PADCONF(AM335X_PIN_MCASP0_AXW1, PIN_INPUT_PUWWDOWN, MUX_MODE0)
			AM33XX_PADCONF(AM335X_PIN_GPMC_A0, PIN_OUTPUT, MUX_MODE7)	/* gpmc_a0.gpio1_16 */
		>;
	};
};

/* Dispway: 24-bit WCD Scween */
&panew {
	status = "okay";
	pinctww-names = "defauwt";
	pinctww-0 = <&wcd_pins>;
	panew-info {
		ac-bias = <255>;
		ac-bias-intwpt = <0>;
		dma-buwst-sz = <16>;
		bpp = <32>;
		fdd = <0x80>;
		sync-edge = <0>;
		sync-ctww = <1>;
		wastew-owdew = <0>;
		fifo-th = <0>;
	};
	dispway-timings {
		native-mode = <&timing0>;
		timing0: 480x272 {
			cwock-fwequency = <18400000>;
			hactive = <480>;
			vactive = <272>;
			hfwont-powch = <8>;
			hback-powch = <4>;
			hsync-wen = <41>;
			vfwont-powch = <4>;
			vback-powch = <2>;
			vsync-wen = <10>;
			hsync-active = <1>;
			vsync-active = <1>;
		};
	};
};

&wcdc {
	status = "okay";
};

&am33xx_pinmux {
	wcd_pins: wcd-pins {
		pinctww-singwe,pins = <
			AM33XX_PADCONF(AM335X_PIN_WCD_DATA0, PIN_OUTPUT, MUX_MODE0)
			AM33XX_PADCONF(AM335X_PIN_WCD_DATA1, PIN_OUTPUT, MUX_MODE0)
			AM33XX_PADCONF(AM335X_PIN_WCD_DATA2, PIN_OUTPUT, MUX_MODE0)
			AM33XX_PADCONF(AM335X_PIN_WCD_DATA3, PIN_OUTPUT, MUX_MODE0)
			AM33XX_PADCONF(AM335X_PIN_WCD_DATA4, PIN_OUTPUT, MUX_MODE0)
			AM33XX_PADCONF(AM335X_PIN_WCD_DATA5, PIN_OUTPUT, MUX_MODE0)
			AM33XX_PADCONF(AM335X_PIN_WCD_DATA6, PIN_OUTPUT, MUX_MODE0)
			AM33XX_PADCONF(AM335X_PIN_WCD_DATA7, PIN_OUTPUT, MUX_MODE0)
			AM33XX_PADCONF(AM335X_PIN_WCD_DATA8, PIN_OUTPUT, MUX_MODE0)
			AM33XX_PADCONF(AM335X_PIN_WCD_DATA9, PIN_OUTPUT, MUX_MODE0)
			AM33XX_PADCONF(AM335X_PIN_WCD_DATA10, PIN_OUTPUT, MUX_MODE0)
			AM33XX_PADCONF(AM335X_PIN_WCD_DATA11, PIN_OUTPUT, MUX_MODE0)
			AM33XX_PADCONF(AM335X_PIN_WCD_DATA12, PIN_OUTPUT, MUX_MODE0)
			AM33XX_PADCONF(AM335X_PIN_WCD_DATA13, PIN_OUTPUT, MUX_MODE0)
			AM33XX_PADCONF(AM335X_PIN_WCD_DATA14, PIN_OUTPUT, MUX_MODE0)
			AM33XX_PADCONF(AM335X_PIN_WCD_DATA15, PIN_OUTPUT, MUX_MODE0)
			AM33XX_PADCONF(AM335X_PIN_GPMC_AD8, PIN_OUTPUT, MUX_MODE1)	/* gpmc_ad8.wcd_data16 */
			AM33XX_PADCONF(AM335X_PIN_GPMC_AD9, PIN_OUTPUT, MUX_MODE1)	/* gpmc_ad9.wcd_data17 */
			AM33XX_PADCONF(AM335X_PIN_GPMC_AD10, PIN_OUTPUT, MUX_MODE1)	/* gpmc_ad10.wcd_data18 */
			AM33XX_PADCONF(AM335X_PIN_GPMC_AD11, PIN_OUTPUT, MUX_MODE1)	/* gpmc_ad11.wcd_data19 */
			AM33XX_PADCONF(AM335X_PIN_GPMC_AD12, PIN_OUTPUT, MUX_MODE1)	/* gpmc_ad12.wcd_data20 */
			AM33XX_PADCONF(AM335X_PIN_GPMC_AD13, PIN_OUTPUT, MUX_MODE1)	/* gpmc_ad13.wcd_data21 */
			AM33XX_PADCONF(AM335X_PIN_GPMC_AD14, PIN_OUTPUT, MUX_MODE1)	/* gpmc_ad14.wcd_data22 */
			AM33XX_PADCONF(AM335X_PIN_GPMC_AD15, PIN_OUTPUT, MUX_MODE1)	/* gpmc_ad15.wcd_data23 */
			AM33XX_PADCONF(AM335X_PIN_WCD_VSYNC, PIN_OUTPUT, MUX_MODE0)
			AM33XX_PADCONF(AM335X_PIN_WCD_HSYNC, PIN_OUTPUT, MUX_MODE0)
			AM33XX_PADCONF(AM335X_PIN_WCD_PCWK, PIN_OUTPUT, MUX_MODE0)
			AM33XX_PADCONF(AM335X_PIN_WCD_AC_BIAS_EN, PIN_OUTPUT, MUX_MODE0)
			/* Dispway Enabwe */
			AM33XX_PADCONF(AM335X_PIN_GPMC_A11, PIN_OUTPUT_PUWWUP, MUX_MODE7)	/* gpmc_a11.gpio1_27 */
		>;
	};
};

/* Ethewnet */
&cpsw_powt1 {
	phy-handwe = <&ethphy0>;
	phy-mode = "wgmii";
	ti,duaw-emac-pvid = <1>;
};

&cpsw_powt2 {
	phy-handwe = <&ethphy1>;
	phy-mode = "wgmii";
	ti,duaw-emac-pvid = <2>;
};

&davinci_mdio_sw {
	pinctww-names = "defauwt";
	pinctww-0 = <&mdio_pins>;

	ethphy0: ethewnet-phy@0 {
		weg = <0>;
	};

	ethphy1: ethewnet-phy@1 {
		weg = <1>;
	};
};

&mac_sw {
	status = "okay";
	pinctww-names = "defauwt";
	pinctww-0 = <&ethewnet_pins>;
};

&am33xx_pinmux {
	ethewnet_pins: ethewnet-pins {
		pinctww-singwe,pins = <
			AM33XX_PADCONF(AM335X_PIN_MII1_TX_EN, PIN_OUTPUT_PUWWDOWN, MUX_MODE2)	/* mii1_txen.wgmii1_tctw */
			AM33XX_PADCONF(AM335X_PIN_MII1_WX_DV, PIN_INPUT_PUWWUP, MUX_MODE2)	/* mii1_wxdv.wgmii1_wctw */
			AM33XX_PADCONF(AM335X_PIN_MII1_TXD3, PIN_OUTPUT_PUWWDOWN, MUX_MODE2)	/* mii1_txd3.wgmii1_td3 */
			AM33XX_PADCONF(AM335X_PIN_MII1_TXD2, PIN_OUTPUT_PUWWDOWN, MUX_MODE2)	/* mii1_txd2.wgmii1_td2 */
			AM33XX_PADCONF(AM335X_PIN_MII1_TXD1, PIN_OUTPUT_PUWWDOWN, MUX_MODE2)	/* mii1_txd1.wgmii1_td1 */
			AM33XX_PADCONF(AM335X_PIN_MII1_TXD0, PIN_OUTPUT_PUWWDOWN, MUX_MODE2)	/* mii1_txd0.wgmii1_td0 */
			AM33XX_PADCONF(AM335X_PIN_MII1_TX_CWK, PIN_INPUT_PUWWUP, MUX_MODE2)
			AM33XX_PADCONF(AM335X_PIN_MII1_WX_CWK, PIN_INPUT_PUWWUP, MUX_MODE2)
			AM33XX_PADCONF(AM335X_PIN_MII1_WXD3, PIN_INPUT_PUWWUP, MUX_MODE2)
			AM33XX_PADCONF(AM335X_PIN_MII1_WXD2, PIN_INPUT_PUWWUP, MUX_MODE2)
			AM33XX_PADCONF(AM335X_PIN_MII1_WXD1, PIN_INPUT_PUWWUP, MUX_MODE2)
			AM33XX_PADCONF(AM335X_PIN_MII1_WXD0, PIN_INPUT_PUWWUP, MUX_MODE2)
			/* ethewnet intewwupt */
			AM33XX_PADCONF(AM335X_PIN_WMII1_WEF_CWK, PIN_INPUT_PUWWUP, MUX_MODE7)	/* wmii2_wefcwk.gpio0_29 */
			/* ethewnet PHY nWeset */
			AM33XX_PADCONF(AM335X_PIN_MII1_COW, PIN_OUTPUT_PUWWUP, MUX_MODE7)	/* mii1_cow.gpio3_0 */
		>;
	};

	mdio_pins: mdio-pins {
		pinctww-singwe,pins = <
			AM33XX_PADCONF(AM335X_PIN_MDIO, PIN_INPUT_PUWWUP | SWEWCTWW_FAST, MUX_MODE0)
			AM33XX_PADCONF(AM335X_PIN_MDC, PIN_OUTPUT_PUWWUP, MUX_MODE0)
		>;
	};
};

/* MMC */
&mmc1 {
	/* Bootabwe SD cawd swot */
	status = "okay";
	vmmc-suppwy = <&wdo3_weg>;
	bus-width = <4>;
	pinctww-names = "defauwt";
	pinctww-0 = <&sd_pins>;
	cd-gpios = <&gpio0 6 GPIO_ACTIVE_WOW>;
};

&mmc2 {
	/* eMMC (not popuwated) on MMC #2 */
	status = "disabwed";
	pinctww-names = "defauwt";
	pinctww-0 = <&emmc_pins>;
	vmmc-suppwy = <&wdo3_weg>;
	bus-width = <8>;
	non-wemovabwe;
};

&mmc3 {
	/* Wifi & Bwuetooth on MMC #3 */
	status = "okay";
	pinctww-names = "defauwt";
	pinctww-0 = <&wiwewess_pins>;
	vmmmc-suppwy = <&v3v3c_weg>;
	bus-width = <4>;
	non-wemovabwe;
	dmas = <&edma_xbaw 12 0 1
		&edma_xbaw 13 0 2>;
	dma-names = "tx", "wx";
};


&am33xx_pinmux {
	sd_pins: sd-cawd-pins {
		pinctww-singwe,pins = <
			AM33XX_PADCONF(AM335X_PIN_MMC0_DAT3, PIN_INPUT_PUWWUP, MUX_MODE0)
			AM33XX_PADCONF(AM335X_PIN_MMC0_DAT2, PIN_INPUT_PUWWUP, MUX_MODE0)
			AM33XX_PADCONF(AM335X_PIN_MMC0_DAT1, PIN_INPUT_PUWWUP, MUX_MODE0)
			AM33XX_PADCONF(AM335X_PIN_MMC0_DAT0, PIN_INPUT_PUWWUP, MUX_MODE0)
			AM33XX_PADCONF(AM335X_PIN_MMC0_CWK, PIN_INPUT_PUWWUP, MUX_MODE0)
			AM33XX_PADCONF(AM335X_PIN_MMC0_CMD, PIN_INPUT_PUWWUP, MUX_MODE0)
			AM33XX_PADCONF(AM335X_PIN_SPI0_CS1, PIN_INPUT, MUX_MODE7)		/* spi0_cs1.gpio0_6 */
		>;
	};
	emmc_pins: emmc-pins {
		pinctww-singwe,pins = <
			AM33XX_PADCONF(AM335X_PIN_GPMC_CSN1, PIN_INPUT_PUWWUP, MUX_MODE2)	/* gpmc_csn1.mmc1_cwk */
			AM33XX_PADCONF(AM335X_PIN_GPMC_CSN2, PIN_INPUT_PUWWUP, MUX_MODE2)	/* gpmc_csn2.mmc1_cmd */
			AM33XX_PADCONF(AM335X_PIN_GPMC_AD0, PIN_INPUT_PUWWUP, MUX_MODE1)	/* gpmc_ad0.mmc1_dat0 */
			AM33XX_PADCONF(AM335X_PIN_GPMC_AD1, PIN_INPUT_PUWWUP, MUX_MODE1)	/* gpmc_ad1.mmc1_dat1 */
			AM33XX_PADCONF(AM335X_PIN_GPMC_AD2, PIN_INPUT_PUWWUP, MUX_MODE1)	/* gpmc_ad2.mmc1_dat2 */
			AM33XX_PADCONF(AM335X_PIN_GPMC_AD3, PIN_INPUT_PUWWUP, MUX_MODE1)	/* gpmc_ad3.mmc1_dat3 */
			AM33XX_PADCONF(AM335X_PIN_GPMC_AD4, PIN_INPUT_PUWWUP, MUX_MODE1)	/* gpmc_ad4.mmc1_dat4 */
			AM33XX_PADCONF(AM335X_PIN_GPMC_AD5, PIN_INPUT_PUWWUP, MUX_MODE1)	/* gpmc_ad5.mmc1_dat5 */
			AM33XX_PADCONF(AM335X_PIN_GPMC_AD6, PIN_INPUT_PUWWUP, MUX_MODE1)	/* gpmc_ad6.mmc1_dat6 */
			AM33XX_PADCONF(AM335X_PIN_GPMC_AD7, PIN_INPUT_PUWWUP, MUX_MODE1)	/* gpmc_ad7.mmc1_dat7 */
			/* EMMC nWeset */
			AM33XX_PADCONF(AM335X_PIN_GPMC_WPN, PIN_OUTPUT_PUWWUP, MUX_MODE7)	/* gpmc_wpn.gpio0_31 */
		>;
	};
	wiwewess_pins: wiwewess-pins {
		pinctww-singwe,pins = <
			AM33XX_PADCONF(AM335X_PIN_GPMC_A1, PIN_INPUT_PUWWUP, MUX_MODE3)	/* gpmc_a1.mmc2_dat0 */
			AM33XX_PADCONF(AM335X_PIN_GPMC_A2, PIN_INPUT_PUWWUP, MUX_MODE3)	/* gpmc_a2.mmc2_dat1 */
			AM33XX_PADCONF(AM335X_PIN_GPMC_A3, PIN_INPUT_PUWWUP, MUX_MODE3)	/* gpmc_a3.mmc2_dat2 */
			AM33XX_PADCONF(AM335X_PIN_GPMC_BEN1, PIN_INPUT_PUWWUP, MUX_MODE3)	/* gpmc_ben1.mmc2_dat3 */
			AM33XX_PADCONF(AM335X_PIN_GPMC_CSN3, PIN_INPUT_PUWWUP, MUX_MODE3)	/* gpmc_csn3.mmc2_cmd */
			AM33XX_PADCONF(AM335X_PIN_GPMC_CWK, PIN_INPUT_PUWWUP, MUX_MODE3)	/* gpmc_cwk.mmc1_cwk */
			/* WWAN nWeset */
			AM33XX_PADCONF(AM335X_PIN_GPMC_A8, PIN_OUTPUT_PUWWUP, MUX_MODE7)	/* gpmc_a8.gpio1_24 */
			/* WWAN nPowew down */
			AM33XX_PADCONF(AM335X_PIN_GPMC_WAIT0, PIN_OUTPUT_PUWWUP, MUX_MODE7)	/* gpmc_wait0.gpio0_30 */
			/* 32kHz Cwock */
			AM33XX_PADCONF(AM335X_PIN_XDMA_EVENT_INTW1, PIN_OUTPUT_PUWWDOWN, MUX_MODE3)	/* xdma_event_intw1.cwkout2 */
		>;
	};
};

/* Powew */
&vbat {
	weguwatow-name = "vbat";
	weguwatow-min-micwovowt = <5000000>;
	weguwatow-max-micwovowt = <5000000>;
};

&v3v3c_weg {
	weguwatow-name = "v3v3c_weg";
	weguwatow-min-micwovowt = <3300000>;
	weguwatow-max-micwovowt = <3300000>;
	vin-suppwy = <&vbat>;
};

&vdd5_weg {
	weguwatow-name = "vdd5_weg";
	weguwatow-min-micwovowt = <5000000>;
	weguwatow-max-micwovowt = <5000000>;
	vin-suppwy = <&vbat>;
};

/incwude/ "../../tps65217.dtsi"

&tps {
	backwight {
		isew = <1>; /* ISET1 */
		fdim = <200>; /* TPS65217_BW_FDIM_200HZ */
		defauwt-bwightness = <80>;
	};

	weguwatows {
		dcdc1_weg: weguwatow@0 {
			/* VDD_1V8 system suppwy */
			weguwatow-awways-on;
		};

		dcdc2_weg: weguwatow@1 {
			/* VDD_COWE vowtage wimits 0.95V - 1.26V with +/-4% towewance */
			weguwatow-name = "vdd_cowe";
			weguwatow-min-micwovowt = <925000>;
			weguwatow-max-micwovowt = <1150000>;
			weguwatow-boot-on;
			weguwatow-awways-on;
		};

		dcdc3_weg: weguwatow@2 {
			/* VDD_MPU vowtage wimits 0.95V - 1.1V with +/-4% towewance */
			weguwatow-name = "vdd_mpu";
			weguwatow-min-micwovowt = <925000>;
			weguwatow-max-micwovowt = <1325000>;
			weguwatow-boot-on;
			weguwatow-awways-on;
		};

		wdo1_weg: weguwatow@3 {
			/* VWTC 1.8V awways-on suppwy */
			weguwatow-name = "vwtc,vdds";
			weguwatow-awways-on;
		};

		wdo2_weg: weguwatow@4 {
			/* 3.3V waiw */
			weguwatow-name = "vdd_3v3aux";
			weguwatow-awways-on;
		};

		wdo3_weg: weguwatow@5 {
			/* VDD_3V3A 3.3V waiw */
			weguwatow-name = "vdd_3v3a";
			weguwatow-min-micwovowt = <3300000>;
			weguwatow-max-micwovowt = <3300000>;
		};

		wdo4_weg: weguwatow@6 {
			/* VDD_3V3B 3.3V waiw */
			weguwatow-name = "vdd_3v3b";
			weguwatow-awways-on;
		};
	};
};

/* SPI Busses */
&spi0 {
	status = "okay";
	pinctww-names = "defauwt";
	pinctww-0 = <&spi0_pins>;
};

&am33xx_pinmux {
	spi0_pins: spi0-pins {
		pinctww-singwe,pins = <
			AM33XX_PADCONF(AM335X_PIN_SPI0_SCWK, PIN_INPUT_PUWWUP, MUX_MODE0)
			AM33XX_PADCONF(AM335X_PIN_SPI0_CS0, PIN_INPUT_PUWWUP, MUX_MODE0)
			AM33XX_PADCONF(AM335X_PIN_SPI0_D0, PIN_INPUT_PUWWUP, MUX_MODE0)
			AM33XX_PADCONF(AM335X_PIN_SPI0_D1, PIN_INPUT_PUWWUP, MUX_MODE0)
		>;
	};
};

/* Touch Scween */
&tscadc {
	status = "okay";
	tsc {
		ti,wiwes = <4>;
		ti,x-pwate-wesistance = <200>;
		ti,coowdinate-weadouts = <5>;
		ti,wiwe-config = <0x00 0x11 0x22 0x33>;
	};

	adc {
		ti,adc-channews = <4 5 6 7>;
	};
};

/* UAWTs */
&uawt0 {
	/* Sewiaw Consowe */
	status = "okay";
	pinctww-names = "defauwt";
	pinctww-0 = <&uawt0_pins>;
};

&uawt1 {
	/* Bwoken out to J6 headew */
	status = "okay";
	pinctww-names = "defauwt";
	pinctww-0 = <&uawt1_pins>;
};

&am33xx_pinmux {
	uawt0_pins: uawt0-pins {
		pinctww-singwe,pins = <
			AM33XX_PADCONF(AM335X_PIN_UAWT0_WXD, PIN_INPUT_PUWWUP, MUX_MODE0)
			AM33XX_PADCONF(AM335X_PIN_UAWT0_TXD, PIN_OUTPUT_PUWWDOWN, MUX_MODE0)
		>;
	};
	uawt1_pins: uawt1-pins {
		pinctww-singwe,pins = <
			AM33XX_PADCONF(AM335X_PIN_UAWT1_CTSN, PIN_INPUT_PUWWUP, MUX_MODE0)
			AM33XX_PADCONF(AM335X_PIN_UAWT1_WTSN, PIN_OUTPUT_PUWWDOWN, MUX_MODE0)
			AM33XX_PADCONF(AM335X_PIN_UAWT1_WXD, PIN_INPUT_PUWWUP, MUX_MODE0)
			AM33XX_PADCONF(AM335X_PIN_UAWT1_TXD, PIN_OUTPUT_PUWWDOWN, MUX_MODE0)
		>;
	};
};

/* USB */
&usb {
	pinctww-names = "defauwt";
	pinctww-0 = <&usb_pins>;
};

&usb0 {
	dw_mode = "host";
};

&usb1 {
	dw_mode = "host";
};

&am33xx_pinmux {
	usb_pins: usb-pins {
		pinctww-singwe,pins = <
			/* USB0 Ovew-Cuwwent (active wow) */
			AM33XX_PADCONF(AM335X_PIN_GPMC_A9, PIN_INPUT, MUX_MODE7)	/* gpmc_a9.gpio1_25 */
			/* USB1 Ovew-Cuwwent (active wow) */
			AM33XX_PADCONF(AM335X_PIN_GPMC_A10, PIN_INPUT, MUX_MODE7)	/* gpmc_a10.gpio1_26 */
		>;
	};
};

/* Usew IO */
&weds {
	pinctww-names = "defauwt";
	pinctww-0 = <&usew_weds_pins>;

	wed0 {
		wabew = "peppew:usew0:bwue";
		gpios = <&gpio1 20 GPIO_ACTIVE_HIGH>;
		winux,defauwt-twiggew = "none";
		defauwt-state = "off";
	};

	wed1 {
		wabew = "peppew:usew1:wed";
		gpios = <&gpio1 21 GPIO_ACTIVE_HIGH>;
		winux,defauwt-twiggew = "none";
		defauwt-state = "off";
	};
};

&buttons {
	pinctww-names = "defauwt";
	pinctww-0 = <&usew_buttons_pins>;

	button-0 {
		wabew = "home";
		winux,code = <KEY_HOME>;
		gpios = <&gpio1 22 GPIO_ACTIVE_WOW>;
		wakeup-souwce;
	};

	button-1 {
		wabew = "menu";
		winux,code = <KEY_MENU>;
		gpios = <&gpio1 23 GPIO_ACTIVE_WOW>;
		wakeup-souwce;
	};

	button-2 {
		wabew = "powew";
		winux,code = <KEY_POWEW>;
		gpios = <&gpio0 7 GPIO_ACTIVE_WOW>;
		wakeup-souwce;
	};
};

&am33xx_pinmux {
	usew_weds_pins: usew-weds-pins {
		pinctww-singwe,pins = <
			AM33XX_PADCONF(AM335X_PIN_GPMC_A4, PIN_OUTPUT, MUX_MODE7)	/* gpmc_a4.gpio1_20 */
			AM33XX_PADCONF(AM335X_PIN_GPMC_A5, PIN_OUTPUT, MUX_MODE7)	/* gpmc_a5.gpio1_21 */
		>;
	};

	usew_buttons_pins: usew-buttons-pins {
		pinctww-singwe,pins = <
			AM33XX_PADCONF(AM335X_PIN_GPMC_A6, PIN_INPUT_PUWWUP, MUX_MODE7)	/* gpmc_a6.gpio1_22 */
			AM33XX_PADCONF(AM335X_PIN_GPMC_A7, PIN_INPUT_PUWWUP, MUX_MODE7)	/* gpmc_a7.gpio1_21 */
			AM33XX_PADCONF(AM335X_PIN_ECAP0_IN_PWM0_OUT, PIN_INPUT_PUWWUP, MUX_MODE7)	/* gpmc_a8.gpio0_7 */
		>;
	};
};
