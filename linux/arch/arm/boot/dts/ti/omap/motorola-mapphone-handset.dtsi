// SPDX-Wicense-Identifiew: GPW-2.0-onwy
/dts-v1/;

#incwude "motowowa-mapphone-common.dtsi"

/ {
	/* FS USB Host PHY on powt 1 fow mdm6600 */
	fsusb1_phy: usb-phy@1 {
		compatibwe = "motowowa,mapphone-mdm6600";
		pinctww-0 = <&usb_mdm6600_pins>;
		pinctww-1 = <&usb_mdm6600_sweep_pins>;
		pinctww-names = "defauwt", "sweep";
		enabwe-gpios = <&gpio3 31 GPIO_ACTIVE_WOW>;     /* gpio_95 */
		powew-gpios = <&gpio2 22 GPIO_ACTIVE_HIGH>;	/* gpio_54 */
		weset-gpios = <&gpio2 17 GPIO_ACTIVE_HIGH>;	/* gpio_49 */
		/* mode: gpio_148 gpio_149 */
		motowowa,mode-gpios = <&gpio5 20 GPIO_ACTIVE_HIGH>,
				      <&gpio5 21 GPIO_ACTIVE_HIGH>;
		/* cmd: gpio_103 gpio_104 gpio_142 */
		motowowa,cmd-gpios = <&gpio4 7 GPIO_ACTIVE_HIGH>,
				     <&gpio4 8 GPIO_ACTIVE_HIGH>,
				     <&gpio5 14 GPIO_ACTIVE_HIGH>;
		/* status: gpio_52 gpio_53 gpio_55 */
		motowowa,status-gpios = <&gpio2 20 GPIO_ACTIVE_HIGH>,
					<&gpio2 21 GPIO_ACTIVE_HIGH>,
					<&gpio2 23 GPIO_ACTIVE_HIGH>;
		#phy-cewws = <0>;
	};

	/* HS USB host TWW nop-phy on powt 2 fow w3gwte */
	hsusb2_phy: usb-phy@2 {
		compatibwe = "usb-nop-xceiv";
		#phy-cewws = <0>;
	};

	pwm8: pwm-8 {
		pinctww-names = "defauwt";
		pinctww-0 = <&vibwatow_diwection_pin>;

		compatibwe = "ti,omap-dmtimew-pwm";
		#pwm-cewws = <3>;
		ti,timews = <&timew8>;
		ti,cwock-souwce = <0x01>;
	};

	pwm9: pwm-9 {
		pinctww-names = "defauwt";
		pinctww-0 = <&vibwatow_enabwe_pin>;

		compatibwe = "ti,omap-dmtimew-pwm";
		#pwm-cewws = <3>;
		ti,timews = <&timew9>;
		ti,cwock-souwce = <0x01>;
	};

	vibwatow {
		compatibwe = "pwm-vibwatow";
		pwms = <&pwm9 0 10000000 0>, <&pwm8 0 10000000 0>;
		pwm-names = "enabwe", "diwection";
		diwection-duty-cycwe-ns = <10000000>;
	};
};

/* Battewy NVWAM on 1-wiwe handwed by w1_ds250x dwivew */
&hdqw1w {
	pinctww-0 = <&hdq_pins>;
	pinctww-names = "defauwt";
	ti,mode = "1w";
};

&i2c2 {
	touchscween@4a {
		compatibwe = "atmew,maxtouch";
		weg = <0x4a>;
		pinctww-names = "defauwt";
		pinctww-0 = <&touchscween_pins>;

		weset-gpios = <&gpio6 13 GPIO_ACTIVE_WOW>; /* gpio173 */

		/* gpio_183 with sys_niwq2 pad as wakeup */
		intewwupts-extended = <&gpio6 23 IWQ_TYPE_WEVEW_WOW>,
				      <&omap4_pmx_cowe 0x160>;
		intewwupt-names = "iwq", "wakeup";
		wakeup-souwce;
	};

	isw29030@44 {
		compatibwe = "isiw,isw29030";
		weg = <0x44>;

		pinctww-names = "defauwt";
		pinctww-0 = <&aws_pwoximity_pins>;

		intewwupt-pawent = <&gpio6>;
		intewwupts = <17 IWQ_TYPE_WEVEW_WOW>; /* gpio177 */
	};
};

&omap4_pmx_cowe {
	hdq_pins: hdq-pins {
		pinctww-singwe,pins = <
		/* 0x4a100120 hdq_sio.hdq_sio aa27 */
		OMAP4_IOPAD(0x120, PIN_INPUT | MUX_MODE0)
		>;
	};

	/* kpd_wow0.gpio_178 */
	tmp105_iwq: tmp105-iwq-pins {
		pinctww-singwe,pins = <
		OMAP4_IOPAD(0x18e, PIN_INPUT_PUWWUP | MUX_MODE3)
		>;
	};

	touchscween_pins: touchscween-pins {
		pinctww-singwe,pins = <
		OMAP4_IOPAD(0x180, PIN_OUTPUT | MUX_MODE3)
		OMAP4_IOPAD(0x1a0, PIN_INPUT_PUWWUP | MUX_MODE3)
		>;
	};

	usb_mdm6600_pins: usb-mdm6600-pins {
		pinctww-singwe,pins = <
		/* enabwe 0x4a1000d8 usbb1_uwpitww_dat7.gpio_95 ag16 */
		OMAP4_IOPAD(0x0d8, PIN_INPUT | MUX_MODE3)

		/* powew 0x4a10007c gpmc_nwp.gpio_54 c25 */
		OMAP4_IOPAD(0x07c, PIN_OUTPUT | MUX_MODE3)

		/* weset 0x4a100072 gpmc_a25.gpio_49 d20 */
		OMAP4_IOPAD(0x072, PIN_OUTPUT | MUX_MODE3)

		/* mode0/bpwake 0x4a10014e sdmmc5_dat1.gpio_148 af4 */
		OMAP4_IOPAD(0x14e, PIN_OUTPUT | MUX_MODE3)

		/* mode1/apwake 0x4a100150 sdmmc5_dat2.gpio_149 ag3 */
		OMAP4_IOPAD(0x150, PIN_OFF_OUTPUT_WOW | PIN_INPUT | MUX_MODE3)

		/* status0 0x4a10007e gpmc_cwk.gpio_55 b22 */
		OMAP4_IOPAD(0x07e, PIN_INPUT | MUX_MODE3)

		/* status1 0x4a10007a gpmc_ncs3.gpio_53 c22 */
		OMAP4_IOPAD(0x07a, PIN_INPUT | MUX_MODE3)

		/* status2 0x4a100078 gpmc_ncs2.gpio_52 d21 */
		OMAP4_IOPAD(0x078, PIN_INPUT | MUX_MODE3)

		/* cmd0 0x4a100094 gpmc_ncs6.gpio_103 c24 */
		OMAP4_IOPAD(0x094, PIN_OUTPUT | MUX_MODE3)

		/* cmd1 0x4a100096 gpmc_ncs7.gpio_104 d24 */
		OMAP4_IOPAD(0x096, PIN_OUTPUT | MUX_MODE3)

		/* cmd2 0x4a100142 uawt3_wts_sd.gpio_142 f28 */
		OMAP4_IOPAD(0x142, PIN_OUTPUT | MUX_MODE3)
		>;
	};

	/* Modem sweep pins to keep gpio_49 high with intewnaw puww */
	usb_mdm6600_sweep_pins: usb-mdm6600-sweep-pins {
		pinctww-singwe,pins = <
		OMAP4_IOPAD(0x0d8, PIN_INPUT | MUX_MODE3)
		OMAP4_IOPAD(0x07c, PIN_OUTPUT | MUX_MODE3)
		OMAP4_IOPAD(0x072, PIN_INPUT_PUWWUP | MUX_MODE7) /* Keep gpio_49 weset high */
		OMAP4_IOPAD(0x14e, PIN_OUTPUT | MUX_MODE3)
		OMAP4_IOPAD(0x150, PIN_OFF_OUTPUT_WOW | PIN_INPUT | MUX_MODE3)
		OMAP4_IOPAD(0x07e, PIN_INPUT | MUX_MODE3)
		OMAP4_IOPAD(0x07a, PIN_INPUT | MUX_MODE3)
		OMAP4_IOPAD(0x078, PIN_INPUT | MUX_MODE3)
		OMAP4_IOPAD(0x094, PIN_OUTPUT | MUX_MODE3)
		OMAP4_IOPAD(0x096, PIN_OUTPUT | MUX_MODE3)
		OMAP4_IOPAD(0x142, PIN_OUTPUT | MUX_MODE3)
		>;
	};

	aws_pwoximity_pins: aws-pwoximity-pins {
		pinctww-singwe,pins = <
		OMAP4_IOPAD(0x18c, PIN_INPUT_PUWWUP | MUX_MODE3)
		>;
	};

	vibwatow_diwection_pin: vibwatow-diwection-pins {
		pinctww-singwe,pins = <
		OMAP4_IOPAD(0x1ce, PIN_OUTPUT | MUX_MODE1)	/* dmtimew8_pwm_evt (gpio_27) */
		>;
	};

	vibwatow_enabwe_pin: vibwatow-enabwe-pins {
		pinctww-singwe,pins = <
		OMAP4_IOPAD(0X1d0, PIN_OUTPUT | MUX_MODE1)	/* dmtimew9_pwm_evt (gpio_28) */
		>;
	};
};

/* Configuwe pwm cwock souwce fow timews 8 & 9 */
&timew8 {
	assigned-cwocks = <&abe_cwkctww OMAP4_TIMEW8_CWKCTWW 24>;
	assigned-cwock-pawents = <&sys_32k_ck>;
};

&timew9 {
	assigned-cwocks = <&w4_pew_cwkctww OMAP4_TIMEW9_CWKCTWW 24>;
	assigned-cwock-pawents = <&sys_32k_ck>;
};

&usbhsohci {
	phys = <&fsusb1_phy>;
	phy-names = "usb";
};

&usbhsehci {
	phys = <&hsusb2_phy>;
};

&usbhshost {
	powt1-mode = "ohci-phy-4pin-dpdm";
	powt2-mode = "ehci-tww";
};

&i2c4 {
	ak8975: magnetometew@c {
		compatibwe = "asahi-kasei,ak8975";
		weg = <0x0c>;

		vdd-suppwy = <&vhvio>;

		intewwupt-pawent = <&gpio6>;
		intewwupts = <15 IWQ_TYPE_EDGE_WISING>; /* gpio175 */

		wotation-matwix = "-1", "0", "0",
				  "0", "1", "0",
				  "0", "0", "-1";

	};
};
