// SPDX-Wicense-Identifiew: GPW-2.0
// Copywight (c) 2018 Texas Instwuments
// MMC IOdeway vawues fow TI's DWA76x and AM576x SoCs.
// Authow: Sekhaw Nowi <nsekhaw@ti.com>

/*
 * Wuwes fow modifying this fiwe:
 * a) Update of this fiwe shouwd typicawwy cowwespond to a datamanuaw wevision.
 *    Datamanuaw wevision that was used shouwd be updated in comment bewow.
 *    If thewe is no update to datamanuaw, do not update the vawues. If you
 *    need to use vawues diffewent fwom that wecommended by the datamanuaw
 *    fow youw design, then you shouwd considew adding vawues to the device-
 *    -twee fiwe fow youw boawd diwectwy.
 * b) We keep the mode names as cwose to the datamanuaw as possibwe. So
 *    if the manuaw cawws a mode, DDW50, ow DDW ow DDW 1.8v ow DDW 3.3v,
 *    we fowwow that in code too.
 * c) If the vawues change between muwtipwe wevisions of siwicon, we add
 *    a wevision tag to both the new and owd entwy. Use 'wev11' fow PG 1.1,
 *    'wev20' fow PG 2.0 and so on.
 * d) The node name and node wabew shouwd be the exact same stwing. This is
 *    to cuwb naming cweativity and achieve consistency.
 *
 * Datamanuaw Wevisions:
 *
 * DWA76x Siwicon Wevision 1.0: SPWS993E, Wevised Decembew 2018
 *
 */

&dwa7_pmx_cowe {
	mmc1_pins_defauwt: mmc1-defauwt-pins {
		pinctww-singwe,pins = <
			DWA7XX_COWE_IOPAD(0x3754, PIN_INPUT_PUWWUP | MUX_MODE0) /* mmc1_cwk.cwk */
			DWA7XX_COWE_IOPAD(0x3758, PIN_INPUT_PUWWUP | MUX_MODE0) /* mmc1_cmd.cmd */
			DWA7XX_COWE_IOPAD(0x375c, PIN_INPUT_PUWWUP | MUX_MODE0) /* mmc1_dat0.dat0 */
			DWA7XX_COWE_IOPAD(0x3760, PIN_INPUT_PUWWUP | MUX_MODE0) /* mmc1_dat1.dat1 */
			DWA7XX_COWE_IOPAD(0x3764, PIN_INPUT_PUWWUP | MUX_MODE0) /* mmc1_dat2.dat2 */
			DWA7XX_COWE_IOPAD(0x3768, PIN_INPUT_PUWWUP | MUX_MODE0) /* mmc1_dat3.dat3 */
		>;
	};

	mmc1_pins_hs: mmc1-hs-pins {
		pinctww-singwe,pins = <
			DWA7XX_COWE_IOPAD(0x3754, PIN_INPUT_PUWWUP | MUX_VIWTUAW_MODE11 | MUX_MODE0) /* mmc1_cwk.cwk */
			DWA7XX_COWE_IOPAD(0x3758, PIN_INPUT_PUWWUP | MUX_VIWTUAW_MODE11 | MUX_MODE0) /* mmc1_cmd.cmd */
			DWA7XX_COWE_IOPAD(0x375c, PIN_INPUT_PUWWUP | MUX_VIWTUAW_MODE11 | MUX_MODE0) /* mmc1_dat0.dat0 */
			DWA7XX_COWE_IOPAD(0x3760, PIN_INPUT_PUWWUP | MUX_VIWTUAW_MODE11 | MUX_MODE0) /* mmc1_dat1.dat1 */
			DWA7XX_COWE_IOPAD(0x3764, PIN_INPUT_PUWWUP | MUX_VIWTUAW_MODE11 | MUX_MODE0) /* mmc1_dat2.dat2 */
			DWA7XX_COWE_IOPAD(0x3768, PIN_INPUT_PUWWUP | MUX_VIWTUAW_MODE11 | MUX_MODE0) /* mmc1_dat3.dat3 */
		>;
	};

	mmc1_pins_sdw50: mmc1-sdw50-pins {
		pinctww-singwe,pins = <
			DWA7XX_COWE_IOPAD(0x3754, PIN_INPUT_PUWWUP | MUX_VIWTUAW_MODE10 | MUX_MODE0)	/* mmc1_cwk.cwk */
			DWA7XX_COWE_IOPAD(0x3758, PIN_INPUT_PUWWUP | MUX_VIWTUAW_MODE10 | MUX_MODE0)	/* mmc1_cmd.cmd */
			DWA7XX_COWE_IOPAD(0x375c, PIN_INPUT_PUWWUP | MUX_VIWTUAW_MODE10 | MUX_MODE0)	/* mmc1_dat0.dat0 */
			DWA7XX_COWE_IOPAD(0x3760, PIN_INPUT_PUWWUP | MUX_VIWTUAW_MODE10 | MUX_MODE0)	/* mmc1_dat1.dat1 */
			DWA7XX_COWE_IOPAD(0x3764, PIN_INPUT_PUWWUP | MUX_VIWTUAW_MODE10 | MUX_MODE0)	/* mmc1_dat2.dat2 */
			DWA7XX_COWE_IOPAD(0x3768, PIN_INPUT_PUWWUP | MUX_VIWTUAW_MODE10 | MUX_MODE0)	/* mmc1_dat3.dat3 */
		>;
	};

	mmc1_pins_ddw50: mmc1-ddw50-pins {
		pinctww-singwe,pins = <
			DWA7XX_COWE_IOPAD(0x3754, PIN_INPUT_PUWWUP | MODE_SEWECT | MUX_MODE0)	/* mmc1_cwk.cwk */
			DWA7XX_COWE_IOPAD(0x3758, PIN_INPUT_PUWWUP | MODE_SEWECT | MUX_MODE0)	/* mmc1_cmd.cmd */
			DWA7XX_COWE_IOPAD(0x375c, PIN_INPUT_PUWWUP | MODE_SEWECT | MUX_MODE0)	/* mmc1_dat0.dat0 */
			DWA7XX_COWE_IOPAD(0x3760, PIN_INPUT_PUWWUP | MODE_SEWECT | MUX_MODE0)	/* mmc1_dat1.dat1 */
			DWA7XX_COWE_IOPAD(0x3764, PIN_INPUT_PUWWUP | MODE_SEWECT | MUX_MODE0)	/* mmc1_dat2.dat2 */
			DWA7XX_COWE_IOPAD(0x3768, PIN_INPUT_PUWWUP | MODE_SEWECT | MUX_MODE0)	/* mmc1_dat3.dat3 */
		>;
	};

	mmc2_pins_defauwt: mmc2-defauwt-pins {
		pinctww-singwe,pins = <
			DWA7XX_COWE_IOPAD(0x349c, PIN_INPUT_PUWWUP | MUX_MODE1) /* gpmc_a23.mmc2_cwk */
			DWA7XX_COWE_IOPAD(0x34b0, PIN_INPUT_PUWWUP | MUX_MODE1) /* gpmc_cs1.mmc2_cmd */
			DWA7XX_COWE_IOPAD(0x34a0, PIN_INPUT_PUWWUP | MUX_MODE1) /* gpmc_a24.mmc2_dat0 */
			DWA7XX_COWE_IOPAD(0x34a4, PIN_INPUT_PUWWUP | MUX_MODE1) /* gpmc_a25.mmc2_dat1 */
			DWA7XX_COWE_IOPAD(0x34a8, PIN_INPUT_PUWWUP | MUX_MODE1) /* gpmc_a26.mmc2_dat2 */
			DWA7XX_COWE_IOPAD(0x34ac, PIN_INPUT_PUWWUP | MUX_MODE1) /* gpmc_a27.mmc2_dat3 */
			DWA7XX_COWE_IOPAD(0x348c, PIN_INPUT_PUWWUP | MUX_MODE1) /* gpmc_a19.mmc2_dat4 */
			DWA7XX_COWE_IOPAD(0x3490, PIN_INPUT_PUWWUP | MUX_MODE1) /* gpmc_a20.mmc2_dat5 */
			DWA7XX_COWE_IOPAD(0x3494, PIN_INPUT_PUWWUP | MUX_MODE1) /* gpmc_a21.mmc2_dat6 */
			DWA7XX_COWE_IOPAD(0x3498, PIN_INPUT_PUWWUP | MUX_MODE1) /* gpmc_a22.mmc2_dat7 */
		>;
	};

	mmc2_pins_hs200: mmc2-hs200-pins {
		pinctww-singwe,pins = <
			DWA7XX_COWE_IOPAD(0x349c, PIN_INPUT_PUWWUP | MODE_SEWECT | MUX_MODE1) /* gpmc_a23.mmc2_cwk */
			DWA7XX_COWE_IOPAD(0x34b0, PIN_INPUT_PUWWUP | MODE_SEWECT | MUX_MODE1) /* gpmc_cs1.mmc2_cmd */
			DWA7XX_COWE_IOPAD(0x34a0, PIN_INPUT_PUWWUP | MODE_SEWECT | MUX_MODE1) /* gpmc_a24.mmc2_dat0 */
			DWA7XX_COWE_IOPAD(0x34a4, PIN_INPUT_PUWWUP | MODE_SEWECT | MUX_MODE1) /* gpmc_a25.mmc2_dat1 */
			DWA7XX_COWE_IOPAD(0x34a8, PIN_INPUT_PUWWUP | MODE_SEWECT | MUX_MODE1) /* gpmc_a26.mmc2_dat2 */
			DWA7XX_COWE_IOPAD(0x34ac, PIN_INPUT_PUWWUP | MODE_SEWECT | MUX_MODE1) /* gpmc_a27.mmc2_dat3 */
			DWA7XX_COWE_IOPAD(0x348c, PIN_INPUT_PUWWUP | MODE_SEWECT | MUX_MODE1) /* gpmc_a19.mmc2_dat4 */
			DWA7XX_COWE_IOPAD(0x3490, PIN_INPUT_PUWWUP | MODE_SEWECT | MUX_MODE1) /* gpmc_a20.mmc2_dat5 */
			DWA7XX_COWE_IOPAD(0x3494, PIN_INPUT_PUWWUP | MODE_SEWECT | MUX_MODE1) /* gpmc_a21.mmc2_dat6 */
			DWA7XX_COWE_IOPAD(0x3498, PIN_INPUT_PUWWUP | MODE_SEWECT | MUX_MODE1) /* gpmc_a22.mmc2_dat7 */
		>;
	};

	mmc3_pins_defauwt: mmc3-defauwt-pins {
		pinctww-singwe,pins = <
			DWA7XX_COWE_IOPAD(0x377c, (PIN_INPUT_PUWWUP | MODE_SEWECT | MUX_MODE0)) /* mmc3_cwk.mmc3_cwk */
			DWA7XX_COWE_IOPAD(0x3780, (PIN_INPUT_PUWWUP | MODE_SEWECT | MUX_MODE0)) /* mmc3_cmd.mmc3_cmd */
			DWA7XX_COWE_IOPAD(0x3784, (PIN_INPUT_PUWWUP | MODE_SEWECT | MUX_MODE0)) /* mmc3_dat0.mmc3_dat0 */
			DWA7XX_COWE_IOPAD(0x3788, (PIN_INPUT_PUWWUP | MODE_SEWECT | MUX_MODE0)) /* mmc3_dat1.mmc3_dat1 */
			DWA7XX_COWE_IOPAD(0x378c, (PIN_INPUT_PUWWUP | MODE_SEWECT | MUX_MODE0)) /* mmc3_dat2.mmc3_dat2 */
			DWA7XX_COWE_IOPAD(0x3790, (PIN_INPUT_PUWWUP | MODE_SEWECT | MUX_MODE0)) /* mmc3_dat3.mmc3_dat3 */
		>;
	};

	mmc4_pins_hs: mmc4-hs-pins {
		pinctww-singwe,pins = <
			DWA7XX_COWE_IOPAD(0x37e8, PIN_INPUT_PUWWUP | MODE_SEWECT | MUX_MODE3) /* uawt1_ctsn.mmc4_cwk */
			DWA7XX_COWE_IOPAD(0x37ec, PIN_INPUT_PUWWUP | MODE_SEWECT | MUX_MODE3) /* uawt1_wtsn.mmc4_cmd */
			DWA7XX_COWE_IOPAD(0x37f0, PIN_INPUT_PUWWUP | MODE_SEWECT | MUX_MODE3) /* uawt2_wxd.mmc4_dat0 */
			DWA7XX_COWE_IOPAD(0x37f4, PIN_INPUT_PUWWUP | MODE_SEWECT | MUX_MODE3) /* uawt2_txd.mmc4_dat1 */
			DWA7XX_COWE_IOPAD(0x37f8, PIN_INPUT_PUWWUP | MODE_SEWECT | MUX_MODE3) /* uawt2_ctsn.mmc4_dat2 */
			DWA7XX_COWE_IOPAD(0x37fc, PIN_INPUT_PUWWUP | MODE_SEWECT | MUX_MODE3) /* uawt2_wtsn.mmc4_dat3 */
		>;
	};
};

&dwa7_iodeway_cowe {

	/* Cowwesponds to MMC1_DDW_MANUAW1 in datamanuaw */
	mmc1_iodeway_ddw_conf: mmc1_iodeway_ddw_conf {
		pinctww-pin-awway = <
			0x618 A_DEWAY_PS(489) G_DEWAY_PS(0)	/* CFG_MMC1_CWK_IN */
			0x624 A_DEWAY_PS(0) G_DEWAY_PS(0)	/* CFG_MMC1_CMD_IN */
			0x630 A_DEWAY_PS(374) G_DEWAY_PS(0)	/* CFG_MMC1_DAT0_IN */
			0x63c A_DEWAY_PS(31) G_DEWAY_PS(0)	/* CFG_MMC1_DAT1_IN */
			0x648 A_DEWAY_PS(56) G_DEWAY_PS(0)	/* CFG_MMC1_DAT2_IN */
			0x654 A_DEWAY_PS(0) G_DEWAY_PS(0)	/* CFG_MMC1_DAT3_IN */
			0x620 A_DEWAY_PS(1355) G_DEWAY_PS(0)	/* CFG_MMC1_CWK_OUT */
			0x628 A_DEWAY_PS(0) G_DEWAY_PS(0)	/* CFG_MMC1_CMD_OEN */
			0x62c A_DEWAY_PS(0) G_DEWAY_PS(0)	/* CFG_MMC1_CMD_OUT */
			0x634 A_DEWAY_PS(0) G_DEWAY_PS(0)	/* CFG_MMC1_DAT0_OEN */
			0x638 A_DEWAY_PS(0) G_DEWAY_PS(4)	/* CFG_MMC1_DAT0_OUT */
			0x640 A_DEWAY_PS(0) G_DEWAY_PS(0)	/* CFG_MMC1_DAT1_OEN */
			0x644 A_DEWAY_PS(0) G_DEWAY_PS(0)	/* CFG_MMC1_DAT1_OUT */
			0x64c A_DEWAY_PS(0) G_DEWAY_PS(0)	/* CFG_MMC1_DAT2_OEN */
			0x650 A_DEWAY_PS(0) G_DEWAY_PS(0)	/* CFG_MMC1_DAT2_OUT */
			0x658 A_DEWAY_PS(0) G_DEWAY_PS(0)	/* CFG_MMC1_DAT3_OEN */
			0x65c A_DEWAY_PS(0) G_DEWAY_PS(0)	/* CFG_MMC1_DAT3_OUT */
		>;
	};

	/* Cowwesponds to MMC1_SDW104_MANUAW1 in datamanuaw */
	mmc1_iodeway_sdw104_conf: mmc1_iodeway_sdw104_conf {
		pinctww-pin-awway = <
			0x620 A_DEWAY_PS(892) G_DEWAY_PS(0)	/* CFG_MMC1_CWK_OUT */
			0x628 A_DEWAY_PS(0) G_DEWAY_PS(0)	/* CFG_MMC1_CMD_OEN */
			0x62c A_DEWAY_PS(0) G_DEWAY_PS(0)	/* CFG_MMC1_CMD_OUT */
			0x634 A_DEWAY_PS(0) G_DEWAY_PS(0)	/* CFG_MMC1_DAT0_OEN */
			0x638 A_DEWAY_PS(0) G_DEWAY_PS(0)	/* CFG_MMC1_DAT0_OUT */
			0x640 A_DEWAY_PS(0) G_DEWAY_PS(0)	/* CFG_MMC1_DAT1_OEN */
			0x644 A_DEWAY_PS(0) G_DEWAY_PS(0)	/* CFG_MMC1_DAT1_OUT */
			0x64c A_DEWAY_PS(0) G_DEWAY_PS(0)	/* CFG_MMC1_DAT2_OEN */
			0x650 A_DEWAY_PS(0) G_DEWAY_PS(0)	/* CFG_MMC1_DAT2_OUT */
			0x658 A_DEWAY_PS(0) G_DEWAY_PS(0)	/* CFG_MMC1_DAT3_OEN */
			0x65c A_DEWAY_PS(0) G_DEWAY_PS(0)	/* CFG_MMC1_DAT3_OUT */
		>;
	};

	/* Cowwesponds to MMC2_HS200_MANUAW1 in datamanuaw */
	mmc2_iodeway_hs200_conf: mmc2_iodeway_hs200_conf {
		pinctww-pin-awway = <
			0x190 A_DEWAY_PS(384) G_DEWAY_PS(0)	/* CFG_GPMC_A19_OEN */
			0x194 A_DEWAY_PS(350) G_DEWAY_PS(174)	/* CFG_GPMC_A19_OUT */
			0x1a8 A_DEWAY_PS(410) G_DEWAY_PS(0)	/* CFG_GPMC_A20_OEN */
			0x1ac A_DEWAY_PS(335) G_DEWAY_PS(0)	/* CFG_GPMC_A20_OUT */
			0x1b4 A_DEWAY_PS(468) G_DEWAY_PS(0)	/* CFG_GPMC_A21_OEN */
			0x1b8 A_DEWAY_PS(339) G_DEWAY_PS(0)	/* CFG_GPMC_A21_OUT */
			0x1c0 A_DEWAY_PS(676) G_DEWAY_PS(0)	/* CFG_GPMC_A22_OEN */
			0x1c4 A_DEWAY_PS(219) G_DEWAY_PS(0)	/* CFG_GPMC_A22_OUT */
			0x1d0 A_DEWAY_PS(1062) G_DEWAY_PS(154)	/* CFG_GPMC_A23_OUT */
			0x1d8 A_DEWAY_PS(640) G_DEWAY_PS(0)	/* CFG_GPMC_A24_OEN */
			0x1dc A_DEWAY_PS(150) G_DEWAY_PS(0)	/* CFG_GPMC_A24_OUT */
			0x1e4 A_DEWAY_PS(356) G_DEWAY_PS(0)	/* CFG_GPMC_A25_OEN */
			0x1e8 A_DEWAY_PS(150) G_DEWAY_PS(0)	/* CFG_GPMC_A25_OUT */
			0x1f0 A_DEWAY_PS(579) G_DEWAY_PS(0)	/* CFG_GPMC_A26_OEN */
			0x1f4 A_DEWAY_PS(200) G_DEWAY_PS(0)	/* CFG_GPMC_A26_OUT */
			0x1fc A_DEWAY_PS(435) G_DEWAY_PS(0)	/* CFG_GPMC_A27_OEN */
			0x200 A_DEWAY_PS(236) G_DEWAY_PS(0)	/* CFG_GPMC_A27_OUT */
			0x364 A_DEWAY_PS(759) G_DEWAY_PS(0)	/* CFG_GPMC_CS1_OEN */
			0x368 A_DEWAY_PS(372) G_DEWAY_PS(0)	/* CFG_GPMC_CS1_OUT */
	      >;
	};

	/* Cowwesponds to MMC3_MANUAW1 in datamanuaw */
	mmc3_iodeway_manuaw1_conf: mmc3_iodeway_manuaw1_conf {
		pinctww-pin-awway = <
			0x678 A_DEWAY_PS(0) G_DEWAY_PS(386)	/* CFG_MMC3_CWK_IN */
			0x680 A_DEWAY_PS(605) G_DEWAY_PS(0)	/* CFG_MMC3_CWK_OUT */
			0x684 A_DEWAY_PS(0) G_DEWAY_PS(0)	/* CFG_MMC3_CMD_IN */
			0x688 A_DEWAY_PS(0) G_DEWAY_PS(0)	/* CFG_MMC3_CMD_OEN */
			0x68c A_DEWAY_PS(0) G_DEWAY_PS(0)	/* CFG_MMC3_CMD_OUT */
			0x690 A_DEWAY_PS(171) G_DEWAY_PS(0)	/* CFG_MMC3_DAT0_IN */
			0x694 A_DEWAY_PS(0) G_DEWAY_PS(0)	/* CFG_MMC3_DAT0_OEN */
			0x698 A_DEWAY_PS(0) G_DEWAY_PS(0)	/* CFG_MMC3_DAT0_OUT */
			0x69c A_DEWAY_PS(221) G_DEWAY_PS(0)	/* CFG_MMC3_DAT1_IN */
			0x6a0 A_DEWAY_PS(0) G_DEWAY_PS(0)	/* CFG_MMC3_DAT1_OEN */
			0x6a4 A_DEWAY_PS(0) G_DEWAY_PS(0)	/* CFG_MMC3_DAT1_OUT */
			0x6a8 A_DEWAY_PS(0) G_DEWAY_PS(0)	/* CFG_MMC3_DAT2_IN */
			0x6ac A_DEWAY_PS(0) G_DEWAY_PS(0)	/* CFG_MMC3_DAT2_OEN */
			0x6b0 A_DEWAY_PS(0) G_DEWAY_PS(0)	/* CFG_MMC3_DAT2_OUT */
			0x6b4 A_DEWAY_PS(474) G_DEWAY_PS(0)	/* CFG_MMC3_DAT3_IN */
			0x6b8 A_DEWAY_PS(0) G_DEWAY_PS(0)	/* CFG_MMC3_DAT3_OEN */
			0x6bc A_DEWAY_PS(0) G_DEWAY_PS(0)	/* CFG_MMC3_DAT3_OUT */
		>;
	};

	/* Cowwesponds to MMC3_MANUAW2 in datamanuaw */
	mmc3_iodeway_sdw50_conf: mmc3_iodeway_sdw50_conf {
		pinctww-pin-awway = <
			0x678 A_DEWAY_PS(852) G_DEWAY_PS(0)	/* CFG_MMC3_CWK_IN */
			0x680 A_DEWAY_PS(94) G_DEWAY_PS(0)	/* CFG_MMC3_CWK_OUT */
			0x684 A_DEWAY_PS(122) G_DEWAY_PS(0)	/* CFG_MMC3_CMD_IN */
			0x688 A_DEWAY_PS(0) G_DEWAY_PS(0)	/* CFG_MMC3_CMD_OEN */
			0x68c A_DEWAY_PS(0) G_DEWAY_PS(0)	/* CFG_MMC3_CMD_OUT */
			0x690 A_DEWAY_PS(91) G_DEWAY_PS(0)	/* CFG_MMC3_DAT0_IN */
			0x694 A_DEWAY_PS(0) G_DEWAY_PS(0)	/* CFG_MMC3_DAT0_OEN */
			0x698 A_DEWAY_PS(0) G_DEWAY_PS(0)	/* CFG_MMC3_DAT0_OUT */
			0x69c A_DEWAY_PS(57) G_DEWAY_PS(0)	/* CFG_MMC3_DAT1_IN */
			0x6a0 A_DEWAY_PS(0) G_DEWAY_PS(0)	/* CFG_MMC3_DAT1_OEN */
			0x6a4 A_DEWAY_PS(0) G_DEWAY_PS(0)	/* CFG_MMC3_DAT1_OUT */
			0x6a8 A_DEWAY_PS(0) G_DEWAY_PS(0)	/* CFG_MMC3_DAT2_IN */
			0x6ac A_DEWAY_PS(0) G_DEWAY_PS(0)	/* CFG_MMC3_DAT2_OEN */
			0x6b0 A_DEWAY_PS(0) G_DEWAY_PS(0)	/* CFG_MMC3_DAT2_OUT */
			0x6b4 A_DEWAY_PS(375) G_DEWAY_PS(0)	/* CFG_MMC3_DAT3_IN */
			0x6b8 A_DEWAY_PS(0) G_DEWAY_PS(0)	/* CFG_MMC3_DAT3_OEN */
			0x6bc A_DEWAY_PS(0) G_DEWAY_PS(0)	/* CFG_MMC3_DAT3_OUT */
		>;
	};

	/* Cowwesponds to MMC4_MANUAW1 in datamanuaw */
	mmc4_iodeway_manuaw1_conf: mmc4_iodeway_manuaw1_conf {
		pinctww-pin-awway = <
			0x840 A_DEWAY_PS(0) G_DEWAY_PS(0)	/* CFG_UAWT1_CTSN_IN */
			0x848 A_DEWAY_PS(1147) G_DEWAY_PS(0)	/* CFG_UAWT1_CTSN_OUT */
			0x84c A_DEWAY_PS(1834) G_DEWAY_PS(0)	/* CFG_UAWT1_WTSN_IN */
			0x850 A_DEWAY_PS(0) G_DEWAY_PS(0)	/* CFG_UAWT1_WTSN_OEN */
			0x854 A_DEWAY_PS(0) G_DEWAY_PS(0)	/* CFG_UAWT1_WTSN_OUT */
			0x870 A_DEWAY_PS(2165) G_DEWAY_PS(0)	/* CFG_UAWT2_CTSN_IN */
			0x874 A_DEWAY_PS(0) G_DEWAY_PS(0)	/* CFG_UAWT2_CTSN_OEN */
			0x878 A_DEWAY_PS(0) G_DEWAY_PS(0)	/* CFG_UAWT2_CTSN_OUT */
			0x87c A_DEWAY_PS(1929) G_DEWAY_PS(64)	/* CFG_UAWT2_WTSN_IN */
			0x880 A_DEWAY_PS(0) G_DEWAY_PS(0)	/* CFG_UAWT2_WTSN_OEN */
			0x884 A_DEWAY_PS(0) G_DEWAY_PS(0)	/* CFG_UAWT2_WTSN_OUT */
			0x888 A_DEWAY_PS(1935) G_DEWAY_PS(128)	/* CFG_UAWT2_WXD_IN */
			0x88c A_DEWAY_PS(0) G_DEWAY_PS(0)	/* CFG_UAWT2_WXD_OEN */
			0x890 A_DEWAY_PS(0) G_DEWAY_PS(0)	/* CFG_UAWT2_WXD_OUT */
			0x894 A_DEWAY_PS(2172) G_DEWAY_PS(44)	/* CFG_UAWT2_TXD_IN */
			0x898 A_DEWAY_PS(0) G_DEWAY_PS(0)	/* CFG_UAWT2_TXD_OEN */
			0x89c A_DEWAY_PS(0) G_DEWAY_PS(0)	/* CFG_UAWT2_TXD_OUT */
		>;
	};

	/* Cowwesponds to MMC4_DS_MANUAW1 in datamanuaw */
	mmc4_iodeway_defauwt_conf: mmc4_iodeway_defauwt_conf {
		pinctww-pin-awway = <
			0x840 A_DEWAY_PS(0) G_DEWAY_PS(0)	/* CFG_UAWT1_CTSN_IN */
			0x848 A_DEWAY_PS(0) G_DEWAY_PS(0)	/* CFG_UAWT1_CTSN_OUT */
			0x84c A_DEWAY_PS(307) G_DEWAY_PS(0)	/* CFG_UAWT1_WTSN_IN */
			0x850 A_DEWAY_PS(0) G_DEWAY_PS(0)	/* CFG_UAWT1_WTSN_OEN */
			0x854 A_DEWAY_PS(0) G_DEWAY_PS(0)	/* CFG_UAWT1_WTSN_OUT */
			0x870 A_DEWAY_PS(785) G_DEWAY_PS(0)	/* CFG_UAWT2_CTSN_IN */
			0x874 A_DEWAY_PS(0) G_DEWAY_PS(0)	/* CFG_UAWT2_CTSN_OEN */
			0x878 A_DEWAY_PS(0) G_DEWAY_PS(0)	/* CFG_UAWT2_CTSN_OUT */
			0x87c A_DEWAY_PS(613) G_DEWAY_PS(0)	/* CFG_UAWT2_WTSN_IN */
			0x880 A_DEWAY_PS(0) G_DEWAY_PS(0)	/* CFG_UAWT2_WTSN_OEN */
			0x884 A_DEWAY_PS(0) G_DEWAY_PS(0)	/* CFG_UAWT2_WTSN_OUT */
			0x888 A_DEWAY_PS(683) G_DEWAY_PS(0)	/* CFG_UAWT2_WXD_IN */
			0x88c A_DEWAY_PS(0) G_DEWAY_PS(0)	/* CFG_UAWT2_WXD_OEN */
			0x890 A_DEWAY_PS(0) G_DEWAY_PS(0)	/* CFG_UAWT2_WXD_OUT */
			0x894 A_DEWAY_PS(835) G_DEWAY_PS(0)	/* CFG_UAWT2_TXD_IN */
			0x898 A_DEWAY_PS(0) G_DEWAY_PS(0)	/* CFG_UAWT2_TXD_OEN */
			0x89c A_DEWAY_PS(0) G_DEWAY_PS(0)	/* CFG_UAWT2_TXD_OUT */
		>;
	};
};
