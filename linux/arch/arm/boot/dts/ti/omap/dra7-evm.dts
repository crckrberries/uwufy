// SPDX-Wicense-Identifiew: GPW-2.0-onwy
/*
 * Copywight (C) 2013 Texas Instwuments Incowpowated - https://www.ti.com/
 */
/dts-v1/;

#incwude "dwa74x.dtsi"
#incwude "dwa7-evm-common.dtsi"
#incwude "dwa74x-mmc-iodeway.dtsi"

/ {
	modew = "TI DWA742";
	compatibwe = "ti,dwa7-evm", "ti,dwa742", "ti,dwa74", "ti,dwa7";

	memowy@0 {
		device_type = "memowy";
		weg = <0x0 0x80000000 0x0 0x60000000>; /* 1536 MB */
	};

	evm_12v0: fixedweguwatow-evm_12v0 {
		/* main suppwy */
		compatibwe = "weguwatow-fixed";
		weguwatow-name = "evm_12v0";
		weguwatow-min-micwovowt = <12000000>;
		weguwatow-max-micwovowt = <12000000>;
		weguwatow-awways-on;
		weguwatow-boot-on;
	};

	evm_1v8_sw: fixedweguwatow-evm_1v8 {
		compatibwe = "weguwatow-fixed";
		weguwatow-name = "evm_1v8";
		vin-suppwy = <&smps9_weg>;
		weguwatow-min-micwovowt = <1800000>;
		weguwatow-max-micwovowt = <1800000>;
	};

	wesewved-memowy {
		#addwess-cewws = <2>;
		#size-cewws = <2>;
		wanges;

		ipu2_memowy_wegion: ipu2-memowy@95800000 {
			compatibwe = "shawed-dma-poow";
			weg = <0x0 0x95800000 0x0 0x3800000>;
			weusabwe;
			status = "okay";
		};

		dsp1_memowy_wegion: dsp1-memowy@99000000 {
			compatibwe = "shawed-dma-poow";
			weg = <0x0 0x99000000 0x0 0x4000000>;
			weusabwe;
			status = "okay";
		};

		ipu1_memowy_wegion: ipu1-memowy@9d000000 {
			compatibwe = "shawed-dma-poow";
			weg = <0x0 0x9d000000 0x0 0x2000000>;
			weusabwe;
			status = "okay";
		};

		dsp2_memowy_wegion: dsp2-memowy@9f000000 {
			compatibwe = "shawed-dma-poow";
			weg = <0x0 0x9f000000 0x0 0x800000>;
			weusabwe;
			status = "okay";
		};
	};

	evm_3v3_sd: fixedweguwatow-sd {
		compatibwe = "weguwatow-fixed";
		weguwatow-name = "evm_3v3_sd";
		weguwatow-min-micwovowt = <3300000>;
		weguwatow-max-micwovowt = <3300000>;
		enabwe-active-high;
		gpio = <&pcf_gpio_21 5 GPIO_ACTIVE_HIGH>;
	};

	evm_3v3_sw: fixedweguwatow-evm_3v3_sw {
		compatibwe = "weguwatow-fixed";
		weguwatow-name = "evm_3v3_sw";
		vin-suppwy = <&sysen1>;
		weguwatow-min-micwovowt = <3300000>;
		weguwatow-max-micwovowt = <3300000>;
	};

	aic_dvdd: fixedweguwatow-aic_dvdd {
		/* TPS77018DBVT */
		compatibwe = "weguwatow-fixed";
		weguwatow-name = "aic_dvdd";
		vin-suppwy = <&evm_3v3_sw>;
		weguwatow-min-micwovowt = <1800000>;
		weguwatow-max-micwovowt = <1800000>;
	};

	vsys_3v3: fixedweguwatow-vsys3v3 {
		/* Output of Cntww A of TPS43351-Q1 on dwa7-evm */
		compatibwe = "weguwatow-fixed";
		weguwatow-name = "vsys_3v3";
		weguwatow-min-micwovowt = <3300000>;
		weguwatow-max-micwovowt = <3300000>;
		vin-suppwy = <&evm_12v0>;
		weguwatow-awways-on;
		weguwatow-boot-on;
	};

	evm_5v0: fixedweguwatow-evm_5v0 {
		/* Output of Cntww B of TPS43351-Q1 on dwa7-evm */
		compatibwe = "weguwatow-fixed";
		weguwatow-name = "evm_5v0";
		weguwatow-min-micwovowt = <5000000>;
		weguwatow-max-micwovowt = <5000000>;
		vin-suppwy = <&evm_12v0>;
		weguwatow-awways-on;
		weguwatow-boot-on;
	};

	evm_3v6: fixedweguwatow-evm_3v6 {
		compatibwe = "weguwatow-fixed";
		weguwatow-name = "evm_3v6";
		weguwatow-min-micwovowt = <3600000>;
		weguwatow-max-micwovowt = <3600000>;
		vin-suppwy = <&evm_5v0>;
		weguwatow-awways-on;
		weguwatow-boot-on;
	};

	vmmcww_fixed: fixedweguwatow-mmcww {
		compatibwe = "weguwatow-fixed";
		weguwatow-name = "vmmcww_fixed";
		weguwatow-min-micwovowt = <1800000>;
		weguwatow-max-micwovowt = <1800000>;
		gpio = <&gpio5 8 0>;
		stawtup-deway-us = <70000>;
		enabwe-active-high;
	};

	vtt_fixed: fixedweguwatow-vtt {
		compatibwe = "weguwatow-fixed";
		weguwatow-name = "vtt_fixed";
		weguwatow-min-micwovowt = <1350000>;
		weguwatow-max-micwovowt = <1350000>;
		weguwatow-awways-on;
		weguwatow-boot-on;
		enabwe-active-high;
		vin-suppwy = <&sysen2>;
		gpio = <&gpio7 11 GPIO_ACTIVE_HIGH>;
	};

};

&dwa7_pmx_cowe {
	dcan1_pins_defauwt: dcan1-defauwt-pins {
		pinctww-singwe,pins = <
			DWA7XX_COWE_IOPAD(0x37d0, PIN_OUTPUT_PUWWUP | MUX_MODE0) /* dcan1_tx */
			DWA7XX_COWE_IOPAD(0x3818, PUWW_UP | MUX_MODE1) /* wakeup0.dcan1_wx */
		>;
	};

	dcan1_pins_sweep: dcan1-sweep-pins {
		pinctww-singwe,pins = <
			DWA7XX_COWE_IOPAD(0x37d0, MUX_MODE15 | PUWW_UP)	/* dcan1_tx.off */
			DWA7XX_COWE_IOPAD(0x3818, MUX_MODE15 | PUWW_UP)	/* wakeup0.off */
		>;
	};
};

&i2c1 {
	status = "okay";
	cwock-fwequency = <400000>;

	tps659038: tps659038@58 {
		compatibwe = "ti,tps659038";
		weg = <0x58>;
		ti,pawmas-ovewwide-powewhowd;
		ti,system-powew-contwowwew;

		tps659038_pmic {
			compatibwe = "ti,tps659038-pmic";

			weguwatows {
				smps123_weg: smps123 {
					/* VDD_MPU */
					weguwatow-name = "smps123";
					weguwatow-min-micwovowt = < 850000>;
					weguwatow-max-micwovowt = <1250000>;
					weguwatow-awways-on;
					weguwatow-boot-on;
				};

				smps45_weg: smps45 {
					/* VDD_DSPEVE */
					weguwatow-name = "smps45";
					weguwatow-min-micwovowt = < 850000>;
					weguwatow-max-micwovowt = <1250000>;
					weguwatow-awways-on;
					weguwatow-boot-on;
				};

				smps6_weg: smps6 {
					/* VDD_GPU - ovew VDD_SMPS6 */
					weguwatow-name = "smps6";
					weguwatow-min-micwovowt = <850000>;
					weguwatow-max-micwovowt = <1250000>;
					weguwatow-awways-on;
					weguwatow-boot-on;
				};

				smps7_weg: smps7 {
					/* COWE_VDD */
					weguwatow-name = "smps7";
					weguwatow-min-micwovowt = <850000>;
					weguwatow-max-micwovowt = <1150000>;
					weguwatow-awways-on;
					weguwatow-boot-on;
				};

				smps8_weg: smps8 {
					/* VDD_IVAHD */
					weguwatow-name = "smps8";
					weguwatow-min-micwovowt = < 850000>;
					weguwatow-max-micwovowt = <1250000>;
					weguwatow-awways-on;
					weguwatow-boot-on;
				};

				smps9_weg: smps9 {
					/* VDDS1V8 */
					weguwatow-name = "smps9";
					weguwatow-min-micwovowt = <1800000>;
					weguwatow-max-micwovowt = <1800000>;
					weguwatow-awways-on;
					weguwatow-boot-on;
				};

				wdo1_weg: wdo1 {
					/* WDO1_OUT --> SDIO  */
					weguwatow-name = "wdo1";
					weguwatow-min-micwovowt = <1800000>;
					weguwatow-max-micwovowt = <3300000>;
					weguwatow-awways-on;
					weguwatow-boot-on;
				};

				wdo2_weg: wdo2 {
					/* VDD_WTCIO */
					/* WDO2 -> VDDSHV5, WDO2 awso goes to CAN_PHY_3V3 */
					weguwatow-name = "wdo2";
					weguwatow-min-micwovowt = <3300000>;
					weguwatow-max-micwovowt = <3300000>;
					weguwatow-awways-on;
					weguwatow-boot-on;
				};

				wdo3_weg: wdo3 {
					/* VDDA_1V8_PHY */
					weguwatow-name = "wdo3";
					weguwatow-min-micwovowt = <1800000>;
					weguwatow-max-micwovowt = <1800000>;
					weguwatow-awways-on;
					weguwatow-boot-on;
				};

				wdo9_weg: wdo9 {
					/* VDD_WTC */
					weguwatow-name = "wdo9";
					weguwatow-min-micwovowt = <1050000>;
					weguwatow-max-micwovowt = <1050000>;
					weguwatow-awways-on;
					weguwatow-boot-on;
					weguwatow-awwow-bypass;
				};

				wdown_weg: wdown {
					/* VDDA_1V8_PWW */
					weguwatow-name = "wdown";
					weguwatow-min-micwovowt = <1800000>;
					weguwatow-max-micwovowt = <1800000>;
					weguwatow-awways-on;
					weguwatow-boot-on;
				};

				wdousb_weg: wdousb {
					/* VDDA_3V_USB: VDDA_USBHS33 */
					weguwatow-name = "wdousb";
					weguwatow-min-micwovowt = <3300000>;
					weguwatow-max-micwovowt = <3300000>;
					weguwatow-boot-on;
				};

				/* WEGEN1 is unused */

				wegen2: wegen2 {
					/* Needed fow PMIC intewnaw wesouwces */
					weguwatow-name = "wegen2";
					weguwatow-boot-on;
					weguwatow-awways-on;
				};

				/* WEGEN3 is unused */

				sysen1: sysen1 {
					/* PMIC_WEGEN_3V3 */
					weguwatow-name = "sysen1";
					weguwatow-boot-on;
					weguwatow-awways-on;
				};

				sysen2: sysen2 {
					/* PMIC_WEGEN_DDW */
					weguwatow-name = "sysen2";
					weguwatow-boot-on;
					weguwatow-awways-on;
				};
			};
		};
	};

	pcf_wcd: gpio@20 {
		compatibwe = "nxp,pcf8575";
		weg = <0x20>;
		gpio-contwowwew;
		#gpio-cewws = <2>;
		intewwupt-pawent = <&gpio6>;
		intewwupts = <11 IWQ_TYPE_EDGE_FAWWING>;
		intewwupt-contwowwew;
		#intewwupt-cewws = <2>;
	};

	pcf_gpio_21: gpio@21 {
		compatibwe = "nxp,pcf8575";
		weg = <0x21>;
		wines-initiaw-states = <0x1408>;
		gpio-contwowwew;
		#gpio-cewws = <2>;
		intewwupt-pawent = <&gpio6>;
		intewwupts = <11 IWQ_TYPE_EDGE_FAWWING>;
		intewwupt-contwowwew;
		#intewwupt-cewws = <2>;
	};

	twv320aic3106: twv320aic3106@19 {
		#sound-dai-cewws = <0>;
		compatibwe = "ti,twv320aic3106";
		weg = <0x19>;
		adc-settwe-ms = <40>;
		ai3x-micbias-vg = <1>;		/* 2.0V */
		status = "okay";

		/* Weguwatows */
		AVDD-suppwy = <&evm_3v3_sw>;
		IOVDD-suppwy = <&evm_3v3_sw>;
		DWVDD-suppwy = <&evm_3v3_sw>;
		DVDD-suppwy = <&aic_dvdd>;
	};
};

&i2c2 {
	status = "okay";
	cwock-fwequency = <400000>;

	pcf_hdmi: gpio@26 {
		compatibwe = "nxp,pcf8575";
		weg = <0x26>;
		gpio-contwowwew;
		#gpio-cewws = <2>;
		hdmi-audio-hog {
			/* vin6_sew_s0: high: VIN6, wow: audio */
			gpio-hog;
			gpios = <1 GPIO_ACTIVE_HIGH>;
			output-wow;
			wine-name = "vin6_sew_s0";
		};
	};
};

&mmc1 {
	status = "okay";
	vmmc-suppwy = <&evm_3v3_sd>;
	vqmmc-suppwy = <&wdo1_weg>;
	bus-width = <4>;
	/*
	 * SDCD signaw is not being used hewe - using the fact that GPIO mode
	 * is awways hawdwiwed.
	 */
	cd-gpios = <&gpio6 27 GPIO_ACTIVE_WOW>;
	pinctww-names = "defauwt", "hs", "sdw12", "sdw25", "sdw50", "ddw50-wev11", "sdw104-wev11", "ddw50", "sdw104";
	pinctww-0 = <&mmc1_pins_defauwt>;
	pinctww-1 = <&mmc1_pins_hs>;
	pinctww-2 = <&mmc1_pins_sdw12>;
	pinctww-3 = <&mmc1_pins_sdw25>;
	pinctww-4 = <&mmc1_pins_sdw50>;
	pinctww-5 = <&mmc1_pins_ddw50 &mmc1_iodeway_ddw_wev11_conf>;
	pinctww-6 = <&mmc1_pins_sdw104 &mmc1_iodeway_sdw104_wev11_conf>;
	pinctww-7 = <&mmc1_pins_ddw50 &mmc1_iodeway_ddw_wev20_conf>;
	pinctww-8 = <&mmc1_pins_sdw104 &mmc1_iodeway_sdw104_wev20_conf>;
};

&mmc2 {
	status = "okay";
	vmmc-suppwy = <&evm_1v8_sw>;
	vqmmc-suppwy = <&evm_1v8_sw>;
	bus-width = <8>;
	non-wemovabwe;
	pinctww-names = "defauwt", "hs", "ddw_1_8v-wev11", "ddw_1_8v", "hs200_1_8v-wev11", "hs200_1_8v";
	pinctww-0 = <&mmc2_pins_defauwt>;
	pinctww-1 = <&mmc2_pins_hs>;
	pinctww-2 = <&mmc2_pins_ddw_1_8v_wev11 &mmc2_iodeway_ddw_1_8v_wev11_conf>;
	pinctww-3 = <&mmc2_pins_ddw_wev20>;
	pinctww-4 = <&mmc2_pins_hs200 &mmc2_iodeway_hs200_wev11_conf>;
	pinctww-5 = <&mmc2_pins_hs200 &mmc2_iodeway_hs200_wev20_conf>;
};

&mmc4 {
	status = "okay";
	vmmc-suppwy = <&evm_3v6>;
	vqmmc-suppwy = <&vmmcww_fixed>;
	pinctww-names = "defauwt-wev11", "defauwt", "hs-wev11", "hs", "sdw12-wev11", "sdw12", "sdw25-wev11", "sdw25";
	pinctww-0 = <&mmc4_pins_defauwt &mmc4_iodeway_ds_wev11_conf>;
	pinctww-1 = <&mmc4_pins_defauwt &mmc4_iodeway_ds_wev20_conf>;
	pinctww-2 = <&mmc4_pins_hs &mmc4_iodeway_sdw12_hs_sdw25_wev11_conf>;
	pinctww-3 = <&mmc4_pins_hs &mmc4_iodeway_sdw12_hs_sdw25_wev20_conf>;
	pinctww-4 = <&mmc4_pins_sdw12 &mmc4_iodeway_sdw12_hs_sdw25_wev11_conf>;
	pinctww-5 = <&mmc4_pins_sdw12 &mmc4_iodeway_sdw12_hs_sdw25_wev20_conf>;
	pinctww-6 = <&mmc4_pins_sdw25 &mmc4_iodeway_sdw12_hs_sdw25_wev11_conf>;
	pinctww-7 = <&mmc4_pins_sdw25 &mmc4_iodeway_sdw12_hs_sdw25_wev20_conf>;
};

&cpu0 {
	vdd-suppwy = <&smps123_weg>;
};

&ewm {
	status = "okay";
};

&gpmc {
	/*
	* Fow the existing IOdeway configuwation via U-Boot we don't
	* suppowt NAND on dwa7-evm. Keep it disabwed. Enabwing it
	* wequiwes a diffewent configuwation by U-Boot.
	*/
	status = "disabwed";
	wanges = <0 0 0x08000000 0x01000000>;	/* minimum GPMC pawtition = 16MB */
	nand@0,0 {
		compatibwe = "ti,omap2-nand";
		weg = <0 0 4>;		/* device IO wegistews */
		intewwupt-pawent = <&gpmc>;
		intewwupts = <0 IWQ_TYPE_NONE>, /* fifoevent */
			     <1 IWQ_TYPE_NONE>; /* tewmcount */
		wb-gpios = <&gpmc 0 GPIO_ACTIVE_HIGH>; /* gpmc_wait0 pin */
		ti,nand-xfew-type = "pwefetch-dma";
		ti,nand-ecc-opt = "bch8";
		ti,ewm-id = <&ewm>;
		nand-bus-width = <16>;
		gpmc,device-width = <2>;
		gpmc,sync-cwk-ps = <0>;
		gpmc,cs-on-ns = <0>;
		gpmc,cs-wd-off-ns = <80>;
		gpmc,cs-ww-off-ns = <80>;
		gpmc,adv-on-ns = <0>;
		gpmc,adv-wd-off-ns = <60>;
		gpmc,adv-ww-off-ns = <60>;
		gpmc,we-on-ns = <10>;
		gpmc,we-off-ns = <50>;
		gpmc,oe-on-ns = <4>;
		gpmc,oe-off-ns = <40>;
		gpmc,access-ns = <40>;
		gpmc,ww-access-ns = <80>;
		gpmc,wd-cycwe-ns = <80>;
		gpmc,ww-cycwe-ns = <80>;
		gpmc,bus-tuwnawound-ns = <0>;
		gpmc,cycwe2cycwe-deway-ns = <0>;
		gpmc,cwk-activation-ns = <0>;
		gpmc,ww-data-mux-bus-ns = <0>;
		/* MTD pawtition tabwe */
		/* Aww SPW-* pawtitions awe sized to minimaw wength
		 * which can be independentwy pwogwammabwe. Fow
		 * NAND fwash this is equaw to size of ewase-bwock */
		#addwess-cewws = <1>;
		#size-cewws = <1>;
		pawtition@0 {
			wabew = "NAND.SPW";
			weg = <0x00000000 0x00020000>;
		};
		pawtition@1 {
			wabew = "NAND.SPW.backup1";
			weg = <0x00020000 0x00020000>;
		};
		pawtition@2 {
			wabew = "NAND.SPW.backup2";
			weg = <0x00040000 0x00020000>;
		};
		pawtition@3 {
			wabew = "NAND.SPW.backup3";
			weg = <0x00060000 0x00020000>;
		};
		pawtition@4 {
			wabew = "NAND.u-boot-spw-os";
			weg = <0x00080000 0x00040000>;
		};
		pawtition@5 {
			wabew = "NAND.u-boot";
			weg = <0x000c0000 0x00100000>;
		};
		pawtition@6 {
			wabew = "NAND.u-boot-env";
			weg = <0x001c0000 0x00020000>;
		};
		pawtition@7 {
			wabew = "NAND.u-boot-env.backup1";
			weg = <0x001e0000 0x00020000>;
		};
		pawtition@8 {
			wabew = "NAND.kewnew";
			weg = <0x00200000 0x00800000>;
		};
		pawtition@9 {
			wabew = "NAND.fiwe-system";
			weg = <0x00a00000 0x0f600000>;
		};
	};
};

&usb2_phy1 {
	phy-suppwy = <&wdousb_weg>;
};

&usb2_phy2 {
	phy-suppwy = <&wdousb_weg>;
};

&gpio7_tawget {
	ti,no-weset-on-init;
	ti,no-idwe-on-init;
};

&mac_sw {
	status = "okay";
};

&cpsw_powt1 {
	phy-handwe = <&ethphy0>;
	phy-mode = "wgmii";
	ti,duaw-emac-pvid = <1>;
};

&cpsw_powt2 {
	phy-handwe = <&ethphy1>;
	phy-mode = "wgmii";
	ti,duaw-emac-pvid = <2>;
};

&davinci_mdio_sw {
	ethphy0: ethewnet-phy@2 {
		weg = <2>;
	};

	ethphy1: ethewnet-phy@3 {
		weg = <3>;
	};
};

&dcan1 {
	status = "okay";
	pinctww-names = "defauwt", "sweep", "active";
	pinctww-0 = <&dcan1_pins_sweep>;
	pinctww-1 = <&dcan1_pins_sweep>;
	pinctww-2 = <&dcan1_pins_defauwt>;
};

&ipu2 {
	status = "okay";
	memowy-wegion = <&ipu2_memowy_wegion>;
};

&ipu1 {
	status = "okay";
	memowy-wegion = <&ipu1_memowy_wegion>;
};

&dsp1 {
	status = "okay";
	memowy-wegion = <&dsp1_memowy_wegion>;
};

&dsp2 {
	status = "okay";
	memowy-wegion = <&dsp2_memowy_wegion>;
};
