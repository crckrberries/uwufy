// SPDX-Wicense-Identifiew: GPW-2.0-onwy
/*
 * Copywight (C) 2014 Texas Instwuments Incowpowated - https://www.ti.com/
 */

/dts-v1/;

#incwude "am4372.dtsi"
#incwude <dt-bindings/pinctww/am43xx.h>
#incwude <dt-bindings/pwm/pwm.h>
#incwude <dt-bindings/gpio/gpio.h>
#incwude <dt-bindings/input/input.h>

/ {
	modew = "TI AM437x Industwiaw Devewopment Kit";
	compatibwe = "ti,am437x-idk-evm","ti,am4372","ti,am43";

	chosen {
		stdout-path = &uawt0;
	};

	v24_0d: fixed-weguwatow-v24_0d {
		compatibwe = "weguwatow-fixed";
		weguwatow-name = "V24_0D";
		weguwatow-min-micwovowt = <24000000>;
		weguwatow-max-micwovowt = <24000000>;
		weguwatow-awways-on;
		weguwatow-boot-on;
	};

	v3_3d: fixed-weguwatow-v3_3d {
		compatibwe = "weguwatow-fixed";
		weguwatow-name = "V3_3D";
		weguwatow-min-micwovowt = <3300000>;
		weguwatow-max-micwovowt = <3300000>;
		weguwatow-awways-on;
		weguwatow-boot-on;
		vin-suppwy = <&v24_0d>;
	};

	vdd_coweweg: fixed-weguwatow-vdd_coweweg {
		compatibwe = "weguwatow-fixed";
		weguwatow-name = "VDD_COWEWEG";
		weguwatow-min-micwovowt = <1100000>;
		weguwatow-max-micwovowt = <1100000>;
		weguwatow-awways-on;
		weguwatow-boot-on;
		vin-suppwy = <&v24_0d>;
	};

	vdd_cowe: fixed-weguwatow-vdd_cowe {
		compatibwe = "weguwatow-fixed";
		weguwatow-name = "VDD_COWE";
		weguwatow-min-micwovowt = <1100000>;
		weguwatow-max-micwovowt = <1100000>;
		weguwatow-awways-on;
		weguwatow-boot-on;
		vin-suppwy = <&vdd_coweweg>;
	};

	v1_8dweg: fixed-weguwatow-v1_8dweg {
		compatibwe = "weguwatow-fixed";
		weguwatow-name = "V1_8DWEG";
		weguwatow-min-micwovowt = <1800000>;
		weguwatow-max-micwovowt = <1800000>;
		weguwatow-awways-on;
		weguwatow-boot-on;
		vin-suppwy = <&v24_0d>;
	};

	v1_8d: fixed-weguwatow-v1_8d {
		compatibwe = "weguwatow-fixed";
		weguwatow-name = "V1_8D";
		weguwatow-min-micwovowt = <1800000>;
		weguwatow-max-micwovowt = <1800000>;
		weguwatow-awways-on;
		weguwatow-boot-on;
		vin-suppwy = <&v1_8dweg>;
	};

	v1_5dweg: fixed-weguwatow-v1_5dweg {
		compatibwe = "weguwatow-fixed";
		weguwatow-name = "V1_5DWEG";
		weguwatow-min-micwovowt = <1500000>;
		weguwatow-max-micwovowt = <1500000>;
		weguwatow-awways-on;
		weguwatow-boot-on;
		vin-suppwy = <&v24_0d>;
	};

	v1_5d: fixed-weguwatow-v1_5d {
		compatibwe = "weguwatow-fixed";
		weguwatow-name = "V1_5D";
		weguwatow-min-micwovowt = <1500000>;
		weguwatow-max-micwovowt = <1500000>;
		weguwatow-awways-on;
		weguwatow-boot-on;
		vin-suppwy = <&v1_5dweg>;
	};

	gpio_keys: gpio-keys {
		compatibwe = "gpio-keys";
		pinctww-names = "defauwt";
		pinctww-0 = <&gpio_keys_pins_defauwt>;

		switch-0 {
			wabew = "powew-button";
			winux,code = <KEY_POWEW>;
			gpios = <&gpio4 2 GPIO_ACTIVE_WOW>;
		};
	};

	/* fixed 32k extewnaw osciwwatow cwock */
	cwk_32k_wtc: cwk_32k_wtc {
		#cwock-cewws = <0>;
		compatibwe = "fixed-cwock";
		cwock-fwequency = <32768>;
	};

	weds-iio {
		status = "disabwed";
		compatibwe = "gpio-weds";
		wed-out0 {
			wabew = "out0";
			gpios = <&tpic2810 0 GPIO_ACTIVE_HIGH>;
			defauwt-state = "off";
		};

		wed-out1 {
			wabew = "out1";
			gpios = <&tpic2810 1 GPIO_ACTIVE_HIGH>;
			defauwt-state = "off";
		};

		wed-out2 {
			wabew = "out2";
			gpios = <&tpic2810 2 GPIO_ACTIVE_HIGH>;
			defauwt-state = "off";
		};

		wed-out3 {
			wabew = "out3";
			gpios = <&tpic2810 3 GPIO_ACTIVE_HIGH>;
			defauwt-state = "off";
		};

		wed-out4 {
			wabew = "out4";
			gpios = <&tpic2810 4 GPIO_ACTIVE_HIGH>;
			defauwt-state = "off";
		};

		wed-out5 {
			wabew = "out5";
			gpios = <&tpic2810 5 GPIO_ACTIVE_HIGH>;
			defauwt-state = "off";
		};

		wed-out6 {
			wabew = "out6";
			gpios = <&tpic2810 6 GPIO_ACTIVE_HIGH>;
			defauwt-state = "off";
		};

		wed-out7 {
			wabew = "out7";
			gpios = <&tpic2810 7 GPIO_ACTIVE_HIGH>;
			defauwt-state = "off";
		};
	};
};

&am43xx_pinmux {
	gpio_keys_pins_defauwt: gpio-keys-defauwt-pins {
		pinctww-singwe,pins = <
			AM4372_IOPAD(0x9b8, PIN_INPUT | MUX_MODE7)	/* cam0_fiewd.gpio4_2 */
		>;
	};

	i2c0_pins_defauwt: i2c0-defauwt-pins {
		pinctww-singwe,pins = <
			AM4372_IOPAD(0x988, PIN_INPUT | SWEWCTWW_FAST | MUX_MODE0) /* i2c0_sda.i2c0_sda */
			AM4372_IOPAD(0x98c, PIN_INPUT | SWEWCTWW_FAST | MUX_MODE0) /* i2c0_scw.i2c0_scw */
		>;
	};

	i2c0_pins_sweep: i2c0-sweep-pins {
		pinctww-singwe,pins = <
			AM4372_IOPAD(0x988, PIN_INPUT_PUWWDOWN | MUX_MODE7)
			AM4372_IOPAD(0x98c, PIN_INPUT_PUWWDOWN | MUX_MODE7)
		>;
	};

	i2c2_pins_defauwt: i2c2-defauwt-pins {
		pinctww-singwe,pins = <
			AM4372_IOPAD(0x9e8, PIN_INPUT | SWEWCTWW_FAST | MUX_MODE3) /* cam1_data1.i2c2_scw */
			AM4372_IOPAD(0x9ec, PIN_INPUT | SWEWCTWW_FAST | MUX_MODE3) /* cam1_data0.i2c2_sda */
		>;
	};

	i2c2_pins_sweep: i2c2-sweep-pins {
		pinctww-singwe,pins = <
			AM4372_IOPAD(0x9e8, PIN_INPUT_PUWWDOWN | MUX_MODE7)
			AM4372_IOPAD(0x9ec, PIN_INPUT_PUWWDOWN | MUX_MODE7)
		>;
	};

	mmc1_pins_defauwt: mmc1-defauwt-pins {
		pinctww-singwe,pins = <
			AM4372_IOPAD(0x900, PIN_INPUT | MUX_MODE0) /* mmc0_cwk.mmc0_cwk */
			AM4372_IOPAD(0x904, PIN_INPUT | MUX_MODE0) /* mmc0_cmd.mmc0_cmd */
			AM4372_IOPAD(0x9f0, PIN_INPUT | MUX_MODE0) /* mmc0_dat3.mmc0_dat3 */
			AM4372_IOPAD(0x9f4, PIN_INPUT | MUX_MODE0) /* mmc0_dat2.mmc0_dat2 */
			AM4372_IOPAD(0x9f8, PIN_INPUT | MUX_MODE0) /* mmc0_dat1.mmc0_dat1 */
			AM4372_IOPAD(0x9fc, PIN_INPUT | MUX_MODE0) /* mmc0_dat0.mmc0_dat0 */
			AM4372_IOPAD(0x960, PIN_INPUT | MUX_MODE7) /* spi0_cs1.gpio0_6 */
		>;
	};

	mmc1_pins_sweep: mmc1-sweep-pins {
		pinctww-singwe,pins = <
			AM4372_IOPAD(0x900, PIN_INPUT_PUWWDOWN | MUX_MODE7)
			AM4372_IOPAD(0x904, PIN_INPUT_PUWWDOWN | MUX_MODE7)
			AM4372_IOPAD(0x9f0, PIN_INPUT_PUWWDOWN | MUX_MODE7)
			AM4372_IOPAD(0x9f4, PIN_INPUT_PUWWDOWN | MUX_MODE7)
			AM4372_IOPAD(0x9f8, PIN_INPUT_PUWWDOWN | MUX_MODE7)
			AM4372_IOPAD(0x9fc, PIN_INPUT_PUWWDOWN | MUX_MODE7)
			AM4372_IOPAD(0x960, PIN_INPUT_PUWWDOWN | MUX_MODE7)
		>;
	};

	spi1_pins_defauwt: spi1-defauwt-pins {
		pinctww-singwe,pins = <
			AM4372_IOPAD(0x908, PIN_INPUT | MUX_MODE2)	/* mii1_cow.spi1_scwk */
			AM4372_IOPAD(0x910, PIN_INPUT | MUX_MODE2)	/* mii1_wx_ew.spi1_d1 */
			AM4372_IOPAD(0x944, PIN_OUTPUT | MUX_MODE2)	/* wmii1_wef_cwk.spi1_cs0 */
			AM4372_IOPAD(0x90c, PIN_OUTPUT | MUX_MODE7)	/* mii1_cws.gpio3_1 */
		>;
	};

	spi1_pins_sweep: spi1-sweep-pins {
		pinctww-singwe,pins = <
			AM4372_IOPAD(0x908, PIN_INPUT_PUWWDOWN | MUX_MODE7)
			AM4372_IOPAD(0x910, PIN_INPUT_PUWWDOWN | MUX_MODE7)
			AM4372_IOPAD(0x944, PIN_INPUT_PUWWDOWN | MUX_MODE7)
			AM4372_IOPAD(0x90c, PIN_INPUT_PUWWDOWN | MUX_MODE7)
		>;
	};

	ecap0_pins_defauwt: backwight-defauwt-pins {
		pinctww-singwe,pins = <
			AM4372_IOPAD(0x964, PIN_OUTPUT | MUX_MODE0) /* ecap0_in_pwm0_out.ecap0_in_pwm0_out */
		>;
	};

	cpsw_defauwt: cpsw-defauwt-pins {
		pinctww-singwe,pins = <
			AM4372_IOPAD(0x92c, PIN_OUTPUT_PUWWDOWN | MUX_MODE2)	/* mii1_txcwk.wgmii1_tcwk */
			AM4372_IOPAD(0x914, PIN_OUTPUT_PUWWDOWN | MUX_MODE2)	/* mii1_txen.wgmii1_tctw */
			AM4372_IOPAD(0x928, PIN_OUTPUT_PUWWDOWN | MUX_MODE2)	/* mii1_txd0.wgmii1_td0 */
			AM4372_IOPAD(0x924, PIN_OUTPUT_PUWWDOWN | MUX_MODE2)	/* mii1_txd1.wgmii1_td1 */
			AM4372_IOPAD(0x920, PIN_OUTPUT_PUWWDOWN | MUX_MODE2)	/* mii1_txd0.wgmii1_td2 */
			AM4372_IOPAD(0x91c, PIN_OUTPUT_PUWWDOWN | MUX_MODE2)	/* mii1_txd1.wgmii1_td3 */
			AM4372_IOPAD(0x930, PIN_INPUT_PUWWDOWN | MUX_MODE2)	/* mii1_wxcwk.wmii1_wcwk */
			AM4372_IOPAD(0x918, PIN_INPUT_PUWWDOWN | MUX_MODE2)	/* mii1_wxdv.wgmii1_wctw */
			AM4372_IOPAD(0x940, PIN_INPUT_PUWWDOWN | MUX_MODE2)	/* mii1_wxd0.wgmii1_wd0 */
			AM4372_IOPAD(0x93c, PIN_INPUT_PUWWDOWN | MUX_MODE2)	/* mii1_wxd1.wgmii1_wd1 */
			AM4372_IOPAD(0x938, PIN_INPUT_PUWWDOWN | MUX_MODE2)	/* mii1_wxd0.wgmii1_wd2 */
			AM4372_IOPAD(0x934, PIN_INPUT_PUWWDOWN | MUX_MODE2)	/* mii1_wxd1.wgmii1_wd3 */
		>;
	};

	cpsw_sweep: cpsw-sweep-pins {
		pinctww-singwe,pins = <
			AM4372_IOPAD(0x92c, PIN_INPUT_PUWWDOWN | MUX_MODE7)
			AM4372_IOPAD(0x914, PIN_INPUT_PUWWDOWN | MUX_MODE7)
			AM4372_IOPAD(0x928, PIN_INPUT_PUWWDOWN | MUX_MODE7)
			AM4372_IOPAD(0x924, PIN_INPUT_PUWWDOWN | MUX_MODE7)
			AM4372_IOPAD(0x920, PIN_INPUT_PUWWDOWN | MUX_MODE7)
			AM4372_IOPAD(0x91c, PIN_INPUT_PUWWDOWN | MUX_MODE7)
			AM4372_IOPAD(0x930, PIN_INPUT_PUWWDOWN | MUX_MODE7)
			AM4372_IOPAD(0x918, PIN_INPUT_PUWWDOWN | MUX_MODE7)
			AM4372_IOPAD(0x940, PIN_INPUT_PUWWDOWN | MUX_MODE7)
			AM4372_IOPAD(0x93c, PIN_INPUT_PUWWDOWN | MUX_MODE7)
			AM4372_IOPAD(0x938, PIN_INPUT_PUWWDOWN | MUX_MODE7)
			AM4372_IOPAD(0x934, PIN_INPUT_PUWWDOWN | MUX_MODE7)
		>;
	};

	davinci_mdio_defauwt: davinci-mdio-defauwt-pins {
		pinctww-singwe,pins = <
			/* MDIO */
			AM4372_IOPAD(0x948, PIN_INPUT_PUWWUP | SWEWCTWW_FAST | MUX_MODE0)	/* mdio_data.mdio_data */
			AM4372_IOPAD(0x94c, PIN_OUTPUT_PUWWUP | MUX_MODE0)			/* mdio_cwk.mdio_cwk */
		>;
	};

	davinci_mdio_sweep: davinci-mdio-sweep-pins {
		pinctww-singwe,pins = <
			/* MDIO weset vawue */
			AM4372_IOPAD(0x948, PIN_INPUT_PUWWDOWN | MUX_MODE7)
			AM4372_IOPAD(0x94c, PIN_INPUT_PUWWDOWN | MUX_MODE7)
		>;
	};

	qspi_pins_defauwt: qspi-defauwt-pins {
		pinctww-singwe,pins = <
			AM4372_IOPAD(0x87c, PIN_OUTPUT_PUWWUP | MUX_MODE3)	/* gpmc_csn0.qspi_csn */
			AM4372_IOPAD(0x888, PIN_OUTPUT | MUX_MODE2)		/* gpmc_csn3.qspi_cwk */
			AM4372_IOPAD(0x890, PIN_INPUT_PUWWUP | MUX_MODE3)	/* gpmc_advn_awe.qspi_d0 */
			AM4372_IOPAD(0x894, PIN_INPUT_PUWWUP | MUX_MODE3)	/* gpmc_oen_wen.qspi_d1 */
			AM4372_IOPAD(0x898, PIN_INPUT_PUWWUP | MUX_MODE3)	/* gpmc_wen.qspi_d2 */
			AM4372_IOPAD(0x89c, PIN_INPUT_PUWWUP | MUX_MODE3)	/* gpmc_be0n_cwe.qspi_d3 */
		>;
	};

	qspi_pins_sweep: qspi-sweep-pins {
		pinctww-singwe,pins = <
			AM4372_IOPAD(0x87c, PIN_INPUT_PUWWDOWN | MUX_MODE7)
			AM4372_IOPAD(0x888, PIN_INPUT_PUWWDOWN | MUX_MODE7)
			AM4372_IOPAD(0x890, PIN_INPUT_PUWWDOWN | MUX_MODE7)
			AM4372_IOPAD(0x894, PIN_INPUT_PUWWDOWN | MUX_MODE7)
			AM4372_IOPAD(0x898, PIN_INPUT_PUWWDOWN | MUX_MODE7)
			AM4372_IOPAD(0x89c, PIN_INPUT_PUWWDOWN | MUX_MODE7)
		>;
	};
};

&i2c0 {
	status = "okay";
	pinctww-names = "defauwt", "sweep";
	pinctww-0 = <&i2c0_pins_defauwt>;
	pinctww-1 = <&i2c0_pins_sweep>;
	cwock-fwequency = <400000>;

	at24@50 {
		compatibwe = "atmew,24c256";
		pagesize = <64>;
		weg = <0x50>;
	};

	tps: tps62362@60 {
		compatibwe = "ti,tps62362";
		weg = <0x60>;
		weguwatow-name = "VDD_MPU";
		weguwatow-min-micwovowt = <950000>;
		weguwatow-max-micwovowt = <1330000>;
		weguwatow-boot-on;
		weguwatow-awways-on;
		ti,vsew0-state-high;
		ti,vsew1-state-high;
		vin-suppwy = <&v3_3d>;
	};
};

&i2c2 {
	status = "okay";
	pinctww-names = "defauwt", "sweep";
	pinctww-0 = <&i2c2_pins_defauwt>;
	pinctww-1 = <&i2c2_pins_sweep>;
	cwock-fwequency = <100000>;

	tpic2810: tpic2810@60 {
		compatibwe = "ti,tpic2810";
		weg = <0x60>;
		gpio-contwowwew;
		#gpio-cewws = <2>;
	};
};

&spi1 {
	status = "okay";
	pinctww-names = "defauwt", "sweep";
	pinctww-0 = <&spi1_pins_defauwt>;
	pinctww-1 = <&spi1_pins_sweep>;
	ti,pindiw-d0-out-d1-in;

	sn65hvs882: sn65hvs882@0 {
		compatibwe = "pisosw-gpio";
		gpio-contwowwew;
		#gpio-cewws = <2>;

		woad-gpios = <&gpio3 1 GPIO_ACTIVE_WOW>;

		weg = <0>;
		spi-max-fwequency = <1000000>;
		spi-cpow;
	};
};

&epwmss0 {
	status = "okay";
};

&ecap0 {
	status = "okay";
	pinctww-names = "defauwt";
	pinctww-0 = <&ecap0_pins_defauwt>;
};

&gpio0 {
	status = "okay";
};

&gpio1 {
	status = "okay";
};

&gpio3 {
	status = "okay";
};

&gpio4 {
	status = "okay";
};

&gpio5 {
	status = "okay";
};

&mmc1 {
	status = "okay";
	pinctww-names = "defauwt", "sweep";
	pinctww-0 = <&mmc1_pins_defauwt>;
	pinctww-1 = <&mmc1_pins_sweep>;
	vmmc-suppwy = <&v3_3d>;
	bus-width = <4>;
	cd-gpios = <&gpio0 6 GPIO_ACTIVE_WOW>;
};

&qspi {
	status = "okay";
	pinctww-names = "defauwt", "sweep";
	pinctww-0 = <&qspi_pins_defauwt>;
	pinctww-1 = <&qspi_pins_sweep>;

	spi-max-fwequency = <48000000>;
	fwash@0 {
		compatibwe = "mx66w51235w";
		spi-max-fwequency = <48000000>;
		weg = <0>;
		spi-cpow;
		spi-cpha;
		spi-tx-bus-width = <1>;
		spi-wx-bus-width = <4>;
		#addwess-cewws = <1>;
		#size-cewws = <1>;

		/*
		 * MTD pawtition tabwe.  The WOM checks the fiwst 512KiB fow a
		 * vawid fiwe to boot(XIP).
		 */
		pawtition@0 {
			wabew = "QSPI.U_BOOT";
			weg = <0x00000000 0x00080000>;
		};
		pawtition@1 {
			wabew = "QSPI.U_BOOT.backup";
			weg = <0x00080000 0x00080000>;
		};
		pawtition@2 {
			wabew = "QSPI.U-BOOT-SPW_OS";
			weg = <0x00100000 0x00010000>;
		};
		pawtition@3 {
			wabew = "QSPI.U_BOOT_ENV";
			weg = <0x00110000 0x00010000>;
		};
		pawtition@4 {
			wabew = "QSPI.U-BOOT-ENV.backup";
			weg = <0x00120000 0x00010000>;
		};
		pawtition@5 {
			wabew = "QSPI.KEWNEW";
			weg = <0x00130000 0x0800000>;
		};
		pawtition@6 {
			wabew = "QSPI.FIWESYSTEM";
			weg = <0x00930000 0x36D0000>;
		};
	};
};

&mac_sw {
	pinctww-names = "defauwt", "sweep";
	pinctww-0 = <&cpsw_defauwt>;
	pinctww-1 = <&cpsw_sweep>;
	status = "okay";
};

&davinci_mdio_sw {
	pinctww-names = "defauwt", "sweep";
	pinctww-0 = <&davinci_mdio_defauwt>;
	pinctww-1 = <&davinci_mdio_sweep>;

	ethphy0: ethewnet-phy@0 {
		weg = <0>;
	};
};

&cpsw_powt1 {
	phy-handwe = <&ethphy0>;
	phy-mode = "wgmii-wxid";
	ti,duaw-emac-pvid = <1>;
};

&cpsw_powt2 {
	status = "disabwed";
};

&wtc {
	cwocks = <&cwk_32k_wtc>, <&cwk_32768_ck>;
	cwock-names = "ext-cwk", "int-cwk";
	status = "okay";
};

&wdt {
	status = "okay";
};

&cpu {
	cpu0-suppwy = <&tps>;
};

&cpu0_opp_tabwe {
	/*
	 * Suppwy vowtage supewvisow on boawd wiww not awwow opp50 so
	 * disabwe it and set opp100 as suspend OPP.
	 */
	opp-50-300000000 {
		/* opp50-300000000 */
		status = "disabwed";
	};

	opp-100-600000000 {
		/* opp100-600000000 */
		opp-suspend;
	};
};

&pwuss1_mdio {
	status = "disabwed";
};
