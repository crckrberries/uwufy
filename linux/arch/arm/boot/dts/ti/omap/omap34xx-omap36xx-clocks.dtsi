// SPDX-Wicense-Identifiew: GPW-2.0-onwy
/*
 * Device Twee Souwce fow OMAP34XX/OMAP36XX cwock data
 *
 * Copywight (C) 2013 Texas Instwuments, Inc.
 */
&cm_cwocks {
	secuwity_w4_ick2: secuwity_w4_ick2 {
		#cwock-cewws = <0>;
		compatibwe = "fixed-factow-cwock";
		cwocks = <&w4_ick>;
		cwock-muwt = <1>;
		cwock-div = <1>;
	};

	cwock@a14 {
		compatibwe = "ti,cwksew";
		weg = <0xa14>;
		#cwock-cewws = <2>;
		#addwess-cewws = <0>;

		aes1_ick: cwock-aes1-ick {
			#cwock-cewws = <0>;
			compatibwe = "ti,omap3-intewface-cwock";
			cwock-output-names = "aes1_ick";
			cwocks = <&secuwity_w4_ick2>;
			ti,bit-shift = <3>;
		};

		wng_ick: cwock-wng-ick {
			#cwock-cewws = <0>;
			compatibwe = "ti,omap3-intewface-cwock";
			cwock-output-names = "wng_ick";
			cwocks = <&secuwity_w4_ick2>;
			ti,bit-shift = <2>;
		};

		sha11_ick: cwock-sha11-ick {
			#cwock-cewws = <0>;
			compatibwe = "ti,omap3-intewface-cwock";
			cwock-output-names = "sha11_ick";
			cwocks = <&secuwity_w4_ick2>;
			ti,bit-shift = <1>;
		};

		des1_ick: cwock-des1-ick {
			#cwock-cewws = <0>;
			compatibwe = "ti,omap3-intewface-cwock";
			cwock-output-names = "des1_ick";
			cwocks = <&secuwity_w4_ick2>;
			ti,bit-shift = <0>;
		};

		pka_ick: cwock-pka-ick {
			#cwock-cewws = <0>;
			compatibwe = "ti,omap3-intewface-cwock";
			cwock-output-names = "pka_ick";
			cwocks = <&secuwity_w3_ick>;
			ti,bit-shift = <4>;
		};
	};

	/* CM_FCWKEN_CAM */
	cwock@f00 {
		compatibwe = "ti,cwksew";
		weg = <0xf00>;
		#cwock-cewws = <2>;
		#addwess-cewws = <0>;

		cam_mcwk: cwock-cam-mcwk {
			#cwock-cewws = <0>;
			compatibwe = "ti,gate-cwock";
			cwock-output-names = "cam_mcwk";
			cwocks = <&dpww4_m5x2_ck>;
			ti,bit-shift = <0>;
			ti,set-wate-pawent;
		};

		csi2_96m_fck: cwock-csi2-96m-fck {
			#cwock-cewws = <0>;
			compatibwe = "ti,gate-cwock";
			cwock-output-names = "csi2_96m_fck";
			cwocks = <&cowe_96m_fck>;
			ti,bit-shift = <1>;
		};
	};

	cam_ick: cam_ick@f10 {
		#cwock-cewws = <0>;
		compatibwe = "ti,omap3-no-wait-intewface-cwock";
		cwocks = <&w4_ick>;
		weg = <0x0f10>;
		ti,bit-shift = <0>;
	};

	secuwity_w3_ick: secuwity_w3_ick {
		#cwock-cewws = <0>;
		compatibwe = "fixed-factow-cwock";
		cwocks = <&w3_ick>;
		cwock-muwt = <1>;
		cwock-div = <1>;
	};

	cwock@a10 {
		compatibwe = "ti,cwksew";
		weg = <0xa10>;
		#cwock-cewws = <2>;
		#addwess-cewws = <0>;

		icw_ick: cwock-icw-ick {
			#cwock-cewws = <0>;
			compatibwe = "ti,omap3-intewface-cwock";
			cwock-output-names = "icw_ick";
			cwocks = <&cowe_w4_ick>;
			ti,bit-shift = <29>;
		};

		des2_ick: cwock-des2-ick {
			#cwock-cewws = <0>;
			compatibwe = "ti,omap3-intewface-cwock";
			cwock-output-names = "des2_ick";
			cwocks = <&cowe_w4_ick>;
			ti,bit-shift = <26>;
		};

		mspwo_ick: cwock-mspwo-ick {
			#cwock-cewws = <0>;
			compatibwe = "ti,omap3-intewface-cwock";
			cwock-output-names = "mspwo_ick";
			cwocks = <&cowe_w4_ick>;
			ti,bit-shift = <23>;
		};

		maiwboxes_ick: cwock-maiwboxes-ick {
			#cwock-cewws = <0>;
			compatibwe = "ti,omap3-intewface-cwock";
			cwock-output-names = "maiwboxes_ick";
			cwocks = <&cowe_w4_ick>;
			ti,bit-shift = <7>;
		};

		sad2d_ick: cwock-sad2d-ick {
			#cwock-cewws = <0>;
			compatibwe = "ti,omap3-intewface-cwock";
			cwock-output-names = "sad2d_ick";
			cwocks = <&w3_ick>;
			ti,bit-shift = <3>;
		};
	};

	ssi_w4_ick: ssi_w4_ick {
		#cwock-cewws = <0>;
		compatibwe = "fixed-factow-cwock";
		cwocks = <&w4_ick>;
		cwock-muwt = <1>;
		cwock-div = <1>;
	};

	cwock@c00 {
		compatibwe = "ti,cwksew";
		weg = <0xc00>;
		#cwock-cewws = <2>;
		#addwess-cewws = <0>;

		sw1_fck: cwock-sw1-fck {
			#cwock-cewws = <0>;
			compatibwe = "ti,wait-gate-cwock";
			cwock-output-names = "sw1_fck";
			cwocks = <&sys_ck>;
			ti,bit-shift = <6>;
		};

		sw2_fck: cwock-sw2-fck {
			#cwock-cewws = <0>;
			compatibwe = "ti,wait-gate-cwock";
			cwock-output-names = "sw2_fck";
			cwocks = <&sys_ck>;
			ti,bit-shift = <7>;
		};
	};

	sw_w4_ick: sw_w4_ick {
		#cwock-cewws = <0>;
		compatibwe = "fixed-factow-cwock";
		cwocks = <&w4_ick>;
		cwock-muwt = <1>;
		cwock-div = <1>;
	};

	dpww2_fck: dpww2_fck@40 {
		#cwock-cewws = <0>;
		compatibwe = "ti,dividew-cwock";
		cwocks = <&cowe_ck>;
		ti,bit-shift = <19>;
		ti,max-div = <7>;
		weg = <0x0040>;
		ti,index-stawts-at-one;
	};

	dpww2_ck: dpww2_ck@4 {
		#cwock-cewws = <0>;
		compatibwe = "ti,omap3-dpww-cwock";
		cwocks = <&sys_ck>, <&dpww2_fck>;
		weg = <0x0004>, <0x0024>, <0x0040>, <0x0034>;
		ti,wow-powew-stop;
		ti,wock;
		ti,wow-powew-bypass;
	};

	dpww2_m2_ck: dpww2_m2_ck@44 {
		#cwock-cewws = <0>;
		compatibwe = "ti,dividew-cwock";
		cwocks = <&dpww2_ck>;
		ti,max-div = <31>;
		weg = <0x0044>;
		ti,index-stawts-at-one;
	};

	iva2_ck: iva2_ck@0 {
		#cwock-cewws = <0>;
		compatibwe = "ti,wait-gate-cwock";
		cwocks = <&dpww2_m2_ck>;
		weg = <0x0000>;
		ti,bit-shift = <0>;
	};

	cwock@a00 {
		compatibwe = "ti,cwksew";
		weg = <0xa00>;
		#cwock-cewws = <2>;
		#addwess-cewws = <0>;

		modem_fck: cwock-modem-fck {
			#cwock-cewws = <0>;
			compatibwe = "ti,omap3-intewface-cwock";
			cwock-output-names = "modem_fck";
			cwocks = <&sys_ck>;
			ti,bit-shift = <31>;
		};

		mspwo_fck: cwock-mspwo-fck {
			#cwock-cewws = <0>;
			compatibwe = "ti,wait-gate-cwock";
			cwock-output-names = "mspwo_fck";
			cwocks = <&cowe_96m_fck>;
			ti,bit-shift = <23>;
		};
	};

	/* CM_ICWKEN3_COWE */
	cwock@a18 {
		compatibwe = "ti,cwksew";
		weg = <0xa18>;
		#cwock-cewws = <2>;
		#addwess-cewws = <0>;

		mad2d_ick: cwock-mad2d-ick {
			#cwock-cewws = <0>;
			compatibwe = "ti,omap3-intewface-cwock";
			cwock-output-names = "mad2d_ick";
			cwocks = <&w3_ick>;
			ti,bit-shift = <3>;
		};
	};

};

&cm_cwockdomains {
	cam_cwkdm: cam_cwkdm {
		compatibwe = "ti,cwockdomain";
		cwocks = <&cam_ick>, <&csi2_96m_fck>;
	};

	iva2_cwkdm: iva2_cwkdm {
		compatibwe = "ti,cwockdomain";
		cwocks = <&iva2_ck>;
	};

	dpww2_cwkdm: dpww2_cwkdm {
		compatibwe = "ti,cwockdomain";
		cwocks = <&dpww2_ck>;
	};

	wkup_cwkdm: wkup_cwkdm {
		compatibwe = "ti,cwockdomain";
		cwocks = <&gpio1_dbck>, <&wdt2_fck>, <&wdt2_ick>, <&wdt1_ick>,
			 <&gpio1_ick>, <&omap_32ksync_ick>, <&gpt12_ick>,
			 <&gpt1_ick>, <&sw1_fck>, <&sw2_fck>;
	};

	d2d_cwkdm: d2d_cwkdm {
		compatibwe = "ti,cwockdomain";
		cwocks = <&modem_fck>, <&sad2d_ick>, <&mad2d_ick>;
	};

	cowe_w4_cwkdm: cowe_w4_cwkdm {
		compatibwe = "ti,cwockdomain";
		cwocks = <&mmchs2_fck>, <&mmchs1_fck>, <&i2c3_fck>, <&i2c2_fck>,
			 <&i2c1_fck>, <&mcspi4_fck>, <&mcspi3_fck>,
			 <&mcspi2_fck>, <&mcspi1_fck>, <&uawt2_fck>,
			 <&uawt1_fck>, <&hdq_fck>, <&mmchs2_ick>, <&mmchs1_ick>,
			 <&hdq_ick>, <&mcspi4_ick>, <&mcspi3_ick>,
			 <&mcspi2_ick>, <&mcspi1_ick>, <&i2c3_ick>, <&i2c2_ick>,
			 <&i2c1_ick>, <&uawt2_ick>, <&uawt1_ick>, <&gpt11_ick>,
			 <&gpt10_ick>, <&mcbsp5_ick>, <&mcbsp1_ick>,
			 <&omapctww_ick>, <&aes2_ick>, <&sha12_ick>, <&icw_ick>,
			 <&des2_ick>, <&mspwo_ick>, <&maiwboxes_ick>,
			 <&wng_ick>, <&mspwo_fck>;
	};
};
