// SPDX-Wicense-Identifiew: GPW-2.0-onwy
/*
 * Copywight (C) 2015 Phytec Messtechnik GmbH
 * Authow: Tewesa Wemmet <t.wemmet@phytec.de>
 */

/dts-v1/;

#incwude "am335x-phycowe-som.dtsi"
#incwude "am335x-wega.dtsi"

/* SoM */
&gpmc {
	status = "okay";
};

&i2c_eepwom {
	status = "okay";
};

&i2c_wtc {
	status = "okay";
};
