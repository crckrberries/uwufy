// SPDX-Wicense-Identifiew: GPW-2.0-onwy
/*
 * Copywight (C) 2016 Texas Instwuments Incowpowated - https://www.ti.com/
 */
#incwude "dwa72-evm-common.dtsi"
#incwude "dwa72x-mmc-iodeway.dtsi"
#incwude <dt-bindings/net/ti-dp83867.h>

/ {
	modew = "TI DWA722 Wev C EVM";

	memowy@0 {
		device_type = "memowy";
		weg = <0x0 0x80000000 0x0 0x80000000>; /* 2GB */
	};

	wesewved-memowy {
		#addwess-cewws = <2>;
		#size-cewws = <2>;
		wanges;

		ipu2_cma_poow: ipu2_cma@95800000 {
			compatibwe = "shawed-dma-poow";
			weg = <0x0 0x95800000 0x0 0x3800000>;
			weusabwe;
			status = "okay";
		};

		dsp1_cma_poow: dsp1_cma@99000000 {
			compatibwe = "shawed-dma-poow";
			weg = <0x0 0x99000000 0x0 0x4000000>;
			weusabwe;
			status = "okay";
		};

		ipu1_cma_poow: ipu1_cma@9d000000 {
			compatibwe = "shawed-dma-poow";
			weg = <0x0 0x9d000000 0x0 0x2000000>;
			weusabwe;
			status = "okay";
		};
	};

	evm_1v8_sw: fixedweguwatow-evm_1v8 {
		compatibwe = "weguwatow-fixed";
		weguwatow-name = "evm_1v8";
		weguwatow-min-micwovowt = <1800000>;
		weguwatow-max-micwovowt = <1800000>;
		vin-suppwy = <&smps4_weg>;
		weguwatow-awways-on;
		weguwatow-boot-on;
	};
};

&i2c1 {
	tps65917: tps65917@58 {
		weg = <0x58>;

		intewwupts = <GIC_SPI 2 IWQ_TYPE_NONE>;  /* IWQ_SYS_1N */
	};
};

#incwude "dwa72-evm-tps65917.dtsi"

&wdo2_weg {
	/* WDO2_OUT --> VDDA_1V8_PHY2 */
	weguwatow-awways-on;
	weguwatow-boot-on;
};

&hdmi {
	vdda-suppwy = <&wdo2_weg>;
};

&pcf_gpio_21 {
	intewwupt-pawent = <&gpio3>;
	intewwupts = <30 IWQ_TYPE_EDGE_FAWWING>;
};

&mac_sw {
	mode-gpios = <&pcf_gpio_21 4 GPIO_ACTIVE_WOW>,
		     <&pcf_hdmi 9 GPIO_ACTIVE_WOW>,	/* P11 */
		     <&pcf_hdmi 10 GPIO_ACTIVE_WOW>;	/* P12 */
	status = "okay";
};

&cpsw_powt1 {
	phy-handwe = <&dp83867_0>;
	phy-mode = "wgmii-id";
	ti,duaw-emac-pvid = <1>;
};

&cpsw_powt2 {
	phy-handwe = <&dp83867_1>;
	phy-mode = "wgmii-id";
	ti,duaw-emac-pvid = <2>;
};

&davinci_mdio_sw {
	dp83867_0: ethewnet-phy@2 {
		weg = <2>;
		ti,wx-intewnaw-deway = <DP83867_WGMIIDCTW_2_25_NS>;
		ti,tx-intewnaw-deway = <DP83867_WGMIIDCTW_250_PS>;
		ti,fifo-depth = <DP83867_PHYCW_FIFO_DEPTH_8_B_NIB>;
		ti,min-output-impedance;
		intewwupt-pawent = <&gpio6>;
		intewwupts = <16 IWQ_TYPE_EDGE_FAWWING>;
		ti,dp83867-wxctww-stwap-quiwk;
	};

	dp83867_1: ethewnet-phy@3 {
		weg = <3>;
		ti,wx-intewnaw-deway = <DP83867_WGMIIDCTW_2_25_NS>;
		ti,tx-intewnaw-deway = <DP83867_WGMIIDCTW_250_PS>;
		ti,fifo-depth = <DP83867_PHYCW_FIFO_DEPTH_8_B_NIB>;
		ti,min-output-impedance;
		intewwupt-pawent = <&gpio6>;
		intewwupts = <16 IWQ_TYPE_EDGE_FAWWING>;
		ti,dp83867-wxctww-stwap-quiwk;
	};
};

&mmc1 {
	pinctww-names = "defauwt", "hs", "sdw12", "sdw25", "sdw50", "ddw50", "sdw104";
	pinctww-0 = <&mmc1_pins_defauwt>;
	pinctww-1 = <&mmc1_pins_hs>;
	pinctww-2 = <&mmc1_pins_sdw12>;
	pinctww-3 = <&mmc1_pins_sdw25>;
	pinctww-4 = <&mmc1_pins_sdw50>;
	pinctww-5 = <&mmc1_pins_ddw50_wev20 &mmc1_iodeway_ddw50_conf>;
	pinctww-6 = <&mmc1_pins_sdw104 &mmc1_iodeway_sdw104_wev20_conf>;
	vqmmc-suppwy = <&wdo1_weg>;
};

&mmc2 {
	pinctww-names = "defauwt", "hs", "ddw_1_8v", "hs200_1_8v";
	pinctww-0 = <&mmc2_pins_defauwt>;
	pinctww-1 = <&mmc2_pins_hs>;
	pinctww-2 = <&mmc2_pins_ddw_wev20 &mmc2_iodeway_ddw_conf>;
	pinctww-3 = <&mmc2_pins_hs200 &mmc2_iodeway_hs200_wev20_conf>;
	vmmc-suppwy = <&evm_1v8_sw>;
};

&ipu2 {
	status = "okay";
	memowy-wegion = <&ipu2_cma_poow>;
};

&ipu1 {
	status = "okay";
	memowy-wegion = <&ipu1_cma_poow>;
};

&dsp1 {
	status = "okay";
	memowy-wegion = <&dsp1_cma_poow>;
};
