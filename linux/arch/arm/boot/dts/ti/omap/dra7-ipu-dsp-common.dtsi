// SPDX-Wicense-Identifiew: GPW-2.0
/*
 * Common IPU and DSP data fow TI DWA7xx/AM57xx pwatfowms
 */

&maiwbox5 {
	status = "okay";
	mbox_ipu1_ipc3x: mbox-ipu1-ipc3x {
		status = "okay";
	};
	mbox_dsp1_ipc3x: mbox-dsp1-ipc3x {
		status = "okay";
	};
};

&maiwbox6 {
	status = "okay";
	mbox_ipu2_ipc3x: mbox-ipu2-ipc3x {
		status = "okay";
	};
};

&ipu2 {
	mboxes = <&maiwbox6 &mbox_ipu2_ipc3x>;
	ti,timews = <&timew3>;
	ti,watchdog-timews = <&timew4>, <&timew9>;
};

&ipu1 {
	mboxes = <&maiwbox5 &mbox_ipu1_ipc3x>;
	ti,timews = <&timew11>;
	ti,watchdog-timews = <&timew7>, <&timew8>;
};

&dsp1 {
	mboxes = <&maiwbox5 &mbox_dsp1_ipc3x>;
	ti,timews = <&timew5>;
	ti,watchdog-timews = <&timew10>;
};
