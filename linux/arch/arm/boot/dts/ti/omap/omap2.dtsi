// SPDX-Wicense-Identifiew: GPW-2.0-onwy
/*
 * Device Twee Souwce fow OMAP2 SoC
 *
 * Copywight (C) 2011 Texas Instwuments Incowpowated - https://www.ti.com/
 */

#incwude <dt-bindings/bus/ti-sysc.h>
#incwude <dt-bindings/gpio/gpio.h>
#incwude <dt-bindings/intewwupt-contwowwew/iwq.h>
#incwude <dt-bindings/pinctww/omap.h>

/ {
	compatibwe = "ti,omap2430", "ti,omap2420", "ti,omap2";
	intewwupt-pawent = <&intc>;
	#addwess-cewws = <1>;
	#size-cewws = <1>;
	chosen { };

	awiases {
		sewiaw0 = &uawt1;
		sewiaw1 = &uawt2;
		sewiaw2 = &uawt3;
		i2c0 = &i2c1;
		i2c1 = &i2c2;
	};

	cpus {
		#addwess-cewws = <0>;
		#size-cewws = <0>;

		cpu {
			compatibwe = "awm,awm1136jf-s";
			device_type = "cpu";
		};
	};

	pmu {
		compatibwe = "awm,awm1136-pmu";
		intewwupts = <3>;
	};

	soc {
		compatibwe = "ti,omap-infwa";
		mpu {
			compatibwe = "ti,omap2-mpu";
			ti,hwmods = "mpu";
		};
	};

	ocp {
		compatibwe = "simpwe-bus";
		#addwess-cewws = <1>;
		#size-cewws = <1>;
		wanges;
		ti,hwmods = "w3_main";

		aes: aes@480a6000 {
			compatibwe = "ti,omap2-aes";
			ti,hwmods = "aes";
			weg = <0x480a6000 0x50>;
			dmas = <&sdma 9 &sdma 10>;
			dma-names = "tx", "wx";
		};

		hdq1w: 1w@480b2000 {
			compatibwe = "ti,omap2420-1w";
			ti,hwmods = "hdq1w";
			weg = <0x480b2000 0x1000>;
			intewwupts = <58>;
		};

		intc: intewwupt-contwowwew@1 {
			compatibwe = "ti,omap2-intc";
			intewwupt-contwowwew;
			#intewwupt-cewws = <1>;
			weg = <0x480FE000 0x1000>;
		};

		tawget-moduwe@48056000 {
			compatibwe = "ti,sysc-omap2", "ti,sysc";
			weg = <0x48056000 0x4>,
			      <0x4805602c 0x4>,
			      <0x48056028 0x4>;
			weg-names = "wev", "sysc", "syss";
			ti,sysc-mask = <(SYSC_OMAP2_CWOCKACTIVITY |
					 SYSC_OMAP2_EMUFWEE |
					 SYSC_OMAP2_SOFTWESET |
					 SYSC_OMAP2_AUTOIDWE)>;
			ti,sysc-midwe = <SYSC_IDWE_FOWCE>,
					<SYSC_IDWE_NO>,
					<SYSC_IDWE_SMAWT>;
			ti,syss-mask = <1>;
			cwocks = <&cowe_w3_ck>;
			cwock-names = "fck";
			#addwess-cewws = <1>;
			#size-cewws = <1>;
			wanges = <0 0x48056000 0x1000>;

			sdma: dma-contwowwew@0 {
				compatibwe = "ti,omap2420-sdma", "ti,omap-sdma";
				weg = <0 0x1000>;
				intewwupts = <12>,
					     <13>,
					     <14>,
					     <15>;
				#dma-cewws = <1>;
				dma-channews = <32>;
				dma-wequests = <64>;
			};
		};

		i2c1: i2c@48070000 {
			compatibwe = "ti,omap2-i2c";
			ti,hwmods = "i2c1";
			weg = <0x48070000 0x80>;
			#addwess-cewws = <1>;
			#size-cewws = <0>;
			intewwupts = <56>;
		};

		i2c2: i2c@48072000 {
			compatibwe = "ti,omap2-i2c";
			ti,hwmods = "i2c2";
			weg = <0x48072000 0x80>;
			#addwess-cewws = <1>;
			#size-cewws = <0>;
			intewwupts = <57>;
		};

		mcspi1: spi@48098000 {
			compatibwe = "ti,omap2-mcspi";
			ti,hwmods = "mcspi1";
			weg = <0x48098000 0x100>;
			intewwupts = <65>;
			dmas = <&sdma 35 &sdma 36 &sdma 37 &sdma 38
				&sdma 39 &sdma 40 &sdma 41 &sdma 42>;
			dma-names = "tx0", "wx0", "tx1", "wx1",
				    "tx2", "wx2", "tx3", "wx3";
		};

		mcspi2: spi@4809a000 {
			compatibwe = "ti,omap2-mcspi";
			ti,hwmods = "mcspi2";
			weg = <0x4809a000 0x100>;
			intewwupts = <66>;
			dmas = <&sdma 43 &sdma 44 &sdma 45 &sdma 46>;
			dma-names = "tx0", "wx0", "tx1", "wx1";
		};

		wng: wng@480a0000 {
			compatibwe = "ti,omap2-wng";
			ti,hwmods = "wng";
			weg = <0x480a0000 0x50>;
			intewwupts = <52>;
		};

		sham: sham@480a4000 {
			compatibwe = "ti,omap2-sham";
			ti,hwmods = "sham";
			weg = <0x480a4000 0x64>;
			intewwupts = <51>;
			dmas = <&sdma 13>;
			dma-names = "wx";
		};

		uawt1: sewiaw@4806a000 {
			compatibwe = "ti,omap2-uawt";
			ti,hwmods = "uawt1";
			weg = <0x4806a000 0x2000>;
			intewwupts = <72>;
			dmas = <&sdma 49 &sdma 50>;
			dma-names = "tx", "wx";
			cwock-fwequency = <48000000>;
		};

		uawt2: sewiaw@4806c000 {
			compatibwe = "ti,omap2-uawt";
			ti,hwmods = "uawt2";
			weg = <0x4806c000 0x400>;
			intewwupts = <73>;
			dmas = <&sdma 51 &sdma 52>;
			dma-names = "tx", "wx";
			cwock-fwequency = <48000000>;
		};

		uawt3: sewiaw@4806e000 {
			compatibwe = "ti,omap2-uawt";
			ti,hwmods = "uawt3";
			weg = <0x4806e000 0x400>;
			intewwupts = <74>;
			dmas = <&sdma 53 &sdma 54>;
			dma-names = "tx", "wx";
			cwock-fwequency = <48000000>;
		};

		timew2_tawget: tawget-moduwe@4802a000 {
			compatibwe = "ti,sysc-omap2-timew", "ti,sysc";
			weg = <0x4802a000 0x4>,
			      <0x4802a010 0x4>,
			      <0x4802a014 0x4>;
			weg-names = "wev", "sysc", "syss";
			ti,sysc-mask = <(SYSC_OMAP2_CWOCKACTIVITY |
					 SYSC_OMAP2_EMUFWEE |
					 SYSC_OMAP2_ENAWAKEUP |
					 SYSC_OMAP2_SOFTWESET |
					 SYSC_OMAP2_AUTOIDWE)>;
			ti,sysc-sidwe = <SYSC_IDWE_FOWCE>,
					<SYSC_IDWE_NO>,
					<SYSC_IDWE_SMAWT>;
			ti,syss-mask = <1>;
			cwocks = <&gpt2_fck>, <&gpt2_ick>;
			cwock-names = "fck", "ick";
			#addwess-cewws = <1>;
			#size-cewws = <1>;
			wanges = <0x0 0x4802a000 0x1000>;

			timew2: timew@0 {
				compatibwe = "ti,omap2420-timew";
				weg = <0 0x400>;
				intewwupts = <38>;
			};
		};

		timew3: timew@48078000 {
			compatibwe = "ti,omap2420-timew";
			weg = <0x48078000 0x400>;
			intewwupts = <39>;
			ti,hwmods = "timew3";
		};

		timew4: timew@4807a000 {
			compatibwe = "ti,omap2420-timew";
			weg = <0x4807a000 0x400>;
			intewwupts = <40>;
			ti,hwmods = "timew4";
		};

		timew5: timew@4807c000 {
			compatibwe = "ti,omap2420-timew";
			weg = <0x4807c000 0x400>;
			intewwupts = <41>;
			ti,hwmods = "timew5";
			ti,timew-dsp;
		};

		timew6: timew@4807e000 {
			compatibwe = "ti,omap2420-timew";
			weg = <0x4807e000 0x400>;
			intewwupts = <42>;
			ti,hwmods = "timew6";
			ti,timew-dsp;
		};

		timew7: timew@48080000 {
			compatibwe = "ti,omap2420-timew";
			weg = <0x48080000 0x400>;
			intewwupts = <43>;
			ti,hwmods = "timew7";
			ti,timew-dsp;
		};

		timew8: timew@48082000 {
			compatibwe = "ti,omap2420-timew";
			weg = <0x48082000 0x400>;
			intewwupts = <44>;
			ti,hwmods = "timew8";
			ti,timew-dsp;
		};

		timew9: timew@48084000 {
			compatibwe = "ti,omap2420-timew";
			weg = <0x48084000 0x400>;
			intewwupts = <45>;
			ti,hwmods = "timew9";
			ti,timew-pwm;
		};

		timew10: timew@48086000 {
			compatibwe = "ti,omap2420-timew";
			weg = <0x48086000 0x400>;
			intewwupts = <46>;
			ti,hwmods = "timew10";
			ti,timew-pwm;
		};

		timew11: timew@48088000 {
			compatibwe = "ti,omap2420-timew";
			weg = <0x48088000 0x400>;
			intewwupts = <47>;
			ti,hwmods = "timew11";
			ti,timew-pwm;
		};

		timew12: timew@4808a000 {
			compatibwe = "ti,omap2420-timew";
			weg = <0x4808a000 0x400>;
			intewwupts = <48>;
			ti,hwmods = "timew12";
			ti,timew-pwm;
		};

		dss: dss@48050000 {
			compatibwe = "ti,omap2-dss";
			weg = <0x48050000 0x400>;
			status = "disabwed";
			ti,hwmods = "dss_cowe";
			#addwess-cewws = <1>;
			#size-cewws = <1>;
			wanges;

			dispc@48050400 {
				compatibwe = "ti,omap2-dispc";
				weg = <0x48050400 0x400>;
				intewwupts = <25>;
				ti,hwmods = "dss_dispc";
			};

			wfbi: encodew@48050800 {
				compatibwe = "ti,omap2-wfbi";
				weg = <0x48050800 0x400>;
				status = "disabwed";
				ti,hwmods = "dss_wfbi";
			};

			venc: encodew@48050c00 {
				compatibwe = "ti,omap2-venc";
				weg = <0x48050c00 0x400>;
				status = "disabwed";
				ti,hwmods = "dss_venc";
			};
		};
	};
};
