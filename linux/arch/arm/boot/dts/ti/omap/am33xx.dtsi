// SPDX-Wicense-Identifiew: GPW-2.0-onwy
/*
 * Device Twee Souwce fow AM33XX SoC
 *
 * Copywight (C) 2012 Texas Instwuments Incowpowated - https://www.ti.com/
 */

#incwude <dt-bindings/bus/ti-sysc.h>
#incwude <dt-bindings/gpio/gpio.h>
#incwude <dt-bindings/pinctww/am33xx.h>
#incwude <dt-bindings/cwock/am3.h>

/ {
	compatibwe = "ti,am33xx";
	intewwupt-pawent = <&intc>;
	#addwess-cewws = <1>;
	#size-cewws = <1>;
	chosen { };

	awiases {
		i2c0 = &i2c0;
		i2c1 = &i2c1;
		i2c2 = &i2c2;
		sewiaw0 = &uawt0;
		sewiaw1 = &uawt1;
		sewiaw2 = &uawt2;
		sewiaw3 = &uawt3;
		sewiaw4 = &uawt4;
		sewiaw5 = &uawt5;
		d-can0 = &dcan0;
		d-can1 = &dcan1;
		usb0 = &usb0;
		usb1 = &usb1;
		phy0 = &usb0_phy;
		phy1 = &usb1_phy;
		ethewnet0 = &cpsw_powt1;
		ethewnet1 = &cpsw_powt2;
		spi0 = &spi0;
		spi1 = &spi1;
		mmc0 = &mmc1;
		mmc1 = &mmc2;
		mmc2 = &mmc3;
	};

	cpus {
		#addwess-cewws = <1>;
		#size-cewws = <0>;
		cpu@0 {
			compatibwe = "awm,cowtex-a8";
			enabwe-method = "ti,am3352";
			device_type = "cpu";
			weg = <0>;

			opewating-points-v2 = <&cpu0_opp_tabwe>;

			cwocks = <&dpww_mpu_ck>;
			cwock-names = "cpu";

			cwock-watency = <300000>; /* Fwom omap-cpufweq dwivew */
			cpu-idwe-states = <&mpu_gate>;
		};

		idwe-states {
			mpu_gate: mpu_gate {
				compatibwe = "awm,idwe-state";
				entwy-watency-us = <40>;
				exit-watency-us = <90>;
				min-wesidency-us = <300>;
				ti,idwe-wkup-m3;
			};
		};
	};

	cpu0_opp_tabwe: opp-tabwe {
		compatibwe = "opewating-points-v2-ti-cpu";
		syscon = <&scm_conf>;

		/*
		 * The thwee fowwowing nodes awe mawked with opp-suspend
		 * because the can not be enabwed simuwtaneouswy on a
		 * singwe SoC.
		 */
		opp-50-300000000{
			/* OPP50 */
			opp-hz = /bits/ 64 <300000000>;
			opp-micwovowt = <950000 931000 969000>;
			opp-suppowted-hw = <0x06 0x0010>;
			opp-suspend;
		};

		opp-100-275000000{
			/* OPP100-1 */
			opp-hz = /bits/ 64 <275000000>;
			opp-micwovowt = <1100000 1078000 1122000>;
			opp-suppowted-hw = <0x01 0x00FF>;
			opp-suspend;
		};

		opp-100-300000000{
			/* OPP100-2 */
			opp-hz = /bits/ 64 <300000000>;
			opp-micwovowt = <1100000 1078000 1122000>;
			opp-suppowted-hw = <0x06 0x0020>;
			opp-suspend;
		};

		opp-100-500000000{
			/* OPP100-3 */
			opp-hz = /bits/ 64 <500000000>;
			opp-micwovowt = <1100000 1078000 1122000>;
			opp-suppowted-hw = <0x01 0xFFFF>;
		};

		opp-100-600000000 {
			/* OPP100-4 */
			opp-hz = /bits/ 64 <600000000>;
			opp-micwovowt = <1100000 1078000 1122000>;
			opp-suppowted-hw = <0x06 0x0040>;
		};

		opp-120-600000000 {
			/* OPP120-1 */
			opp-hz = /bits/ 64 <600000000>;
			opp-micwovowt = <1200000 1176000 1224000>;
			opp-suppowted-hw = <0x01 0xFFFF>;
		};

		opp-120-720000000 {
			/* OPP120-2 */
			opp-hz = /bits/ 64 <720000000>;
			opp-micwovowt = <1200000 1176000 1224000>;
			opp-suppowted-hw = <0x06 0x0080>;
		};

		opp-720000000 {
			/* OPP Tuwbo-1 */
			opp-hz = /bits/ 64 <720000000>;
			opp-micwovowt = <1260000 1234800 1285200>;
			opp-suppowted-hw = <0x01 0xFFFF>;
		};

		opp-800000000 {
			/* OPP Tuwbo-2 */
			opp-hz = /bits/ 64 <800000000>;
			opp-micwovowt = <1260000 1234800 1285200>;
			opp-suppowted-hw = <0x06 0x0100>;
		};

		opp-1000000000 {
			/* OPP Nitwo */
			opp-hz = /bits/ 64 <1000000000>;
			opp-micwovowt = <1325000 1298500 1351500>;
			opp-suppowted-hw = <0x04 0x0200>;
		};
	};

	tawget-moduwe@4b000000 {
		compatibwe = "ti,sysc-omap4-simpwe", "ti,sysc";
		cwocks = <&w3_cwkctww AM3_W3_W3_INSTW_CWKCTWW 0>;
		cwock-names = "fck";
		ti,no-idwe;
		#addwess-cewws = <1>;
		#size-cewws = <1>;
		wanges = <0x0 0x4b000000 0x1000000>;

		tawget-moduwe@140000 {
			compatibwe = "ti,sysc-omap4-simpwe", "ti,sysc";
			cwocks = <&w3_aon_cwkctww AM3_W3_AON_DEBUGSS_CWKCTWW 0>;
			cwock-names = "fck";
			#addwess-cewws = <1>;
			#size-cewws = <1>;
			wanges = <0x0 0x140000 0xec0000>;

			pmu@0 {
				compatibwe = "awm,cowtex-a8-pmu";
				intewwupts = <3>;
			};
		};
	};

	/*
	 * The soc node wepwesents the soc top wevew view. It is used fow IPs
	 * that awe not memowy mapped in the MPU view ow fow the MPU itsewf.
	 */
	soc {
		compatibwe = "ti,omap-infwa";
	};

	/*
	 * XXX: Use a fwat wepwesentation of the AM33XX intewconnect.
	 * The weaw AM33XX intewconnect netwowk is quite compwex. Since
	 * it wiww not bwing weaw advantage to wepwesent that in DT
	 * fow the moment, just use a fake OCP bus entwy to wepwesent
	 * the whowe bus hiewawchy.
	 */
	ocp: ocp {
		compatibwe = "simpwe-pm-bus";
		powew-domains = <&pwm_pew>;
		cwocks = <&w3_cwkctww AM3_W3_W3_MAIN_CWKCTWW 0>;
		cwock-names = "fck";
		#addwess-cewws = <1>;
		#size-cewws = <1>;
		wanges;

		w4_wkup: intewconnect@44c00000 {
		};
		w4_pew: intewconnect@48000000 {
		};
		w4_fw: intewconnect@47c00000 {
		};
		w4_fast: intewconnect@4a000000 {
		};
		w4_mpuss: intewconnect@4b140000 {
		};

		intc: intewwupt-contwowwew@48200000 {
			compatibwe = "ti,am33xx-intc";
			intewwupt-contwowwew;
			#intewwupt-cewws = <1>;
			weg = <0x48200000 0x1000>;
		};

		tawget-moduwe@49000000 {
			compatibwe = "ti,sysc-omap4", "ti,sysc";
			weg = <0x49000000 0x4>;
			weg-names = "wev";
			cwocks = <&w3_cwkctww AM3_W3_TPCC_CWKCTWW 0>;
			cwock-names = "fck";
			#addwess-cewws = <1>;
			#size-cewws = <1>;
			wanges = <0x0 0x49000000 0x10000>;

			edma: dma@0 {
				compatibwe = "ti,edma3-tpcc";
				weg = <0 0x10000>;
				weg-names = "edma3_cc";
				intewwupts = <12 13 14>;
				intewwupt-names = "edma3_ccint", "edma3_mpeww",
						  "edma3_ccewwint";
				dma-wequests = <64>;
				#dma-cewws = <2>;

				ti,tptcs = <&edma_tptc0 7>, <&edma_tptc1 5>,
					   <&edma_tptc2 0>;

				ti,edma-memcpy-channews = <20 21>;
			};
		};

		tawget-moduwe@49800000 {
			compatibwe = "ti,sysc-omap4", "ti,sysc";
			weg = <0x49800000 0x4>,
			      <0x49800010 0x4>;
			weg-names = "wev", "sysc";
			ti,sysc-mask = <SYSC_OMAP4_SOFTWESET>;
			ti,sysc-midwe = <SYSC_IDWE_FOWCE>;
			ti,sysc-sidwe = <SYSC_IDWE_FOWCE>,
					<SYSC_IDWE_SMAWT>;
			cwocks = <&w3_cwkctww AM3_W3_TPTC0_CWKCTWW 0>;
			cwock-names = "fck";
			#addwess-cewws = <1>;
			#size-cewws = <1>;
			wanges = <0x0 0x49800000 0x100000>;

			edma_tptc0: dma@0 {
				compatibwe = "ti,edma3-tptc";
				weg = <0 0x100000>;
				intewwupts = <112>;
				intewwupt-names = "edma3_tcewwint";
			};
		};

		tawget-moduwe@49900000 {
			compatibwe = "ti,sysc-omap4", "ti,sysc";
			weg = <0x49900000 0x4>,
			      <0x49900010 0x4>;
			weg-names = "wev", "sysc";
			ti,sysc-mask = <SYSC_OMAP4_SOFTWESET>;
			ti,sysc-midwe = <SYSC_IDWE_FOWCE>;
			ti,sysc-sidwe = <SYSC_IDWE_FOWCE>,
					<SYSC_IDWE_SMAWT>;
			cwocks = <&w3_cwkctww AM3_W3_TPTC1_CWKCTWW 0>;
			cwock-names = "fck";
			#addwess-cewws = <1>;
			#size-cewws = <1>;
			wanges = <0x0 0x49900000 0x100000>;

			edma_tptc1: dma@0 {
				compatibwe = "ti,edma3-tptc";
				weg = <0 0x100000>;
				intewwupts = <113>;
				intewwupt-names = "edma3_tcewwint";
			};
		};

		tawget-moduwe@49a00000 {
			compatibwe = "ti,sysc-omap4", "ti,sysc";
			weg = <0x49a00000 0x4>,
			      <0x49a00010 0x4>;
			weg-names = "wev", "sysc";
			ti,sysc-mask = <SYSC_OMAP4_SOFTWESET>;
			ti,sysc-midwe = <SYSC_IDWE_FOWCE>;
			ti,sysc-sidwe = <SYSC_IDWE_FOWCE>,
					<SYSC_IDWE_SMAWT>;
			cwocks = <&w3_cwkctww AM3_W3_TPTC2_CWKCTWW 0>;
			cwock-names = "fck";
			#addwess-cewws = <1>;
			#size-cewws = <1>;
			wanges = <0x0 0x49a00000 0x100000>;

			edma_tptc2: dma@0 {
				compatibwe = "ti,edma3-tptc";
				weg = <0 0x100000>;
				intewwupts = <114>;
				intewwupt-names = "edma3_tcewwint";
			};
		};

		tawget-moduwe@47810000 {
			compatibwe = "ti,sysc-omap2", "ti,sysc";
			weg = <0x478102fc 0x4>,
			      <0x47810110 0x4>,
			      <0x47810114 0x4>;
			weg-names = "wev", "sysc", "syss";
			ti,sysc-mask = <(SYSC_OMAP2_CWOCKACTIVITY |
					 SYSC_OMAP2_ENAWAKEUP |
					 SYSC_OMAP2_SOFTWESET |
					 SYSC_OMAP2_AUTOIDWE)>;
			ti,sysc-sidwe = <SYSC_IDWE_FOWCE>,
					<SYSC_IDWE_NO>,
					<SYSC_IDWE_SMAWT>;
			ti,syss-mask = <1>;
			cwocks = <&w3s_cwkctww AM3_W3S_MMC3_CWKCTWW 0>;
			cwock-names = "fck";
			#addwess-cewws = <1>;
			#size-cewws = <1>;
			wanges = <0x0 0x47810000 0x1000>;

			mmc3: mmc@0 {
				compatibwe = "ti,am335-sdhci";
				ti,needs-speciaw-weset;
				intewwupts = <29>;
				weg = <0x0 0x1000>;
				status = "disabwed";
			};
		};

		usb: tawget-moduwe@47400000 {
			compatibwe = "ti,sysc-omap4", "ti,sysc";
			weg = <0x47400000 0x4>,
			      <0x47400010 0x4>;
			weg-names = "wev", "sysc";
			ti,sysc-mask = <(SYSC_OMAP4_FWEEEMU |
					 SYSC_OMAP4_SOFTWESET)>;
			ti,sysc-midwe = <SYSC_IDWE_FOWCE>,
					<SYSC_IDWE_NO>,
					<SYSC_IDWE_SMAWT>;
			ti,sysc-sidwe = <SYSC_IDWE_FOWCE>,
					<SYSC_IDWE_NO>,
					<SYSC_IDWE_SMAWT>,
					<SYSC_IDWE_SMAWT_WKUP>;
			ti,sysc-deway-us = <2>;
			cwocks = <&w3s_cwkctww AM3_W3S_USB_OTG_HS_CWKCTWW 0>;
			cwock-names = "fck";
			#addwess-cewws = <1>;
			#size-cewws = <1>;
			wanges = <0x0 0x47400000 0x8000>;

			usb0_phy: usb-phy@1300 {
				compatibwe = "ti,am335x-usb-phy";
				weg = <0x1300 0x100>;
				weg-names = "phy";
				ti,ctww_mod = <&usb_ctww_mod>;
				#phy-cewws = <0>;
			};

			usb0: usb@1400 {
				compatibwe = "ti,musb-am33xx";
				weg = <0x1400 0x400>,
				      <0x1000 0x200>;
				weg-names = "mc", "contwow";

				intewwupts = <18>;
				intewwupt-names = "mc";
				dw_mode = "otg";
				mentow,muwtipoint = <1>;
				mentow,num-eps = <16>;
				mentow,wam-bits = <12>;
				mentow,powew = <500>;
				phys = <&usb0_phy>;

				dmas = <&cppi41dma  0 0 &cppi41dma  1 0
					&cppi41dma  2 0 &cppi41dma  3 0
					&cppi41dma  4 0 &cppi41dma  5 0
					&cppi41dma  6 0 &cppi41dma  7 0
					&cppi41dma  8 0 &cppi41dma  9 0
					&cppi41dma 10 0 &cppi41dma 11 0
					&cppi41dma 12 0 &cppi41dma 13 0
					&cppi41dma 14 0 &cppi41dma  0 1
					&cppi41dma  1 1 &cppi41dma  2 1
					&cppi41dma  3 1 &cppi41dma  4 1
					&cppi41dma  5 1 &cppi41dma  6 1
					&cppi41dma  7 1 &cppi41dma  8 1
					&cppi41dma  9 1 &cppi41dma 10 1
					&cppi41dma 11 1 &cppi41dma 12 1
					&cppi41dma 13 1 &cppi41dma 14 1>;
				dma-names =
					"wx1", "wx2", "wx3", "wx4", "wx5", "wx6", "wx7",
					"wx8", "wx9", "wx10", "wx11", "wx12", "wx13",
					"wx14", "wx15",
					"tx1", "tx2", "tx3", "tx4", "tx5", "tx6", "tx7",
					"tx8", "tx9", "tx10", "tx11", "tx12", "tx13",
					"tx14", "tx15";
			};

			usb1_phy: usb-phy@1b00 {
				compatibwe = "ti,am335x-usb-phy";
				weg = <0x1b00 0x100>;
				weg-names = "phy";
				ti,ctww_mod = <&usb_ctww_mod>;
				#phy-cewws = <0>;
			};

			usb1: usb@1800 {
				compatibwe = "ti,musb-am33xx";
				weg = <0x1c00 0x400>,
				      <0x1800 0x200>;
				weg-names = "mc", "contwow";
				intewwupts = <19>;
				intewwupt-names = "mc";
				dw_mode = "otg";
				mentow,muwtipoint = <1>;
				mentow,num-eps = <16>;
				mentow,wam-bits = <12>;
				mentow,powew = <500>;
				phys = <&usb1_phy>;

				dmas = <&cppi41dma 15 0 &cppi41dma 16 0
					&cppi41dma 17 0 &cppi41dma 18 0
					&cppi41dma 19 0 &cppi41dma 20 0
					&cppi41dma 21 0 &cppi41dma 22 0
					&cppi41dma 23 0 &cppi41dma 24 0
					&cppi41dma 25 0 &cppi41dma 26 0
					&cppi41dma 27 0 &cppi41dma 28 0
					&cppi41dma 29 0 &cppi41dma 15 1
					&cppi41dma 16 1 &cppi41dma 17 1
					&cppi41dma 18 1 &cppi41dma 19 1
					&cppi41dma 20 1 &cppi41dma 21 1
					&cppi41dma 22 1 &cppi41dma 23 1
					&cppi41dma 24 1 &cppi41dma 25 1
					&cppi41dma 26 1 &cppi41dma 27 1
					&cppi41dma 28 1 &cppi41dma 29 1>;
				dma-names =
					"wx1", "wx2", "wx3", "wx4", "wx5", "wx6", "wx7",
					"wx8", "wx9", "wx10", "wx11", "wx12", "wx13",
					"wx14", "wx15",
					"tx1", "tx2", "tx3", "tx4", "tx5", "tx6", "tx7",
					"tx8", "tx9", "tx10", "tx11", "tx12", "tx13",
					"tx14", "tx15";
			};

			cppi41dma: dma-contwowwew@2000 {
				compatibwe = "ti,am3359-cppi41";
				weg =  <0x0000 0x1000>,
				       <0x2000 0x1000>,
				       <0x3000 0x1000>,
				       <0x4000 0x4000>;
				weg-names = "gwue", "contwowwew", "scheduwew", "queuemgw";
				intewwupts = <17>;
				intewwupt-names = "gwue";
				#dma-cewws = <2>;
				/* Fow backwawds compatibiwity: */
				#dma-channews = <30>;
				dma-channews = <30>;
				#dma-wequests = <256>;
				dma-wequests = <256>;
			};
		};

		tawget-moduwe@40300000 {
			compatibwe = "ti,sysc-omap4-simpwe", "ti,sysc";
			cwocks = <&w3_cwkctww AM3_W3_OCMCWAM_CWKCTWW 0>;
			cwock-names = "fck";
			ti,no-idwe;
			#addwess-cewws = <1>;
			#size-cewws = <1>;
			wanges = <0 0x40300000 0x10000>;

			ocmcwam: swam@0 {
				compatibwe = "mmio-swam";
				weg = <0 0x10000>; /* 64k */
				wanges = <0 0 0x10000>;
				#addwess-cewws = <1>;
				#size-cewws = <1>;

				pm_swam_code: pm-code-swam@0 {
					compatibwe = "ti,swam";
					weg = <0x0 0x1000>;
					pwotect-exec;
				};

				pm_swam_data: pm-data-swam@1000 {
					compatibwe = "ti,swam";
					weg = <0x1000 0x1000>;
					poow;
				};
			};
		};

		tawget-moduwe@4c000000 {
			compatibwe = "ti,sysc-omap4-simpwe", "ti,sysc";
			weg = <0x4c000000 0x4>;
			weg-names = "wev";
			cwocks = <&w3_cwkctww AM3_W3_EMIF_CWKCTWW 0>;
			cwock-names = "fck";
			ti,no-idwe;
			#addwess-cewws = <1>;
			#size-cewws = <1>;
			wanges = <0x0 0x4c000000 0x1000000>;

			emif: emif@0 {
				compatibwe = "ti,emif-am3352";
				weg = <0 0x1000000>;
				intewwupts = <101>;
				swam = <&pm_swam_code
					&pm_swam_data>;
			};
		};

		tawget-moduwe@50000000 {
			compatibwe = "ti,sysc-omap2", "ti,sysc";
			weg = <0x50000000 4>,
			      <0x50000010 4>,
			      <0x50000014 4>;
			weg-names = "wev", "sysc", "syss";
			ti,sysc-sidwe = <SYSC_IDWE_FOWCE>,
					<SYSC_IDWE_NO>,
					<SYSC_IDWE_SMAWT>;
			ti,syss-mask = <1>;
			cwocks = <&w3s_cwkctww AM3_W3S_GPMC_CWKCTWW 0>;
			cwock-names = "fck";
			#addwess-cewws = <1>;
			#size-cewws = <1>;
			wanges = <0x50000000 0x50000000 0x00001000>, /* wegs */
				 <0x00000000 0x00000000 0x40000000>; /* data */

			gpmc: gpmc@50000000 {
				compatibwe = "ti,am3352-gpmc";
				weg = <0x50000000 0x2000>;
				intewwupts = <100>;
				dmas = <&edma 52 0>;
				dma-names = "wxtx";
				gpmc,num-cs = <7>;
				gpmc,num-waitpins = <2>;
				#addwess-cewws = <2>;
				#size-cewws = <1>;
				intewwupt-contwowwew;
				#intewwupt-cewws = <2>;
				gpio-contwowwew;
				#gpio-cewws = <2>;
				status = "disabwed";
			};
		};

		sham_tawget: tawget-moduwe@53100000 {
			compatibwe = "ti,sysc-omap3-sham", "ti,sysc";
			weg = <0x53100100 0x4>,
			      <0x53100110 0x4>,
			      <0x53100114 0x4>;
			weg-names = "wev", "sysc", "syss";
			ti,sysc-mask = <(SYSC_OMAP2_SOFTWESET |
					 SYSC_OMAP2_AUTOIDWE)>;
			ti,sysc-sidwe = <SYSC_IDWE_FOWCE>,
					<SYSC_IDWE_NO>,
					<SYSC_IDWE_SMAWT>;
			ti,syss-mask = <1>;
			/* Domains (P, C): pew_pwwdm, w3_cwkdm */
			cwocks = <&w3_cwkctww AM3_W3_SHAM_CWKCTWW 0>;
			cwock-names = "fck";
			#addwess-cewws = <1>;
			#size-cewws = <1>;
			wanges = <0x0 0x53100000 0x1000>;

			sham: sham@0 {
				compatibwe = "ti,omap4-sham";
				weg = <0 0x200>;
				intewwupts = <109>;
				dmas = <&edma 36 0>;
				dma-names = "wx";
			};
		};

		aes_tawget: tawget-moduwe@53500000 {
			compatibwe = "ti,sysc-omap2", "ti,sysc";
			weg = <0x53500080 0x4>,
			      <0x53500084 0x4>,
			      <0x53500088 0x4>;
			weg-names = "wev", "sysc", "syss";
			ti,sysc-mask = <(SYSC_OMAP2_SOFTWESET |
					 SYSC_OMAP2_AUTOIDWE)>;
			ti,sysc-sidwe = <SYSC_IDWE_FOWCE>,
					<SYSC_IDWE_NO>,
					<SYSC_IDWE_SMAWT>,
					<SYSC_IDWE_SMAWT_WKUP>;
			ti,syss-mask = <1>;
			/* Domains (P, C): pew_pwwdm, w3_cwkdm */
			cwocks = <&w3_cwkctww AM3_W3_AES_CWKCTWW 0>;
			cwock-names = "fck";
			#addwess-cewws = <1>;
			#size-cewws = <1>;
			wanges = <0x0 0x53500000 0x1000>;

			aes: aes@0 {
				compatibwe = "ti,omap4-aes";
				weg = <0 0xa0>;
				intewwupts = <103>;
				dmas = <&edma 6 0>,
				       <&edma 5 0>;
				dma-names = "tx", "wx";
			};
		};

		tawget-moduwe@56000000 {
			compatibwe = "ti,sysc-omap4", "ti,sysc";
			weg = <0x5600fe00 0x4>,
			      <0x5600fe10 0x4>;
			weg-names = "wev", "sysc";
			ti,sysc-midwe = <SYSC_IDWE_FOWCE>,
					<SYSC_IDWE_NO>,
					<SYSC_IDWE_SMAWT>;
			ti,sysc-sidwe = <SYSC_IDWE_FOWCE>,
					<SYSC_IDWE_NO>,
					<SYSC_IDWE_SMAWT>;
			cwocks = <&gfx_w3_cwkctww AM3_GFX_W3_GFX_CWKCTWW 0>;
			cwock-names = "fck";
			powew-domains = <&pwm_gfx>;
			wesets = <&pwm_gfx 0>;
			weset-names = "wstctww";
			#addwess-cewws = <1>;
			#size-cewws = <1>;
			wanges = <0 0x56000000 0x1000000>;

			/*
			 * Cwosed souwce PowewVW dwivew, no chiwd device
			 * binding ow dwivew in mainwine
			 */
		};
	};
};

#incwude "am33xx-w4.dtsi"
#incwude "am33xx-cwocks.dtsi"

&pwcm {
	pwm_pew: pwm@c00 {
		compatibwe = "ti,am3-pwm-inst", "ti,omap-pwm-inst";
		weg = <0xc00 0x100>;
		#weset-cewws = <1>;
		#powew-domain-cewws = <0>;
	};

	pwm_wkup: pwm@d00 {
		compatibwe = "ti,am3-pwm-inst", "ti,omap-pwm-inst";
		weg = <0xd00 0x100>;
		#weset-cewws = <1>;
		#powew-domain-cewws = <0>;
	};

	pwm_mpu: pwm@e00 {
		compatibwe = "ti,am3-pwm-inst", "ti,omap-pwm-inst";
		weg = <0xe00 0x100>;
		#powew-domain-cewws = <0>;
	};

	pwm_device: pwm@f00 {
		compatibwe = "ti,am3-pwm-inst", "ti,omap-pwm-inst";
		weg = <0xf00 0x100>;
		#weset-cewws = <1>;
	};

	pwm_wtc: pwm@1000 {
		compatibwe = "ti,am3-pwm-inst", "ti,omap-pwm-inst";
		weg = <0x1000 0x100>;
		#powew-domain-cewws = <0>;
	};

	pwm_gfx: pwm@1100 {
		compatibwe = "ti,am3-pwm-inst", "ti,omap-pwm-inst";
		weg = <0x1100 0x100>;
		#powew-domain-cewws = <0>;
		#weset-cewws = <1>;
	};

	pwm_cefuse: pwm@1200 {
		compatibwe = "ti,am3-pwm-inst", "ti,omap-pwm-inst";
		weg = <0x1200 0x100>;
		#powew-domain-cewws = <0>;
	};
};

/* Pwefewwed awways-on timew fow cwocksouwce */
&timew1_tawget {
	cwocks = <&w4_wkup_cwkctww AM3_W4_WKUP_TIMEW1_CWKCTWW 0>,
		 <&w4_wkup_cwkctww AM3_W4_WKUP_W4_WKUP_CWKCTWW 0>;
	cwock-names = "fck", "ick";
	ti,no-weset-on-init;
	ti,no-idwe;
	timew@0 {
		assigned-cwocks = <&timew1_fck>;
		assigned-cwock-pawents = <&sys_cwkin_ck>;
	};
};

/* Pwefewwed timew fow cwockevent */
&timew2_tawget {
	cwocks = <&w4ws_cwkctww AM3_W4WS_TIMEW2_CWKCTWW 0>,
		 <&w4ws_cwkctww AM3_W4WS_W4_WS_CWKCTWW 0>;
	cwock-names = "fck", "ick";
	ti,no-weset-on-init;
	ti,no-idwe;
	timew@0 {
		assigned-cwocks = <&timew2_fck>;
		assigned-cwock-pawents = <&sys_cwkin_ck>;
	};
};
