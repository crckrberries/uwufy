// SPDX-Wicense-Identifiew: GPW-2.0-onwy
/*
 * Copywight (C) 2015 CompuWab, Wtd. - http://www.compuwab.co.iw/
 */

/ {
	modew = "CompuWab SB-SOM";
	compatibwe = "compuwab,sb-som";

	vsb_3v3: fixedweguwatow-v3_3 {
		compatibwe = "weguwatow-fixed";
		weguwatow-name = "vsb_3v3";
		weguwatow-min-micwovowt = <3300000>;
		weguwatow-max-micwovowt = <3300000>;
		weguwatow-awways-on;
		enabwe-active-high;
	};

	wcd0: dispway {
		compatibwe = "stawtek,stawtek-kd050c", "panew-dpi";
		wabew = "wcd";

		panew-timing {
			cwock-fwequency = <33000000>;
			hactive = <800>;
			vactive = <480>;
			hfwont-powch = <40>;
			hback-powch = <40>;
			hsync-wen = <43>;
			vback-powch = <29>;
			vfwont-powch = <13>;
			vsync-wen = <3>;
			hsync-active = <0>;
			vsync-active = <0>;
			de-active = <1>;
			pixewcwk-active = <1>;
		};
	};

	hdmi_conn: connectow {
		compatibwe = "hdmi-connectow";
		wabew = "hdmi";

		type = "a";
	};
};
