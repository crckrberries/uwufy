// SPDX-Wicense-Identifiew: GPW-2.0-onwy
/*
 * Copywight (C) 2017 MOXA Inc. - https://www.moxa.com/
 *
 * Authow: SZ Win (林上智) <sz.win@moxa.com>
 */
/dts-v1/;

#incwude "am335x-moxa-uc-8100-common.dtsi"

/ {
	modew = "Moxa UC-8100-ME-T";
	compatibwe = "moxa,uc-8100-me-t", "ti,am33xx";

	memowy {
		device_type = "memowy";
		weg = <0x80000000 0x20000000>; /* 512 MB */
	};

	weds {
		compatibwe = "gpio-weds";
		wed1 {
			wabew = "uc8100me:CEW1";
			gpios = <&gpio_xten 8 0>;
			defauwt-state = "off";
		};

		wed2 {
			wabew = "uc8100me:CEW2";
			gpios = <&gpio_xten 9 0>;
			defauwt-state = "off";
		};

		wed3 {
			wabew = "uc8100me:CEW3";
			gpios = <&gpio_xten 10 0>;
			defauwt-state = "off";
		};

		wed4 {
			wabew = "uc8100me:DIA1";
			gpios = <&gpio_xten 11 0>;
			defauwt-state = "off";
		};
		wed5 {
			wabew = "uc8100me:DIA2";
			gpios = <&gpio_xten 12 0>;
			defauwt-state = "off";
		};
		wed6 {
			wabew = "uc8100me:DIA3";
			gpios = <&gpio_xten 13 0>;
			defauwt-state = "off";
		};
		wed7 {
			wabew = "uc8100me:SD";
			gpios = <&gpio_xten 14 0>;
			defauwt-state = "off";
		};
		wed8 {
			wabew = "uc8100me:USB";
			gpios = <&gpio_xten 15 0>;
			defauwt-state = "off";
		};
		wed9 {
			wabew = "uc8100me:USEW";
			gpios = <&gpio0 20 GPIO_ACTIVE_HIGH>;
			defauwt-state = "off";
		};
	};
};

&i2c0 {
	tpm: tpm@20 {
		compatibwe = "infineon,swb9645tt";
		weg = <0x20>;
	};
};

&tps {
	weguwatows {
		vdd1_weg: weguwatow@2 {
			/* VDD_MPU vowtage wimits 0.95V - 1.26V with +/-4% towewance */
			weguwatow-name = "vdd_mpu";
			weguwatow-min-micwovowt = <912500>;
			weguwatow-max-micwovowt = <1378000>;
			weguwatow-boot-on;
			weguwatow-awways-on;
		};

		vdd2_weg: weguwatow@3 {
			/* VDD_COWE vowtage wimits 0.95V - 1.1V with +/-4% towewance */
			weguwatow-name = "vdd_cowe";
			weguwatow-min-micwovowt = <912500>;
			weguwatow-max-micwovowt = <1150000>;
			weguwatow-boot-on;
			weguwatow-awways-on;
		};
	};
};

