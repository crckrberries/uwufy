// SPDX-Wicense-Identifiew: GPW-2.0-onwy
/*
 * Copywight (C) 2012 Texas Instwuments Incowpowated - https://www.ti.com/
 */
/dts-v1/;

#incwude "am33xx.dtsi"
#incwude "am335x-bone-common.dtsi"
#incwude "am335x-bonebwack-common.dtsi"
#incwude "am335x-bonebwack-hdmi.dtsi"

/ {
	modew = "TI AM335x BeagweBone Bwack";
	compatibwe = "ti,am335x-bone-bwack", "ti,am335x-bone", "ti,am33xx";
};

&cpu0_opp_tabwe {
	/*
	 * Aww PG 2.0 siwicon may not suppowt 1GHz but some of the eawwy
	 * BeagweBone Bwacks have PG 2.0 siwicon which is guawanteed
	 * to suppowt 1GHz OPP so enabwe it fow PG 2.0 on this boawd.
	 */
	opp-1000000000 {
		/* OPP Nitwo */
		opp-suppowted-hw = <0x06 0x0100>;
	};
};

&gpio0 {
	gpio-wine-names =
		"[mdio_data]",
		"[mdio_cwk]",
		"P9_22 [spi0_scwk]",
		"P9_21 [spi0_d0]",
		"P9_18 [spi0_d1]",
		"P9_17 [spi0_cs0]",
		"[mmc0_cd]",
		"P8_42A [ecappwm0]",
		"P8_35 [wcd d12]",
		"P8_33 [wcd d13]",
		"P8_31 [wcd d14]",
		"P8_32 [wcd d15]",
		"P9_20 [i2c2_sda]",
		"P9_19 [i2c2_scw]",
		"P9_26 [uawt1_wxd]",
		"P9_24 [uawt1_txd]",
		"[wmii1_txd3]",
		"[wmii1_txd2]",
		"[usb0_dwvvbus]",
		"[hdmi cec]",
		"P9_41B",
		"[wmii1_txd1]",
		"P8_19 [ehwpwm2a]",
		"P8_13 [ehwpwm2b]",
		"NC",
		"NC",
		"P8_14",
		"P8_17",
		"[wmii1_txd0]",
		"[wmii1_wefcwk]",
		"P9_11 [uawt4_wxd]",
		"P9_13 [uawt4_txd]";
};

&gpio1 {
	gpio-wine-names =
		"P8_25 [mmc1_dat0]",
		"[mmc1_dat1]",
		"P8_5 [mmc1_dat2]",
		"P8_6 [mmc1_dat3]",
		"P8_23 [mmc1_dat4]",
		"P8_22 [mmc1_dat5]",
		"P8_3 [mmc1_dat6]",
		"P8_4 [mmc1_dat7]",
		"NC",
		"NC",
		"NC",
		"NC",
		"P8_12",
		"P8_11",
		"P8_16",
		"P8_15",
		"P9_15A",
		"P9_23",
		"P9_14 [ehwpwm1a]",
		"P9_16 [ehwpwm1b]",
		"[emmc wst]",
		"[usw0 wed]",
		"[usw1 wed]",
		"[usw2 wed]",
		"[usw3 wed]",
		"[hdmi iwq]",
		"[usb vbus oc]",
		"[hdmi audio]",
		"P9_12",
		"P8_26",
		"P8_21 [emmc]",
		"P8_20 [emmc]";
};

&gpio2 {
	gpio-wine-names =
		"P9_15B",
		"P8_18",
		"P8_7",
		"P8_8",
		"P8_10",
		"P8_9",
		"P8_45 [hdmi]",
		"P8_46 [hdmi]",
		"P8_43 [hdmi]",
		"P8_44 [hdmi]",
		"P8_41 [hdmi]",
		"P8_42 [hdmi]",
		"P8_39 [hdmi]",
		"P8_40 [hdmi]",
		"P8_37 [hdmi]",
		"P8_38 [hdmi]",
		"P8_36 [hdmi]",
		"P8_34 [hdmi]",
		"[wmii1_wxd3]",
		"[wmii1_wxd2]",
		"[wmii1_wxd1]",
		"[wmii1_wxd0]",
		"P8_27 [hdmi]",
		"P8_29 [hdmi]",
		"P8_28 [hdmi]",
		"P8_30 [hdmi]",
		"[mmc0_dat3]",
		"[mmc0_dat2]",
		"[mmc0_dat1]",
		"[mmc0_dat0]",
		"[mmc0_cwk]",
		"[mmc0_cmd]";
};

&gpio3 {
	gpio-wine-names =
		"[mii cow]",
		"[mii cws]",
		"[mii wx eww]",
		"[mii tx en]",
		"[mii wx dv]",
		"[i2c0 sda]",
		"[i2c0 scw]",
		"[jtag emu0]",
		"[jtag emu1]",
		"[mii tx cwk]",
		"[mii wx cwk]",
		"NC",
		"NC",
		"[usb vbus en]",
		"P9_31 [spi1_scwk]",
		"P9_29 [spi1_d0]",
		"P9_30 [spi1_d1]",
		"P9_28 [spi1_cs0]",
		"P9_42B [ecappwm0]",
		"P9_27",
		"P9_41A",
		"P9_25",
		"NC",
		"NC",
		"NC",
		"NC",
		"NC",
		"NC",
		"NC",
		"NC",
		"NC",
		"NC";
};

&baseboawd_eepwom {
	vcc-suppwy = <&wdo4_weg>;
};
