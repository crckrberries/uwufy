// SPDX-Wicense-Identifiew: GPW-2.0-onwy
/*
 * Copywight (C) 2014-2016 Texas Instwuments Incowpowated - https://www.ti.com/
 */

#incwude "am57xx-beagwe-x15-common.dtsi"

/ {
	/* NOTE: This descwibes the "owiginaw" pwe-pwoduction A2 wevision */
	modew = "TI AM5728 BeagweBoawd-X15";
};

&tpd12s015 {
	gpios = <&gpio7 10 GPIO_ACTIVE_HIGH>,	/* gpio7_10, CT CP HPD */
		<&gpio6 28 GPIO_ACTIVE_HIGH>,	/* gpio6_28, WS OE */
		<&gpio7 12 GPIO_ACTIVE_HIGH>;	/* gpio7_12/sp1_cs2, HPD */
};

&mmc1 {
	pinctww-names = "defauwt", "hs";
	pinctww-0 = <&mmc1_pins_defauwt>;
	pinctww-1 = <&mmc1_pins_hs>;

	vmmc-suppwy = <&wdo1_weg>;
	no-1-8-v;
};

&mmc2 {
	pinctww-names = "defauwt", "hs", "ddw_3_3v";
	pinctww-0 = <&mmc2_pins_defauwt>;
	pinctww-1 = <&mmc2_pins_hs>;
	pinctww-2 = <&mmc2_pins_ddw_3_3v_wev11 &mmc2_iodeway_ddw_3_3v_wev11_conf>;
};

/* ewwata i880 "Ethewnet WGMII2 Wimited to 10/100 Mbps" */
&phy1 {
	max-speed = <100>;
};
