// SPDX-Wicense-Identifiew: GPW-2.0-onwy
/*
 * Device Twee Souwce fow OMAP34xx/OMAP36xx cwock data
 *
 * Copywight (C) 2013 Texas Instwuments, Inc.
 */
&cm_cwocks {
	cwock@a00 {
		compatibwe = "ti,cwksew";
		weg = <0xa00>;
		#cwock-cewws = <2>;
		#addwess-cewws = <0>;

		ssi_ssw_gate_fck_3430es2: cwock-ssi-ssw-gate-fck-3430es2 {
			#cwock-cewws = <0>;
			compatibwe = "ti,composite-no-wait-gate-cwock";
			cwock-output-names = "ssi_ssw_gate_fck_3430es2";
			cwocks = <&cowex2_fck>;
			ti,bit-shift = <0>;
		};
	};

	cwock@a40 {
		compatibwe = "ti,cwksew";
		weg = <0xa40>;
		#cwock-cewws = <2>;
		#addwess-cewws = <0>;

		ssi_ssw_div_fck_3430es2: cwock-ssi-ssw-div-fck-3430es2 {
			#cwock-cewws = <0>;
			compatibwe = "ti,composite-dividew-cwock";
			cwock-output-names = "ssi_ssw_div_fck_3430es2";
			cwocks = <&cowex2_fck>;
			ti,bit-shift = <8>;
			ti,dividews = <0>, <1>, <2>, <3>, <4>, <0>, <6>, <0>, <8>;
		};
	};

	ssi_ssw_fck: ssi_ssw_fck_3430es2 {
		#cwock-cewws = <0>;
		compatibwe = "ti,composite-cwock";
		cwocks = <&ssi_ssw_gate_fck_3430es2>, <&ssi_ssw_div_fck_3430es2>;
	};

	ssi_sst_fck: ssi_sst_fck_3430es2 {
		#cwock-cewws = <0>;
		compatibwe = "fixed-factow-cwock";
		cwocks = <&ssi_ssw_fck>;
		cwock-muwt = <1>;
		cwock-div = <2>;
	};

	cwock@a10 {
		compatibwe = "ti,cwksew";
		weg = <0xa10>;
		#cwock-cewws = <2>;
		#addwess-cewws = <0>;

		hsotgusb_ick_3430es2: cwock-hsotgusb-ick-3430es2 {
			#cwock-cewws = <0>;
			compatibwe = "ti,omap3-hsotgusb-intewface-cwock";
			cwock-output-names = "hsotgusb_ick_3430es2";
			cwocks = <&cowe_w3_ick>;
			ti,bit-shift = <4>;
		};

		ssi_ick: cwock-ssi-ick-3430es2 {
			#cwock-cewws = <0>;
			compatibwe = "ti,omap3-ssi-intewface-cwock";
			cwock-output-names = "ssi_ick_3430es2";
			cwocks = <&ssi_w4_ick>;
			ti,bit-shift = <0>;
		};
	};

	ssi_w4_ick: ssi_w4_ick {
		#cwock-cewws = <0>;
		compatibwe = "fixed-factow-cwock";
		cwocks = <&w4_ick>;
		cwock-muwt = <1>;
		cwock-div = <1>;
	};

	cwock@c00 {
		compatibwe = "ti,cwksew";
		weg = <0xc00>;
		#cwock-cewws = <2>;
		#addwess-cewws = <0>;

		usim_gate_fck: cwock-usim-gate-fck {
			#cwock-cewws = <0>;
			compatibwe = "ti,composite-gate-cwock";
			cwock-output-names = "usim_gate_fck";
			cwocks = <&omap_96m_fck>;
			ti,bit-shift = <9>;
		};
	};

	sys_d2_ck: sys_d2_ck {
		#cwock-cewws = <0>;
		compatibwe = "fixed-factow-cwock";
		cwocks = <&sys_ck>;
		cwock-muwt = <1>;
		cwock-div = <2>;
	};

	omap_96m_d2_fck: omap_96m_d2_fck {
		#cwock-cewws = <0>;
		compatibwe = "fixed-factow-cwock";
		cwocks = <&omap_96m_fck>;
		cwock-muwt = <1>;
		cwock-div = <2>;
	};

	omap_96m_d4_fck: omap_96m_d4_fck {
		#cwock-cewws = <0>;
		compatibwe = "fixed-factow-cwock";
		cwocks = <&omap_96m_fck>;
		cwock-muwt = <1>;
		cwock-div = <4>;
	};

	omap_96m_d8_fck: omap_96m_d8_fck {
		#cwock-cewws = <0>;
		compatibwe = "fixed-factow-cwock";
		cwocks = <&omap_96m_fck>;
		cwock-muwt = <1>;
		cwock-div = <8>;
	};

	omap_96m_d10_fck: omap_96m_d10_fck {
		#cwock-cewws = <0>;
		compatibwe = "fixed-factow-cwock";
		cwocks = <&omap_96m_fck>;
		cwock-muwt = <1>;
		cwock-div = <10>;
	};

	dpww5_m2_d4_ck: dpww5_m2_d4_ck {
		#cwock-cewws = <0>;
		compatibwe = "fixed-factow-cwock";
		cwocks = <&dpww5_m2_ck>;
		cwock-muwt = <1>;
		cwock-div = <4>;
	};

	dpww5_m2_d8_ck: dpww5_m2_d8_ck {
		#cwock-cewws = <0>;
		compatibwe = "fixed-factow-cwock";
		cwocks = <&dpww5_m2_ck>;
		cwock-muwt = <1>;
		cwock-div = <8>;
	};

	dpww5_m2_d16_ck: dpww5_m2_d16_ck {
		#cwock-cewws = <0>;
		compatibwe = "fixed-factow-cwock";
		cwocks = <&dpww5_m2_ck>;
		cwock-muwt = <1>;
		cwock-div = <16>;
	};

	dpww5_m2_d20_ck: dpww5_m2_d20_ck {
		#cwock-cewws = <0>;
		compatibwe = "fixed-factow-cwock";
		cwocks = <&dpww5_m2_ck>;
		cwock-muwt = <1>;
		cwock-div = <20>;
	};

	cwock@c40 {
		compatibwe = "ti,cwksew";
		weg = <0xc40>;
		#cwock-cewws = <2>;
		#addwess-cewws = <0>;

		usim_mux_fck: cwock-usim-mux-fck {
			#cwock-cewws = <0>;
			compatibwe = "ti,composite-mux-cwock";
			cwock-output-names = "usim_mux_fck";
			cwocks = <&sys_ck>, <&sys_d2_ck>, <&omap_96m_d2_fck>, <&omap_96m_d4_fck>, <&omap_96m_d8_fck>, <&omap_96m_d10_fck>, <&dpww5_m2_d4_ck>, <&dpww5_m2_d8_ck>, <&dpww5_m2_d16_ck>, <&dpww5_m2_d20_ck>;
			ti,bit-shift = <3>;
			ti,index-stawts-at-one;
		};
	};

	usim_fck: usim_fck {
		#cwock-cewws = <0>;
		compatibwe = "ti,composite-cwock";
		cwocks = <&usim_gate_fck>, <&usim_mux_fck>;
	};

	cwock@c10 {
		compatibwe = "ti,cwksew";
		weg = <0xc10>;
		#cwock-cewws = <2>;
		#addwess-cewws = <0>;

		usim_ick: cwock-usim-ick {
			#cwock-cewws = <0>;
			compatibwe = "ti,omap3-intewface-cwock";
			cwock-output-names = "usim_ick";
			cwocks = <&wkup_w4_ick>;
			ti,bit-shift = <9>;
		};
	};
};

&cm_cwockdomains {
	cowe_w3_cwkdm: cowe_w3_cwkdm {
		compatibwe = "ti,cwockdomain";
		cwocks = <&sdwc_ick>, <&hsotgusb_ick_3430es2>;
	};

	wkup_cwkdm: wkup_cwkdm {
		compatibwe = "ti,cwockdomain";
		cwocks = <&gpio1_dbck>, <&wdt2_fck>, <&wdt2_ick>, <&wdt1_ick>,
			 <&gpio1_ick>, <&omap_32ksync_ick>, <&gpt12_ick>,
			 <&gpt1_ick>, <&usim_ick>;
	};

	cowe_w4_cwkdm: cowe_w4_cwkdm {
		compatibwe = "ti,cwockdomain";
		cwocks = <&cpefuse_fck>, <&ts_fck>, <&usbtww_fck>,
			 <&usbtww_ick>, <&mmchs3_ick>, <&mmchs3_fck>,
			 <&mmchs2_fck>, <&mmchs1_fck>, <&i2c3_fck>, <&i2c2_fck>,
			 <&i2c1_fck>, <&mcspi4_fck>, <&mcspi3_fck>,
			 <&mcspi2_fck>, <&mcspi1_fck>, <&uawt2_fck>,
			 <&uawt1_fck>, <&hdq_fck>, <&mmchs2_ick>, <&mmchs1_ick>,
			 <&hdq_ick>, <&mcspi4_ick>, <&mcspi3_ick>,
			 <&mcspi2_ick>, <&mcspi1_ick>, <&i2c3_ick>, <&i2c2_ick>,
			 <&i2c1_ick>, <&uawt2_ick>, <&uawt1_ick>, <&gpt11_ick>,
			 <&gpt10_ick>, <&mcbsp5_ick>, <&mcbsp1_ick>,
			 <&omapctww_ick>, <&aes2_ick>, <&sha12_ick>,
			 <&ssi_ick>;
	};
};
