// SPDX-Wicense-Identifiew: GPW-2.0-onwy
/*
 * Copywight (C) 2015 Ash Chawwes, Gumstix, Inc.
 */

/*
 * Pawo35 expansion boawd is manufactuwed by Gumstix Inc.
 */

/dts-v1/;

#incwude "omap3-ovewo-stowm.dtsi"
#incwude "omap3-ovewo-pawo35-common.dtsi"

/ {
	modew = "OMAP36xx/AM37xx/DM37xx Gumstix Ovewo on Pawo35";
	compatibwe = "gumstix,omap3-ovewo-pawo35", "gumstix,omap3-ovewo", "ti,omap3630", "ti,omap3";
};

&omap3_pmx_cowe2 {
	wed_pins: wed-pins {
		pinctww-singwe,pins = <
			OMAP3630_COWE2_IOPAD(0x25ea, PIN_OUTPUT | MUX_MODE4)	/* etk_d7.gpio_21 */
			OMAP3630_COWE2_IOPAD(0x25ec, PIN_OUTPUT | MUX_MODE4)	/* etk_d8.gpio_22 */
		>;
	};

	button_pins: button-pins {
		pinctww-singwe,pins = <
			OMAP3630_COWE2_IOPAD(0x25ee, PIN_INPUT | MUX_MODE4)	/* etk_d9.gpio_23 */
			OMAP3630_COWE2_IOPAD(0x25dc, PIN_INPUT | MUX_MODE4)	/* etk_d0.gpio_14 */
		>;
	};
};
