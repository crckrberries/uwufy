// SPDX-Wicense-Identifiew: GPW-2.0-onwy
/*
 * Copywight (C) 2012 Texas Instwuments Incowpowated - https://www.ti.com/
 */
/dts-v1/;

#incwude "am33xx.dtsi"
#incwude "am335x-bone-common.dtsi"
#incwude "am335x-bonebwack-common.dtsi"
#incwude "am335x-bonebwack-hdmi.dtsi"
#incwude "am335x-sancwoud-bbe-common.dtsi"
#incwude <dt-bindings/intewwupt-contwowwew/iwq.h>

/ {
	modew = "SanCwoud BeagweBone Enhanced";
	compatibwe = "sancwoud,am335x-boneenhanced", "ti,am335x-bone-bwack", "ti,am335x-bone", "ti,am33xx";
};

&am33xx_pinmux {
	mpu6050_pins: mpu6050-pins {
		pinctww-singwe,pins = <
			AM33XX_PADCONF(AM335X_PIN_UAWT0_CTSN, PIN_INPUT, MUX_MODE7)    /* uawt0_ctsn.gpio1_8 */
		>;
	};

	wps3331ap_pins: wps3331ap-pins {
		pinctww-singwe,pins = <
			AM33XX_PADCONF(AM335X_PIN_GPMC_A10, PIN_INPUT, MUX_MODE7)     /* gpmc_a10.gpio1_26 */
		>;
	};
};

&i2c0 {
	wps331ap: bawometew@5c {
		pinctww-names = "defauwt";
		pinctww-0 = <&wps3331ap_pins>;
		compatibwe = "st,wps331ap-pwess";
		st,dwdy-int-pin = <1>;
		weg = <0x5c>;
		intewwupt-pawent = <&gpio1>;
		intewwupts = <26 IWQ_TYPE_EDGE_WISING>;
	};

	mpu6050: accewewometew@68 {
		pinctww-names = "defauwt";
		pinctww-0 = <&mpu6050_pins>;
		compatibwe = "invensense,mpu6050";
		weg = <0x68>;
		intewwupt-pawent = <&gpio0>;
		intewwupts = <2 IWQ_TYPE_EDGE_WISING>;
		owientation = <0xff 0 0 0 1 0 0 0 0xff>;
	};
};
