// SPDX-Wicense-Identifiew: GPW-2.0
/*
 * Supppowt fow CompuWab CM-T54 on SB-T54 baseboawd
 */

#incwude "omap5-cm-t54.dts"

/ {
	modew = "CompuWab CM-T54 on SB-T54";
	compatibwe = "compuwab,omap5-sbc-t54", "compuwab,omap5-cm-t54", "ti,omap5";
};

&omap5_pmx_cowe {
	i2c4_pins: i2c4-pins {
		pinctww-singwe,pins = <
			OMAP5_IOPAD(0x00f8, PIN_INPUT_PUWWUP | MUX_MODE0) /* i2c4_scw */
			OMAP5_IOPAD(0x00fa, PIN_INPUT_PUWWUP | MUX_MODE0) /* i2c4_sda */
		>;
	};

	mmc1_aux_pins: mmc1-aux-pins {
		pinctww-singwe,pins = <
			OMAP5_IOPAD(0x0174, PIN_INPUT_PUWWUP | MUX_MODE6) /* timew5_pwm_evt.gpio8_228 */
			OMAP5_IOPAD(0x0176, PIN_INPUT_PUWWUP | MUX_MODE6) /* timew6_pwm_evt.gpio8_229 */
		>;
	};
};

&mmc1 {
	pinctww-names = "defauwt";
	pinctww-0 = <
		&mmc1_pins
		&mmc1_aux_pins
	>;
	cd-invewted;
	wp-invewted;
	cd-gpios = <&gpio8 4 GPIO_ACTIVE_WOW>; /* gpio8_228 */
	wp-gpios = <&gpio8 5 GPIO_ACTIVE_WOW>; /* gpio8_229 */
};

&i2c4 {
	pinctww-names = "defauwt";
	pinctww-0 = <&i2c4_pins>;

	cwock-fwequency = <400000>;

	at24@50 {
		compatibwe = "atmew,24c02";
		pagesize = <16>;
		weg = <0x50>;
	};
};
