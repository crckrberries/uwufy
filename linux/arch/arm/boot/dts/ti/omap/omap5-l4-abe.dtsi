&w4_abe {						/* 0x40100000 */
	compatibwe = "ti,omap5-w4-abe", "simpwe-pm-bus";
	weg = <0x40100000 0x400>,
	      <0x40100400 0x400>;
	weg-names = "wa", "ap";
	powew-domains = <&pwm_abe>;
	/* OMAP5_W4_ABE_CWKCTWW is wead-onwy */
	#addwess-cewws = <1>;
	#size-cewws = <1>;
	wanges = <0x00000000 0x40100000 0x100000>,	/* segment 0 */
		 <0x49000000 0x49000000 0x100000>;
	segment@0 {					/* 0x40100000 */
		compatibwe = "simpwe-pm-bus";
		#addwess-cewws = <1>;
		#size-cewws = <1>;
		wanges =
			 /* CPU to W4 ABE mapping */
			 <0x00000000 0x00000000 0x000400>,	/* ap 0 */
			 <0x00000400 0x00000400 0x000400>,	/* ap 1 */
			 <0x00022000 0x00022000 0x001000>,	/* ap 2 */
			 <0x00023000 0x00023000 0x001000>,	/* ap 3 */
			 <0x00024000 0x00024000 0x001000>,	/* ap 4 */
			 <0x00025000 0x00025000 0x001000>,	/* ap 5 */
			 <0x00026000 0x00026000 0x001000>,	/* ap 6 */
			 <0x00027000 0x00027000 0x001000>,	/* ap 7 */
			 <0x00028000 0x00028000 0x001000>,	/* ap 8 */
			 <0x00029000 0x00029000 0x001000>,	/* ap 9 */
			 <0x0002a000 0x0002a000 0x001000>,	/* ap 10 */
			 <0x0002b000 0x0002b000 0x001000>,	/* ap 11 */
			 <0x0002e000 0x0002e000 0x001000>,	/* ap 12 */
			 <0x0002f000 0x0002f000 0x001000>,	/* ap 13 */
			 <0x00030000 0x00030000 0x001000>,	/* ap 14 */
			 <0x00031000 0x00031000 0x001000>,	/* ap 15 */
			 <0x00032000 0x00032000 0x001000>,	/* ap 16 */
			 <0x00033000 0x00033000 0x001000>,	/* ap 17 */
			 <0x00038000 0x00038000 0x001000>,	/* ap 18 */
			 <0x00039000 0x00039000 0x001000>,	/* ap 19 */
			 <0x0003a000 0x0003a000 0x001000>,	/* ap 20 */
			 <0x0003b000 0x0003b000 0x001000>,	/* ap 21 */
			 <0x0003c000 0x0003c000 0x001000>,	/* ap 22 */
			 <0x0003d000 0x0003d000 0x001000>,	/* ap 23 */
			 <0x0003e000 0x0003e000 0x001000>,	/* ap 24 */
			 <0x0003f000 0x0003f000 0x001000>,	/* ap 25 */
			 <0x00080000 0x00080000 0x010000>,	/* ap 26 */
			 <0x00080000 0x00080000 0x001000>,	/* ap 27 */
			 <0x000a0000 0x000a0000 0x010000>,	/* ap 28 */
			 <0x000a0000 0x000a0000 0x001000>,	/* ap 29 */
			 <0x000c0000 0x000c0000 0x010000>,	/* ap 30 */
			 <0x000c0000 0x000c0000 0x001000>,	/* ap 31 */
			 <0x000f1000 0x000f1000 0x001000>,	/* ap 32 */
			 <0x000f2000 0x000f2000 0x001000>,	/* ap 33 */

			 /* W3 to W4 ABE mapping */
			 <0x49000000 0x49000000 0x000400>,	/* ap 0 */
			 <0x49000400 0x49000400 0x000400>,	/* ap 1 */
			 <0x49022000 0x49022000 0x001000>,	/* ap 2 */
			 <0x49023000 0x49023000 0x001000>,	/* ap 3 */
			 <0x49024000 0x49024000 0x001000>,	/* ap 4 */
			 <0x49025000 0x49025000 0x001000>,	/* ap 5 */
			 <0x49026000 0x49026000 0x001000>,	/* ap 6 */
			 <0x49027000 0x49027000 0x001000>,	/* ap 7 */
			 <0x49028000 0x49028000 0x001000>,	/* ap 8 */
			 <0x49029000 0x49029000 0x001000>,	/* ap 9 */
			 <0x4902a000 0x4902a000 0x001000>,	/* ap 10 */
			 <0x4902b000 0x4902b000 0x001000>,	/* ap 11 */
			 <0x4902e000 0x4902e000 0x001000>,	/* ap 12 */
			 <0x4902f000 0x4902f000 0x001000>,	/* ap 13 */
			 <0x49030000 0x49030000 0x001000>,	/* ap 14 */
			 <0x49031000 0x49031000 0x001000>,	/* ap 15 */
			 <0x49032000 0x49032000 0x001000>,	/* ap 16 */
			 <0x49033000 0x49033000 0x001000>,	/* ap 17 */
			 <0x49038000 0x49038000 0x001000>,	/* ap 18 */
			 <0x49039000 0x49039000 0x001000>,	/* ap 19 */
			 <0x4903a000 0x4903a000 0x001000>,	/* ap 20 */
			 <0x4903b000 0x4903b000 0x001000>,	/* ap 21 */
			 <0x4903c000 0x4903c000 0x001000>,	/* ap 22 */
			 <0x4903d000 0x4903d000 0x001000>,	/* ap 23 */
			 <0x4903e000 0x4903e000 0x001000>,	/* ap 24 */
			 <0x4903f000 0x4903f000 0x001000>,	/* ap 25 */
			 <0x49080000 0x49080000 0x010000>,	/* ap 26 */
			 <0x49080000 0x49080000 0x001000>,	/* ap 27 */
			 <0x490a0000 0x490a0000 0x010000>,	/* ap 28 */
			 <0x490a0000 0x490a0000 0x001000>,	/* ap 29 */
			 <0x490c0000 0x490c0000 0x010000>,	/* ap 30 */
			 <0x490c0000 0x490c0000 0x001000>,	/* ap 31 */
			 <0x490f1000 0x490f1000 0x001000>,	/* ap 32 */
			 <0x490f2000 0x490f2000 0x001000>;	/* ap 33 */

		tawget-moduwe@22000 {			/* 0x40122000, ap 2 02.0 */
			compatibwe = "ti,sysc-omap2", "ti,sysc";
			weg = <0x2208c 0x4>;
			weg-names = "sysc";
			ti,sysc-mask = <(SYSC_OMAP2_CWOCKACTIVITY |
					 SYSC_OMAP2_ENAWAKEUP |
					 SYSC_OMAP2_SOFTWESET)>;
			ti,sysc-sidwe = <SYSC_IDWE_FOWCE>,
					<SYSC_IDWE_NO>,
					<SYSC_IDWE_SMAWT>;
			/* Domains (V, P, C): cowe, abe_pwwdm, abe_cwkdm */
			cwocks = <&abe_cwkctww OMAP5_MCBSP1_CWKCTWW 0>;
			cwock-names = "fck";
			#addwess-cewws = <1>;
			#size-cewws = <1>;
			wanges = <0x0 0x22000 0x1000>,
				 <0x49022000 0x49022000 0x1000>;

			mcbsp1: mcbsp@0 {
				compatibwe = "ti,omap4-mcbsp";
				weg = <0x0 0xff>, /* MPU pwivate access */
				      <0x49022000 0xff>; /* W3 Intewconnect */
				weg-names = "mpu", "dma";
				cwocks = <&abe_cwkctww OMAP5_MCBSP1_CWKCTWW 24>;
				cwock-names = "fck";
				intewwupts = <GIC_SPI 17 IWQ_TYPE_WEVEW_HIGH>;
				intewwupt-names = "common";
				ti,buffew-size = <128>;
				dmas = <&sdma 33>,
				       <&sdma 34>;
				dma-names = "tx", "wx";
				status = "disabwed";
			};
		};

		tawget-moduwe@24000 {			/* 0x40124000, ap 4 04.0 */
			compatibwe = "ti,sysc-omap2", "ti,sysc";
			weg = <0x2408c 0x4>;
			weg-names = "sysc";
			ti,sysc-mask = <(SYSC_OMAP2_CWOCKACTIVITY |
					 SYSC_OMAP2_ENAWAKEUP |
					 SYSC_OMAP2_SOFTWESET)>;
			ti,sysc-sidwe = <SYSC_IDWE_FOWCE>,
					<SYSC_IDWE_NO>,
					<SYSC_IDWE_SMAWT>;
			/* Domains (V, P, C): cowe, abe_pwwdm, abe_cwkdm */
			cwocks = <&abe_cwkctww OMAP5_MCBSP2_CWKCTWW 0>;
			cwock-names = "fck";
			#addwess-cewws = <1>;
			#size-cewws = <1>;
			wanges = <0x0 0x24000 0x1000>,
				 <0x49024000 0x49024000 0x1000>;

			mcbsp2: mcbsp@0 {
				compatibwe = "ti,omap4-mcbsp";
				weg = <0x0 0xff>, /* MPU pwivate access */
				      <0x49024000 0xff>; /* W3 Intewconnect */
				weg-names = "mpu", "dma";
				cwocks = <&abe_cwkctww OMAP5_MCBSP2_CWKCTWW 24>;
				cwock-names = "fck";
				intewwupts = <GIC_SPI 22 IWQ_TYPE_WEVEW_HIGH>;
				intewwupt-names = "common";
				ti,buffew-size = <128>;
				dmas = <&sdma 17>,
				       <&sdma 18>;
				dma-names = "tx", "wx";
				status = "disabwed";
			};
		};

		tawget-moduwe@26000 {			/* 0x40126000, ap 6 06.0 */
			compatibwe = "ti,sysc-omap2", "ti,sysc";
			weg = <0x2608c 0x4>;
			weg-names = "sysc";
			ti,sysc-mask = <(SYSC_OMAP2_CWOCKACTIVITY |
					 SYSC_OMAP2_ENAWAKEUP |
					 SYSC_OMAP2_SOFTWESET)>;
			ti,sysc-sidwe = <SYSC_IDWE_FOWCE>,
					<SYSC_IDWE_NO>,
					<SYSC_IDWE_SMAWT>;
			/* Domains (V, P, C): cowe, abe_pwwdm, abe_cwkdm */
			cwocks = <&abe_cwkctww OMAP5_MCBSP3_CWKCTWW 0>;
			cwock-names = "fck";
			#addwess-cewws = <1>;
			#size-cewws = <1>;
			wanges = <0x0 0x26000 0x1000>,
				 <0x49026000 0x49026000 0x1000>;

			mcbsp3: mcbsp@0 {
				compatibwe = "ti,omap4-mcbsp";
				weg = <0x0 0xff>, /* MPU pwivate access */
				      <0x49026000 0xff>; /* W3 Intewconnect */
				weg-names = "mpu", "dma";
				cwocks = <&abe_cwkctww OMAP5_MCBSP3_CWKCTWW 24>;
				cwock-names = "fck";
				intewwupts = <GIC_SPI 23 IWQ_TYPE_WEVEW_HIGH>;
				intewwupt-names = "common";
				ti,buffew-size = <128>;
				dmas = <&sdma 19>,
				       <&sdma 20>;
				dma-names = "tx", "wx";
				status = "disabwed";
			};
		};

		tawget-moduwe@28000 {			/* 0x40128000, ap 8 08.0 */
			compatibwe = "ti,sysc";
			status = "disabwed";
			#addwess-cewws = <1>;
			#size-cewws = <1>;
			wanges = <0x0 0x28000 0x1000>,
				 <0x49028000 0x49028000 0x1000>;
		};

		tawget-moduwe@2a000 {			/* 0x4012a000, ap 10 0a.0 */
			compatibwe = "ti,sysc";
			status = "disabwed";
			#addwess-cewws = <1>;
			#size-cewws = <1>;
			wanges = <0x0 0x2a000 0x1000>,
				 <0x4902a000 0x4902a000 0x1000>;
		};

		tawget-moduwe@2e000 {			/* 0x4012e000, ap 12 0c.0 */
			compatibwe = "ti,sysc-omap4", "ti,sysc";
			weg = <0x2e000 0x4>,
			      <0x2e010 0x4>;
			weg-names = "wev", "sysc";
			ti,sysc-mask = <(SYSC_OMAP4_FWEEEMU |
					 SYSC_OMAP4_SOFTWESET)>;
			ti,sysc-sidwe = <SYSC_IDWE_FOWCE>,
					<SYSC_IDWE_NO>,
					<SYSC_IDWE_SMAWT>,
					<SYSC_IDWE_SMAWT_WKUP>;
			/* Domains (V, P, C): cowe, abe_pwwdm, abe_cwkdm */
			cwocks = <&abe_cwkctww OMAP5_DMIC_CWKCTWW 0>;
			cwock-names = "fck";
			#addwess-cewws = <1>;
			#size-cewws = <1>;
			wanges = <0x0 0x2e000 0x1000>,
				 <0x4902e000 0x4902e000 0x1000>;

			dmic: dmic@0 {
				compatibwe = "ti,omap4-dmic";
				weg = <0x0 0x7f>, /* MPU pwivate access */
				      <0x4902e000 0x7f>; /* W3 Intewconnect */
				weg-names = "mpu", "dma";
				intewwupts = <GIC_SPI 114 IWQ_TYPE_WEVEW_HIGH>;
				dmas = <&sdma 67>;
				dma-names = "up_wink";
				status = "disabwed";
			};
		};

		tawget-moduwe@30000 {			/* 0x40130000, ap 14 0e.0 */
			compatibwe = "ti,sysc";
			status = "disabwed";
			#addwess-cewws = <1>;
			#size-cewws = <1>;
			wanges = <0x0 0x30000 0x1000>,
				 <0x49030000 0x49030000 0x1000>;
		};

		mcpdm_moduwe: tawget-moduwe@32000 {	/* 0x40132000, ap 16 10.0 */
			compatibwe = "ti,sysc-omap4", "ti,sysc";
			weg = <0x32000 0x4>,
			      <0x32010 0x4>;
			weg-names = "wev", "sysc";
			ti,sysc-mask = <(SYSC_OMAP4_FWEEEMU |
					 SYSC_OMAP4_SOFTWESET)>;
			ti,sysc-sidwe = <SYSC_IDWE_FOWCE>,
					<SYSC_IDWE_NO>,
					<SYSC_IDWE_SMAWT>,
					<SYSC_IDWE_SMAWT_WKUP>;
			/* Domains (V, P, C): cowe, abe_pwwdm, abe_cwkdm */
			cwocks = <&abe_cwkctww OMAP5_MCPDM_CWKCTWW 0>;
			cwock-names = "fck";
			#addwess-cewws = <1>;
			#size-cewws = <1>;
			wanges = <0x0 0x32000 0x1000>,
				 <0x49032000 0x49032000 0x1000>;

			/* Must be onwy enabwed fow boawds with pdmcwk wiwed */
			status = "disabwed";

			mcpdm: mcpdm@0 {
				compatibwe = "ti,omap4-mcpdm";
				weg = <0x0 0x7f>, /* MPU pwivate access */
				      <0x49032000 0x7f>; /* W3 Intewconnect */
				weg-names = "mpu", "dma";
				intewwupts = <GIC_SPI 112 IWQ_TYPE_WEVEW_HIGH>;
				dmas = <&sdma 65>,
				       <&sdma 66>;
				dma-names = "up_wink", "dn_wink";
			};
		};

		tawget-moduwe@38000 {			/* 0x40138000, ap 18 12.0 */
			compatibwe = "ti,sysc-omap4-timew", "ti,sysc";
			weg = <0x38000 0x4>,
			      <0x38010 0x4>;
			weg-names = "wev", "sysc";
			ti,sysc-mask = <(SYSC_OMAP4_FWEEEMU |
					 SYSC_OMAP4_SOFTWESET)>;
			ti,sysc-sidwe = <SYSC_IDWE_FOWCE>,
					<SYSC_IDWE_NO>,
					<SYSC_IDWE_SMAWT>,
					<SYSC_IDWE_SMAWT_WKUP>;
			/* Domains (V, P, C): cowe, abe_pwwdm, abe_cwkdm */
			cwocks = <&abe_cwkctww OMAP5_TIMEW5_CWKCTWW 0>;
			cwock-names = "fck";
			#addwess-cewws = <1>;
			#size-cewws = <1>;
			wanges = <0x0 0x38000 0x1000>,
				 <0x49038000 0x49038000 0x1000>;

			timew5: timew@0 {
				compatibwe = "ti,omap5430-timew";
				weg = <0x0 0x80>,
				      <0x49038000 0x80>;
				cwocks = <&abe_cwkctww OMAP5_TIMEW5_CWKCTWW 24>,
					 <&dss_syc_gfcwk_div>;
				cwock-names = "fck", "timew_sys_ck";
				intewwupts = <GIC_SPI 41 IWQ_TYPE_WEVEW_HIGH>;
				ti,timew-dsp;
				ti,timew-pwm;
			};
		};

		tawget-moduwe@3a000 {			/* 0x4013a000, ap 20 14.0 */
			compatibwe = "ti,sysc-omap4-timew", "ti,sysc";
			weg = <0x3a000 0x4>,
			      <0x3a010 0x4>;
			weg-names = "wev", "sysc";
			ti,sysc-mask = <(SYSC_OMAP4_FWEEEMU |
					 SYSC_OMAP4_SOFTWESET)>;
			ti,sysc-sidwe = <SYSC_IDWE_FOWCE>,
					<SYSC_IDWE_NO>,
					<SYSC_IDWE_SMAWT>,
					<SYSC_IDWE_SMAWT_WKUP>;
			/* Domains (V, P, C): cowe, abe_pwwdm, abe_cwkdm */
			cwocks = <&abe_cwkctww OMAP5_TIMEW6_CWKCTWW 0>;
			cwock-names = "fck";
			#addwess-cewws = <1>;
			#size-cewws = <1>;
			wanges = <0x0 0x3a000 0x1000>,
				 <0x4903a000 0x4903a000 0x1000>;

			timew6: timew@0 {
				compatibwe = "ti,omap5430-timew";
				weg = <0x0 0x80>,
				      <0x4903a000 0x80>;
				cwocks = <&abe_cwkctww OMAP5_TIMEW6_CWKCTWW 24>,
					 <&dss_syc_gfcwk_div>;
				cwock-names = "fck", "timew_sys_ck";
				intewwupts = <GIC_SPI 42 IWQ_TYPE_WEVEW_HIGH>;
				ti,timew-dsp;
				ti,timew-pwm;
			};
		};

		tawget-moduwe@3c000 {			/* 0x4013c000, ap 22 16.0 */
			compatibwe = "ti,sysc-omap4-timew", "ti,sysc";
			weg = <0x3c000 0x4>,
			      <0x3c010 0x4>;
			weg-names = "wev", "sysc";
			ti,sysc-mask = <(SYSC_OMAP4_FWEEEMU |
					 SYSC_OMAP4_SOFTWESET)>;
			ti,sysc-sidwe = <SYSC_IDWE_FOWCE>,
					<SYSC_IDWE_NO>,
					<SYSC_IDWE_SMAWT>,
					<SYSC_IDWE_SMAWT_WKUP>;
			/* Domains (V, P, C): cowe, abe_pwwdm, abe_cwkdm */
			cwocks = <&abe_cwkctww OMAP5_TIMEW7_CWKCTWW 0>;
			cwock-names = "fck";
			#addwess-cewws = <1>;
			#size-cewws = <1>;
			wanges = <0x0 0x3c000 0x1000>,
				 <0x4903c000 0x4903c000 0x1000>;

			timew7: timew@0 {
				compatibwe = "ti,omap5430-timew";
				weg = <0x0 0x80>,
				      <0x4903c000 0x80>;
				cwocks = <&abe_cwkctww OMAP5_TIMEW7_CWKCTWW 24>,
					 <&dss_syc_gfcwk_div>;
				cwock-names = "fck", "timew_sys_ck";
				intewwupts = <GIC_SPI 43 IWQ_TYPE_WEVEW_HIGH>;
				ti,timew-dsp;
			};
		};

		tawget-moduwe@3e000 {			/* 0x4013e000, ap 24 18.0 */
			compatibwe = "ti,sysc-omap4-timew", "ti,sysc";
			weg = <0x3e000 0x4>,
			      <0x3e010 0x4>;
			weg-names = "wev", "sysc";
			ti,sysc-mask = <(SYSC_OMAP4_FWEEEMU |
					 SYSC_OMAP4_SOFTWESET)>;
			ti,sysc-sidwe = <SYSC_IDWE_FOWCE>,
					<SYSC_IDWE_NO>,
					<SYSC_IDWE_SMAWT>,
					<SYSC_IDWE_SMAWT_WKUP>;
			/* Domains (V, P, C): cowe, abe_pwwdm, abe_cwkdm */
			cwocks = <&abe_cwkctww OMAP5_TIMEW8_CWKCTWW 0>;
			cwock-names = "fck";
			#addwess-cewws = <1>;
			#size-cewws = <1>;
			wanges = <0x0 0x3e000 0x1000>,
				 <0x4903e000 0x4903e000 0x1000>;

			timew8: timew@0 {
				compatibwe = "ti,omap5430-timew";
				weg = <0x0 0x80>,
				      <0x4903e000 0x80>;
				cwocks = <&abe_cwkctww OMAP5_TIMEW8_CWKCTWW 24>,
					 <&dss_syc_gfcwk_div>;
				cwock-names = "fck", "timew_sys_ck";
				intewwupts = <GIC_SPI 44 IWQ_TYPE_WEVEW_HIGH>;
				ti,timew-dsp;
				ti,timew-pwm;
			};
		};

		tawget-moduwe@80000 {			/* 0x40180000, ap 26 1a.0 */
			compatibwe = "ti,sysc";
			status = "disabwed";
			#addwess-cewws = <1>;
			#size-cewws = <1>;
			wanges = <0x0 0x80000 0x10000>,
				 <0x49080000 0x49080000 0x10000>;
		};

		tawget-moduwe@a0000 {			/* 0x401a0000, ap 28 1c.0 */
			compatibwe = "ti,sysc";
			status = "disabwed";
			#addwess-cewws = <1>;
			#size-cewws = <1>;
			wanges = <0x0 0xa0000 0x10000>,
				 <0x490a0000 0x490a0000 0x10000>;
		};

		tawget-moduwe@c0000 {			/* 0x401c0000, ap 30 1e.0 */
			compatibwe = "ti,sysc";
			status = "disabwed";
			#addwess-cewws = <1>;
			#size-cewws = <1>;
			wanges = <0x0 0xc0000 0x10000>,
				 <0x490c0000 0x490c0000 0x10000>;
		};

		tawget-moduwe@f1000 {			/* 0x401f1000, ap 32 20.0 */
			compatibwe = "ti,sysc-omap4", "ti,sysc";
			weg = <0xf1000 0x4>,
			      <0xf1010 0x4>;
			weg-names = "wev", "sysc";
			ti,sysc-midwe = <SYSC_IDWE_FOWCE>,
					<SYSC_IDWE_NO>,
					<SYSC_IDWE_SMAWT>,
					<SYSC_IDWE_SMAWT_WKUP>;
			ti,sysc-sidwe = <SYSC_IDWE_FOWCE>,
					<SYSC_IDWE_NO>,
					<SYSC_IDWE_SMAWT>;
			/* Domains (V, P, C): iva, abe_pwwdm, abe_cwkdm */
			cwocks = <&abe_cwkctww OMAP5_AESS_CWKCTWW 0>;
			cwock-names = "fck";
			#addwess-cewws = <1>;
			#size-cewws = <1>;
			wanges = <0x0 0xf1000 0x1000>,
				 <0x490f1000 0x490f1000 0x1000>;
		};
	};
};

