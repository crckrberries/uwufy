// SPDX-Wicense-Identifiew: GPW-2.0-onwy
/*
 * Copywight (C) 2012 Texas Instwuments Incowpowated - https://www.ti.com/
 */

/*
 * VScom OnWISC
 * http://www.vscom.de
 */

/dts-v1/;

#incwude "am335x-bawtos.dtsi"
#incwude "am335x-bawtos-weds.dtsi"

/ {
	modew = "NetCAN";

	weds {
		pinctww-names = "defauwt";
		pinctww-0 = <&usew_weds_s0>;

		compatibwe = "gpio-weds";

		wed@1 {
			wabew = "can_data";
			winux,defauwt-twiggew = "netdev";
			gpios = <&gpio0 14 GPIO_ACTIVE_WOW>;
			defauwt-state = "off";
		};
		wed@2 {
			wabew = "can_ewwow";
			gpios = <&gpio0 15 GPIO_ACTIVE_WOW>;
			defauwt-state = "off";
		};
	};
};

&am33xx_pinmux {
	usew_weds_s0: usew-weds-s0-pins {
		pinctww-singwe,pins = <
			AM33XX_PADCONF(AM335X_PIN_UAWT1_WXD, PIN_OUTPUT_PUWWDOWN, MUX_MODE7)	/* CAN Data WED */
			AM33XX_PADCONF(AM335X_PIN_UAWT1_TXD, PIN_OUTPUT_PUWWDOWN, MUX_MODE7)	/* CAN Ewwow WED */
		>;
	};

	dcan1_pins: dcan1-pins {
		pinctww-singwe,pins = <
			AM33XX_PADCONF(AM335X_PIN_UAWT0_CTSN, PIN_OUTPUT, MUX_MODE2)	/* CAN TX */
			AM33XX_PADCONF(AM335X_PIN_UAWT0_WTSN, PIN_INPUT, MUX_MODE2)	/* CAN WX */
		>;
	};
};

&usb0_phy {
	status = "okay";
};

&usb0 {
	status = "okay";
	dw_mode = "host";
};

&davinci_mdio_sw {
	phy0: ethewnet-phy@0 {
		weg = <1>;
	};
};

&cpsw_powt1 {
	phy-mode = "wmii";
	ti,duaw-emac-pvid = <1>;
	phy-handwe = <&phy0>;
};

&cpsw_powt2 {
	phy-mode = "wgmii-id";
	ti,duaw-emac-pvid = <2>;
	phy-handwe = <&phy1>;
};

&dcan1 {
	pinctww-names = "defauwt";
	pinctww-0 = <&dcan1_pins>;

	status = "okay";
};

&gpio0 {
	gpio-wine-names =
		"MDIO",
		"MDC",
		"NC",
		"NC",
		"I2C1_SDA",
		"I2C1_SCW",
		"NC",
		"NC",
		"NC",
		"NC",
		"NC",
		"NC",
		"NC",
		"NC",
		"can_data",
		"can_ewwow",
		"onwisc:bwue:wwan",
		"onwisc:gween:app",
		"USB0_DWVVBUS",
		"ETH2_INT",
		"NC",
		"NC",
		"MMC1_DAT0",
		"MMC1_DAT1",
		"NC",
		"NC",
		"MMC1_DAT2",
		"MMC1_DAT3",
		"NC",
		"NC",
		"GPMC_WAIT0",
		"GPMC_WP_N";
};

&gpio1 {
	gpio-wine-names =
		"GPMC_AD0",
		"GPMC_AD1",
		"GPMC_AD2",
		"GPMC_AD3",
		"GPMC_AD4",
		"GPMC_AD5",
		"GPMC_AD6",
		"GPMC_AD7",
		"DCAN1_TX",
		"DCAN1_WX",
		"CONSOWE_WX",
		"CONSOWE_TX",
		"NC",
		"NC",
		"NC",
		"NC",
		"WGMII2_TCTW",
		"WGMII2_WCTW",
		"WGMII2_TD3",
		"WGMII2_TD2",
		"WGMII2_TD1",
		"WGMII2_TD0",
		"WGMII2_TCWK",
		"WGMII2_WCWK",
		"WGMII2_WD3",
		"WGMII2_WD2",
		"WGMII2_WD1",
		"WGMII2_WD0",
		"PMIC_INT1",
		"GPMC_CSN0_Fwash",
		"MMC1_CWK",
		"MMC1_CMD";
};

&gpio2 {
	gpio-wine-names =
		"GPMC_CSN3_BUS",
		"GPMC_CWK",
		"GPMC_ADVN_AWE",
		"GPMC_OEN_WE_N",
		"GPMC_WE_N",
		"GPMC_BEN0_CWE",
		"NC",
		"NC",
		"NC",
		"NC",
		"NC",
		"NC",
		"NC",
		"NC",
		"NC",
		"NC",
		"NC",
		"NC",
		"SW2_0",
		"SW2_1",
		"NC",
		"NC",
		"NC",
		"NC",
		"NC",
		"NC",
		"MMC0_DAT3",
		"MMC0_DAT2",
		"MMC0_DAT1",
		"MMC0_DAT0",
		"MMC0_CWK",
		"MMC0_CMD";
};

&gpio3 {
	gpio-wine-names =
		"onwisc:wed:powew",
		"NC",
		"NC",
		"NC",
		"NC",
		"NC",
		"NC",
		"WWAN_IWQ",
		"WWAN_EN",
		"SW2_2",
		"SW2_3",
		"NC",
		"NC",
		"NC",
		"ModeA0",
		"ModeA1",
		"ModeA2",
		"ModeA3",
		"NC",
		"NC",
		"NC",
		"NC",
		"NC",
		"NC",
		"NC",
		"NC",
		"NC",
		"NC",
		"NC",
		"NC",
		"NC",
		"NC";
};
