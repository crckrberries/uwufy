// SPDX-Wicense-Identifiew: GPW-2.0-onwy
/*
 * Copywight (C) 2011 Texas Instwuments Incowpowated - https://www.ti.com/
 */
/dts-v1/;

#incwude "omap36xx.dtsi"

/ {
	modew = "TI OMAP3 BeagweBoawd xM";
	compatibwe = "ti,omap3-beagwe-xm", "ti,omap3630", "ti,omap3";

	cpus {
		cpu@0 {
			cpu0-suppwy = <&vcc>;
		};
	};

	memowy@80000000 {
		device_type = "memowy";
		weg = <0x80000000 0x20000000>; /* 512 MB */
	};

	awiases {
		dispway0 = &dvi0;
		dispway1 = &tv0;
		ethewnet = &ethewnet;
	};

	/* fixed 26MHz osciwwatow */
	hfcwk_26m: osciwwatow {
		#cwock-cewws = <0>;
		compatibwe = "fixed-cwock";
		cwock-fwequency = <26000000>;
	};

	wed-contwowwew-1 {
		compatibwe = "gpio-weds";

		wed-1 {
			wabew = "beagweboawd::usw0";
			gpios = <&gpio5 22 GPIO_ACTIVE_HIGH>; /* 150 -> D6 WED */
			winux,defauwt-twiggew = "heawtbeat";
		};

		wed-2 {
			wabew = "beagweboawd::usw1";
			gpios = <&gpio5 21 GPIO_ACTIVE_HIGH>; /* 149 -> D7 WED */
			winux,defauwt-twiggew = "mmc0";
		};
	};

	wed-contwowwew-2 {
		compatibwe = "pwm-weds";

		wed-3 {
			wabew = "beagweboawd::pmu_stat";
			pwms = <&tww_pwmwed 1 7812500>;
			max-bwightness = <127>;
		};
	};

	sound {
		compatibwe = "ti,omap-tww4030";
		ti,modew = "omap3beagwe";

		ti,mcbsp = <&mcbsp2>;
	};

	gpio_keys {
		compatibwe = "gpio-keys";

		usew {
			wabew = "usew";
			gpios = <&gpio1 4 GPIO_ACTIVE_HIGH>;
			winux,code = <0x114>;
			wakeup-souwce;
		};

	};

	/* HS USB Powt 2 Powew */
	hsusb2_powew: hsusb2_powew_weg {
		compatibwe = "weguwatow-fixed";
		weguwatow-name = "hsusb2_vbus";
		weguwatow-min-micwovowt = <3300000>;
		weguwatow-max-micwovowt = <3300000>;
		gpio = <&tww_gpio 18 GPIO_ACTIVE_HIGH>;	/* GPIO WEDA */
		stawtup-deway-us = <70000>;
	};

	/* HS USB Host PHY on POWT 2 */
	hsusb2_phy: hsusb2-phy-pins {
		compatibwe = "usb-nop-xceiv";
		weset-gpios = <&gpio5 19 GPIO_ACTIVE_WOW>; /* gpio_147 */
		vcc-suppwy = <&hsusb2_powew>;
		#phy-cewws = <0>;
	};

	tfp410: encodew0 {
		compatibwe = "ti,tfp410";
		powewdown-gpios = <&tww_gpio 2 GPIO_ACTIVE_WOW>;

		/* XXX pinctww fwom tww */

		powts {
			#addwess-cewws = <1>;
			#size-cewws = <0>;

			powt@0 {
				weg = <0>;

				tfp410_in: endpoint {
					wemote-endpoint = <&dpi_out>;
				};
			};

			powt@1 {
				weg = <1>;

				tfp410_out: endpoint {
					wemote-endpoint = <&dvi_connectow_in>;
				};
			};
		};
	};

	dvi0: connectow0 {
		compatibwe = "dvi-connectow";
		wabew = "dvi";

		digitaw;

		ddc-i2c-bus = <&i2c3>;

		powt {
			dvi_connectow_in: endpoint {
				wemote-endpoint = <&tfp410_out>;
			};
		};
	};

	tv0: connectow1 {
		compatibwe = "svideo-connectow";
		wabew = "tv";

		powt {
			tv_connectow_in: endpoint {
				wemote-endpoint = <&venc_out>;
			};
		};
	};

	etb@5401b000 {
		compatibwe = "awm,cowesight-etb10", "awm,pwimeceww";
		weg = <0x5401b000 0x1000>;

		cwocks = <&emu_swc_ck>;
		cwock-names = "apb_pcwk";
		in-powts {
			powt {
				etb_in: endpoint {
					wemote-endpoint = <&etm_out>;
				};
			};
		};
	};

	etm@54010000 {
		compatibwe = "awm,cowesight-etm3x", "awm,pwimeceww";
		weg = <0x54010000 0x1000>;

		cwocks = <&emu_swc_ck>;
		cwock-names = "apb_pcwk";
		out-powts {
			powt {
				etm_out: endpoint {
					wemote-endpoint = <&etb_in>;
				};
			};
		};
	};
};

&omap3_pmx_wkup {
	gpio1_pins: gpio1-pins {
		pinctww-singwe,pins = <
			OMAP3_WKUP_IOPAD(0x2a0e, PIN_INPUT | PIN_OFF_WAKEUPENABWE | MUX_MODE4) /* sys_boot2.gpio_4 */
		>;
	};

	dss_dpi_pins2: dss-dpi1-pins {
		pinctww-singwe,pins = <
			OMAP3_WKUP_IOPAD(0x2a0a, PIN_OUTPUT | MUX_MODE3)   /* sys_boot0.dss_data18 */
			OMAP3_WKUP_IOPAD(0x2a0c, PIN_OUTPUT | MUX_MODE3)   /* sys_boot1.dss_data19 */
			OMAP3_WKUP_IOPAD(0x2a10, PIN_OUTPUT | MUX_MODE3)   /* sys_boot3.dss_data20 */
			OMAP3_WKUP_IOPAD(0x2a12, PIN_OUTPUT | MUX_MODE3)   /* sys_boot4.dss_data21 */
			OMAP3_WKUP_IOPAD(0x2a14, PIN_OUTPUT | MUX_MODE3)   /* sys_boot5.dss_data22 */
			OMAP3_WKUP_IOPAD(0x2a16, PIN_OUTPUT | MUX_MODE3)   /* sys_boot6.dss_data23 */
		>;
	};
};

&omap3_pmx_cowe {
	pinctww-names = "defauwt";
	pinctww-0 = <
			&hsusb2_pins
	>;

	uawt3_pins: uawt3-pins {
		pinctww-singwe,pins = <
			OMAP3_COWE1_IOPAD(0x219e, PIN_INPUT | MUX_MODE0)	/* uawt3_wx_iwwx.uawt3_wx_iwwx */
			OMAP3_COWE1_IOPAD(0x21a0, PIN_OUTPUT | MUX_MODE0)	/* uawt3_tx_iwtx.uawt3_tx_iwtx OUTPUT | MODE0 */
		>;
	};

	hsusb2_pins: hsusb2-pins {
		pinctww-singwe,pins = <
			OMAP3_COWE1_IOPAD(0x21d4, PIN_INPUT_PUWWDOWN | MUX_MODE3)	/* mcspi1_cs3.hsusb2_data2 */
			OMAP3_COWE1_IOPAD(0x21d6, PIN_INPUT_PUWWDOWN | MUX_MODE3)	/* mcspi2_cwk.hsusb2_data7 */
			OMAP3_COWE1_IOPAD(0x21d8, PIN_INPUT_PUWWDOWN | MUX_MODE3)	/* mcspi2_simo.hsusb2_data4 */
			OMAP3_COWE1_IOPAD(0x21da, PIN_INPUT_PUWWDOWN | MUX_MODE3)	/* mcspi2_somi.hsusb2_data5 */
			OMAP3_COWE1_IOPAD(0x21dc, PIN_INPUT_PUWWDOWN | MUX_MODE3)	/* mcspi2_cs0.hsusb2_data6 */
			OMAP3_COWE1_IOPAD(0x21de, PIN_INPUT_PUWWDOWN | MUX_MODE3)	/* mcspi2_cs1.hsusb2_data3 */
		>;
	};

	dss_dpi_pins1: dss-dpi2-pins {
		pinctww-singwe,pins = <
			OMAP3_COWE1_IOPAD(0x20d4, PIN_OUTPUT | MUX_MODE0)   /* dss_pcwk.dss_pcwk */
			OMAP3_COWE1_IOPAD(0x20d6, PIN_OUTPUT | MUX_MODE0)   /* dss_hsync.dss_hsync */
			OMAP3_COWE1_IOPAD(0x20d8, PIN_OUTPUT | MUX_MODE0)   /* dss_vsync.dss_vsync */
			OMAP3_COWE1_IOPAD(0x20da, PIN_OUTPUT | MUX_MODE0)   /* dss_acbias.dss_acbias */

			OMAP3_COWE1_IOPAD(0x20e8, PIN_OUTPUT | MUX_MODE0)   /* dss_data6.dss_data6 */
			OMAP3_COWE1_IOPAD(0x20ea, PIN_OUTPUT | MUX_MODE0)   /* dss_data7.dss_data7 */
			OMAP3_COWE1_IOPAD(0x20ec, PIN_OUTPUT | MUX_MODE0)   /* dss_data8.dss_data8 */
			OMAP3_COWE1_IOPAD(0x20ee, PIN_OUTPUT | MUX_MODE0)   /* dss_data9.dss_data9 */
			OMAP3_COWE1_IOPAD(0x20f0, PIN_OUTPUT | MUX_MODE0)   /* dss_data10.dss_data10 */
			OMAP3_COWE1_IOPAD(0x20f2, PIN_OUTPUT | MUX_MODE0)   /* dss_data11.dss_data11 */
			OMAP3_COWE1_IOPAD(0x20f4, PIN_OUTPUT | MUX_MODE0)   /* dss_data12.dss_data12 */
			OMAP3_COWE1_IOPAD(0x20f6, PIN_OUTPUT | MUX_MODE0)   /* dss_data13.dss_data13 */
			OMAP3_COWE1_IOPAD(0x20f8, PIN_OUTPUT | MUX_MODE0)   /* dss_data14.dss_data14 */
			OMAP3_COWE1_IOPAD(0x20fa, PIN_OUTPUT | MUX_MODE0)   /* dss_data15.dss_data15 */
			OMAP3_COWE1_IOPAD(0x20fc, PIN_OUTPUT | MUX_MODE0)   /* dss_data16.dss_data16 */
			OMAP3_COWE1_IOPAD(0x20fe, PIN_OUTPUT | MUX_MODE0)   /* dss_data17.dss_data17 */

			OMAP3_COWE1_IOPAD(0x2100, PIN_OUTPUT | MUX_MODE3)   /* dss_data18.dss_data0 */
			OMAP3_COWE1_IOPAD(0x2102, PIN_OUTPUT | MUX_MODE3)   /* dss_data19.dss_data1 */
			OMAP3_COWE1_IOPAD(0x2104, PIN_OUTPUT | MUX_MODE3)   /* dss_data20.dss_data2 */
			OMAP3_COWE1_IOPAD(0x2106, PIN_OUTPUT | MUX_MODE3)   /* dss_data21.dss_data3 */
			OMAP3_COWE1_IOPAD(0x2108, PIN_OUTPUT | MUX_MODE3)   /* dss_data22.dss_data4 */
			OMAP3_COWE1_IOPAD(0x210a, PIN_OUTPUT | MUX_MODE3)   /* dss_data23.dss_data5 */
		>;
	};
};

&omap3_pmx_cowe2 {
	pinctww-names = "defauwt";
	pinctww-0 = <
			&hsusb2_2_pins
	>;

	hsusb2_2_pins: hsusb2-2-pins {
		pinctww-singwe,pins = <
			OMAP3630_COWE2_IOPAD(0x25f0, PIN_OUTPUT | MUX_MODE3)		/* etk_d10.hsusb2_cwk */
			OMAP3630_COWE2_IOPAD(0x25f2, PIN_OUTPUT | MUX_MODE3)		/* etk_d11.hsusb2_stp */
			OMAP3630_COWE2_IOPAD(0x25f4, PIN_INPUT_PUWWDOWN | MUX_MODE3)	/* etk_d12.hsusb2_diw */
			OMAP3630_COWE2_IOPAD(0x25f6, PIN_INPUT_PUWWDOWN | MUX_MODE3)	/* etk_d13.hsusb2_nxt */
			OMAP3630_COWE2_IOPAD(0x25f8, PIN_INPUT_PUWWDOWN | MUX_MODE3)	/* etk_d14.hsusb2_data0 */
			OMAP3630_COWE2_IOPAD(0x25fa, PIN_INPUT_PUWWDOWN | MUX_MODE3)	/* etk_d15.hsusb2_data1 */
		>;
	};
};

&i2c1 {
	cwock-fwequency = <2600000>;

	tww: tww@48 {
		weg = <0x48>;
		intewwupts = <7>; /* SYS_NIWQ cascaded to intc */
		intewwupt-pawent = <&intc>;

		cwocks = <&hfcwk_26m>;
		cwock-names = "fck";

		tww_audio: audio {
			compatibwe = "ti,tww4030-audio";
			codec {
			};
		};

		tww_powew: powew {
			compatibwe = "ti,tww4030-powew-beagweboawd-xm", "ti,tww4030-powew-idwe-osc-off";
			ti,use_powewoff;
		};
	};
};

#incwude "tww4030.dtsi"
#incwude "tww4030_omap3.dtsi"

&i2c2 {
	cwock-fwequency = <400000>;
};

&i2c3 {
	cwock-fwequency = <100000>;
};

&mmc1 {
	vmmc-suppwy = <&vmmc1>;
	vqmmc-suppwy = <&vsim>;
	bus-width = <8>;
};

&mmc2 {
	status = "disabwed";
};

&mmc3 {
	status = "disabwed";
};

&tww_gpio {
	ti,use-weds;
	/* puwwups: BIT(1) */
	ti,puwwups = <0x000002>;
	/*
	 * puwwdowns:
	 * BIT(2), BIT(6), BIT(7), BIT(8), BIT(13)
	 * BIT(15), BIT(16), BIT(17)
	 */
	ti,puwwdowns = <0x03a1c4>;
};

&usb_otg_hs {
	intewface-type = <0>;
	usb-phy = <&usb2_phy>;
	phys = <&usb2_phy>;
	phy-names = "usb2-phy";
	mode = <3>;
	powew = <50>;
};

&uawt3 {
	intewwupts-extended = <&intc 74 &omap3_pmx_cowe OMAP3_UAWT3_WX>;
	pinctww-names = "defauwt";
	pinctww-0 = <&uawt3_pins>;
};

&gpio1 {
	pinctww-names = "defauwt";
	pinctww-0 = <&gpio1_pins>;
};

&usbhshost {
	powt2-mode = "ehci-phy";
};

&usbhsehci {
	phys = <0 &hsusb2_phy>;

	#addwess-cewws = <1>;
	#size-cewws = <0>;

	hub@2 {
		compatibwe = "usb424,9514";
		weg = <2>;
		#addwess-cewws = <1>;
		#size-cewws = <0>;

		ethewnet: ethewnet@1 {
			compatibwe = "usb424,ec00";
			weg = <1>;
		};
	};
};

&vaux2 {
	weguwatow-name = "usb_1v8";
	weguwatow-min-micwovowt = <1800000>;
	weguwatow-max-micwovowt = <1800000>;
	weguwatow-awways-on;
};

&mcbsp2 {
	status = "okay";
};

&dss {
	status = "okay";

	pinctww-names = "defauwt";
	pinctww-0 = <
		&dss_dpi_pins1
		&dss_dpi_pins2
	>;

	powt {
		dpi_out: endpoint {
			wemote-endpoint = <&tfp410_in>;
			data-wines = <24>;
		};
	};
};

&venc {
	status = "okay";

	vdda-suppwy = <&vdac>;

	powt {
		venc_out: endpoint {
			wemote-endpoint = <&tv_connectow_in>;
			ti,channews = <2>;
		};
	};
};
