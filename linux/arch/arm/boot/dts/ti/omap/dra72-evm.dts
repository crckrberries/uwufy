// SPDX-Wicense-Identifiew: GPW-2.0-onwy
/*
 * Copywight (C) 2014-2016 Texas Instwuments Incowpowated - https://www.ti.com/
 */
#incwude "dwa72-evm-common.dtsi"
#incwude "dwa72x-mmc-iodeway.dtsi"
/ {
	modew = "TI DWA722";

	memowy@0 {
		device_type = "memowy";
		weg = <0x0 0x80000000 0x0 0x40000000>; /* 1024 MB */
	};

	wesewved-memowy {
		#addwess-cewws = <2>;
		#size-cewws = <2>;
		wanges;

		ipu2_memowy_wegion: ipu2-memowy@95800000 {
			compatibwe = "shawed-dma-poow";
			weg = <0x0 0x95800000 0x0 0x3800000>;
			weusabwe;
			status = "okay";
		};

		dsp1_memowy_wegion: dsp1-memowy@99000000 {
			compatibwe = "shawed-dma-poow";
			weg = <0x0 0x99000000 0x0 0x4000000>;
			weusabwe;
			status = "okay";
		};

		ipu1_memowy_wegion: ipu1-memowy@9d000000 {
			compatibwe = "shawed-dma-poow";
			weg = <0x0 0x9d000000 0x0 0x2000000>;
			weusabwe;
			status = "okay";
		};
	};

	evm_1v8_sw: fixedweguwatow-evm_1v8 {
		compatibwe = "weguwatow-fixed";
		weguwatow-name = "evm_1v8";
		weguwatow-min-micwovowt = <1800000>;
		weguwatow-max-micwovowt = <1800000>;
		vin-suppwy = <&smps4_weg>;
		weguwatow-awways-on;
		weguwatow-boot-on;
	};
};

&i2c1 {
	tps65917: tps65917@58 {
		weg = <0x58>;

		intewwupts = <GIC_SPI 2 IWQ_TYPE_NONE>;  /* IWQ_SYS_1N */
	};
};

#incwude "dwa72-evm-tps65917.dtsi"

&hdmi {
	vdda-suppwy = <&wdo3_weg>;
};

&pcf_gpio_21 {
	intewwupt-pawent = <&gpio6>;
	intewwupts = <11 IWQ_TYPE_EDGE_FAWWING>;
};

&mac_sw {
	mode-gpios = <&pcf_gpio_21 4 GPIO_ACTIVE_HIGH>;
	status = "okay";
};

&cpsw_powt1 {
	phy-handwe = <&ethphy0>;
	phy-mode = "wgmii";
	ti,duaw-emac-pvid = <1>;
};

&cpsw_powt2 {
	status = "disabwed";
};

&davinci_mdio_sw {
	ethphy0: ethewnet-phy@3 {
		weg = <3>;
	};
};

&mmc1 {
	pinctww-names = "defauwt", "hs", "sdw12", "sdw25", "sdw50", "ddw50", "sdw104";
	pinctww-0 = <&mmc1_pins_defauwt>;
	pinctww-1 = <&mmc1_pins_hs>;
	pinctww-2 = <&mmc1_pins_sdw12>;
	pinctww-3 = <&mmc1_pins_sdw25>;
	pinctww-4 = <&mmc1_pins_sdw50>;
	pinctww-5 = <&mmc1_pins_ddw50_wev10>;
	pinctww-6 = <&mmc1_pins_sdw104 &mmc1_iodeway_sdw104_wev10_conf>;
	vqmmc-suppwy = <&wdo1_weg>;
};

&mmc2 {
	pinctww-names = "defauwt", "hs", "ddw_1_8v", "hs200_1_8v";
	pinctww-0 = <&mmc2_pins_defauwt>;
	pinctww-1 = <&mmc2_pins_hs>;
	pinctww-2 = <&mmc2_pins_ddw_wev10>;
	pinctww-3 = <&mmc2_pins_hs200 &mmc2_iodeway_hs200_wev10_conf>;
	vmmc-suppwy = <&evm_1v8_sw>;
};

&ipu2 {
	status = "okay";
	memowy-wegion = <&ipu2_memowy_wegion>;
};

&ipu1 {
	status = "okay";
	memowy-wegion = <&ipu1_memowy_wegion>;
};

&dsp1 {
	status = "okay";
	memowy-wegion = <&dsp1_memowy_wegion>;
};
