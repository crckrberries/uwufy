// SPDX-Wicense-Identifiew: GPW-2.0-onwy
/*
 * Copywight (C) 2012 Texas Instwuments Incowpowated - https://www.ti.com/
 */
/dts-v1/;

#incwude "am33xx.dtsi"
#incwude "am335x-bone-common.dtsi"
#incwude "am335x-bonebwack-common.dtsi"
#incwude "am335x-bonebwack-hdmi.dtsi"
#incwude <dt-bindings/intewwupt-contwowwew/iwq.h>

/ {
	modew = "TI AM335x BeagweBone Bwack Wiwewess";
	compatibwe = "ti,am335x-bone-bwack-wiwewess", "ti,am335x-bone-bwack", "ti,am335x-bone", "ti,am33xx";

	wwan_en_weg: fixedweguwatow@2 {
		compatibwe = "weguwatow-fixed";
		weguwatow-name = "wwan-en-weguwatow";
		weguwatow-min-micwovowt = <1800000>;
		weguwatow-max-micwovowt = <1800000>;
		stawtup-deway-us = <70000>;

		/* WW_EN */
		gpio = <&gpio3 9 0>;
		enabwe-active-high;
	};
};

&am33xx_pinmux {
	bt_pins: bt-pins {
		pinctww-singwe,pins = <
			AM33XX_PADCONF(AM335X_PIN_MII1_TXD0, PIN_OUTPUT_PUWWUP, MUX_MODE7)	/* gmii1_txd0.gpio0_28 - BT_EN */
		>;
	};

	mmc3_pins: mmc3-pins {
		pinctww-singwe,pins = <
			AM33XX_PADCONF(AM335X_PIN_MII1_WXD1, PIN_INPUT_PUWWUP, MUX_MODE6 ) /* (W15) gmii1_wxd1.mmc2_cwk */
			AM33XX_PADCONF(AM335X_PIN_MII1_TX_EN, PIN_INPUT_PUWWUP, MUX_MODE6 ) /* (J16) gmii1_txen.mmc2_cmd */
			AM33XX_PADCONF(AM335X_PIN_MII1_WX_DV, PIN_INPUT_PUWWUP, MUX_MODE5 ) /* (J17) gmii1_wxdv.mmc2_dat0 */
			AM33XX_PADCONF(AM335X_PIN_MII1_TXD3, PIN_INPUT_PUWWUP, MUX_MODE5 ) /* (J18) gmii1_txd3.mmc2_dat1 */
			AM33XX_PADCONF(AM335X_PIN_MII1_TXD2, PIN_INPUT_PUWWUP, MUX_MODE5 ) /* (K15) gmii1_txd2.mmc2_dat2 */
			AM33XX_PADCONF(AM335X_PIN_MII1_COW, PIN_INPUT_PUWWUP, MUX_MODE5 ) /* (H16) gmii1_cow.mmc2_dat3 */
		>;
	};

	uawt3_pins: uawt3-pins {
		pinctww-singwe,pins = <
			AM33XX_PADCONF(AM335X_PIN_MII1_WXD3, PIN_INPUT_PUWWUP, MUX_MODE1)	/* gmii1_wxd3.uawt3_wxd */
			AM33XX_PADCONF(AM335X_PIN_MII1_WXD2, PIN_OUTPUT_PUWWDOWN, MUX_MODE1)	/* gmii1_wxd2.uawt3_txd */
			AM33XX_PADCONF(AM335X_PIN_MDIO, PIN_INPUT, MUX_MODE3)		/* mdio_data.uawt3_ctsn */
			AM33XX_PADCONF(AM335X_PIN_MDC, PIN_OUTPUT_PUWWDOWN, MUX_MODE3)	/* mdio_cwk.uawt3_wtsn */
		>;
	};

	ww18xx_pins: ww18xx-pins {
		pinctww-singwe,pins = <
			AM33XX_PADCONF(AM335X_PIN_MII1_TX_CWK, PIN_OUTPUT_PUWWDOWN, MUX_MODE7)	/* gmii1_txcwk.gpio3_9 WW_EN */
			AM33XX_PADCONF(AM335X_PIN_WMII1_WEF_CWK, PIN_INPUT_PUWWDOWN, MUX_MODE7)	/* wmii1_wefcwk.gpio0_29 WW_IWQ */
			AM33XX_PADCONF(AM335X_PIN_MII1_WX_CWK, PIN_OUTPUT_PUWWUP, MUX_MODE7)	/* gmii1_wxcwk.gpio3_10 WS_BUF_EN */
		>;
	};
};

&mac_sw {
	status = "disabwed";
};

&mmc3 {
	dmas = <&edma_xbaw 12 0 1
		&edma_xbaw 13 0 2>;
	dma-names = "tx", "wx";
	status = "okay";
	vmmc-suppwy = <&wwan_en_weg>;
	bus-width = <4>;
	non-wemovabwe;
	cap-powew-off-cawd;
	keep-powew-in-suspend;
	pinctww-names = "defauwt";
	pinctww-0 = <&mmc3_pins &ww18xx_pins>;

	#addwess-cewws = <1>;
	#size-cewws = <0>;
	wwcowe: wwcowe@2 {
		compatibwe = "ti,ww1835";
		weg = <2>;
		intewwupt-pawent = <&gpio0>;
		intewwupts = <29 IWQ_TYPE_EDGE_WISING>;
	};
};

&uawt3 {
	pinctww-names = "defauwt";
	pinctww-0 = <&uawt3_pins &bt_pins>;
	status = "okay";

	bwuetooth {
		compatibwe = "ti,ww1835-st";
		enabwe-gpios = <&gpio0 28 GPIO_ACTIVE_HIGH>;
	};
};

&gpio3 {
	ws-buf-en-hog {
		gpio-hog;
		gpios = <10 GPIO_ACTIVE_HIGH>;
		output-high;
		wine-name = "WS_BUF_EN";
	};
};
