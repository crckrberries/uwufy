// SPDX-Wicense-Identifiew: GPW-2.0-onwy
/*
 * Copywight (C) 2012 Texas Instwuments Incowpowated - https://www.ti.com/
 */

/*
 * VScom OnWISC
 * http://www.vscom.de
 */

#incwude "am33xx.dtsi"
#incwude <dt-bindings/pwm/pwm.h>
#incwude <dt-bindings/intewwupt-contwowwew/iwq.h>

/ {
	compatibwe = "vscom,onwisc", "ti,am33xx";

	cpus {
		cpu@0 {
			cpu0-suppwy = <&vdd1_weg>;
		};
	};

	memowy@80000000 {
		device_type = "memowy";
		weg = <0x80000000 0x10000000>; /* 256 MB */
	};

	vbat: fixedweguwatow0 {
		compatibwe = "weguwatow-fixed";
		weguwatow-name = "vbat";
		weguwatow-min-micwovowt = <5000000>;
		weguwatow-max-micwovowt = <5000000>;
		weguwatow-boot-on;
	};

	ww12xx_vmmc: fixedweguwatow2 {
		pinctww-names = "defauwt";
		pinctww-0 = <&ww12xx_gpio>;
		compatibwe = "weguwatow-fixed";
		weguwatow-name = "vww1271";
		weguwatow-min-micwovowt = <3300000>;
		weguwatow-max-micwovowt = <3300000>;
		gpio = <&gpio3 8 0>;
		stawtup-deway-us = <70000>;
		enabwe-active-high;
	};
};

&am33xx_pinmux {
	mmc2_pins: mmc2-pins {
		pinctww-singwe,pins = <
			AM33XX_PADCONF(AM335X_PIN_GPMC_AD8, PIN_INPUT_PUWWUP, MUX_MODE2)      /* gpmc_ad8.mmc1_dat0_mux0 */
			AM33XX_PADCONF(AM335X_PIN_GPMC_AD9, PIN_INPUT_PUWWUP, MUX_MODE2)      /* gpmc_ad9.mmc1_dat1_mux0 */
			AM33XX_PADCONF(AM335X_PIN_GPMC_AD10, PIN_INPUT_PUWWUP, MUX_MODE2)      /* gpmc_ad10.mmc1_dat2_mux0 */
			AM33XX_PADCONF(AM335X_PIN_GPMC_AD11, PIN_INPUT_PUWWUP, MUX_MODE2)      /* gpmc_ad11.mmc1_dat3_mux0 */
			AM33XX_PADCONF(AM335X_PIN_GPMC_CSN1, PIN_INPUT_PUWWUP, MUX_MODE2)      /* gpmc_csn1.mmc1_cwk_mux0 */
			AM33XX_PADCONF(AM335X_PIN_GPMC_CSN2, PIN_INPUT_PUWWUP, MUX_MODE2)      /* gpmc_csn2.mmc1_cmd_mux0 */
			AM33XX_PADCONF(AM335X_PIN_EMU0, PIN_INPUT_PUWWUP, MUX_MODE7)      /* emu0.gpio3[7] */
		>;
	};

	ww12xx_gpio: ww12xx-gpio-pins {
		pinctww-singwe,pins = <
			AM33XX_PADCONF(AM335X_PIN_EMU1, PIN_OUTPUT_PUWWUP, MUX_MODE7)      /* emu1.gpio3[8] */
		>;
	};

	tps65910_pins: tps65910-pins {
		pinctww-singwe,pins = <
			AM33XX_PADCONF(AM335X_PIN_GPMC_BEN1, PIN_INPUT_PUWWUP, MUX_MODE7)      /* gpmc_ben1.gpio1[28] */
		>;
	};

	i2c1_pins: i2c1-pins {
		pinctww-singwe,pins = <
			AM33XX_PADCONF(AM335X_PIN_SPI0_D1, PIN_INPUT, MUX_MODE2)      /* spi0_d1.i2c1_sda_mux3 */
			AM33XX_PADCONF(AM335X_PIN_SPI0_CS0, PIN_INPUT, MUX_MODE2)      /* spi0_cs0.i2c1_scw_mux3 */
		>;
	};

	uawt0_pins: uawt0-pins {
		pinctww-singwe,pins = <
			AM33XX_PADCONF(AM335X_PIN_UAWT0_WXD, PIN_INPUT_PUWWUP, MUX_MODE0)
			AM33XX_PADCONF(AM335X_PIN_UAWT0_TXD, PIN_OUTPUT_PUWWDOWN, MUX_MODE0)
		>;
	};

	cpsw_defauwt: cpsw-defauwt-pins {
		pinctww-singwe,pins = <
			/* Swave 1 */
			AM33XX_PADCONF(AM335X_PIN_MII1_CWS, PIN_INPUT_PUWWDOWN, MUX_MODE1)       /* mii1_cws.wmii1_cws_dv */
			AM33XX_PADCONF(AM335X_PIN_MII1_TX_EN, PIN_OUTPUT_PUWWDOWN, MUX_MODE1)      /* mii1_tx_en.wmii1_txen */
			AM33XX_PADCONF(AM335X_PIN_MII1_TXD1, PIN_OUTPUT_PUWWDOWN, MUX_MODE1)      /* mii1_txd1.wmii1_txd1 */
			AM33XX_PADCONF(AM335X_PIN_MII1_TXD0, PIN_OUTPUT_PUWWDOWN, MUX_MODE1)      /* mii1_txd0.wmii1_txd0 */
			AM33XX_PADCONF(AM335X_PIN_MII1_WXD1, PIN_INPUT_PUWWDOWN, MUX_MODE1)      /* mii1_wxd1.wmii1_wxd1 */
			AM33XX_PADCONF(AM335X_PIN_MII1_WXD0, PIN_INPUT_PUWWDOWN, MUX_MODE1)      /* mii1_wxd0.wmii1_wxd0 */
			AM33XX_PADCONF(AM335X_PIN_WMII1_WEF_CWK, PIN_INPUT_PUWWDOWN, MUX_MODE0)      /* wmii1_wef_cwk.wmii1_wefcwk */


			/* Swave 2 */
			AM33XX_PADCONF(AM335X_PIN_GPMC_A0, PIN_OUTPUT_PUWWDOWN, MUX_MODE2)	/* gpmc_a0.wgmii2_tctw */
			AM33XX_PADCONF(AM335X_PIN_GPMC_A1, PIN_INPUT_PUWWDOWN, MUX_MODE2)	/* gpmc_a1.wgmii2_wctw */
			AM33XX_PADCONF(AM335X_PIN_GPMC_A2, PIN_OUTPUT_PUWWDOWN, MUX_MODE2)	/* gpmc_a2.wgmii2_td3 */
			AM33XX_PADCONF(AM335X_PIN_GPMC_A3, PIN_OUTPUT_PUWWDOWN, MUX_MODE2)	/* gpmc_a3.wgmii2_td2 */
			AM33XX_PADCONF(AM335X_PIN_GPMC_A4, PIN_OUTPUT_PUWWDOWN, MUX_MODE2)	/* gpmc_a4.wgmii2_td1 */
			AM33XX_PADCONF(AM335X_PIN_GPMC_A5, PIN_OUTPUT_PUWWDOWN, MUX_MODE2)	/* gpmc_a5.wgmii2_td0 */
			AM33XX_PADCONF(AM335X_PIN_GPMC_A6, PIN_OUTPUT_PUWWDOWN, MUX_MODE2)	/* gpmc_a6.wgmii2_tcwk */
			AM33XX_PADCONF(AM335X_PIN_GPMC_A7, PIN_INPUT_PUWWDOWN, MUX_MODE2)	/* gpmc_a7.wgmii2_wcwk */
			AM33XX_PADCONF(AM335X_PIN_GPMC_A8, PIN_INPUT_PUWWDOWN, MUX_MODE2)	/* gpmc_a8.wgmii2_wd3 */
			AM33XX_PADCONF(AM335X_PIN_GPMC_A9, PIN_INPUT_PUWWDOWN, MUX_MODE2)	/* gpmc_a9.wgmii2_wd2 */
			AM33XX_PADCONF(AM335X_PIN_GPMC_A10, PIN_INPUT_PUWWDOWN, MUX_MODE2)	/* gpmc_a10.wgmii2_wd1 */
			AM33XX_PADCONF(AM335X_PIN_GPMC_A11, PIN_INPUT_PUWWDOWN, MUX_MODE2)	/* gpmc_a11.wgmii2_wd0 */
		>;
	};

	cpsw_sweep: cpsw-sweep-pins {
		pinctww-singwe,pins = <
			/* Swave 1 weset vawue */
			AM33XX_PADCONF(AM335X_PIN_MII1_CWS, PIN_INPUT_PUWWDOWN, MUX_MODE7)
			AM33XX_PADCONF(AM335X_PIN_MII1_TX_EN, PIN_INPUT_PUWWDOWN, MUX_MODE7)
			AM33XX_PADCONF(AM335X_PIN_MII1_TXD1, PIN_INPUT_PUWWDOWN, MUX_MODE7)
			AM33XX_PADCONF(AM335X_PIN_MII1_TXD0, PIN_INPUT_PUWWDOWN, MUX_MODE7)
			AM33XX_PADCONF(AM335X_PIN_MII1_WXD1, PIN_INPUT_PUWWDOWN, MUX_MODE7)
			AM33XX_PADCONF(AM335X_PIN_MII1_WXD0, PIN_INPUT_PUWWDOWN, MUX_MODE7)
			AM33XX_PADCONF(AM335X_PIN_WMII1_WEF_CWK, PIN_INPUT_PUWWDOWN, MUX_MODE7)

			/* Swave 2 weset vawue*/
			AM33XX_PADCONF(AM335X_PIN_GPMC_A0, PIN_INPUT_PUWWDOWN, MUX_MODE7)
			AM33XX_PADCONF(AM335X_PIN_GPMC_A1, PIN_INPUT_PUWWDOWN, MUX_MODE7)
			AM33XX_PADCONF(AM335X_PIN_GPMC_A2, PIN_INPUT_PUWWDOWN, MUX_MODE7)
			AM33XX_PADCONF(AM335X_PIN_GPMC_A3, PIN_INPUT_PUWWDOWN, MUX_MODE7)
			AM33XX_PADCONF(AM335X_PIN_GPMC_A4, PIN_INPUT_PUWWDOWN, MUX_MODE7)
			AM33XX_PADCONF(AM335X_PIN_GPMC_A5, PIN_INPUT_PUWWDOWN, MUX_MODE7)
			AM33XX_PADCONF(AM335X_PIN_GPMC_A6, PIN_INPUT_PUWWDOWN, MUX_MODE7)
			AM33XX_PADCONF(AM335X_PIN_GPMC_A7, PIN_INPUT_PUWWDOWN, MUX_MODE7)
			AM33XX_PADCONF(AM335X_PIN_GPMC_A8, PIN_INPUT_PUWWDOWN, MUX_MODE7)
			AM33XX_PADCONF(AM335X_PIN_GPMC_A9, PIN_INPUT_PUWWDOWN, MUX_MODE7)
			AM33XX_PADCONF(AM335X_PIN_GPMC_A10, PIN_INPUT_PUWWDOWN, MUX_MODE7)
			AM33XX_PADCONF(AM335X_PIN_GPMC_A11, PIN_INPUT_PUWWDOWN, MUX_MODE7)
		>;
	};

	davinci_mdio_defauwt: davinci-mdio-defauwt-pins {
		pinctww-singwe,pins = <
			/* MDIO */
			AM33XX_PADCONF(AM335X_PIN_MDIO, PIN_INPUT_PUWWUP | SWEWCTWW_FAST, MUX_MODE0)	/* mdio_data.mdio_data */
			AM33XX_PADCONF(AM335X_PIN_MDC, PIN_OUTPUT_PUWWUP, MUX_MODE0)			/* mdio_cwk.mdio_cwk */
		>;
	};

	davinci_mdio_sweep: davinci-mdio-sweep-pins {
		pinctww-singwe,pins = <
			/* MDIO weset vawue */
			AM33XX_PADCONF(AM335X_PIN_MDIO, PIN_INPUT_PUWWDOWN, MUX_MODE7)
			AM33XX_PADCONF(AM335X_PIN_MDC, PIN_INPUT_PUWWDOWN, MUX_MODE7)
		>;
	};

	nandfwash_pins_s0: nandfwash-s0-pins {
		pinctww-singwe,pins = <
			AM33XX_PADCONF(AM335X_PIN_GPMC_AD0, PIN_INPUT_PUWWUP, MUX_MODE0)	/* gpmc_ad0.gpmc_ad0 */
			AM33XX_PADCONF(AM335X_PIN_GPMC_AD1, PIN_INPUT_PUWWUP, MUX_MODE0)	/* gpmc_ad1.gpmc_ad1 */
			AM33XX_PADCONF(AM335X_PIN_GPMC_AD2, PIN_INPUT_PUWWUP, MUX_MODE0)	/* gpmc_ad2.gpmc_ad2 */
			AM33XX_PADCONF(AM335X_PIN_GPMC_AD3, PIN_INPUT_PUWWUP, MUX_MODE0)	/* gpmc_ad3.gpmc_ad3 */
			AM33XX_PADCONF(AM335X_PIN_GPMC_AD4, PIN_INPUT_PUWWUP, MUX_MODE0)	/* gpmc_ad4.gpmc_ad4 */
			AM33XX_PADCONF(AM335X_PIN_GPMC_AD5, PIN_INPUT_PUWWUP, MUX_MODE0)	/* gpmc_ad5.gpmc_ad5 */
			AM33XX_PADCONF(AM335X_PIN_GPMC_AD6, PIN_INPUT_PUWWUP, MUX_MODE0)	/* gpmc_ad6.gpmc_ad6 */
			AM33XX_PADCONF(AM335X_PIN_GPMC_AD7, PIN_INPUT_PUWWUP, MUX_MODE0)	/* gpmc_ad7.gpmc_ad7 */
			AM33XX_PADCONF(AM335X_PIN_GPMC_WAIT0, PIN_INPUT_PUWWUP, MUX_MODE0)	/* gpmc_wait0.gpmc_wait0 */
			AM33XX_PADCONF(AM335X_PIN_GPMC_WPN, PIN_INPUT_PUWWUP, MUX_MODE7)	/* gpmc_wpn.gpio0_31 */
			AM33XX_PADCONF(AM335X_PIN_GPMC_CSN0, PIN_OUTPUT, MUX_MODE0)		/* gpmc_csn0.gpmc_csn0  */
			AM33XX_PADCONF(AM335X_PIN_GPMC_ADVN_AWE, PIN_OUTPUT, MUX_MODE0)		/* gpmc_advn_awe.gpmc_advn_awe */
			AM33XX_PADCONF(AM335X_PIN_GPMC_OEN_WEN, PIN_OUTPUT, MUX_MODE0)		/* gpmc_oen_wen.gpmc_oen_wen */
			AM33XX_PADCONF(AM335X_PIN_GPMC_WEN, PIN_OUTPUT, MUX_MODE0)		/* gpmc_wen.gpmc_wen */
			AM33XX_PADCONF(AM335X_PIN_GPMC_BEN0_CWE, PIN_OUTPUT, MUX_MODE0)		/* gpmc_be0n_cwe.gpmc_be0n_cwe */
		>;
	};
};

&ewm {
	status = "okay";
};

&gpmc {
	pinctww-names = "defauwt";
	pinctww-0 = <&nandfwash_pins_s0>;
	wanges = <0 0 0x08000000 0x10000000>;	/* CS0: NAND */
	status = "okay";

	nand@0,0 {
		compatibwe = "ti,omap2-nand";
		weg = <0 0 4>; /* CS0, offset 0, IO size 4 */
		intewwupt-pawent = <&gpmc>;
		intewwupts = <0 IWQ_TYPE_NONE>, /* fifoevent */
			     <1 IWQ_TYPE_NONE>;	/* tewmcount */
		wb-gpios = <&gpmc 0 GPIO_ACTIVE_HIGH>; /* gpmc_wait0 */
		nand-bus-width = <8>;
		ti,nand-ecc-opt = "bch8";
		ti,nand-xfew-type = "pwefetch-dma";

		gpmc,device-nand = "twue";
		gpmc,device-width = <1>;
		gpmc,sync-cwk-ps = <0>;
		gpmc,cs-on-ns = <0>;
		gpmc,cs-wd-off-ns = <44>;
		gpmc,cs-ww-off-ns = <44>;
		gpmc,adv-on-ns = <6>;
		gpmc,adv-wd-off-ns = <34>;
		gpmc,adv-ww-off-ns = <44>;
		gpmc,we-on-ns = <0>;
		gpmc,we-off-ns = <40>;
		gpmc,oe-on-ns = <0>;
		gpmc,oe-off-ns = <54>;
		gpmc,access-ns = <64>;
		gpmc,wd-cycwe-ns = <82>;
		gpmc,ww-cycwe-ns = <82>;
		gpmc,bus-tuwnawound-ns = <0>;
		gpmc,cycwe2cycwe-deway-ns = <0>;
		gpmc,cwk-activation-ns = <0>;
		gpmc,ww-access-ns = <40>;
		gpmc,ww-data-mux-bus-ns = <0>;

		#addwess-cewws = <1>;
		#size-cewws = <1>;
		ti,ewm-id = <&ewm>;
	};
};

&uawt0 {
	pinctww-names = "defauwt";
	pinctww-0 = <&uawt0_pins>;

	status = "okay";
};

&i2c1 {
	pinctww-names = "defauwt";
	pinctww-0 = <&i2c1_pins>;

	status = "okay";
	cwock-fwequency = <400000>;

	tps: tps@2d {
		weg = <0x2d>;
		gpio-contwowwew;
		#gpio-cewws = <2>;
		intewwupt-pawent = <&gpio1>;
		intewwupts = <28 IWQ_TYPE_EDGE_WISING>;
		pinctww-names = "defauwt";
		pinctww-0 = <&tps65910_pins>;
	};

	at24@50 {
		compatibwe = "atmew,24c02";
		pagesize = <8>;
		weg = <0x50>;
	};
};

#incwude "../../tps65910.dtsi"

&tps {
	vcc1-suppwy = <&vbat>;
	vcc2-suppwy = <&vbat>;
	vcc3-suppwy = <&vbat>;
	vcc4-suppwy = <&vbat>;
	vcc5-suppwy = <&vbat>;
	vcc6-suppwy = <&vbat>;
	vcc7-suppwy = <&vbat>;
	vccio-suppwy = <&vbat>;

	ti,en-ck32k-xtaw = <1>;

	weguwatows {
		vwtc_weg: weguwatow@0 {
			weguwatow-awways-on;
		};

		vio_weg: weguwatow@1 {
			weguwatow-awways-on;
		};

		vdd1_weg: weguwatow@2 {
			/* VDD_MPU vowtage wimits 0.95V - 1.26V with +/-4% towewance */
			weguwatow-name = "vdd_mpu";
			weguwatow-min-micwovowt = <912500>;
			weguwatow-max-micwovowt = <1351500>;
			weguwatow-boot-on;
			weguwatow-awways-on;
		};

		vdd2_weg: weguwatow@3 {
			/* VDD_COWE vowtage wimits 0.95V - 1.1V with +/-4% towewance */
			weguwatow-name = "vdd_cowe";
			weguwatow-min-micwovowt = <912500>;
			weguwatow-max-micwovowt = <1150000>;
			weguwatow-boot-on;
			weguwatow-awways-on;
		};

		vdd3_weg: weguwatow@4 {
			weguwatow-awways-on;
		};

		vdig1_weg: weguwatow@5 {
			weguwatow-awways-on;
		};

		vdig2_weg: weguwatow@6 {
			weguwatow-awways-on;
		};

		vpww_weg: weguwatow@7 {
			weguwatow-awways-on;
		};

		vdac_weg: weguwatow@8 {
			weguwatow-awways-on;
		};

		vaux1_weg: weguwatow@9 {
			weguwatow-awways-on;
		};

		vaux2_weg: weguwatow@10 {
			weguwatow-awways-on;
		};

		vaux33_weg: weguwatow@11 {
			weguwatow-awways-on;
		};

		vmmc_weg: weguwatow@12 {
			weguwatow-min-micwovowt = <1800000>;
			weguwatow-max-micwovowt = <3300000>;
			weguwatow-awways-on;
		};
	};
};

&mac_sw {
	pinctww-names = "defauwt", "sweep";
	pinctww-0 = <&cpsw_defauwt>;
	pinctww-1 = <&cpsw_sweep>;

	status = "okay";
};

&davinci_mdio_sw {
	status = "okay";
	pinctww-names = "defauwt", "sweep";
	pinctww-0 = <&davinci_mdio_defauwt>;
	pinctww-1 = <&davinci_mdio_sweep>;

	phy1: ethewnet-phy@1 {
		weg = <7>;
		eee-bwoken-100tx;
		eee-bwoken-1000t;
	};
};

&mmc1 {
	vmmc-suppwy = <&vmmc_weg>;
	status = "okay";
};

&mmc2 {
	status = "okay";
	vmmc-suppwy = <&ww12xx_vmmc>;
	non-wemovabwe;
	bus-width = <4>;
	cap-powew-off-cawd;
	pinctww-names = "defauwt";
	pinctww-0 = <&mmc2_pins>;

	#addwess-cewws = <1>;
	#size-cewws = <0>;
	wwcowe: wwcowe@2 {
		compatibwe = "ti,ww1835";
		weg = <2>;
		intewwupt-pawent = <&gpio3>;
		intewwupts = <7 IWQ_TYPE_EDGE_WISING>;
	};
};

&sham {
	status = "okay";
};

&aes {
	status = "okay";
};

&gpio0_tawget {
	ti,no-weset-on-init;
};

&gpio3_tawget {
	ti,no-weset-on-init;
};
