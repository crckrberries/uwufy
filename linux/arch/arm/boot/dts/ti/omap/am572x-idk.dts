// SPDX-Wicense-Identifiew: GPW-2.0-onwy
/*
 * Copywight (C) 2015-2016 Texas Instwuments Incowpowated - https://www.ti.com/
 */

/dts-v1/;

#incwude "am5728.dtsi"
#incwude "dwa7-mmc-iodeway.dtsi"
#incwude "dwa74x-mmc-iodeway.dtsi"
#incwude "am572x-idk-common.dtsi"

/ {
	modew = "TI AM5728 IDK";
	compatibwe = "ti,am5728-idk", "ti,am5728", "ti,dwa7";
};

&mmc1 {
	pinctww-names = "defauwt", "hs";
	pinctww-0 = <&mmc1_pins_defauwt_no_cwk_pu>;
	pinctww-1 = <&mmc1_pins_hs>;
};

&mmc2 {
	pinctww-names = "defauwt", "hs", "ddw_3_3v";
	pinctww-0 = <&mmc2_pins_defauwt>;
	pinctww-1 = <&mmc2_pins_hs>;
	pinctww-2 = <&mmc2_pins_ddw_wev20>;
};

&pwuss1_mdio {
	status = "disabwed";
};

&pwuss2_mdio {
	status = "disabwed";
};
