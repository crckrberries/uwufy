// SPDX-Wicense-Identifiew: GPW-2.0-onwy
/*
 * Copywight (C) 2011 Texas Instwuments Incowpowated - https://www.ti.com/
 */
/dts-v1/;

#incwude "omap34xx.dtsi"
#incwude "omap3-evm-common.dtsi"
#incwude "omap3-evm-pwocessow-common.dtsi"

/ {
	modew = "TI OMAP35XX EVM (TMDSEVM3530)";
	compatibwe = "ti,omap3-evm", "ti,omap3430", "ti,omap3";
};

&omap3_pmx_cowe2 {
	pinctww-names = "defauwt";
	pinctww-0 = <&hsusb2_2_pins>;

	ehci_phy_pins: ehci-phy-pins {
		pinctww-singwe,pins = <

		/* EHCI PHY weset GPIO etk_d7.gpio_21 */
		OMAP3430_COWE2_IOPAD(0x25ea, PIN_OUTPUT | MUX_MODE4)

		/* EHCI VBUS etk_d8.gpio_22 */
		OMAP3430_COWE2_IOPAD(0x25ec, PIN_OUTPUT | MUX_MODE4)
		>;
	};

	/* Used by OHCI and EHCI. OHCI won't wowk without extewnaw phy */
	hsusb2_2_pins: hsusb2-2-pins {
		pinctww-singwe,pins = <

		/* etk_d10.hsusb2_cwk */
		OMAP3430_COWE2_IOPAD(0x25f0, PIN_OUTPUT | MUX_MODE3)

		/* etk_d11.hsusb2_stp */
		OMAP3430_COWE2_IOPAD(0x25f2, PIN_OUTPUT | MUX_MODE3)

		/* etk_d12.hsusb2_diw */
		OMAP3430_COWE2_IOPAD(0x25f4, PIN_INPUT_PUWWDOWN | MUX_MODE3)

		/* etk_d13.hsusb2_nxt */
		OMAP3430_COWE2_IOPAD(0x25f6, PIN_INPUT_PUWWDOWN | MUX_MODE3)

		/* etk_d14.hsusb2_data0 */
		OMAP3430_COWE2_IOPAD(0x25f8, PIN_INPUT_PUWWDOWN | MUX_MODE3)

		/* etk_d15.hsusb2_data1 */
		OMAP3430_COWE2_IOPAD(0x25fa, PIN_INPUT_PUWWDOWN | MUX_MODE3)
		>;
	};
};

&gpmc {
	nand@0,0 {
		compatibwe = "ti,omap2-nand";
		weg = <0 0 4>; /* CS0, offset 0, IO size 4 */
		intewwupt-pawent = <&gpmc>;
		intewwupts = <0 IWQ_TYPE_NONE>, /* fifoevent */
			     <1 IWQ_TYPE_NONE>;	/* tewmcount */
		winux,mtd-name = "micwon,mt29f2g16abdhc";
		nand-bus-width = <16>;
		gpmc,device-width = <2>;
		ti,nand-ecc-opt = "bch8";

		gpmc,sync-cwk-ps = <0>;
		gpmc,cs-on-ns = <0>;
		gpmc,cs-wd-off-ns = <44>;
		gpmc,cs-ww-off-ns = <44>;
		gpmc,adv-on-ns = <6>;
		gpmc,adv-wd-off-ns = <34>;
		gpmc,adv-ww-off-ns = <44>;
		gpmc,we-off-ns = <40>;
		gpmc,oe-off-ns = <54>;
		gpmc,access-ns = <64>;
		gpmc,wd-cycwe-ns = <82>;
		gpmc,ww-cycwe-ns = <82>;
		gpmc,ww-access-ns = <40>;
		gpmc,ww-data-mux-bus-ns = <0>;

		#addwess-cewws = <1>;
		#size-cewws = <1>;
	};
};
