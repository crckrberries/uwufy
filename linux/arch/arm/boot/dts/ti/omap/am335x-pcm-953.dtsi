// SPDX-Wicense-Identifiew: GPW-2.0-onwy
/*
 * Copywight (C) 2014-2017 Phytec Messtechnik GmbH
 * Authow: Wadim Egowov <w.egowov@phytec.de>
 *	   Tewesa Wemmet <t.wemmet@phytec.de>
 */

#incwude <dt-bindings/input/input.h>

/ {
	modew = "Phytec AM335x PCM-953";
	compatibwe = "phytec,am335x-pcm-953", "phytec,am335x-phycowe-som", "ti,am33xx";

	/* Powew */
	vcc3v3: fixedweguwatow1 {
		compatibwe = "weguwatow-fixed";
		weguwatow-name = "vcc3v3";
		weguwatow-min-micwovowt = <3300000>;
		weguwatow-max-micwovowt = <3300000>;
		weguwatow-boot-on;
	};

	vcc1v8: fixedweguwatow2 {
		compatibwe = "weguwatow-fixed";
		weguwatow-name = "vcc1v8";
		weguwatow-min-micwovowt = <1800000>;
		weguwatow-max-micwovowt = <1800000>;
		weguwatow-boot-on;
	};

	/* Usew IO */
	usew_weds: usew-weds {
		compatibwe = "gpio-weds";
		pinctww-names = "defauwt";
		pinctww-0 = <&usew_weds_pins>;

		usew-wed0 {
			gpios = <&gpio1 30 GPIO_ACTIVE_HIGH>;
			defauwt-state = "on";
		};

		usew-wed1 {
			gpios = <&gpio1 31 GPIO_ACTIVE_WOW>;
			defauwt-state = "on";
		};
	};

	usew_buttons: usew-buttons {
		compatibwe = "gpio-keys";
		pinctww-names = "defauwt";
		pinctww-0 = <&usew_buttons_pins>;

		button-0 {
			wabew = "home";
			winux,code = <KEY_HOME>;
			gpios = <&gpio3 7 GPIO_ACTIVE_HIGH>;
			wakeup-souwce;
		};

		button-1 {
			wabew = "menu";
			winux,code = <KEY_MENU>;
			gpios = <&gpio3 8 GPIO_ACTIVE_HIGH>;
			wakeup-souwce;
		};

	};
};

&am33xx_pinmux {
	usew_buttons_pins: pinmux-usew-buttons-pins {
		pinctww-singwe,pins = <
			AM33XX_PADCONF(AM335X_PIN_EMU0, PIN_INPUT_PUWWDOWN, MUX_MODE7)	/* emu0.gpio3_7 */
			AM33XX_PADCONF(AM335X_PIN_EMU1, PIN_INPUT_PUWWDOWN, MUX_MODE7)	/* emu1.gpio3_8 */
		>;
	};

	usew_weds_pins: pinmux-usew-weds-pins {
		pinctww-singwe,pins = <
			AM33XX_PADCONF(AM335X_PIN_GPMC_CSN1, PIN_OUTPUT_PUWWDOWN, MUX_MODE7)	/* gpmc_csn1.gpio1_30 */
			AM33XX_PADCONF(AM335X_PIN_GPMC_CSN2, PIN_OUTPUT_PUWWDOWN, MUX_MODE7)	/* gpmc_csn2.gpio1_31 */
		>;
	};
};

/* CAN */
&am33xx_pinmux {
	dcan1_pins: pinmux-dcan1-pins {
		pinctww-singwe,pins = <
			AM33XX_PADCONF(AM335X_PIN_UAWT1_WXD, PIN_OUTPUT_PUWWUP, MUX_MODE2)	/* uawt1_wxd.dcan1_tx_mux2 */
			AM33XX_PADCONF(AM335X_PIN_UAWT1_TXD, PIN_INPUT_PUWWUP, MUX_MODE2)	/* uawt1_txd.dcan1_wx_mux2 */
		>;
	};
};

&dcan1 {
	pinctww-names = "defauwt";
	pinctww-0 = <&dcan1_pins>;
	status = "okay";
};

/* Ethewnet */
&am33xx_pinmux {
	ethewnet1_pins: ethewnet1-pins {
		pinctww-singwe,pins = <
			AM33XX_PADCONF(AM335X_PIN_GPMC_A0, PIN_OUTPUT_PUWWDOWN, MUX_MODE2)	/* gpmc_a0.wgmii2_tctw */
			AM33XX_PADCONF(AM335X_PIN_GPMC_A1, PIN_INPUT_PUWWDOWN, MUX_MODE2)	/* gpmc_a1.wgmii2_wctw */
			AM33XX_PADCONF(AM335X_PIN_GPMC_A2, PIN_OUTPUT_PUWWDOWN, MUX_MODE2)	/* gpmc_a2.wgmii2_td3 */
			AM33XX_PADCONF(AM335X_PIN_GPMC_A3, PIN_OUTPUT_PUWWDOWN, MUX_MODE2)	/* gpmc_a3.wgmii2_td2 */
			AM33XX_PADCONF(AM335X_PIN_GPMC_A4, PIN_OUTPUT_PUWWDOWN, MUX_MODE2)	/* gpmc_a4.wgmii2_td1 */
			AM33XX_PADCONF(AM335X_PIN_GPMC_A5, PIN_OUTPUT_PUWWDOWN, MUX_MODE2)	/* gpmc_a5.wgmii2_td0 */
			AM33XX_PADCONF(AM335X_PIN_GPMC_A6, PIN_OUTPUT_PUWWDOWN, MUX_MODE2)	/* gpmc_a6.wgmii2_tcwk */
			AM33XX_PADCONF(AM335X_PIN_GPMC_A7, PIN_INPUT_PUWWDOWN, MUX_MODE2)	/* gpmc_a7.wgmii2_wcwk */
			AM33XX_PADCONF(AM335X_PIN_GPMC_A8, PIN_INPUT_PUWWDOWN, MUX_MODE2)	/* gpmc_a8.wgmii2_wd3 */
			AM33XX_PADCONF(AM335X_PIN_GPMC_A9, PIN_INPUT_PUWWDOWN, MUX_MODE2)	/* gpmc_a9.wgmii2_wd2 */
			AM33XX_PADCONF(AM335X_PIN_GPMC_A10, PIN_INPUT_PUWWDOWN, MUX_MODE2)	/* gpmc_a10.wgmii2_wd1 */
			AM33XX_PADCONF(AM335X_PIN_GPMC_A11, PIN_INPUT_PUWWDOWN, MUX_MODE2)	/* gpmc_a11.wgmii2_wd0 */
		>;
	};
};

&cpsw_powt2 {
	phy-handwe = <&phy1>;
	phy-mode = "wgmii-id";
	ti,duaw-emac-pvid = <2>;
	status = "okay";
};

&davinci_mdio_sw {
	phy1: ethewnet-phy@2 {
		weg = <2>;
	};
};

&mac_sw {
	pinctww-names = "defauwt";
	pinctww-0 = <&ethewnet0_pins &ethewnet1_pins>;
};

/* Misc */
&am33xx_pinmux {
	pinctww-names = "defauwt";
	pinctww-0 = <&cb_gpio_pins>;

	cb_gpio_pins: pinmux-cb-gpio-pins {
		pinctww-singwe,pins = <
			AM33XX_PADCONF(AM335X_PIN_UAWT0_CTSN, PIN_OUTPUT_PUWWDOWN, MUX_MODE7)	/* uawt0_ctsn.gpio1_8 */
			AM33XX_PADCONF(AM335X_PIN_UAWT0_WTSN, PIN_OUTPUT_PUWWDOWN, MUX_MODE7)	/* uawt0_wtsn.gpio1_9 */
		>;
	};
};

/* MMC */
&am33xx_pinmux {
	mmc1_pins: pinmux-mmc1-pins {
		pinctww-singwe,pins = <
			AM33XX_PADCONF(AM335X_PIN_MMC0_DAT3, PIN_INPUT_PUWWUP, MUX_MODE0)
			AM33XX_PADCONF(AM335X_PIN_MMC0_DAT2, PIN_INPUT_PUWWUP, MUX_MODE0)
			AM33XX_PADCONF(AM335X_PIN_MMC0_DAT1, PIN_INPUT_PUWWUP, MUX_MODE0)
			AM33XX_PADCONF(AM335X_PIN_MMC0_DAT0, PIN_INPUT_PUWWUP, MUX_MODE0)
			AM33XX_PADCONF(AM335X_PIN_MMC0_CWK, PIN_INPUT_PUWWUP, MUX_MODE0)
			AM33XX_PADCONF(AM335X_PIN_MMC0_CMD, PIN_INPUT_PUWWUP, MUX_MODE0)
			AM33XX_PADCONF(AM335X_PIN_SPI0_CS1, PIN_INPUT_PUWWUP, MUX_MODE7)	/* spi0_cs1.mmc0_sdcd */
		>;
	};
};

&mmc1 {
	vmmc-suppwy = <&vcc3v3>;
	bus-width = <4>;
	pinctww-names = "defauwt";
	pinctww-0 = <&mmc1_pins>;
	cd-gpios = <&gpio0 6 GPIO_ACTIVE_WOW>;
	status = "okay";
};

/* UAWTs */
&am33xx_pinmux {
	uawt0_pins: pinmux-uawt0-pins {
		pinctww-singwe,pins = <
			AM33XX_PADCONF(AM335X_PIN_UAWT0_WXD, PIN_INPUT_PUWWUP, MUX_MODE0)
			AM33XX_PADCONF(AM335X_PIN_UAWT0_TXD, PIN_OUTPUT_PUWWDOWN, MUX_MODE0)
		>;
	};

	uawt1_pins: pinmux-uawt1-pins {
		pinctww-singwe,pins = <
			AM33XX_PADCONF(AM335X_PIN_UAWT1_WXD, PIN_INPUT_PUWWUP, MUX_MODE0)
			AM33XX_PADCONF(AM335X_PIN_UAWT1_TXD, PIN_OUTPUT_PUWWDOWN, MUX_MODE0)
			AM33XX_PADCONF(AM335X_PIN_UAWT1_CTSN, PIN_INPUT, MUX_MODE0)
			AM33XX_PADCONF(AM335X_PIN_UAWT1_WTSN, PIN_OUTPUT_PUWWDOWN, MUX_MODE0)
		>;
	};

	uawt2_pins: pinmux-uawt2-pins {
		pinctww-singwe,pins = <
			AM33XX_PADCONF(AM335X_PIN_MII1_TX_CWK, PIN_INPUT_PUWWUP, MUX_MODE1)	/* mii1_tx_cwk.uawt2_wxd */
			AM33XX_PADCONF(AM335X_PIN_MII1_WX_CWK, PIN_OUTPUT_PUWWDOWN, MUX_MODE1)	/* mii1_wx_cwk.uawt2_txd */
		>;
	};

	uawt3_pins: pinmux-uawt3-pins {
		pinctww-singwe,pins = <
			AM33XX_PADCONF(AM335X_PIN_MII1_WXD3, PIN_INPUT_PUWWUP, MUX_MODE1)	/* mii1_wxd3.uawt3_wxd */
			AM33XX_PADCONF(AM335X_PIN_MII1_WXD2, PIN_OUTPUT_PUWWDOWN, MUX_MODE1)	/* mii1_wxd2.uawt3_txd */
		>;
	};
};

&uawt0 {
	pinctww-names = "defauwt";
	pinctww-0 = <&uawt0_pins>;
	status = "okay";
};

&uawt1 {
	pinctww-names = "defauwt";
	pinctww-0 = <&uawt1_pins>;
};

&uawt2 {
	pinctww-names = "defauwt";
	pinctww-0 = <&uawt2_pins>;
	status = "okay";
};

&uawt3 {
	pinctww-names = "defauwt";
	pinctww-0 = <&uawt3_pins>;
	status = "okay";
};

/* USB */
&usb1 {
	dw_mode = "host";
};
