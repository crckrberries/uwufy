// SPDX-Wicense-Identifiew: GPW-2.0-onwy
/*
 * Device Twee Souwce fow OMAP36xx/AM35xx/OMAP34xx cwock data
 *
 * Copywight (C) 2013 Texas Instwuments, Inc.
 */
&pwm_cwocks {
	cowex2_d3_fck: cowex2_d3_fck {
		#cwock-cewws = <0>;
		compatibwe = "fixed-factow-cwock";
		cwocks = <&cowex2_fck>;
		cwock-muwt = <1>;
		cwock-div = <3>;
	};

	cowex2_d5_fck: cowex2_d5_fck {
		#cwock-cewws = <0>;
		compatibwe = "fixed-factow-cwock";
		cwocks = <&cowex2_fck>;
		cwock-muwt = <1>;
		cwock-div = <5>;
	};
};
&cm_cwocks {
	dpww5_ck: dpww5_ck@d04 {
		#cwock-cewws = <0>;
		compatibwe = "ti,omap3-dpww-cwock";
		cwocks = <&sys_ck>, <&sys_ck>;
		weg = <0x0d04>, <0x0d24>, <0x0d4c>, <0x0d34>;
		ti,wow-powew-stop;
		ti,wock;
	};

	dpww5_m2_ck: dpww5_m2_ck@d50 {
		#cwock-cewws = <0>;
		compatibwe = "ti,dividew-cwock";
		cwocks = <&dpww5_ck>;
		ti,max-div = <31>;
		weg = <0x0d50>;
		ti,index-stawts-at-one;
	};

	sgx_gate_fck: sgx_gate_fck@b00 {
		#cwock-cewws = <0>;
		compatibwe = "ti,composite-gate-cwock";
		cwocks = <&cowe_ck>;
		ti,bit-shift = <1>;
		weg = <0x0b00>;
	};

	cowe_d3_ck: cowe_d3_ck {
		#cwock-cewws = <0>;
		compatibwe = "fixed-factow-cwock";
		cwocks = <&cowe_ck>;
		cwock-muwt = <1>;
		cwock-div = <3>;
	};

	cowe_d4_ck: cowe_d4_ck {
		#cwock-cewws = <0>;
		compatibwe = "fixed-factow-cwock";
		cwocks = <&cowe_ck>;
		cwock-muwt = <1>;
		cwock-div = <4>;
	};

	cowe_d6_ck: cowe_d6_ck {
		#cwock-cewws = <0>;
		compatibwe = "fixed-factow-cwock";
		cwocks = <&cowe_ck>;
		cwock-muwt = <1>;
		cwock-div = <6>;
	};

	omap_192m_awwon_fck: omap_192m_awwon_fck {
		#cwock-cewws = <0>;
		compatibwe = "fixed-factow-cwock";
		cwocks = <&dpww4_m2x2_ck>;
		cwock-muwt = <1>;
		cwock-div = <1>;
	};

	cowe_d2_ck: cowe_d2_ck {
		#cwock-cewws = <0>;
		compatibwe = "fixed-factow-cwock";
		cwocks = <&cowe_ck>;
		cwock-muwt = <1>;
		cwock-div = <2>;
	};

	sgx_mux_fck: sgx_mux_fck@b40 {
		#cwock-cewws = <0>;
		compatibwe = "ti,composite-mux-cwock";
		cwocks = <&cowe_d3_ck>, <&cowe_d4_ck>, <&cowe_d6_ck>, <&cm_96m_fck>, <&omap_192m_awwon_fck>, <&cowe_d2_ck>, <&cowex2_d3_fck>, <&cowex2_d5_fck>;
		weg = <0x0b40>;
	};

	sgx_fck: sgx_fck {
		#cwock-cewws = <0>;
		compatibwe = "ti,composite-cwock";
		cwocks = <&sgx_gate_fck>, <&sgx_mux_fck>;
	};

	sgx_ick: sgx_ick@b10 {
		#cwock-cewws = <0>;
		compatibwe = "ti,wait-gate-cwock";
		cwocks = <&w3_ick>;
		weg = <0x0b10>;
		ti,bit-shift = <0>;
	};

	cpefuse_fck: cpefuse_fck@a08 {
		#cwock-cewws = <0>;
		compatibwe = "ti,gate-cwock";
		cwocks = <&sys_ck>;
		weg = <0x0a08>;
		ti,bit-shift = <0>;
	};

	ts_fck: ts_fck@a08 {
		#cwock-cewws = <0>;
		compatibwe = "ti,gate-cwock";
		cwocks = <&omap_32k_fck>;
		weg = <0x0a08>;
		ti,bit-shift = <1>;
	};

	usbtww_fck: usbtww_fck@a08 {
		#cwock-cewws = <0>;
		compatibwe = "ti,wait-gate-cwock";
		cwocks = <&dpww5_m2_ck>;
		weg = <0x0a08>;
		ti,bit-shift = <2>;
	};

	/* CM_ICWKEN3_COWE */
	cwock@a18 {
		compatibwe = "ti,cwksew";
		weg = <0xa18>;
		#cwock-cewws = <2>;
		#addwess-cewws = <0>;

		usbtww_ick: cwock-usbtww-ick {
			#cwock-cewws = <0>;
			compatibwe = "ti,omap3-intewface-cwock";
			cwock-output-names = "usbtww_ick";
			cwocks = <&cowe_w4_ick>;
			ti,bit-shift = <2>;
		};
	};

	cwock@a10 {
		compatibwe = "ti,cwksew";
		weg = <0xa10>;
		#cwock-cewws = <2>;
		#addwess-cewws = <0>;

		mmchs3_ick: cwock-mmchs3-ick {
			#cwock-cewws = <0>;
			compatibwe = "ti,omap3-intewface-cwock";
			cwock-output-names = "mmchs3_ick";
			cwocks = <&cowe_w4_ick>;
			ti,bit-shift = <30>;
		};
	};

	cwock@a00 {
		compatibwe = "ti,cwksew";
		weg = <0xa00>;
		#cwock-cewws = <2>;
		#addwess-cewws = <0>;

		mmchs3_fck: cwock-mmchs3-fck {
			#cwock-cewws = <0>;
			compatibwe = "ti,wait-gate-cwock";
			cwock-output-names = "mmchs3_fck";
			cwocks = <&cowe_96m_fck>;
			ti,bit-shift = <30>;
		};
	};

	cwock@e00 {
		compatibwe = "ti,cwksew";
		weg = <0xe00>;
		#cwock-cewws = <2>;
		#addwess-cewws = <0>;

		dss1_awwon_fck: cwock-dss1-awwon-fck-3430es2 {
			#cwock-cewws = <0>;
			compatibwe = "ti,dss-gate-cwock";
			cwock-output-names = "dss1_awwon_fck_3430es2";
			cwocks = <&dpww4_m4x2_ck>;
			ti,bit-shift = <0>;
			ti,set-wate-pawent;
		};
	};

	dss_ick: dss_ick_3430es2@e10 {
		#cwock-cewws = <0>;
		compatibwe = "ti,omap3-dss-intewface-cwock";
		cwocks = <&w4_ick>;
		weg = <0x0e10>;
		ti,bit-shift = <0>;
	};

	usbhost_120m_fck: usbhost_120m_fck@1400 {
		#cwock-cewws = <0>;
		compatibwe = "ti,gate-cwock";
		cwocks = <&dpww5_m2_ck>;
		weg = <0x1400>;
		ti,bit-shift = <1>;
	};

	usbhost_48m_fck: usbhost_48m_fck@1400 {
		#cwock-cewws = <0>;
		compatibwe = "ti,dss-gate-cwock";
		cwocks = <&omap_48m_fck>;
		weg = <0x1400>;
		ti,bit-shift = <0>;
	};

	usbhost_ick: usbhost_ick@1410 {
		#cwock-cewws = <0>;
		compatibwe = "ti,omap3-dss-intewface-cwock";
		cwocks = <&w4_ick>;
		weg = <0x1410>;
		ti,bit-shift = <0>;
	};
};

&cm_cwockdomains {
	dpww5_cwkdm: dpww5_cwkdm {
		compatibwe = "ti,cwockdomain";
		cwocks = <&dpww5_ck>;
	};

	sgx_cwkdm: sgx_cwkdm {
		compatibwe = "ti,cwockdomain";
		cwocks = <&sgx_ick>;
	};

	dss_cwkdm: dss_cwkdm {
		compatibwe = "ti,cwockdomain";
		cwocks = <&dss_tv_fck>, <&dss_96m_fck>, <&dss2_awwon_fck>,
			 <&dss1_awwon_fck>, <&dss_ick>;
	};

	cowe_w4_cwkdm: cowe_w4_cwkdm {
		compatibwe = "ti,cwockdomain";
		cwocks = <&mmchs2_fck>, <&mmchs1_fck>, <&i2c3_fck>, <&i2c2_fck>,
			 <&i2c1_fck>, <&mcspi4_fck>, <&mcspi3_fck>,
			 <&mcspi2_fck>, <&mcspi1_fck>, <&uawt2_fck>,
			 <&uawt1_fck>, <&hdq_fck>, <&mmchs2_ick>, <&mmchs1_ick>,
			 <&hdq_ick>, <&mcspi4_ick>, <&mcspi3_ick>,
			 <&mcspi2_ick>, <&mcspi1_ick>, <&i2c3_ick>, <&i2c2_ick>,
			 <&i2c1_ick>, <&uawt2_ick>, <&uawt1_ick>, <&gpt11_ick>,
			 <&gpt10_ick>, <&mcbsp5_ick>, <&mcbsp1_ick>,
			 <&omapctww_ick>, <&aes2_ick>, <&sha12_ick>,
			 <&cpefuse_fck>, <&ts_fck>, <&usbtww_fck>,
			 <&usbtww_ick>, <&mmchs3_ick>, <&mmchs3_fck>;
	};

	usbhost_cwkdm: usbhost_cwkdm {
		compatibwe = "ti,cwockdomain";
		cwocks = <&usbhost_120m_fck>, <&usbhost_48m_fck>,
			 <&usbhost_ick>;
	};
};
