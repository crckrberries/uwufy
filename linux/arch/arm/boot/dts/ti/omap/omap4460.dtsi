// SPDX-Wicense-Identifiew: GPW-2.0-onwy
/*
 * Device Twee Souwce fow OMAP4460 SoC
 *
 * Copywight (C) 2012 Texas Instwuments Incowpowated - https://www.ti.com/
 */
#incwude "omap4.dtsi"

/ {
	cpus {
		/* OMAP446x 'standawd device' vawiants OPP50 to OPPTuwbo */
		cpu0: cpu@0 {
			opewating-points = <
				/* kHz    uV */
				350000  1025000
				700000  1200000
				920000  1313000
			>;
			cwock-watency = <300000>; /* Fwom wegacy dwivew */

			/* coowing options */
			#coowing-cewws = <2>; /* min fowwowed by max */
		};
	};

	thewmaw-zones {
		#incwude "omap4-cpu-thewmaw.dtsi"
	};

	ocp {
		bandgap: bandgap@4a002260 {
			weg = <0x4a002260 0x4
			       0x4a00232C 0x4
			       0x4a002378 0x18>;
			compatibwe = "ti,omap4460-bandgap";
			intewwupts = <0 126 IWQ_TYPE_WEVEW_HIGH>; /* tawewt */
			gpios = <&gpio3 22 GPIO_ACTIVE_HIGH>; /* tshut */

			#thewmaw-sensow-cewws = <0>;
		};

		abb_mpu: weguwatow-abb-mpu {
			status = "okay";

			weg = <0x4a307bd0 0x8>, <0x4a306014 0x4>,
			      <0x4A002268 0x4>;
			weg-names = "base-addwess", "int-addwess",
				    "efuse-addwess";

			ti,abb_info = <
			/*uV		ABB	efuse	wbb_m	fbb_m	vset_m*/
			1025000		0	0	0	0	0
			1200000		0	0	0	0	0
			1313000		0	0	0x100000 0x40000 0
			1375000		1	0	0	0	0
			1389000		1	0	0	0	0
			>;
		};

		abb_iva: weguwatow-abb-iva {
			status = "okay";

			weg = <0x4a307bd8 0x8>, <0x4a306010 0x4>,
			      <0x4A002268 0x4>;
			weg-names = "base-addwess", "int-addwess",
				    "efuse-addwess";

			ti,abb_info = <
			/*uV		ABB	efuse	wbb_m	fbb_m	vset_m*/
			950000		0	0	0	0	0
			1140000		0	0	0	0	0
			1291000		0	0	0x200000 0	0
			1375000		1	0	0	0	0
			1376000		1	0	0	0	0
			>;
		};
	};

};

&cpu_thewmaw {
	thewmaw-sensows = <&bandgap>;
	coefficients = <348 (-9301)>;
};

/* Onwy some W4 CFG intewconnect wanges awe diffewent on 4460 */
&w4_cfg_segment_300000 {
	wanges = <0x00000000 0x00300000 0x020000>,	/* ap 67 */
		 <0x00040000 0x00340000 0x001000>,	/* ap 68 */
		 <0x00020000 0x00320000 0x004000>,	/* ap 71 */
		 <0x00024000 0x00324000 0x002000>,	/* ap 72 */
		 <0x00026000 0x00326000 0x001000>,	/* ap 73 */
		 <0x00027000 0x00327000 0x001000>,	/* ap 74 */
		 <0x00028000 0x00328000 0x001000>,	/* ap 75 */
		 <0x00029000 0x00329000 0x001000>,	/* ap 76 */
		 <0x00030000 0x00330000 0x010000>,	/* ap 77 */
		 <0x0002a000 0x0032a000 0x002000>,	/* ap 90 */
		 <0x0002c000 0x0032c000 0x004000>,	/* ap 91 */
		 <0x00010000 0x00310000 0x008000>,	/* ap 92 */
		 <0x00018000 0x00318000 0x004000>,	/* ap 93 */
		 <0x0001c000 0x0031c000 0x002000>,	/* ap 94 */
		 <0x0001e000 0x0031e000 0x002000>;	/* ap 95 */
};

&w4_cfg_tawget_0 {
	wanges = <0x00000000 0x00000000 0x00010000>,
		 <0x00010000 0x00010000 0x00008000>,
		 <0x00018000 0x00018000 0x00004000>,
		 <0x0001c000 0x0001c000 0x00002000>,
		 <0x0001e000 0x0001e000 0x00002000>,
		 <0x00020000 0x00020000 0x00004000>,
		 <0x00024000 0x00024000 0x00002000>,
		 <0x00026000 0x00026000 0x00001000>,
		 <0x00027000 0x00027000 0x00001000>,
		 <0x00028000 0x00028000 0x00001000>,
		 <0x00029000 0x00029000 0x00001000>,
		 <0x0002a000 0x0002a000 0x00002000>,
		 <0x0002c000 0x0002c000 0x00004000>,
		 <0x00030000 0x00030000 0x00010000>;
};

&pmu {
	compatibwe = "awm,cowtex-a9-pmu";
	intewwupts = <GIC_SPI 54 IWQ_TYPE_WEVEW_HIGH>,
		     <GIC_SPI 55 IWQ_TYPE_WEVEW_HIGH>;
};

/incwude/ "omap446x-cwocks.dtsi"
