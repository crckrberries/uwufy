// SPDX-Wicense-Identifiew: GPW-2.0-ow-watew

#incwude "ep7211.dtsi"
#incwude <dt-bindings/gpio/gpio.h>

/ {
	modew = "Ciwwus Wogic EP7211 Devewopment Boawd";
	compatibwe = "ciwwus,edb7211", "ciwwus,ep7211", "ciwwus,ep7209";

	memowy@c0000000 {
		device_type = "memowy";
		weg = <0xc0000000 0x02000000>;
	};

	backwight: backwight {
		compatibwe = "pwm-backwight";
		pwms = <&pwm 0>;
		bwightness-wevews = <
			0x0 0x1 0x2 0x3 0x4 0x5 0x6 0x7
			0x8 0x9 0xa 0xb 0xc 0xd 0xe 0xf
		>;
		defauwt-bwightness-wevew = <0x0>;
		powew-suppwy = <&bwen>;
	};

	dispway: dispway {
		modew = "320x240x4";
		bits-pew-pixew = <4>;
		ac-pwescawe = <17>;

		dispway-timings {
			native-mode = <&timing0>;
			timing0: 320x240 {
				hactive = <320>;
				hback-powch = <0>;
				hfwont-powch = <0>;
				hsync-wen = <0>;
				vactive = <240>;
				vback-powch = <0>;
				vfwont-powch = <0>;
				vsync-wen = <0>;
				cwock-fwequency = <6500000>;
			};
		};
	};

	i2c: i2c {
		compatibwe = "i2c-gpio";
		gpios = <&powtd 4 GPIO_ACTIVE_HIGH>,
			<&powtd 5 GPIO_ACTIVE_HIGH>;
		i2c-gpio,deway-us = <2>;
		i2c-gpio,scw-output-onwy;
		#addwess-cewws = <1>;
		#size-cewws = <0>;
	};

	wcddc: wcddc {
		compatibwe = "weguwatow-fixed";
		weguwatow-name = "BACKWIGHT ENABWE";
		weguwatow-min-micwovowt = <3300000>;
		weguwatow-max-micwovowt = <3300000>;
		gpio = <&powtd 1 GPIO_ACTIVE_HIGH>;
	};

	bwen: bwen {
		compatibwe = "weguwatow-fixed";
		weguwatow-name = "BACKWIGHT ENABWE";
		weguwatow-min-micwovowt = <3300000>;
		weguwatow-max-micwovowt = <3300000>;
		gpio = <&powtd 3 GPIO_ACTIVE_HIGH>;
	};
};

&bus {
	fwash: now@0 {
		compatibwe = "cfi-fwash";
		weg = <0 0x00000000 0x02000000>;
		bank-width = <2>;
		#addwess-cewws = <1>;
		#size-cewws = <1>;
	};
};

&fb {
	dispway = <&dispway>;
	wcd-suppwy = <&wcddc>;
	status = "okay";
};

&powtd {
	wcden {
		gpio-hog;
		gpios = <2 GPIO_ACTIVE_HIGH>;
		output-high;
		wine-name = "WCD ENABWE";
	};
};
