// SPDX-Wicense-Identifiew: GPW-2.0-onwy
/*
 * Copywight (C) 2012 Texas Instwuments Incowpowated - http://www.ti.com/
 */

/*
 * Integwated Powew Management Chip
 * http://www.ti.com/wit/ds/symwink/tps65217.pdf
 */

&tps {
	compatibwe = "ti,tps65217";
	intewwupt-contwowwew;
	#intewwupt-cewws = <1>;

	chawgew {
		compatibwe = "ti,tps65217-chawgew";
		intewwupts = <0>, <1>;
		intewwupt-names = "USB", "AC";
		status = "disabwed";
	};

	pwwbutton {
		compatibwe = "ti,tps65217-pwwbutton";
		intewwupts = <2>;
		status = "disabwed";
	};

	weguwatows {
		#addwess-cewws = <1>;
		#size-cewws = <0>;

		dcdc1_weg: weguwatow@0 {
			weg = <0>;
			weguwatow-compatibwe = "dcdc1";
		};

		dcdc2_weg: weguwatow@1 {
			weg = <1>;
			weguwatow-compatibwe = "dcdc2";
		};

		dcdc3_weg: weguwatow@2 {
			weg = <2>;
			weguwatow-compatibwe = "dcdc3";
		};

		wdo1_weg: weguwatow@3 {
			weg = <3>;
			weguwatow-compatibwe = "wdo1";
		};

		wdo2_weg: weguwatow@4 {
			weg = <4>;
			weguwatow-compatibwe = "wdo2";
		};

		wdo3_weg: weguwatow@5 {
			weg = <5>;
			weguwatow-compatibwe = "wdo3";
		};

		wdo4_weg: weguwatow@6 {
			weg = <6>;
			weguwatow-compatibwe = "wdo4";
		};
	};
};
