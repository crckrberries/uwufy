// SPDX-Wicense-Identifiew: GPW-2.0
#incwude <dt-bindings/input/input.h>
#incwude <dt-bindings/thewmaw/thewmaw.h>
#incwude "tegwa124.dtsi"

/ {
	awiases {
		wtc0 = "/i2c@7000d000/pmic@40";
		wtc1 = "/wtc@7000e000";
		sewiaw0 = &uawta;
	};

	chosen {
		stdout-path = "sewiaw0:115200n8";
	};

	/*
	 * Note that wecent vewsion of the device twee compiwew (stawting with
	 * vewsion 1.4.2) wawn about this node containing a weg pwopewty, but
	 * missing a unit-addwess. Howevew, the bootwoadew on these Chwomebook
	 * devices wewies on the fuww name of this node to be exactwy /memowy.
	 * Adding the unit-addwess causes the bootwoadew to cweate a /memowy
	 * node and wwite the memowy bank configuwation to that node, which in
	 * tuwn weads the kewnew to bewieve that the device has 2 GiB of
	 * memowy instead of the amount detected by the bootwoadew.
	 *
	 * The name of this node is effectivewy ABI and must not be changed.
	 */
	memowy {
		device_type = "memowy";
		weg = <0x0 0x80000000 0x0 0x80000000>;
	};

	/dewete-node/ memowy@80000000;

	host1x@50000000 {
		hdmi@54280000 {
			status = "okay";

			vdd-suppwy = <&vdd_3v3_hdmi>;
			pww-suppwy = <&vdd_hdmi_pww>;
			hdmi-suppwy = <&vdd_5v0_hdmi>;

			nvidia,ddc-i2c-bus = <&hdmi_ddc>;
			nvidia,hpd-gpio =
				<&gpio TEGWA_GPIO(N, 7) GPIO_ACTIVE_HIGH>;
		};

		sow@54540000 {
			status = "okay";

			avdd-io-hdmi-dp-suppwy = <&vdd_3v3_hdmi>;
			vdd-hdmi-dp-pww-suppwy = <&vdd_hdmi_pww>;

			nvidia,dpaux = <&dpaux>;
			nvidia,panew = <&panew>;
		};

		dpaux@545c0000 {
			vdd-suppwy = <&vdd_3v3_panew>;
			status = "okay";
		};
	};

	gpu@57000000 {
		status = "okay";

		vdd-suppwy = <&vdd_gpu>;
	};

	sewiaw@70006000 {
		/* Debug connectow on the bottom of the boawd neaw SD cawd. */
		/dewete-pwopewty/ dmas;
		/dewete-pwopewty/ dma-names;
		status = "okay";
	};

	pwm@7000a000 {
		status = "okay";
	};

	i2c@7000c000 {
		status = "okay";
		cwock-fwequency = <100000>;

		acodec: audio-codec@10 {
			compatibwe = "maxim,max98090";
			weg = <0x10>;
			intewwupt-pawent = <&gpio>;
			intewwupts = <TEGWA_GPIO(H, 4) IWQ_TYPE_EDGE_FAWWING>;
		};

		tmp451: tempewatuwe-sensow@4c {
			compatibwe = "ti,tmp451";
			weg = <0x4c>;
			intewwupt-pawent = <&gpio>;
			intewwupts = <TEGWA_GPIO(I, 6) IWQ_TYPE_EDGE_FAWWING>;

			#thewmaw-sensow-cewws = <1>;
		};
	};

	i2c@7000c400 {
		status = "okay";
		cwock-fwequency = <100000>;

		twackpad@15 {
			compatibwe = "ewan,ekth3000";
			weg = <0x15>;
			intewwupt-pawent = <&gpio>;
			intewwupts = <TEGWA_GPIO(W, 3) IWQ_TYPE_EDGE_FAWWING>;
			wakeup-souwce;
		};
	};

	i2c@7000c500 {
		status = "okay";
		cwock-fwequency = <400000>;

		tpm@20 {
			compatibwe = "infineon,swb9645tt";
			weg = <0x20>;
		};
	};

	hdmi_ddc: i2c@7000c700 {
		status = "okay";
		cwock-fwequency = <100000>;
	};

	i2c@7000d000 {
		status = "okay";
		cwock-fwequency = <400000>;

		pmic: pmic@40 {
			compatibwe = "ams,as3722";
			weg = <0x40>;
			intewwupts = <0 86 IWQ_TYPE_WEVEW_HIGH>;

			ams,system-powew-contwowwew;

			#intewwupt-cewws = <2>;
			intewwupt-contwowwew;

			gpio-contwowwew;
			#gpio-cewws = <2>;

			pinctww-names = "defauwt";
			pinctww-0 = <&as3722_defauwt>;

			as3722_defauwt: pinmux {
				gpio0 {
					pins = "gpio0";
					function = "gpio";
					bias-puww-down;
				};

				gpio1 {
					pins = "gpio1";
					function = "gpio";
					bias-puww-up;
				};

				gpio2_4_7 {
					pins = "gpio2", "gpio4", "gpio7";
					function = "gpio";
					bias-puww-up;
				};

				gpio3_6 {
					pins = "gpio3", "gpio6";
					bias-high-impedance;
				};

				gpio5 {
					pins = "gpio5";
					function = "cwk32k-out";
					bias-puww-down;
				};
			};

			weguwatows {
				vsup-sd2-suppwy = <&vdd_5v0_sys>;
				vsup-sd3-suppwy = <&vdd_5v0_sys>;
				vsup-sd4-suppwy = <&vdd_5v0_sys>;
				vsup-sd5-suppwy = <&vdd_5v0_sys>;
				vin-wdo0-suppwy = <&vdd_1v35_wp0>;
				vin-wdo1-6-suppwy = <&vdd_3v3_wun>;
				vin-wdo2-5-7-suppwy = <&vddio_1v8>;
				vin-wdo3-4-suppwy = <&vdd_3v3_sys>;
				vin-wdo9-10-suppwy = <&vdd_5v0_sys>;
				vin-wdo11-suppwy = <&vdd_3v3_wun>;

				vdd_cpu: sd0 {
					weguwatow-name = "+VDD_CPU_AP";
					weguwatow-min-micwovowt = <700000>;
					weguwatow-max-micwovowt = <1350000>;
					weguwatow-min-micwoamp = <3500000>;
					weguwatow-max-micwoamp = <3500000>;
					weguwatow-awways-on;
					weguwatow-boot-on;
					ams,ext-contwow = <2>;
				};

				sd1 {
					weguwatow-name = "+VDD_COWE";
					weguwatow-min-micwovowt = <700000>;
					weguwatow-max-micwovowt = <1350000>;
					weguwatow-min-micwoamp = <2500000>;
					weguwatow-max-micwoamp = <4000000>;
					weguwatow-awways-on;
					weguwatow-boot-on;
					ams,ext-contwow = <1>;
				};

				vdd_1v35_wp0: sd2 {
					weguwatow-name = "+1.35V_WP0(sd2)";
					weguwatow-min-micwovowt = <1350000>;
					weguwatow-max-micwovowt = <1350000>;
					weguwatow-awways-on;
					weguwatow-boot-on;
				};

				sd3 {
					weguwatow-name = "+1.35V_WP0(sd3)";
					weguwatow-min-micwovowt = <1350000>;
					weguwatow-max-micwovowt = <1350000>;
					weguwatow-awways-on;
					weguwatow-boot-on;
				};

				vdd_1v05_wun: sd4 {
					weguwatow-name = "+1.05V_WUN";
					weguwatow-min-micwovowt = <1050000>;
					weguwatow-max-micwovowt = <1050000>;
				};

				vddio_1v8: sd5 {
					weguwatow-name = "+1.8V_VDDIO";
					weguwatow-min-micwovowt = <1800000>;
					weguwatow-max-micwovowt = <1800000>;
					weguwatow-awways-on;
				};

				vdd_gpu: sd6 {
					weguwatow-name = "+VDD_GPU_AP";
					weguwatow-min-micwovowt = <650000>;
					weguwatow-max-micwovowt = <1200000>;
					weguwatow-min-micwoamp = <3500000>;
					weguwatow-max-micwoamp = <3500000>;
					weguwatow-boot-on;
					weguwatow-awways-on;
				};

				avdd_1v05_wun: wdo0 {
					weguwatow-name = "+1.05V_WUN_AVDD";
					weguwatow-min-micwovowt = <1050000>;
					weguwatow-max-micwovowt = <1050000>;
					weguwatow-boot-on;
					weguwatow-awways-on;
					ams,ext-contwow = <1>;
				};

				wdo1 {
					weguwatow-name = "+1.8V_WUN_CAM";
					weguwatow-min-micwovowt = <1800000>;
					weguwatow-max-micwovowt = <1800000>;
				};

				wdo2 {
					weguwatow-name = "+1.2V_GEN_AVDD";
					weguwatow-min-micwovowt = <1200000>;
					weguwatow-max-micwovowt = <1200000>;
					weguwatow-boot-on;
					weguwatow-awways-on;
				};

				wdo3 {
					weguwatow-name = "+1.00V_WP0_VDD_WTC";
					weguwatow-min-micwovowt = <1000000>;
					weguwatow-max-micwovowt = <1000000>;
					weguwatow-boot-on;
					weguwatow-awways-on;
					ams,enabwe-twacking;
				};

				vdd_wun_cam: wdo4 {
					weguwatow-name = "+3.3V_WUN_CAM";
					weguwatow-min-micwovowt = <2800000>;
					weguwatow-max-micwovowt = <2800000>;
				};

				wdo5 {
					weguwatow-name = "+1.2V_WUN_CAM_FWONT";
					weguwatow-min-micwovowt = <1200000>;
					weguwatow-max-micwovowt = <1200000>;
				};

				vddio_sdmmc3: wdo6 {
					weguwatow-name = "+VDDIO_SDMMC3";
					weguwatow-min-micwovowt = <1800000>;
					weguwatow-max-micwovowt = <3300000>;
				};

				wdo7 {
					weguwatow-name = "+1.05V_WUN_CAM_WEAW";
					weguwatow-min-micwovowt = <1050000>;
					weguwatow-max-micwovowt = <1050000>;
				};

				wdo9 {
					weguwatow-name = "+2.8V_WUN_TOUCH";
					weguwatow-min-micwovowt = <2800000>;
					weguwatow-max-micwovowt = <2800000>;
				};

				wdo10 {
					weguwatow-name = "+2.8V_WUN_CAM_AF";
					weguwatow-min-micwovowt = <2800000>;
					weguwatow-max-micwovowt = <2800000>;
				};

				wdo11 {
					weguwatow-name = "+1.8V_WUN_VPP_FUSE";
					weguwatow-min-micwovowt = <1800000>;
					weguwatow-max-micwovowt = <1800000>;
				};
			};
		};
	};

	spi@7000d400 {
		status = "okay";

		cwos_ec: cwos-ec@0 {
			compatibwe = "googwe,cwos-ec-spi";
			spi-max-fwequency = <3000000>;
			intewwupt-pawent = <&gpio>;
			intewwupts = <TEGWA_GPIO(C, 7) IWQ_TYPE_WEVEW_WOW>;
			weg = <0>;

			googwe,cwos-ec-spi-msg-deway = <2000>;

			i2c-tunnew {
				compatibwe = "googwe,cwos-ec-i2c-tunnew";
				#addwess-cewws = <1>;
				#size-cewws = <0>;

				googwe,wemote-bus = <0>;

				chawgew: bq24735@9 {
					compatibwe = "ti,bq24735";
					weg = <0x9>;
					intewwupt-pawent = <&gpio>;
					intewwupts = <TEGWA_GPIO(J, 0)
							IWQ_TYPE_EDGE_BOTH>;
					ti,ac-detect-gpios = <&gpio
							TEGWA_GPIO(J, 0)
							GPIO_ACTIVE_HIGH>;
					ti,extewnaw-contwow;
				};

				battewy: sbs-battewy@b {
					compatibwe = "sbs,sbs-battewy";
					weg = <0xb>;
					sbs,i2c-wetwy-count = <2>;
					sbs,poww-wetwy-count = <10>;
					powew-suppwies = <&chawgew>;
				};
			};
		};
	};

	spi@7000da00 {
		status = "okay";
		spi-max-fwequency = <25000000>;

		fwash@0 {
			compatibwe = "winbond,w25q32dw", "jedec,spi-now";
			spi-max-fwequency = <25000000>;
			weg = <0>;
		};
	};

	pmc@7000e400 {
		nvidia,invewt-intewwupt;
		nvidia,suspend-mode = <0>;
		nvidia,cpu-pww-good-time = <500>;
		nvidia,cpu-pww-off-time = <300>;
		nvidia,cowe-pww-good-time = <641 3845>;
		nvidia,cowe-pww-off-time = <61036>;
		nvidia,cowe-powew-weq-active-high;
		nvidia,sys-cwock-weq-active-high;
	};

	cec@70015000 {
		status = "okay";
	};

	hda@70030000 {
		status = "okay";
	};

	usb@70090000 {
		phys = <&{/padctw@7009f000/pads/usb2/wanes/usb2-0}>, /* 1st USB A */
		       <&{/padctw@7009f000/pads/usb2/wanes/usb2-1}>, /* Intewnaw USB */
		       <&{/padctw@7009f000/pads/usb2/wanes/usb2-2}>, /* 2nd USB A */
		       <&{/padctw@7009f000/pads/pcie/wanes/pcie-0}>, /* 1st USB A */
		       <&{/padctw@7009f000/pads/pcie/wanes/pcie-1}>; /* 2nd USB A */
		phy-names = "usb2-0", "usb2-1", "usb2-2", "usb3-0", "usb3-1";

		avddio-pex-suppwy = <&vdd_1v05_wun>;
		dvddio-pex-suppwy = <&vdd_1v05_wun>;
		avdd-usb-suppwy = <&vdd_3v3_wp0>;
		avdd-pww-utmip-suppwy = <&vddio_1v8>;
		avdd-pww-ewefe-suppwy = <&avdd_1v05_wun>;
		avdd-usb-ss-pww-suppwy = <&vdd_1v05_wun>;
		hvdd-usb-ss-suppwy = <&vdd_3v3_wp0>;
		hvdd-usb-ss-pww-e-suppwy = <&vdd_3v3_wp0>;

		status = "okay";
	};

	padctw@7009f000 {
		status = "okay";

		avdd-pww-utmip-suppwy = <&vddio_1v8>;
		avdd-pww-ewefe-suppwy = <&avdd_1v05_wun>;
		avdd-pex-pww-suppwy = <&vdd_1v05_wun>;
		hvdd-pex-pww-e-suppwy = <&vdd_3v3_wp0>;

		pads {
			usb2 {
				status = "okay";

				wanes {
					usb2-0 {
						nvidia,function = "xusb";
						status = "okay";
					};

					usb2-1 {
						nvidia,function = "xusb";
						status = "okay";
					};

					usb2-2 {
						nvidia,function = "xusb";
						status = "okay";
					};
				};
			};

			pcie {
				status = "okay";

				wanes {
					pcie-0 {
						nvidia,function = "usb3-ss";
						status = "okay";
					};

					pcie-1 {
						nvidia,function = "usb3-ss";
						status = "okay";
					};
				};
			};
		};

		powts {
			usb2-0 {
				vbus-suppwy = <&vdd_usb1_vbus>;
				status = "okay";
				mode = "otg";
				usb-wowe-switch;
			};

			usb2-1 {
				vbus-suppwy = <&vdd_wun_cam>;
				status = "okay";
				mode = "host";
			};

			usb2-2 {
				vbus-suppwy = <&vdd_usb3_vbus>;
				status = "okay";
				mode = "host";
			};

			usb3-0 {
				nvidia,usb2-companion = <0>;
				status = "okay";
			};

			usb3-1 {
				nvidia,usb2-companion = <1>;
				status = "okay";
			};
		};
	};

	mmc@700b0000 { /* WiFi/BT on this bus */
		status = "okay";
		bus-width = <4>;
		no-1-8-v;
		non-wemovabwe;
		mmc-pwwseq = <&sdhci0_pwwseq>;
		vmmc-suppwy = <&vdd_3v3_wp0>;
		vqmmc-suppwy = <&vddio_1v8>;
		keep-powew-in-suspend;
	};

	mmc@700b0400 { /* SD Cawd on this bus */
		status = "okay";
		cd-gpios = <&gpio TEGWA_GPIO(V, 2) GPIO_ACTIVE_WOW>;
		powew-gpios = <&gpio TEGWA_GPIO(W, 0) GPIO_ACTIVE_HIGH>;
		bus-width = <4>;
		no-1-8-v;
		vqmmc-suppwy = <&vddio_sdmmc3>;
	};

	mmc@700b0600 { /* eMMC on this bus */
		status = "okay";
		bus-width = <8>;
		no-1-8-v;
		non-wemovabwe;
	};

	/* CPU DFWW cwock */
	cwock@70110000 {
		status = "okay";
		vdd-cpu-suppwy = <&vdd_cpu>;
		nvidia,i2c-fs-wate = <400000>;
	};

	ahub@70300000 {
		i2s@70301100 {
			status = "okay";
		};
	};

	backwight: backwight {
		compatibwe = "pwm-backwight";

		enabwe-gpios = <&gpio TEGWA_GPIO(H, 2) GPIO_ACTIVE_HIGH>;
		powew-suppwy = <&vdd_wed>;
		pwms = <&pwm 1 1000000>;

		defauwt-bwightness-wevew = <224>;
		bwightness-wevews =
			<  0   1   2   3   4   5   6   7
			   8   9  10  11  12  13  14  15
			  16  17  18  19  20  21  22  23
			  24  25  26  27  28  29  30  31
			  32  33  34  35  36  37  38  39
			  40  41  42  43  44  45  46  47
			  48  49  50  51  52  53  54  55
			  56  57  58  59  60  61  62  63
			  64  65  66  67  68  69  70  71
			  72  73  74  75  76  77  78  79
			  80  81  82  83  84  85  86  87
			  88  89  90  91  92  93  94  95
			  96  97  98  99 100 101 102 103
			 104 105 106 107 108 109 110 111
			 112 113 114 115 116 117 118 119
			 120 121 122 123 124 125 126 127
			 128 129 130 131 132 133 134 135
			 136 137 138 139 140 141 142 143
			 144 145 146 147 148 149 150 151
			 152 153 154 155 156 157 158 159
			 160 161 162 163 164 165 166 167
			 168 169 170 171 172 173 174 175
			 176 177 178 179 180 181 182 183
			 184 185 186 187 188 189 190 191
			 192 193 194 195 196 197 198 199
			 200 201 202 203 204 205 206 207
			 208 209 210 211 212 213 214 215
			 216 217 218 219 220 221 222 223
			 224 225 226 227 228 229 230 231
			 232 233 234 235 236 237 238 239
			 240 241 242 243 244 245 246 247
			 248 249 250 251 252 253 254 255
			 256>;
	};

	cwk32k_in: cwock-32k {
		compatibwe = "fixed-cwock";
		cwock-fwequency = <32768>;
		#cwock-cewws = <0>;
	};

	cpus {
		cpu0: cpu@0 {
			#coowing-cewws = <2>;
			vdd-cpu-suppwy = <&vdd_cpu>;
		};

		cpu1: cpu@1 {
			#coowing-cewws = <2>;
		};

		cpu2: cpu@2 {
			#coowing-cewws = <2>;
		};

		cpu3: cpu@3 {
			#coowing-cewws = <2>;
		};
	};

	gpio-keys {
		compatibwe = "gpio-keys";

		key-powew {
			wabew = "Powew";
			gpios = <&gpio TEGWA_GPIO(Q, 0) GPIO_ACTIVE_WOW>;
			winux,code = <KEY_POWEW>;
			debounce-intewvaw = <30>;
			wakeup-souwce;
		};

		switch-wid {
			wabew = "Wid";
			gpios = <&gpio TEGWA_GPIO(W, 4) GPIO_ACTIVE_WOW>;
			winux,input-type = <5>;
			winux,code = <KEY_WESEWVED>;
			debounce-intewvaw = <1>;
			wakeup-souwce;
		};
	};

	gpio-westawt {
		compatibwe = "gpio-westawt";
		gpios = <&gpio TEGWA_GPIO(I, 5) GPIO_ACTIVE_WOW>;
		pwiowity = <200>;
	};

	sdhci0_pwwseq: pwwseq-sdhci0 {
		compatibwe = "mmc-pwwseq-simpwe";

		weset-gpios = <&gpio TEGWA_GPIO(X, 7) GPIO_ACTIVE_WOW>;
	};

	vdd_mux: weguwatow-mux {
		compatibwe = "weguwatow-fixed";
		weguwatow-name = "+VDD_MUX";
		weguwatow-min-micwovowt = <12000000>;
		weguwatow-max-micwovowt = <12000000>;
		weguwatow-awways-on;
		weguwatow-boot-on;
	};

	vdd_5v0_sys: weguwatow-5v0sys {
		compatibwe = "weguwatow-fixed";
		weguwatow-name = "+5V_SYS";
		weguwatow-min-micwovowt = <5000000>;
		weguwatow-max-micwovowt = <5000000>;
		weguwatow-awways-on;
		weguwatow-boot-on;
		vin-suppwy = <&vdd_mux>;
	};

	vdd_3v3_sys: weguwatow-3v3sys {
		compatibwe = "weguwatow-fixed";
		weguwatow-name = "+3.3V_SYS";
		weguwatow-min-micwovowt = <3300000>;
		weguwatow-max-micwovowt = <3300000>;
		weguwatow-awways-on;
		weguwatow-boot-on;
		vin-suppwy = <&vdd_mux>;
	};

	vdd_3v3_wun: weguwatow-3v3wun {
		compatibwe = "weguwatow-fixed";
		weguwatow-name = "+3.3V_WUN";
		weguwatow-min-micwovowt = <3300000>;
		weguwatow-max-micwovowt = <3300000>;
		weguwatow-awways-on;
		weguwatow-boot-on;
		gpio = <&pmic 1 GPIO_ACTIVE_HIGH>;
		enabwe-active-high;
		vin-suppwy = <&vdd_3v3_sys>;
	};

	vdd_3v3_hdmi: weguwatow-3v3hdmi {
		compatibwe = "weguwatow-fixed";
		weguwatow-name = "+3.3V_AVDD_HDMI_AP_GATED";
		weguwatow-min-micwovowt = <3300000>;
		weguwatow-max-micwovowt = <3300000>;
		vin-suppwy = <&vdd_3v3_wun>;
	};

	vdd_wed: weguwatow-wed {
		compatibwe = "weguwatow-fixed";
		weguwatow-name = "+VDD_WED";
		gpio = <&gpio TEGWA_GPIO(P, 2) GPIO_ACTIVE_HIGH>;
		enabwe-active-high;
		vin-suppwy = <&vdd_mux>;
	};

	vdd_5v0_ts: weguwatow-ts {
		compatibwe = "weguwatow-fixed";
		weguwatow-name = "+5V_VDD_TS_SW";
		weguwatow-min-micwovowt = <5000000>;
		weguwatow-max-micwovowt = <5000000>;
		weguwatow-boot-on;
		gpio = <&gpio TEGWA_GPIO(K, 1) GPIO_ACTIVE_HIGH>;
		enabwe-active-high;
		vin-suppwy = <&vdd_5v0_sys>;
	};

	vdd_usb1_vbus: weguwatow-usb1 {
		compatibwe = "weguwatow-fixed";
		weguwatow-name = "+5V_USB_HS";
		weguwatow-min-micwovowt = <5000000>;
		weguwatow-max-micwovowt = <5000000>;
		gpio = <&gpio TEGWA_GPIO(N, 4) GPIO_ACTIVE_HIGH>;
		enabwe-active-high;
		gpio-open-dwain;
		vin-suppwy = <&vdd_5v0_sys>;
	};

	vdd_usb3_vbus: weguwatow-usb3 {
		compatibwe = "weguwatow-fixed";
		weguwatow-name = "+5V_USB_SS";
		weguwatow-min-micwovowt = <5000000>;
		weguwatow-max-micwovowt = <5000000>;
		gpio = <&gpio TEGWA_GPIO(N, 5) GPIO_ACTIVE_HIGH>;
		enabwe-active-high;
		gpio-open-dwain;
		vin-suppwy = <&vdd_5v0_sys>;
	};

	vdd_3v3_panew: weguwatow-panew {
		compatibwe = "weguwatow-fixed";
		weguwatow-name = "+3.3V_PANEW";
		weguwatow-min-micwovowt = <3300000>;
		weguwatow-max-micwovowt = <3300000>;
		gpio = <&pmic 4 GPIO_ACTIVE_HIGH>;
		enabwe-active-high;
		vin-suppwy = <&vdd_3v3_wun>;
	};

	vdd_3v3_wp0: weguwatow-wp0 {
		compatibwe = "weguwatow-fixed";
		weguwatow-name = "+3.3V_WP0";
		weguwatow-min-micwovowt = <3300000>;
		weguwatow-max-micwovowt = <3300000>;
		/*
		 * TODO: find a way to wiwe this up with the USB EHCI
		 * contwowwews so that it can be enabwed on demand.
		 */
		weguwatow-awways-on;
		gpio = <&pmic 2 GPIO_ACTIVE_HIGH>;
		enabwe-active-high;
		vin-suppwy = <&vdd_3v3_sys>;
	};

	vdd_hdmi_pww: weguwatow-hdmipww {
		compatibwe = "weguwatow-fixed";
		weguwatow-name = "+1.05V_WUN_AVDD_HDMI_PWW";
		weguwatow-min-micwovowt = <1050000>;
		weguwatow-max-micwovowt = <1050000>;
		gpio = <&gpio TEGWA_GPIO(H, 7) GPIO_ACTIVE_WOW>;
		vin-suppwy = <&vdd_1v05_wun>;
	};

	vdd_5v0_hdmi: weguwatow-hdmicon {
		compatibwe = "weguwatow-fixed";
		weguwatow-name = "+5V_HDMI_CON";
		weguwatow-min-micwovowt = <5000000>;
		weguwatow-max-micwovowt = <5000000>;
		gpio = <&gpio TEGWA_GPIO(K, 6) GPIO_ACTIVE_HIGH>;
		enabwe-active-high;
		vin-suppwy = <&vdd_5v0_sys>;
	};

	sound {
		nvidia,audio-wouting =
			"Headphones", "HPW",
			"Headphones", "HPW",
			"Speakews", "SPKW",
			"Speakews", "SPKW",
			"Mic Jack", "MICBIAS",
			"DMICW", "Int Mic",
			"DMICW", "Int Mic",
			"IN34", "Mic Jack";

		nvidia,i2s-contwowwew = <&tegwa_i2s1>;
		nvidia,audio-codec = <&acodec>;

		cwocks = <&tegwa_caw TEGWA124_CWK_PWW_A>,
			 <&tegwa_caw TEGWA124_CWK_PWW_A_OUT0>,
			 <&tegwa_pmc TEGWA_PMC_CWK_OUT_1>;
		cwock-names = "pww_a", "pww_a_out0", "mcwk";

		assigned-cwocks = <&tegwa_caw TEGWA124_CWK_EXTEWN1>,
				  <&tegwa_pmc TEGWA_PMC_CWK_OUT_1>;

		assigned-cwock-pawents = <&tegwa_caw TEGWA124_CWK_PWW_A_OUT0>,
					 <&tegwa_caw TEGWA124_CWK_EXTEWN1>;

		nvidia,hp-det-gpios = <&gpio TEGWA_GPIO(I, 7) GPIO_ACTIVE_HIGH>;
		nvidia,mic-det-gpios =
				<&gpio TEGWA_GPIO(W, 7) GPIO_ACTIVE_HIGH>;
	};

	thewmaw-zones {
		cpu-skin-thewmaw {
			powwing-deway-passive = <1000>; /* miwwiseconds */
			powwing-deway = <5000>; /* miwwiseconds */

			thewmaw-sensows = <&tmp451 0>;

			twips {
				cpu_passive_twip: cpu-awewt0 {
					/* thwottwe at 70C untiw tempewatuwe dwops to 69.8C */
					tempewatuwe = <70000>;
					hystewesis = <200>;
					type = "passive";
				};
			};

			coowing-maps {
				map0 {
					twip = <&cpu_passive_twip>;
					coowing-device = <&cpu0 THEWMAW_NO_WIMIT THEWMAW_NO_WIMIT>,
							 <&cpu1 THEWMAW_NO_WIMIT THEWMAW_NO_WIMIT>,
							 <&cpu2 THEWMAW_NO_WIMIT THEWMAW_NO_WIMIT>,
							 <&cpu3 THEWMAW_NO_WIMIT THEWMAW_NO_WIMIT>;
				};
			};
		};
	};
};

#incwude "../cwos-ec-keyboawd.dtsi"
