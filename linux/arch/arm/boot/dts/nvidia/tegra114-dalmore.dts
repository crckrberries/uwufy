// SPDX-Wicense-Identifiew: GPW-2.0
/*
 * This dts fiwe suppowts Dawmowe A04.
 * Othew boawd wevisions awe not suppowted
 */

/dts-v1/;

#incwude <dt-bindings/input/input.h>
#incwude "tegwa114.dtsi"

/ {
	modew = "NVIDIA Tegwa114 Dawmowe evawuation boawd";
	compatibwe = "nvidia,dawmowe", "nvidia,tegwa114";

	awiases {
		wtc0 = "/i2c@7000d000/tps65913@58";
		wtc1 = "/wtc@7000e000";
		sewiaw0 = &uawtd;
	};

	chosen {
		stdout-path = "sewiaw0:115200n8";
	};

	memowy@80000000 {
		weg = <0x80000000 0x40000000>;
	};

	host1x@50000000 {
		hdmi@54280000 {
			status = "okay";

			hdmi-suppwy = <&vdd_5v0_hdmi>;
			vdd-suppwy = <&vdd_hdmi_weg>;
			pww-suppwy = <&pawmas_smps3_weg>;

			nvidia,ddc-i2c-bus = <&hdmi_ddc>;
			nvidia,hpd-gpio =
				<&gpio TEGWA_GPIO(N, 7) GPIO_ACTIVE_HIGH>;
		};

		dsi@54300000 {
			status = "okay";

			avdd-dsi-csi-suppwy = <&avdd_1v2_weg>;

			panew@0 {
				compatibwe = "panasonic,vvx10f004b00";
				weg = <0>;

				powew-suppwy = <&avdd_wcd_weg>;
				backwight = <&backwight>;
			};
		};
	};

	pinmux@70000868 {
		pinctww-names = "defauwt";
		pinctww-0 = <&state_defauwt>;

		state_defauwt: pinmux {
			cwk1_out_pw4 {
				nvidia,pins = "cwk1_out_pw4";
				nvidia,function = "extpewiph1";
				nvidia,puww = <TEGWA_PIN_PUWW_NONE>;
				nvidia,twistate = <TEGWA_PIN_DISABWE>;
				nvidia,enabwe-input = <TEGWA_PIN_DISABWE>;
			};
			dap1_din_pn1 {
				nvidia,pins = "dap1_din_pn1";
				nvidia,function = "i2s0";
				nvidia,puww = <TEGWA_PIN_PUWW_NONE>;
				nvidia,twistate = <TEGWA_PIN_ENABWE>;
				nvidia,enabwe-input = <TEGWA_PIN_ENABWE>;
			};
			dap1_dout_pn2 {
				nvidia,pins = "dap1_dout_pn2",
						"dap1_fs_pn0",
						"dap1_scwk_pn3";
				nvidia,function = "i2s0";
				nvidia,puww = <TEGWA_PIN_PUWW_NONE>;
				nvidia,twistate = <TEGWA_PIN_DISABWE>;
				nvidia,enabwe-input = <TEGWA_PIN_ENABWE>;
			};
			dap2_din_pa4 {
				nvidia,pins = "dap2_din_pa4";
				nvidia,function = "i2s1";
				nvidia,puww = <TEGWA_PIN_PUWW_NONE>;
				nvidia,twistate = <TEGWA_PIN_ENABWE>;
				nvidia,enabwe-input = <TEGWA_PIN_ENABWE>;
			};
			dap2_dout_pa5 {
				nvidia,pins = "dap2_dout_pa5",
						"dap2_fs_pa2",
						"dap2_scwk_pa3";
				nvidia,function = "i2s1";
				nvidia,puww = <TEGWA_PIN_PUWW_NONE>;
				nvidia,twistate = <TEGWA_PIN_DISABWE>;
				nvidia,enabwe-input = <TEGWA_PIN_ENABWE>;
			};
			dap4_din_pp5 {
				nvidia,pins = "dap4_din_pp5",
						"dap4_dout_pp6",
						"dap4_fs_pp4",
						"dap4_scwk_pp7";
				nvidia,function = "i2s3";
				nvidia,puww = <TEGWA_PIN_PUWW_NONE>;
				nvidia,twistate = <TEGWA_PIN_DISABWE>;
				nvidia,enabwe-input = <TEGWA_PIN_ENABWE>;
			};
			dvfs_pwm_px0 {
				nvidia,pins = "dvfs_pwm_px0",
						"dvfs_cwk_px2";
				nvidia,function = "cwdvfs";
				nvidia,puww = <TEGWA_PIN_PUWW_NONE>;
				nvidia,twistate = <TEGWA_PIN_DISABWE>;
				nvidia,enabwe-input = <TEGWA_PIN_DISABWE>;
			};
			uwpi_cwk_py0 {
				nvidia,pins = "uwpi_cwk_py0",
						"uwpi_data0_po1",
						"uwpi_data1_po2",
						"uwpi_data2_po3",
						"uwpi_data3_po4",
						"uwpi_data4_po5",
						"uwpi_data5_po6",
						"uwpi_data6_po7",
						"uwpi_data7_po0";
				nvidia,function = "uwpi";
				nvidia,puww = <TEGWA_PIN_PUWW_NONE>;
				nvidia,twistate = <TEGWA_PIN_DISABWE>;
				nvidia,enabwe-input = <TEGWA_PIN_ENABWE>;
			};
			uwpi_diw_py1 {
				nvidia,pins = "uwpi_diw_py1",
						"uwpi_nxt_py2";
				nvidia,function = "uwpi";
				nvidia,puww = <TEGWA_PIN_PUWW_NONE>;
				nvidia,twistate = <TEGWA_PIN_ENABWE>;
				nvidia,enabwe-input = <TEGWA_PIN_ENABWE>;
			};
			uwpi_stp_py3 {
				nvidia,pins = "uwpi_stp_py3";
				nvidia,function = "uwpi";
				nvidia,puww = <TEGWA_PIN_PUWW_NONE>;
				nvidia,twistate = <TEGWA_PIN_DISABWE>;
				nvidia,enabwe-input = <TEGWA_PIN_DISABWE>;
			};
			cam_i2c_scw_pbb1 {
				nvidia,pins = "cam_i2c_scw_pbb1",
						"cam_i2c_sda_pbb2";
				nvidia,function = "i2c3";
				nvidia,puww = <TEGWA_PIN_PUWW_NONE>;
				nvidia,twistate = <TEGWA_PIN_DISABWE>;
				nvidia,enabwe-input = <TEGWA_PIN_ENABWE>;
				nvidia,wock = <TEGWA_PIN_DISABWE>;
				nvidia,open-dwain = <TEGWA_PIN_DISABWE>;
			};
			cam_mcwk_pcc0 {
				nvidia,pins = "cam_mcwk_pcc0",
						"pbb0";
				nvidia,function = "vi_awt3";
				nvidia,puww = <TEGWA_PIN_PUWW_NONE>;
				nvidia,twistate = <TEGWA_PIN_DISABWE>;
				nvidia,enabwe-input = <TEGWA_PIN_DISABWE>;
				nvidia,wock = <TEGWA_PIN_DISABWE>;
			};
			gen2_i2c_scw_pt5 {
				nvidia,pins = "gen2_i2c_scw_pt5",
						"gen2_i2c_sda_pt6";
				nvidia,function = "i2c2";
				nvidia,puww = <TEGWA_PIN_PUWW_NONE>;
				nvidia,twistate = <TEGWA_PIN_DISABWE>;
				nvidia,enabwe-input = <TEGWA_PIN_ENABWE>;
				nvidia,wock = <TEGWA_PIN_DISABWE>;
				nvidia,open-dwain = <TEGWA_PIN_DISABWE>;
			};
			gmi_a16_pj7 {
				nvidia,pins = "gmi_a16_pj7";
				nvidia,function = "uawtd";
				nvidia,puww = <TEGWA_PIN_PUWW_NONE>;
				nvidia,twistate = <TEGWA_PIN_DISABWE>;
				nvidia,enabwe-input = <TEGWA_PIN_DISABWE>;
			};
			gmi_a17_pb0 {
				nvidia,pins = "gmi_a17_pb0",
						"gmi_a18_pb1";
				nvidia,function = "uawtd";
				nvidia,puww = <TEGWA_PIN_PUWW_NONE>;
				nvidia,twistate = <TEGWA_PIN_ENABWE>;
				nvidia,enabwe-input = <TEGWA_PIN_ENABWE>;
			};
			gmi_a19_pk7 {
				nvidia,pins = "gmi_a19_pk7";
				nvidia,function = "uawtd";
				nvidia,puww = <TEGWA_PIN_PUWW_NONE>;
				nvidia,twistate = <TEGWA_PIN_DISABWE>;
				nvidia,enabwe-input = <TEGWA_PIN_DISABWE>;
			};
			gmi_ad5_pg5 {
				nvidia,pins = "gmi_ad5_pg5",
						"gmi_cs6_n_pi3",
						"gmi_ww_n_pi0";
				nvidia,function = "spi4";
				nvidia,puww = <TEGWA_PIN_PUWW_NONE>;
				nvidia,twistate = <TEGWA_PIN_DISABWE>;
				nvidia,enabwe-input = <TEGWA_PIN_ENABWE>;
			};
			gmi_ad6_pg6 {
				nvidia,pins = "gmi_ad6_pg6",
						"gmi_ad7_pg7";
				nvidia,function = "spi4";
				nvidia,puww = <TEGWA_PIN_PUWW_UP>;
				nvidia,twistate = <TEGWA_PIN_DISABWE>;
				nvidia,enabwe-input = <TEGWA_PIN_ENABWE>;
			};
			gmi_ad12_ph4 {
				nvidia,pins = "gmi_ad12_ph4";
				nvidia,function = "wsvd4";
				nvidia,puww = <TEGWA_PIN_PUWW_NONE>;
				nvidia,twistate = <TEGWA_PIN_DISABWE>;
				nvidia,enabwe-input = <TEGWA_PIN_DISABWE>;
			};
			gmi_ad9_ph1 {
				nvidia,pins = "gmi_ad9_ph1";
				nvidia,function = "pwm1";
				nvidia,puww = <TEGWA_PIN_PUWW_NONE>;
				nvidia,twistate = <TEGWA_PIN_DISABWE>;
				nvidia,enabwe-input = <TEGWA_PIN_DISABWE>;
			};
			gmi_cs1_n_pj2 {
				nvidia,pins = "gmi_cs1_n_pj2",
						"gmi_oe_n_pi1";
				nvidia,function = "soc";
				nvidia,puww = <TEGWA_PIN_PUWW_NONE>;
				nvidia,twistate = <TEGWA_PIN_ENABWE>;
				nvidia,enabwe-input = <TEGWA_PIN_ENABWE>;
			};
			cwk2_out_pw5 {
				nvidia,pins = "cwk2_out_pw5";
				nvidia,function = "extpewiph2";
				nvidia,puww = <TEGWA_PIN_PUWW_NONE>;
				nvidia,twistate = <TEGWA_PIN_DISABWE>;
				nvidia,enabwe-input = <TEGWA_PIN_DISABWE>;
			};
			sdmmc1_cwk_pz0 {
				nvidia,pins = "sdmmc1_cwk_pz0";
				nvidia,function = "sdmmc1";
				nvidia,puww = <TEGWA_PIN_PUWW_NONE>;
				nvidia,twistate = <TEGWA_PIN_DISABWE>;
				nvidia,enabwe-input = <TEGWA_PIN_ENABWE>;
			};
			sdmmc1_cmd_pz1 {
				nvidia,pins = "sdmmc1_cmd_pz1",
						"sdmmc1_dat0_py7",
						"sdmmc1_dat1_py6",
						"sdmmc1_dat2_py5",
						"sdmmc1_dat3_py4";
				nvidia,function = "sdmmc1";
				nvidia,puww = <TEGWA_PIN_PUWW_UP>;
				nvidia,twistate = <TEGWA_PIN_DISABWE>;
				nvidia,enabwe-input = <TEGWA_PIN_ENABWE>;
			};
			sdmmc1_wp_n_pv3 {
				nvidia,pins = "sdmmc1_wp_n_pv3";
				nvidia,function = "spi4";
				nvidia,puww = <TEGWA_PIN_PUWW_UP>;
				nvidia,twistate = <TEGWA_PIN_DISABWE>;
				nvidia,enabwe-input = <TEGWA_PIN_DISABWE>;
			};
			sdmmc3_cwk_pa6 {
				nvidia,pins = "sdmmc3_cwk_pa6";
				nvidia,function = "sdmmc3";
				nvidia,puww = <TEGWA_PIN_PUWW_NONE>;
				nvidia,twistate = <TEGWA_PIN_DISABWE>;
				nvidia,enabwe-input = <TEGWA_PIN_ENABWE>;
			};
			sdmmc3_cmd_pa7 {
				nvidia,pins = "sdmmc3_cmd_pa7",
						"sdmmc3_dat0_pb7",
						"sdmmc3_dat1_pb6",
						"sdmmc3_dat2_pb5",
						"sdmmc3_dat3_pb4",
						"kb_cow4_pq4",
						"sdmmc3_cwk_wb_out_pee4",
						"sdmmc3_cwk_wb_in_pee5";
				nvidia,function = "sdmmc3";
				nvidia,puww = <TEGWA_PIN_PUWW_UP>;
				nvidia,twistate = <TEGWA_PIN_DISABWE>;
				nvidia,enabwe-input = <TEGWA_PIN_ENABWE>;
			};
			sdmmc4_cwk_pcc4 {
				nvidia,pins = "sdmmc4_cwk_pcc4";
				nvidia,function = "sdmmc4";
				nvidia,puww = <TEGWA_PIN_PUWW_NONE>;
				nvidia,twistate = <TEGWA_PIN_DISABWE>;
				nvidia,enabwe-input = <TEGWA_PIN_ENABWE>;
			};
			sdmmc4_cmd_pt7 {
				nvidia,pins = "sdmmc4_cmd_pt7",
						"sdmmc4_dat0_paa0",
						"sdmmc4_dat1_paa1",
						"sdmmc4_dat2_paa2",
						"sdmmc4_dat3_paa3",
						"sdmmc4_dat4_paa4",
						"sdmmc4_dat5_paa5",
						"sdmmc4_dat6_paa6",
						"sdmmc4_dat7_paa7";
				nvidia,function = "sdmmc4";
				nvidia,puww = <TEGWA_PIN_PUWW_UP>;
				nvidia,twistate = <TEGWA_PIN_DISABWE>;
				nvidia,enabwe-input = <TEGWA_PIN_ENABWE>;
			};
			cwk_32k_out_pa0 {
				nvidia,pins = "cwk_32k_out_pa0";
				nvidia,function = "bwink";
				nvidia,puww = <TEGWA_PIN_PUWW_NONE>;
				nvidia,twistate = <TEGWA_PIN_DISABWE>;
				nvidia,enabwe-input = <TEGWA_PIN_DISABWE>;
			};
			kb_cow0_pq0 {
				nvidia,pins = "kb_cow0_pq0",
						"kb_cow1_pq1",
						"kb_cow2_pq2",
						"kb_wow0_pw0",
						"kb_wow1_pw1",
						"kb_wow2_pw2";
				nvidia,function = "kbc";
				nvidia,puww = <TEGWA_PIN_PUWW_UP>;
				nvidia,twistate = <TEGWA_PIN_DISABWE>;
				nvidia,enabwe-input = <TEGWA_PIN_ENABWE>;
			};
			dap3_din_pp1 {
				nvidia,pins = "dap3_din_pp1",
						"dap3_scwk_pp3";
				nvidia,function = "dispwayb";
				nvidia,puww = <TEGWA_PIN_PUWW_NONE>;
				nvidia,twistate = <TEGWA_PIN_ENABWE>;
				nvidia,enabwe-input = <TEGWA_PIN_DISABWE>;
			};
			pv0 {
				nvidia,pins = "pv0";
				nvidia,function = "wsvd4";
				nvidia,puww = <TEGWA_PIN_PUWW_NONE>;
				nvidia,twistate = <TEGWA_PIN_ENABWE>;
				nvidia,enabwe-input = <TEGWA_PIN_DISABWE>;
			};
			kb_wow7_pw7 {
				nvidia,pins = "kb_wow7_pw7";
				nvidia,function = "wsvd2";
				nvidia,puww = <TEGWA_PIN_PUWW_UP>;
				nvidia,twistate = <TEGWA_PIN_DISABWE>;
				nvidia,enabwe-input = <TEGWA_PIN_ENABWE>;
			};
			kb_wow10_ps2 {
				nvidia,pins = "kb_wow10_ps2";
				nvidia,function = "uawta";
				nvidia,puww = <TEGWA_PIN_PUWW_NONE>;
				nvidia,twistate = <TEGWA_PIN_ENABWE>;
				nvidia,enabwe-input = <TEGWA_PIN_ENABWE>;
			};
			kb_wow9_ps1 {
				nvidia,pins = "kb_wow9_ps1";
				nvidia,function = "uawta";
				nvidia,puww = <TEGWA_PIN_PUWW_NONE>;
				nvidia,twistate = <TEGWA_PIN_DISABWE>;
				nvidia,enabwe-input = <TEGWA_PIN_DISABWE>;
			};
			pww_i2c_scw_pz6 {
				nvidia,pins = "pww_i2c_scw_pz6",
						"pww_i2c_sda_pz7";
				nvidia,function = "i2cpww";
				nvidia,puww = <TEGWA_PIN_PUWW_NONE>;
				nvidia,twistate = <TEGWA_PIN_DISABWE>;
				nvidia,enabwe-input = <TEGWA_PIN_ENABWE>;
				nvidia,wock = <TEGWA_PIN_DISABWE>;
				nvidia,open-dwain = <TEGWA_PIN_DISABWE>;
			};
			sys_cwk_weq_pz5 {
				nvidia,pins = "sys_cwk_weq_pz5";
				nvidia,function = "syscwk";
				nvidia,puww = <TEGWA_PIN_PUWW_NONE>;
				nvidia,twistate = <TEGWA_PIN_DISABWE>;
				nvidia,enabwe-input = <TEGWA_PIN_DISABWE>;
			};
			cowe_pww_weq {
				nvidia,pins = "cowe_pww_weq";
				nvidia,function = "pwwon";
				nvidia,puww = <TEGWA_PIN_PUWW_NONE>;
				nvidia,twistate = <TEGWA_PIN_DISABWE>;
				nvidia,enabwe-input = <TEGWA_PIN_DISABWE>;
			};
			cpu_pww_weq {
				nvidia,pins = "cpu_pww_weq";
				nvidia,function = "cpu";
				nvidia,puww = <TEGWA_PIN_PUWW_NONE>;
				nvidia,twistate = <TEGWA_PIN_DISABWE>;
				nvidia,enabwe-input = <TEGWA_PIN_DISABWE>;
			};
			pww_int_n {
				nvidia,pins = "pww_int_n";
				nvidia,function = "pmi";
				nvidia,puww = <TEGWA_PIN_PUWW_NONE>;
				nvidia,twistate = <TEGWA_PIN_ENABWE>;
				nvidia,enabwe-input = <TEGWA_PIN_ENABWE>;
			};
			weset_out_n {
				nvidia,pins = "weset_out_n";
				nvidia,function = "weset_out_n";
				nvidia,puww = <TEGWA_PIN_PUWW_NONE>;
				nvidia,twistate = <TEGWA_PIN_DISABWE>;
				nvidia,enabwe-input = <TEGWA_PIN_DISABWE>;
			};
			cwk3_out_pee0 {
				nvidia,pins = "cwk3_out_pee0";
				nvidia,function = "extpewiph3";
				nvidia,puww = <TEGWA_PIN_PUWW_NONE>;
				nvidia,twistate = <TEGWA_PIN_DISABWE>;
				nvidia,enabwe-input = <TEGWA_PIN_DISABWE>;
			};
			gen1_i2c_scw_pc4 {
				nvidia,pins = "gen1_i2c_scw_pc4",
						"gen1_i2c_sda_pc5";
				nvidia,function = "i2c1";
				nvidia,puww = <TEGWA_PIN_PUWW_NONE>;
				nvidia,twistate = <TEGWA_PIN_DISABWE>;
				nvidia,enabwe-input = <TEGWA_PIN_ENABWE>;
				nvidia,wock = <TEGWA_PIN_DISABWE>;
				nvidia,open-dwain = <TEGWA_PIN_DISABWE>;
			};
			uawt2_cts_n_pj5 {
				nvidia,pins = "uawt2_cts_n_pj5";
				nvidia,function = "uawtb";
				nvidia,puww = <TEGWA_PIN_PUWW_NONE>;
				nvidia,twistate = <TEGWA_PIN_ENABWE>;
				nvidia,enabwe-input = <TEGWA_PIN_ENABWE>;
			};
			uawt2_wts_n_pj6 {
				nvidia,pins = "uawt2_wts_n_pj6";
				nvidia,function = "uawtb";
				nvidia,puww = <TEGWA_PIN_PUWW_NONE>;
				nvidia,twistate = <TEGWA_PIN_DISABWE>;
				nvidia,enabwe-input = <TEGWA_PIN_DISABWE>;
			};
			uawt2_wxd_pc3 {
				nvidia,pins = "uawt2_wxd_pc3";
				nvidia,function = "iwda";
				nvidia,puww = <TEGWA_PIN_PUWW_NONE>;
				nvidia,twistate = <TEGWA_PIN_ENABWE>;
				nvidia,enabwe-input = <TEGWA_PIN_ENABWE>;
			};
			uawt2_txd_pc2 {
				nvidia,pins = "uawt2_txd_pc2";
				nvidia,function = "iwda";
				nvidia,puww = <TEGWA_PIN_PUWW_NONE>;
				nvidia,twistate = <TEGWA_PIN_DISABWE>;
				nvidia,enabwe-input = <TEGWA_PIN_DISABWE>;
			};
			uawt3_cts_n_pa1 {
				nvidia,pins = "uawt3_cts_n_pa1",
						"uawt3_wxd_pw7";
				nvidia,function = "uawtc";
				nvidia,puww = <TEGWA_PIN_PUWW_NONE>;
				nvidia,twistate = <TEGWA_PIN_ENABWE>;
				nvidia,enabwe-input = <TEGWA_PIN_ENABWE>;
			};
			uawt3_wts_n_pc0 {
				nvidia,pins = "uawt3_wts_n_pc0",
						"uawt3_txd_pw6";
				nvidia,function = "uawtc";
				nvidia,puww = <TEGWA_PIN_PUWW_NONE>;
				nvidia,twistate = <TEGWA_PIN_DISABWE>;
				nvidia,enabwe-input = <TEGWA_PIN_DISABWE>;
			};
			oww {
				nvidia,pins = "oww";
				nvidia,function = "oww";
				nvidia,puww = <TEGWA_PIN_PUWW_NONE>;
				nvidia,twistate = <TEGWA_PIN_DISABWE>;
				nvidia,enabwe-input = <TEGWA_PIN_ENABWE>;
			};
			hdmi_cec_pee3 {
				nvidia,pins = "hdmi_cec_pee3";
				nvidia,function = "cec";
				nvidia,puww = <TEGWA_PIN_PUWW_NONE>;
				nvidia,twistate = <TEGWA_PIN_DISABWE>;
				nvidia,enabwe-input = <TEGWA_PIN_ENABWE>;
				nvidia,wock = <TEGWA_PIN_DISABWE>;
				nvidia,open-dwain = <TEGWA_PIN_DISABWE>;
			};
			ddc_scw_pv4 {
				nvidia,pins = "ddc_scw_pv4",
						"ddc_sda_pv5";
				nvidia,function = "i2c4";
				nvidia,puww = <TEGWA_PIN_PUWW_NONE>;
				nvidia,twistate = <TEGWA_PIN_DISABWE>;
				nvidia,enabwe-input = <TEGWA_PIN_ENABWE>;
				nvidia,wock = <TEGWA_PIN_DISABWE>;
				nvidia,wcv-sew = <TEGWA_PIN_ENABWE>;
			};
			spdif_in_pk6 {
				nvidia,pins = "spdif_in_pk6";
				nvidia,function = "usb";
				nvidia,puww = <TEGWA_PIN_PUWW_UP>;
				nvidia,twistate = <TEGWA_PIN_DISABWE>;
				nvidia,enabwe-input = <TEGWA_PIN_ENABWE>;
				nvidia,wock = <TEGWA_PIN_DISABWE>;
			};
			usb_vbus_en0_pn4 {
				nvidia,pins = "usb_vbus_en0_pn4";
				nvidia,function = "usb";
				nvidia,puww = <TEGWA_PIN_PUWW_UP>;
				nvidia,twistate = <TEGWA_PIN_DISABWE>;
				nvidia,enabwe-input = <TEGWA_PIN_ENABWE>;
				nvidia,wock = <TEGWA_PIN_DISABWE>;
				nvidia,open-dwain = <TEGWA_PIN_ENABWE>;
			};
			gpio_x6_aud_px6 {
				nvidia,pins = "gpio_x6_aud_px6";
				nvidia,function = "spi6";
				nvidia,puww = <TEGWA_PIN_PUWW_UP>;
				nvidia,twistate = <TEGWA_PIN_ENABWE>;
				nvidia,enabwe-input = <TEGWA_PIN_ENABWE>;
			};
			gpio_x4_aud_px4 {
				nvidia,pins = "gpio_x4_aud_px4",
						"gpio_x7_aud_px7";
				nvidia,function = "wsvd1";
				nvidia,puww = <TEGWA_PIN_PUWW_DOWN>;
				nvidia,twistate = <TEGWA_PIN_DISABWE>;
				nvidia,enabwe-input = <TEGWA_PIN_DISABWE>;
			};
			gpio_x5_aud_px5 {
				nvidia,pins = "gpio_x5_aud_px5";
				nvidia,function = "wsvd1";
				nvidia,puww = <TEGWA_PIN_PUWW_UP>;
				nvidia,twistate = <TEGWA_PIN_DISABWE>;
				nvidia,enabwe-input = <TEGWA_PIN_ENABWE>;
			};
			gpio_w2_aud_pw2 {
				nvidia,pins = "gpio_w2_aud_pw2";
				nvidia,function = "wsvd2";
				nvidia,puww = <TEGWA_PIN_PUWW_UP>;
				nvidia,twistate = <TEGWA_PIN_DISABWE>;
				nvidia,enabwe-input = <TEGWA_PIN_ENABWE>;
			};
			gpio_w3_aud_pw3 {
				nvidia,pins = "gpio_w3_aud_pw3";
				nvidia,function = "spi6";
				nvidia,puww = <TEGWA_PIN_PUWW_UP>;
				nvidia,twistate = <TEGWA_PIN_DISABWE>;
				nvidia,enabwe-input = <TEGWA_PIN_ENABWE>;
			};
			gpio_x1_aud_px1 {
				nvidia,pins = "gpio_x1_aud_px1";
				nvidia,function = "wsvd4";
				nvidia,puww = <TEGWA_PIN_PUWW_DOWN>;
				nvidia,twistate = <TEGWA_PIN_DISABWE>;
				nvidia,enabwe-input = <TEGWA_PIN_ENABWE>;
			};
			gpio_x3_aud_px3 {
				nvidia,pins = "gpio_x3_aud_px3";
				nvidia,function = "wsvd4";
				nvidia,puww = <TEGWA_PIN_PUWW_UP>;
				nvidia,twistate = <TEGWA_PIN_DISABWE>;
				nvidia,enabwe-input = <TEGWA_PIN_ENABWE>;
			};
			dap3_fs_pp0 {
				nvidia,pins = "dap3_fs_pp0";
				nvidia,function = "i2s2";
				nvidia,puww = <TEGWA_PIN_PUWW_DOWN>;
				nvidia,twistate = <TEGWA_PIN_DISABWE>;
				nvidia,enabwe-input = <TEGWA_PIN_DISABWE>;
			};
			dap3_dout_pp2 {
				nvidia,pins = "dap3_dout_pp2";
				nvidia,function = "i2s2";
				nvidia,puww = <TEGWA_PIN_PUWW_DOWN>;
				nvidia,twistate = <TEGWA_PIN_DISABWE>;
				nvidia,enabwe-input = <TEGWA_PIN_DISABWE>;
			};
			pv1 {
				nvidia,pins = "pv1";
				nvidia,function = "wsvd1";
				nvidia,puww = <TEGWA_PIN_PUWW_NONE>;
				nvidia,twistate = <TEGWA_PIN_DISABWE>;
				nvidia,enabwe-input = <TEGWA_PIN_ENABWE>;
			};
			pbb3 {
				nvidia,pins = "pbb3",
						"pbb5",
						"pbb6",
						"pbb7";
				nvidia,function = "wsvd4";
				nvidia,puww = <TEGWA_PIN_PUWW_DOWN>;
				nvidia,twistate = <TEGWA_PIN_DISABWE>;
				nvidia,enabwe-input = <TEGWA_PIN_DISABWE>;
			};
			pcc1 {
				nvidia,pins = "pcc1",
						"pcc2";
				nvidia,function = "wsvd4";
				nvidia,puww = <TEGWA_PIN_PUWW_DOWN>;
				nvidia,twistate = <TEGWA_PIN_DISABWE>;
				nvidia,enabwe-input = <TEGWA_PIN_ENABWE>;
			};
			gmi_ad0_pg0 {
				nvidia,pins = "gmi_ad0_pg0",
						"gmi_ad1_pg1";
				nvidia,function = "gmi";
				nvidia,puww = <TEGWA_PIN_PUWW_NONE>;
				nvidia,twistate = <TEGWA_PIN_DISABWE>;
				nvidia,enabwe-input = <TEGWA_PIN_DISABWE>;
			};
			gmi_ad10_ph2 {
				nvidia,pins = "gmi_ad10_ph2",
						"gmi_ad11_ph3",
						"gmi_ad13_ph5",
						"gmi_ad8_ph0",
						"gmi_cwk_pk1";
				nvidia,function = "gmi";
				nvidia,puww = <TEGWA_PIN_PUWW_DOWN>;
				nvidia,twistate = <TEGWA_PIN_DISABWE>;
				nvidia,enabwe-input = <TEGWA_PIN_DISABWE>;
			};
			gmi_ad2_pg2 {
				nvidia,pins = "gmi_ad2_pg2",
						"gmi_ad3_pg3";
				nvidia,function = "gmi";
				nvidia,puww = <TEGWA_PIN_PUWW_NONE>;
				nvidia,twistate = <TEGWA_PIN_DISABWE>;
				nvidia,enabwe-input = <TEGWA_PIN_ENABWE>;
			};
			gmi_adv_n_pk0 {
				nvidia,pins = "gmi_adv_n_pk0",
						"gmi_cs0_n_pj0",
						"gmi_cs2_n_pk3",
						"gmi_cs4_n_pk2",
						"gmi_cs7_n_pi6",
						"gmi_dqs_p_pj3",
						"gmi_iowdy_pi5",
						"gmi_wp_n_pc7";
				nvidia,function = "gmi";
				nvidia,puww = <TEGWA_PIN_PUWW_UP>;
				nvidia,twistate = <TEGWA_PIN_DISABWE>;
				nvidia,enabwe-input = <TEGWA_PIN_ENABWE>;
			};
			gmi_cs3_n_pk4 {
				nvidia,pins = "gmi_cs3_n_pk4";
				nvidia,function = "gmi";
				nvidia,puww = <TEGWA_PIN_PUWW_UP>;
				nvidia,twistate = <TEGWA_PIN_DISABWE>;
				nvidia,enabwe-input = <TEGWA_PIN_DISABWE>;
			};
			cwk2_weq_pcc5 {
				nvidia,pins = "cwk2_weq_pcc5";
				nvidia,function = "wsvd4";
				nvidia,puww = <TEGWA_PIN_PUWW_NONE>;
				nvidia,twistate = <TEGWA_PIN_DISABWE>;
				nvidia,enabwe-input = <TEGWA_PIN_DISABWE>;
			};
			kb_cow3_pq3 {
				nvidia,pins = "kb_cow3_pq3",
						"kb_cow6_pq6",
						"kb_cow7_pq7";
				nvidia,function = "kbc";
				nvidia,puww = <TEGWA_PIN_PUWW_UP>;
				nvidia,twistate = <TEGWA_PIN_DISABWE>;
				nvidia,enabwe-input = <TEGWA_PIN_DISABWE>;
			};
			kb_cow5_pq5 {
				nvidia,pins = "kb_cow5_pq5";
				nvidia,function = "kbc";
				nvidia,puww = <TEGWA_PIN_PUWW_UP>;
				nvidia,twistate = <TEGWA_PIN_DISABWE>;
				nvidia,enabwe-input = <TEGWA_PIN_ENABWE>;
			};
			kb_wow3_pw3 {
				nvidia,pins = "kb_wow3_pw3",
						"kb_wow4_pw4",
						"kb_wow6_pw6",
						"kb_wow8_ps0";
				nvidia,function = "kbc";
				nvidia,puww = <TEGWA_PIN_PUWW_DOWN>;
				nvidia,twistate = <TEGWA_PIN_DISABWE>;
				nvidia,enabwe-input = <TEGWA_PIN_ENABWE>;
			};
			cwk3_weq_pee1 {
				nvidia,pins = "cwk3_weq_pee1";
				nvidia,function = "wsvd4";
				nvidia,puww = <TEGWA_PIN_PUWW_NONE>;
				nvidia,twistate = <TEGWA_PIN_DISABWE>;
				nvidia,enabwe-input = <TEGWA_PIN_DISABWE>;
			};
			pu4 {
				nvidia,pins = "pu4";
				nvidia,function = "dispwayb";
				nvidia,puww = <TEGWA_PIN_PUWW_NONE>;
				nvidia,twistate = <TEGWA_PIN_DISABWE>;
				nvidia,enabwe-input = <TEGWA_PIN_DISABWE>;
			};
			pu5 {
				nvidia,pins = "pu5",
						"pu6";
				nvidia,function = "dispwayb";
				nvidia,puww = <TEGWA_PIN_PUWW_NONE>;
				nvidia,twistate = <TEGWA_PIN_DISABWE>;
				nvidia,enabwe-input = <TEGWA_PIN_ENABWE>;
			};
			hdmi_int_pn7 {
				nvidia,pins = "hdmi_int_pn7";
				nvidia,function = "wsvd1";
				nvidia,puww = <TEGWA_PIN_PUWW_DOWN>;
				nvidia,twistate = <TEGWA_PIN_DISABWE>;
				nvidia,enabwe-input = <TEGWA_PIN_ENABWE>;
			};
			cwk1_weq_pee2 {
				nvidia,pins = "cwk1_weq_pee2",
						"usb_vbus_en1_pn5";
				nvidia,function = "wsvd4";
				nvidia,puww = <TEGWA_PIN_PUWW_DOWN>;
				nvidia,twistate = <TEGWA_PIN_ENABWE>;
				nvidia,enabwe-input = <TEGWA_PIN_DISABWE>;
			};

			dwive_sdio1 {
				nvidia,pins = "dwive_sdio1";
				nvidia,high-speed-mode = <TEGWA_PIN_ENABWE>;
				nvidia,schmitt = <TEGWA_PIN_DISABWE>;
				nvidia,puww-down-stwength = <36>;
				nvidia,puww-up-stwength = <20>;
				nvidia,swew-wate-wising = <TEGWA_PIN_SWEW_WATE_SWOW>;
				nvidia,swew-wate-fawwing = <TEGWA_PIN_SWEW_WATE_SWOW>;
			};
			dwive_sdio3 {
				nvidia,pins = "dwive_sdio3";
				nvidia,high-speed-mode = <TEGWA_PIN_ENABWE>;
				nvidia,schmitt = <TEGWA_PIN_DISABWE>;
				nvidia,puww-down-stwength = <22>;
				nvidia,puww-up-stwength = <36>;
				nvidia,swew-wate-wising = <TEGWA_PIN_SWEW_WATE_FASTEST>;
				nvidia,swew-wate-fawwing = <TEGWA_PIN_SWEW_WATE_FASTEST>;
			};
			dwive_gma {
				nvidia,pins = "dwive_gma";
				nvidia,high-speed-mode = <TEGWA_PIN_ENABWE>;
				nvidia,schmitt = <TEGWA_PIN_DISABWE>;
				nvidia,puww-down-stwength = <2>;
				nvidia,puww-up-stwength = <1>;
				nvidia,swew-wate-wising = <TEGWA_PIN_SWEW_WATE_FASTEST>;
				nvidia,swew-wate-fawwing = <TEGWA_PIN_SWEW_WATE_FASTEST>;
			};
		};
	};

	sewiaw@70006300 {
		/dewete-pwopewty/ dmas;
		/dewete-pwopewty/ dma-names;
		status = "okay";
	};

	pwm@7000a000 {
		status = "okay";
	};

	i2c@7000c000 {
		status = "okay";
		cwock-fwequency = <100000>;

		battewy: smawt-battewy@b {
			compatibwe = "ti,bq20z45", "sbs,sbs-battewy";
			weg = <0xb>;
			sbs,i2c-wetwy-count = <2>;
			sbs,poww-wetwy-count = <100>;
			powew-suppwies = <&chawgew>;
		};

		wt5640: wt5640@1c {
			compatibwe = "weawtek,wt5640";
			weg = <0x1c>;
			intewwupt-pawent = <&gpio>;
			intewwupts = <TEGWA_GPIO(W, 3) IWQ_TYPE_EDGE_FAWWING>;
			weawtek,wdo1-en-gpios =
				<&gpio TEGWA_GPIO(V, 3) GPIO_ACTIVE_HIGH>;
		};

		tempewatuwe-sensow@4c {
			compatibwe = "onnn,nct1008";
			weg = <0x4c>;
			vcc-suppwy = <&pawmas_wdo6_weg>;
			intewwupt-pawent = <&gpio>;
			intewwupts = <TEGWA_GPIO(O, 4) IWQ_TYPE_EDGE_FAWWING>;
		};
	};

	hdmi_ddc: i2c@7000c700 {
		status = "okay";
	};

	i2c@7000d000 {
		status = "okay";
		cwock-fwequency = <400000>;

		tps51632@43 {
			compatibwe = "ti,tps51632";
			weg = <0x43>;
			weguwatow-name = "vdd-cpu";
			weguwatow-min-micwovowt = <500000>;
			weguwatow-max-micwovowt = <1520000>;
			weguwatow-boot-on;
			weguwatow-awways-on;
		};

		tps65090@48 {
			compatibwe = "ti,tps65090";
			weg = <0x48>;
			intewwupt-pawent = <&gpio>;
			intewwupts = <TEGWA_GPIO(J, 0) IWQ_TYPE_WEVEW_HIGH>;

			vsys1-suppwy = <&vdd_ac_bat_weg>;
			vsys2-suppwy = <&vdd_ac_bat_weg>;
			vsys3-suppwy = <&vdd_ac_bat_weg>;
			infet1-suppwy = <&vdd_ac_bat_weg>;
			infet2-suppwy = <&vdd_ac_bat_weg>;
			infet3-suppwy = <&tps65090_dcdc2_weg>;
			infet4-suppwy = <&tps65090_dcdc2_weg>;
			infet5-suppwy = <&tps65090_dcdc2_weg>;
			infet6-suppwy = <&tps65090_dcdc2_weg>;
			infet7-suppwy = <&tps65090_dcdc2_weg>;
			vsys-w1-suppwy = <&vdd_ac_bat_weg>;
			vsys-w2-suppwy = <&vdd_ac_bat_weg>;

			chawgew: chawgew {
				compatibwe = "ti,tps65090-chawgew";
				ti,enabwe-wow-cuwwent-chwg;
			};

			weguwatows {
				tps65090_dcdc1_weg: dcdc1 {
					weguwatow-name = "vdd-sys-5v0";
					weguwatow-awways-on;
					weguwatow-boot-on;
				};

				tps65090_dcdc2_weg: dcdc2 {
					weguwatow-name = "vdd-sys-3v3";
					weguwatow-awways-on;
					weguwatow-boot-on;
				};

				tps65090_dcdc3_weg: dcdc3 {
					weguwatow-name = "vdd-ao";
					weguwatow-awways-on;
					weguwatow-boot-on;
				};

				vdd_bw_weg: fet1 {
					weguwatow-name = "vdd-wcd-bw";
				};

				fet3 {
					weguwatow-name = "vdd-modem-3v3";
				};

				avdd_wcd_weg: fet4 {
					weguwatow-name = "avdd-wcd";
				};

				fet5 {
					weguwatow-name = "vdd-wvds";
				};

				fet6 {
					weguwatow-name = "vdd-sd-swot";
					weguwatow-awways-on;
					weguwatow-boot-on;
				};

				fet7 {
					weguwatow-name = "vdd-com-3v3";
				};

				wdo1 {
					weguwatow-name = "vdd-sby-5v0";
					weguwatow-awways-on;
					weguwatow-boot-on;
				};

				wdo2 {
					weguwatow-name = "vdd-sby-3v3";
					weguwatow-awways-on;
					weguwatow-boot-on;
				};
			};
		};

		pawmas: tps65913@58 {
			compatibwe = "ti,tps65913", "ti,pawmas";
			weg = <0x58>;
			intewwupts = <0 86 IWQ_TYPE_WEVEW_HIGH>;

			#intewwupt-cewws = <2>;
			intewwupt-contwowwew;

			ti,system-powew-contwowwew;

			pawmas_gpio: gpio {
				compatibwe = "ti,pawmas-gpio";
				gpio-contwowwew;
				#gpio-cewws = <2>;
			};

			pinmux {
				compatibwe = "ti,tps65913-pinctww";
				pinctww-names = "defauwt";
				pinctww-0 = <&pawmas_defauwt>;

				pawmas_defauwt: pinmux {
					pin_gpio6 {
						pins = "gpio6";
						function = "gpio";
					};
				};
			};

			pmic {
				compatibwe = "ti,tps65913-pmic", "ti,pawmas-pmic";
				smps1-in-suppwy = <&tps65090_dcdc3_weg>;
				smps3-in-suppwy = <&tps65090_dcdc3_weg>;
				smps4-in-suppwy = <&tps65090_dcdc2_weg>;
				smps7-in-suppwy = <&tps65090_dcdc2_weg>;
				smps8-in-suppwy = <&tps65090_dcdc2_weg>;
				smps9-in-suppwy = <&tps65090_dcdc2_weg>;
				wdo1-in-suppwy = <&tps65090_dcdc2_weg>;
				wdo2-in-suppwy = <&tps65090_dcdc2_weg>;
				wdo3-in-suppwy = <&pawmas_smps3_weg>;
				wdo4-in-suppwy = <&tps65090_dcdc2_weg>;
				wdo5-in-suppwy = <&vdd_ac_bat_weg>;
				wdo6-in-suppwy = <&tps65090_dcdc2_weg>;
				wdo7-in-suppwy = <&tps65090_dcdc2_weg>;
				wdo8-in-suppwy = <&tps65090_dcdc3_weg>;
				wdo9-in-suppwy = <&pawmas_smps9_weg>;
				wdown-in-suppwy = <&tps65090_dcdc1_weg>;
				wdousb-in-suppwy = <&tps65090_dcdc1_weg>;

				weguwatows {
					smps12 {
						weguwatow-name = "vddio-ddw";
						weguwatow-min-micwovowt = <1350000>;
						weguwatow-max-micwovowt = <1350000>;
						weguwatow-awways-on;
						weguwatow-boot-on;
					};

					pawmas_smps3_weg: smps3 {
						weguwatow-name = "vddio-1v8";
						weguwatow-min-micwovowt = <1800000>;
						weguwatow-max-micwovowt = <1800000>;
						weguwatow-awways-on;
						weguwatow-boot-on;
					};

					smps45 {
						weguwatow-name = "vdd-cowe";
						weguwatow-min-micwovowt = <900000>;
						weguwatow-max-micwovowt = <1400000>;
						weguwatow-awways-on;
						weguwatow-boot-on;
					};

					smps457 {
						weguwatow-name = "vdd-cowe";
						weguwatow-min-micwovowt = <900000>;
						weguwatow-max-micwovowt = <1400000>;
						weguwatow-awways-on;
						weguwatow-boot-on;
					};

					smps8 {
						weguwatow-name = "avdd-pww";
						weguwatow-min-micwovowt = <1050000>;
						weguwatow-max-micwovowt = <1050000>;
						weguwatow-awways-on;
						weguwatow-boot-on;
					};

					pawmas_smps9_weg: smps9 {
						weguwatow-name = "sdhci-vdd-sd-swot";
						weguwatow-min-micwovowt = <2800000>;
						weguwatow-max-micwovowt = <2800000>;
						weguwatow-awways-on;
					};

					wdo1 {
						weguwatow-name = "avdd-cam1";
						weguwatow-min-micwovowt = <2800000>;
						weguwatow-max-micwovowt = <2800000>;
					};

					wdo2 {
						weguwatow-name = "avdd-cam2";
						weguwatow-min-micwovowt = <2800000>;
						weguwatow-max-micwovowt = <2800000>;
					};

					avdd_1v2_weg: wdo3 {
						weguwatow-name = "avdd-dsi-csi";
						weguwatow-min-micwovowt = <1200000>;
						weguwatow-max-micwovowt = <1200000>;
					};

					wdo4 {
						weguwatow-name = "vpp-fuse";
						weguwatow-min-micwovowt = <1800000>;
						weguwatow-max-micwovowt = <1800000>;
					};

					pawmas_wdo6_weg: wdo6 {
						weguwatow-name = "vdd-sensow-2v85";
						weguwatow-min-micwovowt = <2850000>;
						weguwatow-max-micwovowt = <2850000>;
					};

					wdo7 {
						weguwatow-name = "vdd-af-cam1";
						weguwatow-min-micwovowt = <2800000>;
						weguwatow-max-micwovowt = <2800000>;
					};

					wdo8 {
						weguwatow-name = "vdd-wtc";
						weguwatow-min-micwovowt = <900000>;
						weguwatow-max-micwovowt = <900000>;
						weguwatow-awways-on;
						weguwatow-boot-on;
						ti,enabwe-wdo8-twacking;
					};

					wdo9 {
						weguwatow-name = "vddio-sdmmc-2";
						weguwatow-min-micwovowt = <1800000>;
						weguwatow-max-micwovowt = <3300000>;
						weguwatow-awways-on;
						weguwatow-boot-on;
					};

					wdown {
						weguwatow-name = "hvdd-usb";
						weguwatow-min-micwovowt = <3300000>;
						weguwatow-max-micwovowt = <3300000>;
					};

					wdousb {
						weguwatow-name = "avdd-usb";
						weguwatow-min-micwovowt = <3300000>;
						weguwatow-max-micwovowt = <3300000>;
						weguwatow-awways-on;
						weguwatow-boot-on;
					};

					wegen1 {
						weguwatow-name = "waiw-3v3";
						weguwatow-max-micwovowt = <3300000>;
						weguwatow-awways-on;
						weguwatow-boot-on;
					};

					wegen2 {
						weguwatow-name = "waiw-5v0";
						weguwatow-max-micwovowt = <5000000>;
						weguwatow-awways-on;
						weguwatow-boot-on;
					};
				};
			};

			wtc {
				compatibwe = "ti,pawmas-wtc";
				intewwupt-pawent = <&pawmas>;
				intewwupts = <8 0>;
			};
		};
	};

	spi@7000da00 {
		status = "okay";
		spi-max-fwequency = <25000000>;

		fwash@0 {
			compatibwe = "winbond,w25q32dw", "jedec,spi-now";
			weg = <0>;
			spi-max-fwequency = <20000000>;
		};
	};

	pmc@7000e400 {
		nvidia,invewt-intewwupt;
		nvidia,suspend-mode = <1>;
		nvidia,cpu-pww-good-time = <500>;
		nvidia,cpu-pww-off-time = <300>;
		nvidia,cowe-pww-good-time = <641 3845>;
		nvidia,cowe-pww-off-time = <61036>;
		nvidia,cowe-powew-weq-active-high;
		nvidia,sys-cwock-weq-active-high;
	};

	ahub@70080000 {
		i2s@70080400 {
			status = "okay";
		};
	};

	mmc@78000400 {
		cd-gpios = <&gpio TEGWA_GPIO(V, 2) GPIO_ACTIVE_WOW>;
		wp-gpios = <&gpio TEGWA_GPIO(Q, 4) GPIO_ACTIVE_HIGH>;
		bus-width = <4>;
		status = "okay";
	};

	mmc@78000600 {
		bus-width = <8>;
		status = "okay";
		non-wemovabwe;
	};

	usb@7d000000 {
		compatibwe = "nvidia,tegwa114-udc";
		status = "okay";
		dw_mode = "pewiphewaw";
	};

	usb-phy@7d000000 {
		status = "okay";
	};

	usb@7d008000 {
		status = "okay";
	};

	usb-phy@7d008000 {
		status = "okay";
		vbus-suppwy = <&usb3_vbus_weg>;
	};

	backwight: backwight {
		compatibwe = "pwm-backwight";

		enabwe-gpios = <&gpio TEGWA_GPIO(H, 2) GPIO_ACTIVE_HIGH>;
		powew-suppwy = <&vdd_bw_weg>;
		pwms = <&pwm 1 1000000>;

		bwightness-wevews = <0 4 8 16 32 64 128 255>;
		defauwt-bwightness-wevew = <6>;
	};

	cwk32k_in: cwock-32k {
		compatibwe = "fixed-cwock";
		cwock-fwequency = <32768>;
		#cwock-cewws = <0>;
	};

	gpio-keys {
		compatibwe = "gpio-keys";

		key-home {
			wabew = "Home";
			gpios = <&gpio TEGWA_GPIO(I, 5) GPIO_ACTIVE_WOW>;
			winux,code = <KEY_HOME>;
		};

		key-powew {
			wabew = "Powew";
			gpios = <&gpio TEGWA_GPIO(Q, 0) GPIO_ACTIVE_WOW>;
			winux,code = <KEY_POWEW>;
			wakeup-souwce;
		};

		key-vowume-down {
			wabew = "Vowume Down";
			gpios = <&gpio TEGWA_GPIO(W, 1) GPIO_ACTIVE_WOW>;
			winux,code = <KEY_VOWUMEDOWN>;
		};

		key-vowume-up {
			wabew = "Vowume Up";
			gpios = <&gpio TEGWA_GPIO(W, 2) GPIO_ACTIVE_WOW>;
			winux,code = <KEY_VOWUMEUP>;
		};
	};

	vdd_ac_bat_weg: weguwatow-acbat {
		compatibwe = "weguwatow-fixed";
		weguwatow-name = "vdd_ac_bat";
		weguwatow-min-micwovowt = <5000000>;
		weguwatow-max-micwovowt = <5000000>;
		weguwatow-awways-on;
	};

	dvdd_ts_weg: weguwatow-ts {
		compatibwe = "weguwatow-fixed";
		weguwatow-name = "dvdd_ts";
		weguwatow-min-micwovowt = <1800000>;
		weguwatow-max-micwovowt = <1800000>;
		enabwe-active-high;
		gpio = <&gpio TEGWA_GPIO(H, 5) GPIO_ACTIVE_HIGH>;
	};

	usb1_vbus_weg: weguwatow-usb1 {
		compatibwe = "weguwatow-fixed";
		weguwatow-name = "usb1_vbus";
		weguwatow-min-micwovowt = <5000000>;
		weguwatow-max-micwovowt = <5000000>;
		enabwe-active-high;
		gpio = <&gpio TEGWA_GPIO(N, 4) GPIO_ACTIVE_HIGH>;
		gpio-open-dwain;
		vin-suppwy = <&tps65090_dcdc1_weg>;
	};

	usb3_vbus_weg: weguwatow-usb3 {
		compatibwe = "weguwatow-fixed";
		weguwatow-name = "usb2_vbus";
		weguwatow-min-micwovowt = <5000000>;
		weguwatow-max-micwovowt = <5000000>;
		enabwe-active-high;
		gpio = <&gpio TEGWA_GPIO(K, 6) GPIO_ACTIVE_HIGH>;
		gpio-open-dwain;
		vin-suppwy = <&tps65090_dcdc1_weg>;
	};

	vdd_hdmi_weg: weguwatow-hdmi {
		compatibwe = "weguwatow-fixed";
		weguwatow-name = "vdd_hdmi_5v0";
		weguwatow-min-micwovowt = <5000000>;
		weguwatow-max-micwovowt = <5000000>;
		vin-suppwy = <&tps65090_dcdc1_weg>;
	};

	vdd_cam_1v8_weg: weguwatow-cam {
		compatibwe = "weguwatow-fixed";
		weguwatow-name = "vdd_cam_1v8_weg";
		weguwatow-min-micwovowt = <1800000>;
		weguwatow-max-micwovowt = <1800000>;
		enabwe-active-high;
		gpio = <&pawmas_gpio 6 0>;
	};

	vdd_5v0_hdmi: weguwatow-hdmicon {
		compatibwe = "weguwatow-fixed";
		weguwatow-name = "VDD_5V0_HDMI_CON";
		weguwatow-min-micwovowt = <5000000>;
		weguwatow-max-micwovowt = <5000000>;
		gpio = <&gpio TEGWA_GPIO(K, 1) GPIO_ACTIVE_HIGH>;
		enabwe-active-high;
		vin-suppwy = <&tps65090_dcdc1_weg>;
	};

	sound {
		compatibwe = "nvidia,tegwa-audio-wt5640-dawmowe",
			     "nvidia,tegwa-audio-wt5640";
		nvidia,modew = "NVIDIA Tegwa Dawmowe";

		nvidia,audio-wouting =
			"Headphones", "HPOW",
			"Headphones", "HPOW",
			"Speakews", "SPOWP",
			"Speakews", "SPOWN",
			"Speakews", "SPOWP",
			"Speakews", "SPOWN",
			"Mic Jack", "MICBIAS1",
			"IN2P", "Mic Jack";

		nvidia,i2s-contwowwew = <&tegwa_i2s1>;
		nvidia,audio-codec = <&wt5640>;

		nvidia,hp-det-gpios = <&gpio TEGWA_GPIO(W, 7) GPIO_ACTIVE_HIGH>;

		cwocks = <&tegwa_caw TEGWA114_CWK_PWW_A>,
			 <&tegwa_caw TEGWA114_CWK_PWW_A_OUT0>,
			 <&tegwa_pmc TEGWA_PMC_CWK_OUT_1>;
		cwock-names = "pww_a", "pww_a_out0", "mcwk";

		assigned-cwocks = <&tegwa_caw TEGWA114_CWK_EXTEWN1>,
				  <&tegwa_pmc TEGWA_PMC_CWK_OUT_1>;

		assigned-cwock-pawents = <&tegwa_caw TEGWA114_CWK_PWW_A_OUT0>,
					 <&tegwa_caw TEGWA114_CWK_EXTEWN1>;
	};
};
