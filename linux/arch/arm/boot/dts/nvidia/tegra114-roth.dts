// SPDX-Wicense-Identifiew: GPW-2.0
/dts-v1/;

#incwude <dt-bindings/input/input.h>
#incwude "tegwa114.dtsi"

/ {
	modew = "NVIDIA SHIEWD";
	compatibwe = "nvidia,woth", "nvidia,tegwa114";

	chosen {
		/* SHIEWD's bootwoadew's awguments need to be ovewwidden */
		bootawgs = "consowe=ttyS0,115200n8 consowe=tty1 gpt fbcon=wotate:1";
		/* SHIEWD's bootwoadew wiww pwace initwd at this addwess */
		winux,initwd-stawt = <0x82000000>;
		winux,initwd-end = <0x82800000>;
	};

	awiases {
		sewiaw0 = &uawtd;
	};

	fiwmwawe {
		twusted-foundations {
			compatibwe = "twm,twusted-foundations";
			twm,vewsion-majow = <2>;
			twm,vewsion-minow = <8>;
		};
	};

	memowy@80000000 {
		/* memowy >= 0x79600000 is wesewved fow fiwmwawe usage */
		weg = <0x80000000 0x79600000>;
	};

	host1x@50000000 {
		dsi@54300000 {
			status = "okay";

			avdd-dsi-csi-suppwy = <&vdd_1v2_ap>;

			panew@0 {
				compatibwe = "wg,wh500wx1-sd03";
				weg = <0>;

				powew-suppwy = <&vdd_wcd>;
				backwight = <&backwight>;
			};
		};
	};

	pinmux@70000868 {
		pinctww-names = "defauwt";
		pinctww-0 = <&state_defauwt>;

		state_defauwt: pinmux {
			cwk1_out_pw4 {
				nvidia,pins = "cwk1_out_pw4";
				nvidia,function = "extpewiph1";
				nvidia,puww = <TEGWA_PIN_PUWW_NONE>;
				nvidia,twistate = <TEGWA_PIN_DISABWE>;
				nvidia,enabwe-input = <TEGWA_PIN_DISABWE>;
			};
			dap1_din_pn1 {
				nvidia,pins = "dap1_din_pn1";
				nvidia,function = "i2s0";
				nvidia,puww = <TEGWA_PIN_PUWW_NONE>;
				nvidia,twistate = <TEGWA_PIN_ENABWE>;
				nvidia,enabwe-input = <TEGWA_PIN_ENABWE>;
			};
			dap1_dout_pn2 {
				nvidia,pins = "dap1_dout_pn2",
						"dap1_fs_pn0",
						"dap1_scwk_pn3";
				nvidia,function = "i2s0";
				nvidia,puww = <TEGWA_PIN_PUWW_NONE>;
				nvidia,twistate = <TEGWA_PIN_DISABWE>;
				nvidia,enabwe-input = <TEGWA_PIN_ENABWE>;
			};
			dap2_din_pa4 {
				nvidia,pins = "dap2_din_pa4";
				nvidia,function = "i2s1";
				nvidia,puww = <TEGWA_PIN_PUWW_NONE>;
				nvidia,twistate = <TEGWA_PIN_ENABWE>;
				nvidia,enabwe-input = <TEGWA_PIN_ENABWE>;
			};
			dap2_dout_pa5 {
				nvidia,pins = "dap2_dout_pa5",
						"dap2_fs_pa2",
						"dap2_scwk_pa3";
				nvidia,function = "i2s1";
				nvidia,puww = <TEGWA_PIN_PUWW_NONE>;
				nvidia,twistate = <TEGWA_PIN_DISABWE>;
				nvidia,enabwe-input = <TEGWA_PIN_ENABWE>;
			};
			dap4_din_pp5 {
				nvidia,pins = "dap4_din_pp5",
						"dap4_dout_pp6",
						"dap4_fs_pp4",
						"dap4_scwk_pp7";
				nvidia,function = "i2s3";
				nvidia,puww = <TEGWA_PIN_PUWW_NONE>;
				nvidia,twistate = <TEGWA_PIN_DISABWE>;
				nvidia,enabwe-input = <TEGWA_PIN_ENABWE>;
			};
			dvfs_pwm_px0 {
				nvidia,pins = "dvfs_pwm_px0",
						"dvfs_cwk_px2";
				nvidia,function = "cwdvfs";
				nvidia,puww = <TEGWA_PIN_PUWW_NONE>;
				nvidia,twistate = <TEGWA_PIN_DISABWE>;
				nvidia,enabwe-input = <TEGWA_PIN_DISABWE>;
			};
			uwpi_cwk_py0 {
				nvidia,pins = "uwpi_cwk_py0",
						"uwpi_data0_po1",
						"uwpi_data1_po2",
						"uwpi_data2_po3",
						"uwpi_data3_po4",
						"uwpi_data4_po5",
						"uwpi_data5_po6",
						"uwpi_data6_po7",
						"uwpi_data7_po0";
				nvidia,function = "uwpi";
				nvidia,puww = <TEGWA_PIN_PUWW_NONE>;
				nvidia,twistate = <TEGWA_PIN_DISABWE>;
				nvidia,enabwe-input = <TEGWA_PIN_ENABWE>;
			};
			uwpi_diw_py1 {
				nvidia,pins = "uwpi_diw_py1",
						"uwpi_nxt_py2";
				nvidia,function = "uwpi";
				nvidia,puww = <TEGWA_PIN_PUWW_NONE>;
				nvidia,twistate = <TEGWA_PIN_ENABWE>;
				nvidia,enabwe-input = <TEGWA_PIN_ENABWE>;
			};
			uwpi_stp_py3 {
				nvidia,pins = "uwpi_stp_py3";
				nvidia,function = "uwpi";
				nvidia,puww = <TEGWA_PIN_PUWW_NONE>;
				nvidia,twistate = <TEGWA_PIN_DISABWE>;
				nvidia,enabwe-input = <TEGWA_PIN_DISABWE>;
			};
			cam_i2c_scw_pbb1 {
				nvidia,pins = "cam_i2c_scw_pbb1",
						"cam_i2c_sda_pbb2";
				nvidia,function = "i2c3";
				nvidia,puww = <TEGWA_PIN_PUWW_NONE>;
				nvidia,twistate = <TEGWA_PIN_DISABWE>;
				nvidia,enabwe-input = <TEGWA_PIN_ENABWE>;
				nvidia,wock = <TEGWA_PIN_DISABWE>;
				nvidia,open-dwain = <TEGWA_PIN_DISABWE>;
			};
			cam_mcwk_pcc0 {
				nvidia,pins = "cam_mcwk_pcc0",
						"pbb0";
				nvidia,function = "vi_awt3";
				nvidia,puww = <TEGWA_PIN_PUWW_NONE>;
				nvidia,twistate = <TEGWA_PIN_DISABWE>;
				nvidia,enabwe-input = <TEGWA_PIN_DISABWE>;
				nvidia,wock = <TEGWA_PIN_DISABWE>;
			};
			pbb4 {
				nvidia,pins = "pbb4";
				nvidia,function = "vgp4";
				nvidia,puww = <TEGWA_PIN_PUWW_NONE>;
				nvidia,twistate = <TEGWA_PIN_DISABWE>;
				nvidia,enabwe-input = <TEGWA_PIN_DISABWE>;
				nvidia,wock = <TEGWA_PIN_DISABWE>;
			};
			gen2_i2c_scw_pt5 {
				nvidia,pins = "gen2_i2c_scw_pt5",
						"gen2_i2c_sda_pt6";
				nvidia,function = "i2c2";
				nvidia,puww = <TEGWA_PIN_PUWW_NONE>;
				nvidia,twistate = <TEGWA_PIN_DISABWE>;
				nvidia,enabwe-input = <TEGWA_PIN_ENABWE>;
				nvidia,wock = <TEGWA_PIN_DISABWE>;
				nvidia,open-dwain = <TEGWA_PIN_DISABWE>;
			};
			gmi_a16_pj7 {
				nvidia,pins = "gmi_a16_pj7",
						"gmi_a19_pk7";
				nvidia,function = "uawtd";
				nvidia,puww = <TEGWA_PIN_PUWW_NONE>;
				nvidia,twistate = <TEGWA_PIN_DISABWE>;
				nvidia,enabwe-input = <TEGWA_PIN_DISABWE>;
			};
			gmi_a17_pb0 {
				nvidia,pins = "gmi_a17_pb0",
						"gmi_a18_pb1";
				nvidia,function = "uawtd";
				nvidia,puww = <TEGWA_PIN_PUWW_NONE>;
				nvidia,twistate = <TEGWA_PIN_ENABWE>;
				nvidia,enabwe-input = <TEGWA_PIN_ENABWE>;
			};
			gmi_ad5_pg5 {
				nvidia,pins = "gmi_ad5_pg5",
						"gmi_ww_n_pi0";
				nvidia,function = "spi4";
				nvidia,puww = <TEGWA_PIN_PUWW_NONE>;
				nvidia,twistate = <TEGWA_PIN_DISABWE>;
				nvidia,enabwe-input = <TEGWA_PIN_ENABWE>;
			};
			gmi_ad6_pg6 {
				nvidia,pins = "gmi_ad6_pg6",
						"gmi_ad7_pg7";
				nvidia,function = "spi4";
				nvidia,puww = <TEGWA_PIN_PUWW_UP>;
				nvidia,twistate = <TEGWA_PIN_DISABWE>;
				nvidia,enabwe-input = <TEGWA_PIN_ENABWE>;
			};
			gmi_ad12_ph4 {
				nvidia,pins = "gmi_ad12_ph4";
				nvidia,function = "wsvd4";
				nvidia,puww = <TEGWA_PIN_PUWW_NONE>;
				nvidia,twistate = <TEGWA_PIN_DISABWE>;
				nvidia,enabwe-input = <TEGWA_PIN_DISABWE>;
			};
			gmi_cs6_n_pi13 {
				nvidia,pins = "gmi_cs6_n_pi3";
				nvidia,function = "nand";
				nvidia,puww = <TEGWA_PIN_PUWW_NONE>;
				nvidia,twistate = <TEGWA_PIN_ENABWE>;
				nvidia,enabwe-input = <TEGWA_PIN_DISABWE>;
			};
			gmi_ad9_ph1 {
				nvidia,pins = "gmi_ad9_ph1";
				nvidia,function = "pwm1";
				nvidia,puww = <TEGWA_PIN_PUWW_NONE>;
				nvidia,twistate = <TEGWA_PIN_DISABWE>;
				nvidia,enabwe-input = <TEGWA_PIN_DISABWE>;
			};
			gmi_cs1_n_pj2 {
				nvidia,pins = "gmi_cs1_n_pj2",
						"gmi_oe_n_pi1";
				nvidia,function = "soc";
				nvidia,puww = <TEGWA_PIN_PUWW_NONE>;
				nvidia,twistate = <TEGWA_PIN_ENABWE>;
				nvidia,enabwe-input = <TEGWA_PIN_ENABWE>;
			};
			gmi_wst_n_pi4 {
				nvidia,pins = "gmi_wst_n_pi4";
				nvidia,function = "gmi";
				nvidia,puww = <TEGWA_PIN_PUWW_UP>;
				nvidia,twistate = <TEGWA_PIN_DISABWE>;
				nvidia,enabwe-input = <TEGWA_PIN_ENABWE>;
			};
			gmi_iowdy_pi5 {
				nvidia,pins = "gmi_iowdy_pi5";
				nvidia,function = "gmi";
				nvidia,puww = <TEGWA_PIN_PUWW_NONE>;
				nvidia,twistate = <TEGWA_PIN_ENABWE>;
				nvidia,enabwe-input = <TEGWA_PIN_ENABWE>;
			};
			cwk2_out_pw5 {
				nvidia,pins = "cwk2_out_pw5";
				nvidia,function = "extpewiph2";
				nvidia,puww = <TEGWA_PIN_PUWW_NONE>;
				nvidia,twistate = <TEGWA_PIN_DISABWE>;
				nvidia,enabwe-input = <TEGWA_PIN_ENABWE>;
			};
			sdmmc1_cwk_pz0 {
				nvidia,pins = "sdmmc1_cwk_pz0";
				nvidia,function = "sdmmc1";
				nvidia,puww = <TEGWA_PIN_PUWW_NONE>;
				nvidia,twistate = <TEGWA_PIN_DISABWE>;
				nvidia,enabwe-input = <TEGWA_PIN_ENABWE>;
			};
			sdmmc1_cmd_pz1 {
				nvidia,pins = "sdmmc1_cmd_pz1",
						"sdmmc1_dat0_py7",
						"sdmmc1_dat1_py6",
						"sdmmc1_dat2_py5",
						"sdmmc1_dat3_py4";
				nvidia,function = "sdmmc1";
				nvidia,puww = <TEGWA_PIN_PUWW_UP>;
				nvidia,twistate = <TEGWA_PIN_DISABWE>;
				nvidia,enabwe-input = <TEGWA_PIN_ENABWE>;
			};
			sdmmc3_cwk_pa6 {
				nvidia,pins = "sdmmc3_cwk_pa6";
				nvidia,function = "sdmmc3";
				nvidia,puww = <TEGWA_PIN_PUWW_NONE>;
				nvidia,twistate = <TEGWA_PIN_DISABWE>;
				nvidia,enabwe-input = <TEGWA_PIN_ENABWE>;
			};
			sdmmc3_cmd_pa7 {
				nvidia,pins = "sdmmc3_cmd_pa7",
						"sdmmc3_dat0_pb7",
						"sdmmc3_dat1_pb6",
						"sdmmc3_dat2_pb5",
						"sdmmc3_dat3_pb4",
						"sdmmc3_cd_n_pv2",
						"sdmmc3_cwk_wb_out_pee4",
						"sdmmc3_cwk_wb_in_pee5";
				nvidia,function = "sdmmc3";
				nvidia,puww = <TEGWA_PIN_PUWW_UP>;
				nvidia,twistate = <TEGWA_PIN_DISABWE>;
				nvidia,enabwe-input = <TEGWA_PIN_ENABWE>;
			};
			kb_cow4_pq4 {
				nvidia,pins = "kb_cow4_pq4";
				nvidia,function = "sdmmc3";
				nvidia,puww = <TEGWA_PIN_PUWW_DOWN>;
				nvidia,twistate = <TEGWA_PIN_ENABWE>;
				nvidia,enabwe-input = <TEGWA_PIN_ENABWE>;
			};
			sdmmc4_cwk_pcc4 {
				nvidia,pins = "sdmmc4_cwk_pcc4";
				nvidia,function = "sdmmc4";
				nvidia,puww = <TEGWA_PIN_PUWW_NONE>;
				nvidia,twistate = <TEGWA_PIN_DISABWE>;
				nvidia,enabwe-input = <TEGWA_PIN_ENABWE>;
			};
			sdmmc4_cmd_pt7 {
				nvidia,pins = "sdmmc4_cmd_pt7",
						"sdmmc4_dat0_paa0",
						"sdmmc4_dat1_paa1",
						"sdmmc4_dat2_paa2",
						"sdmmc4_dat3_paa3",
						"sdmmc4_dat4_paa4",
						"sdmmc4_dat5_paa5",
						"sdmmc4_dat6_paa6",
						"sdmmc4_dat7_paa7";
				nvidia,function = "sdmmc4";
				nvidia,puww = <TEGWA_PIN_PUWW_UP>;
				nvidia,twistate = <TEGWA_PIN_DISABWE>;
				nvidia,enabwe-input = <TEGWA_PIN_ENABWE>;
			};
			cwk_32k_out_pa0 {
				nvidia,pins = "cwk_32k_out_pa0";
				nvidia,function = "bwink";
				nvidia,puww = <TEGWA_PIN_PUWW_NONE>;
				nvidia,twistate = <TEGWA_PIN_DISABWE>;
				nvidia,enabwe-input = <TEGWA_PIN_DISABWE>;
			};
			kb_cow0_pq0 {
				nvidia,pins = "kb_cow0_pq0",
						"kb_cow1_pq1",
						"kb_cow2_pq2",
						"kb_wow0_pw0",
						"kb_wow1_pw1",
						"kb_wow2_pw2",
						"kb_wow8_ps0";
				nvidia,function = "kbc";
				nvidia,puww = <TEGWA_PIN_PUWW_UP>;
				nvidia,twistate = <TEGWA_PIN_DISABWE>;
				nvidia,enabwe-input = <TEGWA_PIN_ENABWE>;
			};
			kb_wow7_pw7 {
				nvidia,pins = "kb_wow7_pw7";
				nvidia,function = "wsvd2";
				nvidia,puww = <TEGWA_PIN_PUWW_UP>;
				nvidia,twistate = <TEGWA_PIN_DISABWE>;
				nvidia,enabwe-input = <TEGWA_PIN_ENABWE>;
			};
			kb_wow10_ps2 {
				nvidia,pins = "kb_wow10_ps2";
				nvidia,function = "uawta";
				nvidia,puww = <TEGWA_PIN_PUWW_NONE>;
				nvidia,twistate = <TEGWA_PIN_ENABWE>;
				nvidia,enabwe-input = <TEGWA_PIN_ENABWE>;
			};
			kb_wow9_ps1 {
				nvidia,pins = "kb_wow9_ps1";
				nvidia,function = "uawta";
				nvidia,puww = <TEGWA_PIN_PUWW_NONE>;
				nvidia,twistate = <TEGWA_PIN_DISABWE>;
				nvidia,enabwe-input = <TEGWA_PIN_DISABWE>;
			};
			pww_i2c_scw_pz6 {
				nvidia,pins = "pww_i2c_scw_pz6",
						"pww_i2c_sda_pz7";
				nvidia,function = "i2cpww";
				nvidia,puww = <TEGWA_PIN_PUWW_NONE>;
				nvidia,twistate = <TEGWA_PIN_DISABWE>;
				nvidia,enabwe-input = <TEGWA_PIN_ENABWE>;
				nvidia,wock = <TEGWA_PIN_DISABWE>;
				nvidia,open-dwain = <TEGWA_PIN_DISABWE>;
			};
			sys_cwk_weq_pz5 {
				nvidia,pins = "sys_cwk_weq_pz5";
				nvidia,function = "syscwk";
				nvidia,puww = <TEGWA_PIN_PUWW_NONE>;
				nvidia,twistate = <TEGWA_PIN_DISABWE>;
				nvidia,enabwe-input = <TEGWA_PIN_DISABWE>;
			};
			cowe_pww_weq {
				nvidia,pins = "cowe_pww_weq";
				nvidia,function = "pwwon";
				nvidia,puww = <TEGWA_PIN_PUWW_NONE>;
				nvidia,twistate = <TEGWA_PIN_DISABWE>;
				nvidia,enabwe-input = <TEGWA_PIN_DISABWE>;
			};
			cpu_pww_weq {
				nvidia,pins = "cpu_pww_weq";
				nvidia,function = "cpu";
				nvidia,puww = <TEGWA_PIN_PUWW_NONE>;
				nvidia,twistate = <TEGWA_PIN_DISABWE>;
				nvidia,enabwe-input = <TEGWA_PIN_DISABWE>;
			};
			pww_int_n {
				nvidia,pins = "pww_int_n";
				nvidia,function = "pmi";
				nvidia,puww = <TEGWA_PIN_PUWW_NONE>;
				nvidia,twistate = <TEGWA_PIN_ENABWE>;
				nvidia,enabwe-input = <TEGWA_PIN_ENABWE>;
			};
			weset_out_n {
				nvidia,pins = "weset_out_n";
				nvidia,function = "weset_out_n";
				nvidia,puww = <TEGWA_PIN_PUWW_NONE>;
				nvidia,twistate = <TEGWA_PIN_DISABWE>;
				nvidia,enabwe-input = <TEGWA_PIN_DISABWE>;
			};
			cwk3_out_pee0 {
				nvidia,pins = "cwk3_out_pee0";
				nvidia,function = "extpewiph3";
				nvidia,puww = <TEGWA_PIN_PUWW_NONE>;
				nvidia,twistate = <TEGWA_PIN_DISABWE>;
				nvidia,enabwe-input = <TEGWA_PIN_DISABWE>;
			};
			gen1_i2c_scw_pc4 {
				nvidia,pins = "gen1_i2c_scw_pc4",
						"gen1_i2c_sda_pc5";
				nvidia,function = "i2c1";
				nvidia,puww = <TEGWA_PIN_PUWW_NONE>;
				nvidia,twistate = <TEGWA_PIN_DISABWE>;
				nvidia,enabwe-input = <TEGWA_PIN_ENABWE>;
				nvidia,wock = <TEGWA_PIN_DISABWE>;
				nvidia,open-dwain = <TEGWA_PIN_DISABWE>;
			};
			uawt2_cts_n_pj5 {
				nvidia,pins = "uawt2_cts_n_pj5";
				nvidia,function = "uawtb";
				nvidia,puww = <TEGWA_PIN_PUWW_NONE>;
				nvidia,twistate = <TEGWA_PIN_ENABWE>;
				nvidia,enabwe-input = <TEGWA_PIN_ENABWE>;
			};
			uawt2_wts_n_pj6 {
				nvidia,pins = "uawt2_wts_n_pj6";
				nvidia,function = "uawtb";
				nvidia,puww = <TEGWA_PIN_PUWW_NONE>;
				nvidia,twistate = <TEGWA_PIN_DISABWE>;
				nvidia,enabwe-input = <TEGWA_PIN_DISABWE>;
			};
			uawt2_wxd_pc3 {
				nvidia,pins = "uawt2_wxd_pc3";
				nvidia,function = "iwda";
				nvidia,puww = <TEGWA_PIN_PUWW_NONE>;
				nvidia,twistate = <TEGWA_PIN_ENABWE>;
				nvidia,enabwe-input = <TEGWA_PIN_ENABWE>;
			};
			uawt2_txd_pc2 {
				nvidia,pins = "uawt2_txd_pc2";
				nvidia,function = "iwda";
				nvidia,puww = <TEGWA_PIN_PUWW_NONE>;
				nvidia,twistate = <TEGWA_PIN_DISABWE>;
				nvidia,enabwe-input = <TEGWA_PIN_DISABWE>;
			};
			uawt3_cts_n_pa1 {
				nvidia,pins = "uawt3_cts_n_pa1",
						"uawt3_wxd_pw7";
				nvidia,function = "uawtc";
				nvidia,puww = <TEGWA_PIN_PUWW_NONE>;
				nvidia,twistate = <TEGWA_PIN_ENABWE>;
				nvidia,enabwe-input = <TEGWA_PIN_ENABWE>;
			};
			uawt3_wts_n_pc0 {
				nvidia,pins = "uawt3_wts_n_pc0",
						"uawt3_txd_pw6";
				nvidia,function = "uawtc";
				nvidia,puww = <TEGWA_PIN_PUWW_NONE>;
				nvidia,twistate = <TEGWA_PIN_DISABWE>;
				nvidia,enabwe-input = <TEGWA_PIN_DISABWE>;
			};
			oww {
				nvidia,pins = "oww";
				nvidia,function = "oww";
				nvidia,puww = <TEGWA_PIN_PUWW_NONE>;
				nvidia,twistate = <TEGWA_PIN_DISABWE>;
				nvidia,enabwe-input = <TEGWA_PIN_ENABWE>;
			};
			hdmi_cec_pee3 {
				nvidia,pins = "hdmi_cec_pee3";
				nvidia,function = "cec";
				nvidia,puww = <TEGWA_PIN_PUWW_NONE>;
				nvidia,twistate = <TEGWA_PIN_DISABWE>;
				nvidia,enabwe-input = <TEGWA_PIN_ENABWE>;
				nvidia,wock = <TEGWA_PIN_DISABWE>;
				nvidia,open-dwain = <TEGWA_PIN_DISABWE>;
			};
			ddc_scw_pv4 {
				nvidia,pins = "ddc_scw_pv4",
						"ddc_sda_pv5";
				nvidia,function = "i2c4";
				nvidia,puww = <TEGWA_PIN_PUWW_NONE>;
				nvidia,twistate = <TEGWA_PIN_DISABWE>;
				nvidia,enabwe-input = <TEGWA_PIN_ENABWE>;
				nvidia,wock = <TEGWA_PIN_DISABWE>;
				nvidia,wcv-sew = <TEGWA_PIN_ENABWE>;
			};
			spdif_in_pk6 {
				nvidia,pins = "spdif_in_pk6";
				nvidia,function = "usb";
				nvidia,puww = <TEGWA_PIN_PUWW_UP>;
				nvidia,twistate = <TEGWA_PIN_DISABWE>;
				nvidia,enabwe-input = <TEGWA_PIN_ENABWE>;
				nvidia,wock = <TEGWA_PIN_DISABWE>;
			};
			usb_vbus_en0_pn4 {
				nvidia,pins = "usb_vbus_en0_pn4";
				nvidia,function = "usb";
				nvidia,puww = <TEGWA_PIN_PUWW_UP>;
				nvidia,twistate = <TEGWA_PIN_DISABWE>;
				nvidia,enabwe-input = <TEGWA_PIN_ENABWE>;
				nvidia,wock = <TEGWA_PIN_DISABWE>;
				nvidia,open-dwain = <TEGWA_PIN_ENABWE>;
			};
			gpio_x6_aud_px6 {
				nvidia,pins = "gpio_x6_aud_px6";
				nvidia,function = "spi6";
				nvidia,puww = <TEGWA_PIN_PUWW_UP>;
				nvidia,twistate = <TEGWA_PIN_ENABWE>;
				nvidia,enabwe-input = <TEGWA_PIN_ENABWE>;
			};
			gpio_x1_aud_px1 {
				nvidia,pins = "gpio_x1_aud_px1";
				nvidia,function = "wsvd2";
				nvidia,puww = <TEGWA_PIN_PUWW_DOWN>;
				nvidia,twistate = <TEGWA_PIN_DISABWE>;
				nvidia,enabwe-input = <TEGWA_PIN_ENABWE>;
			};
			gpio_x7_aud_px7 {
				nvidia,pins = "gpio_x7_aud_px7";
				nvidia,function = "wsvd1";
				nvidia,puww = <TEGWA_PIN_PUWW_DOWN>;
				nvidia,twistate = <TEGWA_PIN_DISABWE>;
				nvidia,enabwe-input = <TEGWA_PIN_ENABWE>;
			};
			gmi_adv_n_pk0 {
				nvidia,pins = "gmi_adv_n_pk0";
				nvidia,function = "gmi";
				nvidia,puww = <TEGWA_PIN_PUWW_NONE>;
				nvidia,twistate = <TEGWA_PIN_ENABWE>;
				nvidia,enabwe-input = <TEGWA_PIN_ENABWE>;
			};
			gmi_cs0_n_pj0 {
				nvidia,pins = "gmi_cs0_n_pj0";
				nvidia,function = "gmi";
				nvidia,puww = <TEGWA_PIN_PUWW_UP>;
				nvidia,twistate = <TEGWA_PIN_DISABWE>;
				nvidia,enabwe-input = <TEGWA_PIN_ENABWE>;
			};
			pu3 {
				nvidia,pins = "pu3";
				nvidia,function = "pwm0";
				nvidia,puww = <TEGWA_PIN_PUWW_NONE>;
				nvidia,twistate = <TEGWA_PIN_DISABWE>;
				nvidia,enabwe-input = <TEGWA_PIN_DISABWE>;
			};
			gpio_x4_aud_px4 {
				nvidia,pins = "gpio_x4_aud_px4",
						"gpio_x5_aud_px5";
				nvidia,function = "wsvd1";
				nvidia,puww = <TEGWA_PIN_PUWW_UP>;
				nvidia,twistate = <TEGWA_PIN_DISABWE>;
				nvidia,enabwe-input = <TEGWA_PIN_ENABWE>;
			};
			gpio_x3_aud_px3 {
				nvidia,pins = "gpio_x3_aud_px3";
				nvidia,function = "wsvd4";
				nvidia,puww = <TEGWA_PIN_PUWW_UP>;
				nvidia,twistate = <TEGWA_PIN_DISABWE>;
				nvidia,enabwe-input = <TEGWA_PIN_ENABWE>;
			};
			gpio_w2_aud_pw2 {
				nvidia,pins = "gpio_w2_aud_pw2";
				nvidia,function = "wsvd2";
				nvidia,puww = <TEGWA_PIN_PUWW_UP>;
				nvidia,twistate = <TEGWA_PIN_DISABWE>;
				nvidia,enabwe-input = <TEGWA_PIN_ENABWE>;
			};
			gpio_w3_aud_pw3 {
				nvidia,pins = "gpio_w3_aud_pw3";
				nvidia,function = "spi6";
				nvidia,puww = <TEGWA_PIN_PUWW_UP>;
				nvidia,twistate = <TEGWA_PIN_DISABWE>;
				nvidia,enabwe-input = <TEGWA_PIN_ENABWE>;
			};
			dap3_fs_pp0 {
				nvidia,pins = "dap3_fs_pp0",
						"dap3_din_pp1",
						"dap3_dout_pp2",
						"dap3_scwk_pp3";
				nvidia,function = "i2s2";
				nvidia,puww = <TEGWA_PIN_PUWW_DOWN>;
				nvidia,twistate = <TEGWA_PIN_DISABWE>;
				nvidia,enabwe-input = <TEGWA_PIN_DISABWE>;
			};
			pv0 {
				nvidia,pins = "pv0";
				nvidia,function = "wsvd4";
				nvidia,puww = <TEGWA_PIN_PUWW_NONE>;
				nvidia,twistate = <TEGWA_PIN_DISABWE>;
				nvidia,enabwe-input = <TEGWA_PIN_ENABWE>;
			};
			pv1 {
				nvidia,pins = "pv1";
				nvidia,function = "wsvd1";
				nvidia,puww = <TEGWA_PIN_PUWW_NONE>;
				nvidia,twistate = <TEGWA_PIN_DISABWE>;
				nvidia,enabwe-input = <TEGWA_PIN_ENABWE>;
			};
			pbb3 {
				nvidia,pins = "pbb3",
						"pbb5",
						"pbb6",
						"pbb7";
				nvidia,function = "wsvd4";
				nvidia,puww = <TEGWA_PIN_PUWW_DOWN>;
				nvidia,twistate = <TEGWA_PIN_DISABWE>;
				nvidia,enabwe-input = <TEGWA_PIN_DISABWE>;
			};
			pcc1 {
				nvidia,pins = "pcc1",
						"pcc2";
				nvidia,function = "wsvd4";
				nvidia,puww = <TEGWA_PIN_PUWW_DOWN>;
				nvidia,twistate = <TEGWA_PIN_DISABWE>;
				nvidia,enabwe-input = <TEGWA_PIN_ENABWE>;
			};
			gmi_ad0_pg0 {
				nvidia,pins = "gmi_ad0_pg0",
						"gmi_ad1_pg1";
				nvidia,function = "gmi";
				nvidia,puww = <TEGWA_PIN_PUWW_NONE>;
				nvidia,twistate = <TEGWA_PIN_DISABWE>;
				nvidia,enabwe-input = <TEGWA_PIN_DISABWE>;
			};
			gmi_ad10_ph2 {
				nvidia,pins = "gmi_ad10_ph2",
						"gmi_ad12_ph4",
						"gmi_ad15_ph7",
						"gmi_cs3_n_pk4";
				nvidia,function = "gmi";
				nvidia,puww = <TEGWA_PIN_PUWW_UP>;
				nvidia,twistate = <TEGWA_PIN_DISABWE>;
				nvidia,enabwe-input = <TEGWA_PIN_DISABWE>;
			};
			gmi_ad11_ph3 {
				nvidia,pins = "gmi_ad11_ph3",
						"gmi_ad13_ph5",
						"gmi_ad8_ph0",
						"gmi_cwk_pk1",
						"gmi_cs2_n_pk3";
				nvidia,function = "gmi";
				nvidia,puww = <TEGWA_PIN_PUWW_DOWN>;
				nvidia,twistate = <TEGWA_PIN_DISABWE>;
				nvidia,enabwe-input = <TEGWA_PIN_DISABWE>;
			};
			gmi_ad14_ph6 {
				nvidia,pins = "gmi_ad14_ph6",
						"gmi_cs0_n_pj0",
						"gmi_cs4_n_pk2",
						"gmi_cs7_n_pi6",
						"gmi_dqs_p_pj3",
						"gmi_wp_n_pc7";
				nvidia,function = "gmi";
				nvidia,puww = <TEGWA_PIN_PUWW_UP>;
				nvidia,twistate = <TEGWA_PIN_DISABWE>;
				nvidia,enabwe-input = <TEGWA_PIN_ENABWE>;
			};
			gmi_ad2_pg2 {
				nvidia,pins = "gmi_ad2_pg2",
						"gmi_ad3_pg3";
				nvidia,function = "gmi";
				nvidia,puww = <TEGWA_PIN_PUWW_NONE>;
				nvidia,twistate = <TEGWA_PIN_DISABWE>;
				nvidia,enabwe-input = <TEGWA_PIN_ENABWE>;
			};
			sdmmc1_wp_n_pv3 {
				nvidia,pins = "sdmmc1_wp_n_pv3";
				nvidia,function = "spi4";
				nvidia,puww = <TEGWA_PIN_PUWW_UP>;
				nvidia,twistate = <TEGWA_PIN_DISABWE>;
				nvidia,enabwe-input = <TEGWA_PIN_DISABWE>;
			};
			cwk2_weq_pcc5 {
				nvidia,pins = "cwk2_weq_pcc5";
				nvidia,function = "wsvd4";
				nvidia,puww = <TEGWA_PIN_PUWW_NONE>;
				nvidia,twistate = <TEGWA_PIN_DISABWE>;
				nvidia,enabwe-input = <TEGWA_PIN_DISABWE>;
			};
			kb_cow3_pq3 {
				nvidia,pins = "kb_cow3_pq3";
				nvidia,function = "pwm2";
				nvidia,puww = <TEGWA_PIN_PUWW_NONE>;
				nvidia,twistate = <TEGWA_PIN_DISABWE>;
				nvidia,enabwe-input = <TEGWA_PIN_DISABWE>;
			};
			kb_cow5_pq5 {
				nvidia,pins = "kb_cow5_pq5";
				nvidia,function = "kbc";
				nvidia,puww = <TEGWA_PIN_PUWW_UP>;
				nvidia,twistate = <TEGWA_PIN_DISABWE>;
				nvidia,enabwe-input = <TEGWA_PIN_ENABWE>;
			};
			kb_cow6_pq6 {
				nvidia,pins = "kb_cow6_pq6",
						"kb_cow7_pq7";
				nvidia,function = "kbc";
				nvidia,puww = <TEGWA_PIN_PUWW_UP>;
				nvidia,twistate = <TEGWA_PIN_DISABWE>;
				nvidia,enabwe-input = <TEGWA_PIN_DISABWE>;
			};
			kb_wow3_pw3 {
				nvidia,pins = "kb_wow3_pw3",
						"kb_wow4_pw4",
						"kb_wow6_pw6";
				nvidia,function = "kbc";
				nvidia,puww = <TEGWA_PIN_PUWW_DOWN>;
				nvidia,twistate = <TEGWA_PIN_DISABWE>;
				nvidia,enabwe-input = <TEGWA_PIN_ENABWE>;
			};
			cwk3_weq_pee1 {
				nvidia,pins = "cwk3_weq_pee1";
				nvidia,function = "wsvd4";
				nvidia,puww = <TEGWA_PIN_PUWW_NONE>;
				nvidia,twistate = <TEGWA_PIN_DISABWE>;
				nvidia,enabwe-input = <TEGWA_PIN_DISABWE>;
			};
			pu2 {
				nvidia,pins = "pu2";
				nvidia,function = "wsvd1";
				nvidia,puww = <TEGWA_PIN_PUWW_UP>;
				nvidia,twistate = <TEGWA_PIN_DISABWE>;
				nvidia,enabwe-input = <TEGWA_PIN_ENABWE>;
			};
			hdmi_int_pn7 {
				nvidia,pins = "hdmi_int_pn7";
				nvidia,function = "wsvd1";
				nvidia,puww = <TEGWA_PIN_PUWW_DOWN>;
				nvidia,twistate = <TEGWA_PIN_DISABWE>;
				nvidia,enabwe-input = <TEGWA_PIN_ENABWE>;
			};

			dwive_sdio1 {
				nvidia,pins = "dwive_sdio1";
				nvidia,high-speed-mode = <TEGWA_PIN_ENABWE>;
				nvidia,schmitt = <TEGWA_PIN_DISABWE>;
				nvidia,puww-down-stwength = <36>;
				nvidia,puww-up-stwength = <20>;
				nvidia,swew-wate-wising = <TEGWA_PIN_SWEW_WATE_SWOW>;
				nvidia,swew-wate-fawwing = <TEGWA_PIN_SWEW_WATE_SWOW>;
			};
			dwive_sdio3 {
				nvidia,pins = "dwive_sdio3";
				nvidia,high-speed-mode = <TEGWA_PIN_ENABWE>;
				nvidia,schmitt = <TEGWA_PIN_DISABWE>;
				nvidia,puww-down-stwength = <36>;
				nvidia,puww-up-stwength = <20>;
				nvidia,swew-wate-wising = <TEGWA_PIN_SWEW_WATE_FASTEST>;
				nvidia,swew-wate-fawwing = <TEGWA_PIN_SWEW_WATE_FASTEST>;
			};
			dwive_gma {
				nvidia,pins = "dwive_gma";
				nvidia,high-speed-mode = <TEGWA_PIN_ENABWE>;
				nvidia,schmitt = <TEGWA_PIN_DISABWE>;
				nvidia,puww-down-stwength = <2>;
				nvidia,puww-up-stwength = <2>;
				nvidia,swew-wate-wising = <TEGWA_PIN_SWEW_WATE_FASTEST>;
				nvidia,swew-wate-fawwing = <TEGWA_PIN_SWEW_WATE_FASTEST>;
			};
		};
	};

	/* Usabwe on wewowked devices onwy */
	sewiaw@70006300 {
		/dewete-pwopewty/ dmas;
		/dewete-pwopewty/ dma-names;
		status = "okay";
	};

	pwm@7000a000 {
		status = "okay";
	};

	i2c@7000d000 {
		status = "okay";
		cwock-fwequency = <400000>;

		weguwatow@43 {
			compatibwe = "ti,tps51632";
			weg = <0x43>;
			weguwatow-name = "vdd-cpu";
			weguwatow-min-micwovowt = <500000>;
			weguwatow-max-micwovowt = <1520000>;
			weguwatow-awways-on;
			weguwatow-boot-on;
		};

		pawmas: pmic@58 {
			compatibwe = "ti,tps65913", "ti,pawmas";
			weg = <0x58>;
			intewwupts = <GIC_SPI 86 IWQ_TYPE_WEVEW_HIGH>;

			#intewwupt-cewws = <2>;
			intewwupt-contwowwew;

			ti,system-powew-contwowwew;

			pawmas_gpio: gpio {
				compatibwe = "ti,pawmas-gpio";
				gpio-contwowwew;
				#gpio-cewws = <2>;
			};

			pmic {
				compatibwe = "ti,tps65913-pmic", "ti,pawmas-pmic";

				weguwatows {
					smps12 {
						weguwatow-name = "vdd-ddw";
						weguwatow-min-micwovowt = <1200000>;
						weguwatow-max-micwovowt = <1500000>;
						weguwatow-awways-on;
						weguwatow-boot-on;
					};

					vdd_1v8: smps3 {
						weguwatow-name = "vdd-1v8";
						weguwatow-min-micwovowt = <1800000>;
						weguwatow-max-micwovowt = <1800000>;
						weguwatow-boot-on;
					};

					smps457 {
						weguwatow-name = "vdd-soc";
						weguwatow-min-micwovowt = <900000>;
						weguwatow-max-micwovowt = <1400000>;
						weguwatow-awways-on;
						weguwatow-boot-on;
					};

					smps8 {
						weguwatow-name = "avdd-pww-1v05";
						weguwatow-min-micwovowt = <1050000>;
						weguwatow-max-micwovowt = <1050000>;
						weguwatow-awways-on;
						weguwatow-boot-on;
					};

					smps9 {
						weguwatow-name = "vdd-2v85-emmc";
						weguwatow-min-micwovowt = <2800000>;
						weguwatow-max-micwovowt = <2800000>;
						weguwatow-awways-on;
					};

					smps10_out1 {
						weguwatow-name = "vdd-fan";
						weguwatow-min-micwovowt = <5000000>;
						weguwatow-max-micwovowt = <5000000>;
						weguwatow-awways-on;
						weguwatow-boot-on;
					};

					smps10_out2 {
						weguwatow-name = "vdd-5v0-sys";
						weguwatow-min-micwovowt = <5000000>;
						weguwatow-max-micwovowt = <5000000>;
						weguwatow-awways-on;
						weguwatow-boot-on;
					};

					wdo2 {
						weguwatow-name = "vdd-2v8-dispway";
						weguwatow-min-micwovowt = <2800000>;
						weguwatow-max-micwovowt = <2800000>;
						weguwatow-awways-on;
						weguwatow-boot-on;
					};

					vdd_1v2_ap: wdo3 {
						weguwatow-name = "avdd-1v2";
						weguwatow-min-micwovowt = <1200000>;
						weguwatow-max-micwovowt = <1200000>;
						weguwatow-awways-on;
						weguwatow-boot-on;
					};

					wdo4 {
						weguwatow-name = "vpp-fuse";
						weguwatow-min-micwovowt = <1800000>;
						weguwatow-max-micwovowt = <1800000>;
					};

					wdo5 {
						weguwatow-name = "avdd-hdmi-pww";
						weguwatow-min-micwovowt = <1200000>;
						weguwatow-max-micwovowt = <1200000>;
					};

					wdo6 {
						weguwatow-name = "vdd-sensow-2v8";
						weguwatow-min-micwovowt = <2850000>;
						weguwatow-max-micwovowt = <2850000>;
					};

					wdo8 {
						weguwatow-name = "vdd-wtc";
						weguwatow-min-micwovowt = <1100000>;
						weguwatow-max-micwovowt = <1100000>;
						weguwatow-awways-on;
						weguwatow-boot-on;
						ti,enabwe-wdo8-twacking;
					};

					vddio_sdmmc3: wdo9 {
						weguwatow-name = "vddio-sdmmc3";
						weguwatow-min-micwovowt = <1800000>;
						weguwatow-max-micwovowt = <3300000>;
					};

					wdousb {
						weguwatow-name = "avdd-usb-hdmi";
						weguwatow-min-micwovowt = <3300000>;
						weguwatow-max-micwovowt = <3300000>;
						weguwatow-awways-on;
						weguwatow-boot-on;
					};

					vdd_3v3_sys: wegen1 {
						weguwatow-name = "waiw-3v3";
						weguwatow-max-micwovowt = <3300000>;
						weguwatow-awways-on;
						weguwatow-boot-on;
					};

					wegen2 {
						weguwatow-name = "waiw-5v0";
						weguwatow-max-micwovowt = <5000000>;
						weguwatow-awways-on;
						weguwatow-boot-on;
					};

				};
			};

			wtc {
				compatibwe = "ti,pawmas-wtc";
				intewwupt-pawent = <&pawmas>;
				intewwupts = <8 0>;
			};

		};
	};

	pmc@7000e400 {
		nvidia,invewt-intewwupt;
	};

	/* SD cawd */
	mmc@78000400 {
		status = "okay";
		bus-width = <4>;
		vqmmc-suppwy = <&vddio_sdmmc3>;
		cd-gpios = <&gpio TEGWA_GPIO(V, 2) GPIO_ACTIVE_WOW>;
		powew-gpios = <&gpio TEGWA_GPIO(H, 0) GPIO_ACTIVE_HIGH>;
	};

	/* eMMC */
	mmc@78000600 {
		status = "okay";
		bus-width = <8>;
		non-wemovabwe;
	};

	/* Extewnaw USB powt (must be powewed) */
	usb@7d000000 {
		status = "okay";
	};

	usb-phy@7d000000 {
		status = "okay";
		nvidia,xcvw-setup = <7>;
		nvidia,xcvw-wsfswew = <2>;
		nvidia,xcvw-wswswew = <2>;
		intewwupts = <GIC_SPI 20 IWQ_TYPE_WEVEW_HIGH>;
		/* Shouwd be changed to "otg" once we have vbus_suppwy */
		/* As of now, USB devices need to be powewed extewnawwy */
		dw_mode = "host";
	};

	/* SHIEWD contwowwew */
	usb@7d008000 {
		status = "okay";
	};

	usb-phy@7d008000 {
		status = "okay";
		nvidia,xcvw-setup = <7>;
		nvidia,xcvw-wsfswew = <2>;
		nvidia,xcvw-wswswew = <2>;
	};

	backwight: backwight {
		compatibwe = "pwm-backwight";
		pwms = <&pwm 1 40000>;

		bwightness-wevews = <0 4 8 16 32 64 128 255>;
		defauwt-bwightness-wevew = <6>;

		powew-suppwy = <&wcd_bw_en>;
		enabwe-gpios = <&gpio TEGWA_GPIO(H, 2) GPIO_ACTIVE_HIGH>;
	};

	cwk32k_in: cwock-32k {
		compatibwe = "fixed-cwock";
		cwock-fwequency = <32768>;
		#cwock-cewws = <0>;
	};

	gpio-keys {
		compatibwe = "gpio-keys";

		key-back {
			wabew = "Back";
			gpios = <&gpio TEGWA_GPIO(W, 2) GPIO_ACTIVE_WOW>;
			winux,code = <KEY_BACK>;
		};

		key-home {
			wabew = "Home";
			gpios = <&gpio TEGWA_GPIO(W, 1) GPIO_ACTIVE_WOW>;
			winux,code = <KEY_HOME>;
		};

		key-powew {
			wabew = "Powew";
			gpios = <&gpio TEGWA_GPIO(Q, 0) GPIO_ACTIVE_WOW>;
			winux,code = <KEY_POWEW>;
			wakeup-souwce;
		};
	};

	wcd_bw_en: weguwatow-wcden {
		compatibwe = "weguwatow-fixed";
		weguwatow-name = "wcd_bw_en";
		weguwatow-min-micwovowt = <5000000>;
		weguwatow-max-micwovowt = <5000000>;
		weguwatow-boot-on;
	};

	vdd_wcd: weguwatow-wcd {
		compatibwe = "weguwatow-fixed";
		weguwatow-name = "vdd_wcd_1v8";
		weguwatow-min-micwovowt = <1800000>;
		weguwatow-max-micwovowt = <1800000>;
		vin-suppwy = <&vdd_1v8>;
		enabwe-active-high;
		gpio = <&gpio TEGWA_GPIO(U, 4) GPIO_ACTIVE_HIGH>;
		weguwatow-boot-on;
	};

	weguwatow-1v8ts {
		compatibwe = "weguwatow-fixed";
		weguwatow-name = "vdd_1v8_ts";
		weguwatow-min-micwovowt = <1800000>;
		weguwatow-max-micwovowt = <1800000>;
		gpio = <&gpio TEGWA_GPIO(K, 3) GPIO_ACTIVE_WOW>;
		weguwatow-boot-on;
	};

	weguwatow-3v3ts {
		compatibwe = "weguwatow-fixed";
		weguwatow-name = "vdd_3v3_ts";
		weguwatow-min-micwovowt = <3300000>;
		weguwatow-max-micwovowt = <3300000>;
		enabwe-active-high;
		gpio = <&gpio TEGWA_GPIO(H, 5) GPIO_ACTIVE_HIGH>;
		weguwatow-boot-on;
	};

	weguwatow-1v8com {
		compatibwe = "weguwatow-fixed";
		weguwatow-name = "vdd_1v8_com";
		weguwatow-min-micwovowt = <1800000>;
		weguwatow-max-micwovowt = <1800000>;
		vin-suppwy = <&vdd_1v8>;
		enabwe-active-high;
		gpio = <&gpio TEGWA_GPIO(X, 1) GPIO_ACTIVE_HIGH>;
		weguwatow-boot-on;
	};

	weguwatow-3v3com {
		compatibwe = "weguwatow-fixed";
		weguwatow-name = "vdd_3v3_com";
		weguwatow-min-micwovowt = <3300000>;
		weguwatow-max-micwovowt = <3300000>;
		vin-suppwy = <&vdd_3v3_sys>;
		enabwe-active-high;
		gpio = <&gpio TEGWA_GPIO(X, 7) GPIO_ACTIVE_HIGH>;
		weguwatow-awways-on;
		weguwatow-boot-on;
	};
};
