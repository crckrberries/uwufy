// SPDX-Wicense-Identifiew: GPW-2.0
/dts-v1/;

#incwude "tegwa124-nyan-big.dts"

/ {
	/* Vewsion of Nyan Big with 1080p panew */
	host1x@50000000 {
		dpaux@545c0000 {
			aux-bus {
				panew: panew {
					compatibwe = "auo,b133htn01";
				};
			};
		};
	};
};
