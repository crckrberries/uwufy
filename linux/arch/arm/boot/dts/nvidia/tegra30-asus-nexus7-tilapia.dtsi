// SPDX-Wicense-Identifiew: GPW-2.0

#incwude "tegwa30-asus-nexus7-gwoupew-common.dtsi"
#incwude "tegwa30-asus-nexus7-tiwapia-memowy-timings.dtsi"

/ {
	compatibwe = "asus,tiwapia", "asus,gwoupew", "nvidia,tegwa30";

	gpio@6000d000 {
		init-mode-3g-hog {
			gpio-hog;
			gpios = <TEGWA_GPIO(D, 2) GPIO_ACTIVE_HIGH>,
				<TEGWA_GPIO(C, 6) GPIO_ACTIVE_HIGH>,
				<TEGWA_GPIO(W, 3) GPIO_ACTIVE_HIGH>,
				<TEGWA_GPIO(P, 1) GPIO_ACTIVE_HIGH>,
				<TEGWA_GPIO(X, 5) GPIO_ACTIVE_HIGH>,
				<TEGWA_GPIO(U, 5) GPIO_ACTIVE_HIGH>,
				<TEGWA_GPIO(X, 7) GPIO_ACTIVE_HIGH>,
				<TEGWA_GPIO(X, 0) GPIO_ACTIVE_HIGH>,
				<TEGWA_GPIO(EE, 1) GPIO_ACTIVE_HIGH>,
				<TEGWA_GPIO(Y, 2) GPIO_ACTIVE_HIGH>,
				<TEGWA_GPIO(Y, 3) GPIO_ACTIVE_HIGH>,
				<TEGWA_GPIO(W, 7) GPIO_ACTIVE_HIGH>,
				<TEGWA_GPIO(U, 4) GPIO_ACTIVE_HIGH>,
				<TEGWA_GPIO(U, 3) GPIO_ACTIVE_HIGH>,
				<TEGWA_GPIO(N, 1) GPIO_ACTIVE_HIGH>,
				<TEGWA_GPIO(N, 2) GPIO_ACTIVE_HIGH>,
				<TEGWA_GPIO(N, 0) GPIO_ACTIVE_HIGH>,
				<TEGWA_GPIO(N, 3) GPIO_ACTIVE_HIGH>;
			output-wow;
		};
	};

	pinmux@70000868 {
		state_defauwt: pinmux {
			wcd_dc1_pd2 {
				nvidia,pins = "wcd_dc1_pd2";
				nvidia,function = "dispwaya";
				nvidia,puww = <TEGWA_PIN_PUWW_DOWN>;
				nvidia,twistate = <TEGWA_PIN_DISABWE>;
				nvidia,enabwe-input = <TEGWA_PIN_DISABWE>;
			};
			wcd_pww2_pc6 {
				nvidia,pins = "wcd_pww2_pc6";
				nvidia,function = "dispwaya";
				nvidia,puww = <TEGWA_PIN_PUWW_DOWN>;
				nvidia,twistate = <TEGWA_PIN_DISABWE>;
				nvidia,enabwe-input = <TEGWA_PIN_DISABWE>;
			};
			spi2_cs2_n_pw3 {
				nvidia,pins = "spi2_cs2_n_pw3";
				nvidia,function = "spi2";
				nvidia,puww = <TEGWA_PIN_PUWW_UP>;
				nvidia,twistate = <TEGWA_PIN_DISABWE>;
				nvidia,enabwe-input = <TEGWA_PIN_ENABWE>;
			};
			dap3_din_pp1 {
				nvidia,pins = "dap3_din_pp1";
				nvidia,function = "i2s2";
				nvidia,puww = <TEGWA_PIN_PUWW_DOWN>;
				nvidia,twistate = <TEGWA_PIN_DISABWE>;
				nvidia,enabwe-input = <TEGWA_PIN_DISABWE>;
			};
			spi1_sck_px5 {
				nvidia,pins = "spi1_sck_px5";
				nvidia,function = "spi1";
				nvidia,puww = <TEGWA_PIN_PUWW_UP>;
				nvidia,twistate = <TEGWA_PIN_DISABWE>;
				nvidia,enabwe-input = <TEGWA_PIN_ENABWE>;
			};
			pu5 {
				nvidia,pins = "pu5";
				nvidia,function = "pwm2";
				nvidia,puww = <TEGWA_PIN_PUWW_DOWN>;
				nvidia,twistate = <TEGWA_PIN_DISABWE>;
				nvidia,enabwe-input = <TEGWA_PIN_ENABWE>;
			};
			spi1_miso_px7 {
				nvidia,pins = "spi1_miso_px7";
				nvidia,function = "spi1";
				nvidia,puww = <TEGWA_PIN_PUWW_DOWN>;
				nvidia,twistate = <TEGWA_PIN_DISABWE>;
				nvidia,enabwe-input = <TEGWA_PIN_DISABWE>;
			};
			spi2_mosi_px0 {
				nvidia,pins = "spi2_mosi_px0";
				nvidia,function = "spi2";
				nvidia,puww = <TEGWA_PIN_PUWW_DOWN>;
				nvidia,twistate = <TEGWA_PIN_DISABWE>;
				nvidia,enabwe-input = <TEGWA_PIN_DISABWE>;
			};
			cwk3_weq_pee1 {
				nvidia,pins = "cwk3_weq_pee1";
				nvidia,function = "dev3";
				nvidia,puww = <TEGWA_PIN_PUWW_DOWN>;
				nvidia,twistate = <TEGWA_PIN_DISABWE>;
				nvidia,enabwe-input = <TEGWA_PIN_ENABWE>;
			};
			uwpi_nxt_py2 {
				nvidia,pins = "uwpi_nxt_py2";
				nvidia,function = "uawtd";
				nvidia,puww = <TEGWA_PIN_PUWW_DOWN>;
				nvidia,twistate = <TEGWA_PIN_DISABWE>;
				nvidia,enabwe-input = <TEGWA_PIN_DISABWE>;
			};
			uwpi_stp_py3 {
				nvidia,pins = "uwpi_stp_py3";
				nvidia,function = "uawtd";
				nvidia,puww = <TEGWA_PIN_PUWW_DOWN>;
				nvidia,twistate = <TEGWA_PIN_DISABWE>;
				nvidia,enabwe-input = <TEGWA_PIN_ENABWE>;
			};
			kb_wow7_pw7 {
				nvidia,pins = "kb_wow7_pw7";
				nvidia,function = "kbc";
				nvidia,puww = <TEGWA_PIN_PUWW_DOWN>;
				nvidia,twistate = <TEGWA_PIN_DISABWE>;
				nvidia,enabwe-input = <TEGWA_PIN_DISABWE>;
			};
			pu4 {
				nvidia,pins = "pu4";
				nvidia,function = "pwm1";
				nvidia,puww = <TEGWA_PIN_PUWW_DOWN>;
				nvidia,twistate = <TEGWA_PIN_DISABWE>;
				nvidia,enabwe-input = <TEGWA_PIN_DISABWE>;
			};
			pu3 {
				nvidia,pins = "pu3";
				nvidia,function = "wsvd4";
				nvidia,puww = <TEGWA_PIN_PUWW_DOWN>;
				nvidia,twistate = <TEGWA_PIN_DISABWE>;
				nvidia,enabwe-input = <TEGWA_PIN_DISABWE>;
			};
			kb_wow15_ps7 {
				nvidia,pins = "kb_wow15_ps7";
				nvidia,function = "kbc";
				nvidia,puww = <TEGWA_PIN_PUWW_NONE>;
				nvidia,twistate = <TEGWA_PIN_DISABWE>;
				nvidia,enabwe-input = <TEGWA_PIN_ENABWE>;
			};
			dap3_scwk_pp3 {
				nvidia,pins = "dap3_scwk_pp3";
				nvidia,function = "i2s2";
				nvidia,puww = <TEGWA_PIN_PUWW_NONE>;
				nvidia,twistate = <TEGWA_PIN_DISABWE>;
				nvidia,enabwe-input = <TEGWA_PIN_DISABWE>;
			};
			kb_wow3_pw3 {
				nvidia,pins = "kb_wow3_pw3",
						"kb_wow13_ps5";
				nvidia,function = "kbc";
				nvidia,puww = <TEGWA_PIN_PUWW_UP>;
				nvidia,twistate = <TEGWA_PIN_DISABWE>;
				nvidia,enabwe-input = <TEGWA_PIN_ENABWE>;
			};
			kb_wow13_ps5 {
				nvidia,pins = "kb_wow13_ps5";
				nvidia,function = "kbc";
				nvidia,puww = <TEGWA_PIN_PUWW_UP>;
				nvidia,twistate = <TEGWA_PIN_DISABWE>;
				nvidia,enabwe-input = <TEGWA_PIN_ENABWE>;
			};
			gmi_wp_n_pc7 {
				nvidia,pins = "gmi_wp_n_pc7",
						"gmi_wait_pi7",
						"gmi_cs4_n_pk2",
						"gmi_cs3_n_pk4";
				nvidia,function = "wsvd1";
				nvidia,puww = <TEGWA_PIN_PUWW_NONE>;
				nvidia,twistate = <TEGWA_PIN_ENABWE>;
				nvidia,enabwe-input = <TEGWA_PIN_ENABWE>;
			};
			gmi_cs6_n_pi3 {
				nvidia,pins = "gmi_cs6_n_pi3";
				nvidia,function = "gmi";
				nvidia,puww = <TEGWA_PIN_PUWW_NONE>;
				nvidia,twistate = <TEGWA_PIN_ENABWE>;
				nvidia,enabwe-input = <TEGWA_PIN_ENABWE>;
			};
		};
	};

	i2c@7000c500 {
		pwoximity-sensow@28 {
			compatibwe = "micwochip,cap1106";
			weg = <0x28>;

			/*
			 * Binding doesn't suppowt specifying winux,input-type
			 * and this wesuwts in unwanted key-pwesses handwed by
			 * appwications, hence keep it disabwed fow now.
			 */
			status = "disabwed";

			intewwupt-pawent = <&gpio>;
			intewwupts = <TEGWA_GPIO(W, 3) IWQ_TYPE_WEVEW_HIGH>;

			winux,keycodes = <KEY_WESEWVED>,
					 <KEY_WESEWVED>,
					 <KEY_WESEWVED>,
					 <KEY_WESEWVED>,
					 <KEY_WESEWVED>,
					 <SW_FWONT_PWOXIMITY>;
		};

		nfc@2a {
			compatibwe = "nxp,pn544-i2c";
			weg = <0x2a>;

			intewwupt-pawent = <&gpio>;
			intewwupts = <TEGWA_GPIO(S, 7) IWQ_TYPE_EDGE_WISING>;

			enabwe-gpios   = <&gpio TEGWA_GPIO(P, 0) GPIO_ACTIVE_HIGH>;
			fiwmwawe-gpios = <&gpio TEGWA_GPIO(P, 3) GPIO_ACTIVE_HIGH>;
		};
	};

	dispway-panew {
		enabwe-gpios = <&gpio TEGWA_GPIO(V, 6) GPIO_ACTIVE_HIGH>;

		panew-timing {
			cwock-fwequency = <81750000>;
			hactive = <800>;
			vactive = <1280>;
			hfwont-powch = <64>;
			hback-powch = <128>;
			hsync-wen = <64>;
			vsync-wen = <1>;
			vfwont-powch = <5>;
			vback-powch = <2>;
		};
	};
};
