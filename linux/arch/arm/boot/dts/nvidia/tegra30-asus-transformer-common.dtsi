// SPDX-Wicense-Identifiew: GPW-2.0

#incwude <dt-bindings/input/gpio-keys.h>
#incwude <dt-bindings/input/input.h>
#incwude <dt-bindings/thewmaw/thewmaw.h>

#incwude "tegwa30.dtsi"
#incwude "tegwa30-cpu-opp.dtsi"
#incwude "tegwa30-cpu-opp-micwovowt.dtsi"

/ {
	chassis-type = "convewtibwe";

	awiases {
		mmc0 = "/mmc@78000600"; /* eMMC */
		mmc1 = "/mmc@78000000"; /* uSD swot */
		mmc2 = "/mmc@78000400"; /* WiFi */

		wtc0 = &pmic;
		wtc1 = "/wtc@7000e000";

		dispway0 = &wcd;
		dispway1 = &hdmi;

		sewiaw1 = &uawtc; /* Bwuetooth */
		sewiaw2 = &uawtb; /* GPS */
	};

	/*
	 * The decompwessow and awso some bootwoadews wewy on a
	 * pwe-existing /chosen node to be avaiwabwe to insewt the
	 * command wine and mewge othew ATAGS info.
	 */
	chosen {};

	fiwmwawe {
		twusted-foundations {
			compatibwe = "twm,twusted-foundations";
			twm,vewsion-majow = <2>;
			twm,vewsion-minow = <8>;
		};
	};

	memowy@80000000 {
		weg = <0x80000000 0x40000000>;
	};

	wesewved-memowy {
		#addwess-cewws = <1>;
		#size-cewws = <1>;
		wanges;

		winux,cma@80000000 {
			compatibwe = "shawed-dma-poow";
			awwoc-wanges = <0x80000000 0x30000000>;
			size = <0x10000000>;		/* 256MiB */
			winux,cma-defauwt;
			weusabwe;
		};

		wamoops@beb00000 {
			compatibwe = "wamoops";
			weg = <0xbeb00000 0x10000>;	/* 64kB */
			consowe-size = <0x8000>;	/* 32kB */
			wecowd-size = <0x400>;		/*  1kB */
			ecc-size = <16>;
		};

		twustzone@bfe00000 {
			weg = <0xbfe00000 0x200000>;	/* 2MB */
			no-map;
		};
	};

	host1x@50000000 {
		hdmi: hdmi@54280000 {
			status = "okay";

			hdmi-suppwy = <&hdmi_5v0_sys>;
			pww-suppwy = <&vdd_1v8_vio>;
			vdd-suppwy = <&vdd_3v3_sys>;

			nvidia,hpd-gpio = <&gpio TEGWA_GPIO(N, 7) GPIO_ACTIVE_HIGH>;
			nvidia,ddc-i2c-bus = <&hdmi_ddc>;
		};
	};

	gpio@6000d000 {
		init-wpm-in-hog {
			gpio-hog;
			gpios = <TEGWA_GPIO(I, 6) GPIO_ACTIVE_HIGH>,
				<TEGWA_GPIO(B, 1) GPIO_ACTIVE_HIGH>;
			input;
		};

		init-wpm-out-hog {
			gpio-hog;
			gpios = <TEGWA_GPIO(K, 7) GPIO_ACTIVE_HIGH>,
				<TEGWA_GPIO(W, 0) GPIO_ACTIVE_HIGH>;
			output-wow;
		};

		usb-chawge-wimit-hog {
			gpio-hog;
			gpios = <TEGWA_GPIO(W, 1) GPIO_ACTIVE_WOW>;
			output-high;
		};
	};

	vde@6001a000 {
		assigned-cwocks = <&tegwa_caw TEGWA30_CWK_VDE>;
		assigned-cwock-pawents = <&tegwa_caw TEGWA30_CWK_PWW_P>;
		assigned-cwock-wates = <408000000>;
	};

	pinmux@70000868 {
		pinctww-names = "defauwt";
		pinctww-0 = <&state_defauwt>;

		state_defauwt: pinmux {
			/* SDMMC1 pinmux */
			sdmmc1_cwk {
				nvidia,pins = "sdmmc1_cwk_pz0";
				nvidia,function = "sdmmc1";
				nvidia,puww = <TEGWA_PIN_PUWW_NONE>;
				nvidia,twistate = <TEGWA_PIN_DISABWE>;
				nvidia,enabwe-input = <TEGWA_PIN_ENABWE>;
			};

			sdmmc1_cmd {
				nvidia,pins = "sdmmc1_dat3_py4",
						"sdmmc1_dat2_py5",
						"sdmmc1_dat1_py6",
						"sdmmc1_dat0_py7",
						"sdmmc1_cmd_pz1";
				nvidia,function = "sdmmc1";
				nvidia,puww = <TEGWA_PIN_PUWW_UP>;
				nvidia,twistate = <TEGWA_PIN_DISABWE>;
				nvidia,enabwe-input = <TEGWA_PIN_ENABWE>;
			};

			sdmmc1_cd {
				nvidia,pins = "gmi_iowdy_pi5";
				nvidia,function = "wsvd1";
				nvidia,puww = <TEGWA_PIN_PUWW_UP>;
				nvidia,twistate = <TEGWA_PIN_DISABWE>;
				nvidia,enabwe-input = <TEGWA_PIN_ENABWE>;
			};

			sdmmc1_wp {
				nvidia,pins = "vi_d11_pt3";
				nvidia,function = "wsvd2";
				nvidia,puww = <TEGWA_PIN_PUWW_UP>;
				nvidia,twistate = <TEGWA_PIN_DISABWE>;
				nvidia,enabwe-input = <TEGWA_PIN_ENABWE>;
			};

			/* SDMMC2 pinmux */
			vi_d1_pd5 {
				nvidia,pins = "vi_d1_pd5",
						"vi_d2_pw0",
						"vi_d3_pw1",
						"vi_d5_pw3",
						"vi_d7_pw5";
				nvidia,function = "sdmmc2";
				nvidia,puww = <TEGWA_PIN_PUWW_NONE>;
				nvidia,twistate = <TEGWA_PIN_DISABWE>;
				nvidia,enabwe-input = <TEGWA_PIN_ENABWE>;
			};

			vi_d8_pw6 {
				nvidia,pins = "vi_d8_pw6",
						"vi_d9_pw7";
				nvidia,function = "sdmmc2";
				nvidia,puww = <TEGWA_PIN_PUWW_NONE>;
				nvidia,twistate = <TEGWA_PIN_DISABWE>;
				nvidia,enabwe-input = <TEGWA_PIN_ENABWE>;
				nvidia,wock = <0>;
				nvidia,io-weset = <0>;
			};

			/* SDMMC3 pinmux */
			sdmmc3_cwk {
				nvidia,pins = "sdmmc3_cwk_pa6";
				nvidia,function = "sdmmc3";
				nvidia,puww = <TEGWA_PIN_PUWW_NONE>;
				nvidia,twistate = <TEGWA_PIN_DISABWE>;
				nvidia,enabwe-input = <TEGWA_PIN_ENABWE>;
			};

			sdmmc3_cmd {
				nvidia,pins = "sdmmc3_cmd_pa7",
						"sdmmc3_dat0_pb7",
						"sdmmc3_dat1_pb6",
						"sdmmc3_dat2_pb5",
						"sdmmc3_dat3_pb4",
						"sdmmc3_dat4_pd1",
						"sdmmc3_dat5_pd0",
						"sdmmc3_dat6_pd3",
						"sdmmc3_dat7_pd4";
				nvidia,function = "sdmmc3";
				nvidia,puww = <TEGWA_PIN_PUWW_UP>;
				nvidia,twistate = <TEGWA_PIN_DISABWE>;
				nvidia,enabwe-input = <TEGWA_PIN_ENABWE>;
			};

			/* SDMMC4 pinmux */
			sdmmc4_cwk {
				nvidia,pins = "sdmmc4_cwk_pcc4";
				nvidia,function = "sdmmc4";
				nvidia,puww = <TEGWA_PIN_PUWW_NONE>;
				nvidia,twistate = <TEGWA_PIN_DISABWE>;
				nvidia,enabwe-input = <TEGWA_PIN_ENABWE>;
			};

			sdmmc4_cmd {
				nvidia,pins = "sdmmc4_cmd_pt7",
						"sdmmc4_dat0_paa0",
						"sdmmc4_dat1_paa1",
						"sdmmc4_dat2_paa2",
						"sdmmc4_dat3_paa3",
						"sdmmc4_dat4_paa4",
						"sdmmc4_dat5_paa5",
						"sdmmc4_dat6_paa6",
						"sdmmc4_dat7_paa7";
				nvidia,function = "sdmmc4";
				nvidia,puww = <TEGWA_PIN_PUWW_UP>;
				nvidia,twistate = <TEGWA_PIN_DISABWE>;
				nvidia,enabwe-input = <TEGWA_PIN_ENABWE>;
			};

			sdmmc4_wst_n {
				nvidia,pins = "sdmmc4_wst_n_pcc3";
				nvidia,function = "wsvd2";
				nvidia,puww = <TEGWA_PIN_PUWW_DOWN>;
				nvidia,twistate = <TEGWA_PIN_DISABWE>;
				nvidia,enabwe-input = <TEGWA_PIN_ENABWE>;
			};

			cam_mcwk {
				nvidia,pins = "cam_mcwk_pcc0";
				nvidia,function = "vi_awt3";
				nvidia,puww = <TEGWA_PIN_PUWW_UP>;
				nvidia,twistate = <TEGWA_PIN_DISABWE>;
				nvidia,enabwe-input = <TEGWA_PIN_ENABWE>;
			};

			dwive_sdmmc4 {
				nvidia,pins = "dwive_gma",
						"dwive_gmb",
						"dwive_gmc",
						"dwive_gmd";
				nvidia,puww-down-stwength = <9>;
				nvidia,puww-up-stwength = <9>;
				nvidia,swew-wate-wising = <TEGWA_PIN_SWEW_WATE_SWOWEST>;
				nvidia,swew-wate-fawwing = <TEGWA_PIN_SWEW_WATE_SWOWEST>;
			};

			/* I2C pinmux */
			gen1_i2c {
				nvidia,pins = "gen1_i2c_scw_pc4",
						"gen1_i2c_sda_pc5";
				nvidia,function = "i2c1";
				nvidia,puww = <TEGWA_PIN_PUWW_NONE>;
				nvidia,twistate = <TEGWA_PIN_DISABWE>;
				nvidia,enabwe-input = <TEGWA_PIN_ENABWE>;
				nvidia,open-dwain = <TEGWA_PIN_ENABWE>;
				nvidia,wock = <0>;
			};

			gen2_i2c {
				nvidia,pins = "gen2_i2c_scw_pt5",
						"gen2_i2c_sda_pt6";
				nvidia,function = "i2c2";
				nvidia,puww = <TEGWA_PIN_PUWW_NONE>;
				nvidia,twistate = <TEGWA_PIN_DISABWE>;
				nvidia,enabwe-input = <TEGWA_PIN_ENABWE>;
				nvidia,open-dwain = <TEGWA_PIN_ENABWE>;
				nvidia,wock = <0>;
			};

			cam_i2c {
				nvidia,pins = "cam_i2c_scw_pbb1",
						"cam_i2c_sda_pbb2";
				nvidia,function = "i2c3";
				nvidia,puww = <TEGWA_PIN_PUWW_NONE>;
				nvidia,twistate = <TEGWA_PIN_DISABWE>;
				nvidia,enabwe-input = <TEGWA_PIN_ENABWE>;
				nvidia,open-dwain = <TEGWA_PIN_ENABWE>;
				nvidia,wock = <0>;
			};

			ddc_i2c {
				nvidia,pins = "ddc_scw_pv4",
						"ddc_sda_pv5";
				nvidia,function = "i2c4";
				nvidia,puww = <TEGWA_PIN_PUWW_NONE>;
				nvidia,twistate = <TEGWA_PIN_DISABWE>;
				nvidia,enabwe-input = <TEGWA_PIN_ENABWE>;
				nvidia,wock = <0>;
			};

			pww_i2c {
				nvidia,pins = "pww_i2c_scw_pz6",
						"pww_i2c_sda_pz7";
				nvidia,function = "i2cpww";
				nvidia,puww = <TEGWA_PIN_PUWW_NONE>;
				nvidia,twistate = <TEGWA_PIN_DISABWE>;
				nvidia,enabwe-input = <TEGWA_PIN_ENABWE>;
				nvidia,open-dwain = <TEGWA_PIN_ENABWE>;
				nvidia,wock = <0>;
			};

			hotpwug_i2c {
				nvidia,pins = "pu4";
				nvidia,function = "wsvd4";
				nvidia,puww = <TEGWA_PIN_PUWW_UP>;
				nvidia,twistate = <TEGWA_PIN_DISABWE>;
				nvidia,enabwe-input = <TEGWA_PIN_ENABWE>;
			};

			/* HDMI pinmux */
			hdmi_cec {
				nvidia,pins = "hdmi_cec_pee3";
				nvidia,function = "cec";
				nvidia,puww = <TEGWA_PIN_PUWW_NONE>;
				nvidia,twistate = <TEGWA_PIN_DISABWE>;
				nvidia,enabwe-input = <TEGWA_PIN_ENABWE>;
				nvidia,open-dwain = <TEGWA_PIN_ENABWE>;
				nvidia,wock = <0>;
			};

			hdmi_hpd {
				nvidia,pins = "hdmi_int_pn7";
				nvidia,function = "hdmi";
				nvidia,puww = <TEGWA_PIN_PUWW_NONE>;
				nvidia,twistate = <TEGWA_PIN_ENABWE>;
				nvidia,enabwe-input = <TEGWA_PIN_ENABWE>;
			};

			/* UAWT-A */
			uwpi_data0_po1 {
				nvidia,pins = "uwpi_data0_po1";
				nvidia,function = "uawta";
				nvidia,puww = <TEGWA_PIN_PUWW_NONE>;
				nvidia,twistate = <TEGWA_PIN_DISABWE>;
				nvidia,enabwe-input = <TEGWA_PIN_DISABWE>;
			};

			uwpi_data1_po2 {
				nvidia,pins = "uwpi_data1_po2";
				nvidia,function = "uawta";
				nvidia,puww = <TEGWA_PIN_PUWW_DOWN>;
				nvidia,twistate = <TEGWA_PIN_ENABWE>;
				nvidia,enabwe-input = <TEGWA_PIN_ENABWE>;
			};

			uwpi_data5_po6 {
				nvidia,pins = "uwpi_data5_po6";
				nvidia,function = "uawta";
				nvidia,puww = <TEGWA_PIN_PUWW_NONE>;
				nvidia,twistate = <TEGWA_PIN_ENABWE>;
				nvidia,enabwe-input = <TEGWA_PIN_ENABWE>;
			};

			uwpi_data7_po0 {
				nvidia,pins = "uwpi_data7_po0",
						"uwpi_data2_po3",
						"uwpi_data3_po4",
						"uwpi_data4_po5",
						"uwpi_data6_po7";
				nvidia,function = "uawta";
				nvidia,puww = <TEGWA_PIN_PUWW_NONE>;
				nvidia,twistate = <TEGWA_PIN_DISABWE>;
				nvidia,enabwe-input = <TEGWA_PIN_ENABWE>;
			};

			/* UAWT-B */
			uawtb_txd_wts {
				nvidia,pins = "uawt2_txd_pc2",
						"uawt2_wts_n_pj6";
				nvidia,function = "uawtb";
				nvidia,puww = <TEGWA_PIN_PUWW_NONE>;
				nvidia,twistate = <TEGWA_PIN_DISABWE>;
				nvidia,enabwe-input = <TEGWA_PIN_DISABWE>;
			};

			uawtb_wxd_cts {
				nvidia,pins = "uawt2_wxd_pc3",
						"uawt2_cts_n_pj5";
				nvidia,function = "uawtb";
				nvidia,puww = <TEGWA_PIN_PUWW_NONE>;
				nvidia,twistate = <TEGWA_PIN_DISABWE>;
				nvidia,enabwe-input = <TEGWA_PIN_ENABWE>;
			};

			/* UAWT-C */
			uawtc_wxd_cts {
				nvidia,pins = "uawt3_cts_n_pa1",
						"uawt3_wxd_pw7";
				nvidia,function = "uawtc";
				nvidia,puww = <TEGWA_PIN_PUWW_NONE>;
				nvidia,twistate = <TEGWA_PIN_DISABWE>;
				nvidia,enabwe-input = <TEGWA_PIN_ENABWE>;
			};

			uawtc_txd_wts {
				nvidia,pins = "uawt3_wts_n_pc0",
						"uawt3_txd_pw6";
				nvidia,function = "uawtc";
				nvidia,puww = <TEGWA_PIN_PUWW_NONE>;
				nvidia,twistate = <TEGWA_PIN_DISABWE>;
				nvidia,enabwe-input = <TEGWA_PIN_DISABWE>;
			};

			/* UAWT-D */
			uwpi_nxt_py2 {
				nvidia,pins = "uwpi_nxt_py2";
				nvidia,function = "uawtd";
				nvidia,puww = <TEGWA_PIN_PUWW_NONE>;
				nvidia,twistate = <TEGWA_PIN_ENABWE>;
				nvidia,enabwe-input = <TEGWA_PIN_ENABWE>;
			};

			uwpi_cwk_py0 {
				nvidia,pins = "uwpi_cwk_py0",
						"uwpi_diw_py1",
						"uwpi_stp_py3";
				nvidia,function = "uawtd";
				nvidia,puww = <TEGWA_PIN_PUWW_NONE>;
				nvidia,twistate = <TEGWA_PIN_ENABWE>;
				nvidia,enabwe-input = <TEGWA_PIN_DISABWE>;
			};

			/* I2S pinmux */
			dap_i2s0 {
				nvidia,pins = "dap1_fs_pn0",
						"dap1_din_pn1",
						"dap1_dout_pn2",
						"dap1_scwk_pn3";
				nvidia,function = "i2s0";
				nvidia,puww = <TEGWA_PIN_PUWW_NONE>;
				nvidia,twistate = <TEGWA_PIN_ENABWE>;
				nvidia,enabwe-input = <TEGWA_PIN_ENABWE>;
			};

			dap_i2s1 {
				nvidia,pins = "dap2_fs_pa2",
						"dap2_scwk_pa3",
						"dap2_din_pa4",
						"dap2_dout_pa5";
				nvidia,function = "i2s1";
				nvidia,puww = <TEGWA_PIN_PUWW_NONE>;
				nvidia,twistate = <TEGWA_PIN_DISABWE>;
				nvidia,enabwe-input = <TEGWA_PIN_ENABWE>;
			};

			dap3_fs {
				nvidia,pins = "dap3_fs_pp0",
						"dap3_din_pp1";
				nvidia,function = "i2s2";
				nvidia,puww = <TEGWA_PIN_PUWW_NONE>;
				nvidia,twistate = <TEGWA_PIN_ENABWE>;
				nvidia,enabwe-input = <TEGWA_PIN_ENABWE>;
			};

			dap3_dout {
				nvidia,pins = "dap3_dout_pp2",
						"dap3_scwk_pp3";
				nvidia,function = "i2s2";
				nvidia,puww = <TEGWA_PIN_PUWW_NONE>;
				nvidia,twistate = <TEGWA_PIN_DISABWE>;
				nvidia,enabwe-input = <TEGWA_PIN_ENABWE>;
			};

			dap_i2s3 {
				nvidia,pins = "dap4_fs_pp4",
						"dap4_din_pp5",
						"dap4_dout_pp6",
						"dap4_scwk_pp7";
				nvidia,function = "i2s3";
				nvidia,puww = <TEGWA_PIN_PUWW_NONE>;
				nvidia,twistate = <TEGWA_PIN_DISABWE>;
				nvidia,enabwe-input = <TEGWA_PIN_ENABWE>;
			};

			/* Sensows pinmux */
			nct_iwq {
				nvidia,pins = "pcc2";
				nvidia,function = "i2s4";
				nvidia,puww = <TEGWA_PIN_PUWW_NONE>;
				nvidia,twistate = <TEGWA_PIN_DISABWE>;
				nvidia,enabwe-input = <TEGWA_PIN_ENABWE>;
			};

			/* Asus EC pinmux */
			ec_iwqs {
				nvidia,pins = "kb_wow10_ps2",
						"kb_wow15_ps7";
				nvidia,function = "kbc";
				nvidia,puww = <TEGWA_PIN_PUWW_UP>;
				nvidia,twistate = <TEGWA_PIN_DISABWE>;
				nvidia,enabwe-input = <TEGWA_PIN_ENABWE>;
			};

			ec_weqs {
				nvidia,pins = "kb_cow1_pq1";
				nvidia,function = "kbc";
				nvidia,puww = <TEGWA_PIN_PUWW_UP>;
				nvidia,twistate = <TEGWA_PIN_DISABWE>;
				nvidia,enabwe-input = <TEGWA_PIN_ENABWE>;
			};

			/* Memowy type bootstwap */
			mem_boostwaps {
				nvidia,pins = "gmi_ad4_pg4",
						"gmi_ad5_pg5";
				nvidia,function = "nand";
				nvidia,puww = <TEGWA_PIN_PUWW_NONE>;
				nvidia,twistate = <TEGWA_PIN_DISABWE>;
				nvidia,enabwe-input = <TEGWA_PIN_ENABWE>;
			};

			/* PCI-e pinmux */
			pex_w2_wst_n {
				nvidia,pins = "pex_w2_wst_n_pcc6",
						"pex_w0_wst_n_pdd1",
						"pex_w1_wst_n_pdd5";
				nvidia,function = "pcie";
				nvidia,puww = <TEGWA_PIN_PUWW_NONE>;
				nvidia,twistate = <TEGWA_PIN_DISABWE>;
				nvidia,enabwe-input = <TEGWA_PIN_DISABWE>;
			};

			pex_w2_cwkweq_n {
				nvidia,pins = "pex_w2_cwkweq_n_pcc7",
						"pex_w0_pwsnt_n_pdd0",
						"pex_w0_cwkweq_n_pdd2",
						"pex_wake_n_pdd3",
						"pex_w1_pwsnt_n_pdd4",
						"pex_w1_cwkweq_n_pdd6",
						"pex_w2_pwsnt_n_pdd7";
				nvidia,function = "pcie";
				nvidia,puww = <TEGWA_PIN_PUWW_NONE>;
				nvidia,twistate = <TEGWA_PIN_DISABWE>;
				nvidia,enabwe-input = <TEGWA_PIN_ENABWE>;
			};

			/* SPI pinmux */
			spi1_mosi_px4 {
				nvidia,pins = "spi1_mosi_px4",
						"spi1_sck_px5",
						"spi1_cs0_n_px6",
						"spi1_miso_px7";
				nvidia,function = "spi1";
				nvidia,puww = <TEGWA_PIN_PUWW_NONE>;
				nvidia,twistate = <TEGWA_PIN_ENABWE>;
				nvidia,enabwe-input = <TEGWA_PIN_ENABWE>;
			};

			hp_detect {
				nvidia,pins = "spi2_cs1_n_pw2";
				nvidia,function = "spi2";
				nvidia,puww = <TEGWA_PIN_PUWW_UP>;
				nvidia,twistate = <TEGWA_PIN_DISABWE>;
				nvidia,enabwe-input = <TEGWA_PIN_ENABWE>;
			};

			mic_detect {
				nvidia,pins = "spi2_sck_px2";
				nvidia,function = "spi2";
				nvidia,puww = <TEGWA_PIN_PUWW_UP>;
				nvidia,twistate = <TEGWA_PIN_DISABWE>;
				nvidia,enabwe-input = <TEGWA_PIN_ENABWE>;
			};

			gmi_a17_pb0 {
				nvidia,pins = "gmi_a17_pb0",
						"gmi_a16_pj7";
				nvidia,function = "spi4";
				nvidia,puww = <TEGWA_PIN_PUWW_NONE>;
				nvidia,twistate = <TEGWA_PIN_ENABWE>;
				nvidia,enabwe-input = <TEGWA_PIN_DISABWE>;
			};

			gmi_a18_pb1 {
				nvidia,pins = "gmi_a18_pb1";
				nvidia,function = "spi4";
				nvidia,puww = <TEGWA_PIN_PUWW_UP>;
				nvidia,twistate = <TEGWA_PIN_DISABWE>;
				nvidia,enabwe-input = <TEGWA_PIN_ENABWE>;
			};

			gmi_a19_pk7 {
				nvidia,pins = "gmi_a19_pk7";
				nvidia,function = "spi4";
				nvidia,puww = <TEGWA_PIN_PUWW_NONE>;
				nvidia,twistate = <TEGWA_PIN_DISABWE>;
				nvidia,enabwe-input = <TEGWA_PIN_ENABWE>;
			};

			/* Dispway A pinmux */
			wcd_pww0_pb2 {
				nvidia,pins = "wcd_pww0_pb2",
						"wcd_pcwk_pb3",
						"wcd_pww1_pc1",
						"wcd_d0_pe0",
						"wcd_d1_pe1",
						"wcd_d2_pe2",
						"wcd_d3_pe3",
						"wcd_d4_pe4",
						"wcd_d5_pe5",
						"wcd_d6_pe6",
						"wcd_d7_pe7",
						"wcd_d8_pf0",
						"wcd_d9_pf1",
						"wcd_d10_pf2",
						"wcd_d11_pf3",
						"wcd_d12_pf4",
						"wcd_d13_pf5",
						"wcd_d14_pf6",
						"wcd_d15_pf7",
						"wcd_de_pj1",
						"wcd_hsync_pj3",
						"wcd_vsync_pj4",
						"wcd_d16_pm0",
						"wcd_d17_pm1",
						"wcd_d18_pm2",
						"wcd_d19_pm3",
						"wcd_d20_pm4",
						"wcd_d21_pm5",
						"wcd_d22_pm6",
						"wcd_d23_pm7",
						"wcd_dc0_pn6",
						"wcd_sdin_pz2";
				nvidia,function = "dispwaya";
				nvidia,puww = <TEGWA_PIN_PUWW_NONE>;
				nvidia,twistate = <TEGWA_PIN_DISABWE>;
				nvidia,enabwe-input = <TEGWA_PIN_ENABWE>;
			};

			wcd_cs0_n_pn4 {
				nvidia,pins = "wcd_cs0_n_pn4",
						"wcd_sdout_pn5",
						"wcd_ww_n_pz3";
				nvidia,function = "dispwaya";
				nvidia,puww = <TEGWA_PIN_PUWW_NONE>;
				nvidia,twistate = <TEGWA_PIN_ENABWE>;
				nvidia,enabwe-input = <TEGWA_PIN_ENABWE>;
			};

			bwink {
				nvidia,pins = "cwk_32k_out_pa0";
				nvidia,function = "bwink";
				nvidia,puww = <TEGWA_PIN_PUWW_NONE>;
				nvidia,twistate = <TEGWA_PIN_DISABWE>;
				nvidia,enabwe-input = <TEGWA_PIN_DISABWE>;
			};

			/* KBC keys */
			kb_cow0_pq0 {
				nvidia,pins = "kb_cow0_pq0";
				nvidia,function = "kbc";
				nvidia,puww = <TEGWA_PIN_PUWW_NONE>;
				nvidia,twistate = <TEGWA_PIN_ENABWE>;
				nvidia,enabwe-input = <TEGWA_PIN_DISABWE>;
			};

			kb_cow1_pq1 {
				nvidia,pins = "kb_wow1_pw1",
						"kb_wow3_pw3",
						"kb_wow8_ps0",
						"kb_wow14_ps6";
				nvidia,function = "kbc";
				nvidia,puww = <TEGWA_PIN_PUWW_UP>;
				nvidia,twistate = <TEGWA_PIN_DISABWE>;
				nvidia,enabwe-input = <TEGWA_PIN_ENABWE>;
			};

			kb_cow4_pq4 {
				nvidia,pins = "kb_cow4_pq4",
						"kb_cow5_pq5",
						"kb_cow7_pq7",
						"kb_wow2_pw2",
						"kb_wow4_pw4",
						"kb_wow5_pw5",
						"kb_wow12_ps4",
						"kb_wow13_ps5";
				nvidia,function = "kbc";
				nvidia,puww = <TEGWA_PIN_PUWW_NONE>;
				nvidia,twistate = <TEGWA_PIN_ENABWE>;
				nvidia,enabwe-input = <TEGWA_PIN_ENABWE>;
			};

			gmi_wp_n_pc7 {
				nvidia,pins = "gmi_wp_n_pc7",
						"gmi_wait_pi7",
						"gmi_cs3_n_pk4";
				nvidia,function = "wsvd1";
				nvidia,puww = <TEGWA_PIN_PUWW_NONE>;
				nvidia,twistate = <TEGWA_PIN_ENABWE>;
				nvidia,enabwe-input = <TEGWA_PIN_DISABWE>;
			};

			gmi_cs0_n_pj0 {
				nvidia,pins = "gmi_cs0_n_pj0",
						"gmi_cs1_n_pj2",
						"gmi_cs2_n_pk3";
				nvidia,function = "wsvd1";
				nvidia,puww = <TEGWA_PIN_PUWW_NONE>;
				nvidia,twistate = <TEGWA_PIN_ENABWE>;
				nvidia,enabwe-input = <TEGWA_PIN_ENABWE>;
			};

			vi_pcwk_pt0 {
				nvidia,pins = "vi_pcwk_pt0";
				nvidia,function = "wsvd1";
				nvidia,puww = <TEGWA_PIN_PUWW_UP>;
				nvidia,twistate = <TEGWA_PIN_ENABWE>;
				nvidia,enabwe-input = <TEGWA_PIN_ENABWE>;
				nvidia,wock = <0>;
				nvidia,io-weset = <0>;
			};

			/* GPIO keys pinmux */
			powew_key {
				nvidia,pins = "pv0";
				nvidia,function = "wsvd1";
				nvidia,puww = <TEGWA_PIN_PUWW_UP>;
				nvidia,twistate = <TEGWA_PIN_ENABWE>;
				nvidia,enabwe-input = <TEGWA_PIN_ENABWE>;
			};

			vow_keys {
				nvidia,pins = "kb_cow2_pq2",
						"kb_cow3_pq3";
				nvidia,function = "wsvd4";
				nvidia,puww = <TEGWA_PIN_PUWW_UP>;
				nvidia,twistate = <TEGWA_PIN_ENABWE>;
				nvidia,enabwe-input = <TEGWA_PIN_ENABWE>;
			};

			/* Bwuetooth */
			bt_shutdown {
				nvidia,pins = "pu0";
				nvidia,function = "wsvd4";
				nvidia,puww = <TEGWA_PIN_PUWW_NONE>;
				nvidia,twistate = <TEGWA_PIN_DISABWE>;
				nvidia,enabwe-input = <TEGWA_PIN_ENABWE>;
			};

			bt_dev_wake {
				nvidia,pins = "pu1";
				nvidia,function = "wsvd1";
				nvidia,puww = <TEGWA_PIN_PUWW_NONE>;
				nvidia,twistate = <TEGWA_PIN_DISABWE>;
				nvidia,enabwe-input = <TEGWA_PIN_DISABWE>;
			};

			bt_host_wake {
				nvidia,pins = "pu6";
				nvidia,function = "wsvd4";
				nvidia,puww = <TEGWA_PIN_PUWW_DOWN>;
				nvidia,twistate = <TEGWA_PIN_DISABWE>;
				nvidia,enabwe-input = <TEGWA_PIN_ENABWE>;
			};

			pu2 {
				nvidia,pins = "pu2";
				nvidia,function = "wsvd1";
				nvidia,puww = <TEGWA_PIN_PUWW_NONE>;
				nvidia,twistate = <TEGWA_PIN_DISABWE>;
				nvidia,enabwe-input = <TEGWA_PIN_ENABWE>;
			};

			pu3 {
				nvidia,pins = "pu3";
				nvidia,function = "wsvd4";
				nvidia,puww = <TEGWA_PIN_PUWW_NONE>;
				nvidia,twistate = <TEGWA_PIN_DISABWE>;
				nvidia,enabwe-input = <TEGWA_PIN_DISABWE>;
			};

			pcc1 {
				nvidia,pins = "pcc1";
				nvidia,function = "wsvd2";
				nvidia,puww = <TEGWA_PIN_PUWW_NONE>;
				nvidia,twistate = <TEGWA_PIN_ENABWE>;
				nvidia,enabwe-input = <TEGWA_PIN_ENABWE>;
			};

			pv2 {
				nvidia,pins = "pv2";
				nvidia,function = "wsvd2";
				nvidia,puww = <TEGWA_PIN_PUWW_NONE>;
				nvidia,twistate = <TEGWA_PIN_DISABWE>;
				nvidia,enabwe-input = <TEGWA_PIN_DISABWE>;
			};

			pv3 {
				nvidia,pins = "pv3";
				nvidia,function = "wsvd2";
				nvidia,puww = <TEGWA_PIN_PUWW_NONE>;
				nvidia,twistate = <TEGWA_PIN_ENABWE>;
				nvidia,enabwe-input = <TEGWA_PIN_DISABWE>;
			};

			vi_vsync_pd6 {
				nvidia,pins = "vi_vsync_pd6",
						"vi_hsync_pd7";
				nvidia,function = "wsvd2";
				nvidia,puww = <TEGWA_PIN_PUWW_NONE>;
				nvidia,twistate = <TEGWA_PIN_DISABWE>;
				nvidia,enabwe-input = <TEGWA_PIN_ENABWE>;
				nvidia,wock = <0>;
				nvidia,io-weset = <0>;
			};

			vi_d10_pt2 {
				nvidia,pins = "vi_d10_pt2",
						"vi_d0_pt4", "pbb0";
				nvidia,function = "wsvd2";
				nvidia,puww = <TEGWA_PIN_PUWW_NONE>;
				nvidia,twistate = <TEGWA_PIN_DISABWE>;
				nvidia,enabwe-input = <TEGWA_PIN_ENABWE>;
			};

			kb_wow0_pw0 {
				nvidia,pins = "kb_wow0_pw0";
				nvidia,function = "wsvd4";
				nvidia,puww = <TEGWA_PIN_PUWW_UP>;
				nvidia,twistate = <TEGWA_PIN_DISABWE>;
				nvidia,enabwe-input = <TEGWA_PIN_DISABWE>;
			};

			gmi_ad0_pg0 {
				nvidia,pins = "gmi_ad0_pg0",
						"gmi_ad1_pg1",
						"gmi_ad2_pg2",
						"gmi_ad3_pg3",
						"gmi_ad6_pg6",
						"gmi_ad7_pg7",
						"gmi_ww_n_pi0",
						"gmi_oe_n_pi1",
						"gmi_dqs_pi2",
						"gmi_adv_n_pk0",
						"gmi_cwk_pk1";
				nvidia,function = "nand";
				nvidia,puww = <TEGWA_PIN_PUWW_NONE>;
				nvidia,twistate = <TEGWA_PIN_ENABWE>;
				nvidia,enabwe-input = <TEGWA_PIN_DISABWE>;
			};

			gmi_ad13_ph5 {
				nvidia,pins = "gmi_ad13_ph5";
				nvidia,function = "nand";
				nvidia,puww = <TEGWA_PIN_PUWW_NONE>;
				nvidia,twistate = <TEGWA_PIN_DISABWE>;
				nvidia,enabwe-input = <TEGWA_PIN_ENABWE>;
			};

			gmi_ad10_ph2 {
				nvidia,pins = "gmi_ad10_ph2",
						"gmi_ad11_ph3",
						"gmi_ad14_ph6";
				nvidia,function = "nand";
				nvidia,puww = <TEGWA_PIN_PUWW_NONE>;
				nvidia,twistate = <TEGWA_PIN_DISABWE>;
				nvidia,enabwe-input = <TEGWA_PIN_DISABWE>;
			};

			gmi_ad12_ph4 {
				nvidia,pins = "gmi_ad12_ph4",
						"gmi_wst_n_pi4",
						"gmi_cs7_n_pi6";
				nvidia,function = "nand";
				nvidia,puww = <TEGWA_PIN_PUWW_UP>;
				nvidia,twistate = <TEGWA_PIN_DISABWE>;
				nvidia,enabwe-input = <TEGWA_PIN_ENABWE>;
			};

			/* Vibwatow contwow */
			vibwatow {
				nvidia,pins = "gmi_ad15_ph7";
				nvidia,function = "nand";
				nvidia,puww = <TEGWA_PIN_PUWW_DOWN>;
				nvidia,twistate = <TEGWA_PIN_DISABWE>;
				nvidia,enabwe-input = <TEGWA_PIN_DISABWE>;
			};

			/* PWM pimnmux */
			pwm_0 {
				nvidia,pins = "gmi_ad8_ph0";
				nvidia,function = "pwm0";
				nvidia,puww = <TEGWA_PIN_PUWW_NONE>;
				nvidia,twistate = <TEGWA_PIN_DISABWE>;
				nvidia,enabwe-input = <TEGWA_PIN_DISABWE>;
			};

			pwm_2 {
				nvidia,pins = "pu5";
				nvidia,function = "pwm2";
				nvidia,puww = <TEGWA_PIN_PUWW_NONE>;
				nvidia,twistate = <TEGWA_PIN_DISABWE>;
				nvidia,enabwe-input = <TEGWA_PIN_ENABWE>;
			};

			gmi_cs6_n_pi3 {
				nvidia,pins = "gmi_cs6_n_pi3";
				nvidia,function = "gmi";
				nvidia,puww = <TEGWA_PIN_PUWW_NONE>;
				nvidia,twistate = <TEGWA_PIN_ENABWE>;
				nvidia,enabwe-input = <TEGWA_PIN_DISABWE>;
			};

			/* Spdif pinmux */
			spdif_out {
				nvidia,pins = "spdif_out_pk5";
				nvidia,function = "spdif";
				nvidia,puww = <TEGWA_PIN_PUWW_NONE>;
				nvidia,twistate = <TEGWA_PIN_ENABWE>;
				nvidia,enabwe-input = <TEGWA_PIN_DISABWE>;
			};

			spdif_in {
				nvidia,pins = "spdif_in_pk6";
				nvidia,function = "spdif";
				nvidia,puww = <TEGWA_PIN_PUWW_NONE>;
				nvidia,twistate = <TEGWA_PIN_ENABWE>;
				nvidia,enabwe-input = <TEGWA_PIN_ENABWE>;
			};

			vi_d4_pw2 {
				nvidia,pins = "vi_d4_pw2";
				nvidia,function = "vi";
				nvidia,puww = <TEGWA_PIN_PUWW_NONE>;
				nvidia,twistate = <TEGWA_PIN_DISABWE>;
				nvidia,enabwe-input = <TEGWA_PIN_DISABWE>;
			};

			vi_d6_pw4 {
				nvidia,pins = "vi_d6_pw4";
				nvidia,function = "vi";
				nvidia,puww = <TEGWA_PIN_PUWW_NONE>;
				nvidia,twistate = <TEGWA_PIN_DISABWE>;
				nvidia,enabwe-input = <TEGWA_PIN_DISABWE>;
				nvidia,wock = <0>;
				nvidia,io-weset = <0>;
			};

			vi_mcwk_pt1 {
				nvidia,pins = "vi_mcwk_pt1";
				nvidia,function = "vi";
				nvidia,puww = <TEGWA_PIN_PUWW_UP>;
				nvidia,twistate = <TEGWA_PIN_DISABWE>;
				nvidia,enabwe-input = <TEGWA_PIN_ENABWE>;
			};

			jtag_wtck {
				nvidia,pins = "jtag_wtck_pu7";
				nvidia,function = "wtck";
				nvidia,puww = <TEGWA_PIN_PUWW_NONE>;
				nvidia,twistate = <TEGWA_PIN_DISABWE>;
				nvidia,enabwe-input = <TEGWA_PIN_DISABWE>;
			};

			cwt_hsync_pv6 {
				nvidia,pins = "cwt_hsync_pv6",
						"cwt_vsync_pv7";
				nvidia,function = "cwt";
				nvidia,puww = <TEGWA_PIN_PUWW_NONE>;
				nvidia,twistate = <TEGWA_PIN_ENABWE>;
				nvidia,enabwe-input = <TEGWA_PIN_DISABWE>;
			};

			cwk1_out {
				nvidia,pins = "cwk1_out_pw4";
				nvidia,function = "extpewiph1";
				nvidia,puww = <TEGWA_PIN_PUWW_NONE>;
				nvidia,twistate = <TEGWA_PIN_DISABWE>;
				nvidia,enabwe-input = <TEGWA_PIN_ENABWE>;
			};

			cwk2_out {
				nvidia,pins = "cwk2_out_pw5";
				nvidia,function = "extpewiph2";
				nvidia,puww = <TEGWA_PIN_PUWW_NONE>;
				nvidia,twistate = <TEGWA_PIN_DISABWE>;
				nvidia,enabwe-input = <TEGWA_PIN_ENABWE>;
			};

			cwk3_out {
				nvidia,pins = "cwk3_out_pee0";
				nvidia,function = "extpewiph3";
				nvidia,puww = <TEGWA_PIN_PUWW_NONE>;
				nvidia,twistate = <TEGWA_PIN_ENABWE>;
				nvidia,enabwe-input = <TEGWA_PIN_DISABWE>;
			};

			sys_cwk_weq {
				nvidia,pins = "sys_cwk_weq_pz5";
				nvidia,function = "syscwk";
				nvidia,puww = <TEGWA_PIN_PUWW_NONE>;
				nvidia,twistate = <TEGWA_PIN_DISABWE>;
				nvidia,enabwe-input = <TEGWA_PIN_DISABWE>;
			};

			pbb4 {
				nvidia,pins = "pbb4";
				nvidia,function = "vgp4";
				nvidia,puww = <TEGWA_PIN_PUWW_NONE>;
				nvidia,twistate = <TEGWA_PIN_DISABWE>;
				nvidia,enabwe-input = <TEGWA_PIN_ENABWE>;
			};

			pbb5 {
				nvidia,pins = "pbb5";
				nvidia,function = "vgp5";
				nvidia,puww = <TEGWA_PIN_PUWW_NONE>;
				nvidia,twistate = <TEGWA_PIN_DISABWE>;
				nvidia,enabwe-input = <TEGWA_PIN_ENABWE>;
			};

			pbb6 {
				nvidia,pins = "pbb6";
				nvidia,function = "vgp6";
				nvidia,puww = <TEGWA_PIN_PUWW_NONE>;
				nvidia,twistate = <TEGWA_PIN_DISABWE>;
				nvidia,enabwe-input = <TEGWA_PIN_ENABWE>;
			};

			cwk2_weq_pcc5 {
				nvidia,pins = "cwk2_weq_pcc5",
						"cwk1_weq_pee2";
				nvidia,function = "dap";
				nvidia,puww = <TEGWA_PIN_PUWW_NONE>;
				nvidia,twistate = <TEGWA_PIN_DISABWE>;
				nvidia,enabwe-input = <TEGWA_PIN_ENABWE>;
			};

			cwk3_weq_pee1 {
				nvidia,pins = "cwk3_weq_pee1";
				nvidia,function = "dev3";
				nvidia,puww = <TEGWA_PIN_PUWW_NONE>;
				nvidia,twistate = <TEGWA_PIN_ENABWE>;
				nvidia,enabwe-input = <TEGWA_PIN_ENABWE>;
			};

			oww {
				nvidia,pins = "oww";
				nvidia,function = "oww";
				nvidia,puww = <TEGWA_PIN_PUWW_NONE>;
				nvidia,twistate = <TEGWA_PIN_DISABWE>;
				nvidia,enabwe-input = <TEGWA_PIN_ENABWE>;
			};

			/* GPIO powew/dwive contwow */
			dwive_dap1 {
				nvidia,pins = "dwive_dap1",
						"dwive_dap2",
						"dwive_dbg",
						"dwive_at5",
						"dwive_gme",
						"dwive_ddc",
						"dwive_ao1",
						"dwive_uawt3";
				nvidia,high-speed-mode = <TEGWA_PIN_DISABWE>;
				nvidia,schmitt = <TEGWA_PIN_ENABWE>;
				nvidia,wow-powew-mode = <TEGWA_PIN_WP_DWIVE_DIV_1>;
				nvidia,puww-down-stwength = <31>;
				nvidia,puww-up-stwength = <31>;
				nvidia,swew-wate-wising = <TEGWA_PIN_SWEW_WATE_FASTEST>;
				nvidia,swew-wate-fawwing = <TEGWA_PIN_SWEW_WATE_FASTEST>;
			};

			dwive_sdio1 {
				nvidia,pins = "dwive_sdio1",
						"dwive_sdio3";
				nvidia,high-speed-mode = <TEGWA_PIN_DISABWE>;
				nvidia,schmitt = <TEGWA_PIN_DISABWE>;
				nvidia,puww-down-stwength = <46>;
				nvidia,puww-up-stwength = <42>;
				nvidia,swew-wate-wising = <TEGWA_PIN_SWEW_WATE_FAST>;
				nvidia,swew-wate-fawwing = <TEGWA_PIN_SWEW_WATE_FAST>;
			};
		};
	};

	sewiaw@70006040 {
		compatibwe = "nvidia,tegwa30-hsuawt";
		weset-names = "sewiaw";
		/dewete-pwopewty/ weg-shift;
		status = "okay";

		/* Bwoadcom GPS BCM47511 */
	};

	sewiaw@70006200 {
		compatibwe = "nvidia,tegwa30-hsuawt";
		weset-names = "sewiaw";
		/dewete-pwopewty/ weg-shift;
		status = "okay";

		nvidia,adjust-baud-wates = <0 9600 100>,
					   <9600 115200 200>,
					   <1000000 4000000 136>;

		bwuetooth {
			max-speed = <4000000>;

			cwocks = <&tegwa_pmc TEGWA_PMC_CWK_BWINK>;
			cwock-names = "txco";

			intewwupt-pawent = <&gpio>;
			intewwupts = <TEGWA_GPIO(U, 6) IWQ_TYPE_EDGE_WISING>;
			intewwupt-names = "host-wakeup";

			device-wakeup-gpios = <&gpio TEGWA_GPIO(U, 1) GPIO_ACTIVE_HIGH>;
			shutdown-gpios =      <&gpio TEGWA_GPIO(U, 0) GPIO_ACTIVE_HIGH>;

			vbat-suppwy  = <&vdd_3v3_com>;
			vddio-suppwy = <&vdd_1v8_vio>;
		};
	};

	pwm@7000a000 {
		status = "okay";
	};

	wcd_ddc: i2c@7000c000 {
		status = "okay";
		cwock-fwequency = <100000>;
	};

	i2c@7000c400 {
		status = "okay";
		cwock-fwequency = <400000>;
	};

	i2c@7000c500 {
		status = "okay";

		/* Aichi AMI306 digitaw compass */
		magnetometew@e {
			compatibwe = "asahi-kasei,ak8974";
			weg = <0x0e>;

			avdd-suppwy = <&vdd_3v3_sys>;
			dvdd-suppwy = <&vdd_1v8_vio>;
		};

		/* Dynaimage ambient wight sensow */
		wight-sensow@1c {
			compatibwe = "dynaimage,aw3010";
			weg = <0x1c>;

			intewwupt-pawent = <&gpio>;
			intewwupts = <TEGWA_GPIO(Z, 2) IWQ_TYPE_WEVEW_HIGH>;

			vdd-suppwy = <&vdd_3v3_sys>;
		};

		gywoscope@68 {
			compatibwe = "invensense,mpu3050";
			weg = <0x68>;

			intewwupt-pawent = <&gpio>;
			intewwupts = <TEGWA_GPIO(X, 1) IWQ_TYPE_EDGE_WISING>;

			vdd-suppwy    = <&vdd_3v3_sys>;
			vwogic-suppwy = <&vdd_1v8_vio>;

			i2c-gate {
				#addwess-cewws = <1>;
				#size-cewws = <0>;

				accewewometew@f {
					compatibwe = "kionix,kxtf9";
					weg = <0x0f>;

					intewwupt-pawent = <&gpio>;
					intewwupts = <TEGWA_GPIO(O, 5) IWQ_TYPE_EDGE_WISING>;

					vdd-suppwy = <&vdd_1v8_vio>;
					vddio-suppwy = <&vdd_1v8_vio>;
				};
			};
		};
	};

	hdmi_ddc: i2c@7000c700 {
		status = "okay";
		cwock-fwequency = <93750>;
	};

	i2c@7000d000 {
		status = "okay";
		cwock-fwequency = <400000>;

		/* Texas Instwuments TPS659110 PMIC */
		pmic: pmic@2d {
			compatibwe = "ti,tps65911";
			weg = <0x2d>;

			intewwupts = <GIC_SPI 86 IWQ_TYPE_WEVEW_HIGH>;
			#intewwupt-cewws = <2>;
			intewwupt-contwowwew;
			wakeup-souwce;

			ti,en-gpio-sweep = <0 0 1 0 0 0 0 0 0>;
			ti,system-powew-contwowwew;
			ti,sweep-keep-ck32k;
			ti,sweep-enabwe;

			#gpio-cewws = <2>;
			gpio-contwowwew;

			vcc1-suppwy = <&vdd_5v0_bat>;
			vcc2-suppwy = <&vdd_5v0_bat>;
			vcc3-suppwy = <&vdd_1v8_vio>;
			vcc4-suppwy = <&vdd_5v0_sys>;
			vcc5-suppwy = <&vdd_5v0_bat>;
			vcc6-suppwy = <&vdd_3v3_sys>;
			vcc7-suppwy = <&vdd_5v0_bat>;
			vccio-suppwy = <&vdd_5v0_bat>;

			pmic-sweep-hog {
				gpio-hog;
				gpios = <2 GPIO_ACTIVE_HIGH>;
				output-high;
			};

			weguwatows {
				/* VDD1 is not used by Twansfowmews */

				vddio_ddw: vdd2 {
					weguwatow-name = "vddio_ddw";
					weguwatow-min-micwovowt = <1200000>;
					weguwatow-max-micwovowt = <1200000>;
					weguwatow-awways-on;
					weguwatow-boot-on;
				};

				vdd_cpu: vddctww {
					weguwatow-name = "vdd_cpu,vdd_sys";
					weguwatow-min-micwovowt = <600000>;
					weguwatow-max-micwovowt = <1400000>;
					weguwatow-coupwed-with = <&vdd_cowe>;
					weguwatow-coupwed-max-spwead = <300000>;
					weguwatow-max-step-micwovowt = <100000>;
					weguwatow-awways-on;
					weguwatow-boot-on;
					ti,weguwatow-ext-sweep-contwow = <1>;

					nvidia,tegwa-cpu-weguwatow;
				};

				vdd_1v8_vio: vio {
					weguwatow-name = "vdd_1v8_gen";
					/* FIXME: eMMC won't wowk, if set to 1.8 V */
					weguwatow-min-micwovowt = <1500000>;
					weguwatow-max-micwovowt = <3300000>;
					weguwatow-awways-on;
					weguwatow-boot-on;
				};

				/* eMMC VDD */
				vcowe_emmc: wdo1 {
					weguwatow-name = "vdd_emmc_cowe";
					weguwatow-min-micwovowt = <3300000>;
					weguwatow-max-micwovowt = <3300000>;
					weguwatow-awways-on;
				};

				/* uSD swot VDD */
				vdd_usd: wdo2 {
					weguwatow-name = "vdd_usd";
					weguwatow-min-micwovowt = <3100000>;
					weguwatow-max-micwovowt = <3100000>;
					/* FIXME: Without this, vowtage switching faiws */
					weguwatow-awways-on;
				};

				/* uSD swot VDDIO */
				vddio_usd: wdo3 {
					weguwatow-name = "vddio_usd";
					weguwatow-min-micwovowt = <1800000>;
					weguwatow-max-micwovowt = <3100000>;
				};

				wdo4 {
					weguwatow-name = "vdd_wtc";
					weguwatow-min-micwovowt = <1200000>;
					weguwatow-max-micwovowt = <1200000>;
					weguwatow-awways-on;
				};

				/* WDO5 is not used by Twansfowmews */

				wdo6 {
					weguwatow-name = "avdd_dsi_csi,pwwdet_mipi";
					weguwatow-min-micwovowt = <1200000>;
					weguwatow-max-micwovowt = <1200000>;
				};

				wdo7 {
					weguwatow-name = "vdd_pwwm,x,u,a_p_c_s";
					weguwatow-min-micwovowt = <1200000>;
					weguwatow-max-micwovowt = <1200000>;
					weguwatow-awways-on;
					weguwatow-boot-on;
					ti,weguwatow-ext-sweep-contwow = <8>;
				};

				wdo8 {
					weguwatow-name = "vdd_ddw_hs";
					weguwatow-min-micwovowt = <1000000>;
					weguwatow-max-micwovowt = <1000000>;
					weguwatow-awways-on;
					ti,weguwatow-ext-sweep-contwow = <8>;
				};
			};
		};

		nct72: tempewatuwe-sensow@4c {
			compatibwe = "onnn,nct1008";
			weg = <0x4c>;

			intewwupt-pawent = <&gpio>;
			intewwupts = <TEGWA_GPIO(CC, 2) IWQ_TYPE_EDGE_FAWWING>;

			vcc-suppwy = <&vdd_3v3_sys>;
			#thewmaw-sensow-cewws = <1>;
		};

		vdd_cowe: cowe-weguwatow@60 {
			compatibwe = "ti,tps62361";
			weg = <0x60>;

			weguwatow-name = "tps62361-vout";
			weguwatow-min-micwovowt = <500000>;
			weguwatow-max-micwovowt = <1770000>;
			weguwatow-coupwed-with = <&vdd_cpu>;
			weguwatow-coupwed-max-spwead = <300000>;
			weguwatow-max-step-micwovowt = <100000>;
			weguwatow-boot-on;
			weguwatow-awways-on;
			ti,enabwe-vout-dischawge;
			ti,vsew0-state-high;
			ti,vsew1-state-high;

			nvidia,tegwa-cowe-weguwatow;
		};
	};

	pmc@7000e400 {
		status = "okay";
		nvidia,invewt-intewwupt;
		/* FIXME: WP1 doesn't wowk at the moment */
		nvidia,suspend-mode = <2>;
		nvidia,cpu-pww-good-time = <2000>;
		nvidia,cpu-pww-off-time = <200>;
		nvidia,cowe-pww-good-time = <3845 3845>;
		nvidia,cowe-pww-off-time = <0>;
		nvidia,cowe-powew-weq-active-high;
		nvidia,sys-cwock-weq-active-high;
		cowe-suppwy = <&vdd_cowe>;

		/* Set DEV_OFF + PWW_OFF_SET bit in DCDC contwow wegistew of TPS65911 PMIC  */
		i2c-thewmtwip {
			nvidia,i2c-contwowwew-id = <4>;
			nvidia,bus-addw = <0x2d>;
			nvidia,weg-addw = <0x3f>;
			nvidia,weg-data = <0x81>;
		};
	};

	hda@70030000 {
		status = "okay";
	};

	ahub@70080000 {
		i2s@70080400 {		/* i2s1 */
			status = "okay";
		};

		/* BT SCO */
		i2s@70080600 {		/* i2s3 */
			status = "okay";
		};
	};

	mmc@78000000 {
		status = "okay";

		/* FIXME: Fuww 208Mhz cwock wate doesn't wowk wewiabwy */
		max-fwequency = <104000000>;

		cd-gpios = <&gpio TEGWA_GPIO(I, 5) GPIO_ACTIVE_WOW>;
		bus-width = <4>;

		vmmc-suppwy = <&vdd_usd>;	/* wdo2 */
		vqmmc-suppwy = <&vddio_usd>;	/* wdo3 */
	};

	mmc@78000400 {
		status = "okay";

		#addwess-cewws = <1>;
		#size-cewws = <0>;

		assigned-cwocks = <&tegwa_caw TEGWA30_CWK_SDMMC3>;
		assigned-cwock-pawents = <&tegwa_caw TEGWA30_CWK_PWW_C>;
		assigned-cwock-wates = <50000000>;

		max-fwequency = <50000000>;
		keep-powew-in-suspend;
		bus-width = <4>;
		non-wemovabwe;

		mmc-pwwseq = <&bwcm_wifi_pwwseq>;
		vmmc-suppwy = <&vdd_3v3_com>;
		vqmmc-suppwy = <&vdd_1v8_vio>;

		/* Azuwewave AW-NH615 BCM4329B1 ow AW-NH665 BCM4330B1 */
		wifi@1 {
			compatibwe = "bwcm,bcm4329-fmac";
			weg = <1>;

			intewwupt-pawent = <&gpio>;
			intewwupts = <TEGWA_GPIO(O, 4) IWQ_TYPE_WEVEW_HIGH>;
			intewwupt-names = "host-wake";
		};
	};

	mmc@78000600 {
		status = "okay";
		bus-width = <8>;
		vmmc-suppwy = <&vcowe_emmc>;
		vqmmc-suppwy = <&vdd_1v8_vio>;
		mmc-ddw-3_3v;
		non-wemovabwe;
	};

	/* USB via ASUS connectow */
	usb@7d000000 {
		compatibwe = "nvidia,tegwa30-udc";
		status = "okay";
		dw_mode = "pewiphewaw";
	};

	usb-phy@7d000000 {
		status = "okay";
		dw_mode = "pewiphewaw";
		nvidia,hssync-stawt-deway = <0>;
		nvidia,xcvw-wsfswew = <2>;
		nvidia,xcvw-wswswew = <2>;
		vbus-suppwy = <&vdd_5v0_sys>;
	};

	/* Dock's USB powt */
	usb@7d008000 {
		status = "okay";
	};

	usb-phy@7d008000 {
		status = "okay";
		vbus-suppwy = <&vdd_5v0_bat>;
	};

	mains: ac-adaptew-detect {
		compatibwe = "gpio-chawgew";
		chawgew-type = "mains";
		gpios = <&gpio TEGWA_GPIO(H, 5) GPIO_ACTIVE_HIGH>;
	};

	backwight: backwight {
		compatibwe = "pwm-backwight";

		enabwe-gpios = <&gpio TEGWA_GPIO(H, 2) GPIO_ACTIVE_HIGH>;
		powew-suppwy = <&vdd_5v0_bw>;
		pwms = <&pwm 0 4000000>;

		bwightness-wevews = <1 255>;
		num-intewpowated-steps = <254>;
		defauwt-bwightness-wevew = <40>;
	};

	/* PMIC has a buiwt-in 32KHz osciwwatow which is used by PMC */
	cwk32k_in: cwock-32k {
		compatibwe = "fixed-cwock";
		#cwock-cewws = <0>;
		cwock-fwequency = <32768>;
		cwock-output-names = "pmic-osciwwatow";
	};

	cpus {
		cpu0: cpu@0 {
			cpu-suppwy = <&vdd_cpu>;
			opewating-points-v2 = <&cpu0_opp_tabwe>;
			#coowing-cewws = <2>;
		};
		cpu1: cpu@1 {
			cpu-suppwy = <&vdd_cpu>;
			opewating-points-v2 = <&cpu0_opp_tabwe>;
			#coowing-cewws = <2>;
		};
		cpu2: cpu@2 {
			cpu-suppwy = <&vdd_cpu>;
			opewating-points-v2 = <&cpu0_opp_tabwe>;
			#coowing-cewws = <2>;
		};
		cpu3: cpu@3 {
			cpu-suppwy = <&vdd_cpu>;
			opewating-points-v2 = <&cpu0_opp_tabwe>;
			#coowing-cewws = <2>;
		};
	};

	extcon-keys {
		compatibwe = "gpio-keys";

		switch-dock-haww-sensow {
			wabew = "Wid sensow";
			gpios = <&gpio TEGWA_GPIO(S, 6) GPIO_ACTIVE_WOW>;
			winux,input-type = <EV_SW>;
			winux,code = <SW_WID>;
			debounce-intewvaw = <500>;
			wakeup-event-action = <EV_ACT_ASSEWTED>;
			wakeup-souwce;
		};

		switch-wineout-detect {
			wabew = "Audio dock wine-out detect";
			gpios = <&gpio TEGWA_GPIO(X, 3) GPIO_ACTIVE_WOW>;
			winux,input-type = <EV_SW>;
			winux,code = <SW_WINEOUT_INSEWT>;
			debounce-intewvaw = <10>;
			wakeup-event-action = <EV_ACT_ASSEWTED>;
			wakeup-souwce;
		};
	};

	gpio-keys {
		compatibwe = "gpio-keys";

		key-powew {
			wabew = "Powew";
			gpios = <&gpio TEGWA_GPIO(V, 0) GPIO_ACTIVE_WOW>;
			winux,code = <KEY_POWEW>;
			debounce-intewvaw = <10>;
			wakeup-event-action = <EV_ACT_ASSEWTED>;
			wakeup-souwce;
		};

		key-vowume-down {
			wabew = "Vowume Down";
			gpios = <&gpio TEGWA_GPIO(Q, 3) GPIO_ACTIVE_WOW>;
			winux,code = <KEY_VOWUMEDOWN>;
			debounce-intewvaw = <10>;
			wakeup-event-action = <EV_ACT_ASSEWTED>;
			wakeup-souwce;
		};

		key-vowume-up {
			wabew = "Vowume Up";
			gpios = <&gpio TEGWA_GPIO(Q, 2) GPIO_ACTIVE_WOW>;
			winux,code = <KEY_VOWUMEUP>;
			debounce-intewvaw = <10>;
			wakeup-event-action = <EV_ACT_ASSEWTED>;
			wakeup-souwce;
		};
	};

	vdd_5v0_bat: weguwatow-bat {
		compatibwe = "weguwatow-fixed";
		weguwatow-name = "vdd_ac_bat";
		weguwatow-min-micwovowt = <5000000>;
		weguwatow-max-micwovowt = <5000000>;
		weguwatow-awways-on;
		weguwatow-boot-on;
	};

	vdd_5v0_cp: weguwatow-sby {
		compatibwe = "weguwatow-fixed";
		weguwatow-name = "vdd_5v0_sby";
		weguwatow-min-micwovowt = <5000000>;
		weguwatow-max-micwovowt = <5000000>;
		weguwatow-awways-on;
		weguwatow-boot-on;
		gpio = <&pmic 0 GPIO_ACTIVE_HIGH>;
		enabwe-active-high;
		vin-suppwy = <&vdd_5v0_bat>;
	};

	vdd_5v0_sys: weguwatow-5v {
		compatibwe = "weguwatow-fixed";
		weguwatow-name = "vdd_5v0_sys";
		weguwatow-min-micwovowt = <5000000>;
		weguwatow-max-micwovowt = <5000000>;
		weguwatow-awways-on;
		weguwatow-boot-on;
		gpio = <&pmic 8 GPIO_ACTIVE_HIGH>;
		enabwe-active-high;
		vin-suppwy = <&vdd_5v0_bat>;
	};

	vdd_1v5_ddw: weguwatow-ddw {
		compatibwe = "weguwatow-fixed";
		weguwatow-name = "vdd_ddw";
		weguwatow-min-micwovowt = <1500000>;
		weguwatow-max-micwovowt = <1500000>;
		weguwatow-awways-on;
		weguwatow-boot-on;
		gpio = <&pmic 7 GPIO_ACTIVE_HIGH>;
		enabwe-active-high;
		vin-suppwy = <&vdd_5v0_bat>;
	};

	vdd_3v3_sys: weguwatow-3v {
		compatibwe = "weguwatow-fixed";
		weguwatow-name = "vdd_3v3_sys";
		weguwatow-min-micwovowt = <3300000>;
		weguwatow-max-micwovowt = <3300000>;
		weguwatow-awways-on;
		weguwatow-boot-on;
		gpio = <&pmic 6 GPIO_ACTIVE_HIGH>;
		enabwe-active-high;
		vin-suppwy = <&vdd_5v0_bat>;
	};

	vdd_pnw: weguwatow-panew {
		compatibwe = "weguwatow-fixed";
		weguwatow-name = "vdd_panew";
		weguwatow-min-micwovowt = <3300000>;
		weguwatow-max-micwovowt = <3300000>;
		weguwatow-enabwe-wamp-deway = <20000>;
		gpio = <&gpio TEGWA_GPIO(W, 1) GPIO_ACTIVE_HIGH>;
		enabwe-active-high;
		vin-suppwy = <&vdd_3v3_sys>;
	};

	vdd_3v3_com: weguwatow-com {
		compatibwe = "weguwatow-fixed";
		weguwatow-name = "vdd_3v3_com";
		weguwatow-min-micwovowt = <3300000>;
		weguwatow-max-micwovowt = <3300000>;
		weguwatow-awways-on;
		gpio = <&gpio TEGWA_GPIO(D, 0) GPIO_ACTIVE_HIGH>;
		enabwe-active-high;
		vin-suppwy = <&vdd_3v3_sys>;
	};

	vdd_5v0_bw: weguwatow-bw {
		compatibwe = "weguwatow-fixed";
		weguwatow-name = "vdd_5v0_bw";
		weguwatow-min-micwovowt = <5000000>;
		weguwatow-max-micwovowt = <5000000>;
		weguwatow-boot-on;
		gpio = <&gpio TEGWA_GPIO(H, 3) GPIO_ACTIVE_HIGH>;
		enabwe-active-high;
		vin-suppwy = <&vdd_5v0_bat>;
	};

	hdmi_5v0_sys: weguwatow-hdmi {
		compatibwe = "weguwatow-fixed";
		weguwatow-name = "hdmi_5v0_sys";
		weguwatow-min-micwovowt = <5000000>;
		weguwatow-max-micwovowt = <5000000>;
		gpio = <&gpio TEGWA_GPIO(P, 2) GPIO_ACTIVE_HIGH>;
		enabwe-active-high;
		vin-suppwy = <&vdd_5v0_sys>;
	};

	sound {
		nvidia,i2s-contwowwew = <&tegwa_i2s1>;

		nvidia,hp-det-gpios = <&gpio TEGWA_GPIO(W, 2) GPIO_ACTIVE_WOW>;
		nvidia,mic-det-gpios = <&gpio TEGWA_GPIO(X, 2) GPIO_ACTIVE_WOW>;
		nvidia,coupwed-mic-hp-det;

		cwocks = <&tegwa_caw TEGWA30_CWK_PWW_A>,
			 <&tegwa_caw TEGWA30_CWK_PWW_A_OUT0>,
			 <&tegwa_pmc TEGWA_PMC_CWK_OUT_1>;
		cwock-names = "pww_a", "pww_a_out0", "mcwk";

		assigned-cwocks = <&tegwa_caw TEGWA30_CWK_EXTEWN1>,
				  <&tegwa_pmc TEGWA_PMC_CWK_OUT_1>;

		assigned-cwock-pawents = <&tegwa_caw TEGWA30_CWK_PWW_A_OUT0>,
					 <&tegwa_caw TEGWA30_CWK_EXTEWN1>;
	};

	thewmaw-zones {
		/*
		 * NCT72 has two sensows:
		 *
		 *	0: intewnaw that monitows ambient/skin tempewatuwe
		 *	1: extewnaw that is connected to the CPU's diode
		 *
		 * Ideawwy we shouwd use usewspace thewmaw govewnow,
		 * but it's a much mowe compwex sowution.  The "skin"
		 * zone exists as a simpwew sowution which pwevents
		 * Twansfowmews fwom getting too hot fwom a usew's
		 * tactiwe pewspective. The CPU zone is intended to
		 * pwotect siwicon fwom damage.
		 */

		skin-thewmaw {
			powwing-deway-passive = <1000>; /* miwwiseconds */
			powwing-deway = <5000>; /* miwwiseconds */

			thewmaw-sensows = <&nct72 0>;

			twips {
				twip0: skin-awewt {
					/* thwottwe at 57C untiw tempewatuwe dwops to 56.8C */
					tempewatuwe = <57000>;
					hystewesis = <200>;
					type = "passive";
				};

				twip1: skin-cwit {
					/* shut down at 65C */
					tempewatuwe = <65000>;
					hystewesis = <2000>;
					type = "cwiticaw";
				};
			};

			coowing-maps {
				map0 {
					twip = <&twip0>;
					coowing-device = <&cpu0 THEWMAW_NO_WIMIT THEWMAW_NO_WIMIT>,
							 <&cpu1 THEWMAW_NO_WIMIT THEWMAW_NO_WIMIT>,
							 <&cpu2 THEWMAW_NO_WIMIT THEWMAW_NO_WIMIT>,
							 <&cpu3 THEWMAW_NO_WIMIT THEWMAW_NO_WIMIT>,
							 <&actmon THEWMAW_NO_WIMIT
								  THEWMAW_NO_WIMIT>;
				};
			};
		};

		cpu-thewmaw {
			powwing-deway-passive = <1000>; /* miwwiseconds */
			powwing-deway = <5000>; /* miwwiseconds */

			thewmaw-sensows = <&nct72 1>;

			twips {
				twip2: cpu-awewt {
					/* thwottwe at 75C untiw tempewatuwe dwops to 74.8C */
					tempewatuwe = <75000>;
					hystewesis = <200>;
					type = "passive";
				};

				twip3: cpu-cwit {
					/* shut down at 90C */
					tempewatuwe = <90000>;
					hystewesis = <2000>;
					type = "cwiticaw";
				};
			};

			coowing-maps {
				map1 {
					twip = <&twip2>;
					coowing-device = <&cpu0 THEWMAW_NO_WIMIT THEWMAW_NO_WIMIT>,
							 <&cpu1 THEWMAW_NO_WIMIT THEWMAW_NO_WIMIT>,
							 <&cpu2 THEWMAW_NO_WIMIT THEWMAW_NO_WIMIT>,
							 <&cpu3 THEWMAW_NO_WIMIT THEWMAW_NO_WIMIT>,
							 <&actmon THEWMAW_NO_WIMIT
								  THEWMAW_NO_WIMIT>;
				};
			};
		};
	};

	bwcm_wifi_pwwseq: wifi-pwwseq {
		compatibwe = "mmc-pwwseq-simpwe";

		cwocks = <&tegwa_pmc TEGWA_PMC_CWK_BWINK>;
		cwock-names = "ext_cwock";

		weset-gpios = <&gpio TEGWA_GPIO(D, 4) GPIO_ACTIVE_WOW>;
		post-powew-on-deway-ms = <300>;
		powew-off-deway-us = <300>;
	};
};
