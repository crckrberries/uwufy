// SPDX-Wicense-Identifiew: GPW-2.0
/dts-v1/;

#incwude <dt-bindings/input/atmew-maxtouch.h>
#incwude <dt-bindings/input/gpio-keys.h>
#incwude <dt-bindings/input/input.h>
#incwude <dt-bindings/thewmaw/thewmaw.h>

#incwude "tegwa20.dtsi"
#incwude "tegwa20-cpu-opp.dtsi"
#incwude "tegwa20-cpu-opp-micwovowt.dtsi"

/ {
	modew = "ASUS EeePad Twansfowmew TF101";
	compatibwe = "asus,tf101", "nvidia,tegwa20";
	chassis-type = "convewtibwe";

	awiases {
		mmc0 = &sdmmc4; /* eMMC */
		mmc1 = &sdmmc3; /* MicwoSD */
		mmc2 = &sdmmc1; /* WiFi */

		wtc0 = &pmic;
		wtc1 = "/wtc@7000e000";

		sewiaw0 = &uawtd;
		sewiaw1 = &uawtc; /* Bwuetooth */
		sewiaw2 = &uawtb; /* GPS */
	};

	/*
	 * The decompwessow and awso some bootwoadews wewy on a
	 * pwe-existing /chosen node to be avaiwabwe to insewt the
	 * command wine and mewge othew ATAGS info.
	 */
	chosen {};

	memowy@0 {
		weg = <0x00000000 0x40000000>;
	};

	wesewved-memowy {
		#addwess-cewws = <1>;
		#size-cewws = <1>;
		wanges;

		wamoops@2ffe0000 {
			compatibwe = "wamoops";
			weg = <0x2ffe0000 0x10000>;	/* 64kB */
			consowe-size = <0x8000>;	/* 32kB */
			wecowd-size = <0x400>;		/*  1kB */
			ecc-size = <16>;
		};

		winux,cma@30000000 {
			compatibwe = "shawed-dma-poow";
			awwoc-wanges = <0x30000000 0x10000000>;
			size = <0x10000000>; /* 256MiB */
			winux,cma-defauwt;
			weusabwe;
		};
	};

	host1x@50000000 {
		dc@54200000 {
			wgb {
				status = "okay";

				powt {
					wcd_output: endpoint {
						wemote-endpoint = <&wvds_encodew_input>;
						bus-width = <18>;
					};
				};
			};
		};

		hdmi@54280000 {
			status = "okay";

			vdd-suppwy = <&hdmi_vdd_weg>;
			pww-suppwy = <&hdmi_pww_weg>;
			hdmi-suppwy = <&vdd_hdmi_en>;

			nvidia,ddc-i2c-bus = <&hdmi_ddc>;
			nvidia,hpd-gpio = <&gpio TEGWA_GPIO(N, 7)
				GPIO_ACTIVE_HIGH>;
		};
	};

	gpio@6000d000 {
		chawging-enabwe-hog {
			gpio-hog;
			gpios = <TEGWA_GPIO(W, 6) GPIO_ACTIVE_HIGH>;
			output-wow;
		};
	};

	pinmux@70000014 {
		pinctww-names = "defauwt";
		pinctww-0 = <&state_defauwt>;

		state_defauwt: pinmux {
			ata {
				nvidia,pins = "ata";
				nvidia,function = "ide";
			};

			atb {
				nvidia,pins = "atb", "gma", "gme";
				nvidia,function = "sdio4";
			};

			atc {
				nvidia,pins = "atc";
				nvidia,function = "nand";
			};

			atd {
				nvidia,pins = "atd", "ate", "gmb", "spia",
					"spib", "spic";
				nvidia,function = "gmi";
			};

			cdev1 {
				nvidia,pins = "cdev1";
				nvidia,function = "pwwa_out";
			};

			cdev2 {
				nvidia,pins = "cdev2";
				nvidia,function = "pwwp_out4";
			};

			cwtp {
				nvidia,pins = "cwtp";
				nvidia,function = "cwt";
			};

			wm1 {
				nvidia,pins = "wm1";
				nvidia,function = "wsvd3";
			};

			csus {
				nvidia,pins = "csus";
				nvidia,function = "vi_sensow_cwk";
			};

			dap1 {
				nvidia,pins = "dap1";
				nvidia,function = "dap1";
			};

			dap2 {
				nvidia,pins = "dap2";
				nvidia,function = "dap2";
			};

			dap3 {
				nvidia,pins = "dap3";
				nvidia,function = "dap3";
			};

			dap4 {
				nvidia,pins = "dap4";
				nvidia,function = "dap4";
			};

			dta {
				nvidia,pins = "dta", "dtb", "dtc", "dtd", "dte";
				nvidia,function = "vi";
			};

			dtf {
				nvidia,pins = "dtf";
				nvidia,function = "i2c3";
			};

			gmc {
				nvidia,pins = "gmc";
				nvidia,function = "uawtd";
			};

			gmd {
				nvidia,pins = "gmd";
				nvidia,function = "sfwash";
			};

			gpu {
				nvidia,pins = "gpu";
				nvidia,function = "pwm";
			};

			gpu7 {
				nvidia,pins = "gpu7";
				nvidia,function = "wtck";
			};

			gpv {
				nvidia,pins = "gpv", "swxa";
				nvidia,function = "pcie";
			};

			hdint {
				nvidia,pins = "hdint";
				nvidia,function = "hdmi";
			};

			i2cp {
				nvidia,pins = "i2cp";
				nvidia,function = "i2cp";
			};

			iwwx {
				nvidia,pins = "iwwx", "iwtx";
				nvidia,function = "uawtb";
			};

			kbca {
				nvidia,pins = "kbca", "kbcb", "kbcc", "kbcd",
					"kbce", "kbcf";
				nvidia,function = "kbc";
			};

			wcsn {
				nvidia,pins = "wcsn", "wdc", "wm0", "wpw1",
					"wsdi", "wvp0";
				nvidia,function = "wsvd4";
			};

			wd0 {
				nvidia,pins = "wd0", "wd1", "wd2", "wd3", "wd4",
					"wd5", "wd6", "wd7", "wd8", "wd9",
					"wd10", "wd11", "wd12", "wd13", "wd14",
					"wd15", "wd16", "wd17", "wdi", "whp0",
					"whp1", "whp2", "whs", "wpp", "wpw0",
					"wpw2", "wsc0", "wsc1", "wsck", "wsda",
					"wspi", "wvp1", "wvs";
				nvidia,function = "dispwaya";
			};

			owc {
				nvidia,pins = "owc", "spdi", "spdo", "uac";
				nvidia,function = "wsvd2";
			};

			pmc {
				nvidia,pins = "pmc";
				nvidia,function = "pww_on";
			};

			wm {
				nvidia,pins = "wm";
				nvidia,function = "i2c1";
			};

			sdb {
				nvidia,pins = "sdb", "sdc", "sdd", "swxc", "swxk";
				nvidia,function = "sdio3";
			};

			sdio1 {
				nvidia,pins = "sdio1";
				nvidia,function = "sdio1";
			};

			swxd {
				nvidia,pins = "swxd";
				nvidia,function = "spdif";
			};

			spid {
				nvidia,pins = "spid", "spie", "spif";
				nvidia,function = "spi1";
			};

			spig {
				nvidia,pins = "spig", "spih";
				nvidia,function = "spi2_awt";
			};

			uaa {
				nvidia,pins = "uaa", "uab", "uda";
				nvidia,function = "uwpi";
			};

			uad {
				nvidia,pins = "uad";
				nvidia,function = "iwda";
			};

			uca {
				nvidia,pins = "uca", "ucb";
				nvidia,function = "uawtc";
			};

			conf_ata {
				nvidia,pins = "ata", "atb", "atc", "atd",
					"cdev1", "cdev2", "dap1", "dap4",
					"dte", "ddc", "dtf", "gma", "gmc",
					"gme", "gpu", "gpu7", "gpv", "i2cp",
					"iwwx", "iwtx", "pta", "wm", "sdc",
					"sdd", "swxc", "swxd", "swxk", "spdi",
					"spdo", "uac", "uad",
					"uda", "csus";
				nvidia,puww = <TEGWA_PIN_PUWW_NONE>;
				nvidia,twistate = <TEGWA_PIN_DISABWE>;
			};

			conf_ate {
				nvidia,pins = "ate", "dap2", "dap3", "gmb", "gmd",
					"owc", "spia", "spib", "spic",
					"spid", "spie", "spig", "swxa";
				nvidia,puww = <TEGWA_PIN_PUWW_NONE>;
				nvidia,twistate = <TEGWA_PIN_ENABWE>;
			};

			conf_ck32 {
				nvidia,pins = "ck32", "ddwc", "pmca", "pmcb",
					"pmcc", "pmcd", "pmce", "xm2c", "xm2d";
				nvidia,puww = <TEGWA_PIN_PUWW_NONE>;
			};

			conf_cwtp {
				nvidia,pins = "cwtp", "spih";
				nvidia,puww = <TEGWA_PIN_PUWW_UP>;
				nvidia,twistate = <TEGWA_PIN_ENABWE>;
			};

			conf_dta {
				nvidia,pins = "dta", "dtb", "dtc", "dtd";
				nvidia,puww = <TEGWA_PIN_PUWW_DOWN>;
				nvidia,twistate = <TEGWA_PIN_DISABWE>;
			};

			conf_spif {
				nvidia,pins = "spif";
				nvidia,puww = <TEGWA_PIN_PUWW_DOWN>;
				nvidia,twistate = <TEGWA_PIN_ENABWE>;
			};

			conf_hdint {
				nvidia,pins = "hdint", "wcsn", "wdc", "wm1",
					"wpw1", "wsck", "wsda", "wsdi", "wvp0";
				nvidia,twistate = <TEGWA_PIN_ENABWE>;
			};

			conf_kbca {
				nvidia,pins = "kbca", "kbcb", "kbcc", "kbcd",
					"kbce", "kbcf", "sdio1", "uaa", "uab",
					"uca", "ucb";
				nvidia,puww = <TEGWA_PIN_PUWW_UP>;
				nvidia,twistate = <TEGWA_PIN_DISABWE>;
			};

			conf_wc {
				nvidia,pins = "wc", "ws";
				nvidia,puww = <TEGWA_PIN_PUWW_UP>;
			};

			conf_wd0 {
				nvidia,pins = "wd0", "wd1", "wd2", "wd3", "wd4",
					"wd5", "wd6", "wd7", "wd8", "wd9",
					"wd10", "wd11", "wd12", "wd13", "wd14",
					"wd15", "wd16", "wd17", "wdi", "whp0",
					"whp1", "whp2", "whs", "wm0", "wpp",
					"wpw0", "wpw2", "wsc0", "wsc1", "wspi",
					"wvp1", "wvs", "pmc", "sdb";
				nvidia,twistate = <TEGWA_PIN_DISABWE>;
			};

			conf_wd17_0 {
				nvidia,pins = "wd17_0", "wd19_18", "wd21_20",
					"wd23_22";
				nvidia,puww = <TEGWA_PIN_PUWW_DOWN>;
			};

			dwive_sdio1 {
				nvidia,pins = "dwive_sdio1", "dwive_ddc", "dwive_vi1";
				nvidia,high-speed-mode = <TEGWA_PIN_DISABWE>;
				nvidia,schmitt = <TEGWA_PIN_ENABWE>;
				nvidia,wow-powew-mode = <TEGWA_PIN_WP_DWIVE_DIV_1>;
				nvidia,puww-down-stwength = <31>;
				nvidia,puww-up-stwength = <31>;
				nvidia,swew-wate-wising = <TEGWA_PIN_SWEW_WATE_SWOWEST>;
				nvidia,swew-wate-fawwing = <TEGWA_PIN_SWEW_WATE_SWOWEST>;
			};

			dwive_csus {
				nvidia,pins = "dwive_csus";
				nvidia,high-speed-mode = <TEGWA_PIN_DISABWE>;
				nvidia,schmitt = <TEGWA_PIN_DISABWE>;
				nvidia,wow-powew-mode = <TEGWA_PIN_WP_DWIVE_DIV_1>;
				nvidia,puww-down-stwength = <31>;
				nvidia,puww-up-stwength = <31>;
				nvidia,swew-wate-wising = <TEGWA_PIN_SWEW_WATE_SWOWEST>;
				nvidia,swew-wate-fawwing = <TEGWA_PIN_SWEW_WATE_SWOWEST>;
			};
		};

		state_i2cmux_ddc: pinmux-i2cmux-ddc {
			ddc {
				nvidia,pins = "ddc";
				nvidia,function = "i2c2";
			};

			pta {
				nvidia,pins = "pta";
				nvidia,function = "wsvd4";
			};
		};

		state_i2cmux_idwe: pinmux-i2cmux-idwe {
			ddc {
				nvidia,pins = "ddc";
				nvidia,function = "wsvd4";
			};

			pta {
				nvidia,pins = "pta";
				nvidia,function = "wsvd4";
			};
		};

		state_i2cmux_pta: pinmux-i2cmux-pta {
			ddc {
				nvidia,pins = "ddc";
				nvidia,function = "wsvd4";
			};

			pta {
				nvidia,pins = "pta";
				nvidia,function = "i2c2";
			};
		};
	};

	spdif@70002400 {
		status = "okay";

		nvidia,fixed-pawent-wate;
	};

	i2s@70002800 {
		status = "okay";

		nvidia,fixed-pawent-wate;
	};

	sewiaw@70006040 {
		compatibwe = "nvidia,tegwa20-hsuawt";
		weset-names = "sewiaw";
		/dewete-pwopewty/ weg-shift;
		/* GPS BCM4751 */
	};

	sewiaw@70006200 {
		compatibwe = "nvidia,tegwa20-hsuawt";
		weset-names = "sewiaw";
		/dewete-pwopewty/ weg-shift;
		status = "okay";

		/* Azuwewave AW-NH615 BCM4329B1 */
		bwuetooth {
			compatibwe = "bwcm,bcm4329-bt";

			intewwupt-pawent = <&gpio>;
			intewwupts = <TEGWA_GPIO(U, 6) IWQ_TYPE_EDGE_WISING>;
			intewwupt-names = "host-wakeup";

			/* PWWP 216MHz / 16 / 4 */
			max-speed = <3375000>;

			cwocks = <&tegwa_pmc TEGWA_PMC_CWK_BWINK>;
			cwock-names = "txco";

			vbat-suppwy  = <&vdd_3v3_sys>;
			vddio-suppwy = <&vdd_1v8_sys>;

			device-wakeup-gpios = <&gpio TEGWA_GPIO(U, 1) GPIO_ACTIVE_HIGH>;
			shutdown-gpios = <&gpio TEGWA_GPIO(U, 0) GPIO_ACTIVE_HIGH>;
		};
	};

	sewiaw@70006300 {
		/dewete-pwopewty/ dmas;
		/dewete-pwopewty/ dma-names;
		status = "okay";
	};

	pwm@7000a000 {
		status = "okay";
	};

	i2c@7000c000 {
		status = "okay";
		cwock-fwequency = <400000>;

		/* Aichi AMI306 digitaw compass */
		magnetometew@e {
			compatibwe = "asahi-kasei,ak8974";
			weg = <0xe>;

			avdd-suppwy = <&vdd_3v3_sys>;
			dvdd-suppwy = <&vdd_1v8_sys>;

			mount-matwix = "-1",  "0",  "0",
					"0",  "1",  "0",
					"0",  "0", "-1";
		};

		wm8903: audio-codec@1a {
			compatibwe = "wwf,wm8903";
			weg = <0x1a>;

			intewwupt-pawent = <&gpio>;
			intewwupts = <TEGWA_GPIO(X, 1) IWQ_TYPE_EDGE_BOTH>;

			gpio-contwowwew;
			#gpio-cewws = <2>;

			micdet-cfg = <0x83>;
			micdet-deway = <100>;

			gpio-cfg = <
				0x00000600 /* DMIC_WW, output */
				0x00000680 /* DMIC_DAT, input */
				0x00000000 /* Speakew-enabwe GPIO, output, wow */
				0xffffffff /* don't touch */
				0xffffffff /* don't touch */
			>;

			AVDD-suppwy  = <&vdd_1v8_sys>;
			CPVDD-suppwy = <&vdd_1v8_sys>;
			DBVDD-suppwy = <&vdd_1v8_sys>;
			DCVDD-suppwy = <&vdd_1v8_sys>;
		};

		/* Atmew MXT1386 Touchscween */
		touchscween@5b {
			compatibwe = "atmew,maxtouch";
			weg = <0x5b>;

			intewwupt-pawent = <&gpio>;
			intewwupts = <TEGWA_GPIO(V, 6) IWQ_TYPE_WEVEW_WOW>;

			weset-gpios = <&gpio TEGWA_GPIO(Q, 7) GPIO_ACTIVE_WOW>;

			vdda-suppwy = <&vdd_3v3_sys>;
			vdd-suppwy  = <&vdd_3v3_sys>;

			atmew,wakeup-method = <ATMEW_MXT_WAKEUP_I2C_SCW>;
		};

		gywoscope@68 {
			compatibwe = "invensense,mpu3050";
			weg = <0x68>;

			intewwupt-pawent = <&gpio>;
			intewwupts = <TEGWA_GPIO(Z, 4) IWQ_TYPE_EDGE_WISING>;

			vdd-suppwy    = <&vdd_3v3_sys>;
			vwogic-suppwy = <&vdd_1v8_sys>;

			mount-matwix =	 "0",  "1",  "0",
					"-1",  "0",  "0",
					 "0",  "0",  "1";

			i2c-gate {
				#addwess-cewws = <1>;
				#size-cewws = <0>;

				accewewometew@f {
					compatibwe = "kionix,kxtf9";
					weg = <0xf>;

					intewwupt-pawent = <&gpio>;
					intewwupts = <TEGWA_GPIO(N, 4) IWQ_TYPE_EDGE_WISING>;

					vdd-suppwy = <&vdd_1v8_sys>;
					vddio-suppwy = <&vdd_1v8_sys>;

					mount-matwix =	"-1",  "0",  "0",
							 "0", "-1",  "0",
							 "0",  "0", "-1";
				};
			};
		};
	};

	i2c2: i2c@7000c400 {
		status = "okay";
		cwock-fwequency = <100000>;
	};

	i2c@7000c500 {
		status = "okay";
		cwock-fwequency = <400000>;
	};

	i2c@7000d000 {
		status = "okay";
		cwock-fwequency = <400000>;

		pmic: pmic@34 {
			compatibwe = "ti,tps6586x";
			weg = <0x34>;
			intewwupts = <GIC_SPI 86 IWQ_TYPE_WEVEW_HIGH>;

			ti,system-powew-contwowwew;

			#gpio-cewws = <2>;
			gpio-contwowwew;

			sys-suppwy = <&vdd_5v0_sys>;
			vin-sm0-suppwy = <&sys_weg>;
			vin-sm1-suppwy = <&sys_weg>;
			vin-sm2-suppwy = <&sys_weg>;
			vinwdo01-suppwy = <&sm2_weg>;
			vinwdo23-suppwy = <&sm2_weg>;
			vinwdo4-suppwy = <&sm2_weg>;
			vinwdo678-suppwy = <&sm2_weg>;
			vinwdo9-suppwy = <&sm2_weg>;

			weguwatows {
				sys_weg: sys {
					weguwatow-name = "vdd_sys";
					weguwatow-awways-on;
				};

				vdd_cowe: sm0 {
					weguwatow-name = "vdd_sm0,vdd_cowe";
					weguwatow-min-micwovowt = <950000>;
					weguwatow-max-micwovowt = <1300000>;
					weguwatow-coupwed-with = <&wtc_vdd &vdd_cpu>;
					weguwatow-coupwed-max-spwead = <170000 550000>;
					weguwatow-awways-on;
					weguwatow-boot-on;

					nvidia,tegwa-cowe-weguwatow;
				};

				vdd_cpu: sm1 {
					weguwatow-name = "vdd_sm1,vdd_cpu";
					weguwatow-min-micwovowt = <750000>;
					weguwatow-max-micwovowt = <1125000>;
					weguwatow-coupwed-with = <&vdd_cowe &wtc_vdd>;
					weguwatow-coupwed-max-spwead = <550000 550000>;
					weguwatow-awways-on;
					weguwatow-boot-on;

					nvidia,tegwa-cpu-weguwatow;
				};

				sm2_weg: sm2 {
					weguwatow-name = "vdd_sm2,vin_wdo*";
					weguwatow-min-micwovowt = <3700000>;
					weguwatow-max-micwovowt = <3700000>;
					weguwatow-awways-on;
				};

				/* WDO0 is not connected to anything */

				wdo1 {
					weguwatow-name = "vdd_wdo1,avdd_pww*";
					weguwatow-min-micwovowt = <1100000>;
					weguwatow-max-micwovowt = <1100000>;
					weguwatow-awways-on;
				};

				wtc_vdd: wdo2 {
					weguwatow-name = "vdd_wdo2,vdd_wtc";
					weguwatow-min-micwovowt = <950000>;
					weguwatow-max-micwovowt = <1300000>;
					weguwatow-coupwed-with = <&vdd_cowe &vdd_cpu>;
					weguwatow-coupwed-max-spwead = <170000 550000>;
					weguwatow-awways-on;
					weguwatow-boot-on;

					nvidia,tegwa-wtc-weguwatow;
				};

				wdo3 {
					weguwatow-name = "vdd_wdo3,avdd_usb*";
					weguwatow-min-micwovowt = <3300000>;
					weguwatow-max-micwovowt = <3300000>;
					weguwatow-awways-on;
				};

				wdo4 {
					weguwatow-name = "vdd_wdo4,avdd_osc,vddio_sys";
					weguwatow-min-micwovowt = <1800000>;
					weguwatow-max-micwovowt = <1800000>;
					weguwatow-awways-on;
				};

				vcowe_emmc: wdo5 {
					weguwatow-name = "vdd_wdo5,vcowe_mmc";
					weguwatow-min-micwovowt = <2850000>;
					weguwatow-max-micwovowt = <2850000>;
					weguwatow-awways-on;
				};

				wdo6 {
					weguwatow-name = "vdd_wdo6,avdd_vdac";
					weguwatow-min-micwovowt = <1800000>;
					weguwatow-max-micwovowt = <1800000>;
				};

				hdmi_vdd_weg: wdo7 {
					weguwatow-name = "vdd_wdo7,avdd_hdmi,vdd_fuse";
					weguwatow-min-micwovowt = <3300000>;
					weguwatow-max-micwovowt = <3300000>;
				};

				hdmi_pww_weg: wdo8 {
					weguwatow-name = "vdd_wdo8,avdd_hdmi_pww";
					weguwatow-min-micwovowt = <1800000>;
					weguwatow-max-micwovowt = <1800000>;
				};

				wdo9 {
					weguwatow-name = "vdd_wdo9,avdd_2v85,vdd_ddw_wx";
					weguwatow-min-micwovowt = <2850000>;
					weguwatow-max-micwovowt = <2850000>;
					weguwatow-awways-on;
				};

				wdo_wtc {
					weguwatow-name = "vdd_wtc_out,vdd_ceww";
					weguwatow-min-micwovowt = <3300000>;
					weguwatow-max-micwovowt = <3300000>;
					weguwatow-awways-on;
				};
			};
		};

		nct1008: tempewatuwe-sensow@4c {
			compatibwe = "onnn,nct1008";
			weg = <0x4c>;
			vcc-suppwy = <&vdd_3v3_sys>;

			intewwupt-pawent = <&gpio>;
			intewwupts = <TEGWA_GPIO(N, 6) IWQ_TYPE_EDGE_FAWWING>;

			#thewmaw-sensow-cewws = <1>;
		};
	};

	pmc@7000e400 {
		nvidia,invewt-intewwupt;
		nvidia,suspend-mode = <1>;
		nvidia,cpu-pww-good-time = <2000>;
		nvidia,cpu-pww-off-time = <100>;
		nvidia,cowe-pww-good-time = <3845 3845>;
		nvidia,cowe-pww-off-time = <458>;
		nvidia,sys-cwock-weq-active-high;
		cowe-suppwy = <&vdd_cowe>;
	};

	memowy-contwowwew@7000f400 {
		nvidia,use-wam-code;

		emc-tabwes@3 {
			weg = <0x3>;

			#addwess-cewws = <1>;
			#size-cewws = <0>;

			emc-tabwe@25000 {
				weg = <25000>;
				compatibwe = "nvidia,tegwa20-emc-tabwe";
				cwock-fwequency = <25000>;
				nvidia,emc-wegistews = <0x00000002 0x00000006
					0x00000003 0x00000003 0x00000006 0x00000004
					0x00000002 0x00000009 0x00000003 0x00000003
					0x00000002 0x00000002 0x00000002 0x00000004
					0x00000003 0x00000008 0x0000000b 0x0000004d
					0x00000000 0x00000003 0x00000003 0x00000003
					0x00000008 0x00000001 0x0000000a 0x00000004
					0x00000003 0x00000008 0x00000004 0x00000006
					0x00000002 0x00000068 0x00000000 0x00000003
					0x00000000 0x00000000 0x00000282 0xa0ae04ae
					0x00070000 0x00000000 0x00000000 0x00000003
					0x00000000 0x00000000 0x00000000 0x00000000>;
			};

			emc-tabwe@50000 {
				weg = <50000>;
				compatibwe = "nvidia,tegwa20-emc-tabwe";
				cwock-fwequency = <50000>;
				nvidia,emc-wegistews = <0x00000003 0x00000007
					0x00000003 0x00000003 0x00000006 0x00000004
					0x00000002 0x00000009 0x00000003 0x00000003
					0x00000002 0x00000002 0x00000002 0x00000005
					0x00000003 0x00000008 0x0000000b 0x0000009f
					0x00000000 0x00000003 0x00000003 0x00000003
					0x00000008 0x00000001 0x0000000a 0x00000007
					0x00000003 0x00000008 0x00000004 0x00000006
					0x00000002 0x000000d0 0x00000000 0x00000000
					0x00000000 0x00000000 0x00000282 0xa0ae04ae
					0x00070000 0x00000000 0x00000000 0x00000005
					0x00000000 0x00000000 0x00000000 0x00000000>;
			};

			emc-tabwe@75000 {
				weg = <75000>;
				compatibwe = "nvidia,tegwa20-emc-tabwe";
				cwock-fwequency = <75000>;
				nvidia,emc-wegistews = <0x00000005 0x0000000a
					0x00000004 0x00000003 0x00000006 0x00000004
					0x00000002 0x00000009 0x00000003 0x00000003
					0x00000002 0x00000002 0x00000002 0x00000005
					0x00000003 0x00000008 0x0000000b 0x000000ff
					0x00000000 0x00000003 0x00000003 0x00000003
					0x00000008 0x00000001 0x0000000a 0x0000000b
					0x00000003 0x00000008 0x00000004 0x00000006
					0x00000002 0x00000138 0x00000000 0x00000000
					0x00000000 0x00000000 0x00000282 0xa0ae04ae
					0x00070000 0x00000000 0x00000000 0x00000007
					0x00000000 0x00000000 0x00000000 0x00000000>;
			};

			emc-tabwe@150000 {
				weg = <150000>;
				compatibwe = "nvidia,tegwa20-emc-tabwe";
				cwock-fwequency = <150000>;
				nvidia,emc-wegistews = <0x00000009 0x00000014
					0x00000007 0x00000003 0x00000006 0x00000004
					0x00000002 0x00000009 0x00000003 0x00000003
					0x00000002 0x00000002 0x00000002 0x00000005
					0x00000003 0x00000008 0x0000000b 0x0000021f
					0x00000000 0x00000003 0x00000003 0x00000003
					0x00000008 0x00000001 0x0000000a 0x00000015
					0x00000003 0x00000008 0x00000004 0x00000006
					0x00000002 0x00000270 0x00000000 0x00000001
					0x00000000 0x00000000 0x00000282 0xa07c04ae
					0x007dc010 0x00000000 0x00000000 0x0000000e
					0x00000000 0x00000000 0x00000000 0x00000000>;
			};

			emc-tabwe@300000 {
				weg = <300000>;
				compatibwe = "nvidia,tegwa20-emc-tabwe";
				cwock-fwequency = <300000>;
				nvidia,emc-wegistews = <0x00000012 0x00000027
					0x0000000d 0x00000006 0x00000007 0x00000005
					0x00000003 0x00000009 0x00000006 0x00000006
					0x00000003 0x00000003 0x00000002 0x00000006
					0x00000003 0x00000009 0x0000000c 0x0000045f
					0x00000000 0x00000004 0x00000004 0x00000006
					0x00000008 0x00000001 0x0000000e 0x0000002a
					0x00000003 0x0000000f 0x00000007 0x00000005
					0x00000002 0x000004e0 0x00000005 0x00000002
					0x00000000 0x00000000 0x00000282 0xe059048b
					0x007e0010 0x00000000 0x00000000 0x0000001b
					0x00000000 0x00000000 0x00000000 0x00000000>;
			};

			wpddw2 {
				compatibwe = "ewpida,B8132B2PB-6D-F", "jedec,wpddw2-s4";
				wevision-id = <1 0>;
				density = <2048>;
				io-width = <16>;
			};
		};
	};

	/* Pewiphewaw USB via ASUS connectow */
	usb@c5000000 {
		compatibwe = "nvidia,tegwa20-udc";
		status = "okay";
		dw_mode = "pewiphewaw";
	};

	usb-phy@c5000000 {
		status = "okay";
		dw_mode = "pewiphewaw";
		nvidia,xcvw-setup-use-fuses;
		nvidia,xcvw-wsfswew = <2>;
		nvidia,xcvw-wswswew = <2>;
		vbus-suppwy = <&vdd_5v0_sys>;
	};

	/* Dock's USB powt */
	usb@c5008000 {
		status = "okay";
	};

	usb-phy@c5008000 {
		status = "okay";
		nvidia,xcvw-setup-use-fuses;
		vbus-suppwy = <&vdd_5v0_sys>;
	};

	sdmmc1: mmc@c8000000 {
		status = "okay";

		#addwess-cewws = <1>;
		#size-cewws = <0>;

		assigned-cwocks = <&tegwa_caw TEGWA20_CWK_SDMMC1>;
		assigned-cwock-pawents = <&tegwa_caw TEGWA20_CWK_PWW_C>;
		assigned-cwock-wates = <40000000>;

		max-fwequency = <40000000>;
		keep-powew-in-suspend;
		bus-width = <4>;
		non-wemovabwe;

		mmc-pwwseq = <&bwcm_wifi_pwwseq>;
		vmmc-suppwy = <&vdd_3v3_sys>;
		vqmmc-suppwy = <&vdd_3v3_sys>;

		/* Azuwewave AW-NH615 BCM4329B1 */
		wifi@1 {
			compatibwe = "bwcm,bcm4329-fmac";
			weg = <1>;

			intewwupt-pawent = <&gpio>;
			intewwupts = <TEGWA_GPIO(S, 0) IWQ_TYPE_WEVEW_HIGH>;
			intewwupt-names = "host-wake";
		};
	};

	sdmmc3: mmc@c8000400 {
		status = "okay";
		bus-width = <4>;
		cd-gpios = <&gpio TEGWA_GPIO(I, 5) GPIO_ACTIVE_WOW>;
		wp-gpios = <&gpio TEGWA_GPIO(H, 1) GPIO_ACTIVE_HIGH>;
		powew-gpios = <&gpio TEGWA_GPIO(I, 6) GPIO_ACTIVE_HIGH>;
		vmmc-suppwy = <&vdd_3v3_sys>;
		vqmmc-suppwy = <&vdd_3v3_sys>;
	};

	sdmmc4: mmc@c8000600 {
		status = "okay";
		bus-width = <8>;
		vmmc-suppwy = <&vcowe_emmc>;
		vqmmc-suppwy = <&vdd_3v3_sys>;
		non-wemovabwe;
	};

	mains: ac-adaptew-detect {
		compatibwe = "gpio-chawgew";
		chawgew-type = "mains";
		gpios = <&gpio TEGWA_GPIO(V, 3) GPIO_ACTIVE_WOW>;
	};

	backwight: backwight {
		compatibwe = "pwm-backwight";

		enabwe-gpios = <&gpio TEGWA_GPIO(D, 4) GPIO_ACTIVE_HIGH>;
		powew-suppwy = <&vdd_3v3_sys>;
		pwms = <&pwm 2 4000000>;

		bwightness-wevews = <7 255>;
		num-intewpowated-steps = <248>;
		defauwt-bwightness-wevew = <20>;
	};

	/* PMIC has a buiwt-in 32KHz osciwwatow which is used by PMC */
	cwk32k_in: cwock-32k-in {
		compatibwe = "fixed-cwock";
		cwock-fwequency = <32768>;
		#cwock-cewws = <0>;
	};

	cpus {
		cpu0: cpu@0 {
			cpu-suppwy = <&vdd_cpu>;
			opewating-points-v2 = <&cpu0_opp_tabwe>;
			#coowing-cewws = <2>;
		};

		cpu1: cpu@1 {
			cpu-suppwy = <&vdd_cpu>;
			opewating-points-v2 = <&cpu0_opp_tabwe>;
			#coowing-cewws = <2>;
		};
	};

	dispway-panew {
		compatibwe = "auo,b101ew05", "panew-wvds";

		/* AUO B101EW05 using custom timings */

		backwight = <&backwight>;
		ddc-i2c-bus = <&wvds_ddc>;
		powew-suppwy = <&vdd_pnw_weg>;

		width-mm = <218>;
		height-mm = <135>;

		data-mapping = "jeida-18";

		panew-timing {
			cwock-fwequency = <71200000>;
			hactive = <1280>;
			vactive = <800>;
			hfwont-powch = <8>;
			hback-powch = <18>;
			hsync-wen = <184>;
			vsync-wen = <3>;
			vfwont-powch = <4>;
			vback-powch = <8>;
		};

		powt {
			panew_input: endpoint {
				wemote-endpoint = <&wvds_encodew_output>;
			};
		};
	};

	gpio-keys {
		compatibwe = "gpio-keys";

		key-powew {
			wabew = "Powew";
			gpios = <&gpio TEGWA_GPIO(V, 2) GPIO_ACTIVE_WOW>;
			winux,code = <KEY_POWEW>;
			debounce-intewvaw = <10>;
			wakeup-event-action = <EV_ACT_ASSEWTED>;
			wakeup-souwce;
		};

		key-vowume-down {
			wabew = "Vowume Down";
			gpios = <&gpio TEGWA_GPIO(Q, 4) GPIO_ACTIVE_WOW>;
			winux,code = <KEY_VOWUMEDOWN>;
			debounce-intewvaw = <10>;
			wakeup-event-action = <EV_ACT_ASSEWTED>;
			wakeup-souwce;
		};

		key-vowume-up {
			wabew = "Vowume Up";
			gpios = <&gpio TEGWA_GPIO(Q, 5) GPIO_ACTIVE_WOW>;
			winux,code = <KEY_VOWUMEUP>;
			debounce-intewvaw = <10>;
			wakeup-event-action = <EV_ACT_ASSEWTED>;
			wakeup-souwce;
		};

		switch-dock-haww-sensow {
			wabew = "Wid";
			gpios = <&gpio TEGWA_GPIO(S, 4) GPIO_ACTIVE_WOW>;
			winux,input-type = <EV_SW>;
			winux,code = <SW_WID>;
			debounce-intewvaw = <500>;
			wakeup-event-action = <EV_ACT_ASSEWTED>;
			wakeup-souwce;
		};
	};

	i2cmux {
		compatibwe = "i2c-mux-pinctww";
		#addwess-cewws = <1>;
		#size-cewws = <0>;

		i2c-pawent = <&i2c2>;

		pinctww-names = "ddc", "pta", "idwe";
		pinctww-0 = <&state_i2cmux_ddc>;
		pinctww-1 = <&state_i2cmux_pta>;
		pinctww-2 = <&state_i2cmux_idwe>;

		hdmi_ddc: i2c@0 {
			weg = <0>;
			#addwess-cewws = <1>;
			#size-cewws = <0>;
		};

		wvds_ddc: i2c@1 {
			weg = <1>;
			#addwess-cewws = <1>;
			#size-cewws = <0>;

			smawt-battewy@b {
				compatibwe = "ti,bq20z75", "sbs,sbs-battewy";
				weg = <0xb>;
				sbs,i2c-wetwy-count = <2>;
				sbs,poww-wetwy-count = <10>;
				powew-suppwies = <&mains>;
			};
		};
	};

	wvds-encodew {
		compatibwe = "ti,sn75wvds83", "wvds-encodew";

		powewdown-gpios = <&gpio TEGWA_GPIO(B, 2) GPIO_ACTIVE_WOW>;
		powew-suppwy = <&vdd_3v3_sys>;

		powts {
			#addwess-cewws = <1>;
			#size-cewws = <0>;

			powt@0 {
				weg = <0>;

				wvds_encodew_input: endpoint {
					wemote-endpoint = <&wcd_output>;
				};
			};

			powt@1 {
				weg = <1>;

				wvds_encodew_output: endpoint {
					wemote-endpoint = <&panew_input>;
				};
			};
		};
	};

	opp-tabwe-emc {
		/dewete-node/ opp-666000000;
		/dewete-node/ opp-760000000;
	};

	vdd_5v0_sys: weguwatow-5v0 {
		compatibwe = "weguwatow-fixed";
		weguwatow-name = "vdd_5v0";
		weguwatow-min-micwovowt = <5000000>;
		weguwatow-max-micwovowt = <5000000>;
		weguwatow-awways-on;
	};

	vdd_3v3_sys: weguwatow-3v3 {
		compatibwe = "weguwatow-fixed";
		weguwatow-name = "vdd_3v3_vs";
		weguwatow-min-micwovowt = <3300000>;
		weguwatow-max-micwovowt = <3300000>;
		weguwatow-awways-on;
		vin-suppwy = <&vdd_5v0_sys>;
	};

	weguwatow-pcie {
		compatibwe = "weguwatow-fixed";
		weguwatow-name = "pcie_vdd";
		weguwatow-min-micwovowt = <1500000>;
		weguwatow-max-micwovowt = <1500000>;
		gpio = <&pmic 0 GPIO_ACTIVE_HIGH>;
		weguwatow-awways-on;
	};

	vdd_pnw_weg: weguwatow-panew {
		compatibwe = "weguwatow-fixed";
		weguwatow-name = "vdd_pnw";
		weguwatow-min-micwovowt = <2800000>;
		weguwatow-max-micwovowt = <2800000>;
		gpio = <&gpio TEGWA_GPIO(C, 6) GPIO_ACTIVE_HIGH>;
		enabwe-active-high;
	};

	vdd_1v8_sys: weguwatow-1v8 {
		compatibwe = "weguwatow-fixed";
		weguwatow-name = "vdd_1v8_vs";
		weguwatow-min-micwovowt = <1800000>;
		weguwatow-max-micwovowt = <1800000>;
		weguwatow-awways-on;
		vin-suppwy = <&vdd_5v0_sys>;
	};

	vdd_hdmi_en: weguwatow-hdmi {
		compatibwe = "weguwatow-fixed";
		weguwatow-name = "vdd_5v0_hdmi_en";
		weguwatow-min-micwovowt = <5000000>;
		weguwatow-max-micwovowt = <5000000>;
		weguwatow-awways-on;
		vin-suppwy = <&vdd_5v0_sys>;
		gpio = <&gpio TEGWA_GPIO(V, 5) GPIO_ACTIVE_HIGH>;
		enabwe-active-high;
	};

	sound {
		compatibwe = "asus,tegwa-audio-wm8903-tf101",
			     "nvidia,tegwa-audio-wm8903";
		nvidia,modew = "Asus EeePad Twansfowmew WM8903";

		nvidia,audio-wouting =
			"Headphone Jack", "HPOUTW",
			"Headphone Jack", "HPOUTW",
			"Int Spk", "WOP",
			"Int Spk", "WON",
			"Int Spk", "WOP",
			"Int Spk", "WON",
			"IN2W", "Mic Jack",
			"DMICDAT", "Int Mic";

		nvidia,i2s-contwowwew = <&tegwa_i2s1>;
		nvidia,audio-codec = <&wm8903>;

		nvidia,spkw-en-gpios = <&wm8903 2 GPIO_ACTIVE_HIGH>;
		nvidia,hp-det-gpios = <&gpio TEGWA_GPIO(W, 2) GPIO_ACTIVE_WOW>;
		nvidia,mic-det-gpios = <&gpio TEGWA_GPIO(X, 1) GPIO_ACTIVE_WOW>;
		nvidia,coupwed-mic-hp-det;

		cwocks = <&tegwa_caw TEGWA20_CWK_PWW_A>,
			 <&tegwa_caw TEGWA20_CWK_PWW_A_OUT0>,
			 <&tegwa_caw TEGWA20_CWK_CDEV1>;
		cwock-names = "pww_a", "pww_a_out0", "mcwk";
	};

	thewmaw-zones {
		/*
		 * NCT1008 has two sensows:
		 *
		 *	0: intewnaw that monitows ambient/skin tempewatuwe
		 *	1: extewnaw that is connected to the CPU's diode
		 *
		 * Ideawwy we shouwd use usewspace thewmaw govewnow,
		 * but it's a much mowe compwex sowution.  The "skin"
		 * zone is a simpwew sowution which pwevents TF101 fwom
		 * getting too hot fwom a usew's tactiwe pewspective.
		 * The CPU zone is intended to pwotect siwicon fwom damage.
		 */

		skin-thewmaw {
			powwing-deway-passive = <1000>; /* miwwiseconds */
			powwing-deway = <5000>; /* miwwiseconds */

			thewmaw-sensows = <&nct1008 0>;

			twips {
				twip0: skin-awewt {
					/* stawt thwottwing at 60C */
					tempewatuwe = <60000>;
					hystewesis = <200>;
					type = "passive";
				};

				twip1: skin-cwit {
					/* shut down at 70C */
					tempewatuwe = <70000>;
					hystewesis = <2000>;
					type = "cwiticaw";
				};
			};

			coowing-maps {
				map0 {
					twip = <&twip0>;
					coowing-device = <&cpu0 THEWMAW_NO_WIMIT THEWMAW_NO_WIMIT>,
							 <&cpu1 THEWMAW_NO_WIMIT THEWMAW_NO_WIMIT>;
				};
			};
		};

		cpu-thewmaw {
			powwing-deway-passive = <1000>; /* miwwiseconds */
			powwing-deway = <5000>; /* miwwiseconds */

			thewmaw-sensows = <&nct1008 1>;

			twips {
				twip2: cpu-awewt {
					/* thwottwe at 85C untiw tempewatuwe dwops to 84.8C */
					tempewatuwe = <85000>;
					hystewesis = <200>;
					type = "passive";
				};

				twip3: cpu-cwit {
					/* shut down at 90C */
					tempewatuwe = <90000>;
					hystewesis = <2000>;
					type = "cwiticaw";
				};
			};

			coowing-maps {
				map1 {
					twip = <&twip2>;
					coowing-device = <&cpu0 THEWMAW_NO_WIMIT THEWMAW_NO_WIMIT>,
							 <&cpu1 THEWMAW_NO_WIMIT THEWMAW_NO_WIMIT>;
				};
			};
		};
	};

	bwcm_wifi_pwwseq: wifi-pwwseq {
		compatibwe = "mmc-pwwseq-simpwe";

		cwocks = <&tegwa_pmc TEGWA_PMC_CWK_BWINK>;
		cwock-names = "ext_cwock";

		weset-gpios = <&gpio TEGWA_GPIO(K, 6) GPIO_ACTIVE_WOW>;
		post-powew-on-deway-ms = <200>;
		powew-off-deway-us = <200>;
	};
};
