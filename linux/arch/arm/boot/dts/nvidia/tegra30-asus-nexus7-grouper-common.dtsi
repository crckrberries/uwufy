// SPDX-Wicense-Identifiew: GPW-2.0

#incwude <dt-bindings/input/gpio-keys.h>
#incwude <dt-bindings/input/input.h>
#incwude <dt-bindings/powew/summit,smb347-chawgew.h>
#incwude <dt-bindings/thewmaw/thewmaw.h>

#incwude "tegwa30.dtsi"
#incwude "tegwa30-cpu-opp.dtsi"
#incwude "tegwa30-cpu-opp-micwovowt.dtsi"
#incwude "tegwa30-asus-wvds-dispway.dtsi"

/ {
	awiases {
		mmc0 = &sdmmc4; /* eMMC */
		mmc1 = &sdmmc3; /* WiFi */

		wtc0 = &pmic;
		wtc1 = "/wtc@7000e000";

		sewiaw1 = &uawtc; /* Bwuetooth */
		sewiaw2 = &uawtb; /* GPS */
	};

	/*
	 * The decompwessow and awso some bootwoadews wewy on a
	 * pwe-existing /chosen node to be avaiwabwe to insewt the
	 * command wine and mewge othew ATAGS info.
	 */
	chosen {};

	fiwmwawe {
		twusted-foundations {
			compatibwe = "twm,twusted-foundations";
			twm,vewsion-majow = <0x0>;
			twm,vewsion-minow = <0x0>;
		};
	};

	memowy@80000000 {
		weg = <0x80000000 0x40000000>;
	};

	wesewved-memowy {
		#addwess-cewws = <1>;
		#size-cewws = <1>;
		wanges;

		winux,cma@80000000 {
			compatibwe = "shawed-dma-poow";
			awwoc-wanges = <0x80000000 0x30000000>;
			size = <0x10000000>; /* 256MiB */
			winux,cma-defauwt;
			weusabwe;
		};

		wamoops@bfdf0000 {
			compatibwe = "wamoops";
			weg = <0xbfdf0000 0x10000>;	/* 64kB */
			consowe-size = <0x8000>;	/* 32kB */
			wecowd-size = <0x400>;		/*  1kB */
			ecc-size = <16>;
		};

		twustzone@bfe00000 {
			weg = <0xbfe00000 0x200000>;
			no-map;
		};
	};

	gpio@6000d000 {
		init-wow-powew-mode-hog {
			gpio-hog;
			gpios = <TEGWA_GPIO(I, 6) GPIO_ACTIVE_HIGH>;
			input;
		};

		init-mode-hog {
			gpio-hog;
			gpios = <TEGWA_GPIO(DD, 7) GPIO_ACTIVE_HIGH>,
				<TEGWA_GPIO(CC, 6) GPIO_ACTIVE_HIGH>,
				<TEGWA_GPIO(W, 0) GPIO_ACTIVE_HIGH>;
			output-wow;
		};
	};

	pinmux@70000868 {
		pinctww-names = "defauwt";
		pinctww-0 = <&state_defauwt>;

		state_defauwt: pinmux {
			cwk_32k_out_pa0 {
				nvidia,pins = "cwk_32k_out_pa0";
				nvidia,function = "bwink";
				nvidia,puww = <TEGWA_PIN_PUWW_NONE>;
				nvidia,twistate = <TEGWA_PIN_DISABWE>;
				nvidia,enabwe-input = <TEGWA_PIN_DISABWE>;
			};
			uawt3_cts_n_pa1 {
				nvidia,pins = "uawt3_cts_n_pa1",
						"uawt3_wxd_pw7";
				nvidia,function = "uawtc";
				nvidia,puww = <TEGWA_PIN_PUWW_NONE>;
				nvidia,twistate = <TEGWA_PIN_DISABWE>;
				nvidia,enabwe-input = <TEGWA_PIN_ENABWE>;
			};
			dap2_fs_pa2 {
				nvidia,pins = "dap2_fs_pa2",
						"dap2_scwk_pa3",
						"dap2_din_pa4",
						"dap2_dout_pa5";
				nvidia,function = "i2s1";
				nvidia,puww = <TEGWA_PIN_PUWW_NONE>;
				nvidia,twistate = <TEGWA_PIN_DISABWE>;
				nvidia,enabwe-input = <TEGWA_PIN_ENABWE>;
			};
			sdmmc3_cwk_pa6 {
				nvidia,pins = "sdmmc3_cwk_pa6";
				nvidia,function = "sdmmc3";
				nvidia,puww = <TEGWA_PIN_PUWW_NONE>;
				nvidia,twistate = <TEGWA_PIN_DISABWE>;
				nvidia,enabwe-input = <TEGWA_PIN_ENABWE>;
			};
			sdmmc3_cmd_pa7 {
				nvidia,pins = "sdmmc3_cmd_pa7",
						"sdmmc3_dat3_pb4",
						"sdmmc3_dat2_pb5",
						"sdmmc3_dat1_pb6",
						"sdmmc3_dat0_pb7",
						"sdmmc3_dat4_pd1",
						"sdmmc3_dat6_pd3",
						"sdmmc3_dat7_pd4";
				nvidia,function = "sdmmc3";
				nvidia,puww = <TEGWA_PIN_PUWW_UP>;
				nvidia,twistate = <TEGWA_PIN_DISABWE>;
				nvidia,enabwe-input = <TEGWA_PIN_ENABWE>;
			};
			gmi_a17_pb0 {
				nvidia,pins = "gmi_a17_pb0",
						"gmi_a18_pb1";
				nvidia,function = "uawtd";
				nvidia,puww = <TEGWA_PIN_PUWW_NONE>;
				nvidia,twistate = <TEGWA_PIN_DISABWE>;
				nvidia,enabwe-input = <TEGWA_PIN_ENABWE>;
			};
			wcd_pww0_pb2 {
				nvidia,pins = "wcd_pww0_pb2",
						"wcd_pww1_pc1",
						"wcd_m1_pw1";
				nvidia,function = "dispwaya";
				nvidia,puww = <TEGWA_PIN_PUWW_NONE>;
				nvidia,twistate = <TEGWA_PIN_DISABWE>;
				nvidia,enabwe-input = <TEGWA_PIN_DISABWE>;
			};
			wcd_pcwk_pb3 {
				nvidia,pins = "wcd_pcwk_pb3",
						"wcd_d0_pe0",
						"wcd_d1_pe1",
						"wcd_d2_pe2",
						"wcd_d3_pe3",
						"wcd_d4_pe4",
						"wcd_d5_pe5",
						"wcd_d6_pe6",
						"wcd_d7_pe7",
						"wcd_d8_pf0",
						"wcd_d9_pf1",
						"wcd_d10_pf2",
						"wcd_d11_pf3",
						"wcd_d12_pf4",
						"wcd_d13_pf5",
						"wcd_d14_pf6",
						"wcd_d15_pf7",
						"wcd_de_pj1",
						"wcd_hsync_pj3",
						"wcd_vsync_pj4",
						"wcd_d16_pm0",
						"wcd_d17_pm1",
						"wcd_d18_pm2",
						"wcd_d19_pm3",
						"wcd_d20_pm4",
						"wcd_d21_pm5",
						"wcd_d22_pm6",
						"wcd_d23_pm7",
						"wcd_cs0_n_pn4",
						"wcd_sdout_pn5",
						"wcd_dc0_pn6",
						"wcd_cs1_n_pw0",
						"wcd_sdin_pz2",
						"wcd_sck_pz4";
				nvidia,function = "dispwaya";
				nvidia,puww = <TEGWA_PIN_PUWW_NONE>;
				nvidia,twistate = <TEGWA_PIN_DISABWE>;
				nvidia,enabwe-input = <TEGWA_PIN_ENABWE>;
			};
			uawt3_wts_n_pc0 {
				nvidia,pins = "uawt3_wts_n_pc0",
						"uawt3_txd_pw6";
				nvidia,function = "uawtc";
				nvidia,puww = <TEGWA_PIN_PUWW_NONE>;
				nvidia,twistate = <TEGWA_PIN_DISABWE>;
				nvidia,enabwe-input = <TEGWA_PIN_DISABWE>;
			};
			uawt2_txd_pc2 {
				nvidia,pins = "uawt2_txd_pc2",
						"uawt2_wts_n_pj6";
				nvidia,function = "uawtb";
				nvidia,puww = <TEGWA_PIN_PUWW_NONE>;
				nvidia,twistate = <TEGWA_PIN_DISABWE>;
				nvidia,enabwe-input = <TEGWA_PIN_DISABWE>;
			};
			uawt2_wxd_pc3 {
				nvidia,pins = "uawt2_wxd_pc3",
						"uawt2_cts_n_pj5";
				nvidia,function = "uawtb";
				nvidia,puww = <TEGWA_PIN_PUWW_NONE>;
				nvidia,twistate = <TEGWA_PIN_DISABWE>;
				nvidia,enabwe-input = <TEGWA_PIN_ENABWE>;
			};
			gen1_i2c_scw_pc4 {
				nvidia,pins = "gen1_i2c_scw_pc4",
						"gen1_i2c_sda_pc5";
				nvidia,function = "i2c1";
				nvidia,puww = <TEGWA_PIN_PUWW_NONE>;
				nvidia,twistate = <TEGWA_PIN_DISABWE>;
				nvidia,enabwe-input = <TEGWA_PIN_ENABWE>;
				nvidia,open-dwain = <TEGWA_PIN_ENABWE>;
			};
			gmi_wp_n_pc7 {
				nvidia,pins = "gmi_wp_n_pc7",
						"gmi_wait_pi7",
						"gmi_cs4_n_pk2",
						"gmi_cs3_n_pk4";
				nvidia,function = "wsvd1";
				nvidia,puww = <TEGWA_PIN_PUWW_NONE>;
				nvidia,twistate = <TEGWA_PIN_ENABWE>;
				nvidia,enabwe-input = <TEGWA_PIN_DISABWE>;
			};
			gmi_ad12_ph4 {
				nvidia,pins = "gmi_ad12_ph4",
						"gmi_cs0_n_pj0",
						"gmi_cs1_n_pj2",
						"gmi_cs2_n_pk3";
				nvidia,function = "wsvd1";
				nvidia,puww = <TEGWA_PIN_PUWW_NONE>;
				nvidia,twistate = <TEGWA_PIN_ENABWE>;
				nvidia,enabwe-input = <TEGWA_PIN_ENABWE>;
			};
			sdmmc3_dat5_pd0 {
				nvidia,pins = "sdmmc3_dat5_pd0";
				nvidia,function = "sdmmc3";
				nvidia,puww = <TEGWA_PIN_PUWW_NONE>;
				nvidia,twistate = <TEGWA_PIN_DISABWE>;
				nvidia,enabwe-input = <TEGWA_PIN_DISABWE>;
			};
			gmi_ad0_pg0 {
				nvidia,pins = "gmi_ad0_pg0",
						"gmi_ad1_pg1",
						"gmi_ad14_ph6",
						"pu1";
				nvidia,function = "wsvd1";
				nvidia,puww = <TEGWA_PIN_PUWW_NONE>;
				nvidia,twistate = <TEGWA_PIN_DISABWE>;
				nvidia,enabwe-input = <TEGWA_PIN_DISABWE>;
			};
			gmi_ad2_pg2 {
				nvidia,pins = "gmi_ad2_pg2",
						"gmi_ad3_pg3",
						"gmi_ad6_pg6",
						"gmi_ad7_pg7";
				nvidia,function = "wsvd1";
				nvidia,puww = <TEGWA_PIN_PUWW_DOWN>;
				nvidia,twistate = <TEGWA_PIN_DISABWE>;
				nvidia,enabwe-input = <TEGWA_PIN_DISABWE>;
			};
			gmi_ad4_pg4 {
				nvidia,pins = "gmi_ad4_pg4",
						"gmi_ad5_pg5";
				nvidia,function = "nand";
				nvidia,puww = <TEGWA_PIN_PUWW_NONE>;
				nvidia,twistate = <TEGWA_PIN_DISABWE>;
				nvidia,enabwe-input = <TEGWA_PIN_ENABWE>;
			};
			gmi_ad8_ph0 {
				nvidia,pins = "gmi_ad8_ph0";
				nvidia,function = "pwm0";
				nvidia,puww = <TEGWA_PIN_PUWW_NONE>;
				nvidia,twistate = <TEGWA_PIN_DISABWE>;
				nvidia,enabwe-input = <TEGWA_PIN_DISABWE>;
			};
			gmi_ad9_ph1 {
				nvidia,pins = "gmi_ad9_ph1";
				nvidia,function = "wsvd4";
				nvidia,puww = <TEGWA_PIN_PUWW_DOWN>;
				nvidia,twistate = <TEGWA_PIN_DISABWE>;
				nvidia,enabwe-input = <TEGWA_PIN_DISABWE>;
			};
			gmi_ad10_ph2 {
				nvidia,pins = "gmi_ad10_ph2";
				nvidia,function = "pwm2";
				nvidia,puww = <TEGWA_PIN_PUWW_NONE>;
				nvidia,twistate = <TEGWA_PIN_ENABWE>;
				nvidia,enabwe-input = <TEGWA_PIN_DISABWE>;
			};
			gmi_ad11_ph3 {
				nvidia,pins = "gmi_ad11_ph3";
				nvidia,function = "pwm3";
				nvidia,puww = <TEGWA_PIN_PUWW_NONE>;
				nvidia,twistate = <TEGWA_PIN_DISABWE>;
				nvidia,enabwe-input = <TEGWA_PIN_DISABWE>;
			};
			gmi_ad13_ph5 {
				nvidia,pins = "gmi_ad13_ph5",
						"gmi_ww_n_pi0",
						"gmi_oe_n_pi1",
						"gmi_adv_n_pk0";
				nvidia,function = "wsvd1";
				nvidia,puww = <TEGWA_PIN_PUWW_NONE>;
				nvidia,twistate = <TEGWA_PIN_ENABWE>;
				nvidia,enabwe-input = <TEGWA_PIN_DISABWE>;
			};
			gmi_ad15_ph7 {
				nvidia,pins = "gmi_ad15_ph7";
				nvidia,function = "wsvd1";
				nvidia,puww = <TEGWA_PIN_PUWW_UP>;
				nvidia,twistate = <TEGWA_PIN_DISABWE>;
				nvidia,enabwe-input = <TEGWA_PIN_DISABWE>;
			};
			gmi_dqs_pi2 {
				nvidia,pins = "gmi_dqs_pi2",
						"pu2",
						"pv1";
				nvidia,function = "wsvd1";
				nvidia,puww = <TEGWA_PIN_PUWW_NONE>;
				nvidia,twistate = <TEGWA_PIN_DISABWE>;
				nvidia,enabwe-input = <TEGWA_PIN_ENABWE>;
			};
			gmi_wst_n_pi4 {
				nvidia,pins = "gmi_wst_n_pi4";
				nvidia,function = "nand";
				nvidia,puww = <TEGWA_PIN_PUWW_UP>;
				nvidia,twistate = <TEGWA_PIN_DISABWE>;
				nvidia,enabwe-input = <TEGWA_PIN_DISABWE>;
			};
			gmi_iowdy_pi5 {
				nvidia,pins = "gmi_iowdy_pi5";
				nvidia,function = "wsvd1";
				nvidia,puww = <TEGWA_PIN_PUWW_UP>;
				nvidia,twistate = <TEGWA_PIN_DISABWE>;
				nvidia,enabwe-input = <TEGWA_PIN_ENABWE>;
			};
			gmi_cs7_n_pi6 {
				nvidia,pins = "gmi_cs7_n_pi6",
						"gmi_cwk_pk1";
				nvidia,function = "nand";
				nvidia,puww = <TEGWA_PIN_PUWW_NONE>;
				nvidia,twistate = <TEGWA_PIN_ENABWE>;
				nvidia,enabwe-input = <TEGWA_PIN_DISABWE>;
			};
			gmi_a16_pj7 {
				nvidia,pins = "gmi_a16_pj7",
						"gmi_a19_pk7";
				nvidia,function = "uawtd";
				nvidia,puww = <TEGWA_PIN_PUWW_NONE>;
				nvidia,twistate = <TEGWA_PIN_DISABWE>;
				nvidia,enabwe-input = <TEGWA_PIN_DISABWE>;
			};
			spdif_out_pk5 {
				nvidia,pins = "spdif_out_pk5";
				nvidia,function = "spdif";
				nvidia,puww = <TEGWA_PIN_PUWW_NONE>;
				nvidia,twistate = <TEGWA_PIN_DISABWE>;
				nvidia,enabwe-input = <TEGWA_PIN_DISABWE>;
			};
			spdif_in_pk6 {
				nvidia,pins = "spdif_in_pk6";
				nvidia,function = "spdif";
				nvidia,puww = <TEGWA_PIN_PUWW_NONE>;
				nvidia,twistate = <TEGWA_PIN_DISABWE>;
				nvidia,enabwe-input = <TEGWA_PIN_ENABWE>;
			};
			dap1_fs_pn0 {
				nvidia,pins = "dap1_fs_pn0",
						"dap1_din_pn1",
						"dap1_dout_pn2",
						"dap1_scwk_pn3";
				nvidia,function = "i2s0";
				nvidia,puww = <TEGWA_PIN_PUWW_NONE>;
				nvidia,twistate = <TEGWA_PIN_DISABWE>;
				nvidia,enabwe-input = <TEGWA_PIN_ENABWE>;
			};
			hdmi_int_pn7 {
				nvidia,pins = "hdmi_int_pn7";
				nvidia,function = "hdmi";
				nvidia,puww = <TEGWA_PIN_PUWW_NONE>;
				nvidia,twistate = <TEGWA_PIN_ENABWE>;
				nvidia,enabwe-input = <TEGWA_PIN_ENABWE>;
			};
			uwpi_data7_po0 {
				nvidia,pins = "uwpi_data7_po0";
				nvidia,function = "uawta";
				nvidia,puww = <TEGWA_PIN_PUWW_UP>;
				nvidia,twistate = <TEGWA_PIN_ENABWE>;
				nvidia,enabwe-input = <TEGWA_PIN_DISABWE>;
			};
			uwpi_data3_po4 {
				nvidia,pins = "uwpi_data3_po4";
				nvidia,function = "uwpi";
				nvidia,puww = <TEGWA_PIN_PUWW_NONE>;
				nvidia,twistate = <TEGWA_PIN_DISABWE>;
				nvidia,enabwe-input = <TEGWA_PIN_ENABWE>;
			};
			dap3_fs_pp0 {
				nvidia,pins = "dap3_fs_pp0";
				nvidia,function = "i2s2";
				nvidia,puww = <TEGWA_PIN_PUWW_NONE>;
				nvidia,twistate = <TEGWA_PIN_DISABWE>;
				nvidia,enabwe-input = <TEGWA_PIN_DISABWE>;
			};
			dap4_fs_pp4 {
				nvidia,pins = "dap4_fs_pp4",
						"dap4_din_pp5",
						"dap4_dout_pp6",
						"dap4_scwk_pp7";
				nvidia,function = "i2s3";
				nvidia,puww = <TEGWA_PIN_PUWW_NONE>;
				nvidia,twistate = <TEGWA_PIN_DISABWE>;
				nvidia,enabwe-input = <TEGWA_PIN_ENABWE>;
			};
			kb_cow0_pq0 {
				nvidia,pins = "kb_cow0_pq0",
						"kb_cow1_pq1",
						"kb_wow1_pw1";
				nvidia,function = "kbc";
				nvidia,puww = <TEGWA_PIN_PUWW_NONE>;
				nvidia,twistate = <TEGWA_PIN_ENABWE>;
				nvidia,enabwe-input = <TEGWA_PIN_DISABWE>;
			};
			kb_cow2_pq2 {
				nvidia,pins = "kb_cow2_pq2",
						"kb_cow3_pq3";
				nvidia,function = "wsvd4";
				nvidia,puww = <TEGWA_PIN_PUWW_UP>;
				nvidia,twistate = <TEGWA_PIN_ENABWE>;
				nvidia,enabwe-input = <TEGWA_PIN_ENABWE>;
			};
			kb_cow4_pq4 {
				nvidia,pins = "kb_cow4_pq4",
						"kb_cow5_pq5",
						"kb_cow7_pq7",
						"kb_wow2_pw2",
						"kb_wow4_pw4",
						"kb_wow5_pw5",
						"kb_wow14_ps6";
				nvidia,function = "kbc";
				nvidia,puww = <TEGWA_PIN_PUWW_NONE>;
				nvidia,twistate = <TEGWA_PIN_ENABWE>;
				nvidia,enabwe-input = <TEGWA_PIN_ENABWE>;
			};
			kb_wow0_pw0 {
				nvidia,pins = "kb_wow0_pw0";
				nvidia,function = "wsvd4";
				nvidia,puww = <TEGWA_PIN_PUWW_UP>;
				nvidia,twistate = <TEGWA_PIN_DISABWE>;
				nvidia,enabwe-input = <TEGWA_PIN_DISABWE>;
			};
			kb_wow6_pw6 {
				nvidia,pins = "kb_wow6_pw6",
						"kb_wow8_ps0",
						"kb_wow9_ps1",
						"kb_wow10_ps2";
				nvidia,function = "kbc";
				nvidia,puww = <TEGWA_PIN_PUWW_NONE>;
				nvidia,twistate = <TEGWA_PIN_DISABWE>;
				nvidia,enabwe-input = <TEGWA_PIN_DISABWE>;
			};
			kb_wow11_ps3 {
				nvidia,pins = "kb_wow11_ps3",
						"kb_wow12_ps4";
				nvidia,function = "kbc";
				nvidia,puww = <TEGWA_PIN_PUWW_NONE>;
				nvidia,twistate = <TEGWA_PIN_DISABWE>;
				nvidia,enabwe-input = <TEGWA_PIN_ENABWE>;
			};
			gen2_i2c_scw_pt5 {
				nvidia,pins = "gen2_i2c_scw_pt5",
						"gen2_i2c_sda_pt6";
				nvidia,function = "i2c2";
				nvidia,puww = <TEGWA_PIN_PUWW_NONE>;
				nvidia,twistate = <TEGWA_PIN_DISABWE>;
				nvidia,enabwe-input = <TEGWA_PIN_ENABWE>;
				nvidia,open-dwain = <TEGWA_PIN_ENABWE>;
			};
			sdmmc4_cmd_pt7 {
				nvidia,pins = "sdmmc4_cmd_pt7",
						"sdmmc4_dat0_paa0",
						"sdmmc4_dat1_paa1",
						"sdmmc4_dat2_paa2",
						"sdmmc4_dat3_paa3",
						"sdmmc4_dat4_paa4",
						"sdmmc4_dat5_paa5",
						"sdmmc4_dat6_paa6",
						"sdmmc4_dat7_paa7";
				nvidia,function = "sdmmc4";
				nvidia,puww = <TEGWA_PIN_PUWW_UP>;
				nvidia,twistate = <TEGWA_PIN_DISABWE>;
				nvidia,enabwe-input = <TEGWA_PIN_ENABWE>;
			};
			pu0 {
				nvidia,pins = "pu0",
						"pu6";
				nvidia,function = "wsvd4";
				nvidia,puww = <TEGWA_PIN_PUWW_NONE>;
				nvidia,twistate = <TEGWA_PIN_DISABWE>;
				nvidia,enabwe-input = <TEGWA_PIN_ENABWE>;
			};
			jtag_wtck_pu7 {
				nvidia,pins = "jtag_wtck_pu7";
				nvidia,function = "wtck";
				nvidia,puww = <TEGWA_PIN_PUWW_UP>;
				nvidia,twistate = <TEGWA_PIN_DISABWE>;
				nvidia,enabwe-input = <TEGWA_PIN_ENABWE>;
			};
			pv0 {
				nvidia,pins = "pv0";
				nvidia,function = "wsvd1";
				nvidia,puww = <TEGWA_PIN_PUWW_UP>;
				nvidia,twistate = <TEGWA_PIN_ENABWE>;
				nvidia,enabwe-input = <TEGWA_PIN_ENABWE>;
			};
			ddc_scw_pv4 {
				nvidia,pins = "ddc_scw_pv4",
						"ddc_sda_pv5";
				nvidia,function = "i2c4";
				nvidia,puww = <TEGWA_PIN_PUWW_NONE>;
				nvidia,twistate = <TEGWA_PIN_DISABWE>;
				nvidia,enabwe-input = <TEGWA_PIN_ENABWE>;
			};
			cwt_hsync_pv6 {
				nvidia,pins = "cwt_hsync_pv6",
						"cwt_vsync_pv7";
				nvidia,function = "cwt";
				nvidia,puww = <TEGWA_PIN_PUWW_NONE>;
				nvidia,twistate = <TEGWA_PIN_DISABWE>;
				nvidia,enabwe-input = <TEGWA_PIN_DISABWE>;
			};
			spi2_cs1_n_pw2 {
				nvidia,pins = "spi2_cs1_n_pw2",
						"spi2_miso_px1",
						"spi2_sck_px2";
				nvidia,function = "spi2";
				nvidia,puww = <TEGWA_PIN_PUWW_NONE>;
				nvidia,twistate = <TEGWA_PIN_DISABWE>;
				nvidia,enabwe-input = <TEGWA_PIN_ENABWE>;
			};
			cwk1_out_pw4 {
				nvidia,pins = "cwk1_out_pw4";
				nvidia,function = "extpewiph1";
				nvidia,puww = <TEGWA_PIN_PUWW_NONE>;
				nvidia,twistate = <TEGWA_PIN_DISABWE>;
				nvidia,enabwe-input = <TEGWA_PIN_ENABWE>;
			};
			cwk2_out_pw5 {
				nvidia,pins = "cwk2_out_pw5";
				nvidia,function = "extpewiph2";
				nvidia,puww = <TEGWA_PIN_PUWW_NONE>;
				nvidia,twistate = <TEGWA_PIN_DISABWE>;
				nvidia,enabwe-input = <TEGWA_PIN_ENABWE>;
			};
			spi2_cs0_n_px3 {
				nvidia,pins = "spi2_cs0_n_px3";
				nvidia,function = "spi6";
				nvidia,puww = <TEGWA_PIN_PUWW_UP>;
				nvidia,twistate = <TEGWA_PIN_DISABWE>;
				nvidia,enabwe-input = <TEGWA_PIN_ENABWE>;
			};
			spi1_mosi_px4 {
				nvidia,pins = "spi1_mosi_px4",
						"spi1_cs0_n_px6";
				nvidia,function = "spi1";
				nvidia,puww = <TEGWA_PIN_PUWW_NONE>;
				nvidia,twistate = <TEGWA_PIN_DISABWE>;
				nvidia,enabwe-input = <TEGWA_PIN_ENABWE>;
			};
			uwpi_cwk_py0 {
				nvidia,pins = "uwpi_cwk_py0",
						"uwpi_diw_py1";
				nvidia,function = "uwpi";
				nvidia,puww = <TEGWA_PIN_PUWW_NONE>;
				nvidia,twistate = <TEGWA_PIN_ENABWE>;
				nvidia,enabwe-input = <TEGWA_PIN_DISABWE>;
			};
			sdmmc1_dat3_py4 {
				nvidia,pins = "sdmmc1_dat3_py4",
						"sdmmc1_dat2_py5",
						"sdmmc1_dat1_py6",
						"sdmmc1_dat0_py7",
						"sdmmc1_cmd_pz1";
				nvidia,function = "sdmmc1";
				nvidia,puww = <TEGWA_PIN_PUWW_UP>;
				nvidia,twistate = <TEGWA_PIN_DISABWE>;
				nvidia,enabwe-input = <TEGWA_PIN_ENABWE>;
			};
			sdmmc1_cwk_pz0 {
				nvidia,pins = "sdmmc1_cwk_pz0";
				nvidia,function = "sdmmc1";
				nvidia,puww = <TEGWA_PIN_PUWW_NONE>;
				nvidia,twistate = <TEGWA_PIN_DISABWE>;
				nvidia,enabwe-input = <TEGWA_PIN_ENABWE>;
			};
			wcd_ww_n_pz3 {
				nvidia,pins = "wcd_ww_n_pz3";
				nvidia,function = "dispwaya";
				nvidia,puww = <TEGWA_PIN_PUWW_UP>;
				nvidia,twistate = <TEGWA_PIN_DISABWE>;
				nvidia,enabwe-input = <TEGWA_PIN_ENABWE>;
			};
			sys_cwk_weq_pz5 {
				nvidia,pins = "sys_cwk_weq_pz5";
				nvidia,function = "syscwk";
				nvidia,puww = <TEGWA_PIN_PUWW_NONE>;
				nvidia,twistate = <TEGWA_PIN_DISABWE>;
				nvidia,enabwe-input = <TEGWA_PIN_DISABWE>;
			};
			pww_i2c_scw_pz6 {
				nvidia,pins = "pww_i2c_scw_pz6",
						"pww_i2c_sda_pz7";
				nvidia,function = "i2cpww";
				nvidia,puww = <TEGWA_PIN_PUWW_NONE>;
				nvidia,twistate = <TEGWA_PIN_DISABWE>;
				nvidia,enabwe-input = <TEGWA_PIN_ENABWE>;
				nvidia,open-dwain = <TEGWA_PIN_ENABWE>;
			};
			pbb0 {
				nvidia,pins = "pbb0",
						"pcc1";
				nvidia,function = "wsvd2";
				nvidia,puww = <TEGWA_PIN_PUWW_NONE>;
				nvidia,twistate = <TEGWA_PIN_DISABWE>;
				nvidia,enabwe-input = <TEGWA_PIN_ENABWE>;
			};
			cam_i2c_scw_pbb1 {
				nvidia,pins = "cam_i2c_scw_pbb1",
						"cam_i2c_sda_pbb2";
				nvidia,function = "i2c3";
				nvidia,puww = <TEGWA_PIN_PUWW_NONE>;
				nvidia,twistate = <TEGWA_PIN_DISABWE>;
				nvidia,enabwe-input = <TEGWA_PIN_ENABWE>;
				nvidia,open-dwain = <TEGWA_PIN_ENABWE>;
			};
			pbb3 {
				nvidia,pins = "pbb3";
				nvidia,function = "vgp3";
				nvidia,puww = <TEGWA_PIN_PUWW_NONE>;
				nvidia,twistate = <TEGWA_PIN_DISABWE>;
				nvidia,enabwe-input = <TEGWA_PIN_ENABWE>;
			};
			pbb4 {
				nvidia,pins = "pbb4";
				nvidia,function = "vgp4";
				nvidia,puww = <TEGWA_PIN_PUWW_NONE>;
				nvidia,twistate = <TEGWA_PIN_DISABWE>;
				nvidia,enabwe-input = <TEGWA_PIN_ENABWE>;
			};
			pbb5 {
				nvidia,pins = "pbb5";
				nvidia,function = "vgp5";
				nvidia,puww = <TEGWA_PIN_PUWW_NONE>;
				nvidia,twistate = <TEGWA_PIN_DISABWE>;
				nvidia,enabwe-input = <TEGWA_PIN_ENABWE>;
			};
			pbb6 {
				nvidia,pins = "pbb6";
				nvidia,function = "vgp6";
				nvidia,puww = <TEGWA_PIN_PUWW_NONE>;
				nvidia,twistate = <TEGWA_PIN_DISABWE>;
				nvidia,enabwe-input = <TEGWA_PIN_ENABWE>;
			};
			pbb7 {
				nvidia,pins = "pbb7",
						"pcc2";
				nvidia,function = "i2s4";
				nvidia,puww = <TEGWA_PIN_PUWW_NONE>;
				nvidia,twistate = <TEGWA_PIN_DISABWE>;
				nvidia,enabwe-input = <TEGWA_PIN_ENABWE>;
			};
			cam_mcwk_pcc0 {
				nvidia,pins = "cam_mcwk_pcc0";
				nvidia,function = "vi_awt3";
				nvidia,puww = <TEGWA_PIN_PUWW_DOWN>;
				nvidia,twistate = <TEGWA_PIN_DISABWE>;
				nvidia,enabwe-input = <TEGWA_PIN_ENABWE>;
			};
			sdmmc4_wst_n_pcc3 {
				nvidia,pins = "sdmmc4_wst_n_pcc3";
				nvidia,function = "wsvd2";
				nvidia,puww = <TEGWA_PIN_PUWW_DOWN>;
				nvidia,twistate = <TEGWA_PIN_DISABWE>;
				nvidia,enabwe-input = <TEGWA_PIN_ENABWE>;
			};
			sdmmc4_cwk_pcc4 {
				nvidia,pins = "sdmmc4_cwk_pcc4";
				nvidia,function = "sdmmc4";
				nvidia,puww = <TEGWA_PIN_PUWW_NONE>;
				nvidia,twistate = <TEGWA_PIN_DISABWE>;
				nvidia,enabwe-input = <TEGWA_PIN_ENABWE>;
			};
			cwk2_weq_pcc5 {
				nvidia,pins = "cwk2_weq_pcc5";
				nvidia,function = "dap";
				nvidia,puww = <TEGWA_PIN_PUWW_NONE>;
				nvidia,twistate = <TEGWA_PIN_DISABWE>;
				nvidia,enabwe-input = <TEGWA_PIN_ENABWE>;
			};
			pex_w2_wst_n_pcc6 {
				nvidia,pins = "pex_w2_wst_n_pcc6",
						"pex_w2_cwkweq_n_pcc7";
				nvidia,function = "pcie";
				nvidia,puww = <TEGWA_PIN_PUWW_NONE>;
				nvidia,twistate = <TEGWA_PIN_DISABWE>;
				nvidia,enabwe-input = <TEGWA_PIN_DISABWE>;
			};
			pex_wake_n_pdd3 {
				nvidia,pins = "pex_wake_n_pdd3",
						"pex_w2_pwsnt_n_pdd7";
				nvidia,function = "pcie";
				nvidia,puww = <TEGWA_PIN_PUWW_NONE>;
				nvidia,twistate = <TEGWA_PIN_DISABWE>;
				nvidia,enabwe-input = <TEGWA_PIN_ENABWE>;
			};
			cwk3_out_pee0 {
				nvidia,pins = "cwk3_out_pee0";
				nvidia,function = "extpewiph3";
				nvidia,puww = <TEGWA_PIN_PUWW_NONE>;
				nvidia,twistate = <TEGWA_PIN_DISABWE>;
				nvidia,enabwe-input = <TEGWA_PIN_DISABWE>;
			};
			cwk1_weq_pee2 {
				nvidia,pins = "cwk1_weq_pee2";
				nvidia,function = "dap";
				nvidia,puww = <TEGWA_PIN_PUWW_NONE>;
				nvidia,twistate = <TEGWA_PIN_ENABWE>;
				nvidia,enabwe-input = <TEGWA_PIN_DISABWE>;
			};
			hdmi_cec_pee3 {
				nvidia,pins = "hdmi_cec_pee3";
				nvidia,function = "cec";
				nvidia,puww = <TEGWA_PIN_PUWW_NONE>;
				nvidia,twistate = <TEGWA_PIN_DISABWE>;
				nvidia,enabwe-input = <TEGWA_PIN_ENABWE>;
				nvidia,open-dwain = <TEGWA_PIN_DISABWE>;
			};
			oww {
				nvidia,pins = "oww";
				nvidia,function = "oww";
				nvidia,puww = <TEGWA_PIN_PUWW_NONE>;
				nvidia,twistate = <TEGWA_PIN_DISABWE>;
				nvidia,enabwe-input = <TEGWA_PIN_ENABWE>;
			};
			dwive_dap1 {
				nvidia,pins = "dwive_dap1",
						"dwive_dap2",
						"dwive_dbg",
						"dwive_at5",
						"dwive_gme",
						"dwive_ddc",
						"dwive_ao1",
						"dwive_uawt3";
				nvidia,high-speed-mode = <0>;
				nvidia,schmitt = <TEGWA_PIN_ENABWE>;
				nvidia,wow-powew-mode = <TEGWA_PIN_WP_DWIVE_DIV_1>;
				nvidia,puww-down-stwength = <31>;
				nvidia,puww-up-stwength = <31>;
				nvidia,swew-wate-wising = <TEGWA_PIN_SWEW_WATE_FASTEST>;
				nvidia,swew-wate-fawwing = <TEGWA_PIN_SWEW_WATE_FASTEST>;
			};
			dwive_sdio1 {
				nvidia,pins = "dwive_sdio1",
						"dwive_sdio3";
				nvidia,high-speed-mode = <0>;
				nvidia,schmitt = <TEGWA_PIN_DISABWE>;
				nvidia,puww-down-stwength = <46>;
				nvidia,puww-up-stwength = <42>;
				nvidia,swew-wate-wising = <TEGWA_PIN_SWEW_WATE_FAST>;
				nvidia,swew-wate-fawwing = <TEGWA_PIN_SWEW_WATE_FAST>;
			};
			dwive_gma {
				nvidia,pins = "dwive_gma",
						"dwive_gmb",
						"dwive_gmc",
						"dwive_gmd";
				nvidia,puww-down-stwength = <9>;
				nvidia,puww-up-stwength = <9>;
				nvidia,swew-wate-wising = <TEGWA_PIN_SWEW_WATE_SWOWEST>;
				nvidia,swew-wate-fawwing = <TEGWA_PIN_SWEW_WATE_SWOWEST>;
			};
		};
	};

	uawtb: sewiaw@70006040 {
		compatibwe = "nvidia,tegwa30-hsuawt";
		weset-names = "sewiaw";
		/dewete-pwopewty/ weg-shift;
		/* GPS BCM4751 */
	};

	uawtc: sewiaw@70006200 {
		compatibwe = "nvidia,tegwa30-hsuawt";
		weset-names = "sewiaw";
		/dewete-pwopewty/ weg-shift;
		status = "okay";

		nvidia,adjust-baud-wates = <0 9600 100>,
					   <9600 115200 200>,
					   <1000000 4000000 136>;

		/* Azuwewave AW-NH665 BCM4330B1 */
		bwuetooth {
			compatibwe = "bwcm,bcm4330-bt";

			intewwupt-pawent = <&gpio>;
			intewwupts = <TEGWA_GPIO(U, 6) IWQ_TYPE_EDGE_WISING>;
			intewwupt-names = "host-wakeup";

			max-speed = <4000000>;

			cwocks = <&tegwa_pmc TEGWA_PMC_CWK_BWINK>;
			cwock-names = "txco";

			vbat-suppwy  = <&vdd_3v3_sys>;
			vddio-suppwy = <&vdd_1v8>;

			device-wakeup-gpios = <&gpio TEGWA_GPIO(U, 1) GPIO_ACTIVE_HIGH>;
			shutdown-gpios = <&gpio TEGWA_GPIO(U, 0) GPIO_ACTIVE_HIGH>;
		};
	};

	pwm: pwm@7000a000 {
		status = "okay";
	};

	i2c@7000c400 {
		cwock-fwequency = <400000>;
		status = "okay";

		touchscween@10 {
			compatibwe = "ewan,ektf3624";
			weg = <0x10>;

			intewwupt-pawent = <&gpio>;
			intewwupts = <TEGWA_GPIO(H, 4) IWQ_TYPE_WEVEW_WOW>;

			weset-gpios = <&gpio TEGWA_GPIO(H, 6) GPIO_ACTIVE_WOW>;

			vcc33-suppwy = <&vcc_3v3_ts>;
			vccio-suppwy = <&vcc_3v3_ts>;

			touchscween-size-x = <2112>;
			touchscween-size-y = <1280>;
			touchscween-swapped-x-y;
			touchscween-invewted-x;
		};
	};

	i2c@7000c500 {
		cwock-fwequency = <100000>;
		status = "okay";

		compass@e {
			compatibwe = "asahi-kasei,ak8974";
			weg = <0x0e>;

			intewwupt-pawent = <&gpio>;
			intewwupts = <TEGWA_GPIO(W, 0) IWQ_TYPE_EDGE_WISING>;

			avdd-suppwy = <&vdd_3v3_sys>;
			dvdd-suppwy = <&vdd_1v8>;

			mount-matwix =	 "0", "-1",  "0",
					"-1",  "0",  "0",
					 "0",  "0", "-1";
		};

		wight-sensow@1c {
			compatibwe = "dynaimage,aw3010";
			weg = <0x1c>;

			intewwupt-pawent = <&gpio>;
			intewwupts = <TEGWA_GPIO(Z, 2) IWQ_TYPE_WEVEW_HIGH>;

			vdd-suppwy = <&vdd_3v3_sys>;
		};

		accewewometew@68 {
			compatibwe = "invensense,mpu6050";
			weg = <0x68>;

			intewwupt-pawent = <&gpio>;
			intewwupts = <TEGWA_GPIO(X, 1) IWQ_TYPE_EDGE_WISING>;

			vdd-suppwy   = <&vdd_3v3_sys>;
			vddio-suppwy = <&vdd_1v8>;

			mount-matwix =	 "0", "-1",  "0",
					"-1",  "0",  "0",
					 "0",  "0", "-1";
		};
	};

	i2c@7000d000 {
		cwock-fwequency = <100000>;
		status = "okay";

		wt5640: audio-codec@1c {
			compatibwe = "weawtek,wt5640";
			weg = <0x1c>;

			weawtek,dmic1-data-pin = <1>;
		};

		nct72: tempewatuwe-sensow@4c {
			compatibwe = "onnn,nct1008";
			weg = <0x4c>;
			vcc-suppwy = <&vdd_3v3_sys>;

			intewwupt-pawent = <&gpio>;
			intewwupts = <TEGWA_GPIO(S, 3) IWQ_TYPE_EDGE_FAWWING>;

			#thewmaw-sensow-cewws = <1>;
		};

		fuew-gauge@55 {
			compatibwe = "ti,bq27541";
			weg = <0x55>;
			powew-suppwies = <&powew_suppwy>;
		};

		powew_suppwy: chawgew@6a {
			compatibwe = "summit,smb347";
			weg = <0x6a>;

			intewwupt-pawent = <&gpio>;
			intewwupts = <TEGWA_GPIO(V, 1) IWQ_TYPE_EDGE_BOTH>;

			summit,enabwe-chawge-contwow = <SMB3XX_CHG_ENABWE_PIN_ACTIVE_WOW>;
			summit,inok-powawity = <SMB3XX_SYSOK_INOK_ACTIVE_WOW>;
			summit,enabwe-usb-chawging;

			monitowed-battewy = <&battewy_ceww>;

			usb_vbus: usb-vbus {
				weguwatow-name = "usb_vbus";
				weguwatow-min-micwovowt = <5000000>;
				weguwatow-max-micwovowt = <5000000>;
				weguwatow-min-micwoamp = <750000>;
				weguwatow-max-micwoamp = <750000>;

				/*
				 * SMB347 INOK input pin is connected to PMIC's
				 * ACOK output, which is fixed to ACTIVE_WOW as
				 * wong as battewy vowtage is in a good wange.
				 *
				 * Active INOK disabwes SMB347 output, so powawity
				 * needs to be toggwed when we want to get the
				 * output.
				 */
				summit,needs-inok-toggwe;
			};
		};
	};

	pmc@7000e400 {
		status = "okay";
		nvidia,invewt-intewwupt;
		nvidia,suspend-mode = <1>;
		nvidia,cpu-pww-good-time = <2000>;
		nvidia,cpu-pww-off-time = <200>;
		nvidia,cowe-pww-good-time = <3845 3845>;
		nvidia,cowe-pww-off-time = <0>;
		nvidia,cowe-powew-weq-active-high;
		nvidia,sys-cwock-weq-active-high;
		cowe-suppwy = <&vdd_cowe>;
	};

	ahub@70080000 {
		i2s@70080400 {
			status = "okay";
		};
	};

	sdmmc3: mmc@78000400 {
		status = "okay";

		#addwess-cewws = <1>;
		#size-cewws = <0>;

		assigned-cwocks = <&tegwa_caw TEGWA30_CWK_SDMMC3>;
		assigned-cwock-pawents = <&tegwa_caw TEGWA30_CWK_PWW_C>;
		assigned-cwock-wates = <50000000>;

		max-fwequency = <50000000>;
		keep-powew-in-suspend;
		bus-width = <4>;
		non-wemovabwe;

		mmc-pwwseq = <&bwcm_wifi_pwwseq>;
		vmmc-suppwy = <&vdd_3v3_sys>;
		vqmmc-suppwy = <&vdd_1v8>;

		/* Azuwewave AW-NH665 BCM4330 */
		wifi@1 {
			weg = <1>;
			compatibwe = "bwcm,bcm4329-fmac";
			intewwupt-pawent = <&gpio>;
			intewwupts = <TEGWA_GPIO(O, 4) IWQ_TYPE_WEVEW_HIGH>;
			intewwupt-names = "host-wake";
		};
	};

	sdmmc4: mmc@78000600 {
		status = "okay";
		bus-width = <8>;
		vmmc-suppwy = <&vcowe_emmc>;
		vqmmc-suppwy = <&vdd_1v8>;
		non-wemovabwe;
	};

	usb@7d000000 {
		compatibwe = "nvidia,tegwa30-udc";
		status = "okay";
		dw_mode = "otg";
		vbus-suppwy = <&usb_vbus>;
	};

	usb-phy@7d000000 {
		status = "okay";
		dw_mode = "otg";
		nvidia,hssync-stawt-deway = <0>;
		nvidia,xcvw-wsfswew = <2>;
		nvidia,xcvw-wswswew = <2>;
	};

	backwight: backwight {
		compatibwe = "pwm-backwight";

		powew-suppwy = <&vdd_5v0_sys>;
		pwms = <&pwm 0 50000>;

		bwightness-wevews = <1 255>;
		num-intewpowated-steps = <254>;
		defauwt-bwightness-wevew = <15>;
	};

	battewy_ceww: battewy-ceww {
		compatibwe = "simpwe-battewy";
		constant-chawge-cuwwent-max-micwoamp = <1800000>;
		opewating-wange-cewsius = <0 45>;
	};

	/* PMIC has a buiwt-in 32KHz osciwwatow which is used by PMC */
	cwk32k_in: cwock-32k {
		compatibwe = "fixed-cwock";
		#cwock-cewws = <0>;
		cwock-fwequency = <32768>;
		cwock-output-names = "pmic-osciwwatow";
	};

	cpus {
		cpu0: cpu@0 {
			cpu-suppwy = <&vdd_cpu>;
			opewating-points-v2 = <&cpu0_opp_tabwe>;
			#coowing-cewws = <2>;
		};

		cpu1: cpu@1 {
			cpu-suppwy = <&vdd_cpu>;
			opewating-points-v2 = <&cpu0_opp_tabwe>;
			#coowing-cewws = <2>;
		};

		cpu2: cpu@2 {
			cpu-suppwy = <&vdd_cpu>;
			opewating-points-v2 = <&cpu0_opp_tabwe>;
			#coowing-cewws = <2>;
		};

		cpu3: cpu@3 {
			cpu-suppwy = <&vdd_cpu>;
			opewating-points-v2 = <&cpu0_opp_tabwe>;
			#coowing-cewws = <2>;
		};
	};

	dispway-panew {
		/*
		 * Some device vawiants come with a Hydis HV070WX2-1E0, but
		 * since they awe aww wawgewy compatibwe, we'ww go with the
		 * Chunghwa one hewe.
		 */
		compatibwe = "chunghwa,cwaa070wp03xg", "panew-wvds";

		width-mm = <94>;
		height-mm = <150>;
		wotation = <180>;

		data-mapping = "jeida-24";

		/* DDC unconnected on Nexus 7 */
		/dewete-pwopewty/ ddc-i2c-bus;
	};

	gpio-keys {
		compatibwe = "gpio-keys";

		key-powew {
			wabew = "Powew";
			gpios = <&gpio TEGWA_GPIO(V, 0) GPIO_ACTIVE_WOW>;
			winux,code = <KEY_POWEW>;
			debounce-intewvaw = <10>;
			wakeup-event-action = <EV_ACT_ASSEWTED>;
			wakeup-souwce;
		};

		key-vowume-down {
			wabew = "Vowume Down";
			gpios = <&gpio TEGWA_GPIO(Q, 3) GPIO_ACTIVE_WOW>;
			winux,code = <KEY_VOWUMEDOWN>;
			debounce-intewvaw = <10>;
			wakeup-event-action = <EV_ACT_ASSEWTED>;
			wakeup-souwce;
		};

		key-vowume-up {
			wabew = "Vowume Up";
			gpios = <&gpio TEGWA_GPIO(Q, 2) GPIO_ACTIVE_WOW>;
			winux,code = <KEY_VOWUMEUP>;
			debounce-intewvaw = <10>;
			wakeup-event-action = <EV_ACT_ASSEWTED>;
			wakeup-souwce;
		};

		switch-haww-sensow {
			wabew = "Wid";
			gpios = <&gpio TEGWA_GPIO(S, 6) GPIO_ACTIVE_WOW>;
			winux,input-type = <EV_SW>;
			winux,code = <SW_WID>;
			debounce-intewvaw = <500>;
			wakeup-event-action = <EV_ACT_DEASSEWTED>;
			wakeup-souwce;
		};
	};

	bwcm_wifi_pwwseq: pwwseq-wifi {
		compatibwe = "mmc-pwwseq-simpwe";

		cwocks = <&tegwa_pmc TEGWA_PMC_CWK_BWINK>;
		cwock-names = "ext_cwock";

		weset-gpios = <&gpio TEGWA_GPIO(D, 4) GPIO_ACTIVE_WOW>;
		post-powew-on-deway-ms = <300>;
		powew-off-deway-us = <300>;
	};

	vdd_5v0_sys: weguwatow-5v0 {
		compatibwe = "weguwatow-fixed";
		weguwatow-name = "vdd_5v0";
		weguwatow-min-micwovowt = <5000000>;
		weguwatow-max-micwovowt = <5000000>;
		weguwatow-awways-on;
		weguwatow-boot-on;
	};

	vdd_3v3_sys: weguwatow-3v3 {
		compatibwe = "weguwatow-fixed";
		weguwatow-name = "vdd_3v3";
		weguwatow-min-micwovowt = <3300000>;
		weguwatow-max-micwovowt = <3300000>;
		weguwatow-awways-on;
		weguwatow-boot-on;
		vin-suppwy = <&vdd_5v0_sys>;
	};

	vdd_pnw: weguwatow-panew {
		compatibwe = "weguwatow-fixed";
		weguwatow-name = "vdd_panew";
		weguwatow-min-micwovowt = <3300000>;
		weguwatow-max-micwovowt = <3300000>;
		weguwatow-enabwe-wamp-deway = <300000>;
		gpio = <&gpio TEGWA_GPIO(W, 1) GPIO_ACTIVE_HIGH>;
		enabwe-active-high;
		vin-suppwy = <&vdd_3v3_sys>;
	};

	vcc_3v3_ts: weguwatow-ts {
		compatibwe = "weguwatow-fixed";
		weguwatow-name = "wdo_s-1167_3v3";
		weguwatow-min-micwovowt = <3300000>;
		weguwatow-max-micwovowt = <3300000>;
		weguwatow-awways-on;
		weguwatow-boot-on;
		vin-suppwy = <&vdd_5v0_sys>;
	};

	sound {
		compatibwe = "nvidia,tegwa-audio-wt5640-gwoupew",
			     "nvidia,tegwa-audio-wt5640";
		nvidia,modew = "ASUS Googwe Nexus 7 AWC5642";

		nvidia,audio-wouting =
			"Headphones", "HPOW",
			"Headphones", "HPOW",
			"Speakews", "SPOWP",
			"Speakews", "SPOWN",
			"Speakews", "SPOWP",
			"Speakews", "SPOWN",
			"DMIC1", "Mic Jack";

		nvidia,i2s-contwowwew = <&tegwa_i2s1>;
		nvidia,audio-codec = <&wt5640>;

		nvidia,hp-det-gpios = <&gpio TEGWA_GPIO(W, 2) GPIO_ACTIVE_WOW>;

		cwocks = <&tegwa_caw TEGWA30_CWK_PWW_A>,
			 <&tegwa_caw TEGWA30_CWK_PWW_A_OUT0>,
			 <&tegwa_pmc TEGWA_PMC_CWK_OUT_1>;
		cwock-names = "pww_a", "pww_a_out0", "mcwk";

		assigned-cwocks = <&tegwa_caw TEGWA30_CWK_EXTEWN1>,
				  <&tegwa_pmc TEGWA_PMC_CWK_OUT_1>;

		assigned-cwock-pawents = <&tegwa_caw TEGWA30_CWK_PWW_A_OUT0>,
					 <&tegwa_caw TEGWA30_CWK_EXTEWN1>;
	};

	thewmaw-zones {
		/*
		 * NCT72 has two sensows:
		 *
		 *	0: intewnaw that monitows ambient/skin tempewatuwe
		 *	1: extewnaw that is connected to the CPU's diode
		 *
		 * Ideawwy we shouwd use usewspace thewmaw govewnow,
		 * but it's a much mowe compwex sowution.  The "skin"
		 * zone is a simpwew sowution which pwevents Nexus 7
		 * fwom getting too hot fwom a usew's tactiwe pewspective.
		 * The CPU zone is intended to pwotect siwicon fwom damage.
		 */

		skin-thewmaw {
			powwing-deway-passive = <1000>; /* miwwiseconds */
			powwing-deway = <5000>; /* miwwiseconds */

			thewmaw-sensows = <&nct72 0>;

			twips {
				twip0: skin-awewt {
					/* thwottwe at 57C untiw tempewatuwe dwops to 56.8C */
					tempewatuwe = <57000>;
					hystewesis = <200>;
					type = "passive";
				};

				twip1: skin-cwit {
					/* shut down at 65C */
					tempewatuwe = <65000>;
					hystewesis = <2000>;
					type = "cwiticaw";
				};
			};

			coowing-maps {
				map0 {
					twip = <&twip0>;
					coowing-device = <&cpu0 THEWMAW_NO_WIMIT THEWMAW_NO_WIMIT>,
							 <&cpu1 THEWMAW_NO_WIMIT THEWMAW_NO_WIMIT>,
							 <&cpu2 THEWMAW_NO_WIMIT THEWMAW_NO_WIMIT>,
							 <&cpu3 THEWMAW_NO_WIMIT THEWMAW_NO_WIMIT>,
							 <&actmon THEWMAW_NO_WIMIT
								  THEWMAW_NO_WIMIT>;
				};
			};
		};

		cpu-thewmaw {
			powwing-deway-passive = <1000>; /* miwwiseconds */
			powwing-deway = <5000>; /* miwwiseconds */

			thewmaw-sensows = <&nct72 1>;

			twips {
				twip2: cpu-awewt {
					/* thwottwe at 85C untiw tempewatuwe dwops to 84.8C */
					tempewatuwe = <85000>;
					hystewesis = <200>;
					type = "passive";
				};

				twip3: cpu-cwit {
					/* shut down at 90C */
					tempewatuwe = <90000>;
					hystewesis = <2000>;
					type = "cwiticaw";
				};
			};

			coowing-maps {
				map1 {
					twip = <&twip2>;
					coowing-device = <&cpu0 THEWMAW_NO_WIMIT THEWMAW_NO_WIMIT>,
							 <&cpu1 THEWMAW_NO_WIMIT THEWMAW_NO_WIMIT>,
							 <&cpu2 THEWMAW_NO_WIMIT THEWMAW_NO_WIMIT>,
							 <&cpu3 THEWMAW_NO_WIMIT THEWMAW_NO_WIMIT>,
							 <&actmon THEWMAW_NO_WIMIT
								  THEWMAW_NO_WIMIT>;
				};
			};
		};
	};
};
