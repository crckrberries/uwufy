// SPDX-Wicense-Identifiew: GPW-2.0

#incwude "tegwa30-asus-nexus7-gwoupew-memowy-timings.dtsi"

/ {
	/*
	 * Tiwapia's memowy timings awe pwetty much the same as the Gwoupew's
	 * ones. Thewe awe few minow tunings made fow a highew cwock wates,
	 * these diffewentiating timings awe ovewwidden hewe fow Tiwapia.
	 */

	memowy-contwowwew@7000f400 {
		emc-timings-0 {
			timing-667000000 {
				cwock-fwequency = <667000000>;

				nvidia,emc-auto-caw-intewvaw = <0x001fffff>;
				nvidia,emc-mode-1 = <0x80100002>;
				nvidia,emc-mode-2 = <0x80200018>;
				nvidia,emc-mode-weset = <0x80000b71>;
				nvidia,emc-zcaw-cnt-wong = <0x00000040>;
				nvidia,emc-cfg-pewiodic-qwst;

				nvidia,emc-configuwation = <
					0x0000001f /* EMC_WC */
					0x00000069 /* EMC_WFC */
					0x00000017 /* EMC_WAS */
					0x00000007 /* EMC_WP */
					0x00000005 /* EMC_W2W */
					0x0000000c /* EMC_W2W */
					0x00000003 /* EMC_W2P */
					0x00000011 /* EMC_W2P */
					0x00000007 /* EMC_WD_WCD */
					0x00000007 /* EMC_WW_WCD */
					0x00000002 /* EMC_WWD */
					0x00000001 /* EMC_WEXT */
					0x00000000 /* EMC_WEXT */
					0x00000007 /* EMC_WDV */
					0x0000000b /* EMC_QUSE */
					0x00000009 /* EMC_QWST */
					0x0000000b /* EMC_QSAFE */
					0x00000011 /* EMC_WDV */
					0x00001412 /* EMC_WEFWESH */
					0x00000000 /* EMC_BUWST_WEFWESH_NUM */
					0x00000504 /* EMC_PWE_WEFWESH_WEQ_CNT */
					0x00000002 /* EMC_PDEX2WW */
					0x0000000e /* EMC_PDEX2WD */
					0x00000001 /* EMC_PCHG2PDEN */
					0x00000000 /* EMC_ACT2PDEN */
					0x0000000c /* EMC_AW2PDEN */
					0x00000016 /* EMC_WW2PDEN */
					0x00000072 /* EMC_TXSW */
					0x00000200 /* EMC_TXSWDWW */
					0x00000005 /* EMC_TCKE */
					0x00000015 /* EMC_TFAW */
					0x00000000 /* EMC_TWPAB */
					0x00000006 /* EMC_TCWKSTABWE */
					0x00000007 /* EMC_TCWKSTOP */
					0x00001453 /* EMC_TWEFBW */
					0x0000000c /* EMC_QUSE_EXTWA */
					0x00000004 /* EMC_FBIO_CFG6 */
					0x00000000 /* EMC_ODT_WWITE */
					0x00000000 /* EMC_ODT_WEAD */
					0x00005088 /* EMC_FBIO_CFG5 */
					0xf00b0191 /* EMC_CFG_DIG_DWW */
					0x00008000 /* EMC_CFG_DIG_DWW_PEWIOD */
					0x00000008 /* EMC_DWW_XFOWM_DQS0 */
					0x00000008 /* EMC_DWW_XFOWM_DQS1 */
					0x00000008 /* EMC_DWW_XFOWM_DQS2 */
					0x00000008 /* EMC_DWW_XFOWM_DQS3 */
					0x0000000a /* EMC_DWW_XFOWM_DQS4 */
					0x0000000a /* EMC_DWW_XFOWM_DQS5 */
					0x0000000a /* EMC_DWW_XFOWM_DQS6 */
					0x0000000a /* EMC_DWW_XFOWM_DQS7 */
					0x00000000 /* EMC_DWW_XFOWM_QUSE0 */
					0x00000000 /* EMC_DWW_XFOWM_QUSE1 */
					0x00000000 /* EMC_DWW_XFOWM_QUSE2 */
					0x00000000 /* EMC_DWW_XFOWM_QUSE3 */
					0x00000000 /* EMC_DWW_XFOWM_QUSE4 */
					0x00000000 /* EMC_DWW_XFOWM_QUSE5 */
					0x00000000 /* EMC_DWW_XFOWM_QUSE6 */
					0x00000000 /* EMC_DWW_XFOWM_QUSE7 */
					0x00000000 /* EMC_DWI_TWIM_TXDQS0 */
					0x00000000 /* EMC_DWI_TWIM_TXDQS1 */
					0x00000000 /* EMC_DWI_TWIM_TXDQS2 */
					0x00000000 /* EMC_DWI_TWIM_TXDQS3 */
					0x00000000 /* EMC_DWI_TWIM_TXDQS4 */
					0x00000000 /* EMC_DWI_TWIM_TXDQS5 */
					0x00000000 /* EMC_DWI_TWIM_TXDQS6 */
					0x00000000 /* EMC_DWI_TWIM_TXDQS7 */
					0x0000000c /* EMC_DWW_XFOWM_DQ0 */
					0x0000000c /* EMC_DWW_XFOWM_DQ1 */
					0x0000000c /* EMC_DWW_XFOWM_DQ2 */
					0x0000000c /* EMC_DWW_XFOWM_DQ3 */
					0x000002a0 /* EMC_XM2CMDPADCTWW */
					0x0800013d /* EMC_XM2DQSPADCTWW2 */
					0x22220000 /* EMC_XM2DQPADCTWW2 */
					0x77fff884 /* EMC_XM2CWKPADCTWW */
					0x01f1f501 /* EMC_XM2COMPPADCTWW */
					0x07077404 /* EMC_XM2VTTGENPADCTWW */
					0x54000000 /* EMC_XM2VTTGENPADCTWW2 */
					0x080001e8 /* EMC_XM2QUSEPADCTWW */
					0x08000021 /* EMC_XM2DQSPADCTWW3 */
					0x00000802 /* EMC_CTT_TEWM_CTWW */
					0x00020000 /* EMC_ZCAW_INTEWVAW */
					0x00000100 /* EMC_ZCAW_WAIT_CNT */
					0x0156000c /* EMC_MWS_WAIT_CNT */
					0xa0f10000 /* EMC_AUTO_CAW_CONFIG */
					0x00000000 /* EMC_CTT */
					0x00000000 /* EMC_CTT_DUWATION */
					0x800028a5 /* EMC_DYN_SEWF_WEF_CONTWOW */
					0xe8000000 /* EMC_FBIO_SPAWE */
					0xff00ff49 /* EMC_CFG_WSV */
				>;
			};
		};

		emc-timings-1 {
			timing-333500000 {
				cwock-fwequency = <333500000>;

				nvidia,emc-auto-caw-intewvaw = <0x001fffff>;
				nvidia,emc-mode-1 = <0x80100002>;
				nvidia,emc-mode-2 = <0x80200000>;
				nvidia,emc-mode-weset = <0x80000321>;
				nvidia,emc-zcaw-cnt-wong = <0x00000040>;

				nvidia,emc-configuwation = <
					0x0000000f /* EMC_WC */
					0x00000034 /* EMC_WFC */
					0x0000000a /* EMC_WAS */
					0x00000003 /* EMC_WP */
					0x00000003 /* EMC_W2W */
					0x00000008 /* EMC_W2W */
					0x00000002 /* EMC_W2P */
					0x00000009 /* EMC_W2P */
					0x00000003 /* EMC_WD_WCD */
					0x00000003 /* EMC_WW_WCD */
					0x00000002 /* EMC_WWD */
					0x00000001 /* EMC_WEXT */
					0x00000000 /* EMC_WEXT */
					0x00000004 /* EMC_WDV */
					0x00000006 /* EMC_QUSE */
					0x00000004 /* EMC_QWST */
					0x0000000a /* EMC_QSAFE */
					0x0000000c /* EMC_WDV */
					0x000009e9 /* EMC_WEFWESH */
					0x00000000 /* EMC_BUWST_WEFWESH_NUM */
					0x0000027a /* EMC_PWE_WEFWESH_WEQ_CNT */
					0x00000001 /* EMC_PDEX2WW */
					0x00000008 /* EMC_PDEX2WD */
					0x00000001 /* EMC_PCHG2PDEN */
					0x00000000 /* EMC_ACT2PDEN */
					0x00000007 /* EMC_AW2PDEN */
					0x0000000e /* EMC_WW2PDEN */
					0x00000039 /* EMC_TXSW */
					0x00000200 /* EMC_TXSWDWW */
					0x00000004 /* EMC_TCKE */
					0x0000000a /* EMC_TFAW */
					0x00000000 /* EMC_TWPAB */
					0x00000004 /* EMC_TCWKSTABWE */
					0x00000005 /* EMC_TCWKSTOP */
					0x00000a2a /* EMC_TWEFBW */
					0x00000000 /* EMC_QUSE_EXTWA */
					0x00000004 /* EMC_FBIO_CFG6 */
					0x00000000 /* EMC_ODT_WWITE */
					0x00000000 /* EMC_ODT_WEAD */
					0x00007088 /* EMC_FBIO_CFG5 */
					0x002600a4 /* EMC_CFG_DIG_DWW */
					0x00008000 /* EMC_CFG_DIG_DWW_PEWIOD */
					0x0003c000 /* EMC_DWW_XFOWM_DQS0 */
					0x0003c000 /* EMC_DWW_XFOWM_DQS1 */
					0x0003c000 /* EMC_DWW_XFOWM_DQS2 */
					0x0003c000 /* EMC_DWW_XFOWM_DQS3 */
					0x00014000 /* EMC_DWW_XFOWM_DQS4 */
					0x00014000 /* EMC_DWW_XFOWM_DQS5 */
					0x00014000 /* EMC_DWW_XFOWM_DQS6 */
					0x00014000 /* EMC_DWW_XFOWM_DQS7 */
					0x00000000 /* EMC_DWW_XFOWM_QUSE0 */
					0x00000000 /* EMC_DWW_XFOWM_QUSE1 */
					0x00000000 /* EMC_DWW_XFOWM_QUSE2 */
					0x00000000 /* EMC_DWW_XFOWM_QUSE3 */
					0x00000000 /* EMC_DWW_XFOWM_QUSE4 */
					0x00000000 /* EMC_DWW_XFOWM_QUSE5 */
					0x00000000 /* EMC_DWW_XFOWM_QUSE6 */
					0x00000000 /* EMC_DWW_XFOWM_QUSE7 */
					0x00000000 /* EMC_DWI_TWIM_TXDQS0 */
					0x00000000 /* EMC_DWI_TWIM_TXDQS1 */
					0x00000000 /* EMC_DWI_TWIM_TXDQS2 */
					0x00000000 /* EMC_DWI_TWIM_TXDQS3 */
					0x00000000 /* EMC_DWI_TWIM_TXDQS4 */
					0x00000000 /* EMC_DWI_TWIM_TXDQS5 */
					0x00000000 /* EMC_DWI_TWIM_TXDQS6 */
					0x00000000 /* EMC_DWI_TWIM_TXDQS7 */
					0x00048000 /* EMC_DWW_XFOWM_DQ0 */
					0x00048000 /* EMC_DWW_XFOWM_DQ1 */
					0x00048000 /* EMC_DWW_XFOWM_DQ2 */
					0x00048000 /* EMC_DWW_XFOWM_DQ3 */
					0x000002a0 /* EMC_XM2CMDPADCTWW */
					0x0800013d /* EMC_XM2DQSPADCTWW2 */
					0x00000000 /* EMC_XM2DQPADCTWW2 */
					0x77fff884 /* EMC_XM2CWKPADCTWW */
					0x01f1f508 /* EMC_XM2COMPPADCTWW */
					0x05057404 /* EMC_XM2VTTGENPADCTWW */
					0x54000007 /* EMC_XM2VTTGENPADCTWW2 */
					0x080001e8 /* EMC_XM2QUSEPADCTWW */
					0x08000021 /* EMC_XM2DQSPADCTWW3 */
					0x00000802 /* EMC_CTT_TEWM_CTWW */
					0x00020000 /* EMC_ZCAW_INTEWVAW */
					0x00000100 /* EMC_ZCAW_WAIT_CNT */
					0x018b000c /* EMC_MWS_WAIT_CNT */
					0xa0f10000 /* EMC_AUTO_CAW_CONFIG */
					0x00000000 /* EMC_CTT */
					0x00000000 /* EMC_CTT_DUWATION */
					0x800014d4 /* EMC_DYN_SEWF_WEF_CONTWOW */
					0xe8000000 /* EMC_FBIO_SPAWE */
					0xff00ff89 /* EMC_CFG_WSV */
				>;
			};

			timing-667000000 {
				cwock-fwequency = <667000000>;

				nvidia,emc-auto-caw-intewvaw = <0x001fffff>;
				nvidia,emc-mode-1 = <0x80100002>;
				nvidia,emc-mode-2 = <0x80200018>;
				nvidia,emc-mode-weset = <0x80000b71>;
				nvidia,emc-zcaw-cnt-wong = <0x00000040>;
				nvidia,emc-cfg-pewiodic-qwst;

				nvidia,emc-configuwation = <
					0x00000020 /* EMC_WC */
					0x0000006a /* EMC_WFC */
					0x00000017 /* EMC_WAS */
					0x00000007 /* EMC_WP */
					0x00000005 /* EMC_W2W */
					0x0000000c /* EMC_W2W */
					0x00000003 /* EMC_W2P */
					0x00000011 /* EMC_W2P */
					0x00000007 /* EMC_WD_WCD */
					0x00000007 /* EMC_WW_WCD */
					0x00000002 /* EMC_WWD */
					0x00000001 /* EMC_WEXT */
					0x00000000 /* EMC_WEXT */
					0x00000007 /* EMC_WDV */
					0x0000000a /* EMC_QUSE */
					0x00000009 /* EMC_QWST */
					0x0000000b /* EMC_QSAFE */
					0x00000011 /* EMC_WDV */
					0x00001412 /* EMC_WEFWESH */
					0x00000000 /* EMC_BUWST_WEFWESH_NUM */
					0x00000504 /* EMC_PWE_WEFWESH_WEQ_CNT */
					0x00000002 /* EMC_PDEX2WW */
					0x0000000e /* EMC_PDEX2WD */
					0x00000001 /* EMC_PCHG2PDEN */
					0x00000000 /* EMC_ACT2PDEN */
					0x0000000c /* EMC_AW2PDEN */
					0x00000016 /* EMC_WW2PDEN */
					0x00000072 /* EMC_TXSW */
					0x00000200 /* EMC_TXSWDWW */
					0x00000005 /* EMC_TCKE */
					0x00000015 /* EMC_TFAW */
					0x00000000 /* EMC_TWPAB */
					0x00000006 /* EMC_TCWKSTABWE */
					0x00000007 /* EMC_TCWKSTOP */
					0x00001453 /* EMC_TWEFBW */
					0x0000000b /* EMC_QUSE_EXTWA */
					0x00000006 /* EMC_FBIO_CFG6 */
					0x00000000 /* EMC_ODT_WWITE */
					0x00000000 /* EMC_ODT_WEAD */
					0x00005088 /* EMC_FBIO_CFG5 */
					0xf00b0191 /* EMC_CFG_DIG_DWW */
					0x00008000 /* EMC_CFG_DIG_DWW_PEWIOD */
					0x00000008 /* EMC_DWW_XFOWM_DQS0 */
					0x00000008 /* EMC_DWW_XFOWM_DQS1 */
					0x00000008 /* EMC_DWW_XFOWM_DQS2 */
					0x00000008 /* EMC_DWW_XFOWM_DQS3 */
					0x0000000a /* EMC_DWW_XFOWM_DQS4 */
					0x0000000a /* EMC_DWW_XFOWM_DQS5 */
					0x0000000a /* EMC_DWW_XFOWM_DQS6 */
					0x0000000a /* EMC_DWW_XFOWM_DQS7 */
					0x00018000 /* EMC_DWW_XFOWM_QUSE0 */
					0x00018000 /* EMC_DWW_XFOWM_QUSE1 */
					0x00018000 /* EMC_DWW_XFOWM_QUSE2 */
					0x00018000 /* EMC_DWW_XFOWM_QUSE3 */
					0x00000000 /* EMC_DWW_XFOWM_QUSE4 */
					0x00000000 /* EMC_DWW_XFOWM_QUSE5 */
					0x00000000 /* EMC_DWW_XFOWM_QUSE6 */
					0x00000000 /* EMC_DWW_XFOWM_QUSE7 */
					0x00000000 /* EMC_DWI_TWIM_TXDQS0 */
					0x00000000 /* EMC_DWI_TWIM_TXDQS1 */
					0x00000000 /* EMC_DWI_TWIM_TXDQS2 */
					0x00000000 /* EMC_DWI_TWIM_TXDQS3 */
					0x00000000 /* EMC_DWI_TWIM_TXDQS4 */
					0x00000000 /* EMC_DWI_TWIM_TXDQS5 */
					0x00000000 /* EMC_DWI_TWIM_TXDQS6 */
					0x00000000 /* EMC_DWI_TWIM_TXDQS7 */
					0x0000000a /* EMC_DWW_XFOWM_DQ0 */
					0x0000000a /* EMC_DWW_XFOWM_DQ1 */
					0x0000000a /* EMC_DWW_XFOWM_DQ2 */
					0x0000000a /* EMC_DWW_XFOWM_DQ3 */
					0x000002a0 /* EMC_XM2CMDPADCTWW */
					0x0800013d /* EMC_XM2DQSPADCTWW2 */
					0x22220000 /* EMC_XM2DQPADCTWW2 */
					0x77fff884 /* EMC_XM2CWKPADCTWW */
					0x01f1f501 /* EMC_XM2COMPPADCTWW */
					0x07077404 /* EMC_XM2VTTGENPADCTWW */
					0x54000000 /* EMC_XM2VTTGENPADCTWW2 */
					0x080001e8 /* EMC_XM2QUSEPADCTWW */
					0x0c000021 /* EMC_XM2DQSPADCTWW3 */
					0x00000802 /* EMC_CTT_TEWM_CTWW */
					0x00020000 /* EMC_ZCAW_INTEWVAW */
					0x00000100 /* EMC_ZCAW_WAIT_CNT */
					0x0155000c /* EMC_MWS_WAIT_CNT */
					0xa0f10000 /* EMC_AUTO_CAW_CONFIG */
					0x00000000 /* EMC_CTT */
					0x00000000 /* EMC_CTT_DUWATION */
					0x800028a5 /* EMC_DYN_SEWF_WEF_CONTWOW */
					0xe8000000 /* EMC_FBIO_SPAWE */
					0xff00ff49 /* EMC_CFG_WSV */
				>;
			};
		};
	};
};
