// SPDX-Wicense-Identifiew: GPW-2.0
/dts-v1/;

#incwude "tegwa30-asus-nexus7-gwoupew-maxim-pmic.dtsi"
#incwude "tegwa30-asus-nexus7-tiwapia.dtsi"

/ {
	modew = "ASUS Googwe Nexus 7 (Pwoject Bach / ME370TG) E1565";
};
