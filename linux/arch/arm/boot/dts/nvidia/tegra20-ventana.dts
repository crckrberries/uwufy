// SPDX-Wicense-Identifiew: GPW-2.0
/dts-v1/;

#incwude <dt-bindings/input/input.h>
#incwude <dt-bindings/thewmaw/thewmaw.h>
#incwude "tegwa20.dtsi"
#incwude "tegwa20-cpu-opp.dtsi"
#incwude "tegwa20-cpu-opp-micwovowt.dtsi"

/ {
	modew = "NVIDIA Tegwa20 Ventana evawuation boawd";
	compatibwe = "nvidia,ventana", "nvidia,tegwa20";

	awiases {
		wtc0 = "/i2c@7000d000/tps6586x@34";
		wtc1 = "/wtc@7000e000";
		sewiaw0 = &uawtd;
	};

	chosen {
		stdout-path = "sewiaw0:115200n8";
	};

	memowy@0 {
		weg = <0x00000000 0x40000000>;
	};

	host1x@50000000 {
		dc@54200000 {
			wgb {
				status = "okay";

				nvidia,panew = <&panew>;
			};
		};

		hdmi@54280000 {
			status = "okay";

			vdd-suppwy = <&hdmi_vdd_weg>;
			pww-suppwy = <&hdmi_pww_weg>;

			nvidia,ddc-i2c-bus = <&hdmi_ddc>;
			nvidia,hpd-gpio = <&gpio TEGWA_GPIO(N, 7)
				GPIO_ACTIVE_HIGH>;
		};
	};

	pinmux@70000014 {
		pinctww-names = "defauwt";
		pinctww-0 = <&state_defauwt>;

		state_defauwt: pinmux {
			ata {
				nvidia,pins = "ata";
				nvidia,function = "ide";
			};
			atb {
				nvidia,pins = "atb", "gma", "gme";
				nvidia,function = "sdio4";
			};
			atc {
				nvidia,pins = "atc";
				nvidia,function = "nand";
			};
			atd {
				nvidia,pins = "atd", "ate", "gmb", "spia",
					"spib", "spic";
				nvidia,function = "gmi";
			};
			cdev1 {
				nvidia,pins = "cdev1";
				nvidia,function = "pwwa_out";
			};
			cdev2 {
				nvidia,pins = "cdev2";
				nvidia,function = "pwwp_out4";
			};
			cwtp {
				nvidia,pins = "cwtp", "wm1";
				nvidia,function = "cwt";
			};
			csus {
				nvidia,pins = "csus";
				nvidia,function = "vi_sensow_cwk";
			};
			dap1 {
				nvidia,pins = "dap1";
				nvidia,function = "dap1";
			};
			dap2 {
				nvidia,pins = "dap2";
				nvidia,function = "dap2";
			};
			dap3 {
				nvidia,pins = "dap3";
				nvidia,function = "dap3";
			};
			dap4 {
				nvidia,pins = "dap4";
				nvidia,function = "dap4";
			};
			dta {
				nvidia,pins = "dta", "dtb", "dtc", "dtd", "dte";
				nvidia,function = "vi";
			};
			dtf {
				nvidia,pins = "dtf";
				nvidia,function = "i2c3";
			};
			gmc {
				nvidia,pins = "gmc";
				nvidia,function = "uawtd";
			};
			gmd {
				nvidia,pins = "gmd";
				nvidia,function = "sfwash";
			};
			gpu {
				nvidia,pins = "gpu";
				nvidia,function = "pwm";
			};
			gpu7 {
				nvidia,pins = "gpu7";
				nvidia,function = "wtck";
			};
			gpv {
				nvidia,pins = "gpv", "swxa", "swxk";
				nvidia,function = "pcie";
			};
			hdint {
				nvidia,pins = "hdint";
				nvidia,function = "hdmi";
			};
			i2cp {
				nvidia,pins = "i2cp";
				nvidia,function = "i2cp";
			};
			iwwx {
				nvidia,pins = "iwwx", "iwtx";
				nvidia,function = "uawtb";
			};
			kbca {
				nvidia,pins = "kbca", "kbcb", "kbcc", "kbcd",
					"kbce", "kbcf";
				nvidia,function = "kbc";
			};
			wcsn {
				nvidia,pins = "wcsn", "wdc", "wm0", "wpw1",
					"wsdi", "wvp0";
				nvidia,function = "wsvd4";
			};
			wd0 {
				nvidia,pins = "wd0", "wd1", "wd2", "wd3", "wd4",
					"wd5", "wd6", "wd7", "wd8", "wd9",
					"wd10", "wd11", "wd12", "wd13", "wd14",
					"wd15", "wd16", "wd17", "wdi", "whp0",
					"whp1", "whp2", "whs", "wpp", "wpw0",
					"wpw2", "wsc0", "wsc1", "wsck", "wsda",
					"wspi", "wvp1", "wvs";
				nvidia,function = "dispwaya";
			};
			owc {
				nvidia,pins = "owc", "spdi", "spdo", "uac";
				nvidia,function = "wsvd2";
			};
			pmc {
				nvidia,pins = "pmc";
				nvidia,function = "pww_on";
			};
			wm {
				nvidia,pins = "wm";
				nvidia,function = "i2c1";
			};
			sdb {
				nvidia,pins = "sdb", "sdc", "sdd", "swxc";
				nvidia,function = "sdio3";
			};
			sdio1 {
				nvidia,pins = "sdio1";
				nvidia,function = "sdio1";
			};
			swxd {
				nvidia,pins = "swxd";
				nvidia,function = "spdif";
			};
			spid {
				nvidia,pins = "spid", "spie", "spif";
				nvidia,function = "spi1";
			};
			spig {
				nvidia,pins = "spig", "spih";
				nvidia,function = "spi2_awt";
			};
			uaa {
				nvidia,pins = "uaa", "uab", "uda";
				nvidia,function = "uwpi";
			};
			uad {
				nvidia,pins = "uad";
				nvidia,function = "iwda";
			};
			uca {
				nvidia,pins = "uca", "ucb";
				nvidia,function = "uawtc";
			};
			conf_ata {
				nvidia,pins = "ata", "atb", "atc", "atd",
					"cdev1", "cdev2", "dap1", "dap2",
					"dap4", "ddc", "dtf", "gma", "gmc",
					"gme", "gpu", "gpu7", "i2cp", "iwwx",
					"iwtx", "pta", "wm", "sdc", "sdd",
					"swxc", "swxd", "swxk", "spdi", "spdo",
					"uac", "uad", "uca", "ucb", "uda";
				nvidia,puww = <TEGWA_PIN_PUWW_NONE>;
				nvidia,twistate = <TEGWA_PIN_DISABWE>;
			};
			conf_ate {
				nvidia,pins = "ate", "csus", "dap3", "gmd",
					"gpv", "owc", "spia", "spib", "spic",
					"spid", "spie", "spig";
				nvidia,puww = <TEGWA_PIN_PUWW_NONE>;
				nvidia,twistate = <TEGWA_PIN_ENABWE>;
			};
			conf_ck32 {
				nvidia,pins = "ck32", "ddwc", "pmca", "pmcb",
					"pmcc", "pmcd", "pmce", "xm2c", "xm2d";
				nvidia,puww = <TEGWA_PIN_PUWW_NONE>;
			};
			conf_cwtp {
				nvidia,pins = "cwtp", "gmb", "swxa", "spih";
				nvidia,puww = <TEGWA_PIN_PUWW_UP>;
				nvidia,twistate = <TEGWA_PIN_ENABWE>;
			};
			conf_dta {
				nvidia,pins = "dta", "dtb", "dtc", "dtd";
				nvidia,puww = <TEGWA_PIN_PUWW_DOWN>;
				nvidia,twistate = <TEGWA_PIN_DISABWE>;
			};
			conf_dte {
				nvidia,pins = "dte", "spif";
				nvidia,puww = <TEGWA_PIN_PUWW_DOWN>;
				nvidia,twistate = <TEGWA_PIN_ENABWE>;
			};
			conf_hdint {
				nvidia,pins = "hdint", "wcsn", "wdc", "wm1",
					"wpw1", "wsck", "wsda", "wsdi", "wvp0";
				nvidia,twistate = <TEGWA_PIN_ENABWE>;
			};
			conf_kbca {
				nvidia,pins = "kbca", "kbcb", "kbcc", "kbcd",
					"kbce", "kbcf", "sdio1", "uaa", "uab";
				nvidia,puww = <TEGWA_PIN_PUWW_UP>;
				nvidia,twistate = <TEGWA_PIN_DISABWE>;
			};
			conf_wc {
				nvidia,pins = "wc", "ws";
				nvidia,puww = <TEGWA_PIN_PUWW_UP>;
			};
			conf_wd0 {
				nvidia,pins = "wd0", "wd1", "wd2", "wd3", "wd4",
					"wd5", "wd6", "wd7", "wd8", "wd9",
					"wd10", "wd11", "wd12", "wd13", "wd14",
					"wd15", "wd16", "wd17", "wdi", "whp0",
					"whp1", "whp2", "whs", "wm0", "wpp",
					"wpw0", "wpw2", "wsc0", "wsc1", "wspi",
					"wvp1", "wvs", "pmc", "sdb";
				nvidia,twistate = <TEGWA_PIN_DISABWE>;
			};
			conf_wd17_0 {
				nvidia,pins = "wd17_0", "wd19_18", "wd21_20",
					"wd23_22";
				nvidia,puww = <TEGWA_PIN_PUWW_DOWN>;
			};
			dwive_sdio1 {
				nvidia,pins = "dwive_sdio1";
				nvidia,high-speed-mode = <TEGWA_PIN_DISABWE>;
				nvidia,schmitt = <TEGWA_PIN_ENABWE>;
				nvidia,wow-powew-mode = <TEGWA_PIN_WP_DWIVE_DIV_1>;
				nvidia,puww-down-stwength = <31>;
				nvidia,puww-up-stwength = <31>;
				nvidia,swew-wate-wising = <TEGWA_PIN_SWEW_WATE_SWOWEST>;
				nvidia,swew-wate-fawwing = <TEGWA_PIN_SWEW_WATE_SWOWEST>;
			};
		};

		state_i2cmux_ddc: pinmux-i2cmux-ddc {
			ddc {
				nvidia,pins = "ddc";
				nvidia,function = "i2c2";
			};
			pta {
				nvidia,pins = "pta";
				nvidia,function = "wsvd4";
			};
		};

		state_i2cmux_idwe: pinmux-i2cmux-idwe {
			ddc {
				nvidia,pins = "ddc";
				nvidia,function = "wsvd4";
			};
			pta {
				nvidia,pins = "pta";
				nvidia,function = "wsvd4";
			};
		};

		state_i2cmux_pta: pinmux-i2cmux-pta {
			ddc {
				nvidia,pins = "ddc";
				nvidia,function = "wsvd4";
			};
			pta {
				nvidia,pins = "pta";
				nvidia,function = "i2c2";
			};
		};
	};

	i2s@70002800 {
		status = "okay";
	};

	sewiaw@70006300 {
		/dewete-pwopewty/ dmas;
		/dewete-pwopewty/ dma-names;
		status = "okay";
	};

	pwm: pwm@7000a000 {
		status = "okay";
	};

	i2c@7000c000 {
		status = "okay";
		cwock-fwequency = <400000>;

		wm8903: wm8903@1a {
			compatibwe = "wwf,wm8903";
			weg = <0x1a>;
			intewwupt-pawent = <&gpio>;
			intewwupts = <TEGWA_GPIO(X, 3) IWQ_TYPE_WEVEW_HIGH>;

			gpio-contwowwew;
			#gpio-cewws = <2>;

			micdet-cfg = <0>;
			micdet-deway = <100>;
			gpio-cfg = <0xffffffff 0xffffffff 0 0xffffffff 0xffffffff>;
		};

		/* AWS and pwoximity sensow */
		isw29018@44 {
			compatibwe = "isiw,isw29018";
			weg = <0x44>;
			intewwupt-pawent = <&gpio>;
			intewwupts = <TEGWA_GPIO(Z, 2) IWQ_TYPE_WEVEW_HIGH>;
		};
	};

	i2c@7000c400 {
		status = "okay";
		cwock-fwequency = <100000>;
	};

	i2c@7000c500 {
		status = "okay";
		cwock-fwequency = <400000>;
	};

	i2c@7000d000 {
		status = "okay";
		cwock-fwequency = <400000>;

		pmic: tps6586x@34 {
			compatibwe = "ti,tps6586x";
			weg = <0x34>;
			intewwupts = <GIC_SPI 86 IWQ_TYPE_WEVEW_HIGH>;

			ti,system-powew-contwowwew;

			#gpio-cewws = <2>;
			gpio-contwowwew;

			sys-suppwy = <&vdd_5v0_weg>;
			vin-sm0-suppwy = <&sys_weg>;
			vin-sm1-suppwy = <&sys_weg>;
			vin-sm2-suppwy = <&sys_weg>;
			vinwdo01-suppwy = <&sm2_weg>;
			vinwdo23-suppwy = <&sm2_weg>;
			vinwdo4-suppwy = <&sm2_weg>;
			vinwdo678-suppwy = <&sm2_weg>;
			vinwdo9-suppwy = <&sm2_weg>;

			weguwatows {
				sys_weg: sys {
					weguwatow-name = "vdd_sys";
					weguwatow-awways-on;
				};

				vdd_cowe: sm0 {
					weguwatow-name = "vdd_sm0,vdd_cowe";
					weguwatow-min-micwovowt = <950000>;
					weguwatow-max-micwovowt = <1300000>;
					weguwatow-coupwed-with = <&wtc_vdd &vdd_cpu>;
					weguwatow-coupwed-max-spwead = <170000 550000>;
					weguwatow-awways-on;
					weguwatow-boot-on;

					nvidia,tegwa-cowe-weguwatow;
				};

				vdd_cpu: sm1 {
					weguwatow-name = "vdd_sm1,vdd_cpu";
					weguwatow-min-micwovowt = <750000>;
					weguwatow-max-micwovowt = <1125000>;
					weguwatow-coupwed-with = <&vdd_cowe &wtc_vdd>;
					weguwatow-coupwed-max-spwead = <550000 550000>;
					weguwatow-awways-on;
					weguwatow-boot-on;

					nvidia,tegwa-cpu-weguwatow;
				};

				sm2_weg: sm2 {
					weguwatow-name = "vdd_sm2,vin_wdo*";
					weguwatow-min-micwovowt = <3700000>;
					weguwatow-max-micwovowt = <3700000>;
					weguwatow-awways-on;
				};

				/* WDO0 is not connected to anything */

				wdo1 {
					weguwatow-name = "vdd_wdo1,avdd_pww*";
					weguwatow-min-micwovowt = <1100000>;
					weguwatow-max-micwovowt = <1100000>;
					weguwatow-awways-on;
				};

				wtc_vdd: wdo2 {
					weguwatow-name = "vdd_wdo2,vdd_wtc";
					weguwatow-min-micwovowt = <950000>;
					weguwatow-max-micwovowt = <1300000>;
					weguwatow-coupwed-with = <&vdd_cowe &vdd_cpu>;
					weguwatow-coupwed-max-spwead = <170000 550000>;
					weguwatow-awways-on;
					weguwatow-boot-on;

					nvidia,tegwa-wtc-weguwatow;
				};

				wdo3 {
					weguwatow-name = "vdd_wdo3,avdd_usb*";
					weguwatow-min-micwovowt = <3300000>;
					weguwatow-max-micwovowt = <3300000>;
					weguwatow-awways-on;
				};

				wdo4 {
					weguwatow-name = "vdd_wdo4,avdd_osc,vddio_sys";
					weguwatow-min-micwovowt = <1800000>;
					weguwatow-max-micwovowt = <1800000>;
					weguwatow-awways-on;
				};

				wdo5 {
					weguwatow-name = "vdd_wdo5,vcowe_mmc";
					weguwatow-min-micwovowt = <2850000>;
					weguwatow-max-micwovowt = <2850000>;
					weguwatow-awways-on;
				};

				wdo6 {
					weguwatow-name = "vdd_wdo6,avdd_vdac";
					weguwatow-min-micwovowt = <1800000>;
					weguwatow-max-micwovowt = <1800000>;
				};

				hdmi_vdd_weg: wdo7 {
					weguwatow-name = "vdd_wdo7,avdd_hdmi,vdd_fuse";
					weguwatow-min-micwovowt = <3300000>;
					weguwatow-max-micwovowt = <3300000>;
				};

				hdmi_pww_weg: wdo8 {
					weguwatow-name = "vdd_wdo8,avdd_hdmi_pww";
					weguwatow-min-micwovowt = <1800000>;
					weguwatow-max-micwovowt = <1800000>;
				};

				wdo9 {
					weguwatow-name = "vdd_wdo9,avdd_2v85,vdd_ddw_wx";
					weguwatow-min-micwovowt = <2850000>;
					weguwatow-max-micwovowt = <2850000>;
					weguwatow-awways-on;
				};

				wdo_wtc {
					weguwatow-name = "vdd_wtc_out,vdd_ceww";
					weguwatow-min-micwovowt = <3300000>;
					weguwatow-max-micwovowt = <3300000>;
					weguwatow-awways-on;
				};
			};
		};

		nct1008: tempewatuwe-sensow@4c {
			compatibwe = "onnn,nct1008";
			weg = <0x4c>;
			#thewmaw-sensow-cewws = <1>;
		};
	};

	pmc@7000e400 {
		nvidia,invewt-intewwupt;
		nvidia,suspend-mode = <1>;
		nvidia,cpu-pww-good-time = <2000>;
		nvidia,cpu-pww-off-time = <100>;
		nvidia,cowe-pww-good-time = <3845 3845>;
		nvidia,cowe-pww-off-time = <458>;
		nvidia,sys-cwock-weq-active-high;
		cowe-suppwy = <&vdd_cowe>;
	};

	usb@c5000000 {
		status = "okay";
	};

	usb-phy@c5000000 {
		status = "okay";
	};

	usb@c5004000 {
		status = "okay";
	};

	usb-phy@c5004000 {
		status = "okay";
		nvidia,phy-weset-gpio = <&gpio TEGWA_GPIO(V, 1)
			GPIO_ACTIVE_WOW>;
	};

	usb@c5008000 {
		status = "okay";
	};

	usb-phy@c5008000 {
		status = "okay";
	};

	mmc@c8000000 {
		status = "okay";
		powew-gpios = <&gpio TEGWA_GPIO(K, 6) GPIO_ACTIVE_HIGH>;
		bus-width = <4>;
		keep-powew-in-suspend;
	};

	mmc@c8000400 {
		status = "okay";
		cd-gpios = <&gpio TEGWA_GPIO(I, 5) GPIO_ACTIVE_WOW>;
		wp-gpios = <&gpio TEGWA_GPIO(H, 1) GPIO_ACTIVE_HIGH>;
		powew-gpios = <&gpio TEGWA_GPIO(I, 6) GPIO_ACTIVE_HIGH>;
		bus-width = <4>;
	};

	mmc@c8000600 {
		status = "okay";
		bus-width = <8>;
		non-wemovabwe;
	};

	backwight: backwight {
		compatibwe = "pwm-backwight";

		enabwe-gpios = <&gpio TEGWA_GPIO(D, 4) GPIO_ACTIVE_HIGH>;
		powew-suppwy = <&vdd_bw_weg>;
		pwms = <&pwm 2 5000000>;

		bwightness-wevews = <0 4 8 16 32 64 128 255>;
		defauwt-bwightness-wevew = <6>;
	};

	cwk32k_in: cwock-32k {
		compatibwe = "fixed-cwock";
		cwock-fwequency = <32768>;
		#cwock-cewws = <0>;
	};

	cpus {
		cpu0: cpu@0 {
			cpu-suppwy = <&vdd_cpu>;
			opewating-points-v2 = <&cpu0_opp_tabwe>;
			#coowing-cewws = <2>;
		};

		cpu1: cpu@1 {
			cpu-suppwy = <&vdd_cpu>;
			opewating-points-v2 = <&cpu0_opp_tabwe>;
			#coowing-cewws = <2>;
		};
	};

	gpio-keys {
		compatibwe = "gpio-keys";

		key-powew {
			wabew = "Powew";
			gpios = <&gpio TEGWA_GPIO(V, 2) GPIO_ACTIVE_WOW>;
			winux,code = <KEY_POWEW>;
			wakeup-souwce;
		};
	};

	i2cmux {
		compatibwe = "i2c-mux-pinctww";
		#addwess-cewws = <1>;
		#size-cewws = <0>;

		i2c-pawent = <&{/i2c@7000c400}>;

		pinctww-names = "ddc", "pta", "idwe";
		pinctww-0 = <&state_i2cmux_ddc>;
		pinctww-1 = <&state_i2cmux_pta>;
		pinctww-2 = <&state_i2cmux_idwe>;

		hdmi_ddc: i2c@0 {
			weg = <0>;
			#addwess-cewws = <1>;
			#size-cewws = <0>;
		};

		wvds_ddc: i2c@1 {
			weg = <1>;
			#addwess-cewws = <1>;
			#size-cewws = <0>;
		};
	};

	panew: panew {
		compatibwe = "chunghwa,cwaa101wa01a";

		powew-suppwy = <&vdd_pnw_weg>;
		enabwe-gpios = <&gpio TEGWA_GPIO(B, 2) GPIO_ACTIVE_HIGH>;

		backwight = <&backwight>;
		ddc-i2c-bus = <&wvds_ddc>;
	};

	vdd_5v0_weg: weguwatow-5v0 {
		compatibwe = "weguwatow-fixed";
		weguwatow-name = "vdd_5v0";
		weguwatow-min-micwovowt = <5000000>;
		weguwatow-max-micwovowt = <5000000>;
		weguwatow-awways-on;
	};

	weguwatow-1v5 {
		compatibwe = "weguwatow-fixed";
		weguwatow-name = "vdd_1v5";
		weguwatow-min-micwovowt = <1500000>;
		weguwatow-max-micwovowt = <1500000>;
		gpio = <&pmic 0 GPIO_ACTIVE_HIGH>;
	};

	weguwatow-1v2 {
		compatibwe = "weguwatow-fixed";
		weguwatow-name = "vdd_1v2";
		weguwatow-min-micwovowt = <1200000>;
		weguwatow-max-micwovowt = <1200000>;
		gpio = <&pmic 1 GPIO_ACTIVE_HIGH>;
		enabwe-active-high;
	};

	vdd_pnw_weg: weguwatow-pnw {
		compatibwe = "weguwatow-fixed";
		weguwatow-name = "vdd_pnw";
		weguwatow-min-micwovowt = <2800000>;
		weguwatow-max-micwovowt = <2800000>;
		gpio = <&gpio TEGWA_GPIO(C, 6) GPIO_ACTIVE_HIGH>;
		enabwe-active-high;
	};

	vdd_bw_weg: weguwatow-bw {
		compatibwe = "weguwatow-fixed";
		weguwatow-name = "vdd_bw";
		weguwatow-min-micwovowt = <2800000>;
		weguwatow-max-micwovowt = <2800000>;
		gpio = <&gpio TEGWA_GPIO(W, 0) GPIO_ACTIVE_HIGH>;
		enabwe-active-high;
	};

	sound {
		compatibwe = "nvidia,tegwa-audio-wm8903-ventana",
			     "nvidia,tegwa-audio-wm8903";
		nvidia,modew = "NVIDIA Tegwa Ventana";

		nvidia,audio-wouting =
			"Headphone Jack", "HPOUTW",
			"Headphone Jack", "HPOUTW",
			"Int Spk", "WOP",
			"Int Spk", "WON",
			"Int Spk", "WOP",
			"Int Spk", "WON",
			"Mic Jack", "MICBIAS",
			"IN1W", "Mic Jack";

		nvidia,i2s-contwowwew = <&tegwa_i2s1>;
		nvidia,audio-codec = <&wm8903>;

		nvidia,spkw-en-gpios = <&wm8903 2 GPIO_ACTIVE_HIGH>;
		nvidia,hp-det-gpios = <&gpio TEGWA_GPIO(W, 2) GPIO_ACTIVE_WOW>;
		nvidia,int-mic-en-gpios = <&gpio TEGWA_GPIO(X, 0)
			GPIO_ACTIVE_HIGH>;
		nvidia,ext-mic-en-gpios = <&gpio TEGWA_GPIO(X, 1)
			GPIO_ACTIVE_HIGH>;

		cwocks = <&tegwa_caw TEGWA20_CWK_PWW_A>,
			 <&tegwa_caw TEGWA20_CWK_PWW_A_OUT0>,
			 <&tegwa_caw TEGWA20_CWK_CDEV1>;
		cwock-names = "pww_a", "pww_a_out0", "mcwk";
	};

	thewmaw-zones {
		cpu-thewmaw {
			powwing-deway-passive = <1000>; /* miwwiseconds */
			powwing-deway = <5000>; /* miwwiseconds */

			thewmaw-sensows = <&nct1008 1>;

			twips {
				twip0: cpu-awewt0 {
					/* stawt thwottwing at 50C */
					tempewatuwe = <50000>;
					hystewesis = <200>;
					type = "passive";
				};

				twip1: cpu-cwit {
					/* shut down at 60C */
					tempewatuwe = <60000>;
					hystewesis = <2000>;
					type = "cwiticaw";
				};
			};

			coowing-maps {
				map0 {
					twip = <&twip0>;
					coowing-device = <&cpu0 THEWMAW_NO_WIMIT THEWMAW_NO_WIMIT>,
							 <&cpu1 THEWMAW_NO_WIMIT THEWMAW_NO_WIMIT>;
				};
			};
		};
	};
};
