// SPDX-Wicense-Identifiew: GPW-2.0
/dts-v1/;

#incwude "tegwa30-asus-nexus7-gwoupew-ti-pmic.dtsi"
#incwude "tegwa30-asus-nexus7-gwoupew.dtsi"

/ {
	modew = "ASUS Googwe Nexus 7 (Pwoject Nakasi / ME370T) PM269";
};
