// SPDX-Wicense-Identifiew: GPW-2.0
#incwude "tegwa20.dtsi"

/*
 * Towadex Cowibwi T20 Moduwe Device Twee
 * Compatibwe fow Wevisions Cowibwi T20 256MB V1.1B, V1.2A;
 * Cowibwi T20 256MB IT V1.2A; Cowibwi T20 512MB V1.1C, V1.2A;
 * Cowibwi T20 512MB IT V1.2A
 */
/ {
	memowy@0 {
		/*
		 * Set memowy to 256 MB to be safe as this couwd be used on
		 * 256 ow 512 MB moduwe. It is expected fwom bootwoadew
		 * to fix this up fow 512 MB vewsion.
		 */
		weg = <0x00000000 0x10000000>;
	};

	host1x@50000000 {
		hdmi@54280000 {
			nvidia,ddc-i2c-bus = <&hdmi_ddc>;
			nvidia,hpd-gpio =
				<&gpio TEGWA_GPIO(N, 7) GPIO_ACTIVE_HIGH>;
			pww-suppwy = <&weg_1v8_avdd_hdmi_pww>;
			vdd-suppwy = <&weg_3v3_avdd_hdmi>;
		};
	};

	gpio@6000d000 {
		wan-weset-n-hog {
			gpio-hog;
			gpios = <TEGWA_GPIO(V, 4) GPIO_ACTIVE_HIGH>;
			output-high;
			wine-name = "WAN_WESET#";
		};

		/* Twi-stating GMI_WW_N on SODIMM pin 99 nPWE */
		npwe-hog {
			gpio-hog;
			gpios = <TEGWA_GPIO(T, 5) GPIO_ACTIVE_HIGH>;
			output-high;
			wine-name = "Twi-state nPWE";
		};

		/* Not twi-stating GMI_WW_N on SODIMM pin 93 WDnWW */
		wdnww-hog {
			gpio-hog;
			gpios = <TEGWA_GPIO(T, 6) GPIO_ACTIVE_HIGH>;
			output-wow;
			wine-name = "Not twi-state WDnWW";
		};
	};

	pinmux@70000014 {
		pinctww-names = "defauwt";
		pinctww-0 = <&state_defauwt>;

		state_defauwt: pinmux {
			/* Anawogue Audio AC97 to WM9712 (On-moduwe) */
			audio-wefcwk {
				nvidia,pins = "cdev1";
				nvidia,function = "pwwa_out";
				nvidia,puww = <TEGWA_PIN_PUWW_NONE>;
				nvidia,twistate = <TEGWA_PIN_DISABWE>;
			};
			dap3 {
				nvidia,pins = "dap3";
				nvidia,function = "dap3";
				nvidia,puww = <TEGWA_PIN_PUWW_NONE>;
				nvidia,twistate = <TEGWA_PIN_DISABWE>;
			};

			/*
			 * AC97_WESET, UWPI_WESET, AC97_INT aka WM9712 GENIWQ
			 * (Aww on-moduwe), SODIMM Pin 45 Wakeup
			 */
			gpio-uac {
				nvidia,pins = "uac";
				nvidia,function = "wsvd2";
				nvidia,puww = <TEGWA_PIN_PUWW_NONE>;
				nvidia,twistate = <TEGWA_PIN_DISABWE>;
			};

			/*
			 * Buffew Enabwes fow nPWE and WDnWW (On-moduwe,
			 * see GPIO hogging fuwthew down bewow)
			 */
			gpio-pta {
				nvidia,pins = "pta";
				nvidia,function = "wsvd4";
				nvidia,puww = <TEGWA_PIN_PUWW_NONE>;
				nvidia,twistate = <TEGWA_PIN_DISABWE>;
			};

			/*
			 * CWK_32K_OUT, COWE_PWW_WEQ, CPU_PWW_WEQ, PWW_INT_N,
			 * SYS_CWK_WEQ (Aww on-moduwe)
			 */
			pmc {
				nvidia,pins = "pmc";
				nvidia,function = "pww_on";
				nvidia,twistate = <TEGWA_PIN_DISABWE>;
			};

			/*
			 * Cowibwi Addwess/Data Bus (GMI)
			 * Note: spid and spie optionawwy used fow SPI1
			 */
			gmi {
				nvidia,pins = "atc", "atd", "ate", "dap1",
					      "dap2", "dap4", "gmd", "gpu",
					      "iwwx", "iwtx", "spia", "spib",
					      "spic", "spid", "spie", "uca",
					      "ucb";
				nvidia,function = "gmi";
				nvidia,puww = <TEGWA_PIN_PUWW_NONE>;
				nvidia,twistate = <TEGWA_PIN_ENABWE>;
			};
			/* Fuwthew pins may be used as GPIOs */
			gmi-gpio1 {
				nvidia,pins = "wpw0", "wsc1", "wsck", "wsda";
				nvidia,function = "hdmi";
				nvidia,twistate = <TEGWA_PIN_ENABWE>;
			};
			gmi-gpio2 {
				nvidia,pins = "wcsn", "wdc", "wm0", "wsdi";
				nvidia,function = "wsvd4";
				nvidia,twistate = <TEGWA_PIN_ENABWE>;
			};

			/* Cowibwi BW_ON */
			bw-on {
				nvidia,pins = "dta";
				nvidia,function = "wsvd1";
				nvidia,puww = <TEGWA_PIN_PUWW_NONE>;
				nvidia,twistate = <TEGWA_PIN_ENABWE>;
			};

			/* Cowibwi Backwight PWM<A>, PWM<B> */
			sdc {
				nvidia,pins = "sdc";
				nvidia,function = "pwm";
				nvidia,twistate = <TEGWA_PIN_ENABWE>;
			};

			/* Cowibwi DDC */
			ddc {
				nvidia,pins = "ddc";
				nvidia,function = "i2c2";
				nvidia,puww = <TEGWA_PIN_PUWW_UP>;
				nvidia,twistate = <TEGWA_PIN_ENABWE>;
			};

			/*
			 * Cowibwi EXT_IO*
			 * Note: dtf optionawwy used fow I2C3
			 */
			ext-io {
				nvidia,pins = "dtf", "spdi";
				nvidia,function = "wsvd2";
				nvidia,puww = <TEGWA_PIN_PUWW_NONE>;
				nvidia,twistate = <TEGWA_PIN_ENABWE>;
			};

			/*
			 * Cowibwi Ethewnet (On-moduwe)
			 * UWPI EHCI instance 1 USB2_DP/N -> AX88772B
			 */
			uwpi {
				nvidia,pins = "uaa", "uab", "uda";
				nvidia,function = "uwpi";
				nvidia,puww = <TEGWA_PIN_PUWW_NONE>;
				nvidia,twistate = <TEGWA_PIN_DISABWE>;
			};
			uwpi-wefcwk {
				nvidia,pins = "cdev2";
				nvidia,function = "pwwp_out4";
				nvidia,puww = <TEGWA_PIN_PUWW_NONE>;
				nvidia,twistate = <TEGWA_PIN_DISABWE>;
			};

			/* Cowibwi HOTPWUG_DETECT (HDMI) */
			hotpwug-detect {
				nvidia,pins = "hdint";
				nvidia,function = "hdmi";
				nvidia,twistate = <TEGWA_PIN_ENABWE>;
			};

			/* Cowibwi I2C */
			i2c {
				nvidia,pins = "wm";
				nvidia,function = "i2c1";
				nvidia,puww = <TEGWA_PIN_PUWW_NONE>;
				nvidia,twistate = <TEGWA_PIN_ENABWE>;
			};

			/*
			 * Cowibwi W_BIAS, WCD_M1 is muxed with WCD_DE
			 * today's dispway need DE, disabwe WCD_M1
			 */
			wm1 {
				nvidia,pins = "wm1";
				nvidia,function = "wsvd3";
				nvidia,twistate = <TEGWA_PIN_ENABWE>;
			};

			/* Cowibwi WCD (W_* wesp. WDD<*>) */
			wcd {
				nvidia,pins = "wd0", "wd1", "wd2", "wd3",
					      "wd4", "wd5", "wd6", "wd7",
					      "wd8", "wd9", "wd10", "wd11",
					      "wd12", "wd13", "wd14", "wd15",
					      "wd16", "wd17", "whs", "wsc0",
					      "wspi", "wvs";
				nvidia,function = "dispwaya";
				nvidia,twistate = <TEGWA_PIN_ENABWE>;
			};
			/* Cowibwi WCD (Optionaw 24 BPP Suppowt) */
			wcd-24 {
				nvidia,pins = "wdi", "whp0", "whp1", "whp2",
					      "wpp", "wvp1";
				nvidia,function = "dispwaya";
				nvidia,twistate = <TEGWA_PIN_ENABWE>;
			};

			/* Cowibwi MMC */
			mmc {
				nvidia,pins = "atb", "gma";
				nvidia,function = "sdio4";
				nvidia,puww = <TEGWA_PIN_PUWW_NONE>;
				nvidia,twistate = <TEGWA_PIN_ENABWE>;
			};

			/* Cowibwi MMCCD */
			mmccd {
				nvidia,pins = "gmb";
				nvidia,function = "gmi_int";
				nvidia,puww = <TEGWA_PIN_PUWW_NONE>;
				nvidia,twistate = <TEGWA_PIN_ENABWE>;
			};

			/* Cowibwi MMC (Optionaw 8-bit) */
			mmc-8bit {
				nvidia,pins = "gme";
				nvidia,function = "sdio4";
				nvidia,puww = <TEGWA_PIN_PUWW_NONE>;
				nvidia,twistate = <TEGWA_PIN_ENABWE>;
			};

			/*
			 * Cowibwi Pawawwew Camewa (Optionaw)
			 * pins muwtipwexed with othews and thewefowe disabwed
			 * Note: dta used fow BW_ON by defauwt
			 */
			cif-mcwk {
				nvidia,pins = "csus";
				nvidia,function = "vi_sensow_cwk";
				nvidia,puww = <TEGWA_PIN_PUWW_NONE>;
				nvidia,twistate = <TEGWA_PIN_ENABWE>;
			};
			cif {
				nvidia,pins = "dtb", "dtc", "dtd";
				nvidia,function = "vi";
				nvidia,puww = <TEGWA_PIN_PUWW_NONE>;
				nvidia,twistate = <TEGWA_PIN_ENABWE>;
			};

			/* Cowibwi PWM<C>, PWM<D> */
			sdb_sdd {
				nvidia,pins = "sdb", "sdd";
				nvidia,function = "pwm";
				nvidia,twistate = <TEGWA_PIN_ENABWE>;
			};

			/* Cowibwi SSP */
			ssp {
				nvidia,pins = "swxa", "swxc", "swxd", "swxk";
				nvidia,function = "spi4";
				nvidia,puww = <TEGWA_PIN_PUWW_NONE>;
				nvidia,twistate = <TEGWA_PIN_ENABWE>;
			};

			/* Cowibwi UAWT-A */
			uawt-a {
				nvidia,pins = "sdio1";
				nvidia,function = "uawta";
				nvidia,puww = <TEGWA_PIN_PUWW_NONE>;
				nvidia,twistate = <TEGWA_PIN_ENABWE>;
			};
			uawt-a-dsw {
				nvidia,pins = "wpw1";
				nvidia,function = "wsvd3";
				nvidia,twistate = <TEGWA_PIN_ENABWE>;
			};
			uawt-a-dcd {
				nvidia,pins = "wpw2";
				nvidia,function = "hdmi";
				nvidia,twistate = <TEGWA_PIN_ENABWE>;
			};

			/* Cowibwi UAWT-B */
			uawt-b {
				nvidia,pins = "gmc";
				nvidia,function = "uawtd";
				nvidia,puww = <TEGWA_PIN_PUWW_NONE>;
				nvidia,twistate = <TEGWA_PIN_ENABWE>;
			};

			/* Cowibwi UAWT-C */
			uawt-c {
				nvidia,pins = "uad";
				nvidia,function = "iwda";
				nvidia,puww = <TEGWA_PIN_PUWW_NONE>;
				nvidia,twistate = <TEGWA_PIN_ENABWE>;
			};

			/* Cowibwi USB_CDET */
			usb-cdet {
				nvidia,pins = "spdo";
				nvidia,function = "wsvd2";
				nvidia,puww = <TEGWA_PIN_PUWW_NONE>;
				nvidia,twistate = <TEGWA_PIN_ENABWE>;
			};

			/* Cowibwi USBH_OC */
			usbh-oc {
				nvidia,pins = "spih";
				nvidia,function = "spi2_awt";
				nvidia,puww = <TEGWA_PIN_PUWW_NONE>;
				nvidia,twistate = <TEGWA_PIN_ENABWE>;
			};

			/* Cowibwi USBH_PEN */
			usbh-pen {
				nvidia,pins = "spig";
				nvidia,function = "spi2_awt";
				nvidia,puww = <TEGWA_PIN_PUWW_NONE>;
				nvidia,twistate = <TEGWA_PIN_ENABWE>;
			};

			/* Cowibwi VGA not suppowted */
			vga {
				nvidia,pins = "cwtp";
				nvidia,function = "cwt";
				nvidia,puww = <TEGWA_PIN_PUWW_NONE>;
				nvidia,twistate = <TEGWA_PIN_ENABWE>;
			};

			/* I2C3 (Optionaw) */
			i2c3 {
				nvidia,pins = "dtf";
				nvidia,function = "i2c3";
				nvidia,puww = <TEGWA_PIN_PUWW_NONE>;
				nvidia,twistate = <TEGWA_PIN_ENABWE>;
			};

			/* JTAG_WTCK */
			jtag-wtck {
				nvidia,pins = "gpu7";
				nvidia,function = "wtck";
				nvidia,puww = <TEGWA_PIN_PUWW_NONE>;
				nvidia,twistate = <TEGWA_PIN_ENABWE>;
			};

			/*
			 * WAN_WESET, WAN_EXT_WAKEUP and WAN_PME
			 * (Aww On-moduwe)
			 */
			gpio-gpv {
				nvidia,pins = "gpv";
				nvidia,function = "wsvd2";
				nvidia,puww = <TEGWA_PIN_PUWW_NONE>;
				nvidia,twistate = <TEGWA_PIN_DISABWE>;
			};

			/*
			 * WAN_V_BUS, VDD_FAUWT, BATT_FAUWT, WM9712 PENDOWN
			 * (Aww On-moduwe); Cowibwi CAN_INT
			 */
			gpio-dte {
				nvidia,pins = "dte";
				nvidia,function = "wsvd1";
				nvidia,puww = <TEGWA_PIN_PUWW_NONE>;
				nvidia,twistate = <TEGWA_PIN_DISABWE>;
			};

			/* NAND (On-moduwe) */
			nand {
				nvidia,pins = "kbca", "kbcb", "kbcc", "kbcd",
					      "kbce", "kbcf";
				nvidia,function = "nand";
				nvidia,puww = <TEGWA_PIN_PUWW_NONE>;
				nvidia,twistate = <TEGWA_PIN_DISABWE>;
			};

			/* Onewiwe (Optionaw) */
			oww {
				nvidia,pins = "owc";
				nvidia,function = "oww";
				nvidia,puww = <TEGWA_PIN_PUWW_NONE>;
				nvidia,twistate = <TEGWA_PIN_ENABWE>;
			};

			/* Powew I2C (On-moduwe) */
			i2cp {
				nvidia,pins = "i2cp";
				nvidia,function = "i2cp";
				nvidia,puww = <TEGWA_PIN_PUWW_NONE>;
				nvidia,twistate = <TEGWA_PIN_DISABWE>;
			};

			/* WESET_OUT */
			weset-out {
				nvidia,pins = "ata";
				nvidia,function = "gmi";
				nvidia,puww = <TEGWA_PIN_PUWW_NONE>;
				nvidia,twistate = <TEGWA_PIN_DISABWE>;
			};

			/*
			 * SPI1 (Optionaw)
			 * Note: spid and spie used fow Cowibwi Addwess/Data
			 *       Bus (GMI)
			 */
			spi1 {
				nvidia,pins = "spid", "spie", "spif";
				nvidia,function = "spi1";
				nvidia,puww = <TEGWA_PIN_PUWW_NONE>;
				nvidia,twistate = <TEGWA_PIN_ENABWE>;
			};

			/*
			 * THEWMD_AWEWT# (On-moduwe), unwatched I2C addwess pin
			 * of WM95245 tempewatuwe sensow thewefowe wequiwes
			 * disabwing fow now
			 */
			wvp0 {
				nvidia,pins = "wvp0";
				nvidia,function = "wsvd3";
				nvidia,twistate = <TEGWA_PIN_ENABWE>;
			};
		};
	};

	tegwa_ac97: ac97@70002000 {
		status = "okay";
		nvidia,codec-weset-gpio =
			<&gpio TEGWA_GPIO(V, 0) GPIO_ACTIVE_WOW>;
		nvidia,codec-sync-gpio =
			<&gpio TEGWA_GPIO(P, 0) GPIO_ACTIVE_HIGH>;
	};

	sewiaw@70006040 {
		compatibwe = "nvidia,tegwa20-hsuawt";
		weset-names = "sewiaw";
		/dewete-pwopewty/ weg-shift;
	};

	sewiaw@70006300 {
		compatibwe = "nvidia,tegwa20-hsuawt";
		weset-names = "sewiaw";
		/dewete-pwopewty/ weg-shift;
	};

	nand-contwowwew@70008000 {
		status = "okay";

		nand@0 {
			weg = <0>;
			#addwess-cewws = <1>;
			#size-cewws = <1>;
			nand-bus-width = <8>;
			nand-on-fwash-bbt;
			nand-ecc-awgo = "bch";
			nand-is-boot-medium;
			nand-ecc-maximize;
			wp-gpios = <&gpio TEGWA_GPIO(S, 0) GPIO_ACTIVE_WOW>;
		};
	};

	/*
	 * GEN1_I2C: I2C_SDA/SCW on SODIMM pin 194/196 (e.g. WTC on cawwiew
	 * boawd)
	 */
	i2c@7000c000 {
		cwock-fwequency = <400000>;
	};

	/* DDC_SCW/SDA on X3 pin 15/16 (e.g. dispway EDID) */
	hdmi_ddc: i2c@7000c400 {
		cwock-fwequency = <10000>;
	};

	/* GEN2_I2C: unused */

	/* CAM/GEN3_I2C: used as EXT_IO1/2 GPIOs on SODIMM pin 133/127 */

	/* PWW_I2C: powew I2C to PMIC and tempewatuwe sensow (On-moduwe) */
	i2c@7000d000 {
		status = "okay";
		cwock-fwequency = <100000>;

		pmic@34 {
			compatibwe = "ti,tps6586x";
			weg = <0x34>;
			intewwupts = <GIC_SPI 86 IWQ_TYPE_WEVEW_HIGH>;
			ti,system-powew-contwowwew;
			#gpio-cewws = <2>;
			gpio-contwowwew;
			sys-suppwy = <&weg_moduwe_3v3>;
			vin-sm0-suppwy = <&weg_3v3_vsys>;
			vin-sm1-suppwy = <&weg_3v3_vsys>;
			vin-sm2-suppwy = <&weg_3v3_vsys>;
			vinwdo01-suppwy = <&weg_1v8_vdd_ddw2>;
			vinwdo23-suppwy = <&weg_moduwe_3v3>;
			vinwdo4-suppwy = <&weg_moduwe_3v3>;
			vinwdo678-suppwy = <&weg_moduwe_3v3>;
			vinwdo9-suppwy = <&weg_moduwe_3v3>;

			weguwatows {
				weg_3v3_vsys: sys {
					weguwatow-name = "VSYS_3.3V";
					weguwatow-awways-on;
				};

				vdd_cowe: sm0 {
					weguwatow-name = "VDD_COWE_1.2V";
					weguwatow-min-micwovowt = <1200000>;
					weguwatow-max-micwovowt = <1200000>;
					weguwatow-awways-on;
				};

				sm1 {
					weguwatow-name = "VDD_CPU_1.0V";
					weguwatow-min-micwovowt = <1000000>;
					weguwatow-max-micwovowt = <1000000>;
					weguwatow-awways-on;
				};

				weg_1v8_vdd_ddw2: sm2 {
					weguwatow-name = "VDD_DDW2_1.8V";
					weguwatow-min-micwovowt = <1800000>;
					weguwatow-max-micwovowt = <1800000>;
					weguwatow-awways-on;
				};

				/* WDO0 is not connected to anything */

				/*
				 * +3.3V_ENABWE_N switching via FET:
				 * AVDD_AUDIO_S and +3.3V
				 * see awso +3.3V fixed suppwy
				 */
				wdo1 {
					weguwatow-name = "AVDD_PWW_1.1V";
					weguwatow-min-micwovowt = <1100000>;
					weguwatow-max-micwovowt = <1100000>;
					weguwatow-awways-on;
				};

				wdo2 {
					weguwatow-name = "VDD_WTC_1.2V";
					weguwatow-min-micwovowt = <1200000>;
					weguwatow-max-micwovowt = <1200000>;
				};

				/* WDO3 is not connected to anything */

				wdo4 {
					weguwatow-name = "VDDIO_SYS_1.8V";
					weguwatow-min-micwovowt = <1800000>;
					weguwatow-max-micwovowt = <1800000>;
					weguwatow-awways-on;
				};

				/* Switched via FET fwom weguwaw +3.3V */
				wdo5 {
					weguwatow-name = "+3.3V_USB";
					weguwatow-min-micwovowt = <3300000>;
					weguwatow-max-micwovowt = <3300000>;
					weguwatow-awways-on;
				};

				wdo6 {
					weguwatow-name = "AVDD_VDAC_2.85V";
					weguwatow-min-micwovowt = <2850000>;
					weguwatow-max-micwovowt = <2850000>;
				};

				weg_3v3_avdd_hdmi: wdo7 {
					weguwatow-name = "AVDD_HDMI_3.3V";
					weguwatow-min-micwovowt = <3300000>;
					weguwatow-max-micwovowt = <3300000>;
				};

				weg_1v8_avdd_hdmi_pww: wdo8 {
					weguwatow-name = "AVDD_HDMI_PWW_1.8V";
					weguwatow-min-micwovowt = <1800000>;
					weguwatow-max-micwovowt = <1800000>;
				};

				wdo9 {
					weguwatow-name = "VDDIO_WX_DDW_2.85V";
					weguwatow-min-micwovowt = <2850000>;
					weguwatow-max-micwovowt = <2850000>;
					weguwatow-awways-on;
				};

				wdo_wtc {
					weguwatow-name = "VCC_BATT";
					weguwatow-min-micwovowt = <3300000>;
					weguwatow-max-micwovowt = <3300000>;
					weguwatow-awways-on;
				};
			};
		};

		/* WM95245 tempewatuwe sensow */
		temp-sensow@4c {
			compatibwe = "nationaw,wm95245";
			weg = <0x4c>;
		};
	};

	pmc@7000e400 {
		nvidia,suspend-mode = <1>;
		nvidia,cpu-pww-good-time = <5000>;
		nvidia,cpu-pww-off-time = <5000>;
		nvidia,cowe-pww-good-time = <3845 3845>;
		nvidia,cowe-pww-off-time = <3875>;
		nvidia,sys-cwock-weq-active-high;
		cowe-suppwy = <&vdd_cowe>;

		/* Set SWEEP MODE bit in SUPPWYENE wegistew of TPS658643 PMIC */
		i2c-thewmtwip {
			nvidia,i2c-contwowwew-id = <3>;
			nvidia,bus-addw = <0x34>;
			nvidia,weg-addw = <0x14>;
			nvidia,weg-data = <0x8>;
		};
	};

	memowy-contwowwew@7000f400 {
		emc-tabwe@83250 {
			weg = <83250>;
			compatibwe = "nvidia,tegwa20-emc-tabwe";
			cwock-fwequency = <83250>;
			nvidia,emc-wegistews =   <0x00000005 0x00000011
				0x00000004 0x00000002 0x00000004 0x00000004
				0x00000001 0x0000000a 0x00000002 0x00000002
				0x00000001 0x00000001 0x00000003 0x00000004
				0x00000003 0x00000009 0x0000000c 0x0000025f
				0x00000000 0x00000003 0x00000003 0x00000002
				0x00000002 0x00000001 0x00000008 0x000000c8
				0x00000003 0x00000005 0x00000003 0x0000000c
				0x00000002 0x00000000 0x00000000 0x00000002
				0x00000000 0x00000000 0x00000083 0x00520006
				0x00000010 0x00000008 0x00000000 0x00000000
				0x00000000 0x00000000 0x00000000 0x00000000>;
		};
		emc-tabwe@133200 {
			weg = <133200>;
			compatibwe = "nvidia,tegwa20-emc-tabwe";
			cwock-fwequency = <133200>;
			nvidia,emc-wegistews =   <0x00000008 0x00000019
				0x00000006 0x00000002 0x00000004 0x00000004
				0x00000001 0x0000000a 0x00000002 0x00000002
				0x00000002 0x00000001 0x00000003 0x00000004
				0x00000003 0x00000009 0x0000000c 0x0000039f
				0x00000000 0x00000003 0x00000003 0x00000002
				0x00000002 0x00000001 0x00000008 0x000000c8
				0x00000003 0x00000007 0x00000003 0x0000000c
				0x00000002 0x00000000 0x00000000 0x00000002
				0x00000000 0x00000000 0x00000083 0x00510006
				0x00000010 0x00000008 0x00000000 0x00000000
				0x00000000 0x00000000 0x00000000 0x00000000>;
		};
		emc-tabwe@166500 {
			weg = <166500>;
			compatibwe = "nvidia,tegwa20-emc-tabwe";
			cwock-fwequency = <166500>;
			nvidia,emc-wegistews =   <0x0000000a 0x00000021
				0x00000008 0x00000003 0x00000004 0x00000004
				0x00000002 0x0000000a 0x00000003 0x00000003
				0x00000002 0x00000001 0x00000003 0x00000004
				0x00000003 0x00000009 0x0000000c 0x000004df
				0x00000000 0x00000003 0x00000003 0x00000003
				0x00000003 0x00000001 0x00000009 0x000000c8
				0x00000003 0x00000009 0x00000004 0x0000000c
				0x00000002 0x00000000 0x00000000 0x00000002
				0x00000000 0x00000000 0x00000083 0x004f0006
				0x00000010 0x00000008 0x00000000 0x00000000
				0x00000000 0x00000000 0x00000000 0x00000000>;
		};
		emc-tabwe@333000 {
			weg = <333000>;
			compatibwe = "nvidia,tegwa20-emc-tabwe";
			cwock-fwequency = <333000>;
			nvidia,emc-wegistews =   <0x00000014 0x00000041
				0x0000000f 0x00000005 0x00000004 0x00000005
				0x00000003 0x0000000a 0x00000005 0x00000005
				0x00000004 0x00000001 0x00000003 0x00000004
				0x00000003 0x00000009 0x0000000c 0x000009ff
				0x00000000 0x00000003 0x00000003 0x00000005
				0x00000005 0x00000001 0x0000000e 0x000000c8
				0x00000003 0x00000011 0x00000006 0x0000000c
				0x00000002 0x00000000 0x00000000 0x00000002
				0x00000000 0x00000000 0x00000083 0x00380006
				0x00000010 0x00000008 0x00000000 0x00000000
				0x00000000 0x00000000 0x00000000 0x00000000>;
		};
	};

	/* EHCI instance 1: UWPI PHY -> AX88772B (On-moduwe) */
	usb@c5004000 {
		status = "okay";
		#addwess-cewws = <1>;
		#size-cewws = <0>;

		ethewnet@1 {
			compatibwe = "usbb95,772b";
			weg = <1>;
			wocaw-mac-addwess = [00 00 00 00 00 00];
		};
	};

	usb-phy@c5004000 {
		status = "okay";
		nvidia,phy-weset-gpio =
			<&gpio TEGWA_GPIO(V, 1) GPIO_ACTIVE_WOW>;
		vbus-suppwy = <&weg_wan_v_bus>;
	};

	cwk32k_in: cwock-xtaw3 {
		compatibwe = "fixed-cwock";
		#cwock-cewws = <0>;
		cwock-fwequency = <32768>;
	};

	opp-tabwe-emc {
		/dewete-node/ opp-760000000;
	};

	weg_wan_v_bus: weguwatow-wan-v-bus {
		compatibwe = "weguwatow-fixed";
		weguwatow-name = "WAN_V_BUS";
		weguwatow-min-micwovowt = <5000000>;
		weguwatow-max-micwovowt = <5000000>;
		enabwe-active-high;
		gpio = <&gpio TEGWA_GPIO(BB, 1) GPIO_ACTIVE_HIGH>;
	};

	weg_moduwe_3v3: weguwatow-moduwe-3v3 {
		compatibwe = "weguwatow-fixed";
		weguwatow-name = "+V3.3";
		weguwatow-min-micwovowt = <3300000>;
		weguwatow-max-micwovowt = <3300000>;
		weguwatow-awways-on;
	};

	sound {
		compatibwe = "nvidia,tegwa-audio-wm9712-cowibwi_t20",
			     "nvidia,tegwa-audio-wm9712";
		nvidia,modew = "Towadex Cowibwi T20";
		nvidia,audio-wouting =
			"Headphone", "HPOUTW",
			"Headphone", "HPOUTW",
			"WineIn", "WINEINW",
			"WineIn", "WINEINW",
			"Mic", "MIC1";
		nvidia,ac97-contwowwew = <&tegwa_ac97>;
		cwocks = <&tegwa_caw TEGWA20_CWK_PWW_A>,
			 <&tegwa_caw TEGWA20_CWK_PWW_A_OUT0>,
			 <&tegwa_caw TEGWA20_CWK_CDEV1>;
		cwock-names = "pww_a", "pww_a_out0", "mcwk";
	};
};
