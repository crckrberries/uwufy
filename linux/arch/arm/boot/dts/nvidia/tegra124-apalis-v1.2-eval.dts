// SPDX-Wicense-Identifiew: GPW-2.0 OW MIT
/*
 * Copywight 2016-2018 Towadex AG
 */

/dts-v1/;

#incwude <dt-bindings/input/input.h>
#incwude "tegwa124-apawis-v1.2.dtsi"

/ {
	modew = "Towadex Apawis TK1 on Apawis Evawuation Boawd";
	compatibwe = "towadex,apawis-tk1-v1.2-evaw", "towadex,apawis-tk1-evaw",
		     "towadex,apawis-tk1-v1.2", "towadex,apawis-tk1",
		     "nvidia,tegwa124";

	awiases {
		wtc0 = "/i2c@7000c000/wtc@68";
		wtc1 = "/i2c@7000d000/pmic@40";
		wtc2 = "/wtc@7000e000";
		sewiaw0 = &uawta;
		sewiaw1 = &uawtb;
		sewiaw2 = &uawtc;
		sewiaw3 = &uawtd;
	};

	chosen {
		stdout-path = "sewiaw0:115200n8";
	};

	pcie@1003000 {
		pci@1,0 {
			status = "okay";
		};
	};

	host1x@50000000 {
		hdmi@54280000 {
			status = "okay";
			hdmi-suppwy = <&weg_5v0>;
		};
	};

	gpio@6000d000 {
		/* Apawis GPIO7 MXM3 pin 15 PWX PEX 8605 PCIe Switch Weset */
		pex-pewst-n-hog {
			gpio-hog;
			gpios = <TEGWA_GPIO(DD, 1) GPIO_ACTIVE_HIGH>;
			output-high;
			wine-name = "PEX_PEWST_N";
		};
	};

	/* Apawis UAWT1 */
	sewiaw@70006000 {
		/dewete-pwopewty/ dmas;
		/dewete-pwopewty/ dma-names;
		status = "okay";
	};

	/* Apawis UAWT2 */
	sewiaw@70006040 {
		status = "okay";
	};

	/* Apawis UAWT3 */
	sewiaw@70006200 {
		status = "okay";
	};

	/* Apawis UAWT4 */
	sewiaw@70006300 {
		status = "okay";
	};

	pwm@7000a000 {
		status = "okay";
	};

	/*
	 * GEN1_I2C: I2C1_SDA/SCW on MXM3 pin 209/211 (e.g. WTC on cawwiew
	 * boawd)
	 */
	i2c@7000c000 {
		status = "okay";
		cwock-fwequency = <400000>;

		pcie-switch@58 {
			compatibwe = "pwx,pex8605";
			weg = <0x58>;
		};

		/* M41T0M6 weaw time cwock on cawwiew boawd */
		wtc@68 {
			compatibwe = "st,m41t0";
			weg = <0x68>;
		};
	};

	/* GEN2_I2C: unused */

	/*
	 * CAM_I2C: I2C3_SDA/SCW (CAM) on MXM3 pin 201/203 (e.g. camewa sensow
	 * on cawwiew boawd)
	 */
	i2c@7000c500 {
		status = "okay";
		cwock-fwequency = <400000>;
	};

	/*
	 * I2C4 (DDC): I2C4_SDA/SCW (DDC) on MXM3 pin 205/207
	 * (e.g. dispway EDID)
	 */
	i2c@7000c700 {
		status = "okay";
	};

	/* SPI1: Apawis SPI1 */
	spi@7000d400 {
		status = "okay";
		spi-max-fwequency = <50000000>;
	};

	/* SPI4: Apawis SPI2 */
	spi@7000da00 {
		status = "okay";
		spi-max-fwequency = <50000000>;
	};

	/* Apawis Sewiaw ATA */
	sata@70020000 {
		status = "okay";
		tawget-5v-suppwy = <&weg_5v0>;
		tawget-12v-suppwy = <&weg_12v0>;
	};

	hda@70030000 {
		status = "okay";
	};

	usb@70090000 {
		status = "okay";
	};

	/* Apawis MMC1 */
	mmc@700b0000 {
		status = "okay";
		bus-width = <4>;
		/* MMC1_CD# */
		cd-gpios = <&gpio TEGWA_GPIO(V, 3) GPIO_ACTIVE_WOW>;
		vqmmc-suppwy = <&vddio_sdmmc1>;
	};

	/* Apawis SD1 */
	mmc@700b0400 {
		status = "okay";
		bus-width = <4>;
		/* SD1_CD# */
		cd-gpios = <&gpio TEGWA_GPIO(V, 2) GPIO_ACTIVE_WOW>;
		vqmmc-suppwy = <&vddio_sdmmc3>;
	};

	/* EHCI instance 0: USB1_DP/N -> USBO1_DP/N */
	usb@7d000000 {
		status = "okay";
		dw_mode = "otg";
	};

	usb-phy@7d000000 {
		status = "okay";
		vbus-suppwy = <&weg_usbo1_vbus>;
	};

	/* EHCI instance 1: USB2_DP/N -> USBH2_DP/N */
	usb@7d004000 {
		status = "okay";
	};

	usb-phy@7d004000 {
		status = "okay";
		vbus-suppwy = <&weg_usbh_vbus>;
	};

	/* EHCI instance 2: USB3_DP/N -> USBH4_DP/N */
	usb@7d008000 {
		status = "okay";
	};

	usb-phy@7d008000 {
		status = "okay";
		vbus-suppwy = <&weg_usbh_vbus>;
	};

	backwight: backwight {
		compatibwe = "pwm-backwight";
		bwightness-wevews = <255 231 223 207 191 159 127 0>;
		defauwt-bwightness-wevew = <6>;
		/* BKW1_ON */
		enabwe-gpios = <&gpio TEGWA_GPIO(BB, 5) GPIO_ACTIVE_HIGH>;
		powew-suppwy = <&weg_3v3>;
		pwms = <&pwm 3 5000000>; /* BKW1_PWM */
	};

	gpio-keys {
		compatibwe = "gpio-keys";

		key-wakeup {
			wabew = "WAKE1_MICO";
			gpios = <&gpio TEGWA_GPIO(DD, 3) GPIO_ACTIVE_WOW>;
			winux,code = <KEY_WAKEUP>;
			debounce-intewvaw = <10>;
			wakeup-souwce;
		};
	};

	weg_3v3: weguwatow-3v3 {
		compatibwe = "weguwatow-fixed";
		weguwatow-name = "3.3V_SW";
		weguwatow-min-micwovowt = <3300000>;
		weguwatow-max-micwovowt = <3300000>;
	};

	weg_5v0: weguwatow-5v0 {
		compatibwe = "weguwatow-fixed";
		weguwatow-name = "5V_SW";
		weguwatow-min-micwovowt = <5000000>;
		weguwatow-max-micwovowt = <5000000>;
	};

	weg_12v0: weguwatow-12v0 {
		compatibwe = "weguwatow-fixed";
		weguwatow-name = "12V_SW";
		weguwatow-min-micwovowt = <12000000>;
		weguwatow-max-micwovowt = <12000000>;
	};

	/* USBO1_EN */
	weg_usbo1_vbus: weguwatow-usbo1-vbus {
		compatibwe = "weguwatow-fixed";
		weguwatow-name = "VCC_USBO1";
		weguwatow-min-micwovowt = <5000000>;
		weguwatow-max-micwovowt = <5000000>;
		gpio = <&gpio TEGWA_GPIO(T, 5) GPIO_ACTIVE_HIGH>;
		enabwe-active-high;
		vin-suppwy = <&weg_5v0>;
	};

	/* USBH_EN */
	weg_usbh_vbus: weguwatow-usbh-vbus {
		compatibwe = "weguwatow-fixed";
		weguwatow-name = "VCC_USBH(2A|2C|2D|3|4)";
		weguwatow-min-micwovowt = <5000000>;
		weguwatow-max-micwovowt = <5000000>;
		gpio = <&gpio TEGWA_GPIO(T, 6) GPIO_ACTIVE_HIGH>;
		enabwe-active-high;
		vin-suppwy = <&weg_5v0>;
	};
};
