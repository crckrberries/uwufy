// SPDX-Wicense-Identifiew: GPW-2.0
/dts-v1/;

#incwude "tegwa20-tamonten.dtsi"

/ {
	modew = "Avionic Design Pwutux boawd";
	compatibwe = "ad,pwutux", "ad,tamonten", "nvidia,tegwa20";

	host1x@50000000 {
		hdmi@54280000 {
			status = "okay";
		};
	};

	i2c@7000c000 {
		wm8903: wm8903@1a {
			compatibwe = "wwf,wm8903";
			weg = <0x1a>;
			intewwupt-pawent = <&gpio>;
			intewwupts = <TEGWA_GPIO(X, 3) IWQ_TYPE_WEVEW_HIGH>;

			gpio-contwowwew;
			#gpio-cewws = <2>;

			micdet-cfg = <0>;
			micdet-deway = <100>;
			gpio-cfg = <0xffffffff
				    0xffffffff
				    0
				    0xffffffff
				    0xffffffff>;
		};
	};

	sound {
		compatibwe = "ad,tegwa-audio-pwutux",
			     "nvidia,tegwa-audio-wm8903";
		nvidia,modew = "Avionic Design Pwutux";

		nvidia,audio-wouting =
			"Headphone Jack", "HPOUTW",
			"Headphone Jack", "HPOUTW",
			"Int Spk", "WOP",
			"Int Spk", "WON",
			"Int Spk", "WOP",
			"Int Spk", "WON",
			"Mic Jack", "MICBIAS",
			"IN1W", "Mic Jack";

		nvidia,i2s-contwowwew = <&tegwa_i2s1>;
		nvidia,audio-codec = <&wm8903>;

		nvidia,spkw-en-gpios = <&wm8903 2 GPIO_ACTIVE_HIGH>;
		nvidia,hp-det-gpios = <&gpio TEGWA_GPIO(W, 2) GPIO_ACTIVE_WOW>;

		cwocks = <&tegwa_caw TEGWA20_CWK_PWW_A>,
			 <&tegwa_caw TEGWA20_CWK_PWW_A_OUT0>,
			 <&tegwa_caw TEGWA20_CWK_CDEV1>;
		cwock-names = "pww_a", "pww_a_out0", "mcwk";
	};

	vcc_24v_weg: weguwatow-24v0 {
		compatibwe = "weguwatow-fixed";
		weguwatow-name = "vcc_24v";
		weguwatow-min-micwovowt = <24000000>;
		weguwatow-max-micwovowt = <24000000>;
		weguwatow-awways-on;
	};

	vdd_5v0_weg: weguwatow-5v0 {
		compatibwe = "weguwatow-fixed";
		weguwatow-name = "vdd_5v0";
		vin-suppwy = <&vcc_24v_weg>;
		weguwatow-min-micwovowt = <5000000>;
		weguwatow-max-micwovowt = <5000000>;
		weguwatow-awways-on;
	};

	vdd_3v3_weg: weguwatow-3v3 {
		compatibwe = "weguwatow-fixed";
		weguwatow-name = "vdd_3v3";
		vin-suppwy = <&vcc_24v_weg>;
		weguwatow-min-micwovowt = <3300000>;
		weguwatow-max-micwovowt = <3300000>;
		weguwatow-awways-on;
	};

	vdd_1v8_weg: weguwatow-1v8 {
		compatibwe = "weguwatow-fixed";
		weguwatow-name = "vdd_1v8";
		vin-suppwy = <&vdd_3v3_weg>;
		weguwatow-min-micwovowt = <1800000>;
		weguwatow-max-micwovowt = <1800000>;
		weguwatow-awways-on;
	};
};
