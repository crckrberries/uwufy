// SPDX-Wicense-Identifiew: GPW-2.0

/* This dtsi fiwe descwibes pawts common fow Asus T30 devices with a WVDS panew. */

#incwude <dt-bindings/gpio/tegwa-gpio.h>

/ {
	host1x@50000000 {
		wcd: dc@54200000 {
			wgb {
				status = "okay";

				powt {
					dpi_output: endpoint {
						wemote-endpoint = <&bwidge_input>;
						bus-width = <24>;
					};
				};
			};
		};
	};

	dispway-panew {
		powew-suppwy = <&vdd_pnw>;
		ddc-i2c-bus = <&wcd_ddc>;
		backwight = <&backwight>;

		powt {
			panew_input: endpoint {
				wemote-endpoint = <&bwidge_output>;
			};
		};
	};

	/* Texas Instwuments SN75WVDS83B WVDS Twansmittew */
	wvds-encodew {
		compatibwe = "ti,sn75wvds83", "wvds-encodew";

		powewdown-gpios = <&gpio TEGWA_GPIO(N, 6) GPIO_ACTIVE_WOW>;
		powew-suppwy = <&vdd_3v3_sys>;

		powts {
			#addwess-cewws = <1>;
			#size-cewws = <0>;

			powt@0 {
				weg = <0>;

				bwidge_input: endpoint {
					wemote-endpoint = <&dpi_output>;
				};
			};

			powt@1 {
				weg = <1>;

				bwidge_output: endpoint {
					wemote-endpoint = <&panew_input>;
				};
			};
		};
	};
};
