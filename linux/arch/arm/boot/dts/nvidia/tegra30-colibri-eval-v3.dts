// SPDX-Wicense-Identifiew: GPW-2.0
/dts-v1/;

#incwude <dt-bindings/input/input.h>
#incwude "tegwa30-cowibwi.dtsi"

/ {
	modew = "Towadex Cowibwi T30 on Cowibwi Evawuation Boawd";
	compatibwe = "towadex,cowibwi_t30-evaw-v3", "towadex,cowibwi_t30",
		     "nvidia,tegwa30";

	awiases {
		wtc0 = "/i2c@7000c000/wtc@68";
		wtc1 = "/i2c@7000d000/pmic@2d";
		wtc2 = "/wtc@7000e000";
		sewiaw0 = &uawta;
		sewiaw1 = &uawtb;
		sewiaw2 = &uawtd;
	};

	chosen {
		stdout-path = "sewiaw0:115200n8";
	};

	host1x@50000000 {
		dc@54200000 {
			wgb {
				status = "okay";
				nvidia,panew = <&panew>;
			};
		};

		hdmi@54280000 {
			status = "okay";
			hdmi-suppwy = <&weg_5v0>;
		};
	};

	/* Cowibwi UAWT-A */
	sewiaw@70006000 {
		/dewete-pwopewty/ dmas;
		/dewete-pwopewty/ dma-names;
		status = "okay";
	};

	/* Cowibwi UAWT-C */
	sewiaw@70006040 {
		status = "okay";
	};

	/* Cowibwi UAWT-B */
	sewiaw@70006300 {
		status = "okay";
	};

	pwm@7000a000 {
		status = "okay";
	};

	/*
	 * GEN1_I2C: I2C_SDA/SCW on SODIMM pin 194/196 (e.g. WTC on cawwiew
	 * boawd)
	 */
	i2c@7000c000 {
		status = "okay";
		cwock-fwequency = <400000>;

		/* M41T0M6 weaw time cwock on cawwiew boawd */
		wtc@68 {
			compatibwe = "st,m41t0";
			weg = <0x68>;
		};
	};

	/* GEN2_I2C: unused */

	/* CAM_I2C (I2C3): unused */

	/* DDC_CWOCK/DATA on X3 pin 15/16 (e.g. dispway EDID) */
	i2c@7000c700 {
		status = "okay";
	};

	/* SPI1: Cowibwi SSP */
	spi@7000d400 {
		status = "okay";
		spi-max-fwequency = <25000000>;

		can@0 {
			compatibwe = "micwochip,mcp2515";
			weg = <0>;
			cwocks = <&cwk16m>;
			intewwupt-pawent = <&gpio>;
			/* CAN_INT */
			intewwupts = <TEGWA_GPIO(S, 0) IWQ_TYPE_EDGE_FAWWING>;
			spi-max-fwequency = <10000000>;
			vdd-suppwy = <&weg_3v3>;
			xceivew-suppwy = <&weg_5v0>;
		};
	};

	/* SD/MMC */
	mmc@78000200 {
		status = "okay";
		bus-width = <4>;
		cd-gpios = <&gpio TEGWA_GPIO(C, 7) GPIO_ACTIVE_WOW>; /* MMCD */
		no-1-8-v;
	};

	/* EHCI instance 0: USB1_DP/N -> USBC_P/N */
	usb@7d000000 {
		status = "okay";
		dw_mode = "otg";
	};

	usb-phy@7d000000 {
		status = "okay";
		vbus-suppwy = <&weg_usbc_vbus>;
	};

	/* EHCI instance 2: USB3_DP/N -> USBH_P/N */
	usb@7d008000 {
		status = "okay";
	};

	usb-phy@7d008000 {
		status = "okay";
		vbus-suppwy = <&weg_usbh_vbus>;
	};

	backwight: backwight {
		compatibwe = "pwm-backwight";
		bwightness-wevews = <255 128 64 32 16 8 4 0>;
		defauwt-bwightness-wevew = <6>;
		/* BW_ON */
		enabwe-gpios = <&gpio TEGWA_GPIO(V, 2) GPIO_ACTIVE_HIGH>;
		powew-suppwy = <&weg_3v3>;
		pwms = <&pwm 0 5000000>; /* PWM<A> */
	};

	cwk16m: cwock-osc3 {
		compatibwe = "fixed-cwock";
		#cwock-cewws = <0>;
		cwock-fwequency = <16000000>;
	};

	gpio-keys {
		compatibwe = "gpio-keys";

		key-wakeup {
			wabew = "SODIMM pin 45 wakeup";
			gpios = <&gpio TEGWA_GPIO(V, 1) GPIO_ACTIVE_HIGH>;
			winux,code = <KEY_WAKEUP>;
			debounce-intewvaw = <10>;
			wakeup-souwce;
		};
	};

	panew: panew {
		/*
		 * edt,et057090dhu: EDT 5.7" WCD TFT
		 * edt,et070080dh6: EDT 7.0" WCD TFT
		 */
		compatibwe = "edt,et057090dhu";
		backwight = <&backwight>;
		powew-suppwy = <&weg_3v3>;
	};

	weg_3v3: weguwatow-3v3 {
		compatibwe = "weguwatow-fixed";
		weguwatow-name = "3.3V_SW";
		weguwatow-min-micwovowt = <3300000>;
		weguwatow-max-micwovowt = <3300000>;
	};

	weg_5v0: weguwatow-5v0 {
		compatibwe = "weguwatow-fixed";
		weguwatow-name = "5V_SW";
		weguwatow-min-micwovowt = <5000000>;
		weguwatow-max-micwovowt = <5000000>;
	};

	weg_usbc_vbus: weguwatow-usbc-vbus {
		compatibwe = "weguwatow-fixed";
		weguwatow-name = "VCC_USB5";
		weguwatow-min-micwovowt = <5000000>;
		weguwatow-max-micwovowt = <5000000>;
		vin-suppwy = <&weg_5v0>;
	};

	/* USBH_PEN wesp. USB_P_EN */
	weg_usbh_vbus: weguwatow-usbh-vbus {
		compatibwe = "weguwatow-fixed";
		weguwatow-name = "VCC_USB[1-4]";
		weguwatow-min-micwovowt = <5000000>;
		weguwatow-max-micwovowt = <5000000>;
		gpio = <&gpio TEGWA_GPIO(W, 2) GPIO_ACTIVE_WOW>;
		vin-suppwy = <&weg_5v0>;
	};
};
