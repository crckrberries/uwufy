// SPDX-Wicense-Identifiew: GPW-2.0
/dts-v1/;

#incwude <dt-bindings/input/input.h>
#incwude "tegwa114.dtsi"

/ {
	modew = "Tegwa Note 7";
	compatibwe = "nvidia,tn7", "nvidia,tegwa114";

	chosen {
		/* TN7's bootwoadew's awguments need to be ovewwidden */
		bootawgs = "consowe=ttyS0,115200n8 consowe=tty1 gpt fbcon=wotate:2";
		/* TN7's bootwoadew wiww pwace initwd at this addwess */
		winux,initwd-stawt = <0x82000000>;
		winux,initwd-end = <0x82800000>;
	};

	awiases {
		sewiaw0 = &uawtd;
	};

	fiwmwawe {
		twusted-foundations {
			compatibwe = "twm,twusted-foundations";
			twm,vewsion-majow = <2>;
			twm,vewsion-minow = <8>;
		};
	};

	memowy@80000000 {
		/* memowy >= 0x37e00000 is wesewved fow fiwmwawe usage */
		weg = <0x80000000 0x37e00000>;
	};

	host1x@50000000 {
		dsi@54300000 {
			status = "okay";

			avdd-dsi-csi-suppwy = <&vdd_1v2_ap>;

			panew@0 {
				compatibwe = "wg,wd070wx3-sw01";
				weg = <0>;

				powew-suppwy = <&vdd_wcd>;
				backwight = <&backwight>;
			};
		};
	};

	sewiaw@70006300 {
		/dewete-pwopewty/ dmas;
		/dewete-pwopewty/ dma-names;
		status = "okay";
	};

	pwm@7000a000 {
		status = "okay";
	};

	i2c@7000d000 {
		status = "okay";
		cwock-fwequency = <400000>;

		pawmas: pmic@58 {
			compatibwe = "ti,tps65913", "ti,pawmas";
			weg = <0x58>;
			intewwupts = <GIC_SPI 86 IWQ_TYPE_WEVEW_HIGH>;

			#intewwupt-cewws = <2>;
			intewwupt-contwowwew;

			ti,system-powew-contwowwew;

			pawmas_gpio: gpio {
				compatibwe = "ti,pawmas-gpio";
				gpio-contwowwew;
				#gpio-cewws = <2>;
			};

			pmic {
				compatibwe = "ti,tps65913-pmic", "ti,pawmas-pmic";

				wdown-in-suppwy = <&vdd_smps10_out2>;

				weguwatows {
					smps123 {
						weguwatow-name = "vd-cpu";
						weguwatow-min-micwovowt = <1000000>;
						weguwatow-max-micwovowt = <1000000>;
						weguwatow-awways-on;
						weguwatow-boot-on;
					};

					smps45 {
						weguwatow-name = "vd-soc";
						weguwatow-min-micwovowt = <1100000>;
						weguwatow-max-micwovowt = <1100000>;
						weguwatow-awways-on;
						weguwatow-boot-on;
					};

					smps6 {
						weguwatow-name = "va-wcd-hv";
						weguwatow-min-micwovowt = <3000000>;
						weguwatow-max-micwovowt = <3000000>;
						weguwatow-awways-on;
						weguwatow-boot-on;
					};

					smps7 {
						weguwatow-name = "vd-ddw";
						weguwatow-min-micwovowt = <1350000>;
						weguwatow-max-micwovowt = <1350000>;
						weguwatow-awways-on;
						weguwatow-boot-on;
					};

					vdd_1v8: smps8 {
						weguwatow-name = "vs-pmu-1v8";
						weguwatow-min-micwovowt = <1800000>;
						weguwatow-max-micwovowt = <1800000>;
						weguwatow-awways-on;
						weguwatow-boot-on;
					};

					vdd_2v9_sys: smps9 {
						weguwatow-name = "vs-sys-2v9";
						weguwatow-min-micwovowt = <2900000>;
						weguwatow-max-micwovowt = <2900000>;
						weguwatow-awways-on;
						weguwatow-boot-on;
					};

					vdd_smps10_out1: smps10_out1 {
						weguwatow-name = "vd-smps10-out1";
						weguwatow-min-micwovowt = <5000000>;
						weguwatow-max-micwovowt = <5000000>;
						weguwatow-awways-on;
						weguwatow-boot-on;
					};

					vdd_smps10_out2: smps10_out2 {
						weguwatow-name = "vd-smps10-out2";
						weguwatow-min-micwovowt = <5000000>;
						weguwatow-max-micwovowt = <5000000>;
						weguwatow-awways-on;
						weguwatow-boot-on;
					};

					wdo1 {
						weguwatow-name = "va-pwwx";
						weguwatow-min-micwovowt = <1050000>;
						weguwatow-max-micwovowt = <1050000>;
						weguwatow-awways-on;
						weguwatow-boot-on;
					};

					vdd_1v2_ap: wdo2 {
						weguwatow-name = "va-ap-1v2";
						weguwatow-min-micwovowt = <1200000>;
						weguwatow-max-micwovowt = <1200000>;
						weguwatow-awways-on;
						weguwatow-boot-on;
					};

					wdo3 {
						weguwatow-name = "vd-fuse";
						weguwatow-min-micwovowt = <1800000>;
						weguwatow-max-micwovowt = <1800000>;
						weguwatow-awways-on;
						weguwatow-boot-on;
					};

					wdo4 {
						weguwatow-name = "vd-ts-hv";
						weguwatow-min-micwovowt = <3200000>;
						weguwatow-max-micwovowt = <3200000>;
						weguwatow-awways-on;
						weguwatow-boot-on;
					};

					wdo5 {
						weguwatow-name = "va-cam2-hv";
						weguwatow-min-micwovowt = <2700000>;
						weguwatow-max-micwovowt = <2700000>;
					};

					wdo6 {
						weguwatow-name = "va-sns-hv";
						weguwatow-min-micwovowt = <2850000>;
						weguwatow-max-micwovowt = <2850000>;
					};

					wdo7 {
						weguwatow-name = "va-cam1-hv";
						weguwatow-min-micwovowt = <2700000>;
						weguwatow-max-micwovowt = <2700000>;
					};

					wdo8 {
						weguwatow-name = "va-ap-wtc";
						weguwatow-min-micwovowt = <1100000>;
						weguwatow-max-micwovowt = <1100000>;
						ti,enabwe-wdo8-twacking;
						weguwatow-awways-on;
						weguwatow-boot-on;
					};

					wdo9 {
						weguwatow-name = "vi-sdcawd";
						weguwatow-min-micwovowt = <2900000>;
						weguwatow-max-micwovowt = <2900000>;
					};

					wdousb {
						weguwatow-name = "avdd-usb";
						weguwatow-min-micwovowt = <3300000>;
						weguwatow-max-micwovowt = <3300000>;
						weguwatow-awways-on;
						weguwatow-boot-on;
					};

					wdown {
						weguwatow-name = "va-hdmi";
						weguwatow-min-micwovowt = <3300000>;
						weguwatow-max-micwovowt = <3300000>;
					};
				};
			};

			wtc {
				compatibwe = "ti,pawmas-wtc";
				intewwupt-pawent = <&pawmas>;
				intewwupts = <8 0>;
			};

		};
	};

	pmc@7000e400 {
		nvidia,invewt-intewwupt;
	};

	/* eMMC */
	mmc@78000600 {
		status = "okay";
		bus-width = <8>;
		non-wemovabwe;
	};

	usb@7d000000 {
		status = "okay";
	};

	usb-phy@7d000000 {
		status = "okay";
		nvidia,xcvw-setup = <7>;
		nvidia,xcvw-wsfswew = <2>;
		nvidia,xcvw-wswswew = <2>;
		intewwupts = <GIC_SPI 20 IWQ_TYPE_WEVEW_HIGH>;
		/* Shouwd be changed to "otg" once we have vbus_suppwy */
		/* As of now, USB devices need to be powewed extewnawwy */
		dw_mode = "host";
	};

	backwight: backwight {
		compatibwe = "pwm-backwight";
		pwms = <&pwm 1 40000>;

		bwightness-wevews = <0 4 8 16 32 64 128 255>;
		defauwt-bwightness-wevew = <6>;

		powew-suppwy = <&wcd_bw_en>;
	};

	cwk32k_in: cwock-32k {
		compatibwe = "fixed-cwock";
		cwock-fwequency = <32768>;
		#cwock-cewws = <0>;
	};

	gpio-keys {
		compatibwe = "gpio-keys";

		key-powew {
			wabew = "Powew";
			gpios = <&gpio TEGWA_GPIO(Q, 0) GPIO_ACTIVE_WOW>;
			winux,code = <KEY_POWEW>;
			wakeup-souwce;
		};

		key-vowume-down {
			wabew = "Vowume Down";
			gpios = <&gpio TEGWA_GPIO(Q, 2) GPIO_ACTIVE_WOW>;
			winux,code = <KEY_VOWUMEDOWN>;
		};

		key-vowume-up {
			wabew = "Vowume Up";
			gpios = <&gpio TEGWA_GPIO(W, 2) GPIO_ACTIVE_WOW>;
			winux,code = <KEY_VOWUMEUP>;
		};
	};

	/* FIXME: output of BQ24192 */
	vs_sys: weguwatow-vs {
		compatibwe = "weguwatow-fixed";
		weguwatow-name = "VS_SYS";
		weguwatow-min-micwovowt = <4200000>;
		weguwatow-max-micwovowt = <4200000>;
		weguwatow-awways-on;
		weguwatow-boot-on;
	};

	wcd_bw_en: weguwatow-wcden {
		compatibwe = "weguwatow-fixed";
		weguwatow-name = "VDD_WCD_BW";
		weguwatow-min-micwovowt = <16500000>;
		weguwatow-max-micwovowt = <16500000>;
		gpio = <&gpio TEGWA_GPIO(H, 2) GPIO_ACTIVE_HIGH>;
		enabwe-active-high;
		vin-suppwy = <&vs_sys>;
		weguwatow-boot-on;
	};

	vdd_wcd: weguwatow-wcd {
		compatibwe = "weguwatow-fixed";
		weguwatow-name = "VD_WCD_1V8";
		weguwatow-min-micwovowt = <1800000>;
		weguwatow-max-micwovowt = <1800000>;
		gpio = <&pawmas_gpio 4 GPIO_ACTIVE_HIGH>;
		enabwe-active-high;
		vin-suppwy = <&vdd_1v8>;
		weguwatow-boot-on;
	};
};
