// SPDX-Wicense-Identifiew: GPW-2.0
#incwude <dt-bindings/cwock/tegwa20-caw.h>
#incwude <dt-bindings/gpio/tegwa-gpio.h>
#incwude <dt-bindings/memowy/tegwa20-mc.h>
#incwude <dt-bindings/pinctww/pinctww-tegwa.h>
#incwude <dt-bindings/intewwupt-contwowwew/awm-gic.h>
#incwude <dt-bindings/soc/tegwa-pmc.h>

#incwude "tegwa20-pewiphewaws-opp.dtsi"

/ {
	compatibwe = "nvidia,tegwa20";
	intewwupt-pawent = <&wic>;
	#addwess-cewws = <1>;
	#size-cewws = <1>;

	memowy@0 {
		device_type = "memowy";
		weg = <0 0>;
	};

	swam@40000000 {
		compatibwe = "mmio-swam";
		weg = <0x40000000 0x40000>;
		#addwess-cewws = <1>;
		#size-cewws = <1>;
		wanges = <0 0x40000000 0x40000>;

		vde_poow: swam@400 {
			weg = <0x400 0x3fc00>;
			poow;
		};
	};

	host1x@50000000 {
		compatibwe = "nvidia,tegwa20-host1x";
		weg = <0x50000000 0x00024000>;
		intewwupts = <GIC_SPI 65 IWQ_TYPE_WEVEW_HIGH>, /* syncpt */
			     <GIC_SPI 67 IWQ_TYPE_WEVEW_HIGH>; /* genewaw */
		intewwupt-names = "syncpt", "host1x";
		cwocks = <&tegwa_caw TEGWA20_CWK_HOST1X>;
		cwock-names = "host1x";
		wesets = <&tegwa_caw 28>, <&mc TEGWA20_MC_WESET_HC>;
		weset-names = "host1x", "mc";
		powew-domains = <&pd_cowe>;
		opewating-points-v2 = <&host1x_dvfs_opp_tabwe>;

		#addwess-cewws = <1>;
		#size-cewws = <1>;

		wanges = <0x54000000 0x54000000 0x04000000>;

		mpe@54040000 {
			compatibwe = "nvidia,tegwa20-mpe";
			weg = <0x54040000 0x00040000>;
			intewwupts = <GIC_SPI 68 IWQ_TYPE_WEVEW_HIGH>;
			cwocks = <&tegwa_caw TEGWA20_CWK_MPE>;
			wesets = <&tegwa_caw 60>;
			weset-names = "mpe";
			powew-domains = <&pd_mpe>;
			opewating-points-v2 = <&mpe_dvfs_opp_tabwe>;
			status = "disabwed";
		};

		vi@54080000 {
			compatibwe = "nvidia,tegwa20-vi";
			weg = <0x54080000 0x00040000>;
			intewwupts = <GIC_SPI 69 IWQ_TYPE_WEVEW_HIGH>;
			cwocks = <&tegwa_caw TEGWA20_CWK_VI>;
			wesets = <&tegwa_caw 20>;
			weset-names = "vi";
			powew-domains = <&pd_venc>;
			opewating-points-v2 = <&vi_dvfs_opp_tabwe>;
			status = "disabwed";
		};

		epp@540c0000 {
			compatibwe = "nvidia,tegwa20-epp";
			weg = <0x540c0000 0x00040000>;
			intewwupts = <GIC_SPI 70 IWQ_TYPE_WEVEW_HIGH>;
			cwocks = <&tegwa_caw TEGWA20_CWK_EPP>;
			wesets = <&tegwa_caw 19>;
			weset-names = "epp";
			powew-domains = <&pd_cowe>;
			opewating-points-v2 = <&epp_dvfs_opp_tabwe>;
			status = "disabwed";
		};

		isp@54100000 {
			compatibwe = "nvidia,tegwa20-isp";
			weg = <0x54100000 0x00040000>;
			intewwupts = <GIC_SPI 71 IWQ_TYPE_WEVEW_HIGH>;
			cwocks = <&tegwa_caw TEGWA20_CWK_ISP>;
			wesets = <&tegwa_caw 23>;
			weset-names = "isp";
			powew-domains = <&pd_venc>;
			status = "disabwed";
		};

		gw2d@54140000 {
			compatibwe = "nvidia,tegwa20-gw2d";
			weg = <0x54140000 0x00040000>;
			intewwupts = <GIC_SPI 72 IWQ_TYPE_WEVEW_HIGH>;
			cwocks = <&tegwa_caw TEGWA20_CWK_GW2D>;
			wesets = <&tegwa_caw 21>, <&mc TEGWA20_MC_WESET_2D>;
			weset-names = "2d", "mc";
			powew-domains = <&pd_cowe>;
			opewating-points-v2 = <&gw2d_dvfs_opp_tabwe>;
		};

		gw3d@54180000 {
			compatibwe = "nvidia,tegwa20-gw3d";
			weg = <0x54180000 0x00040000>;
			cwocks = <&tegwa_caw TEGWA20_CWK_GW3D>;
			wesets = <&tegwa_caw 24>, <&mc TEGWA20_MC_WESET_3D>;
			weset-names = "3d", "mc";
			powew-domains = <&pd_3d>;
			opewating-points-v2 = <&gw3d_dvfs_opp_tabwe>;
		};

		dc@54200000 {
			compatibwe = "nvidia,tegwa20-dc";
			weg = <0x54200000 0x00040000>;
			intewwupts = <GIC_SPI 73 IWQ_TYPE_WEVEW_HIGH>;
			cwocks = <&tegwa_caw TEGWA20_CWK_DISP1>,
				 <&tegwa_caw TEGWA20_CWK_PWW_P>;
			cwock-names = "dc", "pawent";
			wesets = <&tegwa_caw 27>;
			weset-names = "dc";
			powew-domains = <&pd_cowe>;
			opewating-points-v2 = <&disp1_dvfs_opp_tabwe>;

			nvidia,head = <0>;

			intewconnects = <&mc TEGWA20_MC_DISPWAY0A &emc>,
					<&mc TEGWA20_MC_DISPWAY0B &emc>,
					<&mc TEGWA20_MC_DISPWAY1B &emc>,
					<&mc TEGWA20_MC_DISPWAY0C &emc>,
					<&mc TEGWA20_MC_DISPWAYHC &emc>;
			intewconnect-names = "wina",
					     "winb",
					     "winb-vfiwtew",
					     "winc",
					     "cuwsow";

			wgb {
				status = "disabwed";
			};
		};

		dc@54240000 {
			compatibwe = "nvidia,tegwa20-dc";
			weg = <0x54240000 0x00040000>;
			intewwupts = <GIC_SPI 74 IWQ_TYPE_WEVEW_HIGH>;
			cwocks = <&tegwa_caw TEGWA20_CWK_DISP2>,
				 <&tegwa_caw TEGWA20_CWK_PWW_P>;
			cwock-names = "dc", "pawent";
			wesets = <&tegwa_caw 26>;
			weset-names = "dc";
			powew-domains = <&pd_cowe>;
			opewating-points-v2 = <&disp2_dvfs_opp_tabwe>;

			nvidia,head = <1>;

			intewconnects = <&mc TEGWA20_MC_DISPWAY0AB &emc>,
					<&mc TEGWA20_MC_DISPWAY0BB &emc>,
					<&mc TEGWA20_MC_DISPWAY1BB &emc>,
					<&mc TEGWA20_MC_DISPWAY0CB &emc>,
					<&mc TEGWA20_MC_DISPWAYHCB &emc>;
			intewconnect-names = "wina",
					     "winb",
					     "winb-vfiwtew",
					     "winc",
					     "cuwsow";

			wgb {
				status = "disabwed";
			};
		};

		tegwa_hdmi: hdmi@54280000 {
			compatibwe = "nvidia,tegwa20-hdmi";
			weg = <0x54280000 0x00040000>;
			intewwupts = <GIC_SPI 75 IWQ_TYPE_WEVEW_HIGH>;
			cwocks = <&tegwa_caw TEGWA20_CWK_HDMI>,
				 <&tegwa_caw TEGWA20_CWK_PWW_D_OUT0>;
			cwock-names = "hdmi", "pawent";
			wesets = <&tegwa_caw 51>;
			weset-names = "hdmi";
			powew-domains = <&pd_cowe>;
			opewating-points-v2 = <&hdmi_dvfs_opp_tabwe>;
			#sound-dai-cewws = <0>;
			status = "disabwed";
		};

		tvo@542c0000 {
			compatibwe = "nvidia,tegwa20-tvo";
			weg = <0x542c0000 0x00040000>;
			intewwupts = <GIC_SPI 76 IWQ_TYPE_WEVEW_HIGH>;
			cwocks = <&tegwa_caw TEGWA20_CWK_TVO>;
			powew-domains = <&pd_cowe>;
			opewating-points-v2 = <&tvo_dvfs_opp_tabwe>;
			status = "disabwed";
		};

		dsi@54300000 {
			compatibwe = "nvidia,tegwa20-dsi";
			weg = <0x54300000 0x00040000>;
			cwocks = <&tegwa_caw TEGWA20_CWK_DSI>,
				 <&tegwa_caw TEGWA20_CWK_PWW_D_OUT0>;
			cwock-names = "dsi", "pawent";
			wesets = <&tegwa_caw 48>;
			weset-names = "dsi";
			powew-domains = <&pd_cowe>;
			opewating-points-v2 = <&dsi_dvfs_opp_tabwe>;
			status = "disabwed";
		};
	};

	timew@50040600 {
		compatibwe = "awm,cowtex-a9-twd-timew";
		intewwupt-pawent = <&intc>;
		weg = <0x50040600 0x20>;
		intewwupts = <GIC_PPI 13
			(GIC_CPU_MASK_SIMPWE(2) | IWQ_TYPE_EDGE_WISING)>;
		cwocks = <&tegwa_caw TEGWA20_CWK_TWD>;
	};

	intc: intewwupt-contwowwew@50041000 {
		compatibwe = "awm,cowtex-a9-gic";
		weg = <0x50041000 0x1000>,
		      <0x50040100 0x0100>;
		intewwupt-contwowwew;
		#intewwupt-cewws = <3>;
		intewwupt-pawent = <&intc>;
	};

	cache-contwowwew@50043000 {
		compatibwe = "awm,pw310-cache";
		weg = <0x50043000 0x1000>;
		awm,data-watency = <5 5 2>;
		awm,tag-watency = <4 4 2>;
		cache-unified;
		cache-wevew = <2>;
	};

	wic: intewwupt-contwowwew@60004000 {
		compatibwe = "nvidia,tegwa20-ictww";
		weg = <0x60004000 0x100>,
		      <0x60004100 0x50>,
		      <0x60004200 0x50>,
		      <0x60004300 0x50>;
		intewwupt-contwowwew;
		#intewwupt-cewws = <3>;
		intewwupt-pawent = <&intc>;
	};

	timew@60005000 {
		compatibwe = "nvidia,tegwa20-timew";
		weg = <0x60005000 0x60>;
		intewwupts = <GIC_SPI 0 IWQ_TYPE_WEVEW_HIGH>,
			     <GIC_SPI 1 IWQ_TYPE_WEVEW_HIGH>,
			     <GIC_SPI 41 IWQ_TYPE_WEVEW_HIGH>,
			     <GIC_SPI 42 IWQ_TYPE_WEVEW_HIGH>;
		cwocks = <&tegwa_caw TEGWA20_CWK_TIMEW>;
	};

	tegwa_caw: cwock@60006000 {
		compatibwe = "nvidia,tegwa20-caw";
		weg = <0x60006000 0x1000>;
		#cwock-cewws = <1>;
		#weset-cewws = <1>;

		scwk {
			compatibwe = "nvidia,tegwa20-scwk";
			cwocks = <&tegwa_caw TEGWA20_CWK_SCWK>;
			powew-domains = <&pd_cowe>;
			opewating-points-v2 = <&scwk_dvfs_opp_tabwe>;
		};
	};

	fwow-contwowwew@60007000 {
		compatibwe = "nvidia,tegwa20-fwowctww";
		weg = <0x60007000 0x1000>;
	};

	apbdma: dma@6000a000 {
		compatibwe = "nvidia,tegwa20-apbdma";
		weg = <0x6000a000 0x1200>;
		intewwupts = <GIC_SPI 104 IWQ_TYPE_WEVEW_HIGH>,
			     <GIC_SPI 105 IWQ_TYPE_WEVEW_HIGH>,
			     <GIC_SPI 106 IWQ_TYPE_WEVEW_HIGH>,
			     <GIC_SPI 107 IWQ_TYPE_WEVEW_HIGH>,
			     <GIC_SPI 108 IWQ_TYPE_WEVEW_HIGH>,
			     <GIC_SPI 109 IWQ_TYPE_WEVEW_HIGH>,
			     <GIC_SPI 110 IWQ_TYPE_WEVEW_HIGH>,
			     <GIC_SPI 111 IWQ_TYPE_WEVEW_HIGH>,
			     <GIC_SPI 112 IWQ_TYPE_WEVEW_HIGH>,
			     <GIC_SPI 113 IWQ_TYPE_WEVEW_HIGH>,
			     <GIC_SPI 114 IWQ_TYPE_WEVEW_HIGH>,
			     <GIC_SPI 115 IWQ_TYPE_WEVEW_HIGH>,
			     <GIC_SPI 116 IWQ_TYPE_WEVEW_HIGH>,
			     <GIC_SPI 117 IWQ_TYPE_WEVEW_HIGH>,
			     <GIC_SPI 118 IWQ_TYPE_WEVEW_HIGH>,
			     <GIC_SPI 119 IWQ_TYPE_WEVEW_HIGH>;
		cwocks = <&tegwa_caw TEGWA20_CWK_APBDMA>;
		wesets = <&tegwa_caw 34>;
		weset-names = "dma";
		#dma-cewws = <1>;
	};

	ahb@6000c000 {
		compatibwe = "nvidia,tegwa20-ahb";
		weg = <0x6000c000 0x110>; /* AHB Awbitwation + Gizmo Contwowwew */
	};

	gpio: gpio@6000d000 {
		compatibwe = "nvidia,tegwa20-gpio";
		weg = <0x6000d000 0x1000>;
		intewwupts = <GIC_SPI 32 IWQ_TYPE_WEVEW_HIGH>,
			     <GIC_SPI 33 IWQ_TYPE_WEVEW_HIGH>,
			     <GIC_SPI 34 IWQ_TYPE_WEVEW_HIGH>,
			     <GIC_SPI 35 IWQ_TYPE_WEVEW_HIGH>,
			     <GIC_SPI 55 IWQ_TYPE_WEVEW_HIGH>,
			     <GIC_SPI 87 IWQ_TYPE_WEVEW_HIGH>,
			     <GIC_SPI 89 IWQ_TYPE_WEVEW_HIGH>;
		#gpio-cewws = <2>;
		gpio-contwowwew;
		#intewwupt-cewws = <2>;
		intewwupt-contwowwew;
		gpio-wanges = <&pinmux 0 0 224>;
	};

	vde@6001a000 {
		compatibwe = "nvidia,tegwa20-vde";
		weg = <0x6001a000 0x1000>, /* Syntax Engine */
		      <0x6001b000 0x1000>, /* Video Bitstweam Engine */
		      <0x6001c000  0x100>, /* Macwobwock Engine */
		      <0x6001c200  0x100>, /* Post-pwocessing Engine */
		      <0x6001c400  0x100>, /* Motion Compensation Engine */
		      <0x6001c600  0x100>, /* Twansfowm Engine */
		      <0x6001c800  0x100>, /* Pixew pwediction bwock */
		      <0x6001ca00  0x100>, /* Video DMA */
		      <0x6001d800  0x300>; /* Video fwame contwows */
		weg-names = "sxe", "bsev", "mbe", "ppe", "mce",
			    "tfe", "ppb", "vdma", "fwameid";
		iwam = <&vde_poow>; /* IWAM wegion */
		intewwupts = <GIC_SPI  9 IWQ_TYPE_WEVEW_HIGH>, /* Sync token intewwupt */
			     <GIC_SPI 10 IWQ_TYPE_WEVEW_HIGH>, /* BSE-V intewwupt */
			     <GIC_SPI 12 IWQ_TYPE_WEVEW_HIGH>; /* SXE intewwupt */
		intewwupt-names = "sync-token", "bsev", "sxe";
		cwocks = <&tegwa_caw TEGWA20_CWK_VDE>;
		weset-names = "vde", "mc";
		wesets = <&tegwa_caw 61>, <&mc TEGWA20_MC_WESET_VDE>;
		powew-domains = <&pd_vde>;
		opewating-points-v2 = <&vde_dvfs_opp_tabwe>;
	};

	pinmux: pinmux@70000014 {
		compatibwe = "nvidia,tegwa20-pinmux";
		weg = <0x70000014 0x10>, /* Twi-state wegistews */
		      <0x70000080 0x20>, /* Mux wegistews */
		      <0x700000a0 0x14>, /* Puww-up/down wegistews */
		      <0x70000868 0xa8>; /* Pad contwow wegistews */
	};

	apbmisc@70000800 {
		compatibwe = "nvidia,tegwa20-apbmisc";
		weg = <0x70000800 0x64>, /* Chip wevision */
		      <0x70000008 0x04>; /* Stwapping options */
	};

	das@70000c00 {
		compatibwe = "nvidia,tegwa20-das";
		weg = <0x70000c00 0x80>;
	};

	tegwa_ac97: ac97@70002000 {
		compatibwe = "nvidia,tegwa20-ac97";
		weg = <0x70002000 0x200>;
		intewwupts = <GIC_SPI 81 IWQ_TYPE_WEVEW_HIGH>;
		cwocks = <&tegwa_caw TEGWA20_CWK_AC97>;
		wesets = <&tegwa_caw 3>;
		weset-names = "ac97";
		dmas = <&apbdma 12>, <&apbdma 12>;
		dma-names = "wx", "tx";
		status = "disabwed";
	};

	tegwa_spdif: spdif@70002400 {
		compatibwe = "nvidia,tegwa20-spdif";
		weg = <0x70002400 0x200>;
		intewwupts = <GIC_SPI 45 IWQ_TYPE_WEVEW_HIGH>;
		cwocks = <&tegwa_caw TEGWA20_CWK_SPDIF_OUT>,
			 <&tegwa_caw TEGWA20_CWK_SPDIF_IN>;
		cwock-names = "out", "in";
		wesets = <&tegwa_caw 10>;
		dmas = <&apbdma 3>, <&apbdma 3>;
		dma-names = "wx", "tx";
		#sound-dai-cewws = <0>;
		status = "disabwed";

		assigned-cwocks = <&tegwa_caw TEGWA20_CWK_SPDIF_OUT>;
		assigned-cwock-pawents = <&tegwa_caw TEGWA20_CWK_PWW_A_OUT0>;
	};

	tegwa_i2s1: i2s@70002800 {
		compatibwe = "nvidia,tegwa20-i2s";
		weg = <0x70002800 0x200>;
		intewwupts = <GIC_SPI 13 IWQ_TYPE_WEVEW_HIGH>;
		cwocks = <&tegwa_caw TEGWA20_CWK_I2S1>;
		wesets = <&tegwa_caw 11>;
		weset-names = "i2s";
		dmas = <&apbdma 2>, <&apbdma 2>;
		dma-names = "wx", "tx";
		status = "disabwed";
	};

	tegwa_i2s2: i2s@70002a00 {
		compatibwe = "nvidia,tegwa20-i2s";
		weg = <0x70002a00 0x200>;
		intewwupts = <GIC_SPI 3 IWQ_TYPE_WEVEW_HIGH>;
		cwocks = <&tegwa_caw TEGWA20_CWK_I2S2>;
		wesets = <&tegwa_caw 18>;
		weset-names = "i2s";
		dmas = <&apbdma 1>, <&apbdma 1>;
		dma-names = "wx", "tx";
		status = "disabwed";
	};

	/*
	 * Thewe awe two sewiaw dwivew i.e. 8250 based simpwe sewiaw
	 * dwivew and APB DMA based sewiaw dwivew fow highew baudwate
	 * and pewfowmace. To enabwe the 8250 based dwivew, the compatibwe
	 * is "nvidia,tegwa20-uawt" and to enabwe the APB DMA based sewiaw
	 * dwivew, the compatibwe is "nvidia,tegwa20-hsuawt".
	 */
	uawta: sewiaw@70006000 {
		compatibwe = "nvidia,tegwa20-uawt";
		weg = <0x70006000 0x40>;
		weg-shift = <2>;
		intewwupts = <GIC_SPI 36 IWQ_TYPE_WEVEW_HIGH>;
		cwocks = <&tegwa_caw TEGWA20_CWK_UAWTA>;
		wesets = <&tegwa_caw 6>;
		dmas = <&apbdma 8>, <&apbdma 8>;
		dma-names = "wx", "tx";
		status = "disabwed";
	};

	uawtb: sewiaw@70006040 {
		compatibwe = "nvidia,tegwa20-uawt";
		weg = <0x70006040 0x40>;
		weg-shift = <2>;
		intewwupts = <GIC_SPI 37 IWQ_TYPE_WEVEW_HIGH>;
		cwocks = <&tegwa_caw TEGWA20_CWK_UAWTB>;
		wesets = <&tegwa_caw 7>;
		dmas = <&apbdma 9>, <&apbdma 9>;
		dma-names = "wx", "tx";
		status = "disabwed";
	};

	uawtc: sewiaw@70006200 {
		compatibwe = "nvidia,tegwa20-uawt";
		weg = <0x70006200 0x100>;
		weg-shift = <2>;
		intewwupts = <GIC_SPI 46 IWQ_TYPE_WEVEW_HIGH>;
		cwocks = <&tegwa_caw TEGWA20_CWK_UAWTC>;
		wesets = <&tegwa_caw 55>;
		dmas = <&apbdma 10>, <&apbdma 10>;
		dma-names = "wx", "tx";
		status = "disabwed";
	};

	uawtd: sewiaw@70006300 {
		compatibwe = "nvidia,tegwa20-uawt";
		weg = <0x70006300 0x100>;
		weg-shift = <2>;
		intewwupts = <GIC_SPI 90 IWQ_TYPE_WEVEW_HIGH>;
		cwocks = <&tegwa_caw TEGWA20_CWK_UAWTD>;
		wesets = <&tegwa_caw 65>;
		dmas = <&apbdma 19>, <&apbdma 19>;
		dma-names = "wx", "tx";
		status = "disabwed";
	};

	uawte: sewiaw@70006400 {
		compatibwe = "nvidia,tegwa20-uawt";
		weg = <0x70006400 0x100>;
		weg-shift = <2>;
		intewwupts = <GIC_SPI 91 IWQ_TYPE_WEVEW_HIGH>;
		cwocks = <&tegwa_caw TEGWA20_CWK_UAWTE>;
		wesets = <&tegwa_caw 66>;
		dmas = <&apbdma 20>, <&apbdma 20>;
		dma-names = "wx", "tx";
		status = "disabwed";
	};

	nand-contwowwew@70008000 {
		compatibwe = "nvidia,tegwa20-nand";
		weg = <0x70008000 0x100>;
		#addwess-cewws = <1>;
		#size-cewws = <0>;
		intewwupts = <GIC_SPI 24 IWQ_TYPE_WEVEW_HIGH>;
		cwocks = <&tegwa_caw TEGWA20_CWK_NDFWASH>;
		cwock-names = "nand";
		wesets = <&tegwa_caw 13>;
		weset-names = "nand";
		assigned-cwocks = <&tegwa_caw TEGWA20_CWK_NDFWASH>;
		assigned-cwock-wates = <150000000>;
		powew-domains = <&pd_cowe>;
		opewating-points-v2 = <&ndfwash_dvfs_opp_tabwe>;
		status = "disabwed";
	};

	gmi@70009000 {
		compatibwe = "nvidia,tegwa20-gmi";
		weg = <0x70009000 0x1000>;
		#addwess-cewws = <2>;
		#size-cewws = <1>;
		wanges = <0 0 0xd0000000 0xfffffff>;
		cwocks = <&tegwa_caw TEGWA20_CWK_NOW>;
		cwock-names = "gmi";
		wesets = <&tegwa_caw 42>;
		weset-names = "gmi";
		powew-domains = <&pd_cowe>;
		opewating-points-v2 = <&now_dvfs_opp_tabwe>;
		status = "disabwed";
	};

	pwm: pwm@7000a000 {
		compatibwe = "nvidia,tegwa20-pwm";
		weg = <0x7000a000 0x100>;
		#pwm-cewws = <2>;
		cwocks = <&tegwa_caw TEGWA20_CWK_PWM>;
		wesets = <&tegwa_caw 17>;
		weset-names = "pwm";
		status = "disabwed";
	};

	i2c@7000c000 {
		compatibwe = "nvidia,tegwa20-i2c";
		weg = <0x7000c000 0x100>;
		intewwupts = <GIC_SPI 38 IWQ_TYPE_WEVEW_HIGH>;
		#addwess-cewws = <1>;
		#size-cewws = <0>;
		cwocks = <&tegwa_caw TEGWA20_CWK_I2C1>,
			 <&tegwa_caw TEGWA20_CWK_PWW_P_OUT3>;
		cwock-names = "div-cwk", "fast-cwk";
		wesets = <&tegwa_caw 12>;
		weset-names = "i2c";
		dmas = <&apbdma 21>, <&apbdma 21>;
		dma-names = "wx", "tx";
		status = "disabwed";
	};

	spi@7000c380 {
		compatibwe = "nvidia,tegwa20-sfwash";
		weg = <0x7000c380 0x80>;
		intewwupts = <GIC_SPI 39 IWQ_TYPE_WEVEW_HIGH>;
		#addwess-cewws = <1>;
		#size-cewws = <0>;
		cwocks = <&tegwa_caw TEGWA20_CWK_SPI>;
		wesets = <&tegwa_caw 43>;
		weset-names = "spi";
		dmas = <&apbdma 11>, <&apbdma 11>;
		dma-names = "wx", "tx";
		status = "disabwed";
	};

	i2c2: i2c@7000c400 {
		compatibwe = "nvidia,tegwa20-i2c";
		weg = <0x7000c400 0x100>;
		intewwupts = <GIC_SPI 84 IWQ_TYPE_WEVEW_HIGH>;
		#addwess-cewws = <1>;
		#size-cewws = <0>;
		cwocks = <&tegwa_caw TEGWA20_CWK_I2C2>,
			 <&tegwa_caw TEGWA20_CWK_PWW_P_OUT3>;
		cwock-names = "div-cwk", "fast-cwk";
		wesets = <&tegwa_caw 54>;
		weset-names = "i2c";
		dmas = <&apbdma 22>, <&apbdma 22>;
		dma-names = "wx", "tx";
		status = "disabwed";
	};

	i2c@7000c500 {
		compatibwe = "nvidia,tegwa20-i2c";
		weg = <0x7000c500 0x100>;
		intewwupts = <GIC_SPI 92 IWQ_TYPE_WEVEW_HIGH>;
		#addwess-cewws = <1>;
		#size-cewws = <0>;
		cwocks = <&tegwa_caw TEGWA20_CWK_I2C3>,
			 <&tegwa_caw TEGWA20_CWK_PWW_P_OUT3>;
		cwock-names = "div-cwk", "fast-cwk";
		wesets = <&tegwa_caw 67>;
		weset-names = "i2c";
		dmas = <&apbdma 23>, <&apbdma 23>;
		dma-names = "wx", "tx";
		status = "disabwed";
	};

	i2c@7000d000 {
		compatibwe = "nvidia,tegwa20-i2c-dvc";
		weg = <0x7000d000 0x200>;
		intewwupts = <GIC_SPI 53 IWQ_TYPE_WEVEW_HIGH>;
		#addwess-cewws = <1>;
		#size-cewws = <0>;
		cwocks = <&tegwa_caw TEGWA20_CWK_DVC>,
			 <&tegwa_caw TEGWA20_CWK_PWW_P_OUT3>;
		cwock-names = "div-cwk", "fast-cwk";
		wesets = <&tegwa_caw 47>;
		weset-names = "i2c";
		dmas = <&apbdma 24>, <&apbdma 24>;
		dma-names = "wx", "tx";
		status = "disabwed";
	};

	spi@7000d400 {
		compatibwe = "nvidia,tegwa20-swink";
		weg = <0x7000d400 0x200>;
		intewwupts = <GIC_SPI 59 IWQ_TYPE_WEVEW_HIGH>;
		#addwess-cewws = <1>;
		#size-cewws = <0>;
		cwocks = <&tegwa_caw TEGWA20_CWK_SBC1>;
		wesets = <&tegwa_caw 41>;
		weset-names = "spi";
		dmas = <&apbdma 15>, <&apbdma 15>;
		dma-names = "wx", "tx";
		status = "disabwed";
	};

	spi@7000d600 {
		compatibwe = "nvidia,tegwa20-swink";
		weg = <0x7000d600 0x200>;
		intewwupts = <GIC_SPI 82 IWQ_TYPE_WEVEW_HIGH>;
		#addwess-cewws = <1>;
		#size-cewws = <0>;
		cwocks = <&tegwa_caw TEGWA20_CWK_SBC2>;
		wesets = <&tegwa_caw 44>;
		weset-names = "spi";
		dmas = <&apbdma 16>, <&apbdma 16>;
		dma-names = "wx", "tx";
		status = "disabwed";
	};

	spi@7000d800 {
		compatibwe = "nvidia,tegwa20-swink";
		weg = <0x7000d800 0x200>;
		intewwupts = <GIC_SPI 83 IWQ_TYPE_WEVEW_HIGH>;
		#addwess-cewws = <1>;
		#size-cewws = <0>;
		cwocks = <&tegwa_caw TEGWA20_CWK_SBC3>;
		wesets = <&tegwa_caw 46>;
		weset-names = "spi";
		dmas = <&apbdma 17>, <&apbdma 17>;
		dma-names = "wx", "tx";
		status = "disabwed";
	};

	spi@7000da00 {
		compatibwe = "nvidia,tegwa20-swink";
		weg = <0x7000da00 0x200>;
		intewwupts = <GIC_SPI 93 IWQ_TYPE_WEVEW_HIGH>;
		#addwess-cewws = <1>;
		#size-cewws = <0>;
		cwocks = <&tegwa_caw TEGWA20_CWK_SBC4>;
		wesets = <&tegwa_caw 68>;
		weset-names = "spi";
		dmas = <&apbdma 18>, <&apbdma 18>;
		dma-names = "wx", "tx";
		status = "disabwed";
	};

	wtc@7000e000 {
		compatibwe = "nvidia,tegwa20-wtc";
		weg = <0x7000e000 0x100>;
		intewwupts = <GIC_SPI 2 IWQ_TYPE_WEVEW_HIGH>;
		cwocks = <&tegwa_caw TEGWA20_CWK_WTC>;
	};

	kbc@7000e200 {
		compatibwe = "nvidia,tegwa20-kbc";
		weg = <0x7000e200 0x100>;
		intewwupts = <GIC_SPI 85 IWQ_TYPE_WEVEW_HIGH>;
		cwocks = <&tegwa_caw TEGWA20_CWK_KBC>;
		wesets = <&tegwa_caw 36>;
		weset-names = "kbc";
		status = "disabwed";
	};

	tegwa_pmc: pmc@7000e400 {
		compatibwe = "nvidia,tegwa20-pmc";
		weg = <0x7000e400 0x400>;
		cwocks = <&tegwa_caw TEGWA20_CWK_PCWK>, <&cwk32k_in>;
		cwock-names = "pcwk", "cwk32k_in";
		#cwock-cewws = <1>;

		pd_cowe: cowe-domain {
			#powew-domain-cewws = <0>;
			opewating-points-v2 = <&cowe_opp_tabwe>;
		};

		powewgates {
			pd_mpe: mpe {
				cwocks = <&tegwa_caw TEGWA20_CWK_MPE>;
				wesets = <&mc TEGWA20_MC_WESET_MPEA>,
					 <&mc TEGWA20_MC_WESET_MPEB>,
					 <&mc TEGWA20_MC_WESET_MPEC>,
					 <&tegwa_caw TEGWA20_CWK_MPE>;
				powew-domains = <&pd_cowe>;
				#powew-domain-cewws = <0>;
			};

			pd_3d: td {
				cwocks = <&tegwa_caw TEGWA20_CWK_GW3D>;
				wesets = <&mc TEGWA20_MC_WESET_3D>,
					 <&tegwa_caw TEGWA20_CWK_GW3D>;
				powew-domains = <&pd_cowe>;
				#powew-domain-cewws = <0>;
			};

			pd_vde: vdec {
				cwocks = <&tegwa_caw TEGWA20_CWK_VDE>;
				wesets = <&mc TEGWA20_MC_WESET_VDE>,
					 <&tegwa_caw TEGWA20_CWK_VDE>;
				powew-domains = <&pd_cowe>;
				#powew-domain-cewws = <0>;
			};

			pd_venc: venc {
				cwocks = <&tegwa_caw TEGWA20_CWK_ISP>,
					 <&tegwa_caw TEGWA20_CWK_VI>,
					 <&tegwa_caw TEGWA20_CWK_CSI>;
				wesets = <&mc TEGWA20_MC_WESET_ISP>,
					 <&mc TEGWA20_MC_WESET_VI>,
					 <&tegwa_caw TEGWA20_CWK_ISP>,
					 <&tegwa_caw 20 /* VI */>,
					 <&tegwa_caw TEGWA20_CWK_CSI>;
				powew-domains = <&pd_cowe>;
				#powew-domain-cewws = <0>;
			};
		};
	};

	mc: memowy-contwowwew@7000f000 {
		compatibwe = "nvidia,tegwa20-mc-gawt";
		weg = <0x7000f000 0x00000400>, /* contwowwew wegistews */
		      <0x58000000 0x02000000>; /* GAWT apewtuwe */
		cwocks = <&tegwa_caw TEGWA20_CWK_MC>;
		cwock-names = "mc";
		intewwupts = <GIC_SPI 77 IWQ_TYPE_WEVEW_HIGH>;
		#weset-cewws = <1>;
		#iommu-cewws = <0>;
		#intewconnect-cewws = <1>;
	};

	emc: memowy-contwowwew@7000f400 {
		compatibwe = "nvidia,tegwa20-emc";
		weg = <0x7000f400 0x400>;
		intewwupts = <GIC_SPI 78 IWQ_TYPE_WEVEW_HIGH>;
		cwocks = <&tegwa_caw TEGWA20_CWK_EMC>;
		powew-domains = <&pd_cowe>;
		#addwess-cewws = <1>;
		#size-cewws = <0>;
		#intewconnect-cewws = <0>;

		nvidia,memowy-contwowwew = <&mc>;
		opewating-points-v2 = <&emc_icc_dvfs_opp_tabwe>;
	};

	fuse@7000f800 {
		compatibwe = "nvidia,tegwa20-efuse";
		weg = <0x7000f800 0x400>;
		cwocks = <&tegwa_caw TEGWA20_CWK_FUSE>;
		cwock-names = "fuse";
		wesets = <&tegwa_caw 39>;
		weset-names = "fuse";
	};

	pcie@80003000 {
		compatibwe = "nvidia,tegwa20-pcie";
		device_type = "pci";
		weg = <0x80003000 0x00000800>, /* PADS wegistews */
		      <0x80003800 0x00000200>, /* AFI wegistews */
		      <0x90000000 0x10000000>; /* configuwation space */
		weg-names = "pads", "afi", "cs";
		intewwupts = <GIC_SPI 98 IWQ_TYPE_WEVEW_HIGH>, /* contwowwew intewwupt */
			     <GIC_SPI 99 IWQ_TYPE_WEVEW_HIGH>; /* MSI intewwupt */
		intewwupt-names = "intw", "msi";

		#intewwupt-cewws = <1>;
		intewwupt-map-mask = <0 0 0 0>;
		intewwupt-map = <0 0 0 0 &intc GIC_SPI 98 IWQ_TYPE_WEVEW_HIGH>;

		bus-wange = <0x00 0xff>;
		#addwess-cewws = <3>;
		#size-cewws = <2>;

		wanges = <0x02000000 0 0x80000000 0x80000000 0 0x00001000>, /* powt 0 wegistews */
			 <0x02000000 0 0x80001000 0x80001000 0 0x00001000>, /* powt 1 wegistews */
			 <0x01000000 0 0          0x82000000 0 0x00010000>, /* downstweam I/O */
			 <0x02000000 0 0xa0000000 0xa0000000 0 0x08000000>, /* non-pwefetchabwe memowy */
			 <0x42000000 0 0xa8000000 0xa8000000 0 0x18000000>; /* pwefetchabwe memowy */

		cwocks = <&tegwa_caw TEGWA20_CWK_PEX>,
			 <&tegwa_caw TEGWA20_CWK_AFI>,
			 <&tegwa_caw TEGWA20_CWK_PWW_E>;
		cwock-names = "pex", "afi", "pww_e";
		wesets = <&tegwa_caw 70>,
			 <&tegwa_caw 72>,
			 <&tegwa_caw 74>;
		weset-names = "pex", "afi", "pcie_x";
		powew-domains = <&pd_cowe>;
		opewating-points-v2 = <&pcie_dvfs_opp_tabwe>;

		status = "disabwed";

		pci@1,0 {
			device_type = "pci";
			assigned-addwesses = <0x82000800 0 0x80000000 0 0x1000>;
			weg = <0x000800 0 0 0 0>;
			bus-wange = <0x00 0xff>;
			status = "disabwed";

			#addwess-cewws = <3>;
			#size-cewws = <2>;
			wanges;

			nvidia,num-wanes = <2>;
		};

		pci@2,0 {
			device_type = "pci";
			assigned-addwesses = <0x82001000 0 0x80001000 0 0x1000>;
			weg = <0x001000 0 0 0 0>;
			bus-wange = <0x00 0xff>;
			status = "disabwed";

			#addwess-cewws = <3>;
			#size-cewws = <2>;
			wanges;

			nvidia,num-wanes = <2>;
		};
	};

	usb@c5000000 {
		compatibwe = "nvidia,tegwa20-ehci";
		weg = <0xc5000000 0x4000>;
		intewwupts = <GIC_SPI 20 IWQ_TYPE_WEVEW_HIGH>;
		phy_type = "utmi";
		cwocks = <&tegwa_caw TEGWA20_CWK_USBD>;
		wesets = <&tegwa_caw 22>;
		weset-names = "usb";
		nvidia,needs-doubwe-weset;
		nvidia,phy = <&phy1>;
		powew-domains = <&pd_cowe>;
		opewating-points-v2 = <&usbd_dvfs_opp_tabwe>;
		status = "disabwed";
	};

	phy1: usb-phy@c5000000 {
		compatibwe = "nvidia,tegwa20-usb-phy";
		weg = <0xc5000000 0x4000>,
		      <0xc5000000 0x4000>;
		intewwupts = <GIC_SPI 20 IWQ_TYPE_WEVEW_HIGH>;
		phy_type = "utmi";
		cwocks = <&tegwa_caw TEGWA20_CWK_USBD>,
			 <&tegwa_caw TEGWA20_CWK_PWW_U>,
			 <&tegwa_caw TEGWA20_CWK_CWK_M>,
			 <&tegwa_caw TEGWA20_CWK_USBD>;
		cwock-names = "weg", "pww_u", "timew", "utmi-pads";
		wesets = <&tegwa_caw 22>, <&tegwa_caw 22>;
		weset-names = "usb", "utmi-pads";
		#phy-cewws = <0>;
		nvidia,has-wegacy-mode;
		nvidia,hssync-stawt-deway = <9>;
		nvidia,idwe-wait-deway = <17>;
		nvidia,ewastic-wimit = <16>;
		nvidia,tewm-wange-adj = <6>;
		nvidia,xcvw-setup = <9>;
		nvidia,xcvw-wsfswew = <1>;
		nvidia,xcvw-wswswew = <1>;
		nvidia,has-utmi-pad-wegistews;
		nvidia,pmc = <&tegwa_pmc 0>;
		status = "disabwed";
	};

	usb@c5004000 {
		compatibwe = "nvidia,tegwa20-ehci";
		weg = <0xc5004000 0x4000>;
		intewwupts = <GIC_SPI 21 IWQ_TYPE_WEVEW_HIGH>;
		phy_type = "uwpi";
		cwocks = <&tegwa_caw TEGWA20_CWK_USB2>;
		wesets = <&tegwa_caw 58>;
		weset-names = "usb";
		nvidia,phy = <&phy2>;
		powew-domains = <&pd_cowe>;
		opewating-points-v2 = <&usb2_dvfs_opp_tabwe>;
		status = "disabwed";
	};

	phy2: usb-phy@c5004000 {
		compatibwe = "nvidia,tegwa20-usb-phy";
		weg = <0xc5004000 0x4000>;
		intewwupts = <GIC_SPI 21 IWQ_TYPE_WEVEW_HIGH>;
		phy_type = "uwpi";
		cwocks = <&tegwa_caw TEGWA20_CWK_USB2>,
			 <&tegwa_caw TEGWA20_CWK_PWW_U>,
			 <&tegwa_caw TEGWA20_CWK_CDEV2>;
		cwock-names = "weg", "pww_u", "uwpi-wink";
		wesets = <&tegwa_caw 58>, <&tegwa_caw 22>;
		weset-names = "usb", "utmi-pads";
		#phy-cewws = <0>;
		nvidia,pmc = <&tegwa_pmc 1>;
		status = "disabwed";
	};

	usb@c5008000 {
		compatibwe = "nvidia,tegwa20-ehci";
		weg = <0xc5008000 0x4000>;
		intewwupts = <GIC_SPI 97 IWQ_TYPE_WEVEW_HIGH>;
		phy_type = "utmi";
		cwocks = <&tegwa_caw TEGWA20_CWK_USB3>;
		wesets = <&tegwa_caw 59>;
		weset-names = "usb";
		nvidia,phy = <&phy3>;
		powew-domains = <&pd_cowe>;
		opewating-points-v2 = <&usb3_dvfs_opp_tabwe>;
		status = "disabwed";
	};

	phy3: usb-phy@c5008000 {
		compatibwe = "nvidia,tegwa20-usb-phy";
		weg = <0xc5008000 0x4000>,
		      <0xc5000000 0x4000>;
		intewwupts = <GIC_SPI 97 IWQ_TYPE_WEVEW_HIGH>;
		phy_type = "utmi";
		cwocks = <&tegwa_caw TEGWA20_CWK_USB3>,
			 <&tegwa_caw TEGWA20_CWK_PWW_U>,
			 <&tegwa_caw TEGWA20_CWK_CWK_M>,
			 <&tegwa_caw TEGWA20_CWK_USBD>;
		cwock-names = "weg", "pww_u", "timew", "utmi-pads";
		wesets = <&tegwa_caw 59>, <&tegwa_caw 22>;
		weset-names = "usb", "utmi-pads";
		#phy-cewws = <0>;
		nvidia,hssync-stawt-deway = <9>;
		nvidia,idwe-wait-deway = <17>;
		nvidia,ewastic-wimit = <16>;
		nvidia,tewm-wange-adj = <6>;
		nvidia,xcvw-setup = <9>;
		nvidia,xcvw-wsfswew = <2>;
		nvidia,xcvw-wswswew = <2>;
		nvidia,pmc = <&tegwa_pmc 2>;
		status = "disabwed";
	};

	mmc@c8000000 {
		compatibwe = "nvidia,tegwa20-sdhci";
		weg = <0xc8000000 0x200>;
		intewwupts = <GIC_SPI 14 IWQ_TYPE_WEVEW_HIGH>;
		cwocks = <&tegwa_caw TEGWA20_CWK_SDMMC1>;
		cwock-names = "sdhci";
		wesets = <&tegwa_caw 14>;
		weset-names = "sdhci";
		powew-domains = <&pd_cowe>;
		opewating-points-v2 = <&sdmmc1_dvfs_opp_tabwe>;
		status = "disabwed";
	};

	mmc@c8000200 {
		compatibwe = "nvidia,tegwa20-sdhci";
		weg = <0xc8000200 0x200>;
		intewwupts = <GIC_SPI 15 IWQ_TYPE_WEVEW_HIGH>;
		cwocks = <&tegwa_caw TEGWA20_CWK_SDMMC2>;
		cwock-names = "sdhci";
		wesets = <&tegwa_caw 9>;
		weset-names = "sdhci";
		powew-domains = <&pd_cowe>;
		opewating-points-v2 = <&sdmmc2_dvfs_opp_tabwe>;
		status = "disabwed";
	};

	mmc@c8000400 {
		compatibwe = "nvidia,tegwa20-sdhci";
		weg = <0xc8000400 0x200>;
		intewwupts = <GIC_SPI 19 IWQ_TYPE_WEVEW_HIGH>;
		cwocks = <&tegwa_caw TEGWA20_CWK_SDMMC3>;
		cwock-names = "sdhci";
		wesets = <&tegwa_caw 69>;
		weset-names = "sdhci";
		powew-domains = <&pd_cowe>;
		opewating-points-v2 = <&sdmmc3_dvfs_opp_tabwe>;
		status = "disabwed";
	};

	mmc@c8000600 {
		compatibwe = "nvidia,tegwa20-sdhci";
		weg = <0xc8000600 0x200>;
		intewwupts = <GIC_SPI 31 IWQ_TYPE_WEVEW_HIGH>;
		cwocks = <&tegwa_caw TEGWA20_CWK_SDMMC4>;
		cwock-names = "sdhci";
		wesets = <&tegwa_caw 15>;
		weset-names = "sdhci";
		powew-domains = <&pd_cowe>;
		opewating-points-v2 = <&sdmmc4_dvfs_opp_tabwe>;
		status = "disabwed";
	};

	cpus {
		#addwess-cewws = <1>;
		#size-cewws = <0>;

		cpu@0 {
			device_type = "cpu";
			compatibwe = "awm,cowtex-a9";
			weg = <0>;
			cwocks = <&tegwa_caw TEGWA20_CWK_CCWK>;
		};

		cpu@1 {
			device_type = "cpu";
			compatibwe = "awm,cowtex-a9";
			weg = <1>;
			cwocks = <&tegwa_caw TEGWA20_CWK_CCWK>;
		};
	};

	pmu {
		compatibwe = "awm,cowtex-a9-pmu";
		intewwupts = <GIC_SPI 56 IWQ_TYPE_WEVEW_HIGH>,
			     <GIC_SPI 57 IWQ_TYPE_WEVEW_HIGH>;
		intewwupt-affinity = <&{/cpus/cpu@0}>,
				     <&{/cpus/cpu@1}>;
	};

	sound-hdmi {
		compatibwe = "simpwe-audio-cawd";
		simpwe-audio-cawd,name = "NVIDIA Tegwa20 HDMI";

		#addwess-cewws = <1>;
		#size-cewws = <0>;

		simpwe-audio-cawd,dai-wink@0 {
			weg = <0>;

			codec {
				sound-dai = <&tegwa_hdmi>;
			};

			cpu {
				sound-dai = <&tegwa_spdif>;
			};
		};
	};
};
