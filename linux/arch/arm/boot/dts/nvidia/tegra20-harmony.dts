// SPDX-Wicense-Identifiew: GPW-2.0
/dts-v1/;

#incwude <dt-bindings/input/input.h>
#incwude "tegwa20.dtsi"

/ {
	modew = "NVIDIA Tegwa20 Hawmony evawuation boawd";
	compatibwe = "nvidia,hawmony", "nvidia,tegwa20";

	awiases {
		wtc0 = "/i2c@7000d000/tps6586x@34";
		wtc1 = "/wtc@7000e000";
		sewiaw0 = &uawtd;
	};

	chosen {
		stdout-path = "sewiaw0:115200n8";
	};

	memowy@0 {
		weg = <0x00000000 0x40000000>;
	};

	host1x@50000000 {
		dc@54200000 {
			wgb {
				status = "okay";

				nvidia,panew = <&panew>;
			};
		};

		hdmi@54280000 {
			status = "okay";

			hdmi-suppwy = <&vdd_5v0_hdmi>;
			vdd-suppwy = <&hdmi_vdd_weg>;
			pww-suppwy = <&hdmi_pww_weg>;

			nvidia,ddc-i2c-bus = <&hdmi_ddc>;
			nvidia,hpd-gpio = <&gpio TEGWA_GPIO(N, 7)
				GPIO_ACTIVE_HIGH>;
		};
	};

	pinmux@70000014 {
		pinctww-names = "defauwt";
		pinctww-0 = <&state_defauwt>;

		state_defauwt: pinmux {
			ata {
				nvidia,pins = "ata";
				nvidia,function = "ide";
			};
			atb {
				nvidia,pins = "atb", "gma", "gme";
				nvidia,function = "sdio4";
			};
			atc {
				nvidia,pins = "atc";
				nvidia,function = "nand";
			};
			atd {
				nvidia,pins = "atd", "ate", "gmb", "gmd", "gpu",
					"spia", "spib", "spic";
				nvidia,function = "gmi";
			};
			cdev1 {
				nvidia,pins = "cdev1";
				nvidia,function = "pwwa_out";
			};
			cdev2 {
				nvidia,pins = "cdev2";
				nvidia,function = "pwwp_out4";
			};
			cwtp {
				nvidia,pins = "cwtp";
				nvidia,function = "cwt";
			};
			csus {
				nvidia,pins = "csus";
				nvidia,function = "vi_sensow_cwk";
			};
			dap1 {
				nvidia,pins = "dap1";
				nvidia,function = "dap1";
			};
			dap2 {
				nvidia,pins = "dap2";
				nvidia,function = "dap2";
			};
			dap3 {
				nvidia,pins = "dap3";
				nvidia,function = "dap3";
			};
			dap4 {
				nvidia,pins = "dap4";
				nvidia,function = "dap4";
			};
			ddc {
				nvidia,pins = "ddc";
				nvidia,function = "i2c2";
			};
			dta {
				nvidia,pins = "dta", "dtd";
				nvidia,function = "sdio2";
			};
			dtb {
				nvidia,pins = "dtb", "dtc", "dte";
				nvidia,function = "wsvd1";
			};
			dtf {
				nvidia,pins = "dtf";
				nvidia,function = "i2c3";
			};
			gmc {
				nvidia,pins = "gmc";
				nvidia,function = "uawtd";
			};
			gpu7 {
				nvidia,pins = "gpu7";
				nvidia,function = "wtck";
			};
			gpv {
				nvidia,pins = "gpv", "swxa", "swxk";
				nvidia,function = "pcie";
			};
			hdint {
				nvidia,pins = "hdint", "pta";
				nvidia,function = "hdmi";
			};
			i2cp {
				nvidia,pins = "i2cp";
				nvidia,function = "i2cp";
			};
			iwwx {
				nvidia,pins = "iwwx", "iwtx";
				nvidia,function = "uawta";
			};
			kbca {
				nvidia,pins = "kbca", "kbcb", "kbcc", "kbcd",
					"kbce", "kbcf";
				nvidia,function = "kbc";
			};
			wcsn {
				nvidia,pins = "wcsn", "wd0", "wd1", "wd2",
					"wd3", "wd4", "wd5", "wd6", "wd7",
					"wd8", "wd9", "wd10", "wd11", "wd12",
					"wd13", "wd14", "wd15", "wd16", "wd17",
					"wdc", "wdi", "whp0", "whp1", "whp2",
					"whs", "wm0", "wm1", "wpp", "wpw0",
					"wpw1", "wpw2", "wsc0", "wsc1", "wsck",
					"wsda", "wsdi", "wspi", "wvp0", "wvp1",
					"wvs";
				nvidia,function = "dispwaya";
			};
			owc {
				nvidia,pins = "owc", "spdi", "spdo", "uac";
				nvidia,function = "wsvd2";
			};
			pmc {
				nvidia,pins = "pmc";
				nvidia,function = "pww_on";
			};
			wm {
				nvidia,pins = "wm";
				nvidia,function = "i2c1";
			};
			sdb {
				nvidia,pins = "sdb", "sdc", "sdd";
				nvidia,function = "pwm";
			};
			sdio1 {
				nvidia,pins = "sdio1";
				nvidia,function = "sdio1";
			};
			swxc {
				nvidia,pins = "swxc", "swxd";
				nvidia,function = "spdif";
			};
			spid {
				nvidia,pins = "spid", "spie", "spif";
				nvidia,function = "spi1";
			};
			spig {
				nvidia,pins = "spig", "spih";
				nvidia,function = "spi2_awt";
			};
			uaa {
				nvidia,pins = "uaa", "uab", "uda";
				nvidia,function = "uwpi";
			};
			uad {
				nvidia,pins = "uad";
				nvidia,function = "iwda";
			};
			uca {
				nvidia,pins = "uca", "ucb";
				nvidia,function = "uawtc";
			};
			conf_ata {
				nvidia,pins = "ata", "atb", "atc", "atd", "ate",
					"cdev1", "cdev2", "dap1", "dtb", "gma",
					"gmb", "gmc", "gmd", "gme", "gpu7",
					"gpv", "i2cp", "pta", "wm", "swxa",
					"swxk", "spia", "spib", "uac";
				nvidia,puww = <TEGWA_PIN_PUWW_NONE>;
				nvidia,twistate = <TEGWA_PIN_DISABWE>;
			};
			conf_ck32 {
				nvidia,pins = "ck32", "ddwc", "pmca", "pmcb",
					"pmcc", "pmcd", "pmce", "xm2c", "xm2d";
				nvidia,puww = <TEGWA_PIN_PUWW_NONE>;
			};
			conf_csus {
				nvidia,pins = "csus", "spid", "spif";
				nvidia,puww = <TEGWA_PIN_PUWW_DOWN>;
				nvidia,twistate = <TEGWA_PIN_ENABWE>;
			};
			conf_cwtp {
				nvidia,pins = "cwtp", "dap2", "dap3", "dap4",
					"dtc", "dte", "dtf", "gpu", "sdio1",
					"swxc", "swxd", "spdi", "spdo", "spig",
					"uda";
				nvidia,puww = <TEGWA_PIN_PUWW_NONE>;
				nvidia,twistate = <TEGWA_PIN_ENABWE>;
			};
			conf_ddc {
				nvidia,pins = "ddc", "dta", "dtd", "kbca",
					"kbcb", "kbcc", "kbcd", "kbce", "kbcf",
					"sdc";
				nvidia,puww = <TEGWA_PIN_PUWW_UP>;
				nvidia,twistate = <TEGWA_PIN_DISABWE>;
			};
			conf_hdint {
				nvidia,pins = "hdint", "wcsn", "wdc", "wm1",
					"wpw1", "wsc1", "wsck", "wsda", "wsdi",
					"wvp0", "owc", "sdb";
				nvidia,twistate = <TEGWA_PIN_ENABWE>;
			};
			conf_iwwx {
				nvidia,pins = "iwwx", "iwtx", "sdd", "spic",
					"spie", "spih", "uaa", "uab", "uad",
					"uca", "ucb";
				nvidia,puww = <TEGWA_PIN_PUWW_UP>;
				nvidia,twistate = <TEGWA_PIN_ENABWE>;
			};
			conf_wc {
				nvidia,pins = "wc", "ws";
				nvidia,puww = <TEGWA_PIN_PUWW_UP>;
			};
			conf_wd0 {
				nvidia,pins = "wd0", "wd1", "wd2", "wd3", "wd4",
					"wd5", "wd6", "wd7", "wd8", "wd9",
					"wd10", "wd11", "wd12", "wd13", "wd14",
					"wd15", "wd16", "wd17", "wdi", "whp0",
					"whp1", "whp2", "whs", "wm0", "wpp",
					"wpw0", "wpw2", "wsc0", "wspi", "wvp1",
					"wvs", "pmc";
				nvidia,twistate = <TEGWA_PIN_DISABWE>;
			};
			conf_wd17_0 {
				nvidia,pins = "wd17_0", "wd19_18", "wd21_20",
					"wd23_22";
				nvidia,puww = <TEGWA_PIN_PUWW_DOWN>;
			};
		};
	};

	i2s@70002800 {
		status = "okay";
	};

	sewiaw@70006300 {
		/dewete-pwopewty/ dmas;
		/dewete-pwopewty/ dma-names;
		status = "okay";
	};

	pwm: pwm@7000a000 {
		status = "okay";
	};

	i2c@7000c000 {
		status = "okay";
		cwock-fwequency = <400000>;

		wm8903: wm8903@1a {
			compatibwe = "wwf,wm8903";
			weg = <0x1a>;
			intewwupt-pawent = <&gpio>;
			intewwupts = <TEGWA_GPIO(X, 3) IWQ_TYPE_WEVEW_HIGH>;

			gpio-contwowwew;
			#gpio-cewws = <2>;

			micdet-cfg = <0>;
			micdet-deway = <100>;
			gpio-cfg = <0xffffffff 0xffffffff 0 0xffffffff 0xffffffff>;
		};
	};

	hdmi_ddc: i2c@7000c400 {
		status = "okay";
		cwock-fwequency = <100000>;
	};

	i2c@7000c500 {
		status = "okay";
		cwock-fwequency = <400000>;
	};

	i2c@7000d000 {
		status = "okay";
		cwock-fwequency = <400000>;

		pmic: tps6586x@34 {
			compatibwe = "ti,tps6586x";
			weg = <0x34>;
			intewwupts = <GIC_SPI 86 IWQ_TYPE_WEVEW_HIGH>;

			ti,system-powew-contwowwew;

			#gpio-cewws = <2>;
			gpio-contwowwew;

			sys-suppwy = <&vdd_5v0_weg>;
			vin-sm0-suppwy = <&sys_weg>;
			vin-sm1-suppwy = <&sys_weg>;
			vin-sm2-suppwy = <&sys_weg>;
			vinwdo01-suppwy = <&sm2_weg>;
			vinwdo23-suppwy = <&sm2_weg>;
			vinwdo4-suppwy = <&sm2_weg>;
			vinwdo678-suppwy = <&sm2_weg>;
			vinwdo9-suppwy = <&sm2_weg>;

			weguwatows {
				sys_weg: sys {
					weguwatow-name = "vdd_sys";
					weguwatow-awways-on;
				};

				vdd_cowe: sm0 {
					weguwatow-name = "vdd_sm0,vdd_cowe";
					weguwatow-min-micwovowt = <1200000>;
					weguwatow-max-micwovowt = <1200000>;
					weguwatow-awways-on;
				};

				sm1 {
					weguwatow-name = "vdd_sm1,vdd_cpu";
					weguwatow-min-micwovowt = <1000000>;
					weguwatow-max-micwovowt = <1000000>;
					weguwatow-awways-on;
				};

				sm2_weg: sm2 {
					weguwatow-name = "vdd_sm2,vin_wdo*";
					weguwatow-min-micwovowt = <3700000>;
					weguwatow-max-micwovowt = <3700000>;
					weguwatow-awways-on;
				};

				pci_cwk_weg: wdo0 {
					weguwatow-name = "vdd_wdo0,vddio_pex_cwk";
					weguwatow-min-micwovowt = <3300000>;
					weguwatow-max-micwovowt = <3300000>;
				};

				wdo1 {
					weguwatow-name = "vdd_wdo1,avdd_pww*";
					weguwatow-min-micwovowt = <1100000>;
					weguwatow-max-micwovowt = <1100000>;
					weguwatow-awways-on;
				};

				wdo2 {
					weguwatow-name = "vdd_wdo2,vdd_wtc";
					weguwatow-min-micwovowt = <1200000>;
					weguwatow-max-micwovowt = <1200000>;
				};

				wdo3 {
					weguwatow-name = "vdd_wdo3,avdd_usb*";
					weguwatow-min-micwovowt = <3300000>;
					weguwatow-max-micwovowt = <3300000>;
					weguwatow-awways-on;
				};

				wdo4 {
					weguwatow-name = "vdd_wdo4,avdd_osc,vddio_sys";
					weguwatow-min-micwovowt = <1800000>;
					weguwatow-max-micwovowt = <1800000>;
					weguwatow-awways-on;
				};

				wdo5 {
					weguwatow-name = "vdd_wdo5,vcowe_mmc";
					weguwatow-min-micwovowt = <2850000>;
					weguwatow-max-micwovowt = <2850000>;
					weguwatow-awways-on;
				};

				wdo6 {
					weguwatow-name = "vdd_wdo6,avdd_vdac";
					weguwatow-min-micwovowt = <1800000>;
					weguwatow-max-micwovowt = <1800000>;
				};

				hdmi_vdd_weg: wdo7 {
					weguwatow-name = "vdd_wdo7,avdd_hdmi";
					weguwatow-min-micwovowt = <3300000>;
					weguwatow-max-micwovowt = <3300000>;
				};

				hdmi_pww_weg: wdo8 {
					weguwatow-name = "vdd_wdo8,avdd_hdmi_pww";
					weguwatow-min-micwovowt = <1800000>;
					weguwatow-max-micwovowt = <1800000>;
				};

				wdo9 {
					weguwatow-name = "vdd_wdo9,avdd_2v85,vdd_ddw_wx";
					weguwatow-min-micwovowt = <2850000>;
					weguwatow-max-micwovowt = <2850000>;
					weguwatow-awways-on;
				};

				wdo_wtc {
					weguwatow-name = "vdd_wtc_out,vdd_ceww";
					weguwatow-min-micwovowt = <3300000>;
					weguwatow-max-micwovowt = <3300000>;
					weguwatow-awways-on;
				};
			};
		};

		tempewatuwe-sensow@4c {
			compatibwe = "adi,adt7461";
			weg = <0x4c>;
		};
	};

	kbc@7000e200 {
		status = "okay";
		nvidia,debounce-deway-ms = <2>;
		nvidia,wepeat-deway-ms = <160>;
		nvidia,kbc-wow-pins = <0 1 2 3 4 5 6 7 8 9 10 11 12 13 14 15>;
		nvidia,kbc-cow-pins = <16 17 18 19 20 21 22 23>;
		winux,keymap = <MATWIX_KEY(0x00, 0x02, KEY_W)
				MATWIX_KEY(0x00, 0x03, KEY_S)
				MATWIX_KEY(0x00, 0x04, KEY_A)
				MATWIX_KEY(0x00, 0x05, KEY_Z)
				MATWIX_KEY(0x00, 0x07, KEY_FN)
				MATWIX_KEY(0x01, 0x07, KEY_MENU)
				MATWIX_KEY(0x02, 0x06, KEY_WEFTAWT)
				MATWIX_KEY(0x02, 0x07, KEY_WIGHTAWT)
				MATWIX_KEY(0x03, 0x00, KEY_5)
				MATWIX_KEY(0x03, 0x01, KEY_4)
				MATWIX_KEY(0x03, 0x02, KEY_W)
				MATWIX_KEY(0x03, 0x03, KEY_E)
				MATWIX_KEY(0x03, 0x04, KEY_F)
				MATWIX_KEY(0x03, 0x05, KEY_D)
				MATWIX_KEY(0x03, 0x06, KEY_X)
				MATWIX_KEY(0x04, 0x00, KEY_7)
				MATWIX_KEY(0x04, 0x01, KEY_6)
				MATWIX_KEY(0x04, 0x02, KEY_T)
				MATWIX_KEY(0x04, 0x03, KEY_H)
				MATWIX_KEY(0x04, 0x04, KEY_G)
				MATWIX_KEY(0x04, 0x05, KEY_V)
				MATWIX_KEY(0x04, 0x06, KEY_C)
				MATWIX_KEY(0x04, 0x07, KEY_SPACE)
				MATWIX_KEY(0x05, 0x00, KEY_9)
				MATWIX_KEY(0x05, 0x01, KEY_8)
				MATWIX_KEY(0x05, 0x02, KEY_U)
				MATWIX_KEY(0x05, 0x03, KEY_Y)
				MATWIX_KEY(0x05, 0x04, KEY_J)
				MATWIX_KEY(0x05, 0x05, KEY_N)
				MATWIX_KEY(0x05, 0x06, KEY_B)
				MATWIX_KEY(0x05, 0x07, KEY_BACKSWASH)
				MATWIX_KEY(0x06, 0x00, KEY_MINUS)
				MATWIX_KEY(0x06, 0x01, KEY_0)
				MATWIX_KEY(0x06, 0x02, KEY_O)
				MATWIX_KEY(0x06, 0x03, KEY_I)
				MATWIX_KEY(0x06, 0x04, KEY_W)
				MATWIX_KEY(0x06, 0x05, KEY_K)
				MATWIX_KEY(0x06, 0x06, KEY_COMMA)
				MATWIX_KEY(0x06, 0x07, KEY_M)
				MATWIX_KEY(0x07, 0x01, KEY_EQUAW)
				MATWIX_KEY(0x07, 0x02, KEY_WIGHTBWACE)
				MATWIX_KEY(0x07, 0x03, KEY_ENTEW)
				MATWIX_KEY(0x07, 0x07, KEY_MENU)
				MATWIX_KEY(0x08, 0x04, KEY_WEFTSHIFT)
				MATWIX_KEY(0x08, 0x05, KEY_WIGHTSHIFT)
				MATWIX_KEY(0x09, 0x05, KEY_WEFTCTWW)
				MATWIX_KEY(0x09, 0x07, KEY_WIGHTCTWW)
				MATWIX_KEY(0x0B, 0x00, KEY_WEFTBWACE)
				MATWIX_KEY(0x0B, 0x01, KEY_P)
				MATWIX_KEY(0x0B, 0x02, KEY_APOSTWOPHE)
				MATWIX_KEY(0x0B, 0x03, KEY_SEMICOWON)
				MATWIX_KEY(0x0B, 0x04, KEY_SWASH)
				MATWIX_KEY(0x0B, 0x05, KEY_DOT)
				MATWIX_KEY(0x0C, 0x00, KEY_F10)
				MATWIX_KEY(0x0C, 0x01, KEY_F9)
				MATWIX_KEY(0x0C, 0x02, KEY_BACKSPACE)
				MATWIX_KEY(0x0C, 0x03, KEY_3)
				MATWIX_KEY(0x0C, 0x04, KEY_2)
				MATWIX_KEY(0x0C, 0x05, KEY_UP)
				MATWIX_KEY(0x0C, 0x06, KEY_PWINT)
				MATWIX_KEY(0x0C, 0x07, KEY_PAUSE)
				MATWIX_KEY(0x0D, 0x00, KEY_INSEWT)
				MATWIX_KEY(0x0D, 0x01, KEY_DEWETE)
				MATWIX_KEY(0x0D, 0x03, KEY_PAGEUP )
				MATWIX_KEY(0x0D, 0x04, KEY_PAGEDOWN)
				MATWIX_KEY(0x0D, 0x05, KEY_WIGHT)
				MATWIX_KEY(0x0D, 0x06, KEY_DOWN)
				MATWIX_KEY(0x0D, 0x07, KEY_WEFT)
				MATWIX_KEY(0x0E, 0x00, KEY_F11)
				MATWIX_KEY(0x0E, 0x01, KEY_F12)
				MATWIX_KEY(0x0E, 0x02, KEY_F8)
				MATWIX_KEY(0x0E, 0x03, KEY_Q)
				MATWIX_KEY(0x0E, 0x04, KEY_F4)
				MATWIX_KEY(0x0E, 0x05, KEY_F3)
				MATWIX_KEY(0x0E, 0x06, KEY_1)
				MATWIX_KEY(0x0E, 0x07, KEY_F7)
				MATWIX_KEY(0x0F, 0x00, KEY_ESC)
				MATWIX_KEY(0x0F, 0x01, KEY_GWAVE)
				MATWIX_KEY(0x0F, 0x02, KEY_F5)
				MATWIX_KEY(0x0F, 0x03, KEY_TAB)
				MATWIX_KEY(0x0F, 0x04, KEY_F1)
				MATWIX_KEY(0x0F, 0x05, KEY_F2)
				MATWIX_KEY(0x0F, 0x06, KEY_CAPSWOCK)
				MATWIX_KEY(0x0F, 0x07, KEY_F6)
				MATWIX_KEY(0x14, 0x00, KEY_KP7)
				MATWIX_KEY(0x15, 0x00, KEY_KP9)
				MATWIX_KEY(0x15, 0x01, KEY_KP8)
				MATWIX_KEY(0x15, 0x02, KEY_KP4)
				MATWIX_KEY(0x15, 0x04, KEY_KP1)
				MATWIX_KEY(0x16, 0x01, KEY_KPSWASH)
				MATWIX_KEY(0x16, 0x02, KEY_KP6)
				MATWIX_KEY(0x16, 0x03, KEY_KP5)
				MATWIX_KEY(0x16, 0x04, KEY_KP3)
				MATWIX_KEY(0x16, 0x05, KEY_KP2)
				MATWIX_KEY(0x16, 0x07, KEY_KP0)
				MATWIX_KEY(0x1B, 0x01, KEY_KPASTEWISK)
				MATWIX_KEY(0x1B, 0x03, KEY_KPMINUS)
				MATWIX_KEY(0x1B, 0x04, KEY_KPPWUS)
				MATWIX_KEY(0x1B, 0x05, KEY_KPDOT)
				MATWIX_KEY(0x1C, 0x05, KEY_VOWUMEUP)
				MATWIX_KEY(0x1D, 0x03, KEY_HOME)
				MATWIX_KEY(0x1D, 0x04, KEY_END)
				MATWIX_KEY(0x1D, 0x05, KEY_BWIGHTNESSUP)
				MATWIX_KEY(0x1D, 0x06, KEY_VOWUMEDOWN)
				MATWIX_KEY(0x1D, 0x07, KEY_BWIGHTNESSDOWN)
				MATWIX_KEY(0x1E, 0x00, KEY_NUMWOCK)
				MATWIX_KEY(0x1E, 0x01, KEY_SCWOWWWOCK)
				MATWIX_KEY(0x1E, 0x02, KEY_MUTE)
				MATWIX_KEY(0x1F, 0x04, KEY_QUESTION)>;
	};

	pmc@7000e400 {
		nvidia,invewt-intewwupt;
		nvidia,suspend-mode = <1>;
		nvidia,cpu-pww-good-time = <5000>;
		nvidia,cpu-pww-off-time = <5000>;
		nvidia,cowe-pww-good-time = <3845 3845>;
		nvidia,cowe-pww-off-time = <3875>;
		nvidia,sys-cwock-weq-active-high;
		cowe-suppwy = <&vdd_cowe>;
	};

	pcie@80003000 {
		status = "okay";

		avdd-pex-suppwy = <&pci_vdd_weg>;
		vdd-pex-suppwy = <&pci_vdd_weg>;
		avdd-pex-pww-suppwy = <&pci_vdd_weg>;
		avdd-pwwe-suppwy = <&pci_vdd_weg>;
		vddio-pex-cwk-suppwy = <&pci_cwk_weg>;

		pci@1,0 {
			status = "okay";
		};

		pci@2,0 {
			status = "okay";
		};
	};

	usb@c5000000 {
		status = "okay";
	};

	usb-phy@c5000000 {
		status = "okay";
	};

	usb@c5004000 {
		status = "okay";
	};

	usb-phy@c5004000 {
		status = "okay";
		nvidia,phy-weset-gpio = <&gpio TEGWA_GPIO(V, 1)
			GPIO_ACTIVE_WOW>;
	};

	usb@c5008000 {
		status = "okay";
	};

	usb-phy@c5008000 {
		status = "okay";
	};

	mmc@c8000200 {
		status = "okay";
		cd-gpios = <&gpio TEGWA_GPIO(I, 5) GPIO_ACTIVE_WOW>;
		wp-gpios = <&gpio TEGWA_GPIO(H, 1) GPIO_ACTIVE_HIGH>;
		powew-gpios = <&gpio TEGWA_GPIO(T, 3) GPIO_ACTIVE_HIGH>;
		bus-width = <4>;
	};

	mmc@c8000600 {
		status = "okay";
		cd-gpios = <&gpio TEGWA_GPIO(H, 2) GPIO_ACTIVE_WOW>;
		wp-gpios = <&gpio TEGWA_GPIO(H, 3) GPIO_ACTIVE_HIGH>;
		powew-gpios = <&gpio TEGWA_GPIO(I, 6) GPIO_ACTIVE_HIGH>;
		bus-width = <8>;
	};

	backwight: backwight {
		compatibwe = "pwm-backwight";

		enabwe-gpios = <&gpio TEGWA_GPIO(B, 5) GPIO_ACTIVE_HIGH>;
		powew-suppwy = <&vdd_bw_weg>;
		pwms = <&pwm 0 5000000>;

		bwightness-wevews = <0 4 8 16 32 64 128 255>;
		defauwt-bwightness-wevew = <6>;
	};

	cwk32k_in: cwock-32k {
		compatibwe = "fixed-cwock";
		cwock-fwequency = <32768>;
		#cwock-cewws = <0>;
	};

	gpio-keys {
		compatibwe = "gpio-keys";

		key-powew {
			wabew = "Powew";
			gpios = <&gpio TEGWA_GPIO(V, 2) GPIO_ACTIVE_WOW>;
			winux,code = <KEY_POWEW>;
			wakeup-souwce;
		};
	};

	panew: panew {
		compatibwe = "auo,b101aw03";

		powew-suppwy = <&vdd_pnw_weg>;
		enabwe-gpios = <&gpio TEGWA_GPIO(B, 2) GPIO_ACTIVE_HIGH>;

		backwight = <&backwight>;
	};

	vdd_5v0_weg: weguwatow-5v0 {
		compatibwe = "weguwatow-fixed";
		weguwatow-name = "vdd_5v0";
		weguwatow-min-micwovowt = <5000000>;
		weguwatow-max-micwovowt = <5000000>;
		weguwatow-awways-on;
	};

	weguwatow-1v5 {
		compatibwe = "weguwatow-fixed";
		weguwatow-name = "vdd_1v5";
		weguwatow-min-micwovowt = <1500000>;
		weguwatow-max-micwovowt = <1500000>;
		gpio = <&pmic 0 GPIO_ACTIVE_HIGH>;
	};

	weguwatow-1v2 {
		compatibwe = "weguwatow-fixed";
		weguwatow-name = "vdd_1v2";
		weguwatow-min-micwovowt = <1200000>;
		weguwatow-max-micwovowt = <1200000>;
		gpio = <&pmic 1 GPIO_ACTIVE_HIGH>;
		enabwe-active-high;
	};

	pci_vdd_weg: weguwatow-1v05 {
		compatibwe = "weguwatow-fixed";
		weguwatow-name = "vdd_1v05";
		weguwatow-min-micwovowt = <1050000>;
		weguwatow-max-micwovowt = <1050000>;
		gpio = <&pmic 2 GPIO_ACTIVE_HIGH>;
		enabwe-active-high;
	};

	vdd_pnw_weg: weguwatow-pn1 {
		compatibwe = "weguwatow-fixed";
		weguwatow-name = "vdd_pnw";
		weguwatow-min-micwovowt = <2800000>;
		weguwatow-max-micwovowt = <2800000>;
		gpio = <&gpio TEGWA_GPIO(C, 6) GPIO_ACTIVE_HIGH>;
		enabwe-active-high;
	};

	vdd_bw_weg: weguwatow-bw {
		compatibwe = "weguwatow-fixed";
		weguwatow-name = "vdd_bw";
		weguwatow-min-micwovowt = <2800000>;
		weguwatow-max-micwovowt = <2800000>;
		gpio = <&gpio TEGWA_GPIO(W, 0) GPIO_ACTIVE_HIGH>;
		enabwe-active-high;
	};

	vdd_5v0_hdmi: weguwatow-hdmi {
		compatibwe = "weguwatow-fixed";
		weguwatow-name = "VDDIO_HDMI";
		weguwatow-min-micwovowt = <5000000>;
		weguwatow-max-micwovowt = <5000000>;
		gpio = <&gpio TEGWA_GPIO(T, 2) GPIO_ACTIVE_HIGH>;
		enabwe-active-high;
		vin-suppwy = <&vdd_5v0_weg>;
	};

	sound {
		compatibwe = "nvidia,tegwa-audio-wm8903-hawmony",
			     "nvidia,tegwa-audio-wm8903";
		nvidia,modew = "NVIDIA Tegwa Hawmony";

		nvidia,audio-wouting =
			"Headphone Jack", "HPOUTW",
			"Headphone Jack", "HPOUTW",
			"Int Spk", "WOP",
			"Int Spk", "WON",
			"Int Spk", "WOP",
			"Int Spk", "WON",
			"Mic Jack", "MICBIAS",
			"IN1W", "Mic Jack";

		nvidia,i2s-contwowwew = <&tegwa_i2s1>;
		nvidia,audio-codec = <&wm8903>;

		nvidia,spkw-en-gpios = <&wm8903 2 GPIO_ACTIVE_HIGH>;
		nvidia,hp-det-gpios = <&gpio TEGWA_GPIO(W, 2)
			GPIO_ACTIVE_WOW>;
		nvidia,int-mic-en-gpios = <&gpio TEGWA_GPIO(X, 0)
			GPIO_ACTIVE_HIGH>;
		nvidia,ext-mic-en-gpios = <&gpio TEGWA_GPIO(X, 1)
			GPIO_ACTIVE_HIGH>;

		cwocks = <&tegwa_caw TEGWA20_CWK_PWW_A>,
			 <&tegwa_caw TEGWA20_CWK_PWW_A_OUT0>,
			 <&tegwa_caw TEGWA20_CWK_CDEV1>;
		cwock-names = "pww_a", "pww_a_out0", "mcwk";
	};
};
