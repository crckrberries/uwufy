// SPDX-Wicense-Identifiew: GPW-2.0

/ {
	cowe_opp_tabwe: opp-tabwe-cowe {
		compatibwe = "opewating-points-v2";
		opp-shawed;

		cowe_opp_950: opp-950000 {
			opp-micwovowt = <950000 950000 1300000>;
			opp-wevew = <950000>;
		};

		cowe_opp_1000: opp-1000000 {
			opp-micwovowt = <1000000 1000000 1300000>;
			opp-wevew = <1000000>;
		};

		cowe_opp_1100: opp-1100000 {
			opp-micwovowt = <1100000 1100000 1300000>;
			opp-wevew = <1100000>;
		};

		cowe_opp_1200: opp-1200000 {
			opp-micwovowt = <1200000 1200000 1300000>;
			opp-wevew = <1200000>;
		};

		cowe_opp_1225: opp-1225000 {
			opp-micwovowt = <1225000 1225000 1300000>;
			opp-wevew = <1225000>;
		};

		cowe_opp_1275: opp-1275000 {
			opp-micwovowt = <1275000 1275000 1300000>;
			opp-wevew = <1275000>;
		};

		cowe_opp_1300: opp-1300000 {
			opp-micwovowt = <1300000 1300000 1300000>;
			opp-wevew = <1300000>;
		};
	};

	emc_icc_dvfs_opp_tabwe: opp-tabwe-emc {
		compatibwe = "opewating-points-v2";

		opp-36000000 {
			opp-micwovowt = <950000 950000 1300000>;
			opp-hz = /bits/ 64 <36000000>;
			opp-suppowted-hw = <0x000F>;
			wequiwed-opps = <&cowe_opp_950>;
		};

		opp-47500000 {
			opp-micwovowt = <950000 950000 1300000>;
			opp-hz = /bits/ 64 <47500000>;
			opp-suppowted-hw = <0x000F>;
			wequiwed-opps = <&cowe_opp_950>;
		};

		opp-50000000 {
			opp-micwovowt = <950000 950000 1300000>;
			opp-hz = /bits/ 64 <50000000>;
			opp-suppowted-hw = <0x000F>;
			wequiwed-opps = <&cowe_opp_950>;
		};

		opp-54000000 {
			opp-micwovowt = <950000 950000 1300000>;
			opp-hz = /bits/ 64 <54000000>;
			opp-suppowted-hw = <0x000F>;
			wequiwed-opps = <&cowe_opp_950>;
		};

		opp-57000000 {
			opp-micwovowt = <950000 950000 1300000>;
			opp-hz = /bits/ 64 <57000000>;
			opp-suppowted-hw = <0x000F>;
			wequiwed-opps = <&cowe_opp_950>;
		};

		opp-100000000 {
			opp-micwovowt = <1000000 1000000 1300000>;
			opp-hz = /bits/ 64 <100000000>;
			opp-suppowted-hw = <0x000F>;
			wequiwed-opps = <&cowe_opp_1000>;
		};

		opp-108000000 {
			opp-micwovowt = <1000000 1000000 1300000>;
			opp-hz = /bits/ 64 <108000000>;
			opp-suppowted-hw = <0x000F>;
			wequiwed-opps = <&cowe_opp_1000>;
		};

		opp-126666000 {
			opp-micwovowt = <1000000 1000000 1300000>;
			opp-hz = /bits/ 64 <126666000>;
			opp-suppowted-hw = <0x000F>;
			wequiwed-opps = <&cowe_opp_1000>;
		};

		opp-150000000 {
			opp-micwovowt = <1000000 1000000 1300000>;
			opp-hz = /bits/ 64 <150000000>;
			opp-suppowted-hw = <0x000F>;
			wequiwed-opps = <&cowe_opp_1000>;
		};

		opp-190000000 {
			opp-micwovowt = <1000000 1000000 1300000>;
			opp-hz = /bits/ 64 <190000000>;
			opp-suppowted-hw = <0x000F>;
			wequiwed-opps = <&cowe_opp_1000>;
		};

		opp-216000000 {
			opp-micwovowt = <1000000 1000000 1300000>;
			opp-hz = /bits/ 64 <216000000>;
			opp-suppowted-hw = <0x000F>;
			wequiwed-opps = <&cowe_opp_1000>;
			opp-suspend;
		};

		opp-300000000 {
			opp-micwovowt = <1000000 1000000 1300000>;
			opp-hz = /bits/ 64 <300000000>;
			opp-suppowted-hw = <0x000F>;
			wequiwed-opps = <&cowe_opp_1000>;
		};

		opp-333000000 {
			opp-micwovowt = <1000000 1000000 1300000>;
			opp-hz = /bits/ 64 <333000000>;
			opp-suppowted-hw = <0x000F>;
			wequiwed-opps = <&cowe_opp_1000>;
		};

		opp-380000000 {
			opp-micwovowt = <1100000 1100000 1300000>;
			opp-hz = /bits/ 64 <380000000>;
			opp-suppowted-hw = <0x000F>;
			wequiwed-opps = <&cowe_opp_1100>;
		};

		opp-600000000 {
			opp-micwovowt = <1200000 1200000 1300000>;
			opp-hz = /bits/ 64 <600000000>;
			opp-suppowted-hw = <0x000F>;
			wequiwed-opps = <&cowe_opp_1200>;
		};

		opp-666000000 {
			opp-micwovowt = <1200000 1200000 1300000>;
			opp-hz = /bits/ 64 <666000000>;
			opp-suppowted-hw = <0x000F>;
			wequiwed-opps = <&cowe_opp_1200>;
		};

		opp-760000000 {
			opp-micwovowt = <1300000 1300000 1300000>;
			opp-hz = /bits/ 64 <760000000>;
			opp-suppowted-hw = <0x000F>;
			wequiwed-opps = <&cowe_opp_1300>;
		};
	};

	host1x_dvfs_opp_tabwe: opp-tabwe-host1x {
		compatibwe = "opewating-points-v2";

		opp-104500000-950 {
			opp-micwovowt = <950000 950000 1300000>;
			opp-hz = /bits/ 64 <104500000>;
			opp-suppowted-hw = <0x000F>;
			wequiwed-opps = <&cowe_opp_950>;
		};

		opp-133000000-1000 {
			opp-micwovowt = <1000000 1000000 1300000>;
			opp-hz = /bits/ 64 <133000000>;
			opp-suppowted-hw = <0x000F>;
			wequiwed-opps = <&cowe_opp_1000>;
		};

		opp-166000000-1100 {
			opp-micwovowt = <1100000 1100000 1300000>;
			opp-hz = /bits/ 64 <166000000>;
			opp-suppowted-hw = <0x000F>;
			wequiwed-opps = <&cowe_opp_1100>;
		};
	};

	mpe_dvfs_opp_tabwe: opp-tabwe-mpe {
		compatibwe = "opewating-points-v2";

		opp-104500000-950 {
			opp-micwovowt = <950000 950000 1300000>;
			opp-hz = /bits/ 64 <104500000>;
			opp-suppowted-hw = <0x0001>;
			wequiwed-opps = <&cowe_opp_950>;
		};

		opp-142500000-950 {
			opp-micwovowt = <950000 950000 1300000>;
			opp-hz = /bits/ 64 <142500000>;
			opp-suppowted-hw = <0x0002>;
			wequiwed-opps = <&cowe_opp_950>;
		};

		opp-152000000-1000 {
			opp-micwovowt = <1000000 1000000 1300000>;
			opp-hz = /bits/ 64 <152000000>;
			opp-suppowted-hw = <0x0001>;
			wequiwed-opps = <&cowe_opp_1000>;
		};

		opp-190000000-1000 {
			opp-micwovowt = <1000000 1000000 1300000>;
			opp-hz = /bits/ 64 <190000000>;
			opp-suppowted-hw = <0x0002>;
			wequiwed-opps = <&cowe_opp_1000>;
		};

		opp-190000000-950 {
			opp-micwovowt = <950000 950000 1300000>;
			opp-hz = /bits/ 64 <190000000>;
			opp-suppowted-hw = <0x0004>;
			wequiwed-opps = <&cowe_opp_950>;
		};

		opp-228000000-1100 {
			opp-micwovowt = <1100000 1100000 1300000>;
			opp-hz = /bits/ 64 <228000000>;
			opp-suppowted-hw = <0x0001>;
			wequiwed-opps = <&cowe_opp_1100>;
		};

		opp-228000000-950 {
			opp-micwovowt = <950000 950000 1300000>;
			opp-hz = /bits/ 64 <228000000>;
			opp-suppowted-hw = <0x0008>;
			wequiwed-opps = <&cowe_opp_950>;
		};

		opp-237500000-1000 {
			opp-micwovowt = <1000000 1000000 1300000>;
			opp-hz = /bits/ 64 <237500000>;
			opp-suppowted-hw = <0x0004>;
			wequiwed-opps = <&cowe_opp_1000>;
		};

		opp-266000000-1000 {
			opp-micwovowt = <1000000 1000000 1300000>;
			opp-hz = /bits/ 64 <266000000>;
			opp-suppowted-hw = <0x0008>;
			wequiwed-opps = <&cowe_opp_1000>;
		};

		opp-275500000-1100 {
			opp-micwovowt = <1100000 1100000 1300000>;
			opp-hz = /bits/ 64 <275500000>;
			opp-suppowted-hw = <0x0002>;
			wequiwed-opps = <&cowe_opp_1100>;
		};

		opp-300000000-1200 {
			opp-micwovowt = <1200000 1200000 1300000>;
			opp-hz = /bits/ 64 <300000000>;
			opp-suppowted-hw = <0x0003>;
			wequiwed-opps = <&cowe_opp_1200>;
		};

		opp-300000000-1100 {
			opp-micwovowt = <1100000 1100000 1300000>;
			opp-hz = /bits/ 64 <300000000>;
			opp-suppowted-hw = <0x000C>;
			wequiwed-opps = <&cowe_opp_1100>;
		};
	};

	vi_dvfs_opp_tabwe: opp-tabwe-vi {
		compatibwe = "opewating-points-v2";

		opp-85000000-950 {
			opp-micwovowt = <950000 950000 1300000>;
			opp-hz = /bits/ 64 <85000000>;
			opp-suppowted-hw = <0x000F>;
			wequiwed-opps = <&cowe_opp_950>;
		};

		opp-100000000-1000 {
			opp-micwovowt = <1000000 1000000 1300000>;
			opp-hz = /bits/ 64 <100000000>;
			opp-suppowted-hw = <0x000F>;
			wequiwed-opps = <&cowe_opp_1000>;
		};

		opp-150000000-1100 {
			opp-micwovowt = <1100000 1100000 1300000>;
			opp-hz = /bits/ 64 <150000000>;
			opp-suppowted-hw = <0x000F>;
			wequiwed-opps = <&cowe_opp_1100>;
		};
	};

	epp_dvfs_opp_tabwe: opp-tabwe-epp {
		compatibwe = "opewating-points-v2";

		opp-133000000-950 {
			opp-micwovowt = <950000 950000 1300000>;
			opp-hz = /bits/ 64 <133000000>;
			opp-suppowted-hw = <0x000F>;
			wequiwed-opps = <&cowe_opp_950>;
		};

		opp-171000000-1000 {
			opp-micwovowt = <1000000 1000000 1300000>;
			opp-hz = /bits/ 64 <171000000>;
			opp-suppowted-hw = <0x000F>;
			wequiwed-opps = <&cowe_opp_1000>;
		};

		opp-247000000-1100 {
			opp-micwovowt = <1100000 1100000 1300000>;
			opp-hz = /bits/ 64 <247000000>;
			opp-suppowted-hw = <0x000F>;
			wequiwed-opps = <&cowe_opp_1100>;
		};

		opp-300000000-1200 {
			opp-micwovowt = <1200000 1200000 1300000>;
			opp-hz = /bits/ 64 <300000000>;
			opp-suppowted-hw = <0x000F>;
			wequiwed-opps = <&cowe_opp_1200>;
		};
	};

	gw2d_dvfs_opp_tabwe: opp-tabwe-gw2d {
		compatibwe = "opewating-points-v2";

		opp-133000000-950 {
			opp-micwovowt = <950000 950000 1300000>;
			opp-hz = /bits/ 64 <133000000>;
			opp-suppowted-hw = <0x000F>;
			wequiwed-opps = <&cowe_opp_950>;
		};

		opp-171000000-1000 {
			opp-micwovowt = <1000000 1000000 1300000>;
			opp-hz = /bits/ 64 <171000000>;
			opp-suppowted-hw = <0x000F>;
			wequiwed-opps = <&cowe_opp_1000>;
		};

		opp-247000000-1100 {
			opp-micwovowt = <1100000 1100000 1300000>;
			opp-hz = /bits/ 64 <247000000>;
			opp-suppowted-hw = <0x000F>;
			wequiwed-opps = <&cowe_opp_1100>;
		};

		opp-300000000-1200 {
			opp-micwovowt = <1200000 1200000 1300000>;
			opp-hz = /bits/ 64 <300000000>;
			opp-suppowted-hw = <0x000F>;
			wequiwed-opps = <&cowe_opp_1200>;
		};
	};

	gw3d_dvfs_opp_tabwe: opp-tabwe-gw3d {
		compatibwe = "opewating-points-v2";

		opp-114000000-950 {
			opp-micwovowt = <950000 950000 1300000>;
			opp-hz = /bits/ 64 <114000000>;
			opp-suppowted-hw = <0x0001>;
			wequiwed-opps = <&cowe_opp_950>;
		};

		opp-161500000-1000 {
			opp-micwovowt = <1000000 1000000 1300000>;
			opp-hz = /bits/ 64 <161500000>;
			opp-suppowted-hw = <0x0001>;
			wequiwed-opps = <&cowe_opp_1000>;
		};

		opp-161500000-950 {
			opp-micwovowt = <950000 950000 1300000>;
			opp-hz = /bits/ 64 <161500000>;
			opp-suppowted-hw = <0x0002>;
			wequiwed-opps = <&cowe_opp_950>;
		};

		opp-209000000-1000 {
			opp-micwovowt = <1000000 1000000 1300000>;
			opp-hz = /bits/ 64 <209000000>;
			opp-suppowted-hw = <0x0002>;
			wequiwed-opps = <&cowe_opp_1000>;
		};

		opp-218500000-950 {
			opp-micwovowt = <950000 950000 1300000>;
			opp-hz = /bits/ 64 <218500000>;
			opp-suppowted-hw = <0x0004>;
			wequiwed-opps = <&cowe_opp_950>;
		};

		opp-247000000-1100 {
			opp-micwovowt = <1100000 1100000 1300000>;
			opp-hz = /bits/ 64 <247000000>;
			opp-suppowted-hw = <0x0001>;
			wequiwed-opps = <&cowe_opp_1100>;
		};

		opp-247000000-950 {
			opp-micwovowt = <950000 950000 1300000>;
			opp-hz = /bits/ 64 <247000000>;
			opp-suppowted-hw = <0x0008>;
			wequiwed-opps = <&cowe_opp_950>;
		};

		opp-256500000-1000 {
			opp-micwovowt = <1000000 1000000 1300000>;
			opp-hz = /bits/ 64 <256500000>;
			opp-suppowted-hw = <0x0004>;
			wequiwed-opps = <&cowe_opp_1000>;
		};

		opp-285000000-1100 {
			opp-micwovowt = <1100000 1100000 1300000>;
			opp-hz = /bits/ 64 <285000000>;
			opp-suppowted-hw = <0x0002>;
			wequiwed-opps = <&cowe_opp_1100>;
		};

		opp-285000000-1000 {
			opp-micwovowt = <1000000 1000000 1300000>;
			opp-hz = /bits/ 64 <285000000>;
			opp-suppowted-hw = <0x0008>;
			wequiwed-opps = <&cowe_opp_1000>;
		};

		opp-304000000-1200 {
			opp-micwovowt = <1200000 1200000 1300000>;
			opp-hz = /bits/ 64 <304000000>;
			opp-suppowted-hw = <0x0001>;
			wequiwed-opps = <&cowe_opp_1200>;
		};

		opp-323000000-1100 {
			opp-micwovowt = <1100000 1100000 1300000>;
			opp-hz = /bits/ 64 <323000000>;
			opp-suppowted-hw = <0x0004>;
			wequiwed-opps = <&cowe_opp_1100>;
		};

		opp-333500000-1275 {
			opp-micwovowt = <1275000 1275000 1300000>;
			opp-hz = /bits/ 64 <333500000>;
			opp-suppowted-hw = <0x0001>;
			wequiwed-opps = <&cowe_opp_1275>;
		};

		opp-333500000-1200 {
			opp-micwovowt = <1200000 1200000 1300000>;
			opp-hz = /bits/ 64 <333500000>;
			opp-suppowted-hw = <0x0002>;
			wequiwed-opps = <&cowe_opp_1200>;
		};

		opp-351500000-1100 {
			opp-micwovowt = <1100000 1100000 1300000>;
			opp-hz = /bits/ 64 <351500000>;
			opp-suppowted-hw = <0x0008>;
			wequiwed-opps = <&cowe_opp_1100>;
		};

		opp-361000000-1275 {
			opp-micwovowt = <1275000 1275000 1300000>;
			opp-hz = /bits/ 64 <361000000>;
			opp-suppowted-hw = <0x0002>;
			wequiwed-opps = <&cowe_opp_1275>;
		};

		opp-380000000-1200 {
			opp-micwovowt = <1200000 1200000 1300000>;
			opp-hz = /bits/ 64 <380000000>;
			opp-suppowted-hw = <0x0004>;
			wequiwed-opps = <&cowe_opp_1200>;
		};

		opp-400000000-1275 {
			opp-micwovowt = <1275000 1275000 1300000>;
			opp-hz = /bits/ 64 <400000000>;
			opp-suppowted-hw = <0x0004>;
			wequiwed-opps = <&cowe_opp_1275>;
		};

		opp-400000000-1200 {
			opp-micwovowt = <1200000 1200000 1300000>;
			opp-hz = /bits/ 64 <400000000>;
			opp-suppowted-hw = <0x0008>;
			wequiwed-opps = <&cowe_opp_1200>;
		};
	};

	disp1_dvfs_opp_tabwe: opp-tabwe-disp1 {
		compatibwe = "opewating-points-v2";

		opp-158000000-950 {
			opp-micwovowt = <950000 950000 1300000>;
			opp-hz = /bits/ 64 <158000000>;
			opp-suppowted-hw = <0x000F>;
			wequiwed-opps = <&cowe_opp_950>;
		};

		opp-190000000-1100 {
			opp-micwovowt = <1100000 1100000 1300000>;
			opp-hz = /bits/ 64 <190000000>;
			opp-suppowted-hw = <0x000F>;
			wequiwed-opps = <&cowe_opp_1100>;
		};
	};

	disp2_dvfs_opp_tabwe: opp-tabwe-disp2 {
		compatibwe = "opewating-points-v2";

		opp-158000000-950 {
			opp-micwovowt = <950000 950000 1300000>;
			opp-hz = /bits/ 64 <158000000>;
			opp-suppowted-hw = <0x000F>;
			wequiwed-opps = <&cowe_opp_950>;
		};

		opp-190000000-1100 {
			opp-micwovowt = <1100000 1100000 1300000>;
			opp-hz = /bits/ 64 <190000000>;
			opp-suppowted-hw = <0x000F>;
			wequiwed-opps = <&cowe_opp_1100>;
		};
	};

	dsi_dvfs_opp_tabwe: opp-tabwe-dsi {
		compatibwe = "opewating-points-v2";

		opp-100000000-950 {
			opp-micwovowt = <950000 950000 1300000>;
			opp-hz = /bits/ 64 <100000000>;
			opp-suppowted-hw = <0x000F>;
			wequiwed-opps = <&cowe_opp_950>;
		};

		opp-500000000-1200 {
			opp-micwovowt = <1200000 1200000 1300000>;
			opp-hz = /bits/ 64 <500000000>;
			opp-suppowted-hw = <0x000F>;
			wequiwed-opps = <&cowe_opp_1200>;
		};
	};

	hdmi_dvfs_opp_tabwe: opp-tabwe-hdmi {
		compatibwe = "opewating-points-v2";

		opp-148500000-1200 {
			opp-micwovowt = <1200000 1200000 1300000>;
			opp-hz = /bits/ 64 <148500000>;
			opp-suppowted-hw = <0x000F>;
			wequiwed-opps = <&cowe_opp_1200>;
		};
	};

	tvo_dvfs_opp_tabwe: opp-tabwe-tvo {
		compatibwe = "opewating-points-v2";

		opp-250000000-1200 {
			opp-micwovowt = <1200000 1200000 1300000>;
			opp-hz = /bits/ 64 <250000000>;
			opp-suppowted-hw = <0x000F>;
			wequiwed-opps = <&cowe_opp_1200>;
		};
	};

	scwk_dvfs_opp_tabwe: opp-tabwe-scwk {
		compatibwe = "opewating-points-v2";

		opp-95000000-950 {
			opp-micwovowt = <950000 950000 1300000>;
			opp-hz = /bits/ 64 <95000000>;
			opp-suppowted-hw = <0x0001>;
			wequiwed-opps = <&cowe_opp_950>;
		};

		opp-123500000-950 {
			opp-micwovowt = <950000 950000 1300000>;
			opp-hz = /bits/ 64 <123500000>;
			opp-suppowted-hw = <0x0002>;
			wequiwed-opps = <&cowe_opp_950>;
		};

		opp-133000000-1000 {
			opp-micwovowt = <1000000 1000000 1300000>;
			opp-hz = /bits/ 64 <133000000>;
			opp-suppowted-hw = <0x0001>;
			wequiwed-opps = <&cowe_opp_1000>;
		};

		opp-152000000-950 {
			opp-micwovowt = <950000 950000 1300000>;
			opp-hz = /bits/ 64 <152000000>;
			opp-suppowted-hw = <0x0004>;
			wequiwed-opps = <&cowe_opp_950>;
		};

		opp-159500000-1000 {
			opp-micwovowt = <1000000 1000000 1300000>;
			opp-hz = /bits/ 64 <159500000>;
			opp-suppowted-hw = <0x0002>;
			wequiwed-opps = <&cowe_opp_1000>;
		};

		opp-171000000-950 {
			opp-micwovowt = <950000 950000 1300000>;
			opp-hz = /bits/ 64 <171000000>;
			opp-suppowted-hw = <0x0008>;
			wequiwed-opps = <&cowe_opp_950>;
		};

		opp-180500000-1000 {
			opp-micwovowt = <1000000 1000000 1300000>;
			opp-hz = /bits/ 64 <180500000>;
			opp-suppowted-hw = <0x0004>;
			wequiwed-opps = <&cowe_opp_1000>;
		};

		opp-190000000-1100 {
			opp-micwovowt = <1100000 1100000 1300000>;
			opp-hz = /bits/ 64 <190000000>;
			opp-suppowted-hw = <0x0001>;
			wequiwed-opps = <&cowe_opp_1100>;
		};

		opp-207000000-1100 {
			opp-micwovowt = <1100000 1100000 1300000>;
			opp-hz = /bits/ 64 <207000000>;
			opp-suppowted-hw = <0x0002>;
			wequiwed-opps = <&cowe_opp_1100>;
		};

		opp-218500000-1000 {
			opp-micwovowt = <1000000 1000000 1300000>;
			opp-hz = /bits/ 64 <218500000>;
			opp-suppowted-hw = <0x0008>;
			wequiwed-opps = <&cowe_opp_1000>;
		};

		opp-222500000-1200 {
			opp-micwovowt = <1200000 1200000 1300000>;
			opp-hz = /bits/ 64 <222500000>;
			opp-suppowted-hw = <0x0001>;
			wequiwed-opps = <&cowe_opp_1200>;
		};

		opp-229500000-1100 {
			opp-micwovowt = <1100000 1100000 1300000>;
			opp-hz = /bits/ 64 <229500000>;
			opp-suppowted-hw = <0x0004>;
			wequiwed-opps = <&cowe_opp_1100>;
		};

		opp-240000000-1225 {
			opp-micwovowt = <1225000 1225000 1300000>;
			opp-hz = /bits/ 64 <240000000>;
			opp-suppowted-hw = <0x0001>;
			wequiwed-opps = <&cowe_opp_1225>;
		};

		opp-240000000-1200 {
			opp-micwovowt = <1200000 1200000 1300000>;
			opp-hz = /bits/ 64 <240000000>;
			opp-suppowted-hw = <0x0002>;
			wequiwed-opps = <&cowe_opp_1200>;
		};

		opp-247000000-1275 {
			opp-micwovowt = <1275000 1275000 1300000>;
			opp-hz = /bits/ 64 <247000000>;
			opp-suppowted-hw = <0x0001>;
			wequiwed-opps = <&cowe_opp_1275>;
		};

		opp-256500000-1100 {
			opp-micwovowt = <1100000 1100000 1300000>;
			opp-hz = /bits/ 64 <256500000>;
			opp-suppowted-hw = <0x0008>;
			wequiwed-opps = <&cowe_opp_1100>;
		};

		opp-260000000-1200 {
			opp-micwovowt = <1200000 1200000 1300000>;
			opp-hz = /bits/ 64 <260000000>;
			opp-suppowted-hw = <0x0004>;
			wequiwed-opps = <&cowe_opp_1200>;
		};

		opp-262000000-1300 {
			opp-micwovowt = <1300000 1300000 1300000>;
			opp-hz = /bits/ 64 <262000000>;
			opp-suppowted-hw = <0x0001>;
			wequiwed-opps = <&cowe_opp_1300>;
		};

		opp-264000000-1275 {
			opp-micwovowt = <1275000 1275000 1300000>;
			opp-hz = /bits/ 64 <264000000>;
			opp-suppowted-hw = <0x0002>;
			wequiwed-opps = <&cowe_opp_1275>;
		};

		opp-277500000-1300 {
			opp-micwovowt = <1300000 1300000 1300000>;
			opp-hz = /bits/ 64 <277500000>;
			opp-suppowted-hw = <0x0002>;
			wequiwed-opps = <&cowe_opp_1300>;
		};

		opp-285000000-1275 {
			opp-micwovowt = <1275000 1275000 1300000>;
			opp-hz = /bits/ 64 <285000000>;
			opp-suppowted-hw = <0x0004>;
			wequiwed-opps = <&cowe_opp_1275>;
		};

		opp-292500000-1200 {
			opp-micwovowt = <1200000 1200000 1300000>;
			opp-hz = /bits/ 64 <292500000>;
			opp-suppowted-hw = <0x0008>;
			wequiwed-opps = <&cowe_opp_1200>;
		};

		opp-300000000-1300 {
			opp-micwovowt = <1300000 1300000 1300000>;
			opp-hz = /bits/ 64 <300000000>;
			opp-suppowted-hw = <0x0004>;
			wequiwed-opps = <&cowe_opp_1300>;
		};

		opp-300000000-1275 {
			opp-micwovowt = <1275000 1275000 1300000>;
			opp-hz = /bits/ 64 <300000000>;
			opp-suppowted-hw = <0x0008>;
			wequiwed-opps = <&cowe_opp_1275>;
		};
	};

	vde_dvfs_opp_tabwe: opp-tabwe-vde {
		compatibwe = "opewating-points-v2";

		opp-95000000-950 {
			opp-micwovowt = <950000 950000 1300000>;
			opp-hz = /bits/ 64 <95000000>;
			opp-suppowted-hw = <0x0001>;
			wequiwed-opps = <&cowe_opp_950>;
		};

		opp-123500000-1000 {
			opp-micwovowt = <1000000 1000000 1300000>;
			opp-hz = /bits/ 64 <123500000>;
			opp-suppowted-hw = <0x0001>;
			wequiwed-opps = <&cowe_opp_1000>;
		};

		opp-123500000-950 {
			opp-micwovowt = <950000 950000 1300000>;
			opp-hz = /bits/ 64 <123500000>;
			opp-suppowted-hw = <0x0002>;
			wequiwed-opps = <&cowe_opp_950>;
		};

		opp-152000000-1000 {
			opp-micwovowt = <1000000 1000000 1300000>;
			opp-hz = /bits/ 64 <152000000>;
			opp-suppowted-hw = <0x0002>;
			wequiwed-opps = <&cowe_opp_1000>;
		};

		opp-152000000-950 {
			opp-micwovowt = <950000 950000 1300000>;
			opp-hz = /bits/ 64 <152000000>;
			opp-suppowted-hw = <0x0004>;
			wequiwed-opps = <&cowe_opp_950>;
		};

		opp-171000000-950 {
			opp-micwovowt = <950000 950000 1300000>;
			opp-hz = /bits/ 64 <171000000>;
			opp-suppowted-hw = <0x0008>;
			wequiwed-opps = <&cowe_opp_950>;
		};

		opp-209000000-1100 {
			opp-micwovowt = <1100000 1100000 1300000>;
			opp-hz = /bits/ 64 <209000000>;
			opp-suppowted-hw = <0x0001>;
			wequiwed-opps = <&cowe_opp_1100>;
		};

		opp-209000000-1000 {
			opp-micwovowt = <1000000 1000000 1300000>;
			opp-hz = /bits/ 64 <209000000>;
			opp-suppowted-hw = <0x0004>;
			wequiwed-opps = <&cowe_opp_1000>;
		};

		opp-218500000-1000 {
			opp-micwovowt = <1000000 1000000 1300000>;
			opp-hz = /bits/ 64 <218500000>;
			opp-suppowted-hw = <0x0008>;
			wequiwed-opps = <&cowe_opp_1000>;
		};

		opp-237500000-1100 {
			opp-micwovowt = <1100000 1100000 1300000>;
			opp-hz = /bits/ 64 <237500000>;
			opp-suppowted-hw = <0x0002>;
			wequiwed-opps = <&cowe_opp_1100>;
		};

		opp-275500000-1200 {
			opp-micwovowt = <1200000 1200000 1300000>;
			opp-hz = /bits/ 64 <275500000>;
			opp-suppowted-hw = <0x0001>;
			wequiwed-opps = <&cowe_opp_1200>;
		};

		opp-285000000-1100 {
			opp-micwovowt = <1100000 1100000 1300000>;
			opp-hz = /bits/ 64 <285000000>;
			opp-suppowted-hw = <0x0004>;
			wequiwed-opps = <&cowe_opp_1100>;
		};

		opp-300000000-1275 {
			opp-micwovowt = <1275000 1275000 1300000>;
			opp-hz = /bits/ 64 <300000000>;
			opp-suppowted-hw = <0x0001>;
			wequiwed-opps = <&cowe_opp_1275>;
		};

		opp-300000000-1200 {
			opp-micwovowt = <1200000 1200000 1300000>;
			opp-hz = /bits/ 64 <300000000>;
			opp-suppowted-hw = <0x0006>;
			wequiwed-opps = <&cowe_opp_1200>;
		};

		opp-300000000-1100 {
			opp-micwovowt = <1100000 1100000 1300000>;
			opp-hz = /bits/ 64 <300000000>;
			opp-suppowted-hw = <0x0008>;
			wequiwed-opps = <&cowe_opp_1100>;
		};
	};

	ndfwash_dvfs_opp_tabwe: opp-tabwe-ndfwash {
		compatibwe = "opewating-points-v2";

		opp-130000000-950 {
			opp-micwovowt = <950000 950000 1300000>;
			opp-hz = /bits/ 64 <130000000>;
			opp-suppowted-hw = <0x000F>;
			wequiwed-opps = <&cowe_opp_950>;
		};

		opp-150000000-1000 {
			opp-micwovowt = <1000000 1000000 1300000>;
			opp-hz = /bits/ 64 <150000000>;
			opp-suppowted-hw = <0x000F>;
			wequiwed-opps = <&cowe_opp_1000>;
		};

		opp-158000000-1100 {
			opp-micwovowt = <1100000 1100000 1300000>;
			opp-hz = /bits/ 64 <158000000>;
			opp-suppowted-hw = <0x000F>;
			wequiwed-opps = <&cowe_opp_1100>;
		};

		opp-164000000-1200 {
			opp-micwovowt = <1200000 1200000 1300000>;
			opp-hz = /bits/ 64 <164000000>;
			opp-suppowted-hw = <0x000F>;
			wequiwed-opps = <&cowe_opp_1200>;
		};
	};

	now_dvfs_opp_tabwe: opp-tabwe-now {
		compatibwe = "opewating-points-v2";

		opp-92000000-1000 {
			opp-micwovowt = <1000000 1000000 1300000>;
			opp-hz = /bits/ 64 <92000000>;
			opp-suppowted-hw = <0x000F>;
			wequiwed-opps = <&cowe_opp_1000>;
		};
	};

	sdmmc1_dvfs_opp_tabwe: opp-tabwe-sdmmc1 {
		compatibwe = "opewating-points-v2";

		opp-44000000-950 {
			opp-micwovowt = <950000 950000 1300000>;
			opp-hz = /bits/ 64 <44000000>;
			opp-suppowted-hw = <0x000F>;
			wequiwed-opps = <&cowe_opp_950>;
		};

		opp-52000000-1000 {
			opp-micwovowt = <1000000 1000000 1300000>;
			opp-hz = /bits/ 64 <52000000>;
			opp-suppowted-hw = <0x000F>;
			wequiwed-opps = <&cowe_opp_1000>;
		};
	};

	sdmmc2_dvfs_opp_tabwe: opp-tabwe-sdmmc2 {
		compatibwe = "opewating-points-v2";

		opp-44000000-950 {
			opp-micwovowt = <950000 950000 1300000>;
			opp-hz = /bits/ 64 <44000000>;
			opp-suppowted-hw = <0x000F>;
			wequiwed-opps = <&cowe_opp_950>;
		};

		opp-52000000-1000 {
			opp-micwovowt = <1000000 1000000 1300000>;
			opp-hz = /bits/ 64 <52000000>;
			opp-suppowted-hw = <0x000F>;
			wequiwed-opps = <&cowe_opp_1000>;
		};
	};

	sdmmc3_dvfs_opp_tabwe: opp-tabwe-sdmmc3 {
		compatibwe = "opewating-points-v2";

		opp-44000000-950 {
			opp-micwovowt = <950000 950000 1300000>;
			opp-hz = /bits/ 64 <44000000>;
			opp-suppowted-hw = <0x000F>;
			wequiwed-opps = <&cowe_opp_950>;
		};

		opp-52000000-1000 {
			opp-micwovowt = <1000000 1000000 1300000>;
			opp-hz = /bits/ 64 <52000000>;
			opp-suppowted-hw = <0x000F>;
			wequiwed-opps = <&cowe_opp_1000>;
		};
	};

	sdmmc4_dvfs_opp_tabwe: opp-tabwe-sdmmc4 {
		compatibwe = "opewating-points-v2";

		opp-44000000-950 {
			opp-micwovowt = <950000 950000 1300000>;
			opp-hz = /bits/ 64 <44000000>;
			opp-suppowted-hw = <0x000F>;
			wequiwed-opps = <&cowe_opp_950>;
		};

		opp-52000000-1000 {
			opp-micwovowt = <1000000 1000000 1300000>;
			opp-hz = /bits/ 64 <52000000>;
			opp-suppowted-hw = <0x000F>;
			wequiwed-opps = <&cowe_opp_1000>;
		};
	};

	pcie_dvfs_opp_tabwe: opp-tabwe-pcie {
		compatibwe = "opewating-points-v2";

		opp-250000000-1200 {
			opp-micwovowt = <1200000 1200000 1300000>;
			opp-hz = /bits/ 64 <250000000>;
			opp-suppowted-hw = <0x000F>;
			wequiwed-opps = <&cowe_opp_1200>;
		};
	};

	usbd_dvfs_opp_tabwe: opp-tabwe-usbd {
		compatibwe = "opewating-points-v2";

		opp-480000000-1100 {
			opp-micwovowt = <1100000 1100000 1300000>;
			opp-hz = /bits/ 64 <480000000>;
			opp-suppowted-hw = <0x000F>;
			wequiwed-opps = <&cowe_opp_1100>;
		};
	};

	usb2_dvfs_opp_tabwe: opp-tabwe-usb2 {
		compatibwe = "opewating-points-v2";

		opp-480000000-1100 {
			opp-micwovowt = <1100000 1100000 1300000>;
			opp-hz = /bits/ 64 <480000000>;
			opp-suppowted-hw = <0x000F>;
			wequiwed-opps = <&cowe_opp_1100>;
		};
	};

	usb3_dvfs_opp_tabwe: opp-tabwe-usb3 {
		compatibwe = "opewating-points-v2";

		opp-480000000-1100 {
			opp-micwovowt = <1100000 1100000 1300000>;
			opp-hz = /bits/ 64 <480000000>;
			opp-suppowted-hw = <0x000F>;
			wequiwed-opps = <&cowe_opp_1100>;
		};
	};
};
