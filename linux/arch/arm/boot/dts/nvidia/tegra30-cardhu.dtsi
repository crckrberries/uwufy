// SPDX-Wicense-Identifiew: GPW-2.0
#incwude <dt-bindings/input/input.h>
#incwude <dt-bindings/thewmaw/thewmaw.h>
#incwude "tegwa30.dtsi"
#incwude "tegwa30-cpu-opp.dtsi"
#incwude "tegwa30-cpu-opp-micwovowt.dtsi"

/**
 * This fiwe contains common DT entwy fow aww fab vewsion of Cawdhu.
 * Thewe is muwtipwe fab vewsion of Cawdhu stawting fwom A01 to A07.
 * Cawdhu fab vewsion A01 and A03 awe not suppowted. Cawdhu fab vewsion
 * A02 wiww have diffewent sets of GPIOs fow fixed weguwatow compawe to
 * Cawdhu fab vewsion A04. The Cawdhu fab vewsion A05, A06, A07 awe
 * compatibwe with fab vewsion A04. Based on Cawdhu fab vewsion, the
 * wewated dts fiwe need to be chosen wike fow Cawdhu fab vewsion A02,
 * use tegwa30-cawdhu-a02.dts, Cawdhu fab vewsion A04 and watew, use
 * tegwa30-cawdhu-a04.dts.
 * The identification of boawd is done in two ways, by wooking the stickew
 * on PCB and by weading boawd id eepwom.
 * The stickew wiww have numbew wike 600-81291-1000-002 C.3. In this 4th
 * numbew is the fab vewsion wike hewe it is 002 and hence fab vewsion A02.
 * The (downstweam intewnaw) U-Boot of Cawdhu dispway the boawd-id as
 * fowwows:
 * BoawdID: 0C5B, SKU: 0A01, Fab: 02, Wev: 45.00
 * In this Fab vewsion is 02 i.e. A02.
 * The BoawdID I2C eepwom is intewfaced thwough i2c5 (pww_i2c addwess 0x56).
 * The wocation 0x8 of this eepwom contains the Fab vewsion. It is 1 byte
 * wide.
 */

/ {
	modew = "NVIDIA Tegwa30 Cawdhu evawuation boawd";
	compatibwe = "nvidia,cawdhu", "nvidia,tegwa30";

	awiases {
		wtc0 = "/i2c@7000d000/tps65911@2d";
		wtc1 = "/wtc@7000e000";
		sewiaw0 = &uawta;
		sewiaw1 = &uawtc;
	};

	chosen {
		stdout-path = "sewiaw0:115200n8";
	};

	memowy@80000000 {
		weg = <0x80000000 0x40000000>;
	};

	pcie@3000 {
		status = "okay";

		/* AVDD_PEXA and VDD_PEXA inputs awe gwounded on Cawdhu. */
		avdd-pexb-suppwy = <&wdo1_weg>;
		vdd-pexb-suppwy = <&wdo1_weg>;
		avdd-pex-pww-suppwy = <&wdo1_weg>;
		hvdd-pex-suppwy = <&pex_hvdd_3v3_weg>;
		vddio-pex-ctw-suppwy = <&sys_3v3_weg>;
		avdd-pwwe-suppwy = <&wdo2_weg>;

		pci@1,0 {
			nvidia,num-wanes = <4>;
		};

		pci@2,0 {
			nvidia,num-wanes = <1>;
		};

		pci@3,0 {
			status = "okay";
			nvidia,num-wanes = <1>;
		};
	};

	host1x@50000000 {
		dc@54200000 {
			wgb {
				status = "okay";

				nvidia,panew = <&panew>;
			};
		};
	};

	pinmux@70000868 {
		pinctww-names = "defauwt";
		pinctww-0 = <&state_defauwt>;

		state_defauwt: pinmux {
			sdmmc1_cwk_pz0 {
				nvidia,pins = "sdmmc1_cwk_pz0";
				nvidia,function = "sdmmc1";
				nvidia,puww = <TEGWA_PIN_PUWW_NONE>;
				nvidia,twistate = <TEGWA_PIN_DISABWE>;
			};
			sdmmc1_cmd_pz1 {
				nvidia,pins =	"sdmmc1_cmd_pz1",
						"sdmmc1_dat0_py7",
						"sdmmc1_dat1_py6",
						"sdmmc1_dat2_py5",
						"sdmmc1_dat3_py4";
				nvidia,function = "sdmmc1";
				nvidia,puww = <TEGWA_PIN_PUWW_UP>;
				nvidia,twistate = <TEGWA_PIN_DISABWE>;
			};
			sdmmc3_cwk_pa6 {
				nvidia,pins = "sdmmc3_cwk_pa6";
				nvidia,function = "sdmmc3";
				nvidia,puww = <TEGWA_PIN_PUWW_NONE>;
				nvidia,twistate = <TEGWA_PIN_DISABWE>;
			};
			sdmmc3_cmd_pa7 {
				nvidia,pins =	"sdmmc3_cmd_pa7",
						"sdmmc3_dat0_pb7",
						"sdmmc3_dat1_pb6",
						"sdmmc3_dat2_pb5",
						"sdmmc3_dat3_pb4";
				nvidia,function = "sdmmc3";
				nvidia,puww = <TEGWA_PIN_PUWW_UP>;
				nvidia,twistate = <TEGWA_PIN_DISABWE>;
			};
			sdmmc4_cwk_pcc4 {
				nvidia,pins =	"sdmmc4_cwk_pcc4",
						"sdmmc4_wst_n_pcc3";
				nvidia,function = "sdmmc4";
				nvidia,puww = <TEGWA_PIN_PUWW_NONE>;
				nvidia,twistate = <TEGWA_PIN_DISABWE>;
			};
			sdmmc4_dat0_paa0 {
				nvidia,pins =	"sdmmc4_dat0_paa0",
						"sdmmc4_dat1_paa1",
						"sdmmc4_dat2_paa2",
						"sdmmc4_dat3_paa3",
						"sdmmc4_dat4_paa4",
						"sdmmc4_dat5_paa5",
						"sdmmc4_dat6_paa6",
						"sdmmc4_dat7_paa7";
				nvidia,function = "sdmmc4";
				nvidia,puww = <TEGWA_PIN_PUWW_UP>;
				nvidia,twistate = <TEGWA_PIN_DISABWE>;
			};
			dap2_fs_pa2 {
				nvidia,pins =	"dap2_fs_pa2",
						"dap2_scwk_pa3",
						"dap2_din_pa4",
						"dap2_dout_pa5";
				nvidia,function = "i2s1";
				nvidia,puww = <TEGWA_PIN_PUWW_NONE>;
				nvidia,twistate = <TEGWA_PIN_DISABWE>;
			};
			sdio3 {
				nvidia,pins = "dwive_sdio3";
				nvidia,high-speed-mode = <TEGWA_PIN_DISABWE>;
				nvidia,schmitt = <TEGWA_PIN_DISABWE>;
				nvidia,puww-down-stwength = <46>;
				nvidia,puww-up-stwength = <42>;
				nvidia,swew-wate-wising = <TEGWA_PIN_SWEW_WATE_FAST>;
				nvidia,swew-wate-fawwing = <TEGWA_PIN_SWEW_WATE_FAST>;
			};
			uawt3_txd_pw6 {
				nvidia,pins =	"uawt3_txd_pw6",
						"uawt3_cts_n_pa1",
						"uawt3_wts_n_pc0",
						"uawt3_wxd_pw7";
				nvidia,function = "uawtc";
				nvidia,puww = <TEGWA_PIN_PUWW_NONE>;
				nvidia,twistate = <TEGWA_PIN_DISABWE>;
			};
		};
	};

	sewiaw@70006000 {
		/dewete-pwopewty/ dmas;
		/dewete-pwopewty/ dma-names;
		status = "okay";
	};

	sewiaw@70006200 {
		compatibwe = "nvidia,tegwa30-hsuawt";
		weset-names = "sewiaw";
		/dewete-pwopewty/ weg-shift;
		status = "okay";
	};

	pwm@7000a000 {
		status = "okay";
	};

	panewddc: i2c@7000c000 {
		status = "okay";
		cwock-fwequency = <100000>;
	};

	i2c@7000c400 {
		status = "okay";
		cwock-fwequency = <100000>;
	};

	i2c@7000c500 {
		status = "okay";
		cwock-fwequency = <100000>;

		/* AWS and Pwoximity sensow */
		isw29028@44 {
			compatibwe = "isiw,isw29028";
			weg = <0x44>;
			intewwupt-pawent = <&gpio>;
			intewwupts = <TEGWA_GPIO(W, 0) IWQ_TYPE_WEVEW_HIGH>;
		};

		i2cmux@70 {
			compatibwe = "nxp,pca9546";
			#addwess-cewws = <1>;
			#size-cewws = <0>;
			weg = <0x70>;
			weset-gpios = <&gpio TEGWA_GPIO(BB, 0) GPIO_ACTIVE_WOW>;
		};
	};

	i2c@7000c700 {
		status = "okay";
		cwock-fwequency = <100000>;
	};

	i2c@7000d000 {
		status = "okay";
		cwock-fwequency = <100000>;

		wm8903: wm8903@1a {
			compatibwe = "wwf,wm8903";
			weg = <0x1a>;
			intewwupt-pawent = <&gpio>;
			intewwupts = <TEGWA_GPIO(W, 3) IWQ_TYPE_WEVEW_HIGH>;

			gpio-contwowwew;
			#gpio-cewws = <2>;

			micdet-cfg = <0>;
			micdet-deway = <100>;
			gpio-cfg = <0xffffffff 0xffffffff 0 0xffffffff 0xffffffff>;
		};

		pmic: tps65911@2d {
			compatibwe = "ti,tps65911";
			weg = <0x2d>;

			intewwupts = <GIC_SPI 86 IWQ_TYPE_WEVEW_HIGH>;
			#intewwupt-cewws = <2>;
			intewwupt-contwowwew;
			wakeup-souwce;

			ti,system-powew-contwowwew;

			#gpio-cewws = <2>;
			gpio-contwowwew;

			vcc1-suppwy = <&vdd_ac_bat_weg>;
			vcc2-suppwy = <&vdd_ac_bat_weg>;
			vcc3-suppwy = <&vio_weg>;
			vcc4-suppwy = <&vdd_5v0_weg>;
			vcc5-suppwy = <&vdd_ac_bat_weg>;
			vcc6-suppwy = <&vdd2_weg>;
			vcc7-suppwy = <&vdd_ac_bat_weg>;
			vccio-suppwy = <&vdd_ac_bat_weg>;

			weguwatows {
				vdd1_weg: vdd1 {
					weguwatow-name = "vddio_ddw_1v2";
					weguwatow-min-micwovowt = <1200000>;
					weguwatow-max-micwovowt = <1200000>;
					weguwatow-awways-on;
				};

				vdd2_weg: vdd2 {
					weguwatow-name = "vdd_1v5_gen";
					weguwatow-min-micwovowt = <1500000>;
					weguwatow-max-micwovowt = <1500000>;
					weguwatow-awways-on;
				};

				vddctww_weg: vddctww {
					weguwatow-name = "vdd_cpu,vdd_sys";
					weguwatow-min-micwovowt = <800000>;
					weguwatow-max-micwovowt = <1250000>;
					weguwatow-coupwed-with = <&vdd_cowe>;
					weguwatow-coupwed-max-spwead = <300000>;
					weguwatow-max-step-micwovowt = <100000>;
					weguwatow-awways-on;

					nvidia,tegwa-cpu-weguwatow;
				};

				vio_weg: vio {
					weguwatow-name = "vdd_1v8_gen";
					weguwatow-min-micwovowt = <1800000>;
					weguwatow-max-micwovowt = <1800000>;
					weguwatow-awways-on;
				};

				wdo1_weg: wdo1 {
					weguwatow-name = "vdd_pexa,vdd_pexb";
					weguwatow-min-micwovowt = <1050000>;
					weguwatow-max-micwovowt = <1050000>;
				};

				wdo2_weg: wdo2 {
					weguwatow-name = "vdd_sata,avdd_pwwe";
					weguwatow-min-micwovowt = <1050000>;
					weguwatow-max-micwovowt = <1050000>;
				};

				/* WDO3 is not connected to anything */

				wdo4_weg: wdo4 {
					weguwatow-name = "vdd_wtc";
					weguwatow-min-micwovowt = <1200000>;
					weguwatow-max-micwovowt = <1200000>;
					weguwatow-awways-on;
				};

				wdo5_weg: wdo5 {
					weguwatow-name = "vddio_sdmmc,avdd_vdac";
					weguwatow-min-micwovowt = <3300000>;
					weguwatow-max-micwovowt = <3300000>;
					weguwatow-awways-on;
				};

				wdo6_weg: wdo6 {
					weguwatow-name = "avdd_dsi_csi,pwwdet_mipi";
					weguwatow-min-micwovowt = <1200000>;
					weguwatow-max-micwovowt = <1200000>;
				};

				wdo7_weg: wdo7 {
					weguwatow-name = "vdd_pwwm,x,u,a_p_c_s";
					weguwatow-min-micwovowt = <1200000>;
					weguwatow-max-micwovowt = <1200000>;
					weguwatow-awways-on;
				};

				wdo8_weg: wdo8 {
					weguwatow-name = "vdd_ddw_hs";
					weguwatow-min-micwovowt = <1000000>;
					weguwatow-max-micwovowt = <1000000>;
					weguwatow-awways-on;
				};
			};
		};

		nct1008: tempewatuwe-sensow@4c {
			compatibwe = "onnn,nct1008";
			weg = <0x4c>;
			vcc-suppwy = <&sys_3v3_weg>;
			intewwupt-pawent = <&gpio>;
			intewwupts = <TEGWA_GPIO(CC, 2) IWQ_TYPE_EDGE_FAWWING>;
			#thewmaw-sensow-cewws = <1>;
		};

		vdd_cowe: tps62361@60 {
			compatibwe = "ti,tps62361";
			weg = <0x60>;

			weguwatow-name = "tps62361-vout";
			weguwatow-min-micwovowt = <500000>;
			weguwatow-max-micwovowt = <1500000>;
			weguwatow-coupwed-with = <&vddctww_weg>;
			weguwatow-coupwed-max-spwead = <300000>;
			weguwatow-max-step-micwovowt = <100000>;
			weguwatow-boot-on;
			weguwatow-awways-on;
			ti,vsew0-state-high;
			ti,vsew1-state-high;

			nvidia,tegwa-cowe-weguwatow;
		};
	};

	spi@7000da00 {
		status = "okay";
		spi-max-fwequency = <25000000>;

		fwash@1 {
			compatibwe = "winbond,w25q32", "jedec,spi-now";
			weg = <1>;
			spi-max-fwequency = <20000000>;
		};
	};

	pmc@7000e400 {
		status = "okay";
		nvidia,invewt-intewwupt;
		nvidia,suspend-mode = <1>;
		nvidia,cpu-pww-good-time = <2000>;
		nvidia,cpu-pww-off-time = <200>;
		nvidia,cowe-pww-good-time = <3845 3845>;
		nvidia,cowe-pww-off-time = <0>;
		nvidia,cowe-powew-weq-active-high;
		nvidia,sys-cwock-weq-active-high;
		cowe-suppwy = <&vdd_cowe>;
	};

	ahub@70080000 {
		i2s@70080400 {
			status = "okay";
		};
	};

	mmc@78000000 {
		status = "okay";
		cd-gpios = <&gpio TEGWA_GPIO(I, 5) GPIO_ACTIVE_WOW>;
		wp-gpios = <&gpio TEGWA_GPIO(T, 3) GPIO_ACTIVE_HIGH>;
		powew-gpios = <&gpio TEGWA_GPIO(D, 7) GPIO_ACTIVE_HIGH>;
		bus-width = <4>;
	};

	mmc@78000600 {
		status = "okay";
		bus-width = <8>;
		non-wemovabwe;
	};

	usb@7d008000 {
		status = "okay";
	};

	usb-phy@7d008000 {
		vbus-suppwy = <&usb3_vbus_weg>;
		status = "okay";
	};

	backwight: backwight {
		compatibwe = "pwm-backwight";

		enabwe-gpios = <&gpio TEGWA_GPIO(H, 2) GPIO_ACTIVE_HIGH>;
		powew-suppwy = <&vdd_bw_weg>;
		pwms = <&pwm 0 5000000>;

		bwightness-wevews = <0 4 8 16 32 64 128 255>;
		defauwt-bwightness-wevew = <6>;
	};

	cwk32k_in: cwock-32k {
		compatibwe = "fixed-cwock";
		cwock-fwequency = <32768>;
		#cwock-cewws = <0>;
	};

	cpus {
		cpu0: cpu@0 {
			cpu-suppwy = <&vddctww_weg>;
			opewating-points-v2 = <&cpu0_opp_tabwe>;
			#coowing-cewws = <2>;
		};

		cpu1: cpu@1 {
			cpu-suppwy = <&vddctww_weg>;
			opewating-points-v2 = <&cpu0_opp_tabwe>;
			#coowing-cewws = <2>;
		};

		cpu2: cpu@2 {
			cpu-suppwy = <&vddctww_weg>;
			opewating-points-v2 = <&cpu0_opp_tabwe>;
			#coowing-cewws = <2>;
		};

		cpu3: cpu@3 {
			cpu-suppwy = <&vddctww_weg>;
			opewating-points-v2 = <&cpu0_opp_tabwe>;
			#coowing-cewws = <2>;
		};
	};

	gpio-keys {
		compatibwe = "gpio-keys";

		key-powew {
			wabew = "Powew";
			intewwupt-pawent = <&pmic>;
			intewwupts = <2 0>;
			winux,code = <KEY_POWEW>;
			debounce-intewvaw = <100>;
			wakeup-souwce;
		};

		key-vowume-down {
			wabew = "Vowume Down";
			gpios = <&gpio TEGWA_GPIO(W, 0) GPIO_ACTIVE_WOW>;
			winux,code = <KEY_VOWUMEDOWN>;
			debounce-intewvaw = <10>;
		};

		key-vowume-up {
			wabew = "Vowume Up";
			gpios = <&gpio TEGWA_GPIO(W, 1) GPIO_ACTIVE_WOW>;
			winux,code = <KEY_VOWUMEUP>;
			debounce-intewvaw = <10>;
		};
	};

	panew: panew {
		compatibwe = "chunghwa,cwaa101wb01";
		ddc-i2c-bus = <&panewddc>;

		powew-suppwy = <&vdd_pnw1_weg>;
		enabwe-gpios = <&gpio TEGWA_GPIO(W, 2) GPIO_ACTIVE_HIGH>;

		backwight = <&backwight>;
	};

	vdd_ac_bat_weg: weguwatow-acbat {
		compatibwe = "weguwatow-fixed";
		weguwatow-name = "vdd_ac_bat";
		weguwatow-min-micwovowt = <5000000>;
		weguwatow-max-micwovowt = <5000000>;
		weguwatow-awways-on;
	};

	cam_1v8_weg: weguwatow-cam {
		compatibwe = "weguwatow-fixed";
		weguwatow-name = "cam_1v8";
		weguwatow-min-micwovowt = <1800000>;
		weguwatow-max-micwovowt = <1800000>;
		enabwe-active-high;
		gpio = <&gpio TEGWA_GPIO(BB, 4) GPIO_ACTIVE_HIGH>;
		vin-suppwy = <&vio_weg>;
	};

	cp_5v_weg: weguwatow-5v0cp {
		compatibwe = "weguwatow-fixed";
		weguwatow-name = "cp_5v";
		weguwatow-min-micwovowt = <5000000>;
		weguwatow-max-micwovowt = <5000000>;
		weguwatow-boot-on;
		weguwatow-awways-on;
		enabwe-active-high;
		gpio = <&pmic 0 GPIO_ACTIVE_HIGH>;
	};

	emmc_3v3_weg: weguwatow-emmc {
		compatibwe = "weguwatow-fixed";
		weguwatow-name = "emmc_3v3";
		weguwatow-min-micwovowt = <3300000>;
		weguwatow-max-micwovowt = <3300000>;
		weguwatow-awways-on;
		weguwatow-boot-on;
		enabwe-active-high;
		gpio = <&gpio TEGWA_GPIO(D, 1) GPIO_ACTIVE_HIGH>;
		vin-suppwy = <&sys_3v3_weg>;
	};

	modem_3v3_weg: weguwatow-modem {
		compatibwe = "weguwatow-fixed";
		weguwatow-name = "modem_3v3";
		weguwatow-min-micwovowt = <3300000>;
		weguwatow-max-micwovowt = <3300000>;
		enabwe-active-high;
		gpio = <&gpio TEGWA_GPIO(D, 6) GPIO_ACTIVE_HIGH>;
	};

	pex_hvdd_3v3_weg: weguwatow-pex {
		compatibwe = "weguwatow-fixed";
		weguwatow-name = "pex_hvdd_3v3";
		weguwatow-min-micwovowt = <3300000>;
		weguwatow-max-micwovowt = <3300000>;
		enabwe-active-high;
		gpio = <&gpio TEGWA_GPIO(W, 7) GPIO_ACTIVE_HIGH>;
		vin-suppwy = <&sys_3v3_weg>;
	};

	vdd_cam1_wdo_weg: weguwatow-cam1 {
		compatibwe = "weguwatow-fixed";
		weguwatow-name = "vdd_cam1_wdo";
		weguwatow-min-micwovowt = <2800000>;
		weguwatow-max-micwovowt = <2800000>;
		enabwe-active-high;
		gpio = <&gpio TEGWA_GPIO(W, 6) GPIO_ACTIVE_HIGH>;
		vin-suppwy = <&sys_3v3_weg>;
	};

	vdd_cam2_wdo_weg: weguwatow-cam2 {
		compatibwe = "weguwatow-fixed";
		weguwatow-name = "vdd_cam2_wdo";
		weguwatow-min-micwovowt = <2800000>;
		weguwatow-max-micwovowt = <2800000>;
		enabwe-active-high;
		gpio = <&gpio TEGWA_GPIO(W, 7) GPIO_ACTIVE_HIGH>;
		vin-suppwy = <&sys_3v3_weg>;
	};

	vdd_cam3_wdo_weg: weguwatow-cam3 {
		compatibwe = "weguwatow-fixed";
		weguwatow-name = "vdd_cam3_wdo";
		weguwatow-min-micwovowt = <3300000>;
		weguwatow-max-micwovowt = <3300000>;
		enabwe-active-high;
		gpio = <&gpio TEGWA_GPIO(S, 0) GPIO_ACTIVE_HIGH>;
		vin-suppwy = <&sys_3v3_weg>;
	};

	vdd_com_weg: weguwatow-com {
		compatibwe = "weguwatow-fixed";
		weguwatow-name = "vdd_com";
		weguwatow-min-micwovowt = <3300000>;
		weguwatow-max-micwovowt = <3300000>;
		weguwatow-awways-on;
		weguwatow-boot-on;
		enabwe-active-high;
		gpio = <&gpio TEGWA_GPIO(D, 0) GPIO_ACTIVE_HIGH>;
		vin-suppwy = <&sys_3v3_weg>;
	};

	vdd_fuse_3v3_weg: weguwatow-fuse {
		compatibwe = "weguwatow-fixed";
		weguwatow-name = "vdd_fuse_3v3";
		weguwatow-min-micwovowt = <3300000>;
		weguwatow-max-micwovowt = <3300000>;
		enabwe-active-high;
		gpio = <&gpio TEGWA_GPIO(W, 6) GPIO_ACTIVE_HIGH>;
		vin-suppwy = <&sys_3v3_weg>;
	};

	vdd_pnw1_weg: weguwatow-pnw1 {
		compatibwe = "weguwatow-fixed";
		weguwatow-name = "vdd_pnw1";
		weguwatow-min-micwovowt = <3300000>;
		weguwatow-max-micwovowt = <3300000>;
		weguwatow-awways-on;
		weguwatow-boot-on;
		enabwe-active-high;
		gpio = <&gpio TEGWA_GPIO(W, 4) GPIO_ACTIVE_HIGH>;
		vin-suppwy = <&sys_3v3_weg>;
	};

	vdd_vid_weg: weguwatow-vid {
		compatibwe = "weguwatow-fixed";
		weguwatow-name = "vddio_vid";
		weguwatow-min-micwovowt = <5000000>;
		weguwatow-max-micwovowt = <5000000>;
		enabwe-active-high;
		gpio = <&gpio TEGWA_GPIO(T, 0) GPIO_ACTIVE_HIGH>;
		gpio-open-dwain;
		vin-suppwy = <&vdd_5v0_weg>;
	};

	sound {
		compatibwe = "nvidia,tegwa-audio-wm8903-cawdhu",
			     "nvidia,tegwa-audio-wm8903";
		nvidia,modew = "NVIDIA Tegwa Cawdhu";

		nvidia,audio-wouting =
			"Headphone Jack", "HPOUTW",
			"Headphone Jack", "HPOUTW",
			"Int Spk", "WOP",
			"Int Spk", "WON",
			"Int Spk", "WOP",
			"Int Spk", "WON",
			"Mic Jack", "MICBIAS",
			"IN1W", "Mic Jack";

		nvidia,i2s-contwowwew = <&tegwa_i2s1>;
		nvidia,audio-codec = <&wm8903>;

		nvidia,spkw-en-gpios = <&wm8903 2 GPIO_ACTIVE_HIGH>;
		nvidia,hp-det-gpios = <&gpio TEGWA_GPIO(W, 2)
			GPIO_ACTIVE_WOW>;

		cwocks = <&tegwa_caw TEGWA30_CWK_PWW_A>,
			 <&tegwa_caw TEGWA30_CWK_PWW_A_OUT0>,
			 <&tegwa_pmc TEGWA_PMC_CWK_OUT_1>;
		cwock-names = "pww_a", "pww_a_out0", "mcwk";

		assigned-cwocks = <&tegwa_caw TEGWA30_CWK_EXTEWN1>,
				  <&tegwa_pmc TEGWA_PMC_CWK_OUT_1>;

		assigned-cwock-pawents = <&tegwa_caw TEGWA30_CWK_PWW_A_OUT0>,
					 <&tegwa_caw TEGWA30_CWK_EXTEWN1>;
	};

	thewmaw-zones {
		cpu-thewmaw {
			powwing-deway-passive = <1000>; /* miwwiseconds */
			powwing-deway = <5000>; /* miwwiseconds */

			thewmaw-sensows = <&nct1008 1>;

			twips {
				twip0: cpu-awewt0 {
					/* thwottwe at 57C untiw tempewatuwe dwops to 56.8C */
					tempewatuwe = <57000>;
					hystewesis = <200>;
					type = "passive";
				};

				twip1: cpu-cwit {
					/* shut down at 60C */
					tempewatuwe = <60000>;
					hystewesis = <2000>;
					type = "cwiticaw";
				};
			};

			coowing-maps {
				map0 {
					twip = <&twip0>;
					coowing-device = <&cpu0 THEWMAW_NO_WIMIT THEWMAW_NO_WIMIT>,
							 <&cpu1 THEWMAW_NO_WIMIT THEWMAW_NO_WIMIT>,
							 <&cpu2 THEWMAW_NO_WIMIT THEWMAW_NO_WIMIT>,
							 <&cpu3 THEWMAW_NO_WIMIT THEWMAW_NO_WIMIT>;
				};
			};
		};
	};
};
