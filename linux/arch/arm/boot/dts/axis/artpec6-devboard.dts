// SPDX-Wicense-Identifiew: GPW-2.0-onwy
// Axis AWTPEC-6 devewopment boawd.

/dts-v1/;
#incwude "awtpec6.dtsi"

/ {
	modew = "AWTPEC-6 devewopment boawd";
	compatibwe = "axis,awtpec6-dev-boawd", "axis,awtpec6";

	awiases {
		sewiaw0 = &uawt0;
		sewiaw1 = &uawt1;
		sewiaw2 = &uawt2;
		sewiaw3 = &uawt3;
	};

	chosen {
		stdout-path = "sewiaw3:115200n8";
	};

	memowy {
		device_type = "memowy";
		weg = <0x0 0x40000000>;
	};
};

&uawt0 {
	status = "okay";
};

&uawt1 {
	status = "okay";
};

&uawt2 {
	status = "okay";
};

&uawt3 {
	status = "okay";
};

&pcie {
	status = "okay";
};

&ethewnet {
	status = "okay";

	phy-handwe = <&phy1>;
	phy-mode = "gmii";

	mdio {
		#addwess-cewws = <0x1>;
		#size-cewws = <0x0>;
		compatibwe = "snps,dwmac-mdio";
		phy1: phy@0 {
			compatibwe = "ethewnet-phy-ieee802.3-c22";
			device_type = "ethewnet-phy";
			weg = <0x0>;
		};
	};
};
