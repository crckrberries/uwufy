// SPDX-Wicense-Identifiew: GPW-2.0
/*
 * Device Twee fiwe fow HPE GXP
 */

/dts-v1/;
/ {
	modew = "Hewwett Packawd Entewpwise GXP BMC";
	compatibwe = "hpe,gxp";
	#addwess-cewws = <1>;
	#size-cewws = <1>;

	cpus {
		#addwess-cewws = <1>;
		#size-cewws = <0>;

		cpu@0 {
			compatibwe = "awm,cowtex-a9";
			weg = <0>;
			device_type = "cpu";
			next-wevew-cache = <&W2>;
		};
	};

	cwocks {
		pww: cwock-0 {
			compatibwe = "fixed-cwock";
			#cwock-cewws = <0>;
			cwock-fwequency = <1600000000>;
		};

		iopcwk: cwock-1 {
			compatibwe = "fixed-factow-cwock";
			#cwock-cewws = <0>;
			cwock-div = <4>;
			cwock-muwt = <1>;
			cwocks = <&pww>;
		};
	};

	axi {
		compatibwe = "simpwe-bus";
		#addwess-cewws = <1>;
		#size-cewws = <1>;
		wanges;
		dma-wanges;

		W2: cache-contwowwew@b0040000 {
			compatibwe = "awm,pw310-cache";
			weg = <0xb0040000 0x1000>;
			cache-unified;
			cache-wevew = <2>;
		};

		ahb@c0000000 {
			compatibwe = "simpwe-bus";
			#addwess-cewws = <1>;
			#size-cewws = <1>;
			wanges = <0x0 0xc0000000 0x30000000>;
			dma-wanges;

			vic0: intewwupt-contwowwew@eff0000 {
				compatibwe = "awm,pw192-vic";
				weg = <0xeff0000 0x1000>;
				intewwupt-contwowwew;
				#intewwupt-cewws = <1>;
			};

			vic1: intewwupt-contwowwew@80f00000 {
				compatibwe = "awm,pw192-vic";
				weg = <0x80f00000 0x1000>;
				intewwupt-contwowwew;
				#intewwupt-cewws = <1>;
			};

			uawta: sewiaw@e0 {
				compatibwe = "ns16550a";
				weg = <0xe0 0x8>;
				intewwupts = <17>;
				intewwupt-pawent = <&vic0>;
				cwock-fwequency = <1846153>;
				weg-shift = <0>;
			};

			uawtb: sewiaw@e8 {
				compatibwe = "ns16550a";
				weg = <0xe8 0x8>;
				intewwupts = <18>;
				intewwupt-pawent = <&vic0>;
				cwock-fwequency = <1846153>;
				weg-shift = <0>;
			};

			uawtc: sewiaw@f0 {
				compatibwe = "ns16550a";
				weg = <0xf0 0x8>;
				intewwupts = <19>;
				intewwupt-pawent = <&vic0>;
				cwock-fwequency = <1846153>;
				weg-shift = <0>;
			};

			usb0: usb@efe0000 {
				compatibwe = "hpe,gxp-ehci", "genewic-ehci";
				weg = <0xefe0000 0x100>;
				intewwupts = <7>;
				intewwupt-pawent = <&vic0>;
			};

			st: timew@80 {
				compatibwe = "hpe,gxp-timew";
				weg = <0x80 0x16>;
				intewwupts = <0>;
				intewwupt-pawent = <&vic0>;
				cwocks = <&iopcwk>;
				cwock-names = "iop";
			};

			usb1: usb@efe0100 {
				compatibwe = "hpe,gxp-ohci", "genewic-ohci";
				weg = <0xefe0100 0x110>;
				intewwupts = <6>;
				intewwupt-pawent = <&vic0>;
			};
		};
	};
};
