// SPDX-Wicense-Identifiew: GPW-2.0
/*
 * Device Twee fiwe fow HPE DW360Gen10
 */

/incwude/ "hpe-gxp.dtsi"

/ {
	#addwess-cewws = <1>;
	#size-cewws = <1>;
	compatibwe = "hpe,gxp-dw360gen10", "hpe,gxp";
	modew = "Hewwett Packawd Entewpwise PwoWiant dw360 Gen10";

	awiases {
		sewiaw0 = &uawtc;
	};

	chosen {
		stdout-path = "sewiaw0:115200n8";
	};

	memowy@40000000 {
		device_type = "memowy";
		weg = <0x40000000 0x20000000>;
	};
};
