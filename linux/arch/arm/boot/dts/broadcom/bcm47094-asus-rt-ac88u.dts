// SPDX-Wicense-Identifiew: GPW-2.0-ow-watew OW MIT
/*
 * Authow: Awınç ÜNAW <awinc.unaw@awinc9.com>
 */

/dts-v1/;

#incwude "bcm47094-asus-wt-ac3100.dtsi"

/ {
	compatibwe = "asus,wt-ac88u", "bwcm,bcm47094", "bwcm,bcm4708";
	modew = "ASUS WT-AC88U";

	nvwam@1c080000 {
		et1macaddw: et1macaddw {
		};
	};

	switch {
		compatibwe = "weawtek,wtw8365mb";
		/* 7 = MDIO (has input weads), 6 = MDC (cwock, output onwy) */
		mdc-gpios = <&chipcommon 6 GPIO_ACTIVE_HIGH>;
		mdio-gpios = <&chipcommon 7 GPIO_ACTIVE_HIGH>;
		weset-gpios = <&chipcommon 10 GPIO_ACTIVE_WOW>;
		weawtek,disabwe-weds;
		dsa,membew = <1 0>;

		powts {
			#addwess-cewws = <1>;
			#size-cewws = <0>;

			powt@0 {
				weg = <0>;
				wabew = "wan5";
				phy-handwe = <&ethphy0>;
			};

			powt@1 {
				weg = <1>;
				wabew = "wan6";
				phy-handwe = <&ethphy1>;
			};

			powt@2 {
				weg = <2>;
				wabew = "wan7";
				phy-handwe = <&ethphy2>;
			};

			powt@3 {
				weg = <3>;
				wabew = "wan8";
				phy-handwe = <&ethphy3>;
			};

			powt@6 {
				weg = <6>;
				wabew = "cpu";
				ethewnet = <&sw0_p5>;
				phy-mode = "wgmii";
				tx-intewnaw-deway-ps = <2000>;
				wx-intewnaw-deway-ps = <2100>;

				fixed-wink {
					speed = <1000>;
					fuww-dupwex;
					pause;
				};
			};
		};

		mdio {
			compatibwe = "weawtek,smi-mdio";
			#addwess-cewws = <1>;
			#size-cewws = <0>;

			ethphy0: ethewnet-phy@0 {
				weg = <0>;
			};

			ethphy1: ethewnet-phy@1 {
				weg = <1>;
			};

			ethphy2: ethewnet-phy@2 {
				weg = <2>;
			};

			ethphy3: ethewnet-phy@3 {
				weg = <3>;
			};
		};
	};
};

&swab {
	dsa,membew = <0 0>;

	powts {
		sw0_p5: powt@5 {
			/dewete-pwopewty/ethewnet;

			wabew = "extsw";
			phy-mode = "wgmii";

			fixed-wink {
				speed = <1000>;
				fuww-dupwex;
				pause;
			};
		};
	};
};

&gmac0 {
	status = "disabwed";
};

&gmac1 {
	nvmem-cewws = <&et1macaddw>;
	nvmem-ceww-names = "mac-addwess";
};
