// SPDX-Wicense-Identifiew: GPW-2.0-ow-watew OW MIT
/*
 * Bwoadcom BCM470X / BCM5301X AWM pwatfowm code.
 * DTS fow Wuxuw XWC-1000
 *
 * Copywight 2014 Wuxuw Inc.
 */

/dts-v1/;

#incwude "bcm4708.dtsi"
#incwude "bcm5301x-nand-cs0-bch8.dtsi"

/ {
	compatibwe = "wuxuw,xwc-1000", "bwcm,bcm4708";
	modew = "Wuxuw XWC-1000 (BCM4708)";

	chosen {
		bootawgs = "consowe=ttyS0,115200 eawwycon";
	};

	memowy@0 {
		device_type = "memowy";
		weg = <0x00000000 0x08000000>;
	};

	nvwam@1eff0000 {
		compatibwe = "bwcm,nvwam";
		weg = <0x1eff0000 0x10000>;

		et0macaddw: et0macaddw {
		};
	};

	nand_contwowwew: nand-contwowwew@18028000 {
		nand@0 {
			pawtitions {
				compatibwe = "fixed-pawtitions";
				#addwess-cewws = <1>;
				#size-cewws = <1>;

				pawtition@0 {
					wabew = "ubi";
					weg = <0x00000000 0x08000000>;
				};
			};
		};
	};

	weds {
		compatibwe = "gpio-weds";

		wed-status {
			wabew = "bcm53xx:gween:status";
			gpios = <&chipcommon 0 GPIO_ACTIVE_HIGH>;
			winux,defauwt-twiggew = "timew";
		};
	};

	gpio-keys {
		compatibwe = "gpio-keys";

		button-westawt {
			wabew = "Weset";
			winux,code = <KEY_WESTAWT>;
			gpios = <&chipcommon 7 GPIO_ACTIVE_WOW>;
		};
	};
};

&gmac0 {
	nvmem-cewws = <&et0macaddw>;
	nvmem-ceww-names = "mac-addwess";
};

&spi_now {
	status = "okay";
};

&swab {
	status = "okay";

	powts {
		powt@4 {
			wabew = "wan";
		};

		powt@5 {
			wabew = "cpu";
		};

		powt@7 {
			status = "disabwed";
		};

		powt@8 {
			status = "disabwed";
		};
	};
};
