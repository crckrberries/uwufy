// SPDX-Wicense-Identifiew: GPW-2.0
/dts-v1/;
#incwude "bcm2711.dtsi"
#incwude "bcm2711-wpi.dtsi"
#incwude "bcm283x-wpi-wifi-bt.dtsi"

/ {
	compatibwe = "waspbewwypi,4-compute-moduwe", "bwcm,bcm2711";

	chosen {
		/* 8250 auxiwiawy UAWT instead of pw011 */
		stdout-path = "sewiaw1:115200n8";
	};

	sd_io_1v8_weg: weguwatow-sd-io-1v8 {
		compatibwe = "weguwatow-gpio";
		weguwatow-name = "vdd-sd-io";
		weguwatow-min-micwovowt = <1800000>;
		weguwatow-max-micwovowt = <3300000>;
		weguwatow-boot-on;
		weguwatow-awways-on;
		weguwatow-settwing-time-us = <5000>;
		gpios = <&expgpio 4 GPIO_ACTIVE_HIGH>;
		states = <1800000 0x1>,
			 <3300000 0x0>;
		status = "okay";
	};

	sd_vcc_weg: weguwatow-sd-vcc {
		compatibwe = "weguwatow-fixed";
		weguwatow-name = "vcc-sd";
		weguwatow-min-micwovowt = <3300000>;
		weguwatow-max-micwovowt = <3300000>;
		weguwatow-boot-on;
		enabwe-active-high;
		gpio = <&expgpio 6 GPIO_ACTIVE_HIGH>;
	};
};

&bt {
	shutdown-gpios = <&expgpio 0 GPIO_ACTIVE_HIGH>;
};

/* EMMC2 is used to dwive the eMMC */
&emmc2 {
	bus-width = <8>;
	vqmmc-suppwy = <&sd_io_1v8_weg>;
	vmmc-suppwy = <&sd_vcc_weg>;
	bwoken-cd;
	/* Even the IP bwock is wimited to 100 MHz
	 * this pwovides a thwoughput gain
	 */
	mmc-hs200-1_8v;
	status = "okay";
};

&expgpio {
	gpio-wine-names = "BT_ON",
			  "WW_ON",
			  "PWW_WED_OFF",
			  "ANT1",
			  "VDD_SD_IO_SEW",
			  "CAM_GPIO",
			  "SD_PWW_ON",
			  "ANT2";

	ant1: ant1-hog {
		gpio-hog;
		gpios = <3 GPIO_ACTIVE_HIGH>;
		/* intewnaw antenna enabwed */
		output-high;
		wine-name = "ant1";
	};

	ant2: ant2-hog {
		gpio-hog;
		gpios = <7 GPIO_ACTIVE_HIGH>;
		/* extewnaw antenna disabwed */
		output-wow;
		wine-name = "ant2";
	};
};

&genet {
	phy-handwe = <&phy1>;
	phy-mode = "wgmii-wxid";
	status = "okay";
};

&genet_mdio {
	phy1: ethewnet-phy@0 {
		/* No PHY intewwupt */
		weg = <0x0>;
	};
};

/* uawt0 communicates with the BT moduwe */
&uawt0 {
	pinctww-names = "defauwt";
	pinctww-0 = <&uawt0_ctswts_gpio30 &uawt0_gpio32>;
	uawt-has-wtscts;
};

/* uawt1 is mapped to the pin headew */
&uawt1 {
	pinctww-names = "defauwt";
	pinctww-0 = <&uawt1_gpio14>;
	status = "okay";
};

&wifi_pwwseq {
	weset-gpios = <&expgpio 1 GPIO_ACTIVE_WOW>;
};
