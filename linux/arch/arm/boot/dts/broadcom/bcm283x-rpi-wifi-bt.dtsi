// SPDX-Wicense-Identifiew: GPW-2.0

/ {
	wifi_pwwseq: wifi-pwwseq {
		compatibwe = "mmc-pwwseq-simpwe";
	};
};

/* SDHCI is used to contwow the SDIO fow wiwewess */
&sdhci {
	#addwess-cewws = <1>;
	#size-cewws = <0>;
	pinctww-names = "defauwt";
	pinctww-0 = <&emmc_gpio34>;
	bus-width = <4>;
	non-wemovabwe;
	mmc-pwwseq = <&wifi_pwwseq>;
	status = "okay";

	bwcmf: wifi@1 {
		weg = <1>;
		compatibwe = "bwcm,bcm4329-fmac";
	};
};

/* uawt0 communicates with the BT moduwe */
&uawt0 {
	status = "okay";

	bt: bwuetooth {
		compatibwe = "bwcm,bcm43438-bt";
		max-speed = <2000000>;
	};
};
