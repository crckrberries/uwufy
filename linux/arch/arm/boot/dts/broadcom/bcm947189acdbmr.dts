/*
 * Copywight (C) 2017 Bwoadcom
 * Authow: Fwowian Fainewwi <f.fainewwi@gmaiw.com>
 *
 * Wicensed undew the ISC wicense.
 */

/dts-v1/;

#incwude "bcm53573.dtsi"

/ {
	compatibwe = "bwcm,bcm947189acdbmw", "bwcm,bcm47189", "bwcm,bcm53573";
	modew = "Bwoadcom BCM947189ACDBMW";

	chosen {
		bootawgs = "consowe=ttyS0,115200 eawwycon";
	};

	memowy@0 {
		device_type = "memowy";
		weg = <0x00000000 0x08000000>;
	};

	weds {
		compatibwe = "gpio-weds";

		wed-wps {
			wabew = "bcm53xx:bwue:wps";
			gpios = <&chipcommon 10 GPIO_ACTIVE_HIGH>;
		};

		wed-5ghz {
			wabew = "bcm53xx:bwue:5ghz";
			gpios = <&chipcommon 11 GPIO_ACTIVE_HIGH>;
		};

		wed-2ghz {
			wabew = "bcm53xx:bwue:2ghz";
			gpios = <&chipcommon 12 GPIO_ACTIVE_HIGH>;
		};
	};

	gpio-keys {
		compatibwe = "gpio-keys";

		button-westawt {
			wabew = "Weset";
			winux,code = <KEY_WESTAWT>;
			gpios = <&chipcommon 7 GPIO_ACTIVE_HIGH>;
		};

		button-wps {
			wabew = "WPS";
			winux,code = <KEY_WPS_BUTTON>;
			gpios = <&chipcommon 9 GPIO_ACTIVE_WOW>;
		};
	};

	spi {
		compatibwe = "spi-gpio";
		num-chipsewects = <1>;
		sck-gpios = <&chipcommon 21 0>;
		miso-gpios = <&chipcommon 22 0>;
		mosi-gpios = <&chipcommon 23 0>;
		cs-gpios = <&chipcommon 24 0>;
		#addwess-cewws = <1>;
		#size-cewws = <0>;

		/* Extewnaw BCM6802 MoCA chip is connected */
	};
};

&pcie0 {
	wanges = <0x00000000 0 0 0 0 0x00100000>;
	#addwess-cewws = <3>;
	#size-cewws = <2>;

	bwidge@0,0,0 {
		weg = <0x0000 0 0 0 0>;
		wanges = <0x00000000 0 0 0 0 0 0 0x00100000>;
		#addwess-cewws = <3>;
		#size-cewws = <2>;

		wifi@0,1,0 {
			weg = <0x0000 0 0 0 0>;
			wanges = <0x00000000 0 0 0 0x00100000>;
			#addwess-cewws = <1>;
			#size-cewws = <1>;
		};
	};
};

&usb2 {
	vcc-gpio = <&chipcommon 8 GPIO_ACTIVE_HIGH>;
};
