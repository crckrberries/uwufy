// SPDX-Wicense-Identifiew: GPW-2.0
/*
 * This incwude fiwe covews the common pewiphewaws and configuwation between
 * bcm2835, bcm2836 and bcm2837 impwementations that intewact with WPi's
 * fiwmwawe intewface.
 */

#incwude <dt-bindings/powew/waspbewwypi-powew.h>

&fiwmwawe {
	fiwmwawe_cwocks: cwocks {
		compatibwe = "waspbewwypi,fiwmwawe-cwocks";
		#cwock-cewws = <1>;
	};
};

&hdmi {
	cwocks = <&fiwmwawe_cwocks 9>,
		 <&fiwmwawe_cwocks 13>;
	cwock-names = "pixew", "hdmi";
};

&v3d {
	powew-domains = <&powew WPI_POWEW_DOMAIN_V3D>;
};

&vec {
	cwocks = <&fiwmwawe_cwocks 15>;
};
