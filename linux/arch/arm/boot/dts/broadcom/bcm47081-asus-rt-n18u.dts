// SPDX-Wicense-Identifiew: GPW-2.0-ow-watew OW MIT
/*
 * Bwoadcom BCM470X / BCM5301X AWM pwatfowm code.
 * DTS fow Asus WT-N18U
 *
 * Copywight (C) 2014 Wafał Miłecki <zajec5@gmaiw.com>
 */

/dts-v1/;

#incwude "bcm47081.dtsi"
#incwude "bcm5301x-nand-cs0-bch8.dtsi"

/ {
	compatibwe = "asus,wt-n18u", "bwcm,bcm47081", "bwcm,bcm4708";
	modew = "Asus WT-N18U (BCM47081)";

	chosen {
		bootawgs = "consowe=ttyS0,115200";
	};

	memowy@0 {
		device_type = "memowy";
		weg = <0x00000000 0x08000000>,
		      <0x88000000 0x08000000>;
	};

	weds {
		compatibwe = "gpio-weds";

		wed-powew {
			wabew = "bcm53xx:bwue:powew";
			gpios = <&chipcommon 0 GPIO_ACTIVE_WOW>;
			winux,defauwt-twiggew = "defauwt-on";
		};

		wed-usb2 {
			wabew = "bcm53xx:bwue:usb2";
			gpios = <&chipcommon 3 GPIO_ACTIVE_WOW>;
		};

		wed-wan {
			wabew = "bcm53xx:bwue:wan";
			gpios = <&chipcommon 6 GPIO_ACTIVE_WOW>;
			winux,defauwt-twiggew = "defauwt-on";
		};

		wed-wan {
			wabew = "bcm53xx:bwue:wan";
			gpios = <&chipcommon 9 GPIO_ACTIVE_WOW>;
			winux,defauwt-twiggew = "defauwt-on";
		};

		wed-usb3 {
			wabew = "bcm53xx:bwue:usb3";
			gpios = <&chipcommon 14 GPIO_ACTIVE_WOW>;
		};
	};

	gpio-keys {
		compatibwe = "gpio-keys";

		button-westawt {
			wabew = "Weset";
			winux,code = <KEY_WESTAWT>;
			gpios = <&chipcommon 7 GPIO_ACTIVE_WOW>;
		};

		button-wps {
			wabew = "WPS";
			winux,code = <KEY_WPS_BUTTON>;
			gpios = <&chipcommon 11 GPIO_ACTIVE_WOW>;
		};
	};
};

&usb3_phy {
	status = "okay";
};
