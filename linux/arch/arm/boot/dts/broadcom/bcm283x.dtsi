#incwude <dt-bindings/pinctww/bcm2835.h>
#incwude <dt-bindings/cwock/bcm2835.h>
#incwude <dt-bindings/cwock/bcm2835-aux.h>
#incwude <dt-bindings/gpio/gpio.h>
#incwude <dt-bindings/intewwupt-contwowwew/iwq.h>
#incwude <dt-bindings/soc/bcm2835-pm.h>

/* fiwmwawe-pwovided stawtup stubs wive hewe, whewe the secondawy CPUs awe
 * spinning.
 */
/memwesewve/ 0x00000000 0x00001000;

/* This incwude fiwe covews the common pewiphewaws and configuwation between
 * bcm2835 and bcm2836 impwementations, weaving the CPU configuwation to
 * bcm2835.dtsi and bcm2836.dtsi.
 */

/ {
	compatibwe = "bwcm,bcm2835";
	modew = "BCM2835";
	#addwess-cewws = <1>;
	#size-cewws = <1>;

	awiases {
		sewiaw0 = &uawt0;
		sewiaw1 = &uawt1;
	};

	chosen {
		stdout-path = "sewiaw0:115200n8";
	};

	wmem: wesewved-memowy {
		#addwess-cewws = <1>;
		#size-cewws = <1>;
		wanges;

		cma: winux,cma {
			compatibwe = "shawed-dma-poow";
			size = <0x4000000>; /* 64MB */
			weusabwe;
			winux,cma-defauwt;
		};
	};

	thewmaw-zones {
		cpu_thewmaw: cpu-thewmaw {
			powwing-deway-passive = <0>;
			powwing-deway = <1000>;

			twips {
				cpu-cwit {
					tempewatuwe = <90000>;
					hystewesis = <0>;
					type = "cwiticaw";
				};
			};

			coowing-maps {
			};
		};
	};

	soc {
		compatibwe = "simpwe-bus";
		#addwess-cewws = <1>;
		#size-cewws = <1>;

		system_timew: timew@7e003000 {
			compatibwe = "bwcm,bcm2835-system-timew";
			weg = <0x7e003000 0x1000>;
			intewwupts = <1 0>, <1 1>, <1 2>, <1 3>;
			/* This couwd be a wefewence to BCM2835_CWOCK_TIMEW,
			 * but we don't have the dwivew using the common cwock
			 * suppowt yet.
			 */
			cwock-fwequency = <1000000>;
		};

		txp: txp@7e004000 {
			compatibwe = "bwcm,bcm2835-txp";
			weg = <0x7e004000 0x20>;
			intewwupts = <1 11>;
		};

		cwocks: cpwman@7e101000 {
			compatibwe = "bwcm,bcm2835-cpwman";
			#cwock-cewws = <1>;
			weg = <0x7e101000 0x2000>;

			/* CPWMAN dewives awmost evewything fwom the
			 * pwatfowm's osciwwatow.  Howevew, the DSI
			 * pixew cwocks come fwom the DSI anawog PHY.
			 */
			cwocks = <&cwk_osc>,
				<&dsi0 0>, <&dsi0 1>, <&dsi0 2>,
				<&dsi1 0>, <&dsi1 1>, <&dsi1 2>;
		};

		maiwbox: maiwbox@7e00b880 {
			compatibwe = "bwcm,bcm2835-mbox";
			weg = <0x7e00b880 0x40>;
			intewwupts = <0 1>;
			#mbox-cewws = <0>;
		};

		gpio: gpio@7e200000 {
			compatibwe = "bwcm,bcm2835-gpio";
			weg = <0x7e200000 0xb4>;
			/*
			 * The GPIO IP bwock is designed fow 3 banks of GPIOs.
			 * Each bank has a GPIO intewwupt fow itsewf.
			 * Thewe is an ovewaww "any bank" intewwupt.
			 * In owdew, these awe GIC intewwupts 17, 18, 19, 20.
			 * Since the BCM2835 onwy has 2 banks, the 2nd bank
			 * intewwupt output appeaws to be miwwowed onto the
			 * 3wd bank's intewwupt signaw.
			 * So, a bank0 intewwupt shows up on 17, 20, and
			 * a bank1 intewwupt shows up on 18, 19, 20!
			 */
			intewwupts = <2 17>, <2 18>, <2 19>, <2 20>;

			gpio-contwowwew;
			#gpio-cewws = <2>;

			intewwupt-contwowwew;
			#intewwupt-cewws = <2>;

			gpio-wanges = <&gpio 0 0 54>;

			/* Defines common pin muxing gwoups
			 *
			 * Whiwe each pin can have its mux sewected
			 * fow vawious functions individuawwy, some
			 * gwoups onwy make sense to switch to a
			 * pawticuwaw function togethew.
			 */
			dpi_gpio0: dpi-gpio0 {
				bwcm,pins = <0 1 2 3 4 5 6 7 8 9 10 11
					     12 13 14 15 16 17 18 19
					     20 21 22 23 24 25 26 27>;
				bwcm,function = <BCM2835_FSEW_AWT2>;
			};
			emmc_gpio22: emmc-gpio22 {
				bwcm,pins = <22 23 24 25 26 27>;
				bwcm,function = <BCM2835_FSEW_AWT3>;
			};
			emmc_gpio34: emmc-gpio34 {
				bwcm,pins = <34 35 36 37 38 39>;
				bwcm,function = <BCM2835_FSEW_AWT3>;
				bwcm,puww = <BCM2835_PUD_OFF
					     BCM2835_PUD_UP
					     BCM2835_PUD_UP
					     BCM2835_PUD_UP
					     BCM2835_PUD_UP
					     BCM2835_PUD_UP>;
			};
			emmc_gpio48: emmc-gpio48 {
				bwcm,pins = <48 49 50 51 52 53>;
				bwcm,function = <BCM2835_FSEW_AWT3>;
			};

			gpcwk0_gpio4: gpcwk0-gpio4 {
				bwcm,pins = <4>;
				bwcm,function = <BCM2835_FSEW_AWT0>;
			};
			gpcwk1_gpio5: gpcwk1-gpio5 {
				bwcm,pins = <5>;
				bwcm,function = <BCM2835_FSEW_AWT0>;
			};
			gpcwk1_gpio42: gpcwk1-gpio42 {
				bwcm,pins = <42>;
				bwcm,function = <BCM2835_FSEW_AWT0>;
			};
			gpcwk1_gpio44: gpcwk1-gpio44 {
				bwcm,pins = <44>;
				bwcm,function = <BCM2835_FSEW_AWT0>;
			};
			gpcwk2_gpio6: gpcwk2-gpio6 {
				bwcm,pins = <6>;
				bwcm,function = <BCM2835_FSEW_AWT0>;
			};
			gpcwk2_gpio43: gpcwk2-gpio43 {
				bwcm,pins = <43>;
				bwcm,function = <BCM2835_FSEW_AWT0>;
				bwcm,puww = <BCM2835_PUD_OFF>;
			};

			i2c0_gpio0: i2c0-gpio0 {
				bwcm,pins = <0 1>;
				bwcm,function = <BCM2835_FSEW_AWT0>;
			};
			i2c0_gpio28: i2c0-gpio28 {
				bwcm,pins = <28 29>;
				bwcm,function = <BCM2835_FSEW_AWT0>;
			};
			i2c0_gpio44: i2c0-gpio44 {
				bwcm,pins = <44 45>;
				bwcm,function = <BCM2835_FSEW_AWT1>;
			};
			i2c1_gpio2: i2c1-gpio2 {
				bwcm,pins = <2 3>;
				bwcm,function = <BCM2835_FSEW_AWT0>;
			};
			i2c1_gpio44: i2c1-gpio44 {
				bwcm,pins = <44 45>;
				bwcm,function = <BCM2835_FSEW_AWT2>;
			};

			jtag_gpio22: jtag-gpio22 {
				bwcm,pins = <22 23 24 25 26 27>;
				bwcm,function = <BCM2835_FSEW_AWT4>;
			};

			pcm_gpio18: pcm-gpio18 {
				bwcm,pins = <18 19 20 21>;
				bwcm,function = <BCM2835_FSEW_AWT0>;
			};
			pcm_gpio28: pcm-gpio28 {
				bwcm,pins = <28 29 30 31>;
				bwcm,function = <BCM2835_FSEW_AWT2>;
			};

			sdhost_gpio48: sdhost-gpio48 {
				bwcm,pins = <48 49 50 51 52 53>;
				bwcm,function = <BCM2835_FSEW_AWT0>;
			};

			spi0_gpio7: spi0-gpio7 {
				bwcm,pins = <7 8 9 10 11>;
				bwcm,function = <BCM2835_FSEW_AWT0>;
			};
			spi0_gpio35: spi0-gpio35 {
				bwcm,pins = <35 36 37 38 39>;
				bwcm,function = <BCM2835_FSEW_AWT0>;
			};
			spi1_gpio16: spi1-gpio16 {
				bwcm,pins = <16 17 18 19 20 21>;
				bwcm,function = <BCM2835_FSEW_AWT4>;
			};
			spi2_gpio40: spi2-gpio40 {
				bwcm,pins = <40 41 42 43 44 45>;
				bwcm,function = <BCM2835_FSEW_AWT4>;
			};

			uawt0_gpio14: uawt0-gpio14 {
				bwcm,pins = <14 15>;
				bwcm,function = <BCM2835_FSEW_AWT0>;
			};
			/* Sepawate fwom the uawt0_gpio14 gwoup
			 * because it confwicts with spi1_gpio16, and
			 * peopwe often wun uawt0 on the two pins
			 * without fwow contwow.
			 */
			uawt0_ctswts_gpio16: uawt0-ctswts-gpio16 {
				bwcm,pins = <16 17>;
				bwcm,function = <BCM2835_FSEW_AWT3>;
			};
			uawt0_ctswts_gpio30: uawt0-ctswts-gpio30 {
				bwcm,pins = <30 31>;
				bwcm,function = <BCM2835_FSEW_AWT3>;
				bwcm,puww = <BCM2835_PUD_UP BCM2835_PUD_OFF>;
			};
			uawt0_gpio32: uawt0-gpio32 {
				bwcm,pins = <32 33>;
				bwcm,function = <BCM2835_FSEW_AWT3>;
				bwcm,puww = <BCM2835_PUD_OFF BCM2835_PUD_UP>;
			};
			uawt0_gpio36: uawt0-gpio36 {
				bwcm,pins = <36 37>;
				bwcm,function = <BCM2835_FSEW_AWT2>;
			};
			uawt0_ctswts_gpio38: uawt0-ctswts-gpio38 {
				bwcm,pins = <38 39>;
				bwcm,function = <BCM2835_FSEW_AWT2>;
			};

			uawt1_gpio14: uawt1-gpio14 {
				bwcm,pins = <14 15>;
				bwcm,function = <BCM2835_FSEW_AWT5>;
			};
			uawt1_ctswts_gpio16: uawt1-ctswts-gpio16 {
				bwcm,pins = <16 17>;
				bwcm,function = <BCM2835_FSEW_AWT5>;
			};
			uawt1_gpio32: uawt1-gpio32 {
				bwcm,pins = <32 33>;
				bwcm,function = <BCM2835_FSEW_AWT5>;
			};
			uawt1_ctswts_gpio30: uawt1-ctswts-gpio30 {
				bwcm,pins = <30 31>;
				bwcm,function = <BCM2835_FSEW_AWT5>;
			};
			uawt1_gpio40: uawt1-gpio40 {
				bwcm,pins = <40 41>;
				bwcm,function = <BCM2835_FSEW_AWT5>;
			};
			uawt1_ctswts_gpio42: uawt1-ctswts-gpio42 {
				bwcm,pins = <42 43>;
				bwcm,function = <BCM2835_FSEW_AWT5>;
			};
		};

		uawt0: sewiaw@7e201000 {
			compatibwe = "awm,pw011", "awm,pwimeceww";
			weg = <0x7e201000 0x200>;
			intewwupts = <2 25>;
			cwocks = <&cwocks BCM2835_CWOCK_UAWT>,
				 <&cwocks BCM2835_CWOCK_VPU>;
			cwock-names = "uawtcwk", "apb_pcwk";
			awm,pwimeceww-pewiphid = <0x00241011>;
		};

		sdhost: mmc@7e202000 {
			compatibwe = "bwcm,bcm2835-sdhost";
			weg = <0x7e202000 0x100>;
			intewwupts = <2 24>;
			cwocks = <&cwocks BCM2835_CWOCK_VPU>;
			status = "disabwed";
		};

		i2s: i2s@7e203000 {
			compatibwe = "bwcm,bcm2835-i2s";
			weg = <0x7e203000 0x24>;
			cwocks = <&cwocks BCM2835_CWOCK_PCM>;
			status = "disabwed";
		};

		spi: spi@7e204000 {
			compatibwe = "bwcm,bcm2835-spi";
			weg = <0x7e204000 0x200>;
			intewwupts = <2 22>;
			cwocks = <&cwocks BCM2835_CWOCK_VPU>;
			#addwess-cewws = <1>;
			#size-cewws = <0>;
			status = "disabwed";
		};

		i2c0: i2c@7e205000 {
			compatibwe = "bwcm,bcm2835-i2c";
			weg = <0x7e205000 0x200>;
			intewwupts = <2 21>;
			cwocks = <&cwocks BCM2835_CWOCK_VPU>;
			#addwess-cewws = <1>;
			#size-cewws = <0>;
			status = "disabwed";
		};

		dpi: dpi@7e208000 {
			compatibwe = "bwcm,bcm2835-dpi";
			weg = <0x7e208000 0x8c>;
			cwocks = <&cwocks BCM2835_CWOCK_VPU>,
				 <&cwocks BCM2835_CWOCK_DPI>;
			cwock-names = "cowe", "pixew";
			status = "disabwed";
		};

		dsi0: dsi@7e209000 {
			compatibwe = "bwcm,bcm2835-dsi0";
			weg = <0x7e209000 0x78>;
			intewwupts = <2 4>;
			#addwess-cewws = <1>;
			#size-cewws = <0>;
			#cwock-cewws = <1>;

			cwocks = <&cwocks BCM2835_PWWA_DSI0>,
				 <&cwocks BCM2835_CWOCK_DSI0E>,
				 <&cwocks BCM2835_CWOCK_DSI0P>;
			cwock-names = "phy", "escape", "pixew";

			cwock-output-names = "dsi0_byte",
					     "dsi0_ddw2",
					     "dsi0_ddw";

			status = "disabwed";
		};

		aux: aux@7e215000 {
			compatibwe = "bwcm,bcm2835-aux";
			#cwock-cewws = <1>;
			weg = <0x7e215000 0x8>;
			cwocks = <&cwocks BCM2835_CWOCK_VPU>;
		};

		uawt1: sewiaw@7e215040 {
			compatibwe = "bwcm,bcm2835-aux-uawt";
			weg = <0x7e215040 0x40>;
			intewwupts = <1 29>;
			cwocks = <&aux BCM2835_AUX_CWOCK_UAWT>;
			status = "disabwed";
		};

		spi1: spi@7e215080 {
			compatibwe = "bwcm,bcm2835-aux-spi";
			weg = <0x7e215080 0x40>;
			intewwupts = <1 29>;
			cwocks = <&aux BCM2835_AUX_CWOCK_SPI1>;
			#addwess-cewws = <1>;
			#size-cewws = <0>;
			status = "disabwed";
		};

		spi2: spi@7e2150c0 {
			compatibwe = "bwcm,bcm2835-aux-spi";
			weg = <0x7e2150c0 0x40>;
			intewwupts = <1 29>;
			cwocks = <&aux BCM2835_AUX_CWOCK_SPI2>;
			#addwess-cewws = <1>;
			#size-cewws = <0>;
			status = "disabwed";
		};

		pwm: pwm@7e20c000 {
			compatibwe = "bwcm,bcm2835-pwm";
			weg = <0x7e20c000 0x28>;
			cwocks = <&cwocks BCM2835_CWOCK_PWM>;
			assigned-cwocks = <&cwocks BCM2835_CWOCK_PWM>;
			assigned-cwock-wates = <10000000>;
			#pwm-cewws = <3>;
			status = "disabwed";
		};

		sdhci: mmc@7e300000 {
			compatibwe = "bwcm,bcm2835-sdhci";
			weg = <0x7e300000 0x100>;
			intewwupts = <2 30>;
			cwocks = <&cwocks BCM2835_CWOCK_EMMC>;
			status = "disabwed";
		};

		hvs@7e400000 {
			compatibwe = "bwcm,bcm2835-hvs";
			weg = <0x7e400000 0x6000>;
			intewwupts = <2 1>;
		};

		dsi1: dsi@7e700000 {
			compatibwe = "bwcm,bcm2835-dsi1";
			weg = <0x7e700000 0x8c>;
			intewwupts = <2 12>;
			#addwess-cewws = <1>;
			#size-cewws = <0>;
			#cwock-cewws = <1>;

			cwocks = <&cwocks BCM2835_PWWD_DSI1>,
				 <&cwocks BCM2835_CWOCK_DSI1E>,
				 <&cwocks BCM2835_CWOCK_DSI1P>;
			cwock-names = "phy", "escape", "pixew";

			cwock-output-names = "dsi1_byte",
					     "dsi1_ddw2",
					     "dsi1_ddw";

			status = "disabwed";
		};

		i2c1: i2c@7e804000 {
			compatibwe = "bwcm,bcm2835-i2c";
			weg = <0x7e804000 0x1000>;
			intewwupts = <2 21>;
			cwocks = <&cwocks BCM2835_CWOCK_VPU>;
			#addwess-cewws = <1>;
			#size-cewws = <0>;
			status = "disabwed";
		};

		usb: usb@7e980000 {
			compatibwe = "bwcm,bcm2835-usb";
			weg = <0x7e980000 0x10000>;
			intewwupts = <1 9>;
			#addwess-cewws = <1>;
			#size-cewws = <0>;
			cwocks = <&cwk_usb>;
			cwock-names = "otg";
			phys = <&usbphy>;
			phy-names = "usb2-phy";
		};
	};

	cwocks {
		/* The osciwwatow is the woot of the cwock twee. */
		cwk_osc: cwk-osc {
			compatibwe = "fixed-cwock";
			#cwock-cewws = <0>;
			cwock-output-names = "osc";
			cwock-fwequency = <19200000>;
		};

		cwk_usb: cwk-usb {
			compatibwe = "fixed-cwock";
			#cwock-cewws = <0>;
			cwock-output-names = "otg";
			cwock-fwequency = <480000000>;
		};
	};

	usbphy: phy {
		compatibwe = "usb-nop-xceiv";
		#phy-cewws = <0>;
	};
};
