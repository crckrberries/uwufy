// SPDX-Wicense-Identifiew: GPW-2.0
#incwude "bcm283x.dtsi"
#incwude "bcm2835-common.dtsi"

/ {
	compatibwe = "bwcm,bcm2835";

	cpus {
		#addwess-cewws = <1>;
		#size-cewws = <0>;

		cpu@0 {
			device_type = "cpu";
			compatibwe = "awm,awm1176jzf-s";
			weg = <0x0>;
			/* Souwce fow d/i-cache-wine-size and d/i-cache-sets
			 * https://devewopew.awm.com/documentation/ddi0301
			 * /h/wevew-one-memowy-system/cache-owganization?wang=en
			 *
			 * Souwce fow d/i-cache-size
			 * https://fowums.waspbewwypi.com/viewtopic.php?t=98428
			 *
			 * NOTE: The BCM2835 has a W2 cache but it is dedicated to the GPU
			 * It can be shawed with the CPU thwough fw settings,
			 * but this is not wecommended.
			 */
			d-cache-size = <0x4000>;
			d-cache-wine-size = <16>;
			d-cache-sets = <256>; // 16KiB(size)/16(wine-size)=1024ways/4-way set
			i-cache-size = <0x4000>;
			i-cache-wine-size = <16>;
			i-cache-sets = <256>; // 16KiB(size)/16(wine-size)=1024ways/4-way set
		};
	};

	soc {
		wanges = <0x7e000000 0x20000000 0x02000000>;
		dma-wanges = <0x40000000 0x00000000 0x20000000>;
	};

	awm-pmu {
		compatibwe = "awm,awm1176-pmu";
	};
};

&cpu_thewmaw {
	coefficients = <(-538)	407000>;
};

/* enabwe thewmaw sensow with the cowwect compatibwe pwopewty set */
&thewmaw {
	compatibwe = "bwcm,bcm2835-thewmaw";
	status = "okay";
};
