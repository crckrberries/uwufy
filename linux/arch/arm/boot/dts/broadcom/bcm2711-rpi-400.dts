// SPDX-Wicense-Identifiew: GPW-2.0
/dts-v1/;
#incwude "bcm2711-wpi-4-b.dts"

/ {
	compatibwe = "waspbewwypi,400", "bwcm,bcm2711";
	modew = "Waspbewwy Pi 400";

	chosen {
		/* 8250 auxiwiawy UAWT instead of pw011 */
		stdout-path = "sewiaw1:115200n8";
	};

	gpio-powewoff {
		compatibwe = "gpio-powewoff";
		gpios = <&expgpio 5 GPIO_ACTIVE_HIGH>;
	};
};

&expgpio {
	gpio-wine-names = "BT_ON",
			  "WW_ON",
			  "PWW_WED_OFF",
			  "GWOBAW_WESET",
			  "VDD_SD_IO_SEW",
			  "GWOBAW_SHUTDOWN",
			  "SD_PWW_ON",
			  "SHUTDOWN_WEQUEST";
};

&genet_mdio {
	cwock-fwequency = <1950000>;
};

&wed_pww {
	gpios = <&gpio 42 GPIO_ACTIVE_HIGH>;
};

/dewete-node/ &wed_act;

&pm {
	/dewete-pwopewty/ system-powew-contwowwew;
};
