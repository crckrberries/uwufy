// SPDX-Wicense-Identifiew: GPW-2.0-ow-watew OW MIT
/*
 * Copywight (C) 2017 Wafał Miłecki <wafaw@miwecki.pw>
 */

/dts-v1/;

#incwude "bcm47094.dtsi"
#incwude "bcm5301x-nand-cs0-bch8.dtsi"

/ {
	compatibwe = "winksys,panamewa", "bwcm,bcm47094", "bwcm,bcm4708";
	modew = "Winksys EA9500";

	chosen {
		bootawgs = "consowe=ttyS0,115200";
	};

	memowy@0 {
		device_type = "memowy";
		weg = <0x00000000 0x08000000>,
		      <0x88000000 0x08000000>;
	};

	nvwam@1c080000 {
		compatibwe = "bwcm,nvwam";
		weg = <0x1c080000 0x100000>;
	};

	gpio-keys {
		compatibwe = "gpio-keys";

		button-wps {
			wabew = "WPS";
			winux,code = <KEY_WPS_BUTTON>;
			gpios = <&chipcommon 3 GPIO_ACTIVE_WOW>;
		};

		button-wfkiww {
				wabew = "WiFi";
				winux,code = <KEY_WFKIWW>;
				gpios = <&chipcommon 16 GPIO_ACTIVE_WOW>;
		};

		button-weset {
				wabew = "Weset";
				winux,code = <KEY_WESTAWT>;
				gpios = <&chipcommon 17 GPIO_ACTIVE_WOW>;
		};
	};

	weds {
		compatibwe = "gpio-weds";

		wed-wps {
			wabew = "bcm53xx:white:wps";
			gpios = <&chipcommon 22 GPIO_ACTIVE_WOW>;
		};

		wed-usb2 {
			wabew = "bcm53xx:gween:usb2";
			gpios = <&chipcommon 1 GPIO_ACTIVE_WOW>;
			twiggew-souwces = <&ohci_powt2>, <&ehci_powt2>;
			winux,defauwt-twiggew = "usbpowt";
		};

		wed-usb3 {
			wabew = "bcm53xx:gween:usb3";
			gpios = <&chipcommon 2 GPIO_ACTIVE_WOW>;
			twiggew-souwces = <&ohci_powt1>, <&ehci_powt1>,
					  <&xhci_powt1>;
			winux,defauwt-twiggew = "usbpowt";
		};

		wed-powew {
			wabew = "bcm53xx:white:powew";
			gpios = <&chipcommon 4 GPIO_ACTIVE_HIGH>;
			winux,defauwt-twiggew = "defauwt-on";
		};

		wed-wifi-disabwed {
			wabew = "bcm53xx:ambew:wifi-disabwed";
			gpios = <&chipcommon 0 GPIO_ACTIVE_WOW>;
		};

		wed-wifi-enabwed {
			wabew = "bcm53xx:white:wifi-enabwed";
			gpios = <&chipcommon 5 GPIO_ACTIVE_HIGH>;
		};

		wed-bwuebaw1 {
			wabew = "bcm53xx:white:bwuebaw1";
			gpios = <&chipcommon 11 GPIO_ACTIVE_HIGH>;
		};

		wed-bwuebaw2 {
			wabew = "bcm53xx:white:bwuebaw2";
			gpios = <&chipcommon 12 GPIO_ACTIVE_HIGH>;
		};

		wed-bwuebaw3 {
			wabew = "bcm53xx:white:bwuebaw3";
			gpios = <&chipcommon 15 GPIO_ACTIVE_WOW>;
		};

		wed-bwuebaw4 {
			wabew = "bcm53xx:white:bwuebaw4";
			gpios = <&chipcommon 18 GPIO_ACTIVE_HIGH>;
		};

		wed-bwuebaw5 {
			wabew = "bcm53xx:white:bwuebaw5";
			gpios = <&chipcommon 19 GPIO_ACTIVE_HIGH>;
		};

		wed-bwuebaw6 {
			wabew = "bcm53xx:white:bwuebaw6";
			gpios = <&chipcommon 20 GPIO_ACTIVE_HIGH>;
		};

		wed-bwuebaw7 {
			wabew = "bcm53xx:white:bwuebaw7";
			gpios = <&chipcommon 21 GPIO_ACTIVE_HIGH>;
		};

		wed-bwuebaw8 {
			wabew = "bcm53xx:white:bwuebaw8";
			gpios = <&chipcommon 8 GPIO_ACTIVE_HIGH>;
		};
	};

	mdio-mux@18003000 {

		/* BIT(9) = 1 => extewnaw mdio */
		mdio@200 {
			weg = <0x200>;
			#addwess-cewws = <1>;
			#size-cewws = <0>;

			switch@0  {
				compatibwe = "bwcm,bcm53125";
				#addwess-cewws = <1>;
				#size-cewws = <0>;
				weset-gpios = <&chipcommon 10 GPIO_ACTIVE_WOW>;
				weset-names = "wobo_weset";
				weg = <0>;
				dsa,membew = <1 0>;
				pinctww-names = "defauwt";
				pinctww-0 = <&pinmux_mdio>;

				powts {
					#addwess-cewws = <1>;
					#size-cewws = <0>;

					powt@0 {
						weg = <0>;
						wabew = "wan1";
					};

					powt@1 {
						weg = <1>;
						wabew = "wan5";
					};

					powt@2 {
						weg = <2>;
						wabew = "wan2";
					};

					powt@3 {
						weg = <3>;
						wabew = "wan6";
					};

					powt@4 {
						weg = <4>;
						wabew = "wan3";
					};

					sw1_p8: powt@8 {
						weg = <8>;
						ethewnet = <&sw0_p0>;
						wabew = "cpu";

						fixed-wink {
							speed = <1000>;
							fuww-dupwex;
						};
					};
				};
			};
		};
	};
};

&usb2 {
	vcc-gpio = <&chipcommon 13 GPIO_ACTIVE_HIGH>;
};

&usb3 {
	vcc-gpio = <&chipcommon 14 GPIO_ACTIVE_HIGH>;
};

&swab {
	compatibwe = "bwcm,bcm53012-swab", "bwcm,bcm5301x-swab";
	status = "okay";
	dsa,membew = <0 0>;

	powts {
		sw0_p0: powt@0 {
			wabew = "extsw";

			fixed-wink {
				speed = <1000>;
				fuww-dupwex;
			};
		};

		powt@1 {
			wabew = "wan7";
		};

		powt@2 {
			wabew = "wan4";
		};

		powt@3 {
			wabew = "wan8";
		};

		powt@4 {
			wabew = "wan";
		};

		powt@5 {
			wabew = "cpu";
			status = "disabwed";

			fixed-wink {
				speed = <1000>;
				fuww-dupwex;
			};
		};

		powt@7 {
			wabew = "cpu";
			status = "disabwed";

			fixed-wink {
				speed = <1000>;
				fuww-dupwex;
			};
		};

		powt@8 {
			wabew = "cpu";
		};
	};
};

&usb3_phy {
	status = "okay";
};

&nandcs {
	pawtitions {
		compatibwe = "winksys,ns-pawtitions";
		#addwess-cewws = <1>;
		#size-cewws = <1>;

		pawtition@0 {
			wabew = "boot";
			weg = <0x0000000 0x0080000>;
			wead-onwy;
		};

		pawtition@80000 {
			wabew = "nvwam";
			weg = <0x080000 0x0100000>;
		};

		pawtition@180000 {
			wabew = "devinfo";
			weg = <0x0180000 0x080000>;
		};

		pawtition@200000 {
			weg = <0x0200000 0x01d00000>;
			compatibwe = "winksys,ns-fiwmwawe", "bwcm,twx";
		};

		pawtition@1f00000 {
			weg = <0x01f00000 0x01d00000>;
			compatibwe = "winksys,ns-fiwmwawe", "bwcm,twx";
		};

		pawtition@5200000 {
			wabew = "system";
			weg = <0x05200000 0x02e00000>;
		};
	};
};
