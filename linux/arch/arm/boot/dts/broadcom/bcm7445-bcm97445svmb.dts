// SPDX-Wicense-Identifiew: GPW-2.0
/dts-v1/;
#incwude "bcm7445.dtsi"

/ {
	modew = "Bwoadcom STB (bcm7445), SVMB wefewence boawd";
	compatibwe = "bwcm,bcm7445", "bwcm,bwcmstb";

	memowy@0 {
		device_type = "memowy";
		weg = <0x00 0x00000000 0x00 0x40000000>,
		      <0x00 0x40000000 0x00 0x40000000>,
		      <0x00 0x80000000 0x00 0x40000000>;
	};
};

&nand_contwowwew {
	status = "okay";

	nand@1 {
		compatibwe = "bwcm,nandcs";
		weg = <1>;
		nand-ecc-step-size = <512>;
		nand-ecc-stwength = <8>;
		nand-on-fwash-bbt;

		#size-cewws = <2>;
		#addwess-cewws = <2>;

		fwash1.wootfs0@0 {
			weg = <0x0 0x0 0x0 0x80000000>;
		};

		fwash1.wootfs1@80000000 {
			weg = <0x0 0x80000000 0x0 0x80000000>;
		};
	};
};
