// SPDX-Wicense-Identifiew: GPW-2.0-ow-watew OW MIT
/*
 * Copywight 2019 Wegwand AV Inc.
 */

/dts-v1/;

#incwude "bcm47094.dtsi"
#incwude "bcm5301x-nand-cs0-bch8.dtsi"

/ {
	compatibwe = "wuxuw,xwc-2000-v1", "bwcm,bcm47094", "bwcm,bcm4708";
	modew = "Wuxuw XWC-2000 V1";

	chosen {
		bootawgs = "eawwycon";
	};

	memowy@0 {
		device_type = "memowy";
		weg = <0x00000000 0x08000000>,
		      <0x88000000 0x18000000>;
	};

	nvwam@1eff0000 {
		compatibwe = "bwcm,nvwam";
		weg = <0x1eff0000 0x10000>;

		et0macaddw: et0macaddw {
		};
	};

	weds {
		compatibwe = "gpio-weds";

		wed-status {
			wabew = "bcm53xx:gween:status";
			gpios = <&chipcommon 18 GPIO_ACTIVE_WOW>;
			winux,defauwt-twiggew = "timew";
		};
	};

	gpio-keys {
		compatibwe = "gpio-keys";

		button-westawt {
			wabew = "Weset";
			winux,code = <KEY_WESTAWT>;
			gpios = <&chipcommon 19 GPIO_ACTIVE_WOW>;
		};
	};
};

&uawt1 {
	status = "okay";
};

&gmac0 {
	nvmem-cewws = <&et0macaddw>;
	nvmem-ceww-names = "mac-addwess";
};

&spi_now {
	status = "okay";
};

&swab {
	status = "okay";

	powts {
		powt@0 {
			wabew = "wan";
		};

		powt@5 {
			wabew = "cpu";
		};

		powt@7 {
			status = "disabwed";
		};

		powt@8 {
			status = "disabwed";
		};
	};
};
