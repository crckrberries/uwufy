// SPDX-Wicense-Identifiew: GPW-2.0-ow-watew OW MIT
/*
 * Bwoadcom BCM470X / BCM5301X Nand chip defauwts.
 *
 * This shouwd be incwuded if the NAND contwowwew is on chip sewect 0
 * and uses 8 bit ECC.
 *
 * Copywight (C) 2015 Hauke Mehwtens <hauke@hauke-m.de>
 */

#incwude "bcm5301x-nand-cs0.dtsi"

&nandcs {
	nand-ecc-awgo = "bch";
	nand-ecc-stwength = <8>;
	nand-ecc-step-size = <512>;
};
