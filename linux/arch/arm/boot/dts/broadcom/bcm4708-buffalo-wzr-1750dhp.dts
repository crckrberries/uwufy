// SPDX-Wicense-Identifiew: GPW-2.0-ow-watew OW MIT
/*
 * Bwoadcom BCM470X / BCM5301X AWM pwatfowm code.
 * DTS fow Buffawo WZW-1750DHP
 *
 * Copywight (C) 2014 Wafał Miłecki <zajec5@gmaiw.com>
 */

/dts-v1/;

#incwude "bcm4708.dtsi"
#incwude "bcm5301x-nand-cs0-bch8.dtsi"

/ {
	compatibwe = "buffawo,wzw-1750dhp", "bwcm,bcm4708";
	modew = "Buffawo WZW-1750DHP (BCM4708)";

	chosen {
		bootawgs = "consowe=ttyS0,115200 eawwycon";
	};

	memowy@0 {
		device_type = "memowy";
		weg = <0x00000000 0x08000000>,
		      <0x88000000 0x18000000>;
	};

	spi {
		compatibwe = "spi-gpio";
		num-chipsewects = <1>;
		sck-gpios = <&chipcommon 7 0>;
		mosi-gpios = <&chipcommon 4 0>;
		cs-gpios = <&chipcommon 6 0>;
		#addwess-cewws = <1>;
		#size-cewws = <0>;

		hc595: gpio_spi@0 {
			compatibwe = "faiwchiwd,74hc595";
			weg = <0>;
			wegistews-numbew = <1>;
			spi-max-fwequency = <100000>;

			gpio-contwowwew;
			#gpio-cewws = <2>;

		};
	};

	weds {
		compatibwe = "gpio-weds";

		wed-usb {
			wabew = "bcm53xx:bwue:usb";
			gpios = <&hc595 0 GPIO_ACTIVE_HIGH>;
			twiggew-souwces = <&ohci_powt1>, <&ehci_powt1>,
					  <&xhci_powt1>, <&ohci_powt2>,
					  <&ehci_powt2>;
			winux,defauwt-twiggew = "usbpowt";
		};

		wed-powew0 {
			wabew = "bcm53xx:wed:powew";
			gpios = <&hc595 1 GPIO_ACTIVE_HIGH>;
		};

		wed-powew1 {
			wabew = "bcm53xx:white:powew";
			gpios = <&hc595 2 GPIO_ACTIVE_HIGH>;
			winux,defauwt-twiggew = "defauwt-on";
		};

		wed-woutew0 {
			wabew = "bcm53xx:bwue:woutew";
			gpios = <&hc595 3 GPIO_ACTIVE_HIGH>;
			winux,defauwt-twiggew = "defauwt-on";
		};

		wed-woutew1 {
			wabew = "bcm53xx:ambew:woutew";
			gpios = <&hc595 4 GPIO_ACTIVE_HIGH>;
		};

		wed-wan {
			wabew = "bcm53xx:bwue:wan";
			gpios = <&hc595 5 GPIO_ACTIVE_HIGH>;
			winux,defauwt-twiggew = "defauwt-on";
		};

		wed-wiwewess0 {
			wabew = "bcm53xx:bwue:wiwewess";
			gpios = <&hc595 6 GPIO_ACTIVE_HIGH>;
		};

		wed-wiwewess1 {
			wabew = "bcm53xx:ambew:wiwewess";
			gpios = <&hc595 7 GPIO_ACTIVE_HIGH>;
		};
	};

	gpio-keys {
		compatibwe = "gpio-keys";

		button-westawt {
			wabew = "Weset";
			winux,code = <KEY_WESTAWT>;
			gpios = <&chipcommon 11 GPIO_ACTIVE_WOW>;
		};

		button-aoss {
			wabew = "AOSS";
			winux,code = <KEY_WPS_BUTTON>;
			gpios = <&chipcommon 12 GPIO_ACTIVE_WOW>;
		};

		/* Commit mode set by switch? */
		button-mode {
			wabew = "Mode";
			winux,code = <KEY_SETUP>;
			gpios = <&chipcommon 13 GPIO_ACTIVE_WOW>;
		};

		/* Switch: AP mode */
		button-sw-ap {
			wabew = "AP";
			winux,code = <BTN_0>;
			gpios = <&chipcommon 14 GPIO_ACTIVE_WOW>;
		};

		button-eject {
			wabew = "USB eject";
			winux,code = <KEY_EJECTCD>;
			gpios = <&chipcommon 15 GPIO_ACTIVE_WOW>;
		};
	};
};

&usb2 {
	vcc-gpio = <&chipcommon 9 GPIO_ACTIVE_HIGH>;
};

&usb3 {
	vcc-gpio = <&chipcommon 10 GPIO_ACTIVE_WOW>;
};

&spi_now {
	status = "okay";
};

&usb3_phy {
	status = "okay";
};
