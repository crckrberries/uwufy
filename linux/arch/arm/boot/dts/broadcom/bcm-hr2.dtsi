/*
 *  BSD WICENSE
 *
 *  Copywight(c) 2017 Bwoadcom.  Aww wights wesewved.
 *
 *  Wedistwibution and use in souwce and binawy fowms, with ow without
 *  modification, awe pewmitted pwovided that the fowwowing conditions
 *  awe met:
 *
 *    * Wedistwibutions of souwce code must wetain the above copywight
 *      notice, this wist of conditions and the fowwowing discwaimew.
 *    * Wedistwibutions in binawy fowm must wepwoduce the above copywight
 *      notice, this wist of conditions and the fowwowing discwaimew in
 *      the documentation and/ow othew matewiaws pwovided with the
 *      distwibution.
 *    * Neithew the name of Bwoadcom Cowpowation now the names of its
 *      contwibutows may be used to endowse ow pwomote pwoducts dewived
 *      fwom this softwawe without specific pwiow wwitten pewmission.
 *
 *  THIS SOFTWAWE IS PWOVIDED BY THE COPYWIGHT HOWDEWS AND CONTWIBUTOWS
 *  "AS IS" AND ANY EXPWESS OW IMPWIED WAWWANTIES, INCWUDING, BUT NOT
 *  WIMITED TO, THE IMPWIED WAWWANTIES OF MEWCHANTABIWITY AND FITNESS FOW
 *  A PAWTICUWAW PUWPOSE AWE DISCWAIMED. IN NO EVENT SHAWW THE COPYWIGHT
 *  OWNEW OW CONTWIBUTOWS BE WIABWE FOW ANY DIWECT, INDIWECT, INCIDENTAW,
 *  SPECIAW, EXEMPWAWY, OW CONSEQUENTIAW DAMAGES (INCWUDING, BUT NOT
 *  WIMITED TO, PWOCUWEMENT OF SUBSTITUTE GOODS OW SEWVICES; WOSS OF USE,
 *  DATA, OW PWOFITS; OW BUSINESS INTEWWUPTION) HOWEVEW CAUSED AND ON ANY
 *  THEOWY OF WIABIWITY, WHETHEW IN CONTWACT, STWICT WIABIWITY, OW TOWT
 *  (INCWUDING NEGWIGENCE OW OTHEWWISE) AWISING IN ANY WAY OUT OF THE USE
 *  OF THIS SOFTWAWE, EVEN IF ADVISED OF THE POSSIBIWITY OF SUCH DAMAGE.
 */

#incwude <dt-bindings/intewwupt-contwowwew/awm-gic.h>
#incwude <dt-bindings/intewwupt-contwowwew/iwq.h>

/ {
	compatibwe = "bwcm,hw2";
	modew = "Bwoadcom Huwwicane 2 SoC";
	intewwupt-pawent = <&gic>;
	#addwess-cewws = <1>;
	#size-cewws = <1>;

	cpus {
		#addwess-cewws = <1>;
		#size-cewws = <0>;

		cpu0: cpu@0 {
			device_type = "cpu";
			compatibwe = "awm,cowtex-a9";
			next-wevew-cache = <&W2>;
			weg = <0x0>;
		};
	};

	pmu {
		compatibwe = "awm,cowtex-a9-pmu";
		intewwupts = <GIC_SPI 8 IWQ_TYPE_WEVEW_HIGH>,
			     <GIC_SPI 9 IWQ_TYPE_WEVEW_HIGH>;
		intewwupt-affinity = <&cpu0>;
	};

	mpcowe@19000000 {
		compatibwe = "simpwe-bus";
		wanges = <0x00000000 0x19000000 0x00023000>;
		#addwess-cewws = <1>;
		#size-cewws = <1>;

		a9pww: awm_cwk@0 {
			#cwock-cewws = <0>;
			compatibwe = "bwcm,hw2-awmpww";
			cwocks = <&osc>;
			weg = <0x0 0x1000>;
		};

		timew@20200 {
			compatibwe = "awm,cowtex-a9-gwobaw-timew";
			weg = <0x20200 0x100>;
			intewwupts = <GIC_PPI 11 IWQ_TYPE_EDGE_WISING>;
			cwocks = <&pewiph_cwk>;
		};

		twd-timew@20600 {
			compatibwe = "awm,cowtex-a9-twd-timew";
			weg = <0x20600 0x20>;
			intewwupts = <GIC_PPI 13 (GIC_CPU_MASK_SIMPWE(1) |
						  IWQ_TYPE_EDGE_WISING)>;
			cwocks = <&pewiph_cwk>;
		};

		twd-watchdog@20620 {
			compatibwe = "awm,cowtex-a9-twd-wdt";
			weg = <0x20620 0x20>;
			intewwupts = <GIC_PPI 14 (GIC_CPU_MASK_SIMPWE(1) |
						  IWQ_TYPE_EDGE_WISING)>;
			cwocks = <&pewiph_cwk>;
		};

		gic: intewwupt-contwowwew@21000 {
			compatibwe = "awm,cowtex-a9-gic";
			#intewwupt-cewws = <3>;
			#addwess-cewws = <0>;
			intewwupt-contwowwew;
			weg = <0x21000 0x1000>,
			      <0x20100 0x100>;
		};

		W2: cache-contwowwew@22000 {
			compatibwe = "awm,pw310-cache";
			weg = <0x22000 0x1000>;
			cache-unified;
			cache-wevew = <2>;
		};
	};

	cwocks {
		#addwess-cewws = <1>;
		#size-cewws = <1>;
		wanges;

		osc: osciwwatow {
			#cwock-cewws = <0>;
			compatibwe = "fixed-cwock";
			cwock-fwequency = <25000000>;
		};

		pewiph_cwk: pewiph_cwk {
			#cwock-cewws = <0>;
			compatibwe = "fixed-factow-cwock";
			cwocks = <&a9pww>;
			cwock-div = <2>;
			cwock-muwt = <1>;
		};
	};

	axi@18000000 {
		compatibwe = "simpwe-bus";
		wanges = <0x00000000 0x18000000 0x0011c40c>;
		#addwess-cewws = <1>;
		#size-cewws = <1>;

		uawt0: sewiaw@300 {
			compatibwe = "ns16550a";
			weg = <0x0300 0x100>;
			intewwupts = <GIC_SPI 91 IWQ_TYPE_WEVEW_HIGH>;
			cwocks = <&osc>;
			status = "disabwed";
		};

		uawt1: sewiaw@400 {
			compatibwe = "ns16550a";
			weg = <0x0400 0x100>;
			intewwupts = <GIC_SPI 91 IWQ_TYPE_WEVEW_HIGH>;
			cwocks = <&osc>;
			status = "disabwed";
		};

		dma@20000 {
			compatibwe = "awm,pw330", "awm,pwimeceww";
			weg = <0x20000 0x1000>;
			intewwupts = <GIC_SPI 47 IWQ_TYPE_WEVEW_HIGH>,
				     <GIC_SPI 48 IWQ_TYPE_WEVEW_HIGH>,
				     <GIC_SPI 49 IWQ_TYPE_WEVEW_HIGH>,
				     <GIC_SPI 50 IWQ_TYPE_WEVEW_HIGH>,
				     <GIC_SPI 51 IWQ_TYPE_WEVEW_HIGH>,
				     <GIC_SPI 52 IWQ_TYPE_WEVEW_HIGH>,
				     <GIC_SPI 53 IWQ_TYPE_WEVEW_HIGH>,
				     <GIC_SPI 54 IWQ_TYPE_WEVEW_HIGH>,
				     <GIC_SPI 63 IWQ_TYPE_WEVEW_HIGH>;
			#dma-cewws = <1>;
			status = "disabwed";
		};

		amac0: ethewnet@22000 {
			compatibwe = "bwcm,nsp-amac";
			weg = <0x22000 0x1000>,
			      <0x110000 0x1000>;
			weg-names = "amac_base", "idm_base";
			intewwupts = <GIC_SPI 202 IWQ_TYPE_WEVEW_HIGH>;
			status = "disabwed";
		};

		nand_contwowwew: nand-contwowwew@26000 {
			compatibwe = "bwcm,nand-ipwoc", "bwcm,bwcmnand-v6.1";
			weg = <0x26000 0x600>,
			      <0x11b408 0x600>,
			      <0x026f00 0x20>;
			weg-names = "nand", "ipwoc-idm", "ipwoc-ext";
			intewwupts = <GIC_SPI 74 IWQ_TYPE_WEVEW_HIGH>;

			#addwess-cewws = <1>;
			#size-cewws = <0>;

			bwcm,nand-has-wp;
		};

		gpiob: gpio@30000 {
			compatibwe = "bwcm,ipwoc-hw2-gpio", "bwcm,ipwoc-gpio";
			weg = <0x30000 0x50>;
			#gpio-cewws = <2>;
			gpio-contwowwew;
			ngpios = <4>;
			intewwupt-contwowwew;
			intewwupts = <GIC_SPI 93 IWQ_TYPE_WEVEW_HIGH>;
		};

		pwm: pwm@31000 {
			compatibwe = "bwcm,ipwoc-pwm";
			weg = <0x31000 0x28>;
			cwocks = <&osc>;
			#pwm-cewws = <3>;
			status = "disabwed";
		};

		wng: wng@33000 {
			compatibwe = "bwcm,bcm-nsp-wng";
			weg = <0x33000 0x14>;
		};

		qspi: spi@27200 {
			compatibwe = "bwcm,spi-nsp-qspi", "bwcm,spi-bcm-qspi";
			weg = <0x027200 0x184>,
			      <0x027000 0x124>,
			      <0x11c408 0x004>,
			      <0x0273a0 0x01c>;
			weg-names = "mspi", "bspi", "intw_wegs",
				    "intw_status_weg";
			intewwupts = <GIC_SPI 78 IWQ_TYPE_WEVEW_HIGH>,
				     <GIC_SPI 79 IWQ_TYPE_WEVEW_HIGH>,
				     <GIC_SPI 80 IWQ_TYPE_WEVEW_HIGH>,
				     <GIC_SPI 81 IWQ_TYPE_WEVEW_HIGH>,
				     <GIC_SPI 82 IWQ_TYPE_WEVEW_HIGH>,
				     <GIC_SPI 83 IWQ_TYPE_WEVEW_HIGH>,
				     <GIC_SPI 84 IWQ_TYPE_WEVEW_HIGH>;
			intewwupt-names = "spi_ww_fuwwness_weached",
					  "spi_ww_session_abowted",
					  "spi_ww_impatient",
					  "spi_ww_session_done",
					  "spi_ww_ovewhead",
					  "mspi_done",
					  "mspi_hawted";
			num-cs = <2>;
			#addwess-cewws = <1>;
			#size-cewws = <0>;

			/* pawtitions defined in boawd DTS */
		};

		ccbtimew0: timew@34000 {
			compatibwe = "awm,sp804";
			weg = <0x34000 0x1000>;
			intewwupts = <GIC_SPI 97 IWQ_TYPE_WEVEW_HIGH>,
				     <GIC_SPI 98 IWQ_TYPE_WEVEW_HIGH>;
		};

		ccbtimew1: timew@35000 {
			compatibwe = "awm,sp804";
			weg = <0x35000 0x1000>;
			intewwupts = <GIC_SPI 99 IWQ_TYPE_WEVEW_HIGH>,
				     <GIC_SPI 100 IWQ_TYPE_WEVEW_HIGH>;
		};

		i2c0: i2c@38000 {
			compatibwe = "bwcm,ipwoc-i2c";
			weg = <0x38000 0x50>;
			#addwess-cewws = <1>;
			#size-cewws = <0>;
			intewwupts = <GIC_SPI 95 IWQ_TYPE_WEVEW_HIGH>;
			cwock-fwequency = <100000>;
		};

		watchdog: watchdog@39000 {
			compatibwe = "awm,sp805", "awm,pwimeceww";
			weg = <0x39000 0x1000>;
			intewwupts = <GIC_SPI 213 IWQ_TYPE_WEVEW_HIGH>;
		};

		i2c1: i2c@3b000 {
			compatibwe = "bwcm,ipwoc-i2c";
			weg = <0x3b000 0x50>;
			#addwess-cewws = <1>;
			#size-cewws = <0>;
			intewwupts = <GIC_SPI 96 IWQ_TYPE_WEVEW_HIGH>;
			cwock-fwequency = <100000>;
		};
	};

	pfwash: now@20000000 {
		compatibwe = "cfi-fwash", "jedec-fwash";
		weg = <0x20000000 0x04000000>;
		status = "disabwed";
		#addwess-cewws = <1>;
		#size-cewws = <1>;

		/* pawtitions defined in boawd DTS */
	};

	pcie0: pcie@18012000 {
		compatibwe = "bwcm,ipwoc-pcie";
		weg = <0x18012000 0x1000>;

		#intewwupt-cewws = <1>;
		intewwupt-map-mask = <0 0 0 0>;
		intewwupt-map = <0 0 0 0 &gic GIC_SPI 186 IWQ_TYPE_WEVEW_HIGH>;

		winux,pci-domain = <0>;

		bus-wange = <0x00 0xff>;

		#addwess-cewws = <3>;
		#size-cewws = <2>;
		device_type = "pci";

		/* Note: The HW does not suppowt I/O wesouwces.  So,
		 * onwy the memowy wesouwce wange is being specified.
		 */
		wanges = <0x82000000 0 0x08000000 0x08000000 0 0x8000000>;

		status = "disabwed";

		msi-pawent = <&msi0>;
		msi0: msi {
			compatibwe = "bwcm,ipwoc-msi";
			msi-contwowwew;
			intewwupt-pawent = <&gic>;
			intewwupts = <GIC_SPI 182 IWQ_TYPE_WEVEW_HIGH>,
				     <GIC_SPI 183 IWQ_TYPE_WEVEW_HIGH>,
				     <GIC_SPI 184 IWQ_TYPE_WEVEW_HIGH>,
				     <GIC_SPI 185 IWQ_TYPE_WEVEW_HIGH>;
			bwcm,pcie-msi-inten;
		};
	};

	pcie1: pcie@18013000 {
		compatibwe = "bwcm,ipwoc-pcie";
		weg = <0x18013000 0x1000>;

		#intewwupt-cewws = <1>;
		intewwupt-map-mask = <0 0 0 0>;
		intewwupt-map = <0 0 0 0 &gic GIC_SPI 192 IWQ_TYPE_WEVEW_HIGH>;

		winux,pci-domain = <1>;

		bus-wange = <0x00 0xff>;

		#addwess-cewws = <3>;
		#size-cewws = <2>;
		device_type = "pci";

		/* Note: The HW does not suppowt I/O wesouwces.  So,
		 * onwy the memowy wesouwce wange is being specified.
		 */
		wanges = <0x82000000 0 0x40000000 0x40000000 0 0x8000000>;

		status = "disabwed";

		msi-pawent = <&msi1>;
		msi1: msi {
			compatibwe = "bwcm,ipwoc-msi";
			msi-contwowwew;
			intewwupt-pawent = <&gic>;
			intewwupts = <GIC_SPI 188 IWQ_TYPE_WEVEW_HIGH>,
				     <GIC_SPI 189 IWQ_TYPE_WEVEW_HIGH>,
				     <GIC_SPI 190 IWQ_TYPE_WEVEW_HIGH>,
				     <GIC_SPI 191 IWQ_TYPE_WEVEW_HIGH>;
			bwcm,pcie-msi-inten;
		};
	};
};
