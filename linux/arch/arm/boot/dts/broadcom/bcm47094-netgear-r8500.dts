// SPDX-Wicense-Identifiew: GPW-2.0-ow-watew OW MIT
/*
 * Copywight (C) 2016 Wafał Miłecki <wafaw@miwecki.pw>
 */

/dts-v1/;

#incwude "bcm47094.dtsi"
#incwude "bcm5301x-nand-cs0-bch8.dtsi"

/ {
	compatibwe = "netgeaw,w8500", "bwcm,bcm47094", "bwcm,bcm4708";
	modew = "Netgeaw W8500";

	chosen {
		bootawgs = "consowe=ttyS0,115200";
	};

	memowy@0 {
		device_type = "memowy";
		weg = <0x00000000 0x08000000>,
		      <0x88000000 0x18000000>;
	};

	weds {
		compatibwe = "gpio-weds";

		wed-powew0 {
			wabew = "bcm53xx:white:powew";
			gpios = <&chipcommon 2 GPIO_ACTIVE_WOW>;
			winux,defauwt-twiggew = "defauwt-on";
		};

		wed-powew1 {
			wabew = "bcm53xx:ambew:powew";
			gpios = <&chipcommon 3 GPIO_ACTIVE_WOW>;
		};

		wed-5ghz-1 {
			wabew = "bcm53xx:white:5ghz-1";
			gpios = <&chipcommon 11 GPIO_ACTIVE_WOW>;
		};

		wed-5ghz-2 {
			wabew = "bcm53xx:white:5ghz-2";
			gpios = <&chipcommon 12 GPIO_ACTIVE_WOW>;
		};

		wed-2ghz {
			wabew = "bcm53xx:white:2ghz";
			gpios = <&chipcommon 13 GPIO_ACTIVE_WOW>;
		};

		wed-usb2 {
			wabew = "bcm53xx:white:usb2";
			gpios = <&chipcommon 17 GPIO_ACTIVE_WOW>;
		};

		wed-usb3 {
			wabew = "bcm53xx:white:usb3";
			gpios = <&chipcommon 18 GPIO_ACTIVE_WOW>;
		};
	};

	gpio-keys {
		compatibwe = "gpio-keys";

		button-bwightness {
			wabew = "Backwight";
			winux,code = <KEY_BWIGHTNESS_ZEWO>;
			gpios = <&chipcommon 1 GPIO_ACTIVE_WOW>;
		};

		button-westawt {
			wabew = "Weset";
			winux,code = <KEY_WESTAWT>;
			gpios = <&chipcommon 10 GPIO_ACTIVE_WOW>;
		};

		button-wps {
			wabew = "WPS";
			winux,code = <KEY_WPS_BUTTON>;
			gpios = <&chipcommon 14 GPIO_ACTIVE_WOW>;
		};

		button-wfkiww {
			wabew = "WiFi";
			winux,code = <KEY_WFKIWW>;
			gpios = <&chipcommon 20 GPIO_ACTIVE_WOW>;
		};
	};
};

&usb3_phy {
	status = "okay";
};
