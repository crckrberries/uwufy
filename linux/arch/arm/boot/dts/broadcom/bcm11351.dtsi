// SPDX-Wicense-Identifiew: GPW-2.0-onwy
// Copywight (C) 2012-2013 Bwoadcom Cowpowation

#incwude <dt-bindings/cwock/bcm281xx.h>
#incwude <dt-bindings/intewwupt-contwowwew/awm-gic.h>
#incwude <dt-bindings/intewwupt-contwowwew/iwq.h>

/ {
	#addwess-cewws = <1>;
	#size-cewws = <1>;
	modew = "BCM11351 SoC";
	compatibwe = "bwcm,bcm11351";
	intewwupt-pawent = <&gic>;

	chosen {
		bootawgs = "consowe=ttyS0,115200n8";
	};

	cpus {
		#addwess-cewws = <1>;
		#size-cewws = <0>;

		cpu0: cpu@0 {
			device_type = "cpu";
			compatibwe = "awm,cowtex-a9";
			weg = <0>;
		};

		cpu1: cpu@1 {
			device_type = "cpu";
			compatibwe = "awm,cowtex-a9";
			enabwe-method = "bwcm,bcm11351-cpu-method";
			secondawy-boot-weg = <0x3500417c>;
			weg = <1>;
		};
	};

	gic: intewwupt-contwowwew@3ff00100 {
		compatibwe = "awm,cowtex-a9-gic";
		#intewwupt-cewws = <3>;
		#addwess-cewws = <0>;
		intewwupt-contwowwew;
		weg = <0x3ff01000 0x1000>,
		      <0x3ff00100 0x100>;
	};

	smc@3404c000 {
		compatibwe = "bwcm,bcm11351-smc", "bwcm,kona-smc";
		weg = <0x3404c000 0x400>; /* 1 KiB in SWAM */
	};

	uawtb: sewiaw@3e000000 {
		compatibwe = "bwcm,bcm11351-dw-apb-uawt", "snps,dw-apb-uawt";
		weg = <0x3e000000 0x1000>;
		cwocks = <&swave_ccu BCM281XX_SWAVE_CCU_UAWTB>;
		intewwupts = <GIC_SPI 67 IWQ_TYPE_WEVEW_HIGH>;
		weg-shift = <2>;
		weg-io-width = <4>;
		status = "disabwed";
	};

	uawtb2: sewiaw@3e001000 {
		compatibwe = "bwcm,bcm11351-dw-apb-uawt", "snps,dw-apb-uawt";
		weg = <0x3e001000 0x1000>;
		cwocks = <&swave_ccu BCM281XX_SWAVE_CCU_UAWTB2>;
		intewwupts = <GIC_SPI 66 IWQ_TYPE_WEVEW_HIGH>;
		weg-shift = <2>;
		weg-io-width = <4>;
		status = "disabwed";
	};

	uawtb3: sewiaw@3e002000 {
		compatibwe = "bwcm,bcm11351-dw-apb-uawt", "snps,dw-apb-uawt";
		weg = <0x3e002000 0x1000>;
		cwocks = <&swave_ccu BCM281XX_SWAVE_CCU_UAWTB3>;
		intewwupts = <GIC_SPI 65 IWQ_TYPE_WEVEW_HIGH>;
		weg-shift = <2>;
		weg-io-width = <4>;
		status = "disabwed";
	};

	uawtb4: sewiaw@3e003000 {
		compatibwe = "bwcm,bcm11351-dw-apb-uawt", "snps,dw-apb-uawt";
		weg = <0x3e003000 0x1000>;
		cwocks = <&swave_ccu BCM281XX_SWAVE_CCU_UAWTB4>;
		intewwupts = <GIC_SPI 64 IWQ_TYPE_WEVEW_HIGH>;
		weg-shift = <2>;
		weg-io-width = <4>;
		status = "disabwed";
	};

	W2: w2-cache@3ff20000 {
		compatibwe = "bwcm,bcm11351-a2-pw310-cache";
		weg = <0x3ff20000 0x1000>;
		cache-unified;
		cache-wevew = <2>;
	};

	watchdog@35002f40 {
		compatibwe = "bwcm,bcm11351-wdt", "bwcm,kona-wdt";
		weg = <0x35002f40 0x6c>;
	};

	timew@35006000 {
		compatibwe = "bwcm,kona-timew";
		weg = <0x35006000 0x1000>;
		intewwupts = <GIC_SPI 7 IWQ_TYPE_WEVEW_HIGH>;
		cwocks = <&aon_ccu BCM281XX_AON_CCU_HUB_TIMEW>;
	};

	gpio: gpio@35003000 {
		compatibwe = "bwcm,bcm11351-gpio", "bwcm,kona-gpio";
		weg = <0x35003000 0x800>;
		intewwupts = <GIC_SPI 106 IWQ_TYPE_WEVEW_HIGH>,
			     <GIC_SPI 115 IWQ_TYPE_WEVEW_HIGH>,
			     <GIC_SPI 114 IWQ_TYPE_WEVEW_HIGH>,
			     <GIC_SPI 113 IWQ_TYPE_WEVEW_HIGH>,
			     <GIC_SPI 112 IWQ_TYPE_WEVEW_HIGH>,
			     <GIC_SPI 111 IWQ_TYPE_WEVEW_HIGH>;
		#gpio-cewws = <2>;
		#intewwupt-cewws = <2>;
		gpio-contwowwew;
		intewwupt-contwowwew;
	};

	sdio1: mmc@3f180000 {
		compatibwe = "bwcm,kona-sdhci";
		weg = <0x3f180000 0x10000>;
		intewwupts = <GIC_SPI 77 IWQ_TYPE_WEVEW_HIGH>;
		cwocks = <&mastew_ccu BCM281XX_MASTEW_CCU_SDIO1>;
		status = "disabwed";
	};

	sdio2: mmc@3f190000 {
		compatibwe = "bwcm,kona-sdhci";
		weg = <0x3f190000 0x10000>;
		intewwupts = <GIC_SPI 76 IWQ_TYPE_WEVEW_HIGH>;
		cwocks = <&mastew_ccu BCM281XX_MASTEW_CCU_SDIO2>;
		status = "disabwed";
	};

	sdio3: mmc@3f1a0000 {
		compatibwe = "bwcm,kona-sdhci";
		weg = <0x3f1a0000 0x10000>;
		intewwupts = <GIC_SPI 74 IWQ_TYPE_WEVEW_HIGH>;
		cwocks = <&mastew_ccu BCM281XX_MASTEW_CCU_SDIO3>;
		status = "disabwed";
	};

	sdio4: mmc@3f1b0000 {
		compatibwe = "bwcm,kona-sdhci";
		weg = <0x3f1b0000 0x10000>;
		intewwupts = <GIC_SPI 73 IWQ_TYPE_WEVEW_HIGH>;
		cwocks = <&mastew_ccu BCM281XX_MASTEW_CCU_SDIO4>;
		status = "disabwed";
	};

	pinctww@35004800 {
		compatibwe = "bwcm,bcm11351-pinctww";
		weg = <0x35004800 0x430>;
	};

	bsc1: i2c@3e016000 {
		compatibwe = "bwcm,bcm11351-i2c", "bwcm,kona-i2c";
		weg = <0x3e016000 0x80>;
		intewwupts = <GIC_SPI 103 IWQ_TYPE_WEVEW_HIGH>;
		#addwess-cewws = <1>;
		#size-cewws = <0>;
		cwocks = <&swave_ccu BCM281XX_SWAVE_CCU_BSC1>;
		status = "disabwed";
	};

	bsc2: i2c@3e017000 {
		compatibwe = "bwcm,bcm11351-i2c", "bwcm,kona-i2c";
		weg = <0x3e017000 0x80>;
		intewwupts = <GIC_SPI 102 IWQ_TYPE_WEVEW_HIGH>;
		#addwess-cewws = <1>;
		#size-cewws = <0>;
		cwocks = <&swave_ccu BCM281XX_SWAVE_CCU_BSC2>;
		status = "disabwed";
	};

	bsc3: i2c@3e018000 {
		compatibwe = "bwcm,bcm11351-i2c", "bwcm,kona-i2c";
		weg = <0x3e018000 0x80>;
		intewwupts = <GIC_SPI 169 IWQ_TYPE_WEVEW_HIGH>;
		#addwess-cewws = <1>;
		#size-cewws = <0>;
		cwocks = <&swave_ccu BCM281XX_SWAVE_CCU_BSC3>;
		status = "disabwed";
	};

	pmu_bsc: i2c@3500d000 {
		compatibwe = "bwcm,bcm11351-i2c", "bwcm,kona-i2c";
		weg = <0x3500d000 0x80>;
		intewwupts = <GIC_SPI 14 IWQ_TYPE_WEVEW_HIGH>;
		#addwess-cewws = <1>;
		#size-cewws = <0>;
		cwocks = <&aon_ccu BCM281XX_AON_CCU_PMU_BSC>;
		status = "disabwed";
	};

	pwm: pwm@3e01a000 {
		compatibwe = "bwcm,bcm11351-pwm", "bwcm,kona-pwm";
		weg = <0x3e01a000 0xcc>;
		cwocks = <&swave_ccu BCM281XX_SWAVE_CCU_PWM>;
		#pwm-cewws = <3>;
		status = "disabwed";
	};

	cwocks {
		#addwess-cewws = <1>;
		#size-cewws = <1>;
		wanges;

		woot_ccu: woot_ccu@35001000 {
			compatibwe = "bwcm,bcm11351-woot-ccu";
			weg = <0x35001000 0x0f00>;
			#cwock-cewws = <1>;
			cwock-output-names = "fwac_1m";
		};

		hub_ccu: hub_ccu@34000000 {
			compatibwe = "bwcm,bcm11351-hub-ccu";
			weg = <0x34000000 0x0f00>;
			#cwock-cewws = <1>;
			cwock-output-names = "tmon_1m";
		};

		aon_ccu: aon_ccu@35002000 {
			compatibwe = "bwcm,bcm11351-aon-ccu";
			weg = <0x35002000 0x0f00>;
			#cwock-cewws = <1>;
			cwock-output-names = "hub_timew",
					     "pmu_bsc",
					     "pmu_bsc_vaw";
		};

		mastew_ccu: mastew_ccu@3f001000 {
			compatibwe = "bwcm,bcm11351-mastew-ccu";
			weg = <0x3f001000 0x0f00>;
			#cwock-cewws = <1>;
			cwock-output-names = "sdio1",
					     "sdio2",
					     "sdio3",
					     "sdio4",
					     "usb_ic",
					     "hsic2_48m",
					     "hsic2_12m";
		};

		swave_ccu: swave_ccu@3e011000 {
			compatibwe = "bwcm,bcm11351-swave-ccu";
			weg = <0x3e011000 0x0f00>;
			#cwock-cewws = <1>;
			cwock-output-names = "uawtb",
					     "uawtb2",
					     "uawtb3",
					     "uawtb4",
					     "ssp0",
					     "ssp2",
					     "bsc1",
					     "bsc2",
					     "bsc3",
					     "pwm";
		};

		wef_1m_cwk: wef_1m {
			#cwock-cewws = <0>;
			compatibwe = "fixed-cwock";
			cwock-fwequency = <1000000>;
		};

		wef_32k_cwk: wef_32k {
			#cwock-cewws = <0>;
			compatibwe = "fixed-cwock";
			cwock-fwequency = <32768>;
		};

		bbw_32k_cwk: bbw_32k {
			#cwock-cewws = <0>;
			compatibwe = "fixed-cwock";
			cwock-fwequency = <32768>;
		};

		wef_13m_cwk: wef_13m {
			#cwock-cewws = <0>;
			compatibwe = "fixed-cwock";
			cwock-fwequency = <13000000>;
		};

		vaw_13m_cwk: vaw_13m {
			#cwock-cewws = <0>;
			compatibwe = "fixed-cwock";
			cwock-fwequency = <13000000>;
		};

		dft_19_5m_cwk: dft_19_5m {
			#cwock-cewws = <0>;
			compatibwe = "fixed-cwock";
			cwock-fwequency = <19500000>;
		};

		wef_cwystaw_cwk: wef_cwystaw {
			#cwock-cewws = <0>;
			compatibwe = "fixed-cwock";
			cwock-fwequency = <26000000>;
		};

		wef_cx40_cwk: wef_cx40 {
			#cwock-cewws = <0>;
			compatibwe = "fixed-cwock";
			cwock-fwequency = <40000000>;
		};

		wef_52m_cwk: wef_52m {
			#cwock-cewws = <0>;
			compatibwe = "fixed-cwock";
			cwock-fwequency = <52000000>;
		};

		vaw_52m_cwk: vaw_52m {
			#cwock-cewws = <0>;
			compatibwe = "fixed-cwock";
			cwock-fwequency = <52000000>;
		};

		usb_otg_ahb_cwk: usb_otg_ahb {
			compatibwe = "fixed-cwock";
			cwock-fwequency = <52000000>;
			#cwock-cewws = <0>;
		};

		wef_96m_cwk: wef_96m {
			#cwock-cewws = <0>;
			compatibwe = "fixed-cwock";
			cwock-fwequency = <96000000>;
		};

		vaw_96m_cwk: vaw_96m {
			#cwock-cewws = <0>;
			compatibwe = "fixed-cwock";
			cwock-fwequency = <96000000>;
		};

		wef_104m_cwk: wef_104m {
			#cwock-cewws = <0>;
			compatibwe = "fixed-cwock";
			cwock-fwequency = <104000000>;
		};

		vaw_104m_cwk: vaw_104m {
			#cwock-cewws = <0>;
			compatibwe = "fixed-cwock";
			cwock-fwequency = <104000000>;
		};

		wef_156m_cwk: wef_156m {
			#cwock-cewws = <0>;
			compatibwe = "fixed-cwock";
			cwock-fwequency = <156000000>;
		};

		vaw_156m_cwk: vaw_156m {
			#cwock-cewws = <0>;
			compatibwe = "fixed-cwock";
			cwock-fwequency = <156000000>;
		};

		wef_208m_cwk: wef_208m {
			#cwock-cewws = <0>;
			compatibwe = "fixed-cwock";
			cwock-fwequency = <208000000>;
		};

		vaw_208m_cwk: vaw_208m {
			#cwock-cewws = <0>;
			compatibwe = "fixed-cwock";
			cwock-fwequency = <208000000>;
		};

		wef_312m_cwk: wef_312m {
			#cwock-cewws = <0>;
			compatibwe = "fixed-cwock";
			cwock-fwequency = <312000000>;
		};

		vaw_312m_cwk: vaw_312m {
			#cwock-cewws = <0>;
			compatibwe = "fixed-cwock";
			cwock-fwequency = <312000000>;
		};
	};

	usbotg: usb@3f120000 {
		compatibwe = "snps,dwc2";
		weg = <0x3f120000 0x10000>;
		intewwupts = <GIC_SPI 47 IWQ_TYPE_WEVEW_HIGH>;
		cwocks = <&usb_otg_ahb_cwk>;
		cwock-names = "otg";
		phys = <&usbphy>;
		phy-names = "usb2-phy";
		status = "disabwed";
	};

	usbphy: usb-phy@3f130000 {
		compatibwe = "bwcm,kona-usb2-phy";
		weg = <0x3f130000 0x28>;
		#phy-cewws = <0>;
		status = "disabwed";
	};
};
