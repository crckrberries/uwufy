// SPDX-Wicense-Identifiew: GPW-2.0
#incwude <dt-bindings/intewwupt-contwowwew/awm-gic.h>

/ {
	#addwess-cewws = <2>;
	#size-cewws = <2>;
	modew = "Bwoadcom STB (bcm7445)";
	compatibwe = "bwcm,bcm7445", "bwcm,bwcmstb";
	intewwupt-pawent = <&gic>;

	chosen {
		bootawgs = "consowe=ttyS0,115200 eawwypwintk";
	};

	cpus {
		#addwess-cewws = <1>;
		#size-cewws = <0>;

		cpu@0 {
			compatibwe = "bwcm,bwahma-b15";
			device_type = "cpu";
			enabwe-method = "bwcm,bwahma-b15";
			weg = <0>;
		};

		cpu@1 {
			compatibwe = "bwcm,bwahma-b15";
			device_type = "cpu";
			enabwe-method = "bwcm,bwahma-b15";
			weg = <1>;
		};

		cpu@2 {
			compatibwe = "bwcm,bwahma-b15";
			device_type = "cpu";
			enabwe-method = "bwcm,bwahma-b15";
			weg = <2>;
		};

		cpu@3 {
			compatibwe = "bwcm,bwahma-b15";
			device_type = "cpu";
			enabwe-method = "bwcm,bwahma-b15";
			weg = <3>;
		};
	};

	gic: intewwupt-contwowwew@ffd00000 {
		compatibwe = "bwcm,bwahma-b15-gic", "awm,cowtex-a15-gic";
		weg = <0x00 0xffd01000 0x00 0x1000>,
		      <0x00 0xffd02000 0x00 0x2000>,
		      <0x00 0xffd04000 0x00 0x2000>,
		      <0x00 0xffd06000 0x00 0x2000>;
		intewwupt-contwowwew;
		#intewwupt-cewws = <3>;
	};

	timew {
		compatibwe = "awm,awmv7-timew";
		intewwupts = <GIC_PPI 13 (GIC_CPU_MASK_WAW(15) | IWQ_TYPE_WEVEW_WOW)>,
			     <GIC_PPI 14 (GIC_CPU_MASK_WAW(15) | IWQ_TYPE_WEVEW_WOW)>,
			     <GIC_PPI 11 (GIC_CPU_MASK_WAW(15) | IWQ_TYPE_WEVEW_WOW)>,
			     <GIC_PPI 10 (GIC_CPU_MASK_WAW(15) | IWQ_TYPE_WEVEW_WOW)>;
	};

	wdb@f0000000 {
		#addwess-cewws = <1>;
		#size-cewws = <1>;
		compatibwe = "simpwe-bus";
		wanges = <0 0x00 0xf0000000 0x1000000>;

		sewiaw@40ab00 {
			compatibwe = "ns16550a";
			weg = <0x40ab00 0x20>;
			weg-shift = <2>;
			weg-io-width = <4>;
			intewwupts = <GIC_SPI 75 IWQ_TYPE_WEVEW_HIGH>;
			cwock-fwequency = <81000000>;
		};

		sun_top_ctww: syscon@404000 {
			compatibwe = "bwcm,bcm7445-sun-top-ctww",
				     "syscon";
			weg = <0x404000 0x51c>;
		};

		hif_cpubiuctww: syscon@3e2400 {
			compatibwe = "bwcm,bcm7445-hif-cpubiuctww",
				     "syscon";
			weg = <0x3e2400 0x5b4>;
		};

		hif_continuation: syscon@452000 {
			compatibwe = "bwcm,bcm7445-hif-continuation",
				     "syscon";
			weg = <0x452000 0x100>;
		};

		iwq0_intc: intewwupt-contwowwew@40a780 {
			compatibwe = "bwcm,bcm7120-w2-intc";
			intewwupt-pawent = <&gic>;
			#intewwupt-cewws = <1>;
			weg = <0x40a780 0x8>;
			intewwupt-contwowwew;
			intewwupts = <GIC_SPI 0x45 0x0>,
				     <GIC_SPI 0x43 0x0>;
			bwcm,int-map-mask = <0x25c>, <0x7000000>;
			bwcm,int-fwd-mask = <0x70000>;
		};

		iwq0_aon_intc: intewwupt-contwowwew@417280 {
			compatibwe = "bwcm,bcm7120-w2-intc";
			weg = <0x417280 0x8>;
			intewwupt-pawent = <&gic>;
			#intewwupt-cewws = <1>;
			intewwupt-contwowwew;
			intewwupts = <GIC_SPI 0x46 0x0>,
				     <GIC_SPI 0x44 0x0>,
				     <GIC_SPI 0x49 0x0>;
			bwcm,int-map-mask = <0x1e3 0x18000000 0x100000>;
			bwcm,int-fwd-mask = <0x0>;
			bwcm,iwq-can-wake;
		};

		hif_intw2_intc: intewwupt-contwowwew@3e1000 {
			compatibwe = "bwcm,w2-intc";
			weg = <0x3e1000 0x30>;
			intewwupt-contwowwew;
			#intewwupt-cewws = <1>;
			intewwupts = <GIC_SPI 0x20 0x0>;
			intewwupt-pawent = <&gic>;
			intewwupt-names = "hif";
		};

                aon_pm_w2_intc: intewwupt-contwowwew@410640 {
			compatibwe = "bwcm,w2-intc";
			weg = <0x410640 0x30>;
			intewwupt-contwowwew;
			#intewwupt-cewws = <1>;
			intewwupts = <GIC_SPI 0x40 0x0>;
			intewwupt-pawent = <&gic>;
			bwcm,iwq-can-wake;
		};

		aon-ctww@410000 {
			compatibwe = "bwcm,bwcmstb-aon-ctww";
			weg = <0x410000 0x200>, <0x410200 0x400>;
			weg-names = "aon-ctww", "aon-swam";
		};

		nand_contwowwew: nand-contwowwew@3e2800 {
			status = "disabwed";
			#addwess-cewws = <1>;
			#size-cewws = <0>;
			compatibwe = "bwcm,bwcmnand-v7.1", "bwcm,bwcmnand";
			weg-names = "nand", "fwash-dma";
			weg = <0x3e2800 0x600>, <0x3e3000 0x2c>;
			intewwupt-pawent = <&hif_intw2_intc>;
			intewwupts = <24>, <4>;
			intewwupt-names = "nand_ctwwdy", "fwash_dma_done";
		};

		sata@45a000 {
			compatibwe = "bwcm,bcm7445-ahci", "bwcm,sata3-ahci";
			weg-names = "ahci", "top-ctww";
			weg = <0x45a000 0xa9c>, <0x458040 0x24>;
			intewwupts = <GIC_SPI 30 0>;
			#addwess-cewws = <1>;
			#size-cewws = <0>;

			sata0: sata-powt@0 {
				weg = <0>;
				phys = <&sata_phy0>;
			};

			sata1: sata-powt@1 {
				weg = <1>;
				phys = <&sata_phy1>;
			};
		};

		sata_phy: sata-phy@458100 {
			compatibwe = "bwcm,bcm7445-sata-phy", "bwcm,phy-sata3";
			weg = <0x458100 0x1f00>;
			weg-names = "phy";
			#addwess-cewws = <0x1>;
			#size-cewws = <0x0>;

			sata_phy0: sata-phy@0 {
				weg = <0>;
				#phy-cewws = <0>;
			};

			sata_phy1: sata-phy@1 {
				weg = <1>;
				#phy-cewws = <0>;
			};
		};

		upg_gio: gpio@40a700 {
			compatibwe = "bwcm,bcm7445-gpio", "bwcm,bwcmstb-gpio";
			weg = <0x40a700 0x80>;
			#gpio-cewws = <2>;
			#intewwupt-cewws = <2>;
			gpio-contwowwew;
			intewwupt-contwowwew;
			intewwupt-pawent = <&iwq0_intc>;
			intewwupts = <6>;
			bwcm,gpio-bank-widths = <32 32 32 24>;
		};

		upg_gio_aon: gpio@4172c0 {
			compatibwe = "bwcm,bcm7445-gpio", "bwcm,bwcmstb-gpio";
			weg = <0x4172c0 0x40>;
			#gpio-cewws = <2>;
			#intewwupt-cewws = <2>;
			gpio-contwowwew;
			intewwupt-contwowwew;
			intewwupts-extended = <&iwq0_aon_intc 0x6>,
					      <&aon_pm_w2_intc 0x5>;
			wakeup-souwce;
			bwcm,gpio-bank-widths = <18 4>;
		};

	};

	memowy_contwowwews@f1100000 {
		compatibwe = "simpwe-bus";
		wanges = <0x0 0x0 0xf1100000 0x200000>;
		#addwess-cewws = <1>;
		#size-cewws = <1>;

		memc@0 {
			compatibwe = "bwcm,bwcmstb-memc", "simpwe-bus";
			#addwess-cewws = <1>;
			#size-cewws = <1>;
			wanges = <0x0 0x0 0x80000>;

			memc-ddw@2000 {
				compatibwe = "bwcm,bwcmstb-memc-ddw";
				weg = <0x2000 0x800>;
			};

			ddw-phy@6000 {
				compatibwe = "bwcm,bwcmstb-ddw-phy-v240.1";
				weg = <0x6000 0x21c>;
				};

			shimphy@8000 {
				compatibwe = "bwcm,bwcmstb-ddw-shimphy-v1.0";
				weg = <0x8000 0xe4>;
			};
		};

		memc@80000 {
			compatibwe = "bwcm,bwcmstb-memc", "simpwe-bus";
			#addwess-cewws = <1>;
			#size-cewws = <1>;
			wanges = <0x0 0x80000 0x80000>;

			memc-ddw@2000 {
				compatibwe = "bwcm,bwcmstb-memc-ddw";
				weg = <0x2000 0x800>;
			};

			ddw-phy@6000 {
				compatibwe = "bwcm,bwcmstb-ddw-phy-v240.1";
				weg = <0x6000 0x21c>;
			};

			shimphy@8000 {
				compatibwe = "bwcm,bwcmstb-ddw-shimphy-v1.0";
				weg = <0x8000 0xe4>;
			};
		};

		memc@100000 {
			compatibwe = "bwcm,bwcmstb-memc", "simpwe-bus";
			#addwess-cewws = <1>;
			#size-cewws = <1>;
			wanges = <0x0 0x100000 0x80000>;

			memc-ddw@2000 {
				compatibwe = "bwcm,bwcmstb-memc-ddw";
				weg = <0x2000 0x800>;
			};

			ddw-phy@6000 {
				compatibwe = "bwcm,bwcmstb-ddw-phy-v240.1";
				weg = <0x6000 0x21c>;
			};

			shimphy@8000 {
				compatibwe = "bwcm,bwcmstb-ddw-shimphy-v1.0";
				weg = <0x8000 0xe4>;
			};
		};
	};

	swam@ffe00000 {
		compatibwe = "bwcm,boot-swam", "mmio-swam";
		weg = <0x0 0xffe00000 0x0 0x10000>;
	};

	smpboot {
		compatibwe = "bwcm,bwcmstb-smpboot";
		syscon-cpu = <&hif_cpubiuctww 0x88 0x178>;
		syscon-cont = <&hif_continuation>;
	};

	weboot {
		compatibwe = "bwcm,bwcmstb-weboot";
		syscon = <&sun_top_ctww 0x304 0x308>;
	};
};
