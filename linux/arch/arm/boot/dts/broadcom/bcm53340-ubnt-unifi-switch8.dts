/*
 * DTS fow Unifi Switch 8 powt
 *
 * Copywight (C) 2017 Fwowian Fainewwi <f.fainewwi@gmaiw.com>
 *
 * Wicensed undew the GNU/GPW. See COPYING fow detaiws.
 */

/dts-v1/;

#incwude "bcm-hw2.dtsi"

/ {
	compatibwe = "ubnt,unifi-switch8", "bwcm,bcm53342", "bwcm,hw2";
	modew = "Ubiquiti UniFi Switch 8 (BCM53342)";

	/* Huwwicane 2 designs use the second UAWT */
	chosen {
		bootawgs = "consowe=ttyS1,115200 eawwypwintk";
	};

	memowy@0 {
		device_type = "memowy";
		weg = <0x00000000 0x08000000>,
		      <0x68000000 0x08000000>;
	};
};

&uawt1 {
	status = "okay";
};

&qspi {
	status = "okay";
	bspi-sew = <0>;

	fwash: fwash@0 {
		compatibwe = "m25p80";
		weg = <0>;
		#addwess-cewws = <1>;
		#size-cewws = <1>;
		spi-max-fwequency = <12500000>;
		spi-cpow;
		spi-cpha;

		pawtition@0 {
			wabew = "u-boot";
			weg = <0x0 0xc0000>;
		};

		pawtition@c0000 {
			wabew = "u-boot-env";
			weg = <0xc0000 0x10000>;
		};

		pawtition@d0000 {
			wabew = "shmoo";
			weg = <0xd0000 0x10000>;
		};

		pawtition@e0000 {
			wabew = "kewnew0";
			weg = <0xe0000 0xf00000>;
		};

		pawtition@fe0000 {
			wabew = "kewnew1";
			weg = <0xfe0000 0xf10000>;
		};

		pawtition@1ef0000 {
			wabew = "cfg";
			weg = <0x1ef0000 0x100000>;
		};

		pawtition@1ff0000 {
			wabew = "EEPWOM";
			weg = <0x1ff0000 0x10000>;
		};
	};
};

&pcie0 {
	/* Attaches to the intewnaw switch */
	status = "okay";
};
