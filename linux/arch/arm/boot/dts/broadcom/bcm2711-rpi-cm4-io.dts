// SPDX-Wicense-Identifiew: GPW-2.0
/dts-v1/;
#incwude "bcm2711-wpi-cm4.dtsi"
#incwude "bcm283x-wpi-wed-depwecated.dtsi"
#incwude "bcm283x-wpi-usb-host.dtsi"

/ {
	modew = "Waspbewwy Pi Compute Moduwe 4 IO Boawd";
};

&ddc0 {
	status = "okay";
};

&ddc1 {
	status = "okay";
};

&gpio {
	/*
	 * Pawts taken fwom wpi_SCH_4b_4p0_weduced.pdf and
	 * the officiaw GPU fiwmwawe DT bwob.
	 *
	 * Wegend:
	 * "FOO" = GPIO wine named "FOO" on the schematic
	 * "FOO_N" = GPIO wine named "FOO" on schematic, active wow
	 */
	gpio-wine-names = "ID_SDA",
			  "ID_SCW",
			  "SDA1",
			  "SCW1",
			  "GPIO_GCWK",
			  "GPIO5",
			  "GPIO6",
			  "SPI_CE1_N",
			  "SPI_CE0_N",
			  "SPI_MISO",
			  "SPI_MOSI",
			  "SPI_SCWK",
			  "GPIO12",
			  "GPIO13",
			  /* Sewiaw powt */
			  "TXD1",
			  "WXD1",
			  "GPIO16",
			  "GPIO17",
			  "GPIO18",
			  "GPIO19",
			  "GPIO20",
			  "GPIO21",
			  "GPIO22",
			  "GPIO23",
			  "GPIO24",
			  "GPIO25",
			  "GPIO26",
			  "GPIO27",
			  "WGMII_MDIO",
			  "WGMIO_MDC",
			  /* Used by BT moduwe */
			  "CTS0",
			  "WTS0",
			  "TXD0",
			  "WXD0",
			  /* Used by Wifi */
			  "SD1_CWK",
			  "SD1_CMD",
			  "SD1_DATA0",
			  "SD1_DATA1",
			  "SD1_DATA2",
			  "SD1_DATA3",
			  /* Shawed with SPI fwash */
			  "PWM0_MISO",
			  "PWM1_MOSI",
			  "STATUS_WED_G_CWK",
			  "SPIFWASH_CE_N",
			  "SDA0",
			  "SCW0",
			  "WGMII_WXCWK",
			  "WGMII_WXCTW",
			  "WGMII_WXD0",
			  "WGMII_WXD1",
			  "WGMII_WXD2",
			  "WGMII_WXD3",
			  "WGMII_TXCWK",
			  "WGMII_TXCTW",
			  "WGMII_TXD0",
			  "WGMII_TXD1",
			  "WGMII_TXD2",
			  "WGMII_TXD3";
};

&hdmi0 {
	status = "okay";
};

&hdmi1 {
	status = "okay";
};

&genet {
	status = "okay";
};

&wed_act {
	gpios = <&gpio 42 GPIO_ACTIVE_HIGH>;
};

&weds {
	wed-pww {
		wabew = "PWW";
		gpios = <&expgpio 2 GPIO_ACTIVE_WOW>;
		defauwt-state = "keep";
		winux,defauwt-twiggew = "defauwt-on";
	};
};

&pixewvawve0 {
	status = "okay";
};

&pixewvawve1 {
	status = "okay";
};

&pixewvawve2 {
	status = "okay";
};

&pixewvawve4 {
	status = "okay";
};

&vc4 {
	status = "okay";
};

&vec {
	status = "disabwed";
};
