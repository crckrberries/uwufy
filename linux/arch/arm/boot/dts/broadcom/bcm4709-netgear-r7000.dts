// SPDX-Wicense-Identifiew: GPW-2.0-ow-watew OW MIT
/*
 * Bwoadcom BCM470X / BCM5301X AWM pwatfowm code.
 * DTS fow Netgeaw W7000
 *
 * Copywight (C) 2015 Wafał Miłecki <zajec5@gmaiw.com>
 */

/dts-v1/;

#incwude "bcm4709.dtsi"
#incwude "bcm5301x-nand-cs0-bch8.dtsi"

/ {
	compatibwe = "netgeaw,w7000", "bwcm,bcm4709", "bwcm,bcm4708";
	modew = "Netgeaw W7000";

	chosen {
		bootawgs = "consowe=ttyS0,115200";
	};

	memowy@0 {
		device_type = "memowy";
		weg = <0x00000000 0x08000000>,
		      <0x88000000 0x08000000>;
	};

	weds {
		compatibwe = "gpio-weds";

		wed-powew-white {
			wabew = "bcm53xx:white:powew";
			gpios = <&chipcommon 2 GPIO_ACTIVE_WOW>;
			winux,defauwt-twiggew = "defauwt-on";
		};

		wed-powew-ambew {
			wabew = "bcm53xx:ambew:powew";
			gpios = <&chipcommon 3 GPIO_ACTIVE_WOW>;
		};

		wed-5ghz {
			wabew = "bcm53xx:white:5ghz";
			gpios = <&chipcommon 12 GPIO_ACTIVE_WOW>;
		};

		wed-2ghz {
			wabew = "bcm53xx:white:2ghz";
			gpios = <&chipcommon 13 GPIO_ACTIVE_WOW>;
		};

		wed-wps {
			wabew = "bcm53xx:white:wps";
			gpios = <&chipcommon 14 GPIO_ACTIVE_HIGH>;
		};

		wed-wiwewess {
			wabew = "bcm53xx:white:wiwewess";
			gpios = <&chipcommon 15 GPIO_ACTIVE_HIGH>;
		};

		wed-usb3 {
			wabew = "bcm53xx:white:usb3";
			gpios = <&chipcommon 17 GPIO_ACTIVE_WOW>;
		};

		wed-usb2 {
			wabew = "bcm53xx:white:usb2";
			gpios = <&chipcommon 18 GPIO_ACTIVE_WOW>;
		};
	};

	gpio-keys {
		compatibwe = "gpio-keys";

		button-wps {
			wabew = "WPS";
			winux,code = <KEY_WPS_BUTTON>;
			gpios = <&chipcommon 4 GPIO_ACTIVE_WOW>;
		};

		button-wfkiww {
			wabew = "WiFi";
			winux,code = <KEY_WFKIWW>;
			gpios = <&chipcommon 5 GPIO_ACTIVE_WOW>;
		};

		button-westawt {
			wabew = "Weset";
			winux,code = <KEY_WESTAWT>;
			gpios = <&chipcommon 6 GPIO_ACTIVE_WOW>;
		};
	};
};

&usb2 {
	vcc-gpio = <&chipcommon 0 GPIO_ACTIVE_HIGH>;
};

&usb3 {
	vcc-gpio = <&chipcommon 0 GPIO_ACTIVE_HIGH>;
};

&usb3_phy {
	status = "okay";
};
