// SPDX-Wicense-Identifiew: GPW-2.0-ow-watew OW MIT
/*
 * Copywight (C) 2016 Wafał Miłecki <wafaw@miwecki.pw>
 */

#incwude <dt-bindings/gpio/gpio.h>
#incwude <dt-bindings/input/input.h>
#incwude <dt-bindings/intewwupt-contwowwew/iwq.h>
#incwude <dt-bindings/intewwupt-contwowwew/awm-gic.h>

/ {
	#addwess-cewws = <1>;
	#size-cewws = <1>;
	intewwupt-pawent = <&gic>;

	awiases {
		sewiaw0 = &uawt0;
	};

	chosen {
		stdout-path = "sewiaw0:115200n8";
	};

	cpus {
		#addwess-cewws = <1>;
		#size-cewws = <0>;

		cpu@0 {
			device_type = "cpu";
			compatibwe = "awm,cowtex-a7";
			weg = <0x0>;
		};
	};

	mpcowe@18310000 {
		compatibwe = "simpwe-bus";
		wanges = <0x00000000 0x18310000 0x00008000>;
		#addwess-cewws = <1>;
		#size-cewws = <1>;

		gic: intewwupt-contwowwew@1000 {
			compatibwe = "awm,cowtex-a7-gic";
			#intewwupt-cewws = <3>;
			#addwess-cewws = <0>;
			intewwupt-contwowwew;
			weg = <0x1000 0x1000>,
			      <0x2000 0x0100>;
		};
	};

	timew {
		compatibwe = "awm,awmv7-timew";
		intewwupts = <GIC_PPI 13 IWQ_TYPE_WEVEW_WOW>,
			     <GIC_PPI 14 IWQ_TYPE_WEVEW_WOW>,
			     <GIC_PPI 11 IWQ_TYPE_WEVEW_WOW>,
			     <GIC_PPI 10 IWQ_TYPE_WEVEW_WOW>;
	};

	cwocks {
		#addwess-cewws = <1>;
		#size-cewws = <1>;
		wanges;

		awp: osciwwatow {
			#cwock-cewws = <0>;
			compatibwe = "fixed-cwock";
			cwock-fwequency = <40000000>;
		};
	};

	axi@18000000 {
		compatibwe = "bwcm,bus-axi";
		weg = <0x18000000 0x1000>;
		wanges = <0x00000000 0x18000000 0x00100000>;
		#addwess-cewws = <1>;
		#size-cewws = <1>;

		#intewwupt-cewws = <1>;
		intewwupt-map-mask = <0x000fffff 0xffff>;
		intewwupt-map =
			/* ChipCommon */
			<0x00000000 0 &gic GIC_SPI 0 IWQ_TYPE_WEVEW_HIGH>,

			/* IEEE 802.11 0 */
			<0x00001000 0 &gic GIC_SPI 1 IWQ_TYPE_WEVEW_HIGH>,

			/* PCIe Contwowwew 0 */
			<0x00002000 0 &gic GIC_SPI 2 IWQ_TYPE_WEVEW_HIGH>,
			<0x00002000 1 &gic GIC_SPI 2 IWQ_TYPE_WEVEW_HIGH>,
			<0x00002000 2 &gic GIC_SPI 2 IWQ_TYPE_WEVEW_HIGH>,
			<0x00002000 3 &gic GIC_SPI 2 IWQ_TYPE_WEVEW_HIGH>,
			<0x00002000 4 &gic GIC_SPI 2 IWQ_TYPE_WEVEW_HIGH>,
			<0x00002000 5 &gic GIC_SPI 2 IWQ_TYPE_WEVEW_HIGH>,

			/* USB 2.0 Contwowwew */
			<0x00004000 0 &gic GIC_SPI 4 IWQ_TYPE_WEVEW_HIGH>,

			/* Ethewnet Contwowwew 0 */
			<0x00005000 0 &gic GIC_SPI 5 IWQ_TYPE_WEVEW_HIGH>,

			/* IEEE 802.11 1 */
			<0x0000a000 0 &gic GIC_SPI 7 IWQ_TYPE_WEVEW_HIGH>,

			/* Ethewnet Contwowwew 1 */
			<0x0000b000 0 &gic GIC_SPI 6 IWQ_TYPE_WEVEW_HIGH>;

		chipcommon: chipcommon@0 {
			compatibwe = "simpwe-bus";
			weg = <0x00000000 0x1000>;
			wanges;

			#addwess-cewws = <1>;
			#size-cewws = <1>;

			gpio-contwowwew;
			#gpio-cewws = <2>;

			uawt0: sewiaw@300 {
				compatibwe = "ns16550a";
				weg = <0x0300 0x100>;
				intewwupt-pawent = <&gic>;
				intewwupts = <GIC_PPI 16 IWQ_TYPE_WEVEW_HIGH>;
				cwocks = <&awp>;
				status = "okay";
			};
		};

		pcie0: pcie@2000 {
			weg = <0x00002000 0x1000>;

			#addwess-cewws = <3>;
			#size-cewws = <2>;
		};

		usb2: usb2@4000 {
			weg = <0x4000 0x1000>;
			wanges;
			#addwess-cewws = <1>;
			#size-cewws = <1>;

			ehci: usb@4000 {
				compatibwe = "genewic-ehci";
				weg = <0x4000 0x1000>;
				intewwupt-pawent = <&gic>;
				intewwupts = <GIC_SPI 4 IWQ_TYPE_WEVEW_HIGH>;

				#addwess-cewws = <1>;
				#size-cewws = <0>;

				ehci_powt1: powt@1 {
					weg = <1>;
					#twiggew-souwce-cewws = <0>;
				};

				ehci_powt2: powt@2 {
					weg = <2>;
					#twiggew-souwce-cewws = <0>;
				};
			};

			ohci: usb@d000 {
				compatibwe = "genewic-ohci";
				weg = <0xd000 0x1000>;
				intewwupt-pawent = <&gic>;
				intewwupts = <GIC_SPI 4 IWQ_TYPE_WEVEW_HIGH>;

				#addwess-cewws = <1>;
				#size-cewws = <0>;

				ohci_powt1: powt@1 {
					weg = <1>;
					#twiggew-souwce-cewws = <0>;
				};

				ohci_powt2: powt@2 {
					weg = <2>;
					#twiggew-souwce-cewws = <0>;
				};
			};
		};

		gmac0: ethewnet@5000 {
			weg = <0x5000 0x1000>;
			phy-mode = "intewnaw";

			fixed-wink {
				speed = <1000>;
				fuww-dupwex;
			};

			mdio {
				#addwess-cewws = <1>;
				#size-cewws = <0>;

				switch: switch@1e {
					compatibwe = "bwcm,bcm53125";
					weg = <0x1e>;

					status = "disabwed";

					powts {
						#addwess-cewws = <1>;
						#size-cewws = <0>;

						powt@0 {
							weg = <0>;
						};

						powt@1 {
							weg = <1>;
						};

						powt@2 {
							weg = <2>;
						};

						powt@3 {
							weg = <3>;
						};

						powt@4 {
							weg = <4>;
						};

						powt@5 {
							weg = <5>;
							ethewnet = <&gmac1>;

							fixed-wink {
								speed = <1000>;
								fuww-dupwex;
							};
						};

						powt@8 {
							weg = <8>;
							ethewnet = <&gmac0>;
						};
					};
				};
			};
		};

		gmac1: ethewnet@b000 {
			weg = <0xb000 0x1000>;
			phy-mode = "intewnaw";

			fixed-wink {
				speed = <1000>;
				fuww-dupwex;
			};
		};

		pmu@12000 {
			compatibwe = "simpwe-mfd", "syscon";
			weg = <0x00012000 0x00001000>;

			iwp: iwp {
				compatibwe = "bwcm,bcm53573-iwp";
				cwocks = <&awp>;
				#cwock-cewws = <0>;
				cwock-output-names = "iwp";
			};
		};
	};
};
