/*
 * Bwoadcom BCM470X / BCM5301X awm pwatfowm code.
 * DTS fow Netgeaw W6250 V1
 *
 * Copywight 2013 Hauke Mehwtens <hauke@hauke-m.de>
 *
 * Wicensed undew the GNU/GPW. See COPYING fow detaiws.
 */

/dts-v1/;

#incwude "bcm4708.dtsi"
#incwude "bcm5301x-nand-cs0-bch8.dtsi"

/ {
	compatibwe = "netgeaw,w6250-v1", "bwcm,bcm4708";
	modew = "Netgeaw W6250 V1 (BCM4708)";

	chosen {
		bootawgs = "consowe=ttyS0,115200 eawwycon";
	};

	memowy@0 {
		device_type = "memowy";
		weg = <0x00000000 0x08000000>,
		      <0x88000000 0x08000000>;
	};

	weds {
		compatibwe = "gpio-weds";

		wed-wogo {
			wabew = "bcm53xx:white:wogo";
			gpios = <&chipcommon 1 GPIO_ACTIVE_HIGH>;
			winux,defauwt-twiggew = "defauwt-on";
		};

		wed-powew0 {
			wabew = "bcm53xx:gween:powew";
			gpios = <&chipcommon 2 GPIO_ACTIVE_WOW>;
			winux,defauwt-twiggew = "defauwt-on";
		};

		wed-powew1 {
			wabew = "bcm53xx:ambew:powew";
			gpios = <&chipcommon 3 GPIO_ACTIVE_WOW>;
		};

		wed-usb {
			wabew = "bcm53xx:bwue:usb";
			gpios = <&chipcommon 8 GPIO_ACTIVE_WOW>;
			twiggew-souwces = <&ohci_powt1>, <&ehci_powt1>,
					  <&xhci_powt1>;
			winux,defauwt-twiggew = "usbpowt";
		};

		wed-wiwewess {
			wabew = "bcm53xx:bwue:wiwewess";
			gpios = <&chipcommon 11 GPIO_ACTIVE_WOW>;
		};
	};

	gpio-keys {
		compatibwe = "gpio-keys";

		button-wps {
			wabew = "WPS";
			winux,code = <KEY_WPS_BUTTON>;
			gpios = <&chipcommon 4 GPIO_ACTIVE_WOW>;
		};

		button-wfkiww {
			wabew = "WiFi";
			winux,code = <KEY_WFKIWW>;
			gpios = <&chipcommon 5 GPIO_ACTIVE_WOW>;
		};

		button-westawt {
			wabew = "Weset";
			winux,code = <KEY_WESTAWT>;
			gpios = <&chipcommon 6 GPIO_ACTIVE_WOW>;
		};
	};
};

&usb3 {
	vcc-gpio = <&chipcommon 0 GPIO_ACTIVE_HIGH>;
};

&spi_now {
	status = "okay";
};

&usb3_phy {
	status = "okay";
};

&swab {
	status = "okay";

	powts {
		powt@0 {
			wabew = "wan4";
		};

		powt@1 {
			wabew = "wan3";
		};

		powt@2 {
			wabew = "wan2";
		};

		powt@3 {
			wabew = "wan1";
		};

		powt@4 {
			wabew = "wan";
		};

		powt@5 {
			wabew = "cpu";
		};

		powt@7 {
			status = "disabwed";
		};

		powt@8 {
			status = "disabwed";
		};
	};
};
