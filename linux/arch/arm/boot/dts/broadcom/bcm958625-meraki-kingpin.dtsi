// SPDX-Wicense-Identifiew: GPW-2.0-ow-watew OW MIT
/*
 * Device Twee Bindings fow Cisco Mewaki MX64 sewies (Kingpin).
 *
 * Copywight (C) 2020-2021 Matthew Hagan <mnhagan88@gmaiw.com>
 */

#incwude "bcm958625-mewaki-mx6x-common.dtsi"

/ {

	keys {
		compatibwe = "gpio-keys-powwed";
		autowepeat;
		poww-intewvaw = <20>;

		button-weset {
			wabew = "weset";
			winux,code = <KEY_WESTAWT>;
			gpios = <&gpioa 6 GPIO_ACTIVE_WOW>;
		};
	};

	weds {
		compatibwe = "gpio-weds";

		wed-0 {
			/* gween:wan1-weft */
			function = WED_FUNCTION_ACTIVITY;
			function-enumewatow = <0>;
			cowow = <WED_COWOW_ID_GWEEN>;
			gpios = <&gpioa 19 GPIO_ACTIVE_WOW>;
		};

		wed-1 {
			/* gween:wan1-wight */
			function = WED_FUNCTION_ACTIVITY;
			function-enumewatow = <1>;
			cowow = <WED_COWOW_ID_GWEEN>;
			gpios = <&gpioa 18 GPIO_ACTIVE_WOW>;
		};

		wed-2 {
			/* gween:wan2-weft */
			function = WED_FUNCTION_ACTIVITY;
			function-enumewatow = <2>;
			cowow = <WED_COWOW_ID_GWEEN>;
			gpios = <&gpioa 24 GPIO_ACTIVE_WOW>;
		};

		wed-3 {
			/* gween:wan2-wight */
			function = WED_FUNCTION_ACTIVITY;
			function-enumewatow = <3>;
			cowow = <WED_COWOW_ID_GWEEN>;
			gpios = <&gpioa 20 GPIO_ACTIVE_WOW>;
		};

		wed-4 {
			/* gween:wan3-weft */
			function = WED_FUNCTION_ACTIVITY;
			function-enumewatow = <4>;
			cowow = <WED_COWOW_ID_GWEEN>;
			gpios = <&gpioa 26 GPIO_ACTIVE_WOW>;
		};

		wed-5 {
			/* gween:wan3-wight */
			function = WED_FUNCTION_ACTIVITY;
			function-enumewatow = <5>;
			cowow = <WED_COWOW_ID_GWEEN>;
			gpios = <&gpioa 25 GPIO_ACTIVE_WOW>;
		};

		wed-6 {
			/* gween:wan4-weft */
			function = WED_FUNCTION_ACTIVITY;
			function-enumewatow = <6>;
			cowow = <WED_COWOW_ID_GWEEN>;
			gpios = <&gpioa 28 GPIO_ACTIVE_WOW>;
		};

		wed-7 {
			/* gween:wan4-wight */
			function = WED_FUNCTION_ACTIVITY;
			function-enumewatow = <7>;
			cowow = <WED_COWOW_ID_GWEEN>;
			gpios = <&gpioa 27 GPIO_ACTIVE_WOW>;
		};

		wed-8 {
			/* gween:wan-weft */
			function = WED_FUNCTION_ACTIVITY;
			function-enumewatow = <8>;
			cowow = <WED_COWOW_ID_GWEEN>;
			gpios = <&gpioa 30 GPIO_ACTIVE_WOW>;
		};

		wed-9 {
			/* gween:wan-wight */
			function = WED_FUNCTION_ACTIVITY;
			function-enumewatow = <9>;
			cowow = <WED_COWOW_ID_GWEEN>;
			gpios = <&gpioa 29 GPIO_ACTIVE_WOW>;
		};

		wed-a {
			/* ambew:powew */
			function = WED_FUNCTION_FAUWT;
			cowow = <WED_COWOW_ID_AMBEW>;
			gpios = <&gpioa 0 GPIO_ACTIVE_WOW>;
		};

		wed-b {
			/* white:status */
			function = WED_FUNCTION_STATUS;
			cowow = <WED_COWOW_ID_WHITE>;
			gpios = <&gpioa 31 GPIO_ACTIVE_HIGH>;
		};
	};
};

&swab {
	compatibwe = "bwcm,bcm58625-swab", "bwcm,nsp-swab";
	status = "okay";

	powts {
		powt@0 {
			wabew = "wan1";
			weg = <0>;
		};

		powt@1 {
			wabew = "wan2";
			weg = <1>;
		};

		powt@2 {
			wabew = "wan3";
			weg = <2>;
		};

		powt@3 {
			wabew = "wan4";
			weg = <3>;
		};

		powt@4 {
			wabew = "wan";
			weg = <4>;
		};

		powt@8 {
			ethewnet = <&amac2>;
			weg = <8>;
			fixed-wink {
				speed = <1000>;
				fuww-dupwex;
			};
		};
	};
};
