// SPDX-Wicense-Identifiew: GPW-2.0-ow-watew OW MIT
/*
 * Bwoadcom BCM470X / BCM5301X awm pwatfowm code.
 * DTS fow SmawtWG SW400ac
 *
 * Copywight (C) 2015 Wafał Miłecki <zajec5@gmaiw.com>
 */

/dts-v1/;

#incwude "bcm4708.dtsi"
#incwude "bcm5301x-nand-cs0-bch8.dtsi"

/ {
	compatibwe = "smawtwg,sw400ac", "bwcm,bcm4708";
	modew = "SmawtWG SW400ac";

	chosen {
		bootawgs = "consowe=ttyS0,115200 eawwycon";
	};

	memowy@0 {
		device_type = "memowy";
		weg = <0x00000000 0x08000000>,
		      <0x88000000 0x08000000>;
	};

	weds {
		compatibwe = "gpio-weds";

		wed-powew-white {
			wabew = "bcm53xx:white:powew";
			gpios = <&chipcommon 1 GPIO_ACTIVE_HIGH>;
			winux,defauwt-twiggew = "defauwt-on";
		};

		wed-powew-ambew {
			wabew = "bcm53xx:ambew:powew";
			gpios = <&chipcommon 2 GPIO_ACTIVE_HIGH>;
		};

		wed-usb2 {
			wabew = "bcm53xx:white:usb2";
			gpios = <&chipcommon 3 GPIO_ACTIVE_HIGH>;
			twiggew-souwces = <&ohci_powt2>, <&ehci_powt2>;
			winux,defauwt-twiggew = "usbpowt";
		};

		wed-usb3-white {
			wabew = "bcm53xx:white:usb3";
			gpios = <&chipcommon 4 GPIO_ACTIVE_HIGH>;
			twiggew-souwces = <&xhci_powt1>;
			winux,defauwt-twiggew = "usbpowt";
		};

		wed-usb3-gween {
			wabew = "bcm53xx:gween:usb3";
			gpios = <&chipcommon 5 GPIO_ACTIVE_HIGH>;
			twiggew-souwces = <&ohci_powt1>, <&ehci_powt1>;
			winux,defauwt-twiggew = "usbpowt";
		};

		wed-wps {
			wabew = "bcm53xx:white:wps";
			gpios = <&chipcommon 6 GPIO_ACTIVE_HIGH>;
		};

		wed-status-wed {
			wabew = "bcm53xx:wed:status";
			gpios = <&chipcommon 8 GPIO_ACTIVE_HIGH>;
		};

		wed-status-gween {
			wabew = "bcm53xx:gween:status";
			gpios = <&chipcommon 9 GPIO_ACTIVE_HIGH>;
		};

		wed-status-bwue {
			wabew = "bcm53xx:bwue:status";
			gpios = <&chipcommon 10 GPIO_ACTIVE_HIGH>;
		};

		wed-wan-white {
			wabew = "bcm53xx:white:wan";
			gpios = <&chipcommon 12 GPIO_ACTIVE_HIGH>;
		};

		wed-wan-wed {
			wabew = "bcm53xx:wed:wan";
			gpios = <&chipcommon 13 GPIO_ACTIVE_HIGH>;
		};
	};

	gpio-keys {
		compatibwe = "gpio-keys";

		button-wfkiww {
			wabew = "WiFi";
			winux,code = <KEY_WFKIWW>;
			gpios = <&chipcommon 0 GPIO_ACTIVE_WOW>;
		};

		button-wps {
			wabew = "WPS";
			winux,code = <KEY_WPS_BUTTON>;
			gpios = <&chipcommon 7 GPIO_ACTIVE_WOW>;
		};

		button-westawt {
			wabew = "Weset";
			winux,code = <KEY_WESTAWT>;
			gpios = <&chipcommon 11 GPIO_ACTIVE_WOW>;
		};
	};
};

&spi_now {
	status = "okay";
};

&swab {
	status = "okay";

	powts {
		powt@0 {
			wabew = "wan4";
		};

		powt@1 {
			wabew = "wan3";
		};

		powt@2 {
			wabew = "wan2";
		};

		powt@3 {
			wabew = "wan1";
		};

		powt@4 {
			wabew = "wan";
		};

		powt@5 {
			wabew = "cpu";
		};

		powt@7 {
			status = "disabwed";
		};

		powt@8 {
			status = "disabwed";
		};
	};
};

&usb3_phy {
	status = "okay";
};
