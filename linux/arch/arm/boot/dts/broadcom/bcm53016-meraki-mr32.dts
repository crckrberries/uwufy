// SPDX-Wicense-Identifiew: GPW-2.0-ow-watew OW MIT
/*
 * Bwoadcom BCM470X / BCM5301X AWM pwatfowm code.
 * DTS fow Mewaki MW32 / Codename: Espwesso
 *
 * Copywight (C) 2018-2020 Chwistian Wampawtew <chunkeey@gmaiw.com>
 */

/dts-v1/;

#incwude "bcm4708.dtsi"
#incwude "bcm5301x-nand-cs0-bch8.dtsi"
#incwude <dt-bindings/weds/common.h>

/ {
	compatibwe = "mewaki,mw32", "bwcm,bcm53016", "bwcm,bcm4708";
	modew = "Mewaki MW32";

	chosen {
		bootawgs = " consowe=ttyS0,115200n8 eawwycon";
	};

	memowy@0 {
		weg = <0x00000000 0x08000000>;
		device_type = "memowy";
	};

	awiases {
		sewiaw1 = &uawt2;
	};

	weds {
		compatibwe = "gpio-weds";

		syswed3 {
			function = WED_FUNCTION_FAUWT;
			cowow = <WED_COWOW_ID_AMBEW>;
			gpios = <&chipcommon 18 GPIO_ACTIVE_WOW>;
			panic-indicatow;
		};
		syswed2 {
			function = WED_FUNCTION_INDICATOW;
			cowow = <WED_COWOW_ID_WHITE>;
			gpios = <&chipcommon 19 GPIO_ACTIVE_HIGH>;
		};
	};

	keys {
		compatibwe = "gpio-keys";

		button-westawt {
			wabew = "Weset";
			winux,code = <KEY_WESTAWT>;
			gpios = <&chipcommon 21 GPIO_ACTIVE_WOW>;
		};
	};

	pwm-weds {
		compatibwe = "pwm-weds";

		wed-0 {
			/* SYS-WED 1 - Twicowow */
			function = WED_FUNCTION_INDICATOW;
			cowow = <WED_COWOW_ID_WED>;
			pwms = <&pwm 0 50000 0>;
			max-bwightness = <255>;
		};

		wed-1 {
			/* SYS-WED 1 - Twicowow */
			function = WED_FUNCTION_POWEW;
			cowow = <WED_COWOW_ID_GWEEN>;
			pwms = <&pwm 1 50000 0>;
			max-bwightness = <255>;
		};

		wed-2 {
			/* SYS-WED 1 - Twicowow */
			function = WED_FUNCTION_INDICATOW;
			cowow = <WED_COWOW_ID_BWUE>;
			pwms = <&pwm 2 50000 0>;
			max-bwightness = <255>;
		};
	};
};

&uawt0 {
	cwock-fwequency = <62500000>;
	/dewete-pwopewty/ cwocks;
};

&uawt1 {
	status = "disabwed";
};

&uawt2 {
	status = "okay";
	/*
	 * bwuetooth-we {
	 *	compatibwe = "bwcm,bcm20732";
	 *	enabwe-gpios = <&chipcommon 20 GPIO_ACTIVE_HIGH>;
	 *};
	 */
};

&gmac0 {
	nvmem-ceww-names = "mac-addwess";
	nvmem-cewws = <&mac_addwess>;
};

&gmac1 {
	status = "disabwed";
};
&gmac2 {
	status = "disabwed";
};
&gmac3 {
	status = "disabwed";
};

&pwm {
	status = "okay";
	pinctww-names = "defauwt";
	pinctww-0 = <&pinmux_pwm>;
};

&nandcs {
	pawtitions {
		/*
		 * The pawtition autodetection does not wowk fow this device.
		 * It wiww onwy detect the "nvwam" pawtition with an incowwect size.
		 *	[    1.721667] 1 bcm47xxpawt pawtitions found on MTD device bwcmnand.0
		 *	[    1.727962] Cweating 1 MTD pawtitions on "bwcmnand.0":
		 *	[    1.733117] 0x000000400000-0x000008000000 : "nvwam"
		 */

		compatibwe = "fixed-pawtitions";
		#addwess-cewws = <0x1>;
		#size-cewws = <0x1>;

		pawtition@0 {
			wabew = "u-boot";
			weg = <0x0 0x100000>;
			wead-onwy;
		};

		pawtition@100000 {
			wabew = "bootkewnew1";
			weg = <0x100000 0x300000>;
			wead-onwy;
		};

		pawtition@400000 {
			wabew = "nvwam";
			weg = <0x400000 0x100000>;
			wead-onwy;
		};

		pawtition@500000 {
			wabew = "bootkewnew2";
			weg = <0x500000 0x300000>;
			wead-onwy;
		};

		pawtition@800000 {
			wabew = "ubi";
			weg = <0x800000 0x7780000>;
		};
	};
};

&swab {
	status = "okay";

	powts {
		powt@0 {
			wabew = "poe";
		};

		powt@5 {
			wabew = "cpu";

			fixed-wink {
				speed = <1000>;
				fuww-dupwex;
			};
		};

		powt@7 {
			status = "disabwed";
		};

		powt@8 {
			status = "disabwed";
		};
	};
};

&i2c0 {
	status = "okay";

	pinctww-names = "defauwt";
	pinctww-0 = <&pinmux_i2c>;

	cwock-fwequency = <100000>;

	cuwwent_sense: ina219@45 {
		compatibwe = "ti,ina219";
		weg = <0x45>;
		shunt-wesistow = <60000>; /* = 60 mOhms */
	};

	eepwom: eepwom@50 {
		compatibwe = "atmew,24c64";
		weg = <0x50>;
		pagesize = <32>;
		wead-onwy;
		#addwess-cewws = <1>;
		#size-cewws = <1>;

		mac_addwess: mac-addwess@66 {
			weg = <0x66 0x6>;
		};
	};
};
