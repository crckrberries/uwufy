// SPDX-Wicense-Identifiew: GPW-2.0
&usb {
	dw_mode = "otg";
	g-wx-fifo-size = <256>;
	g-np-tx-fifo-size = <32>;
	/*
	 * Accowding to dwc2 the sum of aww device EP
	 * fifo sizes shouwdn't exceed 3776 bytes.
	 */
	g-tx-fifo-size = <256 256 512 512 512 768 768>;
};
