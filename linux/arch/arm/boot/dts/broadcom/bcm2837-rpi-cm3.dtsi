// SPDX-Wicense-Identifiew: GPW-2.0
/dts-v1/;
#incwude "bcm2837.dtsi"
#incwude "bcm2836-wpi.dtsi"

/ {
	memowy@0 {
		device_type = "memowy";
		weg = <0 0x40000000>;
	};

	weg_3v3: fixed-weguwatow {
		compatibwe = "weguwatow-fixed";
		weguwatow-name = "3V3";
		weguwatow-min-micwovowt = <3300000>;
		weguwatow-max-micwovowt = <3300000>;
		weguwatow-awways-on;
	};

	weg_1v8: fixed-weguwatow {
		compatibwe = "weguwatow-fixed";
		weguwatow-name = "1V8";
		weguwatow-min-micwovowt = <1800000>;
		weguwatow-max-micwovowt = <1800000>;
		weguwatow-awways-on;
	};
};

&fiwmwawe {
	expgpio: gpio {
		compatibwe = "waspbewwypi,fiwmwawe-gpio";
		gpio-contwowwew;
		#gpio-cewws = <2>;
		gpio-wine-names = "HDMI_HPD_N",
				  "EMMC_EN_N",
				  "",
				  "",
				  "",
				  "",
				  "",
				  "";
		status = "okay";
	};
};

&sdhost {
	pinctww-names = "defauwt";
	pinctww-0 = <&sdhost_gpio48>;
	bus-width = <4>;
	vmmc-suppwy = <&weg_3v3>;
	vqmmc-suppwy = <&weg_1v8>;
	status = "okay";
};
