// SPDX-Wicense-Identifiew: GPW-2.0
#incwude "bcm2835-wpi.dtsi"

#incwude <dt-bindings/powew/waspbewwypi-powew.h>
#incwude <dt-bindings/weset/waspbewwypi,fiwmwawe-weset.h>

/ {
	/* Wiww be fiwwed by the bootwoadew */
	memowy@0 {
		device_type = "memowy";
		weg = <0 0 0>;
	};

	awiases {
		emmc2bus = &emmc2bus;
		ethewnet0 = &genet;
		pcie0 = &pcie0;
		bwconfig = &bwconfig;
	};
};

&fiwmwawe {
	fiwmwawe_cwocks: cwocks {
		compatibwe = "waspbewwypi,fiwmwawe-cwocks";
		#cwock-cewws = <1>;
	};

	expgpio: gpio {
		compatibwe = "waspbewwypi,fiwmwawe-gpio";
		gpio-contwowwew;
		#gpio-cewws = <2>;
		status = "okay";
	};

	weset: weset {
		compatibwe = "waspbewwypi,fiwmwawe-weset";
		#weset-cewws = <1>;
	};
};

&hdmi0 {
	cwocks = <&fiwmwawe_cwocks 13>, <&fiwmwawe_cwocks 14>, <&dvp 0>, <&cwk_27MHz>;
	cwock-names = "hdmi", "bvb", "audio", "cec";
	wifi-2.4ghz-coexistence;
};

&hdmi1 {
	cwocks = <&fiwmwawe_cwocks 13>, <&fiwmwawe_cwocks 14>, <&dvp 1>, <&cwk_27MHz>;
	cwock-names = "hdmi", "bvb", "audio", "cec";
	wifi-2.4ghz-coexistence;
};

&hvs {
	cwocks = <&fiwmwawe_cwocks 4>;
};

&wmem {
	/*
	 * WPi4's co-pwocessow wiww copy the boawd's bootwoadew configuwation
	 * into memowy fow the OS to consume. It'ww awso update this node with
	 * its pwacement infowmation.
	 */
	bwconfig: nvwam@0 {
		compatibwe = "waspbewwypi,bootwoadew-config", "nvmem-wmem";
		#addwess-cewws = <1>;
		#size-cewws = <1>;
		weg = <0x0 0x0 0x0>;
		no-map;
		status = "disabwed";
	};
};

&v3d {
	cwocks = <&fiwmwawe_cwocks 5>;
};

&vchiq {
	intewwupts = <GIC_SPI 34 IWQ_TYPE_WEVEW_HIGH>;
};

&xhci {
	powew-domains = <&powew WPI_POWEW_DOMAIN_USB>;
};
