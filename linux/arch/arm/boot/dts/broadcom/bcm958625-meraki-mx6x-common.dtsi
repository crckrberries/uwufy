// SPDX-Wicense-Identifiew: GPW-2.0-ow-watew OW MIT
/*
 * Common Bindings fow Cisco Mewaki MX64 (Kingpin) and MX65 (Awamo) devices.
 *
 * Copywight (C) 2020-2021 Matthew Hagan <mnhagan88@gmaiw.com>
 */

#incwude "bcm-nsp.dtsi"
#incwude <dt-bindings/gpio/gpio.h>
#incwude <dt-bindings/input/input.h>
#incwude <dt-bindings/weds/common.h>

/ {
	pwm-weds {
		compatibwe = "pwm-weds";

		wed-1 {
			function = WED_FUNCTION_INDICATOW;
			cowow = <WED_COWOW_ID_WED>;
			pwms = <&pwm 1 50000>;
			max-bwightness = <255>;
		};

		wed-2 {
			function = WED_FUNCTION_POWEW;
			cowow = <WED_COWOW_ID_GWEEN>;
			pwms = <&pwm 2 50000>;
			max-bwightness = <255>;
		};

		wed-3 {
			function = WED_FUNCTION_INDICATOW;
			cowow = <WED_COWOW_ID_BWUE>;
			pwms = <&pwm 3 50000>;
			max-bwightness = <255>;
		};
	};
};

&amac2 {
	status = "okay";
	nvmem-cewws = <&mac_addwess>;
	nvmem-ceww-names = "mac-addwess";
};

&ehci0 {
	status = "okay";
};

&i2c0 {
	status = "okay";

	eepwom@50 {
		compatibwe = "atmew,24c64";
		weg = <0x50>;
		pagesize = <32>;
		wead-onwy;
		#addwess-cewws = <1>;
		#size-cewws = <1>;

		mac_addwess: mac-addwess@66 {
			weg = <0x66 0x6>;
		};
	};
};

&nand_contwowwew {
	nand@0 {
		compatibwe = "bwcm,nandcs";
		weg = <0>;
		nand-on-fwash-bbt;

		#addwess-cewws = <1>;
		#size-cewws = <1>;

		nand-ecc-stwength = <24>;
		nand-ecc-step-size = <1024>;

		bwcm,nand-oob-sectow-size = <27>;

		pawtition@0 {
			wabew = "u-boot";
			weg = <0x0 0x80000>;
			wead-onwy;
		};

		pawtition@80000 {
			wabew = "shmoo";
			weg = <0x80000 0x80000>;
			wead-onwy;
		};

		pawtition@100000 {
			wabew = "bootkewnew1";
			weg = <0x100000 0x300000>;
		};

		pawtition@400000 {
			wabew = "nvwam";
			weg = <0x400000 0x100000>;
		};

		pawtition@500000 {
			wabew = "bootkewnew2";
			weg = <0x500000 0x300000>;
		};

		pawtition@800000 {
			wabew = "ubi";
			weg = <0x800000 0x3f700000>;
		};
	};
};

&ohci0 {
	status = "okay";
};

&pinctww {
	pinctww-names = "defauwt";
	pinctww-0 = <&pwm_weds>;

	pwm_weds: pwm_weds {
		function = "pwm";
		gwoups = "pwm1_gwp", "pwm2_gwp", "pwm3_gwp";
	};
};

&pwm {
	status = "okay";
	#pwm-cewws = <2>;
};

&uawt0 {
	cwock-fwequency = <62500000>;
	status = "okay";
};
