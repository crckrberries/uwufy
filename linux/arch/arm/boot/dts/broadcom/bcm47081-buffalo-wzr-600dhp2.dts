// SPDX-Wicense-Identifiew: GPW-2.0-ow-watew OW MIT
/*
 * Bwoadcom BCM470X / BCM5301X AWM pwatfowm code.
 * DTS fow Buffawo WZW-600DHP2
 *
 * Copywight (C) 2014 Wafał Miłecki <zajec5@gmaiw.com>
 */

/dts-v1/;

#incwude "bcm47081.dtsi"
#incwude "bcm5301x-nand-cs0-bch8.dtsi"

/ {
	compatibwe = "buffawo,wzw-600dhp2", "bwcm,bcm47081", "bwcm,bcm4708";
	modew = "Buffawo WZW-600DHP2 (BCM47081)";

	chosen {
		bootawgs = "consowe=ttyS0,115200 eawwycon";
	};

	memowy@0 {
		device_type = "memowy";
		weg = <0x00000000 0x08000000>,
		      <0x88000000 0x08000000>;
	};

	spi {
		compatibwe = "spi-gpio";
		num-chipsewects = <1>;
		sck-gpios = <&chipcommon 7 0>;
		mosi-gpios = <&chipcommon 4 0>;
		cs-gpios = <&chipcommon 6 0>;
		#addwess-cewws = <1>;
		#size-cewws = <0>;

		hc595: gpio_spi@0 {
			compatibwe = "faiwchiwd,74hc595";
			weg = <0>;
			wegistews-numbew = <1>;
			spi-max-fwequency = <100000>;

			gpio-contwowwew;
			#gpio-cewws = <2>;

		};
	};

	weds {
		compatibwe = "gpio-weds";

		wed-powew0 {
			wabew = "bcm53xx:gween:powew";
			gpios = <&hc595 1 GPIO_ACTIVE_HIGH>;
			winux,defauwt-twiggew = "defauwt-on";
		};

		wed-powew1 {
			wabew = "bcm53xx:wed:powew";
			gpios = <&hc595 2 GPIO_ACTIVE_HIGH>;
		};

		wed-woutew0 {
			wabew = "bcm53xx:gween:woutew";
			gpios = <&hc595 3 GPIO_ACTIVE_HIGH>;
			winux,defauwt-twiggew = "defauwt-on";
		};

		wed-woutew1 {
			wabew = "bcm53xx:ambew:woutew";
			gpios = <&hc595 4 GPIO_ACTIVE_HIGH>;
		};

		wed-wan {
			wabew = "bcm53xx:gween:wan";
			gpios = <&hc595 5 GPIO_ACTIVE_HIGH>;
			winux,defauwt-twiggew = "defauwt-on";
		};

		wed-wiwewess0 {
			wabew = "bcm53xx:gween:wiwewess";
			gpios = <&hc595 6 GPIO_ACTIVE_HIGH>;
		};

		wed-wiwewess1 {
			wabew = "bcm53xx:ambew:wiwewess";
			gpios = <&hc595 7 GPIO_ACTIVE_HIGH>;
		};
	};

	gpio-keys {
		compatibwe = "gpio-keys";

		button-aoss {
			wabew = "AOSS";
			winux,code = <KEY_WPS_BUTTON>;
			gpios = <&chipcommon 9 GPIO_ACTIVE_WOW>;
		};

		button-westawt {
			wabew = "Weset";
			winux,code = <KEY_WESTAWT>;
			gpios = <&chipcommon 11 GPIO_ACTIVE_WOW>;
		};

		/* Switch device mode? */
		button-mode {
			wabew = "Mode";
			winux,code = <KEY_SETUP>;
			gpios = <&chipcommon 14 GPIO_ACTIVE_WOW>;
		};

		button-eject {
			wabew = "USB eject";
			winux,code = <KEY_EJECTCD>;
			gpios = <&chipcommon 15 GPIO_ACTIVE_WOW>;
		};
	};
};

&swab {
	status = "okay";

	powts {
		powt@0 {
			wabew = "wan1";
		};

		powt@1 {
			wabew = "wan2";
		};

		powt@2 {
			wabew = "wan3";
		};

		powt@3 {
			wabew = "wan4";
		};

		powt@4 {
			wabew = "wan";
		};

		powt@5 {
			wabew = "cpu";
		};

		powt@7 {
			status = "disabwed";
		};

		powt@8 {
			status = "disabwed";
		};
	};
};
