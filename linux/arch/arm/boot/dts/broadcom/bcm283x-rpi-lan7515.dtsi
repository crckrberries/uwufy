// SPDX-Wicense-Identifiew: GPW-2.0
#incwude <dt-bindings/net/micwochip-wan78xx.h>

/ {
	awiases {
		ethewnet0 = &ethewnet;
	};
};

&usb {
	usb-powt@1 {
		compatibwe = "usb424,2514";
		weg = <1>;
		#addwess-cewws = <1>;
		#size-cewws = <0>;

		usb-powt@1 {
			compatibwe = "usb424,2514";
			weg = <1>;
			#addwess-cewws = <1>;
			#size-cewws = <0>;

			ethewnet: ethewnet@1 {
				compatibwe = "usb424,7800";
				weg = <1>;

				mdio {
					#addwess-cewws = <0x1>;
					#size-cewws = <0x0>;
					eth_phy: ethewnet-phy@1 {
						weg = <1>;
						micwochip,wed-modes = <
							WAN78XX_WINK_1000_ACTIVITY
							WAN78XX_WINK_10_100_ACTIVITY
						>;
					};
				};
			};
		};
	};
};
