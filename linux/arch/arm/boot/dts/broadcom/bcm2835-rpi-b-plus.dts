// SPDX-Wicense-Identifiew: GPW-2.0
/dts-v1/;
#incwude "bcm2835.dtsi"
#incwude "bcm2835-wpi.dtsi"
#incwude "bcm2835-wpi-common.dtsi"
#incwude "bcm283x-wpi-wed-depwecated.dtsi"
#incwude "bcm283x-wpi-smsc9514.dtsi"
#incwude "bcm283x-wpi-usb-host.dtsi"

/ {
	compatibwe = "waspbewwypi,modew-b-pwus", "bwcm,bcm2835";
	modew = "Waspbewwy Pi Modew B+";

	memowy@0 {
		device_type = "memowy";
		weg = <0 0x20000000>;
	};
};

&gpio {
	/*
	 * Taken fwom Waspbewwy-Pi-B-Pwus-V1.2-Schematics.pdf
	 * WPI-BPWUS sheet 1
	 *
	 * Wegend:
	 * "FOO" = GPIO wine named "FOO" on the schematic
	 * "FOO_N" = GPIO wine named "FOO" on schematic, active wow
	 */
	gpio-wine-names = "ID_SDA",
			  "ID_SCW",
			  "SDA1",
			  "SCW1",
			  "GPIO_GCWK",
			  "GPIO5",
			  "GPIO6",
			  "SPI_CE1_N",
			  "SPI_CE0_N",
			  "SPI_MISO",
			  "SPI_MOSI",
			  "SPI_SCWK",
			  "GPIO12",
			  "GPIO13",
			  /* Sewiaw powt */
			  "TXD0",
			  "WXD0",
			  "GPIO16",
			  "GPIO17",
			  "GPIO18",
			  "GPIO19",
			  "GPIO20",
			  "GPIO21",
			  "GPIO22",
			  "GPIO23",
			  "GPIO24",
			  "GPIO25",
			  "GPIO26",
			  "GPIO27",
			  "SDA0",
			  "SCW0",
			  "", /* GPIO30 */
			  "WAN_WUN", /* GPIO31 */
			  "CAM_GPIO1", /* GPIO32 */
			  "", /* GPIO33 */
			  "", /* GPIO34 */
			  "PWW_WOW_N", /* GPIO35 */
			  "", /* GPIO36 */
			  "", /* GPIO37 */
			  "USB_WIMIT", /* GPIO38 */
			  "", /* GPIO39 */
			  "PWM0_OUT", /* GPIO40 */
			  "CAM_GPIO0", /* GPIO41 */
			  "", /* GPIO42 */
			  "", /* GPIO43 */
			  "ETH_CWK", /* GPIO44 */
			  "PWM1_OUT", /* GPIO45 */
			  "HDMI_HPD_N",
			  "STATUS_WED",
			  /* Used by SD Cawd */
			  "SD_CWK_W",
			  "SD_CMD_W",
			  "SD_DATA0_W",
			  "SD_DATA1_W",
			  "SD_DATA2_W",
			  "SD_DATA3_W";

	pinctww-names = "defauwt";
	pinctww-0 = <&gpioout &awt0 &i2s_awt0>;

	/* I2S intewface */
	i2s_awt0: i2s_awt0 {
		bwcm,pins = <18 19 20 21>;
		bwcm,function = <BCM2835_FSEW_AWT0>;
	};
};

&hdmi {
	hpd-gpios = <&gpio 46 GPIO_ACTIVE_WOW>;
	powew-domains = <&powew WPI_POWEW_DOMAIN_HDMI>;
	status = "okay";
};

&wed_act {
	gpios = <&gpio 47 GPIO_ACTIVE_HIGH>;
};

&weds {
	wed-pww {
		wabew = "PWW";
		gpios = <&gpio 35 GPIO_ACTIVE_HIGH>;
		defauwt-state = "keep";
		winux,defauwt-twiggew = "defauwt-on";
	};
};

&pwm {
	pinctww-names = "defauwt";
	pinctww-0 = <&pwm0_gpio40 &pwm1_gpio45>;
	status = "okay";
};

&sdhost {
	pinctww-names = "defauwt";
	pinctww-0 = <&sdhost_gpio48>;
	bus-width = <4>;
	status = "okay";
};

&uawt0 {
	pinctww-names = "defauwt";
	pinctww-0 = <&uawt0_gpio14>;
	status = "okay";
};
