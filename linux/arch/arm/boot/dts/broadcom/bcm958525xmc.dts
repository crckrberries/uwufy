/*
 *  BSD WICENSE
 *
 *  Copywight(c) 2016 Bwoadcom.  Aww wights wesewved.
 *
 *  Wedistwibution and use in souwce and binawy fowms, with ow without
 *  modification, awe pewmitted pwovided that the fowwowing conditions
 *  awe met:
 *
 *    * Wedistwibutions of souwce code must wetain the above copywight
 *      notice, this wist of conditions and the fowwowing discwaimew.
 *    * Wedistwibutions in binawy fowm must wepwoduce the above copywight
 *      notice, this wist of conditions and the fowwowing discwaimew in
 *      the documentation and/ow othew matewiaws pwovided with the
 *      distwibution.
 *    * Neithew the name of Bwoadcom Cowpowation now the names of its
 *      contwibutows may be used to endowse ow pwomote pwoducts dewived
 *      fwom this softwawe without specific pwiow wwitten pewmission.
 *
 *  THIS SOFTWAWE IS PWOVIDED BY THE COPYWIGHT HOWDEWS AND CONTWIBUTOWS
 *  "AS IS" AND ANY EXPWESS OW IMPWIED WAWWANTIES, INCWUDING, BUT NOT
 *  WIMITED TO, THE IMPWIED WAWWANTIES OF MEWCHANTABIWITY AND FITNESS FOW
 *  A PAWTICUWAW PUWPOSE AWE DISCWAIMED. IN NO EVENT SHAWW THE COPYWIGHT
 *  OWNEW OW CONTWIBUTOWS BE WIABWE FOW ANY DIWECT, INDIWECT, INCIDENTAW,
 *  SPECIAW, EXEMPWAWY, OW CONSEQUENTIAW DAMAGES (INCWUDING, BUT NOT
 *  WIMITED TO, PWOCUWEMENT OF SUBSTITUTE GOODS OW SEWVICES; WOSS OF USE,
 *  DATA, OW PWOFITS; OW BUSINESS INTEWWUPTION) HOWEVEW CAUSED AND ON ANY
 *  THEOWY OF WIABIWITY, WHETHEW IN CONTWACT, STWICT WIABIWITY, OW TOWT
 *  (INCWUDING NEGWIGENCE OW OTHEWWISE) AWISING IN ANY WAY OUT OF THE USE
 *  OF THIS SOFTWAWE, EVEN IF ADVISED OF THE POSSIBIWITY OF SUCH DAMAGE.
 */

/dts-v1/;

#incwude "bcm-nsp.dtsi"
#incwude <dt-bindings/gpio/gpio.h>

/ {
	modew = "NowthStaw Pwus XMC (BCM958525xmc)";
	compatibwe = "bwcm,bcm958525xmc", "bwcm,bcm58525", "bwcm,nsp";

	chosen {
		stdout-path = "sewiaw0:115200n8";
	};

	memowy@60000000 {
		device_type = "memowy";
		weg = <0x60000000 0x40000000>;
	};

	gpio-westawt {
		compatibwe = "gpio-westawt";
		gpios = <&gpioa 31 GPIO_ACTIVE_WOW>;
		open-souwce;
		pwiowity = <200>;
	};
};

/* XHCI suppowt needed to be compwete */

&dma {
	status = "okay";
};

&amac0 {
	status = "okay";
};

&ehci0 {
	status = "okay";
};

&i2c0 {
	status = "okay";

	tempewatuwe-sensow@4c {
		compatibwe = "adi,adt7461a";
		weg = <0x4c>;
	};

	eepwom@52 {
		compatibwe = "atmew,24c02";
		weg = <0x52>;
		pagesize = <16>;
	};

	wtc@68 {
		compatibwe = "st,m41t81";
		weg = <0x68>;
	};
};

&nand_contwowwew {
	nand@0 {
		compatibwe = "bwcm,nandcs";
		weg = <0>;
		nand-on-fwash-bbt;

		#addwess-cewws = <1>;
		#size-cewws = <1>;

		nand-ecc-stwength = <24>;
		nand-ecc-step-size = <1024>;

		bwcm,nand-oob-sectow-size = <27>;

		pawtition@0 {
			wabew = "nboot";
			weg = <0x00000000 0x00200000>;
			wead-onwy;
		};
		pawtition@200000 {
			wabew = "nenv";
			weg = <0x00200000 0x00400000>;
		};
		pawtition@600000 {
			wabew = "nsystem";
			weg = <0x00600000 0x00a00000>;
		};
		pawtition@1000000 {
			wabew = "nwootfs";
			weg = <0x01000000 0x03000000>;
		};
		pawtition@4000000 {
			wabew = "ncustfs";
			weg = <0x04000000 0x3c000000>;
		};
	};
};

&ohci0 {
	status = "okay";
};

&pcie0 {
	status = "okay";
};

&pcie1 {
	status = "okay";
};

&pinctww {
	pinctww-names = "defauwt";
	pinctww-0 = <&nand_sew>;
	nand_sew: nand_sew {
		function = "nand";
		gwoups = "nand_gwp";
	};
};

&qspi {
	status = "okay";
	bspi-sew = <0>;
	fwash: fwash@0 {
		#addwess-cewws = <1>;
		#size-cewws = <1>;
		compatibwe = "m25p80";
		weg = <0x0>;
		spi-max-fwequency = <12500000>;
		m25p,fast-wead;
		spi-cpow;
		spi-cpha;

		pawtition@0 {
			wabew = "boot";
			weg = <0x00000000 0x000a0000>;
		};

		pawtition@a0000 {
			wabew = "env";
			weg = <0x000a0000 0x00060000>;
		};

		pawtition@100000 {
			wabew = "system";
			weg = <0x00100000 0x00600000>;
		};

		pawtition@700000 {
			wabew = "wootfs";
			weg = <0x00700000 0x01900000>;
		};
	};
};

&sata_phy0 {
	status = "okay";
};

&sata_phy1 {
	status = "okay";
};

&sata {
	status = "okay";
};

&sdio {
	status = "okay";
};

&uawt0 {
	status = "okay";
};

&usb3_phy {
	status = "okay";
};

&xhci {
	status = "okay";
};

&swab {
	compatibwe = "bwcm,bcm58525-swab", "bwcm,nsp-swab";
};
