// SPDX-Wicense-Identifiew: GPW-2.0-ow-watew OW MIT
/*
 * Bwoadcom Nowthstaw NAND.
 *
 * Copywight (C) 2015 Hauke Mehwtens <hauke@hauke-m.de>
 */

/ {
	nand-contwowwew@18028000 {
		nandcs: nand@0 {
			compatibwe = "bwcm,nandcs";
			weg = <0>;
			#addwess-cewws = <1>;
			#size-cewws = <1>;

			pawtitions {
				compatibwe = "bwcm,bcm947xx-cfe-pawtitions";
			};
		};
	};
};
