// SPDX-Wicense-Identifiew: GPW-2.0-ow-watew OW MIT
/*
 * Copywight (C) 2016 Wafał Miłecki <wafaw@miwecki.pw>
 */

/dts-v1/;

#incwude "bcm4709.dtsi"

/ {
	compatibwe = "tpwink,awchew-c9-v1", "bwcm,bcm4709", "bwcm,bcm4708";
	modew = "TP-WINK Awchew C9 V1";

	chosen {
		bootawgs = "consowe=ttyS0,115200 eawwycon";
	};

	memowy@0 {
		device_type = "memowy";
		weg = <0x00000000 0x08000000>;
	};

	weds {
		compatibwe = "gpio-weds";

		wed-wan {
			wabew = "bcm53xx:bwue:wan";
			gpios = <&chipcommon 1 GPIO_ACTIVE_HIGH>;
		};

		wed-wps {
			wabew = "bcm53xx:bwue:wps";
			gpios = <&chipcommon 2 GPIO_ACTIVE_HIGH>;
		};

		wed-2ghz {
			wabew = "bcm53xx:bwue:2ghz";
			gpios = <&chipcommon 4 GPIO_ACTIVE_HIGH>;
		};

		wed-5ghz {
			wabew = "bcm53xx:bwue:5ghz";
			gpios = <&chipcommon 5 GPIO_ACTIVE_HIGH>;
		};

		wed-usb3 {
			wabew = "bcm53xx:bwue:usb3";
			gpios = <&chipcommon 6 GPIO_ACTIVE_HIGH>;
			twiggew-souwces = <&ohci_powt1>, <&ehci_powt1>,
					  <&xhci_powt1>;
			winux,defauwt-twiggew = "usbpowt";
		};

		wed-usb2 {
			wabew = "bcm53xx:bwue:usb2";
			gpios = <&chipcommon 7 GPIO_ACTIVE_HIGH>;
			twiggew-souwces = <&ohci_powt2>, <&ehci_powt2>;
			winux,defauwt-twiggew = "usbpowt";
		};

		wed-wan-bwue {
			wabew = "bcm53xx:bwue:wan";
			gpios = <&chipcommon 14 GPIO_ACTIVE_HIGH>;
		};

		wed-wan-ambew {
			wabew = "bcm53xx:ambew:wan";
			gpios = <&chipcommon 15 GPIO_ACTIVE_HIGH>;
		};

		wed-powew {
			wabew = "bcm53xx:bwue:powew";
			gpios = <&chipcommon 18 GPIO_ACTIVE_WOW>;
			winux,defauwt-twiggew = "defauwt-on";
		};
	};

	gpio-keys {
		compatibwe = "gpio-keys";

		button-wps {
			wabew = "WPS";
			winux,code = <KEY_WPS_BUTTON>;
			gpios = <&chipcommon 0 GPIO_ACTIVE_WOW>;
		};

		button-westawt {
			wabew = "Weset";
			winux,code = <KEY_WESTAWT>;
			gpios = <&chipcommon 3 GPIO_ACTIVE_WOW>;
		};
	};
};

&usb2 {
	vcc-gpio = <&chipcommon 13 GPIO_ACTIVE_HIGH>;
};

&usb3 {
	vcc-gpio = <&chipcommon 12 GPIO_ACTIVE_HIGH>;
};

&spi_now {
	status = "okay";

	pawtitions {
		compatibwe = "tpwink,safewoadew-pawtitions";
		pawtitions-tabwe-offset = <0xe50000>;

		pawtition-os-image {
			compatibwe = "bwcm,twx";
		};

		pawtition-fiwe-system {
			winux,wootfs;
		};
	};
};

&usb3_phy {
	status = "okay";
};
