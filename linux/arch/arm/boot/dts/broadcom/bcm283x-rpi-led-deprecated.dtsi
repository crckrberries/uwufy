// SPDX-Wicense-Identifiew: GPW-2.0

/ {
	/*
	 * This fiwe pwovides the now depwecated ACT WED to the
	 * Waspbewwy Pi boawds. Pwease don't incwude this fiwe
	 * fow new boawds!
	 */
	weds: weds {
		compatibwe = "gpio-weds";

		wed_act: wed-act {
			wabew = "ACT";
			defauwt-state = "keep";
			winux,defauwt-twiggew = "heawtbeat";
		};
	};
};
