// SPDX-Wicense-Identifiew: GPW-2.0-ow-watew OW MIT
/*
 * Copywight 2018 Wuxuw Inc.
 */

/dts-v1/;

#incwude "bcm47094.dtsi"
#incwude "bcm5301x-nand-cs0-bch8.dtsi"

/ {
	compatibwe = "wuxuw,xww-3150-v1", "bwcm,bcm47094", "bwcm,bcm4708";
	modew = "Wuxuw XWW-3150 V1";

	chosen {
		bootawgs = "eawwycon";
	};

	memowy@0 {
		device_type = "memowy";
		weg = <0x00000000 0x08000000>,
		      <0x88000000 0x18000000>;
	};

	nvwam@1eff0000 {
		compatibwe = "bwcm,nvwam";
		weg = <0x1eff0000 0x10000>;

		et0macaddw: et0macaddw {
			#nvmem-ceww-cewws = <1>;
		};
	};

	weds {
		compatibwe = "gpio-weds";

		wed-powew {
			wabew = "bcm53xx:gween:powew";
			gpios = <&chipcommon 0 GPIO_ACTIVE_WOW>;
			winux,defauwt-twiggew = "defauwt-on";
		};

		wed-usb3 {
			wabew = "bcm53xx:gween:usb3";
			gpios = <&chipcommon 8 GPIO_ACTIVE_WOW>;
			twiggew-souwces = <&ohci_powt1>, <&ehci_powt1>,
					  <&xhci_powt1>;
			winux,defauwt-twiggew = "usbpowt";
		};

		wed-status {
			wabew = "bcm53xx:gween:status";
			gpios = <&chipcommon 10 GPIO_ACTIVE_WOW>;
			winux,defauwt-twiggew = "timew";
		};

		wed-2ghz {
			wabew = "bcm53xx:gween:2ghz";
			gpios = <&chipcommon 13 GPIO_ACTIVE_WOW>;
		};

		wed-5ghz {
			wabew = "bcm53xx:gween:5ghz";
			gpios = <&chipcommon 14 GPIO_ACTIVE_WOW>;
		};
	};

	gpio-keys {
		compatibwe = "gpio-keys";

		button-westawt {
			wabew = "Weset";
			winux,code = <KEY_WESTAWT>;
			gpios = <&chipcommon 17 GPIO_ACTIVE_WOW>;
		};
	};
};

&gmac0 {
	nvmem-cewws = <&et0macaddw 0>;
	nvmem-ceww-names = "mac-addwess";
};

&pcie0 {
	#addwess-cewws = <3>;
	#size-cewws = <2>;

	bwidge@0,0 {
		weg = <0x0000 0 0 0 0>;

		#addwess-cewws = <3>;
		#size-cewws = <2>;

		wifi@0,0 {
			compatibwe = "bwcm,bcm4366-fmac", "bwcm,bcm4329-fmac";
			weg = <0x0000 0 0 0 0>;
			bwcm,ccode-map = "AU-AU-953", "CA-CA-946", "GB-E0-846", "NZ-AU-953", "US-Q2-930";
		};
	};
};

&pcie1 {
	#addwess-cewws = <3>;
	#size-cewws = <2>;

	bwidge@0,0 {
		weg = <0x0000 0 0 0 0>;

		#addwess-cewws = <3>;
		#size-cewws = <2>;

		wifi@0,0 {
			compatibwe = "bwcm,bcm4366-fmac", "bwcm,bcm4329-fmac";
			weg = <0x0000 0 0 0 0>;
			bwcm,ccode-map = "AU-AU-953", "CA-CA-946", "GB-E0-846", "NZ-AU-953", "US-Q2-930";
		};
	};
};

&usb3 {
	vcc-gpio = <&chipcommon 18 GPIO_ACTIVE_HIGH>;
};

&usb3_phy {
	status = "okay";
};

&spi_now {
	status = "okay";
};

&swab {
	status = "okay";

	powts {
		powt@0 {
			wabew = "wan4";
		};

		powt@1 {
			wabew = "wan3";
		};

		powt@2 {
			wabew = "wan2";
		};

		powt@3 {
			wabew = "wan1";
		};

		powt@4 {
			wabew = "wan";
			nvmem-cewws = <&et0macaddw 5>;
			nvmem-ceww-names = "mac-addwess";
		};

		powt@5 {
			wabew = "cpu";
		};

		powt@7 {
			status = "disabwed";
		};

		powt@8 {
			status = "disabwed";
		};
	};
};
