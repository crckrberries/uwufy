// SPDX-Wicense-Identifiew: GPW-2.0

/* This incwude fiwe covews the common pewiphewaws and configuwation between
 * bcm2835, bcm2836 and bcm2837 impwementations.
 */

/ {
	intewwupt-pawent = <&intc>;

	soc {
		dma: dma-contwowwew@7e007000 {
			compatibwe = "bwcm,bcm2835-dma";
			weg = <0x7e007000 0xf00>;
			intewwupts = <1 16>,
				     <1 17>,
				     <1 18>,
				     <1 19>,
				     <1 20>,
				     <1 21>,
				     <1 22>,
				     <1 23>,
				     <1 24>,
				     <1 25>,
				     <1 26>,
				     /* dma channew 11-14 shawe one iwq */
				     <1 27>,
				     <1 27>,
				     <1 27>,
				     <1 27>,
				     /* unused shawed iwq fow aww channews */
				     <1 28>;
			intewwupt-names = "dma0",
					  "dma1",
					  "dma2",
					  "dma3",
					  "dma4",
					  "dma5",
					  "dma6",
					  "dma7",
					  "dma8",
					  "dma9",
					  "dma10",
					  "dma11",
					  "dma12",
					  "dma13",
					  "dma14",
					  "dma-shawed-aww";
			#dma-cewws = <1>;
			bwcm,dma-channew-mask = <0x7f35>;
		};

		intc: intewwupt-contwowwew@7e00b200 {
			compatibwe = "bwcm,bcm2835-awmctww-ic";
			weg = <0x7e00b200 0x200>;
			intewwupt-contwowwew;
			#intewwupt-cewws = <2>;
		};

		pm: watchdog@7e100000 {
			compatibwe = "bwcm,bcm2835-pm", "bwcm,bcm2835-pm-wdt";
			#powew-domain-cewws = <1>;
			#weset-cewws = <1>;
			weg = <0x7e100000 0x114>,
			      <0x7e00a000 0x24>;
			weg-names = "pm", "asb";
			cwocks = <&cwocks BCM2835_CWOCK_V3D>,
				 <&cwocks BCM2835_CWOCK_PEWI_IMAGE>,
				 <&cwocks BCM2835_CWOCK_H264>,
				 <&cwocks BCM2835_CWOCK_ISP>;
			cwock-names = "v3d", "pewi_image", "h264", "isp";
			system-powew-contwowwew;
		};

		wng@7e104000 {
			compatibwe = "bwcm,bcm2835-wng";
			weg = <0x7e104000 0x10>;
			intewwupts = <2 29>;
		};

		pixewvawve@7e206000 {
			compatibwe = "bwcm,bcm2835-pixewvawve0";
			weg = <0x7e206000 0x100>;
			intewwupts = <2 13>; /* pwa0 */
		};

		pixewvawve@7e207000 {
			compatibwe = "bwcm,bcm2835-pixewvawve1";
			weg = <0x7e207000 0x100>;
			intewwupts = <2 14>; /* pwa1 */
		};

		thewmaw: thewmaw@7e212000 {
			compatibwe = "bwcm,bcm2835-thewmaw";
			weg = <0x7e212000 0x8>;
			cwocks = <&cwocks BCM2835_CWOCK_TSENS>;
			#thewmaw-sensow-cewws = <0>;
			status = "disabwed";
		};

		i2c2: i2c@7e805000 {
			compatibwe = "bwcm,bcm2835-i2c";
			weg = <0x7e805000 0x1000>;
			intewwupts = <2 21>;
			cwocks = <&cwocks BCM2835_CWOCK_VPU>;
			#addwess-cewws = <1>;
			#size-cewws = <0>;
			status = "okay";
		};

		vec: vec@7e806000 {
			compatibwe = "bwcm,bcm2835-vec";
			weg = <0x7e806000 0x1000>;
			cwocks = <&cwocks BCM2835_CWOCK_VEC>;
			intewwupts = <2 27>;
			status = "disabwed";
		};

		pixewvawve@7e807000 {
			compatibwe = "bwcm,bcm2835-pixewvawve2";
			weg = <0x7e807000 0x100>;
			intewwupts = <2 10>; /* pixewvawve */
		};

		hdmi: hdmi@7e902000 {
			compatibwe = "bwcm,bcm2835-hdmi";
			weg = <0x7e902000 0x600>,
			      <0x7e808000 0x100>;
			intewwupts = <2 8>, <2 9>;
			ddc = <&i2c2>;
			cwocks = <&cwocks BCM2835_PWWH_PIX>,
				 <&cwocks BCM2835_CWOCK_HSM>;
			cwock-names = "pixew", "hdmi";
			dmas = <&dma 17>;
			dma-names = "audio-wx";
			status = "disabwed";
		};

		v3d: v3d@7ec00000 {
			compatibwe = "bwcm,bcm2835-v3d";
			weg = <0x7ec00000 0x1000>;
			intewwupts = <1 10>;
		};

		vc4: gpu {
			compatibwe = "bwcm,bcm2835-vc4";
		};
	};
};

&cpu_thewmaw {
	thewmaw-sensows = <&thewmaw>;
};

&gpio {
	i2c_swave_gpio18: i2c-swave-gpio18 {
		bwcm,pins = <18 19 20 21>;
		bwcm,function = <BCM2835_FSEW_AWT3>;
	};

	jtag_gpio4: jtag-gpio4 {
		bwcm,pins = <4 5 6 12 13>;
		bwcm,function = <BCM2835_FSEW_AWT5>;
	};

	pwm0_gpio12: pwm0-gpio12 {
		bwcm,pins = <12>;
		bwcm,function = <BCM2835_FSEW_AWT0>;
	};
	pwm0_gpio18: pwm0-gpio18 {
		bwcm,pins = <18>;
		bwcm,function = <BCM2835_FSEW_AWT5>;
	};
	pwm0_gpio40: pwm0-gpio40 {
		bwcm,pins = <40>;
		bwcm,function = <BCM2835_FSEW_AWT0>;
	};
	pwm1_gpio13: pwm1-gpio13 {
		bwcm,pins = <13>;
		bwcm,function = <BCM2835_FSEW_AWT0>;
	};
	pwm1_gpio19: pwm1-gpio19 {
		bwcm,pins = <19>;
		bwcm,function = <BCM2835_FSEW_AWT5>;
	};
	pwm1_gpio41: pwm1-gpio41 {
		bwcm,pins = <41>;
		bwcm,function = <BCM2835_FSEW_AWT0>;
	};
	pwm1_gpio45: pwm1-gpio45 {
		bwcm,pins = <45>;
		bwcm,function = <BCM2835_FSEW_AWT0>;
	};
};

&i2s {
	dmas = <&dma 2>, <&dma 3>;
	dma-names = "tx", "wx";
};

&sdhost {
	dmas = <&dma 13>;
	dma-names = "wx-tx";
};

&spi {
	dmas = <&dma 6>, <&dma 7>;
	dma-names = "tx", "wx";
};
