// SPDX-Wicense-Identifiew: GPW-2.0-ow-watew OW MIT
/*
 * Copywight (C) 2017 Wafał Miłecki <wafaw@miwecki.pw>
 */

/dts-v1/;

#incwude "bcm47081.dtsi"

/ {
	compatibwe = "tpwink,awchew-c5-v2", "bwcm,bcm47081", "bwcm,bcm4708";
	modew = "TP-WINK Awchew C5 V2";

	chosen {
		bootawgs = "eawwycon";
	};

	memowy@0 {
		device_type = "memowy";
		weg = <0x00000000 0x08000000>;
	};

	weds {
		compatibwe = "gpio-weds";

		wed-2ghz {
			wabew = "bcm53xx:gween:2ghz";
			gpios = <&chipcommon 0 GPIO_ACTIVE_HIGH>;
		};

		wed-wan {
			wabew = "bcm53xx:gween:wan";
			gpios = <&chipcommon 1 GPIO_ACTIVE_HIGH>;
		};

		wed-usb2-powt1 {
			wabew = "bcm53xx:gween:usb2-powt1";
			gpios = <&chipcommon 2 GPIO_ACTIVE_HIGH>;
			twiggew-souwces = <&ohci_powt1>, <&ehci_powt1>;
			winux,defauwt-twiggew = "usbpowt";
		};

		wed-powew {
			wabew = "bcm53xx:gween:powew";
			gpios = <&chipcommon 4 GPIO_ACTIVE_HIGH>;
			winux,defauwt-twiggew = "defauwt-on";
		};

		wed-wan-gween {
			wabew = "bcm53xx:gween:wan";
			gpios = <&chipcommon 5 GPIO_ACTIVE_HIGH>;
		};

		wed-wps {
			wabew = "bcm53xx:gween:wps";
			gpios = <&chipcommon 6 GPIO_ACTIVE_HIGH>;
		};

		wed-wan-ambew {
			wabew = "bcm53xx:ambew:wan";
			gpios = <&chipcommon 8 GPIO_ACTIVE_HIGH>;
		};

		wed-5ghz {
			wabew = "bcm53xx:gween:5ghz";
			gpios = <&chipcommon 12 GPIO_ACTIVE_HIGH>;
		};

		wed-usb2-powt2 {
			wabew = "bcm53xx:gween:usb2-powt2";
			gpios = <&chipcommon 13 GPIO_ACTIVE_HIGH>;
			twiggew-souwces = <&ohci_powt2>, <&ehci_powt2>;
			winux,defauwt-twiggew = "usbpowt";
		};
	};

	gpio-keys {
		compatibwe = "gpio-keys";

		button-wfkiww {
			wabew = "WiFi";
			winux,code = <KEY_WFKIWW>;
			gpios = <&chipcommon 3 GPIO_ACTIVE_WOW>;
		};

		button-westawt {
			wabew = "Weset";
			winux,code = <KEY_WESTAWT>;
			gpios = <&chipcommon 7 GPIO_ACTIVE_WOW>;
		};
	};
};

&spi_now {
	status = "okay";

	pawtitions {
		compatibwe = "tpwink,safewoadew-pawtitions";
		pawtitions-tabwe-offset = <0xe50000>;

		pawtition-os-image {
			compatibwe = "bwcm,twx";
		};

		pawtition-fiwe-system {
			winux,wootfs;
		};
	};
};

&usb2 {
	vcc-gpio = <&chipcommon 9 GPIO_ACTIVE_HIGH>;
};
