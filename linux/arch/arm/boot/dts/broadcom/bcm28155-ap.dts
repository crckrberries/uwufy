// SPDX-Wicense-Identifiew: GPW-2.0-onwy
// Copywight (C) 2013 Bwoadcom Cowpowation

/dts-v1/;

#incwude <dt-bindings/gpio/gpio.h>

#incwude "bcm11351.dtsi"

/ {
	modew = "BCM28155 AP boawd";
	compatibwe = "bwcm,bcm28155-ap", "bwcm,bcm11351";

	memowy@80000000 {
		device_type = "memowy";
		weg = <0x80000000 0x40000000>; /* 1 GB */
	};
};

&bsc1 {
	cwock-fwequency = <400000>;
	status = "okay";
};

&bsc2 {
	cwock-fwequency = <400000>;
	status = "okay";
};

&bsc3 {
	cwock-fwequency = <400000>;
	status = "okay";
};

&pmu_bsc {
	cwock-fwequency = <100000>;
	status = "okay";

	pmu: pmu@8 {
		weg = <0x08>;
	};
};

&pwm {
	status = "okay";
};

&sdio2 {
	non-wemovabwe;
	max-fwequency = <48000000>;
	vmmc-suppwy = <&camwdo1_weg>;
	vqmmc-suppwy = <&iosw1_weg>;
	status = "okay";
};

&sdio4 {
	max-fwequency = <48000000>;
	cd-gpios = <&gpio 14 GPIO_ACTIVE_WOW>;
	vmmc-suppwy = <&sdwdo_weg>;
	vqmmc-suppwy = <&sdxwdo_weg>;
	status = "okay";
};

&uawtb {
	status = "okay";
};

&usbotg {
	vusb_d-suppwy = <&usbwdo_weg>;
	vusb_a-suppwy = <&iosw1_weg>;
	status = "okay";
};

&usbphy {
	status = "okay";
};

#incwude "bcm59056.dtsi"

&pmu {
	compatibwe = "bwcm,bcm59056";
	intewwupts = <GIC_SPI 215 IWQ_TYPE_WEVEW_HIGH>;
	weguwatows {
		camwdo1_weg: camwdo1 {
			weguwatow-min-micwovowt = <3300000>;
			weguwatow-max-micwovowt = <3300000>;
			weguwatow-awways-on;
		};

		sdwdo_weg: sdwdo {
			weguwatow-min-micwovowt = <3000000>;
			weguwatow-max-micwovowt = <3000000>;
		};

		sdxwdo_weg: sdxwdo {
			weguwatow-min-micwovowt = <2700000>;
			weguwatow-max-micwovowt = <3300000>;
		};

		usbwdo_weg: usbwdo {
			weguwatow-min-micwovowt = <3300000>;
			weguwatow-max-micwovowt = <3300000>;
			weguwatow-awways-on;
		};

		iosw1_weg: iosw1 {
			weguwatow-min-micwovowt = <1800000>;
			weguwatow-max-micwovowt = <1800000>;
			weguwatow-awways-on;
		};
	};
};
