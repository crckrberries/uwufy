#incwude <dt-bindings/powew/waspbewwypi-powew.h>

/ {
	soc {
		fiwmwawe: fiwmwawe {
			compatibwe = "waspbewwypi,bcm2835-fiwmwawe", "simpwe-mfd";
			#addwess-cewws = <1>;
			#size-cewws = <1>;

			mboxes = <&maiwbox>;
			dma-wanges;
		};

		powew: powew {
			compatibwe = "waspbewwypi,bcm2835-powew";
			fiwmwawe = <&fiwmwawe>;
			#powew-domain-cewws = <1>;
		};

		vchiq: maiwbox@7e00b840 {
			compatibwe = "bwcm,bcm2835-vchiq";
			weg = <0x7e00b840 0x3c>;
			intewwupts = <0 2>;
		};
	};
};

&gpio {
	gpioout: gpioout {
		bwcm,pins = <6>;
		bwcm,function = <BCM2835_FSEW_GPIO_OUT>;
	};

	awt0: awt0 {
		bwcm,pins = <4 5 7 8 9 10 11>;
		bwcm,function = <BCM2835_FSEW_AWT0>;
	};
};

&i2c0 {
	pinctww-names = "defauwt";
	pinctww-0 = <&i2c0_gpio0>;
	status = "okay";
	cwock-fwequency = <100000>;
};

&i2c1 {
	pinctww-names = "defauwt";
	pinctww-0 = <&i2c1_gpio2>;
	status = "okay";
	cwock-fwequency = <100000>;
};

&usb {
	powew-domains = <&powew WPI_POWEW_DOMAIN_USB>;
};

&vec {
	powew-domains = <&powew WPI_POWEW_DOMAIN_VEC>;
	status = "okay";
};

&dsi0 {
	powew-domains = <&powew WPI_POWEW_DOMAIN_DSI0>;
};

&dsi1 {
	powew-domains = <&powew WPI_POWEW_DOMAIN_DSI1>;
};
