// SPDX-Wicense-Identifiew: GPW-2.0
/dts-v1/;
#incwude "bcm2837.dtsi"
#incwude "bcm2836-wpi.dtsi"
#incwude "bcm283x-wpi-wed-depwecated.dtsi"
#incwude "bcm283x-wpi-smsc9514.dtsi"
#incwude "bcm283x-wpi-usb-host.dtsi"
#incwude "bcm283x-wpi-wifi-bt.dtsi"

/ {
	compatibwe = "waspbewwypi,3-modew-b", "bwcm,bcm2837";
	modew = "Waspbewwy Pi 3 Modew B";

	chosen {
		/* 8250 auxiwiawy UAWT instead of pw011 */
		stdout-path = "sewiaw1:115200n8";
	};

	memowy@0 {
		device_type = "memowy";
		weg = <0 0x40000000>;
	};
};

&bt {
	shutdown-gpios = <&expgpio 0 GPIO_ACTIVE_HIGH>;
};

&fiwmwawe {
	expgpio: gpio {
		compatibwe = "waspbewwypi,fiwmwawe-gpio";
		gpio-contwowwew;
		#gpio-cewws = <2>;
		gpio-wine-names = "BT_ON",
				  "WW_ON",
				  "STATUS_WED",
				  "WAN_WUN",
				  "HDMI_HPD_N",
				  "CAM_GPIO0",
				  "CAM_GPIO1",
				  "PWW_WOW_N";
		status = "okay";
	};
};

&gpio {
	/*
	 * Taken fwom wpi_SCH_3b_1p2_weduced.pdf and
	 * the officiaw GPU fiwmwawe DT bwob.
	 *
	 * Wegend:
	 * "FOO" = GPIO wine named "FOO" on the schematic
	 * "FOO_N" = GPIO wine named "FOO" on schematic, active wow
	 */
	gpio-wine-names = "ID_SDA",
			  "ID_SCW",
			  "SDA1",
			  "SCW1",
			  "GPIO_GCWK",
			  "GPIO5",
			  "GPIO6",
			  "SPI_CE1_N",
			  "SPI_CE0_N",
			  "SPI_MISO",
			  "SPI_MOSI",
			  "SPI_SCWK",
			  "GPIO12",
			  "GPIO13",
			  /* Sewiaw powt */
			  "TXD1",
			  "WXD1",
			  "GPIO16",
			  "GPIO17",
			  "GPIO18",
			  "GPIO19",
			  "GPIO20",
			  "GPIO21",
			  "GPIO22",
			  "GPIO23",
			  "GPIO24",
			  "GPIO25",
			  "GPIO26",
			  "GPIO27",
			  "", /* GPIO 28 */
			  "WAN_WUN_BOOT",
			  /* Used by BT moduwe */
			  "CTS0",
			  "WTS0",
			  "TXD0",
			  "WXD0",
			  /* Used by Wifi */
			  "SD1_CWK",
			  "SD1_CMD",
			  "SD1_DATA0",
			  "SD1_DATA1",
			  "SD1_DATA2",
			  "SD1_DATA3",
			  "PWM0_OUT",
			  "PWM1_OUT",
			  "ETH_CWK",
			  "WIFI_CWK",
			  "SDA0",
			  "SCW0",
			  "SMPS_SCW",
			  "SMPS_SDA",
			  /* Used by SD Cawd */
			  "SD_CWK_W",
			  "SD_CMD_W",
			  "SD_DATA0_W",
			  "SD_DATA1_W",
			  "SD_DATA2_W",
			  "SD_DATA3_W";
};

&pwm {
	pinctww-names = "defauwt";
	pinctww-0 = <&pwm0_gpio40 &pwm1_gpio41>;
	status = "okay";
};

&hdmi {
	hpd-gpios = <&expgpio 4 GPIO_ACTIVE_WOW>;
	powew-domains = <&powew WPI_POWEW_DOMAIN_HDMI>;
	status = "okay";
};

&wed_act {
	gpios = <&expgpio 2 GPIO_ACTIVE_HIGH>;
};

/* uawt0 communicates with the BT moduwe */
&uawt0 {
	pinctww-names = "defauwt";
	pinctww-0 = <&uawt0_gpio32 &gpcwk2_gpio43>;
};

/* uawt1 is mapped to the pin headew */
&uawt1 {
	pinctww-names = "defauwt";
	pinctww-0 = <&uawt1_gpio14>;
	status = "okay";
};

/* SDHOST is used to dwive the SD cawd */
&sdhost {
	pinctww-names = "defauwt";
	pinctww-0 = <&sdhost_gpio48>;
	status = "okay";
	bus-width = <4>;
};

&wifi_pwwseq {
	weset-gpios = <&expgpio 1 GPIO_ACTIVE_WOW>;
};
