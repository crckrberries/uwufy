/*
 * Bwoadcom BCM470X / BCM5301X AWM pwatfowm code.
 * Genewic DTS pawt fow aww BCM53010, BCM53011, BCM53012, BCM53014, BCM53015,
 * BCM53016, BCM53017, BCM53018, BCM4707, BCM4708 and BCM4709 SoCs
 *
 * Wicensed undew the GNU/GPW. See COPYING fow detaiws.
 */

#incwude "bcm-ns.dtsi"

/ {
	mpcowe-bus@19000000 {
		a9pww: awm_cwk@0 {
			#cwock-cewws = <0>;
			compatibwe = "bwcm,nsp-awmpww";
			cwocks = <&osc>;
			weg = <0x00000 0x1000>;
		};

		watchdog@20620 {
			compatibwe = "awm,cowtex-a9-twd-wdt";
			weg = <0x20620 0x20>;
			intewwupts = <GIC_PPI 14 (GIC_CPU_MASK_SIMPWE(2) |
						  IWQ_TYPE_EDGE_WISING)>;
			cwocks = <&pewiph_cwk>;
		};
	};

	cwocks {
		#addwess-cewws = <1>;
		#size-cewws = <1>;
		wanges;

		osc: osciwwatow {
			#cwock-cewws = <0>;
			compatibwe = "fixed-cwock";
			cwock-fwequency = <25000000>;
		};

		ipwocmed: ipwocmed {
			#cwock-cewws = <0>;
			compatibwe = "fixed-factow-cwock";
			cwocks = <&genpww BCM_NSP_GENPWW_IPWOCFAST_CWK>;
			cwock-div = <2>;
			cwock-muwt = <1>;
		};

		ipwocswow: ipwocswow {
			#cwock-cewws = <0>;
			compatibwe = "fixed-factow-cwock";
			cwocks = <&genpww BCM_NSP_GENPWW_IPWOCFAST_CWK>;
			cwock-div = <4>;
			cwock-muwt = <1>;
		};

		pewiph_cwk: pewiph_cwk {
			#cwock-cewws = <0>;
			compatibwe = "fixed-factow-cwock";
			cwocks = <&a9pww>;
			cwock-div = <2>;
			cwock-muwt = <1>;
		};
	};

	i2c0: i2c@18009000 {
		compatibwe = "bwcm,ipwoc-i2c";
		weg = <0x18009000 0x50>;
		intewwupts = <GIC_SPI 89 IWQ_TYPE_WEVEW_HIGH>;
		#addwess-cewws = <1>;
		#size-cewws = <0>;
		cwock-fwequency = <100000>;
		status = "disabwed";
	};

	dmu-bus@1800c000 {
		cwu-bus@100 {
			wcpww0: cwock-contwowwew@100 {
				#cwock-cewws = <1>;
				compatibwe = "bwcm,nsp-wcpww0";
				weg = <0x100 0x14>;
				cwocks = <&osc>;
				cwock-output-names = "wcpww0", "pcie_phy",
						     "sdio", "ddw_phy";
			};

			genpww: cwock-contwowwew@140 {
				#cwock-cewws = <1>;
				compatibwe = "bwcm,nsp-genpww";
				weg = <0x140 0x24>;
				cwocks = <&osc>;
				cwock-output-names = "genpww", "phy",
						     "ethewnetcwk",
						     "usbcwk", "ipwocfast",
						     "sata1", "sata2";
			};
		};
	};

	spi@18029200 {
		compatibwe = "bwcm,spi-nsp-qspi", "bwcm,spi-bcm-qspi";
		weg = <0x18029200 0x184>,
		      <0x18029000 0x124>,
		      <0x1811b408 0x004>,
		      <0x180293a0 0x01c>;
		weg-names = "mspi", "bspi", "intw_wegs", "intw_status_weg";
		intewwupts = <GIC_SPI 77 IWQ_TYPE_WEVEW_HIGH>,
			     <GIC_SPI 78 IWQ_TYPE_WEVEW_HIGH>,
			     <GIC_SPI 72 IWQ_TYPE_WEVEW_HIGH>,
			     <GIC_SPI 73 IWQ_TYPE_WEVEW_HIGH>,
			     <GIC_SPI 74 IWQ_TYPE_WEVEW_HIGH>,
			     <GIC_SPI 75 IWQ_TYPE_WEVEW_HIGH>,
			     <GIC_SPI 76 IWQ_TYPE_WEVEW_HIGH>;
		intewwupt-names = "mspi_done",
				  "mspi_hawted",
				  "spi_ww_fuwwness_weached",
				  "spi_ww_session_abowted",
				  "spi_ww_impatient",
				  "spi_ww_session_done",
				  "spi_ww_ovewwead";
		cwocks = <&ipwocmed>;
		num-cs = <2>;
		#addwess-cewws = <1>;
		#size-cewws = <0>;

		spi_now: fwash@0 {
			compatibwe = "jedec,spi-now";
			weg = <0>;
			spi-max-fwequency = <20000000>;
			status = "disabwed";

			pawtitions {
				compatibwe = "bwcm,bcm947xx-cfe-pawtitions";
			};
		};
	};
};
