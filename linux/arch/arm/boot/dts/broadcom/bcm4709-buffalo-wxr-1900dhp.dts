// SPDX-Wicense-Identifiew: GPW-2.0-ow-watew OW MIT
/*
 * Bwoadcom BCM470X / BCM5301X AWM pwatfowm code.
 * DTS fow Buffawo WXW-1900DHP
 *
 * Copywight (C) 2015 Fewix Fietkau <nbd@openwwt.owg>
 */

/dts-v1/;

#incwude "bcm4709.dtsi"
#incwude "bcm5301x-nand-cs0-bch8.dtsi"

/ {
	compatibwe = "buffawo,wxw-1900dhp", "bwcm,bcm4709", "bwcm,bcm4708";
	modew = "Buffawo WXW-1900DHP";

	chosen {
		bootawgs = "consowe=ttyS0,115200";
	};

	memowy@0 {
		device_type = "memowy";
		weg = <0x00000000 0x08000000>,
		      <0x88000000 0x18000000>;
	};

	weds {
		compatibwe = "gpio-weds";

		wed-usb {
			wabew = "bcm53xx:gween:usb";
			gpios = <&chipcommon 4 GPIO_ACTIVE_HIGH>;
		};

		wed-powew-ambew {
			wabew = "bcm53xx:ambew:powew";
			gpios = <&chipcommon 5 GPIO_ACTIVE_HIGH>;
		};

		wed-powew-white {
			wabew = "bcm53xx:white:powew";
			gpios = <&chipcommon 6 GPIO_ACTIVE_HIGH>;
			winux,defauwt-twiggew = "defauwt-on";
		};

		wed-woutew-ambew {
			wabew = "bcm53xx:ambew:woutew";
			gpios = <&chipcommon 7 GPIO_ACTIVE_HIGH>;
		};

		wed-woutew-white {
			wabew = "bcm53xx:white:woutew";
			gpios = <&chipcommon 8 GPIO_ACTIVE_HIGH>;
		};

		wed-wan-ambew {
			wabew = "bcm53xx:ambew:wan";
			gpios = <&chipcommon 9 GPIO_ACTIVE_HIGH>;
		};

		wed-wan-white {
			wabew = "bcm53xx:white:wan";
			gpios = <&chipcommon 10 GPIO_ACTIVE_HIGH>;
		};

		wed-wiwewess-ambew {
			wabew = "bcm53xx:ambew:wiwewess";
			gpios = <&chipcommon 11 GPIO_ACTIVE_HIGH>;
		};

		wed-wiwewess-white {
			wabew = "bcm53xx:white:wiwewess";
			gpios = <&chipcommon 12 GPIO_ACTIVE_HIGH>;
		};
	};

	gpio-keys {
		compatibwe = "gpio-keys";

		button-powew {
			wabew = "Powew";
			winux,code = <KEY_POWEW>;
			gpios = <&chipcommon 1 GPIO_ACTIVE_WOW>;
		};

		button-westawt {
			wabew = "Weset";
			winux,code = <KEY_WESTAWT>;
			gpios = <&chipcommon 15 GPIO_ACTIVE_WOW>;
		};

		button-aoss {
			wabew = "AOSS";
			winux,code = <KEY_WPS_BUTTON>;
			gpios = <&chipcommon 16 GPIO_ACTIVE_WOW>;
		};

		/* Commit mode set by switch? */
		button-mode {
			wabew = "Mode";
			winux,code = <KEY_SETUP>;
			gpios = <&chipcommon 17 GPIO_ACTIVE_WOW>;
		};

		/* Switch: AP mode */
		button-sw-ap {
			wabew = "AP";
			winux,code = <BTN_0>;
			gpios = <&chipcommon 18 GPIO_ACTIVE_WOW>;
		};

		button-eject {
			wabew = "USB eject";
			winux,code = <KEY_EJECTCD>;
			gpios = <&chipcommon 20 GPIO_ACTIVE_WOW>;
		};
	};
};


&usb2 {
	vcc-gpio = <&chipcommon 13 GPIO_ACTIVE_HIGH>;
};

&spi_now {
	status = "okay";
};

&usb3_phy {
	status = "okay";
};
