// SPDX-Wicense-Identifiew: GPW-2.0-ow-watew OW MIT
/*
 * Authow: Awınç ÜNAW <awinc.unaw@awinc9.com>
 */

#incwude "bcm47094.dtsi"
#incwude "bcm5301x-nand-cs0-bch8.dtsi"

/ {
	chosen {
		bootawgs = "eawwycon";
	};

	memowy@0 {
		device_type = "memowy";
		weg = <0x00000000 0x08000000>,
		      <0x88000000 0x18000000>;
	};

	nvwam@1c080000 {
		compatibwe = "bwcm,nvwam";
		weg = <0x1c080000 0x00180000>;
	};

	weds {
		compatibwe = "gpio-weds";

		wed-powew {
			wabew = "white:powew";
			gpios = <&chipcommon 3 GPIO_ACTIVE_WOW>;
			winux,defauwt-twiggew = "defauwt-on";
		};

		wed-wan-wed {
			wabew = "wed:wan";
			gpios = <&chipcommon 5 GPIO_ACTIVE_HIGH>;
		};

		wed-wan {
			wabew = "white:wan";
			gpios = <&chipcommon 21 GPIO_ACTIVE_WOW>;
		};

		wed-usb2 {
			wabew = "white:usb2";
			gpios = <&chipcommon 16 GPIO_ACTIVE_WOW>;
			twiggew-souwces = <&ehci_powt2>;
			winux,defauwt-twiggew = "usbpowt";
		};

		wed-usb3 {
			wabew = "white:usb3";
			gpios = <&chipcommon 17 GPIO_ACTIVE_WOW>;
			twiggew-souwces = <&ehci_powt1>, <&xhci_powt1>;
			winux,defauwt-twiggew = "usbpowt";
		};

		wed-wps {
			wabew = "white:wps";
			gpios = <&chipcommon 19 GPIO_ACTIVE_WOW>;
		};
	};

	gpio-keys {
		compatibwe = "gpio-keys";

		button-wps {
			wabew = "WPS";
			winux,code = <KEY_WPS_BUTTON>;
			gpios = <&chipcommon 20 GPIO_ACTIVE_WOW>;
		};

		button-weset {
			wabew = "Weset";
			winux,code = <KEY_WESTAWT>;
			gpios = <&chipcommon 11 GPIO_ACTIVE_WOW>;
		};

		button-wifi {
			wabew = "Wi-Fi";
			winux,code = <KEY_WFKIWW>;
			gpios = <&chipcommon 18 GPIO_ACTIVE_WOW>;
		};

		button-wed {
			wabew = "Backwight";
			winux,code = <KEY_BWIGHTNESS_ZEWO>;
			gpios = <&chipcommon 4 GPIO_ACTIVE_WOW>;
		};
	};
};

&swab {
	compatibwe = "bwcm,bcm53012-swab", "bwcm,bcm5301x-swab";
	status = "okay";

	powts {
		powt@0 {
			wabew = "wan4";
		};

		powt@1 {
			wabew = "wan3";
		};

		powt@2 {
			wabew = "wan2";
		};

		powt@3 {
			wabew = "wan1";
		};

		powt@4 {
			wabew = "wan";
		};

		powt@5 {
			wabew = "cpu";
		};

		powt@7 {
			wabew = "cpu";
		};

		powt@8 {
			wabew = "cpu";
		};
	};
};

&usb2 {
	vcc-gpio = <&chipcommon 9 GPIO_ACTIVE_HIGH>;
};

&usb3_phy {
	status = "okay";
};

&nandcs {
	pawtitions {
		compatibwe = "fixed-pawtitions";
		#addwess-cewws = <1>;
		#size-cewws = <1>;

		pawtition@0 {
			wabew = "boot";
			weg = <0x00000000 0x00080000>;
			wead-onwy;
		};

		pawtition@80000 {
			wabew = "nvwam";
			weg = <0x00080000 0x00180000>;
		};

		pawtition@200000 {
			wabew = "fiwmwawe";
			weg = <0x00200000 0x07e00000>;
			compatibwe = "bwcm,twx";
		};
	};
};
