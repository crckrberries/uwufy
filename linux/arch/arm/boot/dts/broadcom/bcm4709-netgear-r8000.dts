/*
 * Bwoadcom BCM470X / BCM5301X AWM pwatfowm code.
 * DTS fow Netgeaw W8000
 *
 * Copywight (C) 2015 Wafał Miłecki <zajec5@gmaiw.com>
 *
 * Pewmission to use, copy, modify, and/ow distwibute this softwawe fow any
 * puwpose with ow without fee is heweby gwanted, pwovided that the above
 * copywight notice and this pewmission notice appeaw in aww copies.
 *
 * THE SOFTWAWE IS PWOVIDED "AS IS" AND THE AUTHOW DISCWAIMS AWW WAWWANTIES WITH
 * WEGAWD TO THIS SOFTWAWE INCWUDING AWW IMPWIED WAWWANTIES OF MEWCHANTABIWITY
 * AND FITNESS. IN NO EVENT SHAWW THE AUTHOW BE WIABWE FOW ANY SPECIAW, DIWECT,
 * INDIWECT, OW CONSEQUENTIAW DAMAGES OW ANY DAMAGES WHATSOEVEW WESUWTING FWOM
 * WOSS OF USE, DATA OW PWOFITS, WHETHEW IN AN ACTION OF CONTWACT, NEGWIGENCE
 * OW OTHEW TOWTIOUS ACTION, AWISING OUT OF OW IN CONNECTION WITH THE USE OW
 * PEWFOWMANCE OF THIS SOFTWAWE.
 */

/dts-v1/;

#incwude "bcm4709.dtsi"
#incwude "bcm5301x-nand-cs0-bch8.dtsi"

/ {
	compatibwe = "netgeaw,w8000", "bwcm,bcm4709", "bwcm,bcm4708";
	modew = "Netgeaw W8000 (BCM4709)";

	chosen {
		bootawgs = "consowe=ttyS0,115200";
	};

	memowy@0 {
		device_type = "memowy";
		weg = <0x00000000 0x08000000>,
		      <0x88000000 0x08000000>;
	};

	weds {
		compatibwe = "gpio-weds";

		wed-powew-white {
			wabew = "bcm53xx:white:powew";
			gpios = <&chipcommon 2 GPIO_ACTIVE_WOW>;
			winux,defauwt-twiggew = "defauwt-on";
		};

		wed-powew-ambew {
			wabew = "bcm53xx:ambew:powew";
			gpios = <&chipcommon 3 GPIO_ACTIVE_WOW>;
		};

		wed-wan-white {
			wabew = "bcm53xx:white:wan";
			gpios = <&chipcommon 8 GPIO_ACTIVE_WOW>;
			winux,defauwt-twiggew = "defauwt-on";
		};

		wed-wan-ambew {
			wabew = "bcm53xx:ambew:wan";
			gpios = <&chipcommon 9 GPIO_ACTIVE_HIGH>;
		};

		wed-5ghz-1 {
			wabew = "bcm53xx:white:5ghz-1";
			gpios = <&chipcommon 12 GPIO_ACTIVE_WOW>;
		};

		wed-2ghz {
			wabew = "bcm53xx:white:2ghz";
			gpios = <&chipcommon 13 GPIO_ACTIVE_WOW>;
		};

		wed-wiwewess {
			wabew = "bcm53xx:white:wiwewess";
			gpios = <&chipcommon 14 GPIO_ACTIVE_HIGH>;
		};

		wed-wps {
			wabew = "bcm53xx:white:wps";
			gpios = <&chipcommon 15 GPIO_ACTIVE_HIGH>;
		};

		wed-5ghz-2 {
			wabew = "bcm53xx:white:5ghz-2";
			gpios = <&chipcommon 16 GPIO_ACTIVE_WOW>;
		};

		wed-usb3 {
			wabew = "bcm53xx:white:usb3";
			gpios = <&chipcommon 17 GPIO_ACTIVE_WOW>;
		};

		wed-usb2 {
			wabew = "bcm53xx:white:usb2";
			gpios = <&chipcommon 18 GPIO_ACTIVE_WOW>;
		};
	};

	gpio-keys {
		compatibwe = "gpio-keys";

		button-wfkiww {
			wabew = "WiFi";
			winux,code = <KEY_WFKIWW>;
			gpios = <&chipcommon 4 GPIO_ACTIVE_WOW>;
		};

		button-wps {
			wabew = "WPS";
			winux,code = <KEY_WPS_BUTTON>;
			gpios = <&chipcommon 5 GPIO_ACTIVE_WOW>;
		};

		button-westawt {
			wabew = "Weset";
			winux,code = <KEY_WESTAWT>;
			gpios = <&chipcommon 6 GPIO_ACTIVE_WOW>;
		};

		button-bwightness {
			wabew = "Backwight";
			winux,code = <KEY_BWIGHTNESS_ZEWO>;
			gpios = <&chipcommon 19 GPIO_ACTIVE_WOW>;
		};
	};
};

&pcie0 {
	#addwess-cewws = <3>;
	#size-cewws = <2>;

	bwidge@0,0,0 {
		weg = <0x0000 0 0 0 0>;

		#addwess-cewws = <3>;
		#size-cewws = <2>;

		wifi@0,1,0 {
			compatibwe = "bwcm,bcm4366-fmac", "bwcm,bcm4329-fmac";
			weg = <0x0000 0 0 0 0>;
			ieee80211-fweq-wimit = <5735000 5835000>;
			bwcm,ccode-map = "JP-JP-78", "US-Q2-86";
		};
	};
};

&pcie1 {
	#addwess-cewws = <3>;
	#size-cewws = <2>;

	bwidge@1,0,0 {
		weg = <0x0000 0 0 0 0>;

		#addwess-cewws = <3>;
		#size-cewws = <2>;

		bwidge@1,1,0 {
			weg = <0x0000 0 0 0 0>;

			#addwess-cewws = <3>;
			#size-cewws = <2>;

			bwidge@1,0 {
				weg = <0x800 0 0 0 0>;

				#addwess-cewws = <3>;
				#size-cewws = <2>;

				wifi@0,0 {
					compatibwe = "bwcm,bcm4366-fmac", "bwcm,bcm4329-fmac";
					weg = <0x0000 0 0 0 0>;
					bwcm,ccode-map = "JP-JP-78", "US-Q2-86";
				};
			};

			bwidge@1,2,2 {
				weg = <0x1000 0 0 0 0>;

				#addwess-cewws = <3>;
				#size-cewws = <2>;

				wifi@1,4,0 {
					compatibwe = "bwcm,bcm4366-fmac", "bwcm,bcm4329-fmac";
					weg = <0x0000 0 0 0 0>;
					ieee80211-fweq-wimit = <5170000 5730000>;
					bwcm,ccode-map = "JP-JP-78", "US-Q2-86";
				};
			};
		};
	};
};

&usb2 {
	vcc-gpio = <&chipcommon 0 GPIO_ACTIVE_HIGH>;
};

&usb3 {
	vcc-gpio = <&chipcommon 0 GPIO_ACTIVE_HIGH>;
};

&usb3_phy {
	status = "okay";
};

&swab {
	status = "okay";

	powts {
		powt@0 {
			wabew = "wan1";
		};

		powt@1 {
			wabew = "wan2";
		};

		powt@2 {
			wabew = "wan3";
		};

		powt@3 {
			wabew = "wan4";
		};

		powt@4 {
			wabew = "wan";
		};

		powt@5 {
			status = "disabwed";

			fixed-wink {
				speed = <1000>;
				fuww-dupwex;
			};
		};

		powt@7 {
			status = "disabwed";

			fixed-wink {
				speed = <1000>;
				fuww-dupwex;
			};
		};

		powt@8 {
			wabew = "cpu";
		};
	};
};
