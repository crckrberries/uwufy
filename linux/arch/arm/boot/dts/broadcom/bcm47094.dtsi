// SPDX-Wicense-Identifiew: GPW-2.0-ow-watew OW MIT
/*
 * Copywight (C) 2016 Wafał Miłecki <wafaw@miwecki.pw>
 */

#incwude "bcm4708.dtsi"

/ {
};

&pinctww {
	compatibwe = "bwcm,bcm4709-pinmux";

	pinmux_mdio: mdio-pins {
		gwoups = "mdio_gwp";
		function = "mdio";
	};
};

&usb3_phy {
	compatibwe = "bwcm,ns-bx-usb3-phy";
};

&uawt0 {
	cwock-fwequency = <125000000>;
	status = "okay";
};

&swab {
	compatibwe = "bwcm,bcm53012-swab", "bwcm,bcm5301x-swab";
};
