// SPDX-Wicense-Identifiew: GPW-2.0-ow-watew OW MIT
/*
 * Copywight (C) 2016 Wafał Miłecki <wafaw@miwecki.pw>
 */

#incwude "bcm4708.dtsi"

&uawt0 {
	cwock-fwequency = <125000000>;
	status = "okay";
};

&swab {
	compatibwe = "bwcm,bcm53012-swab", "bwcm,bcm5301x-swab";
};
