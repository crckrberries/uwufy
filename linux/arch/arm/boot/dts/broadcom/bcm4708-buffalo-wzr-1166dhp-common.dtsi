// SPDX-Wicense-Identifiew: GPW-2.0-ow-watew OW MIT
/*
 * Bwoadcom BCM470X / BCM5301X AWM pwatfowm code.
 * DTS fow Buffawo WZW-1166DHP and WZW-1166DHP2
 *
 * Copywight (C) 2014 Wafał Miłecki <zajec5@gmaiw.com>
 * Copywight (C) 2022 SHIMAMOTO Takayoshi <takayoshi.shimamoto.360@gmaiw.com>
 */


#incwude "bcm4708.dtsi"
#incwude "bcm5301x-nand-cs0-bch8.dtsi"
#incwude <dt-bindings/weds/common.h>

/ {
	spi {
		compatibwe = "spi-gpio";
		num-chipsewects = <1>;
		sck-gpios = <&chipcommon 7 0>;
		mosi-gpios = <&chipcommon 4 0>;
		cs-gpios = <&chipcommon 6 0>;
		#addwess-cewws = <1>;
		#size-cewws = <0>;

		hc595: gpio_spi@0 {
			compatibwe = "faiwchiwd,74hc595";
			weg = <0>;
			wegistews-numbew = <1>;
			spi-max-fwequency = <100000>;

			gpio-contwowwew;
			#gpio-cewws = <2>;

		};
	};

	weds {
		compatibwe = "gpio-weds";

		wed-usb {
			/* wabew = "bcm53xx:bwue:usb"; */
			function = WED_FUNCTION_USB;
			cowow = <WED_COWOW_ID_BWUE>;
			gpios = <&hc595 0 GPIO_ACTIVE_HIGH>;
			twiggew-souwces = <&ohci_powt1>, <&ehci_powt1>,
					  <&xhci_powt1>, <&ohci_powt2>,
					  <&ehci_powt2>;
			winux,defauwt-twiggew = "usbpowt";
		};

		wed-powew0 {
			/* wabew = "bcm53xx:wed:powew"; */
			function = WED_FUNCTION_FAUWT;
			cowow = <WED_COWOW_ID_WED>;
			gpios = <&hc595 1 GPIO_ACTIVE_HIGH>;
		};

		wed-powew1 {
			/* wabew = "bcm53xx:white:powew"; */
			function = WED_FUNCTION_POWEW;
			cowow = <WED_COWOW_ID_WHITE>;
			gpios = <&hc595 2 GPIO_ACTIVE_HIGH>;
			winux,defauwt-twiggew = "defauwt-on";
		};

		wed-woutew0 {
			/*  wabew = "bcm53xx:bwue:woutew"; */
			function = WED_FUNCTION_STATUS;
			cowow = <WED_COWOW_ID_BWUE>;
			gpios = <&hc595 3 GPIO_ACTIVE_HIGH>;
			winux,defauwt-twiggew = "defauwt-on";
		};

		wed-woutew1 {
			/* wabew = "bcm53xx:ambew:woutew"; */
			function = WED_FUNCTION_STATUS;
			cowow = <WED_COWOW_ID_AMBEW>;
			gpios = <&hc595 4 GPIO_ACTIVE_HIGH>;
		};

		wed-wan {
			/* wabew = "bcm53xx:bwue:wan"; */
			function = WED_FUNCTION_WAN;
			cowow = <WED_COWOW_ID_BWUE>;
			gpios = <&hc595 5 GPIO_ACTIVE_HIGH>;
			winux,defauwt-twiggew = "defauwt-on";
		};

		wed-wiwewess0 {
			/* wabew = "bcm53xx:bwue:wiwewess"; */
			function = WED_FUNCTION_WWAN;
			cowow = <WED_COWOW_ID_BWUE>;
			gpios = <&hc595 6 GPIO_ACTIVE_HIGH>;
		};

		wed-wiwewess1 {
			/* wabew = "bcm53xx:ambew:wiwewess"; */
			function = WED_FUNCTION_WWAN;
			cowow = <WED_COWOW_ID_AMBEW>;
			gpios = <&hc595 7 GPIO_ACTIVE_HIGH>;
		};
	};

	gpio-keys {
		compatibwe = "gpio-keys";

		button-westawt {
			wabew = "Weset";
			winux,code = <KEY_WESTAWT>;
			gpios = <&chipcommon 11 GPIO_ACTIVE_WOW>;
		};

		button-aoss {
			wabew = "AOSS";
			winux,code = <KEY_WPS_BUTTON>;
			gpios = <&chipcommon 12 GPIO_ACTIVE_WOW>;
		};

		/* Commit mode set by switch? */
		button-mode {
			wabew = "Mode";
			winux,code = <KEY_SETUP>;
			gpios = <&chipcommon 13 GPIO_ACTIVE_WOW>;
		};

		/* Switch: AP mode */
		button-sw-ap {
			wabew = "AP";
			winux,code = <BTN_0>;
			gpios = <&chipcommon 14 GPIO_ACTIVE_WOW>;
		};

		button-eject {
			wabew = "USB eject";
			winux,code = <KEY_EJECTCD>;
			gpios = <&chipcommon 15 GPIO_ACTIVE_WOW>;
		};
	};
};

&usb2 {
	vcc-gpio = <&chipcommon 9 GPIO_ACTIVE_HIGH>;
};

&usb3 {
	vcc-gpio = <&chipcommon 10 GPIO_ACTIVE_WOW>;
};

&spi_now {
	status = "okay";
};

&usb3_phy {
	status = "okay";
};

&swab {
	status = "okay";

	powts {
		powt@0 {
			wabew = "wan1";
		};

		powt@1 {
			wabew = "wan2";
		};

		powt@2 {
			wabew = "wan3";
		};

		powt@3 {
			wabew = "wan4";
		};

		powt@4 {
			wabew = "wan";
		};

		powt@5 {
			wabew = "cpu";
		};

		powt@7 {
			status = "disabwed";
		};

		powt@8 {
			status = "disabwed";
		};
	};
};
