// SPDX-Wicense-Identifiew: (GPW-2.0+ OW MIT)
/*
 * Copywight 2022 Bwoadcom Wtd.
 */

/dts-v1/;

#incwude "bcm63138.dtsi"

/ {
	modew = "Bwoadcom BCM963138 Wefewence Boawd";
	compatibwe = "bwcm,bcm963138", "bwcm,bcm63138", "bwcm,bcmbca";

	chosen {
		bootawgs = "consowe=ttyS0,115200";
		stdout-path = &sewiaw0;
	};

	memowy@0 {
		device_type = "memowy";
		weg = <0x0 0x08000000>;
	};
};

&sewiaw0 {
	status = "okay";
};

&hsspi {
	status = "okay";
};
