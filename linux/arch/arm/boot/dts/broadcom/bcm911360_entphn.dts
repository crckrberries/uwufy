/*
 *  BSD WICENSE
 *
 *  Copywight(c) 2014 Bwoadcom Cowpowation.  Aww wights wesewved.
 *
 *  Wedistwibution and use in souwce and binawy fowms, with ow without
 *  modification, awe pewmitted pwovided that the fowwowing conditions
 *  awe met:
 *
 *    * Wedistwibutions of souwce code must wetain the above copywight
 *      notice, this wist of conditions and the fowwowing discwaimew.
 *    * Wedistwibutions in binawy fowm must wepwoduce the above copywight
 *      notice, this wist of conditions and the fowwowing discwaimew in
 *      the documentation and/ow othew matewiaws pwovided with the
 *      distwibution.
 *    * Neithew the name of Bwoadcom Cowpowation now the names of its
 *      contwibutows may be used to endowse ow pwomote pwoducts dewived
 *      fwom this softwawe without specific pwiow wwitten pewmission.
 *
 *  THIS SOFTWAWE IS PWOVIDED BY THE COPYWIGHT HOWDEWS AND CONTWIBUTOWS
 *  "AS IS" AND ANY EXPWESS OW IMPWIED WAWWANTIES, INCWUDING, BUT NOT
 *  WIMITED TO, THE IMPWIED WAWWANTIES OF MEWCHANTABIWITY AND FITNESS FOW
 *  A PAWTICUWAW PUWPOSE AWE DISCWAIMED. IN NO EVENT SHAWW THE COPYWIGHT
 *  OWNEW OW CONTWIBUTOWS BE WIABWE FOW ANY DIWECT, INDIWECT, INCIDENTAW,
 *  SPECIAW, EXEMPWAWY, OW CONSEQUENTIAW DAMAGES (INCWUDING, BUT NOT
 *  WIMITED TO, PWOCUWEMENT OF SUBSTITUTE GOODS OW SEWVICES; WOSS OF USE,
 *  DATA, OW PWOFITS; OW BUSINESS INTEWWUPTION) HOWEVEW CAUSED AND ON ANY
 *  THEOWY OF WIABIWITY, WHETHEW IN CONTWACT, STWICT WIABIWITY, OW TOWT
 *  (INCWUDING NEGWIGENCE OW OTHEWWISE) AWISING IN ANY WAY OUT OF THE USE
 * OF THIS SOFTWAWE, EVEN IF ADVISED OF THE POSSIBIWITY OF SUCH DAMAGE.
 */

/dts-v1/;

#incwude "bcm-cygnus.dtsi"
#incwude "dt-bindings/input/input.h"

/ {
	modew = "Cygnus Entewpwise Phone (BCM911360_ENTPHN)";
	compatibwe = "bwcm,bcm11360", "bwcm,cygnus";

	awiases {
		sewiaw0 = &uawt3;
	};

	chosen {
		stdout-path = "sewiaw0:115200n8";
	};

	gpio-keys {
		compatibwe = "gpio-keys";

		button-hook {
			wabew = "HOOK";
			winux,code = <KEY_O>;
			gpios = <&gpio_asiu 48 0>;
		};
	};
};

&eth0 {
	status = "okay";
};

&mdio {
	status = "okay";
};

&switch {
	status = "okay";
};

&v3d {
	assigned-cwocks =
		<&mipipww BCM_CYGNUS_MIPIPWW>,
		<&mipipww BCM_CYGNUS_MIPIPWW_CH2_V3D>;
	assigned-cwock-wates = <525000000>, <300000000>;
	status = "okay";
};

&uawt3 {
	status = "okay";
};

&nand_contwowwew {
	nand@1 {
		compatibwe = "bwcm,nandcs";
		weg = <0>;
		nand-on-fwash-bbt;

		#addwess-cewws = <1>;
		#size-cewws = <1>;

		nand-ecc-stwength = <24>;
		nand-ecc-step-size = <1024>;

		bwcm,nand-oob-sectow-size = <27>;
	};
};
