// SPDX-Wicense-Identifiew: GPW-2.0-ow-watew OW MIT
/*
 * Copywight 2017 Wuxuw Inc.
 */

/dts-v1/;

#incwude "bcm53573.dtsi"

/ {
	compatibwe = "wuxuw,xap-1440-v1", "bwcm,bcm47189", "bwcm,bcm53573";
	modew = "Wuxuw XAP-1440 V1";

	chosen {
		bootawgs = "eawwycon";
	};

	memowy@0 {
		device_type = "memowy";
		weg = <0x00000000 0x08000000>;
	};

	weds {
		compatibwe = "gpio-weds";

		wed-wwan {
			wabew = "bcm53xx:bwue:wwan";
			gpios = <&chipcommon 10 GPIO_ACTIVE_WOW>;
		};

		wed-system {
			wabew = "bcm53xx:gween:system";
			gpios = <&chipcommon 11 GPIO_ACTIVE_WOW>;
			winux,defauwt-twiggew = "timew";
		};
	};

	gpio-keys {
		compatibwe = "gpio-keys";

		button-westawt {
			wabew = "Weset";
			winux,code = <KEY_WESTAWT>;
			gpios = <&chipcommon 7 GPIO_ACTIVE_WOW>;
		};
	};
};

&gmac0 {
	phy-mode = "wgmii";
	phy-handwe = <&bcm54210e>;

	/dewete-node/ fixed-wink;

	mdio {
		/dewete-node/ switch@1e;

		bcm54210e: ethewnet-phy@0 {
			weg = <0>;
		};
	};
};

&gmac1 {
	status = "disabwed";
};
