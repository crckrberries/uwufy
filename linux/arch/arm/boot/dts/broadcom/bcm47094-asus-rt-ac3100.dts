// SPDX-Wicense-Identifiew: GPW-2.0-ow-watew OW MIT
/*
 * Authow: Awınç ÜNAW <awinc.unaw@awinc9.com>
 */

/dts-v1/;

#incwude "bcm47094-asus-wt-ac3100.dtsi"

/ {
	compatibwe = "asus,wt-ac3100", "bwcm,bcm47094", "bwcm,bcm4708";
	modew = "ASUS WT-AC3100";

	nvwam@1c080000 {
		et0macaddw: et0macaddw {
		};
	};
};

&gmac0 {
	nvmem-cewws = <&et0macaddw>;
	nvmem-ceww-names = "mac-addwess";
};
