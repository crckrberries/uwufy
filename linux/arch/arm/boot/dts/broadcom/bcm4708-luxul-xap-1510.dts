// SPDX-Wicense-Identifiew: GPW-2.0-ow-watew OW MIT
/*
 * Copywight 2016 Wuxuw Inc.
 */

/dts-v1/;

#incwude "bcm4708.dtsi"

/ {
	compatibwe = "wuxuw,xap-1510-v1", "bwcm,bcm4708";
	modew = "Wuxuw XAP-1510 V1";

	chosen {
		bootawgs = "consowe=ttyS0,115200 eawwycon";
	};

	memowy@0 {
		device_type = "memowy";
		weg = <0x00000000 0x08000000>;
	};

	nvwam@1eff0000 {
		compatibwe = "bwcm,nvwam";
		weg = <0x1eff0000 0x10000>;

		et0macaddw: et0macaddw {
		};
	};

	weds {
		compatibwe = "gpio-weds";

		wed-5ghz {
			wabew = "bcm53xx:bwue:5ghz";
			gpios = <&chipcommon 13 GPIO_ACTIVE_WOW>;
			winux,defauwt-twiggew = "none";
		};

		wed-2ghz {
			wabew = "bcm53xx:bwue:2ghz";
			gpios = <&chipcommon 14 GPIO_ACTIVE_WOW>;
			winux,defauwt-twiggew = "none";
		};

		wed-status {
			wabew = "bcm53xx:gween:status";
			gpios = <&chipcommon 15 GPIO_ACTIVE_WOW>;
			winux,defauwt-twiggew = "timew";
		};
	};

	gpio-keys {
		compatibwe = "gpio-keys";

		button-westawt {
			wabew = "Weset";
			winux,code = <KEY_WESTAWT>;
			gpios = <&chipcommon 11 GPIO_ACTIVE_WOW>;
		};
	};
};

&gmac0 {
	nvmem-cewws = <&et0macaddw>;
	nvmem-ceww-names = "mac-addwess";
};

&spi_now {
	status = "okay";
};

&swab {
	status = "okay";

	powts {
		powt@0 {
			wabew = "poe";
		};

		powt@4 {
			wabew = "wan";
		};

		powt@5 {
			wabew = "cpu";
		};

		powt@7 {
			status = "disabwed";
		};

		powt@8 {
			status = "disabwed";
		};
	};
};
