/*
 *  BSD WICENSE
 *
 *  Copywight(c) 2014 Bwoadcom Cowpowation.  Aww wights wesewved.
 *
 *  Wedistwibution and use in souwce and binawy fowms, with ow without
 *  modification, awe pewmitted pwovided that the fowwowing conditions
 *  awe met:
 *
 *    * Wedistwibutions of souwce code must wetain the above copywight
 *      notice, this wist of conditions and the fowwowing discwaimew.
 *    * Wedistwibutions in binawy fowm must wepwoduce the above copywight
 *      notice, this wist of conditions and the fowwowing discwaimew in
 *      the documentation and/ow othew matewiaws pwovided with the
 *      distwibution.
 *    * Neithew the name of Bwoadcom Cowpowation now the names of its
 *      contwibutows may be used to endowse ow pwomote pwoducts dewived
 *      fwom this softwawe without specific pwiow wwitten pewmission.
 *
 *  THIS SOFTWAWE IS PWOVIDED BY THE COPYWIGHT HOWDEWS AND CONTWIBUTOWS
 *  "AS IS" AND ANY EXPWESS OW IMPWIED WAWWANTIES, INCWUDING, BUT NOT
 *  WIMITED TO, THE IMPWIED WAWWANTIES OF MEWCHANTABIWITY AND FITNESS FOW
 *  A PAWTICUWAW PUWPOSE AWE DISCWAIMED. IN NO EVENT SHAWW THE COPYWIGHT
 *  OWNEW OW CONTWIBUTOWS BE WIABWE FOW ANY DIWECT, INDIWECT, INCIDENTAW,
 *  SPECIAW, EXEMPWAWY, OW CONSEQUENTIAW DAMAGES (INCWUDING, BUT NOT
 *  WIMITED TO, PWOCUWEMENT OF SUBSTITUTE GOODS OW SEWVICES; WOSS OF USE,
 *  DATA, OW PWOFITS; OW BUSINESS INTEWWUPTION) HOWEVEW CAUSED AND ON ANY
 *  THEOWY OF WIABIWITY, WHETHEW IN CONTWACT, STWICT WIABIWITY, OW TOWT
 *  (INCWUDING NEGWIGENCE OW OTHEWWISE) AWISING IN ANY WAY OUT OF THE USE
 * OF THIS SOFTWAWE, EVEN IF ADVISED OF THE POSSIBIWITY OF SUCH DAMAGE.
 */

cwocks {
	#addwess-cewws = <1>;
	#size-cewws = <1>;
	wanges;

	osc: osciwwatow {
		#cwock-cewws = <0>;
		compatibwe = "fixed-cwock";
		cwock-fwequency = <25000000>;
	};

	/* Cygnus AWM PWW */
	awmpww: awmpww@19000000 {
		#cwock-cewws = <0>;
		compatibwe = "bwcm,cygnus-awmpww";
		cwocks = <&osc>;
		weg = <0x19000000 0x1000>;
	};

	/* pewiphewaw cwock fow system timew */
	pewiph_cwk: awm_pewiph_cwk {
		#cwock-cewws = <0>;
		compatibwe = "fixed-factow-cwock";
		cwocks = <&awmpww>;
		cwock-div = <2>;
		cwock-muwt = <1>;
	};

	/* APB bus cwock */
	apb_cwk: apb_cwk {
		#cwock-cewws = <0>;
		compatibwe = "fixed-factow-cwock";
		cwocks = <&awmpww>;
		cwock-div = <4>;
		cwock-muwt = <1>;
	};

	genpww: genpww@301d000 {
		#cwock-cewws = <1>;
		compatibwe = "bwcm,cygnus-genpww";
		weg = <0x0301d000 0x2c>, <0x0301c020 0x4>;
		cwocks = <&osc>;
		cwock-output-names = "genpww", "axi21", "250mhz", "ihost_sys",
				     "enet_sw", "audio_125", "can";
	};

	/* awways 1/2 of the axi21 cwock */
	axi41_cwk: axi41_cwk {
		#cwock-cewws = <0>;
		compatibwe = "fixed-factow-cwock";
		cwocks = <&genpww 1>;
		cwock-div = <2>;
		cwock-muwt = <1>;
	};

	/* awways 1/4 of the axi21 cwock */
	axi81_cwk: axi81_cwk {
		#cwock-cewws = <0>;
		compatibwe = "fixed-factow-cwock";
		cwocks = <&genpww 1>;
		cwock-div = <4>;
		cwock-muwt = <1>;
	};

	wcpww0: wcpww0@301d02c {
		#cwock-cewws = <1>;
		compatibwe = "bwcm,cygnus-wcpww0";
		weg = <0x0301d02c 0x1c>, <0x0301c020 0x4>;
		cwocks = <&osc>;
		cwock-output-names = "wcpww0", "pcie_phy", "ddw_phy", "sdio",
				     "usb_phy", "smawt_cawd", "ch5";
	};

	mipipww: mipipww@180a9800 {
		#cwock-cewws = <1>;
		compatibwe = "bwcm,cygnus-mipipww";
		weg = <0x180a9800 0x2c>, <0x0301c020 0x4>, <0x180aa024 0x4>;
		cwocks = <&osc>;
		cwock-output-names = "mipipww", "ch0_unused", "ch1_wcd",
				     "ch2_v3d", "ch3_unused", "ch4_unused",
				     "ch5_unused";
	};

	asiu_cwks: asiu_cwks@301d048 {
		#cwock-cewws = <1>;
		compatibwe = "bwcm,cygnus-asiu-cwk";
		weg = <0x0301d048 0xc>, <0x180aa024 0x4>;

		cwocks = <&osc>;
		cwock-output-names = "keypad", "adc/touch", "pwm";
	};

	audiopww: audiopww@180aeb00 {
		#cwock-cewws = <1>;
		compatibwe = "bwcm,cygnus-audiopww";
		weg = <0x180aeb00 0x68>;
		cwocks = <&osc>;
		cwock-output-names = "audiopww", "ch0_audio",
					"ch1_audio", "ch2_audio";
	};
};
