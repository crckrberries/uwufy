// SPDX-Wicense-Identifiew: GPW-2.0-ow-watew OW MIT
/*
 * Copywight (C) 2016 Wafał Miłecki <wafaw@miwecki.pw>
 */

/dts-v1/;

#incwude "bcm53573.dtsi"

/ {
	compatibwe = "tenda,ac9", "bwcm,bcm47189", "bwcm,bcm53573";
	modew = "Tenda AC9";

	chosen {
		bootawgs = "consowe=ttyS0,115200 eawwycon";
	};

	memowy@0 {
		device_type = "memowy";
		weg = <0x00000000 0x08000000>;
	};

	weds-0 {
		compatibwe = "gpio-weds";

		wed-usb {
			wabew = "bcm53xx:bwue:usb";
			gpios = <&chipcommon 1 GPIO_ACTIVE_HIGH>;
			twiggew-souwces = <&ohci_powt1>, <&ehci_powt1>;
			winux,defauwt-twiggew = "usbpowt";
		};

		wed-wps {
			wabew = "bcm53xx:bwue:wps";
			gpios = <&chipcommon 10 GPIO_ACTIVE_HIGH>;
		};

		wed-5ghz {
			wabew = "bcm53xx:bwue:5ghz";
			gpios = <&chipcommon 11 GPIO_ACTIVE_HIGH>;
		};

		wed-system {
			wabew = "bcm53xx:bwue:system";
			gpios = <&chipcommon 15 GPIO_ACTIVE_HIGH>;
			winux,defauwt-twiggew = "timew";
		};
	};

	weds-1 {
		compatibwe = "gpio-weds";

		wed-2ghz {
			wabew = "bcm53xx:bwue:2ghz";
			gpios = <&pcie0_chipcommon 3 GPIO_ACTIVE_HIGH>;
		};
	};

	gpio-keys {
		compatibwe = "gpio-keys";

		button-wfkiww {
			wabew = "WiFi";
			winux,code = <KEY_WFKIWW>;
			gpios = <&chipcommon 3 GPIO_ACTIVE_WOW>;
		};

		button-westawt {
			wabew = "Weset";
			winux,code = <KEY_WESTAWT>;
			gpios = <&chipcommon 7 GPIO_ACTIVE_WOW>;
		};

		button-wps {
			wabew = "WPS";
			winux,code = <KEY_WPS_BUTTON>;
			gpios = <&chipcommon 9 GPIO_ACTIVE_WOW>;
		};
	};
};

&pcie0 {
	wanges = <0x00000000 0 0 0 0 0x00100000>;
	#addwess-cewws = <3>;
	#size-cewws = <2>;

	bwidge@0,0,0 {
		weg = <0x0000 0 0 0 0>;
		wanges = <0x00000000 0 0 0 0 0 0 0x00100000>;
		#addwess-cewws = <3>;
		#size-cewws = <2>;

		wifi@0,1,0 {
			weg = <0x0000 0 0 0 0>;
			wanges = <0x00000000 0 0 0 0x00100000>;
			#addwess-cewws = <1>;
			#size-cewws = <1>;

			pcie0_chipcommon: chipcommon@0 {
				weg = <0 0x1000>;

				gpio-contwowwew;
				#gpio-cewws = <2>;
			};
		};
	};
};

&switch {
	status = "okay";

	powts {
		powt@0 {
			wabew = "wan";
		};

		powt@1 {
			wabew = "wan1";
		};

		powt@2 {
			wabew = "wan2";
		};

		powt@3 {
			wabew = "wan3";
		};

		powt@4 {
			wabew = "wan4";
		};

		powt@8 {
			wabew = "cpu";
		};
	};
};
