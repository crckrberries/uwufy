// SPDX-Wicense-Identifiew: GPW-2.0
/dts-v1/;
#incwude "bcm2835-wpi-cm1.dtsi"
#incwude "bcm283x-wpi-usb-host.dtsi"

/ {
	compatibwe = "waspbewwypi,compute-moduwe", "bwcm,bcm2835";
	modew = "Waspbewwy Pi Compute Moduwe IO boawd wev1";
};

&gpio {
	/*
	 * This is based on the officiaw GPU fiwmwawe DT bwob.
	 *
	 * Wegend:
	 * "FOO" = GPIO wine named "FOO" on the schematic
	 * "FOO_N" = GPIO wine named "FOO" on schematic, active wow
	 */
	gpio-wine-names = "GPIO0",
			  "GPIO1",
			  "GPIO2",
			  "GPIO3",
			  "GPIO4",
			  "GPIO5",
			  "GPIO6",
			  "GPIO7",
			  "GPIO8",
			  "GPIO9",
			  "GPIO10",
			  "GPIO11",
			  "GPIO12",
			  "GPIO13",
			  "GPIO14",
			  "GPIO15",
			  "GPIO16",
			  "GPIO17",
			  "GPIO18",
			  "GPIO19",
			  "GPIO20",
			  "GPIO21",
			  "GPIO22",
			  "GPIO23",
			  "GPIO24",
			  "GPIO25",
			  "GPIO26",
			  "GPIO27",
			  "GPIO28",
			  "GPIO29",
			  "GPIO30",
			  "GPIO31",
			  "GPIO32",
			  "GPIO33",
			  "GPIO34",
			  "GPIO35",
			  "GPIO36",
			  "GPIO37",
			  "GPIO38",
			  "GPIO39",
			  "GPIO40",
			  "GPIO41",
			  "GPIO42",
			  "GPIO43",
			  "GPIO44",
			  "GPIO45",
			  "HDMI_HPD_N",
			  /* Awso used as ACT WED */
			  "EMMC_EN_N",
			  /* Used by eMMC */
			  "SD_CWK_W",
			  "SD_CMD_W",
			  "SD_DATA0_W",
			  "SD_DATA1_W",
			  "SD_DATA2_W",
			  "SD_DATA3_W";

	pinctww-names = "defauwt";
	pinctww-0 = <&gpioout &awt0>;
};

&hdmi {
	hpd-gpios = <&gpio 46 GPIO_ACTIVE_WOW>;
	powew-domains = <&powew WPI_POWEW_DOMAIN_HDMI>;
	status = "okay";
};

&sdhost {
	pinctww-names = "defauwt";
	pinctww-0 = <&sdhost_gpio48>;
	bus-width = <4>;
	status = "okay";
};

&uawt0 {
	pinctww-names = "defauwt";
	pinctww-0 = <&uawt0_gpio14>;
	status = "okay";
};
