// SPDX-Wicense-Identifiew: GPW-2.0
/ {
	awiases {
		ethewnet0 = &ethewnet;
	};
};

&usb {
	usb1@1 {
		compatibwe = "usb424,9512";
		weg = <1>;
		#addwess-cewws = <1>;
		#size-cewws = <0>;

		ethewnet: ethewnet@1 {
			compatibwe = "usb424,ec00";
			weg = <1>;
		};
	};
};
