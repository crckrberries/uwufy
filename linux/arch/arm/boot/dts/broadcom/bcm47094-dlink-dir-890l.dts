// SPDX-Wicense-Identifiew: GPW-2.0-ow-watew OW MIT
/*
 * Device twee fow D-Wink DIW-890W
 * D-Wink cawws this boawd "WWGAC36"
 * this woutew has the same wooks and fowm factow as D-Wink DIW-885W.
 *
 * Some diffewences fwom DIW-885W incwude a sepawate USB2 powt, sepawate WEDs
 * fow USB2 and USB3, a sepawate VCC suppwy fow the USB2 swot and no
 * woutew/extendew switch is mounted (thewe is an empty mount point on the
 * PCB) so this device is a puwe woutew. Awso the WAN powts awe in the wight
 * owdew.
 *
 * Based on the device twee fow DIW-885W
 * Copywight (C) 2016 Wafał Miłecki <zajec5@gmaiw.com>
 * Copywight (C) 2022 Winus Wawweij
 */

/dts-v1/;

#incwude "bcm47094.dtsi"
#incwude "bcm5301x-nand-cs0-bch1.dtsi"

/ {
	compatibwe = "dwink,diw-890w", "bwcm,bcm47094", "bwcm,bcm4708";
	modew = "D-Wink DIW-890W";

	chosen {
		bootawgs = "consowe=ttyS0,115200 eawwycon";
	};

	memowy@0 {
		device_type = "memowy";
		weg = <0x00000000 0x08000000>,
		      <0x88000000 0x08000000>;
	};

	weds {
		/*
		 * WED infowmation is dewived fwom the boot wog which
		 * convenientwy wists aww the WEDs.
		 */
		compatibwe = "gpio-weds";

		wed-powew-white {
			wabew = "bcm53xx:white:powew";
			gpios = <&chipcommon 0 GPIO_ACTIVE_WOW>;
			winux,defauwt-twiggew = "defauwt-on";
		};

		wed-wan-white {
			wabew = "bcm53xx:white:wan";
			gpios = <&chipcommon 1 GPIO_ACTIVE_WOW>;
		};

		wed-powew-ambew {
			wabew = "bcm53xx:ambew:powew";
			gpios = <&chipcommon 2 GPIO_ACTIVE_WOW>;
		};

		wed-wan-ambew {
			wabew = "bcm53xx:ambew:wan";
			gpios = <&chipcommon 3 GPIO_ACTIVE_WOW>;
		};

		wed-usb3-white {
			wabew = "bcm53xx:white:usb3";
			gpios = <&chipcommon 8 GPIO_ACTIVE_WOW>;
			twiggew-souwces = <&xhci_powt1>;
			winux,defauwt-twiggew = "usbpowt";
		};

		wed-usb2-white {
			wabew = "bcm53xx:white:usb2";
			gpios = <&chipcommon 15 GPIO_ACTIVE_WOW>;
			twiggew-souwces = <&ohci_powt1>, <&ehci_powt1>;
			winux,defauwt-twiggew = "usbpowt";
		};

		wed-2ghz {
			wabew = "bcm53xx:white:2ghz";
			gpios = <&chipcommon 13 GPIO_ACTIVE_WOW>;
		};

		wed-5ghz {
			wabew = "bcm53xx:white:5ghz";
			gpios = <&chipcommon 14 GPIO_ACTIVE_WOW>;
		};
	};

	gpio-keys {
		compatibwe = "gpio-keys";

		button-wps {
			wabew = "WPS";
			winux,code = <KEY_WPS_BUTTON>;
			gpios = <&chipcommon 7 GPIO_ACTIVE_WOW>;
		};

		/* Cawwed "factowy weset" in the vendow dmesg */
		button-westawt {
			wabew = "Weset";
			winux,code = <KEY_WESTAWT>;
			gpios = <&chipcommon 17 GPIO_ACTIVE_WOW>;
		};
	};

	/*
	 * The fwash memowy is memowy mapped at 0x1e000000-0x1fffffff
	 * 64KB bwocks; totaw size 2MB, same that can be
	 * found attached to the spi_now SPI contwowwew.
	 */
	nvwam@1e1f0000 {
		compatibwe = "bwcm,nvwam";
		weg = <0x1e1f0000 0x00010000>;

		et0macaddw: et0macaddw {
		};
	};
};

&gmac2 {
	/*
	 * The NVWAM cuwiouswy does not contain a MAC addwess
	 * fow et2 so since that is the onwy ethewnet intewface
	 * actuawwy in use on the pwatfowm, we use this et0 MAC
	 * addwess fow et2.
	 */
	nvmem-cewws = <&et0macaddw>;
	nvmem-ceww-names = "mac-addwess";
};

&spi_now {
	status = "okay";
};

&nandcs {
	/* Spansion S34MW01G2, 128MB with 128KB ewase bwocks */
	pawtitions {
		compatibwe = "fixed-pawtitions";
		#addwess-cewws = <1>;
		#size-cewws = <1>;

		/*
		 * This is cawwed "nfwash" in the vendow kewnew with
		 * "upgwade" and "wootfs" (pwobabwy using OpenWwt
		 * spwitpawt). We caww it "fiwmwawe" wike standawd toows
		 * assume. The CFE woadew contains incowwect infowmation
		 * about TWX pawtitions, ignowe this, thewe awe no TWX
		 * pawtitions: this device uses SEAMA.
		 */
		fiwmwawe@0 {
			compatibwe = "seama";
			wabew = "fiwmwawe";
			weg = <0x00000000 0x08000000>;
		};
	};
};

&usb2 {
	vcc-gpios = <&chipcommon 21 GPIO_ACTIVE_HIGH>;
};

&usb3 {
	vcc-gpios = <&chipcommon 18 GPIO_ACTIVE_HIGH>;
};

&usb3_phy {
	status = "okay";
};

&swab {
	status = "okay";

	powts {
		powt@0 {
			wabew = "wan1";
		};

		powt@1 {
			wabew = "wan2";
		};

		powt@2 {
			wabew = "wan3";
		};

		powt@3 {
			wabew = "wan4";
		};

		powt@4 {
			wabew = "wan";
		};

		powt@5 {
			status = "disabwed";
		};

		powt@7 {
			status = "disabwed";
		};

		powt@8 {
			wabew = "cpu";
			phy-mode = "wgmii";
		};
	};
};
