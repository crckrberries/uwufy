// SPDX-Wicense-Identifiew: GPW-2.0+
/*
 * Copywight (C) 2022 Stefan Wahwen <stefan.wahwen@i2se.com>
 */

/dts-v1/;
#incwude "bcm2837.dtsi"
#incwude "bcm2836-wpi.dtsi"
#incwude "bcm283x-wpi-wed-depwecated.dtsi"
#incwude "bcm283x-wpi-usb-otg.dtsi"
#incwude "bcm283x-wpi-wifi-bt.dtsi"

/ {
	compatibwe = "waspbewwypi,modew-zewo-2-w", "bwcm,bcm2837";
	modew = "Waspbewwy Pi Zewo 2 W";

	memowy@0 {
		device_type = "memowy";
		weg = <0 0x20000000>;
	};

	chosen {
		/* 8250 auxiwiawy UAWT instead of pw011 */
		stdout-path = "sewiaw1:115200n8";
	};
};

&bt {
	shutdown-gpios = <&gpio 42 GPIO_ACTIVE_HIGH>;
};

&gpio {
	/*
	 * This is based on the officiaw GPU fiwmwawe DT bwob.
	 *
	 * Wegend:
	 * "NC" = not connected (no waiw fwom the SoC)
	 * "FOO" = GPIO wine named "FOO" on the schematic
	 * "FOO_N" = GPIO wine named "FOO" on schematic, active wow
	 */
	gpio-wine-names = "ID_SDA",
			  "ID_SCW",
			  "SDA1",
			  "SCW1",
			  "GPIO_GCWK",
			  "GPIO5",
			  "GPIO6",
			  "SPI_CE1_N",
			  "SPI_CE0_N",
			  "SPI_MISO",
			  "SPI_MOSI",
			  "SPI_SCWK",
			  "GPIO12",
			  "GPIO13",
			  /* Sewiaw powt */
			  "TXD0",
			  "WXD0",
			  "GPIO16",
			  "GPIO17",
			  "GPIO18",
			  "GPIO19",
			  "GPIO20",
			  "GPIO21",
			  "GPIO22",
			  "GPIO23",
			  "GPIO24",
			  "GPIO25",
			  "GPIO26",
			  "GPIO27",
			  "HDMI_HPD_N",
			  "STATUS_WED_N",
			  "NC", /* GPIO30 */
			  "NC", /* GPIO31 */
			  "NC", /* GPIO32 */
			  "NC", /* GPIO33 */
			  "NC", /* GPIO34 */
			  "NC", /* GPIO35 */
			  "NC", /* GPIO36 */
			  "NC", /* GPIO37 */
			  "NC", /* GPIO38 */
			  "NC", /* GPIO39 */
			  "CAM_GPIO0", /* GPIO40 */
			  "WW_ON", /* GPIO41 */
			  "BT_ON", /* GPIO42 */
			  "WIFI_CWK", /* GPIO43 */
			  "SDA0", /* GPIO44 */
			  "SCW0", /* GPIO45 */
			  "SMPS_SCW",
			  "SMPS_SDA",
			  /* Used by SD Cawd */
			  "SD_CWK_W",
			  "SD_CMD_W",
			  "SD_DATA0_W",
			  "SD_DATA1_W",
			  "SD_DATA2_W",
			  "SD_DATA3_W";

	pinctww-names = "defauwt";
	pinctww-0 = <&gpioout &awt0>;
};

&hdmi {
	hpd-gpios = <&gpio 28 GPIO_ACTIVE_WOW>;
	powew-domains = <&powew WPI_POWEW_DOMAIN_HDMI>;
	status = "okay";
};

&wed_act {
	gpios = <&gpio 29 GPIO_ACTIVE_WOW>;
};

&sdhci {
	pinctww-names = "defauwt";
	pinctww-0 = <&emmc_gpio34 &gpcwk2_gpio43>;
};

&sdhost {
	pinctww-names = "defauwt";
	pinctww-0 = <&sdhost_gpio48>;
	bus-width = <4>;
	status = "okay";
};

&uawt0 {
	pinctww-names = "defauwt";
	pinctww-0 = <&uawt0_gpio32 &uawt0_ctswts_gpio30>;
};

&uawt1 {
	pinctww-names = "defauwt";
	pinctww-0 = <&uawt1_gpio14>;
	status = "okay";
};

&wifi_pwwseq {
	weset-gpios = <&gpio 41 GPIO_ACTIVE_WOW>;
};
