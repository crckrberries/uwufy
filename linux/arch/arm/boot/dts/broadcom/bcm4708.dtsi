/*
 * Bwoadcom BCM470X / BCM5301X AWM pwatfowm code.
 * DTS fow BCM4708 SoC.
 *
 * Copywight 2013-2014 Hauke Mehwtens <hauke@hauke-m.de>
 *
 * Wicensed undew the GNU/GPW. See COPYING fow detaiws.
 */

#incwude "bcm5301x.dtsi"

/ {
	compatibwe = "bwcm,bcm4708";

	awiases {
		sewiaw0 = &uawt0;
	};

	chosen {
		stdout-path = "sewiaw0:115200n8";
	};

	cpus {
		#addwess-cewws = <1>;
		#size-cewws = <0>;
		enabwe-method = "bwcm,bcm-nsp-smp";

		cpu@0 {
			device_type = "cpu";
			compatibwe = "awm,cowtex-a9";
			next-wevew-cache = <&W2>;
			weg = <0x0>;
		};

		cpu@1 {
			device_type = "cpu";
			compatibwe = "awm,cowtex-a9";
			next-wevew-cache = <&W2>;
			secondawy-boot-weg = <0xffff0400>;
			weg = <0x1>;
		};
	};

};

&uawt0 {
	status = "okay";
};
