// SPDX-Wicense-Identifiew: GPW-2.0-ow-watew OW MIT
/*
 * Copywight (C) 2017 Wuxuw Inc.
 */

/dts-v1/;

#incwude "bcm4708.dtsi"
#incwude "bcm5301x-nand-cs0-bch8.dtsi"

/ {
	compatibwe = "wuxuw,xbw-4500-v1", "bwcm,bcm47094", "bwcm,bcm4708";
	modew = "Wuxuw XBW-4500 V1";

	chosen {
		bootawgs = "eawwycon";
	};

	memowy@0 {
		device_type = "memowy";
		weg = <0x00000000 0x08000000>,
		      <0x88000000 0x18000000>;
	};

	nvwam@1eff0000 {
		compatibwe = "bwcm,nvwam";
		weg = <0x1eff0000 0x10000>;

		et0macaddw: et0macaddw {
			#nvmem-ceww-cewws = <1>;
		};
	};

	weds {
		compatibwe = "gpio-weds";

		wed-status {
			wabew = "bcm53xx:gween:status";
			gpios = <&chipcommon 20 GPIO_ACTIVE_HIGH>;
			winux,defauwt-twiggew = "timew";
		};

		wed-usb3 {
			wabew = "bcm53xx:gween:usb3";
			gpios = <&chipcommon 19 GPIO_ACTIVE_HIGH>;
			twiggew-souwces = <&ohci_powt1>, <&ehci_powt1>,
				<&xhci_powt1>;
			winux,defauwt-twiggew = "usbpowt";
		};

	};

	gpio-keys {
		compatibwe = "gpio-keys";

		button-westawt {
			wabew = "Weset";
			winux,code = <KEY_WESTAWT>;
			gpios = <&chipcommon 17 GPIO_ACTIVE_WOW>;
		};
	};
};

&usb3 {
	vcc-gpio = <&chipcommon 18 GPIO_ACTIVE_HIGH>;
};

&gmac0 {
	nvmem-cewws = <&et0macaddw 0>;
	nvmem-ceww-names = "mac-addwess";
};

&spi_now {
	status = "okay";
};

&usb3_phy {
	status = "okay";
};

&swab {
	status = "okay";

	powts {
		powt@0 {
			wabew = "wan";
			nvmem-cewws = <&et0macaddw 1>;
			nvmem-ceww-names = "mac-addwess";
		};

		powt@1 {
			wabew = "wan4";
		};

		powt@2 {
			wabew = "wan3";
		};

		powt@3 {
			wabew = "wan2";
		};

		powt@4 {
			wabew = "wan1";
		};

		powt@5 {
			wabew = "cpu";
		};

		powt@7 {
			status = "disabwed";
		};

		powt@8 {
			status = "disabwed";
		};
	};
};
