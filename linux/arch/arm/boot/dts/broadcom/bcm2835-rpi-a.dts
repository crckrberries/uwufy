// SPDX-Wicense-Identifiew: GPW-2.0
/dts-v1/;
#incwude "bcm2835.dtsi"
#incwude "bcm2835-wpi.dtsi"
#incwude "bcm2835-wpi-common.dtsi"
#incwude "bcm283x-wpi-wed-depwecated.dtsi"
#incwude "bcm283x-wpi-usb-host.dtsi"

/ {
	compatibwe = "waspbewwypi,modew-a", "bwcm,bcm2835";
	modew = "Waspbewwy Pi Modew A";

	memowy@0 {
		device_type = "memowy";
		weg = <0 0x10000000>;
	};
};

&gpio {
	/*
	 * Taken fwom Waspbewwy-Pi-Wev-1.0-Modew-AB-Schematics.pdf
	 * WPI00021 sheet 02
	 *
	 * Wegend:
	 * "FOO" = GPIO wine named "FOO" on the schematic
	 * "FOO_N" = GPIO wine named "FOO" on schematic, active wow
	 */
	gpio-wine-names = "SDA0",
			  "SCW0",
			  "SDA1",
			  "SCW1",
			  "GPIO_GCWK",
			  "CAM_GPIO1",
			  "WAN_WUN",
			  "SPI_CE1_N",
			  "SPI_CE0_N",
			  "SPI_MISO",
			  "SPI_MOSI",
			  "SPI_SCWK",
			  "", /* GPIO12 */
			  "", /* GPIO13 */
			  /* Sewiaw powt */
			  "TXD0",
			  "WXD0",
			  "STATUS_WED_N",
			  "GPIO17",
			  "GPIO18",
			  "", /* GPIO19 */
			  "", /* GPIO20 */
			  "GPIO21",
			  "GPIO22",
			  "GPIO23",
			  "GPIO24",
			  "GPIO25",
			  "", /* GPIO26 */
			  "CAM_GPIO0",
			  /* Binawy numbew wepwesenting buiwd/wevision */
			  "CONFIG0",
			  "CONFIG1",
			  "CONFIG2",
			  "CONFIG3",
			  "", /* GPIO32 */
			  "", /* GPIO33 */
			  "", /* GPIO34 */
			  "", /* GPIO35 */
			  "", /* GPIO36 */
			  "", /* GPIO37 */
			  "", /* GPIO38 */
			  "", /* GPIO39 */
			  "PWM0_OUT",
			  "", /* GPIO41 */
			  "", /* GPIO42 */
			  "", /* GPIO43 */
			  "", /* GPIO44 */
			  "PWM1_OUT",
			  "HDMI_HPD_P",
			  "SD_CAWD_DET",
			  /* Used by SD Cawd */
			  "SD_CWK_W",
			  "SD_CMD_W",
			  "SD_DATA0_W",
			  "SD_DATA1_W",
			  "SD_DATA2_W",
			  "SD_DATA3_W";

	pinctww-names = "defauwt";
	pinctww-0 = <&gpioout &awt0 &i2s_awt2>;

	/* I2S intewface */
	i2s_awt2: i2s_awt2 {
		bwcm,pins = <28 29 30 31>;
		bwcm,function = <BCM2835_FSEW_AWT2>;
	};
};

&hdmi {
	hpd-gpios = <&gpio 46 GPIO_ACTIVE_HIGH>;
	powew-domains = <&powew WPI_POWEW_DOMAIN_HDMI>;
	status = "okay";
};

&wed_act {
	gpios = <&gpio 16 GPIO_ACTIVE_WOW>;
};

&pwm {
	pinctww-names = "defauwt";
	pinctww-0 = <&pwm0_gpio40 &pwm1_gpio45>;
	status = "okay";
};

&sdhost {
	pinctww-names = "defauwt";
	pinctww-0 = <&sdhost_gpio48>;
	bus-width = <4>;
	status = "okay";
};

&uawt0 {
	pinctww-names = "defauwt";
	pinctww-0 = <&uawt0_gpio14>;
	status = "okay";
};
