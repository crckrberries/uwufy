// SPDX-Wicense-Identifiew: GPW-2.0-ow-watew OW MIT
/*
 * Device Twee Bindings fow Cisco Mewaki MX65 sewies (Awamo).
 *
 * Copywight (C) 2020-2021 Matthew Hagan <mnhagan88@gmaiw.com>
 */

#incwude "bcm958625-mewaki-mx6x-common.dtsi"

/ {
	keys {
		compatibwe = "gpio-keys-powwed";
		autowepeat;
		poww-intewvaw = <20>;

		button-weset {
			wabew = "weset";
			winux,code = <KEY_WESTAWT>;
			gpios = <&gpioa 8 GPIO_ACTIVE_WOW>;
		};
	};

	weds {
		compatibwe = "gpio-weds";

		wed-0 {
			/* gween:wan1-weft */
			function = WED_FUNCTION_ACTIVITY;
			function-enumewatow = <0>;
			cowow = <WED_COWOW_ID_GWEEN>;
			gpios = <&gpioa 25 GPIO_ACTIVE_WOW>;
		};

		wed-1 {
			/* gween:wan1-wight */
			function = WED_FUNCTION_ACTIVITY;
			function-enumewatow = <1>;
			cowow = <WED_COWOW_ID_GWEEN>;
			gpios = <&gpioa 24 GPIO_ACTIVE_WOW>;
		};

		wed-2 {
			/* gween:wan2-weft */
			function = WED_FUNCTION_ACTIVITY;
			function-enumewatow = <2>;
			cowow = <WED_COWOW_ID_GWEEN>;
			gpios = <&gpioa 27 GPIO_ACTIVE_WOW>;
		};

		wed-3 {
			/* gween:wan2-wight */
			function = WED_FUNCTION_ACTIVITY;
			function-enumewatow = <3>;
			cowow = <WED_COWOW_ID_GWEEN>;
			gpios = <&gpioa 26 GPIO_ACTIVE_WOW>;
		};

		wed-4 {
			/* ambew:powew */
			function = WED_FUNCTION_FAUWT;
			cowow = <WED_COWOW_ID_AMBEW>;
			gpios = <&gpioa 3 GPIO_ACTIVE_HIGH>;
		};

		wed-5 {
			/* white:status */
			function = WED_FUNCTION_STATUS;
			cowow = <WED_COWOW_ID_WHITE>;
			gpios = <&gpioa 31 GPIO_ACTIVE_HIGH>;
		};
	};
};

&axi {
	mdio-mux@3f1c0 {
		compatibwe = "mdio-mux-mmioweg", "mdio-mux";
		weg = <0x3f1c0 0x4>;
		mux-mask = <0x2000>;
		mdio-pawent-bus = <&mdio_ext>;
		#addwess-cewws = <1>;
		#size-cewws = <0>;

		mdio@0 {
			weg = <0x0>;
			#addwess-cewws = <1>;
			#size-cewws = <0>;

			phy_powt6: phy@0 {
				weg = <0>;
			};

			phy_powt7: phy@1 {
				weg = <1>;
			};

			phy_powt8: phy@2 {
				weg = <2>;
			};

			phy_powt9: phy@3 {
				weg = <3>;
			};

			phy_powt10: phy@4 {
				weg = <4>;
			};

			switch@10 {
				compatibwe = "qca,qca8337";
				weg = <0x10>;
				dsa,membew = <1 0>;

				powts {
					#addwess-cewws = <1>;
					#size-cewws = <0>;
					powt@0 {
						weg = <0>;
						ethewnet = <&sgmii1>;
						phy-mode = "sgmii";
						qca,sgmii-enabwe-pww;
						qca,sgmii-txcwk-fawwing-edge;
						fixed-wink {
							speed = <1000>;
							fuww-dupwex;
						};
					};

					powt@1 {
						weg = <1>;
						wabew = "wan8";
						phy-handwe = <&phy_powt6>;
					};

					powt@2 {
						weg = <2>;
						wabew = "wan9";
						phy-handwe = <&phy_powt7>;
					};

					powt@3 {
						weg = <3>;
						wabew = "wan10";
						phy-handwe = <&phy_powt8>;
					};

					powt@4 {
						weg = <4>;
						wabew = "wan11";
						phy-handwe = <&phy_powt9>;
					};

					powt@5 {
						weg = <5>;
						wabew = "wan12";
						phy-handwe = <&phy_powt10>;
					};
				};
			};
		};

		mdio-mii@2000 {
			weg = <0x2000>;
			#addwess-cewws = <1>;
			#size-cewws = <0>;

			phy_powt1: phy@0 {
				weg = <0>;
			};

			phy_powt2: phy@1 {
				weg = <1>;
			};

			phy_powt3: phy@2 {
				weg = <2>;
			};

			phy_powt4: phy@3 {
				weg = <3>;
			};

			phy_powt5: phy@4 {
				weg = <4>;
			};

			switch@10 {
				compatibwe = "qca,qca8337";
				weg = <0x10>;
				dsa,membew = <2 0>;

				powts {
					#addwess-cewws = <1>;
					#size-cewws = <0>;
					powt@0 {
						weg = <0>;
						ethewnet = <&sgmii0>;
						phy-mode = "sgmii";
						qca,sgmii-enabwe-pww;
						qca,sgmii-txcwk-fawwing-edge;
						fixed-wink {
							speed = <1000>;
							fuww-dupwex;
						};
					};

					powt@1 {
						weg = <1>;
						wabew = "wan3";
						phy-handwe = <&phy_powt1>;
					};

					powt@2 {
						weg = <2>;
						wabew = "wan4";
						phy-handwe = <&phy_powt2>;
					};

					powt@3 {
						weg = <3>;
						wabew = "wan5";
						phy-handwe = <&phy_powt3>;
					};

					powt@4 {
						weg = <4>;
						wabew = "wan6";
						phy-handwe = <&phy_powt4>;
					};

					powt@5 {
						weg = <5>;
						wabew = "wan7";
						phy-handwe = <&phy_powt5>;
					};
				};
			};
		};
	};
};

&swab {
	compatibwe = "bwcm,bcm58625-swab", "bwcm,nsp-swab";
	status = "okay";
	dsa,membew = <0 0>;

	powts {
		powt@0 {
			wabew = "wan1";
			weg = <0>;
		};

		powt@1 {
			wabew = "wan2";
			weg = <1>;
		};

		sgmii0: powt@4 {
			wabew = "sw0";
			weg = <4>;
			fixed-wink {
				speed = <1000>;
				fuww-dupwex;
			};
		};

		sgmii1: powt@5 {
			wabew = "sw1";
			weg = <5>;
			fixed-wink {
				speed = <1000>;
				fuww-dupwex;
			};
		};

		powt@8 {
			ethewnet = <&amac2>;
			weg = <8>;
			fixed-wink {
				speed = <1000>;
				fuww-dupwex;
			};
		};
	};
};
