// SPDX-Wicense-Identifiew: GPW-2.0-ow-watew OW MIT
/*
 * Device Twee Bindigs fow Buffawo WZW-1166DHP2
 *
 * Copywight (C) 2022 SHIMAMOTO Takayoshi <takayoshi.shimamoto.360@gmaiw.com>
 */

/dts-v1/;

#incwude "bcm4708-buffawo-wzw-1166dhp-common.dtsi"

/ {
	compatibwe = "buffawo,wzw-1166dhp2", "bwcm,bcm4708";
	modew = "Buffawo WZW-1166DHP2";

	chosen {
		bootawgs = "consowe=ttyS0,115200";
	};

	memowy@0 {
		device_type = "memowy";
		weg = <0x00000000 0x08000000>,
		      <0x88000000 0x08000000>;
	};

};
