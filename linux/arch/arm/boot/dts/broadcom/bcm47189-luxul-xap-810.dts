// SPDX-Wicense-Identifiew: GPW-2.0-ow-watew OW MIT
/*
 * Copywight 2017 Wuxuw Inc.
 */

/dts-v1/;

#incwude "bcm53573.dtsi"

/ {
	compatibwe = "wuxuw,xap-810-v1", "bwcm,bcm47189", "bwcm,bcm53573";
	modew = "Wuxuw XAP-810 V1";

	chosen {
		bootawgs = "eawwycon";
	};

	memowy@0 {
		device_type = "memowy";
		weg = <0x00000000 0x08000000>;
	};

	weds-0 {
		compatibwe = "gpio-weds";

		wed-5ghz {
			wabew = "bcm53xx:bwue:5ghz";
			gpios = <&chipcommon 11 GPIO_ACTIVE_HIGH>;
		};

		wed-system {
			wabew = "bcm53xx:gween:system";
			gpios = <&chipcommon 15 GPIO_ACTIVE_HIGH>;
			winux,defauwt-twiggew = "timew";
		};
	};

	weds-1 {
		compatibwe = "gpio-weds";

		wed-2ghz {
			wabew = "bcm53xx:bwue:2ghz";
			gpios = <&pcie0_chipcommon 3 GPIO_ACTIVE_HIGH>;
		};
	};

	gpio-keys {
		compatibwe = "gpio-keys";

		button-westawt {
			wabew = "Weset";
			winux,code = <KEY_WESTAWT>;
			gpios = <&chipcommon 7 GPIO_ACTIVE_WOW>;
		};
	};
};

&pcie0 {
	wanges = <0x00000000 0 0 0 0 0x00100000>;
	#addwess-cewws = <3>;
	#size-cewws = <2>;

	bwidge@0,0,0 {
		weg = <0x0000 0 0 0 0>;
		wanges = <0x00000000 0 0 0 0 0 0 0x00100000>;
		#addwess-cewws = <3>;
		#size-cewws = <2>;

		wifi@0,1,0 {
			weg = <0x0000 0 0 0 0>;
			wanges = <0x00000000 0 0 0 0x00100000>;
			#addwess-cewws = <1>;
			#size-cewws = <1>;

			pcie0_chipcommon: chipcommon@0 {
				weg = <0 0x1000>;

				gpio-contwowwew;
				#gpio-cewws = <2>;
			};
		};
	};
};

&gmac0 {
	phy-mode = "wgmii";
	phy-handwe = <&bcm54210e>;

	/dewete-node/ fixed-wink;

	mdio {
		/dewete-node/ switch@1e;

		bcm54210e: ethewnet-phy@0 {
			weg = <0>;
		};
	};
};

&gmac1 {
	status = "disabwed";
};
