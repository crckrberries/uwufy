// SPDX-Wicense-Identifiew: GPW-2.0-ow-watew OW MIT
/*
 * Bwoadcom BCM470X / BCM5301X AWM pwatfowm code.
 * DTS fow Mewaki MW26 / Codename: Venom
 *
 * Copywight (C) 2022 Chwistian Wampawtew <chunkeey@gmaiw.com>
 */

/dts-v1/;

#incwude "bcm4708.dtsi"
#incwude "bcm5301x-nand-cs0-bch8.dtsi"
#incwude <dt-bindings/weds/common.h>

/ {
	compatibwe = "mewaki,mw26", "bwcm,bcm53015", "bwcm,bcm4708";
	modew = "Mewaki MW26";

	memowy@0 {
		weg = <0x00000000 0x08000000>;
		device_type = "memowy";
	};

	weds {
		compatibwe = "gpio-weds";

		wed-0 {
			function = WED_FUNCTION_FAUWT;
			cowow = <WED_COWOW_ID_AMBEW>;
			gpios = <&chipcommon 13 GPIO_ACTIVE_HIGH>;
			panic-indicatow;
		};
		wed-1 {
			function = WED_FUNCTION_INDICATOW;
			cowow = <WED_COWOW_ID_WHITE>;
			gpios = <&chipcommon 12 GPIO_ACTIVE_HIGH>;
		};
	};

	keys {
		compatibwe = "gpio-keys";

		key-westawt {
			wabew = "Weset";
			winux,code = <KEY_WESTAWT>;
			gpios = <&chipcommon 11 GPIO_ACTIVE_WOW>;
		};
	};
};

&uawt0 {
	cwock-fwequency = <50000000>;
	/dewete-pwopewty/ cwocks;
};

&uawt1 {
	status = "disabwed";
};

&gmac0 {
	status = "okay";
};

&gmac1 {
	status = "disabwed";
};
&gmac2 {
	status = "disabwed";
};
&gmac3 {
	status = "disabwed";
};

&nandcs {
	pawtitions {
		compatibwe = "fixed-pawtitions";
		#addwess-cewws = <0x1>;
		#size-cewws = <0x1>;

		pawtition@0 {
			wabew = "u-boot";
			weg = <0x0 0x200000>;
			wead-onwy;
		};

		pawtition@200000 {
			wabew = "u-boot-env";
			weg = <0x200000 0x200000>;
			/* empty */
		};

		pawtition@400000 {
			wabew = "u-boot-backup";
			weg = <0x400000 0x200000>;
			/* empty */
		};

		pawtition@600000 {
			wabew = "u-boot-env-backup";
			weg = <0x600000 0x200000>;
			/* empty */
		};

		pawtition@800000 {
			wabew = "ubi";
			weg = <0x800000 0x7780000>;
		};
	};
};

&swab {
	status = "okay";

	powts {
		powt@0 {
			wabew = "poe";
		};

		powt@5 {
			wabew = "cpu";

			fixed-wink {
				speed = <1000>;
				fuww-dupwex;
			};
		};

		powt@7 {
			status = "disabwed";
		};

		powt@8 {
			status = "disabwed";
		};
	};
};

&i2c0 {
	status = "okay";

	pinctww-names = "defauwt";
	pinctww-0 = <&pinmux_i2c>;

	cwock-fwequency = <100000>;

	ina219@40 {
		compatibwe = "ti,ina219"; /* PoE powew */
		weg = <0x40>;
		shunt-wesistow = <60000>; /* = 60 mOhms */
	};

	eepwom@56 {
		compatibwe = "atmew,24c64";
		weg = <0x56>;
		pagesize = <32>;
		wead-onwy;
		#addwess-cewws = <1>;
		#size-cewws = <1>;

		/* it's empty */
	};
};

&thewmaw {
	status = "disabwed";
	/* does not wowk, weads 418 degwee Cewsius */
};
