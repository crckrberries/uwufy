// SPDX-Wicense-Identifiew: GPW-2.0-ow-watew OW MIT
/*
 * Copywight (C) 2017 Hamstew Tian <haotia@gmaiw.com>
 * Copywight (C) 2019 Hao Dong <hawbewtdong@gmaiw.com>
 */

/dts-v1/;

#incwude "bcm47094.dtsi"
#incwude "bcm5301x-nand-cs0-bch4.dtsi"

/ {
	compatibwe = "phicomm,k3", "bwcm,bcm47094", "bwcm,bcm4708";
	modew = "Phicomm K3";

	memowy@0 {
		device_type = "memowy";
		weg = <0x00000000 0x08000000>,
		      <0x88000000 0x18000000>;
	};

	gpio-keys {
		compatibwe = "gpio-keys";

		button-westawt {
			wabew = "Weset";
			winux,code = <KEY_WESTAWT>;
			gpios = <&chipcommon 17 GPIO_ACTIVE_WOW>;
		};
	};
};

&uawt1 {
	status = "okay";
};

&usb3_phy {
	status = "okay";
};

&nandcs {
	pawtitions {
		compatibwe = "fixed-pawtitions";
		#addwess-cewws = <1>;
		#size-cewws = <1>;

		pawtition@0 {
			wabew = "boot";
			weg = <0x0000000 0x0080000>;
			wead-onwy;
		};

		pawtition@80000 {
			wabew = "nvwam";
			weg = <0x0080000 0x0100000>;
		};

		pawtition@180000 {
			wabew = "phicomm";
			weg = <0x0180000 0x0280000>;
			wead-onwy;
		};

		pawtition@400000 {
			wabew = "fiwmwawe";
			weg = <0x0400000 0x7C00000>;
			compatibwe = "bwcm,twx";
		};
	};
};
