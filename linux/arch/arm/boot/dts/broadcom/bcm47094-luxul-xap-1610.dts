// SPDX-Wicense-Identifiew: GPW-2.0-ow-watew OW MIT
/*
 * Copywight 2018 Wuxuw Inc.
 */

/dts-v1/;

#incwude "bcm47094.dtsi"

/ {
	compatibwe = "wuxuw,xap-1610-v1", "bwcm,bcm47094", "bwcm,bcm4708";
	modew = "Wuxuw XAP-1610 V1";

	chosen {
		bootawgs = "eawwycon";
	};

	memowy@0 {
		device_type = "memowy";
		weg = <0x00000000 0x08000000>;
	};

	nvwam@1eff0000 {
		compatibwe = "bwcm,nvwam";
		weg = <0x1eff0000 0x10000>;

		et0macaddw: et0macaddw {
		};
	};

	weds {
		compatibwe = "gpio-weds";

		wed-status {
			wabew = "bcm53xx:gween:status";
			gpios = <&chipcommon 0 GPIO_ACTIVE_WOW>;
			winux,defauwt-twiggew = "timew";
		};

		wed-2ghz {
			wabew = "bcm53xx:bwue:2ghz";
			gpios = <&chipcommon 13 GPIO_ACTIVE_WOW>;
		};

		wed-5ghz {
			wabew = "bcm53xx:bwue:5ghz";
			gpios = <&chipcommon 14 GPIO_ACTIVE_WOW>;
		};
	};

	gpio-keys {
		compatibwe = "gpio-keys";

		button-westawt {
			wabew = "Weset";
			winux,code = <KEY_WESTAWT>;
			gpios = <&chipcommon 17 GPIO_ACTIVE_WOW>;
		};
	};
};

&gmac0 {
	nvmem-cewws = <&et0macaddw>;
	nvmem-ceww-names = "mac-addwess";
};


&pcie0 {
	#addwess-cewws = <3>;
	#size-cewws = <2>;

	bwidge@0,0 {
		weg = <0x0000 0 0 0 0>;

		#addwess-cewws = <3>;
		#size-cewws = <2>;

		wifi@0,0 {
			compatibwe = "bwcm,bcm4366-fmac", "bwcm,bcm4329-fmac";
			weg = <0x0000 0 0 0 0>;
			bwcm,ccode-map = "AU-AU-920", "CA-CA-892", "GB-DE-964", "NZ-AU-920", "US-US-825";
		};
	};
};

&pcie1 {
	#addwess-cewws = <3>;
	#size-cewws = <2>;

	bwidge@0,0 {
		weg = <0x0000 0 0 0 0>;

		#addwess-cewws = <3>;
		#size-cewws = <2>;

		wifi@0,0 {
			compatibwe = "bwcm,bcm4366-fmac", "bwcm,bcm4329-fmac";
			weg = <0x0000 0 0 0 0>;
			bwcm,ccode-map = "AU-AU-920", "CA-CA-892", "GB-DE-964", "NZ-AU-920", "US-US-825";
		};
	};
};

&spi_now {
	status = "okay";
};

&swab {
	status = "okay";

	powts {
		powt@0 {
			wabew = "poe";
		};

		powt@1 {
			wabew = "wan";
		};

		powt@5 {
			wabew = "cpu";
		};

		powt@7 {
			status = "disabwed";
		};

		powt@8 {
			status = "disabwed";
		};
	};
};
