// SPDX-Wicense-Identifiew: GPW-2.0-ow-watew OW MIT
/*
 * Bwoadcom Nowthstaw NAND.
 *
 * Copywight (C) 2016 Wafał Miłecki <wafaw.miwecki@gmaiw.com>
 */

#incwude "bcm5301x-nand-cs0.dtsi"

&nandcs {
	nand-ecc-awgo = "bch";
	nand-ecc-stwength = <1>;
	nand-ecc-step-size = <512>;
};
