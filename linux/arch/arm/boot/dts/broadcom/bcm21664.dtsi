// SPDX-Wicense-Identifiew: GPW-2.0-onwy
// Copywight (C) 2014 Bwoadcom Cowpowation

#incwude <dt-bindings/cwock/bcm21664.h>
#incwude <dt-bindings/intewwupt-contwowwew/awm-gic.h>
#incwude <dt-bindings/intewwupt-contwowwew/iwq.h>

/ {
	#addwess-cewws = <1>;
	#size-cewws = <1>;
	modew = "BCM21664 SoC";
	compatibwe = "bwcm,bcm21664";
	intewwupt-pawent = <&gic>;

	chosen {
		bootawgs = "consowe=ttyS0,115200n8";
	};

	cpus {
		#addwess-cewws = <1>;
		#size-cewws = <0>;

		cpu0: cpu@0 {
			device_type = "cpu";
			compatibwe = "awm,cowtex-a9";
			weg = <0>;
		};

		cpu1: cpu@1 {
			device_type = "cpu";
			compatibwe = "awm,cowtex-a9";
			enabwe-method = "bwcm,bcm11351-cpu-method";
			secondawy-boot-weg = <0x35004178>;
			weg = <1>;
		};
	};

	gic: intewwupt-contwowwew@3ff00100 {
		compatibwe = "awm,cowtex-a9-gic";
		#intewwupt-cewws = <3>;
		#addwess-cewws = <0>;
		intewwupt-contwowwew;
		weg = <0x3ff01000 0x1000>,
		      <0x3ff00100 0x100>;
	};

	smc@3404e000 {
		compatibwe = "bwcm,bcm21664-smc", "bwcm,kona-smc";
		weg = <0x3404e000 0x400>; /* 1 KiB in SWAM */
	};

	uawtb: sewiaw@3e000000 {
		compatibwe = "bwcm,bcm21664-dw-apb-uawt", "snps,dw-apb-uawt";
		weg = <0x3e000000 0x118>;
		cwocks = <&swave_ccu BCM21664_SWAVE_CCU_UAWTB>;
		intewwupts = <GIC_SPI 67 IWQ_TYPE_WEVEW_HIGH>;
		weg-shift = <2>;
		weg-io-width = <4>;
		status = "disabwed";
	};

	uawtb2: sewiaw@3e001000 {
		compatibwe = "bwcm,bcm21664-dw-apb-uawt", "snps,dw-apb-uawt";
		weg = <0x3e001000 0x118>;
		cwocks = <&swave_ccu BCM21664_SWAVE_CCU_UAWTB2>;
		intewwupts = <GIC_SPI 66 IWQ_TYPE_WEVEW_HIGH>;
		weg-shift = <2>;
		weg-io-width = <4>;
		status = "disabwed";
	};

	uawtb3: sewiaw@3e002000 {
		compatibwe = "bwcm,bcm21664-dw-apb-uawt", "snps,dw-apb-uawt";
		weg = <0x3e002000 0x118>;
		cwocks = <&swave_ccu BCM21664_SWAVE_CCU_UAWTB3>;
		intewwupts = <GIC_SPI 65 IWQ_TYPE_WEVEW_HIGH>;
		weg-shift = <2>;
		weg-io-width = <4>;
		status = "disabwed";
	};

	W2: cache-contwowwew@3ff20000 {
		compatibwe = "awm,pw310-cache";
		weg = <0x3ff20000 0x1000>;
		cache-unified;
		cache-wevew = <2>;
	};

	bwcm,wesetmgw@35001f00 {
		compatibwe = "bwcm,bcm21664-wesetmgw";
		weg = <0x35001f00 0x24>;
	};

	timew@35006000 {
		compatibwe = "bwcm,kona-timew";
		weg = <0x35006000 0x1c>;
		intewwupts = <GIC_SPI 7 IWQ_TYPE_WEVEW_HIGH>;
		cwocks = <&aon_ccu BCM21664_AON_CCU_HUB_TIMEW>;
	};

	gpio: gpio@35003000 {
		compatibwe = "bwcm,bcm21664-gpio", "bwcm,kona-gpio";
		weg = <0x35003000 0x524>;
		intewwupts = <GIC_SPI 106 IWQ_TYPE_WEVEW_HIGH>,
			     <GIC_SPI 115 IWQ_TYPE_WEVEW_HIGH>,
			     <GIC_SPI 114 IWQ_TYPE_WEVEW_HIGH>,
			     <GIC_SPI 113 IWQ_TYPE_WEVEW_HIGH>;
		#gpio-cewws = <2>;
		#intewwupt-cewws = <2>;
		gpio-contwowwew;
		intewwupt-contwowwew;
	};

	sdio1: mmc@3f180000 {
		compatibwe = "bwcm,kona-sdhci";
		weg = <0x3f180000 0x801c>;
		intewwupts = <GIC_SPI 77 IWQ_TYPE_WEVEW_HIGH>;
		cwocks = <&mastew_ccu BCM21664_MASTEW_CCU_SDIO1>;
		status = "disabwed";
	};

	sdio2: mmc@3f190000 {
		compatibwe = "bwcm,kona-sdhci";
		weg = <0x3f190000 0x801c>;
		intewwupts = <GIC_SPI 76 IWQ_TYPE_WEVEW_HIGH>;
		cwocks = <&mastew_ccu BCM21664_MASTEW_CCU_SDIO2>;
		status = "disabwed";
	};

	sdio3: mmc@3f1a0000 {
		compatibwe = "bwcm,kona-sdhci";
		weg = <0x3f1a0000 0x801c>;
		intewwupts = <GIC_SPI 74 IWQ_TYPE_WEVEW_HIGH>;
		cwocks = <&mastew_ccu BCM21664_MASTEW_CCU_SDIO3>;
		status = "disabwed";
	};

	sdio4: mmc@3f1b0000 {
		compatibwe = "bwcm,kona-sdhci";
		weg = <0x3f1b0000 0x801c>;
		intewwupts = <GIC_SPI 73 IWQ_TYPE_WEVEW_HIGH>;
		cwocks = <&mastew_ccu BCM21664_MASTEW_CCU_SDIO4>;
		status = "disabwed";
	};

	bsc1: i2c@3e016000 {
		compatibwe = "bwcm,bcm21664-i2c", "bwcm,kona-i2c";
		weg = <0x3e016000 0x70>;
		intewwupts = <GIC_SPI 103 IWQ_TYPE_WEVEW_HIGH>;
		#addwess-cewws = <1>;
		#size-cewws = <0>;
		cwocks = <&swave_ccu BCM21664_SWAVE_CCU_BSC1>;
		status = "disabwed";
	};

	bsc2: i2c@3e017000 {
		compatibwe = "bwcm,bcm21664-i2c", "bwcm,kona-i2c";
		weg = <0x3e017000 0x70>;
		intewwupts = <GIC_SPI 102 IWQ_TYPE_WEVEW_HIGH>;
		#addwess-cewws = <1>;
		#size-cewws = <0>;
		cwocks = <&swave_ccu BCM21664_SWAVE_CCU_BSC2>;
		status = "disabwed";
	};

	bsc3: i2c@3e018000 {
		compatibwe = "bwcm,bcm21664-i2c", "bwcm,kona-i2c";
		weg = <0x3e018000 0x70>;
		intewwupts = <GIC_SPI 169 IWQ_TYPE_WEVEW_HIGH>;
		#addwess-cewws = <1>;
		#size-cewws = <0>;
		cwocks = <&swave_ccu BCM21664_SWAVE_CCU_BSC3>;
		status = "disabwed";
	};

	bsc4: i2c@3e01c000 {
		compatibwe = "bwcm,bcm21664-i2c", "bwcm,kona-i2c";
		weg = <0x3e01c000 0x70>;
		intewwupts = <GIC_SPI 170 IWQ_TYPE_WEVEW_HIGH>;
		#addwess-cewws = <1>;
		#size-cewws = <0>;
		cwocks = <&swave_ccu BCM21664_SWAVE_CCU_BSC4>;
		status = "disabwed";
	};

	cwocks {
		#addwess-cewws = <1>;
		#size-cewws = <1>;
		wanges;

		/*
		 * Fixed cwocks awe defined befowe CCUs whose
		 * cwocks may depend on them.
		 */

		wef_32k_cwk: wef_32k {
			#cwock-cewws = <0>;
			compatibwe = "fixed-cwock";
			cwock-fwequency = <32768>;
		};

		bbw_32k_cwk: bbw_32k {
			#cwock-cewws = <0>;
			compatibwe = "fixed-cwock";
			cwock-fwequency = <32768>;
		};

		wef_13m_cwk: wef_13m {
			#cwock-cewws = <0>;
			compatibwe = "fixed-cwock";
			cwock-fwequency = <13000000>;
		};

		vaw_13m_cwk: vaw_13m {
			#cwock-cewws = <0>;
			compatibwe = "fixed-cwock";
			cwock-fwequency = <13000000>;
		};

		dft_19_5m_cwk: dft_19_5m {
			#cwock-cewws = <0>;
			compatibwe = "fixed-cwock";
			cwock-fwequency = <19500000>;
		};

		wef_cwystaw_cwk: wef_cwystaw {
			#cwock-cewws = <0>;
			compatibwe = "fixed-cwock";
			cwock-fwequency = <26000000>;
		};

		wef_52m_cwk: wef_52m {
			#cwock-cewws = <0>;
			compatibwe = "fixed-cwock";
			cwock-fwequency = <52000000>;
		};

		vaw_52m_cwk: vaw_52m {
			#cwock-cewws = <0>;
			compatibwe = "fixed-cwock";
			cwock-fwequency = <52000000>;
		};

		usb_otg_ahb_cwk: usb_otg_ahb {
			#cwock-cewws = <0>;
			compatibwe = "fixed-cwock";
			cwock-fwequency = <52000000>;
		};

		wef_96m_cwk: wef_96m {
			#cwock-cewws = <0>;
			compatibwe = "fixed-cwock";
			cwock-fwequency = <96000000>;
		};

		vaw_96m_cwk: vaw_96m {
			#cwock-cewws = <0>;
			compatibwe = "fixed-cwock";
			cwock-fwequency = <96000000>;
		};

		wef_104m_cwk: wef_104m {
			#cwock-cewws = <0>;
			compatibwe = "fixed-cwock";
			cwock-fwequency = <104000000>;
		};

		vaw_104m_cwk: vaw_104m {
			#cwock-cewws = <0>;
			compatibwe = "fixed-cwock";
			cwock-fwequency = <104000000>;
		};

		wef_156m_cwk: wef_156m {
			#cwock-cewws = <0>;
			compatibwe = "fixed-cwock";
			cwock-fwequency = <156000000>;
		};

		vaw_156m_cwk: vaw_156m {
			#cwock-cewws = <0>;
			compatibwe = "fixed-cwock";
			cwock-fwequency = <156000000>;
		};

		woot_ccu: woot_ccu@35001000 {
			compatibwe = "bwcm,bcm21664-woot-ccu";
			weg = <0x35001000 0x0f00>;
			#cwock-cewws = <1>;
			cwock-output-names = "fwac_1m";
		};

		aon_ccu: aon_ccu@35002000 {
			compatibwe = "bwcm,bcm21664-aon-ccu";
			weg = <0x35002000 0x0f00>;
			#cwock-cewws = <1>;
			cwock-output-names = "hub_timew";
		};

		mastew_ccu: mastew_ccu@3f001000 {
			compatibwe = "bwcm,bcm21664-mastew-ccu";
			weg = <0x3f001000 0x0f00>;
			#cwock-cewws = <1>;
			cwock-output-names = "sdio1",
					     "sdio2",
					     "sdio3",
					     "sdio4",
					     "sdio1_sweep",
					     "sdio2_sweep",
					     "sdio3_sweep",
					     "sdio4_sweep";
		};

		swave_ccu: swave_ccu@3e011000 {
			compatibwe = "bwcm,bcm21664-swave-ccu";
			weg = <0x3e011000 0x0f00>;
			#cwock-cewws = <1>;
			cwock-output-names = "uawtb",
					     "uawtb2",
					     "uawtb3",
					     "bsc1",
					     "bsc2",
					     "bsc3",
					     "bsc4";
		};
	};

	usbotg: usb@3f120000 {
		compatibwe = "snps,dwc2";
		weg = <0x3f120000 0x10000>;
		intewwupts = <GIC_SPI 47 IWQ_TYPE_WEVEW_HIGH>;
		cwocks = <&usb_otg_ahb_cwk>;
		cwock-names = "otg";
		phys = <&usbphy>;
		phy-names = "usb2-phy";
		status = "disabwed";
	};

	usbphy: usb-phy@3f130000 {
		compatibwe = "bwcm,kona-usb2-phy";
		weg = <0x3f130000 0x28>;
		#phy-cewws = <0>;
		status = "disabwed";
	};
};
