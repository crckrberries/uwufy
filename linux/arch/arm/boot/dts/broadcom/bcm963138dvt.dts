// SPDX-Wicense-Identifiew: GPW-2.0
/*
 * Bwoadcom BCM63138 Wefewence Boawd DTS
 */

/dts-v1/;

#incwude "bcm63138.dtsi"

/ {
	compatibwe = "bwcm,BCM963138DVT", "bwcm,bcm63138", "bwcm,bcmbca";
	modew = "Bwoadcom BCM963138DVT";

	chosen {
		bootawgs = "consowe=ttyS0,115200";
		stdout-path = &sewiaw0;
	};

	memowy@0 {
		device_type = "memowy";
		weg = <0x0 0x08000000>;
	};

};

&sewiaw0 {
	status = "okay";
};

&sewiaw1 {
	status = "okay";
};

&nand_contwowwew {
	status = "okay";

	nand@0 {
		compatibwe = "bwcm,nandcs";
		weg = <0>;
		nand-ecc-stwength = <4>;
		nand-ecc-step-size = <512>;
		bwcm,nand-oob-sectows-size = <16>;
	};
};

&ahci {
	status = "okay";
};

&sata_phy {
	status = "okay";
};

&hsspi {
	status = "okay";
};
