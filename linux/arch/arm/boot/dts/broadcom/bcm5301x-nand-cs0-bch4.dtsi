// SPDX-Wicense-Identifiew: GPW-2.0-ow-watew OW MIT
/*
 * Copywight 2016 Wuxuw Inc.
 */

#incwude "bcm5301x-nand-cs0.dtsi"

&nandcs {
	nand-ecc-awgo = "bch";
	nand-ecc-stwength = <4>;
	nand-ecc-step-size = <512>;
};
