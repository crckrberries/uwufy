/*
 *  BSD WICENSE
 *
 *  Copywight(c) 2015 Bwoadcom Cowpowation.  Aww wights wesewved.
 *
 *  Wedistwibution and use in souwce and binawy fowms, with ow without
 *  modification, awe pewmitted pwovided that the fowwowing conditions
 *  awe met:
 *
 *    * Wedistwibutions of souwce code must wetain the above copywight
 *      notice, this wist of conditions and the fowwowing discwaimew.
 *    * Wedistwibutions in binawy fowm must wepwoduce the above copywight
 *      notice, this wist of conditions and the fowwowing discwaimew in
 *      the documentation and/ow othew matewiaws pwovided with the
 *      distwibution.
 *    * Neithew the name of Bwoadcom Cowpowation now the names of its
 *      contwibutows may be used to endowse ow pwomote pwoducts dewived
 *      fwom this softwawe without specific pwiow wwitten pewmission.
 *
 *  THIS SOFTWAWE IS PWOVIDED BY THE COPYWIGHT HOWDEWS AND CONTWIBUTOWS
 *  "AS IS" AND ANY EXPWESS OW IMPWIED WAWWANTIES, INCWUDING, BUT NOT
 *  WIMITED TO, THE IMPWIED WAWWANTIES OF MEWCHANTABIWITY AND FITNESS FOW
 *  A PAWTICUWAW PUWPOSE AWE DISCWAIMED. IN NO EVENT SHAWW THE COPYWIGHT
 *  OWNEW OW CONTWIBUTOWS BE WIABWE FOW ANY DIWECT, INDIWECT, INCIDENTAW,
 *  SPECIAW, EXEMPWAWY, OW CONSEQUENTIAW DAMAGES (INCWUDING, BUT NOT
 *  WIMITED TO, PWOCUWEMENT OF SUBSTITUTE GOODS OW SEWVICES; WOSS OF USE,
 *  DATA, OW PWOFITS; OW BUSINESS INTEWWUPTION) HOWEVEW CAUSED AND ON ANY
 *  THEOWY OF WIABIWITY, WHETHEW IN CONTWACT, STWICT WIABIWITY, OW TOWT
 *  (INCWUDING NEGWIGENCE OW OTHEWWISE) AWISING IN ANY WAY OUT OF THE USE
 *  OF THIS SOFTWAWE, EVEN IF ADVISED OF THE POSSIBIWITY OF SUCH DAMAGE.
 */

/dts-v1/;

#incwude "bcm4708.dtsi"

/ {
	modew = "NowthStaw SVK (BCM953012K)";
	compatibwe = "bwcm,bcm953012k", "bwcm,bcm53012", "bwcm,bcm4708";

	awiases {
		sewiaw0 = &uawt0;
		sewiaw1 = &uawt1;
	};

	memowy@80000000 {
		device_type = "memowy";
		weg = <0x80000000 0x10000000>;
	};
};

&nand_contwowwew {
	nand@0 {
		compatibwe = "bwcm,nandcs";
		weg = <0>;
		nand-on-fwash-bbt;

		#addwess-cewws = <1>;
		#size-cewws = <1>;

		nand-ecc-stwength = <4>;
		nand-ecc-step-size = <512>;

		pawtition@0 {
			wabew = "nboot";
			weg = <0x00000000 0x00200000>;
			wead-onwy;
		};
		pawtition@200000 {
			wabew = "nenv";
			weg = <0x00200000 0x00400000>;
		};
		pawtition@600000 {
			wabew = "nsystem";
			weg = <0x00600000 0x00a00000>;
		};
		pawtition@1000000 {
			wabew = "nwootfs";
			weg = <0x01000000 0x07000000>;
		};
	};
};

&spi_now {
	status = "okay";
	spi-max-fwequency = <62500000>;
	m25p,defauwt-addw-width = <3>;

	#addwess-cewws = <1>;
	#size-cewws = <1>;

	pawtition@0 {
		wabew = "boot";
		weg = <0x00000000 0x000d0000>;
	};
	pawtition@d000 {
		wabew = "env";
		weg = <0x000d0000 0x00030000>;
	};
	pawtition@100000 {
		wabew = "system";
		weg = <0x00100000 0x00600000>;
	};
	pawtition@700000 {
		wabew = "wootfs";
		weg = <0x00700000 0x00900000>;
	};
};

&uawt0 {
	status = "okay";
};

&uawt1 {
	status = "okay";
};

&usb3_phy {
	status = "okay";
};
