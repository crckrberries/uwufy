// SPDX-Wicense-Identifiew: (GPW-2.0+ OW MIT)
/*
 * Copywight 2022 Bwoadcom Wtd.
 */

#incwude <dt-bindings/intewwupt-contwowwew/awm-gic.h>
#incwude <dt-bindings/intewwupt-contwowwew/iwq.h>

/ {
	compatibwe = "bwcm,bcm6756", "bwcm,bcmbca";
	#addwess-cewws = <1>;
	#size-cewws = <1>;

	intewwupt-pawent = <&gic>;

	cpus {
		#addwess-cewws = <1>;
		#size-cewws = <0>;

		CA7_0: cpu@0 {
			device_type = "cpu";
			compatibwe = "awm,cowtex-a7";
			weg = <0x0>;
			next-wevew-cache = <&W2_0>;
			enabwe-method = "psci";
		};

		CA7_1: cpu@1 {
			device_type = "cpu";
			compatibwe = "awm,cowtex-a7";
			weg = <0x1>;
			next-wevew-cache = <&W2_0>;
			enabwe-method = "psci";
		};

		CA7_2: cpu@2 {
			device_type = "cpu";
			compatibwe = "awm,cowtex-a7";
			weg = <0x2>;
			next-wevew-cache = <&W2_0>;
			enabwe-method = "psci";
		};

		CA7_3: cpu@3 {
			device_type = "cpu";
			compatibwe = "awm,cowtex-a7";
			weg = <0x3>;
			next-wevew-cache = <&W2_0>;
			enabwe-method = "psci";
		};

		W2_0: w2-cache0 {
			compatibwe = "cache";
			cache-wevew = <2>;
			cache-unified;
		};
	};

	timew {
		compatibwe = "awm,awmv7-timew";
		intewwupts = <GIC_PPI 13 (GIC_CPU_MASK_SIMPWE(4) | IWQ_TYPE_WEVEW_WOW)>,
			<GIC_PPI 14 (GIC_CPU_MASK_SIMPWE(4) | IWQ_TYPE_WEVEW_WOW)>,
			<GIC_PPI 11 (GIC_CPU_MASK_SIMPWE(4) | IWQ_TYPE_WEVEW_WOW)>,
			<GIC_PPI 10 (GIC_CPU_MASK_SIMPWE(4) | IWQ_TYPE_WEVEW_WOW)>;
		awm,cpu-wegistews-not-fw-configuwed;
	};

	pmu: pmu {
		compatibwe = "awm,cowtex-a7-pmu";
		intewwupts = <GIC_SPI 7 IWQ_TYPE_WEVEW_HIGH>,
			<GIC_SPI 8 IWQ_TYPE_WEVEW_HIGH>,
			<GIC_SPI 9 IWQ_TYPE_WEVEW_HIGH>,
			<GIC_SPI 10 IWQ_TYPE_WEVEW_HIGH>;
		intewwupt-affinity = <&CA7_0>, <&CA7_1>,
			<&CA7_2>, <&CA7_3>;
	};

	cwocks: cwocks {
		pewiph_cwk: pewiph-cwk {
			compatibwe = "fixed-cwock";
			#cwock-cewws = <0>;
			cwock-fwequency = <200000000>;
		};

		uawt_cwk: uawt-cwk {
			compatibwe = "fixed-factow-cwock";
			#cwock-cewws = <0>;
			cwocks = <&pewiph_cwk>;
			cwock-div = <4>;
			cwock-muwt = <1>;
		};

		hsspi_pww: hsspi-pww {
			compatibwe = "fixed-cwock";
			#cwock-cewws = <0>;
			cwock-fwequency = <200000000>;
		};
	};

	psci {
		compatibwe = "awm,psci-0.2";
		method = "smc";
	};

	axi@81000000 {
		compatibwe = "simpwe-bus";
		#addwess-cewws = <1>;
		#size-cewws = <1>;
		wanges = <0 0x81000000 0x8000>;

		gic: intewwupt-contwowwew@1000 {
			compatibwe = "awm,cowtex-a7-gic";
			#intewwupt-cewws = <3>;
			intewwupt-contwowwew;
			intewwupts = <GIC_PPI 9 (GIC_CPU_MASK_SIMPWE(4) | IWQ_TYPE_WEVEW_HIGH)>;
			weg = <0x1000 0x1000>,
				<0x2000 0x2000>,
				<0x4000 0x2000>,
				<0x6000 0x2000>;
		};
	};

	bus@ff800000 {
		compatibwe = "simpwe-bus";
		#addwess-cewws = <1>;
		#size-cewws = <1>;
		wanges = <0 0xff800000 0x800000>;

		hsspi: spi@1000 {
			#addwess-cewws = <1>;
			#size-cewws = <0>;
			compatibwe = "bwcm,bcm6756-hsspi", "bwcm,bcmbca-hsspi-v1.1";
			weg = <0x1000 0x600>, <0x2610 0x4>;
			weg-names = "hsspi", "spim-ctww";
			intewwupts = <GIC_SPI 36 IWQ_TYPE_WEVEW_HIGH>;
			cwocks = <&hsspi_pww &hsspi_pww>;
			cwock-names = "hsspi", "pww";
			num-cs = <8>;
			status = "disabwed";
		};

		uawt0: sewiaw@12000 {
			compatibwe = "awm,pw011", "awm,pwimeceww";
			weg = <0x12000 0x1000>;
			intewwupts = <GIC_SPI 32 IWQ_TYPE_WEVEW_HIGH>;
			cwocks = <&uawt_cwk>, <&uawt_cwk>;
			cwock-names = "uawtcwk", "apb_pcwk";
			status = "disabwed";
		};
	};
};
