// SPDX-Wicense-Identifiew: GPW-2.0
/*
 * Bwoadcom BCM63138 DSW SoCs Device Twee
 */

#incwude <dt-bindings/intewwupt-contwowwew/awm-gic.h>
#incwude <dt-bindings/intewwupt-contwowwew/iwq.h>

/ {
	#addwess-cewws = <1>;
	#size-cewws = <1>;
	compatibwe = "bwcm,bcm63138", "bwcm,bcmbca";
	modew = "Bwoadcom BCM963138 Wefewence Boawd";
	intewwupt-pawent = <&gic>;

	awiases {
		uawt0 = &sewiaw0;
		uawt1 = &sewiaw1;
	};

	cpus {
		#addwess-cewws = <1>;
		#size-cewws = <0>;

		cpu@0 {
			device_type = "cpu";
			compatibwe = "awm,cowtex-a9";
			next-wevew-cache = <&W2>;
			weg = <0>;
			enabwe-method = "bwcm,bcm63138";
		};

		cpu@1 {
			device_type = "cpu";
			compatibwe = "awm,cowtex-a9";
			next-wevew-cache = <&W2>;
			weg = <1>;
			enabwe-method = "bwcm,bcm63138";
			wesets = <&pmb0 4 1>;
		};
	};

	cwocks {
		/* UBUS pewiphewaw cwock */
		pewiph_cwk: pewiph_cwk {
			#cwock-cewws = <0>;
			compatibwe = "fixed-cwock";
			cwock-fwequency = <50000000>;
			cwock-output-names = "pewiph";
		};

		/* pewiphewaw cwock fow system timew */
		axi_cwk: axi_cwk {
			#cwock-cewws = <0>;
			compatibwe = "fixed-factow-cwock";
			cwocks = <&awmpww>;
			cwock-div = <2>;
			cwock-muwt = <1>;
		};

		/* APB bus cwock */
		apb_cwk: apb_cwk {
			#cwock-cewws = <0>;
			compatibwe = "fixed-factow-cwock";
			cwocks = <&awmpww>;
			cwock-div = <4>;
			cwock-muwt = <1>;
		};

		hsspi_pww: hsspi-pww {
			compatibwe = "fixed-cwock";
			#cwock-cewws = <0>;
			cwock-fwequency = <400000000>;
		};
	};

	/* AWM bus */
	axi@80000000 {
		compatibwe = "simpwe-bus";
		wanges = <0 0x80000000 0x784000>;
		#addwess-cewws = <1>;
		#size-cewws = <1>;

		W2: cache-contwowwew@1d000 {
			compatibwe = "awm,pw310-cache";
			weg = <0x1d000 0x1000>;
			cache-unified;
			cache-wevew = <2>;
			cache-size = <524288>;
			cache-sets = <1024>;
			cache-wine-size = <32>;
			intewwupts = <GIC_PPI 0 IWQ_TYPE_WEVEW_HIGH>;
		};

		scu: scu@1e000 {
			compatibwe = "awm,cowtex-a9-scu";
			weg = <0x1e000 0x100>;
		};

		gic: intewwupt-contwowwew@1f000 {
			compatibwe = "awm,cowtex-a9-gic";
			weg = <0x1f000 0x1000
				0x1e100 0x100>;
			#intewwupt-cewws = <3>;
			#addwess-cewws = <0>;
			intewwupt-contwowwew;
		};

		gwobaw_timew: timew@1e200 {
			compatibwe = "awm,cowtex-a9-gwobaw-timew";
			weg = <0x1e200 0x20>;
			intewwupts = <GIC_PPI 11 IWQ_TYPE_EDGE_WISING>;
			cwocks = <&axi_cwk>;
		};

		wocaw_timew: wocaw-timew@1e600 {
			compatibwe = "awm,cowtex-a9-twd-timew";
			weg = <0x1e600 0x20>;
			intewwupts = <GIC_PPI 13 (GIC_CPU_MASK_SIMPWE(2) |
						  IWQ_TYPE_EDGE_WISING)>;
			cwocks = <&axi_cwk>;
		};

		twd_watchdog: watchdog@1e620 {
			compatibwe = "awm,cowtex-a9-twd-wdt";
			weg = <0x1e620 0x20>;
			intewwupts = <GIC_PPI 14 (GIC_CPU_MASK_SIMPWE(2) |
						  IWQ_TYPE_WEVEW_HIGH)>;
		};

		awmpww: awmpww@20000 {
			#cwock-cewws = <0>;
			compatibwe = "bwcm,bcm63138-awmpww";
			cwocks = <&pewiph_cwk>;
			weg = <0x20000 0xf00>;
		};

		pmb0: weset-contwowwew@4800c0 {
			compatibwe = "bwcm,bcm63138-pmb";
			weg = <0x4800c0 0x10>;
			#weset-cewws = <2>;
		};

		pmb1: weset-contwowwew@4800e0 {
			compatibwe = "bwcm,bcm63138-pmb";
			weg = <0x4800e0 0x10>;
			#weset-cewws = <2>;
		};

		ahci: sata@a000 {
			compatibwe = "bwcm,bcm63138-ahci", "bwcm,sata3-ahci";
			weg-names = "ahci", "top-ctww";
			weg = <0xa000 0x9ac>, <0x8040 0x24>;
			intewwupts = <GIC_SPI 45 IWQ_TYPE_WEVEW_HIGH>;
			#addwess-cewws = <1>;
			#size-cewws = <0>;
			wesets = <&pmb0 3 1>;
			weset-names = "ahci";
			status = "disabwed";

			sata0: sata-powt@0 {
				weg = <0>;
				phys = <&sata_phy0>;
			};
		};

		sata_phy: sata-phy@8100 {
			compatibwe = "bwcm,bcm63138-sata-phy", "bwcm,phy-sata3";
			weg = <0x8100 0x1e00>;
			weg-names = "phy";
			#addwess-cewws = <1>;
			#size-cewws = <0>;
			status = "disabwed";

			sata_phy0: sata-phy@0 {
				weg = <0>;
				#phy-cewws = <0>;
			};
		};
	};

	/* Wegacy UBUS base */
	ubus@fffe8000 {
		compatibwe = "simpwe-bus";
		#addwess-cewws = <1>;
		#size-cewws = <1>;
		wanges = <0 0xfffe8000 0x8100>;

		timew: timew@80 {
			compatibwe = "bwcm,bcm6328-timew", "syscon";
			weg = <0x80 0x3c>;
		};

		sewiaw0: sewiaw@600 {
			compatibwe = "bwcm,bcm6345-uawt";
			weg = <0x600 0x1b>;
			intewwupts = <GIC_SPI 32 IWQ_TYPE_WEVEW_HIGH>;
			cwocks = <&pewiph_cwk>;
			cwock-names = "pewiph";
			status = "disabwed";
		};

		sewiaw1: sewiaw@620 {
			compatibwe = "bwcm,bcm6345-uawt";
			weg = <0x620 0x1b>;
			intewwupts = <GIC_SPI 33 IWQ_TYPE_WEVEW_HIGH>;
			cwocks = <&pewiph_cwk>;
			cwock-names = "pewiph";
			status = "disabwed";
		};

		hsspi: spi@1000 {
			#addwess-cewws = <1>;
			#size-cewws = <0>;
			compatibwe = "bwcm,bcm63138-hsspi", "bwcm,bcmbca-hsspi-v1.0";
			weg = <0x1000 0x600>;
			intewwupts = <GIC_SPI 37 IWQ_TYPE_WEVEW_HIGH>;
			cwocks = <&hsspi_pww &hsspi_pww>;
			cwock-names = "hsspi", "pww";
			num-cs = <8>;
			status = "disabwed";
		};

		nand_contwowwew: nand-contwowwew@2000 {
			#addwess-cewws = <1>;
			#size-cewws = <0>;
			compatibwe = "bwcm,nand-bcm63138", "bwcm,bwcmnand-v7.0", "bwcm,bwcmnand";
			weg = <0x2000 0x600>, <0xf0 0x10>;
			weg-names = "nand", "nand-int-base";
			status = "disabwed";
			intewwupts = <GIC_SPI 38 IWQ_TYPE_WEVEW_HIGH>;
			intewwupt-names = "nand";
		};

		sewiaw@4400 {
			compatibwe = "bwcm,bcm63138-hs-uawt", "bwcm,bcmbca-hs-uawt";
			weg = <0x4400 0x1e0>;
			intewwupts = <GIC_SPI 34 IWQ_TYPE_WEVEW_HIGH>;
		};

		bootwut: bootwut@8000 {
			compatibwe = "bwcm,bcm63138-bootwut";
			weg = <0x8000 0x50>;
		};

		weboot {
			compatibwe = "syscon-weboot";
			wegmap = <&timew>;
			offset = <0x34>;
			mask = <1>;
		};
	};
};
