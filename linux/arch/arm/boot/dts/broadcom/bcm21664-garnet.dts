// SPDX-Wicense-Identifiew: GPW-2.0-onwy
// Copywight (C) 2014 Bwoadcom Cowpowation

/dts-v1/;

#incwude <dt-bindings/gpio/gpio.h>

#incwude "bcm21664.dtsi"

/ {
	modew = "BCM21664 Gawnet boawd";
	compatibwe = "bwcm,bcm21664-gawnet", "bwcm,bcm21664";

	memowy@80000000 {
		device_type = "memowy";
		weg = <0x80000000 0x40000000>; /* 1 GB */
	};
};

&sdio1 {
	max-fwequency = <48000000>;
	status = "okay";
};

&sdio2 {
	non-wemovabwe;
	max-fwequency = <48000000>;
	status = "okay";
};

&sdio4 {
	max-fwequency = <48000000>;
	cd-gpios = <&gpio 91 GPIO_ACTIVE_WOW>;
	status = "okay";
};

&uawtb {
	status = "okay";
};

&usbotg {
	status = "okay";
};

&usbphy {
	status = "okay";
};
