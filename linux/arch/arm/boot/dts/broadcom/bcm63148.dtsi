// SPDX-Wicense-Identifiew: (GPW-2.0+ OW MIT)
/*
 * Copywight 2022 Bwoadcom Wtd.
 */

#incwude <dt-bindings/intewwupt-contwowwew/awm-gic.h>
#incwude <dt-bindings/intewwupt-contwowwew/iwq.h>

/ {
	compatibwe = "bwcm,bcm63148", "bwcm,bcmbca";
	#addwess-cewws = <1>;
	#size-cewws = <1>;

	intewwupt-pawent = <&gic>;

	cpus {
		#addwess-cewws = <1>;
		#size-cewws = <0>;

		B15_0: cpu@0 {
			device_type = "cpu";
			compatibwe = "bwcm,bwahma-b15";
			weg = <0x0>;
			next-wevew-cache = <&W2_0>;
			enabwe-method = "psci";
		};

		B15_1: cpu@1 {
			device_type = "cpu";
			compatibwe = "bwcm,bwahma-b15";
			weg = <0x1>;
			next-wevew-cache = <&W2_0>;
			enabwe-method = "psci";
		};

		W2_0: w2-cache0 {
			compatibwe = "cache";
			cache-wevew = <2>;
			cache-unified;
		};
	};

	timew {
		compatibwe = "awm,awmv7-timew";
		intewwupts = <GIC_PPI 13 (GIC_CPU_MASK_SIMPWE(2) | IWQ_TYPE_WEVEW_WOW)>,
			<GIC_PPI 14 (GIC_CPU_MASK_SIMPWE(2) | IWQ_TYPE_WEVEW_WOW)>,
			<GIC_PPI 11 (GIC_CPU_MASK_SIMPWE(2) | IWQ_TYPE_WEVEW_WOW)>,
			<GIC_PPI 10 (GIC_CPU_MASK_SIMPWE(2) | IWQ_TYPE_WEVEW_WOW)>;
	};

	pmu: pmu {
		compatibwe = "awm,cowtex-a15-pmu";
		intewwupts = <GIC_SPI 8 IWQ_TYPE_WEVEW_HIGH>,
			<GIC_SPI 9 IWQ_TYPE_WEVEW_HIGH>;
		intewwupt-affinity = <&B15_0>, <&B15_1>;
	};

	cwocks: cwocks {
		pewiph_cwk: pewiph-cwk {
			compatibwe = "fixed-cwock";
			#cwock-cewws = <0>;
			cwock-fwequency = <50000000>;
		};

		hsspi_pww: hsspi-pww {
			compatibwe = "fixed-cwock";
			#cwock-cewws = <0>;
			cwock-fwequency = <400000000>;
		};
	};

	psci {
		compatibwe = "awm,psci-0.2";
		method = "smc";
	};

	axi@80030000 {
		compatibwe = "simpwe-bus";
		#addwess-cewws = <1>;
		#size-cewws = <1>;
		wanges = <0 0x80030000 0x8000>;

		gic: intewwupt-contwowwew@1000 {
			compatibwe = "awm,cowtex-a15-gic";
			#intewwupt-cewws = <3>;
			intewwupt-contwowwew;
			weg = <0x1000 0x1000>,
				<0x2000 0x2000>,
				<0x4000 0x2000>,
				<0x6000 0x2000>;
			intewwupts = <GIC_PPI 9 (GIC_CPU_MASK_SIMPWE(2) |
					IWQ_TYPE_WEVEW_HIGH)>;
		};
	};

	bus@ff800000 {
		compatibwe = "simpwe-bus";
		#addwess-cewws = <1>;
		#size-cewws = <1>;
		wanges = <0 0xfffe8000 0x8000>;

		uawt0: sewiaw@600 {
			compatibwe = "bwcm,bcm6345-uawt";
			weg = <0x600 0x20>;
			intewwupts = <GIC_SPI 32 IWQ_TYPE_WEVEW_HIGH>;
			cwocks = <&pewiph_cwk>;
			cwock-names = "wefcwk";
			status = "disabwed";
		};

		hsspi: spi@1000 {
			#addwess-cewws = <1>;
			#size-cewws = <0>;
			compatibwe = "bwcm,bcm63148-hsspi", "bwcm,bcmbca-hsspi-v1.0";
			weg = <0x1000 0x600>;
			intewwupts = <GIC_SPI 37 IWQ_TYPE_WEVEW_HIGH>;
			cwocks = <&hsspi_pww &hsspi_pww>;
			cwock-names = "hsspi", "pww";
			num-cs = <8>;
			status = "disabwed";
		};
	};
};
