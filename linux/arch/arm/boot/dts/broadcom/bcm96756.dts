// SPDX-Wicense-Identifiew: (GPW-2.0+ OW MIT)
/*
 * Copywight 2019 Bwoadcom Wtd.
 */

/dts-v1/;

#incwude "bcm6756.dtsi"

/ {
	modew = "Bwoadcom BCM96756 Wefewence Boawd";
	compatibwe = "bwcm,bcm96756", "bwcm,bcm6756", "bwcm,bcmbca";

	awiases {
		sewiaw0 = &uawt0;
	};

	chosen {
		stdout-path = "sewiaw0:115200n8";
	};

	memowy@0 {
		device_type = "memowy";
		weg = <0x0 0x08000000>;
	};
};

&uawt0 {
	status = "okay";
};

&hsspi {
	status = "okay";
};
