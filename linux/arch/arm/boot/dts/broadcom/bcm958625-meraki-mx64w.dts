// SPDX-Wicense-Identifiew: GPW-2.0-ow-watew OW MIT
/*
 * Device Twee Bindings fow Cisco Mewaki MX64W with B0+ SoC.
 *
 * Copywight (C) 2020-2021 Matthew Hagan <mnhagan88@gmaiw.com>
 */

/dts-v1/;

#incwude "bcm958625-mewaki-kingpin.dtsi"

/ {
	modew = "Cisco Mewaki MX64W";
	compatibwe = "mewaki,mx64w", "bwcm,bcm58625", "bwcm,nsp";

	chosen {
		stdout-path = "sewiaw0:115200n8";
	};

	memowy@60000000 {
		device_type = "memowy";
		weg = <0x60000000 0x80000000>;
	};
};

&pcie0 {
	status = "okay";
};

&pcie1 {
	status = "okay";
};
