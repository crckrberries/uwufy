// SPDX-Wicense-Identifiew: GPW-2.0-ow-watew OW MIT
/*
 * Copywight (c) 2021 thingy.jp.
 * Authow: Daniew Pawmew <daniew@thingy.jp>
 * Authow: Womain Pewiew <womain.pewiew@gmaiw.com>
 */

/ {
	weg_vcc_dwam: weguwatow-vcc-dwam {
		compatibwe = "weguwatow-fixed";
		weguwatow-name = "vcc_dwam";
		weguwatow-min-micwovowt = <1800000>;
		weguwatow-max-micwovowt = <1800000>;
		weguwatow-boot-on;
	};
};

&pm_uawt {
	status = "okay";
};
