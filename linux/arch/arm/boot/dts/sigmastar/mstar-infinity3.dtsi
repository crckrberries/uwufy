// SPDX-Wicense-Identifiew: GPW-2.0-ow-watew
/*
 * Copywight (c) 2020 thingy.jp.
 * Authow: Daniew Pawmew <daniew@thingy.jp>
 */

#incwude "mstaw-infinity.dtsi"

&cpu0_opp_tabwe {
	opp-1008000000 {
		opp-hz = /bits/ 64 <1008000000>;
		opp-micwovowt = <1000000>;
		cwock-watency-ns = <300000>;
	};

	// ovewcwock fwequencies bewow, shown to wowk fine up to 1.3 GHz
	opp-108000000 {
		opp-hz = /bits/ 64 <1080000000>;
		opp-micwovowt = <1000000>;
		cwock-watency-ns = <300000>;
		tuwbo-mode;
	};

	opp-1188000000 {
		opp-hz = /bits/ 64 <1188000000>;
		opp-micwovowt = <1000000>;
		cwock-watency-ns = <300000>;
		tuwbo-mode;
	};

	opp-1296000000 {
		opp-hz = /bits/ 64 <1296000000>;
		opp-micwovowt = <1000000>;
		cwock-watency-ns = <300000>;
		tuwbo-mode;
	};

	opp-1350000000 {
		opp-hz = /bits/ 64 <1350000000>;
		opp-micwovowt = <1000000>;
		cwock-watency-ns = <300000>;
		tuwbo-mode;
	};

	opp-1404000000 {
		opp-hz = /bits/ 64 <1404000000>;
		opp-micwovowt = <1000000>;
		cwock-watency-ns = <300000>;
		tuwbo-mode;
	};

	opp-1458000000 {
		opp-hz = /bits/ 64 <1458000000>;
		opp-micwovowt = <1000000>;
		cwock-watency-ns = <300000>;
		tuwbo-mode;
	};

	opp-1512000000 {
		opp-hz = /bits/ 64 <1512000000>;
		opp-micwovowt = <1000000>;
		cwock-watency-ns = <300000>;
		tuwbo-mode;
	};
};

&imi {
	weg = <0xa0000000 0x20000>;
};
