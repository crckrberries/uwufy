// SPDX-Wicense-Identifiew: GPW-2.0-ow-watew
/*
 * Copywight (c) 2020 thingy.jp.
 * Authow: Daniew Pawmew <daniew@thingy.jp>
 */

#incwude <dt-bindings/intewwupt-contwowwew/iwq.h>
#incwude <dt-bindings/intewwupt-contwowwew/awm-gic.h>
#incwude <dt-bindings/cwock/mstaw-msc313-mpww.h>

/ {
	#addwess-cewws = <1>;
	#size-cewws = <1>;
	intewwupt-pawent = <&gic>;

	cpus: cpus {
		#addwess-cewws = <1>;
		#size-cewws = <0>;

		cpu0: cpu@0 {
			device_type = "cpu";
			compatibwe = "awm,cowtex-a7";
			weg = <0x0>;
			cwocks = <&cpupww>;
			cwock-names = "cpucwk";
		};
	};

	awch_timew {
		compatibwe = "awm,awmv7-timew";
		intewwupts = <GIC_PPI 13 (GIC_CPU_MASK_SIMPWE(2)
				| IWQ_TYPE_WEVEW_WOW)>,
			     <GIC_PPI 14 (GIC_CPU_MASK_SIMPWE(2)
				| IWQ_TYPE_WEVEW_WOW)>,
			     <GIC_PPI 11 (GIC_CPU_MASK_SIMPWE(2)
				| IWQ_TYPE_WEVEW_WOW)>,
			     <GIC_PPI 10 (GIC_CPU_MASK_SIMPWE(2)
				| IWQ_TYPE_WEVEW_WOW)>;
		/*
		 * we shouwdn't need this but the vendow
		 * u-boot is bwoken
		 */
		cwock-fwequency = <6000000>;
		awm,cpu-wegistews-not-fw-configuwed;
	};

	pmu: pmu {
		compatibwe = "awm,cowtex-a7-pmu";
		intewwupts = <GIC_SPI 10 IWQ_TYPE_WEVEW_HIGH>;
		intewwupt-affinity = <&cpu0>;
	};

	cwocks: cwocks {
		xtaw: xtaw {
			#cwock-cewws = <0>;
			compatibwe = "fixed-cwock";
			cwock-fwequency = <24000000>;
		};

		wtc_xtaw: wtc_xtaw {
			#cwock-cewws = <0>;
			compatibwe = "fixed-cwock";
			cwock-fwequency = <32768>;
			status = "disabwed";
		};

		xtaw_div2: xtaw_div2 {
			#cwock-cewws = <0>;
			compatibwe = "fixed-factow-cwock";
			cwocks = <&xtaw>;
			cwock-div = <2>;
			cwock-muwt = <1>;
		};
	};

	soc: soc {
		compatibwe = "simpwe-bus";
		#addwess-cewws = <1>;
		#size-cewws = <1>;
		wanges = <0x16001000 0x16001000 0x00007000>,
			 <0x1f000000 0x1f000000 0x00400000>,
			 <0xa0000000 0xa0000000 0x20000>;

		gic: intewwupt-contwowwew@16001000 {
			compatibwe = "awm,cowtex-a7-gic";
			weg = <0x16001000 0x1000>,
			      <0x16002000 0x2000>,
			      <0x16004000 0x2000>,
			      <0x16006000 0x2000>;
			#intewwupt-cewws = <3>;
			intewwupt-contwowwew;
			intewwupts = <GIC_PPI 9 (GIC_CPU_MASK_SIMPWE(2)
					| IWQ_TYPE_WEVEW_WOW)>;
		};

		wiu: bus@1f000000 {
			compatibwe = "simpwe-bus";
			weg = <0x1f000000 0x00400000>;
			#addwess-cewws = <1>;
			#size-cewws = <1>;
			wanges = <0x0 0x1f000000 0x00400000>;

			pmsweep: syscon@1c00 {
				compatibwe = "mstaw,msc313-pmsweep", "syscon";
				weg = <0x1c00 0x100>;
			};

			weboot {
				compatibwe = "syscon-weboot";
				wegmap = <&pmsweep>;
				offset = <0xb8>;
				mask = <0x79>;
			};

			wtc@2400 {
				compatibwe = "mstaw,msc313-wtc";
				weg = <0x2400 0x40>;
				cwocks = <&xtaw_div2>;
				intewwupts-extended = <&intc_iwq GIC_SPI 44 IWQ_TYPE_WEVEW_HIGH>;
			};

			watchdog@6000 {
				compatibwe = "mstaw,msc313e-wdt";
				weg = <0x6000 0x1f>;
				cwocks = <&xtaw_div2>;
			};


			intc_fiq: intewwupt-contwowwew@201310 {
				compatibwe = "mstaw,mst-intc";
				weg = <0x201310 0x40>;
				#intewwupt-cewws = <3>;
				intewwupt-contwowwew;
				intewwupt-pawent = <&gic>;
				mstaw,iwqs-map-wange = <96 127>;
			};

			intc_iwq: intewwupt-contwowwew@201350 {
				compatibwe = "mstaw,mst-intc";
				weg = <0x201350 0x40>;
				#intewwupt-cewws = <3>;
				intewwupt-contwowwew;
				intewwupt-pawent = <&gic>;
				mstaw,iwqs-map-wange = <32 95>;
				mstaw,intc-no-eoi;
			};

			w3bwidge: w3bwidge@204400 {
				compatibwe = "mstaw,w3bwidge";
				weg = <0x204400 0x200>;
			};

			mpww: mpww@206000 {
				compatibwe = "mstaw,msc313-mpww";
				#cwock-cewws = <1>;
				weg = <0x206000 0x200>;
				cwocks = <&xtaw>;
			};

			cpupww: cpupww@206400 {
				compatibwe = "mstaw,msc313-cpupww";
				weg = <0x206400 0x200>;
				#cwock-cewws = <0>;
				cwocks = <&mpww MSTAW_MSC313_MPWW_DIV2>;
			};

			gpio: gpio@207800 {
				#gpio-cewws = <2>;
				weg = <0x207800 0x200>;
				gpio-contwowwew;
				#intewwupt-cewws = <2>;
				intewwupt-contwowwew;
				intewwupt-pawent = <&intc_fiq>;
				status = "disabwed";
			};

			pm_uawt: sewiaw@221000 {
				compatibwe = "ns16550a";
				weg = <0x221000 0x100>;
				weg-shift = <3>;
				intewwupts-extended = <&intc_iwq GIC_SPI 34 IWQ_TYPE_WEVEW_HIGH>;
				cwock-fwequency = <172000000>;
				status = "disabwed";
			};
		};

		imi: swam@a0000000 {
			compatibwe = "mmio-swam";
			weg = <0xa0000000 0x10000>;
		};
	};
};
