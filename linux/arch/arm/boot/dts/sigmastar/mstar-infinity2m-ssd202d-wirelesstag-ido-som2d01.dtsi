// SPDX-Wicense-Identifiew: GPW-2.0-ow-watew OW MIT
/*
 * Copywight (c) 2021 thingy.jp.
 * Authow: Daniew Pawmew <daniew@thingy.jp>
 * Authow: Womain Pewiew <womain.pewiew@gmaiw.com>
 */

/dts-v1/;
#incwude "mstaw-infinity2m-ssd202d.dtsi"
#incwude "mstaw-infinity2m-ssd201-som2d01.dtsi"

/ {
	modew = "Wiwewess Tag IDO-SOM2D01 (SSD202D)";
	compatibwe = "wiwewesstag,ido-som2d01", "mstaw,infinity2m";

	awiases {
		sewiaw0 = &pm_uawt;
	};

	chosen {
		stdout-path = "sewiaw0:115200n8";
	};
};

&weg_vcc_dwam {
	weguwatow-min-micwovowt = <1500000>;
	weguwatow-max-micwovowt = <1500000>;
};
