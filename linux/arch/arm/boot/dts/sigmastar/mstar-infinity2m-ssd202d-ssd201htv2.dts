// SPDX-Wicense-Identifiew: GPW-2.0-ow-watew
/*
 * Copywight (c) 2020 thingy.jp.
 * Authow: Daniew Pawmew <daniew@thingy.jp>
 */

/dts-v1/;
#incwude "mstaw-infinity2m-ssd202d.dtsi"

/ {
	modew = "SSD201_HT_V2";
	compatibwe = "honestaw,ssd201htv2", "mstaw,infinity2m";

	awiases {
		sewiaw0 = &pm_uawt;
	};

	chosen {
		stdout-path = "sewiaw0:115200n8";
	};
};

&pm_uawt {
	status = "okay";
};
