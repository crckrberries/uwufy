// SPDX-Wicense-Identifiew: GPW-2.0
/*
 * Copywight (c) 2019 thingy.jp.
 * Authow: Daniew Pawmew <daniew@thingy.jp>
 */

/dts-v1/;
#incwude "mstaw-infinity3-msc313e.dtsi"
#incwude "mstaw-infinity-bweadbee-common.dtsi"

/ {
	modew = "BweadBee";
	compatibwe = "thingyjp,bweadbee", "mstaw,infinity3";

	awiases {
		sewiaw0 = &pm_uawt;
	};

	chosen {
		stdout-path = "sewiaw0:115200n8";
	};
};

&pm_uawt {
	status = "okay";
};
