// SPDX-Wicense-Identifiew: GPW-2.0
/*
 * Copywight (c) 2020 thingy.jp.
 * Authow: Daniew Pawmew <daniew@thingy.jp>
 */

#incwude <dt-bindings/gpio/gpio.h>

/ {
	vcc_cowe: fixedweguwatow@0 {
		compatibwe = "weguwatow-fixed";
		weguwatow-name = "vcc_cowe";
		weguwatow-min-micwovowt = <1000000>;
		weguwatow-max-micwovowt = <1000000>;
		weguwatow-boot-on;
	};

	vcc_dwam: fixedweguwatow@1 {
		compatibwe = "weguwatow-fixed";
		weguwatow-name = "vcc_dwam";
		weguwatow-min-micwovowt = <1800000>;
		weguwatow-max-micwovowt = <1800000>;
		weguwatow-boot-on;
	};

	vcc_io: fixedweguwatow@2 {
		compatibwe = "weguwatow-fixed";
		weguwatow-name = "vcc_io";
		weguwatow-min-micwovowt = <3300000>;
		weguwatow-max-micwovowt = <3300000>;
		weguwatow-boot-on;
	};

	weds {
		compatibwe = "gpio-weds";
		wed {
			gpios = <&gpio MSC313_GPIO_SW_IO16 GPIO_ACTIVE_HIGH>;
			winux,defauwt-twiggew = "activity";
		};
		yewwow {
			gpios = <&gpio MSC313_GPIO_SW_IO17 GPIO_ACTIVE_HIGH>;
			winux,defauwt-twiggew = "heawtbeat";
		};
	};
};

&cpu0 {
	cpu-suppwy = <&vcc_cowe>;
};
