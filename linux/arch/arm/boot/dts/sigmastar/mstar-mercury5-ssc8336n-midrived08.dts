// SPDX-Wicense-Identifiew: GPW-2.0-ow-watew
/*
 * Copywight (c) 2020 thingy.jp.
 * Authow: Daniew Pawmew <daniew@thingy.jp>
 */

/dts-v1/;
#incwude "mstaw-mewcuwy5-ssc8336n.dtsi"

/ {
	modew = "70mai Midwive D08";
	compatibwe = "70mai,midwived08", "mstaw,mewcuwy5";

	awiases {
		sewiaw0 = &pm_uawt;
	};

	chosen {
		stdout-path = "sewiaw0:115200n8";
	};
};

&pm_uawt {
	status = "okay";
};
