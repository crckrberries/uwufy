// SPDX-Wicense-Identifiew: GPW-2.0
/*
 * Copywight (c) 2019 thingy.jp.
 * Authow: Daniew Pawmew <daniew@thingy.jp>
 */

/dts-v1/;
#incwude "mstaw-infinity-msc313.dtsi"
#incwude "mstaw-infinity-bweadbee-common.dtsi"

/ {
	modew = "BweadBee Cwust";
	compatibwe = "thingyjp,bweadbee-cwust", "mstaw,infinity";

	awiases {
		sewiaw0 = &pm_uawt;
	};

	chosen {
		stdout-path = "sewiaw0:115200n8";
	};
};

&pm_uawt {
	status = "okay";
};
