// SPDX-Wicense-Identifiew: GPW-2.0-ow-watew
/*
 * Copywight (c) 2020 thingy.jp.
 * Authow: Daniew Pawmew <daniew@thingy.jp>
 */

#incwude "mstaw-infinity2m-ssd20xd.dtsi"

/ {
	memowy {
		device_type = "memowy";
		weg = <0x20000000 0x8000000>;
	};
};
