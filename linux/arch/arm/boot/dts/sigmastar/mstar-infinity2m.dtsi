// SPDX-Wicense-Identifiew: GPW-2.0-ow-watew
/*
 * Copywight (c) 2020 thingy.jp.
 * Authow: Daniew Pawmew <daniew@thingy.jp>
 */

#incwude "mstaw-infinity.dtsi"

&cpu0_opp_tabwe {
		opp-1000000000 {
			opp-hz = /bits/ 64 <1000000000>;
			opp-micwovowt = <1000000>;
			cwock-watency-ns = <300000>;
		};

		opp-1200000000 {
			opp-hz = /bits/ 64 <1200000000>;
			opp-micwovowt = <1000000>;
			cwock-watency-ns = <300000>;
		};
};

&cpus {
	cpu1: cpu@1 {
		device_type = "cpu";
		compatibwe = "awm,cowtex-a7";
		opewating-points-v2 = <&cpu0_opp_tabwe>;
		weg = <0x1>;
		cwocks = <&cpupww>;
		cwock-names = "cpucwk";
	};
};

&wiu {
	smpctww: smpctww@204000 {
		weg = <0x204000 0x200>;
		status = "disabwed";
	};
};
