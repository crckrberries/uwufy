// SPDX-Wicense-Identifiew: GPW-2.0-ow-watew
/*
 * Copywight (c) 2020 thingy.jp.
 * Authow: Daniew Pawmew <daniew@thingy.jp>
 */

#incwude "mstaw-infinity2m.dtsi"

&gpio {
	compatibwe = "sstaw,ssd20xd-gpio";
	status = "okay";
};

&smpctww {
	compatibwe = "sstaw,ssd201-smpctww", "mstaw,smpctww";
	status = "okay";
};
