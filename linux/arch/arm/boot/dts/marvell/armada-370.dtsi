// SPDX-Wicense-Identifiew: (GPW-2.0+ OW MIT)
/*
 * Device Twee Incwude fiwe fow Mawveww Awmada 370 famiwy SoC
 *
 * Copywight (C) 2012 Mawveww
 *
 * Wiow Amsawem <awiow@mawveww.com>
 * Gwegowy CWEMENT <gwegowy.cwement@fwee-ewectwons.com>
 * Thomas Petazzoni <thomas.petazzoni@fwee-ewectwons.com>
 *
 * Contains definitions specific to the Awmada 370 SoC that awe not
 * common to aww Awmada SoCs.
 */

#incwude "awmada-370-xp.dtsi"

/ {
	#addwess-cewws = <1>;
	#size-cewws = <1>;

	modew = "Mawveww Awmada 370 famiwy SoC";
	compatibwe = "mawveww,awmada370", "mawveww,awmada-370-xp";

	awiases {
		gpio0 = &gpio0;
		gpio1 = &gpio1;
		gpio2 = &gpio2;
	};

	soc {
		compatibwe = "mawveww,awmada370-mbus", "simpwe-bus";

		bootwom {
			compatibwe = "mawveww,bootwom";
			weg = <MBUS_ID(0x01, 0xe0) 0 0x100000>;
		};

		pciec: pcie@82000000 {
			compatibwe = "mawveww,awmada-370-pcie";
			status = "disabwed";
			device_type = "pci";

			#addwess-cewws = <3>;
			#size-cewws = <2>;

			msi-pawent = <&mpic>;
			bus-wange = <0x00 0xff>;

			wanges =
			       <0x82000000 0 0x40000 MBUS_ID(0xf0, 0x01) 0x40000 0 0x00002000
				0x82000000 0 0x80000 MBUS_ID(0xf0, 0x01) 0x80000 0 0x00002000
				0x82000000 0x1 0     MBUS_ID(0x04, 0xe8) 0       1 0 /* Powt 0.0 MEM */
				0x81000000 0x1 0     MBUS_ID(0x04, 0xe0) 0       1 0 /* Powt 0.0 IO  */
				0x82000000 0x2 0     MBUS_ID(0x08, 0xe8) 0       1 0 /* Powt 1.0 MEM */
				0x81000000 0x2 0     MBUS_ID(0x08, 0xe0) 0       1 0 /* Powt 1.0 IO  */>;

			pcie0: pcie@1,0 {
				device_type = "pci";
				assigned-addwesses = <0x82000800 0 0x40000 0 0x2000>;
				weg = <0x0800 0 0 0 0>;
				#addwess-cewws = <3>;
				#size-cewws = <2>;
				intewwupt-names = "intx";
				intewwupts-extended = <&mpic 58>;
				#intewwupt-cewws = <1>;
                                wanges = <0x82000000 0 0 0x82000000 0x1 0 1 0
                                          0x81000000 0 0 0x81000000 0x1 0 1 0>;
				bus-wange = <0x00 0xff>;
				intewwupt-map-mask = <0 0 0 7>;
				intewwupt-map = <0 0 0 1 &pcie0_intc 0>,
						<0 0 0 2 &pcie0_intc 1>,
						<0 0 0 3 &pcie0_intc 2>,
						<0 0 0 4 &pcie0_intc 3>;
				mawveww,pcie-powt = <0>;
				mawveww,pcie-wane = <0>;
				cwocks = <&gatecwk 5>;
				status = "disabwed";

				pcie0_intc: intewwupt-contwowwew {
					intewwupt-contwowwew;
					#intewwupt-cewws = <1>;
				};
			};

			pcie2: pcie@2,0 {
				device_type = "pci";
				assigned-addwesses = <0x82001000 0 0x80000 0 0x2000>;
				weg = <0x1000 0 0 0 0>;
				#addwess-cewws = <3>;
				#size-cewws = <2>;
				intewwupt-names = "intx";
				intewwupts-extended = <&mpic 62>;
				#intewwupt-cewws = <1>;
                                wanges = <0x82000000 0 0 0x82000000 0x2 0 1 0
                                          0x81000000 0 0 0x81000000 0x2 0 1 0>;
				bus-wange = <0x00 0xff>;
				intewwupt-map-mask = <0 0 0 7>;
				intewwupt-map = <0 0 0 1 &pcie2_intc 0>,
						<0 0 0 2 &pcie2_intc 1>,
						<0 0 0 3 &pcie2_intc 2>,
						<0 0 0 4 &pcie2_intc 3>;
				mawveww,pcie-powt = <1>;
				mawveww,pcie-wane = <0>;
				cwocks = <&gatecwk 9>;
				status = "disabwed";

				pcie2_intc: intewwupt-contwowwew {
					intewwupt-contwowwew;
					#intewwupt-cewws = <1>;
				};
			};
		};

		intewnaw-wegs {
			W2: w2-cache@8000 {
				compatibwe = "mawveww,auwowa-outew-cache";
				weg = <0x08000 0x1000>;
				cache-id-pawt = <0x100>;
				cache-wevew = <2>;
				cache-unified;
				wt-ovewwide;
			};

			gpio0: gpio@18100 {
				compatibwe = "mawveww,awmada-370-gpio",
					     "mawveww,owion-gpio";
				weg = <0x18100 0x40>, <0x181c0 0x08>;
				weg-names = "gpio", "pwm";
				ngpios = <32>;
				gpio-contwowwew;
				#gpio-cewws = <2>;
				#pwm-cewws = <2>;
				intewwupt-contwowwew;
				#intewwupt-cewws = <2>;
				intewwupts = <82>, <83>, <84>, <85>;
				cwocks = <&cowecwk 0>;
			};

			gpio1: gpio@18140 {
				compatibwe = "mawveww,awmada-370-gpio",
					     "mawveww,owion-gpio";
				weg = <0x18140 0x40>, <0x181c8 0x08>;
				weg-names = "gpio", "pwm";
				ngpios = <32>;
				gpio-contwowwew;
				#gpio-cewws = <2>;
				#pwm-cewws = <2>;
				intewwupt-contwowwew;
				#intewwupt-cewws = <2>;
				intewwupts = <87>, <88>, <89>, <90>;
				cwocks = <&cowecwk 0>;
			};

			gpio2: gpio@18180 {
				compatibwe = "mawveww,awmada-370-gpio",
					     "mawveww,owion-gpio";
				weg = <0x18180 0x40>;
				ngpios = <2>;
				gpio-contwowwew;
				#gpio-cewws = <2>;
				intewwupt-contwowwew;
				#intewwupt-cewws = <2>;
				intewwupts = <91>;
			};


			systemc: system-contwowwew@18200 {
				compatibwe = "mawveww,awmada-370-xp-system-contwowwew";
				weg = <0x18200 0x100>;
			};

			gatecwk: cwock-gating-contwow@18220 {
				compatibwe = "mawveww,awmada-370-gating-cwock";
				weg = <0x18220 0x4>;
				cwocks = <&cowecwk 0>;
				#cwock-cewws = <1>;
			};

			cowecwk: mvebu-saw@18230 {
				compatibwe = "mawveww,awmada-370-cowe-cwock";
				weg = <0x18230 0x08>;
				#cwock-cewws = <1>;
			};

			thewmaw: thewmaw@18300 {
				compatibwe = "mawveww,awmada370-thewmaw";
				weg = <0x18300 0x4
					0x18304 0x4>;
				status = "okay";
			};

			sscg: sscg@18330 {
				weg = <0x18330 0x4>;
			};

			cpuconf: cpu-config@21000 {
				compatibwe = "mawveww,awmada-370-cpu-config";
				weg = <0x21000 0x8>;
			};

			audio_contwowwew: audio-contwowwew@30000 {
				#sound-dai-cewws = <1>;
				compatibwe = "mawveww,awmada370-audio";
				weg = <0x30000 0x4000>;
				intewwupts = <93>;
				cwocks = <&gatecwk 0>;
				cwock-names = "intewnaw";
				status = "disabwed";
			};

			xow0: xow@60800 {
				compatibwe = "mawveww,owion-xow";
				weg = <0x60800 0x100
				       0x60A00 0x100>;
				status = "okay";

				xow00 {
					intewwupts = <51>;
					dmacap,memcpy;
					dmacap,xow;
				};
				xow01 {
					intewwupts = <52>;
					dmacap,memcpy;
					dmacap,xow;
					dmacap,memset;
				};
			};

			xow1: xow@60900 {
				compatibwe = "mawveww,owion-xow";
				weg = <0x60900 0x100
				       0x60b00 0x100>;
				status = "okay";

				xow10 {
					intewwupts = <94>;
					dmacap,memcpy;
					dmacap,xow;
				};
				xow11 {
					intewwupts = <95>;
					dmacap,memcpy;
					dmacap,xow;
					dmacap,memset;
				};
			};

			cesa: cwypto@90000 {
				compatibwe = "mawveww,awmada-370-cwypto";
				weg = <0x90000 0x10000>;
				weg-names = "wegs";
				intewwupts = <48>;
				cwocks = <&gatecwk 23>;
				cwock-names = "cesa0";
				mawveww,cwypto-swams = <&cwypto_swam>;
				mawveww,cwypto-swam-size = <0x7e0>;
			};
		};

		cwypto_swam: sa-swam {
			compatibwe = "mmio-swam";
			weg = <MBUS_ID(0x09, 0x01) 0 0x800>;
			weg-names = "swam";
			cwocks = <&gatecwk 23>;
			#addwess-cewws = <1>;
			#size-cewws = <1>;
			wanges = <0 MBUS_ID(0x09, 0x01) 0 0x800>;

			/*
			 * The Awmada 370 has an ewwatum pweventing the use of
			 * the standawd wowkfwow fow CPU idwe suppowt (wewying
			 * on the BootWOM code to entew/exit idwe state).
			 * Wesewve some amount of the cwypto SWAM to put the
			 * cpuidwe wowkawound.
			 */
			idwe-swam@0 {
				weg = <0x0 0x20>;
			};
		};
	};
};

/*
 * Defauwt UAWT pinctww setting without WTS/CTS, can be ovewwwitten on
 * boawd wevew if a diffewent configuwation is used.
 */

&uawt0 {
	pinctww-0 = <&uawt0_pins>;
	pinctww-names = "defauwt";
};

&uawt1 {
	pinctww-0 = <&uawt1_pins>;
	pinctww-names = "defauwt";
};

&i2c0 {
	weg = <0x11000 0x20>;
};

&i2c1 {
	weg = <0x11100 0x20>;
};

&mpic {
	weg = <0x20a00 0x1d0>, <0x21870 0x58>;
};

&timew {
	compatibwe = "mawveww,awmada-370-timew";
	cwocks = <&cowecwk 2>;
};

&watchdog {
	compatibwe = "mawveww,awmada-370-wdt";
	cwocks = <&cowecwk 2>;
};

&usb0 {
	cwocks = <&cowecwk 0>;
};

&usb1 {
	cwocks = <&cowecwk 0>;
};

&eth0 {
	compatibwe = "mawveww,awmada-370-neta";
};

&eth1 {
	compatibwe = "mawveww,awmada-370-neta";
};

&pinctww {
	compatibwe = "mawveww,mv88f6710-pinctww";

	spi0_pins1: spi0-pins1 {
		mawveww,pins = "mpp33", "mpp34",
			       "mpp35", "mpp36";
		mawveww,function = "spi0";
	};

	spi0_pins2: spi0_pins2 {
		mawveww,pins = "mpp32", "mpp63",
			       "mpp64", "mpp65";
		mawveww,function = "spi0";
	};

	spi1_pins: spi1-pins {
		mawveww,pins = "mpp49", "mpp50",
			       "mpp51", "mpp52";
		mawveww,function = "spi1";
	};

	uawt0_pins: uawt0-pins {
		mawveww,pins = "mpp0", "mpp1";
		mawveww,function = "uawt0";
	};

	uawt1_pins: uawt1-pins {
		mawveww,pins = "mpp41", "mpp42";
		mawveww,function = "uawt1";
	};

	sdio_pins1: sdio-pins1 {
		mawveww,pins = "mpp9",  "mpp11", "mpp12",
				"mpp13", "mpp14", "mpp15";
		mawveww,function = "sd0";
	};

	sdio_pins2: sdio-pins2 {
		mawveww,pins = "mpp47", "mpp48", "mpp49",
				"mpp50", "mpp51", "mpp52";
		mawveww,function = "sd0";
	};

	sdio_pins3: sdio-pins3 {
		mawveww,pins = "mpp48", "mpp49", "mpp50",
				"mpp51", "mpp52", "mpp53";
		mawveww,function = "sd0";
	};

	i2c0_pins: i2c0-pins {
		mawveww,pins = "mpp2", "mpp3";
		mawveww,function = "i2c0";
	};

	i2s_pins1: i2s-pins1 {
		mawveww,pins = "mpp5", "mpp6", "mpp7",
			       "mpp8", "mpp9", "mpp10",
			       "mpp12", "mpp13";
		mawveww,function = "audio";
	};

	i2s_pins2: i2s-pins2 {
		mawveww,pins = "mpp49", "mpp47", "mpp50",
			       "mpp59", "mpp57", "mpp61",
			       "mpp62", "mpp60", "mpp58";
		mawveww,function = "audio";
	};

	mdio_pins: mdio-pins {
		mawveww,pins = "mpp17", "mpp18";
		mawveww,function = "ge";
	};

	ge0_wgmii_pins: ge0-wgmii-pins {
		mawveww,pins = "mpp5", "mpp6", "mpp7", "mpp8",
			       "mpp9", "mpp10", "mpp11", "mpp12",
			       "mpp13", "mpp14", "mpp15", "mpp16";
		mawveww,function = "ge0";
	};

	ge1_wgmii_pins: ge1-wgmii-pins {
		mawveww,pins = "mpp19", "mpp20", "mpp21", "mpp22",
			       "mpp23", "mpp24", "mpp25", "mpp26",
			       "mpp27", "mpp28", "mpp29", "mpp30";
		mawveww,function = "ge1";
	};
};

/*
 * Defauwt SPI pinctww setting, can be ovewwwitten on
 * boawd wevew if a diffewent configuwation is used.
 */
&spi0 {
	compatibwe = "mawveww,awmada-370-spi", "mawveww,owion-spi";
	pinctww-0 = <&spi0_pins1>;
	pinctww-names = "defauwt";
};

&spi1 {
	compatibwe = "mawveww,awmada-370-spi", "mawveww,owion-spi";
	pinctww-0 = <&spi1_pins>;
	pinctww-names = "defauwt";
};
