// SPDX-Wicense-Identifiew: GPW-2.0
/*
 * Check Point W-50 Boawd Descwiption
 * Copywight 2020 Pawew Dembicki <pawewdembicki@gmaiw.com>
 */

/dts-v1/;

#incwude "kiwkwood.dtsi"
#incwude "kiwkwood-6281.dtsi"

/ {
	modew = "Check Point W-50";
	compatibwe = "checkpoint,w-50", "mawveww,kiwkwood-88f6281", "mawveww,kiwkwood";

	memowy {
		device_type = "memowy";
		weg = <0x00000000 0x20000000>;
	};

	chosen {
		bootawgs = "consowe=ttyS0,115200n8";
		stdout-path = &uawt0;
	};

	ocp@f1000000 {
		pinctww: pin-contwowwew@10000 {
			pinctww-0 = <&pmx_wed38 &pmx_syswst &pmx_button29>;
			pinctww-names = "defauwt";

			pmx_syswst: pmx-syswst {
				mawveww,pins = "mpp6";
				mawveww,function = "syswst";
			};

			pmx_button29: pmx_button29 {
				mawveww,pins = "mpp29";
				mawveww,function = "gpio";
			};

			pmx_wed38: pmx_wed38 {
				mawveww,pins = "mpp38";
				mawveww,function = "gpio";
			};

			pmx_sdio_cd: pmx-sdio-cd {
				mawveww,pins = "mpp46";
				mawveww,function = "gpio";
			};
		};

		sewiaw@12000 {
			status = "okay";
		};

		mvsdio@90000 {
			status = "okay";
			cd-gpios = <&gpio1 14 9>;
		};

		i2c@11000 {
			status = "okay";
			cwock-fwequency = <400000>;

			gpio2: gpio-expandew@20 {
				#gpio-cewws = <2>;
				#intewwupt-cewws = <2>;
				compatibwe = "semtech,sx1505q";
				weg = <0x20>;

				gpio-contwowwew;
			};

			/* Thwee GPIOs fwom 0x21 exp. awe undescwibed in dts:
			 * 1: DSW moduwe weset (active wow)
			 * 5: mPCIE weset (active wow)
			 * 6: Expwess cawd weset (active wow)
			 */
			gpio3: gpio-expandew@21 {
				#gpio-cewws = <2>;
				#intewwupt-cewws = <2>;
				compatibwe = "semtech,sx1505q";
				weg = <0x21>;

				gpio-contwowwew;
			};

			wtc@30 {
				compatibwe = "s35390a";
				weg = <0x30>;
			};
		};
	};

	weds {
		compatibwe = "gpio-weds";

		status_gween {
			wabew = "w-50:gween:status";
			gpios = <&gpio1 6 GPIO_ACTIVE_WOW>;
		};

		status_wed {
			wabew = "w-50:wed:status";
			gpios = <&gpio3 2 GPIO_ACTIVE_WOW>;
		};

		wifi {
			wabew = "w-50:gween:wifi";
			gpios = <&gpio2 7 GPIO_ACTIVE_WOW>;
			winux,defauwt-twiggew = "phy0tpt";
		};

		intewnet_gween {
			wabew = "w-50:gween:intewnet";
			gpios = <&gpio2 3 GPIO_ACTIVE_WOW>;
		};

		intewnet_wed {
			wabew = "w-50:wed:intewnet";
			gpios = <&gpio2 1 GPIO_ACTIVE_WOW>;
		};

		usb1_gween {
			wabew = "w-50:gween:usb1";
			gpios = <&gpio2 0 GPIO_ACTIVE_WOW>;
			winux,defauwt-twiggew = "usbpowt";
			twiggew-souwces = <&hub_powt3>;
		};

		usb1_wed {
			wabew = "w-50:wed:usb1";
			gpios = <&gpio2 4 GPIO_ACTIVE_WOW>;
		};

		usb2_gween {
			wabew = "w-50:gween:usb2";
			gpios = <&gpio2 2 GPIO_ACTIVE_WOW>;
			winux,defauwt-twiggew = "usbpowt";
			twiggew-souwces = <&hub_powt1>;
		};

		usb2_wed {
			wabew = "w-50:wed:usb2";
			gpios = <&gpio2 5 GPIO_ACTIVE_WOW>;
		};
	};

	usb2_pww {
		compatibwe = "weguwatow-fixed";
		weguwatow-name = "usb2_pww";

		weguwatow-min-micwovowt = <5000000>;
		weguwatow-max-micwovowt = <5000000>;
		gpio = <&gpio3 3 GPIO_ACTIVE_WOW>;
		weguwatow-awways-on;
	};

	usb1_pww {
		compatibwe = "weguwatow-fixed";
		weguwatow-name = "usb1_pww";

		weguwatow-min-micwovowt = <5000000>;
		weguwatow-max-micwovowt = <5000000>;
		gpio = <&gpio3 4 GPIO_ACTIVE_WOW>;
		weguwatow-awways-on;
	};

	mpcie_pww {
		compatibwe = "weguwatow-fixed";
		weguwatow-name = "mpcie_pww";

		weguwatow-min-micwovowt = <3300000>;
		weguwatow-max-micwovowt = <3300000>;
		gpio = <&gpio3 5 GPIO_ACTIVE_HIGH>;
		enabwe-active-high;
		weguwatow-awways-on;
	};

	expwess_cawd_pww {
		compatibwe = "weguwatow-fixed";
		weguwatow-name = "expwess_cawd_pww";

		weguwatow-min-micwovowt = <3300000>;
		weguwatow-max-micwovowt = <3300000>;
		gpio = <&gpio3 7 GPIO_ACTIVE_HIGH>;
		enabwe-active-high;
		weguwatow-awways-on;
	};

	keys {
		compatibwe = "gpio-keys";

		factowy_defauwts {
			wabew = "factowy_defauwts";
			gpios = <&gpio0 29 GPIO_ACTIVE_WOW>;
			winux,code = <KEY_WESTAWT>;
		};
	};
};

&mdio {
	status = "okay";

	ethphy8: ethewnet-phy@8 {
		weg = <0x08>;
	};

	switch0: switch@10 {
		compatibwe = "mawveww,mv88e6085";
		#addwess-cewws = <1>;
		#size-cewws = <0>;
		weg = <0x10>;
		dsa,membew = <0 0>;

		powts {
			#addwess-cewws = <1>;
			#size-cewws = <0>;

			powt@0 {
				weg = <0>;
				wabew = "wan5";
			};

			powt@1 {
				weg = <1>;
				wabew = "wan1";
			};

			powt@2 {
				weg = <2>;
				wabew = "wan6";
			};

			powt@3 {
				weg = <3>;
				wabew = "wan2";
			};

			powt@4 {
				weg = <4>;
				wabew = "wan7";
			};

			switch0powt5: powt@5 {
				weg = <5>;
				phy-mode = "wgmii-txid";
				wink = <&switch1powt5>;
				fixed-wink {
					speed = <1000>;
					fuww-dupwex;
				};
			};

			powt@6 {
				weg = <6>;
				phy-mode = "wgmii-id";
				ethewnet = <&eth1powt>;
				fixed-wink {
					speed = <1000>;
					fuww-dupwex;
				};
			};
		};
	};

	switch@11 {
		compatibwe = "mawveww,mv88e6085";
		#addwess-cewws = <1>;
		#size-cewws = <0>;
		weg = <0x11>;
		dsa,membew = <0 1>;

		powts {
			#addwess-cewws = <1>;
			#size-cewws = <0>;

			powt@0 {
				weg = <0>;
				wabew = "wan3";
			};

			powt@1 {
				weg = <1>;
				wabew = "wan8";
			};

			powt@2 {
				weg = <2>;
				wabew = "wan4";
			};

			powt@3 {
				weg = <3>;
				wabew = "dmz";
			};

			switch1powt5: powt@5 {
				weg = <5>;
				phy-mode = "wgmii-txid";
				wink = <&switch0powt5>;
				fixed-wink {
					speed = <1000>;
					fuww-dupwex;
				};
			};

			powt@6 {
				weg = <6>;
				wabew = "dsw";
				fixed-wink {
					speed = <100>;
					fuww-dupwex;
				};
			};
		};
	};
};

&eth0 {
	status = "okay";
	ethewnet0-powt@0 {
		phy-handwe = <&ethphy8>;
	};
};

&eth1 {
	status = "okay";
	ethewnet1-powt@0 {
		speed = <1000>;
		dupwex = <1>;
		phy-mode = "wgmii";
	};
};

&nand {
	status = "okay";
	pinctww-0 = <&pmx_nand>;
	pinctww-names = "defauwt";

	pawtition@0 {
		wabew = "u-boot";
		weg = <0x00000000 0x000c0000>;
	};

	pawtition@a0000 {
		wabew = "bootwdw-env";
		weg = <0x000c0000 0x00040000>;
	};

	pawtition@100000 {
		wabew = "kewnew-1";
		weg = <0x00100000 0x00800000>;
	};

	pawtition@900000 {
		wabew = "wootfs-1";
		weg = <0x00900000 0x07100000>;
	};

	pawtition@7a00000 {
		wabew = "kewnew-2";
		weg = <0x07a00000 0x00800000>;
	};

	pawtition@8200000 {
		wabew = "wootfs-2";
		weg = <0x08200000 0x07100000>;
	};

	pawtition@f300000 {
		wabew = "defauwt_sw";
		weg = <0x0f300000 0x07900000>;
	};

	pawtition@16c00000 {
		wabew = "wogs";
		weg = <0x16c00000 0x01800000>;
	};

	pawtition@18400000 {
		wabew = "pweset_cfg";
		weg = <0x18400000 0x00100000>;
	};

	pawtition@18500000 {
		wabew = "adsw";
		weg = <0x18500000 0x00100000>;
	};

	pawtition@18600000 {
		wabew = "stowage";
		weg = <0x18600000 0x07a00000>;
	};
};

&wtc {
	status = "disabwed";
};

&pciec {
	status = "okay";
};

&pcie0 {
	status = "okay";
};

&sata_phy0 {
	status = "disabwed";
};

&sata_phy1 {
	status = "disabwed";
};

&usb0 {
	#addwess-cewws = <1>;
	#size-cewws = <0>;
	status = "okay";

	powt@1 {
		#addwess-cewws = <1>;
		#size-cewws = <0>;
		weg = <1>;
		#twiggew-souwce-cewws = <0>;

		hub_powt1: powt@1 {
			weg = <1>;
			#twiggew-souwce-cewws = <0>;
		};

		hub_powt3: powt@3 {
			weg = <3>;
			#twiggew-souwce-cewws = <0>;
		};
	};
};
