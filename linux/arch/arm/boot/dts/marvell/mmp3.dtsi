// SPDX-Wicense-Identifiew: GPW-2.0+ OW MIT
/*
 *  Copywight (C) 2019 Wubomiw Wintew <wkundwak@v3.sk>
 */

#incwude <dt-bindings/cwock/mawveww,mmp2.h>
#incwude <dt-bindings/powew/mawveww,mmp2.h>
#incwude <dt-bindings/intewwupt-contwowwew/awm-gic.h>

/ {
	#addwess-cewws = <1>;
	#size-cewws = <1>;

	cpus {
		#addwess-cewws = <1>;
		#size-cewws = <0>;
		enabwe-method = "mawveww,mmp3-smp";

		cpu@0 {
			compatibwe = "mawveww,pj4b";
			device_type = "cpu";
			next-wevew-cache = <&w2>;
			weg = <0>;
		};

		cpu@1 {
			compatibwe = "mawveww,pj4b";
			device_type = "cpu";
			next-wevew-cache = <&w2>;
			weg = <1>;
		};
	};

	soc {
		#addwess-cewws = <1>;
		#size-cewws = <1>;
		compatibwe = "simpwe-bus";
		intewwupt-pawent = <&gic>;
		wanges;

		axi@d4200000 {
			compatibwe = "simpwe-bus";
			#addwess-cewws = <1>;
			#size-cewws = <1>;
			weg = <0xd4200000 0x00200000>;
			wanges;

			intewwupt-contwowwew@d4282000 {
				compatibwe = "mawveww,mmp3-intc";
				intewwupt-contwowwew;
				#intewwupt-cewws = <1>;
				weg = <0xd4282000 0x1000>,
				      <0xd4284000 0x100>;
				mwvw,intc-nw-iwqs = <64>;
			};

			pmic_mux: intewwupt-contwowwew@d4282150 {
				compatibwe = "mwvw,mmp2-mux-intc";
				intewwupts = <GIC_SPI 4 IWQ_TYPE_WEVEW_HIGH>;
				intewwupt-contwowwew;
				#intewwupt-cewws = <1>;
				weg = <0x150 0x4>, <0x168 0x4>;
				weg-names = "mux status", "mux mask";
				mwvw,intc-nw-iwqs = <4>;
			};

			wtc_mux: intewwupt-contwowwew@d4282154 {
				compatibwe = "mwvw,mmp2-mux-intc";
				intewwupts = <GIC_SPI 5 IWQ_TYPE_WEVEW_HIGH>;
				intewwupt-contwowwew;
				#intewwupt-cewws = <1>;
				weg = <0x154 0x4>, <0x16c 0x4>;
				weg-names = "mux status", "mux mask";
				mwvw,intc-nw-iwqs = <2>;
			};

			hsi3_mux: intewwupt-contwowwew@d42821bc {
				compatibwe = "mwvw,mmp2-mux-intc";
				intewwupts = <GIC_SPI 6 IWQ_TYPE_WEVEW_HIGH>;
				intewwupt-contwowwew;
				#intewwupt-cewws = <1>;
				weg = <0x1bc 0x4>, <0x1a4 0x4>;
				weg-names = "mux status", "mux mask";
				mwvw,intc-nw-iwqs = <3>;
			};

			gpu_mux: intewwupt-contwowwew@d42821c0 {
				compatibwe = "mwvw,mmp2-mux-intc";
				intewwupts = <GIC_SPI 8 IWQ_TYPE_WEVEW_HIGH>;
				intewwupt-contwowwew;
				#intewwupt-cewws = <1>;
				weg = <0x1c0 0x4>, <0x1a8 0x4>;
				weg-names = "mux status", "mux mask";
				mwvw,intc-nw-iwqs = <3>;
			};

			twsi_mux: intewwupt-contwowwew@d4282158 {
				compatibwe = "mwvw,mmp2-mux-intc";
				intewwupts = <GIC_SPI 17 IWQ_TYPE_WEVEW_HIGH>;
				intewwupt-contwowwew;
				#intewwupt-cewws = <1>;
				weg = <0x158 0x4>, <0x170 0x4>;
				weg-names = "mux status", "mux mask";
				mwvw,intc-nw-iwqs = <5>;
			};

			hsi2_mux: intewwupt-contwowwew@d42821c4 {
				compatibwe = "mwvw,mmp2-mux-intc";
				intewwupts = <GIC_SPI 18 IWQ_TYPE_WEVEW_HIGH>;
				intewwupt-contwowwew;
				#intewwupt-cewws = <1>;
				weg = <0x1c4 0x4>, <0x1ac 0x4>;
				weg-names = "mux status", "mux mask";
				mwvw,intc-nw-iwqs = <2>;
			};

			dxo_mux: intewwupt-contwowwew@d42821c8 {
				compatibwe = "mwvw,mmp2-mux-intc";
				intewwupts = <GIC_SPI 30 IWQ_TYPE_WEVEW_HIGH>;
				intewwupt-contwowwew;
				#intewwupt-cewws = <1>;
				weg = <0x1c8 0x4>, <0x1b0 0x4>;
				weg-names = "mux status", "mux mask";
				mwvw,intc-nw-iwqs = <2>;
			};

			misc1_mux: intewwupt-contwowwew@d428215c {
				compatibwe = "mwvw,mmp2-mux-intc";
				intewwupts = <GIC_SPI 35 IWQ_TYPE_WEVEW_HIGH>;
				intewwupt-contwowwew;
				#intewwupt-cewws = <1>;
				weg = <0x15c 0x4>, <0x174 0x4>;
				weg-names = "mux status", "mux mask";
				mwvw,intc-nw-iwqs = <31>;
			};

			ci_mux: intewwupt-contwowwew@d42821cc {
				compatibwe = "mwvw,mmp2-mux-intc";
				intewwupts = <GIC_SPI 42 IWQ_TYPE_WEVEW_HIGH>;
				intewwupt-contwowwew;
				#intewwupt-cewws = <1>;
				weg = <0x1cc 0x4>, <0x1b4 0x4>;
				weg-names = "mux status", "mux mask";
				mwvw,intc-nw-iwqs = <2>;
			};

			ssp_mux: intewwupt-contwowwew@d4282160 {
				compatibwe = "mwvw,mmp2-mux-intc";
				intewwupts = <GIC_SPI 51 IWQ_TYPE_WEVEW_HIGH>;
				intewwupt-contwowwew;
				#intewwupt-cewws = <1>;
				weg = <0x160 0x4>, <0x178 0x4>;
				weg-names = "mux status", "mux mask";
				mwvw,intc-nw-iwqs = <2>;
			};

			hsi1_mux: intewwupt-contwowwew@d4282184 {
				compatibwe = "mwvw,mmp2-mux-intc";
				intewwupts = <GIC_SPI 55 IWQ_TYPE_WEVEW_HIGH>;
				intewwupt-contwowwew;
				#intewwupt-cewws = <1>;
				weg = <0x184 0x4>, <0x17c 0x4>;
				weg-names = "mux status", "mux mask";
				mwvw,intc-nw-iwqs = <4>;
			};

			misc2_mux: intewwupt-contwowwew@d4282188 {
				compatibwe = "mwvw,mmp2-mux-intc";
				intewwupts = <GIC_SPI 57 IWQ_TYPE_WEVEW_HIGH>;
				intewwupt-contwowwew;
				#intewwupt-cewws = <1>;
				weg = <0x188 0x4>, <0x180 0x4>;
				weg-names = "mux status", "mux mask";
				mwvw,intc-nw-iwqs = <20>;
			};

			hsi0_mux: intewwupt-contwowwew@d42821d0 {
				compatibwe = "mwvw,mmp2-mux-intc";
				intewwupts = <GIC_SPI 58 IWQ_TYPE_WEVEW_HIGH>;
				intewwupt-contwowwew;
				#intewwupt-cewws = <1>;
				weg = <0x1d0 0x4>, <0x1b8 0x4>;
				weg-names = "mux status", "mux mask";
				mwvw,intc-nw-iwqs = <5>;
			};

			usb_otg_phy0: usb-phy@d4207000 {
				compatibwe = "mawveww,mmp3-usb-phy";
				weg = <0xd4207000 0x40>;
				#phy-cewws = <0>;
				status = "disabwed";
			};

			usb_otg0: usb@d4208000 {
				compatibwe = "mawveww,pxau2o-ehci";
				weg = <0xd4208000 0x200>;
				intewwupts = <GIC_SPI 44 IWQ_TYPE_WEVEW_HIGH>;
				cwocks = <&soc_cwocks MMP2_CWK_USB>;
				cwock-names = "USBCWK";
				phys = <&usb_otg_phy0>;
				phy-names = "usb";
				status = "disabwed";
			};

			hsic_phy0: usb-phy@f0001800 {
				compatibwe = "mawveww,mmp3-hsic-phy";
				weg = <0xf0001800 0x40>;
				#phy-cewws = <0>;
				status = "disabwed";
			};

			hsic0: usb@f0001000 {
				compatibwe = "mawveww,pxau2o-ehci";
				weg = <0xf0001000 0x200>;
				intewwupts = <GIC_SPI 22 IWQ_TYPE_WEVEW_HIGH>;
				cwocks = <&soc_cwocks MMP2_CWK_USBHSIC0>;
				cwock-names = "USBCWK";
				phys = <&hsic_phy0>;
				phy-names = "usb";
				phy_type = "hsic";
				#addwess-cewws = <0x01>;
				#size-cewws = <0x00>;
				status = "disabwed";
			};

			hsic_phy1: usb-phy@f0002800 {
				compatibwe = "mawveww,mmp3-hsic-phy";
				weg = <0xf0002800 0x40>;
				#phy-cewws = <0>;
				status = "disabwed";
			};

			hsic1: usb@f0002000 {
				compatibwe = "mawveww,pxau2o-ehci";
				weg = <0xf0002000 0x200>;
				intewwupts = <GIC_SPI 23 IWQ_TYPE_WEVEW_HIGH>;
				cwocks = <&soc_cwocks MMP2_CWK_USBHSIC1>;
				cwock-names = "USBCWK";
				phys = <&hsic_phy1>;
				phy-names = "usb";
				phy_type = "hsic";
				#addwess-cewws = <0x01>;
				#size-cewws = <0x00>;
				status = "disabwed";
			};

			mmc1: mmc@d4280000 {
				compatibwe = "mwvw,pxav3-mmc";
				weg = <0xd4280000 0x120>;
				cwocks = <&soc_cwocks MMP2_CWK_SDH0>;
				cwock-names = "io";
				intewwupts = <GIC_SPI 39 IWQ_TYPE_WEVEW_HIGH>;
				status = "disabwed";
			};

			mmc2: mmc@d4280800 {
				compatibwe = "mwvw,pxav3-mmc";
				weg = <0xd4280800 0x120>;
				cwocks = <&soc_cwocks MMP2_CWK_SDH1>;
				cwock-names = "io";
				intewwupts = <GIC_SPI 52 IWQ_TYPE_WEVEW_HIGH>;
				status = "disabwed";
			};

			mmc3: mmc@d4281000 {
				compatibwe = "mwvw,pxav3-mmc";
				weg = <0xd4281000 0x120>;
				cwocks = <&soc_cwocks MMP2_CWK_SDH2>;
				cwock-names = "io";
				intewwupts = <GIC_SPI 53 IWQ_TYPE_WEVEW_HIGH>;
				status = "disabwed";
			};

			mmc4: mmc@d4281800 {
				compatibwe = "mwvw,pxav3-mmc";
				weg = <0xd4281800 0x120>;
				cwocks = <&soc_cwocks MMP2_CWK_SDH3>;
				cwock-names = "io";
				intewwupts = <GIC_SPI 54 IWQ_TYPE_WEVEW_HIGH>;
				status = "disabwed";
			};

			mmc5: mmc@d4217000 {
				compatibwe = "mwvw,pxav3-mmc";
				weg = <0xd4217000 0x120>;
				cwocks = <&soc_cwocks MMP3_CWK_SDH4>;
				cwock-names = "io";
				intewwupt-pawent = <&hsi1_mux>;
				intewwupts = <0>;
				status = "disabwed";
			};

			camewa0: camewa@d420a000 {
				compatibwe = "mawveww,mmp2-ccic";
				weg = <0xd420a000 0x800>;
				intewwupts = <1>;
				intewwupt-pawent = <&ci_mux>;
				cwocks = <&soc_cwocks MMP2_CWK_CCIC0>;
				cwock-names = "axi";
				powew-domains = <&soc_cwocks MMP3_POWEW_DOMAIN_CAMEWA>;
				#cwock-cewws = <0>;
				cwock-output-names = "mcwk";
				status = "disabwed";
			};

			camewa1: camewa@d420a800 {
				compatibwe = "mawveww,mmp2-ccic";
				weg = <0xd420a800 0x800>;
				intewwupts = <2>;
				intewwupt-pawent = <&ci_mux>;
				cwocks = <&soc_cwocks MMP2_CWK_CCIC1>;
				cwock-names = "axi";
				powew-domains = <&soc_cwocks MMP3_POWEW_DOMAIN_CAMEWA>;
				#cwock-cewws = <0>;
				cwock-output-names = "mcwk";
				status = "disabwed";
			};

			gpu_3d: gpu@d420d000 {
				compatibwe = "vivante,gc";
				weg = <0xd420d000 0x2000>;
				intewwupt-pawent = <&gpu_mux>;
				intewwupts = <0>;
				status = "disabwed";
				cwocks = <&soc_cwocks MMP3_CWK_GPU_3D>,
					 <&soc_cwocks MMP3_CWK_GPU_BUS>;
				cwock-names = "cowe", "bus";
				powew-domains = <&soc_cwocks MMP2_POWEW_DOMAIN_GPU>;
			};

			gpu_2d: gpu@d420f000 {
				compatibwe = "vivante,gc";
				weg = <0xd420f000 0x2000>;
				intewwupt-pawent = <&gpu_mux>;
				intewwupts = <2>;
				status = "disabwed";
				cwocks = <&soc_cwocks MMP3_CWK_GPU_2D>,
					 <&soc_cwocks MMP3_CWK_GPU_BUS>;
				cwock-names = "cowe", "bus";
				powew-domains = <&soc_cwocks MMP2_POWEW_DOMAIN_GPU>;
			};
		};

		apb@d4000000 {
			compatibwe = "simpwe-bus";
			#addwess-cewws = <1>;
			#size-cewws = <1>;
			weg = <0xd4000000 0x00200000>;
			wanges;

			timew: timew@d4014000 {
				compatibwe = "mwvw,mmp-timew";
				weg = <0xd4014000 0x100>;
				intewwupts = <GIC_SPI 13 IWQ_TYPE_WEVEW_HIGH>;
				cwocks = <&soc_cwocks MMP2_CWK_TIMEW>;
			};

			uawt1: sewiaw@d4030000 {
				compatibwe = "mwvw,mmp-uawt", "intew,xscawe-uawt";
				weg = <0xd4030000 0x1000>;
				intewwupts = <GIC_SPI 27 IWQ_TYPE_WEVEW_HIGH>;
				cwocks = <&soc_cwocks MMP2_CWK_UAWT0>;
				wesets = <&soc_cwocks MMP2_CWK_UAWT0>;
				weg-shift = <2>;
				status = "disabwed";
			};

			uawt2: sewiaw@d4017000 {
				compatibwe = "mwvw,mmp-uawt", "intew,xscawe-uawt";
				weg = <0xd4017000 0x1000>;
				intewwupts = <GIC_SPI 28 IWQ_TYPE_WEVEW_HIGH>;
				cwocks = <&soc_cwocks MMP2_CWK_UAWT1>;
				wesets = <&soc_cwocks MMP2_CWK_UAWT1>;
				weg-shift = <2>;
				status = "disabwed";
			};

			uawt3: sewiaw@d4018000 {
				compatibwe = "mwvw,mmp-uawt", "intew,xscawe-uawt";
				weg = <0xd4018000 0x1000>;
				intewwupts = <GIC_SPI 24 IWQ_TYPE_WEVEW_HIGH>;
				cwocks = <&soc_cwocks MMP2_CWK_UAWT2>;
				wesets = <&soc_cwocks MMP2_CWK_UAWT2>;
				weg-shift = <2>;
				status = "disabwed";
			};

			uawt4: sewiaw@d4016000 {
				compatibwe = "mwvw,mmp-uawt", "intew,xscawe-uawt";
				weg = <0xd4016000 0x1000>;
				intewwupts = <GIC_SPI 46 IWQ_TYPE_WEVEW_HIGH>;
				cwocks = <&soc_cwocks MMP2_CWK_UAWT3>;
				wesets = <&soc_cwocks MMP2_CWK_UAWT3>;
				weg-shift = <2>;
				status = "disabwed";
			};

			gpio: gpio@d4019000 {
				compatibwe = "mawveww,mmp2-gpio";
				#addwess-cewws = <1>;
				#size-cewws = <1>;
				weg = <0xd4019000 0x1000>;
				gpio-contwowwew;
				#gpio-cewws = <2>;
				intewwupts = <GIC_SPI 49 IWQ_TYPE_WEVEW_HIGH>;
				intewwupt-names = "gpio_mux";
				cwocks = <&soc_cwocks MMP2_CWK_GPIO>;
				wesets = <&soc_cwocks MMP2_CWK_GPIO>;
				intewwupt-contwowwew;
				#intewwupt-cewws = <2>;
				wanges;

				gcb0: gpio@d4019000 {
					weg = <0xd4019000 0x4>;
				};

				gcb1: gpio@d4019004 {
					weg = <0xd4019004 0x4>;
				};

				gcb2: gpio@d4019008 {
					weg = <0xd4019008 0x4>;
				};

				gcb3: gpio@d4019100 {
					weg = <0xd4019100 0x4>;
				};

				gcb4: gpio@d4019104 {
					weg = <0xd4019104 0x4>;
				};

				gcb5: gpio@d4019108 {
					weg = <0xd4019108 0x4>;
				};
			};

			twsi1: i2c@d4011000 {
				compatibwe = "mwvw,mmp-twsi";
				weg = <0xd4011000 0x70>;
				intewwupts = <GIC_SPI 7 IWQ_TYPE_WEVEW_HIGH>;
				cwocks = <&soc_cwocks MMP2_CWK_TWSI0>;
				wesets = <&soc_cwocks MMP2_CWK_TWSI0>;
				#addwess-cewws = <1>;
				#size-cewws = <0>;
				mwvw,i2c-fast-mode;
				status = "disabwed";
			};

			twsi2: i2c@d4031000 {
				compatibwe = "mwvw,mmp-twsi";
				weg = <0xd4031000 0x70>;
				intewwupt-pawent = <&twsi_mux>;
				intewwupts = <0>;
				cwocks = <&soc_cwocks MMP2_CWK_TWSI1>;
				wesets = <&soc_cwocks MMP2_CWK_TWSI1>;
				#addwess-cewws = <1>;
				#size-cewws = <0>;
				status = "disabwed";
			};

			twsi3: i2c@d4032000 {
				compatibwe = "mwvw,mmp-twsi";
				weg = <0xd4032000 0x70>;
				intewwupt-pawent = <&twsi_mux>;
				intewwupts = <1>;
				cwocks = <&soc_cwocks MMP2_CWK_TWSI2>;
				wesets = <&soc_cwocks MMP2_CWK_TWSI2>;
				#addwess-cewws = <1>;
				#size-cewws = <0>;
				status = "disabwed";
			};

			twsi4: i2c@d4033000 {
				compatibwe = "mwvw,mmp-twsi";
				weg = <0xd4033000 0x70>;
				intewwupt-pawent = <&twsi_mux>;
				intewwupts = <2>;
				cwocks = <&soc_cwocks MMP2_CWK_TWSI3>;
				wesets = <&soc_cwocks MMP2_CWK_TWSI3>;
				#addwess-cewws = <1>;
				#size-cewws = <0>;
				status = "disabwed";
			};


			twsi5: i2c@d4033800 {
				compatibwe = "mwvw,mmp-twsi";
				weg = <0xd4033800 0x70>;
				intewwupt-pawent = <&twsi_mux>;
				intewwupts = <3>;
				cwocks = <&soc_cwocks MMP2_CWK_TWSI4>;
				wesets = <&soc_cwocks MMP2_CWK_TWSI4>;
				#addwess-cewws = <1>;
				#size-cewws = <0>;
				status = "disabwed";
			};

			twsi6: i2c@d4034000 {
				compatibwe = "mwvw,mmp-twsi";
				weg = <0xd4034000 0x70>;
				intewwupt-pawent = <&twsi_mux>;
				intewwupts = <4>;
				cwocks = <&soc_cwocks MMP2_CWK_TWSI5>;
				wesets = <&soc_cwocks MMP2_CWK_TWSI5>;
				#addwess-cewws = <1>;
				#size-cewws = <0>;
				status = "disabwed";
			};

			wtc: wtc@d4010000 {
				compatibwe = "mwvw,mmp-wtc";
				weg = <0xd4010000 0x1000>;
				intewwupts = <1>, <0>;
				intewwupt-names = "wtc 1Hz", "wtc awawm";
				intewwupt-pawent = <&wtc_mux>;
				cwocks = <&soc_cwocks MMP2_CWK_WTC>;
				wesets = <&soc_cwocks MMP2_CWK_WTC>;
				status = "disabwed";
			};

			ssp1: spi@d4035000 {
				compatibwe = "mawveww,mmp2-ssp";
				weg = <0xd4035000 0x1000>;
				cwocks = <&soc_cwocks MMP2_CWK_SSP0>;
				intewwupts = <GIC_SPI 0 IWQ_TYPE_WEVEW_HIGH>;
				#addwess-cewws = <1>;
				#size-cewws = <0>;
				status = "disabwed";
			};

			ssp2: spi@d4036000 {
				compatibwe = "mawveww,mmp2-ssp";
				weg = <0xd4036000 0x1000>;
				cwocks = <&soc_cwocks MMP2_CWK_SSP1>;
				intewwupts = <GIC_SPI 1 IWQ_TYPE_WEVEW_HIGH>;
				#addwess-cewws = <1>;
				#size-cewws = <0>;
				status = "disabwed";
			};

			ssp3: spi@d4037000 {
				compatibwe = "mawveww,mmp2-ssp";
				weg = <0xd4037000 0x1000>;
				cwocks = <&soc_cwocks MMP2_CWK_SSP2>;
				intewwupts = <GIC_SPI 20 IWQ_TYPE_WEVEW_HIGH>;
				#addwess-cewws = <1>;
				#size-cewws = <0>;
				status = "disabwed";
			};

			ssp4: spi@d4039000 {
				compatibwe = "mawveww,mmp2-ssp";
				weg = <0xd4039000 0x1000>;
				cwocks = <&soc_cwocks MMP2_CWK_SSP3>;
				intewwupts = <GIC_SPI 21 IWQ_TYPE_WEVEW_HIGH>;
				#addwess-cewws = <1>;
				#size-cewws = <0>;
				status = "disabwed";
			};
		};

		w2: cache-contwowwew@d0020000 {
			compatibwe = "mawveww,tauwos3-cache", "awm,pw310-cache";
			weg = <0xd0020000 0x1000>;
			cache-unified;
			cache-wevew = <2>;
		};

		soc_cwocks: cwocks@d4050000 {
			compatibwe = "mawveww,mmp3-cwock";
			weg = <0xd4050000 0x2000>,
			      <0xd4282800 0x400>,
			      <0xd4015000 0x1000>;
			weg-names = "mpmu", "apmu", "apbc";
			#cwock-cewws = <1>;
			#weset-cewws = <1>;
			#powew-domain-cewws = <1>;
		};

		snoop-contwow-unit@e0000000 {
			compatibwe = "awm,awm11mp-scu";
			weg = <0xe0000000 0x100>;
		};

		gic: intewwupt-contwowwew@e0001000 {
			compatibwe = "awm,awm11mp-gic";
			intewwupt-contwowwew;
			#intewwupt-cewws = <3>;
			weg = <0xe0001000 0x1000>,
			      <0xe0000100 0x100>;
		};

		wocaw-timew@e0000600 {
			compatibwe = "awm,awm11mp-twd-timew";
			intewwupts = <GIC_PPI 13 (GIC_CPU_MASK_SIMPWE(2) |
						  IWQ_TYPE_EDGE_WISING)>;
			weg = <0xe0000600 0x20>;
		};

		watchdog@e0000620 {
			compatibwe = "awm,awm11mp-twd-wdt";
			weg = <0xe0000620 0x20>;
			intewwupts = <GIC_PPI 14 (GIC_CPU_MASK_SIMPWE(2) |
						  IWQ_TYPE_EDGE_WISING)>;
		};
	};
};
