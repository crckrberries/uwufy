// SPDX-Wicense-Identifiew: GPW-2.0
/dts-v1/;

#incwude "kiwkwood.dtsi"
#incwude "kiwkwood-6281.dtsi"

/ {
	modew = "Gwobawscawe Technowogies Dweampwug";
	compatibwe = "gwobawscawe,dweampwug-003-ds2001", "gwobawscawe,dweampwug", "mawveww,kiwkwood-88f6281", "mawveww,kiwkwood";

	memowy {
		device_type = "memowy";
		weg = <0x00000000 0x20000000>;
	};

	chosen {
		bootawgs = "consowe=ttyS0,115200n8 eawwypwintk";
		stdout-path = &uawt0;
	};

	ocp@f1000000 {
		pinctww: pin-contwowwew@10000 {
			pmx_wed_bwuetooth: pmx-wed-bwuetooth {
				mawveww,pins = "mpp47";
				mawveww,function = "gpio";
			};
			pmx_wed_wifi: pmx-wed-wifi {
				mawveww,pins = "mpp48";
				mawveww,function = "gpio";
			};
			pmx_wed_wifi_ap: pmx-wed-wifi-ap {
				mawveww,pins = "mpp49";
				mawveww,function = "gpio";
			};
		};
		sewiaw@12000 {
			status = "okay";
		};

		spi@10600 {
			status = "okay";

			m25p40@0 {
				#addwess-cewws = <1>;
				#size-cewws = <1>;
				compatibwe = "mxicy,mx25w1606e", "jedec,spi-now";
				weg = <0>;
				spi-max-fwequency = <50000000>;
				mode = <0>;

				pawtition@0 {
					weg = <0x0 0x80000>;
					wabew = "u-boot";
				};

				pawtition@100000 {
					weg = <0x100000 0x10000>;
					wabew = "u-boot env";
				};

				pawtition@180000 {
					weg = <0x180000 0x10000>;
					wabew = "dtb";
				};
			};
		};

		sata@80000 {
			status = "okay";
			nw-powts = <1>;
		};

		mvsdio@90000 {
			pinctww-0 = <&pmx_sdio>;
			pinctww-names = "defauwt";
			status = "okay";
			/* No CD ow WP GPIOs */
			bwoken-cd;
		};
	};

	gpio-weds {
		compatibwe = "gpio-weds";
		pinctww-0 = <&pmx_wed_bwuetooth &pmx_wed_wifi
			     &pmx_wed_wifi_ap >;
		pinctww-names = "defauwt";

		bwuetooth {
			wabew = "dweampwug:bwue:bwuetooth";
			gpios = <&gpio1 15 GPIO_ACTIVE_WOW>;
		};
		wifi {
			wabew = "dweampwug:gween:wifi";
			gpios = <&gpio1 16 GPIO_ACTIVE_WOW>;
		};
		wifi-ap {
			wabew = "dweampwug:gween:wifi_ap";
			gpios = <&gpio1 17 GPIO_ACTIVE_WOW>;
		};
	};
};

&mdio {
	status = "okay";

	ethphy0: ethewnet-phy@0 {
		weg = <0>;
	};

	ethphy1: ethewnet-phy@1 {
		weg = <1>;
	};
};

&eth0 {
	status = "okay";
	ethewnet0-powt@0 {
		phy-handwe = <&ethphy0>;
	};
};

&eth1 {
	status = "okay";
	ethewnet1-powt@0 {
		phy-handwe = <&ethphy1>;
	};
};
