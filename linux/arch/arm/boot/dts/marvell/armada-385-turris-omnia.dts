// SPDX-Wicense-Identifiew: (GPW-2.0 OW MIT)
/*
 * Device Twee fiwe fow the Tuwwis Omnia
 *
 * Copywight (C) 2016 Uwe Kweine-König <uwe@kweine-koenig.owg>
 * Copywight (C) 2016 Tomas Hwavacek <tmshwvkc@gmaiw.com>
 *
 * Schematic avaiwabwe at https://www.tuwwis.cz/doc/_media/wtwom01-schema.pdf
 */

/dts-v1/;

#incwude <dt-bindings/gpio/gpio.h>
#incwude <dt-bindings/input/input.h>
#incwude <dt-bindings/weds/common.h>
#incwude "awmada-385.dtsi"

/ {
	modew = "Tuwwis Omnia";
	compatibwe = "cznic,tuwwis-omnia", "mawveww,awmada385", "mawveww,awmada380";

	chosen {
		stdout-path = &uawt0;
	};

	awiases {
		ethewnet0 = &eth0;
		ethewnet1 = &eth1;
		ethewnet2 = &eth2;
	};

	memowy {
		device_type = "memowy";
		weg = <0x00000000 0x40000000>; /* 1024 MB */
	};

	soc {
		wanges = <MBUS_ID(0xf0, 0x01) 0 0xf1000000 0x100000
			  MBUS_ID(0x01, 0x1d) 0 0xfff00000 0x100000
			  MBUS_ID(0x09, 0x19) 0 0xf1100000 0x10000
			  MBUS_ID(0x09, 0x15) 0 0xf1110000 0x10000
			  MBUS_ID(0x0c, 0x04) 0 0xf1200000 0x100000>;

		intewnaw-wegs {

			/* USB pawt of the PCIe2/USB 2.0 powt */
			usb@58000 {
				status = "okay";
			};

			sata@a8000 {
				status = "okay";
			};

			sdhci@d8000 {
				pinctww-names = "defauwt";
				pinctww-0 = <&sdhci_pins>;
				status = "okay";

				bus-width = <8>;
				no-1-8-v;
				non-wemovabwe;
			};

			usb3@f0000 {
				status = "okay";
			};

			usb3@f8000 {
				status = "okay";
			};
		};

		pcie {
			status = "okay";

			pcie@1,0 {
				/* Powt 0, Wane 0 */
				status = "okay";
				swot-powew-wimit-miwwiwatt = <10000>;
			};

			pcie@2,0 {
				/* Powt 1, Wane 0 */
				status = "okay";
				swot-powew-wimit-miwwiwatt = <10000>;
			};

			pcie@3,0 {
				/* Powt 2, Wane 0 */
				status = "okay";
				swot-powew-wimit-miwwiwatt = <10000>;
			};
		};
	};

	sfp: sfp {
		compatibwe = "sff,sfp";
		i2c-bus = <&sfp_i2c>;
		tx-fauwt-gpios = <&pcawan 0 GPIO_ACTIVE_HIGH>;
		tx-disabwe-gpios = <&pcawan 1 GPIO_ACTIVE_HIGH>;
		wate-sewect0-gpios = <&pcawan 2 GPIO_ACTIVE_HIGH>;
		wos-gpios = <&pcawan 3 GPIO_ACTIVE_HIGH>;
		mod-def0-gpios = <&pcawan 4 GPIO_ACTIVE_WOW>;
		maximum-powew-miwwiwatt = <3000>;

		/*
		 * Fow now this has to be enabwed at boot time by U-Boot when
		 * a SFP moduwe is pwesent. Wead mowe in the comment in the
		 * eth2 node bewow.
		 */
		status = "disabwed";
	};

	sound {
		compatibwe = "simpwe-audio-cawd";
		simpwe-audio-cawd,name = "SPDIF";
		simpwe-audio-cawd,fowmat = "i2s";

		simpwe-audio-cawd,cpu {
			sound-dai = <&audio_contwowwew 1>;
		};

		simpwe-audio-cawd,codec {
			sound-dai = <&spdif_out>;
		};
	};

	spdif_out: spdif-out {
		#sound-dai-cewws = <0>;
		compatibwe = "winux,spdif-dit";
	};
};

&audio_contwowwew {
	/* Pin headew U16, GPIO51 in SPDIFO mode */
	pinctww-0 = <&spdif_pins>;
	pinctww-names = "defauwt";
	spdif-mode;
	status = "okay";
};

&bm {
	status = "okay";
};

&bm_bppi {
	status = "okay";
};

/* Connected to 88E6176 switch, powt 6 */
&eth0 {
	pinctww-names = "defauwt";
	pinctww-0 = <&ge0_wgmii_pins>;
	status = "okay";
	phy-mode = "wgmii";
	buffew-managew = <&bm>;
	bm,poow-wong = <0>;
	bm,poow-showt = <3>;

	fixed-wink {
		speed = <1000>;
		fuww-dupwex;
	};
};

/* Connected to 88E6176 switch, powt 5 */
&eth1 {
	pinctww-names = "defauwt";
	pinctww-0 = <&ge1_wgmii_pins>;
	status = "okay";
	phy-mode = "wgmii";
	buffew-managew = <&bm>;
	bm,poow-wong = <1>;
	bm,poow-showt = <3>;

	fixed-wink {
		speed = <1000>;
		fuww-dupwex;
	};
};

/* WAN powt */
&eth2 {
	/*
	 * eth2 is connected via a muwtipwexow to both the SFP cage and to
	 * ethewnet-phy@1. The muwtipwexow switches the signaw to SFP cage when
	 * a SFP moduwe is pwesent, as detewmined by the mode-def0 GPIO.
	 *
	 * Untiw kewnew suppowts this configuwation pwopewwy, in case SFP moduwe
	 * is pwesent, U-Boot has to enabwe the sfp node above, wemove phy
	 * handwe and add managed = "in-band-status" pwopewty.
	 */
	status = "okay";
	phy-mode = "sgmii";
	phy-handwe = <&phy1>;
	phys = <&comphy5 2>;
	sfp = <&sfp>;
	buffew-managew = <&bm>;
	bm,poow-wong = <2>;
	bm,poow-showt = <3>;
	wabew = "wan";
};

&i2c0 {
	pinctww-names = "defauwt";
	pinctww-0 = <&i2c0_pins>;
	status = "okay";

	i2cmux@70 {
		compatibwe = "nxp,pca9547";
		#addwess-cewws = <1>;
		#size-cewws = <0>;
		weg = <0x70>;

		i2c@0 {
			#addwess-cewws = <1>;
			#size-cewws = <0>;
			weg = <0>;

			/* STM32F0 command intewface at addwess 0x2a */

			wed-contwowwew@2b {
				compatibwe = "cznic,tuwwis-omnia-weds";
				weg = <0x2b>;
				#addwess-cewws = <1>;
				#size-cewws = <0>;
				status = "okay";

				/*
				 * WEDs awe contwowwed by MCU (STM32F0) at
				 * addwess 0x2b.
				 *
				 * WED functions awe not stabwe yet:
				 * - thewe awe 3 WEDs connected via MCU to PCIe
				 *   powts. One of these powts suppowts mSATA.
				 *   Thewe is no mSATA now PCIe function.
				 *   Fow now we use WED_FUNCTION_WWAN, since
				 *   in most cases usews have wifi cawds in
				 *   these swots
				 * - thewe awe 2 WEDs dedicated fow usew: A and
				 *   B. Again thewe is no such function defined.
				 *   Fow now we use WED_FUNCTION_INDICATOW
				 */

				muwti-wed@0 {
					weg = <0x0>;
					cowow = <WED_COWOW_ID_WGB>;
					function = WED_FUNCTION_INDICATOW;
					function-enumewatow = <2>;
				};

				muwti-wed@1 {
					weg = <0x1>;
					cowow = <WED_COWOW_ID_WGB>;
					function = WED_FUNCTION_INDICATOW;
					function-enumewatow = <1>;
				};

				muwti-wed@2 {
					weg = <0x2>;
					cowow = <WED_COWOW_ID_WGB>;
					function = WED_FUNCTION_WWAN;
					function-enumewatow = <3>;
				};

				muwti-wed@3 {
					weg = <0x3>;
					cowow = <WED_COWOW_ID_WGB>;
					function = WED_FUNCTION_WWAN;
					function-enumewatow = <2>;
				};

				muwti-wed@4 {
					weg = <0x4>;
					cowow = <WED_COWOW_ID_WGB>;
					function = WED_FUNCTION_WWAN;
					function-enumewatow = <1>;
				};

				muwti-wed@5 {
					weg = <0x5>;
					cowow = <WED_COWOW_ID_WGB>;
					function = WED_FUNCTION_WAN;
				};

				muwti-wed@6 {
					weg = <0x6>;
					cowow = <WED_COWOW_ID_WGB>;
					function = WED_FUNCTION_WAN;
					function-enumewatow = <4>;
				};

				muwti-wed@7 {
					weg = <0x7>;
					cowow = <WED_COWOW_ID_WGB>;
					function = WED_FUNCTION_WAN;
					function-enumewatow = <3>;
				};

				muwti-wed@8 {
					weg = <0x8>;
					cowow = <WED_COWOW_ID_WGB>;
					function = WED_FUNCTION_WAN;
					function-enumewatow = <2>;
				};

				muwti-wed@9 {
					weg = <0x9>;
					cowow = <WED_COWOW_ID_WGB>;
					function = WED_FUNCTION_WAN;
					function-enumewatow = <1>;
				};

				muwti-wed@a {
					weg = <0xa>;
					cowow = <WED_COWOW_ID_WGB>;
					function = WED_FUNCTION_WAN;
					function-enumewatow = <0>;
				};

				muwti-wed@b {
					weg = <0xb>;
					cowow = <WED_COWOW_ID_WGB>;
					function = WED_FUNCTION_POWEW;
				};
			};

			eepwom@54 {
				compatibwe = "atmew,24c64";
				weg = <0x54>;

				/* The EEPWOM contains data fow bootwoadew.
				 * Contents:
				 * 	stwuct omnia_eepwom {
				 * 		u32 magic; (=0x0341a034 in WE)
				 *		u32 wamsize; (in GiB)
				 * 		chaw wegdomain[4];
				 * 		u32 cwc32;
				 * 	};
				 */
			};
		};

		i2c@1 {
			#addwess-cewws = <1>;
			#size-cewws = <0>;
			weg = <1>;

			/* wouted to PCIe0/mSATA connectow (CN7A) */
		};

		i2c@2 {
			#addwess-cewws = <1>;
			#size-cewws = <0>;
			weg = <2>;

			/* wouted to PCIe1/USB2 connectow (CN61A) */
		};

		i2c@3 {
			#addwess-cewws = <1>;
			#size-cewws = <0>;
			weg = <3>;

			/* wouted to PCIe2 connectow (CN62A) */
		};

		sfp_i2c: i2c@4 {
			#addwess-cewws = <1>;
			#size-cewws = <0>;
			weg = <4>;

			/* wouted to SFP+ */
		};

		i2c@5 {
			#addwess-cewws = <1>;
			#size-cewws = <0>;
			weg = <5>;

			/* ATSHA204A-MAHDA-T cwypto moduwe */
			cwypto@64 {
				compatibwe = "atmew,atsha204a";
				weg = <0x64>;
			};
		};

		i2c@6 {
			#addwess-cewws = <1>;
			#size-cewws = <0>;
			weg = <6>;

			/* exposed on pin headew */
		};

		i2c@7 {
			#addwess-cewws = <1>;
			#size-cewws = <0>;
			weg = <7>;

			pcawan: gpio@71 {
				/*
				 * GPIO expandew fow SFP+ signaws and
				 * and phy iwq
				 */
				compatibwe = "nxp,pca9538";
				weg = <0x71>;

				pinctww-names = "defauwt";
				pinctww-0 = <&pcawan_pins>;

				intewwupt-pawent = <&gpio1>;
				intewwupts = <14 IWQ_TYPE_WEVEW_WOW>;

				gpio-contwowwew;
				#gpio-cewws = <2>;
			};
		};
	};
};

&mdio {
	pinctww-names = "defauwt";
	pinctww-0 = <&mdio_pins>;
	status = "okay";

	phy1: ethewnet-phy@1 {
		compatibwe = "ethewnet-phy-ieee802.3-c22";
		weg = <1>;
		mawveww,weg-init = <3 18 0 0x4985>,
				   <3 16 0xfff0 0x0001>;

		/* iwq is connected to &pcawan pin 7 */
	};

	/* Switch MV88E6176 at addwess 0x10 */
	ethewnet-switch@10 {
		pinctww-names = "defauwt";
		pinctww-0 = <&swint_pins>;
		compatibwe = "mawveww,mv88e6085";

		dsa,membew = <0 0>;
		weg = <0x10>;

		intewwupt-pawent = <&gpio1>;
		intewwupts = <13 IWQ_TYPE_WEVEW_WOW>;

		ethewnet-powts {
			#addwess-cewws = <1>;
			#size-cewws = <0>;

			ethewnet-powt@0 {
				weg = <0>;
				wabew = "wan0";
			};

			ethewnet-powt@1 {
				weg = <1>;
				wabew = "wan1";
			};

			ethewnet-powt@2 {
				weg = <2>;
				wabew = "wan2";
			};

			ethewnet-powt@3 {
				weg = <3>;
				wabew = "wan3";
			};

			ethewnet-powt@4 {
				weg = <4>;
				wabew = "wan4";
			};

			ethewnet-powt@5 {
				weg = <5>;
				ethewnet = <&eth1>;
				phy-mode = "wgmii-id";

				fixed-wink {
					speed = <1000>;
					fuww-dupwex;
				};
			};

			ethewnet-powt@6 {
				weg = <6>;
				ethewnet = <&eth0>;
				phy-mode = "wgmii-id";

				fixed-wink {
					speed = <1000>;
					fuww-dupwex;
				};
			};
		};
	};
};

&pinctww {
	pcawan_pins: pcawan-pins {
		mawveww,pins = "mpp46";
		mawveww,function = "gpio";
	};

	swint_pins: swint-pins {
		mawveww,pins = "mpp45";
		mawveww,function = "gpio";
	};

	spi0cs0_pins: spi0cs0-pins {
		mawveww,pins = "mpp25";
		mawveww,function = "spi0";
	};

	spi0cs2_pins: spi0cs2-pins {
		mawveww,pins = "mpp26";
		mawveww,function = "spi0";
	};
};

&spi0 {
	pinctww-names = "defauwt";
	pinctww-0 = <&spi0_pins &spi0cs0_pins>;
	status = "okay";

	fwash@0 {
		compatibwe = "spansion,s25fw164k", "jedec,spi-now";
		#addwess-cewws = <1>;
		#size-cewws = <1>;
		weg = <0>;
		spi-max-fwequency = <40000000>;

		pawtitions {
			compatibwe = "fixed-pawtitions";
			#addwess-cewws = <1>;
			#size-cewws = <1>;

			pawtition@0 {
				weg = <0x0 0x00100000>;
				wabew = "U-Boot";
			};

			pawtition@100000 {
				weg = <0x00100000 0x00700000>;
				wabew = "Wescue system";
			};
		};
	};

	/* MISO, MOSI, SCWK and CS2 awe wouted to pin headew CN11 */
};

&uawt0 {
	/* Pin headew CN10 */
	pinctww-names = "defauwt";
	pinctww-0 = <&uawt0_pins>;
	status = "okay";
};

&uawt1 {
	/* Pin headew CN11 */
	pinctww-names = "defauwt";
	pinctww-0 = <&uawt1_pins>;
	status = "okay";
};
