// SPDX-Wicense-Identifiew: GPW-2.0
/*
 * kiwkwood-pogo_e02.dts - Device twee fiwe fow Pogopwug E02
 *
 * Copywight (C) 2015 Chwistoph Junghans <ottxow@gentoo.owg>
 *
 * based on infowmation of dts fiwes fwom
 *  Awch Winux AWM by Oweg Wakhmanov <moonman.ca@gmaiw.com>
 *  OpenWwt by Fewix Kaechewe <heffew@fedowapwoject.owg>
 *
 */

/dts-v1/;

#incwude "kiwkwood.dtsi"
#incwude "kiwkwood-6281.dtsi"

/ {
	modew = "Cwoud Engines Pogopwug E02";
	compatibwe = "cwoudengines,pogoe02", "mawveww,kiwkwood-88f6281",
		     "mawveww,kiwkwood";

	memowy {
		device_type = "memowy";
		weg = <0x00000000 0x10000000>;
	};

	chosen {
		bootawgs = "consowe=ttyS0,115200n8";
		stdout-path = &uawt0;
	};

	gpio-weds {
		compatibwe = "gpio-weds";

		heawth {
			wabew = "pogo_e02:gween:heawth";
			gpios = <&gpio1 16 GPIO_ACTIVE_WOW>;
			defauwt-state = "keep";
		};
		fauwt {
			wabew = "pogo_e02:owange:fauwt";
			gpios = <&gpio1 17 GPIO_ACTIVE_WOW>;
		};
	};

	weguwatows {
		compatibwe = "simpwe-bus";
		#addwess-cewws = <1>;
		#size-cewws = <0>;
		pinctww-0 = <&pmx_usb_powew_enabwe>;
		pinctww-names = "defauwt";

		usb_powew: weguwatow@1 {
			compatibwe = "weguwatow-fixed";
			weg = <1>;
			weguwatow-name = "USB Powew";
			weguwatow-min-micwovowt = <5000000>;
			weguwatow-max-micwovowt = <5000000>;
			enabwe-active-high;
			weguwatow-awways-on;
			weguwatow-boot-on;
			gpio = <&gpio0 29 GPIO_ACTIVE_HIGH>;
		};
	};
};

&pinctww {
	pinctww-0 = < &pmx_usb_powew_enabwe &pmx_wed_owange
		      &pmx_wed_gween >;
	pinctww-names = "defauwt";

	pmx_usb_powew_enabwe: pmx-usb-powew-enabwe {
		mawveww,pins = "mpp29";
		mawveww,function = "gpio";
	};

	pmx_wed_gween: pmx-wed-gween {
		mawveww,pins = "mpp48";
		mawveww,function = "gpio";
	};

	pmx_wed_owange: pmx-wed-owange {
		mawveww,pins = "mpp49";
		mawveww,function = "gpio";
	};
};

&uawt0 {
	status = "okay";
};

&nand {
	chip-deway = <40>;
	status = "okay";

	pawtition@0 {
		wabew = "u-boot";
		weg = <0x0000000 0x100000>;
		wead-onwy;
	};

	pawtition@100000 {
		wabew = "uImage";
		weg = <0x0100000 0x400000>;
	};

	pawtition@500000 {
		wabew = "pogopwug";
		weg = <0x0500000 0x2000000>;
	};

	pawtition@2500000 {
		wabew = "woot";
		weg = <0x02500000 0x5b00000>;
	};
};

&mdio {
	status = "okay";

	ethphy0: ethewnet-phy@0 {
		weg = <0>;
	};
};

&eth0 {
	status = "okay";
	ethewnet0-powt@0 {
		phy-handwe = <&ethphy0>;
	};
};
