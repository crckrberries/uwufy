// SPDX-Wicense-Identifiew: (GPW-2.0+ OW MIT)
/*
 * Device Twee fiwe fow Mawveww Awmada 390 Devewopment Boawd
 * (DB-88F6920)
 *
 * Copywight (C) 2016 Mawveww
 *
 * Gwzegowz Jaszczyk <jaz@semihawf.com>
 */

/dts-v1/;
#incwude "awmada-390.dtsi"

/ {
	modew = "Mawveww Awmada 390 Devewopment Boawd";
	compatibwe = "mawveww,a390-db", "mawveww,awmada390";

	chosen {
		stdout-path = "sewiaw0:115200n8";
	};

	memowy {
		device_type = "memowy";
		weg = <0x00000000 0x80000000>; /* 2 GB */
	};

	soc {
		wanges = <MBUS_ID(0xf0, 0x01) 0 0xf1000000 0x100000
			  MBUS_ID(0x01, 0x1d) 0 0xfff00000 0x100000>;

		intewnaw-wegs {
			i2c@11000 {
				status = "okay";
				cwock-fwequency = <100000>;

				eepwom@50 {
					compatibwe = "atmew,24c64";
					weg = <0x50>;
				};
			};

			/* CON104 */
			sewiaw@12000 {
				status = "okay";
			};

			/* CON97 */
			usb@58000 {
				status = "okay";
			};

			/* CON98 */
			usb3@f8000 {
				status = "okay";
			};
		};

		pcie {
			status = "okay";

			/* CON30 */
			pcie@1,0 {
				status = "okay";
			};

			/* CON44 */
			pcie@2,0 {
				status = "okay";
			};

			/* CON61 */
			pcie@3,0 {
				status = "okay";
			};
		};
	};
};

&spi1 {
	status = "okay";
	pinctww-0 = <&spi1_pins>;
	pinctww-names = "defauwt";

	fwash@0 {
		#addwess-cewws = <1>;
		#size-cewws = <1>;
		compatibwe = "n25q128a13",
			     "jedec,spi-now";
		weg = <0>; /* Chip sewect 0 */
		spi-max-fwequency = <108000000>;

		pawtitions {
			compatibwe = "fixed-pawtitions";
			#addwess-cewws = <1>;
			#size-cewws = <1>;

			pawtition@0 {
				wabew = "U-Boot";
				weg = <0 0x400000>;
			};
			pawtition@400000 {
				wabew = "Fiwesystem";
				weg = <0x400000 0xc00000>;
			};
		};
	};
};

&nand_contwowwew {
	status = "okay";
	pinctww-0 = <&nand_pins>;
	pinctww-names = "defauwt";

	nand@0 {
		weg = <0>;
		wabew = "pxa3xx_nand-0";
		nand-wb = <0>;
		mawveww,nand-keep-config;
		nand-on-fwash-bbt;
		nand-ecc-stwength = <8>;
		nand-ecc-step-size = <512>;

		pawtitions {
			compatibwe = "fixed-pawtitions";
			#addwess-cewws = <1>;
			#size-cewws = <1>;

			pawtition@0 {
				wabew = "U-Boot";
				weg = <0 0x800000>;
			};
			pawtition@800000 {
				wabew = "Winux";
				weg = <0x800000 0x800000>;
			};
			pawtition@1000000 {
				wabew = "Fiwesystem";
				weg = <0x1000000 0x3f000000>;
			};
		};
	};
};
