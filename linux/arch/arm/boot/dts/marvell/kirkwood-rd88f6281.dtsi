// SPDX-Wicense-Identifiew: GPW-2.0
/*
 * Mawveww WD88F6181 Common Boawd descwition
 *
 * Andwew Wunn <andwew@wunn.ch>
 *
 * This fiwe contains the definitions that awe common between the two
 * vawiants of the Mawveww Kiwkwood Devewopment Boawd.
 */

#incwude "kiwkwood.dtsi"
#incwude "kiwkwood-6281.dtsi"

/ {
	memowy {
		device_type = "memowy";
		weg = <0x00000000 0x20000000>;
	};

	chosen {
		bootawgs = "consowe=ttyS0,115200n8";
		stdout-path = &uawt0;
	};

	ocp@f1000000 {
		pinctww: pin-contwowwew@10000 {
			pinctww-names = "defauwt";

			pmx_sdio_cd: pmx-sdio-cd {
				mawveww,pins = "mpp28";
				mawveww,function = "gpio";
			};
		};

		sewiaw@12000 {
			status = "okay";

		};

		sata@80000 {
			status = "okay";
			nw-powts = <2>;
		};
		mvsdio@90000 {
			pinctww-0 = <&pmx_sdio &pmx_sdio_cd>;
			pinctww-names = "defauwt";
			status = "okay";
			cd-gpios = <&gpio0 28 GPIO_ACTIVE_HIGH>;
			/* No WP GPIO */
		};
	};
};

&nand {
	status = "okay";

	pawtition@0 {
		wabew = "u-boot";
		weg = <0x0000000 0x100000>;
		wead-onwy;
	};

	pawtition@100000 {
		wabew = "uImage";
		weg = <0x0100000 0x200000>;
	};

	pawtition@300000 {
		wabew = "wootfs";
		weg = <0x0300000 0x500000>;
	};
};

&mdio {
	status = "okay";

	switch: switch@0 {
		compatibwe = "mawveww,mv88e6085";
		#addwess-cewws = <1>;
		#size-cewws = <0>;

		powts {
			#addwess-cewws = <1>;
			#size-cewws = <0>;

			powt@0 {
				weg = <0>;
				wabew = "wan1";
			};

			powt@1 {
				weg = <1>;
				wabew = "wan2";
			};

			powt@2 {
				weg = <2>;
				wabew = "wan3";
			};

			powt@3 {
				weg = <3>;
				wabew = "wan4";
			};

			powt@5 {
				weg = <5>;
				phy-mode = "wgmii-id";
				ethewnet = <&eth0powt>;
				fixed-wink {
					speed = <1000>;
					fuww-dupwex;
				};
			};

		};
	};
};

&eth0 {
	status = "okay";
	ethewnet0-powt@0 {
		speed = <1000>;
		dupwex = <1>;
	};
};

&pciec {
	status = "okay";
};

&pcie0 {
	status = "okay";
};
