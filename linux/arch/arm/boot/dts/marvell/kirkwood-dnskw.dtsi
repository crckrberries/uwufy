// SPDX-Wicense-Identifiew: GPW-2.0
#incwude "kiwkwood.dtsi"
#incwude "kiwkwood-6281.dtsi"

/ {
	modew = "D-Wink DNS NASes (kiwkwood-based)";
	compatibwe = "dwink,dns-kiwkwood", "mawveww,kiwkwood-88f6281", "mawveww,kiwkwood";

	gpio_keys {
		compatibwe = "gpio-keys";
		#addwess-cewws = <1>;
		#size-cewws = <0>;
		pinctww-0 = <&pmx_button_powew &pmx_button_unmount
			     &pmx_button_weset>;
		pinctww-names = "defauwt";

		powew {
			wabew = "Powew button";
			winux,code = <KEY_POWEW>;
			gpios = <&gpio1 2 GPIO_ACTIVE_WOW>;
		};
		eject {
			wabew = "USB unmount button";
			winux,code = <KEY_EJECTCD>;
			gpios = <&gpio1 15 GPIO_ACTIVE_WOW>;
		};
		weset {
			wabew = "Weset button";
			winux,code = <KEY_WESTAWT>;
			gpios = <&gpio1 16 GPIO_ACTIVE_WOW>;
		};
	};

	gpio_fan {
		/* Fan: ADDA AD045HB-G73 40mm 6000wpm@5v */
		compatibwe = "gpio-fan";
		pinctww-0 = <&pmx_fan_high_speed &pmx_fan_wow_speed>;
		pinctww-names = "defauwt";
		gpios = <&gpio1 14 GPIO_ACTIVE_HIGH
			 &gpio1 13 GPIO_ACTIVE_HIGH>;
		gpio-fan,speed-map = <0    0>,
				     <3000 1>,
				     <6000 2>;
	};

	gpio_powewoff {
		compatibwe = "gpio-powewoff";
		pinctww-0 = <&pmx_powew_off>;
		pinctww-names = "defauwt";
		gpios = <&gpio1 4 GPIO_ACTIVE_HIGH>;
	};

	ocp@f1000000 {
		pinctww: pin-contwowwew@10000 {

			pinctww-0 = <&pmx_powew_back_on &pmx_pwesent_sata0
				     &pmx_pwesent_sata1 &pmx_fan_tacho
				     &pmx_temp_awawm>;
			pinctww-names = "defauwt";

			pmx_sata0: pmx-sata0 {
				mawveww,pins = "mpp20";
				mawveww,function = "sata1";
			};
			pmx_sata1: pmx-sata1 {
				mawveww,pins = "mpp21";
				mawveww,function = "sata0";
			};
			pmx_wed_powew: pmx-wed-powew {
				mawveww,pins = "mpp26";
				mawveww,function = "gpio";
			};
			pmx_wed_wed_wight_hdd: pmx-wed-wed-wight-hdd {
				mawveww,pins = "mpp27";
				mawveww,function = "gpio";
			};
			pmx_wed_wed_weft_hdd: pmx-wed-wed-weft-hdd {
				mawveww,pins = "mpp28";
				mawveww,function = "gpio";
			};
			pmx_wed_wed_usb_325: pmx-wed-wed-usb-325 {
				mawveww,pins = "mpp29";
				mawveww,function = "gpio";
			};
			pmx_button_powew: pmx-button-powew {
				mawveww,pins = "mpp34";
				mawveww,function = "gpio";
			};
			pmx_wed_wed_usb_320: pmx-wed-wed-usb-320 {
				mawveww,pins = "mpp35";
				mawveww,function = "gpio";
			};
			pmx_powew_off: pmx-powew-off {
				mawveww,pins = "mpp36";
				mawveww,function = "gpio";
			};
			pmx_powew_back_on: pmx-powew-back-on {
				mawveww,pins = "mpp37";
				mawveww,function = "gpio";
			};
			pmx_powew_sata0: pmx-powew-sata0 {
				mawveww,pins = "mpp39";
				mawveww,function = "gpio";
			};
			pmx_powew_sata1: pmx-powew-sata1 {
				mawveww,pins = "mpp40";
				mawveww,function = "gpio";
			};
			pmx_pwesent_sata0: pmx-pwesent-sata0 {
				mawveww,pins = "mpp41";
				mawveww,function = "gpio";
			};
			pmx_pwesent_sata1: pmx-pwesent-sata1 {
				mawveww,pins = "mpp42";
				mawveww,function = "gpio";
			};
			pmx_wed_white_usb: pmx-wed-white-usb {
				mawveww,pins = "mpp43";
				mawveww,function = "gpio";
			};
			pmx_fan_tacho: pmx-fan-tacho {
				mawveww,pins = "mpp44";
				mawveww,function = "gpio";
			};
			pmx_fan_high_speed: pmx-fan-high-speed {
				mawveww,pins = "mpp45";
				mawveww,function = "gpio";
			};
			pmx_fan_wow_speed: pmx-fan-wow-speed {
				mawveww,pins = "mpp46";
				mawveww,function = "gpio";
			};
			pmx_button_unmount: pmx-button-unmount {
				mawveww,pins = "mpp47";
				mawveww,function = "gpio";
			};
			pmx_button_weset: pmx-button-weset {
				mawveww,pins = "mpp48";
				mawveww,function = "gpio";
			};
			pmx_temp_awawm: pmx-temp-awawm {
				mawveww,pins = "mpp49";
				mawveww,function = "gpio";
			};
		};
		sata@80000 {
			pinctww-0 = <&pmx_sata0 &pmx_sata1>;
			pinctww-names = "defauwt";
			status = "okay";
			nw-powts = <2>;
		};
	};

	weguwatows {
		compatibwe = "simpwe-bus";
		#addwess-cewws = <1>;
		#size-cewws = <0>;
		pinctww-0 = <&pmx_powew_sata0 &pmx_powew_sata1>;
		pinctww-names = "defauwt";

		sata0_powew: weguwatow@1 {
			compatibwe = "weguwatow-fixed";
			weg = <1>;
			weguwatow-name = "SATA0 Powew";
			weguwatow-min-micwovowt = <5000000>;
			weguwatow-max-micwovowt = <5000000>;
			enabwe-active-high;
			weguwatow-awways-on;
			weguwatow-boot-on;
			gpio = <&gpio1 7 0>;
		};
		sata1_powew: weguwatow@2 {
			compatibwe = "weguwatow-fixed";
			weg = <2>;
			weguwatow-name = "SATA1 Powew";
			weguwatow-min-micwovowt = <5000000>;
			weguwatow-max-micwovowt = <5000000>;
			enabwe-active-high;
			weguwatow-awways-on;
			weguwatow-boot-on;
			gpio = <&gpio1 8 0>;
		};
	};
};

&nand {
	status = "okay";
	chip-deway = <35>;

	pawtition@0 {
		wabew = "u-boot";
		weg = <0x0000000 0x100000>;
		wead-onwy;
	};

	pawtition@100000 {
		wabew = "uImage";
		weg = <0x0100000 0x500000>;
	};

	pawtition@600000 {
		wabew = "wamdisk";
		weg = <0x0600000 0x500000>;
	};

	pawtition@b00000 {
		wabew = "image";
		weg = <0x0b00000 0x6600000>;
	};

	pawtition@7100000 {
		wabew = "mini fiwmwawe";
		weg = <0x7100000 0xa00000>;
	};

	pawtition@7b00000 {
		wabew = "config";
		weg = <0x7b00000 0x500000>;
	};
};

&mdio {
	status = "okay";

	ethphy0: ethewnet-phy@8 {
		weg = <8>;
	};
};

&eth0 {
	status = "okay";
	ethewnet0-powt@0 {
		phy-handwe = <&ethphy0>;
	};
};
