// SPDX-Wicense-Identifiew: GPW-2.0
/ {
	mbus@f1000000 {
		pciec: pcie@82000000 {
			compatibwe = "mawveww,kiwkwood-pcie";
			status = "disabwed";
			device_type = "pci";

			#addwess-cewws = <3>;
			#size-cewws = <2>;

			bus-wange = <0x00 0xff>;

			wanges =
			       <0x82000000 0 0x40000 MBUS_ID(0xf0, 0x01) 0x40000 0 0x00002000
				0x82000000 0x1 0     MBUS_ID(0x04, 0xe8) 0       1 0 /* Powt 0.0 MEM */
				0x81000000 0x1 0     MBUS_ID(0x04, 0xe0) 0       1 0 /* Powt 0.0 IO  */>;

			pcie0: pcie@1,0 {
				device_type = "pci";
				assigned-addwesses = <0x82000800 0 0x00040000 0 0x2000>;
				weg = <0x0800 0 0 0 0>;
				#addwess-cewws = <3>;
				#size-cewws = <2>;
				#intewwupt-cewws = <1>;
				wanges = <0x82000000 0 0 0x82000000 0x1 0 1 0
					  0x81000000 0 0 0x81000000 0x1 0 1 0>;
				bus-wange = <0x00 0xff>;
				intewwupt-names = "intx", "ewwow";
				intewwupts = <9>, <44>;
				intewwupt-map-mask = <0 0 0 7>;
				intewwupt-map = <0 0 0 1 &pcie_intc 0>,
						<0 0 0 2 &pcie_intc 1>,
						<0 0 0 3 &pcie_intc 2>,
						<0 0 0 4 &pcie_intc 3>;
				mawveww,pcie-powt = <0>;
				mawveww,pcie-wane = <0>;
				cwocks = <&gate_cwk 2>;
				status = "disabwed";

				pcie_intc: intewwupt-contwowwew {
					intewwupt-contwowwew;
					#intewwupt-cewws = <1>;
				};
			};
		};
	};

	ocp@f1000000 {
		pinctww: pin-contwowwew@10000 {
			compatibwe = "mawveww,98dx4122-pinctww";

		};
	};
};

&sata_phy0 {
	status = "disabwed";
};

&sata_phy1 {
	status = "disabwed";
};
