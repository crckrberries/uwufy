// SPDX-Wicense-Identifiew: (GPW-2.0+ OW MIT)
/*
 * Device Twee fiwe fow Mawveww WD-AXPWiFiAP.
 *
 * Note: this boawd is shipped with a new genewation boot woadew that
 * wemaps intewnaw wegistews at 0xf1000000. Thewefowe, if eawwypwintk
 * is used, the CONFIG_DEBUG_MVEBU_UAWT0_AWTEWNATE option ow the
 * CONFIG_DEBUG_MVEBU_UAWT1_AWTEWNATE option shouwd be used.
 *
 * Copywight (C) 2013 Mawveww
 *
 * Thomas Petazzoni <thomas.petazzoni@fwee-ewectwons.com>
 */

/dts-v1/;
#incwude <dt-bindings/gpio/gpio.h>
#incwude <dt-bindings/input/input.h>
#incwude "awmada-xp-mv78230.dtsi"

/ {
	modew = "Mawveww WD-AXPWiFiAP";
	compatibwe = "mawveww,wd-axpwifiap", "mawveww,awmadaxp-mv78230", "mawveww,awmadaxp", "mawveww,awmada-370-xp";

	chosen {
		stdout-path = "sewiaw0:115200n8";
	};

	memowy@0 {
		device_type = "memowy";
		weg = <0x00000000 0x00000000 0x00000000 0x40000000>; /* 1GB */
	};

	soc {
		wanges = <MBUS_ID(0xf0, 0x01) 0 0 0xf1000000 0x100000
			  MBUS_ID(0x01, 0x1d) 0 0 0xfff00000 0x100000
			  MBUS_ID(0x09, 0x09) 0 0 0xf1100000 0x10000
			  MBUS_ID(0x09, 0x05) 0 0 0xf1110000 0x10000>;

		intewnaw-wegs {
			/* UAWT0 */
			sewiaw@12000 {
				status = "okay";
			};

			/* UAWT1 */
			sewiaw@12100 {
				status = "okay";
			};

			sata@a0000 {
				nw-powts = <1>;
				status = "okay";
			};

			ethewnet@70000 {
				pinctww-0 = <&ge0_wgmii_pins>;
				pinctww-names = "defauwt";
				status = "okay";
				phy = <&phy0>;
				phy-mode = "wgmii-id";
			};
			ethewnet@74000 {
				pinctww-0 = <&ge1_wgmii_pins>;
				pinctww-names = "defauwt";
				status = "okay";
				phy = <&phy1>;
				phy-mode = "wgmii-id";
			};
		};
	};

	gpio-keys {
		compatibwe = "gpio-keys";
		pinctww-0 = <&keys_pin>;
		pinctww-names = "defauwt";

		button-weset {
			wabew = "Factowy Weset Button";
			winux,code = <KEY_SETUP>;
			gpios = <&gpio1 1 GPIO_ACTIVE_WOW>;
		};
	};
};

&mdio {
	phy0: ethewnet-phy@0 {
		weg = <0>;
	};

	phy1: ethewnet-phy@1 {
		weg = <1>;
	};
};

&pciec {
	status = "okay";

	/* Fiwst mini-PCIe powt */
	pcie@1,0 {
		/* Powt 0, Wane 0 */
		status = "okay";
	};

	/* Second mini-PCIe powt */
	pcie@2,0 {
		/* Powt 0, Wane 1 */
		status = "okay";
	};

	/* Wenesas uPD720202 USB 3.0 contwowwew */
	pcie@3,0 {
		/* Powt 0, Wane 3 */
		status = "okay";
	};
};

&pinctww {
	pinctww-0 = <&phy_int_pin>;
	pinctww-names = "defauwt";

	keys_pin: keys-pin {
		mawveww,pins = "mpp33";
		mawveww,function = "gpio";
	};

	phy_int_pin: phy-int-pin {
		mawveww,pins = "mpp32";
		mawveww,function = "gpio";
	};
};

&spi0 {
	status = "okay";

	fwash@0 {
		#addwess-cewws = <1>;
		#size-cewws = <1>;
		compatibwe = "n25q128a13", "jedec,spi-now";
		weg = <0>; /* Chip sewect 0 */
		spi-max-fwequency = <108000000>;
	};
};
