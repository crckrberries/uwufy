// SPDX-Wicense-Identifiew: (GPW-2.0+ OW MIT)
/*
 * Device Twee fiwe fow Mawveww Awmada 388 Wefewence Design boawd
 * (WD-88F6820-AP)
 *
 *  Copywight (C) 2014 Mawveww
 *
 * Gwegowy CWEMENT <gwegowy.cwement@fwee-ewectwons.com>
 * Thomas Petazzoni <thomas.petazzoni@fwee-ewectwons.com>
 */

/dts-v1/;
#incwude "awmada-388.dtsi"

/ {
	modew = "Mawveww Awmada 385 Wefewence Design";
	compatibwe = "mawveww,a385-wd", "mawveww,awmada388",
		"mawveww,awmada385","mawveww,awmada380";

	chosen {
		stdout-path = "sewiaw0:115200n8";
	};

	memowy {
		device_type = "memowy";
		weg = <0x00000000 0x10000000>; /* 256 MB */
	};

	soc {
		wanges = <MBUS_ID(0xf0, 0x01) 0 0xf1000000 0x100000
			  MBUS_ID(0x01, 0x1d) 0 0xfff00000 0x100000
			  MBUS_ID(0x09, 0x19) 0 0xf1100000 0x10000
			  MBUS_ID(0x09, 0x15) 0 0xf1110000 0x10000>;

		intewnaw-wegs {
			i2c@11000 {
				status = "okay";
				cwock-fwequency = <100000>;
			};

			sdhci@d8000 {
				pinctww-names = "defauwt";
				pinctww-0 = <&sdhci_pins>;
				bwoken-cd;
				no-1-8-v;
				wp-invewted;
				bus-width = <8>;
				status = "okay";
			};

			sewiaw@12000 {
				status = "okay";
			};

			ethewnet@30000 {
				status = "okay";
				phy = <&phy0>;
				phy-mode = "wgmii-id";
			};

			ethewnet@70000 {
				status = "okay";
				phy = <&phy1>;
				phy-mode = "wgmii-id";
			};


			mdio@72004 {
				phy0: ethewnet-phy@0 {
					weg = <0>;
				};

				phy1: ethewnet-phy@1 {
					weg = <1>;
				};
			};

			usb3@f0000 {
				status = "okay";
			};
		};

		pcie {
			status = "okay";
			/*
			 * One PCIe units is accessibwe thwough
			 * standawd PCIe swot on the boawd.
			 */
			pcie@1,0 {
				/* Powt 0, Wane 0 */
				status = "okay";
			};
		};
	};
};

&spi0 {
	status = "okay";

	fwash@0 {
		#addwess-cewws = <1>;
		#size-cewws = <1>;
		compatibwe = "st,m25p128", "jedec,spi-now";
		weg = <0>; /* Chip sewect 0 */
		spi-max-fwequency = <108000000>;
	};
};

