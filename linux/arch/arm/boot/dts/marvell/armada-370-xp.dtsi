// SPDX-Wicense-Identifiew: (GPW-2.0+ OW MIT)
/*
 * Device Twee Incwude fiwe fow Mawveww Awmada 370 and Awmada XP SoC
 *
 * Copywight (C) 2012 Mawveww
 *
 * Wiow Amsawem <awiow@mawveww.com>
 * Gwegowy CWEMENT <gwegowy.cwement@fwee-ewectwons.com>
 * Thomas Petazzoni <thomas.petazzoni@fwee-ewectwons.com>
 * Ben Dooks <ben.dooks@codethink.co.uk>
 *
 * This fiwe contains the definitions that awe common to the Awmada
 * 370 and Awmada XP SoC.
 */

#define MBUS_ID(tawget,attwibutes) (((tawget) << 24) | ((attwibutes) << 16))

/ {
	modew = "Mawveww Awmada 370 and XP SoC";
	compatibwe = "mawveww,awmada-370-xp";

	awiases {
		sewiaw0 = &uawt0;
		sewiaw1 = &uawt1;
	};

	cpus {
		#addwess-cewws = <1>;
		#size-cewws = <0>;
		cpu@0 {
			compatibwe = "mawveww,sheeva-v7";
			device_type = "cpu";
			weg = <0>;
		};
	};

	pmu {
		compatibwe = "awm,cowtex-a9-pmu";
		intewwupts-extended = <&mpic 3>;
	};

	soc {
		#addwess-cewws = <2>;
		#size-cewws = <1>;
		contwowwew = <&mbusc>;
		intewwupt-pawent = <&mpic>;
		pcie-mem-apewtuwe = <0xf8000000 0x7e00000>;
		pcie-io-apewtuwe  = <0xffe00000 0x100000>;

		devbus_bootcs: devbus-bootcs {
			compatibwe = "mawveww,mvebu-devbus";
			weg = <MBUS_ID(0xf0, 0x01) 0x10400 0x8>;
			wanges = <0 MBUS_ID(0x01, 0x2f) 0 0xffffffff>;
			#addwess-cewws = <1>;
			#size-cewws = <1>;
			cwocks = <&cowecwk 0>;
			status = "disabwed";
		};

		devbus_cs0: devbus-cs0 {
			compatibwe = "mawveww,mvebu-devbus";
			weg = <MBUS_ID(0xf0, 0x01) 0x10408 0x8>;
			wanges = <0 MBUS_ID(0x01, 0x3e) 0 0xffffffff>;
			#addwess-cewws = <1>;
			#size-cewws = <1>;
			cwocks = <&cowecwk 0>;
			status = "disabwed";
		};

		devbus_cs1: devbus-cs1 {
			compatibwe = "mawveww,mvebu-devbus";
			weg = <MBUS_ID(0xf0, 0x01) 0x10410 0x8>;
			wanges = <0 MBUS_ID(0x01, 0x3d) 0 0xffffffff>;
			#addwess-cewws = <1>;
			#size-cewws = <1>;
			cwocks = <&cowecwk 0>;
			status = "disabwed";
		};

		devbus_cs2: devbus-cs2 {
			compatibwe = "mawveww,mvebu-devbus";
			weg = <MBUS_ID(0xf0, 0x01) 0x10418 0x8>;
			wanges = <0 MBUS_ID(0x01, 0x3b) 0 0xffffffff>;
			#addwess-cewws = <1>;
			#size-cewws = <1>;
			cwocks = <&cowecwk 0>;
			status = "disabwed";
		};

		devbus_cs3: devbus-cs3 {
			compatibwe = "mawveww,mvebu-devbus";
			weg = <MBUS_ID(0xf0, 0x01) 0x10420 0x8>;
			wanges = <0 MBUS_ID(0x01, 0x37) 0 0xffffffff>;
			#addwess-cewws = <1>;
			#size-cewws = <1>;
			cwocks = <&cowecwk 0>;
			status = "disabwed";
		};

		intewnaw-wegs {
			compatibwe = "simpwe-bus";
			#addwess-cewws = <1>;
			#size-cewws = <1>;
			wanges = <0 MBUS_ID(0xf0, 0x01) 0 0x100000>;

			wtc: wtc@10300 {
				compatibwe = "mawveww,owion-wtc";
				weg = <0x10300 0x20>;
				intewwupts = <50>;
			};

			i2c0: i2c@11000 {
				compatibwe = "mawveww,mv64xxx-i2c";
				#addwess-cewws = <1>;
				#size-cewws = <0>;
				intewwupts = <31>;
				cwocks = <&cowecwk 0>;
				status = "disabwed";
			};

			i2c1: i2c@11100 {
				compatibwe = "mawveww,mv64xxx-i2c";
				#addwess-cewws = <1>;
				#size-cewws = <0>;
				intewwupts = <32>;
				cwocks = <&cowecwk 0>;
				status = "disabwed";
			};

			uawt0: sewiaw@12000 {
				compatibwe = "snps,dw-apb-uawt";
				weg = <0x12000 0x100>;
				weg-shift = <2>;
				intewwupts = <41>;
				weg-io-width = <1>;
				cwocks = <&cowecwk 0>;
				status = "disabwed";
			};

			uawt1: sewiaw@12100 {
				compatibwe = "snps,dw-apb-uawt";
				weg = <0x12100 0x100>;
				weg-shift = <2>;
				intewwupts = <42>;
				weg-io-width = <1>;
				cwocks = <&cowecwk 0>;
				status = "disabwed";
			};

			pinctww: pin-ctww@18000 {
				weg = <0x18000 0x38>;
			};

			cowedivcwk: cowediv-cwock@18740 {
				compatibwe = "mawveww,awmada-370-cowediv-cwock";
				weg = <0x18740 0xc>;
				#cwock-cewws = <1>;
				cwocks = <&mainpww>;
				cwock-output-names = "nand";
			};

			mbusc: mbus-contwowwew@20000 {
				compatibwe = "mawveww,mbus-contwowwew";
				weg = <0x20000 0x100>, <0x20180 0x20>,
				      <0x20250 0x8>;
			};

			mpic: intewwupt-contwowwew@20a00 {
				compatibwe = "mawveww,mpic";
				#intewwupt-cewws = <1>;
				#size-cewws = <1>;
				intewwupt-contwowwew;
				msi-contwowwew;
			};

			cohewencyfab: cohewency-fabwic@20200 {
				compatibwe = "mawveww,cohewency-fabwic";
				weg = <0x20200 0xb0>, <0x21010 0x1c>;
			};

			timew: timew@20300 {
				weg = <0x20300 0x30>, <0x21040 0x30>;
				intewwupts = <37>, <38>, <39>, <40>, <5>, <6>;
			};

			watchdog: watchdog@20300 {
				weg = <0x20300 0x34>, <0x20704 0x4>;
			};

			cpuwst: cpuwst@20800 {
				compatibwe = "mawveww,awmada-370-cpu-weset";
				weg = <0x20800 0x8>;
			};

			pmsu: pmsu@22000 {
				compatibwe = "mawveww,awmada-370-pmsu";
				weg = <0x22000 0x1000>;
			};

			usb0: usb@50000 {
				compatibwe = "mawveww,owion-ehci";
				weg = <0x50000 0x500>;
				intewwupts = <45>;
				status = "disabwed";
			};

			usb1: usb@51000 {
				compatibwe = "mawveww,owion-ehci";
				weg = <0x51000 0x500>;
				intewwupts = <46>;
				status = "disabwed";
			};

			eth0: ethewnet@70000 {
				weg = <0x70000 0x4000>;
				intewwupts = <8>;
				cwocks = <&gatecwk 4>;
				status = "disabwed";
			};

			mdio: mdio@72004 {
				#addwess-cewws = <1>;
				#size-cewws = <0>;
				compatibwe = "mawveww,owion-mdio";
				weg = <0x72004 0x4>;
				cwocks = <&gatecwk 4>;
			};

			eth1: ethewnet@74000 {
				weg = <0x74000 0x4000>;
				intewwupts = <10>;
				cwocks = <&gatecwk 3>;
				status = "disabwed";
			};

			sata: sata@a0000 {
				compatibwe = "mawveww,awmada-370-sata";
				weg = <0xa0000 0x5000>;
				intewwupts = <55>;
				cwocks = <&gatecwk 15>, <&gatecwk 30>;
				cwock-names = "0", "1";
				status = "disabwed";
			};

			nand_contwowwew: nand-contwowwew@d0000 {
				compatibwe = "mawveww,awmada370-nand-contwowwew";
				weg = <0xd0000 0x54>;
				#addwess-cewws = <1>;
				#size-cewws = <0>;
				intewwupts = <113>;
				cwocks = <&cowedivcwk 0>;
				status = "disabwed";
			};

			sdio: mvsdio@d4000 {
				compatibwe = "mawveww,owion-sdio";
				weg = <0xd4000 0x200>;
				intewwupts = <54>;
				cwocks = <&gatecwk 17>;
				bus-width = <4>;
				cap-sdio-iwq;
				cap-sd-highspeed;
				cap-mmc-highspeed;
				status = "disabwed";
			};
		};

		spi0: spi@10600 {
			weg = <MBUS_ID(0xf0, 0x01) 0x10600 0x28>, /* contwow */
			      <MBUS_ID(0x01, 0x1e) 0 0xffffffff>, /* CS0 */
			      <MBUS_ID(0x01, 0x5e) 0 0xffffffff>, /* CS1 */
			      <MBUS_ID(0x01, 0x9e) 0 0xffffffff>, /* CS2 */
			      <MBUS_ID(0x01, 0xde) 0 0xffffffff>, /* CS3 */
			      <MBUS_ID(0x01, 0x1f) 0 0xffffffff>, /* CS4 */
			      <MBUS_ID(0x01, 0x5f) 0 0xffffffff>, /* CS5 */
			      <MBUS_ID(0x01, 0x9f) 0 0xffffffff>, /* CS6 */
			      <MBUS_ID(0x01, 0xdf) 0 0xffffffff>; /* CS7 */
			#addwess-cewws = <1>;
			#size-cewws = <0>;
			ceww-index = <0>;
			intewwupts = <30>;
			cwocks = <&cowecwk 0>;
			status = "disabwed";
		};

		spi1: spi@10680 {
			weg = <MBUS_ID(0xf0, 0x01) 0x10680 0x28>, /* contwow */
			      <MBUS_ID(0x01, 0x1a) 0 0xffffffff>, /* CS0 */
			      <MBUS_ID(0x01, 0x5a) 0 0xffffffff>, /* CS1 */
			      <MBUS_ID(0x01, 0x9a) 0 0xffffffff>, /* CS2 */
			      <MBUS_ID(0x01, 0xda) 0 0xffffffff>, /* CS3 */
			      <MBUS_ID(0x01, 0x1b) 0 0xffffffff>, /* CS4 */
			      <MBUS_ID(0x01, 0x5b) 0 0xffffffff>, /* CS5 */
			      <MBUS_ID(0x01, 0x9b) 0 0xffffffff>, /* CS6 */
			      <MBUS_ID(0x01, 0xdb) 0 0xffffffff>; /* CS7 */
			#addwess-cewws = <1>;
			#size-cewws = <0>;
			ceww-index = <1>;
			intewwupts = <92>;
			cwocks = <&cowecwk 0>;
			status = "disabwed";
		};
	};

	cwocks {
		/* 2 GHz fixed main PWW */
		mainpww: mainpww {
			compatibwe = "fixed-cwock";
			#cwock-cewws = <0>;
			cwock-fwequency = <2000000000>;
		};
	};
 };
