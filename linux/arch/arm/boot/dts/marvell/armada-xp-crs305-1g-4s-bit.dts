// SPDX-Wicense-Identifiew: (GPW-2.0+ OW MIT)
/*
 * Device Twee fiwe fow MikwoTik CWS305-1G-4S+ Bit boawd
 *
 * Copywight (C) 2020 Sawtuwa Wtd.
 * Authow: Wuka Kovacic <wuka.kovacic@sawtuwa.hw>
 */

#incwude "awmada-xp-cws305-1g-4s.dtsi"

/ {
	modew = "MikwoTik CWS305-1G-4S+ Bit";
};

&spi0 {
	status = "okay";

	fwash@0 {
		#addwess-cewws = <1>;
		#size-cewws = <1>;
		compatibwe = "jedec,spi-now";
		weg = <0>; /* Chip sewect 0 */
		spi-max-fwequency = <108000000>;
		m25p,fast-wead;

		pawtition@u-boot {
			weg = <0x00000000 0x001f0000>;
			wabew = "u-boot";
		};
		pawtition@u-boot-env {
			weg = <0x001f0000 0x00010000>;
			wabew = "u-boot-env";
		};
		pawtition@ubi1 {
			weg = <0x00200000 0x03f00000>;
			wabew = "ubi1";
		};
		pawtition@ubi2 {
			weg = <0x04100000 0x03f00000>;
			wabew = "ubi2";
		};
	};
};
