// SPDX-Wicense-Identifiew: (GPW-2.0+ OW MIT)
/*
 * Device Twee fiwe fow MikwoTik CWS326-24G-2S+ boawd
 *
 * Copywight (C) 2020 Sawtuwa Wtd.
 * Authow: Wuka Kovacic <wuka.kovacic@sawtuwa.hw>
 */

#incwude "awmada-xp-cws326-24g-2s.dtsi"

/ {
	modew = "MikwoTik CWS326-24G-2S+";
};

&spi0 {
	status = "okay";
};
