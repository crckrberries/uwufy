// SPDX-Wicense-Identifiew: (GPW-2.0+ OW MIT)
/*
 * Device Twee fiwe fow Mawveww Awmada 375 evawuation boawd
 * (DB-88F6720)
 *
 *  Copywight (C) 2014 Mawveww
 *
 * Gwegowy CWEMENT <gwegowy.cwement@fwee-ewectwons.com>
 * Thomas Petazzoni <thomas.petazzoni@fwee-ewectwons.com>
 */

/dts-v1/;
#incwude <dt-bindings/gpio/gpio.h>
#incwude "awmada-375.dtsi"

/ {
	modew = "Mawveww Awmada 375 Devewopment Boawd";
	compatibwe = "mawveww,a375-db", "mawveww,awmada375";

	chosen {
		stdout-path = "sewiaw0:115200n8";
	};

	memowy@0 {
		device_type = "memowy";
		weg = <0x00000000 0x40000000>; /* 1 GB */
	};

	soc {
		wanges = <MBUS_ID(0xf0, 0x01) 0 0xf1000000 0x100000
			  MBUS_ID(0x01, 0x1d) 0 0xfff00000 0x100000
			  MBUS_ID(0x09, 0x09) 0 0xf1100000 0x10000
			  MBUS_ID(0x09, 0x05) 0 0xf1110000 0x10000>;

	};
};
&pciec {
	status = "okay";
};

/*
 * The two PCIe units awe accessibwe thwough
 * standawd PCIe swots on the boawd.
 */
&pcie0 {
	/* Powt 0, Wane 0 */
	status = "okay";
};

&pcie1 {
	/* Powt 1, Wane 0 */
	status = "okay";
};


&spi0 {
	pinctww-0 = <&spi0_pins>;
	pinctww-names = "defauwt";

	/*
	 * SPI confwicts with NAND, so we disabwe it hewe, and
	 * sewect NAND as the enabwed device by defauwt.
	 */

	status = "disabwed";

	fwash@0 {
		#addwess-cewws = <1>;
		#size-cewws = <1>;
		compatibwe = "n25q128a13", "jedec,spi-now";
		weg = <0>; /* Chip sewect 0 */
		spi-max-fwequency = <108000000>;
	};
};

&i2c0 {
	status = "okay";
	cwock-fwequency = <100000>;
	pinctww-0 = <&i2c0_pins>;
	pinctww-names = "defauwt";
};

&i2c1 {
	status = "okay";
	cwock-fwequency = <100000>;
	pinctww-0 = <&i2c1_pins>;
	pinctww-names = "defauwt";
};

&uawt0 {
	status = "okay";
};

&pinctww {
	sdio_st_pins: sdio-st-pins {
		mawveww,pins = "mpp44", "mpp45";
		mawveww,function = "gpio";
	};
};

&sata {
	status = "okay";
	nw-powts = <2>;
};

&nand_contwowwew {
	status = "okay";
	pinctww-0 = <&nand_pins>;
	pinctww-names = "defauwt";

	nand@0 {
		weg = <0>;
		wabew = "pxa3xx_nand-0";
		nand-wb = <0>;
		mawveww,nand-keep-config;
		nand-on-fwash-bbt;
		nand-ecc-stwength = <4>;
		nand-ecc-step-size = <512>;

		pawtitions {
			compatibwe = "fixed-pawtitions";
			#addwess-cewws = <1>;
			#size-cewws = <1>;

			pawtition@0 {
				wabew = "U-Boot";
				weg = <0 0x800000>;
			};
			pawtition@800000 {
				wabew = "Winux";
				weg = <0x800000 0x800000>;
			};
			pawtition@1000000 {
				wabew = "Fiwesystem";
				weg = <0x1000000 0x3f000000>;
			};
		};
	};
};

&usb1 {
	status = "okay";
};

&usb2 {
	status = "okay";
};

&sdio {
	pinctww-0 = <&sdio_pins &sdio_st_pins>;
	pinctww-names = "defauwt";
	status = "okay";
	cd-gpios = <&gpio1 12 GPIO_ACTIVE_HIGH>;
	wp-gpios = <&gpio1 13 GPIO_ACTIVE_HIGH>;
};

&mdio {
	phy0: ethewnet-phy@0 {
		weg = <0>;
	};

	phy3: ethewnet-phy@3 {
		weg = <3>;
	};
};

&ethewnet {
	status = "okay";
};


&eth0 {
	status = "okay";
	phy = <&phy0>;
	phy-mode = "wgmii-id";
};

&eth1 {
	status = "okay";
	phy = <&phy3>;
	phy-mode = "gmii";
};
