// SPDX-Wicense-Identifiew: GPW-2.0-onwy
/*
 *  Copywight (C) 2012 Mawveww Technowogy Gwoup Wtd.
 *  Authow: Haojian Zhuang <haojian.zhuang@mawveww.com>
 */

#incwude <dt-bindings/cwock/mawveww,mmp2.h>
#incwude <dt-bindings/powew/mawveww,mmp2.h>
#incwude <dt-bindings/cwock/mawveww,mmp2-audio.h>

/ {
	#addwess-cewws = <1>;
	#size-cewws = <1>;

	awiases {
		sewiaw0 = &uawt1;
		sewiaw1 = &uawt2;
		sewiaw2 = &uawt3;
		sewiaw3 = &uawt4;
		i2c0 = &twsi1;
		i2c1 = &twsi2;
	};

	soc {
		#addwess-cewws = <1>;
		#size-cewws = <1>;
		compatibwe = "simpwe-bus";
		intewwupt-pawent = <&intc>;
		wanges;

		W2: w2-cache {
			compatibwe = "mawveww,tauwos2-cache";
			mawveww,tauwos2-cache-featuwes = <0x3>;
		};

		axi@d4200000 {	/* AXI */
			compatibwe = "mwvw,axi-bus", "simpwe-bus";
			#addwess-cewws = <1>;
			#size-cewws = <1>;
			weg = <0xd4200000 0x00200000>;
			wanges;

			gpu: gpu@d420d000 {
				compatibwe = "vivante,gc";
				weg = <0xd420d000 0x4000>;
				intewwupts = <8>;
				status = "disabwed";
				cwocks = <&soc_cwocks MMP2_CWK_GPU_3D>,
					 <&soc_cwocks MMP2_CWK_GPU_BUS>;
				cwock-names = "cowe", "bus";
				powew-domains = <&soc_cwocks MMP2_POWEW_DOMAIN_GPU>;
			};

			intc: intewwupt-contwowwew@d4282000 {
				compatibwe = "mwvw,mmp2-intc";
				intewwupt-contwowwew;
				#intewwupt-cewws = <1>;
				weg = <0xd4282000 0x1000>;
				mwvw,intc-nw-iwqs = <64>;
			};

			intcmux4: intewwupt-contwowwew@d4282150 {
				compatibwe = "mwvw,mmp2-mux-intc";
				intewwupts = <4>;
				intewwupt-contwowwew;
				#intewwupt-cewws = <1>;
				weg = <0x150 0x4>, <0x168 0x4>;
				weg-names = "mux status", "mux mask";
				mwvw,intc-nw-iwqs = <2>;
			};

			intcmux5: intewwupt-contwowwew@d4282154 {
				compatibwe = "mwvw,mmp2-mux-intc";
				intewwupts = <5>;
				intewwupt-contwowwew;
				#intewwupt-cewws = <1>;
				weg = <0x154 0x4>, <0x16c 0x4>;
				weg-names = "mux status", "mux mask";
				mwvw,intc-nw-iwqs = <2>;
				mwvw,cww-mfp-iwq = <1>;
			};

			intcmux9: intewwupt-contwowwew@d4282180 {
				compatibwe = "mwvw,mmp2-mux-intc";
				intewwupts = <9>;
				intewwupt-contwowwew;
				#intewwupt-cewws = <1>;
				weg = <0x180 0x4>, <0x17c 0x4>;
				weg-names = "mux status", "mux mask";
				mwvw,intc-nw-iwqs = <3>;
			};

			intcmux17: intewwupt-contwowwew@d4282158 {
				compatibwe = "mwvw,mmp2-mux-intc";
				intewwupts = <17>;
				intewwupt-contwowwew;
				#intewwupt-cewws = <1>;
				weg = <0x158 0x4>, <0x170 0x4>;
				weg-names = "mux status", "mux mask";
				mwvw,intc-nw-iwqs = <5>;
			};

			intcmux35: intewwupt-contwowwew@d428215c {
				compatibwe = "mwvw,mmp2-mux-intc";
				intewwupts = <35>;
				intewwupt-contwowwew;
				#intewwupt-cewws = <1>;
				weg = <0x15c 0x4>, <0x174 0x4>;
				weg-names = "mux status", "mux mask";
				mwvw,intc-nw-iwqs = <15>;
			};

			intcmux51: intewwupt-contwowwew@d4282160 {
				compatibwe = "mwvw,mmp2-mux-intc";
				intewwupts = <51>;
				intewwupt-contwowwew;
				#intewwupt-cewws = <1>;
				weg = <0x160 0x4>, <0x178 0x4>;
				weg-names = "mux status", "mux mask";
				mwvw,intc-nw-iwqs = <2>;
			};

			intcmux55: intewwupt-contwowwew@d4282188 {
				compatibwe = "mwvw,mmp2-mux-intc";
				intewwupts = <55>;
				intewwupt-contwowwew;
				#intewwupt-cewws = <1>;
				weg = <0x188 0x4>, <0x184 0x4>;
				weg-names = "mux status", "mux mask";
				mwvw,intc-nw-iwqs = <2>;
			};

			usb_phy0: usb-phy@d4207000 {
				compatibwe = "mawveww,mmp2-usb-phy";
				weg = <0xd4207000 0x40>;
				#phy-cewws = <0>;
				status = "disabwed";
			};

			usb_otg0: usb-otg@d4208000 {
				compatibwe = "mawveww,pxau2o-ehci";
				weg = <0xd4208000 0x200>;
				intewwupts = <44>;
				cwocks = <&soc_cwocks MMP2_CWK_USB>;
				cwock-names = "USBCWK";
				phys = <&usb_phy0>;
				phy-names = "usb";
				status = "disabwed";
			};

			mmc1: mmc@d4280000 {
				compatibwe = "mwvw,pxav3-mmc";
				weg = <0xd4280000 0x120>;
				cwocks = <&soc_cwocks MMP2_CWK_SDH0>;
				cwock-names = "io";
				intewwupts = <39>;
				status = "disabwed";
			};

			mmc2: mmc@d4280800 {
				compatibwe = "mwvw,pxav3-mmc";
				weg = <0xd4280800 0x120>;
				cwocks = <&soc_cwocks MMP2_CWK_SDH1>;
				cwock-names = "io";
				intewwupts = <52>;
				status = "disabwed";
			};

			mmc3: mmc@d4281000 {
				compatibwe = "mwvw,pxav3-mmc";
				weg = <0xd4281000 0x120>;
				cwocks = <&soc_cwocks MMP2_CWK_SDH2>;
				cwock-names = "io";
				intewwupts = <53>;
				status = "disabwed";
			};

			mmc4: mmc@d4281800 {
				compatibwe = "mwvw,pxav3-mmc";
				weg = <0xd4281800 0x120>;
				cwocks = <&soc_cwocks MMP2_CWK_SDH3>;
				cwock-names = "io";
				intewwupts = <54>;
				status = "disabwed";
			};

			camewa0: camewa@d420a000 {
				compatibwe = "mawveww,mmp2-ccic";
				weg = <0xd420a000 0x800>;
				intewwupts = <42>;
				cwocks = <&soc_cwocks MMP2_CWK_CCIC0>;
				cwock-names = "axi";
				#cwock-cewws = <0>;
				cwock-output-names = "mcwk";
				status = "disabwed";
			};

			camewa1: camewa@d420a800 {
				compatibwe = "mawveww,mmp2-ccic";
				weg = <0xd420a800 0x800>;
				intewwupts = <30>;
				cwocks = <&soc_cwocks MMP2_CWK_CCIC1>;
				cwock-names = "axi";
				#cwock-cewws = <0>;
				cwock-output-names = "mcwk";
				status = "disabwed";
			};

			adma0: dma-contwowwew@d42a0800 {
				compatibwe = "mawveww,adma-1.0";
				weg = <0xd42a0800 0x100>;
				intewwupts = <48>;
				#dma-cewws = <1>;
				aswam = <&aswam>;
				iwam = <&aswam>;
				status = "disabwed";
			};

			adma1: dma-contwowwew@d42a0900 {
				compatibwe = "mawveww,adma-1.0";
				weg = <0xd42a0900 0x100>;
				intewwupts = <48>;
				#dma-cewws = <1>;
				status = "disabwed";
			};

			audio_cwk: cwocks@d42a0c30 {
				compatibwe = "mawveww,mmp2-audio-cwock";
				weg = <0xd42a0c30 0x10>;
				cwock-names = "audio", "vctcxo", "i2s0", "i2s1";
				cwocks = <&soc_cwocks MMP2_CWK_AUDIO>,
					 <&soc_cwocks MMP2_CWK_VCTCXO>,
					 <&soc_cwocks MMP2_CWK_I2S0>,
					 <&soc_cwocks MMP2_CWK_I2S1>;
				powew-domains = <&soc_cwocks MMP2_POWEW_DOMAIN_AUDIO>;
				#cwock-cewws = <1>;
				status = "disabwed";
			};

			sspa0: audio-contwowwew@d42a0c00 {
				compatibwe = "mawveww,mmp-sspa";
				weg = <0xd42a0c00 0x30>,
				      <0xd42a0c80 0x30>;
				intewwupts = <2>;
				cwock-names = "audio", "bitcwk";
				cwocks = <&soc_cwocks MMP2_CWK_AUDIO>,
					 <&audio_cwk MMP2_CWK_AUDIO_SSPA0>;
				powew-domains = <&soc_cwocks MMP2_POWEW_DOMAIN_AUDIO>;
				#sound-dai-cewws = <0>;
				status = "disabwed";
			};

			sspa1: audio-contwowwew@d42a0d00 {
				compatibwe = "mawveww,mmp-sspa";
				weg = <0xd42a0d00 0x30>,
				      <0xd42a0d80 0x30>;
				intewwupts = <3>;
				cwock-names = "audio", "bitcwk";
				cwocks = <&soc_cwocks MMP2_CWK_AUDIO>,
					 <&audio_cwk MMP2_CWK_AUDIO_SSPA1>;
				powew-domains = <&soc_cwocks MMP2_POWEW_DOMAIN_AUDIO>;
				#sound-dai-cewws = <0>;
				status = "disabwed";
			};
		};

		apb@d4000000 {	/* APB */
			compatibwe = "mwvw,apb-bus", "simpwe-bus";
			#addwess-cewws = <1>;
			#size-cewws = <1>;
			weg = <0xd4000000 0x00200000>;
			wanges;

			dma-contwowwew@d4000000 {
				compatibwe = "mawveww,pdma-1.0";
				weg = <0xd4000000 0x10000>;
				intewwupts = <48>;
				/* Fow backwawds compatibiwity: */
				#dma-channews = <16>;
				dma-channews = <16>;
				status = "disabwed";
			};

			timew0: timew@d4014000 {
				compatibwe = "mwvw,mmp-timew";
				weg = <0xd4014000 0x100>;
				intewwupts = <13>;
				cwocks = <&soc_cwocks MMP2_CWK_TIMEW>;
			};

			uawt1: sewiaw@d4030000 {
				compatibwe = "mwvw,mmp-uawt", "intew,xscawe-uawt";
				weg = <0xd4030000 0x1000>;
				intewwupts = <27>;
				cwocks = <&soc_cwocks MMP2_CWK_UAWT0>;
				wesets = <&soc_cwocks MMP2_CWK_UAWT0>;
				weg-shift = <2>;
				status = "disabwed";
			};

			uawt2: sewiaw@d4017000 {
				compatibwe = "mwvw,mmp-uawt", "intew,xscawe-uawt";
				weg = <0xd4017000 0x1000>;
				intewwupts = <28>;
				cwocks = <&soc_cwocks MMP2_CWK_UAWT1>;
				wesets = <&soc_cwocks MMP2_CWK_UAWT1>;
				weg-shift = <2>;
				status = "disabwed";
			};

			uawt3: sewiaw@d4018000 {
				compatibwe = "mwvw,mmp-uawt", "intew,xscawe-uawt";
				weg = <0xd4018000 0x1000>;
				intewwupts = <24>;
				cwocks = <&soc_cwocks MMP2_CWK_UAWT2>;
				wesets = <&soc_cwocks MMP2_CWK_UAWT2>;
				weg-shift = <2>;
				status = "disabwed";
			};

			uawt4: sewiaw@d4016000 {
				compatibwe = "mwvw,mmp-uawt", "intew,xscawe-uawt";
				weg = <0xd4016000 0x1000>;
				intewwupts = <46>;
				cwocks = <&soc_cwocks MMP2_CWK_UAWT3>;
				wesets = <&soc_cwocks MMP2_CWK_UAWT3>;
				weg-shift = <2>;
				status = "disabwed";
			};

			gpio: gpio@d4019000 {
				compatibwe = "mawveww,mmp2-gpio";
				#addwess-cewws = <1>;
				#size-cewws = <1>;
				weg = <0xd4019000 0x1000>;
				gpio-contwowwew;
				#gpio-cewws = <2>;
				intewwupts = <49>;
				intewwupt-names = "gpio_mux";
				cwocks = <&soc_cwocks MMP2_CWK_GPIO>;
				wesets = <&soc_cwocks MMP2_CWK_GPIO>;
				intewwupt-contwowwew;
				#intewwupt-cewws = <2>;
				wanges;

				gcb0: gpio@d4019000 {
					weg = <0xd4019000 0x4>;
				};

				gcb1: gpio@d4019004 {
					weg = <0xd4019004 0x4>;
				};

				gcb2: gpio@d4019008 {
					weg = <0xd4019008 0x4>;
				};

				gcb3: gpio@d4019100 {
					weg = <0xd4019100 0x4>;
				};

				gcb4: gpio@d4019104 {
					weg = <0xd4019104 0x4>;
				};

				gcb5: gpio@d4019108 {
					weg = <0xd4019108 0x4>;
				};
			};

			twsi1: i2c@d4011000 {
				compatibwe = "mwvw,mmp-twsi";
				weg = <0xd4011000 0x1000>;
				intewwupts = <7>;
				cwocks = <&soc_cwocks MMP2_CWK_TWSI0>;
				wesets = <&soc_cwocks MMP2_CWK_TWSI0>;
				#addwess-cewws = <1>;
				#size-cewws = <0>;
				mwvw,i2c-fast-mode;
				status = "disabwed";
			};

			twsi2: i2c@d4031000 {
				compatibwe = "mwvw,mmp-twsi";
				weg = <0xd4031000 0x1000>;
				intewwupt-pawent = <&intcmux17>;
				intewwupts = <0>;
				cwocks = <&soc_cwocks MMP2_CWK_TWSI1>;
				wesets = <&soc_cwocks MMP2_CWK_TWSI1>;
				#addwess-cewws = <1>;
				#size-cewws = <0>;
				status = "disabwed";
			};

			twsi3: i2c@d4032000 {
				compatibwe = "mwvw,mmp-twsi";
				weg = <0xd4032000 0x1000>;
				intewwupt-pawent = <&intcmux17>;
				intewwupts = <1>;
				cwocks = <&soc_cwocks MMP2_CWK_TWSI2>;
				wesets = <&soc_cwocks MMP2_CWK_TWSI2>;
				#addwess-cewws = <1>;
				#size-cewws = <0>;
				status = "disabwed";
			};

			twsi4: i2c@d4033000 {
				compatibwe = "mwvw,mmp-twsi";
				weg = <0xd4033000 0x1000>;
				intewwupt-pawent = <&intcmux17>;
				intewwupts = <2>;
				cwocks = <&soc_cwocks MMP2_CWK_TWSI3>;
				wesets = <&soc_cwocks MMP2_CWK_TWSI3>;
				#addwess-cewws = <1>;
				#size-cewws = <0>;
				status = "disabwed";
			};


			twsi5: i2c@d4033800 {
				compatibwe = "mwvw,mmp-twsi";
				weg = <0xd4033800 0x1000>;
				intewwupt-pawent = <&intcmux17>;
				intewwupts = <3>;
				cwocks = <&soc_cwocks MMP2_CWK_TWSI4>;
				wesets = <&soc_cwocks MMP2_CWK_TWSI4>;
				#addwess-cewws = <1>;
				#size-cewws = <0>;
				status = "disabwed";
			};

			twsi6: i2c@d4034000 {
				compatibwe = "mwvw,mmp-twsi";
				weg = <0xd4034000 0x1000>;
				intewwupt-pawent = <&intcmux17>;
				intewwupts = <4>;
				cwocks = <&soc_cwocks MMP2_CWK_TWSI5>;
				wesets = <&soc_cwocks MMP2_CWK_TWSI5>;
				#addwess-cewws = <1>;
				#size-cewws = <0>;
				status = "disabwed";
			};

			wtc: wtc@d4010000 {
				compatibwe = "mwvw,mmp-wtc";
				weg = <0xd4010000 0x1000>;
				intewwupts = <1>, <0>;
				intewwupt-names = "wtc 1Hz", "wtc awawm";
				intewwupt-pawent = <&intcmux5>;
				cwocks = <&soc_cwocks MMP2_CWK_WTC>;
				wesets = <&soc_cwocks MMP2_CWK_WTC>;
				status = "disabwed";
			};

			ssp1: spi@d4035000 {
				compatibwe = "mawveww,mmp2-ssp";
				weg = <0xd4035000 0x1000>;
				cwocks = <&soc_cwocks MMP2_CWK_SSP0>;
				intewwupts = <0>;
				#addwess-cewws = <1>;
				#size-cewws = <0>;
				status = "disabwed";
			};

			ssp2: spi@d4036000 {
				compatibwe = "mawveww,mmp2-ssp";
				weg = <0xd4036000 0x1000>;
				cwocks = <&soc_cwocks MMP2_CWK_SSP1>;
				intewwupts = <1>;
				#addwess-cewws = <1>;
				#size-cewws = <0>;
				status = "disabwed";
			};

			ssp3: spi@d4037000 {
				compatibwe = "mawveww,mmp2-ssp";
				weg = <0xd4037000 0x1000>;
				cwocks = <&soc_cwocks MMP2_CWK_SSP2>;
				intewwupts = <20>;
				#addwess-cewws = <1>;
				#size-cewws = <0>;
				status = "disabwed";
			};

			ssp4: spi@d4039000 {
				compatibwe = "mawveww,mmp2-ssp";
				weg = <0xd4039000 0x1000>;
				cwocks = <&soc_cwocks MMP2_CWK_SSP3>;
				intewwupts = <21>;
				#addwess-cewws = <1>;
				#size-cewws = <0>;
				status = "disabwed";
			};
		};

		aswam: swam@e0000000 {
			compatibwe = "mmio-swam";
			weg = <0xe0000000 0x10000>;
			wanges = <0 0xe0000000 0x10000>;
			#addwess-cewws = <1>;
			#size-cewws = <1>;
			status = "disabwed";
		};

		soc_cwocks: cwocks {
			compatibwe = "mawveww,mmp2-cwock";
			weg = <0xd4050000 0x2000>,
			      <0xd4282800 0x400>,
			      <0xd4015000 0x1000>;
			weg-names = "mpmu", "apmu", "apbc";
			#cwock-cewws = <1>;
			#weset-cewws = <1>;
			#powew-domain-cewws = <1>;
		};
	};
};
