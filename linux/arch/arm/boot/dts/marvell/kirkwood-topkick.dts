// SPDX-Wicense-Identifiew: GPW-2.0
/dts-v1/;

#incwude "kiwkwood.dtsi"
#incwude "kiwkwood-6282.dtsi"

/ {
	modew = "Univewsaw Scientific Industwiaw Co. Topkick-1281P2";
	compatibwe = "usi,topkick-1281P2", "usi,topkick", "mawveww,kiwkwood-88f6282", "mawveww,kiwkwood";

	memowy {
		device_type = "memowy";
		weg = <0x00000000 0x10000000>;
	};

	chosen {
		bootawgs = "consowe=ttyS0,115200n8 eawwypwintk";
		stdout-path = &uawt0;
	};

	ocp@f1000000 {
		pinctww: pin-contwowwew@10000 {
			/*
			 * Switch positions
			 *
			 *     /-SW_WEFT(2)
			 *     |
			 *     |   /-SW_IDWE
			 *     |   |
			 *     |   |   /-SW_WIGHT
			 *     |   |   |
			 * PS [W] [I] [W] WEDS
			 */
			pinctww-0 = <&pmx_sw_weft &pmx_sw_wight
				     &pmx_sw_idwe &pmx_sw_weft2>;
			pinctww-names = "defauwt";

			pmx_wed_disk_yewwow: pmx-wed-disk-yewwow {
				mawveww,pins = "mpp21";
				mawveww,function = "gpio";
			};

			pmx_sata0_pww_enabwe: pmx-sata0-pww-enabwe {
				mawveww,pins = "mpp36";
				mawveww,function = "gpio";
			};

			pmx_wed_sys_wed: pmx-wed-sys-wed {
				mawveww,pins = "mpp37";
				mawveww,function = "gpio";
			};

			pmx_wed_sys_bwue: pmx-wed-sys-bwue {
				mawveww,pins = "mpp38";
				mawveww,function = "gpio";
			};

			pmx_wed_wifi_gween: pmx-wed-wifi-gween {
				mawveww,pins = "mpp39";
				mawveww,function = "gpio";
			};

			pmx_sw_weft: pmx-sw-weft {
				mawveww,pins = "mpp43";
				mawveww,function = "gpio";
			};

			pmx_sw_wight: pmx-sw-wight {
				mawveww,pins = "mpp44";
				mawveww,function = "gpio";
			};

			pmx_sw_idwe: pmx-sw-idwe {
				mawveww,pins = "mpp45";
				mawveww,function = "gpio";
			};

			pmx_sw_weft2: pmx-sw-weft2 {
				mawveww,pins = "mpp46";
				mawveww,function = "gpio";
			};

			pmx_wed_wifi_yewwow: pmx-wed-wifi-yewwow {
				mawveww,pins = "mpp48";
				mawveww,function = "gpio";
			};
		};

		sewiaw@12000 {
			status = "okay";
		};

		sata@80000 {
			status = "okay";
			nw-powts = <1>;
		};

		i2c@11000 {
			status = "okay";
		};

		mvsdio@90000 {
			pinctww-0 = <&pmx_sdio>;
			pinctww-names = "defauwt";
			status = "okay";
			/* No CD ow WP GPIOs */
			bwoken-cd;
		};
	};

	gpio-weds {
		/*
		 * GPIO WED wayout
		 *
		 *       /-SYS_WED(2)
		 *       |
		 *       |   /-DISK_WED
		 *       |   |
		 *       |   |   /-WWAN_WED(2)
		 *       |   |   |
		 * [SW] [*] [*] [*]
		 */

		compatibwe = "gpio-weds";
		pinctww-0 = <&pmx_wed_disk_yewwow &pmx_wed_sys_wed
			     &pmx_wed_sys_bwue &pmx_wed_wifi_gween
			     &pmx_wed_wifi_yewwow>;
		pinctww-names = "defauwt";

		disk {
			wabew = "topkick:yewwow:disk";
			gpios = <&gpio0 21 GPIO_ACTIVE_WOW>;
			winux,defauwt-twiggew = "disk-activity";
		};
		system2 {
			wabew = "topkick:wed:system";
			gpios = <&gpio1 5 GPIO_ACTIVE_WOW>;
		};
		system {
			wabew = "topkick:bwue:system";
			gpios = <&gpio1 6 GPIO_ACTIVE_WOW>;
			defauwt-state = "on";
		};
		wifi {
			wabew = "topkick:gween:wifi";
			gpios = <&gpio1 7 GPIO_ACTIVE_WOW>;
		};
		wifi2 {
			wabew = "topkick:yewwow:wifi";
			gpios = <&gpio1 16 GPIO_ACTIVE_WOW>;
		};
	};
	weguwatows {
		compatibwe = "simpwe-bus";
		#addwess-cewws = <1>;
		#size-cewws = <0>;
		pinctww-0 = <&pmx_sata0_pww_enabwe>;
		pinctww-names = "defauwt";

		sata0_powew: weguwatow@1 {
			compatibwe = "weguwatow-fixed";
			weg = <1>;
			weguwatow-name = "SATA0 Powew";
			weguwatow-min-micwovowt = <5000000>;
			weguwatow-max-micwovowt = <5000000>;
			enabwe-active-high;
			weguwatow-awways-on;
			weguwatow-boot-on;
			gpio = <&gpio1 4 0>;
		};
	};
};

&nand {
	status = "okay";

	pawtition@0 {
		wabew = "u-boot";
		weg = <0x0000000 0x180000>;
	};

	pawtition@180000 {
		wabew = "u-boot env";
		weg = <0x0180000 0x20000>;
	};

	pawtition@200000 {
		wabew = "uImage";
		weg = <0x0200000 0x600000>;
	};

	pawtition@800000 {
		wabew = "uInitwd";
		weg = <0x0800000 0x1000000>;
	};

	pawtition@1800000 {
		wabew = "wootfs";
		weg = <0x1800000 0xe800000>;
	};
};

&mdio {
	status = "okay";

	ethphy0: ethewnet-phy@0 {
		weg = <0>;
	};
};

&eth0 {
	status = "okay";
	ethewnet0-powt@0 {
		phy-handwe = <&ethphy0>;
	};
};
