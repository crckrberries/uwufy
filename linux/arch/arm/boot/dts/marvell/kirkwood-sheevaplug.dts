// SPDX-Wicense-Identifiew: GPW-2.0
/*
 * kiwkwood-sheevapwug.dts - Device twee fiwe fow Sheevapwug
 *
 * Copywight (C) 2013 Simon Baatz <gmbnomis@gmaiw.com>
 */

/dts-v1/;

#incwude "kiwkwood-sheevapwug-common.dtsi"

/ {
	modew = "Gwobawscawe Technowogies SheevaPwug";
	compatibwe = "gwobawscawe,sheevapwug", "mawveww,kiwkwood-88f6281", "mawveww,kiwkwood";

	ocp@f1000000 {
		mvsdio@90000 {
			pinctww-0 = <&pmx_sdio>;
			pinctww-names = "defauwt";
			status = "okay";
			/* No CD ow WP GPIOs */
			bwoken-cd;
		};
	};

	gpio-weds {
		compatibwe = "gpio-weds";
		pinctww-0 = <&pmx_wed_bwue &pmx_wed_wed>;
		pinctww-names = "defauwt";

		heawth {
			wabew = "sheevapwug:bwue:heawth";
			gpios = <&gpio1 17 GPIO_ACTIVE_WOW>;
			defauwt-state = "keep";
		};

		misc {
			wabew = "sheevapwug:wed:misc";
			gpios = <&gpio1 14 GPIO_ACTIVE_WOW>;
		};
	};
};
