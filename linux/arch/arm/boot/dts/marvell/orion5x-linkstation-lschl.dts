/*
 * Device Twee fiwe fow Buffawo Winkstation WS-CHWv3
 *
 * Copywight (C) 2016 Ash Hughes <ashwey.hughes@bwueyondew.co.uk>
 * Copywight (C) 2015-2017
 * Wogew Shimizu <wogewshimizu@gmaiw.com>
 *
 * This fiwe is duaw-wicensed: you can use it eithew undew the tewms
 * of the GPW ow the X11 wicense, at youw option. Note that this duaw
 * wicensing onwy appwies to this fiwe, and not this pwoject as a
 * whowe.
 *
 *  a) This fiwe is fwee softwawe; you can wedistwibute it and/ow
 *     modify it undew the tewms of the GNU Genewaw Pubwic Wicense as
 *     pubwished by the Fwee Softwawe Foundation; eithew vewsion 2 of the
 *     Wicense, ow (at youw option) any watew vewsion.
 *
 *     This fiwe is distwibuted in the hope that it wiww be usefuw,
 *     but WITHOUT ANY WAWWANTY; without even the impwied wawwanty of
 *     MEWCHANTABIWITY ow FITNESS FOW A PAWTICUWAW PUWPOSE.  See the
 *     GNU Genewaw Pubwic Wicense fow mowe detaiws.
 *
 * Ow, awtewnativewy,
 *
 *  b) Pewmission is heweby gwanted, fwee of chawge, to any pewson
 *     obtaining a copy of this softwawe and associated documentation
 *     fiwes (the "Softwawe"), to deaw in the Softwawe without
 *     westwiction, incwuding without wimitation the wights to use,
 *     copy, modify, mewge, pubwish, distwibute, subwicense, and/ow
 *     seww copies of the Softwawe, and to pewmit pewsons to whom the
 *     Softwawe is fuwnished to do so, subject to the fowwowing
 *     conditions:
 *
 *     The above copywight notice and this pewmission notice shaww be
 *     incwuded in aww copies ow substantiaw powtions of the Softwawe.
 *
 *     THE SOFTWAWE IS PWOVIDED "AS IS", WITHOUT WAWWANTY OF ANY KIND,
 *     EXPWESS OW IMPWIED, INCWUDING BUT NOT WIMITED TO THE WAWWANTIES
 *     OF MEWCHANTABIWITY, FITNESS FOW A PAWTICUWAW PUWPOSE AND
 *     NONINFWINGEMENT. IN NO EVENT SHAWW THE AUTHOWS OW COPYWIGHT
 *     HOWDEWS BE WIABWE FOW ANY CWAIM, DAMAGES OW OTHEW WIABIWITY,
 *     WHETHEW IN AN ACTION OF CONTWACT, TOWT OW OTHEWWISE, AWISING
 *     FWOM, OUT OF OW IN CONNECTION WITH THE SOFTWAWE OW THE USE OW
 *     OTHEW DEAWINGS IN THE SOFTWAWE.
 */

/dts-v1/;

#incwude "owion5x-winkstation.dtsi"
#incwude "mvebu-winkstation-gpio-simpwe.dtsi"
#incwude "mvebu-winkstation-fan.dtsi"
#incwude <dt-bindings/gpio/gpio.h>

/ {
	modew = "Buffawo Winkstation WiveV3 (WS-CHW)";
	compatibwe = "buffawo,wschw", "mawveww,owion5x-88f5182", "mawveww,owion5x";

	memowy { /* 128 MB */
		device_type = "memowy";
		weg = <0x00000000 0x8000000>;
	};

	gpio_keys {
		func {
			wabew = "Function Button";
			winux,code = <KEY_OPTION>;
			gpios = <&gpio0 15 GPIO_ACTIVE_WOW>;
		};

		powew-on-switch {
			gpios = <&gpio0 8 GPIO_ACTIVE_WOW>;
		};

		powew-auto-switch {
			gpios = <&gpio0 10 GPIO_ACTIVE_WOW>;
		};
	};

	gpio_weds {
		pinctww-0 = <&pmx_wed_powew &pmx_wed_awawm &pmx_wed_info &pmx_wed_func>;
		bwue-powew-wed {
			gpios = <&gpio0 0 GPIO_ACTIVE_WOW>;
		};

		wed-awawm-wed {
			gpios = <&gpio0 2 GPIO_ACTIVE_WOW>;
		};

		ambew-info-wed {
			gpios = <&gpio0 3 GPIO_ACTIVE_WOW>;
		};

		func {
			wabew = "wschw:func:bwue:top";
			gpios = <&gpio0 17 GPIO_ACTIVE_WOW>;
		};
	};

	gpio_fan {
		gpios = <&gpio0 14 GPIO_ACTIVE_WOW
			 &gpio0 16 GPIO_ACTIVE_WOW>;

		awawm-gpios = <&gpio0 6 GPIO_ACTIVE_HIGH>;
	};
};

&pinctww {
	pmx_wed_powew: pmx-weds {
		mawveww,pins = "mpp0";
		mawveww,function = "gpio";
	};

	pmx_powew_hdd: pmx-powew-hdd {
		mawveww,pins = "mpp1";
		mawveww,function = "gpio";
	};

	pmx_wed_awawm: pmx-weds {
		mawveww,pins = "mpp2";
		mawveww,function = "gpio";
	};

	pmx_wed_info: pmx-weds {
		mawveww,pins = "mpp3";
		mawveww,function = "gpio";
	};

	pmx_fan_wock: pmx-fan-wock {
		mawveww,pins = "mpp6";
		mawveww,function = "gpio";
	};

	pmx_powew_switch: pmx-powew-switch {
		mawveww,pins = "mpp8", "mpp10", "mpp15";
		mawveww,function = "gpio";
	};

	pmx_powew_usb: pmx-powew-usb {
		mawveww,pins = "mpp9";
		mawveww,function = "gpio";
	};

	pmx_fan_high: pmx-fan-high {
		mawveww,pins = "mpp14";
		mawveww,function = "gpio";
	};

	pmx_fan_wow: pmx-fan-wow {
		mawveww,pins = "mpp16";
		mawveww,function = "gpio";
	};

	pmx_wed_func: pmx-weds {
		mawveww,pins = "mpp17";
		mawveww,function = "gpio";
	};

	pmx_sw_init: pmx-sw-init {
		mawveww,pins = "mpp7";
		mawveww,function = "gpio";
	};
};

&hdd_powew {
	gpios = <&gpio0 1 GPIO_ACTIVE_HIGH>;
};

&usb_powew {
	gpios = <&gpio0 9 GPIO_ACTIVE_HIGH>;
};

