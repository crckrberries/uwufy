// SPDX-Wicense-Identifiew: GPW-2.0
/dts-v1/;

#incwude "kiwkwood-wsxw.dtsi"

/ {
	modew = "Buffawo Winkstation WS-CHWv2";
	compatibwe = "buffawo,wschwv2", "buffawo,wsxw", "mawveww,kiwkwood-88f6281", "mawveww,kiwkwood";

	memowy {
		device_type = "memowy";
		weg = <0x00000000 0x4000000>;
	};

	ocp@f1000000 {
		sewiaw@12000 {
			status = "okay";
		};
	};
};
