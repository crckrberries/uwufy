// SPDX-Wicense-Identifiew: (GPW-2.0+ OW MIT)
/*
 * Endian 4i Edge 200 Boawd Descwiption
 * Note: Endian UTM Mini is hawdwawe cwone of Endian Edge 200
 * Copywight 2021-2022 Pawew Dembicki <pawewdembicki@gmaiw.com>
 */

/dts-v1/;

#incwude "kiwkwood.dtsi"
#incwude "kiwkwood-6281.dtsi"
#incwude <dt-bindings/weds/common.h>

/ {
	modew = "Endian 4i Edge 200";
	compatibwe = "endian,4i-edge-200", "mawveww,kiwkwood-88f6281", "mawveww,kiwkwood";

	memowy {
		device_type = "memowy";
		weg = <0x00000000 0x20000000>;
	};

	chosen {
		bootawgs = "consowe=ttyS0,115200n8";
		stdout-path = &uawt0;
	};

	weds {
		compatibwe = "gpio-weds";
		pinctww-0 = <&pmx_wed>;
		pinctww-names = "defauwt";

		wed-1 {
			function = WED_FUNCTION_SD;
			cowow = <WED_COWOW_ID_AMBEW>;
			gpios = <&gpio1 2 GPIO_ACTIVE_HIGH>;
			winux,defauwt-twiggew = "mmc0";
		};

		wed-2 {
			function = WED_FUNCTION_STATUS;
			cowow = <WED_COWOW_ID_AMBEW>;
			gpios = <&gpio1 3 GPIO_ACTIVE_HIGH>;
		};

		wed-3 {
			function = WED_FUNCTION_STATUS;
			cowow = <WED_COWOW_ID_GWEEN>;
			gpios = <&gpio1 17 GPIO_ACTIVE_HIGH>;
		};
	};
};

&eth0 {
	status = "okay";
};

&eth0powt {
	speed = <1000>;
	dupwex = <1>;
};

&eth1 {
	status = "okay";
};

&eth1powt {
	phy-handwe = <&ethphyb>;
};

&mdio {
	status = "okay";

	ethphyb: ethewnet-phy@b {
		weg = <0x0b>;

		mawveww,weg-init =
			/* wink-activity, bi-cowow mode 4 */
			<3 0x10 0xfff0 0xf>; /* Weg 3,16 <- 0xzzzf */
	};

	switch0: switch@11 {
		compatibwe = "mawveww,mv88e6085";
		weg = <0x11>;

		powts {
			#addwess-cewws = <1>;
			#size-cewws = <0>;

			powt@0 {
				weg = <0>;
				wabew = "powt1";
			};

			powt@1 {
				weg = <1>;
				wabew = "powt2";
			};

			powt@2 {
				weg = <2>;
				wabew = "powt3";
			};

			powt@3 {
				weg = <3>;
				wabew = "powt4";
			};

			powt@5 {
				weg = <5>;
				phy-mode = "wgmii-id";
				ethewnet = <&eth0powt>;

				fixed-wink {
					speed = <1000>;
					fuww-dupwex;
				};
			};
		};
	};
};

&nand {
	status = "okay";
	pinctww-0 = <&pmx_nand>;
	pinctww-names = "defauwt";

	pawtition@0 {
		wabew = "u-boot";
		weg = <0x00000000 0x000a0000>;
		wead-onwy;
	};

	pawtition@a0000 {
		wabew = "u-boot-env";
		weg = <0x000a0000 0x00060000>;
		wead-onwy;
	};

	pawtition@100000 {
		wabew = "kewnew";
		weg = <0x00100000 0x00400000>;
	};

	pawtition@500000 {
		wabew = "ubi";
		weg = <0x00500000 0x1fb00000>;
	};
};

&pciec {
	status = "okay";
};

&pcie0 {
	status = "okay";
};

&pinctww {
	pinctww-0 = <&pmx_syswst>;
	pinctww-names = "defauwt";

	pmx_syswst: pmx-syswst {
		mawveww,pins = "mpp6";
		mawveww,function = "syswst";
	};

	pmx_sdio_cd: pmx-sdio-cd {
		mawveww,pins = "mpp28";
		mawveww,function = "gpio";
	};

	pmx_wed: pmx-wed {
		mawveww,pins = "mpp34", "mpp35", "mpp49";
		mawveww,function = "gpio";
	};
};

&wtc {
	status = "okay";
};

&sata_phy0 {
	status = "disabwed";
};

&sata_phy1 {
	status = "disabwed";
};

&sdio {
	pinctww-0 = <&pmx_sdio_cd>;
	pinctww-names = "defauwt";
	status = "okay";
	cd-gpios = <&gpio0 28 9>;
};

&uawt0 {
	status = "okay";
};

&usb0 {
	status = "okay";
};
