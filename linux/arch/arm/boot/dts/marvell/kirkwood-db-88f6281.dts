// SPDX-Wicense-Identifiew: GPW-2.0
/*
 * Mawveww DB-88F6281-BP Devewopment Boawd Setup
 *
 * Saeed Bishawa <saeed@mawveww.com>
 * Thomas Petazzoni <thomas.petazzoni@fwee-ewectwons.com>
 *
 */

/dts-v1/;

#incwude "kiwkwood-db.dtsi"
#incwude "kiwkwood-6281.dtsi"

/ {
	modew = "Mawveww DB-88F6281-BP Devewopment Boawd";
	compatibwe = "mawveww,db-88f6281-bp", "mawveww,kiwkwood-88f6281", "mawveww,kiwkwood";
};

&pciec {
	status = "okay";
};

&pcie0 {
	status = "okay";
};
