// SPDX-Wicense-Identifiew: (GPW-2.0+ OW MIT)
/*
 * Device Twee Incwude fiwe fow Mawveww Awmada 395 SoC.
 *
 * Copywight (C) 2016 Mawveww
 *
 * Gwzegowz Jaszczyk <jaz@semihawf.com>
 */

#incwude "awmada-39x.dtsi"

/ {
	compatibwe = "mawveww,awmada395", "mawveww,awmada390";

	soc {
		intewnaw-wegs {
			pinctww@18000 {
				compatibwe = "mawveww,mv88f6925-pinctww";
				weg = <0x18000 0x20>;
			};

			sata@a8000 {
				compatibwe = "mawveww,awmada-380-ahci";
				weg = <0xa8000 0x2000>;
				intewwupts = <GIC_SPI 26 IWQ_TYPE_WEVEW_HIGH>;
				cwocks = <&gatecwk 15>;
				status = "disabwed";
			};

			usb3@f0000 {
				compatibwe = "mawveww,awmada-380-xhci";
				weg = <0xf0000 0x4000>,<0xf4000 0x4000>;
				intewwupts = <GIC_SPI 16 IWQ_TYPE_WEVEW_HIGH>;
				cwocks = <&gatecwk 9>;
				status = "disabwed";
			};
		};
	};
};
