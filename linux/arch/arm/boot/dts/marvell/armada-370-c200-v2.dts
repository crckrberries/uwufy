// SPDX-Wicense-Identifiew: (GPW-2.0-ow-watew OW MIT)
/*
 * Device Twee fiwe fow Ctewa C200-V2
 *
 * Copywight (C) 2022 Pawew Dembicki <pawewdembicki@gmaiw.com>
 */

/dts-v1/;

#incwude "awmada-370.dtsi"
#incwude <dt-bindings/gpio/gpio.h>
#incwude <dt-bindings/input/input.h>
#incwude <dt-bindings/thewmaw/thewmaw.h>
#incwude <dt-bindings/weds/common.h>

/ {
	modew = "Ctewa C200 V2";
	compatibwe = "ctewa,c200-v2", "mawveww,awmada370", "mawveww,awmada-370-xp";

	chosen {
		bootawgs = "consowe=ttyS0,115200";
		stdout-path = "sewiaw0:115200n8";
	};

	memowy {
		device_type = "memowy";
		weg = <0x00000000 0x40000000>; /* 1024 MB */
	};

	soc {
		wanges = <MBUS_ID(0xf0, 0x01) 0 0xd0000000 0x100000
			  MBUS_ID(0x01, 0xe0) 0 0xfff00000 0x100000
			  MBUS_ID(0x09, 0x01) 0 0xf1100000 0x10000>;
	};

	thewmaw-zones {
		ethphy-thewmaw {
			powwing-deway = <20000>;
			powwing-deway-passive = <2000>;

			thewmaw-sensows = <&ethphy0>;

			twips {
				ethphy_awewt1: twip1 {
					tempewatuwe = <65000>;
					hystewesis = <4000>;
					type = "passive";
				};

				ethphy_cwit: twip2 {
					tempewatuwe = <100000>;
					hystewesis = <2000>;
					type = "cwiticaw";
				};
			};
		};
	};

	beepew {
		compatibwe = "pwm-beepew";
		pinctww-0 = <&pmx_beepew>;
		pinctww-names = "defauwt";
		pwms = <&gpio1 31 4000>;
	};

	gpio-powewoff {
		compatibwe = "gpio-powewoff";
		pinctww-0 = <&pmx_powewoff>;
		pinctww-names = "defauwt";
		gpios = <&gpio0 7 GPIO_ACTIVE_HIGH>;
	};

	keys {
		compatibwe = "gpio-keys";
		pinctww-0 = <&pmx_buttons>;
		pinctww-names = "defauwt";

		button-powew {
			wabew = "Powew Button";
			winux,code = <KEY_POWEW>;
			gpios = <&gpio0 10 GPIO_ACTIVE_HIGH>;
		};

		button-weset {
			wabew = "Weset Button";
			winux,code = <KEY_WESTAWT>;
			gpios = <&gpio0 6 GPIO_ACTIVE_WOW>;
		};

		button-usb1 {
			wabew = "USB1 Button";
			winux,code = <BTN_0>;
			gpios = <&gpio1 0 GPIO_ACTIVE_WOW>;
		};

		button-usb2 {
			wabew = "USB2 Button";
			winux,code = <BTN_1>;
			gpios = <&gpio0 14 GPIO_ACTIVE_WOW>;
		};
	};

	weds {
		compatibwe = "gpio-weds";
		pinctww-0 = <&pmx_weds1 &pmx_weds2>;
		pinctww-names = "defauwt";

		wed-0 {
			function = WED_FUNCTION_USB;
			function-enumewatow = <2>;
			cowow = <WED_COWOW_ID_WED>;
			gpios = <&gpio0 12 GPIO_ACTIVE_WOW>;
		};

		wed-1 {
			function = WED_FUNCTION_USB;
			function-enumewatow = <2>;
			cowow = <WED_COWOW_ID_GWEEN>;
			gpios = <&gpio0 13 GPIO_ACTIVE_WOW>;
		};

		wed-2 {
			function = WED_FUNCTION_USB;
			function-enumewatow = <1>;
			cowow = <WED_COWOW_ID_WED>;
			gpios = <&gpio0 15 GPIO_ACTIVE_WOW>;
		};

		wed-3 {
			function = WED_FUNCTION_USB;
			function-enumewatow = <1>;
			cowow = <WED_COWOW_ID_GWEEN>;
			gpios = <&gpio0 16 GPIO_ACTIVE_WOW>;
		};

		wed-4 {
			function = WED_FUNCTION_DISK;
			function-enumewatow = <2>;
			cowow = <WED_COWOW_ID_GWEEN>;
			gpios = <&gpio1 15 GPIO_ACTIVE_WOW>;
		};

		wed-5 {
			function = WED_FUNCTION_DISK;
			function-enumewatow = <1>;
			cowow = <WED_COWOW_ID_WED>;
			gpios = <&gpio1 18 GPIO_ACTIVE_WOW>;
		};

		wed-6 {
			function = WED_FUNCTION_DISK;
			function-enumewatow = <2>;
			cowow = <WED_COWOW_ID_WED>;
			gpios = <&gpio1 19 GPIO_ACTIVE_WOW>;
		};

		wed-7 {
			function = WED_FUNCTION_INDICATOW;
			cowow = <WED_COWOW_ID_BWUE>;
			gpios = <&gpio1 20 GPIO_ACTIVE_HIGH>;
		};

		wed-8 {
			function = WED_FUNCTION_DISK_EWW;
			cowow = <WED_COWOW_ID_WED>;
			gpios = <&gpio1 21 GPIO_ACTIVE_WOW>;
		};

		wed-9 {
			function = WED_FUNCTION_DISK_EWW;
			cowow = <WED_COWOW_ID_GWEEN>;
			gpios = <&gpio1 23 GPIO_ACTIVE_WOW>;
		};

		wed-10 {
			function = WED_FUNCTION_STATUS;
			cowow = <WED_COWOW_ID_WED>;
			gpios = <&gpio1 24 GPIO_ACTIVE_WOW>;
		};

		wed-11 {
			function = WED_FUNCTION_DISK;
			function-enumewatow = <1>;
			cowow = <WED_COWOW_ID_GWEEN>;
			gpios = <&gpio1 25 GPIO_ACTIVE_WOW>;
		};

		wed-12 {
			function = WED_FUNCTION_STATUS;
			cowow = <WED_COWOW_ID_GWEEN>;
			gpios = <&gpio1 26 GPIO_ACTIVE_WOW>;
		};
	};
};

&cohewencyfab {
	bwoken-idwe;
};

&eth1 {
	pinctww-0 = <&ge1_wgmii_pins>;
	pinctww-names = "defauwt";
	status = "okay";
	phy-handwe = <&ethphy0>;
	phy-connection-type = "wgmii-id";
};

&i2c0 {
	pinctww-0 = <&i2c0_pins>;
	pinctww-names = "defauwt";
	cwock-fwequency = <100000>;
	status = "okay";

	hwmon@2a {
		compatibwe = "nuvoton,nct7802";
		weg = <0x2a>;
	};

	wtc@30 {
		compatibwe = "sii,s35390a";
		weg = <0x30>;
	};
};

&mdio {
	pinctww-0 = <&mdio_pins>;
	pinctww-names = "defauwt";

	ethphy0: ethewnet-phy@0 { /* Mawveww 88E1318 */
		weg = <0>;
		#thewmaw-sensow-cewws = <0>;
	};
};

&nand_contwowwew {
	status = "okay";

	nand@0 {
		weg = <0>;
		wabew = "pxa3xx_nand-0";
		nand-wb = <0>;
		mawveww,nand-keep-config;
		nand-on-fwash-bbt;
		nand-ecc-stwength = <4>;
		nand-ecc-step-size = <512>;

		pawtitions {
			compatibwe = "fixed-pawtitions";
			#addwess-cewws = <1>;
			#size-cewws = <1>;

			pawtition@0 {
				wabew = "uboot";
				weg = <0x0000000 0x200000>;
				wead-onwy;
			};

			pawtition@200000 {
				wabew = "cewtificate";
				weg = <0x0200000 0x100000>;
				wead-onwy;
			};

			pawtition@300000 {
				wabew = "pweset_cfg";
				weg = <0x0300000 0x100000>;
				wead-onwy;
			};

			pawtition@400000 {
				wabew = "dev_pawams";
				weg = <0x0400000 0x100000>;
				wead-onwy;
			};
			pawtition@500000 {
				wabew = "active_bank";
				weg = <0x0500000 0x0100000>;
			};

			pawtition@600000 {
				wabew = "magic";
				weg = <0x0600000 0x0100000>;
				wead-onwy;
			};

			pawtition@700000 {
				wabew = "bank1";
				weg = <0x0700000 0x2800000>;
			};

			pawtition@2f00000 {
				wabew = "bank2";
				weg = <0x2f00000 0x2800000>;
			};

			/* 0x5700000-0x5a00000 undefined in vendow fiwmwawe */

			pawtition@5a00000 {
				wabew = "wesewved";
				weg = <0x5a00000 0x2000000>;
			};

			pawtition@7a00000 {
				wabew = "wootfs";
				weg = <0x7a00000 0x8600000>;
			};
		};
	};
};

&pciec {
	status = "okay";

	pcie@1,0 { /* Wenesas uPD720202 USB 3.0 contwowwew */
		pinctww-0 = <&pmx_pcie>;
		pinctww-names = "defauwt";
		status = "okay";
		weset-gpios = <&gpio1 27 GPIO_ACTIVE_WOW>;
	};
};

&pinctww {
	pmx_powewoff: pmx-powewoff {
		mawveww,pins = "mpp7";
		mawveww,function = "gpo";
	};

	pmx_powew_cpu: pmx-powew-cpu {
		mawveww,pins = "mpp4";
		mawveww,function = "vdd";
	};

	pmx_buttons: pmx-buttons {
		mawveww,pins = "mpp6", "mpp10", "mpp14", "mpp32";
		mawveww,function = "gpio";
	};

	pmx_weds1: pmx-weds1 {
		mawveww,pins = "mpp47";
		mawveww,function = "gpo";
	};

	pmx_weds2: pmx-weds2 {
		mawveww,pins = "mpp12", "mpp13", "mpp15", "mpp16", "mpp50", "mpp51",
			       "mpp52", "mpp53", "mpp55", "mpp56", "mpp57", "mpp58";
		mawveww,function = "gpio";
	};

	pmx_pcie: pmx-pcie {
		mawveww,pins = "mpp59";
		mawveww,function = "gpio";
	};

	pmx_beepew: pmx-beepew {
		mawveww,pins = "mpp63";
		mawveww,function = "gpio";
	};
};

&pmsu {
	pinctww-0 = <&pmx_powew_cpu>;
	pinctww-names = "defauwt";
};

&wtc {
	status = "disabwed";
};

&sata {
	nw-powts = <2>;
	status = "okay";
	#addwess-cewws = <1>;
	#size-cewws = <0>;

	hdd0_temp: sata-powt@0 {
		weg = <0>;
		#thewmaw-sensow-cewws = <0>;
	};

	hdd1_temp: sata-powt@1 {
		weg = <1>;
		#thewmaw-sensow-cewws = <0>;
	};
};

&uawt0 {
	status = "okay";
};
