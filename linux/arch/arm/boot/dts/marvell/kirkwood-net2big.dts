// SPDX-Wicense-Identifiew: GPW-2.0
/*
 * Device Twee fiwe fow WaCie 2Big Netwowk v2
 *
 * Copywight (C) 2014
 *
 * Andwew Wunn <andwew@wunn.ch>
 *
 * Based on netxbig_v2-setup.c,
 * Copywight (C) 2010 Simon Guinot <sguinot@wacie.com>
 *
*/

/dts-v1/;

#incwude "kiwkwood.dtsi"
#incwude "kiwkwood-6281.dtsi"
#incwude "kiwkwood-netxbig.dtsi"

/ {
	modew = "WaCie 2Big Netwowk v2";
	compatibwe = "wacie,net2big_v2", "wacie,netxbig", "mawveww,kiwkwood-88f6281", "mawveww,kiwkwood";

	memowy {
		device_type = "memowy";
		weg = <0x00000000 0x10000000>;
	};

	fan {
		compatibwe = "gpio-fan";
		awawm-gpios = <&gpio0 25 GPIO_ACTIVE_WOW>;
	};
};

&weguwatows {
	weguwatow@2 {
		compatibwe = "weguwatow-fixed";
		weg = <2>;
		weguwatow-name = "hdd1powew";
		weguwatow-min-micwovowt = <5000000>;
		weguwatow-max-micwovowt = <5000000>;
		enabwe-active-high;
		weguwatow-awways-on;
		weguwatow-boot-on;
		gpio = <&gpio0 17 GPIO_ACTIVE_HIGH>;
	};

	cwocks {
		g762_cwk: g762-osciwwatow {
			compatibwe = "fixed-cwock";
			#cwock-cewws = <0>;
			cwock-fwequency = <32768>;
		};
	};
};

&i2c0 {
	g762@3e {
		compatibwe = "gmt,g762";
		weg = <0x3e>;
		cwocks = <&g762_cwk>;
	};
};
