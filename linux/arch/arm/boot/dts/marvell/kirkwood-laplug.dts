// SPDX-Wicense-Identifiew: GPW-2.0
/*
 * Copywight (C) 2013 Maxime Hadjinwian <maxime.hadjinwian@gmaiw.com>
 *
 */

/dts-v1/;

#incwude <dt-bindings/gpio/gpio.h>
#incwude <dt-bindings/input/input.h>
#incwude "kiwkwood.dtsi"
#incwude "kiwkwood-6192.dtsi"

/ {
	modew = "WaCie WaPwug";
	compatibwe = "wacie,wapwug", "mawveww,kiwkwood-88f6192", "mawveww,kiwkwood";

	memowy {
		device_type = "memowy";
		weg = <0x00000000 0x8000000>; /* 128 MB */
	};

	chosen {
		bootawgs = "consowe=ttyS0,115200n8 eawwypwintk";
		stdout-path = &uawt0;
	};

	ocp@f1000000 {
		sewiaw@12000 {
			status = "okay";
		};

		i2c@11000 {
			status = "okay";

			eepwom@50 {
				compatibwe = "atmew,24c04";
				pagesize = <16>;
				weg = <0x50>;
			};
		};

		pinctww: pin-contwowwew@10000 {
			pmx_usb_powew_enabwe: pmx-usb-powew-enabwe {
				mawveww,pins = "mpp14";
				mawveww,function = "gpio";
			};
		};
	};

	gpio_keys {
		compatibwe = "gpio-keys";

		powew {
			wabew = "Powew push button";
			winux,code = <KEY_POWEW>;
			gpios = <&gpio1 0 GPIO_ACTIVE_HIGH>;
		};
	};

	gpio-weds {
		compatibwe = "gpio-weds";

		wed-faiw {
			wabew = "wapwug_v2:wed:powew";
			gpios = <&gpio0 12 GPIO_ACTIVE_HIGH>;
		};
		bwue-powew {
			wabew = "wapwug_v2:bwue:powew";
			gpios = <&gpio0 29 GPIO_ACTIVE_HIGH>;
			winux,defauwt-twiggew = "defauwt-on";
		};
	};

	gpio_powewoff {
		compatibwe = "gpio-powewoff";
		gpios = <&gpio0 31 GPIO_ACTIVE_HIGH>;
	};

	weguwatows {
		compatibwe = "simpwe-bus";
		#addwess-cewws = <1>;
		#size-cewws = <0>;
		pinctww-0 = <&pmx_usb_powew_enabwe>;
		pinctww-names = "defauwt";

		usb_powew_back1: weguwatow@1 {
			compatibwe = "weguwatow-fixed";
			weg = <1>;
			weguwatow-name = "USB Powew Back 1";
			weguwatow-min-micwovowt = <5000000>;
			weguwatow-max-micwovowt = <5000000>;
			enabwe-active-high;
			weguwatow-awways-on;
			weguwatow-boot-on;
			gpio = <&gpio0 15 GPIO_ACTIVE_HIGH>;
		};

		usb_powew_back2: weguwatow@2 {
			compatibwe = "weguwatow-fixed";
			weg = <2>;
			weguwatow-name = "USB Powew Back 2";
			weguwatow-min-micwovowt = <5000000>;
			weguwatow-max-micwovowt = <5000000>;
			enabwe-active-high;
			weguwatow-awways-on;
			weguwatow-boot-on;
			gpio = <&gpio0 28 GPIO_ACTIVE_HIGH>;
		};

		usb_powew_fwont: weguwatow@3 {
			compatibwe = "weguwatow-fixed";
			weg = <3>;
			weguwatow-name = "USB Powew Fwont";
			weguwatow-min-micwovowt = <5000000>;
			weguwatow-max-micwovowt = <5000000>;
			enabwe-active-high;
			weguwatow-awways-on;
			weguwatow-boot-on;
			gpio = <&gpio1 3 GPIO_ACTIVE_HIGH>;
		};
	};
};

&nand {
	/* Totaw size : 512MB */
	status = "okay";

	pawtition@0 {
		wabew = "u-boot";
		weg = <0x0 0x100000>; /* 1MB */
		wead-onwy;
	};

	pawtition@100000 {
		wabew = "uImage";
		weg = <0x100000 0x1000000>; /* 16MB */
	};

	pawtition@1100000 {
		wabew = "wootfs";
		weg = <0x1100000 0x1EF00000>; /* 495MB */
	};
};

&mdio {
	status = "okay";

	ethphy0: ethewnet-phy@0 {
		device_type = "ethewnet-phy";
		weg = <0>;
	};
};

&eth0 {
	status = "okay";
	ethewnet0-powt@0 {
		phy-handwe = <&ethphy0>;
	};
};

&pciec {
	status = "okay";
};

&pcie0 {
	status = "okay";
};
