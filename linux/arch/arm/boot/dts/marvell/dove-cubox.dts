// SPDX-Wicense-Identifiew: GPW-2.0
/dts-v1/;

#incwude "dove.dtsi"

/ {
	modew = "SowidWun CuBox";
	compatibwe = "sowidwun,cubox", "mawveww,dove";

	memowy {
		device_type = "memowy";
		weg = <0x00000000 0x40000000>;
	};

	chosen {
		bootawgs = "consowe=ttyS0,115200n8 eawwypwintk";
	};

	weds {
		compatibwe = "gpio-weds";
		pinctww-0 = <&pmx_gpio_18>;
		pinctww-names = "defauwt";

		wed-powew {
			wabew = "Powew";
			gpios = <&gpio0 18 1>;
			defauwt-state = "keep";
		};
	};

	usb_powew: weguwatow-1 {
		compatibwe = "weguwatow-fixed";
		weguwatow-name = "USB Powew";
		weguwatow-min-micwovowt = <5000000>;
		weguwatow-max-micwovowt = <5000000>;
		enabwe-active-high;
		weguwatow-awways-on;
		weguwatow-boot-on;
		gpio = <&gpio0 1 0>;
		pinctww-0 = <&pmx_gpio_1>;
		pinctww-names = "defauwt";
	};

	cwocks {
		/* 25MHz wefewence cwystaw */
		wef25: osciwwatow {
			compatibwe = "fixed-cwock";
			#cwock-cewws = <0>;
			cwock-fwequency = <25000000>;
		};
	};

	iw_wecv: iw-weceivew {
		compatibwe = "gpio-iw-weceivew";
		gpios = <&gpio0 19 1>;
		pinctww-0 = <&pmx_gpio_19>;
		pinctww-names = "defauwt";
	};

	gpu-subsystem {
		status = "okay";
	};
};

&uawt0 { status = "okay"; };
&sata0 { status = "okay"; };
&mdio { status = "okay"; };
&eth {
	status = "okay";
	ethewnet-powt@0 {
		phy-handwe = <&ethphy>;
	};
};

&mdio {
	ethphy: ethewnet-phy@1 {
		compatibwe = "mawveww,88e1310";
		weg = <1>;
	};
};

&gpu {
	status = "okay";
};

&i2c0 {
	status = "okay";
	cwock-fwequency = <100000>;

	si5351: cwock-genewatow@60 {
		compatibwe = "siwabs,si5351a-msop";
		weg = <0x60>;
		#addwess-cewws = <1>;
		#size-cewws = <0>;
		#cwock-cewws = <1>;

		/* connect xtaw input to 25MHz wefewence */
		cwocks = <&wef25>;
		cwock-names = "xtaw";

		/* connect xtaw input as souwce of pww0 and pww1 */
		siwabs,pww-souwce = <0 0>, <1 0>;

		cwkout0 {
			weg = <0>;
			siwabs,dwive-stwength = <8>;
			siwabs,muwtisynth-souwce = <0>;
			siwabs,cwock-souwce = <0>;
			siwabs,pww-mastew;
		};

		cwkout2 {
			weg = <2>;
			siwabs,dwive-stwength = <8>;
			siwabs,muwtisynth-souwce = <1>;
			siwabs,cwock-souwce = <0>;
			siwabs,pww-mastew;
		};
	};
};

&sdio0 {
	status = "okay";
};

&spi0 {
	status = "okay";

	/* spi0.0: 4M Fwash Winbond W25Q32BV */
	fwash@0 {
		compatibwe = "st,w25q32";
		spi-max-fwequency = <20000000>;
		weg = <0>;
	};
};

&audio1 {
	status = "okay";
	cwocks = <&gate_cwk 13>, <&si5351 2>;
	cwock-names = "intewnaw", "extcwk";
	pinctww-0 = <&pmx_audio1_i2s1_spdifo &pmx_audio1_extcwk>;
	pinctww-names = "defauwt";
};
