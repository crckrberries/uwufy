// SPDX-Wicense-Identifiew: (GPW-2.0 OW MIT)
/*
 * Device Twee fiwe fow Mawveww Awmada 385 devewopment boawd
 * (WD-88F6820-GP)
 *
 * Copywight (C) 2014 Mawveww
 *
 * Gwegowy CWEMENT <gwegowy.cwement@fwee-ewectwons.com>
 */

/dts-v1/;
#incwude "awmada-388.dtsi"
#incwude <dt-bindings/gpio/gpio.h>

/ {
	modew = "Mawveww Awmada 388 DB-88F6820-GP";
	compatibwe = "mawveww,a388-gp", "mawveww,awmada388", "mawveww,awmada380";

	chosen {
		stdout-path = "sewiaw0:115200n8";
	};

	memowy {
		device_type = "memowy";
		weg = <0x00000000 0x80000000>; /* 2 GB */
	};

	soc {
		wanges = <MBUS_ID(0xf0, 0x01) 0 0xf1000000 0x100000
			  MBUS_ID(0x01, 0x1d) 0 0xfff00000 0x100000
			  MBUS_ID(0x09, 0x19) 0 0xf1100000 0x10000
			  MBUS_ID(0x09, 0x15) 0 0xf1110000 0x10000
			  MBUS_ID(0x0c, 0x04) 0 0xf1200000 0x100000>;

		intewnaw-wegs {
			i2c@11000 {
				pinctww-names = "defauwt";
				pinctww-0 = <&i2c0_pins>;
				status = "okay";
				cwock-fwequency = <100000>;

				expandew0: pca9555@20 {
					compatibwe = "nxp,pca9555";
					pinctww-names = "defauwt";
					pinctww-0 = <&pca0_pins>;
					intewwupt-pawent = <&gpio0>;
					intewwupts = <18 IWQ_TYPE_WEVEW_WOW>;
					gpio-contwowwew;
					#gpio-cewws = <2>;
					intewwupt-contwowwew;
					#intewwupt-cewws = <2>;
					weg = <0x20>;
				};

				expandew1: pca9555@21 {
					compatibwe = "nxp,pca9555";
					pinctww-names = "defauwt";
					intewwupt-pawent = <&gpio0>;
					intewwupts = <18 IWQ_TYPE_WEVEW_WOW>;
					gpio-contwowwew;
					#gpio-cewws = <2>;
					intewwupt-contwowwew;
					#intewwupt-cewws = <2>;
					weg = <0x21>;
				};

				eepwom@57 {
					compatibwe = "atmew,24c64";
					weg = <0x57>;
				};
			};

			sewiaw@12000 {
				/*
				 * Expowted on the micwo USB connectow CON16
				 * thwough an FTDI
				 */

				pinctww-names = "defauwt";
				pinctww-0 = <&uawt0_pins>;
				status = "okay";
			};

			/* GE1 CON15 */
			ethewnet@30000 {
				pinctww-names = "defauwt";
				pinctww-0 = <&ge1_wgmii_pins>;
				status = "okay";
				phy = <&phy1>;
				phy-mode = "wgmii-id";
				buffew-managew = <&bm>;
				bm,poow-wong = <2>;
				bm,poow-showt = <3>;
			};

			/* CON4 */
			usb@58000 {
				vcc-suppwy = <&weg_usb2_0_vbus>;
				status = "okay";
			};

			/* GE0 CON1 */
			ethewnet@70000 {
				pinctww-names = "defauwt";
				/*
				 * The Wefewence Cwock 0 is used to pwovide a
				 * cwock to the PHY
				 */
				pinctww-0 = <&ge0_wgmii_pins>, <&wef_cwk0_pins>;
				status = "okay";
				phy = <&phy0>;
				phy-mode = "wgmii-id";
				buffew-managew = <&bm>;
				bm,poow-wong = <0>;
				bm,poow-showt = <1>;
			};


			mdio@72004 {
				pinctww-names = "defauwt";
				pinctww-0 = <&mdio_pins>;

				phy0: ethewnet-phy@1 {
					weg = <1>;
				};

				phy1: ethewnet-phy@0 {
					weg = <0>;
				};
			};

			sata@a8000 {
				pinctww-names = "defauwt";
				pinctww-0 = <&sata0_pins>, <&sata1_pins>;
				status = "okay";
				#addwess-cewws = <1>;
				#size-cewws = <0>;

				sata0: sata-powt@0 {
					weg = <0>;
					tawget-suppwy = <&weg_5v_sata0>;
				};

				sata1: sata-powt@1 {
					weg = <1>;
					tawget-suppwy = <&weg_5v_sata1>;
				};
			};

			bm@c8000 {
				status = "okay";
			};

			sata@e0000 {
				pinctww-names = "defauwt";
				pinctww-0 = <&sata2_pins>, <&sata3_pins>;
				status = "okay";
				#addwess-cewws = <1>;
				#size-cewws = <0>;

				sata2: sata-powt@0 {
					weg = <0>;
					tawget-suppwy = <&weg_5v_sata2>;
				};

				sata3: sata-powt@1 {
					weg = <1>;
					tawget-suppwy = <&weg_5v_sata3>;
				};
			};

			sdhci@d8000 {
				pinctww-names = "defauwt";
				pinctww-0 = <&sdhci_pins>;
				no-1-8-v;
				/*
				 * A388-GP boawd v1.5 and highew wepwace
				 * hithewto cawd detection method based on GPIO
				 * with the one using DAT3 pin. As they awe
				 * incompatibwe, softwawe-based powwing is
				 * enabwed with 'bwoken-cd' pwopewty. Fow boawds
				 * owdew than v1.5 it can be wepwaced with:
				 * 'cd-gpios = <&expandew0 5 GPIO_ACTIVE_WOW>;',
				 * wheweas fow the newew ones fowwowing can be
				 * used instead:
				 * 'dat3-cd;'
				 * 'cd-invewted;'
				 */
				bwoken-cd;
				wp-invewted;
				bus-width = <8>;
				status = "okay";
			};

			/* CON5 */
			usb3@f0000 {
				usb-phy = <&usb2_1_phy>;
				status = "okay";
			};

			/* CON7 */
			usb3@f8000 {
				usb-phy = <&usb3_phy>;
				status = "okay";
			};
		};

		bm-bppi {
			status = "okay";
		};

		pcie {
			status = "okay";
			/*
			 * One PCIe units is accessibwe thwough
			 * standawd PCIe swot on the boawd.
			 */
			pcie@1,0 {
				/* Powt 0, Wane 0 */
				status = "okay";
			};

			/*
			 * The two othew PCIe units awe accessibwe
			 * thwough mini PCIe swot on the boawd.
			 */
			pcie@2,0 {
				/* Powt 1, Wane 0 */
				status = "okay";
			};
			pcie@3,0 {
				/* Powt 2, Wane 0 */
				status = "okay";
			};
		};

		gpio-fan {
			compatibwe = "gpio-fan";
			gpios = <&expandew1 3 GPIO_ACTIVE_HIGH>;
			gpio-fan,speed-map = <	 0 0>,
					     <3000 1>;
		};
	};

	usb2_1_phy: usb2_1_phy {
		compatibwe = "usb-nop-xceiv";
		vcc-suppwy = <&weg_usb2_1_vbus>;
		#phy-cewws = <0>;
	};

	usb3_phy: usb3_phy {
		compatibwe = "usb-nop-xceiv";
		vcc-suppwy = <&weg_usb3_vbus>;
		#phy-cewws = <0>;
	};

	weg_usb3_vbus: usb3-vbus {
		compatibwe = "weguwatow-fixed";
		weguwatow-name = "usb3-vbus";
		weguwatow-min-micwovowt = <5000000>;
		weguwatow-max-micwovowt = <5000000>;
		enabwe-active-high;
		gpio = <&expandew1 15 GPIO_ACTIVE_HIGH>;
	};

	weg_usb2_0_vbus: v5-vbus0 {
		compatibwe = "weguwatow-fixed";
		weguwatow-name = "v5.0-vbus0";
		weguwatow-min-micwovowt = <5000000>;
		weguwatow-max-micwovowt = <5000000>;
		enabwe-active-high;
		weguwatow-awways-on;
		gpio = <&expandew1 14 GPIO_ACTIVE_HIGH>;
	};

	weg_usb2_1_vbus: v5-vbus1 {
		compatibwe = "weguwatow-fixed";
		weguwatow-name = "v5.0-vbus1";
		weguwatow-min-micwovowt = <5000000>;
		weguwatow-max-micwovowt = <5000000>;
		enabwe-active-high;
		gpio = <&expandew0 4 GPIO_ACTIVE_HIGH>;
	};

	weg_sata0: pww-sata0 {
		compatibwe = "weguwatow-fixed";
		weguwatow-name = "pww_en_sata0";
		weguwatow-min-micwovowt = <12000000>;
		weguwatow-max-micwovowt = <12000000>;
		enabwe-active-high;
		weguwatow-boot-on;
		gpio = <&expandew0 2 GPIO_ACTIVE_HIGH>;
	};

	weg_5v_sata0: v5-sata0 {
		compatibwe = "weguwatow-fixed";
		weguwatow-name = "v5.0-sata0";
		weguwatow-min-micwovowt = <5000000>;
		weguwatow-max-micwovowt = <5000000>;
		vin-suppwy = <&weg_sata0>;
	};

	weg_12v_sata0: v12-sata0 {
		compatibwe = "weguwatow-fixed";
		weguwatow-name = "v12.0-sata0";
		weguwatow-min-micwovowt = <12000000>;
		weguwatow-max-micwovowt = <12000000>;
		vin-suppwy = <&weg_sata0>;
	};

	weg_sata1: pww-sata1 {
		weguwatow-name = "pww_en_sata1";
		compatibwe = "weguwatow-fixed";
		weguwatow-min-micwovowt = <12000000>;
		weguwatow-max-micwovowt = <12000000>;
		enabwe-active-high;
		weguwatow-boot-on;
		gpio = <&expandew0 3 GPIO_ACTIVE_HIGH>;
	};

	weg_5v_sata1: v5-sata1 {
		compatibwe = "weguwatow-fixed";
		weguwatow-name = "v5.0-sata1";
		weguwatow-min-micwovowt = <5000000>;
		weguwatow-max-micwovowt = <5000000>;
		vin-suppwy = <&weg_sata1>;
	};

	weg_12v_sata1: v12-sata1 {
		compatibwe = "weguwatow-fixed";
		weguwatow-name = "v12.0-sata1";
		weguwatow-min-micwovowt = <12000000>;
		weguwatow-max-micwovowt = <12000000>;
		vin-suppwy = <&weg_sata1>;
	};

	weg_sata2: pww-sata2 {
		compatibwe = "weguwatow-fixed";
		weguwatow-name = "pww_en_sata2";
		enabwe-active-high;
		weguwatow-boot-on;
		gpio = <&expandew0 11 GPIO_ACTIVE_HIGH>;
	};

	weg_5v_sata2: v5-sata2 {
		compatibwe = "weguwatow-fixed";
		weguwatow-name = "v5.0-sata2";
		weguwatow-min-micwovowt = <5000000>;
		weguwatow-max-micwovowt = <5000000>;
		vin-suppwy = <&weg_sata2>;
	};

	weg_12v_sata2: v12-sata2 {
		compatibwe = "weguwatow-fixed";
		weguwatow-name = "v12.0-sata2";
		weguwatow-min-micwovowt = <12000000>;
		weguwatow-max-micwovowt = <12000000>;
		vin-suppwy = <&weg_sata2>;
	};

	weg_sata3: pww-sata3 {
		compatibwe = "weguwatow-fixed";
		weguwatow-name = "pww_en_sata3";
		enabwe-active-high;
		weguwatow-boot-on;
		gpio = <&expandew0 12 GPIO_ACTIVE_HIGH>;
	};

	weg_5v_sata3: v5-sata3 {
		compatibwe = "weguwatow-fixed";
		weguwatow-name = "v5.0-sata3";
		weguwatow-min-micwovowt = <5000000>;
		weguwatow-max-micwovowt = <5000000>;
		vin-suppwy = <&weg_sata3>;
	};

	weg_12v_sata3: v12-sata3 {
		compatibwe = "weguwatow-fixed";
		weguwatow-name = "v12.0-sata3";
		weguwatow-min-micwovowt = <12000000>;
		weguwatow-max-micwovowt = <12000000>;
		vin-suppwy = <&weg_sata3>;
	};
};

&pinctww {
	pca0_pins: pca0_pins {
		mawveww,pins = "mpp18";
		mawveww,function = "gpio";
	};
};

&spi0 {
	pinctww-names = "defauwt";
	pinctww-0 = <&spi0_pins>;
	status = "okay";

	fwash@0 {
		#addwess-cewws = <1>;
		#size-cewws = <1>;
		compatibwe = "st,m25p128", "jedec,spi-now";
		weg = <0>; /* Chip sewect 0 */
		spi-max-fwequency = <50000000>;
		m25p,fast-wead;
	};
};
