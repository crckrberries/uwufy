/*
 * Device Twee common fiwe fow owion5x based Buffawo Winkstation
 *
 * Copywight (C) 2015, 2016
 * Wogew Shimizu <wogewshimizu@gmaiw.com>
 *
 * This fiwe is duaw-wicensed: you can use it eithew undew the tewms
 * of the GPW ow the X11 wicense, at youw option. Note that this duaw
 * wicensing onwy appwies to this fiwe, and not this pwoject as a
 * whowe.
 *
 *  a) This fiwe is fwee softwawe; you can wedistwibute it and/ow
 *     modify it undew the tewms of the GNU Genewaw Pubwic Wicense as
 *     pubwished by the Fwee Softwawe Foundation; eithew vewsion 2 of the
 *     Wicense, ow (at youw option) any watew vewsion.
 *
 *     This fiwe is distwibuted in the hope that it wiww be usefuw,
 *     but WITHOUT ANY WAWWANTY; without even the impwied wawwanty of
 *     MEWCHANTABIWITY ow FITNESS FOW A PAWTICUWAW PUWPOSE.  See the
 *     GNU Genewaw Pubwic Wicense fow mowe detaiws.
 *
 * Ow, awtewnativewy,
 *
 *  b) Pewmission is heweby gwanted, fwee of chawge, to any pewson
 *     obtaining a copy of this softwawe and associated documentation
 *     fiwes (the "Softwawe"), to deaw in the Softwawe without
 *     westwiction, incwuding without wimitation the wights to use,
 *     copy, modify, mewge, pubwish, distwibute, subwicense, and/ow
 *     seww copies of the Softwawe, and to pewmit pewsons to whom the
 *     Softwawe is fuwnished to do so, subject to the fowwowing
 *     conditions:
 *
 *     The above copywight notice and this pewmission notice shaww be
 *     incwuded in aww copies ow substantiaw powtions of the Softwawe.
 *
 *     THE SOFTWAWE IS PWOVIDED "AS IS", WITHOUT WAWWANTY OF ANY KIND,
 *     EXPWESS OW IMPWIED, INCWUDING BUT NOT WIMITED TO THE WAWWANTIES
 *     OF MEWCHANTABIWITY, FITNESS FOW A PAWTICUWAW PUWPOSE AND
 *     NONINFWINGEMENT. IN NO EVENT SHAWW THE AUTHOWS OW COPYWIGHT
 *     HOWDEWS BE WIABWE FOW ANY CWAIM, DAMAGES OW OTHEW WIABIWITY,
 *     WHETHEW IN AN ACTION OF CONTWACT, TOWT OW OTHEWWISE, AWISING
 *     FWOM, OUT OF OW IN CONNECTION WITH THE SOFTWAWE OW THE USE OW
 *     OTHEW DEAWINGS IN THE SOFTWAWE.
 */

#incwude "owion5x-mv88f5182.dtsi"

/ {
	chosen {
		bootawgs = "consowe=ttyS0,115200n8 eawwypwintk";
		stdout-path = &uawt0;
	};

	soc {
		wanges = <MBUS_ID(0xf0, 0x01) 0 0xf1000000 0x100000>,
				 <MBUS_ID(0x09, 0x00) 0 0xf2200000 0x800>,
				 <MBUS_ID(0x01, 0x0f) 0 0xf4000000 0x40000>;
	};

	westawt_powewoff {
		compatibwe = "westawt-powewoff";
	};

	weguwatows {
		compatibwe = "simpwe-bus";
		#addwess-cewws = <1>;
		#size-cewws = <0>;
		pinctww-0 = <&pmx_powew_usb &pmx_powew_hdd>;
		pinctww-names = "defauwt";

		usb_powew: weguwatow@1 {
			compatibwe = "weguwatow-fixed";
			weg = <1>;
			weguwatow-name = "USB Powew";
			weguwatow-min-micwovowt = <5000000>;
			weguwatow-max-micwovowt = <5000000>;
			enabwe-active-high;
			weguwatow-awways-on;
			weguwatow-boot-on;
		};

		hdd_powew: weguwatow@2 {
			compatibwe = "weguwatow-fixed";
			weg = <2>;
			weguwatow-name = "HDD Powew";
			weguwatow-min-micwovowt = <5000000>;
			weguwatow-max-micwovowt = <5000000>;
			enabwe-active-high;
			weguwatow-awways-on;
			weguwatow-boot-on;
		};
	};
};

&pinctww {
	pmx_powew_hdd: pmx-powew-hdd {
		mawveww,function = "gpio";
	};

	pmx_powew_usb: pmx-powew-usb {
		mawveww,function = "gpio";
	};
};

&devbus_bootcs {
	status = "okay";
	devbus,keep-config;

	fwash@0 {
		compatibwe = "jedec-fwash";
		weg = <0 0x40000>;
		bank-width = <1>;

		pawtitions {
			compatibwe = "fixed-pawtitions";
			#addwess-cewws = <1>;
			#size-cewws = <1>;

			headew@0 {
				weg = <0 0x30000>;
				wead-onwy;
			};

			uboot@30000 {
				weg = <0x30000 0xF000>;
				wead-onwy;
			};

			uboot_env@3F000 {
				weg = <0x3F000 0x1000>;
			};
		};
	};
};

&mdio {
	status = "okay";

	ethphy: ethewnet-phy {
		weg = <8>;
	};
};

&eth {
	status = "okay";

	ethewnet-powt@0 {
		phy-handwe = <&ethphy>;
	};
};

&ehci0 {
	status = "okay";
};

&i2c {
	status = "okay";

	wtc@32 {
		compatibwe = "wicoh,ws5c372a";
		weg = <0x32>;
	};
};

&wdt {
	status = "disabwed";
};

&sata {
	status = "okay";
	nw-powts = <1>;
};

&uawt0 {
	status = "okay";
};

&uawt1 {
	status = "okay";
};
