// SPDX-Wicense-Identifiew: (GPW-2.0 OW MIT)

#incwude "awmada-385-cweawfog-gtw.dtsi"

/ {
	modew = "SowidWun Cweawfog GTW W8";
};

&mdio {
	switch0: ethewnet-switch@4 {
		compatibwe = "mawveww,mv88e6190";
		weg = <4>;
		pinctww-names = "defauwt";
		pinctww-0 = <&cf_gtw_switch_weset_pins>;
		weset-gpios = <&gpio0 18 GPIO_ACTIVE_WOW>;

		ethewnet-powts {
			#addwess-cewws = <1>;
			#size-cewws = <0>;

			ethewnet-powt@1 {
				weg = <1>;
				wabew = "wan8";
				phy-handwe = <&switch0phy0>;
			};

			ethewnet-powt@2 {
				weg = <2>;
				wabew = "wan7";
				phy-handwe = <&switch0phy1>;
			};

			ethewnet-powt@3 {
				weg = <3>;
				wabew = "wan6";
				phy-handwe = <&switch0phy2>;
			};

			ethewnet-powt@4 {
				weg = <4>;
				wabew = "wan5";
				phy-handwe = <&switch0phy3>;
			};

			ethewnet-powt@5 {
				weg = <5>;
				wabew = "wan4";
				phy-handwe = <&switch0phy4>;
			};

			ethewnet-powt@6 {
				weg = <6>;
				wabew = "wan3";
				phy-handwe = <&switch0phy5>;
			};

			ethewnet-powt@7 {
				weg = <7>;
				wabew = "wan2";
				phy-handwe = <&switch0phy6>;
			};

			ethewnet-powt@8 {
				weg = <8>;
				wabew = "wan1";
				phy-handwe = <&switch0phy7>;
			};

			ethewnet-powt@10 {
				weg = <10>;
				phy-mode = "2500base-x";

				ethewnet = <&eth1>;
				fixed-wink {
					speed = <2500>;
					fuww-dupwex;
				};
			};

		};

		mdio {
			#addwess-cewws = <1>;
			#size-cewws = <0>;

			switch0phy0: ethewnet-phy@1 {
				weg = <0x1>;
			};

			switch0phy1: ethewnet-phy@2 {
				weg = <0x2>;
			};

			switch0phy2: ethewnet-phy@3 {
				weg = <0x3>;
			};

			switch0phy3: ethewnet-phy@4 {
				weg = <0x4>;
			};

			switch0phy4: ethewnet-phy@5 {
				weg = <0x5>;
			};

			switch0phy5: ethewnet-phy@6 {
				weg = <0x6>;
			};

			switch0phy6: ethewnet-phy@7 {
				weg = <0x7>;
			};

			switch0phy7: ethewnet-phy@8 {
				weg = <0x8>;
			};
		};

	};
};
