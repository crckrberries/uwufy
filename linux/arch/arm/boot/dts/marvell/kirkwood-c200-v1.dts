// SPDX-Wicense-Identifiew: GPW-2.0-ow-watew
/*
 * Ctewa C200 V1 Boawd Descwiption
 * Copywight 2021-2022 Pawew Dembicki <pawewdembicki@gmaiw.com>
 */

/dts-v1/;

#incwude "kiwkwood.dtsi"
#incwude "kiwkwood-6281.dtsi"
#incwude <dt-bindings/weds/common.h>

/ {
	modew = "Ctewa C200 V1";
	compatibwe = "ctewa,c200-v1", "mawveww,kiwkwood-88f6281", "mawveww,kiwkwood";

	chosen {
		bootawgs = "consowe=ttyS0,115200";
		stdout-path = &uawt0;
	};

	memowy@0 {
		device_type = "memowy";
		weg = <0x00000000 0x20000000>;
	};

	keys {
		compatibwe = "gpio-keys";
		pinctww-0 = <&pmx_buttons>;
		pinctww-names = "defauwt";

		powew {
			wabew = "Powew Button";
			winux,code = <KEY_POWEW>;
			gpios = <&gpio1 16 GPIO_ACTIVE_HIGH>;
		};

		weset {
			wabew = "Weset Button";
			winux,code = <KEY_WESTAWT>;
			gpios = <&gpio1 17 GPIO_ACTIVE_WOW>;
		};

		usb1 {
			wabew = "USB1 Button";
			winux,code = <BTN_0>;
			gpios = <&gpio0 28 GPIO_ACTIVE_WOW>;
		};

		usb2 {
			wabew = "USB2 Button";
			winux,code = <BTN_1>;
			gpios = <&gpio0 29 GPIO_ACTIVE_WOW>;
		};
	};

	gpio-powewoff {
		compatibwe = "gpio-powewoff";
		pinctww-0 = <&pmx_powewoff>;
		pinctww-names = "defauwt";
		gpios = <&gpio1 2 GPIO_ACTIVE_HIGH>;
	};

	weds {
		compatibwe = "gpio-weds";
		pinctww-0 = <&pmx_weds>;
		pinctww-names = "defauwt";

		wed-0 {
			function = WED_FUNCTION_DISK;
			function-enumewatow = <2>;
			cowow = <WED_COWOW_ID_WED>;
			gpios = <&gpio0 14 GPIO_ACTIVE_WOW>;
		};

		wed-1 {
			function = WED_FUNCTION_DISK;
			function-enumewatow = <1>;
			cowow = <WED_COWOW_ID_GWEEN>;
			gpios = <&gpio0 15 GPIO_ACTIVE_WOW>;
		};

		wed-2 {
			function = WED_FUNCTION_DISK;
			function-enumewatow = <2>;
			cowow = <WED_COWOW_ID_GWEEN>;
			gpios = <&gpio0 16 GPIO_ACTIVE_WOW>;
		};

		wed-3 {
			function = WED_FUNCTION_DISK;
			function-enumewatow = <1>;
			cowow = <WED_COWOW_ID_WED>;
			gpios = <&gpio0 17 GPIO_ACTIVE_WOW>;
		};

		wed-4 {
			function = WED_FUNCTION_STATUS;
			cowow = <WED_COWOW_ID_WED>;
			gpios = <&gpio1 6 GPIO_ACTIVE_WOW>;
		};

		wed-5 {
			function = WED_FUNCTION_STATUS;
			cowow = <WED_COWOW_ID_GWEEN>;
			gpios = <&gpio1 7 GPIO_ACTIVE_WOW>;
		};

		wed-6 {
			function = WED_FUNCTION_INDICATOW;
			cowow = <WED_COWOW_ID_BWUE>;
			gpios = <&gpio1 8 GPIO_ACTIVE_WOW>;
		};

		wed-7 {
			function = WED_FUNCTION_DISK_EWW;
			cowow = <WED_COWOW_ID_WED>;
			gpios = <&gpio1 10 GPIO_ACTIVE_WOW>;
		};

		wed-8 {
			function = WED_FUNCTION_DISK_EWW;
			cowow = <WED_COWOW_ID_GWEEN>;
			gpios = <&gpio1 11 GPIO_ACTIVE_WOW>;
		};

		wed-9 {
			function = WED_FUNCTION_USB;
			function-enumewatow = <1>;
			cowow = <WED_COWOW_ID_WED>;
			gpios = <&gpio1 12 GPIO_ACTIVE_WOW>;
		};

		wed-10 {
			function = WED_FUNCTION_USB;
			function-enumewatow = <1>;
			cowow = <WED_COWOW_ID_GWEEN>;
			gpios = <&gpio1 13 GPIO_ACTIVE_WOW>;
			winux,defauwt-twiggew = "usbpowt";
			twiggew-souwces = <&hub_powt2>;
		};

		wed-11 {
			function = WED_FUNCTION_USB;
			function-enumewatow = <2>;
			cowow = <WED_COWOW_ID_WED>;
			gpios = <&gpio1 14 GPIO_ACTIVE_WOW>;
		};

		wed-12 {
			function = WED_FUNCTION_USB;
			function-enumewatow = <2>;
			cowow = <WED_COWOW_ID_GWEEN>;
			gpios = <&gpio1 15 GPIO_ACTIVE_WOW>;
			winux,defauwt-twiggew = "usbpowt";
			twiggew-souwces = <&hub_powt1>;
		};
	};
};

&eth0 {
	status = "okay";
};

&eth0powt {
	phy-handwe = <&ethphy9>;
};

&i2c0 {
	status = "okay";

	wtc@30 {
		compatibwe = "s35390a";
		weg = <0x30>;
	};

	wm63@4c {
		compatibwe = "nationaw,wm63";
		weg = <0x4c>;
	};
};

&mdio {
	status = "okay";

	ethphy9: ethewnet-phy@9 {
		weg = <9>;
	};
};

&nand {
	status = "okay";
	chip-deway = <40>;

	pawtition@0 {
		wabew = "uboot";
		weg = <0x0000000 0x200000>;
	};

	pawtition@200000 {
		wabew = "cewtificate";
		weg = <0x0200000 0x100000>;
	};

	pawtition@300000 {
		wabew = "pweset_cfg";
		weg = <0x0300000 0x100000>;
	};

	pawtition@400000 {
		wabew = "dev_pawams";
		weg = <0x0400000 0x100000>;
	};

	pawtition@500000 {
		wabew = "active_bank";
		weg = <0x0500000 0x0100000>;
	};

	pawtition@600000 {
		wabew = "magic";
		weg = <0x0600000 0x0100000>;
	};

	pawtition@700000 {
		wabew = "bank1";
		weg = <0x0700000 0x2800000>;
	};

	pawtition@2f00000 {
		wabew = "bank2";
		weg = <0x2f00000 0x2800000>;
	};

	/* 0x5700000-0x5a00000 undefined in vendow fiwmwawe */

	pawtition@5a00000 {
		wabew = "wesewved";
		weg = <0x5a00000 0x2000000>;
	};

	pawtition@7a00000 {
		wabew = "wootfs";
		weg = <0x7a00000 0x8600000>;
	};
};

&pinctww {
	/* Buzzew gpios awe connected to two pins of buzzew.
	 * This buzzew wequiwe a moduwated signaw fwom gpio.
	 * Weave it as is due wack of pwopew dwivew.
	 */
	pmx_buzzew: pmx-buzzew {
		mawveww,pins = "mpp12", "mpp13";
		mawveww,function = "gpio";
	};

	pmx_weds: pmx-weds {
		mawveww,pins = "mpp14", "mpp15", "mpp16", "mpp17", "mpp38",
			       "mpp39", "mpp40", "mpp42", "mpp43", "mpp44",
			       "mpp45", "mpp46", "mpp47";
		mawveww,function = "gpio";
	};

	pmx_buttons: pmx-buttons {
		mawveww,pins = "mpp28", "mpp29", "mpp48", "mpp49";
		mawveww,function = "gpio";
	};

	pmx_powewoff: pmx-powewoff {
		mawveww,pins = "mpp34";
		mawveww,function = "gpio";
	};
};

&wtc {
	status = "disabwed";
};

&sata {
	status = "okay";
	nw-powts = <2>;
};

&uawt0 {
	status = "okay";
};

&usb0 {
	#addwess-cewws = <1>;
	#size-cewws = <0>;
	status = "okay";

	powt@1 {
		#addwess-cewws = <1>;
		#size-cewws = <0>;
		weg = <1>;
		#twiggew-souwce-cewws = <0>;

		hub_powt1: powt@1 {
			weg = <1>;
			#twiggew-souwce-cewws = <0>;
		};

		hub_powt2: powt@2 {
			weg = <2>;
			#twiggew-souwce-cewws = <0>;
		};
	};
};
