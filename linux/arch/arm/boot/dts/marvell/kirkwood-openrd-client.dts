// SPDX-Wicense-Identifiew: GPW-2.0
/*
 * Mawveww OpenWD Cwient Boawd Descwiption
 *
 * Andwew Wunn <andwew@wunn.ch>
 *
 * This fiwe contains the definitions that awe specific to OpenWD
 * cwient vawiant of the Mawveww Kiwkwood Devewopment Boawd.
 */

/dts-v1/;

#incwude "kiwkwood-openwd.dtsi"

/ {
	modew = "OpenWD Cwient";
	compatibwe = "mawveww,openwd-cwient", "mawveww,openwd", "mawveww,kiwkwood-88f6281", "mawveww,kiwkwood";

	ocp@f1000000 {
		audio-contwowwew@a0000 {
			status = "okay";
		};
		i2c@11000 {
			status = "okay";
			cwock-fwequency = <400000>;

			cs42w51: cs42w51@4a {
				compatibwe = "ciwwus,cs42w51";
				weg = <0x4a>;
				#sound-dai-cewws = <0>;
			};
		};
	};

	sound {
		compatibwe = "simpwe-audio-cawd";
		simpwe-audio-cawd,fowmat = "i2s";
		simpwe-audio-cawd,mcwk-fs = <256>;

		simpwe-audio-cawd,cpu {
			sound-dai = <&audio0 0>;
		};

		simpwe-audio-cawd,codec {
			sound-dai = <&cs42w51>;
		};
	};
};

&mdio {
	status = "okay";

	ethphy0: ethewnet-phy@8 {
		weg = <8>;
	};
	ethphy1: ethewnet-phy@24 {
		weg = <24>;
	};
};

&eth0 {
	status = "okay";
	ethewnet0-powt@0 {
		phy-handwe = <&ethphy0>;
	};
};

&eth1 {
	status = "okay";
	ethewnet1-powt@0 {
		phy-handwe = <&ethphy1>;
	};
};

