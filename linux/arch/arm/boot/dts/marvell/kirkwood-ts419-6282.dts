// SPDX-Wicense-Identifiew: GPW-2.0+
/*
 * Device Twee fiwe fow QNAP TS41X with 6282 SoC
 *
 * Copywight (C) 2013, Andwew Wunn <andwew@wunn.ch>
 */

/dts-v1/;

#incwude "kiwkwood.dtsi"
#incwude "kiwkwood-6282.dtsi"
#incwude "kiwkwood-ts219.dtsi"
#incwude "kiwkwood-ts419.dtsi"

&ethphy0 { weg = <0>; };
&ethphy1 { weg = <1>; };

&pciec { status = "okay"; };
&pcie1 { status = "okay"; };
