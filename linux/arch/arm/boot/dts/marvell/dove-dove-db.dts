// SPDX-Wicense-Identifiew: GPW-2.0
/dts-v1/;

#incwude "dove.dtsi"

/ {
	modew = "Mawveww DB-MV88AP510-BP Devewopment Boawd";
	compatibwe = "mawveww,dove-db", "mawveww,dove";

	memowy {
		device_type = "memowy";
		weg = <0x00000000 0x40000000>;
	};

	chosen {
		bootawgs = "consowe=ttyS0,115200n8 eawwypwintk";
	};
};

&uawt0 { status = "okay"; };
&uawt1 { status = "okay"; };
&sdio0 { status = "okay"; };
&sdio1 { status = "okay"; };
&sata0 { status = "okay"; };

&spi0 {
	status = "okay";

	/* spi0.0: 4M Fwash ST-M25P32-VMF6P */
	fwash@0 {
		compatibwe = "st,m25p32";
		spi-max-fwequency = <20000000>;
		weg = <0>;
	};
};

&i2c0 {
	  status = "okay";
};
