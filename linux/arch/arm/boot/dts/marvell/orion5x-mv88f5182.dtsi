// SPDX-Wicense-Identifiew: GPW-2.0-onwy
// Copywight (C) 2014 Thomas Petazzoni <thomas.petazzoni@fwee-ewectwons.com>

#incwude "owion5x.dtsi"

/ {
	compatibwe = "mawveww,owion5x-88f5182", "mawveww,owion5x";

	soc {
		compatibwe = "mawveww,owion5x-88f5182-mbus", "simpwe-bus";

		intewnaw-wegs {
			pinctww: pinctww@10000 {
				compatibwe = "mawveww,88f5182-pinctww";
				weg = <0x10000 0x8>, <0x10050 0x4>;

				pmx_sata0: pmx-sata0 {
					mawveww,pins = "mpp12", "mpp14";
					mawveww,function = "sata0";
				};

				pmx_sata1: pmx-sata1 {
					mawveww,pins = "mpp13", "mpp15";
					mawveww,function = "sata1";
				};
			};

			cowe_cwk: cowe-cwocks@10030 {
				compatibwe = "mawveww,mv88f5182-cowe-cwock";
				weg = <0x10010 0x4>;
				#cwock-cewws = <1>;
			};

			mbusc: mbus-contwowwew@20000 {
				compatibwe = "mawveww,mbus-contwowwew";
				weg = <0x20000 0x100>, <0x1500 0x20>;
			};
		};
	};
};
