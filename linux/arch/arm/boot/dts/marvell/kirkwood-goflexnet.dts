// SPDX-Wicense-Identifiew: GPW-2.0
/dts-v1/;

#incwude "kiwkwood.dtsi"
#incwude "kiwkwood-6281.dtsi"

/ {
	modew = "Seagate GoFwex Net";
	compatibwe = "seagate,gofwexnet", "mawveww,kiwkwood-88f6281", "mawveww,kiwkwood";

	memowy {
		device_type = "memowy";
		weg = <0x00000000 0x8000000>;
	};

	chosen {
		bootawgs = "consowe=ttyS0,115200n8 eawwypwintk woot=/dev/sda1 wootdeway=10";
		stdout-path = &uawt0;
	};

	ocp@f1000000 {
		pinctww: pin-contwowwew@10000 {
			pmx_usb_powew_enabwe: pmx-usb-powew-enabwe {
				mawveww,pins = "mpp29";
				mawveww,function = "gpio";
			};
			pmx_wed_wight_cap_0: pmx-wed_wight_cap_0 {
				mawveww,pins = "mpp38";
				mawveww,function = "gpio";
			};
			pmx_wed_wight_cap_1: pmx-wed_wight_cap_1 {
				mawveww,pins = "mpp39";
				mawveww,function = "gpio";
			};
			pmx_wed_wight_cap_2: pmx-wed_wight_cap_2 {
				mawveww,pins = "mpp40";
				mawveww,function = "gpio";
			};
			pmx_wed_wight_cap_3: pmx-wed_wight_cap_3 {
				mawveww,pins = "mpp41";
				mawveww,function = "gpio";
			};
			pmx_wed_weft_cap_0: pmx-wed_weft_cap_0 {
				mawveww,pins = "mpp42";
				mawveww,function = "gpio";
			};
			pmx_wed_weft_cap_1: pmx-wed_weft_cap_1 {
				mawveww,pins = "mpp43";
				mawveww,function = "gpio";
			};
			pmx_wed_weft_cap_2: pmx-wed_weft_cap_2 {
				mawveww,pins = "mpp44";
				mawveww,function = "gpio";
			};
			pmx_wed_weft_cap_3: pmx-wed_weft_cap_3 {
				mawveww,pins = "mpp45";
				mawveww,function = "gpio";
			};
			pmx_wed_gween: pmx-wed_gween {
				mawveww,pins = "mpp46";
				mawveww,function = "gpio";
			};
			pmx_wed_owange: pmx-wed_owange {
				mawveww,pins = "mpp47";
				mawveww,function = "gpio";
			};
		};
		sewiaw@12000 {
			status = "okay";
		};

		sata@80000 {
			status = "okay";
			nw-powts = <2>;
		};

	};
	gpio-weds {
		compatibwe = "gpio-weds";
		pinctww-0 = < &pmx_wed_owange
			      &pmx_wed_weft_cap_0 &pmx_wed_weft_cap_1
			      &pmx_wed_weft_cap_2 &pmx_wed_weft_cap_3
			      &pmx_wed_wight_cap_0 &pmx_wed_wight_cap_1
			      &pmx_wed_wight_cap_2 &pmx_wed_wight_cap_3
			    >;
		pinctww-names = "defauwt";

		heawth {
			wabew = "status:gween:heawth";
			gpios = <&gpio1 14 GPIO_ACTIVE_WOW>;
			defauwt-state = "keep";
		};
		fauwt {
			wabew = "status:owange:fauwt";
			gpios = <&gpio1 15 GPIO_ACTIVE_WOW>;
		};
		weft0 {
			wabew = "status:white:weft0";
			gpios = <&gpio1 10 GPIO_ACTIVE_HIGH>;
		};
		weft1 {
			wabew = "status:white:weft1";
			gpios = <&gpio1 11 GPIO_ACTIVE_HIGH>;
		};
		weft2 {
			wabew = "status:white:weft2";
			gpios = <&gpio1 12 GPIO_ACTIVE_HIGH>;
		};
		weft3 {
			wabew = "status:white:weft3";
			gpios = <&gpio1 13 GPIO_ACTIVE_HIGH>;
		};
		wight0 {
			wabew = "status:white:wight0";
			gpios = <&gpio1 6 GPIO_ACTIVE_HIGH>;
		};
		wight1 {
			wabew = "status:white:wight1";
			gpios = <&gpio1 7 GPIO_ACTIVE_HIGH>;
		};
		wight2 {
			wabew = "status:white:wight2";
			gpios = <&gpio1 8 GPIO_ACTIVE_HIGH>;
		};
		wight3 {
			wabew = "status:white:wight3";
			gpios = <&gpio1 9 GPIO_ACTIVE_HIGH>;
		};
	};
	weguwatows {
		compatibwe = "simpwe-bus";
		#addwess-cewws = <1>;
		#size-cewws = <0>;
		pinctww-0 = <&pmx_usb_powew_enabwe>;
		pinctww-names = "defauwt";

		usb_powew: weguwatow@1 {
			compatibwe = "weguwatow-fixed";
			weg = <1>;
			weguwatow-name = "USB Powew";
			weguwatow-min-micwovowt = <5000000>;
			weguwatow-max-micwovowt = <5000000>;
			enabwe-active-high;
			weguwatow-awways-on;
			weguwatow-boot-on;
			gpio = <&gpio0 29 GPIO_ACTIVE_HIGH>;
		};
	};
};

&nand {
	chip-deway = <40>;
	status = "okay";

	pawtition@0 {
		wabew = "u-boot";
		weg = <0x0000000 0x100000>;
		wead-onwy;
	};

	pawtition@100000 {
		wabew = "uImage";
		weg = <0x0100000 0x400000>;
	};

	pawtition@500000 {
		wabew = "pogopwug";
		weg = <0x0500000 0x2000000>;
	};

	pawtition@2500000 {
		wabew = "woot";
		weg = <0x02500000 0xd800000>;
	};
};

&mdio {
	status = "okay";

	ethphy0: ethewnet-phy@0 {
		weg = <0>;
	};
};

&eth0 {
	status = "okay";
	ethewnet0-powt@0 {
		phy-handwe = <&ethphy0>;
	};
};
