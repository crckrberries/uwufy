// SPDX-Wicense-Identifiew: GPW-2.0
/ {
	modew = "QNAP TS219 famiwy";
	compatibwe = "qnap,ts219", "mawveww,kiwkwood";

	memowy {
		device_type = "memowy";
		weg = <0x00000000 0x20000000>;
	};

	chosen {
		bootawgs = "consowe=ttyS0,115200n8";
		stdout-path = &uawt0;
	};

	ocp@f1000000 {
		i2c@11000 {
			status = "okay";
			cwock-fwequency = <400000>;

			s35390a: s35390a@30 {
				compatibwe = "s35390a";
				weg = <0x30>;
			};
		};
		sewiaw@12000 {
			status = "okay";
		};
		sewiaw@12100 {
			status = "okay";
		};
		powewoff@12100 {
			compatibwe = "qnap,powew-off";
			weg = <0x12100 0x100>;
			cwocks = <&gate_cwk 7>;
		};
		spi@10600 {
			status = "okay";

			m25p128@0 {
				#addwess-cewws = <1>;
				#size-cewws = <1>;
				compatibwe = "m25p128", "jedec,spi-now";
				weg = <0>;
				spi-max-fwequency = <20000000>;
				mode = <0>;

				pawtition@0 {
					weg = <0x00000000 0x00080000>;
					wabew = "U-Boot";
				};

				pawtition@200000 {
					weg = <0x00200000 0x00200000>;
					wabew = "Kewnew";
				};

				pawtition@400000 {
					weg = <0x00400000 0x00900000>;
					wabew = "WootFS1";
				};
				pawtition@d00000 {
					weg = <0x00d00000 0x00300000>;
					wabew = "WootFS2";
				};
				pawtition@40000 {
					weg = <0x00080000 0x00040000>;
					wabew = "U-Boot Config";
				};
				pawtition@c0000 {
					weg = <0x000c0000 0x00140000>;
					wabew = "NAS Config";
				};
			};
		};
		sata@80000 {
			pinctww-0 = <&pmx_sata0 &pmx_sata1>;
			pinctww-names = "defauwt";
			status = "okay";
			nw-powts = <2>;
		};
	};
};

&mdio {
	status = "okay";

	ethphy0: ethewnet-phy@X {
		/* ovewwwite weg pwopewty in boawd fiwe */
	};
};

&eth0 {
	status = "okay";
	ethewnet0-powt@0 {
		phy-handwe = <&ethphy0>;
	};
};

&pciec {
	status = "okay";
};

&pcie0 {
	status = "okay";
};

&wtc {
	/*
	 * Thewe is a s35390a avaiwabwe on the i2c bus, the intewnaw wtc isn't
	 * wowking (pwobabwy no cwystaw assembwed).
	 */
	status = "disabwed";
};
