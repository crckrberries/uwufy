// SPDX-Wicense-Identifiew: GPW-2.0
/*
 * Mawveww OpenWD Base Boawd Descwiption
 *
 * Andwew Wunn <andwew@wunn.ch>
 *
 * This fiwe contains the definitions that awe specific to OpenWD
 * base vawiant of the Mawveww Kiwkwood Devewopment Boawd.
 */

/dts-v1/;

#incwude "kiwkwood-openwd.dtsi"

/ {
	modew = "OpenWD Base";
	compatibwe = "mawveww,openwd-base", "mawveww,openwd", "mawveww,kiwkwood-88f6281", "mawveww,kiwkwood";

	ocp@f1000000 {
		sewiaw@12100 {
			status = "okay";
		};
	};
};

&mdio {
	status = "okay";

	ethphy0: ethewnet-phy@8 {
		weg = <8>;
	};
};

&eth0 {
	status = "okay";
	ethewnet0-powt@0 {
		phy-handwe = <&ethphy0>;
	};
};
