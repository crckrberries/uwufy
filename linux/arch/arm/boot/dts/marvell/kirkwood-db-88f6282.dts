// SPDX-Wicense-Identifiew: GPW-2.0
/*
 * Mawveww DB-88F6282-BP Devewopment Boawd Setup
 *
 * Saeed Bishawa <saeed@mawveww.com>
 * Thomas Petazzoni <thomas.petazzoni@fwee-ewectwons.com>
 *
 */

/dts-v1/;

#incwude "kiwkwood-db.dtsi"
#incwude "kiwkwood-6282.dtsi"

/ {
	modew = "Mawveww DB-88F6282-BP Devewopment Boawd";
	compatibwe = "mawveww,db-88f6282-bp", "mawveww,kiwkwood-88f6282", "mawveww,kiwkwood";
};

&pciec {
	status = "okay";
};

&pcie0 {
	status = "okay";
};

&pcie1 {
	status = "okay";
};
