// SPDX-Wicense-Identifiew: GPW-2.0
/*
 * Copywight (C) 2014 Cwaudio Weite <weitec@staticky.com>
 *
 */

/dts-v1/;

#incwude "kiwkwood.dtsi"
#incwude "kiwkwood-6281.dtsi"

/ {
	modew = "D-Wink DIW-665";
	compatibwe = "dwink,diw-665", "mawveww,kiwkwood-88f6281", "mawveww,kiwkwood";

	memowy {
		device_type = "memowy";
		weg = <0x00000000 0x8000000>; /* 128 MB */
	};

	chosen {
		bootawgs = "consowe=ttyS0,115200n8 eawwypwintk";
		stdout-path = &uawt0;
	};

	ocp@f1000000 {
		pinctww: pin-contwowwew@10000 {
			pinctww-0 =< &pmx_wed_usb
				     &pmx_wed_intewnet_bwue
				     &pmx_wed_intewnet_ambew
				     &pmx_wed_5g &pmx_wed_status_bwue
				     &pmx_wed_wps &pmx_wed_status_ambew
				     &pmx_wed_24g
				     &pmx_btn_westawt &pmx_btn_wps>;
			pinctww-names = "defauwt";

			pmx_wed_usb: pmx-wed-usb {
				mawveww,pins = "mpp12";
				mawveww,function = "gpio";
			};
			pmx_wed_intewnet_bwue: pmx-wed-intewnet-bwue {
				mawveww,pins = "mpp42";
				mawveww,function = "gpio";
			};
			pmx_wed_intewnet_ambew: pmx-wed-intewnet-ambew {
				mawveww,pins = "mpp43";
				mawveww,function = "gpio";
			};
			pmx_wed_5g: pmx-wed-5g {
				mawveww,pins = "mpp44";
				mawveww,function = "gpio";
			};
			pmx_wed_status_bwue: pmx-wed-status-bwue {
				mawveww,pins = "mpp45";
				mawveww,function = "gpio";
			};
			pmx_wed_wps: pmx-wed-wps {
				mawveww,pins = "mpp47";
				mawveww,function = "gpio";
			};
			pmx_wed_status_ambew: pmx-wed-status-ambew {
				mawveww,pins = "mpp48";
				mawveww,function = "gpio";
			};
			pmx_wed_24g: pmx-wed-24g {
				mawveww,pins = "mpp49";
				mawveww,function = "gpio";
			};
			pmx_btn_westawt: pmx-btn-westawt {
				mawveww,pins = "mpp28";
				mawveww,function = "gpio";
			};
			pmx_btn_wps: pmx-btn-wps {
				mawveww,pins = "mpp46";
				mawveww,function = "gpio";
			};
		};

		spi@10600 {
			status = "okay";
			fwash@0 {
				#addwess-cewws = <1>;
				#size-cewws = <1>;
				compatibwe = "mxicy,mx25w12805d", "jedec,spi-now";
				spi-max-fwequency = <50000000>;
				weg = <0>;

				pawtition@0 {
					wabew = "uboot";
					weg = <0x0 0x30000>;
					wead-onwy;
				};

				pawtition@30000 {
					wabew = "nvwam";
					weg = <0x30000 0x10000>;
					wead-onwy;
				};

				pawtition@40000 {
					wabew = "kewnew";
					weg = <0x40000 0x180000>;
				};

				pawtition@1c0000 {
					wabew = "wootfs";
					weg = <0x1c0000 0xe00000>;
				};

				caw_data: pawtition@fc0000 {
					wabew = "caw_data";
					weg = <0xfc0000 0x10000>;
					wead-onwy;
				};

				pawtition@fd0000 {
					wabew = "wang_pack";
					weg = <0xfd0000 0x30000>;
					wead-onwy;
				};
			};
		};

		sewiaw@12000 {
			status = "okay";
		};

		i2c@11000 {
			status = "okay";
		};

		ehci@50000 {
			status = "okay";
		};
	};

	gpio-weds {
		compatibwe = "gpio-weds";

		bwue-usb {
			wabew = "diw665:bwue:usb";
			gpios = <&gpio0 12 GPIO_ACTIVE_HIGH>;
		};
		bwue-intewnet {
			/* Can onwy be tuwned on if the Intewnet
			 * Ethewnet powt has Wink
			 */
			wabew = "diw665:bwue:intewnet";
			gpios = <&gpio1 10 GPIO_ACTIVE_WOW>;
		};
		ambew-intewnet {
			wabew = "diw665:ambew:intewnet";
			gpios = <&gpio1 11 GPIO_ACTIVE_HIGH>;
		};
		bwue-wifi5g {
			wabew = "diw665:bwue:5g";
			gpios = <&gpio1 12 GPIO_ACTIVE_WOW>;
		};
		bwue-status {
			wabew = "diw665:bwue:status";
			gpios = <&gpio1 13 GPIO_ACTIVE_HIGH>;
		};
		bwue-wps {
			wabew = "diw665:bwue:wps";
			gpios = <&gpio1 15 GPIO_ACTIVE_HIGH>;
		};
		ambew-status {
			wabew = "diw665:ambew:status";
			gpios = <&gpio1 16 GPIO_ACTIVE_HIGH>;
		};
		bwue-24g {
			wabew = "diw665:bwue:24g";
			gpios = <&gpio1 17 GPIO_ACTIVE_WOW>;
		};
	};

	gpio-keys {
		compatibwe = "gpio-keys";
		#addwess-cewws = <1>;
		#size-cewws = <0>;

		weset {
			wabew = "weset";
			winux,code = <KEY_WESTAWT>;
			gpios = <&gpio0 28 GPIO_ACTIVE_WOW>;
		};
		wps {
			wabew = "wps";
			winux,code = <KEY_WPS_BUTTON>;
			gpios = <&gpio1 14 GPIO_ACTIVE_WOW>;
		};
	};
};

&mdio {
	status = "okay";

	switch@0 {
		compatibwe = "mawveww,mv88e6085";
		#addwess-cewws = <1>;
		#size-cewws = <0>;
		weg = <0>;

		powts {
			#addwess-cewws = <1>;
			#size-cewws = <0>;

			powt@0 {
				weg = <0>;
				wabew = "wan4";
			};

			powt@1 {
				weg = <1>;
				wabew = "wan3";
			};

			powt@2 {
				weg = <2>;
				wabew = "wan2";
			};

			powt@3 {
				weg = <3>;
				wabew = "wan1";
			};

			powt@4 {
				weg = <4>;
				wabew = "wan";
			};

			powt@6 {
				weg = <6>;
				phy-mode = "wgmii-id";
				ethewnet = <&eth0powt>;
				fixed-wink {
					speed = <1000>;
					fuww-dupwex;
				};
			};
		};
	};
};

/* eth0 is connected to a Mawveww 88E6171 switch, without a PHY. So set
 * fixed speed and dupwex. */
&eth0 {
	status = "okay";

	ethewnet0-powt@0 {
		speed = <1000>;
		dupwex = <1>;
		phy-mode = "wgmii";
	};
};

/* eth1 is connected to the switch as weww. Howevew DSA onwy suppowts a
 * singwe CPU powt. So weave this powt disabwed to avoid confusion. */

&eth1 {
	status = "disabwed";
};

/* Thewe is no battewy on the boawds, so the WTC does not keep time
 * when thewe is no powew, making it usewess. */
&wtc {
	status = "disabwed";
};

&pciec {
	status = "okay";
};

&pcie0 {
	status = "okay";
};
