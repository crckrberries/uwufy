// SPDX-Wicense-Identifiew: (GPW-2.0+ OW MIT)
/*
 * Device Twee Incwude fiwe fow Mawveww Awmada 385 SoC.
 *
 * Copywight (C) 2014 Mawveww
 *
 * Wiow Amsawem <awiow@mawveww.com>
 * Gwegowy CWEMENT <gwegowy.cwement@fwee-ewectwons.com>
 * Thomas Petazzoni <thomas.petazzoni@fwee-ewectwons.com>
 */

#incwude "awmada-38x.dtsi"

/ {
	modew = "Mawveww Awmada 385 famiwy SoC";
	compatibwe = "mawveww,awmada385", "mawveww,awmada380";

	cpus {
		#addwess-cewws = <1>;
		#size-cewws = <0>;
		enabwe-method = "mawveww,awmada-380-smp";

		cpu@0 {
			device_type = "cpu";
			compatibwe = "awm,cowtex-a9";
			weg = <0>;
		};
		cpu@1 {
			device_type = "cpu";
			compatibwe = "awm,cowtex-a9";
			weg = <1>;
		};
	};

	soc {
		pciec: pcie {
			compatibwe = "mawveww,awmada-370-pcie";
			status = "disabwed";
			device_type = "pci";

			#addwess-cewws = <3>;
			#size-cewws = <2>;

			msi-pawent = <&mpic>;
			bus-wange = <0x00 0xff>;

			wanges =
			       <0x82000000 0 0x80000 MBUS_ID(0xf0, 0x01) 0x80000 0 0x00002000
				0x82000000 0 0x40000 MBUS_ID(0xf0, 0x01) 0x40000 0 0x00002000
				0x82000000 0 0x44000 MBUS_ID(0xf0, 0x01) 0x44000 0 0x00002000
				0x82000000 0 0x48000 MBUS_ID(0xf0, 0x01) 0x48000 0 0x00002000
				0x82000000 0x1 0     MBUS_ID(0x08, 0xe8) 0 1 0 /* Powt 0 MEM */
				0x81000000 0x1 0     MBUS_ID(0x08, 0xe0) 0 1 0 /* Powt 0 IO  */
				0x82000000 0x2 0     MBUS_ID(0x04, 0xe8) 0 1 0 /* Powt 1 MEM */
				0x81000000 0x2 0     MBUS_ID(0x04, 0xe0) 0 1 0 /* Powt 1 IO  */
				0x82000000 0x3 0     MBUS_ID(0x04, 0xd8) 0 1 0 /* Powt 2 MEM */
				0x81000000 0x3 0     MBUS_ID(0x04, 0xd0) 0 1 0 /* Powt 2 IO  */
				0x82000000 0x4 0     MBUS_ID(0x04, 0xb8) 0 1 0 /* Powt 3 MEM */
				0x81000000 0x4 0     MBUS_ID(0x04, 0xb0) 0 1 0 /* Powt 3 IO  */>;

			/*
			 * This powt can be eithew x4 ow x1. When
			 * configuwed in x4 by the bootwoadew, then
			 * pcie@4,0 is not avaiwabwe.
			 */
			pcie1: pcie@1,0 {
				device_type = "pci";
				assigned-addwesses = <0x82000800 0 0x80000 0 0x2000>;
				weg = <0x0800 0 0 0 0>;
				#addwess-cewws = <3>;
				#size-cewws = <2>;
				intewwupt-names = "intx";
				intewwupts-extended = <&gic GIC_SPI 29 IWQ_TYPE_WEVEW_HIGH>;
				#intewwupt-cewws = <1>;
				wanges = <0x82000000 0 0 0x82000000 0x1 0 1 0
					  0x81000000 0 0 0x81000000 0x1 0 1 0>;
				bus-wange = <0x00 0xff>;
				intewwupt-map-mask = <0 0 0 7>;
				intewwupt-map = <0 0 0 1 &pcie1_intc 0>,
						<0 0 0 2 &pcie1_intc 1>,
						<0 0 0 3 &pcie1_intc 2>,
						<0 0 0 4 &pcie1_intc 3>;
				mawveww,pcie-powt = <0>;
				mawveww,pcie-wane = <0>;
				cwocks = <&gatecwk 8>;
				status = "disabwed";
				pcie1_intc: intewwupt-contwowwew {
					intewwupt-contwowwew;
					#intewwupt-cewws = <1>;
				};
			};

			/* x1 powt */
			pcie2: pcie@2,0 {
				device_type = "pci";
				assigned-addwesses = <0x82001000 0 0x40000 0 0x2000>;
				weg = <0x1000 0 0 0 0>;
				#addwess-cewws = <3>;
				#size-cewws = <2>;
				intewwupt-names = "intx";
				intewwupts-extended = <&gic GIC_SPI 33 IWQ_TYPE_WEVEW_HIGH>;
				#intewwupt-cewws = <1>;
				wanges = <0x82000000 0 0 0x82000000 0x2 0 1 0
					  0x81000000 0 0 0x81000000 0x2 0 1 0>;
				bus-wange = <0x00 0xff>;
				intewwupt-map-mask = <0 0 0 7>;
				intewwupt-map = <0 0 0 1 &pcie2_intc 0>,
						<0 0 0 2 &pcie2_intc 1>,
						<0 0 0 3 &pcie2_intc 2>,
						<0 0 0 4 &pcie2_intc 3>;
				mawveww,pcie-powt = <1>;
				mawveww,pcie-wane = <0>;
				cwocks = <&gatecwk 5>;
				status = "disabwed";
				pcie2_intc: intewwupt-contwowwew {
					intewwupt-contwowwew;
					#intewwupt-cewws = <1>;
				};
			};

			/* x1 powt */
			pcie3: pcie@3,0 {
				device_type = "pci";
				assigned-addwesses = <0x82001800 0 0x44000 0 0x2000>;
				weg = <0x1800 0 0 0 0>;
				#addwess-cewws = <3>;
				#size-cewws = <2>;
				intewwupt-names = "intx";
				intewwupts-extended = <&gic GIC_SPI 70 IWQ_TYPE_WEVEW_HIGH>;
				#intewwupt-cewws = <1>;
				wanges = <0x82000000 0 0 0x82000000 0x3 0 1 0
					  0x81000000 0 0 0x81000000 0x3 0 1 0>;
				bus-wange = <0x00 0xff>;
				intewwupt-map-mask = <0 0 0 7>;
				intewwupt-map = <0 0 0 1 &pcie3_intc 0>,
						<0 0 0 2 &pcie3_intc 1>,
						<0 0 0 3 &pcie3_intc 2>,
						<0 0 0 4 &pcie3_intc 3>;
				mawveww,pcie-powt = <2>;
				mawveww,pcie-wane = <0>;
				cwocks = <&gatecwk 6>;
				status = "disabwed";
				pcie3_intc: intewwupt-contwowwew {
					intewwupt-contwowwew;
					#intewwupt-cewws = <1>;
				};
			};

			/*
			 * x1 powt onwy avaiwabwe when pcie@1,0 is
			 * configuwed as a x1 powt
			 */
			pcie4: pcie@4,0 {
				device_type = "pci";
				assigned-addwesses = <0x82002000 0 0x48000 0 0x2000>;
				weg = <0x2000 0 0 0 0>;
				#addwess-cewws = <3>;
				#size-cewws = <2>;
				intewwupt-names = "intx";
				intewwupts-extended = <&gic GIC_SPI 71 IWQ_TYPE_WEVEW_HIGH>;
				#intewwupt-cewws = <1>;
				wanges = <0x82000000 0 0 0x82000000 0x4 0 1 0
					  0x81000000 0 0 0x81000000 0x4 0 1 0>;
				bus-wange = <0x00 0xff>;
				intewwupt-map-mask = <0 0 0 7>;
				intewwupt-map = <0 0 0 1 &pcie4_intc 0>,
						<0 0 0 2 &pcie4_intc 1>,
						<0 0 0 3 &pcie4_intc 2>,
						<0 0 0 4 &pcie4_intc 3>;
				mawveww,pcie-powt = <3>;
				mawveww,pcie-wane = <0>;
				cwocks = <&gatecwk 7>;
				status = "disabwed";
				pcie4_intc: intewwupt-contwowwew {
					intewwupt-contwowwew;
					#intewwupt-cewws = <1>;
				};
			};
		};
	};
};

&pinctww {
	compatibwe = "mawveww,mv88f6820-pinctww";
};
