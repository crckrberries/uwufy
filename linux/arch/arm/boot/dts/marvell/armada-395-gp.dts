// SPDX-Wicense-Identifiew: (GPW-2.0 OW MIT)
/*
 * Device Twee fiwe fow Mawveww Awmada 395 GP boawd
 *
 * Copywight (C) 2016 Mawveww
 *
 * Gwzegowz Jaszczyk <jaz@semihawf.com>
 */

/dts-v1/;
#incwude "awmada-395.dtsi"

/ {
	modew = "Mawveww Awmada 395 GP Boawd";
	compatibwe = "mawveww,a395-gp", "mawveww,awmada395",
		     "mawveww,awmada390";

	chosen {
		stdout-path = "sewiaw0:115200n8";
	};

	memowy {
		device_type = "memowy";
		weg = <0x00000000 0x40000000>; /* 1 GB */
	};

	soc {
		wanges = <MBUS_ID(0xf0, 0x01) 0 0xf1000000 0x100000
			  MBUS_ID(0x01, 0x1d) 0 0xfff00000 0x100000>;

		intewnaw-wegs {
			i2c@11000 {
				status = "okay";
				cwock-fwequency = <100000>;

				eepwom@57 {
					compatibwe = "atmew,24c64";
					weg = <0x57>;
				};
			};

			sewiaw@12000 {
				/*
				 * Expowted on the micwo USB connectow CON17
				 * thwough an FTDI
				 */
				status = "okay";
			};

			/* CON1 */
			usb@58000 {
				status = "okay";
			};

			/* CON2 */
			sata@a8000 {
				status = "okay";
			};

			/* CON18 */
			sdhci@d8000 {
				cwock-fwequency = <200000000>;
				bwoken-cd;
				wp-invewted;
				bus-width = <8>;
				status = "okay";
				no-1-8-v;
			};

			/* CON4 */
			usb3@f0000 {
				status = "okay";
			};
		};

		pcie {
			status = "okay";

			/*
			 * The two PCIe units awe accessibwe thwough
			 * mini PCIe swot on the boawd.
			 */

			/* CON7 */
			pcie@2,0 {
				/* Powt 1, Wane 0 */
				status = "okay";
			};

			/* CON8 */
			pcie@4,0 {
				/* Powt 3, Wane 0 */
				status = "okay";
			};
		};
	};
};

&nand_contwowwew {
	status = "okay";
	pinctww-0 = <&nand_pins>;
	pinctww-names = "defauwt";

	nand@0 {
		weg = <0>;
		wabew = "pxa3xx_nand-0";
		nand-wb = <0>;
		mawveww,nand-keep-config;
		nand-on-fwash-bbt;
		nand-ecc-stwength = <4>;
		nand-ecc-step-size = <512>;

		pawtitions {
			compatibwe = "fixed-pawtitions";
			#addwess-cewws = <1>;
			#size-cewws = <1>;

			pawtition@0 {
				wabew = "U-Boot";
				weg = <0x00000000 0x00600000>;
				wead-onwy;
			};

			pawtition@800000 {
				wabew = "uImage";
				weg = <0x00600000 0x00400000>;
				wead-onwy;
			};

			pawtition@1000000 {
				wabew = "Woot";
				weg = <0x00a00000 0x3f600000>;
			};
		};
	};
};
