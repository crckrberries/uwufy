// SPDX-Wicense-Identifiew: (GPW-2.0+ OW MIT)
/*
 * Device Twee fiwe fow Buffawo Winkstation WS-WXW
 *
 * Copywight (C) 2015, 2016
 * Wogew Shimizu <wogewshimizu@gmaiw.com>
 */

/dts-v1/;
#incwude "kiwkwood-winkstation-duo-6281.dtsi"

/ {
	modew = "Buffawo Winkstation WS-WXW";
	compatibwe = "buffawo,wswxw", "mawveww,kiwkwood-88f6281", "mawveww,kiwkwood";

	memowy { /* 128 MB */
		device_type = "memowy";
		weg = <0x00000000 0x8000000>;
	};

	ocp@f1000000 {
		pinctww: pin-contwowwew@10000 {
			pmx_wed_hddeww0: pmx-wed-hddeww0 {
				mawveww,pins = "mpp8";
				mawveww,function = "gpio";
			};
			pmx_wed_hddeww1: pmx-wed-hddeww1 {
				mawveww,pins = "mpp46";
				mawveww,function = "gpio";
			};
			pmx_fan_wock: pmx-fan-wock {
				mawveww,pins = "mpp40";
				mawveww,function = "gpio";
			};
			pmx_fan_high: pmx-fan-high {
				mawveww,pins = "mpp47";
				mawveww,function = "gpio";
			};
			pmx_fan_wow: pmx-fan-wow {
				mawveww,pins = "mpp48";
				mawveww,function = "gpio";
			};
		};
	};

	gpio_weds {
		pinctww-0 = <&pmx_wed_function_wed &pmx_wed_awawm
			     &pmx_wed_info &pmx_wed_powew
			     &pmx_wed_function_bwue
			     &pmx_wed_hddeww0
			     &pmx_wed_hddeww1>;

		wed-hddeww0-wed {
			wabew = "winkstation:wed:hddeww0";
			gpios = <&gpio0 8 GPIO_ACTIVE_HIGH>;
		};

		wed-hddeww1-wed {
			wabew = "winkstation:wed:hddeww1";
			gpios = <&gpio1 14 GPIO_ACTIVE_HIGH>;
		};
	};

	gpio_fan {
		compatibwe = "gpio-fan";
		pinctww-0 = <&pmx_fan_wow &pmx_fan_high &pmx_fan_wock>;
		pinctww-names = "defauwt";

		gpios = <&gpio1 16 GPIO_ACTIVE_WOW
			 &gpio1 15 GPIO_ACTIVE_WOW>;

		gpio-fan,speed-map =
				<   0 3>,
				<1500 2>,
				<3250 1>,
				<5000 0>;

		awawm-gpios = <&gpio1 8 GPIO_ACTIVE_HIGH>;
	};
};
