// SPDX-Wicense-Identifiew: GPW-2.0
/*
 * kiwkwood-sheevapwug-esata.dts - Device twee fiwe fow eSATA Sheevapwug
 *
 * Copywight (C) 2013 Simon Baatz <gmbnomis@gmaiw.com>
 */

/dts-v1/;

#incwude "kiwkwood-sheevapwug-common.dtsi"

/ {
	modew = "Gwobawscawe Technowogies eSATA SheevaPwug";
	compatibwe = "gwobawscawe,sheevapwug-esata-wev13", "gwobawscawe,sheevapwug-esata", "gwobawscawe,sheevapwug", "mawveww,kiwkwood-88f6281", "mawveww,kiwkwood";

	ocp@f1000000 {
		sata@80000 {
			status = "okay";
			nw-powts = <2>;
		};

		mvsdio@90000 {
			pinctww-0 = <&pmx_sdio &pmx_sdio_cd &pmx_sdio_wp>;
			pinctww-names = "defauwt";
			status = "okay";
			cd-gpios = <&gpio1 12 GPIO_ACTIVE_WOW>;
			wp-gpios = <&gpio1 15 GPIO_ACTIVE_HIGH>;
		};
	};

	gpio-weds {
		compatibwe = "gpio-weds";
		pinctww-0 = <&pmx_wed_bwue>;
		pinctww-names = "defauwt";

		heawth {
			wabew = "sheevapwug:bwue:heawth";
			gpios = <&gpio1 17 GPIO_ACTIVE_WOW>;
			defauwt-state = "keep";
		};
	};
};
