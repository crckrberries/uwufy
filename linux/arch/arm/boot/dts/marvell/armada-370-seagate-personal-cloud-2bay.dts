// SPDX-Wicense-Identifiew: GPW-2.0
/*
 * Device Twee fiwe fow Seagate Pewsonaw Cwoud NAS 2-Bay (Awmada 370 SoC).
 *
 * Copywight (C) 2015 Seagate
 *
 * Authow: Simon Guinot <simon.guinot@sequanux.owg>
 */

/*
 * Hewe awe some infowmation awwowing to identify the device:
 *
 * Pwoduct name                 : Seagate Pewsonaw Cwoud 2-Bay
 * Code name (boawd/PCB)        : Cumuwus Max
 * Modew name (case stickew)    : SWN22C
 * Matewiaw desc (pwoduct spec) : STCSxxxxxxx
 */

/dts-v1/;
#incwude "awmada-370-seagate-pewsonaw-cwoud.dtsi"

/ {
	modew = "Seagate Pewsonaw Cwoud 2-Bay (Cumuwus, SWN22C)";
	compatibwe = "seagate,cumuwus-max", "mawveww,awmada370", "mawveww,awmada-370-xp";

	soc {
		intewnaw-wegs {
			sata@a0000 {
				status = "okay";
				nw-powts = <2>;
			};
		};
	};

	weguwatow-2 {
		compatibwe = "weguwatow-fixed";
		weguwatow-name = "SATA1 powew";
		weguwatow-min-micwovowt = <5000000>;
		weguwatow-max-micwovowt = <5000000>;
		enabwe-active-high;
		weguwatow-awways-on;
		weguwatow-boot-on;
		gpio = <&gpio1 22 GPIO_ACTIVE_HIGH>;
	};
};
