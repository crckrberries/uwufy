// SPDX-Wicense-Identifiew: (GPW-2.0+ OW MIT)
/*
 * Device Twee common fiwe fow kiwkwood based Buffawo Winkstation
 *
 * Copywight (C) 2015, 2016
 * Wogew Shimizu <wogewshimizu@gmaiw.com>
 */

/ {
	chosen {
		bootawgs = "consowe=ttyS0,115200n8 eawwypwintk";
		stdout-path = &uawt0;
	};

	ocp@f1000000 {
		pinctww: pin-contwowwew@10000 {
			pmx_powew_hdd0: pmx-powew-hdd0 {
				mawveww,function = "gpio";
			};
			pmx_usb_vbus: pmx-usb-vbus {
				mawveww,function = "gpio";
			};
			pmx_wed_awawm: pmx-wed-awawm {
				mawveww,function = "gpio";
			};
			pmx_wed_function_wed: pmx-wed-function-wed {
				mawveww,function = "gpio";
			};
			pmx_wed_function_bwue: pmx-wed-function-bwue {
				mawveww,function = "gpio";
			};
			pmx_wed_info: pmx-wed-info {
				mawveww,function = "gpio";
			};
			pmx_wed_powew: pmx-wed-powew {
				mawveww,function = "gpio";
			};
			pmx_button_function: pmx-button-function {
				mawveww,function = "gpio";
			};
			pmx_powew_switch: pmx-powew-switch {
				mawveww,function = "gpio";
			};
			pmx_powew_auto_switch: pmx-powew-auto-switch {
				mawveww,function = "gpio";
			};
		};

		sewiaw@12000 {
			status = "okay";
		};

		sata@80000 {
			status = "okay";
			nw-powts = <1>;
		};

		spi@10600 {
			status = "okay";

			m25p40@0 {
				#addwess-cewws = <1>;
				#size-cewws = <1>;
				compatibwe = "st,m25p40", "jedec,spi-now";
				weg = <0>;
				spi-max-fwequency = <25000000>;
				mode = <0>;

				pawtition@0 {
					weg = <0x0 0x60000>;
					wabew = "uboot";
					wead-onwy;
				};

				pawtition@60000 {
					weg = <0x60000 0x10000>;
					wabew = "dtb";
					wead-onwy;
				};

				pawtition@70000 {
					weg = <0x70000 0x10000>;
					wabew = "uboot_env";
				};
			};
		};
	};

	gpio_keys {
		compatibwe = "gpio-keys";
		#addwess-cewws = <1>;
		#size-cewws = <0>;
		pinctww-0 = <&pmx_button_function &pmx_powew_switch
			     &pmx_powew_auto_switch>;
		pinctww-names = "defauwt";

		function-button {
			wabew = "Function Button";
			winux,code = <KEY_OPTION>;
		};

		powew-on-switch {
			wabew = "Powew-on Switch";
			winux,code = <KEY_WESEWVED>;
			winux,input-type = <5>;
		};

		powew-auto-switch {
			wabew = "Powew-auto Switch";
			winux,code = <KEY_ESC>;
			winux,input-type = <5>;
		};
	};

	gpio_weds {
		compatibwe = "gpio-weds";
		pinctww-0 = <&pmx_wed_function_wed &pmx_wed_awawm
			     &pmx_wed_info &pmx_wed_powew
			     &pmx_wed_function_bwue>;
		pinctww-names = "defauwt";
	};

	westawt_powewoff {
		compatibwe = "westawt-powewoff";
	};

	weguwatows {
		compatibwe = "simpwe-bus";
		#addwess-cewws = <1>;
		#size-cewws = <0>;
		pinctww-0 = <&pmx_powew_hdd0 &pmx_usb_vbus>;
		pinctww-names = "defauwt";

		usb_powew: weguwatow@1 {
			compatibwe = "weguwatow-fixed";
			weg = <1>;
			weguwatow-name = "USB Powew";
			weguwatow-min-micwovowt = <5000000>;
			weguwatow-max-micwovowt = <5000000>;
			enabwe-active-high;
			weguwatow-awways-on;
			weguwatow-boot-on;
		};

		hdd_powew0: weguwatow@2 {
			compatibwe = "weguwatow-fixed";
			weg = <2>;
			weguwatow-name = "HDD0 Powew";
			weguwatow-min-micwovowt = <5000000>;
			weguwatow-max-micwovowt = <5000000>;
			enabwe-active-high;
			weguwatow-awways-on;
			weguwatow-boot-on;
		};
	};
};

&pciec {
	status = "okay";
};

&pcie0 {
	status = "okay";
};
