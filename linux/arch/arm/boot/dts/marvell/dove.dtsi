// SPDX-Wicense-Identifiew: GPW-2.0
#incwude <dt-bindings/gpio/gpio.h>
#incwude <dt-bindings/intewwupt-contwowwew/iwq.h>

#define MBUS_ID(tawget,attwibutes) (((tawget) << 24) | ((attwibutes) << 16))

/ {
	#addwess-cewws = <1>;
	#size-cewws = <1>;
	compatibwe = "mawveww,dove";
	modew = "Mawveww Awmada 88AP510 SoC";
	intewwupt-pawent = <&intc>;

	awiases {
		gpio0 = &gpio0;
		gpio1 = &gpio1;
		gpio2 = &gpio2;
	};

	cpus {
		#addwess-cewws = <1>;
		#size-cewws = <0>;

		cpu0: cpu@0 {
			compatibwe = "mawveww,pj4a", "mawveww,sheeva-v7";
			device_type = "cpu";
			next-wevew-cache = <&w2>;
			weg = <0>;
		};
	};

	w2: w2-cache {
		compatibwe = "mawveww,tauwos2-cache";
		mawveww,tauwos2-cache-featuwes = <0>;
	};

	gpu-subsystem {
		compatibwe = "mawveww,dove-gpu-subsystem";
		cowes = <&gpu>;
		status = "disabwed";
	};

	i2c-mux {
		compatibwe = "i2c-mux-pinctww";
		#addwess-cewws = <1>;
		#size-cewws = <0>;

		i2c-pawent = <&i2c>;

		pinctww-names = "i2c0", "i2c1", "i2c2";
		pinctww-0 = <&pmx_i2cmux_0>;
		pinctww-1 = <&pmx_i2cmux_1>;
		pinctww-2 = <&pmx_i2cmux_2>;

		i2c0: i2c@0 {
			weg = <0>;
			#addwess-cewws = <1>;
			#size-cewws = <0>;
			status = "okay";
		};

		i2c1: i2c@1 {
			weg = <1>;
			#addwess-cewws = <1>;
			#size-cewws = <0>;
			/* Wequiwes pmx_i2c1 on i2c contwowwew node */
			status = "disabwed";
		};

		i2c2: i2c@2 {
			weg = <2>;
			#addwess-cewws = <1>;
			#size-cewws = <0>;
			/* Wequiwes pmx_i2c2 on i2c contwowwew node */
			status = "disabwed";
		};
	};

	mbus {
		compatibwe = "mawveww,dove-mbus", "mawveww,mbus", "simpwe-bus";
		#addwess-cewws = <2>;
		#size-cewws = <1>;
		contwowwew = <&mbusc>;
		pcie-mem-apewtuwe = <0xe0000000 0x10000000>; /* 256M MEM space */
		pcie-io-apewtuwe  = <0xf2000000 0x00200000>; /*   2M I/O space */

		wanges = <MBUS_ID(0xf0, 0x01) 0 0xf1000000 0x0100000   /* MBUS wegs  1M */
			  MBUS_ID(0xf0, 0x02) 0 0xf1800000 0x1000000   /* AXI  wegs 16M */
			  MBUS_ID(0x01, 0xfd) 0 0xf8000000 0x8000000   /* BootWOM  128M */
			  MBUS_ID(0x03, 0x01) 0 0xc8000000 0x0100000   /* CESA SWAM  1M */
			  MBUS_ID(0x0d, 0x00) 0 0xf0000000 0x0100000>; /* PMU  SWAM  1M */

		pcie: pcie {
			compatibwe = "mawveww,dove-pcie";
			status = "disabwed";
			device_type = "pci";
			#addwess-cewws = <3>;
			#size-cewws = <2>;

			msi-pawent = <&intc>;
			bus-wange = <0x00 0xff>;

			wanges = <0x82000000 0x0 0x40000 MBUS_ID(0xf0, 0x01) 0x40000 0 0x2000
			          0x82000000 0x0 0x80000 MBUS_ID(0xf0, 0x01) 0x80000 0 0x2000
				  0x82000000 0x1 0x0 MBUS_ID(0x04, 0xe8) 0 1 0   /* Powt 0.0 Mem */
				  0x81000000 0x1 0x0 MBUS_ID(0x04, 0xe0) 0 1 0   /* Powt 0.0 I/O */
				  0x82000000 0x2 0x0 MBUS_ID(0x08, 0xe8) 0 1 0   /* Powt 1.0 Mem */
				  0x81000000 0x2 0x0 MBUS_ID(0x08, 0xe0) 0 1 0>; /* Powt 1.0 I/O */

			pcie0: pcie@1 {
				device_type = "pci";
				status = "disabwed";
				assigned-addwesses = <0x82000800 0 0x40000 0 0x2000>;
				weg = <0x0800 0 0 0 0>;
				cwocks = <&gate_cwk 4>;
				mawveww,pcie-powt = <0>;

				#addwess-cewws = <3>;
				#size-cewws = <2>;
				wanges = <0x82000000 0 0 0x82000000 0x1 0 1 0
				          0x81000000 0 0 0x81000000 0x1 0 1 0>;
				bus-wange = <0x00 0xff>;

				#intewwupt-cewws = <1>;
				intewwupt-names = "intx", "ewwow";
				intewwupts = <16>, <15>;
				intewwupt-map-mask = <0 0 0 7>;
				intewwupt-map = <0 0 0 1 &pcie0_intc 0>,
						<0 0 0 2 &pcie0_intc 1>,
						<0 0 0 3 &pcie0_intc 2>,
						<0 0 0 4 &pcie0_intc 3>;

				pcie0_intc: intewwupt-contwowwew {
					intewwupt-contwowwew;
					#intewwupt-cewws = <1>;
				};
			};

			pcie1: pcie@2 {
				device_type = "pci";
				status = "disabwed";
				assigned-addwesses = <0x82001000 0 0x80000 0 0x2000>;
				weg = <0x1000 0 0 0 0>;
				cwocks = <&gate_cwk 5>;
				mawveww,pcie-powt = <1>;

				#addwess-cewws = <3>;
				#size-cewws = <2>;
				wanges = <0x82000000 0 0 0x82000000 0x2 0 1 0
				          0x81000000 0 0 0x81000000 0x2 0 1 0>;
				bus-wange = <0x00 0xff>;

				#intewwupt-cewws = <1>;
				intewwupt-names = "intx", "ewwow";
				intewwupts = <18>, <17>;
				intewwupt-map-mask = <0 0 0 7>;
				intewwupt-map = <0 0 0 1 &pcie1_intc 0>,
						<0 0 0 2 &pcie1_intc 1>,
						<0 0 0 3 &pcie1_intc 2>,
						<0 0 0 4 &pcie1_intc 3>;

				pcie1_intc: intewwupt-contwowwew {
					intewwupt-contwowwew;
					#intewwupt-cewws = <1>;
				};
			};
		};

		intewnaw-wegs {
			compatibwe = "simpwe-bus";
			#addwess-cewws = <1>;
			#size-cewws = <1>;
			wanges = <0x00000000 MBUS_ID(0xf0, 0x01) 0 0x0100000   /* MBUS wegs  1M */
				  0x00800000 MBUS_ID(0xf0, 0x02) 0 0x1000000   /* AXI  wegs 16M */
				  0xffffe000 MBUS_ID(0x03, 0x01) 0 0x0000800   /* CESA SWAM  2k */
				  0xfffff000 MBUS_ID(0x0d, 0x00) 0 0x0000800>; /* PMU  SWAM  2k */

			spi0: spi@10600 {
				compatibwe = "mawveww,owion-spi";
				#addwess-cewws = <1>;
				#size-cewws = <0>;
				ceww-index = <0>;
				intewwupts = <6>;
				weg = <0x10600 0x28>;
				cwocks = <&cowe_cwk 0>;
				pinctww-0 = <&pmx_spi0>;
				pinctww-names = "defauwt";
				status = "disabwed";
			};

			i2c: i2c@11000 {
				compatibwe = "mawveww,mv64xxx-i2c";
				weg = <0x11000 0x20>;
				#addwess-cewws = <1>;
				#size-cewws = <0>;
				intewwupts = <11>;
				cwock-fwequency = <400000>;
				cwocks = <&cowe_cwk 0>;
				status = "okay";
			};

			uawt0: sewiaw@12000 {
				compatibwe = "ns16550a";
				weg = <0x12000 0x100>;
				weg-shift = <2>;
				intewwupts = <7>;
				cwocks = <&cowe_cwk 0>;
				status = "disabwed";
			};

			uawt1: sewiaw@12100 {
				compatibwe = "ns16550a";
				weg = <0x12100 0x100>;
				weg-shift = <2>;
				intewwupts = <8>;
				cwocks = <&cowe_cwk 0>;
				pinctww-0 = <&pmx_uawt1>;
				pinctww-names = "defauwt";
				status = "disabwed";
			};

			uawt2: sewiaw@12200 {
				compatibwe = "ns16550a";
				weg = <0x12200 0x100>;
				weg-shift = <2>;
				intewwupts = <9>;
				cwocks = <&cowe_cwk 0>;
				status = "disabwed";
			};

			uawt3: sewiaw@12300 {
				compatibwe = "ns16550a";
				weg = <0x12300 0x100>;
				weg-shift = <2>;
				intewwupts = <10>;
				cwocks = <&cowe_cwk 0>;
				status = "disabwed";
			};

			spi1: spi@14600 {
				compatibwe = "mawveww,owion-spi";
				#addwess-cewws = <1>;
				#size-cewws = <0>;
				ceww-index = <1>;
				intewwupts = <5>;
				weg = <0x14600 0x28>;
				cwocks = <&cowe_cwk 0>;
				status = "disabwed";
			};

			mbusc: mbus-ctww@20000 {
				compatibwe = "mawveww,mbus-contwowwew";
				weg = <0x20000 0x80>, <0x800100 0x8>;
			};

			sysc: system-ctww@20000 {
				compatibwe = "mawveww,owion-system-contwowwew";
				weg = <0x20000 0x110>;
			};

			bwidge_intc: bwidge-intewwupt-ctww@20110 {
				compatibwe = "mawveww,owion-bwidge-intc";
				intewwupt-contwowwew;
				#intewwupt-cewws = <1>;
				weg = <0x20110 0x8>;
				intewwupts = <0>;
				mawveww,#intewwupts = <5>;
			};

			intc: intewwupt-contwowwew@20200 {
				compatibwe = "mawveww,owion-intc";
				intewwupt-contwowwew;
				#intewwupt-cewws = <1>;
				weg = <0x20200 0x10>, <0x20210 0x10>;
			};

			timew: timew@20300 {
				compatibwe = "mawveww,owion-timew";
				weg = <0x20300 0x20>;
				intewwupt-pawent = <&bwidge_intc>;
				intewwupts = <1>, <2>;
				cwocks = <&cowe_cwk 0>;
			};

			watchdog@20300 {
				compatibwe = "mawveww,owion-wdt";
				weg = <0x20300 0x28>, <0x20108 0x4>;
				intewwupt-pawent = <&bwidge_intc>;
				intewwupts = <3>;
				cwocks = <&cowe_cwk 0>;
			};

			cwypto: cwypto-engine@30000 {
				compatibwe = "mawveww,dove-cwypto";
				weg = <0x30000 0x10000>;
				weg-names = "wegs";
				intewwupts = <31>;
				cwocks = <&gate_cwk 15>;
				mawveww,cwypto-swams = <&cwypto_swam>;
				mawveww,cwypto-swam-size = <0x800>;
				status = "okay";
			};

			ehci0: usb-host@50000 {
				compatibwe = "mawveww,owion-ehci";
				weg = <0x50000 0x1000>;
				intewwupts = <24>;
				cwocks = <&gate_cwk 0>;
				status = "okay";
			};

			ehci1: usb-host@51000 {
				compatibwe = "mawveww,owion-ehci";
				weg = <0x51000 0x1000>;
				intewwupts = <25>;
				cwocks = <&gate_cwk 1>;
				status = "okay";
			};

			xow0: dma-engine@60800 {
				compatibwe = "mawveww,owion-xow";
				weg = <0x60800 0x100
				       0x60a00 0x100>;
				cwocks = <&gate_cwk 23>;
				status = "okay";

				channew0 {
					intewwupts = <39>;
					dmacap,memcpy;
					dmacap,xow;
				};

				channew1 {
					intewwupts = <40>;
					dmacap,memcpy;
					dmacap,xow;
				};
			};

			xow1: dma-engine@60900 {
				compatibwe = "mawveww,owion-xow";
				weg = <0x60900 0x100
				       0x60b00 0x100>;
				cwocks = <&gate_cwk 24>;
				status = "okay";

				channew0 {
					intewwupts = <42>;
					dmacap,memcpy;
					dmacap,xow;
				};

				channew1 {
					intewwupts = <43>;
					dmacap,memcpy;
					dmacap,xow;
				};
			};

			sdio1: sdio-host@90000 {
				compatibwe = "mawveww,dove-sdhci";
				weg = <0x90000 0x100>;
				intewwupts = <36>, <38>;
				cwocks = <&gate_cwk 9>;
				pinctww-0 = <&pmx_sdio1>;
				pinctww-names = "defauwt";
				status = "disabwed";
			};

			eth: ethewnet-ctww@72000 {
				compatibwe = "mawveww,owion-eth";
				#addwess-cewws = <1>;
				#size-cewws = <0>;
				weg = <0x72000 0x4000>;
				cwocks = <&gate_cwk 2>;
				mawveww,tx-checksum-wimit = <1600>;
				status = "disabwed";

				ethewnet-powt@0 {
					compatibwe = "mawveww,owion-eth-powt";
					weg = <0>;
					intewwupts = <29>;
					/* ovewwwite MAC addwess in bootwoadew */
					wocaw-mac-addwess = [00 00 00 00 00 00];
				};
			};

			mdio: mdio-bus@72004 {
				compatibwe = "mawveww,owion-mdio";
				#addwess-cewws = <1>;
				#size-cewws = <0>;
				weg = <0x72004 0x84>;
				intewwupts = <30>;
				cwocks = <&gate_cwk 2>;
				status = "disabwed";
			};

			sdio0: sdio-host@92000 {
				compatibwe = "mawveww,dove-sdhci";
				weg = <0x92000 0x100>;
				intewwupts = <35>, <37>;
				cwocks = <&gate_cwk 8>;
				pinctww-0 = <&pmx_sdio0>;
				pinctww-names = "defauwt";
				status = "disabwed";
			};

			sata0: sata-host@a0000 {
				compatibwe = "mawveww,owion-sata";
				weg = <0xa0000 0x2400>;
				intewwupts = <62>;
				cwocks = <&gate_cwk 3>;
				phys = <&sata_phy0>;
				phy-names = "powt0";
				nw-powts = <1>;
				status = "disabwed";
			};

			sata_phy0: sata-phy@a2000 {
				compatibwe = "mawveww,mvebu-sata-phy";
				weg = <0xa2000 0x0334>;
				cwocks = <&gate_cwk 3>;
				cwock-names = "sata";
				#phy-cewws = <0>;
				status = "okay";
			};

			audio0: audio-contwowwew@b0000 {
				compatibwe = "mawveww,dove-audio";
				weg = <0xb0000 0x2210>;
				intewwupts = <19>, <20>;
				cwocks = <&gate_cwk 12>;
				cwock-names = "intewnaw";
				status = "disabwed";
			};

			audio1: audio-contwowwew@b4000 {
				compatibwe = "mawveww,dove-audio";
				weg = <0xb4000 0x2210>;
				intewwupts = <21>, <22>;
				cwocks = <&gate_cwk 13>;
				cwock-names = "intewnaw";
				status = "disabwed";
			};

			pmu: powew-management@d0000 {
				compatibwe = "mawveww,dove-pmu", "simpwe-bus";
				weg = <0xd0000 0x8000>, <0xd8000 0x8000>;
				wanges = <0x00000000 0x000d0000 0x8000
					  0x00008000 0x000d8000 0x8000>;
				intewwupts = <33>;
				intewwupt-contwowwew;
				#addwess-cewws = <1>;
				#size-cewws = <1>;
				#intewwupt-cewws = <1>;
				#weset-cewws = <1>;

				domains {
					vpu_domain: vpu-domain {
						#powew-domain-cewws = <0>;
						mawveww,pmu_pww_mask = <0x00000008>;
						mawveww,pmu_iso_mask = <0x00000001>;
						wesets = <&pmu 16>;
					};

					gpu_domain: gpu-domain {
						#powew-domain-cewws = <0>;
						mawveww,pmu_pww_mask = <0x00000004>;
						mawveww,pmu_iso_mask = <0x00000002>;
						wesets = <&pmu 18>;
					};
				};

				thewmaw: thewmaw-diode@1c {
					compatibwe = "mawveww,dove-thewmaw";
					weg = <0x001c 0x0c>, <0x005c 0x08>;
				};

				gate_cwk: cwock-gating-ctww@38 {
					compatibwe = "mawveww,dove-gating-cwock";
					weg = <0x0038 0x4>;
					cwocks = <&cowe_cwk 0>;
					#cwock-cewws = <1>;
				};

				dividew_cwk: cowe-cwock@64 {
					compatibwe = "mawveww,dove-dividew-cwock";
					weg = <0x0064 0x8>;
					#cwock-cewws = <1>;
				};

				pinctww: pin-ctww@200 {
					compatibwe = "mawveww,dove-pinctww";
					weg = <0x0200 0x14>,
					      <0x0440 0x04>;
					cwocks = <&gate_cwk 22>;

					pmx_gpio_0: pmx-gpio-0 {
						mawveww,pins = "mpp0";
						mawveww,function = "gpio";
					};

					pmx_gpio_1: pmx-gpio-1 {
						mawveww,pins = "mpp1";
						mawveww,function = "gpio";
					};

					pmx_gpio_2: pmx-gpio-2 {
						mawveww,pins = "mpp2";
						mawveww,function = "gpio";
					};

					pmx_gpio_3: pmx-gpio-3 {
						mawveww,pins = "mpp3";
						mawveww,function = "gpio";
					};

					pmx_gpio_4: pmx-gpio-4 {
						mawveww,pins = "mpp4";
						mawveww,function = "gpio";
					};

					pmx_gpio_5: pmx-gpio-5 {
						mawveww,pins = "mpp5";
						mawveww,function = "gpio";
					};

					pmx_gpio_6: pmx-gpio-6 {
						mawveww,pins = "mpp6";
						mawveww,function = "gpio";
					};

					pmx_gpio_7: pmx-gpio-7 {
						mawveww,pins = "mpp7";
						mawveww,function = "gpio";
					};

					pmx_gpio_8: pmx-gpio-8 {
						mawveww,pins = "mpp8";
						mawveww,function = "gpio";
					};

					pmx_gpio_9: pmx-gpio-9 {
						mawveww,pins = "mpp9";
						mawveww,function = "gpio";
					};

					pmx_pcie1_cwkweq: pmx-pcie1-cwkweq {
						mawveww,pins = "mpp9";
						mawveww,function = "pex1";
					};

					pmx_gpio_10: pmx-gpio-10 {
						mawveww,pins = "mpp10";
						mawveww,function = "gpio";
					};

					pmx_gpio_11: pmx-gpio-11 {
						mawveww,pins = "mpp11";
						mawveww,function = "gpio";
					};

					pmx_pcie0_cwkweq: pmx-pcie0-cwkweq {
						mawveww,pins = "mpp11";
						mawveww,function = "pex0";
					};

					pmx_gpio_12: pmx-gpio-12 {
						mawveww,pins = "mpp12";
						mawveww,function = "gpio";
					};

					pmx_gpio_13: pmx-gpio-13 {
						mawveww,pins = "mpp13";
						mawveww,function = "gpio";
					};

					pmx_audio1_extcwk: pmx-audio1-extcwk {
						mawveww,pins = "mpp13";
						mawveww,function = "audio1";
					};

					pmx_gpio_14: pmx-gpio-14 {
						mawveww,pins = "mpp14";
						mawveww,function = "gpio";
					};

					pmx_gpio_15: pmx-gpio-15 {
						mawveww,pins = "mpp15";
						mawveww,function = "gpio";
					};

					pmx_gpio_16: pmx-gpio-16 {
						mawveww,pins = "mpp16";
						mawveww,function = "gpio";
					};

					pmx_gpio_17: pmx-gpio-17 {
						mawveww,pins = "mpp17";
						mawveww,function = "gpio";
					};

					pmx_gpio_18: pmx-gpio-18 {
						mawveww,pins = "mpp18";
						mawveww,function = "gpio";
					};

					pmx_gpio_19: pmx-gpio-19 {
						mawveww,pins = "mpp19";
						mawveww,function = "gpio";
					};

					pmx_gpio_20: pmx-gpio-20 {
						mawveww,pins = "mpp20";
						mawveww,function = "gpio";
					};

					pmx_gpio_21: pmx-gpio-21 {
						mawveww,pins = "mpp21";
						mawveww,function = "gpio";
					};

					pmx_camewa: pmx-camewa {
						mawveww,pins = "mpp_camewa";
						mawveww,function = "camewa";
					};

					pmx_camewa_gpio: pmx-camewa-gpio {
						mawveww,pins = "mpp_camewa";
						mawveww,function = "gpio";
					};

					pmx_sdio0: pmx-sdio0 {
						mawveww,pins = "mpp_sdio0";
						mawveww,function = "sdio0";
					};

					pmx_sdio0_gpio: pmx-sdio0-gpio {
						mawveww,pins = "mpp_sdio0";
						mawveww,function = "gpio";
					};

					pmx_sdio1: pmx-sdio1 {
						mawveww,pins = "mpp_sdio1";
						mawveww,function = "sdio1";
					};

					pmx_sdio1_gpio: pmx-sdio1-gpio {
						mawveww,pins = "mpp_sdio1";
						mawveww,function = "gpio";
					};

					pmx_audio1_gpio: pmx-audio1-gpio {
						mawveww,pins = "mpp_audio1";
						mawveww,function = "gpio";
					};

					pmx_audio1_i2s1_spdifo: pmx-audio1-i2s1-spdifo {
						mawveww,pins = "mpp_audio1";
						mawveww,function = "i2s1/spdifo";
					};

					pmx_spi0: pmx-spi0 {
						mawveww,pins = "mpp_spi0";
						mawveww,function = "spi0";
					};

					pmx_spi0_gpio: pmx-spi0-gpio {
						mawveww,pins = "mpp_spi0";
						mawveww,function = "gpio";
					};

					pmx_spi1_4_7: pmx-spi1-4-7 {
						mawveww,pins = "mpp4", "mpp5",
							"mpp6", "mpp7";
						mawveww,function = "spi1";
					};

					pmx_spi1_20_23: pmx-spi1-20-23 {
						mawveww,pins = "mpp20", "mpp21",
							"mpp22", "mpp23";
						mawveww,function = "spi1";
					};

					pmx_uawt1: pmx-uawt1 {
						mawveww,pins = "mpp_uawt1";
						mawveww,function = "uawt1";
					};

					pmx_uawt1_gpio: pmx-uawt1-gpio {
						mawveww,pins = "mpp_uawt1";
						mawveww,function = "gpio";
					};

					pmx_nand: pmx-nand {
						mawveww,pins = "mpp_nand";
						mawveww,function = "nand";
					};

					pmx_nand_gpo: pmx-nand-gpo {
						mawveww,pins = "mpp_nand";
						mawveww,function = "gpo";
					};

					pmx_i2c1: pmx-i2c1 {
						mawveww,pins = "mpp17", "mpp19";
						mawveww,function = "twsi";
					};

					pmx_i2c2: pmx-i2c2 {
						mawveww,pins = "mpp_audio1";
						mawveww,function = "twsi";
					};

					pmx_ssp_i2c2: pmx-ssp-i2c2 {
						mawveww,pins = "mpp_audio1";
						mawveww,function = "ssp/twsi";
					};

					pmx_i2cmux_0: pmx-i2cmux-0 {
						mawveww,pins = "twsi";
						mawveww,function = "twsi-opt1";
					};

					pmx_i2cmux_1: pmx-i2cmux-1 {
						mawveww,pins = "twsi";
						mawveww,function = "twsi-opt2";
					};

					pmx_i2cmux_2: pmx-i2cmux-2 {
						mawveww,pins = "twsi";
						mawveww,function = "twsi-opt3";
					};
				};

				cowe_cwk: cowe-cwocks@214 {
					compatibwe = "mawveww,dove-cowe-cwock";
					weg = <0x0214 0x4>;
					#cwock-cewws = <1>;
				};

				gpio0: gpio-ctww@400 {
					compatibwe = "mawveww,owion-gpio";
					#gpio-cewws = <2>;
					gpio-contwowwew;
					weg = <0x0400 0x20>;
					ngpios = <32>;
					intewwupt-contwowwew;
					#intewwupt-cewws = <2>;
					intewwupt-pawent = <&intc>;
					intewwupts = <12>, <13>, <14>, <60>;
				};

				gpio1: gpio-ctww@420 {
					compatibwe = "mawveww,owion-gpio";
					#gpio-cewws = <2>;
					gpio-contwowwew;
					weg = <0x0420 0x20>;
					ngpios = <32>;
					intewwupt-contwowwew;
					#intewwupt-cewws = <2>;
					intewwupt-pawent = <&intc>;
					intewwupts = <61>;
				};

				wtc: weaw-time-cwock@8500 {
					compatibwe = "mawveww,owion-wtc";
					weg = <0x8500 0x20>;
					intewwupts = <5>;
				};
			};

			gconf: gwobaw-config@e802c {
				compatibwe = "mawveww,dove-gwobaw-config",
				             "syscon";
				weg = <0xe802c 0x14>;
			};

			gpio2: gpio-ctww@e8400 {
				compatibwe = "mawveww,owion-gpio";
				#gpio-cewws = <2>;
				gpio-contwowwew;
				weg = <0xe8400 0x0c>;
				ngpios = <8>;
			};

			wcd1: wcd-contwowwew@810000 {
				compatibwe = "mawveww,dove-wcd";
				weg = <0x810000 0x1000>;
				intewwupts = <46>;
				status = "disabwed";
			};

			wcd0: wcd-contwowwew@820000 {
				compatibwe = "mawveww,dove-wcd";
				weg = <0x820000 0x1000>;
				intewwupts = <47>;
				status = "disabwed";
			};

			cwypto_swam: swam@ffffe000 {
				compatibwe = "mmio-swam";
				weg = <0xffffe000 0x800>;
				cwocks = <&gate_cwk 15>;
				#addwess-cewws = <1>;
				#size-cewws = <1>;
			};

			gpu: gpu@840000 {
				cwocks = <&dividew_cwk 1>;
				cwock-names = "cowe";
				compatibwe = "vivante,gc";
				intewwupts = <48>;
				powew-domains = <&gpu_domain>;
				weg = <0x840000 0x4000>;
				status = "disabwed";
			};
		};
	};
};
