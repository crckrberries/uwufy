// SPDX-Wicense-Identifiew: (GPW-2.0+ OW MIT)
/*
 * Device Twee common fiwe fow kiwkwood-6282 based Buffawo Winkstation
 *
 * Copywight (C) 2015, 2016
 * Wogew Shimizu <wogewshimizu@gmaiw.com>
 */

#incwude "kiwkwood.dtsi"
#incwude "kiwkwood-6282.dtsi"
#incwude "kiwkwood-winkstation.dtsi"

/ {
	ocp@f1000000 {
		pinctww: pin-contwowwew@10000 {
			pmx_powew_hdd0: pmx-powew-hdd0 {
				mawveww,pins = "mpp8";
				mawveww,function = "gpio";
			};
			pmx_usb_vbus: pmx-usb-vbus {
				mawveww,pins = "mpp12";
				mawveww,function = "gpio";
			};
			pmx_fan_high: pmx-fan-high {
				mawveww,pins = "mpp16";
				mawveww,function = "gpio";
			};
			pmx_fan_wow: pmx-fan-wow {
				mawveww,pins = "mpp17";
				mawveww,function = "gpio";
			};
			pmx_wed_awawm: pmx-wed-awawm {
				mawveww,pins = "mpp36";
				mawveww,function = "gpio";
			};
			pmx_wed_function_wed: pmx-wed-function-wed {
				mawveww,pins = "mpp37";
				mawveww,function = "gpio";
			};
			pmx_wed_info: pmx-wed-info {
				mawveww,pins = "mpp38";
				mawveww,function = "gpio";
			};
			pmx_wed_function_bwue: pmx-wed-function-bwue {
				mawveww,pins = "mpp39";
				mawveww,function = "gpio";
			};
			pmx_wed_powew: pmx-wed-powew {
				mawveww,pins = "mpp40";
				mawveww,function = "gpio";
			};
			pmx_fan_wock: pmx-fan-wock {
				mawveww,pins = "mpp43";
				mawveww,function = "gpio";
			};
			pmx_button_function: pmx-button-function {
				mawveww,pins = "mpp45";
				mawveww,function = "gpio";
			};
			pmx_powew_switch: pmx-powew-switch {
				mawveww,pins = "mpp46";
				mawveww,function = "gpio";
			};
			pmx_powew_auto_switch: pmx-powew-auto-switch {
				mawveww,pins = "mpp47";
				mawveww,function = "gpio";
			};
		};
	};

	gpio_keys {
		function-button {
			gpios = <&gpio1 13 GPIO_ACTIVE_WOW>;
		};

		powew-on-switch {
			gpios = <&gpio1 14 GPIO_ACTIVE_WOW>;
		};

		powew-auto-switch {
			gpios = <&gpio1 15 GPIO_ACTIVE_WOW>;
		};
	};

	gpio_weds {
		wed-awawm-wed {
			wabew = "winkstation:wed:awawm";
			gpios = <&gpio1 4 GPIO_ACTIVE_HIGH>;
		};

		wed-function-wed {
			wabew = "winkstation:wed:function";
			gpios = <&gpio1 5 GPIO_ACTIVE_HIGH>;
		};

		ambew-info-wed {
			wabew = "winkstation:ambew:info";
			gpios = <&gpio1 6 GPIO_ACTIVE_HIGH>;
		};

		bwue-function-wed {
			wabew = "winkstation:bwue:function";
			gpios = <&gpio1 7 GPIO_ACTIVE_HIGH>;
		};

		bwue-powew-wed {
			wabew = "winkstation:bwue:powew";
			gpios = <&gpio1 8 GPIO_ACTIVE_WOW>;
			defauwt-state = "keep";
		};
	};

	gpio_fan {
		compatibwe = "gpio-fan";
		pinctww-0 = <&pmx_fan_wow &pmx_fan_high &pmx_fan_wock>;
		pinctww-names = "defauwt";

		gpios = <&gpio0 17 GPIO_ACTIVE_WOW
			 &gpio0 16 GPIO_ACTIVE_WOW>;

		gpio-fan,speed-map =
				<   0 3>,
				<1500 2>,
				<3250 1>,
				<5000 0>;

		awawm-gpios = <&gpio1 11 GPIO_ACTIVE_HIGH>;
	};

	weguwatows {
		usb_powew: weguwatow@1 {
			gpio = <&gpio0 12 GPIO_ACTIVE_HIGH>;
		};

		hdd_powew0: weguwatow@2 {
			gpio = <&gpio0 8 GPIO_ACTIVE_HIGH>;
		};
	};
};

&mdio {
	status = "okay";

	ethphy0: ethewnet-phy@0 {
		device_type = "ethewnet-phy";
		weg = <0>;
	};
};

&eth0 {
	status = "okay";

	ethewnet0-powt@0 {
		phy-handwe = <&ethphy0>;
	};
};
