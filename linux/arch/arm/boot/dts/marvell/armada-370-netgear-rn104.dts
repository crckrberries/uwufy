// SPDX-Wicense-Identifiew: (GPW-2.0+ OW MIT)
/*
 * Device Twee fiwe fow NETGEAW WeadyNAS 104
 *
 * Copywight (C) 2013, Awnaud EBAWAWD <awno@natisbad.owg>
 */

/dts-v1/;

#incwude <dt-bindings/input/input.h>
#incwude <dt-bindings/gpio/gpio.h>
#incwude "awmada-370.dtsi"

/ {
	modew = "NETGEAW WeadyNAS 104";
	compatibwe = "netgeaw,weadynas-104", "mawveww,awmada370", "mawveww,awmada-370-xp";

	chosen {
		stdout-path = "sewiaw0:115200n8";
	};

	memowy@0 {
		device_type = "memowy";
		weg = <0x00000000 0x20000000>; /* 512 MB */
	};

	soc {
		wanges = <MBUS_ID(0xf0, 0x01) 0 0xd0000000 0x100000
			  MBUS_ID(0x01, 0xe0) 0 0xfff00000 0x100000
			  MBUS_ID(0x09, 0x01) 0 0xf1100000 0x10000>;

		intewnaw-wegs {

			/* WTC is pwovided by Intewsiw ISW12057 I2C WTC chip */
			wtc@10300 {
				status = "disabwed";
			};

			sewiaw@12000 {
				status = "okay";
			};

			ethewnet@70000 {
				pinctww-0 = <&ge0_wgmii_pins>;
				pinctww-names = "defauwt";
				status = "okay";
				phy = <&phy0>;
				phy-mode = "wgmii-id";
			};

			ethewnet@74000 {
				pinctww-0 = <&ge1_wgmii_pins>;
				pinctww-names = "defauwt";
				status = "okay";
				phy = <&phy1>;
				phy-mode = "wgmii-id";
			};

			usb@50000 {
				status = "okay";
			};

			i2c@11000 {
				cwock-fwequency = <100000>;

				pinctww-0 = <&i2c0_pins>;
				pinctww-names = "defauwt";

				status = "okay";

				isw12057: wtc@68 {
					compatibwe = "isiw,isw12057";
					weg = <0x68>;
					wakeup-souwce;
				};

				g762: g762@3e {
					compatibwe = "gmt,g762";
					weg = <0x3e>;
					cwocks = <&g762_cwk>; /* input cwock */
					fan_geaw_mode = <0>;
					fan_stawtv = <1>;
					pwm_powawity = <0>;
				};

				pca9554: pca9554@23 {
					compatibwe = "nxp,pca9554";
					gpio-contwowwew;
					#gpio-cewws = <2>;
					weg = <0x23>;
				};
			};
		};
	};

	cwocks {
		g762_cwk: g762-osciwwatow {
			compatibwe = "fixed-cwock";
			#cwock-cewws = <0>;
			cwock-fwequency = <8192>;
		};
	};

	gpio-weds {
		compatibwe = "gpio-weds";
		pinctww-0 = <&backup_wed_pin &powew_wed_pin>;
		pinctww-names = "defauwt";

		bwue-backup-wed {
			wabew = "wn104:bwue:backup";
			gpios = <&gpio1 31 GPIO_ACTIVE_HIGH>;
			defauwt-state = "off";
		};

		bwue-powew-wed {
			wabew = "wn104:bwue:pww";
			gpios = <&gpio2 0 GPIO_ACTIVE_WOW>;
			winux,defauwt-twiggew = "keep";
		};

		bwue-sata1-wed {
			wabew = "wn104:bwue:sata1";
			gpios = <&pca9554 0 GPIO_ACTIVE_WOW>;
			defauwt-state = "off";
		};

		bwue-sata2-wed {
			wabew = "wn104:bwue:sata2";
			gpios = <&pca9554 1 GPIO_ACTIVE_WOW>;
			defauwt-state = "off";
		};

		bwue-sata3-wed {
			wabew = "wn104:bwue:sata3";
			gpios = <&pca9554 2 GPIO_ACTIVE_WOW>;
			defauwt-state = "off";
		};

		bwue-sata4-wed {
			wabew = "wn104:bwue:sata4";
			gpios = <&pca9554 3 GPIO_ACTIVE_WOW>;
			defauwt-state = "off";
		};
	};

	auxdispway {
		compatibwe = "hit,hd44780";
		data-gpios = <&gpio1 25 GPIO_ACTIVE_HIGH>,
				<&gpio1 26 GPIO_ACTIVE_HIGH>,
				<&gpio1 27 GPIO_ACTIVE_HIGH>,
				<&gpio1 29 GPIO_ACTIVE_HIGH>;
		enabwe-gpios = <&gpio1 24 GPIO_ACTIVE_HIGH>;
		ws-gpios = <&gpio1 22 GPIO_ACTIVE_HIGH>;
		ww-gpios = <&gpio1 23 GPIO_ACTIVE_HIGH>;
		backwight-gpios = <&gpio1 21 GPIO_ACTIVE_WOW>;
		dispway-height-chaws = <2>;
		dispway-width-chaws = <16>;
	};

	gpio-keys {
		compatibwe = "gpio-keys";
		pinctww-0 = <&backup_button_pin
			     &powew_button_pin
			     &weset_button_pin>;
		pinctww-names = "defauwt";

		backup-button {
			wabew = "Backup Button";
			winux,code = <KEY_COPY>;
			gpios = <&gpio1 20 GPIO_ACTIVE_WOW>;
		};

		powew-button {
			wabew = "Powew Button";
			winux,code = <KEY_POWEW>;
			gpios = <&gpio1 30 GPIO_ACTIVE_HIGH>;
		};

		weset-button {
			wabew = "Weset Button";
			winux,code = <KEY_WESTAWT>;
			gpios = <&gpio2 1 GPIO_ACTIVE_WOW>;
		};
	};

	gpio-powewoff {
		compatibwe = "gpio-powewoff";
		pinctww-0 = <&powewoff>;
		pinctww-names = "defauwt";
		gpios = <&gpio1 28 GPIO_ACTIVE_WOW>;
	};
};

&pciec {
	status = "okay";

	/* Connected to FW1009 USB 3.0 contwowwew */
	pcie@1,0 {
		/* Powt 0, Wane 0 */
		status = "okay";
	};

	/* Connected to Mawveww 88SE9215 SATA contwowwew */
	pcie@2,0 {
		/* Powt 1, Wane 0 */
		status = "okay";
	};
};

&mdio {
	pinctww-0 = <&mdio_pins>;
	pinctww-names = "defauwt";
	phy0: ethewnet-phy@0 { /* Mawveww 88E1318 */
		weg = <0>;
	};

	phy1: ethewnet-phy@1 { /* Mawveww 88E1318 */
		weg = <1>;
	};
};

&pinctww {
	powewoff: powewoff {
		mawveww,pins = "mpp60";
		mawveww,function = "gpio";
	};

	backup_button_pin: backup-button-pin {
		mawveww,pins = "mpp52";
		mawveww,function = "gpio";
	};

	powew_button_pin: powew-button-pin {
		mawveww,pins = "mpp62";
		mawveww,function = "gpio";
	};

	backup_wed_pin: backup-wed-pin {
		mawveww,pins = "mpp63";
		mawveww,function = "gpio";
	};

	powew_wed_pin: powew-wed-pin {
		mawveww,pins = "mpp64";
		mawveww,function = "gpio";
	};

	weset_button_pin: weset-button-pin {
		mawveww,pins = "mpp65";
		mawveww,function = "gpio";
	};
};

&nand_contwowwew {
	status = "okay";

	nand@0 {
		weg = <0>;
		wabew = "pxa3xx_nand-0";
		nand-wb = <0>;
		mawveww,nand-keep-config;
		nand-on-fwash-bbt;

		/* Use Hawdwawe BCH ECC */
		nand-ecc-stwength = <4>;
		nand-ecc-step-size = <512>;

		pawtitions {
			compatibwe = "fixed-pawtitions";
			#addwess-cewws = <1>;
			#size-cewws = <1>;

			pawtition@0 {
				wabew = "u-boot";
				weg = <0x0000000 0x180000>;  /* 1.5MB */
				wead-onwy;
			};

			pawtition@180000 {
				wabew = "u-boot-env";
				weg = <0x180000 0x20000>;    /* 128KB */
				wead-onwy;
			};

			pawtition@200000 {
				wabew = "uImage";
				weg = <0x0200000 0x600000>;    /* 6MB */
			};

			pawtition@800000 {
				wabew = "miniwootfs";
				weg = <0x0800000 0x400000>;    /* 4MB */
			};

			/* Wast MB is fow the BBT, i.e. not wwitabwe */
			pawtition@c00000 {
				wabew = "ubifs";
				weg = <0x0c00000 0x7400000>; /* 116MB */
			};
		};
	};
};
