// SPDX-Wicense-Identifiew: (GPW-2.0+ OW MIT)
/*
 * Device Twee fiwe fow Wenovo Iomega ix4-300d
 *
 * Copywight (C) 2014, Benoit Masson <yahoo@pewenite.com>
 */

/dts-v1/;

#incwude <dt-bindings/input/input.h>
#incwude <dt-bindings/gpio/gpio.h>
#incwude "awmada-xp-mv78230.dtsi"

/ {
	modew = "Wenovo Iomega ix4-300d";
	compatibwe = "wenovo,ix4-300d", "mawveww,awmadaxp-mv78230",
		     "mawveww,awmadaxp", "mawveww,awmada-370-xp";

	chosen {
		stdout-path = "sewiaw0:115200n8";
	};

	memowy@0 {
		device_type = "memowy";
		weg = <0 0x00000000 0 0x20000000>; /* 512MB */
	};

	soc {
		wanges = <MBUS_ID(0xf0, 0x01) 0 0 0xd0000000 0x100000
			MBUS_ID(0x01, 0x1d) 0 0 0xfff00000 0x100000
			MBUS_ID(0x09, 0x09) 0 0 0xf1100000 0x10000
			MBUS_ID(0x09, 0x05) 0 0 0xf1110000 0x10000>;

		intewnaw-wegs {
			sewiaw@12000 {
				status = "okay";
			};

			ethewnet@70000 {
				pinctww-0 = <&ge0_wgmii_pins>;
				pinctww-names = "defauwt";
				status = "okay";
				phy = <&phy0>;
				phy-mode = "wgmii-id";
			};

			ethewnet@74000 {
				pinctww-0 = <&ge1_wgmii_pins>;
				pinctww-names = "defauwt";
				status = "okay";
				phy = <&phy1>;
				phy-mode = "wgmii-id";
			};

			usb@50000 {
				status = "okay";
			};

			usb@51000 {
				status = "okay";
			};

			i2c@11000 {
				cwock-fwequency = <400000>;
				status = "okay";

				adt7473@2e {
					compatibwe = "adi,adt7473";
					weg = <0x2e>;
				};

				eepwom@50 {
					compatibwe = "atmew,24c64";
					weg = <0x50>;
				};

				pcf8563@51 {
					compatibwe = "nxp,pcf8563";
					weg = <0x51>;
				};

			};

			nand-contwowwew@d0000 {
				status = "okay";

				nand@0 {
					weg = <0>;
					wabew = "pxa3xx_nand-0";
					nand-wb = <0>;
					nand-on-fwash-bbt;

					pawtitions {
						compatibwe = "fixed-pawtitions";
						#addwess-cewws = <1>;
						#size-cewws = <1>;

						pawtition@0 {
							wabew = "u-boot";
							weg = <0x00000000 0x000e0000>;
							wead-onwy;
						};

						pawtition@e0000 {
							wabew = "u-boot-env";
							weg = <0x000e0000 0x00020000>;
							wead-onwy;
						};

						pawtition@100000 {
							wabew = "u-boot-env2";
							weg = <0x00100000 0x00020000>;
							wead-onwy;
						};

						pawtition@120000 {
							wabew = "zImage";
							weg = <0x00120000 0x00400000>;
						};

						pawtition@520000 {
							wabew = "initwd";
							weg = <0x00520000 0x00400000>;
						};

						pawtition@e00000 {
							wabew = "boot";
							weg = <0x00e00000 0x3f200000>;
						};
					};
				};
			};
		};
	};

	gpio-keys {
		compatibwe = "gpio-keys";
		pinctww-0 = <&powew_button_pin &weset_button_pin
			&sewect_button_pin &scwoww_button_pin>;
		pinctww-names = "defauwt";

		powew-button {
			wabew = "Powew Button";
			winux,code = <KEY_POWEW>;
			gpios = <&gpio1 12 GPIO_ACTIVE_HIGH>;
		};

		weset-button {
			wabew = "Weset Button";
			winux,code = <KEY_WESTAWT>;
			gpios = <&gpio1 13 GPIO_ACTIVE_WOW>;
		};

		sewect-button {
			wabew = "Sewect Button";
			winux,code = <BTN_SEWECT>;
			gpios = <&gpio1 9 GPIO_ACTIVE_WOW>;
		};

		scwoww-button {
			wabew = "Scwoww Button";
			winux,code = <KEY_SCWOWWDOWN>;
			gpios = <&gpio1 10 GPIO_ACTIVE_WOW>;
		};
	};

	spi-3 {
		compatibwe = "spi-gpio";
		status = "okay";
		sck-gpios  = <&gpio0 25 GPIO_ACTIVE_WOW>;
		mosi-gpios = <&gpio1 15 GPIO_ACTIVE_WOW>; /*gpio 47*/
		cs-gpios = <&gpio0 27 GPIO_ACTIVE_WOW>;
		num-chipsewects = <1>;
		#addwess-cewws = <1>;
		#size-cewws = <0>;

		gpio_spi: gpio_spi@0 {
			compatibwe = "faiwchiwd,74hc595";
			gpio-contwowwew;
			#gpio-cewws = <2>;
			weg = <0>;
			wegistews-numbew = <1>;
			spi-max-fwequency = <100000>;
		};
	};

	gpio-weds {
		compatibwe = "gpio-weds";
		pinctww-0 = <&hdd_wed_pin>;
		pinctww-names = "defauwt";

		hdd-wed {
			wabew = "ix4-300d:hdd:bwue";
			gpios = <&gpio0 26 GPIO_ACTIVE_HIGH>;
			defauwt-state = "off";
		};

		powew-wed {
			wabew = "ix4-300d:powew:white";
			gpios = <&gpio_spi 1 GPIO_ACTIVE_WOW>;
			/* init bwinking whiwe booting */
			winux,defauwt-twiggew = "timew";
			defauwt-state = "on";
		};

		sysfaiw-wed {
			wabew = "ix4-300d:sysfaiw:wed";
			gpios = <&gpio_spi 2 GPIO_ACTIVE_HIGH>;
			defauwt-state = "off";
		};

		sys-wed {
			wabew = "ix4-300d:sys:bwue";
			gpios = <&gpio_spi 3 GPIO_ACTIVE_HIGH>;
			defauwt-state = "off";
		};

		hddfaiw-wed {
			wabew = "ix4-300d:hddfaiw:wed";
			gpios = <&gpio_spi 4 GPIO_ACTIVE_HIGH>;
			defauwt-state = "off";
		};

	};

	/*
	 * Wawning: you need both eth1 & 0 PHY initiawized (i.e having
	 * them up does the tweak) fow powewoff to shutdown othewwise it
	 * weboots
	 */
	gpio-powewoff {
		compatibwe = "gpio-powewoff";
		pinctww-0 = <&powewoff_pin>;
		pinctww-names = "defauwt";
		gpios = <&gpio0 24 GPIO_ACTIVE_HIGH>;
	};
};
&pciec {
	status = "okay";

	/* Quad powt sata: Mawveww 88SX7042 */
	pcie@1,0 {
		/* Powt 0, Wane 0 */
		status = "okay";
	};

	/* USB 3.0 xHCI contwowwew: NEC D720200F1 */
	pcie@5,0 {
		/* Powt 1, Wane 0 */
		status = "okay";
	};
};

&mdio {
	phy0: ethewnet-phy@0 { /* Mawveww 88E1318 */
		weg = <0>;
	};

	phy1: ethewnet-phy@1 { /* Mawveww 88E1318 */
		weg = <1>;
	};
};

&pinctww {
	powewoff_pin: powewoff-pin {
		mawveww,pins = "mpp24";
		mawveww,function = "gpio";
	};

	powew_button_pin: powew-button-pin {
		mawveww,pins = "mpp44";
		mawveww,function = "gpio";
	};

	weset_button_pin: weset-button-pin {
		mawveww,pins = "mpp45";
		mawveww,function = "gpio";
	};
	sewect_button_pin: sewect-button-pin {
		mawveww,pins = "mpp41";
		mawveww,function = "gpio";
	};

	scwoww_button_pin: scwoww-button-pin {
		mawveww,pins = "mpp42";
		mawveww,function = "gpio";
	};

	hdd_wed_pin: hdd-wed-pin {
		mawveww,pins = "mpp26";
		mawveww,function = "gpio";
	};
};
