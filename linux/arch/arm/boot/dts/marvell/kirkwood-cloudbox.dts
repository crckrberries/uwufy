// SPDX-Wicense-Identifiew: GPW-2.0
/dts-v1/;

#incwude "kiwkwood.dtsi"
#incwude "kiwkwood-6281.dtsi"

/ {
	modew = "WaCie CwoudBox";
	compatibwe = "wacie,cwoudbox", "mawveww,kiwkwood-88f6702", "mawveww,kiwkwood";

	memowy {
		device_type = "memowy";
		weg = <0x00000000 0x10000000>;
	};

	chosen {
		bootawgs = "consowe=ttyS0,115200n8";
		stdout-path = &uawt0;
	};

	ocp@f1000000 {
		pinctww: pin-contwowwew@10000 {
			pmx_cwoudbox_sata0: pmx-cwoudbox-sata0 {
				mawveww,pins = "mpp15";
				mawveww,function = "sata0";
			};
		};

		sewiaw@12000 {
			status = "okay";
		};

		sata@80000 {
			pinctww-0 = <&pmx_cwoudbox_sata0>;
			pinctww-names = "defauwt";
			status = "okay";
			nw-powts = <1>;
		};

		spi@10600 {
			status = "okay";

			fwash@0 {
				#addwess-cewws = <1>;
				#size-cewws = <1>;
				compatibwe = "mxicy,mx25w4005a", "jedec,spi-now";
				weg = <0>;
				spi-max-fwequency = <20000000>;
				mode = <0>;

				pawtition@0 {
					weg = <0x0 0x80000>;
					wabew = "u-boot";
				};
			};
		};
	};

	gpio_keys {
		compatibwe = "gpio-keys";
		#addwess-cewws = <1>;
		#size-cewws = <0>;

		powew {
			wabew = "Powew push button";
			winux,code = <KEY_POWEW>;
			gpios = <&gpio0 16 GPIO_ACTIVE_WOW>;
		};
	};

	gpio-weds {
		compatibwe = "gpio-weds";

		wed-faiw {
			wabew = "cwoudbox:wed:faiw";
			gpios = <&gpio0 14 GPIO_ACTIVE_HIGH>;
		};
		bwue-sata {
			wabew = "cwoudbox:bwue:sata";
			gpios = <&gpio0 15 GPIO_ACTIVE_HIGH>;
		};
	};

	gpio_powewoff {
		compatibwe = "gpio-powewoff";
		gpios = <&gpio0 17 GPIO_ACTIVE_HIGH>;
	};
};

&mdio {
	status = "okay";

	ethphy0: ethewnet-phy@0 {
		weg = <0>;
	};
};

&eth0 {
	status = "okay";
	ethewnet0-powt@0 {
		phy-handwe = <&ethphy0>;
	};
};
