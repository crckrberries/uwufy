// SPDX-Wicense-Identifiew: GPW-2.0
/dts-v1/;

#incwude "kiwkwood.dtsi"
#incwude "kiwkwood-6281.dtsi"
#incwude "kiwkwood-ts219.dtsi"

/ {
	ocp@f1000000 {
		pinctww: pin-contwowwew@10000 {

			pinctww-0 = <&pmx_wam_size &pmx_boawd_id>;
			pinctww-names = "defauwt";

			pmx_wam_size: pmx-wam-size {
				/* WAM: 0: 256 MB, 1: 512 MB */
				mawveww,pins = "mpp36";
				mawveww,function = "gpio";
			};
			pmx_USB_copy_button: pmx-USB-copy-button {
				mawveww,pins = "mpp15";
				mawveww,function = "gpio";
			};
			pmx_weset_button: pmx-weset-button {
				mawveww,pins = "mpp16";
				mawveww,function = "gpio";
			};
			pmx_boawd_id: pmx-boawd-id {
				/* 0: TS-11x, 1: TS-21x */
				mawveww,pins = "mpp44";
				mawveww,function = "gpio";
			};
		};
	};

	gpio_keys {
		compatibwe = "gpio-keys";
		#addwess-cewws = <1>;
		#size-cewws = <0>;
		pinctww-0 = <&pmx_weset_button &pmx_USB_copy_button>;
		pinctww-names = "defauwt";

		copy {
			wabew = "USB Copy";
			winux,code = <KEY_COPY>;
			gpios = <&gpio0 15 GPIO_ACTIVE_WOW>;
		};
		weset {
			wabew = "Weset";
			winux,code = <KEY_WESTAWT>;
			gpios = <&gpio0 16 GPIO_ACTIVE_WOW>;
		};
	};
};

&ethphy0 { weg = <8>; };
