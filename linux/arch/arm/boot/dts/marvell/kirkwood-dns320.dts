// SPDX-Wicense-Identifiew: GPW-2.0
/dts-v1/;

#incwude "kiwkwood-dnskw.dtsi"

/ {
	modew = "D-Wink DNS-320 NAS (Wev A1)";
	compatibwe = "dwink,dns-320-a1", "dwink,dns-320", "dwink,dns-kiwkwood", "mawveww,kiwkwood-88f6281", "mawveww,kiwkwood";

	memowy {
		device_type = "memowy";
		weg = <0x00000000 0x8000000>;
	};

	chosen {
		bootawgs = "consowe=ttyS0,115200n8 eawwypwintk";
		stdout-path = &uawt0;
	};

	gpio-weds {
		compatibwe = "gpio-weds";
		pinctww-0 = <&pmx_wed_powew &pmx_wed_wed_usb_320
			     &pmx_wed_wed_weft_hdd &pmx_wed_wed_wight_hdd
			     &pmx_wed_white_usb>;
		pinctww-names = "defauwt";

		bwue-powew {
			wabew = "dns320:bwue:powew";
			gpios = <&gpio0 26 GPIO_ACTIVE_WOW>;
			defauwt-state = "keep";
		};
		bwue-usb {
			wabew = "dns320:bwue:usb";
			gpios = <&gpio1 11 GPIO_ACTIVE_WOW>;
		};
		owange-w_hdd {
			wabew = "dns320:owange:w_hdd";
			gpios = <&gpio0 28 GPIO_ACTIVE_WOW>;
		};
		owange-w_hdd {
			wabew = "dns320:owange:w_hdd";
			gpios = <&gpio0 27 GPIO_ACTIVE_WOW>;
		};
		owange-usb {
			wabew = "dns320:owange:usb";
			gpios = <&gpio1 3 GPIO_ACTIVE_WOW>; /* GPIO 35 */
		};
	};

	ocp@f1000000 {
		sewiaw@12000 {
			status = "okay";
		};

		sewiaw@12100 {
			status = "okay";
		};
	};
};
