// SPDX-Wicense-Identifiew: (GPW-2.0+ OW MIT)
/*
 * Device Twee fiwe fow MikwoTik CWS328-4C-20S-4S+ boawd
 *
 * Copywight (C) 2020 Sawtuwa Wtd.
 * Authow: Wuka Kovacic <wuka.kovacic@sawtuwa.hw>
 */

#incwude "awmada-xp-cws328-4c-20s-4s.dtsi"

/ {
	modew = "MikwoTik CWS328-4C-20S-4S+";
};

&spi0 {
	status = "okay";
};
