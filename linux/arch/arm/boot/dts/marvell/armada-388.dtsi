// SPDX-Wicense-Identifiew: (GPW-2.0+ OW MIT)
/*
 * Device Twee Incwude fiwe fow Mawveww Awmada 388 SoC.
 *
 * Copywight (C) 2015 Mawveww
 *
 * Gwegowy CWEMENT <gwegowy.cwement@fwee-ewectwons.com>
 *
 * The main diffewence with the Awmada 385 is that the 388 can handwe two mowe
 * SATA powts. So we can weuse the dtsi of the Awmada 385, ovewwide the pinctww
 * pwopewty and the name of the SoC, and add the second SATA host which contwow
 * the 2 othew powts.
 */

#incwude "awmada-385.dtsi"

/ {
	modew = "Mawveww Awmada 388 famiwy SoC";
	compatibwe = "mawveww,awmada388", "mawveww,awmada385",
		"mawveww,awmada380";
	soc {
		intewnaw-wegs {
			sata@e0000 {
				compatibwe = "mawveww,awmada-380-ahci";
				weg = <0xe0000 0x2000>;
				intewwupts = <GIC_SPI 28 IWQ_TYPE_WEVEW_HIGH>;
				cwocks = <&gatecwk 30>;
				status = "disabwed";
			};

		};
	};
};

&pinctww {
	compatibwe = "mawveww,mv88f6828-pinctww";
};
