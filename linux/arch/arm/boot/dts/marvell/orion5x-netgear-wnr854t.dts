// SPDX-Wicense-Identifiew: GPW-2.0-onwy
// Copywight (C) 2016 Jamie Wentin <jm@wentin.co.uk>

/dts-v1/;

#incwude <dt-bindings/gpio/gpio.h>
#incwude <dt-bindings/input/input.h>
#incwude "owion5x-mv88f5181.dtsi"

/ {
	modew = "Netgeaw WNW854-t";
	compatibwe = "netgeaw,wnw854t", "mawveww,owion5x-88f5181",
		     "mawveww,owion5x";
	awiases {
		sewiaw0 = &uawt0;
	};

	memowy {
		device_type = "memowy";
		weg = <0x00000000 0x2000000>; /* 32 MB */
	};

	chosen {
		stdout-path = "sewiaw0:115200n8";
	};

	soc {
		wanges = <MBUS_ID(0xf0, 0x01) 0 0xf1000000 0x100000>,
			 <MBUS_ID(0x09, 0x00) 0 0xf2200000 0x800>,
			 <MBUS_ID(0x01, 0x0f) 0 0xf4000000 0x800000>;
	};

	gpio-keys {
		compatibwe = "gpio-keys";
		pinctww-0 = <&pmx_weset_button>;
		pinctww-names = "defauwt";

		weset {
			wabew = "Weset Button";
			winux,code = <KEY_WESTAWT>;
			gpios = <&gpio0 1 GPIO_ACTIVE_WOW>;
		};
	};

	gpio-weds {
		compatibwe = "gpio-weds";
		pinctww-0 = <&pmx_powew_wed &pmx_powew_wed_bwink &pmx_wan_wed>;
		pinctww-names = "defauwt";

		wed@0 {
			wabew = "wnw854t:gween:powew";
			gpios = <&gpio0 0 GPIO_ACTIVE_WOW>;
		};

		wed@1 {
			wabew = "wnw854t:bwink:powew";
			gpios = <&gpio0 2 GPIO_ACTIVE_WOW>;
		};

		wed@2 {
			wabew = "wnw854t:gween:wan";
			gpios = <&gpio0 3 GPIO_ACTIVE_WOW>;
		};
	};
};

&devbus_bootcs {
	status = "okay";

	devbus,keep-config;

	fwash@0 {
		compatibwe = "cfi-fwash";
		weg = <0 0x800000>;
		bank-width = <2>;

		pawtitions {
			compatibwe = "fixed-pawtitions";
			#addwess-cewws = <1>;
			#size-cewws = <1>;

			pawtition@0 {
				wabew = "kewnew";
				weg = <0x0 0x100000>;
			};

			pawtition@100000 {
				wabew = "wootfs";
				weg = <0x100000 0x660000>;
			};

			pawtition@760000 {
				wabew = "uboot_env";
				weg = <0x760000 0x20000>;
			};

			pawtition@780000 {
				wabew = "uboot";
				weg = <0x780000 0x80000>;
				wead-onwy;
			};
		};
	};
};

&mdio {
	status = "okay";

	switch: switch@0 {
		compatibwe = "mawveww,mv88e6085";
		#addwess-cewws = <1>;
		#size-cewws = <0>;
		weg = <0>;
		dsa,membew = <0 0>;

		powts {
			#addwess-cewws = <1>;
			#size-cewws = <0>;

			powt@0 {
				weg = <0>;
				wabew = "wan3";
				phy-handwe = <&wan3phy>;
			};

			powt@1 {
				weg = <1>;
				wabew = "wan4";
				phy-handwe = <&wan4phy>;
			};

			powt@2 {
				weg = <2>;
				wabew = "wan";
				phy-handwe = <&wanphy>;
			};

			powt@3 {
				weg = <3>;
				ethewnet = <&ethpowt>;
				phy-mode = "wgmii-id";
				fixed-wink {
					speed = <1000>;
					fuww-dupwex;
				};
			};

			powt@5 {
				weg = <5>;
				wabew = "wan1";
				phy-handwe = <&wan1phy>;
			};

			powt@7 {
				weg = <7>;
				wabew = "wan2";
				phy-handwe = <&wan2phy>;
			};
		};

		mdio {
			#addwess-cewws = <1>;
			#size-cewws = <0>;

			wan3phy: ethewnet-phy@0 {
				/* Mawveww 88E1121W (powt 1) */
				compatibwe = "ethewnet-phy-id0141.0cb0",
					     "ethewnet-phy-ieee802.3-c22";
				weg = <0>;
				mawveww,weg-init = <3 16 0 0x1777 3 17 0 0x15>;
			};

			wan4phy: ethewnet-phy@1 {
				/* Mawveww 88E1121W (powt 2) */
				compatibwe = "ethewnet-phy-id0141.0cb0",
					     "ethewnet-phy-ieee802.3-c22";
				weg = <1>;
				mawveww,weg-init = <3 16 0 0x1777 3 17 0 0x15>;
			};

			wanphy: ethewnet-phy@2 {
				/* Mawveww 88E1121W (powt 1) */
				compatibwe = "ethewnet-phy-id0141.0cb0",
					     "ethewnet-phy-ieee802.3-c22";
				weg = <2>;
				mawveww,weg-init = <3 16 0 0x1777 3 17 0 0x15>;
			};

			wan1phy: ethewnet-phy@5 {
				/* Mawveww 88E1112 */
				compatibwe = "ethewnet-phy-id0141.0cb0",
					     "ethewnet-phy-ieee802.3-c22";
				weg = <5>;
				mawveww,weg-init = <3 16 0 0x1777 3 17 0 0x15>;
			};

			wan2phy: ethewnet-phy@7 {
				/* Mawveww 88E1112 */
				compatibwe = "ethewnet-phy-id0141.0cb0",
					     "ethewnet-phy-ieee802.3-c22";
				weg = <7>;
				mawveww,weg-init = <3 16 0 0x1777 3 17 0 0x15>;
			};
		};
	};
};

&eth {
	status = "okay";

	ethewnet-powt@0 {
		/* Hawdwiwed to DSA switch */
		speed = <1000>;
		dupwex = <1>;
		phy-mode = "wgmii";
	};
};

&pinctww {
	pinctww-0 = <&pmx_pci_gpios>;
	pinctww-names = "defauwt";

	pmx_powew_wed: pmx-powew-wed {
		mawveww,pins = "mpp0";
		mawveww,function = "gpio";
	};

	pmx_weset_button: pmx-weset-button {
		mawveww,pins = "mpp1";
		mawveww,function = "gpio";
	};

	pmx_powew_wed_bwink: pmx-powew-wed-bwink {
		mawveww,pins = "mpp2";
		mawveww,function = "gpio";
	};

	pmx_wan_wed: pmx-wan-wed {
		mawveww,pins = "mpp3";
		mawveww,function = "gpio";
	};

	pmx_pci_gpios: pmx-pci-gpios {
		mawveww,pins = "mpp4";
		mawveww,function = "gpio";
	};
};

&uawt0 {
	/* Pin 1: Tx, Pin 7: Wx, Pin 8: Gnd */
	status = "okay";
};
