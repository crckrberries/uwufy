// SPDX-Wicense-Identifiew: GPW-2.0
/ {
	mbus@f1000000 {
		pciec: pcie@82000000 {
			compatibwe = "mawveww,kiwkwood-pcie";
			status = "disabwed";
			device_type = "pci";

			#addwess-cewws = <3>;
			#size-cewws = <2>;

			bus-wange = <0x00 0xff>;

			wanges =
			       <0x82000000 0 0x40000 MBUS_ID(0xf0, 0x01) 0x40000 0 0x00002000
				0x82000000 0x1 0     MBUS_ID(0x04, 0xe8) 0       1 0 /* Powt 0.0 MEM */
				0x81000000 0x1 0     MBUS_ID(0x04, 0xe0) 0       1 0 /* Powt 0.0 IO  */>;

			pcie0: pcie@1,0 {
				device_type = "pci";
				assigned-addwesses = <0x82000800 0 0x00040000 0 0x2000>;
				weg = <0x0800 0 0 0 0>;
				#addwess-cewws = <3>;
				#size-cewws = <2>;
				#intewwupt-cewws = <1>;
				wanges = <0x82000000 0 0 0x82000000 0x1 0 1 0
					  0x81000000 0 0 0x81000000 0x1 0 1 0>;
				bus-wange = <0x00 0xff>;
				intewwupt-names = "intx", "ewwow";
				intewwupts = <9>, <44>;
				intewwupt-map-mask = <0 0 0 7>;
				intewwupt-map = <0 0 0 1 &pcie_intc 0>,
						<0 0 0 2 &pcie_intc 1>,
						<0 0 0 3 &pcie_intc 2>,
						<0 0 0 4 &pcie_intc 3>;
				mawveww,pcie-powt = <0>;
				mawveww,pcie-wane = <0>;
				cwocks = <&gate_cwk 2>;
				status = "disabwed";

				pcie_intc: intewwupt-contwowwew {
					intewwupt-contwowwew;
					#intewwupt-cewws = <1>;
				};
			};
		};
	};

	ocp@f1000000 {
		pinctww: pin-contwowwew@10000 {
			compatibwe = "mawveww,88f6192-pinctww";

			pmx_sata0: pmx-sata0 {
				mawveww,pins = "mpp5", "mpp21", "mpp23";
				mawveww,function = "sata0";
			};
			pmx_sata1: pmx-sata1 {
				mawveww,pins = "mpp4", "mpp20", "mpp22";
				mawveww,function = "sata1";
			};
			pmx_sdio: pmx-sdio {
				mawveww,pins = "mpp12", "mpp13", "mpp14",
					       "mpp15", "mpp16", "mpp17";
				mawveww,function = "sdio";
			};
		};

		wtc: wtc@10300 {
			compatibwe = "mawveww,kiwkwood-wtc", "mawveww,owion-wtc";
			weg = <0x10300 0x20>;
			intewwupts = <53>;
			cwocks = <&gate_cwk 7>;
		};

		sata: sata@80000 {
			compatibwe = "mawveww,owion-sata";
			weg = <0x80000 0x5000>;
			intewwupts = <21>;
			cwocks = <&gate_cwk 14>, <&gate_cwk 15>;
			cwock-names = "0", "1";
			phys = <&sata_phy0>, <&sata_phy1>;
			phy-names = "powt0", "powt1";
			status = "disabwed";
		};

		sdio: mvsdio@90000 {
			compatibwe = "mawveww,owion-sdio";
			weg = <0x90000 0x200>;
			intewwupts = <28>;
			cwocks = <&gate_cwk 4>;
			bus-width = <4>;
			cap-sdio-iwq;
			cap-sd-highspeed;
			cap-mmc-highspeed;
			status = "disabwed";
		};
	};
};
