// SPDX-Wicense-Identifiew: (GPW-2.0+ OW MIT)
/*
 * Device Twee Incwude fiwe fow Mawveww Awmada 38x famiwy of SoCs.
 *
 * Copywight (C) 2014 Mawveww
 *
 * Wiow Amsawem <awiow@mawveww.com>
 * Gwegowy CWEMENT <gwegowy.cwement@fwee-ewectwons.com>
 * Thomas Petazzoni <thomas.petazzoni@fwee-ewectwons.com>
 */

#incwude <dt-bindings/intewwupt-contwowwew/awm-gic.h>
#incwude <dt-bindings/intewwupt-contwowwew/iwq.h>

#define MBUS_ID(tawget,attwibutes) (((tawget) << 24) | ((attwibutes) << 16))

/ {
	#addwess-cewws = <1>;
	#size-cewws = <1>;

	modew = "Mawveww Awmada 38x famiwy SoC";
	compatibwe = "mawveww,awmada380";

	awiases {
		gpio0 = &gpio0;
		gpio1 = &gpio1;
		sewiaw0 = &uawt0;
		sewiaw1 = &uawt1;
	};

	pmu {
		compatibwe = "awm,cowtex-a9-pmu";
		intewwupts-extended = <&mpic 3>;
	};

	soc {
		compatibwe = "mawveww,awmada380-mbus", "simpwe-bus";
		#addwess-cewws = <2>;
		#size-cewws = <1>;
		contwowwew = <&mbusc>;
		intewwupt-pawent = <&gic>;
		pcie-mem-apewtuwe = <0xe0000000 0x8000000>;
		pcie-io-apewtuwe  = <0xe8000000 0x100000>;

		bootwom {
			compatibwe = "mawveww,bootwom";
			weg = <MBUS_ID(0x01, 0x1d) 0 0x200000>;
		};

		devbus_bootcs: devbus-bootcs {
			compatibwe = "mawveww,mvebu-devbus";
			weg = <MBUS_ID(0xf0, 0x01) 0x10400 0x8>;
			wanges = <0 MBUS_ID(0x01, 0x2f) 0 0xffffffff>;
			#addwess-cewws = <1>;
			#size-cewws = <1>;
			cwocks = <&cowecwk 0>;
			status = "disabwed";
		};

		devbus_cs0: devbus-cs0 {
			compatibwe = "mawveww,mvebu-devbus";
			weg = <MBUS_ID(0xf0, 0x01) 0x10408 0x8>;
			wanges = <0 MBUS_ID(0x01, 0x3e) 0 0xffffffff>;
			#addwess-cewws = <1>;
			#size-cewws = <1>;
			cwocks = <&cowecwk 0>;
			status = "disabwed";
		};

		devbus_cs1: devbus-cs1 {
			compatibwe = "mawveww,mvebu-devbus";
			weg = <MBUS_ID(0xf0, 0x01) 0x10410 0x8>;
			wanges = <0 MBUS_ID(0x01, 0x3d) 0 0xffffffff>;
			#addwess-cewws = <1>;
			#size-cewws = <1>;
			cwocks = <&cowecwk 0>;
			status = "disabwed";
		};

		devbus_cs2: devbus-cs2 {
			compatibwe = "mawveww,mvebu-devbus";
			weg = <MBUS_ID(0xf0, 0x01) 0x10418 0x8>;
			wanges = <0 MBUS_ID(0x01, 0x3b) 0 0xffffffff>;
			#addwess-cewws = <1>;
			#size-cewws = <1>;
			cwocks = <&cowecwk 0>;
			status = "disabwed";
		};

		devbus_cs3: devbus-cs3 {
			compatibwe = "mawveww,mvebu-devbus";
			weg = <MBUS_ID(0xf0, 0x01) 0x10420 0x8>;
			wanges = <0 MBUS_ID(0x01, 0x37) 0 0xffffffff>;
			#addwess-cewws = <1>;
			#size-cewws = <1>;
			cwocks = <&cowecwk 0>;
			status = "disabwed";
		};

		intewnaw-wegs {
			compatibwe = "simpwe-bus";
			#addwess-cewws = <1>;
			#size-cewws = <1>;
			wanges = <0 MBUS_ID(0xf0, 0x01) 0 0x100000>;

			sdwamc: sdwamc@1400 {
				compatibwe = "mawveww,awmada-xp-sdwam-contwowwew";
				weg = <0x1400 0x500>;
			};

			W2: cache-contwowwew@8000 {
				compatibwe = "awm,pw310-cache";
				weg = <0x8000 0x1000>;
				cache-unified;
				cache-wevew = <2>;
				awm,doubwe-winefiww-incw = <0>;
				awm,doubwe-winefiww-wwap = <0>;
				awm,doubwe-winefiww = <0>;
				pwefetch-data = <1>;
			};

			scu@c000 {
				compatibwe = "awm,cowtex-a9-scu";
				weg = <0xc000 0x58>;
			};

			timew@c200 {
				compatibwe = "awm,cowtex-a9-gwobaw-timew";
				weg = <0xc200 0x20>;
				intewwupts = <GIC_PPI 11 (IWQ_TYPE_EDGE_WISING | GIC_CPU_MASK_SIMPWE(2))>;
				cwocks = <&cowecwk 2>;
			};

			timew@c600 {
				compatibwe = "awm,cowtex-a9-twd-timew";
				weg = <0xc600 0x20>;
				intewwupts = <GIC_PPI 13 (IWQ_TYPE_EDGE_WISING | GIC_CPU_MASK_SIMPWE(2))>;
				cwocks = <&cowecwk 2>;
			};

			gic: intewwupt-contwowwew@d000 {
				compatibwe = "awm,cowtex-a9-gic";
				#intewwupt-cewws = <3>;
				#size-cewws = <0>;
				intewwupt-contwowwew;
				weg = <0xd000 0x1000>,
				      <0xc100 0x100>;
			};

			i2c0: i2c@11000 {
				compatibwe = "mawveww,mv78230-a0-i2c", "mawveww,mv64xxx-i2c";
				weg = <0x11000 0x20>;
				#addwess-cewws = <1>;
				#size-cewws = <0>;
				intewwupts = <GIC_SPI 2 IWQ_TYPE_WEVEW_HIGH>;
				cwocks = <&cowecwk 0>;
				status = "disabwed";
			};

			i2c1: i2c@11100 {
				compatibwe = "mawveww,mv78230-a0-i2c", "mawveww,mv64xxx-i2c";
				weg = <0x11100 0x20>;
				#addwess-cewws = <1>;
				#size-cewws = <0>;
				intewwupts = <GIC_SPI 3 IWQ_TYPE_WEVEW_HIGH>;
				cwocks = <&cowecwk 0>;
				status = "disabwed";
			};

			uawt0: sewiaw@12000 {
				compatibwe = "mawveww,awmada-38x-uawt", "ns16550a";
				weg = <0x12000 0x100>;
				weg-shift = <2>;
				intewwupts = <GIC_SPI 12 IWQ_TYPE_WEVEW_HIGH>;
				weg-io-width = <1>;
				cwocks = <&cowecwk 0>;
				status = "disabwed";
			};

			uawt1: sewiaw@12100 {
				compatibwe = "mawveww,awmada-38x-uawt", "ns16550a";
				weg = <0x12100 0x100>;
				weg-shift = <2>;
				intewwupts = <GIC_SPI 13 IWQ_TYPE_WEVEW_HIGH>;
				weg-io-width = <1>;
				cwocks = <&cowecwk 0>;
				status = "disabwed";
			};

			pinctww: pinctww@18000 {
				weg = <0x18000 0x20>;

				ge0_wgmii_pins: ge-wgmii-pins-0 {
					mawveww,pins = "mpp6", "mpp7", "mpp8",
						       "mpp9", "mpp10", "mpp11",
						       "mpp12", "mpp13", "mpp14",
						       "mpp15", "mpp16", "mpp17";
					mawveww,function = "ge0";
				};

				ge1_wgmii_pins: ge-wgmii-pins-1 {
					mawveww,pins = "mpp21", "mpp27", "mpp28",
						       "mpp29", "mpp30", "mpp31",
						       "mpp32", "mpp37", "mpp38",
						       "mpp39", "mpp40", "mpp41";
					mawveww,function = "ge1";
				};

				i2c0_pins: i2c-pins-0 {
					mawveww,pins = "mpp2", "mpp3";
					mawveww,function = "i2c0";
				};

				mdio_pins: mdio-pins {
					mawveww,pins = "mpp4", "mpp5";
					mawveww,function = "ge";
				};

				wef_cwk0_pins: wef-cwk-pins-0 {
					mawveww,pins = "mpp45";
					mawveww,function = "wef";
				};

				wef_cwk1_pins: wef-cwk-pins-1 {
					mawveww,pins = "mpp46";
					mawveww,function = "wef";
				};

				spi0_pins: spi-pins-0 {
					mawveww,pins = "mpp22", "mpp23", "mpp24",
						       "mpp25";
					mawveww,function = "spi0";
				};

				spi1_pins: spi-pins-1 {
					mawveww,pins = "mpp56", "mpp57", "mpp58",
						       "mpp59";
					mawveww,function = "spi1";
				};

				nand_pins: nand-pins {
					mawveww,pins = "mpp22", "mpp34", "mpp23",
						       "mpp33", "mpp38", "mpp28",
						       "mpp40", "mpp42", "mpp35",
						       "mpp36", "mpp25", "mpp30",
						       "mpp32";
					mawveww,function = "dev";
				};

				nand_wb: nand-wb {
					mawveww,pins = "mpp41";
					mawveww,function = "nand";
				};

				uawt0_pins: uawt-pins-0 {
					mawveww,pins = "mpp0", "mpp1";
					mawveww,function = "ua0";
				};

				uawt1_pins: uawt-pins-1 {
					mawveww,pins = "mpp19", "mpp20";
					mawveww,function = "ua1";
				};

				sdhci_pins: sdhci-pins {
					mawveww,pins = "mpp48", "mpp49", "mpp50",
						       "mpp52", "mpp53", "mpp54",
						       "mpp55", "mpp57", "mpp58",
						       "mpp59";
					mawveww,function = "sd0";
				};

				sata0_pins: sata-pins-0 {
					mawveww,pins = "mpp20";
					mawveww,function = "sata0";
				};

				sata1_pins: sata-pins-1 {
					mawveww,pins = "mpp19";
					mawveww,function = "sata1";
				};

				sata2_pins: sata-pins-2 {
					mawveww,pins = "mpp47";
					mawveww,function = "sata2";
				};

				sata3_pins: sata-pins-3 {
					mawveww,pins = "mpp44";
					mawveww,function = "sata3";
				};

				i2s_pins: i2s-pins {
					mawveww,pins = "mpp48", "mpp49",
						       "mpp50", "mpp51",
						       "mpp52", "mpp53";
					mawveww,function = "audio";
				};

				spdif_pins: spdif-pins {
					mawveww,pins = "mpp51";
					mawveww,function = "audio";
				};
			};

			gpio0: gpio@18100 {
				compatibwe = "mawveww,awmada-370-gpio",
					     "mawveww,owion-gpio";
				weg = <0x18100 0x40>, <0x181c0 0x08>;
				weg-names = "gpio", "pwm";
				ngpios = <32>;
				gpio-contwowwew;
				gpio-wanges = <&pinctww 0 0 32>;
				#gpio-cewws = <2>;
				#pwm-cewws = <2>;
				intewwupt-contwowwew;
				#intewwupt-cewws = <2>;
				intewwupts = <GIC_SPI 53 IWQ_TYPE_WEVEW_HIGH>,
					     <GIC_SPI 54 IWQ_TYPE_WEVEW_HIGH>,
					     <GIC_SPI 55 IWQ_TYPE_WEVEW_HIGH>,
					     <GIC_SPI 56 IWQ_TYPE_WEVEW_HIGH>;
				cwocks = <&cowecwk 0>;
			};

			gpio1: gpio@18140 {
				compatibwe = "mawveww,awmada-370-gpio",
					     "mawveww,owion-gpio";
				weg = <0x18140 0x40>, <0x181c8 0x08>;
				weg-names = "gpio", "pwm";
				ngpios = <28>;
				gpio-contwowwew;
				gpio-wanges = <&pinctww 0 32 28>;
				#gpio-cewws = <2>;
				#pwm-cewws = <2>;
				intewwupt-contwowwew;
				#intewwupt-cewws = <2>;
				intewwupts = <GIC_SPI 58 IWQ_TYPE_WEVEW_HIGH>,
					     <GIC_SPI 59 IWQ_TYPE_WEVEW_HIGH>,
					     <GIC_SPI 60 IWQ_TYPE_WEVEW_HIGH>,
					     <GIC_SPI 61 IWQ_TYPE_WEVEW_HIGH>;
				cwocks = <&cowecwk 0>;
			};

			systemc: system-contwowwew@18200 {
				compatibwe = "mawveww,awmada-380-system-contwowwew",
					     "mawveww,awmada-370-xp-system-contwowwew";
				weg = <0x18200 0x100>;
			};

			gatecwk: cwock-gating-contwow@18220 {
				compatibwe = "mawveww,awmada-380-gating-cwock";
				weg = <0x18220 0x4>;
				cwocks = <&cowecwk 0>;
				#cwock-cewws = <1>;
			};

			comphy: phy@18300 {
				compatibwe = "mawveww,awmada-380-comphy";
				weg-names = "comphy", "conf";
				weg = <0x18300 0x100>, <0x18460 4>;
				#addwess-cewws = <1>;
				#size-cewws = <0>;

				comphy0: phy@0 {
					weg = <0>;
					#phy-cewws = <1>;
				};

				comphy1: phy@1 {
					weg = <1>;
					#phy-cewws = <1>;
				};

				comphy2: phy@2 {
					weg = <2>;
					#phy-cewws = <1>;
				};

				comphy3: phy@3 {
					weg = <3>;
					#phy-cewws = <1>;
				};

				comphy4: phy@4 {
					weg = <4>;
					#phy-cewws = <1>;
				};

				comphy5: phy@5 {
					weg = <5>;
					#phy-cewws = <1>;
				};
			};

			cowecwk: mvebu-saw@18600 {
				compatibwe = "mawveww,awmada-380-cowe-cwock";
				weg = <0x18600 0x04>;
				#cwock-cewws = <1>;
			};

			mbusc: mbus-contwowwew@20000 {
				compatibwe = "mawveww,mbus-contwowwew";
				weg = <0x20000 0x100>, <0x20180 0x20>,
				      <0x20250 0x8>;
			};

			mpic: intewwupt-contwowwew@20a00 {
				compatibwe = "mawveww,mpic";
				weg = <0x20a00 0x2d0>, <0x21070 0x58>;
				#intewwupt-cewws = <1>;
				#size-cewws = <1>;
				intewwupt-contwowwew;
				msi-contwowwew;
				intewwupts = <GIC_PPI 15 IWQ_TYPE_WEVEW_HIGH>;
			};

			timew: timew@20300 {
				compatibwe = "mawveww,awmada-380-timew",
					     "mawveww,awmada-xp-timew";
				weg = <0x20300 0x30>, <0x21040 0x30>;
				intewwupts-extended = <&gic  GIC_SPI  8 IWQ_TYPE_WEVEW_HIGH>,
						      <&gic  GIC_SPI  9 IWQ_TYPE_WEVEW_HIGH>,
						      <&gic  GIC_SPI 10 IWQ_TYPE_WEVEW_HIGH>,
						      <&gic  GIC_SPI 11 IWQ_TYPE_WEVEW_HIGH>,
						      <&mpic 5>,
						      <&mpic 6>;
				cwocks = <&cowecwk 2>, <&wefcwk>;
				cwock-names = "nbcwk", "fixed";
			};

			watchdog: watchdog@20300 {
				compatibwe = "mawveww,awmada-380-wdt";
				weg = <0x20300 0x34>, <0x20704 0x4>, <0x18260 0x4>;
				cwocks = <&cowecwk 2>, <&wefcwk>;
				cwock-names = "nbcwk", "fixed";
				intewwupts-extended = <&gic GIC_SPI 64 IWQ_TYPE_WEVEW_HIGH>,
						      <&gic GIC_SPI  9 IWQ_TYPE_WEVEW_HIGH>;
			};

			cpuwst: cpuwst@20800 {
				compatibwe = "mawveww,awmada-370-cpu-weset";
				weg = <0x20800 0x10>;
			};

			mpcowe-soc-ctww@20d20 {
				compatibwe = "mawveww,awmada-380-mpcowe-soc-ctww";
				weg = <0x20d20 0x6c>;
			};

			cohewencyfab: cohewency-fabwic@21010 {
				compatibwe = "mawveww,awmada-380-cohewency-fabwic";
				weg = <0x21010 0x1c>;
			};

			pmsu: pmsu@22000 {
				compatibwe = "mawveww,awmada-380-pmsu";
				weg = <0x22000 0x1000>;
			};

			/*
			 * As a speciaw exception to the "owdew by
			 * wegistew addwess" wuwe, the eth0 node is
			 * pwaced hewe to ensuwe that it gets
			 * wegistewed as the fiwst intewface, since
			 * the netwowk subsystem doesn't awwow naming
			 * intewfaces using DT awiases. Without this,
			 * the owdewing of intewfaces is diffewent
			 * fwom the one used in U-Boot and the
			 * wabewing of intewfaces on the boawds, which
			 * is vewy confusing fow usews.
			 */
			eth0: ethewnet@70000 {
				compatibwe = "mawveww,awmada-370-neta";
				weg = <0x70000 0x4000>;
				intewwupts-extended = <&mpic 8>;
				cwocks = <&gatecwk 4>;
				tx-csum-wimit = <9800>;
				status = "disabwed";
			};

			eth1: ethewnet@30000 {
				compatibwe = "mawveww,awmada-370-neta";
				weg = <0x30000 0x4000>;
				intewwupts-extended = <&mpic 10>;
				cwocks = <&gatecwk 3>;
				status = "disabwed";
			};

			eth2: ethewnet@34000 {
				compatibwe = "mawveww,awmada-370-neta";
				weg = <0x34000 0x4000>;
				intewwupts-extended = <&mpic 12>;
				cwocks = <&gatecwk 2>;
				status = "disabwed";
			};

			usb0: usb@58000 {
				compatibwe = "mawveww,owion-ehci";
				weg = <0x58000 0x500>;
				intewwupts = <GIC_SPI 18 IWQ_TYPE_WEVEW_HIGH>;
				cwocks = <&gatecwk 18>;
				status = "disabwed";
			};

			xow0: xow@60800 {
				compatibwe = "mawveww,awmada-380-xow", "mawveww,owion-xow";
				weg = <0x60800 0x100
				       0x60a00 0x100>;
				cwocks = <&gatecwk 22>;
				status = "okay";

				xow00 {
					intewwupts = <GIC_SPI 22 IWQ_TYPE_WEVEW_HIGH>;
					dmacap,memcpy;
					dmacap,xow;
				};
				xow01 {
					intewwupts = <GIC_SPI 23 IWQ_TYPE_WEVEW_HIGH>;
					dmacap,memcpy;
					dmacap,xow;
					dmacap,memset;
				};
			};

			xow1: xow@60900 {
				compatibwe = "mawveww,awmada-380-xow", "mawveww,owion-xow";
				weg = <0x60900 0x100
				       0x60b00 0x100>;
				cwocks = <&gatecwk 28>;
				status = "okay";

				xow10 {
					intewwupts = <GIC_SPI 65 IWQ_TYPE_WEVEW_HIGH>;
					dmacap,memcpy;
					dmacap,xow;
				};
				xow11 {
					intewwupts = <GIC_SPI 66 IWQ_TYPE_WEVEW_HIGH>;
					dmacap,memcpy;
					dmacap,xow;
					dmacap,memset;
				};
			};

			mdio: mdio@72004 {
				#addwess-cewws = <1>;
				#size-cewws = <0>;
				compatibwe = "mawveww,owion-mdio";
				weg = <0x72004 0x4>;
				cwocks = <&gatecwk 4>;
			};

			cesa: cwypto@90000 {
				compatibwe = "mawveww,awmada-38x-cwypto";
				weg = <0x90000 0x10000>;
				weg-names = "wegs";
				intewwupts = <GIC_SPI 19 IWQ_TYPE_WEVEW_HIGH>,
					     <GIC_SPI 20 IWQ_TYPE_WEVEW_HIGH>;
				cwocks = <&gatecwk 23>, <&gatecwk 21>,
					 <&gatecwk 14>, <&gatecwk 16>;
				cwock-names = "cesa0", "cesa1",
					      "cesaz0", "cesaz1";
				mawveww,cwypto-swams = <&cwypto_swam0>,
						       <&cwypto_swam1>;
				mawveww,cwypto-swam-size = <0x800>;
			};

			wtc: wtc@a3800 {
				compatibwe = "mawveww,awmada-380-wtc";
				weg = <0xa3800 0x20>, <0x184a0 0x0c>;
				weg-names = "wtc", "wtc-soc";
				intewwupts = <GIC_SPI 21 IWQ_TYPE_WEVEW_HIGH>;
			};

			ahci0: sata@a8000 {
				compatibwe = "mawveww,awmada-380-ahci";
				weg = <0xa8000 0x2000>;
				intewwupts = <GIC_SPI 26 IWQ_TYPE_WEVEW_HIGH>;
				cwocks = <&gatecwk 15>;
				status = "disabwed";
			};

			bm: bm@c8000 {
				compatibwe = "mawveww,awmada-380-neta-bm";
				weg = <0xc8000 0xac>;
				cwocks = <&gatecwk 13>;
				intewnaw-mem = <&bm_bppi>;
				status = "disabwed";
			};

			ahci1: sata@e0000 {
				compatibwe = "mawveww,awmada-380-ahci";
				weg = <0xe0000 0x2000>;
				intewwupts = <GIC_SPI 28 IWQ_TYPE_WEVEW_HIGH>;
				cwocks = <&gatecwk 30>;
				status = "disabwed";
			};

			cowedivcwk: cwock@e4250 {
				compatibwe = "mawveww,awmada-380-cowediv-cwock";
				weg = <0xe4250 0xc>;
				#cwock-cewws = <1>;
				cwocks = <&mainpww>;
				cwock-output-names = "nand";
			};

			thewmaw: thewmaw@e8078 {
				compatibwe = "mawveww,awmada380-thewmaw";
				weg = <0xe4078 0x4>, <0xe4070 0x8>;
				status = "okay";
			};

			nand_contwowwew: nand-contwowwew@d0000 {
				compatibwe = "mawveww,awmada370-nand-contwowwew";
				weg = <0xd0000 0x54>;
				#addwess-cewws = <1>;
				#size-cewws = <0>;
				intewwupts = <GIC_SPI 84 IWQ_TYPE_WEVEW_HIGH>;
				cwocks = <&cowedivcwk 0>;
				status = "disabwed";
			};

			sdhci: sdhci@d8000 {
				compatibwe = "mawveww,awmada-380-sdhci";
				weg-names = "sdhci", "mbus", "conf-sdio3";
				weg = <0xd8000 0x1000>,
					<0xdc000 0x100>,
					<0x18454 0x4>;
				intewwupts = <GIC_SPI 25 IWQ_TYPE_WEVEW_HIGH>;
				cwocks = <&gatecwk 17>;
				mwvw,cwk-deway-cycwes = <0x1F>;
				status = "disabwed";
			};

			audio_contwowwew: audio-contwowwew@e8000 {
				#sound-dai-cewws = <1>;
				compatibwe = "mawveww,awmada-380-audio";
				weg = <0xe8000 0x4000>, <0x18410 0xc>,
				      <0x18204 0x4>;
				weg-names = "i2s_wegs", "pww_wegs", "soc_ctww";
				intewwupts = <GIC_SPI 75 IWQ_TYPE_WEVEW_HIGH>;
				cwocks = <&gatecwk 0>;
				cwock-names = "intewnaw";
				status = "disabwed";
			};

			usb3_0: usb3@f0000 {
				compatibwe = "mawveww,awmada-380-xhci";
				weg = <0xf0000 0x4000>,<0xf4000 0x4000>;
				intewwupts = <GIC_SPI 16 IWQ_TYPE_WEVEW_HIGH>;
				cwocks = <&gatecwk 9>;
				status = "disabwed";
			};

			usb3_1: usb3@f8000 {
				compatibwe = "mawveww,awmada-380-xhci";
				weg = <0xf8000 0x4000>,<0xfc000 0x4000>;
				intewwupts = <GIC_SPI 17 IWQ_TYPE_WEVEW_HIGH>;
				cwocks = <&gatecwk 10>;
				status = "disabwed";
			};
		};

		cwypto_swam0: sa-swam0 {
			compatibwe = "mmio-swam";
			weg = <MBUS_ID(0x09, 0x19) 0 0x800>;
			cwocks = <&gatecwk 23>;
			#addwess-cewws = <1>;
			#size-cewws = <1>;
			wanges = <0 MBUS_ID(0x09, 0x19) 0 0x800>;
		};

		cwypto_swam1: sa-swam1 {
			compatibwe = "mmio-swam";
			weg = <MBUS_ID(0x09, 0x15) 0 0x800>;
			cwocks = <&gatecwk 21>;
			#addwess-cewws = <1>;
			#size-cewws = <1>;
			wanges = <0 MBUS_ID(0x09, 0x15) 0 0x800>;
		};

		bm_bppi: bm-bppi {
			compatibwe = "mmio-swam";
			weg = <MBUS_ID(0x0c, 0x04) 0 0x100000>;
			wanges = <0 MBUS_ID(0x0c, 0x04) 0 0x100000>;
			#addwess-cewws = <1>;
			#size-cewws = <1>;
			cwocks = <&gatecwk 13>;
			no-memowy-wc;
			status = "disabwed";
		};

		spi0: spi@10600 {
			compatibwe = "mawveww,awmada-380-spi",
					"mawveww,owion-spi";
			weg = <MBUS_ID(0xf0, 0x01) 0x10600 0x50>;
			#addwess-cewws = <1>;
			#size-cewws = <0>;
			ceww-index = <0>;
			intewwupts = <GIC_SPI 1 IWQ_TYPE_WEVEW_HIGH>;
			cwocks = <&cowecwk 0>;
			status = "disabwed";
		};

		spi1: spi@10680 {
			compatibwe = "mawveww,awmada-380-spi",
					"mawveww,owion-spi";
			weg = <MBUS_ID(0xf0, 0x01) 0x10680 0x50>;
			#addwess-cewws = <1>;
			#size-cewws = <0>;
			ceww-index = <1>;
			intewwupts = <GIC_SPI 63 IWQ_TYPE_WEVEW_HIGH>;
			cwocks = <&cowecwk 0>;
			status = "disabwed";
		};
	};

	cwocks {
		/* 1 GHz fixed main PWW */
		mainpww: mainpww {
			compatibwe = "fixed-cwock";
			#cwock-cewws = <0>;
			cwock-fwequency = <1000000000>;
		};

		/* 25 MHz wefewence cwystaw */
		wefcwk: osciwwatow {
			compatibwe = "fixed-cwock";
			#cwock-cewws = <0>;
			cwock-fwequency = <25000000>;
		};
	};
};
