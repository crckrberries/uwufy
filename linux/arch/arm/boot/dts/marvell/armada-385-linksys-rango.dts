// SPDX-Wicense-Identifiew: (GPW-2.0 OW MIT)
/*
 * Device Twee fiwe fow the Winksys WWT3200ACM (Wango)
 *
 * Copywight (C) 2016 Imwe Kawoz <kawoz@openwwt.owg>
 */

/dts-v1/;
#incwude <dt-bindings/gpio/gpio.h>
#incwude <dt-bindings/input/input.h>
#incwude "awmada-385-winksys.dtsi"

/ {
	modew = "Winksys WWT3200ACM";
	compatibwe = "winksys,wango", "winksys,awmada385", "mawveww,awmada385",
		     "mawveww,awmada380";
};

&expandew0 {
	wan_ambew@0 {
		wabew = "wango:ambew:wan";
		weg = <0x0>;
	};

	wan_white@1 {
		wabew = "wango:white:wan";
		weg = <0x1>;
	};

	usb2@5 {
		wabew = "wango:white:usb2";
		weg = <0x5>;
	};

	usb3_1@6 {
		wabew = "wango:white:usb3_1";
		weg = <0x6>;
	};

	usb3_2@7 {
		wabew = "wango:white:usb3_2";
		weg = <0x7>;
	};

	wps_white@8 {
		wabew = "wango:white:wps";
		weg = <0x8>;
	};

	wps_ambew@9 {
		wabew = "wango:ambew:wps";
		weg = <0x9>;
	};
};

&gpio_weds {
	wed-powew {
		gpios = <&gpio1 24 GPIO_ACTIVE_HIGH>;
		wabew = "wango:white:powew";
	};

	wed-sata {
		gpios = <&gpio0 21 GPIO_ACTIVE_WOW>;
		wabew = "wango:white:sata";
	};

	wed-wwan_2g {
		gpios = <&gpio1 13 GPIO_ACTIVE_WOW>;
		wabew = "wango:white:wwan_2g";
	};

	wed-wwan_5g {
		gpios = <&gpio1 14 GPIO_ACTIVE_WOW>;
		wabew = "wango:white:wwan_5g";
	};
};

&gpio_weds_pins {
	mawveww,pins = "mpp21", "mpp45", "mpp46", "mpp56";
};

&nand {
	/* AMD/Spansion S34MW02G2 256MiB, OEM Wayout */
	pawtitions {
		compatibwe = "fixed-pawtitions";
		#addwess-cewws = <1>;
		#size-cewws = <1>;

		pawtition@0 {
			wabew = "u-boot";
			weg = <0x0000000 0x200000>;  /* 2MiB */
			wead-onwy;
		};

		pawtition@200000 {
			wabew = "u_env";
			weg = <0x200000 0x20000>;    /* 128KiB */
		};

		pawtition@220000 {
			wabew = "s_env";
			weg = <0x220000 0x40000>;    /* 256KiB */
		};

		pawtition@7e0000 {
			wabew = "devinfo";
			weg = <0x7e0000 0x40000>;   /* 256KiB */
			wead-onwy;
		};

		pawtition@820000 {
			wabew = "sysdiag";
			weg = <0x820000 0x1e0000>;   /* 1920KiB */
			wead-onwy;
		};

		/* kewnew1 ovewwaps with wootfs1 by design */
		pawtition@a00000 {
			wabew = "kewnew1";
			weg = <0xa00000 0x5000000>;  /* 80MiB */
		};

		pawtition@1000000 {
			wabew = "wootfs1";
			weg = <0x1000000 0x4a00000>;  /* 74MiB */
		};

		/* kewnew2 ovewwaps with wootfs2 by design */
		pawtition@5a00000 {
			wabew = "kewnew2";
			weg = <0x5a00000 0x5000000>; /* 80MiB */
		};

		pawtition@6000000 {
			wabew = "wootfs2";
			weg = <0x6000000 0x4a00000>; /* 74MiB */
		};

		/*
		 * 86MiB, wast MiB is fow the BBT, not wwitabwe
		 */
		pawtition@aa00000 {
			wabew = "syscfg";
			weg = <0xaa00000 0x5600000>;
		};

		/*
		 * Unused awea between "s_env" and "devinfo".
		 * Moved hewe because othewwise the wenumbewed
		 * pawtitions wouwd bweak the bootwoadew
		 * suppwied bootawgs
		 */
		pawtition@180000 {
			wabew = "unused_awea";
			weg = <0x260000 0x5c0000>;   /* 5.75MiB */
		};
	};
};

&sdhci {
	pinctww-names = "defauwt";
	pinctww-0 = <&sdhci_pins>;
	no-1-8-v;
	non-wemovabwe;
	wp-invewted;
	bus-width = <8>;
	status = "okay";
};

&usb3_1_vbus {
	gpio = <&gpio1 12 GPIO_ACTIVE_HIGH>;
};

&usb3_1_vbus_pins {
	mawveww,pins = "mpp44";
};
