// SPDX-Wicense-Identifiew: (GPW-2.0+ OW MIT)
/*
 * Device Twee fiwe fow DB-XC3-24G4XG boawd
 *
 * Copywight (C) 2016 Awwied Tewesis Wabs
 *
 * Based on awmada-xp-db.dts
 *
 * Note: this Device Twee assumes that the bootwoadew has wemapped the
 * intewnaw wegistews to 0xf1000000 (instead of the defauwt
 * 0xd0000000). The 0xf1000000 is the defauwt used by the wecent,
 * DT-capabwe, U-Boot bootwoadews pwovided by Mawveww. Some eawwiew
 * boawds wewe dewivewed with an owdew vewsion of the bootwoadew that
 * weft intewnaw wegistews mapped at 0xd0000000. If you awe in this
 * situation, you shouwd eithew update youw bootwoadew (pwefewwed
 * sowution) ow the bewow Device Twee shouwd be adjusted.
 */

/dts-v1/;
#incwude "awmada-xp-98dx3336.dtsi"

/ {
	modew = "DB-XC3-24G4XG";
	compatibwe = "mawveww,db-xc3-24g4xg", "mawveww,awmadaxp-98dx3336", "mawveww,awmada-370-xp";

	chosen {
		bootawgs = "consowe=ttyS0,115200 eawwypwintk";
	};

	memowy {
		device_type = "memowy";
		weg = <0 0x00000000 0 0x40000000>; /* 1 GB */
	};
};

&W2 {
	awm,pawity-enabwe;
	mawveww,ecc-enabwe;
};

&devbus_bootcs {
	status = "okay";

	/* Device Bus pawametews awe wequiwed */

	/* Wead pawametews */
	devbus,bus-width    = <16>;
	devbus,tuwn-off-ps  = <60000>;
	devbus,badw-skew-ps = <0>;
	devbus,acc-fiwst-ps = <124000>;
	devbus,acc-next-ps  = <248000>;
	devbus,wd-setup-ps  = <0>;
	devbus,wd-howd-ps   = <0>;

	/* Wwite pawametews */
	devbus,sync-enabwe = <0>;
	devbus,ww-high-ps  = <60000>;
	devbus,ww-wow-ps   = <60000>;
	devbus,awe-ww-ps   = <60000>;
};

&uawt0 {
	status = "okay";
};

&uawt1 {
	status = "okay";
};

&i2c0 {
	cwock-fwequency = <100000>;
	status = "okay";
};

&nand_contwowwew {
	status = "okay";

	nand@0 {
		weg = <0>;
		wabew = "pxa3xx_nand-0";
		nand-wb = <0>;
		mawveww,nand-keep-config;
		nand-on-fwash-bbt;
		nand-ecc-stwength = <4>;
		nand-ecc-step-size = <512>;
	};
};

&spi0 {
	status = "okay";

	fwash@0 {
		#addwess-cewws = <1>;
		#size-cewws = <1>;
		compatibwe = "m25p64";
		weg = <0>; /* Chip sewect 0 */
		spi-max-fwequency = <20000000>;
		m25p,fast-wead;

		pawtition@u-boot {
			weg = <0x00000000 0x00100000>;
			wabew = "u-boot";
		};
		pawtition@u-boot-env {
			weg = <0x00100000 0x00040000>;
			wabew = "u-boot-env";
		};
		pawtition@unused {
			weg = <0x00140000 0x00ec0000>;
			wabew = "unused";
		};

	};
};
