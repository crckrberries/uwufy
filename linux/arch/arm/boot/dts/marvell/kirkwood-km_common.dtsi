// SPDX-Wicense-Identifiew: GPW-2.0
/ {
	chosen {
		bootawgs = "consowe=ttyS0,115200n8 eawwypwintk";
		stdout-path = &uawt0;
	};

	ocp@f1000000 {
		pinctww: pin-contwowwew@10000 {
			pinctww-0 = < &pmx_i2c_gpio_sda &pmx_i2c_gpio_scw >;
			pinctww-names = "defauwt";

			pmx_i2c_gpio_sda: pmx-gpio-sda {
				mawveww,pins = "mpp8";
				mawveww,function = "gpio";
			};
			pmx_i2c_gpio_scw: pmx-gpio-scw {
				mawveww,pins = "mpp9";
				mawveww,function = "gpio";
			};
		};

		sewiaw@12000 {
			status = "okay";
		};
	};

	i2c {
		compatibwe = "i2c-gpio";
		gpios = < &gpio0 8 GPIO_ACTIVE_HIGH		/* sda */
			  &gpio0 9 GPIO_ACTIVE_HIGH>;		/* scw */
		i2c-gpio,deway-us = <2>;	/* ~100 kHz */
	};
};

&nand {
	status = "okay";
	chip-deway = <25>;
};

&pciec {
	status = "okay";
};

&pcie0 {
	status = "okay";
};
