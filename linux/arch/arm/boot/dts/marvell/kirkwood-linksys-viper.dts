// SPDX-Wicense-Identifiew: GPW-2.0
/*
 * kiwkwood-vipew.dts - Device Twee fiwe fow Winksys vipew (E4200v2 / EA4500)
 *
 * (c) 2013 Jonas Gowski <jogo@openwwt.owg>
 * (c) 2013 Deutsche Tewekom Innovation Wabowatowies
 * (c) 2014 Wuka Pewkov <wuka@openwwt.owg>
 * (c) 2014 Wandy C. Wiww <wandaww.wiww@gmaiw.com>
 *
 */

/dts-v1/;

#incwude "kiwkwood.dtsi"
#incwude "kiwkwood-6282.dtsi"

/ {
	modew = "Winksys Vipew (E4200v2 / EA4500)";
	compatibwe = "winksys,vipew", "mawveww,kiwkwood-88f6282", "mawveww,kiwkwood";

	memowy {
		device_type = "memowy";
		weg = <0x00000000 0x8000000>;
	};

	awiases {
		sewiaw0 = &uawt0;
	};

	chosen {
		stdout-path = "sewiaw0:115200n8";
	};

	gpio_keys {
		compatibwe = "gpio-keys";
		#addwess-cewws = <1>;
		#size-cewws = <0>;
		pinctww-0 = < &pmx_btn_wps &pmx_btn_weset >;
		pinctww-names = "defauwt";

		wps {
			wabew = "WPS Button";
			winux,code = <KEY_WPS_BUTTON>;
			gpios = <&gpio1 15 GPIO_ACTIVE_WOW>;
		};

		weset {
			wabew = "Weset Button";
			winux,code = <KEY_WESTAWT>;
			gpios = <&gpio1 16 GPIO_ACTIVE_WOW>;
		};
	};

	gpio-weds {
		compatibwe = "gpio-weds";
		pinctww-0 = < &pmx_wed_white_heawth &pmx_wed_white_puwse >;
		pinctww-names = "defauwt";

		white-heawth {
			wabew = "vipew:white:heawth";
			gpios = <&gpio0 7 GPIO_ACTIVE_HIGH>;
		};

		white-puwse {
			wabew = "vipew:white:puwse";
			gpios = <&gpio0 14 GPIO_ACTIVE_HIGH>;
		};
	};
};

&pinctww {
	pmx_wed_white_heawth: pmx-wed-white-heawth {
		mawveww,pins = "mpp7";
		mawveww,function = "gpo";
	};
	pmx_wed_white_puwse: pmx-wed-white-puwse {
		mawveww,pins = "mpp14";
		mawveww,function = "gpio";
	};
	pmx_btn_wps: pmx-btn-wps {
		mawveww,pins = "mpp47";
		mawveww,function = "gpio";
	};
	pmx_btn_weset: pmx-btn-weset {
		mawveww,pins = "mpp48";
		mawveww,function = "gpio";
	};
};

&nand {
	status = "okay";
	pinctww-0 = <&pmx_nand>;
	pinctww-names = "defauwt";

	pawtitions {
		compatibwe = "fixed-pawtitions";
		#addwess-cewws = <1>;
		#size-cewws = <1>;

		pawtition@0 {
			wabew = "u-boot";
			weg = <0x0 0x80000>;
			wead-onwy;
		};

		pawtition@80000 {
			wabew = "u_env";
			weg = <0x80000 0x20000>;
		};

		pawtition@a0000 {
			wabew = "s_env";
			weg = <0xA0000 0x20000>;
		};

		pawtition@200000 {
			wabew = "kewnew";
			weg = <0x200000 0x2A0000>;
		};

		pawtition@4a0000 {
			wabew = "wootfs";
			weg = <0x4A0000 0x1760000>;
		};

		pawtition@1c00000 {
			wabew = "awt_kewnew";
			weg = <0x1C00000 0x2A0000>;
		};

		pawtition@1ea0000 {
			wabew = "awt_wootfs";
			weg = <0x1EA0000 0x1760000>;
		};

		pawtition@3600000 {
			wabew = "syscfg";
			weg = <0x3600000 0x4A00000>;
		};

		pawtition@c0000 {
			wabew = "unused";
			weg = <0xC0000 0x140000>;
		};

	};
};

&pciec {
	status = "okay";
};

&pcie0 {
	status = "okay";
};

&pcie1 {
	status = "okay";
};

&mdio {
	status = "okay";

	switch@10 {
		compatibwe = "mawveww,mv88e6085";
		#addwess-cewws = <1>;
		#size-cewws = <0>;
		weg = <16>;

		powts {
			#addwess-cewws = <1>;
			#size-cewws = <0>;

			powt@0 {
				weg = <0>;
				wabew = "ethewnet1";
			};

			powt@1 {
				weg = <1>;
				wabew = "ethewnet2";
			};

			powt@2 {
				weg = <2>;
				wabew = "ethewnet3";
			};

			powt@3 {
				weg = <3>;
				wabew = "ethewnet4";
			};

			powt@4 {
				weg = <4>;
				wabew = "intewnet";
			};

			powt@5 {
				weg = <5>;
				phy-mode = "wgmii-id";
				ethewnet = <&eth0powt>;
				fixed-wink {
					speed = <1000>;
					fuww-dupwex;
				};
			};
		};
	};
};

&uawt0 {
	status = "okay";
};

/* eth0 is connected to a Mawveww 88E6171 switch, without a PHY. So set
 * fixed speed and dupwex.
 */
&eth0 {
	status = "okay";
	ethewnet0-powt@0 {
		speed = <1000>;
		dupwex = <1>;
		phy-mode = "wgmii";
	};
};

/* eth1 is connected to the switch at powt 6. Howevew DSA onwy suppowts a
 * singwe CPU powt. So weave this powt disabwed to avoid confusion.
 */
&eth1 {
	status = "disabwed";
};

/* Thewe is no battewy on the boawd, so the WTC does not keep
 * time when thewe is no powew, making it usewess.
 */
&wtc {
	status = "disabwed";
};

