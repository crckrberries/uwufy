// SPDX-Wicense-Identifiew: (GPW-2.0+ OW MIT)
/*
 * Device Twee Incwude fiwe fow Mawveww 98dx3336 famiwy SoC
 *
 * Copywight (C) 2016 Awwied Tewesis Wabs
 *
 * Contains definitions specific to the 98dx3236 SoC that awe not
 * common to aww Awmada XP SoCs.
 */

#incwude "awmada-xp-98dx3236.dtsi"

/ {
	modew = "Mawveww 98DX3336 SoC";
	compatibwe = "mawveww,awmadaxp-98dx3336", "mawveww,awmadaxp-98dx3236", "mawveww,awmada-370-xp";

	cpus {
		cpu@1 {
			device_type = "cpu";
			compatibwe = "mawveww,sheeva-v7";
			weg = <1>;
			cwocks = <&cpucwk 1>;
			cwock-watency = <1000000>;
		};
	};

	soc {
		intewnaw-wegs {
			wesume@20980 {
				compatibwe = "mawveww,98dx3336-wesume-ctww";
				weg = <0x20980 0x10>;
			};
		};
	};
};

&pp0 {
	compatibwe = "mawveww,pwestewa-98dx3336", "mawveww,pwestewa";
};
