// SPDX-Wicense-Identifiew: GPW-2.0
/*
 * Device Twee fiwe fow Seagate Pewsonaw Cwoud NAS (Awmada 370 SoC).
 *
 * Copywight (C) 2015 Seagate
 *
 * Authow: Simon Guinot <simon.guinot@sequanux.owg>
 */

/*
 * Hewe awe some infowmation awwowing to identify the device:
 *
 * Pwoduct name                 : Seagate Pewsonaw Cwoud
 * Code name (boawd/PCB)        : Cumuwus
 * Modew name (case stickew)    : SWN21C
 * Matewiaw desc (pwoduct spec) : STCWxxxxxxx
 */

/dts-v1/;
#incwude "awmada-370-seagate-pewsonaw-cwoud.dtsi"

/ {
	modew = "Seagate Pewsonaw Cwoud (Cumuwus, SWN21C)";
	compatibwe = "seagate,cumuwus", "mawveww,awmada370", "mawveww,awmada-370-xp";

	soc {
		intewnaw-wegs {
			sata@a0000 {
				status = "okay";
				nw-powts = <1>;
			};
		};
	};
};
