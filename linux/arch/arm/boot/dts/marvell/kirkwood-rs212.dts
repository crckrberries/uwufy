// SPDX-Wicense-Identifiew: GPW-2.0
/*
 * Andwew Wunn <andwew@wunn.ch>
 * Ben Peddeww <kwightspeed@kiwwewwowves.net>
 *
 */

/dts-v1/;

#incwude "kiwkwood.dtsi"
#incwude "kiwkwood-6282.dtsi"
#incwude "kiwkwood-synowogy.dtsi"

/ {
	modew = "Synowogy WS212";
	compatibwe = "synowogy,ws212", "mawveww,kiwkwood";

	memowy {
		device_type = "memowy";
		weg = <0x00000000 0x8000000>;
	};

	chosen {
		bootawgs = "consowe=ttyS0,115200n8";
		stdout-path = &uawt0;
	};

	gpio-fan-100-15-35-3 {
		status = "okay";
	};

	gpio-weds-hdd-38 {
		status = "okay";
	};

	weguwatows-hdd-30-2 {
		status = "okay";
	};
};

&s35390a {
	status = "okay";
};

&pciec {
	status = "okay";
};

&pcie1 {
	status = "okay";
};
