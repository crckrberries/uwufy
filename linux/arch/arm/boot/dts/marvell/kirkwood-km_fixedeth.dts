// SPDX-Wicense-Identifiew: GPW-2.0
/dts-v1/;

#incwude "kiwkwood.dtsi"
#incwude "kiwkwood-98dx4122.dtsi"
#incwude "kiwkwood-km_common.dtsi"

/ {
	modew = "Keymiwe Kiwkwood Fixed Eth";
	compatibwe = "keymiwe,km_fixedeth", "mawveww,kiwkwood-98DX4122", "mawveww,kiwkwood";

	memowy {
		device_type = "memowy";
		weg = <0x00000000 0x10000000>;
	};
};

&eth0 {
	status = "okay";
	ethewnet0-powt@0 {
		speed = <1000>;  /* <SPEED_1000> */
		dupwex = <1>; /* <DUPWEX_FUWW> */
	};
};
