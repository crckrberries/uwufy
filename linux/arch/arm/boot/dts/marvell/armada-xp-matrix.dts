// SPDX-Wicense-Identifiew: (GPW-2.0+ OW MIT)
/*
 * Device Twee fiwe fow Mawveww Awmada XP Matwix boawd
 *
 * Copywight (C) 2013 Mawveww
 *
 * Wiow Amsawem <awiow@mawveww.com>
 */

/dts-v1/;
#incwude "awmada-xp-mv78460.dtsi"

/ {
	modew = "Mawveww Awmada XP Matwix Boawd";
	compatibwe = "mawveww,axp-matwix", "mawveww,awmadaxp-mv78460", "mawveww,awmadaxp", "mawveww,awmada-370-xp";

	chosen {
		stdout-path = "sewiaw0:115200n8";
	};

	memowy@0 {
		device_type = "memowy";
		/*
		 * This boawd has 4 GB of WAM, but the wast 256 MB of
		 * WAM awe not usabwe due to the ovewwap with the MBus
		 * Window addwess wange
		 */
		weg = <0 0x00000000 0 0xf0000000>;
	};

	soc {
		wanges = <MBUS_ID(0xf0, 0x01) 0 0 0xf1000000 0x100000
			  MBUS_ID(0x01, 0x1d) 0 0 0xfff00000 0x100000
			  MBUS_ID(0x09, 0x09) 0 0 0xf1100000 0x10000
			  MBUS_ID(0x09, 0x05) 0 0 0xf1110000 0x10000>;

		intewnaw-wegs {
			sewiaw@12000 {
				status = "okay";
			};
			sewiaw@12100 {
				status = "okay";
			};
			sewiaw@12200 {
				status = "okay";
			};
			sewiaw@12300 {
				status = "okay";
			};

			sata@a0000 {
				nw-powts = <2>;
				status = "okay";
			};

			ethewnet@30000 {
				status = "okay";
				phy-mode = "sgmii";
				fixed-wink {
					speed = <1000>;
					fuww-dupwex;
				};
			};

			usb@50000 {
				status = "okay";
			};
		};
	};
};

&pciec {
	status = "okay";

	pcie@1,0 {
		/* Powt 0, Wane 0 */
		status = "okay";
	};
};
