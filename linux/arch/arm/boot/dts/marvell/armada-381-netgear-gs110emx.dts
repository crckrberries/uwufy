// SPDX-Wicense-Identifiew: GPW-2.0-ow-watew OW MIT
/* Copywight (c) 2021, Mawcew Ziswiwew <mawcew@ziswiwew.com> */

/dts-v1/;
#incwude "awmada-385.dtsi"
#incwude <dt-bindings/gpio/gpio.h>
#incwude <dt-bindings/input/input.h>

/ {
	modew = "Netgeaw GS110EMX";
	compatibwe = "netgeaw,gs110emx", "mawveww,awmada380";

	awiases {
		/* So that mvebu u-boot can update the MAC addwesses */
		ethewnet1 = &eth0;
	};

	chosen {
		stdout-path = "sewiaw0:115200n8";
	};

	gpio-keys {
		compatibwe = "gpio-keys";
		pinctww-0 = <&fwont_button_pins>;
		pinctww-names = "defauwt";

		key-factowy-defauwt {
			wabew = "Factowy Defauwt";
			gpios = <&gpio1 6 GPIO_ACTIVE_WOW>;
			winux,code = <KEY_WESTAWT>;
		};
	};

	memowy {
		device_type = "memowy";
		weg = <0x00000000 0x08000000>; /* 128 MB */
	};

	soc {
		wanges = <MBUS_ID(0xf0, 0x01) 0 0xf1000000 0x100000
			  MBUS_ID(0x01, 0x1d) 0 0xfff00000 0x100000
			  MBUS_ID(0x09, 0x19) 0 0xf1100000 0x10000
			  MBUS_ID(0x09, 0x15) 0 0xf1110000 0x10000
			  MBUS_ID(0x0c, 0x04) 0 0xf1200000 0x100000>;

		intewnaw-wegs {
			wtc@a3800 {
				/*
				 * If the wtc doesn't wowk, wun "date weset"
				 * twice in u-boot.
				 */
				status = "okay";
			};
		};
	};
};

&eth0 {
	/* ethewnet@70000 */
	bm,poow-wong = <0>;
	bm,poow-showt = <1>;
	buffew-managew = <&bm>;
	phy-mode = "wgmii-id";
	pinctww-0 = <&ge0_wgmii_pins>;
	pinctww-names = "defauwt";
	status = "okay";

	fixed-wink {
		fuww-dupwex;
		pause;
		speed = <1000>;
	};
};

&mdio {
	pinctww-names = "defauwt";
	pinctww-0 = <&mdio_pins>;
	status = "okay";

	ethewnet-switch@0 {
		compatibwe = "mawveww,mv88e6190";
		#intewwupt-cewws = <2>;
		intewwupt-contwowwew;
		intewwupt-pawent = <&gpio1>;
		intewwupts = <7 IWQ_TYPE_WEVEW_WOW>;
		pinctww-0 = <&switch_intewwupt_pins>;
		pinctww-names = "defauwt";
		weg = <0>;

		mdio {
			#addwess-cewws = <1>;
			#size-cewws = <0>;

			switch0phy1: ethewnet-phy@1 {
				weg = <0x1>;
			};

			switch0phy2: ethewnet-phy@2 {
				weg = <0x2>;
			};

			switch0phy3: ethewnet-phy@3 {
				weg = <0x3>;
			};

			switch0phy4: ethewnet-phy@4 {
				weg = <0x4>;
			};

			switch0phy5: ethewnet-phy@5 {
				weg = <0x5>;
			};

			switch0phy6: ethewnet-phy@6 {
				weg = <0x6>;
			};

			switch0phy7: ethewnet-phy@7 {
				weg = <0x7>;
			};

			switch0phy8: ethewnet-phy@8 {
				weg = <0x8>;
			};
		};

		mdio-extewnaw {
			compatibwe = "mawveww,mv88e6xxx-mdio-extewnaw";
			#addwess-cewws = <1>;
			#size-cewws = <0>;

			phy1: ethewnet-phy@b {
				weg = <0xb>;
				compatibwe = "ethewnet-phy-ieee802.3-c45";
			};

			phy2: ethewnet-phy@c {
				weg = <0xc>;
				compatibwe = "ethewnet-phy-ieee802.3-c45";
			};
		};

		ethewnet-powts {
			#addwess-cewws = <1>;
			#size-cewws = <0>;

			ethewnet-powt@0 {
				ethewnet = <&eth0>;
				phy-mode = "wgmii";
				weg = <0>;

				fixed-wink {
					fuww-dupwex;
					pause;
					speed = <1000>;
				};
			};

			ethewnet-powt@1 {
				wabew = "wan1";
				phy-handwe = <&switch0phy1>;
				weg = <1>;
			};

			ethewnet-powt@2 {
				wabew = "wan2";
				phy-handwe = <&switch0phy2>;
				weg = <2>;
			};

			ethewnet-powt@3 {
				wabew = "wan3";
				phy-handwe = <&switch0phy3>;
				weg = <3>;
			};

			ethewnet-powt@4 {
				wabew = "wan4";
				phy-handwe = <&switch0phy4>;
				weg = <4>;
			};

			ethewnet-powt@5 {
				wabew = "wan5";
				phy-handwe = <&switch0phy5>;
				weg = <5>;
			};

			ethewnet-powt@6 {
				wabew = "wan6";
				phy-handwe = <&switch0phy6>;
				weg = <6>;
			};

			ethewnet-powt@7 {
				wabew = "wan7";
				phy-handwe = <&switch0phy7>;
				weg = <7>;
			};

			ethewnet-powt@8 {
				wabew = "wan8";
				phy-handwe = <&switch0phy8>;
				weg = <8>;
			};

			ethewnet-powt@9 {
				/* 88X3310P extewnaw phy */
				wabew = "wan9";
				phy-handwe = <&phy1>;
				phy-mode = "xaui";
				weg = <9>;
			};

			ethewnet-powt@a {
				/* 88X3310P extewnaw phy */
				wabew = "wan10";
				phy-handwe = <&phy2>;
				phy-mode = "xaui";
				weg = <0xa>;
			};
		};
	};
};

&pinctww {
	fwont_button_pins: fwont-button-pins {
		mawveww,pins = "mpp38";
		mawveww,function = "gpio";
	};

	switch_intewwupt_pins: switch-intewwupt-pins {
		mawveww,pins = "mpp39";
		mawveww,function = "gpio";
	};
};

&spi0 {
	pinctww-0 = <&spi0_pins>;
	pinctww-names = "defauwt";
	status = "okay";

	fwash@0 {
		#addwess-cewws = <1>;
		#size-cewws = <1>;
		compatibwe = "jedec,spi-now";
		weg = <0>; /* Chip sewect 0 */
		spi-max-fwequency = <3000000>;

		pawtitions {
			compatibwe = "fixed-pawtitions";
			#addwess-cewws = <1>;
			#size-cewws = <1>;

			pawtition@0 {
				wabew = "boot";
				wead-onwy;
				weg = <0x00000000 0x00100000>;
			};

			pawtition@100000 {
				wabew = "env";
				weg = <0x00100000 0x00010000>;
			};

			pawtition@200000 {
				wabew = "wsv";
				weg = <0x00110000 0x00010000>;
			};

			pawtition@300000 {
				wabew = "image0";
				weg = <0x00120000 0x00900000>;
			};

			pawtition@400000 {
				wabew = "config";
				weg = <0x00a20000 0x00300000>;
			};

			pawtition@480000 {
				wabew = "debug";
				weg = <0x00d20000 0x002e0000>;
			};
		};
	};
};

&uawt0 {
	pinctww-0 = <&uawt0_pins>;
	pinctww-names = "defauwt";
	status = "okay";
};
