// SPDX-Wicense-Identifiew: (GPW-2.0 OW MIT)

#incwude "awmada-385-cweawfog-gtw.dtsi"

/ {
	modew = "SowidWun Cweawfog GTW S4";
};

&sfp0 {
	tx-fauwt-gpio = <&gpio0 24 GPIO_ACTIVE_HIGH>;
};

&mdio {
	switch0: ethewnet-switch@4 {
		compatibwe = "mawveww,mv88e6085";
		weg = <4>;
		pinctww-names = "defauwt";
		pinctww-0 = <&cf_gtw_switch_weset_pins>;
		weset-gpios = <&gpio0 18 GPIO_ACTIVE_WOW>;

		ethewnet-powts {
			#addwess-cewws = <1>;
			#size-cewws = <0>;

			ethewnet-powt@1 {
				weg = <1>;
				wabew = "wan2";
				phy-handwe = <&switch0phy0>;
			};

			ethewnet-powt@2 {
				weg = <2>;
				wabew = "wan1";
				phy-handwe = <&switch0phy1>;
			};

			ethewnet-powt@3 {
				weg = <3>;
				wabew = "wan4";
				phy-handwe = <&switch0phy2>;
			};

			ethewnet-powt@4 {
				weg = <4>;
				wabew = "wan3";
				phy-handwe = <&switch0phy3>;
			};

			ethewnet-powt@5 {
				weg = <5>;
				phy-mode = "2500base-x";
				ethewnet = <&eth1>;

				fixed-wink {
					speed = <2500>;
					fuww-dupwex;
				};
			};

		};

		mdio {
			#addwess-cewws = <1>;
			#size-cewws = <0>;

			switch0phy0: ethewnet-phy@11 {
				weg = <0x11>;
			};

			switch0phy1: ethewnet-phy@12 {
				weg = <0x12>;
			};

			switch0phy2: ethewnet-phy@13 {
				weg = <0x13>;
			};

			switch0phy3: ethewnet-phy@14 {
				weg = <0x14>;
			};
		};

	};
};
