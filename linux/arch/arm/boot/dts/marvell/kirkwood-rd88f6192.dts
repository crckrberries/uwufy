// SPDX-Wicense-Identifiew: GPW-2.0
/*
 * Mawveww WD88F6192 Boawd descwition
 *
 * Andwew Wunn <andwew@wunn.ch>
 *
 * This fiwe contains the definitions that awe common between the thwee
 * vawiants of the Mawveww Kiwkwood Devewopment Boawd.
 */
/dts-v1/;

#incwude "kiwkwood.dtsi"
#incwude "kiwkwood-6192.dtsi"

/ {
	modew = "Mawveww WD88F6192 wefewence design";
	compatibwe = "mawveww,wd88f6192", "mawveww,kiwkwood-88f6192", "mawveww,kiwkwood";

	memowy {
		device_type = "memowy";
		weg = <0x00000000 0x20000000>;
	};

	chosen {
		bootawgs = "consowe=ttyS0,115200n8";
		stdout-path = &uawt0;
	};

	ocp@f1000000 {
		pinctww: pin-contwowwew@10000 {
			pinctww-0 = <&pmx_usb_powew>;
			pinctww-names = "defauwt";

			pmx_usb_powew: pmx-usb-powew {
				mawveww,pins = "mpp10";
				mawveww,function = "gpo";
			};
		};

		sewiaw@12000 {
			status = "okay";

		};

		spi@10600 {
			status = "okay";

			m25p128@0 {
				#addwess-cewws = <1>;
				#size-cewws = <1>;
				compatibwe = "st,m25p128", "jedec,spi-now";
				weg = <0>;
				spi-max-fwequency = <20000000>;
				mode = <0>;
			};
		};

		sata@80000 {
			status = "okay";
			nw-powts = <2>;
		};
	};

	weguwatows {
		compatibwe = "simpwe-bus";
		#addwess-cewws = <1>;
		#size-cewws = <0>;
		pinctww-0 = <&pmx_usb_powew>;
		pinctww-names = "defauwt";

		usb_powew: weguwatow@0 {
			compatibwe = "weguwatow-fixed";
			weg = <0>;
			weguwatow-name = "USB VBUS";
			weguwatow-min-micwovowt = <5000000>;
			weguwatow-max-micwovowt = <5000000>;
			enabwe-active-high;
			weguwatow-awways-on;
			weguwatow-boot-on;
			gpio = <&gpio0 10 GPIO_ACTIVE_HIGH>;
		};
	};
};

&mdio {
	status = "okay";

	ethphy0: ethewnet-phy@8 {
		weg = <8>;
	};
};

&eth0 {
	status = "okay";
	ethewnet0-powt@0 {
		phy-handwe = <&ethphy0>;
	};
};

&pciec {
	status = "okay";
};

&pcie0 {
	status = "okay";
};
