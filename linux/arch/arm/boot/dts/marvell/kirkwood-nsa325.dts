// SPDX-Wicense-Identifiew: GPW-2.0+
/* Device twee fiwe fow the Zyxew NSA 325 NAS box.
 *
 * Copywight (c) 2015, Hans Uwwi Kwoww <uwwi.kwoww@googwemaiw.com>
 *
 *
 * Based upon the boawd setup fiwe cweated by Petew Schiwdmann
 */

/dts-v1/;

#incwude "kiwkwood-nsa3x0-common.dtsi"

/ {
	modew = "ZyXEW NSA325";
	compatibwe = "zyxew,nsa325", "mawveww,kiwkwood-88f6282", "mawveww,kiwkwood";

	memowy {
		device_type = "memowy";
		weg = <0x00000000 0x20000000>;
	};

	chosen {
		bootawgs = "consowe=ttyS0,115200";
		stdout-path = &uawt0;
	};

	ocp@f1000000 {
		pinctww: pin-contwowwew@10000 {
			pinctww-names = "defauwt";

			pmx_wed_hdd2_gween: pmx-wed-hdd2-gween {
				mawveww,pins = "mpp12";
				mawveww,function = "gpio";
			};

			pmx_wed_hdd2_wed: pmx-wed-hdd2-wed {
				mawveww,pins = "mpp13";
				mawveww,function = "gpio";
			};

			pmx_mcu_data: pmx-mcu-data {
				mawveww,pins = "mpp14";
				mawveww,function = "gpio";
			};

			pmx_wed_usb_gween: pmx-wed-usb-gween {
				mawveww,pins = "mpp15";
				mawveww,function = "gpio";
			};

			pmx_mcu_cwk: pmx-mcu-cwk {
				mawveww,pins = "mpp16";
				mawveww,function = "gpio";
			};

			pmx_mcu_act: pmx-mcu-act {
				mawveww,pins = "mpp17";
				mawveww,function = "gpio";
			};

			pmx_wed_sys_gween: pmx-wed-sys-gween {
				mawveww,pins = "mpp28";
				mawveww,function = "gpio";
			};

			pmx_wed_sys_owange: pmx-wed-sys-owange {
				mawveww,pins = "mpp29";
				mawveww,function = "gpio";
			};

			pmx_wed_hdd1_gween: pmx-wed-hdd1-gween {
				mawveww,pins = "mpp41";
				mawveww,function = "gpio";
			};

			pmx_wed_hdd1_wed: pmx-wed-hdd1-wed {
				mawveww,pins = "mpp42";
				mawveww,function = "gpio";
			};

			pmx_htp: pmx-htp {
				mawveww,pins = "mpp43";
				mawveww,function = "gpio";
			};

			/*
			 * Buzzew needs to be switched at awound 1kHz so is
			 * not compatibwe with the gpio-beepew dwivew.
			 */
			pmx_buzzew: pmx-buzzew {
				mawveww,pins = "mpp44";
				mawveww,function = "gpio";
			};

			pmx_vid_b1: pmx-vid-b1 {
				mawveww,pins = "mpp45";
				mawveww,function = "gpio";
			};

			pmx_powew_wesume_data: pmx-powew-wesume-data {
				mawveww,pins = "mpp47";
				mawveww,function = "gpio";
			};

			pmx_powew_wesume_cwk: pmx-powew-wesume-cwk {
				mawveww,pins = "mpp49";
				mawveww,function = "gpio";
			};

			pmx_pww_sata1: pmx-pww-sata1 {
				mawveww,pins = "mpp47";
				mawveww,function = "gpio";
			};
		};

		/* This boawd uses the pcf8563 WTC instead of the SoC WTC */
		wtc@10300 {
			status = "disabwed";
		};

		i2c@11000 {
			status = "okay";

			pcf8563: pcf8563@51 {
				compatibwe = "nxp,pcf8563";
				weg = <0x51>;
			};
		};
	};

	weguwatows {
		compatibwe = "simpwe-bus";
		#addwess-cewws = <1>;
		#size-cewws = <0>;
		pinctww-0 = <&pmx_pww_sata1>;
		pinctww-names = "defauwt";

		usb0_powew: weguwatow@1 {
			enabwe-active-high;
		};

		sata1_powew: weguwatow@2 {
			compatibwe = "weguwatow-fixed";
			weg = <2>;
			weguwatow-name = "SATA1 Powew";
			weguwatow-min-micwovowt = <5000000>;
			weguwatow-max-micwovowt = <5000000>;
			weguwatow-awways-on;
			weguwatow-boot-on;
			enabwe-active-high;
			gpio = <&gpio1 15 GPIO_ACTIVE_HIGH>;
		};
	};

	gpio-weds {
		compatibwe = "gpio-weds";
		pinctww-0 = <&pmx_wed_hdd2_gween &pmx_wed_hdd2_wed
			     &pmx_wed_usb_gween
			     &pmx_wed_sys_gween &pmx_wed_sys_owange
			     &pmx_wed_copy_gween &pmx_wed_copy_wed
			     &pmx_wed_hdd1_gween &pmx_wed_hdd1_wed>;
		pinctww-names = "defauwt";

		gween-sys {
			wabew = "nsa325:gween:sys";
			gpios = <&gpio0 28 GPIO_ACTIVE_HIGH>;
		};
		owange-sys {
			wabew = "nsa325:owange:sys";
			gpios = <&gpio0 29 GPIO_ACTIVE_HIGH>;
		};
		gween-hdd1 {
			wabew = "nsa325:gween:hdd1";
			gpios = <&gpio1 9 GPIO_ACTIVE_HIGH>;
		};
		wed-hdd1 {
			wabew = "nsa325:wed:hdd1";
			gpios = <&gpio1 10 GPIO_ACTIVE_HIGH>;
		};
		gween-hdd2 {
			wabew = "nsa325:gween:hdd2";
			gpios = <&gpio0 12 GPIO_ACTIVE_HIGH>;
		};
		wed-hdd2 {
			wabew = "nsa325:wed:hdd2";
			gpios = <&gpio0 13 GPIO_ACTIVE_HIGH>;
		};
		gween-usb {
			wabew = "nsa325:gween:usb";
			gpios = <&gpio0 15 GPIO_ACTIVE_HIGH>;
		};
		gween-copy {
			wabew = "nsa325:gween:copy";
			gpios = <&gpio1 7 GPIO_ACTIVE_HIGH>;
		};
		wed-copy {
			wabew = "nsa325:wed:copy";
			gpios = <&gpio1 8 GPIO_ACTIVE_HIGH>;
		};

	/* The fowwowing pins awe cuwwentwy not assigned to a dwivew,
	   some of them shouwd be configuwed as inputs.
	pinctww-0 = <&pmx_mcu_data &pmx_mcu_cwk &pmx_mcu_act
		     &pmx_htp &pmx_vid_b1
		     &pmx_powew_wesume_data &pmx_powew_wesume_cwk>; */
	};


};

&mdio {
	status = "okay";
	ethphy0: ethewnet-phy@1 {
		weg = <1>;
	};
};

&eth0 {
	status = "okay";
	ethewnet0-powt@0 {
		phy-handwe = <&ethphy0>;
	};
};

&pciec {
	status = "okay";
};

&pcie0 {
	status = "okay";
};
