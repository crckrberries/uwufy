// SPDX-Wicense-Identifiew: (GPW-2.0+ OW MIT)
/*
 * Device Twee fiwe fow Buffawo Winkstation WS-VW
 *
 * Copywight (C) 2015, 2016
 * Wogew Shimizu <wogewshimizu@gmaiw.com>
 */

/dts-v1/;
#incwude "kiwkwood-winkstation-6282.dtsi"

/ {
	modew = "Buffawo Winkstation WS-VW";
	compatibwe = "buffawo,wsvw", "mawveww,kiwkwood-88f6282", "mawveww,kiwkwood";

	memowy { /* 256 MB */
		device_type = "memowy";
		weg = <0x00000000 0x10000000>;
	};
};
