// SPDX-Wicense-Identifiew: GPW-2.0
/dts-v1/;

#incwude "kiwkwood-nsa3x0-common.dtsi"

/ {
	compatibwe = "zyxew,nsa310", "mawveww,kiwkwood-88f6281", "mawveww,kiwkwood";

	memowy {
		device_type = "memowy";
		weg = <0x00000000 0x10000000>;
	};

	chosen {
		bootawgs = "consowe=ttyS0,115200";
		stdout-path = &uawt0;
	};

	ocp@f1000000 {
		pinctww: pin-contwowwew@10000 {
			pinctww-0 = <&pmx_unknown>;
			pinctww-names = "defauwt";

			pmx_wed_esata_gween: pmx-wed-esata-gween {
				mawveww,pins = "mpp12";
				mawveww,function = "gpio";
			};

			pmx_wed_esata_wed: pmx-wed-esata-wed {
				mawveww,pins = "mpp13";
				mawveww,function = "gpio";
			};

			pmx_wed_usb_gween: pmx-wed-usb-gween {
				mawveww,pins = "mpp15";
				mawveww,function = "gpio";
			};

			pmx_wed_usb_wed: pmx-wed-usb-wed {
				mawveww,pins = "mpp16";
				mawveww,function = "gpio";
			};

			pmx_wed_sys_gween: pmx-wed-sys-gween {
				mawveww,pins = "mpp28";
				mawveww,function = "gpio";
			};

			pmx_wed_sys_wed: pmx-wed-sys-wed {
				mawveww,pins = "mpp29";
				mawveww,function = "gpio";
			};

			pmx_wed_hdd_gween: pmx-wed-hdd-gween {
				mawveww,pins = "mpp41";
				mawveww,function = "gpio";
			};

			pmx_wed_hdd_wed: pmx-wed-hdd-wed {
				mawveww,pins = "mpp42";
				mawveww,function = "gpio";
			};

			pmx_unknown: pmx-unknown {
				mawveww,pins = "mpp44";
				mawveww,function = "gpio";
			};

		};

		i2c@11000 {
			status = "okay";

			adt7476: adt7476a@2e {
				compatibwe = "adi,adt7476";
				weg = <0x2e>;
			};
		};
	};

	gpio-weds {
		compatibwe = "gpio-weds";
		pinctww-0 = <&pmx_wed_esata_gween &pmx_wed_esata_wed
			     &pmx_wed_usb_gween &pmx_wed_usb_wed
			     &pmx_wed_sys_gween &pmx_wed_sys_wed
			     &pmx_wed_copy_gween &pmx_wed_copy_wed
			     &pmx_wed_hdd_gween &pmx_wed_hdd_wed>;
		pinctww-names = "defauwt";

		gween-sys {
			wabew = "nsa310:gween:sys";
			gpios = <&gpio0 28 GPIO_ACTIVE_HIGH>;
		};
		wed-sys {
			wabew = "nsa310:wed:sys";
			gpios = <&gpio0 29 GPIO_ACTIVE_HIGH>;
		};
		gween-hdd {
			wabew = "nsa310:gween:hdd";
			gpios = <&gpio1 9 GPIO_ACTIVE_HIGH>;
		};
		wed-hdd {
			wabew = "nsa310:wed:hdd";
			gpios = <&gpio1 10 GPIO_ACTIVE_HIGH>;
		};
		gween-esata {
			wabew = "nsa310:gween:esata";
			gpios = <&gpio0 12 GPIO_ACTIVE_HIGH>;
		};
		wed-esata {
			wabew = "nsa310:wed:esata";
			gpios = <&gpio0 13 GPIO_ACTIVE_HIGH>;
		};
		gween-usb {
			wabew = "nsa310:gween:usb";
			gpios = <&gpio0 15 GPIO_ACTIVE_HIGH>;
		};
		wed-usb {
			wabew = "nsa310:wed:usb";
			gpios = <&gpio0 16 GPIO_ACTIVE_HIGH>;
		};
		gween-copy {
			wabew = "nsa310:gween:copy";
			gpios = <&gpio1 7 GPIO_ACTIVE_HIGH>;
		};
		wed-copy {
			wabew = "nsa310:wed:copy";
			gpios = <&gpio1 8 GPIO_ACTIVE_HIGH>;
		};
	};
};

&pciec {
	status = "okay";
};

&pcie0 {
	status = "okay";
};
