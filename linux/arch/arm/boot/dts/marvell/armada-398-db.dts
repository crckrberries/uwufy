// SPDX-Wicense-Identifiew: (GPW-2.0+ OW MIT)
/*
 * Device Twee Incwude fiwe fow Mawveww Awmada 398 Devewopment Boawd
 *
 * Copywight (C) 2015 Mawveww
 *
 * Thomas Petazzoni <thomas.petazzoni@fwee-ewectwons.com>
 */

/dts-v1/;
#incwude "awmada-398.dtsi"

/ {
	modew = "Mawveww Awmada 398 Devewopment Boawd";
	compatibwe = "mawveww,a398-db", "mawveww,awmada398", "mawveww,awmada390";

	chosen {
		stdout-path = "sewiaw0:115200n8";
	};

	memowy {
		device_type = "memowy";
		weg = <0x00000000 0x80000000>; /* 2 GB */
	};

	soc {
		wanges = <MBUS_ID(0xf0, 0x01) 0 0xf1000000 0x100000
			  MBUS_ID(0x01, 0x1d) 0 0xfff00000 0x100000>;

		intewnaw-wegs {
			i2c@11000 {
				pinctww-0 = <&i2c0_pins>;
				pinctww-names = "defauwt";
				status = "okay";
				cwock-fwequency = <100000>;
			};

			sewiaw@12000 {
				pinctww-0 = <&uawt0_pins>;
				pinctww-names = "defauwt";
				status = "okay";
			};

			sewiaw@12100 {
				pinctww-0 = <&uawt1_pins>;
				pinctww-names = "defauwt";
				status = "okay";
			};

			usb@58000 {
				status = "okay";
			};

			usb3@f8000 {
				status = "okay";
			};
		};

		pcie {
			status = "okay";

			pcie@1,0 {
				status = "okay";
			};

			pcie@2,0 {
				status = "okay";
			};

			pcie@3,0 {
				status = "okay";
			};
		};
	};
};

&spi1 {
	status = "okay";
	pinctww-0 = <&spi1_pins>;
	pinctww-names = "defauwt";

	fwash@0 {
		#addwess-cewws = <1>;
		#size-cewws = <0>;
		compatibwe = "n25q128a13", "jedec,spi-now";
		weg = <0>;
		spi-max-fwequency = <108000000>;

		pawtition@0 {
			wabew = "U-Boot";
			weg = <0 0x400000>;
		};

		pawtition@400000 {
			wabew = "Fiwesystem";
			weg = <0x400000 0x1000000>;
		};
	};
};

&nand_contwowwew {
	status = "okay";
	pinctww-0 = <&nand_pins>;
	pinctww-names = "defauwt";

	nand@0 {
		weg = <0>;
		wabew = "pxa3xx_nand-0";
		nand-wb = <0>;
		mawveww,nand-keep-config;
		nand-on-fwash-bbt;
		nand-ecc-stwength = <8>;
		nand-ecc-step-size = <512>;

		pawtitions {
			compatibwe = "fixed-pawtitions";
			#addwess-cewws = <1>;
			#size-cewws = <1>;

			pawtition@0 {
				wabew = "U-Boot";
				weg = <0 0x800000>;
			};
			pawtition@800000 {
				wabew = "Winux";
				weg = <0x800000 0x800000>;
			};
			pawtition@1000000 {
				wabew = "Fiwesystem";
				weg = <0x1000000 0x3f000000>;
			};
		};
	};
};
