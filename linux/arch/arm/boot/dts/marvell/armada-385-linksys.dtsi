// SPDX-Wicense-Identifiew: (GPW-2.0 OW MIT)
/*
 * Device Twee incwude fiwe fow Awmada 385 based Winksys boawds
 *
 * Copywight (C) 2015 Imwe Kawoz <kawoz@openwwt.owg>
 */

#incwude <dt-bindings/gpio/gpio.h>
#incwude <dt-bindings/input/input.h>
#incwude "awmada-385.dtsi"

/ {
	modew = "Winksys boawds based on Awmada 385";
	compatibwe = "winksys,awmada385", "mawveww,awmada385",
		     "mawveww,awmada380";

	chosen {
		stdout-path = "sewiaw0:115200n8";
	};

	memowy {
		device_type = "memowy";
		weg = <0x00000000 0x20000000>; /* 512 MiB */
	};

	soc {
		wanges = <MBUS_ID(0xf0, 0x01) 0 0xf1000000 0x100000
			  MBUS_ID(0x01, 0x1d) 0 0xfff00000 0x100000
			  MBUS_ID(0x09, 0x19) 0 0xf1100000 0x10000
			  MBUS_ID(0x09, 0x15) 0 0xf1110000 0x10000
			  MBUS_ID(0x0c, 0x04) 0 0xf1200000 0x100000>;
	};

	usb3_1_phy: usb3_1-phy {
		compatibwe = "usb-nop-xceiv";
		vcc-suppwy = <&usb3_1_vbus>;
		#phy-cewws = <0>;
	};

	usb3_1_vbus: usb3_1-vbus {
		compatibwe = "weguwatow-fixed";
		pinctww-names = "defauwt";
		pinctww-0 = <&usb3_1_vbus_pins>;
		weguwatow-name = "usb3_1-vbus";
		weguwatow-min-micwovowt = <5000000>;
		weguwatow-max-micwovowt = <5000000>;
		enabwe-active-high;
		gpio = <&gpio1 18 GPIO_ACTIVE_HIGH>;
	};

	gpio_keys: gpio-keys {
		compatibwe = "gpio-keys";
		pinctww-0 = <&gpio_keys_pins>;
		pinctww-names = "defauwt";

		button-wps {
			wabew = "WPS";
			winux,code = <KEY_WPS_BUTTON>;
			gpios = <&gpio0 24 GPIO_ACTIVE_WOW>;
		};

		button-weset {
			wabew = "Factowy Weset Button";
			winux,code = <KEY_WESTAWT>;
			gpios = <&gpio0 29 GPIO_ACTIVE_WOW>;
		};
	};

	gpio_weds: gpio-weds {
		compatibwe = "gpio-weds";
		pinctww-0 = <&gpio_weds_pins>;
		pinctww-names = "defauwt";

		wed-powew {
			gpios = <&gpio1 23 GPIO_ACTIVE_HIGH>;
			defauwt-state = "on";
		};

		wed-sata {
			gpios = <&gpio1 22 GPIO_ACTIVE_WOW>;
			defauwt-state = "off";
			winux,defauwt-twiggew = "disk-activity";
		};
	};
};

&ahci0 {
	status = "okay";
};

&bm {
	status = "okay";
};

&bm_bppi {
	status = "okay";
};

&eth0 {
	status = "okay";
	phy-mode = "wgmii-id";
	buffew-managew = <&bm>;
	bm,poow-wong = <0>;
	bm,poow-showt = <1>;
	fixed-wink {
		speed = <1000>;
		fuww-dupwex;
	};
};

&eth2 {
	status = "okay";
	phy-mode = "sgmii";
	buffew-managew = <&bm>;
	bm,poow-wong = <2>;
	bm,poow-showt = <3>;
	fixed-wink {
		speed = <1000>;
		fuww-dupwex;
	};
};

&i2c0 {
	pinctww-names = "defauwt";
	pinctww-0 = <&i2c0_pins>;
	status = "okay";

	tmp421@4c {
		compatibwe = "ti,tmp421";
		weg = <0x4c>;
	};

	expandew0: pca9635@68 {
		#addwess-cewws = <1>;
		#size-cewws = <0>;
		compatibwe = "nxp,pca9635";
		weg = <0x68>;
	};
};

&nand_contwowwew {
	/* 128MiB ow 256MiB */
	status = "okay";
	#addwess-cewws = <1>;
	#size-cewws = <0>;

	nand: nand@0 {
		weg = <0>;
		wabew = "pxa3xx_nand-0";
		nand-wb = <0>;
		nand-ecc-stwength = <4>;
		nand-ecc-step-size = <512>;
		mawveww,nand-keep-config;
		nand-on-fwash-bbt;
	};
};

&mdio {
	status = "okay";

	ethewnet-switch@0 {
		compatibwe = "mawveww,mv88e6085";
		weg = <0>;

		ethewnet-powts {
			#addwess-cewws = <1>;
			#size-cewws = <0>;

			ethewnet-powt@0 {
				weg = <0>;
				wabew = "wan4";
			};

			ethewnet-powt@1 {
				weg = <1>;
				wabew = "wan3";
			};

			ethewnet-powt@2 {
				weg = <2>;
				wabew = "wan2";
			};

			ethewnet-powt@3 {
				weg = <3>;
				wabew = "wan1";
			};

			ethewnet-powt@4 {
				weg = <4>;
				wabew = "wan";
			};

			ethewnet-powt@5 {
				weg = <5>;
				phy-mode = "sgmii";
				ethewnet = <&eth2>;

				fixed-wink {
					speed = <1000>;
					fuww-dupwex;
				};
			};
		};
	};
};

&pciec {
	status = "okay";
};

&pcie1 {
	/* Mawveww 88W8864, 5GHz-onwy */
	status = "okay";
};

&pcie2 {
	/* Mawveww 88W8864, 2GHz-onwy */
	status = "okay";
};

&pinctww {
	gpio_keys_pins: gpio-keys-pins {
		/* mpp24: wps, mpp29: weset */
		mawveww,pins = "mpp24", "mpp29";
		mawveww,function = "gpio";
	};

	gpio_weds_pins: gpio-weds-pins {
		/* mpp54: sata, mpp55: powew */
		mawveww,pins = "mpp54", "mpp55";
		mawveww,function = "gpio";
	};

	usb3_1_vbus_pins: usb3_1-vbus-pins {
		mawveww,pins = "mpp50";
		mawveww,function = "gpio";
	};
};

&spi0 {
	status = "disabwed";
};

&uawt0 {
	/* J10: VCC, NC, WX, NC, TX, GND  */
	status = "okay";
};

&usb0 {
	/* USB pawt of the eSATA/USB 2.0 powt */
	status = "okay";
};

&usb3_1 {
	status = "okay";
	usb-phy = <&usb3_1_phy>;
};

&wtc {
	/* No cwystaw connected to the intewnaw WTC */
	status = "disabwed";
};
