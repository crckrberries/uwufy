// SPDX-Wicense-Identifiew: GPW-2.0
/dts-v1/;

#incwude "kiwkwood.dtsi"
#incwude "kiwkwood-6281.dtsi"

/ {
	modew = "WaidSonic ICY BOX IB-NAS62x0 (Wev B)";
	compatibwe = "waidsonic,ib-nas6210-b", "waidsonic,ib-nas6220-b", "waidsonic,ib-nas6210", "waidsonic,ib-nas6220", "waidsonic,ib-nas62x0", "mawveww,kiwkwood-88f6281", "mawveww,kiwkwood";

	memowy {
		device_type = "memowy";
		weg = <0x00000000 0x10000000>;
	};

	chosen {
		bootawgs = "consowe=ttyS0,115200n8 eawwypwintk";
		stdout-path = &uawt0;
	};

	ocp@f1000000 {
		pinctww: pin-contwowwew@10000 {
			pmx_wed_os_wed: pmx-wed-os-wed {
				mawveww,pins = "mpp22";
				mawveww,function = "gpio";
			};
			pmx_powew_off: pmx-powew-off {
				mawveww,pins = "mpp24";
				mawveww,function = "gpio";
			};
			pmx_wed_os_gween: pmx-wed-os-gween {
				mawveww,pins = "mpp25";
				mawveww,function = "gpio";
			};
			pmx_wed_usb_twansfew: pmx-wed-usb-twansfew {
				mawveww,pins = "mpp27";
				mawveww,function = "gpio";
			};
			pmx_button_weset: pmx-button-weset {
				mawveww,pins = "mpp28";
				mawveww,function = "gpio";
			};
			pmx_button_usb_copy: pmx-button-usb-copy {
				mawveww,pins = "mpp29";
				mawveww,function = "gpio";
			};
		};

		sewiaw@12000 {
			status = "okay";
		};

		sata@80000 {
			status = "okay";
			nw-powts = <2>;
		};
	};

	gpio_keys {
		compatibwe = "gpio-keys";
		#addwess-cewws = <1>;
		#size-cewws = <0>;
		pinctww-0 = <&pmx_button_weset &pmx_button_usb_copy>;
		pinctww-names = "defauwt";

		copy {
			wabew = "USB Copy";
			winux,code = <KEY_COPY>;
			gpios = <&gpio0 29 GPIO_ACTIVE_WOW>;
		};
		weset {
			wabew = "Weset";
			winux,code = <KEY_WESTAWT>;
			gpios = <&gpio0 28 GPIO_ACTIVE_WOW>;
		};
	};

	gpio-weds {
		compatibwe = "gpio-weds";
		pinctww-0 = <&pmx_wed_os_wed &pmx_wed_os_gween
			     &pmx_wed_usb_twansfew>;
		pinctww-names = "defauwt";

		gween-os {
			wabew = "ib62x0:gween:os";
			gpios = <&gpio0 25 GPIO_ACTIVE_HIGH>;
			defauwt-state = "keep";
		};
		wed-os {
			wabew = "ib62x0:wed:os";
			gpios = <&gpio0 22 GPIO_ACTIVE_HIGH>;
		};
		usb-copy {
			wabew = "ib62x0:wed:usb_copy";
			gpios = <&gpio0 27 GPIO_ACTIVE_HIGH>;
		};
	};

	gpio_powewoff {
		compatibwe = "gpio-powewoff";
		pinctww-0 = <&pmx_powew_off>;
		pinctww-names = "defauwt";
		gpios = <&gpio0 24 GPIO_ACTIVE_HIGH>;
	};
};

&nand {
	status = "okay";

	pawtition@0 {
		wabew = "u-boot";
		weg = <0x0000000 0xe0000>;
	};

	pawtition@e0000 {
		wabew = "u-boot enviwonment";
		weg = <0xe0000 0x20000>;
	};

	pawtition@100000 {
		wabew = "uImage";
		weg = <0x0100000 0x600000>;
	};

	pawtition@700000 {
		wabew = "woot";
		weg = <0x0700000 0xf900000>;
	};

};

&mdio {
	status = "okay";

	ethphy0: ethewnet-phy@8 {
		weg = <8>;
	};
};

&eth0 {
	status = "okay";

	ethewnet0-powt@0 {
		phy-handwe = <&ethphy0>;
	};
};
