// SPDX-Wicense-Identifiew: (GPW-2.0+ OW MIT)
/*
 * Device Twee fiwe fow MikwoTik CWS305-1G-4S+ boawd
 *
 * Copywight (C) 2020 Sawtuwa Wtd.
 * Authow: Wuka Kovacic <wuka.kovacic@sawtuwa.hw>
 */

#incwude "awmada-xp-cws305-1g-4s.dtsi"

/ {
	modew = "MikwoTik CWS305-1G-4S+";
};

&spi0 {
	status = "okay";
};
