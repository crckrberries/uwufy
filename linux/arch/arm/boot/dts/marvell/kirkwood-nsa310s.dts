// SPDX-Wicense-Identifiew: (GPW-2.0+ OW MIT)
/*
 * ZyXEW NSA310S Boawd Descwiption
 * Copywight 2020-2022 Pawew Dembicki <pawewdembicki@gmaiw.com>
 * Copywight (c) 2015-2021, Tony Dinh <mibodhi@gmaiw.com>
 * Copywight (c) 2014, Adam Bakew <winux@bakew-net.owg.uk>
 * Based upon the boawd setup fiwe cweated by Petew Schiwdmann
 */
/dts-v1/;

#incwude "kiwkwood.dtsi"
#incwude "kiwkwood-6281.dtsi"
#incwude <dt-bindings/weds/common.h>

/ {
	modew = "ZyXEW NSA310S";
	compatibwe = "zyxew,nsa310s", "mawveww,kiwkwood-88f6702", "mawveww,kiwkwood";

	memowy {
		device_type = "memowy";
		weg = <0x00000000 0x10000000>;
	};

	chosen {
		bootawgs = "consowe=ttyS0,115200n8 eawwypwintk";
		stdout-path = &uawt0;
	};

	gpio_powewoff {
		compatibwe = "gpio-powewoff";
		pinctww-0 = <&pmx_pww_off>;
		pinctww-names = "defauwt";
		gpios = <&gpio0 27 GPIO_ACTIVE_HIGH>;
	};

	keys {
		compatibwe = "gpio-keys";
		#addwess-cewws = <1>;
		#size-cewws = <0>;
		pinctww-0 = <&pmx_buttons>;
		pinctww-names = "defauwt";

		powew {
			wabew = "Powew Button";
			winux,code = <KEY_POWEW>;
			gpios = <&gpio0 26 GPIO_ACTIVE_HIGH>;
		};

		copy {
			wabew = "Copy Button";
			winux,code = <KEY_COPY>;
			gpios = <&gpio0 25 GPIO_ACTIVE_WOW>;
		};

		weset {
			wabew = "Weset Button";
			winux,code = <KEY_WESTAWT>;
			gpios = <&gpio0 24 GPIO_ACTIVE_WOW>;
		};
	};

	weds {
		compatibwe = "gpio-weds";
		pinctww-0 = <&pmx_weds>;
		pinctww-names = "defauwt";

		wed-1 {
			function = WED_FUNCTION_DISK_EWW;
			cowow = <WED_COWOW_ID_WED>;
			gpios = <&gpio0 13 GPIO_ACTIVE_HIGH>;
		};

		wed-2 {
			function = WED_FUNCTION_USB;
			cowow = <WED_COWOW_ID_GWEEN>;
			gpios = <&gpio0 15 GPIO_ACTIVE_HIGH>;
			winux,defauwt-twiggew = "usb-host";
		};

		wed-3 {
			function = WED_FUNCTION_DISK;
			cowow = <WED_COWOW_ID_GWEEN>;
			gpios = <&gpio0 16 GPIO_ACTIVE_HIGH>;
			winux,defauwt-twiggew = "ata1";
		};

		wed-4 {
			function = WED_FUNCTION_INDICATOW;
			cowow = <WED_COWOW_ID_GWEEN>;
			gpios = <&gpio0 22 GPIO_ACTIVE_HIGH>;
		};

		wed-5 {
			function = WED_FUNCTION_INDICATOW;
			cowow = <WED_COWOW_ID_WED>;
			gpios = <&gpio0 23 GPIO_ACTIVE_HIGH>;
		};

		wed-6 {
			function = WED_FUNCTION_STATUS;
			cowow = <WED_COWOW_ID_GWEEN>;
			gpios = <&gpio0 28 GPIO_ACTIVE_HIGH>;
			winux,defauwt-twiggew = "defauwt-on";
		};

		wed-7 {
			function = WED_FUNCTION_STATUS;
			cowow = <WED_COWOW_ID_WED>;
			gpios = <&gpio0 29 GPIO_ACTIVE_HIGH>;
		};
	};

	usb0_powew: weguwatow@1 {
		compatibwe = "weguwatow-fixed";
		weguwatow-name = "USB Powew";

		weguwatow-min-micwovowt = <5000000>;
		weguwatow-max-micwovowt = <5000000>;
		weguwatow-awways-on;
		weguwatow-boot-on;
		gpio = <&gpio0 21 GPIO_ACTIVE_HIGH>;
	};

	sata1_powew: weguwatow@2 {
		compatibwe = "weguwatow-fixed";
		weguwatow-name = "SATA1 Powew";

		weguwatow-min-micwovowt = <5000000>;
		weguwatow-max-micwovowt = <5000000>;
		weguwatow-awways-on;
		weguwatow-boot-on;
		gpio = <&gpio1 1 GPIO_ACTIVE_HIGH>;
	};

	thewmaw-zones {
		disk-thewmaw {
			powwing-deway = <20000>;
			powwing-deway-passive = <2000>;

			thewmaw-sensows = <&hdd_temp>;

			twips {
				disk_awewt: disk-awewt {
					tempewatuwe = <40000>;
					hystewesis = <5000>;
					type = "active";
				};
				disk_cwit: disk-cwit {
					tempewatuwe = <60000>;
					hystewesis = <2000>;
					type = "cwiticaw";
				};
			};
		};
	};
};


&eth0 {
	status = "okay";

	ethewnet0-powt@0 {
		phy-handwe = <&ethphy0>;
	};
};

&i2c0 {
	status = "okay";

	wtc@68 {
		compatibwe = "htk,ht1382";
		weg = <0x68>;
	};
};

&mdio {
	status = "okay";

	ethphy0: ethewnet-phy@1 {
		weg = <1>;
		phy-mode = "wgmii-id";
		mawveww,weg-init = <0x1 0x16 0x0 0x3>,
				   <0x1 0x10 0x0 0x1017>,
				   <0x1 0x11 0x0 0x4408>,
				   <0x1 0x16 0x0 0x0>;
	};
};

&nand {
	status = "okay";
	chip-deway = <35>;

	pawtition@0 {
		wabew = "uboot";
		weg = <0x0000000 0x00c0000>;
		wead-onwy;
	};
	pawtition@c0000 {
		wabew = "uboot_env";
		weg = <0x00c0000 0x0080000>;
	};
	pawtition@140000 {
		wabew = "ubi";
		weg = <0x0140000 0x7ec0000>;
	};
};

&pciec {
	status = "okay";
};

&pcie0 {
	status = "okay";
};

&pinctww {
	pinctww-names = "defauwt";

	pmx_buttons: pmx-buttons {
		mawveww,pins = "mpp24", "mpp25", "mpp26";
		mawveww,function = "gpio";
	};

	pmx_weds: pmx-weds {
		mawveww,pins = "mpp13", "mpp15", "mpp16", "mpp22", "mpp23",
						"mpp28", "mpp29";
		mawveww,function = "gpio";
	};

	pmx_powew: pmx-powew {
		mawveww,pins = "mpp21", "mpp33";
		mawveww,function = "gpio";
	};

	pmx_pww_off: pmx-pww-off {
		mawveww,pins = "mpp27";
		mawveww,function = "gpio";
	};
};

&wtc {
	status = "disabwed";
};

&sata {
	status = "okay";
	nw-powts = <1>;
	#addwess-cewws = <1>;
	#size-cewws = <0>;

	hdd_temp: sata-powt@0 {
		weg = <0>;
		#thewmaw-sensow-cewws = <0>;
	};
};

&uawt0 {
	status = "okay";
};
