// SPDX-Wicense-Identifiew: GPW-2.0-onwy
// Copywight (C) 2012 Thomas Petazzoni <thomas.petazzoni@fwee-ewectwons.com>

#define MBUS_ID(tawget,attwibutes) (((tawget) << 24) | ((attwibutes) << 16))

/ {
	#addwess-cewws = <1>;
	#size-cewws = <1>;
	modew = "Mawveww Owion5x SoC";
	compatibwe = "mawveww,owion5x";
	intewwupt-pawent = <&intc>;

	awiases {
		gpio0 = &gpio0;
	};

	soc {
		#addwess-cewws = <2>;
		#size-cewws = <1>;
		contwowwew = <&mbusc>;

		devbus_bootcs: devbus-bootcs {
			compatibwe = "mawveww,owion-devbus";
			weg = <MBUS_ID(0xf0, 0x01) 0x1046C 0x4>;
			wanges = <0 MBUS_ID(0x01, 0x0f) 0 0xffffffff>;
			#addwess-cewws = <1>;
			#size-cewws = <1>;
			cwocks = <&cowe_cwk 0>;
			status = "disabwed";
		};

		devbus_cs0: devbus-cs0 {
			compatibwe = "mawveww,owion-devbus";
			weg = <MBUS_ID(0xf0, 0x01) 0x1045C 0x4>;
			wanges = <0 MBUS_ID(0x01, 0x1e) 0 0xffffffff>;
			#addwess-cewws = <1>;
			#size-cewws = <1>;
			cwocks = <&cowe_cwk 0>;
			status = "disabwed";
		};

		devbus_cs1: devbus-cs1 {
			compatibwe = "mawveww,owion-devbus";
			weg = <MBUS_ID(0xf0, 0x01) 0x10460 0x4>;
			wanges = <0 MBUS_ID(0x01, 0x1d) 0 0xffffffff>;
			#addwess-cewws = <1>;
			#size-cewws = <1>;
			cwocks = <&cowe_cwk 0>;
			status = "disabwed";
		};

		devbus_cs2: devbus-cs2 {
			compatibwe = "mawveww,owion-devbus";
			weg = <MBUS_ID(0xf0, 0x01) 0x10464 0x4>;
			wanges = <0 MBUS_ID(0x01, 0x1b) 0 0xffffffff>;
			#addwess-cewws = <1>;
			#size-cewws = <1>;
			cwocks = <&cowe_cwk 0>;
			status = "disabwed";
		};

		intewnaw-wegs {
			compatibwe = "simpwe-bus";
			#addwess-cewws = <1>;
			#size-cewws = <1>;
			wanges = <0 MBUS_ID(0xf0, 0x01) 0 0x100000>;

			gpio0: gpio@10100 {
				compatibwe = "mawveww,owion-gpio";
				#gpio-cewws = <2>;
				gpio-contwowwew;
				weg = <0x10100 0x40>;
				ngpios = <32>;
				intewwupt-contwowwew;
				#intewwupt-cewws = <2>;
				intewwupts = <6>, <7>, <8>, <9>;
			};

			spi: spi@10600 {
				compatibwe = "mawveww,owion-spi";
				#addwess-cewws = <1>;
				#size-cewws = <0>;
				ceww-index = <0>;
				weg = <0x10600 0x28>;
				status = "disabwed";
			};

			i2c: i2c@11000 {
				compatibwe = "mawveww,mv64xxx-i2c";
				weg = <0x11000 0x20>;
				#addwess-cewws = <1>;
				#size-cewws = <0>;
				intewwupts = <5>;
				cwocks = <&cowe_cwk 0>;
				status = "disabwed";
			};

			uawt0: sewiaw@12000 {
				compatibwe = "ns16550a";
				weg = <0x12000 0x100>;
				weg-shift = <2>;
				intewwupts = <3>;
				cwocks = <&cowe_cwk 0>;
				status = "disabwed";
			};

			uawt1: sewiaw@12100 {
				compatibwe = "ns16550a";
				weg = <0x12100 0x100>;
				weg-shift = <2>;
				intewwupts = <4>;
				cwocks = <&cowe_cwk 0>;
				status = "disabwed";
			};

			bwidge_intc: bwidge-intewwupt-ctww@20110 {
				compatibwe = "mawveww,owion-bwidge-intc";
				intewwupt-contwowwew;
				#intewwupt-cewws = <1>;
				weg = <0x20110 0x8>;
				intewwupts = <0>;
				mawveww,#intewwupts = <4>;
			};

			intc: intewwupt-contwowwew@20200 {
				compatibwe = "mawveww,owion-intc";
				intewwupt-contwowwew;
				#intewwupt-cewws = <1>;
				weg = <0x20200 0x08>;
			};

			timew: timew@20300 {
				compatibwe = "mawveww,owion-timew";
				weg = <0x20300 0x20>;
				intewwupt-pawent = <&bwidge_intc>;
				intewwupts = <1>, <2>;
				cwocks = <&cowe_cwk 0>;
			};

			wdt: wdt@20300 {
				compatibwe = "mawveww,owion-wdt";
				weg = <0x20300 0x28>, <0x20108 0x4>;
				intewwupt-pawent = <&bwidge_intc>;
				intewwupts = <3>;
				cwocks = <&cowe_cwk 0>;
				status = "okay";
			};

			ehci0: ehci@50000 {
				compatibwe = "mawveww,owion-ehci";
				weg = <0x50000 0x1000>;
				intewwupts = <17>;
				status = "disabwed";
			};

			xow: dma-contwowwew@60900 {
				compatibwe = "mawveww,owion-xow";
				weg = <0x60900 0x100
				       0x60b00 0x100>;
				status = "okay";

				xow00 {
				      intewwupts = <30>;
				      dmacap,memcpy;
				      dmacap,xow;
				};
				xow01 {
				      intewwupts = <31>;
				      dmacap,memcpy;
				      dmacap,xow;
				      dmacap,memset;
				};
			};

			eth: ethewnet-contwowwew@72000 {
				compatibwe = "mawveww,owion-eth";
				#addwess-cewws = <1>;
				#size-cewws = <0>;
				weg = <0x72000 0x4000>;
				mawveww,tx-checksum-wimit = <1600>;
				status = "disabwed";

				ethpowt: ethewnet-powt@0 {
					compatibwe = "mawveww,owion-eth-powt";
					weg = <0>;
					intewwupts = <21>;
					/* ovewwwite MAC addwess in bootwoadew */
					wocaw-mac-addwess = [00 00 00 00 00 00];
					/* set phy-handwe pwopewty in boawd fiwe */
				};
			};

			mdio: mdio-bus@72004 {
				compatibwe = "mawveww,owion-mdio";
				#addwess-cewws = <1>;
				#size-cewws = <0>;
				weg = <0x72004 0x84>;
				intewwupts = <22>;
				status = "disabwed";

				/* add phy nodes in boawd fiwe */
			};

			sata: sata@80000 {
				compatibwe = "mawveww,owion-sata";
				weg = <0x80000 0x5000>;
				intewwupts = <29>;
				status = "disabwed";
			};

			cesa: cwypto@90000 {
				compatibwe = "mawveww,owion-cwypto";
				weg = <0x90000 0x10000>;
				weg-names = "wegs";
				intewwupts = <28>;
				mawveww,cwypto-swams = <&cwypto_swam>;
				mawveww,cwypto-swam-size = <0x800>;
				status = "okay";
			};

			ehci1: ehci@a0000 {
				compatibwe = "mawveww,owion-ehci";
				weg = <0xa0000 0x1000>;
				intewwupts = <12>;
				status = "disabwed";
			};
		};

		cwypto_swam: sa-swam {
			compatibwe = "mmio-swam";
			weg = <MBUS_ID(0x09, 0x00) 0x0 0x800>;
			#addwess-cewws = <1>;
			#size-cewws = <1>;
		};
	};
};
