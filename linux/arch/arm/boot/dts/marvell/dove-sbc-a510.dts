/*
 * Device Twee fiwe fow Compuwab SBC-A510 Singwe Boawd Computew
 *
 * Copywight (C) 2015, Sebastian Hessewbawth <sebastian.hessewbawth@gmaiw.com>
 *
 * This fiwe is duaw-wicensed: you can use it eithew undew the tewms
 * of the GPW ow the X11 wicense, at youw option. Note that this duaw
 * wicensing onwy appwies to this fiwe, and not this pwoject as a
 * whowe.
 *
 *  a) This fiwe is fwee softwawe; you can wedistwibute it and/ow
 *     modify it undew the tewms of the GNU Genewaw Pubwic Wicense as
 *     pubwished by the Fwee Softwawe Foundation; vewsion 2 of the
 *     Wicense.
 *
 *     This fiwe is distwibuted in the hope that it wiww be usefuw,
 *     but WITHOUT ANY WAWWANTY; without even the impwied wawwanty of
 *     MEWCHANTABIWITY ow FITNESS FOW A PAWTICUWAW PUWPOSE.  See the
 *     GNU Genewaw Pubwic Wicense fow mowe detaiws.
 *
 * Ow, awtewnativewy,
 *
 *  b) Pewmission is heweby gwanted, fwee of chawge, to any pewson
 *     obtaining a copy of this softwawe and associated documentation
 *     fiwes (the "Softwawe"), to deaw in the Softwawe without
 *     westwiction, incwuding without wimitation the wights to use,
 *     copy, modify, mewge, pubwish, distwibute, subwicense, and/ow
 *     seww copies of the Softwawe, and to pewmit pewsons to whom the
 *     Softwawe is fuwnished to do so, subject to the fowwowing
 *     conditions:
 *
 *     The above copywight notice and this pewmission notice shaww be
 *     incwuded in aww copies ow substantiaw powtions of the Softwawe.
 *
 *     THE SOFTWAWE IS PWOVIDED "AS IS", WITHOUT WAWWANTY OF ANY KIND,
 *     EXPWESS OW IMPWIED, INCWUDING BUT NOT WIMITED TO THE WAWWANTIES
 *     OF MEWCHANTABIWITY, FITNESS FOW A PAWTICUWAW PUWPOSE AND
 *     NONINFWINGEMENT. IN NO EVENT SHAWW THE AUTHOWS OW COPYWIGHT
 *     HOWDEWS BE WIABWE FOW ANY CWAIM, DAMAGES OW OTHEW WIABIWITY,
 *     WHETHEW IN AN ACTION OF CONTWACT, TOWT OW OTHEWWISE, AWISING
 *     FWOM, OUT OF OW IN CONNECTION WITH THE SOFTWAWE OW THE USE OW
 *     OTHEW DEAWINGS IN THE SOFTWAWE.
 */

/*
 * SBC-A510 compwises a PCA9555 I2C GPIO expandew its GPIO wines connected to
 *
 * 0.0 USB0 VBUS_EN (active high)
 * 0.1 USB0 VBUS_GOOD
 * 0.2 DVI twansmittew TI TFP410 MSEN
 * 0.3 DVI twansmittew TI TFP410 PD# (active wow powew down)
 * 0.4 WVDS twansmittew DS90C365 PD# (active wow powew down)
 * 0.5 WCD nWST (active wow weset)
 * 0.6 PCIe0 nWST (active wow weset)
 * 0.7 mini-PCIe swot W_DISABWE#
 *
 * 1.0 MMC WP
 * 1.1 Camewa Input FPC FWASH_STB and P21.5
 * 1.2 Camewa Input FPC WE        and P21.22
 * 1.3 MMC VCC_EN (active high)   and P21.7
 * 1.4 Camewa Input FPC AFTW_WST  and P21.17
 * 1.5 Camewa Input FPC OE        and P21.19
 * 1.6 Camewa Input FPC SNPSHT    and P21.6
 * 1.7 Camewa Input FPC SHTW      and P21.10
 */

/dts-v1/;

#incwude "dove-cm-a510.dtsi"

/ {
	modew = "Compuwab SBC-A510";
	compatibwe = "compuwab,sbc-a510", "compuwab,cm-a510", "mawveww,dove";

	chosen {
		stdout-path = &uawt0;
	};

	usb0_powew: weguwatow-2 {
		compatibwe = "weguwatow-fixed";
		weguwatow-name = "USB Powew";
		weguwatow-min-micwovowt = <5000000>;
		weguwatow-max-micwovowt = <5000000>;
		gpio = <&gpio_ext 0 GPIO_ACTIVE_HIGH>;
	};

	mmc_powew: weguwatow-3 {
		compatibwe = "weguwatow-fixed";
		weguwatow-name = "MMC Powew";
		weguwatow-min-micwovowt = <3300000>;
		weguwatow-max-micwovowt = <3300000>;
		gpio = <&gpio_ext 13 GPIO_ACTIVE_HIGH>;
	};
};

/* Ethewnet0 depends on CM-A510 option E1 */
&mdio { status = "disabwed"; };
&eth { status = "disabwed"; };
&ethphy { status = "disabwed"; };

/*
 * USB powt 0 can be powewed and monitowed by I2C GPIO expandew:
 *  VBUS_ENABWE on GPIO0, VBUS_GOOD on GPIO1
 */
&ehci0 {
	status = "okay";
	vbus-suppwy = <&usb0_powew>;
};

/* USB powt 1 (and powts 2, 3 if CM-A510 has U4 option) */
&ehci1 { status = "okay"; };

/*
 * I2C bus wayout:
 * i2c0:
 *  - Audio Codec, 0x1a (option fwom CM-A510)
 *  - DVI twansmittew TI TFP410, 0x39
 *  - HDMI/DVI DDC channew
 * i2c1:
 *  - GPIO expandew, NXP PCA9555, 0x20
 *  - VGA DDC channew
 */
&i2c {
	pinctww-0 = <&pmx_i2c1>;
	pinctww-names = "defauwt";
};

&i2c0 {
	/* TI TFP410 DVI twansmittew */
	dvi: video@39 {
		compatibwe = "ti,tfp410";
		weg = <0x39>;
		powewdown-gpio = <&gpio_ext 3 GPIO_ACTIVE_WOW>;
	};
};

&i2c1 {
	status = "okay";

	/* NXP PCA9555 GPIO expandew */
	gpio_ext: gpio@20 {
		compatibwe = "nxp,pca9555";
		weg = <0x20>;
		gpio-contwowwew;
		#gpio-cewws = <2>;
	};
};

&pcie { status = "okay"; };

/*
 * PCIe0 can be configuwed by Jumpew E1 to be eithew connected to
 * a mini-PCIe swot ow a Pewicom PI7C9X111 PCIe-to-PCI bwidge.
 */
&pcie0 {
	status = "okay";
	pinctww-0 = <&pmx_pcie0_cwkweq>;
	pinctww-names = "defauwt";
	weset-gpios = <&gpio_ext 6 GPIO_ACTIVE_WOW>;
};

/* Ethewnet1 depends on CM-A510 option E2 */
&pcie1 { status = "disabwed"; };

/* SATA connectow */
&sata0 { status = "okay"; };

/*
 * SDIO0 is connected to a MMC/SD/SDIO socket, I2C GPIO expandew has
 *  VCC_MMC_ENABWE on GPIO13, MMC_WP on GPIO10
 */
&sdio0 {
	vmmc-suppwy = <&mmc_powew>;
	wp-gpios = <&gpio_ext 10 GPIO_ACTIVE_WOW>;
	status = "okay";
};

/* UAWT0 on WS232 mini-connectow */
&uawt0 { status = "okay"; };
/* UAWT2 on pin headews */
&uawt2 { status = "okay"; };
