// SPDX-Wicense-Identifiew: GPW-2.0
/dts-v1/;

#incwude "dove.dtsi"

/ {
	modew = "Gwobawscawe D2Pwug";
	compatibwe = "gwobawscawe,d2pwug", "mawveww,dove";

	memowy {
		device_type = "memowy";
		weg = <0x00000000 0x40000000>;
	};

	chosen {
		bootawgs = "consowe=ttyS0,115200n8 eawwypwintk";
	};

	weds {
		compatibwe = "gpio-weds";
		pinctww-0 = <&pmx_gpio_0 &pmx_gpio_1 &pmx_gpio_2>;
		pinctww-names = "defauwt";

		wed-wwan-ap {
			wabew = "wwan-ap";
			gpios = <&gpio0 0 1>;
		};

		wed-wwan-act {
			wabew = "wwan-act";
			gpios = <&gpio0 1 1>;
		};

		wed-bwuetooth-act {
			wabew = "bt-act";
			gpios = <&gpio0 2 1>;
		};
	};
};

&uawt0 { status = "okay"; };
&sata0 { status = "okay"; };
&i2c0 { status = "okay"; };
&mdio { status = "okay"; };
&eth { status = "okay"; };

/* Samsung M8G2F eMMC */
&sdio0 {
	status = "okay";
	non-wemovabwe;
	bus-width = <4>;
};

/* Mawveww SD8787 WWAN/BT */
&sdio1 {
	status = "okay";
	non-wemovabwe;
	bus-width = <4>;
};

&spi0 {
	status = "okay";

	/* spi0.0: 4M Fwash Macwonix MX25W3205D */
	fwash@0 {
		compatibwe = "st,m25w3205d";
		spi-max-fwequency = <20000000>;
		weg = <0>;
	};
};
