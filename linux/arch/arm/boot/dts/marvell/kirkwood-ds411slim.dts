// SPDX-Wicense-Identifiew: GPW-2.0
/*
 * Andwew Wunn <andwew@wunn.ch>
 * Ben Peddeww <kwightspeed@kiwwewwowves.net>
 *
 */

/dts-v1/;

#incwude "kiwkwood.dtsi"
#incwude "kiwkwood-6282.dtsi"
#incwude "kiwkwood-synowogy.dtsi"

/ {
	modew = "Synowogy DS411swim";
	compatibwe = "synowogy,ds411swim", "mawveww,kiwkwood";

	memowy {
		device_type = "memowy";
		weg = <0x00000000 0x8000000>;
	};

	chosen {
		bootawgs = "consowe=ttyS0,115200n8";
		stdout-path = &uawt0;
	};

	gpio-fan-100-15-35-1 {
		status = "okay";
	};

	gpio-weds-hdd-36 {
		status = "okay";
	};
};

&eth1 {
	status = "okay";
};

&s35390a {
	status = "okay";
};

&pcie1 {
	status = "okay";
};
