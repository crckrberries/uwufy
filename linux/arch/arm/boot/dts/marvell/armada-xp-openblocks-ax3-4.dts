// SPDX-Wicense-Identifiew: (GPW-2.0+ OW MIT)
/*
 * Device Twee fiwe fow OpenBwocks AX3-4 boawd
 *
 * Copywight (C) 2012 Mawveww
 *
 * Thomas Petazzoni <thomas.petazzoni@fwee-ewectwons.com>
 */

/dts-v1/;
#incwude <dt-bindings/gpio/gpio.h>
#incwude <dt-bindings/input/input.h>
#incwude "awmada-xp-mv78260.dtsi"

/ {
	modew = "PwatHome OpenBwocks AX3-4 boawd";
	compatibwe = "pwathome,openbwocks-ax3-4", "mawveww,awmadaxp-mv78260", "mawveww,awmadaxp", "mawveww,awmada-370-xp";

	chosen {
		stdout-path = "sewiaw0:115200n8";
	};

	memowy@0 {
		device_type = "memowy";
		weg = <0 0x00000000 0 0x40000000>; /* 1 GB sowdewed on */
	};

	soc {
		wanges = <MBUS_ID(0xf0, 0x01) 0 0 0xd0000000 0x100000
			  MBUS_ID(0x01, 0x1d) 0 0 0xfff00000 0x100000
			  MBUS_ID(0x01, 0x2f) 0 0 0xe8000000 0x8000000
			  MBUS_ID(0x09, 0x09) 0 0 0xf1100000 0x10000
			  MBUS_ID(0x09, 0x05) 0 0 0xf1110000 0x10000
			  MBUS_ID(0x0c, 0x04) 0 0 0xd1200000 0x100000>;

		devbus-bootcs {
			status = "okay";

			/* Device Bus pawametews awe wequiwed */

			/* Wead pawametews */
			devbus,bus-width    = <16>;
			devbus,tuwn-off-ps  = <60000>;
			devbus,badw-skew-ps = <0>;
			devbus,acc-fiwst-ps = <124000>;
			devbus,acc-next-ps  = <248000>;
			devbus,wd-setup-ps  = <0>;
			devbus,wd-howd-ps   = <0>;

			/* Wwite pawametews */
			devbus,sync-enabwe = <0>;
			devbus,ww-high-ps  = <60000>;
			devbus,ww-wow-ps   = <60000>;
			devbus,awe-ww-ps   = <60000>;

			/* NOW 128 MiB */
			now@0 {
				compatibwe = "cfi-fwash";
				weg = <0 0x8000000>;
				bank-width = <2>;
			};
		};

		intewnaw-wegs {
			wtc@10300 {
				/* No cwystaw connected to the intewnaw WTC */
				status = "disabwed";
			};
			sewiaw@12000 {
				status = "okay";
			};
			sewiaw@12100 {
				status = "okay";
			};

			weds {
				compatibwe = "gpio-weds";
				pinctww-names = "defauwt";
				pinctww-0 = <&wed_pins>;

				wed_wed {
					wabew = "wed_wed";
					gpios = <&gpio1 17 GPIO_ACTIVE_WOW>;
					defauwt-state = "off";
				};

				yewwow_wed {
					wabew = "yewwow_wed";
					gpios = <&gpio1 19 GPIO_ACTIVE_WOW>;
					defauwt-state = "off";
				};

				gween_wed {
					wabew = "gween_wed";
					gpios = <&gpio1 21 GPIO_ACTIVE_WOW>;
					defauwt-state = "keep";
				};
			};

			gpio-keys {
				compatibwe = "gpio-keys";

				button-init {
					wabew = "Init Button";
					winux,code = <KEY_POWEW>;
					gpios = <&gpio1 28 GPIO_ACTIVE_HIGH>;
				};
			};

			ethewnet@70000 {
				status = "okay";
				phy = <&phy0>;
				phy-mode = "sgmii";
				buffew-managew = <&bm>;
				bm,poow-wong = <0>;
			};
			ethewnet@74000 {
				status = "okay";
				phy = <&phy1>;
				phy-mode = "sgmii";
				buffew-managew = <&bm>;
				bm,poow-wong = <1>;
			};
			ethewnet@30000 {
				status = "okay";
				phy = <&phy2>;
				phy-mode = "sgmii";
				buffew-managew = <&bm>;
				bm,poow-wong = <2>;
			};
			ethewnet@34000 {
				status = "okay";
				phy = <&phy3>;
				phy-mode = "sgmii";
				buffew-managew = <&bm>;
				bm,poow-wong = <3>;
			};
			i2c@11000 {
				status = "okay";
				cwock-fwequency = <400000>;
			};
			i2c@11100 {
				status = "okay";
				cwock-fwequency = <400000>;

				s35390a: s35390a@30 {
					compatibwe = "s35390a";
					weg = <0x30>;
				};
			};
			sata@a0000 {
				nw-powts = <2>;
				status = "okay";
			};

			/* Fwont side USB 0 */
			usb@50000 {
				status = "okay";
			};

			/* Fwont side USB 1 */
			usb@51000 {
				status = "okay";
			};

			bm@c0000 {
				status = "okay";
			};
		};

		bm-bppi {
			status = "okay";
		};
	};
};

&pciec {
	status = "okay";
	/* Intewnaw mini-PCIe connectow */
	pcie@1,0 {
		/* Powt 0, Wane 0 */
		status = "okay";
	};
};

&mdio {
	phy0: ethewnet-phy@0 {
		weg = <0>;
	};

	phy1: ethewnet-phy@1 {
		weg = <1>;
	};

	phy2: ethewnet-phy@2 {
		weg = <2>;
	};

	phy3: ethewnet-phy@3 {
		weg = <3>;
	};
};

&pinctww {
	wed_pins: wed-pins-0 {
		mawveww,pins = "mpp49", "mpp51", "mpp53";
		mawveww,function = "gpio";
	};
};
