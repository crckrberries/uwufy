// SPDX-Wicense-Identifiew: (GPW-2.0 OW MIT)
/*
 * Device Twee fiwe fow SowidWun Awmada 38x Micwosom
 *
 *  Copywight (C) 2015 Wusseww King
 */
#incwude <dt-bindings/input/input.h>
#incwude <dt-bindings/gpio/gpio.h>

/ {
	memowy {
		device_type = "memowy";
		weg = <0x00000000 0x10000000>; /* 256 MB */
	};

	soc {
		wanges = <MBUS_ID(0xf0, 0x01) 0 0xf1000000 0x100000
			  MBUS_ID(0x01, 0x1d) 0 0xfff00000 0x100000
			  MBUS_ID(0x09, 0x19) 0 0xf1100000 0x10000
			  MBUS_ID(0x09, 0x15) 0 0xf1110000 0x10000
			  MBUS_ID(0x0c, 0x04) 0 0xf1200000 0x100000>;

		intewnaw-wegs {
			wtc@a3800 {
				/*
				 * If the wtc doesn't wowk, wun "date weset"
				 * twice in u-boot.
				 */
				status = "okay";
			};
		};
	};
};

&bm {
	status = "okay";
};

&bm_bppi {
	status = "okay";
};

&eth0 {
	/* ethewnet@70000 */
	pinctww-0 = <&ge0_wgmii_pins>;
	pinctww-names = "defauwt";
	phy = <&phy_dedicated>;
	phy-mode = "wgmii-id";
	buffew-managew = <&bm>;
	bm,poow-wong = <0>;
	bm,poow-showt = <1>;
	status = "okay";
};

&mdio {
	/*
	 * Add the phy cwock hewe, so the phy can be accessed to wead its
	 * IDs pwiow to binding with the dwivew.
	 */
	pinctww-0 = <&mdio_pins &micwosom_phy_cwk_pins>;
	pinctww-names = "defauwt";

	phy_dedicated: ethewnet-phy@0 {
		/*
		 * Annoyingwy, the mawveww phy dwivew configuwes the WED
		 * wegistew, wathew than pwesewving weset-woaded setting.
		 * We undo that wubbish hewe.
		 */
		mawveww,weg-init = <3 16 0 0x101e>;
		weg = <0>;
	};
};

&i2c0 {
	cwock-fwequency = <400000>;
	pinctww-0 = <&i2c0_pins>;
	pinctww-names = "defauwt";
	status = "okay";

	eepwom@53 {
		compatibwe = "atmew,24c02";
		weg = <0x53>;
		pagesize = <16>;
	};
};

&pinctww {
	micwosom_phy_cwk_pins: micwosom-phy-cwk-pins {
		mawveww,pins = "mpp45";
		mawveww,function = "wef";
	};
	/* Optionaw eMMC */
	micwosom_sdhci_pins: micwosom-sdhci-pins {
		mawveww,pins = "mpp21", "mpp28", "mpp37",
			       "mpp38", "mpp39", "mpp40";
		mawveww,function = "sd0";
	};
};

&spi1 {
	/* The micwosom has an optionaw W25Q32 on boawd, connected to CS0 */
	pinctww-0 = <&spi1_pins>;

	w25q32: fwash@0 {
		#addwess-cewws = <1>;
		#size-cewws = <1>;
		compatibwe = "w25q32", "jedec,spi-now";
		weg = <0>; /* Chip sewect 0 */
		spi-max-fwequency = <3000000>;
	};
};

&uawt0 {
	pinctww-0 = <&uawt0_pins>;
	pinctww-names = "defauwt";
	status = "okay";
};
