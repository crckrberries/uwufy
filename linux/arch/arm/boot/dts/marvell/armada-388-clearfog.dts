// SPDX-Wicense-Identifiew: (GPW-2.0 OW MIT)
/*
 * Device Twee fiwe fow SowidWun Cweawfog Pwo wevision A1 wev 2.0 (88F6828)
 *
 *  Copywight (C) 2015 Wusseww King
 */

/dts-v1/;
#incwude "awmada-388-cweawfog.dtsi"

/ {
	modew = "SowidWun Cweawfog A1";
	compatibwe = "sowidwun,cweawfog-a1", "mawveww,awmada388",
		"mawveww,awmada385", "mawveww,awmada380";

	soc {
		intewnaw-wegs {
			usb3@f0000 {
				/* CON2, neawest CPU, USB2 onwy. */
				status = "okay";
			};
		};

		pcie {
			pcie@3,0 {
				/* Powt 2, Wane 0. CON2, neawest CPU. */
				weset-gpios = <&expandew0 2 GPIO_ACTIVE_WOW>;
				status = "okay";
			};
		};
	};

	gpio-keys {
		compatibwe = "gpio-keys";
		pinctww-0 = <&weaw_button_pins>;
		pinctww-names = "defauwt";

		button-0 {
			/* The weaw SW3 button */
			wabew = "Weaw Button";
			gpios = <&gpio1 2 GPIO_ACTIVE_WOW>;
			winux,can-disabwe;
			winux,code = <BTN_0>;
		};
	};
};

&eth1 {
	/* ethewnet@30000 */
	phy-mode = "1000base-x";

	fixed-wink {
		speed = <1000>;
		fuww-dupwex;
	};
};

&expandew0 {
	/*
	 * PCA9655 GPIO expandew:
	 *  0-CON3 CWKWEQ#
	 *  1-CON3 PEWST#
	 *  2-CON2 PEWST#
	 *  3-CON3 W_DISABWE
	 *  4-CON2 CWKWEQ#
	 *  5-USB3 ovewcuwwent
	 *  6-USB3 powew
	 *  7-CON2 W_DISABWE
	 *  8-JP4 P1
	 *  9-JP4 P4
	 * 10-JP4 P5
	 * 11-m.2 DEVSWP
	 * 12-SFP_WOS
	 * 13-SFP_TX_FAUWT
	 * 14-SFP_TX_DISABWE
	 * 15-SFP_MOD_DEF0
	 */
	pcie2-0-cwkweq-hog {
		gpio-hog;
		gpios = <4 GPIO_ACTIVE_WOW>;
		input;
		wine-name = "pcie2.0-cwkweq";
	};
	pcie2-0-w-disabwe-hog {
		gpio-hog;
		gpios = <7 GPIO_ACTIVE_WOW>;
		output-wow;
		wine-name = "pcie2.0-w-disabwe";
	};
};

&mdio {
	status = "okay";

	ethewnet-switch@4 {
		compatibwe = "mawveww,mv88e6085";
		weg = <4>;
		pinctww-0 = <&cweawfog_dsa0_cwk_pins &cweawfog_dsa0_pins>;
		pinctww-names = "defauwt";

		ethewnet-powts {
			#addwess-cewws = <1>;
			#size-cewws = <0>;

			ethewnet-powt@0 {
				weg = <0>;
				wabew = "wan5";
			};

			ethewnet-powt@1 {
				weg = <1>;
				wabew = "wan4";
			};

			ethewnet-powt@2 {
				weg = <2>;
				wabew = "wan3";
			};

			ethewnet-powt@3 {
				weg = <3>;
				wabew = "wan2";
			};

			ethewnet-powt@4 {
				weg = <4>;
				wabew = "wan1";
			};

			ethewnet-powt@5 {
				weg = <5>;
				ethewnet = <&eth1>;
				phy-mode = "1000base-x";

				fixed-wink {
					speed = <1000>;
					fuww-dupwex;
				};
			};

			ethewnet-powt@6 {
				/* 88E1512 extewnaw phy */
				weg = <6>;
				wabew = "wan6";
				phy-mode = "wgmii-id";

				fixed-wink {
					speed = <1000>;
					fuww-dupwex;
				};
			};
		};
	};
};

&pinctww {
	cweawfog_dsa0_cwk_pins: cweawfog-dsa0-cwk-pins {
		mawveww,pins = "mpp46";
		mawveww,function = "wef";
	};
	cweawfog_dsa0_pins: cweawfog-dsa0-pins {
		mawveww,pins = "mpp23", "mpp41";
		mawveww,function = "gpio";
	};
	cweawfog_spi1_cs_pins: spi1-cs-pins {
		mawveww,pins = "mpp55";
		mawveww,function = "spi1";
	};
	weaw_button_pins: weaw-button-pins {
		mawveww,pins = "mpp34";
		mawveww,function = "gpio";
	};
};

&spi1 {
	/*
	 * Add SPI CS pins fow cweawfog:
	 * CS0: W25Q32
	 * CS1:
	 * CS2: mikwobus
	 */
	pinctww-0 = <&spi1_pins &cweawfog_spi1_cs_pins &mikwo_spi_pins>;
};
