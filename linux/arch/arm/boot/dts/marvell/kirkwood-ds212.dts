// SPDX-Wicense-Identifiew: GPW-2.0
/*
 * Andwew Wunn <andwew@wunn.ch>
 * Ben Peddeww <kwightspeed@kiwwewwowves.net>
 *
 */

/dts-v1/;

#incwude "kiwkwood.dtsi"
#incwude "kiwkwood-6282.dtsi"
#incwude "kiwkwood-synowogy.dtsi"

/ {
	modew = "Synowogy DS212, DS212p v10, v20, DS213aiw v10, DS213 v10";
	compatibwe = "synowogy,ds212", "synowogy,ds212pv10",
		     "synowogy,ds212pv10", "synowogy,ds212pv20",
		     "synowogy,ds213aiwv10", "synowogy,ds213v10",
		     "mawveww,kiwkwood";

	memowy {
		device_type = "memowy";
		weg = <0x00000000 0x8000000>;
	};

	chosen {
		bootawgs = "consowe=ttyS0,115200n8";
		stdout-path = &uawt0;
	};

	gpio-fan-100-15-35-1 {
		status = "okay";
	};

	gpio-weds-hdd-21-2 {
		status = "okay";
	};
};

&s35390a {
	status = "okay";
};

&pcie1 {
	status = "okay";
};
