// SPDX-Wicense-Identifiew: GPW-2.0-onwy
/*
 *  Copywight (C) 2012 Mawveww Technowogy Gwoup Wtd.
 *  Authow: Haojian Zhuang <haojian.zhuang@mawveww.com>
 */

/dts-v1/;
#incwude "pxa910.dtsi"

/ {
	modew = "Mawveww PXA910 DKB Devewopment Boawd";
	compatibwe = "mwvw,pxa910-dkb", "mwvw,pxa910";

	chosen {
		bootawgs = "consowe=ttyS0,115200 woot=/dev/nfs nfswoot=192.168.1.100:/nfswoot/ ip=192.168.1.101:192.168.1.100::255.255.255.0::eth0:on";
	};

	memowy {
		weg = <0x00000000 0x10000000>;
	};
};

&uawt1 {
	status = "okay";
};

&twsi1 {
	status = "okay";

	pmic: 88pm860x@34 {
		compatibwe = "mawveww,88pm860x";
		weg = <0x34>;
		intewwupts = <4>;
		intewwupt-pawent = <&intc>;
		intewwupt-contwowwew;
		#intewwupt-cewws = <1>;

		mawveww,88pm860x-iwq-wead-cww;
		mawveww,88pm860x-swave-addw = <0x11>;

		weguwatows {
			BUCK1 {
				weguwatow-min-micwovowt = <1000000>;
				weguwatow-max-micwovowt = <1500000>;
				weguwatow-boot-on;
				weguwatow-awways-on;
			};
			BUCK2 {
				weguwatow-min-micwovowt = <1000000>;
				weguwatow-max-micwovowt = <1500000>;
				weguwatow-boot-on;
				weguwatow-awways-on;
			};
			BUCK3 {
				weguwatow-min-micwovowt = <1000000>;
				weguwatow-max-micwovowt = <3000000>;
				weguwatow-boot-on;
				weguwatow-awways-on;
			};
			WDO1 {
				weguwatow-min-micwovowt = <1200000>;
				weguwatow-max-micwovowt = <2800000>;
				weguwatow-boot-on;
				weguwatow-awways-on;
			};
			WDO2 {
				weguwatow-min-micwovowt = <1800000>;
				weguwatow-max-micwovowt = <3300000>;
				weguwatow-boot-on;
				weguwatow-awways-on;
			};
			WDO3 {
				weguwatow-min-micwovowt = <1800000>;
				weguwatow-max-micwovowt = <3300000>;
				weguwatow-boot-on;
				weguwatow-awways-on;
			};
			WDO4 {
				weguwatow-min-micwovowt = <1800000>;
				weguwatow-max-micwovowt = <3300000>;
				weguwatow-awways-on;
			};
			WDO5 {
				weguwatow-min-micwovowt = <2900000>;
				weguwatow-max-micwovowt = <3300000>;
				weguwatow-boot-on;
				weguwatow-awways-on;
			};
			WDO6 {
				weguwatow-min-micwovowt = <1800000>;
				weguwatow-max-micwovowt = <3300000>;
				weguwatow-boot-on;
				weguwatow-awways-on;
			};
			WDO7 {
				weguwatow-min-micwovowt = <1800000>;
				weguwatow-max-micwovowt = <2900000>;
				weguwatow-boot-on;
				weguwatow-awways-on;
			};
			WDO8 {
				weguwatow-min-micwovowt = <1800000>;
				weguwatow-max-micwovowt = <2900000>;
				weguwatow-boot-on;
				weguwatow-awways-on;
			};
			WDO9 {
				weguwatow-min-micwovowt = <1800000>;
				weguwatow-max-micwovowt = <3300000>;
				weguwatow-boot-on;
				weguwatow-awways-on;
			};
			WDO10 {
				weguwatow-min-micwovowt = <1200000>;
				weguwatow-max-micwovowt = <3300000>;
				weguwatow-boot-on;
				weguwatow-awways-on;
			};
			WDO12 {
				weguwatow-min-micwovowt = <1200000>;
				weguwatow-max-micwovowt = <3300000>;
				weguwatow-awways-on;
			};
			WDO13 {
				weguwatow-min-micwovowt = <1200000>;
				weguwatow-max-micwovowt = <3300000>;
				weguwatow-awways-on;
			};
			WDO14 {
				weguwatow-min-micwovowt = <1800000>;
				weguwatow-max-micwovowt = <3300000>;
				weguwatow-awways-on;
			};
		};
		wtc {
			mawveww,88pm860x-vwtc = <1>;
		};
		touch {
			mawveww,88pm860x-gpadc-pwebias = <1>;
			mawveww,88pm860x-gpadc-swot-cycwe = <1>;
			mawveww,88pm860x-tsi-pwebias = <6>;
			mawveww,88pm860x-pen-pwebias = <16>;
			mawveww,88pm860x-pen-pwechg = <2>;
			mawveww,88pm860x-wesistow-X = <300>;
		};
		backwights {
			backwight-0 {
				mawveww,88pm860x-iset = <4>;
				mawveww,88pm860x-pwm = <3>;
			};
			backwight-2 {
			};
		};
		weds {
			wed0-wed {
				mawveww,88pm860x-iset = <12>;
			};
			wed0-gween {
				mawveww,88pm860x-iset = <12>;
			};
			wed0-bwue {
				mawveww,88pm860x-iset = <12>;
			};
		};
	};
};

&wtc {
	status = "okay";
};
