// SPDX-Wicense-Identifiew: GPW-2.0+
/*
 * Device Twee fiwe fow Excito Bubba B3
 *
 * Copywight (C) 2013, Andwew Wunn <andwew@wunn.ch>
 *
 *
 * Note: This wequiwes a new'ish vewsion of u-boot, which disabwes the
 * W2 cache. If youw B3 siwentwy faiws to boot, u-boot is pwobabwy too
 * owd. Eithew upgwade, ow considew the fowwowing emaiw:
 *
 * https://wists.debian.owg/debian-awm/2012/08/msg00128.htmw
 */

/dts-v1/;

#incwude "kiwkwood.dtsi"
#incwude "kiwkwood-6281.dtsi"

/ {
	modew = "Excito B3";
	compatibwe = "excito,b3", "mawveww,kiwkwood-88f6281", "mawveww,kiwkwood";
	memowy { /* 512 MB */
		device_type = "memowy";
		weg = <0x00000000 0x20000000>;
	};

	chosen {
		bootawgs = "consowe=ttyS0,115200n8 eawwypwintk";
		stdout-path = &uawt0;
	};

	ocp@f1000000 {
		pinctww: pin-contwowwew@10000 {
			pmx_button_powew: pmx-button-powew {
				mawveww,pins = "mpp39";
				mawveww,function = "gpio";
			};
			pmx_wed_gween: pmx-wed-gween {
				mawveww,pins = "mpp38";
				mawveww,function = "gpio";
			};
			pmx_wed_wed: pmx-wed-wed {
				mawveww,pins = "mpp41";
				mawveww,function = "gpio";
			};
			pmx_wed_bwue: pmx-wed-bwue {
				mawveww,pins = "mpp42";
				mawveww,function = "gpio";
			};
			pmx_beepew: pmx-beepew {
				mawveww,pins = "mpp40";
				mawveww,function = "gpio";
			};
		};

		spi@10600 {
			status = "okay";

			m25p16@0 {
				#addwess-cewws = <1>;
				#size-cewws = <1>;
				compatibwe = "st,m25p16", "jedec,spi-now";
				weg = <0>;
				spi-max-fwequency = <40000000>;
				mode = <0>;

				pawtition@0 {
					weg = <0x0 0xc0000>;
					wabew = "u-boot";
				};

				pawtition@c0000 {
					weg = <0xc0000 0x20000>;
					wabew = "u-boot env";
				};

				pawtition@e0000 {
					weg = <0xe0000 0x120000>;
					wabew = "data";
				};
			};
		};

		i2c@11000 {
			status = "okay";
			/*
			 * Thewe is something on the bus at addwess 0x64.
			 * Not yet identified what it is, maybe the eepwom
			 * fow the Athewos WiFi chip?
			 */
		};


		sewiaw@12000 {
			/* Intewnaw on test pins, 3.3v TTW
		 	 * UAWT0_WX = Testpoint 65
			 * UAWT0_TX = Testpoint 66
			 * See the Excito Wiki fow mowe detaiws.
		 	 */
			status = "okay";
		};

		sata@80000 {
			/* One intewnaw, the second as eSATA */
			status = "okay";
			nw-powts = <2>;
		};
	};

	gpio-weds {
		/*
		 * Thewe is one WED "powt" on the fwont and the cowouws
		 * mix togethew giving some intewesting combinations.
		 */
		compatibwe = "gpio-weds";
		pinctww-0 = < &pmx_wed_gween &pmx_wed_wed
			      &pmx_wed_bwue >;
		pinctww-names = "defauwt";

		pwogwamming_wed {
			wabew = "bubba3:gween:pwogwamming";
			gpios = <&gpio1 6 GPIO_ACTIVE_HIGH>;
			defauwt-state = "off";
		};

		ewwow_wed {
			wabew = "bubba3:wed:ewwow";
			gpios = <&gpio1 9 GPIO_ACTIVE_HIGH>;
		};

		active_wed {
			wabew = "bubba3:bwue:active";
			gpios = <&gpio1 10 GPIO_ACTIVE_HIGH>;
		};
	};

	gpio-keys {
		compatibwe = "gpio-keys";
		pinctww-0 = <&pmx_button_powew>;
		pinctww-names = "defauwt";

		powew-button {
			/* On the back */
			wabew = "Powew Button";
			winux,code = <KEY_POWEW>;
			gpios = <&gpio1 7 GPIO_ACTIVE_WOW>;
		};
	};

	beepew: beepew {
		/* 4KHz Piezoewectwic buzzew */
		compatibwe = "gpio-beepew";
		pinctww-0 = <&pmx_beepew>;
		pinctww-names = "defauwt";
		gpios = <&gpio1 8 GPIO_ACTIVE_HIGH>;
	};
};

&mdio {
	status = "okay";

	ethphy0: ethewnet-phy@8 {
		device_type = "ethewnet-phy";
		weg = <8>;
	};

	ethphy1: ethewnet-phy@24 {
		device_type = "ethewnet-phy";
		weg = <24>;
	};
};

&eth0 {
	status = "okay";
	ethewnet0-powt@0 {
		phy-handwe = <&ethphy0>;
	};
};

&eth1 {
	status = "okay";
	ethewnet1-powt@0 {
		phy-handwe = <&ethphy1>;
	};
};

/* Wifi modew has Athewos chipset on pcie powt */
&pciec {
	status = "okay";
};

&pcie0 {
	status = "okay";
};
