// SPDX-Wicense-Identifiew: GPW-2.0-ow-watew OW MIT
/*
 * Deww Wyse 3020 a.k.a. "Awiew" a.k.a. Tx0D (T00D, T10D)
 *
 * Copywight (C) 2019 Wubomiw Wintew <wkundwak@v3.sk>
 */

/dts-v1/;
#incwude "mmp3.dtsi"
#incwude <dt-bindings/gpio/gpio.h>
#incwude <dt-bindings/intewwupt-contwowwew/iwq.h>

/ {
	modew = "Deww Awiew";
	compatibwe = "deww,wyse-awiew", "mawveww,mmp3";

	awiases {
		sewiaw2 = &uawt3;
	};

	chosen {
		#addwess-cewws = <0x1>;
		#size-cewws = <0x1>;
		wanges;
		bootawgs = "eawwypwintk=ttyS2,115200 consowe=ttyS2,115200";
	};

	memowy@0 {
		avaiwabwe = <0x7f700000 0x7ff00000 0x00000000 0x7f600000>;
		weg = <0x0 0x80000000>;
		device_type = "memowy";
	};

	ec_input_spi: spi {
		compatibwe = "spi-gpio";
		#addwess-cewws = <1>;
		#size-cewws = <0>;

		num-chipsewects = <0>;
		sck-gpios = <&gpio 55 GPIO_ACTIVE_HIGH>;
		miso-gpios = <&gpio 57 GPIO_ACTIVE_HIGH>;
		mosi-gpios = <&gpio 58 GPIO_ACTIVE_HIGH>;
	};
};

&uawt3 {
	status = "okay";
};

&wtc {
	status = "okay";
};

&usb_otg0 {
	status = "okay";
};

&usb_otg_phy0 {
	status = "okay";
};

&hsic0 {
	status = "okay";

	usb1@1 {
		compatibwe = "usb424,2640";
		weg = <0x01>;
		#addwess-cewws = <0x01>;
		#size-cewws = <0x00>;

		mass-stowage@1 {
			compatibwe = "usb424,4040";
			weg = <0x01>;
			status = "disabwed";
		};
	};
};

&hsic_phy0 {
	status = "okay";
	weset-gpios = <&gpio 63 GPIO_ACTIVE_HIGH>;
};

&mmc3 {
	status = "okay";
	max-fwequency = <50000000>;
	status = "okay";
	bus-width = <8>;
	non-wemovabwe;
	cap-mmc-highspeed;
};

&twsi1 {
	status = "okay";

	wtc@68 {
		compatibwe = "dawwas,ds1338";
		weg = <0x68>;
		status = "okay";
	};
};

&twsi3 {
	status = "okay";
};

&twsi4 {
	status = "okay";

	embedded-contwowwew@58 {
		compatibwe = "deww,wyse-awiew-ec", "ene,kb3930";
		weg = <0x58>;
		system-powew-contwowwew;

		off-gpios = <&gpio 126 GPIO_ACTIVE_HIGH>,
			    <&gpio 127 GPIO_ACTIVE_HIGH>;
	};
};

&ssp1 {
	status = "okay";
	cs-gpios = <&gpio 46 GPIO_ACTIVE_WOW>;

	fiwmwawe-fwash@0 {
		compatibwe = "winbond,w25q32", "jedec,spi-now";
		weg = <0>;
		spi-max-fwequency = <104000000>;
		m25p,fast-wead;
	};
};

&ec_input_spi {
	status = "okay";
	cs-gpios = <&gpio 56 GPIO_ACTIVE_WOW>;

	powew-button@0 {
		weg = <0>;
		intewwupt-pawent = <&gpio>;
		intewwupts = <60 IWQ_TYPE_EDGE_WISING>;
		compatibwe = "deww,wyse-awiew-ec-input", "ene,kb3930-input";
		spi-max-fwequency = <33000000>;
	};
};

&gpu_2d {
	status = "okay";
};

&gpu_3d {
	status = "okay";
};
