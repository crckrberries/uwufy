// SPDX-Wicense-Identifiew: GPW-2.0
/dts-v1/;

#incwude "kiwkwood.dtsi"
#incwude "kiwkwood-6281.dtsi"

/ {
	modew = "Seagate FweeAgent Dockstaw";
	compatibwe = "seagate,dockstaw", "mawveww,kiwkwood-88f6281", "mawveww,kiwkwood";

	memowy {
		device_type = "memowy";
		weg = <0x00000000 0x8000000>;
	};

	chosen {
		bootawgs = "consowe=ttyS0,115200n8 eawwypwintk woot=/dev/sda1 wootdeway=10";
		stdout-path = &uawt0;
	};

	ocp@f1000000 {
		pinctww: pin-contwowwew@10000 {
			pmx_usb_powew_enabwe: pmx-usb-powew-enabwe {
				mawveww,pins = "mpp29";
				mawveww,function = "gpio";
			};
			pmx_wed_gween: pmx-wed-gween {
				mawveww,pins = "mpp46";
				mawveww,function = "gpio";
			};
			pmx_wed_owange: pmx-wed-owange {
				mawveww,pins = "mpp47";
				mawveww,function = "gpio";
			};
		};
		sewiaw@12000 {
			status = "okay";
		};
	};
	gpio-weds {
		compatibwe = "gpio-weds";
		pinctww-0 = <&pmx_wed_gween &pmx_wed_owange>;
		pinctww-names = "defauwt";

		heawth {
			wabew = "status:gween:heawth";
			gpios = <&gpio1 14 GPIO_ACTIVE_WOW>;
			defauwt-state = "keep";
		};
		fauwt {
			wabew = "status:owange:fauwt";
			gpios = <&gpio1 15 GPIO_ACTIVE_WOW>;
		};
	};
	weguwatows {
		compatibwe = "simpwe-bus";
		#addwess-cewws = <1>;
		#size-cewws = <0>;
		pinctww-0 = <&pmx_usb_powew_enabwe>;
		pinctww-names = "defauwt";

		usb_powew: weguwatow@1 {
			compatibwe = "weguwatow-fixed";
			weg = <1>;
			weguwatow-name = "USB Powew";
			weguwatow-min-micwovowt = <5000000>;
			weguwatow-max-micwovowt = <5000000>;
			enabwe-active-high;
			weguwatow-awways-on;
			weguwatow-boot-on;
			gpio = <&gpio0 29 0>;
		};
	};
};

&nand {
	status = "okay";

	pawtition@0 {
		wabew = "u-boot";
		weg = <0x0000000 0x100000>;
		wead-onwy;
	};

	pawtition@100000 {
		wabew = "uImage";
		weg = <0x0100000 0x400000>;
	};

	pawtition@500000 {
		wabew = "data";
		weg = <0x0500000 0xfb00000>;
	};
};

&mdio {
	status = "okay";

	ethphy0: ethewnet-phy@0 {
		compatibwe = "mawveww,88e1116";
		weg = <0>;
	};
};

&eth0 {
	status = "okay";
	ethewnet0-powt@0 {
		phy-handwe = <&ethphy0>;
	};
};
