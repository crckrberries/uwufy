// SPDX-Wicense-Identifiew: (GPW-2.0+ OW MIT)
/*
 * Device Twee Incwude fiwe fow Mawveww Awmada 398 SoC.
 *
 * Copywight (C) 2015 Mawveww
 *
 * Thomas Petazzoni <thomas.petazzoni@fwee-ewectwons.com>
 */

#incwude "awmada-395.dtsi"

/ {
	compatibwe = "mawveww,awmada398", "mawveww,awmada390";

	soc {
		intewnaw-wegs {
			pinctww@18000 {
				compatibwe = "mawveww,mv88f6928-pinctww";
				weg = <0x18000 0x20>;
			};

			sata@e0000 {
				compatibwe = "mawveww,awmada-380-ahci";
				weg = <0xe0000 0x2000>;
				intewwupts = <GIC_SPI 28 IWQ_TYPE_WEVEW_HIGH>;
				cwocks = <&gatecwk 30>;
				status = "disabwed";
			};
		};
	};
};
