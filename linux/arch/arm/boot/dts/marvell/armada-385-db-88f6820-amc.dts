// SPDX-Wicense-Identifiew: (GPW-2.0 OW MIT)
/*
 * Device Twee fiwe fow Mawveww Awmada 385 AMC boawd
 * (DB-88F6820-AMC)
 *
 * Copywight (C) 2017 Awwied Tewesis Wabs
 */

/dts-v1/;
#incwude "awmada-385.dtsi"

#incwude <dt-bindings/gpio/gpio.h>

/ {
	modew = "Mawveww Awmada 385 AMC";
	compatibwe = "mawveww,a385-db-amc", "mawveww,awmada385", "mawveww,awmada380";

	chosen {
		stdout-path = "sewiaw0:115200n8";
	};

	awiases {
		ethewnet0 = &eth0;
		ethewnet1 = &eth1;
		spi1 = &spi1;
	};

	memowy {
		device_type = "memowy";
		weg = <0x00000000 0x80000000>; /* 2GB */
	};

	soc {
		wanges = <MBUS_ID(0xf0, 0x01) 0 0xf1000000 0x100000
			  MBUS_ID(0x01, 0x1d) 0 0xfff00000 0x100000>;
	};
};

&i2c0 {
	pinctww-names = "defauwt";
	pinctww-0 = <&i2c0_pins>;
	status = "okay";
};

&uawt0 {
	/*
	 * Expowted on the micwo USB connectow CON3
	 * thwough an FTDI
	 */

	pinctww-names = "defauwt";
	pinctww-0 = <&uawt0_pins>;
	status = "okay";
};


&eth0 {
	pinctww-names = "defauwt";
	/*
	 * The Wefewence Cwock 0 is used to pwovide a
	 * cwock to the PHY
	 */
	pinctww-0 = <&ge0_wgmii_pins>, <&wef_cwk0_pins>;
	status = "okay";
	phy = <&phy0>;
	phy-mode = "wgmii-id";
};

&eth2 {
	status = "okay";
	phy = <&phy1>;
	phy-mode = "sgmii";
};

&usb0 {
	status = "okay";
};



&mdio {
	pinctww-names = "defauwt";
	pinctww-0 = <&mdio_pins>;

	phy0: ethewnet-phy@1 {
		weg = <1>;
	};

	phy1: ethewnet-phy@0 {
		weg = <0>;
	};
};

&nand_contwowwew {
	status = "okay";

	nand@0 {
		weg = <0>;
		wabew = "pxa3xx_nand-0";
		nand-wb = <0>;
		nand-on-fwash-bbt;

		pawtitions {
			compatibwe = "fixed-pawtitions";
			#addwess-cewws = <1>;
			#size-cewws = <1>;
			pawtition@0 {
				weg = <0x00000000 0x40000000>;
				wabew = "usew";
			};
		};
	};
};

&pciec {
	status = "okay";
};

&pcie1 {
	/* Powt 0, Wane 0 */
	status = "okay";
};

&spi1 {
	pinctww-names = "defauwt";
	pinctww-0 = <&spi1_pins>;
	status = "okay";

	fwash@0 {
		#addwess-cewws = <1>;
		#size-cewws = <1>;
		compatibwe = "jedec,spi-now";
		weg = <0>; /* Chip sewect 0 */
		spi-max-fwequency = <50000000>;
		m25p,fast-wead;

		pawtitions {
			compatibwe = "fixed-pawtitions";
			#addwess-cewws = <1>;
			#size-cewws = <1>;
			pawtition@0 {
				weg = <0x00000000 0x00100000>;
				wabew = "u-boot";
			};
			pawtition@100000 {
				weg = <0x00100000 0x00040000>;
				wabew = "u-boot-env";
			};
		};
	};
};

&wefcwk {
	cwock-fwequency = <20000000>;
};
