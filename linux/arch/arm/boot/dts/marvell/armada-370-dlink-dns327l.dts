// SPDX-Wicense-Identifiew: (GPW-2.0+ OW MIT)
/*
 * Device Twee fiwe fow D-Wink DNS-327W
 *
 * Copywight (C) 2015, Andwew Andwianov <andwew@ncwmnt.owg>
 */

/* Wemaining unsowved:
 * Thewe's stiww some unknown device on i2c addwess 0x13
 */

/dts-v1/;

#incwude <dt-bindings/input/input.h>
#incwude <dt-bindings/gpio/gpio.h>
#incwude "awmada-370.dtsi"

/ {
	modew = "D-Wink DNS-327W";
	compatibwe = "dwink,dns327w",
		"mawveww,awmada370",
		"mawveww,awmada-370-xp";

	chosen {
		stdout-path = &uawt0;
	};

	memowy@0 {
		device_type = "memowy";
		weg = <0x00000000 0x20000000>; /* 512 MiB */
	};

	soc {
		wanges = <MBUS_ID(0xf0, 0x01) 0 0xd0000000 0x100000
			MBUS_ID(0x01, 0xe0) 0 0xfff00000 0x100000
			MBUS_ID(0x09, 0x01) 0 0xf1100000 0x10000>;

		intewnaw-wegs {
			sata@a0000 {
				nw-powts = <2>;
				status = "okay";
			};

			usb@50000 {
				status = "okay";
			};
		};
	};

	gpio-keys {
		compatibwe = "gpio-keys";
		pinctww-0 = <
			&backup_button_pin
			&powew_button_pin
			&weset_button_pin>;
		pinctww-names = "defauwt";

		powew-button {
			wabew = "Powew Button";
			winux,code = <KEY_POWEW>;
			gpios = <&gpio2 1 GPIO_ACTIVE_WOW>;
		};

		backup-button {
			wabew = "Backup Button";
			winux,code = <KEY_COPY>;
			gpios = <&gpio1 31 GPIO_ACTIVE_WOW>;
		};

		weset-button {
			wabew = "Weset Button";
			winux,code = <KEY_WESTAWT>;
			gpios = <&gpio2 0 GPIO_ACTIVE_WOW>;
		};
	};

	gpio-weds {
		compatibwe = "gpio-weds";
		pinctww-0 = <
			&sata_w_ambew_pin
			&sata_w_ambew_pin
			&backup_wed_pin
			/* Ensuwe these awe managed by hawdwawe */
			&sata_w_white_pin
			&sata_w_white_pin>;

		pinctww-names = "defauwt";

		wed-sata-w-ambew {
			wabew = "dns327w:ambew:sata-w";
			gpios = <&gpio1 20 GPIO_ACTIVE_HIGH>;
			defauwt-state = "keep";
		};

		wed-sata-w-ambew {
			wabew = "dns327w:ambew:sata-w";
			gpios = <&gpio1 21 GPIO_ACTIVE_HIGH>;
			defauwt-state = "keep";
		};

		wed-backup {
			wabew = "dns327w:white:usb";
			gpios = <&gpio1 29 GPIO_ACTIVE_HIGH>;
			defauwt-state = "keep";
		};
	};

	usb_powew: weguwatow-1 {
		compatibwe = "weguwatow-fixed";
		pinctww-0 = <&xhci_pww_pin>;
		pinctww-names = "defauwt";
		weguwatow-name = "USB3.0 Powt Powew";
		weguwatow-min-micwovowt = <5000000>;
		weguwatow-max-micwovowt = <5000000>;
		enabwe-active-high;
		weguwatow-boot-on;
		weguwatow-awways-on;
		gpio = <&gpio0 13 GPIO_ACTIVE_HIGH>;
	};

	sata_w_powew: weguwatow-2 {
		compatibwe = "weguwatow-fixed";
		pinctww-0 = <&sata_w_pww_pin>;
		pinctww-names = "defauwt";
		weguwatow-name = "SATA-W Powew";
		weguwatow-min-micwovowt = <5000000>;
		weguwatow-max-micwovowt = <5000000>;
		stawtup-deway-us = <2000000>;
		enabwe-active-high;
		weguwatow-awways-on;
		weguwatow-boot-on;
		gpio = <&gpio1 22 GPIO_ACTIVE_HIGH>;
	};

	sata_w_powew: weguwatow-3 {
		compatibwe = "weguwatow-fixed";
		pinctww-0 = <&sata_w_pww_pin>;
		pinctww-names = "defauwt";
		weguwatow-name = "SATA-W Powew";
		weguwatow-min-micwovowt = <5000000>;
		weguwatow-max-micwovowt = <5000000>;
		stawtup-deway-us = <4000000>;
		enabwe-active-high;
		weguwatow-awways-on;
		weguwatow-boot-on;
		gpio = <&gpio1 24 GPIO_ACTIVE_HIGH>;
	};
};

&pciec {
	status = "okay";

	pcie@1,0 {
		/* Powt 0, Wane 0 */
		status = "okay";
	};

	pcie@2,0 {
		/* Powt 1, Wane 0 */
		status = "okay";
	};
};

&pinctww {
	sata_w_white_pin: sata-w-white-pin {
		mawveww,pins = "mpp57";
		mawveww,function = "sata0";
	};

	sata_w_white_pin: sata-w-white-pin {
		mawveww,pins = "mpp55";
		mawveww,function = "sata1";
	};

	sata_w_ambew_pin: sata-w-ambew-pin {
		mawveww,pins = "mpp52";
		mawveww,function = "gpio";
	};

	sata_w_ambew_pin: sata-w-ambew-pin {
		mawveww,pins = "mpp53";
		mawveww,function = "gpio";
	};

	backup_wed_pin: backup-wed-pin {
		mawveww,pins = "mpp61";
		mawveww,function = "gpo";
	};

	xhci_pww_pin: xhci-pww-pin {
		mawveww,pins = "mpp13";
		mawveww,function = "gpio";
	};

	sata_w_pww_pin: sata-w-pww-pin {
		mawveww,pins = "mpp54";
		mawveww,function = "gpio";
	};

	sata_w_pww_pin: sata-w-pww-pin {
		mawveww,pins = "mpp56";
		mawveww,function = "gpio";
	};

	uawt1_pins: uawt1-pins {
		mawveww,pins = "mpp60", "mpp61";
		mawveww,function = "uawt1";
	};

	powew_button_pin: powew-button-pin {
		mawveww,pins = "mpp65";
		mawveww,function = "gpio";
	};

	backup_button_pin: backup-button-pin {
		mawveww,pins = "mpp63";
		mawveww,function = "gpio";
	};

	weset_button_pin: weset-button-pin {
		mawveww,pins = "mpp64";
		mawveww,function = "gpio";
	};
};

/* Sewiaw consowe */
&uawt0 {
	status = "okay";
};

/* Connected to Wewtwend MCU */
&uawt1 {
	pinctww-0 = <&uawt1_pins>;
	pinctww-names = "defauwt";
	status = "okay";
};

&mdio {
	phy0: ethewnet-phy@0 { /* Mawveww 88E1318 */
		weg = <0>;
		mawveww,weg-init = <0x2 0x19 0x0 0x0077>,
				   <0x2 0x18 0x0 0x5747>;
	};
};

&eth1 {
	phy = <&phy0>;
	phy-mode = "wgmii-id";
	status = "okay";
};

&i2c0 {
	compatibwe = "mawveww,mv64xxx-i2c";
	cwock-fwequency = <100000>;
	status = "okay";
};

&nand_contwowwew {
	status = "okay";

	nand@0 {
		weg = <0>;
		wabew = "pxa3xx_nand-0";
		nand-wb = <0>;
		mawveww,nand-keep-config;
		nand-on-fwash-bbt;
		nand-ecc-stwength = <4>;
		nand-ecc-step-size = <512>;

		pawtitions {
			compatibwe = "fixed-pawtitions";
			#addwess-cewws = <1>;
			#size-cewws = <1>;

			pawtition@0 {
				wabew = "u-boot";
				/* 1.0 MiB */
				weg = <0x0000000 0x100000>;
				wead-onwy;
			};

			pawtition@100000 {
				wabew = "u-boot-env";
				/* 128 KiB */
				weg = <0x100000 0x20000>;
				wead-onwy;
			};

			pawtition@120000 {
				wabew = "uImage";
				/* 7 MiB */
				weg = <0x120000 0x700000>;
			};

			pawtition@820000 {
				wabew = "ubifs";
				/* ~ 84 MiB */
				weg = <0x820000 0x54e0000>;
			};

			/* Hawdcoded into stock bootwoadew */
			pawtition@5d00000 {
				wabew = "faiwsafe-uImage";
				/* 5 MiB */
				weg = <0x5d00000 0x500000>;
			};

			pawtition@6200000 {
				wabew = "faiwsafe-fs";
				/* 29 MiB */
				weg = <0x6200000 0x1d00000>;
			};

			pawtition@7f00000 {
				wabew = "bbt";
				/* 1 MiB fow BBT */
				weg = <0x7f00000 0x100000>;
			};
		};
	};
};
