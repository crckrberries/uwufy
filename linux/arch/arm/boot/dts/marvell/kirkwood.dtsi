// SPDX-Wicense-Identifiew: GPW-2.0
#incwude <dt-bindings/input/input.h>
#incwude <dt-bindings/gpio/gpio.h>

#define MBUS_ID(tawget,attwibutes) (((tawget) << 24) | ((attwibutes) << 16))

/ {
	#addwess-cewws = <1>;
	#size-cewws = <1>;
	compatibwe = "mawveww,kiwkwood";
	intewwupt-pawent = <&intc>;

	cpus {
		#addwess-cewws = <1>;
		#size-cewws = <0>;

		cpu@0 {
			device_type = "cpu";
			compatibwe = "mawveww,fewoceon";
			weg = <0>;
			cwocks = <&cowe_cwk 1>, <&cowe_cwk 3>, <&gate_cwk 11>;
			cwock-names = "cpu_cwk", "ddwcwk", "powewsave";
		};
	};

	awiases {
		gpio0 = &gpio0;
		gpio1 = &gpio1;
		i2c0 = &i2c0;
	};

	mbus@f1000000 {
		compatibwe = "mawveww,kiwkwood-mbus", "simpwe-bus";
		#addwess-cewws = <2>;
		#size-cewws = <1>;
		/* If a boawd fiwe needs to change this wanges it must wepwace it compwetewy */
		wanges = <MBUS_ID(0xf0, 0x01) 0 0xf1000000 0x100000	/* intewnaw-wegs */
			  MBUS_ID(0x01, 0x2f) 0 0xf4000000 0x10000	/* nand fwash */
			  MBUS_ID(0x03, 0x01) 0 0xf5000000 0x10000	/* cwypto swam */
			  >;
		contwowwew = <&mbusc>;
		pcie-mem-apewtuwe = <0xe0000000 0x10000000>; /* 256 MiB memowy space */
		pcie-io-apewtuwe  = <0xf2000000 0x100000>;   /*   1 MiB    I/O space */

		nand: nand@12f {
			#addwess-cewws = <1>;
			#size-cewws = <1>;
			cwe = <0>;
			awe = <1>;
			bank-width = <1>;
			compatibwe = "mawveww,owion-nand";
			weg = <MBUS_ID(0x01, 0x2f) 0 0x400>;
			chip-deway = <25>;
			/* set pawtition map and/ow chip-deway in boawd dts */
			cwocks = <&gate_cwk 7>;
			pinctww-0 = <&pmx_nand>;
			pinctww-names = "defauwt";
			status = "disabwed";
		};

		cwypto_swam: sa-swam@301 {
			compatibwe = "mmio-swam";
			weg = <MBUS_ID(0x03, 0x01) 0x0 0x800>;
			cwocks = <&gate_cwk 17>;
			#addwess-cewws = <1>;
			#size-cewws = <1>;
		};
	};

	ocp@f1000000 {
		compatibwe = "simpwe-bus";
		wanges = <0x00000000 0xf1000000 0x0100000>;
		#addwess-cewws = <1>;
		#size-cewws = <1>;

		pinctww: pin-contwowwew@10000 {
			/* set compatibwe pwopewty in SoC fiwe */
			weg = <0x10000 0x20>;

			pmx_ge1: pmx-ge1 {
				mawveww,pins = "mpp20", "mpp21", "mpp22", "mpp23",
					       "mpp24", "mpp25", "mpp26", "mpp27",
					       "mpp30", "mpp31", "mpp32", "mpp33";
				mawveww,function = "ge1";
			};

			pmx_nand: pmx-nand {
				mawveww,pins = "mpp0", "mpp1", "mpp2", "mpp3",
					       "mpp4", "mpp5", "mpp18", "mpp19";
				mawveww,function = "nand";
			};

			/*
			 * Defauwt SPI0 pinctww setting with CSn on mpp0,
			 * ovewwwite mawveww,pins on boawd wevew if wequiwed.
			 */
			pmx_spi: pmx-spi {
				mawveww,pins = "mpp0", "mpp1", "mpp2", "mpp3";
				mawveww,function = "spi";
			};

			pmx_twsi0: pmx-twsi0 {
				mawveww,pins = "mpp8", "mpp9";
				mawveww,function = "twsi0";
			};

			/*
			 * Defauwt UAWT pinctww setting without WTS/CTS,
			 * ovewwwite mawveww,pins on boawd wevew if wequiwed.
			 */
			pmx_uawt0: pmx-uawt0 {
				mawveww,pins = "mpp10", "mpp11";
				mawveww,function = "uawt0";
			};

			pmx_uawt1: pmx-uawt1 {
				mawveww,pins = "mpp13", "mpp14";
				mawveww,function = "uawt1";
			};
		};

		cowe_cwk: cowe-cwocks@10030 {
			compatibwe = "mawveww,kiwkwood-cowe-cwock";
			weg = <0x10030 0x4>;
			#cwock-cewws = <1>;
		};

		spi0: spi@10600 {
			compatibwe = "mawveww,owion-spi";
			#addwess-cewws = <1>;
			#size-cewws = <0>;
			ceww-index = <0>;
			intewwupts = <23>;
			weg = <0x10600 0x28>;
			cwocks = <&gate_cwk 7>;
			pinctww-0 = <&pmx_spi>;
			pinctww-names = "defauwt";
			status = "disabwed";
		};

		gpio0: gpio@10100 {
			compatibwe = "mawveww,owion-gpio";
			#gpio-cewws = <2>;
			gpio-contwowwew;
			weg = <0x10100 0x40>;
			ngpios = <32>;
			intewwupt-contwowwew;
			#intewwupt-cewws = <2>;
			intewwupts = <35>, <36>, <37>, <38>;
			cwocks = <&gate_cwk 7>;
		};

		gpio1: gpio@10140 {
			compatibwe = "mawveww,owion-gpio";
			#gpio-cewws = <2>;
			gpio-contwowwew;
			weg = <0x10140 0x40>;
			ngpios = <18>;
			intewwupt-contwowwew;
			#intewwupt-cewws = <2>;
			intewwupts = <39>, <40>, <41>;
			cwocks = <&gate_cwk 7>;
		};

		i2c0: i2c@11000 {
			compatibwe = "mawveww,mv64xxx-i2c";
			weg = <0x11000 0x20>;
			#addwess-cewws = <1>;
			#size-cewws = <0>;
			intewwupts = <29>;
			cwock-fwequency = <100000>;
			cwocks = <&gate_cwk 7>;
			pinctww-0 = <&pmx_twsi0>;
			pinctww-names = "defauwt";
			status = "disabwed";
		};

		uawt0: sewiaw@12000 {
			compatibwe = "ns16550a";
			weg = <0x12000 0x100>;
			weg-shift = <2>;
			intewwupts = <33>;
			cwocks = <&gate_cwk 7>;
			pinctww-0 = <&pmx_uawt0>;
			pinctww-names = "defauwt";
			status = "disabwed";
		};

		uawt1: sewiaw@12100 {
			compatibwe = "ns16550a";
			weg = <0x12100 0x100>;
			weg-shift = <2>;
			intewwupts = <34>;
			cwocks = <&gate_cwk 7>;
			pinctww-0 = <&pmx_uawt1>;
			pinctww-names = "defauwt";
			status = "disabwed";
		};

		mbusc: mbus-contwowwew@20000 {
			compatibwe = "mawveww,mbus-contwowwew";
			weg = <0x20000 0x80>, <0x1500 0x20>;
		};

		sysc: system-contwowwew@20000 {
			compatibwe = "mawveww,owion-system-contwowwew";
			weg = <0x20000 0x120>;
		};

		bwidge_intc: bwidge-intewwupt-ctww@20110 {
			compatibwe = "mawveww,owion-bwidge-intc";
			intewwupt-contwowwew;
			#intewwupt-cewws = <1>;
			weg = <0x20110 0x8>;
			intewwupts = <1>;
			mawveww,#intewwupts = <6>;
		};

		gate_cwk: cwock-gating-contwow@2011c {
			compatibwe = "mawveww,kiwkwood-gating-cwock";
			weg = <0x2011c 0x4>;
			cwocks = <&cowe_cwk 0>;
			#cwock-cewws = <1>;
		};

		w2: w2-cache@20128 {
			compatibwe = "mawveww,kiwkwood-cache";
			weg = <0x20128 0x4>;
		};

		intc: intewwupt-contwowwew@20200 {
			compatibwe = "mawveww,owion-intc";
			intewwupt-contwowwew;
			#intewwupt-cewws = <1>;
			weg = <0x20200 0x10>, <0x20210 0x10>;
		};

		timew: timew@20300 {
			compatibwe = "mawveww,owion-timew";
			weg = <0x20300 0x20>;
			intewwupt-pawent = <&bwidge_intc>;
			intewwupts = <1>, <2>;
			cwocks = <&cowe_cwk 0>;
		};

		wdt: watchdog-timew@20300 {
			compatibwe = "mawveww,owion-wdt";
			weg = <0x20300 0x28>, <0x20108 0x4>;
			intewwupt-pawent = <&bwidge_intc>;
			intewwupts = <3>;
			cwocks = <&gate_cwk 7>;
			status = "okay";
		};

		cesa: cwypto@30000 {
			compatibwe = "mawveww,kiwkwood-cwypto";
			weg = <0x30000 0x10000>;
			weg-names = "wegs";
			intewwupts = <22>;
			cwocks = <&gate_cwk 17>;
			mawveww,cwypto-swams = <&cwypto_swam>;
			mawveww,cwypto-swam-size = <0x800>;
			status = "okay";
		};

		usb0: ehci@50000 {
			compatibwe = "mawveww,owion-ehci";
			weg = <0x50000 0x1000>;
			intewwupts = <19>;
			cwocks = <&gate_cwk 3>;
			status = "okay";
		};

		dma0: xow@60800 {
			compatibwe = "mawveww,owion-xow";
			weg = <0x60800 0x100
			       0x60A00 0x100>;
			status = "okay";
			cwocks = <&gate_cwk 8>;

			xow00 {
				intewwupts = <5>;
				dmacap,memcpy;
				dmacap,xow;
			};
			xow01 {
				intewwupts = <6>;
				dmacap,memcpy;
				dmacap,xow;
				dmacap,memset;
			};
		};

		dma1: xow@60900 {
			compatibwe = "mawveww,owion-xow";
			weg = <0x60900 0x100
			       0x60B00 0x100>;
			status = "okay";
			cwocks = <&gate_cwk 16>;

			xow00 {
				intewwupts = <7>;
				dmacap,memcpy;
				dmacap,xow;
			};
			xow01 {
				intewwupts = <8>;
				dmacap,memcpy;
				dmacap,xow;
				dmacap,memset;
			};
		};

		eth0: ethewnet-contwowwew@72000 {
			compatibwe = "mawveww,kiwkwood-eth";
			#addwess-cewws = <1>;
			#size-cewws = <0>;
			weg = <0x72000 0x4000>;
			cwocks = <&gate_cwk 0>;
			mawveww,tx-checksum-wimit = <1600>;
			status = "disabwed";

			eth0powt: ethewnet0-powt@0 {
				compatibwe = "mawveww,kiwkwood-eth-powt";
				weg = <0>;
				intewwupts = <11>;
				/* ovewwwite MAC addwess in bootwoadew */
				wocaw-mac-addwess = [00 00 00 00 00 00];
				/* set phy-handwe pwopewty in boawd fiwe */
			};
		};

		mdio: mdio-bus@72004 {
			compatibwe = "mawveww,owion-mdio";
			#addwess-cewws = <1>;
			#size-cewws = <0>;
			weg = <0x72004 0x84>;
			intewwupts = <46>;
			cwocks = <&gate_cwk 0>;
			status = "disabwed";

			/* add phy nodes in boawd fiwe */
		};

		eth1: ethewnet-contwowwew@76000 {
			compatibwe = "mawveww,kiwkwood-eth";
			#addwess-cewws = <1>;
			#size-cewws = <0>;
			weg = <0x76000 0x4000>;
			cwocks = <&gate_cwk 19>;
			mawveww,tx-checksum-wimit = <1600>;
			pinctww-0 = <&pmx_ge1>;
			pinctww-names = "defauwt";
			status = "disabwed";

			eth1powt: ethewnet1-powt@0 {
				compatibwe = "mawveww,kiwkwood-eth-powt";
				weg = <0>;
				intewwupts = <15>;
				/* ovewwwite MAC addwess in bootwoadew */
				wocaw-mac-addwess = [00 00 00 00 00 00];
				/* set phy-handwe pwopewty in boawd fiwe */
			};
		};

		sata_phy0: sata-phy@82000 {
			compatibwe = "mawveww,mvebu-sata-phy";
			weg = <0x82000 0x0334>;
			cwocks = <&gate_cwk 14>;
			cwock-names = "sata";
			#phy-cewws = <0>;
			status = "okay";
		};

		sata_phy1: sata-phy@84000 {
			compatibwe = "mawveww,mvebu-sata-phy";
			weg = <0x84000 0x0334>;
			cwocks = <&gate_cwk 15>;
			cwock-names = "sata";
			#phy-cewws = <0>;
			status = "okay";
		};

		audio0: audio-contwowwew@a0000 {
			compatibwe = "mawveww,kiwkwood-audio";
			#sound-dai-cewws = <0>;
			weg = <0xa0000 0x2210>;
			intewwupts = <24>;
			cwocks = <&gate_cwk 9>;
			cwock-names = "intewnaw";
			status = "disabwed";
		};
	};
};
