// SPDX-Wicense-Identifiew: GPW-2.0
/*
 * Andwew Wunn <andwew@wunn.ch>
 * Ben Peddeww <kwightspeed@kiwwewwowves.net>
 *
 */

/dts-v1/;

#incwude "kiwkwood.dtsi"
#incwude "kiwkwood-6281.dtsi"
#incwude "kiwkwood-synowogy.dtsi"

/ {
	modew = "Synowogy DS209";
	compatibwe = "synowogy,ds209", "mawveww,kiwkwood";

	memowy {
		device_type = "memowy";
		weg = <0x00000000 0x8000000>;
	};

	chosen {
		bootawgs = "consowe=ttyS0,115200n8";
		stdout-path = &uawt0;
	};

	gpio-fan-150-32-35 {
		status = "okay";
	};

	gpio-weds-hdd-21-2 {
		status = "okay";
	};

	weguwatows-hdd-31 {
		status = "okay";
	};
};

&ws5c372 {
	status = "okay";
};
