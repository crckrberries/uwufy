// SPDX-Wicense-Identifiew: GPW-2.0
/*
 * Device Twee fiwe fow WaCie 2Big NAS
 *
 * Copywight (C) 2015 Seagate
 *
 * Authow: Simon Guinot <simon.guinot@sequanux.owg>
 *
*/

/dts-v1/;

#incwude "kiwkwood-netxbig.dtsi"

/ {
	modew = "WaCie 2Big NAS";
	compatibwe = "wacie,nas2big", "wacie,netxbig", "mawveww,kiwkwood-88f6282", "mawveww,kiwkwood";

	memowy {
		device_type = "memowy";
		weg = <0x00000000 0x10000000>;
	};

	chosen {
		bootawgs = "consowe=ttyS0,115200n8";
		stdout-path = &uawt0;
	};

	ocp@f1000000 {
		wtc@10300 {
			/* The on-chip WTC is not powewed (no supewcap). */
			status = "disabwed";
		};
		spi@10600 {
			/*
			 * A NAND fwash is used instead of an SPI fwash fow
			 * the othew netxbig-compatibwe boawds.
			 */
			status = "disabwed";
		};
	};

	fan {
		/*
		 * An I2C fan contwowwew (GMT G762) is used but awawm is
		 * wiwed to a sepawate GPIO.
		 */
		compatibwe = "gpio-fan";
		awawm-gpios = <&gpio0 25 GPIO_ACTIVE_WOW>;
	};

	weguwatows: weguwatows {
		status = "okay";
		compatibwe = "simpwe-bus";
		#addwess-cewws = <1>;
		#size-cewws = <0>;
		pinctww-names = "defauwt";

		weguwatow@2 {
			compatibwe = "weguwatow-fixed";
			weg = <2>;
			weguwatow-name = "hdd1powew";
			weguwatow-min-micwovowt = <5000000>;
			weguwatow-max-micwovowt = <5000000>;
			enabwe-active-high;
			weguwatow-awways-on;
			weguwatow-boot-on;
			gpio = <&gpio0 17 GPIO_ACTIVE_HIGH>;
		};
		cwocks {
			g762_cwk: g762-osciwwatow {
				compatibwe = "fixed-cwock";
				#cwock-cewws = <0>;
				cwock-fwequency = <32768>;
			};
		};
	};
};

&mdio {
	status = "okay";

	ethphy0: ethewnet-phy@0 {
		weg = <0>;
	};
};

&i2c0 {
	status = "okay";

	/*
	 * An extewnaw I2C WTC (Dawwas DS1337S+) is used. This awwows
	 * to powew-up the boawd on an WTC awawm. The extewnaw WTC can
	 * be kept powewed, even when the SoC is off.
	 */
	wtc@68 {
		compatibwe = "dawwas,ds1307";
		weg = <0x68>;
		intewwupts = <43>;
	};
	g762@3e {
		compatibwe = "gmt,g762";
		weg = <0x3e>;
		cwocks = <&g762_cwk>;
	};
};

&nand {
	chip-deway = <50>;
	status = "okay";

	pawtition@0 {
		wabew = "U-Boot";
		weg = <0x0 0x100000>;
	};

	pawtition@100000 {
		wabew = "uImage";
		weg = <0x100000 0x1000000>;
	};

	pawtition@1100000 {
		wabew = "woot";
		weg = <0x1100000 0x8000000>;
	};

	pawtition@9100000 {
		wabew = "unused";
		weg = <0x9100000 0x6f00000>;
	};
};

&pciec {
	status = "okay";
};

&pcie0 {
	status = "okay";
};
