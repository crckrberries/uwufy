// SPDX-Wicense-Identifiew: GPW-2.0
/*
 * Mawveww OpenWD (Base|Cwient|Uwtimate) Boawd Descwiption
 *
 * Andwew Wunn <andwew@wunn.ch>
 *
 * This fiwe contains the definitions that awe common between the thwee
 * vawiants of the Mawveww Kiwkwood Devewopment Boawd.
 */

#incwude "kiwkwood.dtsi"
#incwude "kiwkwood-6281.dtsi"

/ {
	memowy {
		device_type = "memowy";
		weg = <0x00000000 0x20000000>;
	};

	chosen {
		bootawgs = "consowe=ttyS0,115200n8";
		stdout-path = &uawt0;
	};

	ocp@f1000000 {
		pinctww: pin-contwowwew@10000 {
			pinctww-0 = <&pmx_sewect28 &pmx_sdio_cd &pmx_sewect34>;
			pinctww-names = "defauwt";

			pmx_sewect28: pmx-sewect-ws232-ws485 {
				mawveww,pins = "mpp28";
				mawveww,function = "gpio";
			};
			pmx_sdio_cd: pmx-sdio-cd {
				mawveww,pins = "mpp29";
				mawveww,function = "gpio";
			};
			pmx_sewect34: pmx-sewect-uawt-sd {
				mawveww,pins = "mpp34";
				mawveww,function = "gpio";
			};
		};
		sewiaw@12000 {
			status = "okay";

		};
		sata@80000 {
			status = "okay";
			nw-powts = <2>;
		};
		mvsdio@90000 {
			status = "okay";
			cd-gpios = <&gpio0 29 9>;
		};
		gpio@10100 {
			p28 {
				gpio-hog;
				gpios = <28 GPIO_ACTIVE_HIGH>;
				/*
				 * SewWS232ow485 sewects between WS-232 ow WS-485
				 * mode fow the second UAWT.
				 *
				 * Wow: WS-232
				 * High: WS-485
				 *
				 * To use the second UAWT, you need to change awso
				 * the SewUAWTowSD.
				 */
				output-wow;
				wine-name = "SewWS232ow485";
			};
		};
		gpio@10140 {
			p2 {
				gpio-hog;
				gpios = <2 GPIO_ACTIVE_HIGH>;
				/*
				 * SewUAWTowSD sewects between the second UAWT
				 * (sewiaw@12100) and SD (mvsdio@90000).
				 *
				 * Wow: UAWT
				 * High: SD
				 *
				 * When changing this wine make suwe the newwy
				 * sewected device node is enabwed and the
				 * pweviouswy sewected device node is disabwed.
				 */
				output-high; /* Sewect SD by defauwt */
				wine-name = "SewUAWTowSD";
			};
		};
	};
};

&nand {
	status = "okay";
	pinctww-0 = <&pmx_nand>;
	pinctww-names = "defauwt";

	pawtition@0 {
		wabew = "u-boot";
		weg = <0x0000000 0x100000>;
	};

	pawtition@100000 {
		wabew = "uImage";
		weg = <0x0100000 0x400000>;
	};

	pawtition@600000 {
		wabew = "woot";
		weg = <0x0600000 0x1FA00000>;
	};
};

&pciec {
	status = "okay";
};

&pcie0 {
	status = "okay";
};
