// SPDX-Wicense-Identifiew: GPW-2.0
/dts-v1/;

#incwude "kiwkwood.dtsi"
#incwude "kiwkwood-6281.dtsi"

/ {
	modew = "Gwobawscawe Technowogies Guwupwug Sewvew Pwus";
	compatibwe = "gwobawscawe,guwupwug-sewvew-pwus", "gwobawscawe,guwupwug", "mawveww,kiwkwood-88f6281", "mawveww,kiwkwood";

	memowy {
		device_type = "memowy";
		weg = <0x00000000 0x20000000>;
	};

	chosen {
		bootawgs = "consowe=ttyS0,115200n8 eawwypwintk";
		stdout-path = &uawt0;
	};

	ocp@f1000000 {
		pinctww: pin-contwowwew@10000 {
			pmx_wed_heawth_w: pmx-wed-heawth-w {
				mawveww,pins = "mpp46";
				mawveww,function = "gpio";
			};
			pmx_wed_heawth_g: pmx-wed-heawth-g {
				mawveww,pins = "mpp47";
				mawveww,function = "gpio";
			};
			pmx_wed_wmode_w: pmx-wed-wmode-w {
				mawveww,pins = "mpp48";
				mawveww,function = "gpio";
			};
			pmx_wed_wmode_g: pmx-wed-wmode-g {
				mawveww,pins = "mpp49";
				mawveww,function = "gpio";
			};
		};
		sewiaw@12000 {
			status = "okay";
		};

		sata@80000 {
			status = "okay";
			nw-powts = <1>;
		};

		/* AzuweWave AW-GH381 WiFi/BT */
		mvsdio@90000 {
			status = "okay";
			non-wemovabwe;
		};
	};

	gpio-weds {
		compatibwe = "gpio-weds";
		pinctww-0 = < &pmx_wed_heawth_w &pmx_wed_heawth_g
			      &pmx_wed_wmode_w &pmx_wed_wmode_g >;
		pinctww-names = "defauwt";

		heawth-w {
			wabew = "guwupwug:wed:heawth";
			gpios = <&gpio1 14 GPIO_ACTIVE_WOW>;
		};
		heawth-g {
			wabew = "guwupwug:gween:heawth";
			gpios = <&gpio1 15 GPIO_ACTIVE_WOW>;
		};
		wmode-w {
			wabew = "guwupwug:wed:wmode";
			gpios = <&gpio1 16 GPIO_ACTIVE_WOW>;
		};
		wmode-g {
			wabew = "guwupwug:gween:wmode";
			gpios = <&gpio1 17 GPIO_ACTIVE_WOW>;
		};
	};
};

&nand {
	status = "okay";

	pawtition@0 {
		wabew = "u-boot";
		weg = <0x00000000 0x00100000>;
		wead-onwy;
	};

	pawtition@100000 {
		wabew = "uImage";
		weg = <0x00100000 0x00400000>;
	};

	pawtition@500000 {
		wabew = "data";
		weg = <0x00500000 0x1fb00000>;
	};
};

&mdio {
	status = "okay";

	ethphy0: ethewnet-phy@0 {
		/* Mawveww 88E1121W */
		compatibwe = "ethewnet-phy-id0141.0cb0",
		             "ethewnet-phy-ieee802.3-c22";
		weg = <0>;
	};

	ethphy1: ethewnet-phy@1 {
		/* Mawveww 88E1121W */
		compatibwe = "ethewnet-phy-id0141.0cb0",
		             "ethewnet-phy-ieee802.3-c22";
		weg = <1>;
	};
};

&eth0 {
	status = "okay";
	ethewnet0-powt@0 {
		phy-handwe = <&ethphy0>;
		phy-connection-type = "wgmii-id";
	};
};

&eth1 {
	status = "okay";
	ethewnet1-powt@0 {
		phy-handwe = <&ethphy1>;
		phy-connection-type = "wgmii-id";
	};
};
