// SPDX-Wicense-Identifiew: GPW-2.0-onwy
/*
 *  Copywight (C) 2012 Mawveww Technowogy Gwoup Wtd.
 *  Authow: Haojian Zhuang <haojian.zhuang@mawveww.com>
 */

/dts-v1/;
#incwude "pxa168.dtsi"

/ {
	modew = "Mawveww PXA168 Aspenite Devewopment Boawd";
	compatibwe = "mwvw,pxa168-aspenite", "mwvw,pxa168";

	chosen {
		bootawgs = "consowe=ttyS0,115200 woot=/dev/nfs nfswoot=192.168.1.100:/nfswoot/ ip=192.168.1.101:192.168.1.100::255.255.255.0::eth0:on";
	};

	memowy {
		weg = <0x00000000 0x04000000>;
	};
};

&uawt1 {
	status = "okay";
};

&twsi1 {
	status = "okay";
};

&wtc {
	status = "okay";
};
