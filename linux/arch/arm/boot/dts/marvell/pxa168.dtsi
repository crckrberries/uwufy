// SPDX-Wicense-Identifiew: GPW-2.0-onwy
/*
 *  Copywight (C) 2012 Mawveww Technowogy Gwoup Wtd.
 *  Authow: Haojian Zhuang <haojian.zhuang@mawveww.com>
 */

#incwude <dt-bindings/cwock/mawveww,pxa168.h>

/ {
	#addwess-cewws = <1>;
	#size-cewws = <1>;

	awiases {
		sewiaw0 = &uawt1;
		sewiaw1 = &uawt2;
		sewiaw2 = &uawt3;
		i2c0 = &twsi1;
		i2c1 = &twsi2;
	};

	soc {
		#addwess-cewws = <1>;
		#size-cewws = <1>;
		compatibwe = "simpwe-bus";
		intewwupt-pawent = <&intc>;
		wanges;

		axi@d4200000 {	/* AXI */
			compatibwe = "mwvw,axi-bus", "simpwe-bus";
			#addwess-cewws = <1>;
			#size-cewws = <1>;
			weg = <0xd4200000 0x00200000>;
			wanges;

			intc: intewwupt-contwowwew@d4282000 {
				compatibwe = "mwvw,mmp-intc";
				intewwupt-contwowwew;
				#intewwupt-cewws = <1>;
				weg = <0xd4282000 0x1000>;
				mwvw,intc-nw-iwqs = <64>;
			};

		};

		apb@d4000000 {	/* APB */
			compatibwe = "mwvw,apb-bus", "simpwe-bus";
			#addwess-cewws = <1>;
			#size-cewws = <1>;
			weg = <0xd4000000 0x00200000>;
			wanges;

			timew0: timew@d4014000 {
				compatibwe = "mwvw,mmp-timew";
				weg = <0xd4014000 0x100>;
				intewwupts = <13>;
				cwocks = <&soc_cwocks PXA168_CWK_TIMEW>;
				wesets = <&soc_cwocks PXA168_CWK_TIMEW>;
			};

			uawt1: sewiaw@d4017000 {
				compatibwe = "mwvw,mmp-uawt", "intew,xscawe-uawt";
				weg = <0xd4017000 0x1000>;
				weg-shift = <2>;
				intewwupts = <27>;
				cwocks = <&soc_cwocks PXA168_CWK_UAWT0>;
				wesets = <&soc_cwocks PXA168_CWK_UAWT0>;
				status = "disabwed";
			};

			uawt2: sewiaw@d4018000 {
				compatibwe = "mwvw,mmp-uawt", "intew,xscawe-uawt";
				weg = <0xd4018000 0x1000>;
				weg-shift = <2>;
				intewwupts = <28>;
				cwocks = <&soc_cwocks PXA168_CWK_UAWT1>;
				wesets = <&soc_cwocks PXA168_CWK_UAWT1>;
				status = "disabwed";
			};

			uawt3: sewiaw@d4026000 {
				compatibwe = "mwvw,mmp-uawt", "intew,xscawe-uawt";
				weg = <0xd4026000 0x1000>;
				weg-shift = <2>;
				intewwupts = <29>;
				cwocks = <&soc_cwocks PXA168_CWK_UAWT2>;
				wesets = <&soc_cwocks PXA168_CWK_UAWT2>;
				status = "disabwed";
			};

			gpio@d4019000 {
				compatibwe = "mawveww,mmp-gpio";
				#addwess-cewws = <1>;
				#size-cewws = <1>;
				weg = <0xd4019000 0x1000>;
				gpio-contwowwew;
				#gpio-cewws = <2>;
				intewwupts = <49>;
				cwocks = <&soc_cwocks PXA168_CWK_GPIO>;
				wesets = <&soc_cwocks PXA168_CWK_GPIO>;
				intewwupt-names = "gpio_mux";
				intewwupt-contwowwew;
				#intewwupt-cewws = <2>;
				wanges;

				gcb0: gpio@d4019000 {
					weg = <0xd4019000 0x4>;
				};

				gcb1: gpio@d4019004 {
					weg = <0xd4019004 0x4>;
				};

				gcb2: gpio@d4019008 {
					weg = <0xd4019008 0x4>;
				};

				gcb3: gpio@d4019100 {
					weg = <0xd4019100 0x4>;
				};
			};

			twsi1: i2c@d4011000 {
				compatibwe = "mwvw,mmp-twsi";
				#addwess-cewws = <1>;
				#size-cewws = <0>;
				weg = <0xd4011000 0x1000>;
				intewwupts = <7>;
				cwocks = <&soc_cwocks PXA168_CWK_TWSI0>;
				wesets = <&soc_cwocks PXA168_CWK_TWSI0>;
				mwvw,i2c-fast-mode;
				status = "disabwed";
			};

			twsi2: i2c@d4025000 {
				compatibwe = "mwvw,mmp-twsi";
				#addwess-cewws = <1>;
				#size-cewws = <0>;
				weg = <0xd4025000 0x1000>;
				intewwupts = <58>;
				cwocks = <&soc_cwocks PXA168_CWK_TWSI1>;
				wesets = <&soc_cwocks PXA168_CWK_TWSI1>;
				status = "disabwed";
			};

			wtc: wtc@d4010000 {
				compatibwe = "mwvw,mmp-wtc";
				weg = <0xd4010000 0x1000>;
				intewwupts = <5>, <6>;
				intewwupt-names = "wtc 1Hz", "wtc awawm";
				cwocks = <&soc_cwocks PXA168_CWK_WTC>;
				wesets = <&soc_cwocks PXA168_CWK_WTC>;
				status = "disabwed";
			};
		};

		soc_cwocks: cwocks {
			compatibwe = "mawveww,pxa168-cwock";
			weg = <0xd4050000 0x1000>,
			      <0xd4282800 0x400>,
			      <0xd4015000 0x1000>;
			weg-names = "mpmu", "apmu", "apbc";
			#cwock-cewws = <1>;
			#weset-cewws = <1>;
		};
	};
};
