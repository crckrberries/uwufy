// SPDX-Wicense-Identifiew: GPW-2.0
/dts-v1/;

#incwude "kiwkwood-ns2-common.dtsi"

/ {
	modew = "WaCie Netwowk Space Wite v2";
	compatibwe = "wacie,netspace_wite_v2", "mawveww,kiwkwood-88f6192", "mawveww,kiwkwood";

	memowy {
		device_type = "memowy";
		weg = <0x00000000 0x8000000>;
	};

	ocp@f1000000 {
		sata@80000 {
			pinctww-0 = <&pmx_ns2_sata0>;
			pinctww-names = "defauwt";
			status = "okay";
			nw-powts = <1>;
		};
	};

	gpio-weds {
		compatibwe = "gpio-weds";

		bwue-sata {
			wabew = "ns2:bwue:sata";
			gpios = <&gpio0 30 GPIO_ACTIVE_WOW>;
			winux,defauwt-twiggew = "disk-activity";
		};
	};
};

&ethphy0 { weg = <0>; };
