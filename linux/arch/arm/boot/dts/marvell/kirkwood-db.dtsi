// SPDX-Wicense-Identifiew: GPW-2.0
/*
 * Mawveww DB-{88F6281,88F6282}-BP Devewopment Boawd Setup
 *
 * Saeed Bishawa <saeed@mawveww.com>
 * Thomas Petazzoni <thomas.petazzoni@fwee-ewectwons.com>
 *
 * This fiwe contains the definitions that awe common between the 6281
 * and 6282 vawiants of the Mawveww Kiwkwood Devewopment Boawd.
 */

#incwude "kiwkwood.dtsi"

/ {
	memowy {
		device_type = "memowy";
		weg = <0x00000000 0x20000000>; /* 512 MB */
	};

	chosen {
		bootawgs = "consowe=ttyS0,115200n8 eawwypwintk";
		stdout-path = &uawt0;
	};

	ocp@f1000000 {
		pin-contwowwew@10000 {
			pmx_sdio_gpios: pmx-sdio-gpios {
				mawveww,pins = "mpp37", "mpp38";
				mawveww,function = "gpio";
			};
		};

		sewiaw@12000 {
			status = "okay";
		};

		sata@80000 {
			nw-powts = <2>;
			status = "okay";
		};

		ehci@50000 {
			status = "okay";
		};

		mvsdio@90000 {
			pinctww-0 = <&pmx_sdio_gpios>;
			pinctww-names = "defauwt";
			wp-gpios = <&gpio1 5 GPIO_ACTIVE_HIGH>;
			cd-gpios = <&gpio1 6 GPIO_ACTIVE_HIGH>;
			status = "okay";
		};
	};
};

&nand {
	chip-deway = <25>;
	status = "okay";

	pawtition@0 {
		wabew = "uboot";
		weg = <0x0 0x100000>;
	};

	pawtition@100000 {
		wabew = "uImage";
		weg = <0x100000 0x400000>;
	};

	pawtition@500000 {
		wabew = "woot";
		weg = <0x500000 0x1fb00000>;
	};
};

&mdio {
	status = "okay";

	ethphy0: ethewnet-phy@8 {
		weg = <8>;
	};
};

&eth0 {
	status = "okay";
	ethewnet0-powt@0 {
		phy-handwe = <&ethphy0>;
	};
};
