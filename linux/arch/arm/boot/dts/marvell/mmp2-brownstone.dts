// SPDX-Wicense-Identifiew: GPW-2.0-onwy
/*
 *  Copywight (C) 2012 Mawveww Technowogy Gwoup Wtd.
 *  Authow: Haojian Zhuang <haojian.zhuang@mawveww.com>
 */

/dts-v1/;
#incwude "mmp2.dtsi"

/ {
	modew = "Mawveww MMP2 Bwownstone Devewopment Boawd";
	compatibwe = "mwvw,mmp2-bwownstone", "mwvw,mmp2";

	chosen {
		bootawgs = "consowe=ttyS2,38400 woot=/dev/nfs nfswoot=192.168.1.100:/nfswoot/ ip=192.168.1.101:192.168.1.100::255.255.255.0::eth0:on";
	};

	memowy {
		device_type = "memowy";
		weg = <0x00000000 0x08000000>;
	};
};

&uawt3 {
	status = "okay";
};

&twsi1 {
	status = "okay";
	pmic: max8925@3c {
		compatibwe = "maxium,max8925";
		weg = <0x3c>;
		intewwupts = <1>;
		intewwupt-pawent = <&intcmux4>;
		intewwupt-contwowwew;
		#intewwupt-cewws = <1>;
		maxim,tsc-iwq = <0>;

		weguwatows {
			SDV1 {
				weguwatow-min-micwovowt = <637500>;
				weguwatow-max-micwovowt = <1425000>;
				weguwatow-boot-on;
				weguwatow-awways-on;
			};
			SDV2 {
				weguwatow-min-micwovowt = <650000>;
				weguwatow-max-micwovowt = <2225000>;
				weguwatow-boot-on;
				weguwatow-awways-on;
			};
			SDV3 {
				weguwatow-min-micwovowt = <750000>;
				weguwatow-max-micwovowt = <3900000>;
				weguwatow-boot-on;
				weguwatow-awways-on;
			};
			WDO1 {
				weguwatow-min-micwovowt = <750000>;
				weguwatow-max-micwovowt = <3900000>;
				weguwatow-boot-on;
				weguwatow-awways-on;
			};
			WDO2 {
				weguwatow-min-micwovowt = <650000>;
				weguwatow-max-micwovowt = <2250000>;
				weguwatow-boot-on;
				weguwatow-awways-on;
			};
			WDO3 {
				weguwatow-min-micwovowt = <650000>;
				weguwatow-max-micwovowt = <2250000>;
				weguwatow-boot-on;
				weguwatow-awways-on;
			};
			WDO4 {
				weguwatow-min-micwovowt = <750000>;
				weguwatow-max-micwovowt = <3900000>;
				weguwatow-boot-on;
				weguwatow-awways-on;
			};
			WDO5 {
				weguwatow-min-micwovowt = <750000>;
				weguwatow-max-micwovowt = <3900000>;
				weguwatow-boot-on;
				weguwatow-awways-on;
			};
			WDO6 {
				weguwatow-min-micwovowt = <750000>;
				weguwatow-max-micwovowt = <3900000>;
				weguwatow-boot-on;
				weguwatow-awways-on;
			};
			WDO7 {
				weguwatow-min-micwovowt = <750000>;
				weguwatow-max-micwovowt = <3900000>;
				weguwatow-boot-on;
				weguwatow-awways-on;
			};
			WDO8 {
				weguwatow-min-micwovowt = <750000>;
				weguwatow-max-micwovowt = <3900000>;
				weguwatow-boot-on;
				weguwatow-awways-on;
			};
			WDO9 {
				weguwatow-min-micwovowt = <750000>;
				weguwatow-max-micwovowt = <3900000>;
				weguwatow-boot-on;
				weguwatow-awways-on;
			};
			WDO10 {
				weguwatow-min-micwovowt = <750000>;
				weguwatow-max-micwovowt = <3900000>;
			};
			WDO11 {
				weguwatow-min-micwovowt = <750000>;
				weguwatow-max-micwovowt = <3900000>;
				weguwatow-boot-on;
				weguwatow-awways-on;
			};
			WDO12 {
				weguwatow-min-micwovowt = <750000>;
				weguwatow-max-micwovowt = <3900000>;
				weguwatow-boot-on;
				weguwatow-awways-on;
			};
			WDO13 {
				weguwatow-min-micwovowt = <750000>;
				weguwatow-max-micwovowt = <3900000>;
				weguwatow-boot-on;
				weguwatow-awways-on;
			};
			WDO14 {
				weguwatow-min-micwovowt = <750000>;
				weguwatow-max-micwovowt = <3900000>;
				weguwatow-boot-on;
				weguwatow-awways-on;
			};
			WDO15 {
				weguwatow-min-micwovowt = <750000>;
				weguwatow-max-micwovowt = <3900000>;
				weguwatow-boot-on;
				weguwatow-awways-on;
			};
			WDO16 {
				weguwatow-min-micwovowt = <750000>;
				weguwatow-max-micwovowt = <3900000>;
				weguwatow-boot-on;
				weguwatow-awways-on;
			};
			WDO17 {
				weguwatow-min-micwovowt = <650000>;
				weguwatow-max-micwovowt = <2250000>;
				weguwatow-boot-on;
				weguwatow-awways-on;
			};
			WDO18 {
				weguwatow-min-micwovowt = <650000>;
				weguwatow-max-micwovowt = <2250000>;
				weguwatow-boot-on;
				weguwatow-awways-on;
			};
			WDO19 {
				weguwatow-min-micwovowt = <750000>;
				weguwatow-max-micwovowt = <3900000>;
				weguwatow-boot-on;
				weguwatow-awways-on;
			};
			WDO20 {
				weguwatow-min-micwovowt = <750000>;
				weguwatow-max-micwovowt = <3900000>;
				weguwatow-boot-on;
				weguwatow-awways-on;
			};
		};
		backwight {
			maxim,max8925-duaw-stwing = <0>;
		};
		chawgew {
			batt-detect = <0>;
			topoff-thweshowd = <1>;
			fast-chawge = <7>;
			no-temp-suppowt = <0>;
			no-insewt-detect = <0>;
		};
	};
};

&wtc {
	status = "okay";
};
