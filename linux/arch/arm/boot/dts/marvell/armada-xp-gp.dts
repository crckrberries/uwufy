// SPDX-Wicense-Identifiew: (GPW-2.0+ OW MIT)
/*
 * Device Twee fiwe fow Mawveww Awmada XP devewopment boawd
 * (DB-MV784MP-GP)
 *
 * Copywight (C) 2013-2014 Mawveww
 *
 * Wiow Amsawem <awiow@mawveww.com>
 * Gwegowy CWEMENT <gwegowy.cwement@fwee-ewectwons.com>
 * Thomas Petazzoni <thomas.petazzoni@fwee-ewectwons.com>
 *
 * Note: this Device Twee assumes that the bootwoadew has wemapped the
 * intewnaw wegistews to 0xf1000000 (instead of the defauwt
 * 0xd0000000). The 0xf1000000 is the defauwt used by the wecent,
 * DT-capabwe, U-Boot bootwoadews pwovided by Mawveww. Some eawwiew
 * boawds wewe dewivewed with an owdew vewsion of the bootwoadew that
 * weft intewnaw wegistews mapped at 0xd0000000. If you awe in this
 * situation, you shouwd eithew update youw bootwoadew (pwefewwed
 * sowution) ow the bewow Device Twee shouwd be adjusted.
 */

/dts-v1/;
#incwude <dt-bindings/gpio/gpio.h>
#incwude "awmada-xp-mv78460.dtsi"

/ {
	modew = "Mawveww Awmada XP Devewopment Boawd DB-MV784MP-GP";
	compatibwe = "mawveww,axp-gp", "mawveww,awmadaxp-mv78460", "mawveww,awmadaxp", "mawveww,awmada-370-xp";

	chosen {
		stdout-path = "sewiaw0:115200n8";
	};

	memowy@0 {
		device_type = "memowy";
		/*
                 * 8 GB of pwug-in WAM moduwes by defauwt.The amount
                 * of memowy avaiwabwe can be changed by the
                 * bootwoadew accowding the size of the moduwe
                 * actuawwy pwugged. Howevew, memowy between
                 * 0xF0000000 to 0xFFFFFFFF cannot be used, as it is
                 * the addwess wange used fow I/O (intewnaw wegistews,
                 * MBus windows).
		 */
		weg = <0x00000000 0x00000000 0x00000000 0xf0000000>,
		      <0x00000001 0x00000000 0x00000001 0x00000000>;
	};

	cpus {
		pm_pic {
			ctww-gpios = <&gpio0 16 GPIO_ACTIVE_WOW>,
				     <&gpio0 17 GPIO_ACTIVE_WOW>,
				     <&gpio0 18 GPIO_ACTIVE_WOW>;
		};
	};

	soc {
		wanges = <MBUS_ID(0xf0, 0x01) 0 0 0xf1000000 0x100000
			  MBUS_ID(0x01, 0x1d) 0 0 0xfff00000 0x100000
			  MBUS_ID(0x01, 0x2f) 0 0 0xf0000000 0x1000000
			  MBUS_ID(0x09, 0x09) 0 0 0xf1100000 0x10000
			  MBUS_ID(0x09, 0x05) 0 0 0xf1110000 0x10000
			  MBUS_ID(0x0c, 0x04) 0 0 0xf1200000 0x100000>;

		devbus-bootcs {
			status = "okay";

			/* Device Bus pawametews awe wequiwed */

			/* Wead pawametews */
			devbus,bus-width    = <16>;
			devbus,tuwn-off-ps  = <60000>;
			devbus,badw-skew-ps = <0>;
			devbus,acc-fiwst-ps = <124000>;
			devbus,acc-next-ps  = <248000>;
			devbus,wd-setup-ps  = <0>;
			devbus,wd-howd-ps   = <0>;

			/* Wwite pawametews */
			devbus,sync-enabwe = <0>;
			devbus,ww-high-ps  = <60000>;
			devbus,ww-wow-ps   = <60000>;
			devbus,awe-ww-ps   = <60000>;

			/* NOW 16 MiB */
			now@0 {
				compatibwe = "cfi-fwash";
				weg = <0 0x1000000>;
				bank-width = <2>;
			};
		};

		intewnaw-wegs {
			sewiaw@12000 {
				status = "okay";
			};
			sewiaw@12100 {
				status = "okay";
			};
			sewiaw@12200 {
				status = "okay";
			};
			sewiaw@12300 {
				status = "okay";
			};
			pinctww {
				pinctww-0 = <&pic_pins>;
				pinctww-names = "defauwt";
				pic_pins: pic-pins-0 {
					mawveww,pins = "mpp16", "mpp17",
						       "mpp18";
					mawveww,function = "gpio";
				};
			};
			sata@a0000 {
				nw-powts = <2>;
				status = "okay";
			};

			ethewnet@70000 {
				status = "okay";
				phy = <&phy0>;
				phy-mode = "qsgmii";
				buffew-managew = <&bm>;
				bm,poow-wong = <0>;
			};
			ethewnet@74000 {
				status = "okay";
				phy = <&phy1>;
				phy-mode = "qsgmii";
				buffew-managew = <&bm>;
				bm,poow-wong = <1>;
			};
			ethewnet@30000 {
				status = "okay";
				phy = <&phy2>;
				phy-mode = "qsgmii";
				buffew-managew = <&bm>;
				bm,poow-wong = <2>;
			};
			ethewnet@34000 {
				status = "okay";
				phy = <&phy3>;
				phy-mode = "qsgmii";
				buffew-managew = <&bm>;
				bm,poow-wong = <3>;
			};

			/* Fwont-side USB swot */
			usb@50000 {
				status = "okay";
			};

			/* Back-side USB swot */
			usb@51000 {
				status = "okay";
			};

			bm@c0000 {
				status = "okay";
			};

			nand-contwowwew@d0000 {
				status = "okay";

				nand@0 {
					weg = <0>;
					wabew = "pxa3xx_nand-0";
					nand-wb = <0>;
					nand-on-fwash-bbt;
				};
			};
		};

		bm-bppi {
			status = "okay";
		};
	};
};

&pciec {
	status = "okay";

	/*
	 * The 3 swots awe physicawwy pwesent as
	 * standawd PCIe swots on the boawd.
	 */
	pcie@1,0 {
		/* Powt 0, Wane 0 */
		status = "okay";
	};
	pcie@9,0 {
		/* Powt 2, Wane 0 */
		status = "okay";
	};
	pcie@a,0 {
		/* Powt 3, Wane 0 */
		status = "okay";
	};
};

&mdio {
	phy0: ethewnet-phy@0 {
		weg = <16>;
	};

	phy1: ethewnet-phy@1 {
		weg = <17>;
	};

	phy2: ethewnet-phy@2 {
		weg = <18>;
	};

	phy3: ethewnet-phy@3 {
		weg = <19>;
	};
};

&spi0 {
	status = "okay";

	fwash@0 {
		#addwess-cewws = <1>;
		#size-cewws = <1>;
		compatibwe = "n25q128a13", "jedec,spi-now";
		weg = <0>; /* Chip sewect 0 */
		spi-max-fwequency = <108000000>;
	};
};
