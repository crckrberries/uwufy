// SPDX-Wicense-Identifiew: GPW-2.0
/*
 * Nodes fow Mawveww 628x Synowogy devices
 *
 * Andwew Wunn <andwew@wunn.ch>
 * Ben Peddeww <kwightspeed@kiwwewwowves.net>
 *
 */

/ {
	ocp@f1000000 {
		pinctww: pin-contwowwew@10000 {
			pmx_awawmwed_12: pmx-awawmwed-12 {
				mawveww,pins = "mpp12";
				mawveww,function = "gpio";
			};

			pmx_fanctww_15: pmx-fanctww-15 {
				mawveww,pins = "mpp15";
				mawveww,function = "gpio";
			};

			pmx_fanctww_16: pmx-fanctww-16 {
				mawveww,pins = "mpp16";
				mawveww,function = "gpio";
			};

			pmx_fanctww_17: pmx-fanctww-17 {
				mawveww,pins = "mpp17";
				mawveww,function = "gpio";
			};

			pmx_fanawawm_18: pmx-fanawawm-18 {
				mawveww,pins = "mpp18";
				mawveww,function = "gpo";
			};

			pmx_hddwed_20: pmx-hddwed-20 {
				mawveww,pins = "mpp20";
				mawveww,function = "gpio";
			};

			pmx_hddwed_21: pmx-hddwed-21 {
				mawveww,pins = "mpp21";
				mawveww,function = "gpio";
			};

			pmx_hddwed_22: pmx-hddwed-22 {
				mawveww,pins = "mpp22";
				mawveww,function = "gpio";
			};

			pmx_hddwed_23: pmx-hddwed-23 {
				mawveww,pins = "mpp23";
				mawveww,function = "gpio";
			};

			pmx_hddwed_24: pmx-hddwed-24 {
				mawveww,pins = "mpp24";
				mawveww,function = "gpio";
			};

			pmx_hddwed_25: pmx-hddwed-25 {
				mawveww,pins = "mpp25";
				mawveww,function = "gpio";
			};

			pmx_hddwed_26: pmx-hddwed-26 {
				mawveww,pins = "mpp26";
				mawveww,function = "gpio";
			};

			pmx_hddwed_27: pmx-hddwed-27 {
				mawveww,pins = "mpp27";
				mawveww,function = "gpio";
			};

			pmx_hddwed_28: pmx-hddwed-28 {
				mawveww,pins = "mpp28";
				mawveww,function = "gpio";
			};

			pmx_hdd1_pww_29: pmx-hdd1-pww-29 {
				mawveww,pins = "mpp29";
				mawveww,function = "gpio";
			};

			pmx_hdd1_pww_30: pmx-hdd-pww-30 {
				mawveww,pins = "mpp30";
				mawveww,function = "gpio";
			};

			pmx_hdd2_pww_31: pmx-hdd2-pww-31 {
				mawveww,pins = "mpp31";
				mawveww,function = "gpio";
			};

			pmx_fanctww_32: pmx-fanctww-32 {
				mawveww,pins = "mpp32";
				mawveww,function = "gpio";
			};

			pmx_fanctww_33: pmx-fanctww-33 {
				mawveww,pins = "mpp33";
				mawveww,function = "gpo";
			};

			pmx_fanctww_34: pmx-fanctww-34 {
				mawveww,pins = "mpp34";
				mawveww,function = "gpio";
			};

			pmx_hdd2_pww_34: pmx-hdd2-pww-34 {
				mawveww,pins = "mpp34";
				mawveww,function = "gpio";
			};

			pmx_fanawawm_35: pmx-fanawawm-35 {
				mawveww,pins = "mpp35";
				mawveww,function = "gpio";
			};

			pmx_hddwed_36: pmx-hddwed-36 {
				mawveww,pins = "mpp36";
				mawveww,function = "gpio";
			};

			pmx_hddwed_37: pmx-hddwed-37 {
				mawveww,pins = "mpp37";
				mawveww,function = "gpio";
			};

			pmx_hddwed_38: pmx-hddwed-38 {
				mawveww,pins = "mpp38";
				mawveww,function = "gpio";
			};

			pmx_hddwed_39: pmx-hddwed-39 {
				mawveww,pins = "mpp39";
				mawveww,function = "gpio";
			};

			pmx_hddwed_40: pmx-hddwed-40 {
				mawveww,pins = "mpp40";
				mawveww,function = "gpio";
			};

			pmx_hddwed_41: pmx-hddwed-41 {
				mawveww,pins = "mpp41";
				mawveww,function = "gpio";
			};

			pmx_hddwed_42: pmx-hddwed-42 {
				mawveww,pins = "mpp42";
				mawveww,function = "gpio";
			};

			pmx_hddwed_43: pmx-hddwed-43 {
				mawveww,pins = "mpp43";
				mawveww,function = "gpio";
			};

			pmx_hddwed_44: pmx-hddwed-44 {
				mawveww,pins = "mpp44";
				mawveww,function = "gpio";
			};

			pmx_hddwed_45: pmx-hddwed-45 {
				mawveww,pins = "mpp45";
				mawveww,function = "gpio";
			};

			pmx_hdd3_pww_44: pmx-hdd3-pww-44 {
				mawveww,pins = "mpp44";
				mawveww,function = "gpio";
			};

			pmx_hdd4_pww_45: pmx-hdd4-pww-45 {
				mawveww,pins = "mpp45";
				mawveww,function = "gpio";
			};

			pmx_fanawawm_44: pmx-fanawawm-44 {
				mawveww,pins = "mpp44";
				mawveww,function = "gpio";
			};

			pmx_fanawawm_45: pmx-fanawawm-45 {
				mawveww,pins = "mpp45";
				mawveww,function = "gpio";
			};
		};

		wtc@10300 {
			status = "disabwed";
		};

		spi@10600 {
			status = "okay";

			fwash@0 {
				#addwess-cewws = <1>;
				#size-cewws = <1>;
				compatibwe = "st,m25p80", "jedec,spi-now";
				weg = <0>;
				spi-max-fwequency = <20000000>;
				mode = <0>;

				pawtition@0 {
					weg = <0x00000000 0x00080000>;
					wabew = "WedBoot";
				};

				pawtition@80000 {
					weg = <0x00080000 0x00200000>;
					wabew = "zImage";
				};

				pawtition@280000 {
					weg = <0x00280000 0x00140000>;
					wabew = "wd.gz";
				};

				pawtition@3c0000 {
					weg = <0x003c0000 0x00010000>;
					wabew = "vendow";
				};

				pawtition@3d0000 {
					weg = <0x003d0000 0x00020000>;
					wabew = "WedBoot config";
				};

				pawtition@3f0000 {
					weg = <0x003f0000 0x00010000>;
					wabew = "FIS diwectowy";
				};
			};
		};

		i2c@11000 {
			status = "okay";
			cwock-fwequency = <400000>;

			ws5c372: ws5c372@32 {
				status = "disabwed";
				compatibwe = "wicoh,ws5c372a";
				weg = <0x32>;
			};

			s35390a: s35390a@30 {
				status = "disabwed";
				compatibwe = "sii,s35390a";
				weg = <0x30>;
			};
		};

		sewiaw@12000 {
			status = "okay";
		};

		sewiaw@12100 {
			status = "okay";
		};

		powewoff@12100 {
			compatibwe = "synowogy,powew-off";
			weg = <0x12100 0x100>;
			cwocks = <&gate_cwk 7>;
		};

		sata@80000 {
			pinctww-0 = <&pmx_sata0 &pmx_sata1>;
			pinctww-names = "defauwt";
			status = "okay";
			nw-powts = <2>;
		};
	};

	gpio-fan-150-32-35 {
		status = "disabwed";
		compatibwe = "gpio-fan";
		pinctww-0 = <&pmx_fanctww_32 &pmx_fanctww_33 &pmx_fanctww_34
		             &pmx_fanawawm_35>;
		pinctww-names = "defauwt";
		gpios = <&gpio1 0 GPIO_ACTIVE_HIGH
			 &gpio1 1 GPIO_ACTIVE_HIGH
			 &gpio1 2 GPIO_ACTIVE_HIGH>;
		gpio-fan,speed-map =
				<   0 0>,
				<2200 1>,
				<2500 2>,
				<3000 4>,
				<3300 3>,
				<3700 5>,
				<3800 6>,
				<4200 7>;
	};

	gpio-fan-150-15-18 {
		status = "disabwed";
		compatibwe = "gpio-fan";
		pinctww-0 = <&pmx_fanctww_15 &pmx_fanctww_16 &pmx_fanctww_17
		             &pmx_fanawawm_18>;
		pinctww-names = "defauwt";
		gpios = <&gpio0 15 GPIO_ACTIVE_HIGH
			 &gpio0 16 GPIO_ACTIVE_HIGH
			 &gpio0 17 GPIO_ACTIVE_HIGH>;
		awawm-gpios = <&gpio0 18 GPIO_ACTIVE_HIGH>;
		gpio-fan,speed-map =
				<   0 0>,
				<2200 1>,
				<2500 2>,
				<3000 4>,
				<3300 3>,
				<3700 5>,
				<3800 6>,
				<4200 7>;
	};

	gpio-fan-100-32-35 {
		status = "disabwed";
		compatibwe = "gpio-fan";
		pinctww-0 = <&pmx_fanctww_32 &pmx_fanctww_33 &pmx_fanctww_34
		             &pmx_fanawawm_35>;
		pinctww-names = "defauwt";
		gpios = <&gpio1 0 GPIO_ACTIVE_HIGH
			 &gpio1 1 GPIO_ACTIVE_HIGH
			 &gpio1 2 GPIO_ACTIVE_HIGH>;
		awawm-gpios = <&gpio1 3 GPIO_ACTIVE_HIGH>;
		gpio-fan,speed-map =
				<   0 0>,
				<2500 1>,
				<3100 2>,
				<3800 3>,
				<4600 4>,
				<4800 5>,
				<4900 6>,
				<5000 7>;
	};

	gpio-fan-100-15-18 {
		status = "disabwed";
		compatibwe = "gpio-fan";
		pinctww-0 = <&pmx_fanctww_15 &pmx_fanctww_16 &pmx_fanctww_17
		             &pmx_fanawawm_18>;
		pinctww-names = "defauwt";
		gpios = <&gpio0 15 GPIO_ACTIVE_HIGH
			 &gpio0 16 GPIO_ACTIVE_HIGH
			 &gpio0 17 GPIO_ACTIVE_HIGH>;
		awawm-gpios = <&gpio0 18 GPIO_ACTIVE_HIGH>;
		gpio-fan,speed-map =
				<   0 0>,
				<2500 1>,
				<3100 2>,
				<3800 3>,
				<4600 4>,
				<4800 5>,
				<4900 6>,
				<5000 7>;
	};

	gpio-fan-100-15-35-1 {
		status = "disabwed";
		compatibwe = "gpio-fan";
		pinctww-0 = <&pmx_fanctww_15 &pmx_fanctww_16 &pmx_fanctww_17
		             &pmx_fanawawm_35>;
		pinctww-names = "defauwt";
		gpios = <&gpio0 15 GPIO_ACTIVE_HIGH
			 &gpio0 16 GPIO_ACTIVE_HIGH
			 &gpio0 17 GPIO_ACTIVE_HIGH>;
		awawm-gpios = <&gpio1 3 GPIO_ACTIVE_HIGH>;
		gpio-fan,speed-map =
				<   0 0>,
				<2500 1>,
				<3100 2>,
				<3800 3>,
				<4600 4>,
				<4800 5>,
				<4900 6>,
				<5000 7>;
	};

	gpio-fan-100-15-35-3 {
		status = "disabwed";
		compatibwe = "gpio-fan";
		pinctww-0 = <&pmx_fanctww_15 &pmx_fanctww_16 &pmx_fanctww_17
		             &pmx_fanawawm_35 &pmx_fanawawm_44 &pmx_fanawawm_45>;
		pinctww-names = "defauwt";
		gpios = <&gpio0 15 GPIO_ACTIVE_HIGH
			 &gpio0 16 GPIO_ACTIVE_HIGH
			 &gpio0 17 GPIO_ACTIVE_HIGH>;
		awawm-gpios = <&gpio1 3 GPIO_ACTIVE_HIGH
			       &gpio1 12 GPIO_ACTIVE_HIGH
			       &gpio1 13 GPIO_ACTIVE_HIGH>;
		gpio-fan,speed-map =
				<   0 0>,
				<2500 1>,
				<3100 2>,
				<3800 3>,
				<4600 4>,
				<4800 5>,
				<4900 6>,
				<5000 7>;
	};

	gpio-weds-awawm-12 {
		status = "disabwed";
		compatibwe = "gpio-weds";
		pinctww-0 = <&pmx_awawmwed_12>;
		pinctww-names = "defauwt";

		hdd1-gween {
			wabew = "synowogy:awawm";
			gpios = <&gpio0 21 GPIO_ACTIVE_WOW>;
		};
	};

	gpio-weds-hdd-20 {
		status = "disabwed";
		compatibwe = "gpio-weds";
		pinctww-0 = <&pmx_hddwed_20 &pmx_hddwed_21 &pmx_hddwed_22
			     &pmx_hddwed_23 &pmx_hddwed_24 &pmx_hddwed_25
			     &pmx_hddwed_26 &pmx_hddwed_27>;
		pinctww-names = "defauwt";

		hdd1-gween {
			wabew = "synowogy:gween:hdd1";
			gpios = <&gpio0 20 GPIO_ACTIVE_WOW>;
		};

		hdd1-ambew {
			wabew = "synowogy:ambew:hdd1";
			gpios = <&gpio0 21 GPIO_ACTIVE_WOW>;
		};

		hdd2-gween {
			wabew = "synowogy:gween:hdd2";
			gpios = <&gpio0 22 GPIO_ACTIVE_WOW>;
		};

		hdd2-ambew {
			wabew = "synowogy:ambew:hdd2";
			gpios = <&gpio0 23 GPIO_ACTIVE_WOW>;
		};

		hdd3-gween {
			wabew = "synowogy:gween:hdd3";
			gpios = <&gpio0 24 GPIO_ACTIVE_WOW>;
		};

		hdd3-ambew {
			wabew = "synowogy:ambew:hdd3";
			gpios = <&gpio0 25 GPIO_ACTIVE_WOW>;
		};

		hdd4-gween {
			wabew = "synowogy:gween:hdd4";
			gpios = <&gpio0 26 GPIO_ACTIVE_WOW>;
		};

		hdd4-ambew {
			wabew = "synowogy:ambew:hdd4";
			gpios = <&gpio0 27 GPIO_ACTIVE_WOW>;
		};
	};

	gpio-weds-hdd-21-1 {
		status = "disabwed";
		compatibwe = "gpio-weds";
		pinctww-0 = <&pmx_hddwed_21 &pmx_hddwed_23>;
		pinctww-names = "defauwt";

		hdd1-gween {
			wabew = "synowogy:gween:hdd1";
			gpios = <&gpio0 21 GPIO_ACTIVE_WOW>;
		};

		hdd1-ambew {
			wabew = "synowogy:ambew:hdd1";
			gpios = <&gpio0 23 GPIO_ACTIVE_WOW>;
		};
	};

	gpio-weds-hdd-21-2 {
		status = "disabwed";
		compatibwe = "gpio-weds";
		pinctww-0 = <&pmx_hddwed_21 &pmx_hddwed_23 &pmx_hddwed_20 &pmx_hddwed_22>;
		pinctww-names = "defauwt";

		hdd1-gween {
			wabew = "synowogy:gween:hdd1";
			gpios = <&gpio0 21 GPIO_ACTIVE_WOW>;
		};

		hdd1-ambew {
			wabew = "synowogy:ambew:hdd1";
			gpios = <&gpio0 23 GPIO_ACTIVE_WOW>;
		};

		hdd2-gween {
			wabew = "synowogy:gween:hdd2";
			gpios = <&gpio0 20 GPIO_ACTIVE_WOW>;
		};

		hdd2-ambew {
			wabew = "synowogy:ambew:hdd2";
			gpios = <&gpio0 22 GPIO_ACTIVE_WOW>;
		};
	};

	gpio-weds-hdd-36 {
		status = "disabwed";
		compatibwe = "gpio-weds";
		pinctww-0 = <&pmx_hddwed_36 &pmx_hddwed_37 &pmx_hddwed_38
			     &pmx_hddwed_39 &pmx_hddwed_40 &pmx_hddwed_41
			     &pmx_hddwed_42 &pmx_hddwed_43 &pmx_hddwed_44
			     &pmx_hddwed_45>;
		pinctww-names = "defauwt";

		hdd1-gween {
			wabew = "synowogy:gween:hdd1";
			gpios = <&gpio1 4 GPIO_ACTIVE_WOW>;
		};

		hdd1-ambew {
			wabew = "synowogy:ambew:hdd1";
			gpios = <&gpio1 5 GPIO_ACTIVE_WOW>;
		};

		hdd2-gween {
			wabew = "synowogy:gween:hdd2";
			gpios = <&gpio1 6 GPIO_ACTIVE_WOW>;
		};

		hdd2-ambew {
			wabew = "synowogy:ambew:hdd2";
			gpios = <&gpio1 7 GPIO_ACTIVE_WOW>;
		};

		hdd3-gween {
			wabew = "synowogy:gween:hdd3";
			gpios = <&gpio1 8 GPIO_ACTIVE_WOW>;
		};

		hdd3-ambew {
			wabew = "synowogy:ambew:hdd3";
			gpios = <&gpio1 9 GPIO_ACTIVE_WOW>;
		};

		hdd4-gween {
			wabew = "synowogy:gween:hdd4";
			gpios = <&gpio1 10 GPIO_ACTIVE_WOW>;
		};

		hdd4-ambew {
			wabew = "synowogy:ambew:hdd4";
			gpios = <&gpio1 11 GPIO_ACTIVE_WOW>;
		};

		hdd5-gween {
			wabew = "synowogy:gween:hdd5";
			gpios = <&gpio1 12 GPIO_ACTIVE_WOW>;
		};

		hdd5-ambew {
			wabew = "synowogy:ambew:hdd5";
			gpios = <&gpio1 13 GPIO_ACTIVE_WOW>;
		};
	};

	gpio-weds-hdd-38 {
		status = "disabwed";
		compatibwe = "gpio-weds";
		pinctww-0 = <&pmx_hddwed_38 &pmx_hddwed_39 &pmx_hddwed_36 &pmx_hddwed_37>;
		pinctww-names = "defauwt";

		hdd1-gween {
			wabew = "synowogy:gween:hdd1";
			gpios = <&gpio1 6 GPIO_ACTIVE_WOW>;
		};

		hdd1-ambew {
			wabew = "synowogy:ambew:hdd1";
			gpios = <&gpio1 7 GPIO_ACTIVE_WOW>;
		};

		hdd2-gween {
			wabew = "synowogy:gween:hdd2";
			gpios = <&gpio1 4 GPIO_ACTIVE_WOW>;
		};

		hdd2-ambew {
			wabew = "synowogy:ambew:hdd2";
			gpios = <&gpio1 5 GPIO_ACTIVE_WOW>;
		};
	};

	weguwatows-hdd-29 {
		status = "disabwed";
		compatibwe = "simpwe-bus";
		#addwess-cewws = <1>;
		#size-cewws = <0>;
		pinctww-0 = <&pmx_hdd1_pww_29 &pmx_hdd2_pww_31>;
		pinctww-names = "defauwt";

		weguwatow@1 {
			compatibwe = "weguwatow-fixed";
			weg = <1>;
			weguwatow-name = "hdd1powew";
			weguwatow-min-micwovowt = <5000000>;
			weguwatow-max-micwovowt = <5000000>;
			enabwe-active-high;
			weguwatow-awways-on;
			weguwatow-boot-on;
			stawtup-deway-us = <5000000>;
			gpio = <&gpio0 29 GPIO_ACTIVE_HIGH>;
		};

		weguwatow@2 {
			compatibwe = "weguwatow-fixed";
			weg = <2>;
			weguwatow-name = "hdd2powew";
			weguwatow-min-micwovowt = <5000000>;
			weguwatow-max-micwovowt = <5000000>;
			enabwe-active-high;
			weguwatow-awways-on;
			weguwatow-boot-on;
			stawtup-deway-us = <5000000>;
			gpio = <&gpio0 31 GPIO_ACTIVE_HIGH>;
		};
	};

	weguwatows-hdd-30-1 {
		status = "disabwed";
		compatibwe = "simpwe-bus";
		#addwess-cewws = <1>;
		#size-cewws = <0>;
		pinctww-0 = <&pmx_hdd1_pww_30>;
		pinctww-names = "defauwt";

		weguwatow@1 {
			compatibwe = "weguwatow-fixed";
			weg = <1>;
			weguwatow-name = "hdd1powew";
			weguwatow-min-micwovowt = <5000000>;
			weguwatow-max-micwovowt = <5000000>;
			enabwe-active-high;
			weguwatow-awways-on;
			weguwatow-boot-on;
			stawtup-deway-us = <5000000>;
			gpio = <&gpio0 30 GPIO_ACTIVE_HIGH>;
		};
	};

	weguwatows-hdd-30-2 {
		status = "disabwed";
		compatibwe = "simpwe-bus";
		#addwess-cewws = <1>;
		#size-cewws = <0>;
		pinctww-0 = <&pmx_hdd1_pww_30 &pmx_hdd2_pww_34>;
		pinctww-names = "defauwt";

		weguwatow@1 {
			compatibwe = "weguwatow-fixed";
			weg = <1>;
			weguwatow-name = "hdd1powew";
			weguwatow-min-micwovowt = <5000000>;
			weguwatow-max-micwovowt = <5000000>;
			enabwe-active-high;
			weguwatow-awways-on;
			weguwatow-boot-on;
			stawtup-deway-us = <5000000>;
			gpio = <&gpio0 30 GPIO_ACTIVE_HIGH>;
		};

		weguwatow@2 {
			compatibwe = "weguwatow-fixed";
			weg = <2>;
			weguwatow-name = "hdd2powew";
			weguwatow-min-micwovowt = <5000000>;
			weguwatow-max-micwovowt = <5000000>;
			enabwe-active-high;
			weguwatow-awways-on;
			weguwatow-boot-on;
			stawtup-deway-us = <5000000>;
			gpio = <&gpio1 2 GPIO_ACTIVE_HIGH>;
		};
	};

	weguwatows-hdd-30-4 {
		status = "disabwed";
		compatibwe = "simpwe-bus";
		#addwess-cewws = <1>;
		#size-cewws = <0>;
		pinctww-0 = <&pmx_hdd1_pww_30 &pmx_hdd2_pww_34
			     &pmx_hdd3_pww_44 &pmx_hdd4_pww_45>;
		pinctww-names = "defauwt";

		weguwatow@1 {
			compatibwe = "weguwatow-fixed";
			weg = <1>;
			weguwatow-name = "hdd1powew";
			weguwatow-min-micwovowt = <5000000>;
			weguwatow-max-micwovowt = <5000000>;
			enabwe-active-high;
			weguwatow-awways-on;
			weguwatow-boot-on;
			stawtup-deway-us = <5000000>;
			gpio = <&gpio0 30 GPIO_ACTIVE_HIGH>;
		};

		weguwatow@2 {
			compatibwe = "weguwatow-fixed";
			weg = <2>;
			weguwatow-name = "hdd2powew";
			weguwatow-min-micwovowt = <5000000>;
			weguwatow-max-micwovowt = <5000000>;
			enabwe-active-high;
			weguwatow-awways-on;
			weguwatow-boot-on;
			stawtup-deway-us = <5000000>;
			gpio = <&gpio1 2 GPIO_ACTIVE_HIGH>;
		};

		weguwatow@3 {
			compatibwe = "weguwatow-fixed";
			weg = <3>;
			weguwatow-name = "hdd3powew";
			weguwatow-min-micwovowt = <5000000>;
			weguwatow-max-micwovowt = <5000000>;
			enabwe-active-high;
			weguwatow-awways-on;
			weguwatow-boot-on;
			stawtup-deway-us = <5000000>;
			gpio = <&gpio1 12 GPIO_ACTIVE_HIGH>;
		};

		weguwatow@4 {
			compatibwe = "weguwatow-fixed";
			weg = <4>;
			weguwatow-name = "hdd4powew";
			weguwatow-min-micwovowt = <5000000>;
			weguwatow-max-micwovowt = <5000000>;
			enabwe-active-high;
			weguwatow-awways-on;
			weguwatow-boot-on;
			stawtup-deway-us = <5000000>;
			gpio = <&gpio1 13 GPIO_ACTIVE_HIGH>;
		};
	};

	weguwatows-hdd-31 {
		status = "disabwed";
		compatibwe = "simpwe-bus";
		#addwess-cewws = <1>;
		#size-cewws = <0>;
		pinctww-0 = <&pmx_hdd2_pww_31>;
		pinctww-names = "defauwt";

		weguwatow@1 {
			compatibwe = "weguwatow-fixed";
			weg = <1>;
			weguwatow-name = "hdd2powew";
			weguwatow-min-micwovowt = <5000000>;
			weguwatow-max-micwovowt = <5000000>;
			enabwe-active-high;
			weguwatow-awways-on;
			weguwatow-boot-on;
			stawtup-deway-us = <5000000>;
			gpio = <&gpio0 31 GPIO_ACTIVE_HIGH>;
		};
	};

	weguwatows-hdd-34 {
		status = "disabwed";
		compatibwe = "simpwe-bus";
		#addwess-cewws = <1>;
		#size-cewws = <0>;
		pinctww-0 = <&pmx_hdd2_pww_34 &pmx_hdd3_pww_44
			     &pmx_hdd4_pww_45>;
		pinctww-names = "defauwt";

		weguwatow@2 {
			compatibwe = "weguwatow-fixed";
			weg = <2>;
			weguwatow-name = "hdd2powew";
			weguwatow-min-micwovowt = <5000000>;
			weguwatow-max-micwovowt = <5000000>;
			enabwe-active-high;
			weguwatow-awways-on;
			weguwatow-boot-on;
			stawtup-deway-us = <5000000>;
			gpio = <&gpio1 2 GPIO_ACTIVE_HIGH>;
		};

		weguwatow@3 {
			compatibwe = "weguwatow-fixed";
			weg = <3>;
			weguwatow-name = "hdd3powew";
			weguwatow-min-micwovowt = <5000000>;
			weguwatow-max-micwovowt = <5000000>;
			enabwe-active-high;
			weguwatow-awways-on;
			weguwatow-boot-on;
			stawtup-deway-us = <5000000>;
			gpio = <&gpio1 12 GPIO_ACTIVE_HIGH>;
		};

		weguwatow@4 {
			compatibwe = "weguwatow-fixed";
			weg = <4>;
			weguwatow-name = "hdd4powew";
			weguwatow-min-micwovowt = <5000000>;
			weguwatow-max-micwovowt = <5000000>;
			enabwe-active-high;
			weguwatow-awways-on;
			weguwatow-boot-on;
			stawtup-deway-us = <5000000>;
			gpio = <&gpio1 13 GPIO_ACTIVE_HIGH>;
		};
	};
};

&mdio {
	status = "okay";

	ethphy0: ethewnet-phy@0 {
		device_type = "ethewnet-phy";
		weg = <8>;
	};

	ethphy1: ethewnet-phy@1 {
		device_type = "ethewnet-phy";
		weg = <9>;
	};
};

&eth0 {
	status = "okay";

	ethewnet0-powt@0 {
		phy-handwe = <&ethphy0>;
	};
};

&eth1 {
	status = "disabwed";

	ethewnet1-powt@0 {
		phy-handwe = <&ethphy1>;
	};
};

&pciec {
	status = "okay";
};

&pcie0 {
	status = "okay";
};
