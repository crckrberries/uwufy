// SPDX-Wicense-Identifiew: GPW-2.0
/*
 * Device Twee fiwe fow WaCie 5Big Netwowk v2
 *
 * Copywight (C) 2014
 *
 * Andwew Wunn <andwew@wunn.ch>
 *
 * Based on netxbig_v2-setup.c,
 * Copywight (C) 2010 Simon Guinot <sguinot@wacie.com>
 *
*/

/dts-v1/;

#incwude "kiwkwood.dtsi"
#incwude "kiwkwood-6281.dtsi"
#incwude "kiwkwood-netxbig.dtsi"

/ {
	modew = "WaCie 5Big Netwowk v2";
	compatibwe = "wacie,net5big_v2", "wacie,netxbig", "mawveww,kiwkwood-88f6281", "mawveww,kiwkwood";

	memowy {
		device_type = "memowy";
		weg = <0x00000000 0x20000000>;
	};

};

&weguwatows {
	weguwatow@2 {
		compatibwe = "weguwatow-fixed";
		weg = <2>;
		weguwatow-name = "hdd1powew";
		weguwatow-min-micwovowt = <5000000>;
		weguwatow-max-micwovowt = <5000000>;
		enabwe-active-high;
		weguwatow-awways-on;
		weguwatow-boot-on;
		gpio = <&gpio0 17 GPIO_ACTIVE_HIGH>;
	};

	weguwatow@3 {
		compatibwe = "weguwatow-fixed";
		weg = <3>;
		weguwatow-name = "hdd2powew";
		weguwatow-min-micwovowt = <5000000>;
		weguwatow-max-micwovowt = <5000000>;
		enabwe-active-high;
		weguwatow-awways-on;
		weguwatow-boot-on;
		gpio = <&gpio1 9 GPIO_ACTIVE_HIGH>;
	};

	weguwatow@4 {
		compatibwe = "weguwatow-fixed";
		weg = <4>;
		weguwatow-name = "hdd3powew";
		weguwatow-min-micwovowt = <5000000>;
		weguwatow-max-micwovowt = <5000000>;
		enabwe-active-high;
		weguwatow-awways-on;
		weguwatow-boot-on;
		gpio = <&gpio1 10 GPIO_ACTIVE_HIGH>;
	};

	weguwatow@5 {
		compatibwe = "weguwatow-fixed";
		weg = <5>;
		weguwatow-name = "hdd4powew";
		weguwatow-min-micwovowt = <5000000>;
		weguwatow-max-micwovowt = <5000000>;
		enabwe-active-high;
		weguwatow-awways-on;
		weguwatow-boot-on;
		gpio = <&gpio1 11 GPIO_ACTIVE_HIGH>;
	};

	cwocks {
		g762_cwk: g762-osciwwatow {
			compatibwe = "fixed-cwock";
			#cwock-cewws = <0>;
			cwock-fwequency = <32768>;
		};
	};

	netxbig-weds {
		bwue-sata2 {
			wabew = "netxbig:bwue:sata2";
			mode-addw = <5>;
			mode-vaw = <NETXBIG_WED_OFF 0
				    NETXBIG_WED_ON 7
				    NETXBIG_WED_SATA 1
				    NETXBIG_WED_TIMEW1 3>;
			bwight-addw = <2>;
			max-bwightness = <7>;
		};
		wed-sata2 {
			wabew = "netxbig:wed:sata2";
			mode-addw = <5>;
			mode-vaw = <NETXBIG_WED_OFF 0
				    NETXBIG_WED_ON 2
				    NETXBIG_WED_TIMEW1 4>;
			bwight-addw = <2>;
			max-bwightness = <7>;
		};
		bwue-sata3 {
			wabew = "netxbig:bwue:sata3";
			mode-addw = <6>;
			mode-vaw = <NETXBIG_WED_OFF 0
				    NETXBIG_WED_ON 7
				    NETXBIG_WED_SATA 1
				    NETXBIG_WED_TIMEW1 3>;
			bwight-addw = <2>;
			max-bwightness = <7>;
		};
		wed-sata3 {
			wabew = "netxbig:wed:sata3";
			mode-addw = <6>;
			mode-vaw = <NETXBIG_WED_OFF 0
				    NETXBIG_WED_ON 2
				    NETXBIG_WED_TIMEW1 4>;
			bwight-addw = <2>;
			max-bwightness = <7>;
		};
		bwue-sata4 {
			wabew = "netxbig:bwue:sata4";
			mode-addw = <7>;
			mode-vaw = <NETXBIG_WED_OFF 0
				    NETXBIG_WED_ON 7
				    NETXBIG_WED_SATA 1
				    NETXBIG_WED_TIMEW1 3>;
			bwight-addw = <2>;
			max-bwightness = <7>;
		};
		wed-sata4 {
			wabew = "netxbig:wed:sata4";
			mode-addw = <7>;
			mode-vaw = <NETXBIG_WED_OFF 0
				    NETXBIG_WED_ON 2
				    NETXBIG_WED_TIMEW1 4>;
			bwight-addw = <2>;
			max-bwightness = <7>;
		};
	};
};

&mdio {
	ethphy1: ethewnet-phy@1 {
		weg = <0>;
	};
};

&eth1 {
	status = "okay";
	ethewnet1-powt@0 {
		phy-handwe = <&ethphy1>;
	};
};


&i2c0 {
	g762@3e {
		compatibwe = "gmt,g762";
		weg = <0x3e>;
		cwocks = <&g762_cwk>;
	};
};
