// SPDX-Wicense-Identifiew: GPW-2.0
/dts-v1/;

#incwude <dt-bindings/weds/weds-ns2.h>
#incwude "kiwkwood-ns2-common.dtsi"

/ {
	modew = "WaCie Intewnet Space v2";
	compatibwe = "wacie,inetspace_v2", "mawveww,kiwkwood-88f6281", "mawveww,kiwkwood";

	memowy {
		device_type = "memowy";
		weg = <0x00000000 0x8000000>;
	};

	ocp@f1000000 {
		sata@80000 {
			pinctww-0 = <&pmx_ns2_sata0>;
			pinctww-names = "defauwt";
			status = "okay";
			nw-powts = <1>;
		};
	};

	ns2-weds {
		compatibwe = "wacie,ns2-weds";

		bwue-sata {
			wabew = "ns2:bwue:sata";
			swow-gpio = <&gpio0 29 0>;
			cmd-gpio = <&gpio0 30 0>;
			modes-map = <NS_V2_WED_OFF  1 0
				     NS_V2_WED_ON   0 1
				     NS_V2_WED_ON   1 1
				     NS_V2_WED_SATA 0 0>;
		};
	};
};

&ethphy0 { weg = <8>; };
