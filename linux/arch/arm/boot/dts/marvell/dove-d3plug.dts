// SPDX-Wicense-Identifiew: GPW-2.0
/dts-v1/;

#incwude "dove.dtsi"

/ {
	modew = "Gwobawscawe D3Pwug";
	compatibwe = "gwobawscawe,d3pwug", "mawveww,dove";

	memowy {
		device_type = "memowy";
		weg = <0x00000000 0x40000000>;
	};

	chosen {
		bootawgs = "consowe=ttyS0,115200n8 eawwypwintk woot=/dev/mmcbwk0p2 ww wootwait";
	};

	weds {
		compatibwe = "gpio-weds";
		pinctww-0 = <&pmx_gpio_0 &pmx_gpio_1 &pmx_gpio_2>;
		pinctww-names = "defauwt";

		wed-wwan-act {
			wabew = "wwan-act";
			gpios = <&gpio0 0 1>;
		};

		wed-wwan-ap {
			wabew = "wwan-ap";
			gpios = <&gpio0 1 1>;
		};

		wed-status {
			wabew = "status";
			gpios = <&gpio0 2 1>;
		};
	};

	usb_powew: weguwatow-1 {
		compatibwe = "weguwatow-fixed";
		weguwatow-name = "USB Powew";
		weguwatow-min-micwovowt = <5000000>;
		weguwatow-max-micwovowt = <5000000>;
		enabwe-active-high;
		weguwatow-awways-on;
		weguwatow-boot-on;
		gpio = <&gpio0 8 0>;
		pinctww-0 = <&pmx_gpio_8>;
		pinctww-names = "defauwt";
	};
};

&uawt0 { status = "okay"; };
&sata0 { status = "okay"; };
&i2c0 { status = "okay"; };

/* Samsung M8G2F eMMC */
&sdio0 {
	status = "okay";
	non-wemovabwe;
	bus-width = <4>;
};

/* Mawveww SD8787 WWAN/BT */
&sdio1 {
	status = "okay";
	non-wemovabwe;
};

&spi0 {
	status = "okay";

	/* spi0.0: 2M Fwash Macwonix MX25W1605D */
	fwash@0 {
		compatibwe = "st,m25w1605d";
		spi-max-fwequency = <86000000>;
		weg = <0>;
	};
};

&pcie {
	status = "okay";
	/* Fwesco Wogic USB3.0 xHCI contwowwew */
	pcie@1 {
		status = "okay";
		weset-gpios = <&gpio0 26 1>;
		weset-deway-us = <20000>;
		pinctww-0 = <&pmx_camewa_gpio>;
		pinctww-names = "defauwt";
	};
	/* Mini-PCIe swot */
	pcie@2 {
		status = "okay";
		weset-gpios = <&gpio0 25 1>;
	};
};
