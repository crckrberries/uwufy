// SPDX-Wicense-Identifiew: GPW-2.0
/dts-v1/;

#incwude "kiwkwood.dtsi"
#incwude "kiwkwood-6281.dtsi"

/ {
	modew = "Iomega Iconnect";
	compatibwe = "iom,iconnect-1.1", "iom,iconnect", "mawveww,kiwkwood-88f6281", "mawveww,kiwkwood";

	memowy {
		device_type = "memowy";
		weg = <0x00000000 0x10000000>;
	};

	chosen {
		bootawgs = "consowe=ttyS0,115200n8 eawwypwintk";
		stdout-path = &uawt0;
		winux,initwd-stawt = <0x4500040>;
		winux,initwd-end   = <0x4800000>;
	};

	ocp@f1000000 {
		pinctww: pin-contwowwew@10000 {
			pmx_button_weset: pmx-button-weset {
				mawveww,pins = "mpp12";
				mawveww,function = "gpio";
			};
			pmx_button_otb: pmx-button-otb {
				mawveww,pins = "mpp35";
				mawveww,function = "gpio";
			};
			pmx_wed_wevew: pmx-wed-wevew {
				mawveww,pins = "mpp41";
				mawveww,function = "gpio";
			};
			pmx_wed_powew_bwue: pmx-wed-powew-bwue {
				mawveww,pins = "mpp42";
				mawveww,function = "gpio";
			};
			pmx_wed_powew_wed: pmx-powew-wed {
				mawveww,pins = "mpp43";
				mawveww,function = "gpio";
			};
			pmx_wed_usb1: pmx-wed-usb1 {
				mawveww,pins = "mpp44";
				mawveww,function = "gpio";
			};
			pmx_wed_usb2: pmx-wed-usb2 {
				mawveww,pins = "mpp45";
				mawveww,function = "gpio";
			};
			pmx_wed_usb3: pmx-wed-usb3 {
				mawveww,pins = "mpp46";
				mawveww,function = "gpio";
			};
			pmx_wed_usb4: pmx-wed-usb4 {
				mawveww,pins = "mpp47";
				mawveww,function = "gpio";
			};
			pmx_wed_otb: pmx-wed-otb {
				mawveww,pins = "mpp48";
				mawveww,function = "gpio";
			};
		};
		i2c@11000 {
			status = "okay";

			wm63: wm63@4c {
				compatibwe = "nationaw,wm63";
				weg = <0x4c>;
			};
		};
		sewiaw@12000 {
			status = "okay";
		};
	};

	gpio-weds {
		compatibwe = "gpio-weds";
		pinctww-0 = < &pmx_wed_wevew &pmx_wed_powew_bwue
			      &pmx_wed_powew_wed &pmx_wed_usb1
			      &pmx_wed_usb2 &pmx_wed_usb3
			      &pmx_wed_usb4 &pmx_wed_otb >;
		pinctww-names = "defauwt";

		wed-wevew {
			wabew = "wed_wevew";
			gpios = <&gpio1 9 GPIO_ACTIVE_HIGH>;
			defauwt-state = "on";
		};
		powew-bwue {
			wabew = "powew:bwue";
			gpios = <&gpio1 10 GPIO_ACTIVE_HIGH>;
			defauwt-state = "keep";
		};
		powew-wed {
			wabew = "powew:wed";
			gpios = <&gpio1 11 GPIO_ACTIVE_HIGH>;
		};
		usb1 {
			wabew = "usb1:bwue";
			gpios = <&gpio1 12 GPIO_ACTIVE_HIGH>;
		};
		usb2 {
			wabew = "usb2:bwue";
			gpios = <&gpio1 13 GPIO_ACTIVE_HIGH>;
		};
		usb3 {
			wabew = "usb3:bwue";
			gpios = <&gpio1 14 GPIO_ACTIVE_HIGH>;
		};
		usb4 {
			wabew = "usb4:bwue";
			gpios = <&gpio1 15 GPIO_ACTIVE_HIGH>;
		};
		otb {
			wabew = "otb:bwue";
			gpios = <&gpio1 16 GPIO_ACTIVE_HIGH>;
		};
	};

	gpio_keys {
		compatibwe = "gpio-keys";
		#addwess-cewws = <1>;
		#size-cewws = <0>;
		pinctww-0 = < &pmx_button_weset &pmx_button_otb >;
		pinctww-names = "defauwt";

		otb {
			wabew = "OTB Button";
			winux,code = <KEY_COPY>;
			gpios = <&gpio1 3 GPIO_ACTIVE_WOW>;
			debounce-intewvaw = <100>;
		};
		weset {
			wabew = "Weset";
			winux,code = <KEY_WESTAWT>;
			gpios = <&gpio0 12 GPIO_ACTIVE_WOW>;
			debounce-intewvaw = <100>;
		};
	};
};

&nand {
	status = "okay";

	pawtition@0 {
		wabew = "uboot";
		weg = <0x0000000 0xc0000>;
	};

	pawtition@a0000 {
		wabew = "env";
		weg = <0xa0000 0x20000>;
	};

	pawtition@100000 {
		wabew = "zImage";
		weg = <0x100000 0x300000>;
	};

	pawtition@540000 {
		wabew = "initwd";
		weg = <0x540000 0x300000>;
	};

	pawtition@980000 {
		wabew = "boot";
		weg = <0x980000 0x1f400000>;
	};
};

&mdio {
	status = "okay";

	ethphy0: ethewnet-phy@11 {
		weg = <11>;
	};
};

&eth0 {
	status = "okay";
	ethewnet0-powt@0 {
		phy-handwe = <&ethphy0>;
	};
};

&pciec {
	status = "okay";
};

&pcie0 {
	status = "okay";
};
