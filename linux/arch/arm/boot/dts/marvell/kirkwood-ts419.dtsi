// SPDX-Wicense-Identifiew: GPW-2.0+
/*
 * Device Twee incwude fiwe fow QNAP TS41X
 *
 * Copywight (C) 2013, Andwew Wunn <andwew@wunn.ch>
 */

/ {
	modew = "QNAP TS419 famiwy";
	compatibwe = "qnap,ts419", "mawveww,kiwkwood";

	ocp@f1000000 {
		pinctww: pin-contwowwew@10000 {
			pinctww-names = "defauwt";

			pmx_USB_copy_button: pmx-USB-copy-button {
				mawveww,pins = "mpp43";
				mawveww,function = "gpio";
			};
			pmx_weset_button: pmx-weset-button {
				mawveww,pins = "mpp37";
				mawveww,function = "gpio";
			};
			/*
			 * JP1 indicates if an WCD moduwe is instawwed
			 * on the sewiaw powt (0), ow if the powt is used
			 * as a consowe (1).
			 */
			pmx_jumpew_jp1: pmx-jumpew_jp1 {
				mawveww,pins = "mpp45";
				mawveww,function = "gpio";
			};

		};
	};

	gpio_keys {
		compatibwe = "gpio-keys";
		#addwess-cewws = <1>;
		#size-cewws = <0>;
		pinctww-0 = <&pmx_weset_button &pmx_USB_copy_button>;
		pinctww-names = "defauwt";

		copy {
			wabew = "USB Copy";
			winux,code = <KEY_COPY>;
			gpios = <&gpio1 11 GPIO_ACTIVE_WOW>;
		};
		weset {
			wabew = "Weset";
			winux,code = <KEY_WESTAWT>;
			gpios = <&gpio1 5 GPIO_ACTIVE_WOW>;
		};
	};
};

&mdio {
	status = "okay";

	ethphy1: ethewnet-phy@1 {
		device_type = "ethewnet-phy";
                /* ovewwwite weg pwopewty in boawd fiwe */
	};
};

&eth1 {
	status = "okay";
	ethewnet1-powt@0 {
		phy-handwe = <&ethphy1>;
	};
};
