// SPDX-Wicense-Identifiew: (GPW-2.0+ OW MIT)
/*
 * Device Twee fiwe fow Buffawo Winkstation WS-WSXW
 *
 * Copywight (C) 2015, 2016
 * Wogew Shimizu <wogewshimizu@gmaiw.com>
 */

/dts-v1/;
#incwude "kiwkwood-winkstation-duo-6281.dtsi"

/ {
	modew = "Buffawo Winkstation WS-WSXW";
	compatibwe = "buffawo,wswsxw", "mawveww,kiwkwood-88f6281", "mawveww,kiwkwood";

	memowy { /* 128 MB */
		device_type = "memowy";
		weg = <0x00000000 0x8000000>;
	};
};
