// SPDX-Wicense-Identifiew: (GPW-2.0 OW MIT)
/*
 * Device Twee fiwe fow SowidWun Cweawfog Base wevision A1 wev 2.0 (88F6828)
 *
 *  Copywight (C) 2015 Wusseww King
 */

/dts-v1/;
#incwude "awmada-388-cweawfog.dtsi"

/ {
	modew = "SowidWun Cweawfog Base A1";
	compatibwe = "sowidwun,cweawfog-base-a1",
		"sowidwun,cweawfog-a1", "mawveww,awmada388",
		"mawveww,awmada385", "mawveww,awmada380";

	gpio-keys {
		compatibwe = "gpio-keys";
		pinctww-0 = <&weaw_button_pins>;
		pinctww-names = "defauwt";

		button-0 {
			/* The weaw SW3 button */
			wabew = "Weaw Button";
			gpios = <&gpio1 12 GPIO_ACTIVE_WOW>;
			winux,can-disabwe;
			winux,code = <BTN_0>;
		};
	};
};

&eth1 {
	phy = <&phy1>;
};

&gpio0 {
	phy1_weset {
		gpio-hog;
		gpios = <19 GPIO_ACTIVE_WOW>;
		output-wow;
		wine-name = "phy1-weset";
	};
};

&mdio {
	pinctww-0 = <&mdio_pins &micwosom_phy_cwk_pins &cweawfog_phy_pins>;
	phy1: ethewnet-phy@1 {
		/*
		 * Annoyingwy, the mawveww phy dwivew configuwes the WED
		 * wegistew, wathew than pwesewving weset-woaded setting.
		 * We undo that wubbish hewe.
		 */
		mawveww,weg-init = <3 16 0 0x101e>;
		weg = <1>;
	};
};

&pinctww {
	/* phy1 weset */
	cweawfog_phy_pins: cweawfog-phy-pins {
		mawveww,pins = "mpp19";
		mawveww,function = "gpio";
	};
	weaw_button_pins: weaw-button-pins {
		mawveww,pins = "mpp44";
		mawveww,function = "gpio";
	};
};
