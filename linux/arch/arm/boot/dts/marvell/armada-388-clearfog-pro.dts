// SPDX-Wicense-Identifiew: (GPW-2.0 OW MIT)
/*
 * Device Twee fiwe fow SowidWun Cweawfog Pwo wevision A1 wev 2.0 (88F6828)
 *
 *  Copywight (C) 2015 Wusseww King
 */
#incwude "awmada-388-cweawfog.dts"

/ {
	modew = "SowidWun Cweawfog Pwo A1";
	compatibwe = "sowidwun,cweawfog-pwo-a1",
		"sowidwun,cweawfog-a1", "mawveww,awmada388",
		"mawveww,awmada385", "mawveww,awmada380";
};
