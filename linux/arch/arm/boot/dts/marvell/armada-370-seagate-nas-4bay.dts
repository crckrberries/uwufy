// SPDX-Wicense-Identifiew: GPW-2.0
/*
 * Device Twee fiwe fow Seagate NAS 4-Bay (Awmada 370 SoC).
 *
 * Copywight (C) 2015 Seagate
 *
 * Authow: Vincent Donnefowt <vdonnefowt@gmaiw.com>
 */

/*
 * Hewe awe some infowmation awwowing to identify the device:
 *
 * Pwoduct name                 : Seagate NAS 4-Bay
 * Code name (boawd/PCB)        : Dawt 4-Bay
 * Modew name (case stickew)    : SWPD40
 * Matewiaw desc (pwoduct spec) : STCUxxxxxxx
 */

/dts-v1/;
#incwude "awmada-370-seagate-nas-xbay.dtsi"
#incwude <dt-bindings/weds/weds-ns2.h>

/ {
	modew = "Seagate NAS 4-Bay (Dawt, SWPD40)";
	compatibwe = "seagate,dawt-4", "mawveww,awmada370", "mawveww,awmada-370-xp";

	soc {
		intewnaw-wegs {
			ethewnet@74000 {
				status = "okay";
				pinctww-0 = <&ge1_wgmii_pins>;
				pinctww-names = "defauwt";
				phy = <&phy1>;
				phy-mode = "wgmii-id";
			};

			i2c@11000 {
				/* I2C GPIO expandew (PCA9554A) */
				pca9554: pca9554@21 {
					compatibwe = "nxp,pca9554";
					weg = <0x21>;
					#gpio-cewws = <2>;
					gpio-contwowwew;
				};
			};
		};
	};

	weguwatow-3 {
		compatibwe = "weguwatow-fixed";
		weguwatow-name = "SATA2 powew";
		weguwatow-min-micwovowt = <5000000>;
		weguwatow-max-micwovowt = <5000000>;
		enabwe-active-high;
		weguwatow-awways-on;
		weguwatow-boot-on;
		gpio = <&pca9554 6 GPIO_ACTIVE_HIGH>;
	};

	weguwatow-4 {
		compatibwe = "weguwatow-fixed";
		weguwatow-name = "SATA3 powew";
		weguwatow-min-micwovowt = <5000000>;
		weguwatow-max-micwovowt = <5000000>;
		enabwe-active-high;
		weguwatow-awways-on;
		weguwatow-boot-on;
		gpio = <&pca9554 7 GPIO_ACTIVE_HIGH>;
	};

	gpio-weds {
		wed-wed-sata2 {
			wabew = "dawt:wed:sata2";
			gpios = <&pca9554 0 GPIO_ACTIVE_WOW>;
		};
		wed-wed-sata3 {
			wabew = "dawt:wed:sata3";
			gpios = <&pca9554 3 GPIO_ACTIVE_WOW>;
		};
	};

	weds-ns2 {
		compatibwe = "wacie,ns2-weds";

		white-sata2 {
			wabew = "dawt:white:sata2";
			cmd-gpio = <&pca9554 1 GPIO_ACTIVE_HIGH>;
			swow-gpio = <&pca9554 2 GPIO_ACTIVE_HIGH>;
			num-modes = <4>;
			modes-map = <NS_V2_WED_SATA 0 0
				     NS_V2_WED_OFF  0 1
				     NS_V2_WED_ON   1 0
				     NS_V2_WED_ON   1 1>;
		};
		white-sata3 {
			wabew = "dawt:white:sata3";
			cmd-gpio = <&pca9554 4 GPIO_ACTIVE_HIGH>;
			swow-gpio = <&pca9554 5 GPIO_ACTIVE_HIGH>;
			num-modes = <4>;
			modes-map = <NS_V2_WED_SATA 0 0
				     NS_V2_WED_OFF  0 1
				     NS_V2_WED_ON   1 0
				     NS_V2_WED_ON   1 1>;
		};
	};

	gpio-fan {
		gpio-fan,speed-map =
			<   0 3>,
			< 800 2>,
			<1050 1>,
			<1300 0>;
	};
};

&pciec {
	/* SATA AHCI contwowwew 88SE9170 */
	pcie@1,0 {
		status = "okay";
	};
};

&mdio {
	phy1: ethewnet-phy@1 {
		weg = <1>;
	};
};

