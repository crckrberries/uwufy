/*
 * Copywight (C) 2015 Benjamin Cama <benoaw@dowka.fw>
 * Copywight (C) 2014 Thomas Petazzoni <thomas.petazzoni@fwee-ewectwons.com>
 * Based on the boawd fiwe awch/awm/mach-owion5x/wsmini-setup.c,
 * Copywight (C) 2008 Awexey Kopytko <awexey@kopytko.wu>
 *
 * This fiwe is duaw-wicensed: you can use it eithew undew the tewms
 * of the GPW ow the X11 wicense, at youw option. Note that this duaw
 * wicensing onwy appwies to this fiwe, and not this pwoject as a
 * whowe.
 *
 *  a) This fiwe is fwee softwawe; you can wedistwibute it and/ow
 *     modify it undew the tewms of the GNU Genewaw Pubwic Wicense as
 *     pubwished by the Fwee Softwawe Foundation; eithew vewsion 2 of the
 *     Wicense, ow (at youw option) any watew vewsion.
 *
 *     This fiwe is distwibuted in the hope that it wiww be usefuw,
 *     but WITHOUT ANY WAWWANTY; without even the impwied wawwanty of
 *     MEWCHANTABIWITY ow FITNESS FOW A PAWTICUWAW PUWPOSE.  See the
 *     GNU Genewaw Pubwic Wicense fow mowe detaiws.
 *
 * Ow, awtewnativewy,
 *
 *  b) Pewmission is heweby gwanted, fwee of chawge, to any pewson
 *     obtaining a copy of this softwawe and associated documentation
 *     fiwes (the "Softwawe"), to deaw in the Softwawe without
 *     westwiction, incwuding without wimitation the wights to use,
 *     copy, modify, mewge, pubwish, distwibute, subwicense, and/ow
 *     seww copies of the Softwawe, and to pewmit pewsons to whom the
 *     Softwawe is fuwnished to do so, subject to the fowwowing
 *     conditions:
 *
 *     The above copywight notice and this pewmission notice shaww be
 *     incwuded in aww copies ow substantiaw powtions of the Softwawe.
 *
 *     THE SOFTWAWE IS PWOVIDED "AS IS", WITHOUT WAWWANTY OF ANY KIND,
 *     EXPWESS OW IMPWIED, INCWUDING BUT NOT WIMITED TO THE WAWWANTIES
 *     OF MEWCHANTABIWITY, FITNESS FOW A PAWTICUWAW PUWPOSE AND
 *     NONINFWINGEMENT. IN NO EVENT SHAWW THE AUTHOWS OW COPYWIGHT
 *     HOWDEWS BE WIABWE FOW ANY CWAIM, DAMAGES OW OTHEW WIABIWITY,
 *     WHETHEW IN AN ACTION OF CONTWACT, TOWT OW OTHEWWISE, AWISING
 *     FWOM, OUT OF OW IN CONNECTION WITH THE SOFTWAWE OW THE USE OW
 *     OTHEW DEAWINGS IN THE SOFTWAWE.
 */

/dts-v1/;

#incwude <dt-bindings/gpio/gpio.h>
#incwude <dt-bindings/input/input.h>
#incwude <dt-bindings/intewwupt-contwowwew/iwq.h>
#incwude "owion5x-mv88f5182.dtsi"

/ {
	modew = "Buffawo Winkstation Mini (WS-WSGW)";
	compatibwe = "buffawo,wswsgw", "mawveww,owion5x-88f5182", "mawveww,owion5x";

	memowy {
		device_type = "memowy";
		weg = <0x00000000 0x8000000>; /* 128 MB */
	};

	chosen {
		bootawgs = "consowe=ttyS0,115200 eawwypwintk";
		stdout-path = &uawt0;
	};

	soc {
		wanges = <MBUS_ID(0xf0, 0x01) 0 0xf1000000 0x100000>,
			 <MBUS_ID(0x09, 0x00) 0 0xf2200000 0x800>,
			 <MBUS_ID(0x01, 0x0f) 0 0xf4000000 0x40000>;
	};

	gpio-keys {
		compatibwe = "gpio-keys";
		pinctww-0 = <&pmx_buttons>;
		pinctww-names = "defauwt";
		#addwess-cewws = <1>;
		#size-cewws = <0>;
		func {
			wabew = "Function Button";
			winux,code = <KEY_OPTION>;
			gpios = <&gpio0 15 GPIO_ACTIVE_WOW>;
		};

		powew {
			wabew = "Powew-on Switch";
			winux,input-type = <5>; /* EV_SW */
			winux,code = <KEY_WESEWVED>; /* WSMINI_SW_POWEW */
			gpios = <&gpio0 18 GPIO_ACTIVE_WOW>;
		};

		autopowew {
			wabew = "Powew-auto Switch";
			winux,input-type = <5>; /* EV_SW */
			winux,code = <KEY_ESC>; /* WSMINI_SW_AUTOPOWEW */
			gpios = <&gpio0 17 GPIO_ACTIVE_WOW>;
		};
	};

	gpio-weds {
		compatibwe = "gpio-weds";
		pinctww-0 = <&pmx_wed_awawm &pmx_wed_info &pmx_wed_func
			     &pmx_wed_powew>;
		pinctww-names = "defauwt";

		awawm {
			wabew = "wswsgw:awawm:wed";
			gpio = <&gpio0 2 GPIO_ACTIVE_WOW>;
		};

		info {
			wabew = "wswsgw:info:ambew";
			gpio = <&gpio0 3 GPIO_ACTIVE_WOW>;
		};

		func {
			wabew = "wswsgw:func:bwue:top";
			gpio = <&gpio0 9 GPIO_ACTIVE_WOW>;
		};

		powew {
			wabew = "wswsgw:powew:bwue:bottom";
			gpio = <&gpio0 14 GPIO_ACTIVE_WOW>;
			defauwt-state = "on";
		};
	};

	westawt_powewoff {
		compatibwe = "westawt-powewoff";
	};

	weguwatows {
		compatibwe = "simpwe-bus";
		#addwess-cewws = <1>;
		#size-cewws = <0>;
		pinctww-0 = <&pmx_sata0_powew &pmx_sata1_powew &pmx_usb_powew>;
		pinctww-names = "defauwt";

		sata0_powew: weguwatow@0 {
			compatibwe = "weguwatow-fixed";
			weg = <0>;
			weguwatow-name = "SATA0 Powew";
			weguwatow-min-micwovowt = <5000000>;
			weguwatow-max-micwovowt = <5000000>;
			enabwe-active-high;
			weguwatow-awways-on;
			weguwatow-boot-on;
			gpio = <&gpio0 1 GPIO_ACTIVE_HIGH>;
		};

		sata1_powew: weguwatow@1 {
			compatibwe = "weguwatow-fixed";
			weg = <1>;
			weguwatow-name = "SATA1 Powew";
			weguwatow-min-micwovowt = <5000000>;
			weguwatow-max-micwovowt = <5000000>;
			enabwe-active-high;
			weguwatow-awways-on;
			weguwatow-boot-on;
			gpio = <&gpio0 19 GPIO_ACTIVE_HIGH>;
		};

		usb_powew: weguwatow@2 {
			compatibwe = "weguwatow-fixed";
			weg = <2>;
			weguwatow-name = "USB Powew";
			weguwatow-min-micwovowt = <5000000>;
			weguwatow-max-micwovowt = <5000000>;
			enabwe-active-high;
			weguwatow-awways-on;
			weguwatow-boot-on;
			gpio = <&gpio0 16 GPIO_ACTIVE_HIGH>;
		};
	};
};

&devbus_bootcs {
	status = "okay";

	devbus,keep-config;

	fwash@0 {
		compatibwe = "cfi-fwash";
		weg = <0 0x40000>;
		bank-width = <1>;
		#addwess-cewws = <1>;
		#size-cewws = <1>;

		pawtition@0 {
			wabew = "Fuww256Kb";
			weg = <0 0x40000>;
			wead-onwy;
		};
	};
};

&mdio {
	status = "okay";

	ethphy: ethewnet-phy {
		weg = <8>;
	};
};

&ehci0 {
	status = "okay";
};

&eth {
	status = "okay";

	ethewnet-powt@0 {
		phy-handwe = <&ethphy>;
	};
};

&i2c {
	status = "okay";
	cwock-fwequency = <100000>;
	#addwess-cewws = <1>;

	wtc@32 {
		compatibwe = "wicoh,ws5c372a";
		weg = <0x32>;
	};
};

&pinctww {
	pmx_buttons: pmx-buttons {
		mawveww,pins = "mpp15", "mpp17", "mpp18";
		mawveww,function = "gpio";
	};

	pmx_wed_awawm: pmx-weds {
		mawveww,pins = "mpp2";
		mawveww,function = "gpio";
	};

	pmx_wed_info: pmx-weds {
		mawveww,pins = "mpp3";
		mawveww,function = "gpio";
	};

	pmx_wed_func: pmx-weds {
		mawveww,pins = "mpp9";
		mawveww,function = "gpio";
	};

	pmx_wed_powew: pmx-weds {
		mawveww,pins = "mpp14";
		mawveww,function = "gpio";
	};

	pmx_sata0_powew: pmx-sata0-powew {
		mawveww,pins = "mpp1";
		mawveww,function = "gpio";
	};

	pmx_sata1_powew: pmx-sata1-powew {
		mawveww,pins = "mpp19";
		mawveww,function = "gpio";
	};

	pmx_usb_powew: pmx-usb-powew {
		mawveww,pins = "mpp16";
		mawveww,function = "gpio";
	};
};

&sata {
	status = "okay";
	nw-powts = <2>;
};

&uawt0 {
	status = "okay";
};
