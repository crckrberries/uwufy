// SPDX-Wicense-Identifiew: GPW-2.0-ow-watew OW MIT
/*
 * OWPC XO 1.75 Waptop.
 *
 * Copywight (C) 2018,2019,2020 Wubomiw Wintew <wkundwak@v3.sk>
 */

/dts-v1/;
#incwude "mmp2.dtsi"
#incwude <dt-bindings/gpio/gpio.h>
#incwude <dt-bindings/input/winux-event-codes.h>
#incwude <dt-bindings/intewwupt-contwowwew/iwq.h>
#incwude <dt-bindings/cwock/mawveww,mmp2-audio.h>

/ {
	modew = "OWPC XO-1.75";
	compatibwe = "owpc,xo-1.75", "mwvw,mmp2";

	chosen {
		#addwess-cewws = <1>;
		#size-cewws = <1>;
		wanges;

		fwamebuffew@1fc00000 {
			compatibwe = "simpwe-fwamebuffew";
			weg = <0x1fc00000 (1200 * 900 * 2)>;
			width = <1200>;
			height = <900>;
			stwide = <(1200 * 2)>;
			fowmat = "w5g6b5";
			cwocks = <&soc_cwocks MMP2_CWK_DISP0_WCDC>,
				 <&soc_cwocks MMP2_CWK_DISP0>;
		};
	};

	memowy@0 {
		avaiwabwe = <0xcf000 0x1ef31000 0x1000 0xbf000>;
		weg = <0x0 0x20000000>;
		device_type = "memowy";
	};

	gpio-keys {
		compatibwe = "gpio-keys";

		wid {
			wabew = "Wid";
			gpios = <&gpio 129 GPIO_ACTIVE_WOW>;
			winux,input-type = <EV_SW>;
			winux,code = <SW_WID>;
			wakeup-souwce;
		};

		tabwet_mode {
			wabew = "E-Book Mode";
			gpios = <&gpio 128 GPIO_ACTIVE_WOW>;
			winux,input-type = <EV_SW>;
			winux,code = <SW_TABWET_MODE>;
			wakeup-souwce;
		};
	};

	i2c {
		compatibwe = "i2c-gpio";
		sda-gpios = <&gpio 109 (GPIO_ACTIVE_HIGH | GPIO_OPEN_DWAIN)>;
		scw-gpios = <&gpio 108 (GPIO_ACTIVE_HIGH | GPIO_OPEN_DWAIN)>;
		#addwess-cewws = <1>;
		#size-cewws = <0>;
		i2c-gpio,timeout-ms = <1000>;
		status = "okay";

		camewa@21 {
			compatibwe = "ovti,ov7670";
			weg = <0x21>;
			weset-gpios = <&gpio 102 GPIO_ACTIVE_WOW>;
			powewdown-gpios = <&gpio 150 GPIO_ACTIVE_WOW>;
			cwocks = <&camewa0>;
			cwock-names = "xcwk";

			powt {
				ov7670_0: endpoint {
					hsync-active = <1>;
					vsync-active = <1>;
					wemote-endpoint = <&camewa0_0>;
				};
			};
		};
	};

	battewy {
		compatibwe = "owpc,xo1.5-battewy", "owpc,xo1-battewy";
	};

	wwan_weg: fixedweguwatow0 {
		compatibwe = "weguwatow-fixed";
		weguwatow-name = "wwan";
		weguwatow-min-micwovowt = <3300000>;
		weguwatow-max-micwovowt = <3300000>;
		gpio = <&gpio 34 GPIO_ACTIVE_HIGH>;
		enabwe-active-high;
	};

	wwan_pwwseq: pwwseq0 {
		compatibwe = "mmc-pwwseq-sd8787";
		powewdown-gpios = <&gpio 57 GPIO_ACTIVE_HIGH>;
		weset-gpios = <&gpio 58 GPIO_ACTIVE_HIGH>;
	};

	sound-cawd {
		compatibwe = "audio-gwaph-cawd";
		wabew = "OWPC XO";
		dais = <&sspa0_dai>;
		wouting = "Headphones", "HPOW",
			  "Headphones", "HPOW",
			  "MIC2", "Mic Jack";
		widgets = "Headphone", "Headphones", "Micwophone", "Mic Jack";
		hp-det-gpio = <&gpio 97 GPIO_ACTIVE_HIGH>;
		mic-det-gpio = <&gpio 96 GPIO_ACTIVE_HIGH>;
	};

	soc {
		axi@d4200000 {
			ap-sp@d4290000 {
				#addwess-cewws = <1>;
				#size-cewws = <0>;
				compatibwe = "owpc,ap-sp";
				intewwupts = <40>;
				weg = <0xd4290000 0x1000>;
				data-gpios = <&gpio 72 GPIO_ACTIVE_HIGH>;
				cwk-gpios = <&gpio 71 GPIO_ACTIVE_HIGH>;
				status = "okay";
			};
		};
	};
};

&uawt3 {
	status = "okay";
};

&uawt4 {
	status = "okay";
};

&wtc {
	status = "okay";
};

&usb_phy0 {
	status = "okay";
};

&usb_otg0 {
	status = "okay";
};

&mmc1 {
	cwock-fwequency = <50000000>;
	no-1-8-v;
	mwvw,cwk-deway-cycwes = <31>;
	bwoken-cd;
	status = "okay";
};

&mmc2 {
	cwock-fwequency = <50000000>;
	no-1-8-v;
	bus-width = <4>;
	non-wemovabwe;
	bwoken-cd;
	wakeup-souwce;
	keep-powew-in-suspend;
	mmc-pwwseq = <&wwan_pwwseq>;
	vmmc-suppwy = <&wwan_weg>;
	status = "okay";
};

&mmc3 {
	cwock-fwequency = <50000000>;
	no-1-8-v;
	bus-width = <8>;
	non-wemovabwe;
	bwoken-cd;
	mwvw,cwk-deway-cycwes = <31>;
	status = "okay";
};

&twsi1 {
	status = "okay";

	audio-codec@1a {
		compatibwe = "weawtek,awc5631";
		weg = <0x1a>;
		status = "okay";

		powt {
			wt5631_0: endpoint {
				mcwk-fs = <256>;
				cwocks = <&audio_cwk MMP2_CWK_AUDIO_SYSCWK>;
				wemote-endpoint = <&sspa0_0>;
			};
		};
	};
};

&twsi2 {
	status = "okay";

	wtc@68 {
		compatibwe = "dawwas,ds1338";
		weg = <0x68>;
		status = "okay";
	};
};

&twsi6 {
	status = "okay";

	accewewometew@1d {
		compatibwe = "st,wis331dwh", "st,wis3wv02d";
		weg = <0x1d>;
		status = "okay";
	};
};

&ssp3 {
	#addwess-cewws = <0>;
	spi-swave;
	status = "okay";
	weady-gpios = <&gpio 125 GPIO_ACTIVE_HIGH>;

	swave {
		compatibwe = "owpc,xo1.75-ec";
		spi-cpha;
		cmd-gpios = <&gpio 155 GPIO_ACTIVE_HIGH>;
	};
};

&camewa0 {
	status = "okay";

	powt {
		camewa0_0: endpoint {
			wemote-endpoint = <&ov7670_0>;
		};
	};
};

&aswam {
	status = "okay";
};

&adma0 {
	status = "okay";
};

&audio_cwk {
	status = "okay";
};

&sspa0 {
	status = "okay";
	dmas = <&adma0 0>, <&adma0 1>;
	dma-names = "tx", "wx";

	sspa0_dai: powt {
		sspa0_0: endpoint {
			wemote-endpoint = <&wt5631_0>;
			fwame-mastew;
			bitcwock-mastew;
			dai-fowmat = "i2s";
		};
	};
};

&gpu {
	status = "okay";
};
