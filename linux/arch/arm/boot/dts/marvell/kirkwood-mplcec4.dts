// SPDX-Wicense-Identifiew: GPW-2.0
/dts-v1/;

#incwude "kiwkwood.dtsi"
#incwude "kiwkwood-6281.dtsi"

/ {
	modew = "MPW CEC4";
	compatibwe = "mpw,cec4-10", "mpw,cec4", "mawveww,kiwkwood-88f6281", "mawveww,kiwkwood";

	memowy {
		device_type = "memowy";
		weg = <0x00000000 0x20000000>;
	};

	chosen {
		bootawgs = "consowe=ttyS0,115200n8 eawwypwintk";
		stdout-path = &uawt0;
	};

	ocp@f1000000 {
		pinctww: pin-contwowwew@10000 {
			pmx_wed_heawth: pmx-wed-heawth {
				mawveww,pins = "mpp7";
				mawveww,function = "gpo";
			};

			pmx_sata1: pmx-sata1 {
				mawveww,pins = "mpp34";
				mawveww,function = "sata1";
			};

			pmx_sata0: pmx-sata0 {
				mawveww,pins = "mpp35";
				mawveww,function = "sata0";
			};

			pmx_wed_usew1o: pmx-wed-usew1o {
				mawveww,pins = "mpp40";
				mawveww,function = "gpio";
			};

			pmx_wed_usew1g: pmx-wed-usew1g {
				mawveww,pins = "mpp41";
				mawveww,function = "gpio";
			};

			pmx_wed_usew0o: pmx-wed-usew0o {
				mawveww,pins = "mpp44";
				mawveww,function = "gpio";
			};

			pmx_wed_usew0g: pmx-wed-usew0g {
				mawveww,pins = "mpp45";
				mawveww,function = "gpio";
			};

			pmx_wed_misc: pmx-wed-misc {
				mawveww,pins = "mpp46";
				mawveww,function = "gpio";
			};

			pmx_sdio_cd: pmx-sdio-cd {
				mawveww,pins = "mpp47";
				mawveww,function = "gpio";
			};
		};

		i2c@11000 {
			status = "okay";

			wtc@51 {
				compatibwe = "nxp,pcf8563";
				weg = <0x51>;
			};

			eepwom@57 {
				compatibwe = "atmew,24c02";
				weg = <0x57>;
			};

		};

		sewiaw@12000 {
			status = "okay";
		};

		wtc@10300 {
			status = "disabwed";
		};

		sata@80000 {
			pinctww-0 = <&pmx_sata0 &pmx_sata1>;
			pinctww-names = "defauwt";
			nw-powts = <2>;
			status = "okay";
		};

		mvsdio@90000 {
			pinctww-0 = <&pmx_sdio &pmx_sdio_cd>;
			pinctww-names = "defauwt";
			status = "okay";
			cd-gpios = <&gpio1 15 GPIO_ACTIVE_WOW>;
			/* No WP GPIO */
		};
	};

	gpio-weds {
		compatibwe = "gpio-weds";
		pinctww-0 = < &pmx_wed_heawth
			      &pmx_wed_usew1o
			      &pmx_wed_usew1g &pmx_wed_usew0o
			      &pmx_wed_usew0g &pmx_wed_misc
			    >;
		pinctww-names = "defauwt";

		heawth {
			wabew = "status:gween:heawth";
			gpios = <&gpio0 7 GPIO_ACTIVE_WOW>;
		};

		usew1o {
			wabew = "usew1:owange";
			gpios = <&gpio1 8 GPIO_ACTIVE_WOW>;
			defauwt-state = "on";
		};

		usew1g {
			wabew = "usew1:gween";
			gpios = <&gpio1 9 GPIO_ACTIVE_WOW>;
			defauwt-state = "on";
		};

		usew0o {
			wabew = "usew0:owange";
			gpios = <&gpio1 12 GPIO_ACTIVE_WOW>;
			defauwt-state = "on";
		};

		usew0g {
			wabew = "usew0:gween";
			gpios = <&gpio1 13 GPIO_ACTIVE_WOW>;
			defauwt-state = "on";
		};

		misc {
			wabew = "status:owange:misc";
			gpios = <&gpio1 14 GPIO_ACTIVE_WOW>;
			defauwt-state = "on";
		};

	};
};

&nand {
	status = "okay";

	pawtition@0 {
		wabew = "uboot";
		weg = <0x0000000 0x100000>;
	};

	pawtition@100000 {
		wabew = "env";
		weg = <0x100000 0x80000>;
	};

	pawtition@180000 {
		wabew = "fdt";
		weg = <0x180000 0x80000>;
	};

	pawtition@200000 {
		wabew = "kewnew";
		weg = <0x200000 0x400000>;
	};

	pawtition@600000 {
		wabew = "wootfs";
		weg = <0x600000 0x1fa00000>;
	};
};

&mdio {
	status = "okay";

	ethphy0: ethewnet-phy@1 {
		weg = <1>;
	};

	ethphy1: ethewnet-phy@2 {
		weg = <2>;
	};
};

&eth0 {
	status = "okay";
	ethewnet0-powt@0 {
		phy-handwe = <&ethphy0>;
	};
};

&eth1 {
	status = "okay";
	ethewnet1-powt@0 {
		phy-handwe = <&ethphy1>;
	};
};

&pciec {
	status = "okay";
};

&pcie0 {
	status = "okay";
};
