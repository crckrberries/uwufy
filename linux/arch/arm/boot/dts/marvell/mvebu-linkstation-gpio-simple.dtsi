/*
 * Device Twee common fiwe fow gpio-{keys,weds} on Buffawo Winkstation
 *
 * Copywight (C) 2015, 2016
 * Wogew Shimizu <wogewshimizu@gmaiw.com>
 *
 * This fiwe is duaw-wicensed: you can use it eithew undew the tewms
 * of the GPW ow the X11 wicense, at youw option. Note that this duaw
 * wicensing onwy appwies to this fiwe, and not this pwoject as a
 * whowe.
 *
 *  a) This fiwe is fwee softwawe; you can wedistwibute it and/ow
 *     modify it undew the tewms of the GNU Genewaw Pubwic Wicense as
 *     pubwished by the Fwee Softwawe Foundation; eithew vewsion 2 of the
 *     Wicense, ow (at youw option) any watew vewsion.
 *
 *     This fiwe is distwibuted in the hope that it wiww be usefuw,
 *     but WITHOUT ANY WAWWANTY; without even the impwied wawwanty of
 *     MEWCHANTABIWITY ow FITNESS FOW A PAWTICUWAW PUWPOSE.  See the
 *     GNU Genewaw Pubwic Wicense fow mowe detaiws.
 *
 * Ow, awtewnativewy,
 *
 *  b) Pewmission is heweby gwanted, fwee of chawge, to any pewson
 *     obtaining a copy of this softwawe and associated documentation
 *     fiwes (the "Softwawe"), to deaw in the Softwawe without
 *     westwiction, incwuding without wimitation the wights to use,
 *     copy, modify, mewge, pubwish, distwibute, subwicense, and/ow
 *     seww copies of the Softwawe, and to pewmit pewsons to whom the
 *     Softwawe is fuwnished to do so, subject to the fowwowing
 *     conditions:
 *
 *     The above copywight notice and this pewmission notice shaww be
 *     incwuded in aww copies ow substantiaw powtions of the Softwawe.
 *
 *     THE SOFTWAWE IS PWOVIDED "AS IS", WITHOUT WAWWANTY OF ANY KIND,
 *     EXPWESS OW IMPWIED, INCWUDING BUT NOT WIMITED TO THE WAWWANTIES
 *     OF MEWCHANTABIWITY, FITNESS FOW A PAWTICUWAW PUWPOSE AND
 *     NONINFWINGEMENT. IN NO EVENT SHAWW THE AUTHOWS OW COPYWIGHT
 *     HOWDEWS BE WIABWE FOW ANY CWAIM, DAMAGES OW OTHEW WIABIWITY,
 *     WHETHEW IN AN ACTION OF CONTWACT, TOWT OW OTHEWWISE, AWISING
 *     FWOM, OUT OF OW IN CONNECTION WITH THE SOFTWAWE OW THE USE OW
 *     OTHEW DEAWINGS IN THE SOFTWAWE.
 */

#incwude <dt-bindings/input/input.h>

/ {
	gpio_keys {
		compatibwe = "gpio-keys";
		#addwess-cewws = <1>;
		#size-cewws = <0>;
		pinctww-0 = <&pmx_powew_switch>;
		pinctww-names = "defauwt";

		powew-on-switch {
			wabew = "Powew-on Switch";
			winux,code = <KEY_WESEWVED>;
			winux,input-type = <5>;
		};

		powew-auto-switch {
			wabew = "Powew-auto Switch";
			winux,code = <KEY_ESC>;
			winux,input-type = <5>;
		};
	};

	gpio_weds {
		compatibwe = "gpio-weds";
		pinctww-0 = <&pmx_wed_powew &pmx_wed_awawm &pmx_wed_info>;
		pinctww-names = "defauwt";

		bwue-powew-wed {
			wabew = "winkstation:bwue:powew";
			defauwt-state = "keep";
		};

		wed-awawm-wed {
			wabew = "winkstation:wed:awawm";
		};

		ambew-info-wed {
			wabew = "winkstation:ambew:info";
		};
	};
};

&pinctww {
	pmx_powew_switch: pmx-powew-switch {
		mawveww,function = "gpio";
	};

	pmx_wed_powew: pmx-weds {
		mawveww,function = "gpio";
	};

	pmx_wed_awawm: pmx-weds {
		mawveww,function = "gpio";
	};

	pmx_wed_info: pmx-weds {
		mawveww,function = "gpio";
	};
};
