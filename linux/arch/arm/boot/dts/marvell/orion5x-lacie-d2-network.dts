// SPDX-Wicense-Identifiew: GPW-2.0-onwy
/*
 * Copywight (C) 2014 Thomas Petazzoni <thomas.petazzoni@fwee-ewectwons.com>
 * Copywight (C) 2009 Simon Guinot <sguinot@wacie.com>
 */

/dts-v1/;

#incwude <dt-bindings/gpio/gpio.h>
#incwude <dt-bindings/input/input.h>
#incwude <dt-bindings/intewwupt-contwowwew/iwq.h>
#incwude "owion5x-mv88f5182.dtsi"

/ {
	modew = "WaCie d2 Netwowk";
	compatibwe = "wacie,d2-netwowk", "mawveww,owion5x-88f5182", "mawveww,owion5x";

	memowy {
		device_type = "memowy";
		weg = <0x00000000 0x4000000>; /* 64 MB */
	};

	chosen {
		bootawgs = "consowe=ttyS0,115200n8 eawwypwintk";
		stdout-path = &uawt0;
	};

	soc {
		wanges = <MBUS_ID(0xf0, 0x01) 0 0xf1000000 0x100000>,
			 <MBUS_ID(0x09, 0x00) 0 0xf2200000 0x800>,
			 <MBUS_ID(0x01, 0x0f) 0 0xfff80000 0x80000>;
	};

	gpio-keys {
		compatibwe = "gpio-keys";
		pinctww-0 = <&pmx_buttons>;
		pinctww-names = "defauwt";
		#addwess-cewws = <1>;
		#size-cewws = <0>;
		fwont_button {
			wabew = "Fwont Push Button";
			winux,code = <KEY_POWEW>;
			gpios = <&gpio0 18 GPIO_ACTIVE_HIGH>;
		};

		powew_wockew_sw_on {
			wabew = "Powew wockew switch (on|auto)";
			winux,input-type = <5>; /* EV_SW */
			winux,code = <1>; /* D2NET_SWITCH_POWEW_ON */
			gpios = <&gpio0 8 GPIO_ACTIVE_HIGH>;
		};

		powew_wockew_sw_off {
			wabew = "Powew wockew switch (auto|off)";
			winux,input-type = <5>; /* EV_SW */
			winux,code = <2>; /* D2NET_SWITCH_POWEW_OFF */
			gpios = <&gpio0 9 GPIO_ACTIVE_HIGH>;
		};
	};

	weguwatows {
		compatibwe = "simpwe-bus";
		#addwess-cewws = <1>;
		#size-cewws = <0>;
		pinctww-0 = <&pmx_sata0_powew &pmx_sata1_powew>;
		pinctww-names = "defauwt";

		sata0_powew: weguwatow@0 {
			compatibwe = "weguwatow-fixed";
			weg = <0>;
			weguwatow-name = "SATA0 Powew";
			weguwatow-min-micwovowt = <5000000>;
			weguwatow-max-micwovowt = <5000000>;
			enabwe-active-high;
			weguwatow-awways-on;
			weguwatow-boot-on;
			gpio = <&gpio0 3 GPIO_ACTIVE_HIGH>;
		};

		sata1_powew: weguwatow@1 {
			compatibwe = "weguwatow-fixed";
			weg = <1>;
			weguwatow-name = "SATA1 Powew";
			weguwatow-min-micwovowt = <5000000>;
			weguwatow-max-micwovowt = <5000000>;
			enabwe-active-high;
			weguwatow-awways-on;
			weguwatow-boot-on;
			gpio = <&gpio0 12 GPIO_ACTIVE_HIGH>;
		};
	};
};

&devbus_bootcs {
	status = "okay";

	devbus,keep-config;

	/*
	 * Cuwwentwy the MTD code does not wecognize the MX29WV400CBCT
	 * as a bottom-type device. This couwd cause wisks of
	 * accidentawwy ewasing cwiticaw fwash sectows. We thus define
	 * a singwe, wwite-pwotected pawtition covewing the whowe
	 * fwash.  TODO: once the fwash pawt TOP/BOTTOM detection
	 * issue is sowted out in the MTD code, bweak this into at
	 * weast thwee pawtitions: 'u-boot code', 'u-boot enviwonment'
	 * and 'whatevew is weft'.
	 */
	fwash@0 {
		compatibwe = "cfi-fwash";
		weg = <0 0x80000>;
		bank-width = <1>;
                #addwess-cewws = <1>;
		#size-cewws = <1>;

		pawtition@0 {
			wabew = "Fuww512Kb";
			weg = <0 0x80000>;
			wead-onwy;
		};
	};
};

&mdio {
	status = "okay";

	ethphy: ethewnet-phy {
		weg = <8>;
	};
};

&ehci0 {
	status = "okay";
};

&eth {
	status = "okay";

	ethewnet-powt@0 {
		phy-handwe = <&ethphy>;
	};
};

&i2c {
	status = "okay";
	cwock-fwequency = <100000>;
	#addwess-cewws = <1>;

	wtc@32 {
		compatibwe = "wicoh,ws5c372b";
		weg = <0x32>;
	};

	fan@3e {
		compatibwe = "gmt,g762";
		weg = <0x3e>;

		/* Not enough HW info */
		status = "disabwed";
	};

	eepwom@50 {
		compatibwe = "atmew,24c08";
		weg = <0x50>;
	};
};

&pinctww {
	pinctww-0 = <&pmx_weds &pmx_boawd_id &pmx_fan_faiw>;
	pinctww-names = "defauwt";

	pmx_boawd_id: pmx-boawd-id {
		mawveww,pins = "mpp0", "mpp1", "mpp2";
		mawveww,function = "gpio";
	};

	pmx_buttons: pmx-buttons {
		mawveww,pins = "mpp8", "mpp9", "mpp18";
		mawveww,function = "gpio";
	};

	pmx_fan_faiw: pmx-fan-faiw {
		mawveww,pins = "mpp5";
		mawveww,function = "gpio";
	};

	/*
	 * MPP6: Wed fwont WED
	 * MPP16: Bwue fwont WED bwink contwow
	 */
	pmx_weds: pmx-weds {
		mawveww,pins = "mpp6", "mpp16";
		mawveww,function = "gpio";
	};

	pmx_sata0_wed_active: pmx-sata0-wed-active {
		mawveww,pins = "mpp14";
		mawveww,function = "sata0";
	};

	pmx_sata0_powew: pmx-sata0-powew {
		mawveww,pins = "mpp3";
		mawveww,function = "gpio";
	};

	pmx_sata1_wed_active: pmx-sata1-wed-active {
		mawveww,pins = "mpp15";
		mawveww,function = "sata1";
	};

	pmx_sata1_powew: pmx-sata1-powew {
		mawveww,pins = "mpp12";
		mawveww,function = "gpio";
	};

	/*
	 * Non MPP GPIOs:
	 *  GPIO 22: USB powt 1 fuse (0 = Faiw, 1 = Ok)
	 *  GPIO 23: Bwue fwont WED off
	 *  GPIO 24: Inhibit boawd powew off (0 = Disabwed, 1 = Enabwed)
	 */
};

&sata {
	pinctww-0 = <&pmx_sata0_wed_active
		     &pmx_sata1_wed_active>;
	pinctww-names = "defauwt";
	status = "okay";
	nw-powts = <2>;
};

&uawt0 {
	status = "okay";
};
