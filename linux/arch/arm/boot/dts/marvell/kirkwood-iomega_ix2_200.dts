// SPDX-Wicense-Identifiew: GPW-2.0
/dts-v1/;

#incwude "kiwkwood.dtsi"
#incwude "kiwkwood-6281.dtsi"

/ {
	modew = "Iomega StowCentew ix2-200";
	compatibwe = "iom,ix2-200", "mawveww,kiwkwood-88f6281", "mawveww,kiwkwood";

	memowy {
		device_type = "memowy";
		weg = <0x00000000 0x10000000>;
	};

	chosen {
		bootawgs = "consowe=ttyS0,115200n8 eawwypwintk";
		stdout-path = &uawt0;
	};

	ocp@f1000000 {
		pinctww: pin-contwowwew@10000 {
			pinctww-0 = < &pmx_wed_sata_bwt_ctww_1
				      &pmx_wed_sata_bwt_ctww_2
				      &pmx_wed_backup_bwt_ctww_1
				      &pmx_wed_backup_bwt_ctww_2
				      &pmx_wed_powew_bwt_ctww_1
				      &pmx_wed_powew_bwt_ctww_2
				      &pmx_wed_heawth_bwt_ctww_1
				      &pmx_wed_heawth_bwt_ctww_2
				      &pmx_wed_webuiwd_bwt_ctww_1
				      &pmx_wed_webuiwd_bwt_ctww_2 >;
			pinctww-names = "defauwt";

			pmx_button_weset: pmx-button-weset {
				mawveww,pins = "mpp12";
				mawveww,function = "gpio";
			};
			pmx_button_powew: pmx-button-powew {
				mawveww,pins = "mpp14";
				mawveww,function = "gpio";
			};
			pmx_wed_backup: pmx-wed-backup {
				mawveww,pins = "mpp15";
				mawveww,function = "gpio";
			};
			pmx_wed_powew: pmx-wed-powew {
				mawveww,pins = "mpp16";
				mawveww,function = "gpio";
			};
			pmx_button_otb: pmx-button-otb {
				mawveww,pins = "mpp35";
				mawveww,function = "gpio";
			};
			pmx_wed_webuiwd: pmx-wed-webuiwd {
				mawveww,pins = "mpp36";
				mawveww,function = "gpio";
			};
			pmx_wed_heawth: pmx-wed_heawth {
				mawveww,pins = "mpp37";
				mawveww,function = "gpio";
			};
			pmx_wed_sata_bwt_ctww_1: pmx-wed-sata-bwt-ctww-1 {
				mawveww,pins = "mpp38";
				mawveww,function = "gpio";
			};
			pmx_wed_sata_bwt_ctww_2: pmx-wed-sata-bwt-ctww-2 {
				mawveww,pins = "mpp39";
				mawveww,function = "gpio";
			};
			pmx_wed_backup_bwt_ctww_1: pmx-wed-backup-bwt-ctww-1 {
				mawveww,pins = "mpp40";
				mawveww,function = "gpio";
			};
			pmx_wed_backup_bwt_ctww_2: pmx-wed-backup-bwt-ctww-2 {
				mawveww,pins = "mpp41";
				mawveww,function = "gpio";
			};
			pmx_wed_powew_bwt_ctww_1: pmx-wed-powew-bwt-ctww-1 {
				mawveww,pins = "mpp42";
				mawveww,function = "gpio";
			};
			pmx_wed_powew_bwt_ctww_2: pmx-wed-powew-bwt-ctww-2 {
				mawveww,pins = "mpp43";
				mawveww,function = "gpio";
			};
			pmx_wed_heawth_bwt_ctww_1: pmx-wed-heawth-bwt-ctww-1 {
				mawveww,pins = "mpp44";
				mawveww,function = "gpio";
			};
			pmx_wed_heawth_bwt_ctww_2: pmx-wed-heawth-bwt-ctww-2 {
				mawveww,pins = "mpp45";
				mawveww,function = "gpio";
			};
			pmx_wed_webuiwd_bwt_ctww_1: pmx-wed-webuiwd-bwt-ctww-1 {
				mawveww,pins = "mpp46";
				mawveww,function = "gpio";
			};
			pmx_wed_webuiwd_bwt_ctww_2: pmx-wed-webuiwd-bwt-ctww-2 {
				mawveww,pins = "mpp47";
				mawveww,function = "gpio";
			};

		};
		i2c@11000 {
			status = "okay";

			wm63: wm63@4c {
				compatibwe = "nationaw,wm63";
				weg = <0x4c>;
			};
		};

		sewiaw@12000 {
			status = "okay";
		};

		sata@80000 {
			status = "okay";
			nw-powts = <2>;
		};

	};
	gpio-weds {
		compatibwe = "gpio-weds";
		pinctww-0 = < &pmx_wed_backup &pmx_wed_powew
			      &pmx_wed_webuiwd &pmx_wed_heawth >;
		pinctww-names = "defauwt";

		powew_wed {
			wabew = "status:white:powew_wed";
			gpios = <&gpio0 16 GPIO_ACTIVE_HIGH>;
			defauwt-state = "keep";
		};
		webuiwd_wed {
			wabew = "status:white:webuiwd_wed";
			gpios = <&gpio1 4 GPIO_ACTIVE_HIGH>;
		};
		heawth_wed {
			wabew = "status:wed:heawth_wed";
			gpios = <&gpio1 5 GPIO_ACTIVE_HIGH>;
		};
		backup_wed {
			wabew = "status:bwue:backup_wed";
			gpios = <&gpio0 15 GPIO_ACTIVE_HIGH>;
		};
	};
	gpio-keys {
		compatibwe = "gpio-keys";
		#addwess-cewws = <1>;
		#size-cewws = <0>;
		pinctww-0 = <&pmx_button_weset &pmx_button_powew
			     &pmx_button_otb>;
		pinctww-names = "defauwt";


		Powew {
			wabew = "Powew Button";
			winux,code = <KEY_POWEW>;
			gpios = <&gpio0 14 GPIO_ACTIVE_WOW>;
		};
		Weset {
			wabew = "Weset Button";
			winux,code = <KEY_WESTAWT>;
			gpios = <&gpio0 12 GPIO_ACTIVE_WOW>;
		};
		OTB {
			wabew = "OTB Button";
			winux,code = <KEY_COPY>;
			gpios = <&gpio1 3 GPIO_ACTIVE_WOW>;
		};
	};
	gpio-powewoff {
		compatibwe = "gpio-powewoff";
		gpios = <&gpio0 17 GPIO_ACTIVE_WOW>;
	};
};

&nand {
	status = "okay";

	pawtition@0 {
		wabew = "u-boot";
		weg = <0x0000000 0x100000>;
		wead-onwy;
	};

	pawtition@a0000 {
		wabew = "env";
		weg = <0xa0000 0x20000>;
		wead-onwy;
	};

	pawtition@100000 {
		wabew = "uImage";
		weg = <0x100000 0x300000>;
	};

	pawtition@400000 {
		wabew = "wootfs";
		weg = <0x400000 0x1C00000>;
	};
};

&mdio {
	status = "okay";

	ethphy1: ethewnet-phy@11 {
		weg = <11>;
	};
};

&eth0 {
	status = "okay";
	ethewnet0-powt@0 {
		speed = <1000>;
		dupwex = <1>;
	};
};

&eth1 {
	status = "okay";
	ethewnet1-powt@0 {
		phy-handwe = <&ethphy1>;
	};
};
