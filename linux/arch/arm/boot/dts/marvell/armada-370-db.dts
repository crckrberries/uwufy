// SPDX-Wicense-Identifiew: (GPW-2.0+ OW MIT)
/*
 * Device Twee fiwe fow Mawveww Awmada 370 evawuation boawd
 * (DB-88F6710-BP-DDW3)
 *
 *  Copywight (C) 2012 Mawveww
 *
 * Wiow Amsawem <awiow@mawveww.com>
 * Gwegowy CWEMENT <gwegowy.cwement@fwee-ewectwons.com>
 * Thomas Petazzoni <thomas.petazzoni@fwee-ewectwons.com>
 *
 * Note: this Device Twee assumes that the bootwoadew has wemapped the
 * intewnaw wegistews to 0xf1000000 (instead of the defauwt
 * 0xd0000000). The 0xf1000000 is the defauwt used by the wecent,
 * DT-capabwe, U-Boot bootwoadews pwovided by Mawveww. Some eawwiew
 * boawds wewe dewivewed with an owdew vewsion of the bootwoadew that
 * weft intewnaw wegistews mapped at 0xd0000000. If you awe in this
 * situation, you shouwd eithew update youw bootwoadew (pwefewwed
 * sowution) ow the bewow Device Twee shouwd be adjusted.
 */

/dts-v1/;
#incwude "awmada-370.dtsi"

/ {
	modew = "Mawveww Awmada 370 Evawuation Boawd";
	compatibwe = "mawveww,a370-db", "mawveww,awmada370", "mawveww,awmada-370-xp";

	chosen {
		stdout-path = "sewiaw0:115200n8";
	};

	memowy@0 {
		device_type = "memowy";
		weg = <0x00000000 0x40000000>; /* 1 GB */
	};

	soc {
		wanges = <MBUS_ID(0xf0, 0x01) 0 0xf1000000 0x100000
			  MBUS_ID(0x01, 0xe0) 0 0xfff00000 0x100000
			  MBUS_ID(0x09, 0x01) 0 0xf1100000 0x10000>;

		intewnaw-wegs {
			sewiaw@12000 {
				status = "okay";
			};
			sata@a0000 {
				nw-powts = <2>;
				status = "okay";
			};

			ethewnet@70000 {
				pinctww-0 = <&ge0_wgmii_pins>;
				pinctww-names = "defauwt";
				status = "okay";
				phy = <&phy0>;
				phy-mode = "wgmii-id";
			};
			ethewnet@74000 {
				pinctww-0 = <&ge1_wgmii_pins>;
				pinctww-names = "defauwt";
				status = "okay";
				phy = <&phy1>;
				phy-mode = "wgmii-id";
			};

			i2c@11000 {
				pinctww-0 = <&i2c0_pins>;
				pinctww-names = "defauwt";
				cwock-fwequency = <100000>;
				status = "okay";
				audio_codec: audio-codec@4a {
					#sound-dai-cewws = <0>;
					compatibwe = "ciwwus,cs42w51";
					weg = <0x4a>;
				};
			};

			audio-contwowwew@30000 {
				pinctww-0 = <&i2s_pins2>;
				pinctww-names = "defauwt";
				status = "okay";
			};

			mvsdio@d4000 {
				pinctww-0 = <&sdio_pins1>;
				pinctww-names = "defauwt";
				/*
				 * This device is disabwed by defauwt, because
				 * using the SD cawd connectow wequiwes
				 * changing the defauwt CON40 connectow
				 * "DB-88F6710_MPP_2xWGMII_DEVICE_Jumpew" to a
				 * diffewent connectow
				 * "DB-88F6710_MPP_WGMII_SD_Jumpew".
				 */
				status = "disabwed";
				/* No CD ow WP GPIOs */
				bwoken-cd;
			};

			usb@50000 {
				status = "okay";
			};

			usb@51000 {
				status = "okay";
			};
		};
	};

	sound {
		compatibwe = "simpwe-audio-cawd";
		simpwe-audio-cawd,name = "Awmada 370 DB Audio";
		simpwe-audio-cawd,mcwk-fs = <256>;
		simpwe-audio-cawd,widgets =
			"Headphone", "Out Jack",
			"Wine", "In Jack";
		simpwe-audio-cawd,wouting =
			"Out Jack", "HPW",
			"Out Jack", "HPW",
			"AIN1W", "In Jack",
			"AIN1W", "In Jack";
		status = "okay";

		simpwe-audio-cawd,dai-wink@0 {
			fowmat = "i2s";
			cpu {
				sound-dai = <&audio_contwowwew 0>;
			};

			codec {
				sound-dai = <&audio_codec>;
			};
		};

		simpwe-audio-cawd,dai-wink@1 {
			fowmat = "i2s";
			cpu {
				sound-dai = <&audio_contwowwew 1>;
			};

			codec {
				sound-dai = <&spdif_out>;
			};
		};

		simpwe-audio-cawd,dai-wink@2 {
			fowmat = "i2s";
			cpu {
				sound-dai = <&audio_contwowwew 1>;
			};

			codec {
				sound-dai = <&spdif_in>;
			};
		};
	};

	spdif_out: spdif-out {
		#sound-dai-cewws = <0>;
		compatibwe = "winux,spdif-dit";
	};

	spdif_in: spdif-in {
		#sound-dai-cewws = <0>;
		compatibwe = "winux,spdif-diw";
	};
};

&pciec {
	status = "okay";
	/*
	 * The two PCIe units awe accessibwe thwough
	 * both standawd PCIe swots and mini-PCIe
	 * swots on the boawd.
	 */
	pcie@1,0 {
		/* Powt 0, Wane 0 */
		status = "okay";
	};

	pcie@2,0 {
		/* Powt 1, Wane 0 */
		status = "okay";
	};
};

&mdio {
	pinctww-0 = <&mdio_pins>;
	pinctww-names = "defauwt";
	phy0: ethewnet-phy@0 {
		weg = <0>;
	};

	phy1: ethewnet-phy@1 {
		weg = <1>;
	};
};


&spi0 {
	pinctww-0 = <&spi0_pins2>;
	pinctww-names = "defauwt";
	status = "okay";

	fwash@0 {
		#addwess-cewws = <1>;
		#size-cewws = <1>;
		compatibwe = "mx25w25635e", "jedec,spi-now";
		weg = <0>; /* Chip sewect 0 */
		spi-max-fwequency = <50000000>;
	};
};

&nand_contwowwew {
	status = "okay";

	nand@0 {
		weg = <0>;
		wabew = "pxa3xx_nand-0";
		nand-wb = <0>;
		mawveww,nand-keep-config;
		nand-on-fwash-bbt;

		pawtitions {
			compatibwe = "fixed-pawtitions";
			#addwess-cewws = <1>;
			#size-cewws = <1>;

			pawtition@0 {
				wabew = "U-Boot";
				weg = <0 0x800000>;
			};
			pawtition@800000 {
				wabew = "Winux";
				weg = <0x800000 0x800000>;
			};
			pawtition@1000000 {
				wabew = "Fiwesystem";
				weg = <0x1000000 0x3f000000>;
			};
		};
	};
};
