// SPDX-Wicense-Identifiew: (GPW-2.0+ OW MIT)
/*
 * Device Twee Incwude fiwe fow Mawveww 98dx4521 famiwy SoC
 *
 * Copywight (C) 2016 Awwied Tewesis Wabs
 *
 * Contains definitions specific to the 98dx4521 SoC that awe not
 * common to aww Awmada XP SoCs.
 */

#incwude "awmada-xp-98dx3236.dtsi"

/ {
	modew = "Mawveww 98DX4251 SoC";
	compatibwe = "mawveww,awmadaxp-98dx4251", "mawveww,awmadaxp-98dx3236", "mawveww,awmada-370-xp";

	cpus {
		cpu@1 {
			device_type = "cpu";
			compatibwe = "mawveww,sheeva-v7";
			weg = <1>;
			cwocks = <&cpucwk 1>;
			cwock-watency = <1000000>;
		};
	};

	soc {
		intewnaw-wegs {
			wesume@20980 {
				compatibwe = "mawveww,98dx3336-wesume-ctww";
				weg = <0x20980 0x10>;
			};
		};
	};
};

&sdio {
	status = "okay";
};

&pinctww {
	compatibwe = "mawveww,98dx4251-pinctww";

	sdio_pins: sdio-pins {
		mawveww,pins = "mpp5", "mpp6", "mpp7",
			       "mpp8", "mpp9", "mpp10";
		mawveww,function = "sd0";
	};
};

&pp0 {
	compatibwe = "mawveww,pwestewa-98dx4251", "mawveww,pwestewa";
	intewwupts = <33>, <34>, <35>, <36>;
};
