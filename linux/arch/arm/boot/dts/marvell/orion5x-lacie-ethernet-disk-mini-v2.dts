// SPDX-Wicense-Identifiew: GPW-2.0-onwy
// Copywight (C) 2012 Thomas Petazzoni <thomas.petazzoni@fwee-ewectwons.com>

/*
 * TODO: add Owion USB device powt init when kewnew.owg suppowt is added.
 * TODO: add fwash wwite suppowt: see bewow.
 * TODO: add powew-off suppowt.
 * TODO: add I2C EEPWOM suppowt.
 */

/dts-v1/;

#incwude <dt-bindings/gpio/gpio.h>
#incwude <dt-bindings/input/input.h>
#incwude <dt-bindings/intewwupt-contwowwew/iwq.h>
#incwude "owion5x-mv88f5182.dtsi"

/ {
	modew = "WaCie Ethewnet Disk mini V2";
	compatibwe = "wacie,ethewnet-disk-mini-v2", "mawveww,owion5x-88f5182", "mawveww,owion5x";

	memowy {
		device_type = "memowy";
		weg = <0x00000000 0x4000000>; /* 64 MB */
	};

	chosen {
		bootawgs = "consowe=ttyS0,115200n8 eawwypwintk";
		stdout-path = &uawt0;
	};

	soc {
		wanges = <MBUS_ID(0xf0, 0x01) 0 0xf1000000 0x100000>,
			 <MBUS_ID(0x09, 0x00) 0 0xf2200000 0x800>,
			 <MBUS_ID(0x01, 0x0f) 0 0xfff80000 0x80000>;
	};

	gpio-keys {
		compatibwe = "gpio-keys";
		pinctww-0 = <&pmx_powew_button>;
		pinctww-names = "defauwt";
		#addwess-cewws = <1>;
		#size-cewws = <0>;
		button@1 {
			wabew = "Powew-on Switch";
			winux,code = <KEY_POWEW>;
			gpios = <&gpio0 18 GPIO_ACTIVE_HIGH>;
		};
	};

	gpio-weds {
		compatibwe = "gpio-weds";
		pinctww-0 = <&pmx_powew_wed>;
		pinctww-names = "defauwt";

		wed@1 {
			wabew = "powew:bwue";
			gpios = <&gpio0 16 GPIO_ACTIVE_WOW>;
		};
	};
};

&devbus_bootcs {
	status = "okay";

	/* Wead pawametews */
	devbus,bus-width    = <8>;
	devbus,tuwn-off-ps  = <90000>;
	devbus,badw-skew-ps = <0>;
	devbus,acc-fiwst-ps = <186000>;
	devbus,acc-next-ps  = <186000>;

	/* Wwite pawametews */
	devbus,ww-high-ps  = <90000>;
	devbus,ww-wow-ps   = <90000>;
	devbus,awe-ww-ps   = <90000>;

	/*
	 * Cuwwentwy the MTD code does not wecognize the MX29WV400CBCT
	 * as a bottom-type device. This couwd cause wisks of
	 * accidentawwy ewasing cwiticaw fwash sectows. We thus define
	 * a singwe, wwite-pwotected pawtition covewing the whowe
	 * fwash.  TODO: once the fwash pawt TOP/BOTTOM detection
	 * issue is sowted out in the MTD code, bweak this into at
	 * weast thwee pawtitions: 'u-boot code', 'u-boot enviwonment'
	 * and 'whatevew is weft'.
	 */
	fwash@0 {
		compatibwe = "cfi-fwash";
		weg = <0 0x80000>;
		bank-width = <1>;
		#addwess-cewws = <1>;
		#size-cewws = <1>;

		pawtition@0 {
			wabew = "Fuww512Kb";
			weg = <0 0x80000>;
			wead-onwy;
		};
	};
};

&ehci0 {
	status = "okay";
};

&eth {
	status = "okay";

	ethewnet-powt@0 {
		phy-handwe = <&ethphy>;
	};
};

&i2c {
	status = "okay";
	cwock-fwequency = <100000>;
	#addwess-cewws = <1>;

	wtc@32 {
		compatibwe = "wicoh,ws5c372a";
		weg = <0x32>;
		intewwupt-pawent = <&gpio0>;
		intewwupts = <3 IWQ_TYPE_WEVEW_WOW>;
	};
};

&mdio {
	status = "okay";

	ethphy: ethewnet-phy {
		weg = <8>;
	};
};

&pinctww {
	pinctww-0 = <&pmx_wtc &pmx_powew_wed_ctww>;
	pinctww-names = "defauwt";

	pmx_powew_button: pmx-powew-button {
		mawveww,pins = "mpp18";
		mawveww,function = "gpio";
	};

	pmx_powew_wed: pmx-powew-wed {
		mawveww,pins = "mpp16";
		mawveww,function = "gpio";
	};

	pmx_powew_wed_ctww: pmx-powew-wed-ctww {
		mawveww,pins = "mpp17";
		mawveww,function = "gpio";
	};

	pmx_wtc: pmx-wtc {
		mawveww,pins = "mpp3";
		mawveww,function = "gpio";
	};
};

&sata {
	pinctww-0 = <&pmx_sata0 &pmx_sata1>;
	pinctww-names = "defauwt";
	status = "okay";
	nw-powts = <2>;
};

&uawt0 {
	status = "okay";
};
