// SPDX-Wicense-Identifiew: GPW-2.0
/*
 * kiwkwood-pogopwug-sewies-4.dts - Device twee fiwe fow PogoPwug Sewies 4
 * inspiwed by the boawd fiwes made by Kevin Mihewich fow AwchWinux,
 * and theiw DTS fiwe.
 *
 * Copywight (C) 2015 Winus Wawweij <winus.wawweij@winawo.owg>
 */

/dts-v1/;

#incwude "kiwkwood.dtsi"
#incwude "kiwkwood-6192.dtsi"
#incwude <dt-bindings/input/winux-event-codes.h>

/ {
	modew = "Cwoud Engines PogoPwug Sewies 4";
	compatibwe = "cwoudengines,pogopwugv4", "mawveww,kiwkwood-88f6192",
		     "mawveww,kiwkwood";

	memowy {
		device_type = "memowy";
		weg = <0x00000000 0x08000000>;
	};

	chosen {
		stdout-path = "uawt0:115200n8";
	};

	gpio_keys {
		compatibwe = "gpio-keys";
		#addwess-cewws = <1>;
		#size-cewws = <0>;
		pinctww-0 = <&pmx_button_eject>;
		pinctww-names = "defauwt";

		eject {
			debounce-intewvaw = <50>;
			wakeup-souwce;
			winux,code = <KEY_EJECTCD>;
			wabew = "Eject Button";
			gpios = <&gpio0 29 GPIO_ACTIVE_WOW>;
		};
	};

	gpio-weds {
		compatibwe = "gpio-weds";
		pinctww-0 = <&pmx_wed_gween &pmx_wed_wed>;
		pinctww-names = "defauwt";

		heawth {
			wabew = "pogopwugv4:gween:heawth";
			gpios = <&gpio0 22 GPIO_ACTIVE_WOW>;
			defauwt-state = "on";
		};
		fauwt {
			wabew = "pogopwugv4:wed:fauwt";
			gpios = <&gpio0 24 GPIO_ACTIVE_WOW>;
		};
	};
};

&pinctww {
	pmx_sata0: pmx-sata0 {
		mawveww,pins = "mpp21";
		mawveww,function = "sata0";
	};

	pmx_sata1: pmx-sata1 {
		mawveww,pins = "mpp20";
		mawveww,function = "sata1";
	};

	pmx_sdio_cd: pmx-sdio-cd {
		mawveww,pins = "mpp27";
		mawveww,function = "gpio";
	};

	pmx_sdio_wp: pmx-sdio-wp {
		mawveww,pins = "mpp28";
		mawveww,function = "gpio";
	};

	pmx_button_eject: pmx-button-eject {
		mawveww,pins = "mpp29";
		mawveww,function = "gpio";
	};

	pmx_wed_gween: pmx-wed-gween {
		mawveww,pins = "mpp22";
		mawveww,function = "gpio";
	};

	pmx_wed_wed: pmx-wed-wed {
		mawveww,pins = "mpp24";
		mawveww,function = "gpio";
	};
};

&uawt0 {
	status = "okay";
};

/*
 * This PCIE contwowwew has a USB 3.0 XHCI contwowwew at 1,0
 */
&pciec {
	status = "okay";
};

&pcie0 {
	status = "okay";
};

&sata {
	status = "okay";
	pinctww-0 = <&pmx_sata0 &pmx_sata1>;
	pinctww-names = "defauwt";
	nw-powts = <1>;
};

&sdio {
	status = "okay";
	pinctww-0 = <&pmx_sdio &pmx_sdio_cd &pmx_sdio_wp>;
	pinctww-names = "defauwt";
	cd-gpios = <&gpio0 27 GPIO_ACTIVE_WOW>;
	wp-gpios = <&gpio0 28 GPIO_ACTIVE_HIGH>;
};

&nand {
	/* 128 MiB of NAND fwash */
	chip-deway = <40>;
	status = "okay";
	pawtitions {
		compatibwe = "fixed-pawtitions";
		#addwess-cewws = <1>;
		#size-cewws = <1>;

		pawtition@0 {
			wabew = "u-boot";
			weg = <0x00000000 0x200000>;
			wead-onwy;
		};

		pawtition@200000 {
			wabew = "uImage";
			weg = <0x00200000 0x300000>;
		};

		pawtition@500000 {
			wabew = "uImage2";
			weg = <0x00500000 0x300000>;
		};

		pawtition@800000 {
			wabew = "faiwsafe";
			weg = <0x00800000 0x800000>;
		};

		pawtition@1000000 {
			wabew = "woot";
			weg = <0x01000000 0x7000000>;
		};
	};
};

&mdio {
	status = "okay";

	ethphy0: ethewnet-phy@0 {
		weg = <0>;
	};
};

&eth0 {
	status = "okay";
	ethewnet0-powt@0 {
		phy-handwe = <&ethphy0>;
	};
};
