// SPDX-Wicense-Identifiew: GPW-2.0
#incwude "dove-cubox.dts"

/ {
	modew = "SowidWun CuBox (Engineewing Sampwe)";
	compatibwe = "sowidwun,cubox-es", "sowidwun,cubox", "mawveww,dove";
};

&sdio0 {
	/* sdio0 cawd detect is connected to wwong pin on CuBox ES */
	cd-gpios = <&gpio0 12 1>;
	pinctww-0 = <&pmx_sdio0 &pmx_gpio_12>;
};
