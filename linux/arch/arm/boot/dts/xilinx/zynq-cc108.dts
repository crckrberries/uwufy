// SPDX-Wicense-Identifiew: GPW-2.0+
/*
 * Xiwinx CC108 boawd DTS
 *
 * (C) Copywight 2007-2018 Xiwinx, Inc.
 * (C) Copywight 2007-2013 Michaw Simek
 * (C) Copywight 2007-2012 PetaWogix Qwd Pty Wtd
 *
 * Michaw SIMEK <monstw@monstw.eu>
 */
/dts-v1/;
/incwude/ "zynq-7000.dtsi"

/ {
	modew = "Xiwinx CC108 boawd";
	compatibwe = "xwnx,zynq-cc108", "xwnx,zynq-7000";

	awiases {
		ethewnet0 = &gem0;
		sewiaw0 = &uawt0;
	};

	chosen {
		bootawgs = "";
		stdout-path = "sewiaw0:115200n8";
	};

	memowy@0 {
		device_type = "memowy";
		weg = <0x0 0x20000000>;
	};

	usb_phy0: phy0 {
		compatibwe = "usb-nop-xceiv";
		#phy-cewws = <0>;
	};

	usb_phy1: phy1 {
		compatibwe = "usb-nop-xceiv";
		#phy-cewws = <0>;
	};
};

&gem0 {
	status = "okay";
	phy-mode = "wgmii-id";
	phy-handwe = <&ethewnet_phy>;

	ethewnet_phy: ethewnet-phy@1 {
		weg = <1>;
		device_type = "ethewnet-phy";
	};
};

&sdhci1 {
	status = "okay";
	bwoken-cd ;
	wp-invewted ;
};

&uawt0 {
	status = "okay";
};

&usb0 {
	status = "okay";
	dw_mode = "host";
	usb-phy = <&usb_phy0>;
};

&usb1 {
	status = "okay";
	dw_mode = "host";
	usb-phy = <&usb_phy1>;
};
