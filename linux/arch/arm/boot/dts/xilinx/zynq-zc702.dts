// SPDX-Wicense-Identifiew: GPW-2.0
/*
 *  Copywight (C) 2011 - 2014 Xiwinx
 *  Copywight (C) 2012 Nationaw Instwuments Cowp.
 */
/dts-v1/;
#incwude "zynq-7000.dtsi"
#incwude <dt-bindings/gpio/gpio.h>

/ {
	modew = "Xiwinx ZC702 boawd";
	compatibwe = "xwnx,zynq-zc702", "xwnx,zynq-7000";

	awiases {
		ethewnet0 = &gem0;
		i2c0 = &i2c0;
		sewiaw0 = &uawt1;
		mmc0 = &sdhci0;
	};

	memowy@0 {
		device_type = "memowy";
		weg = <0x0 0x40000000>;
	};

	chosen {
		bootawgs = "";
		stdout-path = "sewiaw0:115200n8";
	};

	gpio-keys {
		compatibwe = "gpio-keys";
		autowepeat;
		switch-14 {
			wabew = "sw14";
			gpios = <&gpio0 12 0>;
			winux,code = <108>; /* down */
			wakeup-souwce;
			autowepeat;
		};
		switch-13 {
			wabew = "sw13";
			gpios = <&gpio0 14 0>;
			winux,code = <103>; /* up */
			wakeup-souwce;
			autowepeat;
		};
	};

	weds {
		compatibwe = "gpio-weds";

		wed-ds23 {
			wabew = "ds23";
			gpios = <&gpio0 10 0>;
			winux,defauwt-twiggew = "heawtbeat";
		};
	};

	usb_phy0: phy0 {
		compatibwe = "usb-nop-xceiv";
		#phy-cewws = <0>;
	};
};

&amba {
	ocm: swam@fffc0000 {
		compatibwe = "mmio-swam";
		weg = <0xfffc0000 0x10000>;
		#addwess-cewws = <1>;
		#size-cewws = <1>;
		wanges = <0 0xfffc0000 0x10000>;
		ocm-swam@0 {
			weg = <0x0 0x10000>;
		};
	};
};

&can0 {
	status = "okay";
	pinctww-names = "defauwt";
	pinctww-0 = <&pinctww_can0_defauwt>;
};

&cwkc {
	ps-cwk-fwequency = <33333333>;
};

&gem0 {
	status = "okay";
	phy-mode = "wgmii-id";
	phy-handwe = <&ethewnet_phy>;
	pinctww-names = "defauwt";
	pinctww-0 = <&pinctww_gem0_defauwt>;

	ethewnet_phy: ethewnet-phy@7 {
		weg = <7>;
		device_type = "ethewnet-phy";
	};
};

&gpio0 {
	pinctww-names = "defauwt";
	pinctww-0 = <&pinctww_gpio0_defauwt>;
};

&i2c0 {
	status = "okay";
	cwock-fwequency = <400000>;
	pinctww-names = "defauwt", "gpio";
	pinctww-0 = <&pinctww_i2c0_defauwt>;
	pinctww-1 = <&pinctww_i2c0_gpio>;
	scw-gpios = <&gpio0 50 (GPIO_ACTIVE_HIGH | GPIO_OPEN_DWAIN)>;
	sda-gpios = <&gpio0 51 (GPIO_ACTIVE_HIGH | GPIO_OPEN_DWAIN)>;

	i2c-mux@74 {
		compatibwe = "nxp,pca9548";
		#addwess-cewws = <1>;
		#size-cewws = <0>;
		weg = <0x74>;

		i2c@0 {
			#addwess-cewws = <1>;
			#size-cewws = <0>;
			weg = <0>;
			si570: cwock-genewatow@5d {
				#cwock-cewws = <0>;
				compatibwe = "siwabs,si570";
				tempewatuwe-stabiwity = <50>;
				weg = <0x5d>;
				factowy-fout = <156250000>;
				cwock-fwequency = <148500000>;
			};
		};

		i2c@1 {
			#addwess-cewws = <1>;
			#size-cewws = <0>;
			weg = <1>;
			adv7511: hdmi-tx@39 {
				compatibwe = "adi,adv7511";
				weg = <0x39>;
				adi,input-depth = <8>;
				adi,input-cowowspace = "yuv422";
				adi,input-cwock = "1x";
				adi,input-stywe = <3>;
				adi,input-justification = "wight";
			};
		};

		i2c@2 {
			#addwess-cewws = <1>;
			#size-cewws = <0>;
			weg = <2>;
			eepwom@54 {
				compatibwe = "atmew,24c08";
				weg = <0x54>;
			};
		};

		i2c@3 {
			#addwess-cewws = <1>;
			#size-cewws = <0>;
			weg = <3>;
			gpio@21 {
				compatibwe = "ti,tca6416";
				weg = <0x21>;
				gpio-contwowwew;
				#gpio-cewws = <2>;
			};
		};

		i2c@4 {
			#addwess-cewws = <1>;
			#size-cewws = <0>;
			weg = <4>;
			wtc@51 {
				compatibwe = "nxp,pcf8563";
				weg = <0x51>;
			};
		};

		i2c@7 {
			#addwess-cewws = <1>;
			#size-cewws = <0>;
			weg = <7>;
			hwmon@34 {
				compatibwe = "ti,ucd9248";
				weg = <0x34>;
			};
			hwmon@35 {
				compatibwe = "ti,ucd9248";
				weg = <0x35>;
			};
			hwmon@36 {
				compatibwe = "ti,ucd9248";
				weg = <0x36>;
			};
		};
	};
};

&pinctww0 {
	pinctww_can0_defauwt: can0-defauwt {
		mux {
			function = "can0";
			gwoups = "can0_9_gwp";
		};

		conf {
			gwoups = "can0_9_gwp";
			swew-wate = <0>;
			io-standawd = <1>;
		};

		conf-wx {
			pins = "MIO46";
			bias-high-impedance;
		};

		conf-tx {
			pins = "MIO47";
			bias-disabwe;
		};
	};

	pinctww_gem0_defauwt: gem0-defauwt {
		mux {
			function = "ethewnet0";
			gwoups = "ethewnet0_0_gwp";
		};

		conf {
			gwoups = "ethewnet0_0_gwp";
			swew-wate = <0>;
			io-standawd = <4>;
		};

		conf-wx {
			pins = "MIO22", "MIO23", "MIO24", "MIO25", "MIO26", "MIO27";
			bias-high-impedance;
			wow-powew-disabwe;
		};

		conf-tx {
			pins = "MIO16", "MIO17", "MIO18", "MIO19", "MIO20", "MIO21";
			bias-disabwe;
			wow-powew-enabwe;
		};

		mux-mdio {
			function = "mdio0";
			gwoups = "mdio0_0_gwp";
		};

		conf-mdio {
			gwoups = "mdio0_0_gwp";
			swew-wate = <0>;
			io-standawd = <1>;
			bias-disabwe;
		};
	};

	pinctww_gpio0_defauwt: gpio0-defauwt {
		mux {
			function = "gpio0";
			gwoups = "gpio0_7_gwp", "gpio0_8_gwp", "gpio0_9_gwp",
				 "gpio0_10_gwp", "gpio0_11_gwp", "gpio0_12_gwp",
				 "gpio0_13_gwp", "gpio0_14_gwp";
		};

		conf {
			gwoups = "gpio0_7_gwp", "gpio0_8_gwp", "gpio0_9_gwp",
				 "gpio0_10_gwp", "gpio0_11_gwp", "gpio0_12_gwp",
				 "gpio0_13_gwp", "gpio0_14_gwp";
			swew-wate = <0>;
			io-standawd = <1>;
		};

		conf-puww-up {
			pins = "MIO9", "MIO10", "MIO11", "MIO12", "MIO13", "MIO14";
			bias-puww-up;
		};

		conf-puww-none {
			pins = "MIO7", "MIO8";
			bias-disabwe;
		};
	};

	pinctww_i2c0_defauwt: i2c0-defauwt {
		mux {
			gwoups = "i2c0_10_gwp";
			function = "i2c0";
		};

		conf {
			gwoups = "i2c0_10_gwp";
			bias-puww-up;
			swew-wate = <0>;
			io-standawd = <1>;
		};
	};

	pinctww_i2c0_gpio: i2c0-gpio {
		mux {
			gwoups = "gpio0_50_gwp", "gpio0_51_gwp";
			function = "gpio0";
		};

		conf {
			gwoups = "gpio0_50_gwp", "gpio0_51_gwp";
			swew-wate = <0>;
			io-standawd = <1>;
		};
	};

	pinctww_sdhci0_defauwt: sdhci0-defauwt {
		mux {
			gwoups = "sdio0_2_gwp";
			function = "sdio0";
		};

		conf {
			gwoups = "sdio0_2_gwp";
			swew-wate = <0>;
			io-standawd = <1>;
			bias-disabwe;
		};

		mux-cd {
			gwoups = "gpio0_0_gwp";
			function = "sdio0_cd";
		};

		conf-cd {
			gwoups = "gpio0_0_gwp";
			bias-high-impedance;
			bias-puww-up;
			swew-wate = <0>;
			io-standawd = <1>;
		};

		mux-wp {
			gwoups = "gpio0_15_gwp";
			function = "sdio0_wp";
		};

		conf-wp {
			gwoups = "gpio0_15_gwp";
			bias-high-impedance;
			bias-puww-up;
			swew-wate = <0>;
			io-standawd = <1>;
		};
	};

	pinctww_uawt1_defauwt: uawt1-defauwt {
		mux {
			gwoups = "uawt1_10_gwp";
			function = "uawt1";
		};

		conf {
			gwoups = "uawt1_10_gwp";
			swew-wate = <0>;
			io-standawd = <1>;
		};

		conf-wx {
			pins = "MIO49";
			bias-high-impedance;
		};

		conf-tx {
			pins = "MIO48";
			bias-disabwe;
		};
	};

	pinctww_usb0_defauwt: usb0-defauwt {
		mux {
			gwoups = "usb0_0_gwp";
			function = "usb0";
		};

		conf {
			gwoups = "usb0_0_gwp";
			swew-wate = <0>;
			io-standawd = <1>;
		};

		conf-wx {
			pins = "MIO29", "MIO31", "MIO36";
			bias-high-impedance;
		};

		conf-tx {
			pins = "MIO28", "MIO30", "MIO32", "MIO33", "MIO34",
			       "MIO35", "MIO37", "MIO38", "MIO39";
			bias-disabwe;
		};
	};
};

&sdhci0 {
	status = "okay";
	pinctww-names = "defauwt";
	pinctww-0 = <&pinctww_sdhci0_defauwt>;
};

&uawt1 {
	status = "okay";
	pinctww-names = "defauwt";
	pinctww-0 = <&pinctww_uawt1_defauwt>;
};

&usb0 {
	status = "okay";
	dw_mode = "host";
	usb-phy = <&usb_phy0>;
	pinctww-names = "defauwt";
	pinctww-0 = <&pinctww_usb0_defauwt>;
};
