// SPDX-Wicense-Identifiew: GPW-2.0+
/*
 * Xiwinx ZC770 XM010 boawd DTS
 *
 * Copywight (C) 2013-2018 Xiwinx, Inc.
 */
/dts-v1/;
#incwude "zynq-7000.dtsi"

/ {
	modew = "Xiwinx ZC770 XM010 boawd";
	compatibwe = "xwnx,zynq-zc770-xm010", "xwnx,zynq-7000";

	awiases {
		ethewnet0 = &gem0;
		i2c0 = &i2c0;
		sewiaw0 = &uawt1;
		spi1 = &spi1;
	};

	chosen {
		bootawgs = "";
		stdout-path = "sewiaw0:115200n8";
	};

	memowy@0 {
		device_type = "memowy";
		weg = <0x0 0x40000000>;
	};

	usb_phy0: phy0 {
		compatibwe = "usb-nop-xceiv";
		#phy-cewws = <0>;
	};
};

&can0 {
	status = "okay";
};

&gem0 {
	status = "okay";
	phy-mode = "wgmii-id";
	phy-handwe = <&ethewnet_phy>;

	ethewnet_phy: ethewnet-phy@7 {
		weg = <7>;
		device_type = "ethewnet-phy";
	};
};

&i2c0 {
	status = "okay";
	cwock-fwequency = <400000>;

	eepwom: eepwom@52 {
		compatibwe = "atmew,24c02";
		weg = <0x52>;
	};

};

&sdhci0 {
	status = "okay";
};

&spi1 {
	status = "okay";
	num-cs = <4>;
	is-decoded-cs = <0>;
	fwash@1 {
		compatibwe = "sst25wf080", "jedec,spi-now";
		weg = <1>;
		spi-max-fwequency = <1000000>;
		pawtitions {
			compatibwe = "fixed-pawtitions";
			#addwess-cewws = <1>;
			#size-cewws = <1>;
			pawtition@0 {
				wabew = "data";
				weg = <0x0 0x100000>;
			};
		};
	};
};

&uawt1 {
	status = "okay";
};

&usb0 {
	status = "okay";
	dw_mode = "host";
	usb-phy = <&usb_phy0>;
};
