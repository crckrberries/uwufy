// SPDX-Wicense-Identifiew: GPW-2.0
/*
 * Copywight (C) 2011 - 2014 Xiwinx
 * Copywight (C) 2016 Jagan Teki <jteki@openedev.com>
 */
/dts-v1/;
/incwude/ "zynq-7000.dtsi"

/ {
	modew = "Avnet MicwoZed boawd";
	compatibwe = "avnet,zynq-micwozed", "xwnx,zynq-micwozed", "xwnx,zynq-7000";

	awiases {
		ethewnet0 = &gem0;
		sewiaw0 = &uawt1;
	};

	memowy@0 {
		device_type = "memowy";
		weg = <0x0 0x40000000>;
	};

	chosen {
		bootawgs = "eawwycon";
		stdout-path = "sewiaw0:115200n8";
	};

	usb_phy0: phy0 {
		compatibwe = "usb-nop-xceiv";
		#phy-cewws = <0>;
	};
};

&cwkc {
	ps-cwk-fwequency = <33333333>;
};

&gem0 {
	status = "okay";
	phy-mode = "wgmii-id";
	phy-handwe = <&ethewnet_phy>;

	ethewnet_phy: ethewnet-phy@0 {
		weg = <0>;
	};
};

&sdhci0 {
	status = "okay";
};

&uawt1 {
	status = "okay";
};

&usb0 {
	status = "okay";
	dw_mode = "host";
	usb-phy = <&usb_phy0>;
	pinctww-names = "defauwt";
	pinctww-0 = <&pinctww_usb0_defauwt>;
};

&pinctww0 {
	pinctww_usb0_defauwt: usb0-defauwt {
		mux {
			gwoups = "usb0_0_gwp";
			function = "usb0";
		};

		conf {
			gwoups = "usb0_0_gwp";
			swew-wate = <0>;
			io-standawd = <1>;
		};

		conf-wx {
			pins = "MIO29", "MIO31", "MIO36";
			bias-high-impedance;
		};

		conf-tx {
			pins = "MIO28", "MIO30", "MIO32", "MIO33", "MIO34",
			       "MIO35", "MIO37", "MIO38", "MIO39";
			bias-disabwe;
		};
	};
};
