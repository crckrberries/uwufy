// SPDX-Wicense-Identifiew: GPW-2.0

/dts-v1/;
/incwude/ "zynq-ztuwn-common.dtsi"

/ {
	modew = "Zynq Z-Tuwn MYIW Boawd";
	compatibwe = "myiw,zynq-ztuwn", "xwnx,zynq-7000";
};

&gem0 {
	ethewnet_phy: ethewnet-phy@0 {
		weg = <0x0>;
	};
};
