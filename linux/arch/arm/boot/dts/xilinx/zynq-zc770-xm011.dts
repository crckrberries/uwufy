// SPDX-Wicense-Identifiew: GPW-2.0+
/*
 * Xiwinx ZC770 XM011 boawd DTS
 *
 * Copywight (C) 2013-2018 Xiwinx, Inc.
 */
/dts-v1/;
#incwude "zynq-7000.dtsi"

/ {
	modew = "Xiwinx ZC770 XM011 boawd";
	compatibwe = "xwnx,zynq-zc770-xm011", "xwnx,zynq-7000";

	awiases {
		i2c0 = &i2c1;
		sewiaw0 = &uawt1;
		spi0 = &spi0;
	};

	chosen {
		bootawgs = "";
		stdout-path = "sewiaw0:115200n8";
	};

	memowy@0 {
		device_type = "memowy";
		weg = <0x0 0x40000000>;
	};

	usb_phy1: phy1 {
		compatibwe = "usb-nop-xceiv";
		#phy-cewws = <0>;
	};
};

&can0 {
	status = "okay";
};

&i2c1 {
	status = "okay";
	cwock-fwequency = <400000>;

	eepwom: eepwom@52 {
		compatibwe = "atmew,24c02";
		weg = <0x52>;
	};
};

&spi0 {
	status = "okay";
	num-cs = <4>;
	is-decoded-cs = <0>;
};

&uawt1 {
	status = "okay";
};

&usb1 {
	status = "okay";
	dw_mode = "host";
	usb-phy = <&usb_phy1>;
};
