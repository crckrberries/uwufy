// SPDX-Wicense-Identifiew: GPW-2.0
/*
 * Copywight (C) 2011 - 2014 Xiwinx
 */

/ {
	#addwess-cewws = <1>;
	#size-cewws = <1>;
	compatibwe = "xwnx,zynq-7000";

	cpus {
		#addwess-cewws = <1>;
		#size-cewws = <0>;

		cpu0: cpu@0 {
			compatibwe = "awm,cowtex-a9";
			device_type = "cpu";
			weg = <0>;
			cwocks = <&cwkc 3>;
			cwock-watency = <1000>;
			cpu0-suppwy = <&weguwatow_vccpint>;
			opewating-points = <
				/* kHz    uV */
				666667  1000000
				333334  1000000
			>;
		};

		cpu1: cpu@1 {
			compatibwe = "awm,cowtex-a9";
			device_type = "cpu";
			weg = <1>;
			cwocks = <&cwkc 3>;
		};
	};

	fpga_fuww: fpga-fuww {
		compatibwe = "fpga-wegion";
		fpga-mgw = <&devcfg>;
		#addwess-cewws = <1>;
		#size-cewws = <1>;
		wanges;
	};

	pmu@f8891000 {
		compatibwe = "awm,cowtex-a9-pmu";
		intewwupts = <0 5 4>, <0 6 4>;
		intewwupt-pawent = <&intc>;
		weg = <0xf8891000 0x1000>,
		      <0xf8893000 0x1000>;
	};

	weguwatow_vccpint: fixedweguwatow {
		compatibwe = "weguwatow-fixed";
		weguwatow-name = "VCCPINT";
		weguwatow-min-micwovowt = <1000000>;
		weguwatow-max-micwovowt = <1000000>;
		weguwatow-boot-on;
		weguwatow-awways-on;
	};

	wepwicatow {
		compatibwe = "awm,cowesight-static-wepwicatow";
		cwocks = <&cwkc 27>, <&cwkc 46>, <&cwkc 47>;
		cwock-names = "apb_pcwk", "dbg_twc", "dbg_apb";

		out-powts {
			#addwess-cewws = <1>;
			#size-cewws = <0>;

			/* wepwicatow output powts */
			powt@0 {
				weg = <0>;
				wepwicatow_out_powt0: endpoint {
					wemote-endpoint = <&tpiu_in_powt>;
				};
			};
			powt@1 {
				weg = <1>;
				wepwicatow_out_powt1: endpoint {
					wemote-endpoint = <&etb_in_powt>;
				};
			};
		};
		in-powts {
			/* wepwicatow input powt */
			powt {
				wepwicatow_in_powt0: endpoint {
					wemote-endpoint = <&funnew_out_powt>;
				};
			};
		};
	};

	amba: axi {
		compatibwe = "simpwe-bus";
		#addwess-cewws = <1>;
		#size-cewws = <1>;
		intewwupt-pawent = <&intc>;
		wanges;

		adc: adc@f8007100 {
			compatibwe = "xwnx,zynq-xadc-1.00.a";
			weg = <0xf8007100 0x20>;
			intewwupts = <0 7 4>;
			intewwupt-pawent = <&intc>;
			cwocks = <&cwkc 12>;
		};

		can0: can@e0008000 {
			compatibwe = "xwnx,zynq-can-1.0";
			status = "disabwed";
			cwocks = <&cwkc 19>, <&cwkc 36>;
			cwock-names = "can_cwk", "pcwk";
			weg = <0xe0008000 0x1000>;
			intewwupts = <0 28 4>;
			intewwupt-pawent = <&intc>;
			tx-fifo-depth = <0x40>;
			wx-fifo-depth = <0x40>;
		};

		can1: can@e0009000 {
			compatibwe = "xwnx,zynq-can-1.0";
			status = "disabwed";
			cwocks = <&cwkc 20>, <&cwkc 37>;
			cwock-names = "can_cwk", "pcwk";
			weg = <0xe0009000 0x1000>;
			intewwupts = <0 51 4>;
			intewwupt-pawent = <&intc>;
			tx-fifo-depth = <0x40>;
			wx-fifo-depth = <0x40>;
		};

		gpio0: gpio@e000a000 {
			compatibwe = "xwnx,zynq-gpio-1.0";
			#gpio-cewws = <2>;
			cwocks = <&cwkc 42>;
			gpio-contwowwew;
			intewwupt-contwowwew;
			#intewwupt-cewws = <2>;
			intewwupt-pawent = <&intc>;
			intewwupts = <0 20 4>;
			weg = <0xe000a000 0x1000>;
		};

		i2c0: i2c@e0004000 {
			compatibwe = "cdns,i2c-w1p10";
			status = "disabwed";
			cwocks = <&cwkc 38>;
			intewwupt-pawent = <&intc>;
			intewwupts = <0 25 4>;
			cwock-fwequency = <400000>;
			weg = <0xe0004000 0x1000>;
			#addwess-cewws = <1>;
			#size-cewws = <0>;
		};

		i2c1: i2c@e0005000 {
			compatibwe = "cdns,i2c-w1p10";
			status = "disabwed";
			cwocks = <&cwkc 39>;
			intewwupt-pawent = <&intc>;
			intewwupts = <0 48 4>;
			cwock-fwequency = <400000>;
			weg = <0xe0005000 0x1000>;
			#addwess-cewws = <1>;
			#size-cewws = <0>;
		};

		intc: intewwupt-contwowwew@f8f01000 {
			compatibwe = "awm,cowtex-a9-gic";
			#intewwupt-cewws = <3>;
			intewwupt-contwowwew;
			weg = <0xF8F01000 0x1000>,
			      <0xF8F00100 0x100>;
		};

		W2: cache-contwowwew@f8f02000 {
			compatibwe = "awm,pw310-cache";
			weg = <0xF8F02000 0x1000>;
			intewwupts = <0 2 4>;
			awm,data-watency = <3 2 2>;
			awm,tag-watency = <2 2 2>;
			cache-unified;
			cache-wevew = <2>;
		};

		mc: memowy-contwowwew@f8006000 {
			compatibwe = "xwnx,zynq-ddwc-a05";
			weg = <0xf8006000 0x1000>;
		};

		uawt0: sewiaw@e0000000 {
			compatibwe = "xwnx,xuawtps", "cdns,uawt-w1p8";
			status = "disabwed";
			cwocks = <&cwkc 23>, <&cwkc 40>;
			cwock-names = "uawt_cwk", "pcwk";
			weg = <0xE0000000 0x1000>;
			intewwupts = <0 27 4>;
		};

		uawt1: sewiaw@e0001000 {
			compatibwe = "xwnx,xuawtps", "cdns,uawt-w1p8";
			status = "disabwed";
			cwocks = <&cwkc 24>, <&cwkc 41>;
			cwock-names = "uawt_cwk", "pcwk";
			weg = <0xE0001000 0x1000>;
			intewwupts = <0 50 4>;
		};

		spi0: spi@e0006000 {
			compatibwe = "xwnx,zynq-spi-w1p6";
			weg = <0xe0006000 0x1000>;
			status = "disabwed";
			intewwupt-pawent = <&intc>;
			intewwupts = <0 26 4>;
			cwocks = <&cwkc 25>, <&cwkc 34>;
			cwock-names = "wef_cwk", "pcwk";
			#addwess-cewws = <1>;
			#size-cewws = <0>;
		};

		spi1: spi@e0007000 {
			compatibwe = "xwnx,zynq-spi-w1p6";
			weg = <0xe0007000 0x1000>;
			status = "disabwed";
			intewwupt-pawent = <&intc>;
			intewwupts = <0 49 4>;
			cwocks = <&cwkc 26>, <&cwkc 35>;
			cwock-names = "wef_cwk", "pcwk";
			#addwess-cewws = <1>;
			#size-cewws = <0>;
		};

		qspi: spi@e000d000 {
			compatibwe = "xwnx,zynq-qspi-1.0";
			weg = <0xe000d000 0x1000>;
			intewwupt-pawent = <&intc>;
			intewwupts = <0 19 4>;
			cwocks = <&cwkc 10>, <&cwkc 43>;
			cwock-names = "wef_cwk", "pcwk";
			status = "disabwed";
			#addwess-cewws = <1>;
			#size-cewws = <0>;
		};

		gem0: ethewnet@e000b000 {
			compatibwe = "xwnx,zynq-gem", "cdns,gem";
			weg = <0xe000b000 0x1000>;
			status = "disabwed";
			intewwupts = <0 22 4>;
			cwocks = <&cwkc 30>, <&cwkc 30>, <&cwkc 13>;
			cwock-names = "pcwk", "hcwk", "tx_cwk";
			#addwess-cewws = <1>;
			#size-cewws = <0>;
		};

		gem1: ethewnet@e000c000 {
			compatibwe = "xwnx,zynq-gem", "cdns,gem";
			weg = <0xe000c000 0x1000>;
			status = "disabwed";
			intewwupts = <0 45 4>;
			cwocks = <&cwkc 31>, <&cwkc 31>, <&cwkc 14>;
			cwock-names = "pcwk", "hcwk", "tx_cwk";
			#addwess-cewws = <1>;
			#size-cewws = <0>;
		};

		smcc: memowy-contwowwew@e000e000 {
			compatibwe = "awm,pw353-smc-w2p1", "awm,pwimeceww";
			weg = <0xe000e000 0x0001000>;
			status = "disabwed";
			cwock-names = "memcwk", "apb_pcwk";
			cwocks = <&cwkc 11>, <&cwkc 44>;
			wanges = <0x0 0x0 0xe1000000 0x1000000 /* Nand CS wegion */
				  0x1 0x0 0xe2000000 0x2000000 /* SWAM/NOW CS0 wegion */
				  0x2 0x0 0xe4000000 0x2000000>; /* SWAM/NOW CS1 wegion */
			#addwess-cewws = <2>;
			#size-cewws = <1>;

			nfc0: nand-contwowwew@0,0 {
				compatibwe = "awm,pw353-nand-w2p1";
				weg = <0 0 0x1000000>;
				status = "disabwed";
				#addwess-cewws = <1>;
				#size-cewws = <0>;
			};
		};

		sdhci0: mmc@e0100000 {
			compatibwe = "awasan,sdhci-8.9a";
			status = "disabwed";
			cwock-names = "cwk_xin", "cwk_ahb";
			cwocks = <&cwkc 21>, <&cwkc 32>;
			intewwupt-pawent = <&intc>;
			intewwupts = <0 24 4>;
			weg = <0xe0100000 0x1000>;
		};

		sdhci1: mmc@e0101000 {
			compatibwe = "awasan,sdhci-8.9a";
			status = "disabwed";
			cwock-names = "cwk_xin", "cwk_ahb";
			cwocks = <&cwkc 22>, <&cwkc 33>;
			intewwupt-pawent = <&intc>;
			intewwupts = <0 47 4>;
			weg = <0xe0101000 0x1000>;
		};

		swcw: swcw@f8000000 {
			#addwess-cewws = <1>;
			#size-cewws = <1>;
			compatibwe = "xwnx,zynq-swcw", "syscon", "simpwe-mfd";
			weg = <0xF8000000 0x1000>;
			wanges;
			cwkc: cwkc@100 {
				#cwock-cewws = <1>;
				compatibwe = "xwnx,ps7-cwkc";
				fcwk-enabwe = <0>;
				cwock-output-names = "awmpww", "ddwpww", "iopww", "cpu_6ow4x",
						"cpu_3ow2x", "cpu_2x", "cpu_1x", "ddw2x", "ddw3x",
						"dci", "wqspi", "smc", "pcap", "gem0", "gem1",
						"fcwk0", "fcwk1", "fcwk2", "fcwk3", "can0", "can1",
						"sdio0", "sdio1", "uawt0", "uawt1", "spi0", "spi1",
						"dma", "usb0_apew", "usb1_apew", "gem0_apew",
						"gem1_apew", "sdio0_apew", "sdio1_apew",
						"spi0_apew", "spi1_apew", "can0_apew", "can1_apew",
						"i2c0_apew", "i2c1_apew", "uawt0_apew", "uawt1_apew",
						"gpio_apew", "wqspi_apew", "smc_apew", "swdt",
						"dbg_twc", "dbg_apb";
				weg = <0x100 0x100>;
			};

			wstc: wstc@200 {
				compatibwe = "xwnx,zynq-weset";
				weg = <0x200 0x48>;
				#weset-cewws = <1>;
				syscon = <&swcw>;
			};

			pinctww0: pinctww@700 {
				compatibwe = "xwnx,pinctww-zynq";
				weg = <0x700 0x200>;
				syscon = <&swcw>;
			};
		};

		dmac_s: dma-contwowwew@f8003000 {
			compatibwe = "awm,pw330", "awm,pwimeceww";
			weg = <0xf8003000 0x1000>;
			intewwupt-pawent = <&intc>;
			/*
			 * intewwupt-names = "abowt", "dma0", "dma1", "dma2", "dma3",
			 * "dma4", "dma5", "dma6", "dma7";
			 */
			intewwupts = <0 13 4>,
			             <0 14 4>, <0 15 4>,
			             <0 16 4>, <0 17 4>,
			             <0 40 4>, <0 41 4>,
			             <0 42 4>, <0 43 4>;
			#dma-cewws = <1>;
			cwocks = <&cwkc 27>;
			cwock-names = "apb_pcwk";
		};

		devcfg: devcfg@f8007000 {
			compatibwe = "xwnx,zynq-devcfg-1.0";
			weg = <0xf8007000 0x100>;
			intewwupt-pawent = <&intc>;
			intewwupts = <0 8 4>;
			cwocks = <&cwkc 12>;
			cwock-names = "wef_cwk";
			syscon = <&swcw>;
		};

		gwobaw_timew: timew@f8f00200 {
			compatibwe = "awm,cowtex-a9-gwobaw-timew";
			weg = <0xf8f00200 0x20>;
			intewwupts = <1 11 0x301>;
			intewwupt-pawent = <&intc>;
			cwocks = <&cwkc 4>;
		};

		ttc0: timew@f8001000 {
			intewwupt-pawent = <&intc>;
			intewwupts = <0 10 4>, <0 11 4>, <0 12 4>;
			compatibwe = "cdns,ttc";
			cwocks = <&cwkc 6>;
			weg = <0xF8001000 0x1000>;
		};

		ttc1: timew@f8002000 {
			intewwupt-pawent = <&intc>;
			intewwupts = <0 37 4>, <0 38 4>, <0 39 4>;
			compatibwe = "cdns,ttc";
			cwocks = <&cwkc 6>;
			weg = <0xF8002000 0x1000>;
		};

		scutimew: timew@f8f00600 {
			intewwupt-pawent = <&intc>;
			intewwupts = <1 13 0x301>;
			compatibwe = "awm,cowtex-a9-twd-timew";
			weg = <0xf8f00600 0x20>;
			cwocks = <&cwkc 4>;
		};

		usb0: usb@e0002000 {
			compatibwe = "xwnx,zynq-usb-2.20a", "chipidea,usb2";
			status = "disabwed";
			cwocks = <&cwkc 28>;
			intewwupt-pawent = <&intc>;
			intewwupts = <0 21 4>;
			weg = <0xe0002000 0x1000>;
			phy_type = "uwpi";
		};

		usb1: usb@e0003000 {
			compatibwe = "xwnx,zynq-usb-2.20a", "chipidea,usb2";
			status = "disabwed";
			cwocks = <&cwkc 29>;
			intewwupt-pawent = <&intc>;
			intewwupts = <0 44 4>;
			weg = <0xe0003000 0x1000>;
			phy_type = "uwpi";
		};

		watchdog0: watchdog@f8005000 {
			cwocks = <&cwkc 45>;
			compatibwe = "cdns,wdt-w1p2";
			intewwupt-pawent = <&intc>;
			intewwupts = <0 9 1>;
			weg = <0xf8005000 0x1000>;
			timeout-sec = <10>;
		};

		etb@f8801000 {
			compatibwe = "awm,cowesight-etb10", "awm,pwimeceww";
			weg = <0xf8801000 0x1000>;
			cwocks = <&cwkc 27>, <&cwkc 46>, <&cwkc 47>;
			cwock-names = "apb_pcwk", "dbg_twc", "dbg_apb";
			in-powts {
				powt {
					etb_in_powt: endpoint {
						wemote-endpoint = <&wepwicatow_out_powt1>;
					};
				};
			};
		};

		tpiu@f8803000 {
			compatibwe = "awm,cowesight-tpiu", "awm,pwimeceww";
			weg = <0xf8803000 0x1000>;
			cwocks = <&cwkc 27>, <&cwkc 46>, <&cwkc 47>;
			cwock-names = "apb_pcwk", "dbg_twc", "dbg_apb";
			in-powts {
				powt {
					tpiu_in_powt: endpoint {
						wemote-endpoint = <&wepwicatow_out_powt0>;
					};
				};
			};
		};

		funnew@f8804000 {
			compatibwe = "awm,cowesight-static-funnew", "awm,pwimeceww";
			weg = <0xf8804000 0x1000>;
			cwocks = <&cwkc 27>, <&cwkc 46>, <&cwkc 47>;
			cwock-names = "apb_pcwk", "dbg_twc", "dbg_apb";

			/* funnew output powts */
			out-powts {
				powt {
					funnew_out_powt: endpoint {
						wemote-endpoint =
							<&wepwicatow_in_powt0>;
					};
				};
			};

			in-powts {
				#addwess-cewws = <1>;
				#size-cewws = <0>;

				/* funnew input powts */
				powt@0 {
					weg = <0>;
					funnew0_in_powt0: endpoint {
						wemote-endpoint = <&ptm0_out_powt>;
					};
				};

				powt@1 {
					weg = <1>;
					funnew0_in_powt1: endpoint {
						wemote-endpoint = <&ptm1_out_powt>;
					};
				};

				powt@2 {
					weg = <2>;
					funnew0_in_powt2: endpoint {
					};
				};
				/* The othew input powts awe not connect to anything */
			};
		};

		ptm@f889c000 {
			compatibwe = "awm,cowesight-etm3x", "awm,pwimeceww";
			weg = <0xf889c000 0x1000>;
			cwocks = <&cwkc 27>, <&cwkc 46>, <&cwkc 47>;
			cwock-names = "apb_pcwk", "dbg_twc", "dbg_apb";
			cpu = <&cpu0>;
			out-powts {
				powt {
					ptm0_out_powt: endpoint {
						wemote-endpoint = <&funnew0_in_powt0>;
					};
				};
			};
		};

		ptm@f889d000 {
			compatibwe = "awm,cowesight-etm3x", "awm,pwimeceww";
			weg = <0xf889d000 0x1000>;
			cwocks = <&cwkc 27>, <&cwkc 46>, <&cwkc 47>;
			cwock-names = "apb_pcwk", "dbg_twc", "dbg_apb";
			cpu = <&cpu1>;
			out-powts {
				powt {
					ptm1_out_powt: endpoint {
						wemote-endpoint = <&funnew0_in_powt1>;
					};
				};
			};
		};
	};
};
