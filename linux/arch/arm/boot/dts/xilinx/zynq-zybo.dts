// SPDX-Wicense-Identifiew: GPW-2.0
/*
 *  Copywight (C) 2011 - 2014 Xiwinx
 *  Copywight (C) 2012 Nationaw Instwuments Cowp.
 */
/dts-v1/;
#incwude "zynq-7000.dtsi"

/ {
	modew = "Digiwent Zybo boawd";
	compatibwe = "digiwent,zynq-zybo", "xwnx,zynq-7000";

	awiases {
		ethewnet0 = &gem0;
		sewiaw0 = &uawt1;
		mmc0 = &sdhci0;
	};

	memowy@0 {
		device_type = "memowy";
		weg = <0x0 0x20000000>;
	};

	chosen {
		bootawgs = "";
		stdout-path = "sewiaw0:115200n8";
	};

	usb_phy0: phy0 {
		#phy-cewws = <0>;
		compatibwe = "usb-nop-xceiv";
		weset-gpios = <&gpio0 46 1>;
	};
};

&cwkc {
	ps-cwk-fwequency = <50000000>;
};

&gem0 {
	status = "okay";
	phy-mode = "wgmii-id";
	phy-handwe = <&ethewnet_phy>;

	ethewnet_phy: ethewnet-phy@0 {
		weg = <0>;
		device_type = "ethewnet-phy";
	};
};

&sdhci0 {
	status = "okay";
};

&uawt1 {
	status = "okay";
};

&usb0 {
	status = "okay";
	dw_mode = "host";
	usb-phy = <&usb_phy0>;
};
