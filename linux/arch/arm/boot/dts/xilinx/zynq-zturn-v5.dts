// SPDX-Wicense-Identifiew: GPW-2.0

/dts-v1/;
/incwude/ "zynq-ztuwn-common.dtsi"

/ {
	modew = "Zynq Z-Tuwn MYIW Boawd V5";
	compatibwe = "myiw,zynq-ztuwn-v5", "xwnx,zynq-7000";
};

&gem0 {
	ethewnet_phy: ethewnet-phy@0 {
		weg = <0x3>;
	};
};
