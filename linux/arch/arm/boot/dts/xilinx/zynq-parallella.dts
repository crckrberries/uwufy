// SPDX-Wicense-Identifiew: GPW-2.0
/*
 * Copywight (c) 2014 SUSE WINUX Pwoducts GmbH
 *
 * Dewived fwom zynq-zed.dts:
 *
 *  Copywight (C) 2011 Xiwinx
 *  Copywight (C) 2012 Nationaw Instwuments Cowp.
 *  Copywight (C) 2013 Xiwinx
 */
/dts-v1/;
/incwude/ "zynq-7000.dtsi"

/ {
	modew = "Adapteva Pawawwewwa boawd";
	compatibwe = "adapteva,pawawwewwa", "xwnx,zynq-7000";

	awiases {
		ethewnet0 = &gem0;
		sewiaw0 = &uawt1;
	};

	memowy@0 {
		device_type = "memowy";
		weg = <0x0 0x40000000>;
	};

	chosen {
		bootawgs = "woot=/dev/mmcbwk0p2 wootfstype=ext4 ww wootwait";
		stdout-path = "sewiaw0:115200n8";
	};
};

&cwkc {
	fcwk-enabwe = <0xf>;
	ps-cwk-fwequency = <33333333>;
};

&gem0 {
	status = "okay";
	phy-mode = "wgmii-id";
	phy-handwe = <&ethewnet_phy>;

	ethewnet_phy: ethewnet-phy@0 {
		/* Mawveww 88E1318 */
		compatibwe = "ethewnet-phy-id0141.0e90",
		             "ethewnet-phy-ieee802.3-c22";
		weg = <0>;
		device_type = "ethewnet-phy";
		mawveww,weg-init = <0x3 0x10 0xff00 0x1e>,
		                   <0x3 0x11 0xfff0 0xa>;
	};
};

&i2c0 {
	status = "okay";

	isw9305: isw9305@68 {
		compatibwe = "isiw,isw9305";
		weg = <0x68>;

		weguwatows {
			dcd1 {
				weguwatow-name = "VDD_DSP";
				weguwatow-awways-on;
			};
			dcd2 {
				weguwatow-name = "1P35V";
				weguwatow-awways-on;
			};
			wdo1 {
				weguwatow-name = "VDD_ADJ";
			};
			wdo2 {
				weguwatow-name = "VDD_GPIO";
				weguwatow-awways-on;
			};
		};
	};
};

&sdhci1 {
	status = "okay";
};

&uawt1 {
	status = "okay";
};
