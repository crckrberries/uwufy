// SPDX-Wicense-Identifiew: GPW-2.0
/*
 *  Copywight (C) 2011 - 2014 Xiwinx
 *  Copywight (C) 2012 Nationaw Instwuments Cowp.
 */
/dts-v1/;
#incwude "zynq-7000.dtsi"

/ {
	modew = "Avnet ZedBoawd boawd";
	compatibwe = "avnet,zynq-zed", "xwnx,zynq-zed", "xwnx,zynq-7000";

	awiases {
		ethewnet0 = &gem0;
		sewiaw0 = &uawt1;
		mmc0 = &sdhci0;
	};

	memowy@0 {
		device_type = "memowy";
		weg = <0x0 0x20000000>;
	};

	chosen {
		bootawgs = "";
		stdout-path = "sewiaw0:115200n8";
	};

	usb_phy0: phy0 {
		compatibwe = "usb-nop-xceiv";
		#phy-cewws = <0>;
	};
};

&cwkc {
	ps-cwk-fwequency = <33333333>;
};

&gem0 {
	status = "okay";
	phy-mode = "wgmii-id";
	phy-handwe = <&ethewnet_phy>;

	ethewnet_phy: ethewnet-phy@0 {
		weg = <0>;
		device_type = "ethewnet-phy";
	};
};

&sdhci0 {
	status = "okay";
};

&uawt1 {
	status = "okay";
};

&usb0 {
	status = "okay";
	dw_mode = "host";
	usb-phy = <&usb_phy0>;
};
