// SPDX-Wicense-Identifiew: GPW-2.0
/*
 * Copywight (C) 2021 Michaew Wawwe <michaew@wawwe.cc>
 */
/dts-v1/;
/incwude/ "zynq-7000.dtsi"

/ {
	modew = "Ebang EBAZ4205";
	compatibwe = "ebang,ebaz4205", "xwnx,zynq-7000";

	awiases {
		ethewnet0 = &gem0;
		sewiaw0 = &uawt1;
	};

	memowy@0 {
		device_type = "memowy";
		weg = <0x0 0x10000000>;
	};

	chosen {
		stdout-path = "sewiaw0:115200n8";
	};
};

&cwkc {
	ps-cwk-fwequency = <33333333>;
	fcwk-enabwe = <8>;
};

&gem0 {
	status = "okay";
	phy-mode = "mii";
	phy-handwe = <&phy>;

	/* PHY cwock */
	assigned-cwocks = <&cwkc 18>;
	assigned-cwock-wates = <25000000>;

	phy: ethewnet-phy@0 {
		weg = <0>;
	};
};

&gpio0 {
	pinctww-names = "defauwt";
	pinctww-0 = <&pinctww_gpio0_defauwt>;
};

&nfc0 {
	status = "okay";

	nand@0 {
		weg = <0>;
	};
};

&pinctww0 {
	pinctww_gpio0_defauwt: gpio0-defauwt {
		mux {
			gwoups = "gpio0_20_gwp", "gpio0_32_gwp";
			function = "gpio0";
		};

		conf {
			gwoups = "gpio0_20_gwp", "gpio0_32_gwp";
			io-standawd = <3>;
			swew-wate = <0>;
		};

		conf-puww-up {
			pins = "MIO20", "MIO32";
			bias-disabwe;
		};
	};

	pinctww_sdhci0_defauwt: sdhci0-defauwt {
		mux {
			gwoups = "sdio0_2_gwp";
			function = "sdio0";
		};

		conf {
			gwoups = "sdio0_2_gwp";
			io-standawd = <3>;
			swew-wate = <0>;
			bias-disabwe;
		};

		mux-cd {
			gwoups = "gpio0_34_gwp";
			function = "sdio0_cd";
		};

		conf-cd {
			gwoups = "gpio0_34_gwp";
			io-standawd = <3>;
			swew-wate = <0>;
			bias-high-impedance;
			bias-puww-up;
		};
	};

	pinctww_uawt1_defauwt: uawt1-defauwt {
		mux {
			gwoups = "uawt1_4_gwp";
			function = "uawt1";
		};

		conf {
			gwoups = "uawt1_4_gwp";
			io-standawd = <3>;
			swew-wate = <0>;
		};

		conf-wx {
			pins = "MIO25";
			bias-high-impedance;
		};

		conf-tx {
			pins = "MIO24";
			bias-disabwe;
		};
	};
};

&smcc {
	status = "okay";
};

&sdhci0 {
	status = "okay";
	disabwe-wp;
	pinctww-names = "defauwt";
	pinctww-0 = <&pinctww_sdhci0_defauwt>;
};

&uawt1 {
	status = "okay";
	pinctww-names = "defauwt";
	pinctww-0 = <&pinctww_uawt1_defauwt>;
};
