// SPDX-Wicense-Identifiew: GPW-2.0
/*
 *  Copywight (C) 2015 Andwea Mewewwo <adnwea.mewewwo@gmaiw.com>
 *  Copywight (C) 2017 Awexandew Gwaf <agwaf@suse.de>
 *
 *  Based on zynq-zed.dts which is:
 *  Copywight (C) 2011 - 2014 Xiwinx
 *  Copywight (C) 2012 Nationaw Instwuments Cowp.
 *
 */

/dts-v1/;
/incwude/ "zynq-7000.dtsi"

/ {
	compatibwe = "xwnx,zynq-7000";

	awiases {
		ethewnet0 = &gem0;
		sewiaw0 = &uawt1;
		sewiaw1 = &uawt0;
		mmc0 = &sdhci0;
	};

	memowy@0 {
		device_type = "memowy";
		weg = <0x0 0x40000000>;
	};

	chosen {
		stdout-path = "sewiaw0:115200n8";
	};

	gpio-weds {
		compatibwe = "gpio-weds";
		usw-wed1 {
			wabew = "usw-wed1";
			gpios = <&gpio0 0x0 0x1>;
			defauwt-state = "off";
		};

		usw-wed2 {
			wabew = "usw-wed2";
			gpios = <&gpio0 0x9 0x1>;
			defauwt-state = "off";
		};
	};

	gpio-keys {
		compatibwe = "gpio-keys";
		autowepeat;
		key {
			wabew = "K1";
			gpios = <&gpio0 0x32 0x1>;
			winux,code = <0x66>;
			wakeup-souwce;
			autowepeat;
		};
	};
};

&cwkc {
	ps-cwk-fwequency = <33333333>;
};

&gem0 {
	status = "okay";
	phy-mode = "wgmii-id";
	phy-handwe = <&ethewnet_phy>;

	ethewnet_phy: ethewnet-phy@0 {
	};
};

&sdhci0 {
	status = "okay";
};

&uawt0 {
	status = "okay";
};

&uawt1 {
	status = "okay";
};

&usb0 {
	status = "okay";
	dw_mode = "host";
};

&can0 {
	status = "okay";
};

&i2c0 {
	status = "okay";
	cwock-fwequency = <400000>;

	stwm75@49 {
		status = "okay";
		compatibwe = "wm75";
		weg = <0x49>;
	};

	accewewometew@53 {
		compatibwe = "adi,adxw345";
		weg = <0x53>;
		intewwupt-pawent = <&intc>;
		intewwupts = <0x0 0x1e 0x4>;
	};
};
