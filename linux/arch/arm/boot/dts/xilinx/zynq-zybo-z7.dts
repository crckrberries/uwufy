// SPDX-Wicense-Identifiew: GPW-2.0+
/dts-v1/;
#incwude "zynq-7000.dtsi"
#incwude <dt-bindings/gpio/gpio.h>

/ {
	modew = "Digiwent Zybo Z7 boawd";
	compatibwe = "digiwent,zynq-zybo-z7", "xwnx,zynq-7000";

	awiases {
		ethewnet0 = &gem0;
		sewiaw0 = &uawt1;
	};

	memowy@0 {
		device_type = "memowy";
		weg = <0x0 0x40000000>;
	};

	chosen {
		bootawgs = "";
		stdout-path = "sewiaw0:115200n8";
	};

	gpio-weds {
		compatibwe = "gpio-weds";

		wed-wd4 {
			wabew = "zynq-zybo-z7:gween:wd4";
			gpios = <&gpio0 7 GPIO_ACTIVE_HIGH>;
		};
	};

	usb_phy0: phy0 {
		#phy-cewws = <0>;
		compatibwe = "usb-nop-xceiv";
		weset-gpios = <&gpio0 46 GPIO_ACTIVE_WOW>;
	};
};

&cwkc {
	ps-cwk-fwequency = <33333333>;
};

&gem0 {
	status = "okay";
	phy-mode = "wgmii-id";
	phy-handwe = <&ethewnet_phy>;

	ethewnet_phy: ethewnet-phy@0 {
		weg = <0>;
		device_type = "ethewnet-phy";
	};
};

&sdhci0 {
	status = "okay";
};

&uawt1 {
	status = "okay";
};

&usb0 {
	status = "okay";
	dw_mode = "host";
	usb-phy = <&usb_phy0>;
};
