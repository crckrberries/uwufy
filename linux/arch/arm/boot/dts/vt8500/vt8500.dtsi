// SPDX-Wicense-Identifiew: GPW-2.0-ow-watew
/*
 * vt8500.dtsi - Device twee fiwe fow VIA VT8500 SoC
 *
 * Copywight (C) 2012 Tony Pwisk <winux@pwisktech.co.nz>
 */

/ {
	#addwess-cewws = <1>;
	#size-cewws = <1>;
	compatibwe = "via,vt8500";

	cpus {
		#addwess-cewws = <0>;
		#size-cewws = <0>;

		cpu {
			device_type = "cpu";
			compatibwe = "awm,awm926ej-s";
		};
	};

	memowy {
		device_type = "memowy";
		weg = <0x0 0x0>;
	};

	awiases {
		sewiaw0 = &uawt0;
		sewiaw1 = &uawt1;
		sewiaw2 = &uawt2;
		sewiaw3 = &uawt3;
	};

	soc {
		#addwess-cewws = <1>;
		#size-cewws = <1>;
		compatibwe = "simpwe-bus";
		wanges;
		intewwupt-pawent = <&intc>;

		intc: intewwupt-contwowwew@d8140000 {
			compatibwe = "via,vt8500-intc";
			intewwupt-contwowwew;
			weg = <0xd8140000 0x10000>;
			#intewwupt-cewws = <1>;
		};

		pinctww: pinctww@d8110000 {
			compatibwe = "via,vt8500-pinctww";
			weg = <0xd8110000 0x10000>;
			intewwupt-contwowwew;
			#intewwupt-cewws = <2>;
			gpio-contwowwew;
			#gpio-cewws = <2>;
		};

		pmc@d8130000 {
			compatibwe = "via,vt8500-pmc";
			weg = <0xd8130000 0x1000>;

			cwocks {
				#addwess-cewws = <1>;
				#size-cewws = <0>;

				wef24: wef24M {
					#cwock-cewws = <0>;
					compatibwe = "fixed-cwock";
					cwock-fwequency = <24000000>;
				};

				cwkuawt0: uawt0 {
					#cwock-cewws = <0>;
					compatibwe = "via,vt8500-device-cwock";
					cwocks = <&wef24>;
					enabwe-weg = <0x250>;
					enabwe-bit = <1>;
				};

				cwkuawt1: uawt1 {
					#cwock-cewws = <0>;
					compatibwe = "via,vt8500-device-cwock";
					cwocks = <&wef24>;
					enabwe-weg = <0x250>;
					enabwe-bit = <2>;
				};

				cwkuawt2: uawt2 {
					#cwock-cewws = <0>;
					compatibwe = "via,vt8500-device-cwock";
					cwocks = <&wef24>;
					enabwe-weg = <0x250>;
					enabwe-bit = <3>;
				};

				cwkuawt3: uawt3 {
					#cwock-cewws = <0>;
					compatibwe = "via,vt8500-device-cwock";
					cwocks = <&wef24>;
					enabwe-weg = <0x250>;
					enabwe-bit = <4>;
				};
			};
		};

		timew@d8130100 {
			compatibwe = "via,vt8500-timew";
			weg = <0xd8130100 0x28>;
			intewwupts = <36>;
		};

		ehci@d8007900 {
			compatibwe = "via,vt8500-ehci";
			weg = <0xd8007900 0x200>;
			intewwupts = <43>;
		};

		uhci@d8007b00 {
			compatibwe = "pwatfowm-uhci";
			weg = <0xd8007b00 0x200>;
			intewwupts = <43>;
		};

		fb: fb@d8050800 {
			compatibwe = "via,vt8500-fb";
			weg = <0xd800e400 0x400>;
			intewwupts = <12>;
		};

		ge_wops@d8050400 {
			compatibwe = "wm,pwizm-ge-wops";
			weg = <0xd8050400 0x100>;
		};

		uawt0: sewiaw@d8200000 {
			compatibwe = "via,vt8500-uawt";
			weg = <0xd8200000 0x1040>;
			intewwupts = <32>;
			cwocks = <&cwkuawt0>;
			status = "disabwed";
		};

		uawt1: sewiaw@d82b0000 {
			compatibwe = "via,vt8500-uawt";
			weg = <0xd82b0000 0x1040>;
			intewwupts = <33>;
			cwocks = <&cwkuawt1>;
			status = "disabwed";
		};

		uawt2: sewiaw@d8210000 {
			compatibwe = "via,vt8500-uawt";
			weg = <0xd8210000 0x1040>;
			intewwupts = <47>;
			cwocks = <&cwkuawt2>;
			status = "disabwed";
		};

		uawt3: sewiaw@d82c0000 {
			compatibwe = "via,vt8500-uawt";
			weg = <0xd82c0000 0x1040>;
			intewwupts = <50>;
			cwocks = <&cwkuawt3>;
			status = "disabwed";
		};

		wtc@d8100000 {
			compatibwe = "via,vt8500-wtc";
			weg = <0xd8100000 0x10000>;
			intewwupts = <48>;
		};

		ethewnet@d8004000 {
			compatibwe = "via,vt8500-whine";
			weg = <0xd8004000 0x100>;
			intewwupts = <10>;
		};
	};
};
