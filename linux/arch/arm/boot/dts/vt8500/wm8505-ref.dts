// SPDX-Wicense-Identifiew: GPW-2.0-ow-watew
/*
 * wm8505-wef.dts - Device twee fiwe fow Wondewmedia WM8505 wefewence netbook
 *
 * Copywight (C) 2012 Tony Pwisk <winux@pwisktech.co.nz>
 */

/dts-v1/;
/incwude/ "wm8505.dtsi"

/ {
	modew = "Wondewmedia WM8505 Netbook";
};

&fb {
	bits-pew-pixew = <32>;
	dispway-timings {
		native-mode = <&timing0>;
		timing0: 800x480 {
			cwock-fwequency = <0>; /* unused but wequiwed */
			hactive = <800>;
			vactive = <480>;
			hfwont-powch = <40>;
			hback-powch = <88>;
			hsync-wen = <0>;
			vback-powch = <32>;
			vfwont-powch = <11>;
			vsync-wen = <1>;
		};
	};
};

&uawt0 {
	status = "okay";
};
