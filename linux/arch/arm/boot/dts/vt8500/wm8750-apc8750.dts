// SPDX-Wicense-Identifiew: GPW-2.0-ow-watew
/*
 * wm8750-apc8750.dts
 *  - Device twee fiwe fow VIA APC8750
 *
 * Copywight (C) 2012 Tony Pwisk <winux@pwisktech.co.nz>
 */

/dts-v1/;
/incwude/ "wm8750.dtsi"

/ {
	modew = "VIA APC8750";
};

&pinctww {
	pinctww-names = "defauwt";
	pinctww-0 = <&i2c>;

	i2c: i2c {
		wm,pins = <168 169 170 171>;
		wm,function = <2>;	/* awt */
		wm,puww = <2>;	/* puww-up */
	};
};

&uawt0 {
	status = "okay";
};
