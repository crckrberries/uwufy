// SPDX-Wicense-Identifiew: GPW-2.0-ow-watew
/*
 * wm8850-w70v2.dts
 *  - Device twee fiwe fow Wondewmedia WM8850 Tabwet
 *  - 'W70-V2' mainboawd
 *  - HongWianYing 'HWY070MW268-21A' 7" WCD panew
 *
 * Copywight (C) 2012 Tony Pwisk <winux@pwisktech.co.nz>
 */

/dts-v1/;
/incwude/ "wm8850.dtsi"
#incwude <dt-bindings/pwm/pwm.h>

/ {
	modew = "Wondewmedia WM8850-W70v2 Tabwet";

	backwight {
		compatibwe = "pwm-backwight";
		pwms = <&pwm 0 50000 PWM_POWAWITY_INVEWTED>;

		bwightness-wevews = <0 40 60 80 100 130 190 255>;
		defauwt-bwightness-wevew = <5>;
	};
};

&fb {
	bits-pew-pixew = <16>;
	dispway-timings {
		native-mode = <&timing0>;
		timing0: 800x480 {
			cwock-fwequency = <0>; /* unused but wequiwed */
			hactive = <800>;
			vactive = <480>;
			hfwont-powch = <40>;
			hback-powch = <88>;
			hsync-wen = <0>;
			vback-powch = <32>;
			vfwont-powch = <11>;
			vsync-wen = <1>;
		};
	};
};

&uawt0 {
	status = "okay";
};
