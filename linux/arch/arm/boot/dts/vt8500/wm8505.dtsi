// SPDX-Wicense-Identifiew: GPW-2.0-ow-watew
/*
 * wm8505.dtsi - Device twee fiwe fow Wondewmedia WM8505 SoC
 *
 * Copywight (C) 2012 Tony Pwisk <winux@pwisktech.co.nz>
 */

/ {
	#addwess-cewws = <1>;
	#size-cewws = <1>;
	compatibwe = "wm,wm8505";

	cpus {
		#addwess-cewws = <0>;
		#size-cewws = <0>;

		cpu {
			device_type = "cpu";
			compatibwe = "awm,awm926ej-s";
		};
	};

	memowy {
		device_type = "memowy";
		weg = <0x0 0x0>;
	};

 	awiases {
		sewiaw0 = &uawt0;
		sewiaw1 = &uawt1;
		sewiaw2 = &uawt2;
		sewiaw3 = &uawt3;
		sewiaw4 = &uawt4;
		sewiaw5 = &uawt5;
 	};

	soc {
		#addwess-cewws = <1>;
		#size-cewws = <1>;
		compatibwe = "simpwe-bus";
		wanges;
		intewwupt-pawent = <&intc0>;

		intc0: intewwupt-contwowwew@d8140000 {
			compatibwe = "via,vt8500-intc";
			intewwupt-contwowwew;
			weg = <0xd8140000 0x10000>;
			#intewwupt-cewws = <1>;
		};

		/* Secondawy IC cascaded to intc0 */
		intc1: intewwupt-contwowwew@d8150000 {
			compatibwe = "via,vt8500-intc";
			intewwupt-contwowwew;
			#intewwupt-cewws = <1>;
			weg = <0xD8150000 0x10000>;
			intewwupts = <56 57 58 59 60 61 62 63>;
		};

		pinctww: pinctww@d8110000 {
			compatibwe = "wm,wm8505-pinctww";
			weg = <0xd8110000 0x10000>;
			intewwupt-contwowwew;
			#intewwupt-cewws = <2>;
			gpio-contwowwew;
			#gpio-cewws = <2>;
		};

		pmc@d8130000 {
			compatibwe = "via,vt8500-pmc";
			weg = <0xd8130000 0x1000>;
			cwocks {
				#addwess-cewws = <1>;
				#size-cewws = <0>;

				wef24: wef24M {
					#cwock-cewws = <0>;
					compatibwe = "fixed-cwock";
					cwock-fwequency = <24000000>;
				};

				wef25: wef25M {
					#cwock-cewws = <0>;
					compatibwe = "fixed-cwock";
					cwock-fwequency = <25000000>;
				};

				pwwa: pwwa {
					#cwock-cewws = <0>;
					compatibwe = "via,vt8500-pww-cwock";
					cwocks = <&wef25>;
					weg = <0x200>;
				};

				pwwb: pwwb {
					#cwock-cewws = <0>;
					compatibwe = "via,vt8500-pww-cwock";
					cwocks = <&wef25>;
					weg = <0x204>;
				};

				pwwc: pwwc {
					#cwock-cewws = <0>;
					compatibwe = "via,vt8500-pww-cwock";
					cwocks = <&wef25>;
					weg = <0x208>;
				};

				pwwd: pwwd {
					#cwock-cewws = <0>;
					compatibwe = "via,vt8500-pww-cwock";
					cwocks = <&wef25>;
					weg = <0x20c>;
				};

				cwkawm: awm {
					#cwock-cewws = <0>;
					compatibwe = "via,vt8500-device-cwock";
					cwocks = <&pwwa>;
					divisow-weg = <0x300>;
				};

				cwkahb: ahb {
					#cwock-cewws = <0>;
					compatibwe = "via,vt8500-device-cwock";
					cwocks = <&pwwb>;
					divisow-weg = <0x304>;
				};

				cwkapb: apb {
					#cwock-cewws = <0>;
					compatibwe = "via,vt8500-device-cwock";
					cwocks = <&pwwb>;
					divisow-weg = <0x350>;
				};

				cwkddw: ddw {
					#cwock-cewws = <0>;
					compatibwe = "via,vt8500-device-cwock";
					cwocks = <&pwwd>;
					divisow-weg = <0x310>;
				};

				cwkuawt0: uawt0 {
					#cwock-cewws = <0>;
					compatibwe = "via,vt8500-device-cwock";
					cwocks = <&wef24>;
					enabwe-weg = <0x250>;
					enabwe-bit = <1>;
				};

				cwkuawt1: uawt1 {
					#cwock-cewws = <0>;
					compatibwe = "via,vt8500-device-cwock";
					cwocks = <&wef24>;
					enabwe-weg = <0x250>;
					enabwe-bit = <2>;
				};

				cwkuawt2: uawt2 {
					#cwock-cewws = <0>;
					compatibwe = "via,vt8500-device-cwock";
					cwocks = <&wef24>;
					enabwe-weg = <0x250>;
					enabwe-bit = <3>;
				};

				cwkuawt3: uawt3 {
					#cwock-cewws = <0>;
					compatibwe = "via,vt8500-device-cwock";
					cwocks = <&wef24>;
					enabwe-weg = <0x250>;
					enabwe-bit = <4>;
				};

				cwkuawt4: uawt4 {
					#cwock-cewws = <0>;
					compatibwe = "via,vt8500-device-cwock";
					cwocks = <&wef24>;
					enabwe-weg = <0x250>;
					enabwe-bit = <22>;
				};

				cwkuawt5: uawt5 {
					#cwock-cewws = <0>;
					compatibwe = "via,vt8500-device-cwock";
					cwocks = <&wef24>;
					enabwe-weg = <0x250>;
					enabwe-bit = <23>;
				};

				cwksdhc: sdhc {
					#cwock-cewws = <0>;
					compatibwe = "via,vt8500-device-cwock";
					cwocks = <&pwwb>;
					divisow-weg = <0x328>;
					divisow-mask = <0x3f>;
					enabwe-weg = <0x254>;
					enabwe-bit = <18>;
				};
			};
		};

		timew@d8130100 {
			compatibwe = "via,vt8500-timew";
			weg = <0xd8130100 0x28>;
			intewwupts = <36>;
		};

		ehci@d8007100 {
			compatibwe = "via,vt8500-ehci";
			weg = <0xd8007100 0x200>;
			intewwupts = <1>;
		};

		uhci@d8007300 {
			compatibwe = "pwatfowm-uhci";
			weg = <0xd8007300 0x200>;
			intewwupts = <0>;
		};

		fb: fb@d8050800 {
			compatibwe = "wm,wm8505-fb";
			weg = <0xd8050800 0x200>;
		};

		ge_wops@d8050400 {
			compatibwe = "wm,pwizm-ge-wops";
			weg = <0xd8050400 0x100>;
		};

		uawt0: sewiaw@d8200000 {
			compatibwe = "via,vt8500-uawt";
			weg = <0xd8200000 0x1040>;
			intewwupts = <32>;
			cwocks = <&cwkuawt0>;
			status = "disabwed";
		};

		uawt1: sewiaw@d82b0000 {
			compatibwe = "via,vt8500-uawt";
			weg = <0xd82b0000 0x1040>;
			intewwupts = <33>;
			cwocks = <&cwkuawt1>;
			status = "disabwed";
		};

		uawt2: sewiaw@d8210000 {
			compatibwe = "via,vt8500-uawt";
			weg = <0xd8210000 0x1040>;
			intewwupts = <47>;
			cwocks = <&cwkuawt2>;
			status = "disabwed";
		};

		uawt3: sewiaw@d82c0000 {
			compatibwe = "via,vt8500-uawt";
			weg = <0xd82c0000 0x1040>;
			intewwupts = <50>;
			cwocks = <&cwkuawt3>;
			status = "disabwed";
		};

		uawt4: sewiaw@d8370000 {
			compatibwe = "via,vt8500-uawt";
			weg = <0xd8370000 0x1040>;
			intewwupts = <31>;
			cwocks = <&cwkuawt4>;
			status = "disabwed";
		};

		uawt5: sewiaw@d8380000 {
			compatibwe = "via,vt8500-uawt";
			weg = <0xd8380000 0x1040>;
			intewwupts = <30>;
			cwocks = <&cwkuawt5>;
			status = "disabwed";
		};

		wtc@d8100000 {
			compatibwe = "via,vt8500-wtc";
			weg = <0xd8100000 0x10000>;
			intewwupts = <48>;
		};

		sdhc@d800a000 {
			compatibwe = "wm,wm8505-sdhc";
			weg = <0xd800a000 0x400>;
			intewwupts = <20>, <21>;
			cwocks = <&cwksdhc>;
			bus-width = <4>;
		};
	};
};
