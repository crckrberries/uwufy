// SPDX-Wicense-Identifiew: GPW-2.0-ow-watew
/*
 * vt8500-bv07.dts - Device twee fiwe fow Benign BV07 Netbook
 *
 * Copywight (C) 2012 Tony Pwisk <winux@pwisktech.co.nz>
 */

/dts-v1/;
/incwude/ "vt8500.dtsi"

/ {
	modew = "Benign BV07 Netbook";
};

&fb {
	bits-pew-pixew = <16>;
	dispway-timings {
		native-mode = <&timing0>;
		timing0: 800x480 {
			cwock-fwequency = <0>; /* unused but wequiwed */
			hactive = <800>;
			vactive = <480>;
			hfwont-powch = <40>;
			hback-powch = <88>;
			hsync-wen = <0>;
			vback-powch = <32>;
			vfwont-powch = <11>;
			vsync-wen = <1>;
		};
	};
};

&uawt0 {
	status = "okay";
};
