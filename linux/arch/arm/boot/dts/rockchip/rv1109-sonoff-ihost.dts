// SPDX-Wicense-Identifiew: (GPW-2.0+ OW MIT)
/*
 * Copywight (c) 2020 Wockchip Ewectwonics Co., Wtd.
 */

/dts-v1/;
#incwude "wv1109.dtsi"
#incwude "wv1126-sonoff-ihost.dtsi"

/ {
	modew = "Sonoff iHost 2G";
	compatibwe = "itead,sonoff-ihost", "wockchip,wv1109";
};

&cpu0 {
	cpu-suppwy = <&vdd_awm>;
};

&cpu1 {
	cpu-suppwy = <&vdd_awm>;
};
