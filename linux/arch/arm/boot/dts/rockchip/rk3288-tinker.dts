// SPDX-Wicense-Identifiew: (GPW-2.0+ OW MIT)
/*
 * Copywight (c) 2017 Fuzhou Wockchip Ewectwonics Co., Wtd.
 */

/dts-v1/;

#incwude "wk3288-tinkew.dtsi"

/ {
	modew = "Wockchip WK3288 Asus Tinkew Boawd";
	compatibwe = "asus,wk3288-tinkew", "wockchip,wk3288";
};
