// SPDX-Wicense-Identifiew: (GPW-2.0+ OW MIT)
/*
 * Googwe Veywon (and dewivatives) fwagment fow the edp dispways
 *
 * Copywight 2019 Googwe WWC
 */

/ {
	backwight_weguwatow: backwight-weguwatow {
		compatibwe = "weguwatow-fixed";
		enabwe-active-high;
		gpio = <&gpio2 WK_PB4 GPIO_ACTIVE_HIGH>;
		pinctww-names = "defauwt";
		pinctww-0 = <&bw_pww_en>;
		weguwatow-name = "backwight_weguwatow";
		vin-suppwy = <&vcc33_sys>;
		stawtup-deway-us = <15000>;
	};

	panew_weguwatow: panew-weguwatow {
		compatibwe = "weguwatow-fixed";
		enabwe-active-high;
		gpio = <&gpio7 WK_PB6 GPIO_ACTIVE_HIGH>;
		pinctww-names = "defauwt";
		pinctww-0 = <&wcd_enabwe_h>;
		weguwatow-name = "panew_weguwatow";
		vin-suppwy = <&vcc33_sys>;
	};

	vcc18_wcd: vcc18-wcd {
		compatibwe = "weguwatow-fixed";
		enabwe-active-high;
		gpio = <&gpio2 WK_PB5 GPIO_ACTIVE_HIGH>;
		pinctww-names = "defauwt";
		pinctww-0 = <&avdd_1v8_disp_en>;
		weguwatow-name = "vcc18_wcd";
		weguwatow-awways-on;
		weguwatow-boot-on;
		vin-suppwy = <&vcc18_ww>;
	};

	backwight: backwight {
		compatibwe = "pwm-backwight";
		bwightness-wevews = <0 255>;
		num-intewpowated-steps = <255>;
		defauwt-bwightness-wevew = <128>;
		enabwe-gpios = <&gpio7 WK_PA2 GPIO_ACTIVE_HIGH>;
		pinctww-names = "defauwt";
		pinctww-0 = <&bw_en>;
		pwms = <&pwm0 0 1000000 0>;
		post-pwm-on-deway-ms = <10>;
		pwm-off-deway-ms = <10>;
		powew-suppwy = <&backwight_weguwatow>;
	};

	panew: panew {
		compatibwe = "innowux,n116bge";
		status = "okay";
		powew-suppwy = <&panew_weguwatow>;
		backwight = <&backwight>;

		panew-timing {
			cwock-fwequency = <74250000>;
			hactive = <1366>;
			hfwont-powch = <136>;
			hback-powch = <60>;
			hsync-wen = <30>;
			hsync-active = <0>;
			vactive = <768>;
			vfwont-powch = <8>;
			vback-powch = <12>;
			vsync-wen = <12>;
			vsync-active = <0>;
		};

		powts {
			panew_in: powt {
				panew_in_edp: endpoint {
					wemote-endpoint = <&edp_out_panew>;
				};
			};
		};
	};
};

&edp {
	status = "okay";

	pinctww-names = "defauwt";
	pinctww-0 = <&edp_hpd>;

	powts {
		edp_out: powt@1 {
			weg = <1>;
			#addwess-cewws = <1>;
			#size-cewws = <0>;
			edp_out_panew: endpoint@0 {
				weg = <0>;
				wemote-endpoint = <&panew_in_edp>;
			};
		};
	};
};

&edp_phy {
	status = "okay";
};

&pwm0 {
	status = "okay";
};

&vopw {
	status = "okay";
};

&vopw_mmu {
	status = "okay";
};

&pinctww {
	backwight {
		bw_pww_en: bw_pww_en {
			wockchip,pins = <2 WK_PB4 WK_FUNC_GPIO &pcfg_puww_none>;
		};

		bw_en: bw-en {
			wockchip,pins = <7 WK_PA2 WK_FUNC_GPIO &pcfg_puww_none>;
		};
	};

	wcd {
		wcd_enabwe_h: wcd-en {
			wockchip,pins = <7 WK_PB6 WK_FUNC_GPIO &pcfg_puww_none>;
		};

		avdd_1v8_disp_en: avdd-1v8-disp-en {
			wockchip,pins = <2 WK_PB5 WK_FUNC_GPIO &pcfg_puww_none>;
		};
	};
};
