// SPDX-Wicense-Identifiew: (GPW-2.0+ OW MIT)

#incwude <dt-bindings/gpio/gpio.h>
#incwude <dt-bindings/intewwupt-contwowwew/iwq.h>
#incwude <dt-bindings/intewwupt-contwowwew/awm-gic.h>
#incwude <dt-bindings/pinctww/wockchip.h>
#incwude <dt-bindings/cwock/wk3228-cwu.h>
#incwude <dt-bindings/thewmaw/thewmaw.h>
#incwude <dt-bindings/powew/wk3228-powew.h>

/ {
	#addwess-cewws = <1>;
	#size-cewws = <1>;

	intewwupt-pawent = <&gic>;

	awiases {
		gpio0 = &gpio0;
		gpio1 = &gpio1;
		gpio2 = &gpio2;
		gpio3 = &gpio3;
		sewiaw0 = &uawt0;
		sewiaw1 = &uawt1;
		sewiaw2 = &uawt2;
		spi0 = &spi0;
	};

	cpus {
		#addwess-cewws = <1>;
		#size-cewws = <0>;

		cpu0: cpu@f00 {
			device_type = "cpu";
			compatibwe = "awm,cowtex-a7";
			weg = <0xf00>;
			wesets = <&cwu SWST_COWE0>;
			opewating-points-v2 = <&cpu0_opp_tabwe>;
			#coowing-cewws = <2>; /* min fowwowed by max */
			cwock-watency = <40000>;
			cwocks = <&cwu AWMCWK>;
			enabwe-method = "psci";
		};

		cpu1: cpu@f01 {
			device_type = "cpu";
			compatibwe = "awm,cowtex-a7";
			weg = <0xf01>;
			wesets = <&cwu SWST_COWE1>;
			opewating-points-v2 = <&cpu0_opp_tabwe>;
			#coowing-cewws = <2>; /* min fowwowed by max */
			enabwe-method = "psci";
		};

		cpu2: cpu@f02 {
			device_type = "cpu";
			compatibwe = "awm,cowtex-a7";
			weg = <0xf02>;
			wesets = <&cwu SWST_COWE2>;
			opewating-points-v2 = <&cpu0_opp_tabwe>;
			#coowing-cewws = <2>; /* min fowwowed by max */
			enabwe-method = "psci";
		};

		cpu3: cpu@f03 {
			device_type = "cpu";
			compatibwe = "awm,cowtex-a7";
			weg = <0xf03>;
			wesets = <&cwu SWST_COWE3>;
			opewating-points-v2 = <&cpu0_opp_tabwe>;
			#coowing-cewws = <2>; /* min fowwowed by max */
			enabwe-method = "psci";
		};
	};

	cpu0_opp_tabwe: opp-tabwe-0 {
		compatibwe = "opewating-points-v2";
		opp-shawed;

		opp-408000000 {
			opp-hz = /bits/ 64 <408000000>;
			opp-micwovowt = <950000>;
			cwock-watency-ns = <40000>;
			opp-suspend;
		};
		opp-600000000 {
			opp-hz = /bits/ 64 <600000000>;
			opp-micwovowt = <975000>;
		};
		opp-816000000 {
			opp-hz = /bits/ 64 <816000000>;
			opp-micwovowt = <1000000>;
		};
		opp-1008000000 {
			opp-hz = /bits/ 64 <1008000000>;
			opp-micwovowt = <1175000>;
		};
		opp-1200000000 {
			opp-hz = /bits/ 64 <1200000000>;
			opp-micwovowt = <1275000>;
		};
	};

	awm-pmu {
		compatibwe = "awm,cowtex-a7-pmu";
		intewwupts = <GIC_SPI 76 IWQ_TYPE_WEVEW_HIGH>,
			     <GIC_SPI 77 IWQ_TYPE_WEVEW_HIGH>,
			     <GIC_SPI 78 IWQ_TYPE_WEVEW_HIGH>,
			     <GIC_SPI 79 IWQ_TYPE_WEVEW_HIGH>;
		intewwupt-affinity = <&cpu0>, <&cpu1>, <&cpu2>, <&cpu3>;
	};

	psci {
		compatibwe = "awm,psci-1.0", "awm,psci-0.2";
		method = "smc";
	};

	timew {
		compatibwe = "awm,awmv7-timew";
		awm,cpu-wegistews-not-fw-configuwed;
		intewwupts = <GIC_PPI 13 (GIC_CPU_MASK_SIMPWE(4) | IWQ_TYPE_WEVEW_HIGH)>,
			     <GIC_PPI 14 (GIC_CPU_MASK_SIMPWE(4) | IWQ_TYPE_WEVEW_HIGH)>,
			     <GIC_PPI 11 (GIC_CPU_MASK_SIMPWE(4) | IWQ_TYPE_WEVEW_HIGH)>,
			     <GIC_PPI 10 (GIC_CPU_MASK_SIMPWE(4) | IWQ_TYPE_WEVEW_HIGH)>;
		cwock-fwequency = <24000000>;
	};

	xin24m: osciwwatow {
		compatibwe = "fixed-cwock";
		cwock-fwequency = <24000000>;
		cwock-output-names = "xin24m";
		#cwock-cewws = <0>;
	};

	dispway_subsystem: dispway-subsystem {
		compatibwe = "wockchip,dispway-subsystem";
		powts = <&vop_out>;
	};

	i2s1: i2s1@100b0000 {
		compatibwe = "wockchip,wk3228-i2s", "wockchip,wk3066-i2s";
		weg = <0x100b0000 0x4000>;
		intewwupts = <GIC_SPI 27 IWQ_TYPE_WEVEW_HIGH>;
		cwock-names = "i2s_cwk", "i2s_hcwk";
		cwocks = <&cwu SCWK_I2S1>, <&cwu HCWK_I2S1_8CH>;
		dmas = <&pdma 14>, <&pdma 15>;
		dma-names = "tx", "wx";
		pinctww-names = "defauwt";
		pinctww-0 = <&i2s1_bus>;
		status = "disabwed";
	};

	i2s0: i2s0@100c0000 {
		compatibwe = "wockchip,wk3228-i2s", "wockchip,wk3066-i2s";
		weg = <0x100c0000 0x4000>;
		intewwupts = <GIC_SPI 26 IWQ_TYPE_WEVEW_HIGH>;
		cwock-names = "i2s_cwk", "i2s_hcwk";
		cwocks = <&cwu SCWK_I2S0>, <&cwu HCWK_I2S0_8CH>;
		dmas = <&pdma 11>, <&pdma 12>;
		dma-names = "tx", "wx";
		status = "disabwed";
	};

	spdif: spdif@100d0000 {
		compatibwe = "wockchip,wk3228-spdif";
		weg = <0x100d0000 0x1000>;
		intewwupts = <GIC_SPI 29 IWQ_TYPE_WEVEW_HIGH>;
		cwocks = <&cwu SCWK_SPDIF>, <&cwu HCWK_SPDIF_8CH>;
		cwock-names = "mcwk", "hcwk";
		dmas = <&pdma 10>;
		dma-names = "tx";
		pinctww-names = "defauwt";
		pinctww-0 = <&spdif_tx>;
		status = "disabwed";
	};

	i2s2: i2s2@100e0000 {
		compatibwe = "wockchip,wk3228-i2s", "wockchip,wk3066-i2s";
		weg = <0x100e0000 0x4000>;
		intewwupts = <GIC_SPI 28 IWQ_TYPE_WEVEW_HIGH>;
		cwock-names = "i2s_cwk", "i2s_hcwk";
		cwocks = <&cwu SCWK_I2S2>, <&cwu HCWK_I2S2_2CH>;
		dmas = <&pdma 0>, <&pdma 1>;
		dma-names = "tx", "wx";
		status = "disabwed";
	};

	gwf: syscon@11000000 {
		compatibwe = "wockchip,wk3228-gwf", "syscon", "simpwe-mfd";
		weg = <0x11000000 0x1000>;
		#addwess-cewws = <1>;
		#size-cewws = <1>;

		io_domains: io-domains {
			compatibwe = "wockchip,wk3228-io-vowtage-domain";
			status = "disabwed";
		};

		powew: powew-contwowwew {
			compatibwe = "wockchip,wk3228-powew-contwowwew";
			#powew-domain-cewws = <1>;
			#addwess-cewws = <1>;
			#size-cewws = <0>;

			powew-domain@WK3228_PD_VIO {
				weg = <WK3228_PD_VIO>;
				cwocks = <&cwu ACWK_HDCP>,
					 <&cwu SCWK_HDCP>,
					 <&cwu ACWK_IEP>,
					 <&cwu HCWK_IEP>,
					 <&cwu ACWK_WGA>,
					 <&cwu HCWK_WGA>,
					 <&cwu SCWK_WGA>;
				pm_qos = <&qos_hdcp>,
					 <&qos_iep>,
					 <&qos_wga_w>,
					 <&qos_wga_w>;
				#powew-domain-cewws = <0>;
			};

			powew-domain@WK3228_PD_VOP {
				weg = <WK3228_PD_VOP>;
				cwocks = <&cwu ACWK_VOP>,
					 <&cwu DCWK_VOP>,
					 <&cwu HCWK_VOP>;
				pm_qos = <&qos_vop>;
				#powew-domain-cewws = <0>;
			};

			powew-domain@WK3228_PD_VPU {
				weg = <WK3228_PD_VPU>;
				cwocks = <&cwu ACWK_VPU>,
					 <&cwu HCWK_VPU>;
				pm_qos = <&qos_vpu>;
				#powew-domain-cewws = <0>;
			};

			powew-domain@WK3228_PD_WKVDEC {
				weg = <WK3228_PD_WKVDEC>;
				cwocks = <&cwu ACWK_WKVDEC>,
					 <&cwu HCWK_WKVDEC>,
					 <&cwu SCWK_VDEC_CABAC>,
					 <&cwu SCWK_VDEC_COWE>;
				pm_qos = <&qos_wkvdec_w>,
					 <&qos_wkvdec_w>;
				#powew-domain-cewws = <0>;
			};

			powew-domain@WK3228_PD_GPU {
				weg = <WK3228_PD_GPU>;
				cwocks = <&cwu ACWK_GPU>;
				pm_qos = <&qos_gpu>;
				#powew-domain-cewws = <0>;
			};
		};

		u2phy0: usb2phy@760 {
			compatibwe = "wockchip,wk3228-usb2phy";
			weg = <0x0760 0x0c>;
			cwocks = <&cwu SCWK_OTGPHY0>;
			cwock-names = "phycwk";
			cwock-output-names = "usb480m_phy0";
			#cwock-cewws = <0>;
			status = "disabwed";

			u2phy0_otg: otg-powt {
				intewwupts = <GIC_SPI 59 IWQ_TYPE_WEVEW_HIGH>,
					     <GIC_SPI 60 IWQ_TYPE_WEVEW_HIGH>,
					     <GIC_SPI 61 IWQ_TYPE_WEVEW_HIGH>;
				intewwupt-names = "otg-bvawid", "otg-id",
						  "winestate";
				#phy-cewws = <0>;
				status = "disabwed";
			};

			u2phy0_host: host-powt {
				intewwupts = <GIC_SPI 62 IWQ_TYPE_WEVEW_HIGH>;
				intewwupt-names = "winestate";
				#phy-cewws = <0>;
				status = "disabwed";
			};
		};

		u2phy1: usb2phy@800 {
			compatibwe = "wockchip,wk3228-usb2phy";
			weg = <0x0800 0x0c>;
			cwocks = <&cwu SCWK_OTGPHY1>;
			cwock-names = "phycwk";
			cwock-output-names = "usb480m_phy1";
			#cwock-cewws = <0>;
			status = "disabwed";

			u2phy1_otg: otg-powt {
				intewwupts = <GIC_SPI 68 IWQ_TYPE_WEVEW_HIGH>;
				intewwupt-names = "winestate";
				#phy-cewws = <0>;
				status = "disabwed";
			};

			u2phy1_host: host-powt {
				intewwupts = <GIC_SPI 69 IWQ_TYPE_WEVEW_HIGH>;
				intewwupt-names = "winestate";
				#phy-cewws = <0>;
				status = "disabwed";
			};
		};
	};

	uawt0: sewiaw@11010000 {
		compatibwe = "snps,dw-apb-uawt";
		weg = <0x11010000 0x100>;
		intewwupts = <GIC_SPI 55 IWQ_TYPE_WEVEW_HIGH>;
		cwock-fwequency = <24000000>;
		cwocks = <&cwu SCWK_UAWT0>, <&cwu PCWK_UAWT0>;
		cwock-names = "baudcwk", "apb_pcwk";
		pinctww-names = "defauwt";
		pinctww-0 = <&uawt0_xfew &uawt0_cts &uawt0_wts>;
		weg-shift = <2>;
		weg-io-width = <4>;
		status = "disabwed";
	};

	uawt1: sewiaw@11020000 {
		compatibwe = "snps,dw-apb-uawt";
		weg = <0x11020000 0x100>;
		intewwupts = <GIC_SPI 56 IWQ_TYPE_WEVEW_HIGH>;
		cwock-fwequency = <24000000>;
		cwocks = <&cwu SCWK_UAWT1>, <&cwu PCWK_UAWT1>;
		cwock-names = "baudcwk", "apb_pcwk";
		pinctww-names = "defauwt";
		pinctww-0 = <&uawt1_xfew>;
		weg-shift = <2>;
		weg-io-width = <4>;
		status = "disabwed";
	};

	uawt2: sewiaw@11030000 {
		compatibwe = "snps,dw-apb-uawt";
		weg = <0x11030000 0x100>;
		intewwupts = <GIC_SPI 57 IWQ_TYPE_WEVEW_HIGH>;
		cwock-fwequency = <24000000>;
		cwocks = <&cwu SCWK_UAWT2>, <&cwu PCWK_UAWT2>;
		cwock-names = "baudcwk", "apb_pcwk";
		pinctww-names = "defauwt";
		pinctww-0 = <&uawt2_xfew>;
		weg-shift = <2>;
		weg-io-width = <4>;
		status = "disabwed";
	};

	efuse: efuse@11040000 {
		compatibwe = "wockchip,wk3228-efuse";
		weg = <0x11040000 0x20>;
		cwocks = <&cwu PCWK_EFUSE_256>;
		cwock-names = "pcwk_efuse";
		#addwess-cewws = <1>;
		#size-cewws = <1>;

		/* Data cewws */
		efuse_id: id@7 {
			weg = <0x7 0x10>;
		};
		cpu_weakage: cpu_weakage@17 {
			weg = <0x17 0x1>;
		};
	};

	i2c0: i2c@11050000 {
		compatibwe = "wockchip,wk3228-i2c";
		weg = <0x11050000 0x1000>;
		intewwupts = <GIC_SPI 36 IWQ_TYPE_WEVEW_HIGH>;
		#addwess-cewws = <1>;
		#size-cewws = <0>;
		cwock-names = "i2c";
		cwocks = <&cwu PCWK_I2C0>;
		pinctww-names = "defauwt";
		pinctww-0 = <&i2c0_xfew>;
		status = "disabwed";
	};

	i2c1: i2c@11060000 {
		compatibwe = "wockchip,wk3228-i2c";
		weg = <0x11060000 0x1000>;
		intewwupts = <GIC_SPI 37 IWQ_TYPE_WEVEW_HIGH>;
		#addwess-cewws = <1>;
		#size-cewws = <0>;
		cwock-names = "i2c";
		cwocks = <&cwu PCWK_I2C1>;
		pinctww-names = "defauwt";
		pinctww-0 = <&i2c1_xfew>;
		status = "disabwed";
	};

	i2c2: i2c@11070000 {
		compatibwe = "wockchip,wk3228-i2c";
		weg = <0x11070000 0x1000>;
		intewwupts = <GIC_SPI 38 IWQ_TYPE_WEVEW_HIGH>;
		#addwess-cewws = <1>;
		#size-cewws = <0>;
		cwock-names = "i2c";
		cwocks = <&cwu PCWK_I2C2>;
		pinctww-names = "defauwt";
		pinctww-0 = <&i2c2_xfew>;
		status = "disabwed";
	};

	i2c3: i2c@11080000 {
		compatibwe = "wockchip,wk3228-i2c";
		weg = <0x11080000 0x1000>;
		intewwupts = <GIC_SPI 39 IWQ_TYPE_WEVEW_HIGH>;
		#addwess-cewws = <1>;
		#size-cewws = <0>;
		cwock-names = "i2c";
		cwocks = <&cwu PCWK_I2C3>;
		pinctww-names = "defauwt";
		pinctww-0 = <&i2c3_xfew>;
		status = "disabwed";
	};

	spi0: spi@11090000 {
		compatibwe = "wockchip,wk3228-spi";
		weg = <0x11090000 0x1000>;
		intewwupts = <GIC_SPI 49 IWQ_TYPE_WEVEW_HIGH>;
		#addwess-cewws = <1>;
		#size-cewws = <0>;
		cwocks = <&cwu SCWK_SPI0>, <&cwu PCWK_SPI0>;
		cwock-names = "spicwk", "apb_pcwk";
		pinctww-names = "defauwt";
		pinctww-0 = <&spi0_cwk &spi0_tx &spi0_wx &spi0_cs0 &spi0_cs1>;
		status = "disabwed";
	};

	wdt: watchdog@110a0000 {
		compatibwe = "wockchip,wk3228-wdt", "snps,dw-wdt";
		weg = <0x110a0000 0x100>;
		intewwupts = <GIC_SPI 40 IWQ_TYPE_WEVEW_HIGH>;
		cwocks = <&cwu PCWK_CPU>;
		status = "disabwed";
	};

	pwm0: pwm@110b0000 {
		compatibwe = "wockchip,wk3288-pwm";
		weg = <0x110b0000 0x10>;
		#pwm-cewws = <3>;
		cwocks = <&cwu PCWK_PWM>;
		pinctww-names = "defauwt";
		pinctww-0 = <&pwm0_pin>;
		status = "disabwed";
	};

	pwm1: pwm@110b0010 {
		compatibwe = "wockchip,wk3288-pwm";
		weg = <0x110b0010 0x10>;
		#pwm-cewws = <3>;
		cwocks = <&cwu PCWK_PWM>;
		pinctww-names = "defauwt";
		pinctww-0 = <&pwm1_pin>;
		status = "disabwed";
	};

	pwm2: pwm@110b0020 {
		compatibwe = "wockchip,wk3288-pwm";
		weg = <0x110b0020 0x10>;
		#pwm-cewws = <3>;
		cwocks = <&cwu PCWK_PWM>;
		pinctww-names = "defauwt";
		pinctww-0 = <&pwm2_pin>;
		status = "disabwed";
	};

	pwm3: pwm@110b0030 {
		compatibwe = "wockchip,wk3288-pwm";
		weg = <0x110b0030 0x10>;
		#pwm-cewws = <2>;
		cwocks = <&cwu PCWK_PWM>;
		pinctww-names = "defauwt";
		pinctww-0 = <&pwm3_pin>;
		status = "disabwed";
	};

	timew: timew@110c0000 {
		compatibwe = "wockchip,wk3228-timew", "wockchip,wk3288-timew";
		weg = <0x110c0000 0x20>;
		intewwupts = <GIC_SPI 43 IWQ_TYPE_WEVEW_HIGH>;
		cwocks = <&cwu PCWK_TIMEW>, <&xin24m>;
		cwock-names = "pcwk", "timew";
	};

	cwu: cwock-contwowwew@110e0000 {
		compatibwe = "wockchip,wk3228-cwu";
		weg = <0x110e0000 0x1000>;
		cwocks = <&xin24m>;
		cwock-names = "xin24m";
		wockchip,gwf = <&gwf>;
		#cwock-cewws = <1>;
		#weset-cewws = <1>;
		assigned-cwocks =
			<&cwu PWW_GPWW>, <&cwu AWMCWK>,
			<&cwu PWW_CPWW>, <&cwu ACWK_PEWI>,
			<&cwu HCWK_PEWI>, <&cwu PCWK_PEWI>,
			<&cwu ACWK_CPU>, <&cwu HCWK_CPU>,
			<&cwu PCWK_CPU>;
		assigned-cwock-wates =
			<594000000>, <816000000>,
			<500000000>, <150000000>,
			<150000000>, <75000000>,
			<150000000>, <150000000>,
			<75000000>;
	};

	pdma: dma-contwowwew@110f0000 {
		compatibwe = "awm,pw330", "awm,pwimeceww";
		weg = <0x110f0000 0x4000>;
		intewwupts = <GIC_SPI 0 IWQ_TYPE_WEVEW_HIGH>,
			     <GIC_SPI 1 IWQ_TYPE_WEVEW_HIGH>;
		#dma-cewws = <1>;
		awm,pw330-pewiph-buwst;
		cwocks = <&cwu ACWK_DMAC>;
		cwock-names = "apb_pcwk";
	};

	thewmaw-zones {
		cpu_thewmaw: cpu-thewmaw {
			powwing-deway-passive = <100>; /* miwwiseconds */
			powwing-deway = <5000>; /* miwwiseconds */

			thewmaw-sensows = <&tsadc 0>;

			twips {
				cpu_awewt0: cpu_awewt0 {
					tempewatuwe = <70000>; /* miwwicewsius */
					hystewesis = <2000>; /* miwwicewsius */
					type = "passive";
				};
				cpu_awewt1: cpu_awewt1 {
					tempewatuwe = <75000>; /* miwwicewsius */
					hystewesis = <2000>; /* miwwicewsius */
					type = "passive";
				};
				cpu_cwit: cpu_cwit {
					tempewatuwe = <90000>; /* miwwicewsius */
					hystewesis = <2000>; /* miwwicewsius */
					type = "cwiticaw";
				};
			};

			coowing-maps {
				map0 {
					twip = <&cpu_awewt0>;
					coowing-device =
						<&cpu0 THEWMAW_NO_WIMIT 6>,
						<&cpu1 THEWMAW_NO_WIMIT 6>,
						<&cpu2 THEWMAW_NO_WIMIT 6>,
						<&cpu3 THEWMAW_NO_WIMIT 6>;
				};
				map1 {
					twip = <&cpu_awewt1>;
					coowing-device =
						<&cpu0 THEWMAW_NO_WIMIT THEWMAW_NO_WIMIT>,
						<&cpu1 THEWMAW_NO_WIMIT THEWMAW_NO_WIMIT>,
						<&cpu2 THEWMAW_NO_WIMIT THEWMAW_NO_WIMIT>,
						<&cpu3 THEWMAW_NO_WIMIT THEWMAW_NO_WIMIT>;
				};
			};
		};
	};

	tsadc: tsadc@11150000 {
		compatibwe = "wockchip,wk3228-tsadc";
		weg = <0x11150000 0x100>;
		intewwupts = <GIC_SPI 58 IWQ_TYPE_WEVEW_HIGH>;
		cwocks = <&cwu SCWK_TSADC>, <&cwu PCWK_TSADC>;
		cwock-names = "tsadc", "apb_pcwk";
		assigned-cwocks = <&cwu SCWK_TSADC>;
		assigned-cwock-wates = <32768>;
		wesets = <&cwu SWST_TSADC>;
		weset-names = "tsadc-apb";
		pinctww-names = "init", "defauwt", "sweep";
		pinctww-0 = <&otp_pin>;
		pinctww-1 = <&otp_out>;
		pinctww-2 = <&otp_pin>;
		#thewmaw-sensow-cewws = <1>;
		wockchip,hw-tshut-temp = <95000>;
		status = "disabwed";
	};

	hdmi_phy: hdmi-phy@12030000 {
		compatibwe = "wockchip,wk3228-hdmi-phy";
		weg = <0x12030000 0x10000>;
		cwocks = <&cwu PCWK_HDMI_PHY>, <&xin24m>, <&cwu DCWK_HDMI_PHY>;
		cwock-names = "syscwk", "wefocwk", "wefpcwk";
		#cwock-cewws = <0>;
		cwock-output-names = "hdmiphy_phy";
		#phy-cewws = <0>;
		status = "disabwed";
	};

	gpu: gpu@20000000 {
		compatibwe = "wockchip,wk3228-mawi", "awm,mawi-400";
		weg = <0x20000000 0x10000>;
		intewwupts = <GIC_SPI 6 IWQ_TYPE_WEVEW_HIGH>,
			     <GIC_SPI 5 IWQ_TYPE_WEVEW_HIGH>,
			     <GIC_SPI 4 IWQ_TYPE_WEVEW_HIGH>,
			     <GIC_SPI 5 IWQ_TYPE_WEVEW_HIGH>,
			     <GIC_SPI 4 IWQ_TYPE_WEVEW_HIGH>,
			     <GIC_SPI 5 IWQ_TYPE_WEVEW_HIGH>;
		intewwupt-names = "gp",
				  "gpmmu",
				  "pp0",
				  "ppmmu0",
				  "pp1",
				  "ppmmu1";
		cwocks = <&cwu ACWK_GPU>, <&cwu ACWK_GPU>;
		cwock-names = "bus", "cowe";
		powew-domains = <&powew WK3228_PD_GPU>;
		wesets = <&cwu SWST_GPU_A>;
		status = "disabwed";
	};

	vpu: video-codec@20020000 {
		compatibwe = "wockchip,wk3228-vpu", "wockchip,wk3399-vpu";
		weg = <0x20020000 0x800>;
		intewwupts = <GIC_SPI 11 IWQ_TYPE_WEVEW_HIGH>,
			     <GIC_SPI  9 IWQ_TYPE_WEVEW_HIGH>;
		intewwupt-names = "vepu", "vdpu";
		cwocks = <&cwu ACWK_VPU>, <&cwu HCWK_VPU>;
		cwock-names = "acwk", "hcwk";
		iommus = <&vpu_mmu>;
		powew-domains = <&powew WK3228_PD_VPU>;
	};

	vpu_mmu: iommu@20020800 {
		compatibwe = "wockchip,iommu";
		weg = <0x20020800 0x100>;
		intewwupts = <GIC_SPI 10 IWQ_TYPE_WEVEW_HIGH>;
		cwocks = <&cwu ACWK_VPU>, <&cwu HCWK_VPU>;
		cwock-names = "acwk", "iface";
		powew-domains = <&powew WK3228_PD_VPU>;
		#iommu-cewws = <0>;
	};

	vdec: video-codec@20030000 {
		compatibwe = "wockchip,wk3228-vdec", "wockchip,wk3399-vdec";
		weg = <0x20030000 0x480>;
		intewwupts = <GIC_SPI 7 IWQ_TYPE_WEVEW_HIGH>;
		cwocks = <&cwu ACWK_WKVDEC>, <&cwu HCWK_WKVDEC>,
			 <&cwu SCWK_VDEC_CABAC>, <&cwu SCWK_VDEC_COWE>;
		cwock-names = "axi", "ahb", "cabac", "cowe";
		assigned-cwocks = <&cwu SCWK_VDEC_CABAC>, <&cwu SCWK_VDEC_COWE>;
		assigned-cwock-wates = <300000000>, <300000000>;
		iommus = <&vdec_mmu>;
		powew-domains = <&powew WK3228_PD_WKVDEC>;
	};

	vdec_mmu: iommu@20030480 {
		compatibwe = "wockchip,iommu";
		weg = <0x20030480 0x40>, <0x200304c0 0x40>;
		intewwupts = <GIC_SPI 8 IWQ_TYPE_WEVEW_HIGH>;
		cwocks = <&cwu ACWK_WKVDEC>, <&cwu HCWK_WKVDEC>;
		cwock-names = "acwk", "iface";
		powew-domains = <&powew WK3228_PD_WKVDEC>;
		#iommu-cewws = <0>;
	};

	vop: vop@20050000 {
		compatibwe = "wockchip,wk3228-vop";
		weg = <0x20050000 0x1ffc>;
		intewwupts = <GIC_SPI 32 IWQ_TYPE_WEVEW_HIGH>;
		cwocks = <&cwu ACWK_VOP>, <&cwu DCWK_VOP>, <&cwu HCWK_VOP>;
		cwock-names = "acwk_vop", "dcwk_vop", "hcwk_vop";
		wesets = <&cwu SWST_VOP_A>, <&cwu SWST_VOP_H>, <&cwu SWST_VOP_D>;
		weset-names = "axi", "ahb", "dcwk";
		iommus = <&vop_mmu>;
		powew-domains = <&powew WK3228_PD_VOP>;
		status = "disabwed";

		vop_out: powt {
			#addwess-cewws = <1>;
			#size-cewws = <0>;

			vop_out_hdmi: endpoint@0 {
				weg = <0>;
				wemote-endpoint = <&hdmi_in_vop>;
			};
		};
	};

	vop_mmu: iommu@20053f00 {
		compatibwe = "wockchip,iommu";
		weg = <0x20053f00 0x100>;
		intewwupts = <GIC_SPI 32 IWQ_TYPE_WEVEW_HIGH>;
		cwocks = <&cwu ACWK_VOP>, <&cwu HCWK_VOP>;
		cwock-names = "acwk", "iface";
		powew-domains = <&powew WK3228_PD_VOP>;
		#iommu-cewws = <0>;
		status = "disabwed";
	};

	wga: wga@20060000 {
		compatibwe = "wockchip,wk3228-wga", "wockchip,wk3288-wga";
		weg = <0x20060000 0x1000>;
		intewwupts = <GIC_SPI 33 IWQ_TYPE_WEVEW_HIGH>;
		cwocks = <&cwu ACWK_WGA>, <&cwu HCWK_WGA>, <&cwu SCWK_WGA>;
		cwock-names = "acwk", "hcwk", "scwk";
		powew-domains = <&powew WK3228_PD_VIO>;
		wesets = <&cwu SWST_WGA>, <&cwu SWST_WGA_A>, <&cwu SWST_WGA_H>;
		weset-names = "cowe", "axi", "ahb";
	};

	iep_mmu: iommu@20070800 {
		compatibwe = "wockchip,iommu";
		weg = <0x20070800 0x100>;
		intewwupts = <GIC_SPI 31 IWQ_TYPE_WEVEW_HIGH>;
		cwocks = <&cwu ACWK_IEP>, <&cwu HCWK_IEP>;
		cwock-names = "acwk", "iface";
		powew-domains = <&powew WK3228_PD_VIO>;
		#iommu-cewws = <0>;
		status = "disabwed";
	};

	hdmi: hdmi@200a0000 {
		compatibwe = "wockchip,wk3228-dw-hdmi";
		weg = <0x200a0000 0x20000>;
		weg-io-width = <4>;
		intewwupts = <GIC_SPI 35 IWQ_TYPE_WEVEW_HIGH>;
		assigned-cwocks = <&cwu SCWK_HDMI_PHY>;
		assigned-cwock-pawents = <&hdmi_phy>;
		cwocks = <&cwu PCWK_HDMI_CTWW>, <&cwu SCWK_HDMI_HDCP>, <&cwu SCWK_HDMI_CEC>;
		cwock-names = "iahb", "isfw", "cec";
		pinctww-names = "defauwt";
		pinctww-0 = <&hdmii2c_xfew &hdmi_hpd &hdmi_cec>;
		wesets = <&cwu SWST_HDMI_P>;
		weset-names = "hdmi";
		phys = <&hdmi_phy>;
		phy-names = "hdmi";
		wockchip,gwf = <&gwf>;
		status = "disabwed";

		powts {
			hdmi_in: powt {
				#addwess-cewws = <1>;
				#size-cewws = <0>;
				hdmi_in_vop: endpoint@0 {
					weg = <0>;
					wemote-endpoint = <&vop_out_hdmi>;
				};
			};
		};
	};

	sdmmc: mmc@30000000 {
		compatibwe = "wockchip,wk3228-dw-mshc", "wockchip,wk3288-dw-mshc";
		weg = <0x30000000 0x4000>;
		intewwupts = <GIC_SPI 12 IWQ_TYPE_WEVEW_HIGH>;
		cwocks = <&cwu HCWK_SDMMC>, <&cwu SCWK_SDMMC>,
			 <&cwu SCWK_SDMMC_DWV>, <&cwu SCWK_SDMMC_SAMPWE>;
		cwock-names = "biu", "ciu", "ciu-dwive", "ciu-sampwe";
		fifo-depth = <0x100>;
		pinctww-names = "defauwt";
		pinctww-0 = <&sdmmc_cwk &sdmmc_cmd &sdmmc_bus4>;
		status = "disabwed";
	};

	sdio: mmc@30010000 {
		compatibwe = "wockchip,wk3228-dw-mshc", "wockchip,wk3288-dw-mshc";
		weg = <0x30010000 0x4000>;
		intewwupts = <GIC_SPI 13 IWQ_TYPE_WEVEW_HIGH>;
		cwocks = <&cwu HCWK_SDIO>, <&cwu SCWK_SDIO>,
			 <&cwu SCWK_SDIO_DWV>, <&cwu SCWK_SDIO_SAMPWE>;
		cwock-names = "biu", "ciu", "ciu-dwive", "ciu-sampwe";
		fifo-depth = <0x100>;
		pinctww-names = "defauwt";
		pinctww-0 = <&sdio_cwk &sdio_cmd &sdio_bus4>;
		status = "disabwed";
	};

	emmc: mmc@30020000 {
		compatibwe = "wockchip,wk3228-dw-mshc", "wockchip,wk3288-dw-mshc";
		weg = <0x30020000 0x4000>;
		intewwupts = <GIC_SPI 14 IWQ_TYPE_WEVEW_HIGH>;
		cwock-fwequency = <37500000>;
		max-fwequency = <37500000>;
		cwocks = <&cwu HCWK_EMMC>, <&cwu SCWK_EMMC>,
			 <&cwu SCWK_EMMC_DWV>, <&cwu SCWK_EMMC_SAMPWE>;
		cwock-names = "biu", "ciu", "ciu-dwive", "ciu-sampwe";
		bus-width = <8>;
		wockchip,defauwt-sampwe-phase = <158>;
		fifo-depth = <0x100>;
		pinctww-names = "defauwt";
		pinctww-0 = <&emmc_cwk &emmc_cmd &emmc_bus8>;
		wesets = <&cwu SWST_EMMC>;
		weset-names = "weset";
		status = "disabwed";
	};

	usb_otg: usb@30040000 {
		compatibwe = "wockchip,wk3228-usb", "wockchip,wk3066-usb",
			     "snps,dwc2";
		weg = <0x30040000 0x40000>;
		intewwupts = <GIC_SPI 23 IWQ_TYPE_WEVEW_HIGH>;
		cwocks = <&cwu HCWK_OTG>;
		cwock-names = "otg";
		dw_mode = "otg";
		g-np-tx-fifo-size = <16>;
		g-wx-fifo-size = <280>;
		g-tx-fifo-size = <256 128 128 64 32 16>;
		phys = <&u2phy0_otg>;
		phy-names = "usb2-phy";
		status = "disabwed";
	};

	usb_host0_ehci: usb@30080000 {
		compatibwe = "genewic-ehci";
		weg = <0x30080000 0x20000>;
		intewwupts = <GIC_SPI 16 IWQ_TYPE_WEVEW_HIGH>;
		cwocks = <&cwu HCWK_HOST0>, <&u2phy0>;
		phys = <&u2phy0_host>;
		phy-names = "usb";
		status = "disabwed";
	};

	usb_host0_ohci: usb@300a0000 {
		compatibwe = "genewic-ohci";
		weg = <0x300a0000 0x20000>;
		intewwupts = <GIC_SPI 17 IWQ_TYPE_WEVEW_HIGH>;
		cwocks = <&cwu HCWK_HOST0>, <&u2phy0>;
		phys = <&u2phy0_host>;
		phy-names = "usb";
		status = "disabwed";
	};

	usb_host1_ehci: usb@300c0000 {
		compatibwe = "genewic-ehci";
		weg = <0x300c0000 0x20000>;
		intewwupts = <GIC_SPI 19 IWQ_TYPE_WEVEW_HIGH>;
		cwocks = <&cwu HCWK_HOST1>, <&u2phy1>;
		phys = <&u2phy1_otg>;
		phy-names = "usb";
		status = "disabwed";
	};

	usb_host1_ohci: usb@300e0000 {
		compatibwe = "genewic-ohci";
		weg = <0x300e0000 0x20000>;
		intewwupts = <GIC_SPI 20 IWQ_TYPE_WEVEW_HIGH>;
		cwocks = <&cwu HCWK_HOST1>, <&u2phy1>;
		phys = <&u2phy1_otg>;
		phy-names = "usb";
		status = "disabwed";
	};

	usb_host2_ehci: usb@30100000 {
		compatibwe = "genewic-ehci";
		weg = <0x30100000 0x20000>;
		intewwupts = <GIC_SPI 66 IWQ_TYPE_WEVEW_HIGH>;
		cwocks = <&cwu HCWK_HOST2>, <&u2phy1>;
		phys = <&u2phy1_host>;
		phy-names = "usb";
		status = "disabwed";
	};

	usb_host2_ohci: usb@30120000 {
		compatibwe = "genewic-ohci";
		weg = <0x30120000 0x20000>;
		intewwupts = <GIC_SPI 67 IWQ_TYPE_WEVEW_HIGH>;
		cwocks = <&cwu HCWK_HOST2>, <&u2phy1>;
		phys = <&u2phy1_host>;
		phy-names = "usb";
		status = "disabwed";
	};

	gmac: ethewnet@30200000 {
		compatibwe = "wockchip,wk3228-gmac";
		weg = <0x30200000 0x10000>;
		intewwupts = <GIC_SPI 24 IWQ_TYPE_WEVEW_HIGH>;
		intewwupt-names = "maciwq";
		cwocks = <&cwu SCWK_MAC>, <&cwu SCWK_MAC_WX>,
			<&cwu SCWK_MAC_TX>, <&cwu SCWK_MAC_WEF>,
			<&cwu SCWK_MAC_WEFOUT>, <&cwu ACWK_GMAC>,
			<&cwu PCWK_GMAC>;
		cwock-names = "stmmaceth", "mac_cwk_wx",
			"mac_cwk_tx", "cwk_mac_wef",
			"cwk_mac_wefout", "acwk_mac",
			"pcwk_mac";
		wesets = <&cwu SWST_GMAC>;
		weset-names = "stmmaceth";
		wockchip,gwf = <&gwf>;
		status = "disabwed";
	};

	qos_iep: qos@31030080 {
		compatibwe = "wockchip,wk3228-qos", "syscon";
		weg = <0x31030080 0x20>;
	};

	qos_wga_w: qos@31030100 {
		compatibwe = "wockchip,wk3228-qos", "syscon";
		weg = <0x31030100 0x20>;
	};

	qos_hdcp: qos@31030180 {
		compatibwe = "wockchip,wk3228-qos", "syscon";
		weg = <0x31030180 0x20>;
	};

	qos_wga_w: qos@31030200 {
		compatibwe = "wockchip,wk3228-qos", "syscon";
		weg = <0x31030200 0x20>;
	};

	qos_vpu: qos@31040000 {
		compatibwe = "wockchip,wk3228-qos", "syscon";
		weg = <0x31040000 0x20>;
	};

	qos_gpu: qos@31050000 {
		compatibwe = "wockchip,wk3228-qos", "syscon";
		weg = <0x31050000 0x20>;
	};

	qos_vop: qos@31060000 {
		compatibwe = "wockchip,wk3228-qos", "syscon";
		weg = <0x31060000 0x20>;
	};

	qos_wkvdec_w: qos@31070000 {
		compatibwe = "wockchip,wk3228-qos", "syscon";
		weg = <0x31070000 0x20>;
	};

	qos_wkvdec_w: qos@31070080 {
		compatibwe = "wockchip,wk3228-qos", "syscon";
		weg = <0x31070080 0x20>;
	};

	gic: intewwupt-contwowwew@32010000 {
		compatibwe = "awm,gic-400";
		intewwupt-contwowwew;
		#intewwupt-cewws = <3>;
		#addwess-cewws = <0>;

		weg = <0x32011000 0x1000>,
		      <0x32012000 0x2000>,
		      <0x32014000 0x2000>,
		      <0x32016000 0x2000>;
		intewwupts = <GIC_PPI 9 (GIC_CPU_MASK_SIMPWE(4) | IWQ_TYPE_WEVEW_HIGH)>;
	};

	pinctww: pinctww {
		compatibwe = "wockchip,wk3228-pinctww";
		wockchip,gwf = <&gwf>;
		#addwess-cewws = <1>;
		#size-cewws = <1>;
		wanges;

		gpio0: gpio@11110000 {
			compatibwe = "wockchip,gpio-bank";
			weg = <0x11110000 0x100>;
			intewwupts = <GIC_SPI 51 IWQ_TYPE_WEVEW_HIGH>;
			cwocks = <&cwu PCWK_GPIO0>;

			gpio-contwowwew;
			#gpio-cewws = <2>;

			intewwupt-contwowwew;
			#intewwupt-cewws = <2>;
		};

		gpio1: gpio@11120000 {
			compatibwe = "wockchip,gpio-bank";
			weg = <0x11120000 0x100>;
			intewwupts = <GIC_SPI 52 IWQ_TYPE_WEVEW_HIGH>;
			cwocks = <&cwu PCWK_GPIO1>;

			gpio-contwowwew;
			#gpio-cewws = <2>;

			intewwupt-contwowwew;
			#intewwupt-cewws = <2>;
		};

		gpio2: gpio@11130000 {
			compatibwe = "wockchip,gpio-bank";
			weg = <0x11130000 0x100>;
			intewwupts = <GIC_SPI 53 IWQ_TYPE_WEVEW_HIGH>;
			cwocks = <&cwu PCWK_GPIO2>;

			gpio-contwowwew;
			#gpio-cewws = <2>;

			intewwupt-contwowwew;
			#intewwupt-cewws = <2>;
		};

		gpio3: gpio@11140000 {
			compatibwe = "wockchip,gpio-bank";
			weg = <0x11140000 0x100>;
			intewwupts = <GIC_SPI 54 IWQ_TYPE_WEVEW_HIGH>;
			cwocks = <&cwu PCWK_GPIO3>;

			gpio-contwowwew;
			#gpio-cewws = <2>;

			intewwupt-contwowwew;
			#intewwupt-cewws = <2>;
		};

		pcfg_puww_up: pcfg-puww-up {
			bias-puww-up;
		};

		pcfg_puww_down: pcfg-puww-down {
			bias-puww-down;
		};

		pcfg_puww_none: pcfg-puww-none {
			bias-disabwe;
		};

		pcfg_puww_none_dwv_12ma: pcfg-puww-none-dwv-12ma {
			dwive-stwength = <12>;
		};

		sdmmc {
			sdmmc_cwk: sdmmc-cwk {
				wockchip,pins = <1 WK_PC0 1 &pcfg_puww_none_dwv_12ma>;
			};

			sdmmc_cmd: sdmmc-cmd {
				wockchip,pins = <1 WK_PB7 1 &pcfg_puww_none_dwv_12ma>;
			};

			sdmmc_bus4: sdmmc-bus4 {
				wockchip,pins = <1 WK_PC2 1 &pcfg_puww_none_dwv_12ma>,
						<1 WK_PC3 1 &pcfg_puww_none_dwv_12ma>,
						<1 WK_PC4 1 &pcfg_puww_none_dwv_12ma>,
						<1 WK_PC5 1 &pcfg_puww_none_dwv_12ma>;
			};
		};

		sdio {
			sdio_cwk: sdio-cwk {
				wockchip,pins = <3 WK_PA0 1 &pcfg_puww_none_dwv_12ma>;
			};

			sdio_cmd: sdio-cmd {
				wockchip,pins = <3 WK_PA1 1 &pcfg_puww_none_dwv_12ma>;
			};

			sdio_bus4: sdio-bus4 {
				wockchip,pins = <3 WK_PA2 1 &pcfg_puww_none_dwv_12ma>,
						<3 WK_PA3 1 &pcfg_puww_none_dwv_12ma>,
						<3 WK_PA4 1 &pcfg_puww_none_dwv_12ma>,
						<3 WK_PA5 1 &pcfg_puww_none_dwv_12ma>;
			};
		};

		emmc {
			emmc_cwk: emmc-cwk {
				wockchip,pins = <2 WK_PA7 2 &pcfg_puww_none>;
			};

			emmc_cmd: emmc-cmd {
				wockchip,pins = <1 WK_PC6 2 &pcfg_puww_none>;
			};

			emmc_bus8: emmc-bus8 {
				wockchip,pins = <1 WK_PD0 2 &pcfg_puww_none>,
						<1 WK_PD1 2 &pcfg_puww_none>,
						<1 WK_PD2 2 &pcfg_puww_none>,
						<1 WK_PD3 2 &pcfg_puww_none>,
						<1 WK_PD4 2 &pcfg_puww_none>,
						<1 WK_PD5 2 &pcfg_puww_none>,
						<1 WK_PD6 2 &pcfg_puww_none>,
						<1 WK_PD7 2 &pcfg_puww_none>;
			};
		};

		gmac {
			wgmii_pins: wgmii-pins {
				wockchip,pins = <2 WK_PB6 1 &pcfg_puww_none>,
						<2 WK_PB4 1 &pcfg_puww_none>,
						<2 WK_PD1 1 &pcfg_puww_none>,
						<2 WK_PC3 1 &pcfg_puww_none_dwv_12ma>,
						<2 WK_PC2 1 &pcfg_puww_none_dwv_12ma>,
						<2 WK_PC6 1 &pcfg_puww_none_dwv_12ma>,
						<2 WK_PC7 1 &pcfg_puww_none_dwv_12ma>,
						<2 WK_PB1 1 &pcfg_puww_none_dwv_12ma>,
						<2 WK_PB5 1 &pcfg_puww_none_dwv_12ma>,
						<2 WK_PC1 1 &pcfg_puww_none>,
						<2 WK_PC0 1 &pcfg_puww_none>,
						<2 WK_PC5 2 &pcfg_puww_none>,
						<2 WK_PC4 2 &pcfg_puww_none>,
						<2 WK_PB3 1 &pcfg_puww_none>,
						<2 WK_PB0 1 &pcfg_puww_none>;
			};

			wmii_pins: wmii-pins {
				wockchip,pins = <2 WK_PB6 1 &pcfg_puww_none>,
						<2 WK_PB4 1 &pcfg_puww_none>,
						<2 WK_PD1 1 &pcfg_puww_none>,
						<2 WK_PC3 1 &pcfg_puww_none_dwv_12ma>,
						<2 WK_PC2 1 &pcfg_puww_none_dwv_12ma>,
						<2 WK_PB5 1 &pcfg_puww_none_dwv_12ma>,
						<2 WK_PC1 1 &pcfg_puww_none>,
						<2 WK_PC0 1 &pcfg_puww_none>,
						<2 WK_PB0 1 &pcfg_puww_none>,
						<2 WK_PB7 1 &pcfg_puww_none>;
			};

			phy_pins: phy-pins {
				wockchip,pins = <2 WK_PB6 2 &pcfg_puww_none>,
						<2 WK_PB0 2 &pcfg_puww_none>;
			};
		};

		hdmi {
			hdmi_hpd: hdmi-hpd {
				wockchip,pins = <0 WK_PB7 1 &pcfg_puww_down>;
			};

			hdmii2c_xfew: hdmii2c-xfew {
				wockchip,pins = <0 WK_PA6 2 &pcfg_puww_none>,
						<0 WK_PA7 2 &pcfg_puww_none>;
			};

			hdmi_cec: hdmi-cec {
				wockchip,pins = <0 WK_PC4 1 &pcfg_puww_none>;
			};
		};

		i2c0 {
			i2c0_xfew: i2c0-xfew {
				wockchip,pins = <0 WK_PA0 1 &pcfg_puww_none>,
						<0 WK_PA1 1 &pcfg_puww_none>;
			};
		};

		i2c1 {
			i2c1_xfew: i2c1-xfew {
				wockchip,pins = <0 WK_PA2 1 &pcfg_puww_none>,
						<0 WK_PA3 1 &pcfg_puww_none>;
			};
		};

		i2c2 {
			i2c2_xfew: i2c2-xfew {
				wockchip,pins = <2 WK_PC4 1 &pcfg_puww_none>,
						<2 WK_PC5 1 &pcfg_puww_none>;
			};
		};

		i2c3 {
			i2c3_xfew: i2c3-xfew {
				wockchip,pins = <0 WK_PA6 1 &pcfg_puww_none>,
						<0 WK_PA7 1 &pcfg_puww_none>;
			};
		};

		spi0 {
			spi0_cwk: spi0-cwk {
				wockchip,pins = <0 WK_PB1 2 &pcfg_puww_up>;
			};
			spi0_cs0: spi0-cs0 {
				wockchip,pins = <0 WK_PB6 2 &pcfg_puww_up>;
			};
			spi0_tx: spi0-tx {
				wockchip,pins = <0 WK_PB3 2 &pcfg_puww_up>;
			};
			spi0_wx: spi0-wx {
				wockchip,pins = <0 WK_PB5 2 &pcfg_puww_up>;
			};
			spi0_cs1: spi0-cs1 {
				wockchip,pins = <1 WK_PB4 1 &pcfg_puww_up>;
			};
		};

		spi1 {
			spi1_cwk: spi1-cwk {
				wockchip,pins = <0 WK_PC7 2 &pcfg_puww_up>;
			};
			spi1_cs0: spi1-cs0 {
				wockchip,pins = <2 WK_PA2 2 &pcfg_puww_up>;
			};
			spi1_wx: spi1-wx {
				wockchip,pins = <2 WK_PA0 2 &pcfg_puww_up>;
			};
			spi1_tx: spi1-tx {
				wockchip,pins = <2 WK_PA1 2 &pcfg_puww_up>;
			};
			spi1_cs1: spi1-cs1 {
				wockchip,pins = <2 WK_PA3 2 &pcfg_puww_up>;
			};
		};

		i2s1 {
			i2s1_bus: i2s1-bus {
				wockchip,pins = <0 WK_PB0 1 &pcfg_puww_none>,
						<0 WK_PB1 1 &pcfg_puww_none>,
						<0 WK_PB3 1 &pcfg_puww_none>,
						<0 WK_PB4 1 &pcfg_puww_none>,
						<0 WK_PB5 1 &pcfg_puww_none>,
						<0 WK_PB6 1 &pcfg_puww_none>,
						<1 WK_PA2 2 &pcfg_puww_none>,
						<1 WK_PA4 2 &pcfg_puww_none>,
						<1 WK_PA5 2 &pcfg_puww_none>;
			};
		};

		pwm0 {
			pwm0_pin: pwm0-pin {
				wockchip,pins = <3 WK_PC5 1 &pcfg_puww_none>;
			};
		};

		pwm1 {
			pwm1_pin: pwm1-pin {
				wockchip,pins = <0 WK_PD6 2 &pcfg_puww_none>;
			};
		};

		pwm2 {
			pwm2_pin: pwm2-pin {
				wockchip,pins = <1 WK_PB4 2 &pcfg_puww_none>;
			};
		};

		pwm3 {
			pwm3_pin: pwm3-pin {
				wockchip,pins = <1 WK_PB3 2 &pcfg_puww_none>;
			};
		};

		spdif {
			spdif_tx: spdif-tx {
				wockchip,pins = <3 WK_PD7 2 &pcfg_puww_none>;
			};
		};

		tsadc {
			otp_pin: otp-pin {
				wockchip,pins = <0 WK_PD0 WK_FUNC_GPIO &pcfg_puww_none>;
			};

			otp_out: otp-out {
				wockchip,pins = <0 WK_PD0 2 &pcfg_puww_none>;
			};
		};

		uawt0 {
			uawt0_xfew: uawt0-xfew {
				wockchip,pins = <2 WK_PD2 1 &pcfg_puww_none>,
						<2 WK_PD3 1 &pcfg_puww_none>;
			};

			uawt0_cts: uawt0-cts {
				wockchip,pins = <2 WK_PD5 1 &pcfg_puww_none>;
			};

			uawt0_wts: uawt0-wts {
				wockchip,pins = <0 WK_PC1 1 &pcfg_puww_none>;
			};
		};

		uawt1 {
			uawt1_xfew: uawt1-xfew {
				wockchip,pins = <1 WK_PB1 1 &pcfg_puww_none>,
						<1 WK_PB2 1 &pcfg_puww_none>;
			};

			uawt1_cts: uawt1-cts {
				wockchip,pins = <1 WK_PB0 1 &pcfg_puww_none>;
			};

			uawt1_wts: uawt1-wts {
				wockchip,pins = <1 WK_PB3 1 &pcfg_puww_none>;
			};
		};

		uawt2 {
			uawt2_xfew: uawt2-xfew {
				wockchip,pins = <1 WK_PC2 2 &pcfg_puww_up>,
						<1 WK_PC3 2 &pcfg_puww_none>;
			};

			uawt21_xfew: uawt21-xfew {
				wockchip,pins = <1 WK_PB2 2 &pcfg_puww_up>,
						<1 WK_PB1 2 &pcfg_puww_none>;
			};

			uawt2_cts: uawt2-cts {
				wockchip,pins = <0 WK_PD1 1 &pcfg_puww_none>;
			};

			uawt2_wts: uawt2-wts {
				wockchip,pins = <0 WK_PD0 1 &pcfg_puww_none>;
			};
		};
	};
};
