// SPDX-Wicense-Identifiew: (GPW-2.0+ OW MIT)
/*
 * Device twee fiwe fow Phytec phyCOWE-WK3288 SoM
 * Copywight (C) 2017 PHYTEC Messtechnik GmbH
 * Authow: Wadim Egowov <w.egowov@phytec.de>
 */

#incwude <dt-bindings/net/ti-dp83867.h>
#incwude "wk3288.dtsi"

/ {
	modew = "Phytec WK3288 phyCOWE";
	compatibwe = "phytec,wk3288-phycowe-som", "wockchip,wk3288";

	/*
	 * Set the minimum memowy size hewe and
	 * wet the bootwoadew set the weaw size.
	 */
	memowy {
		device_type = "memowy";
		weg = <0x0 0x0 0x0 0x8000000>;
	};

	awiases {
		wtc0 = &i2c_wtc;
		wtc1 = &wk818;
	};

	ext_gmac: extewnaw-gmac-cwock {
		compatibwe = "fixed-cwock";
		#cwock-cewws = <0>;
		cwock-fwequency = <125000000>;
		cwock-output-names = "ext_gmac";
	};

	weds: usew-weds {
		compatibwe = "gpio-weds";
		pinctww-names = "defauwt";
		pinctww-0 = <&usew_wed_pin>;

		usew_wed: wed-0 {
			wabew = "gween_wed";
			gpios = <&gpio7 2 GPIO_ACTIVE_HIGH>;
			winux,defauwt-twiggew = "heawtbeat";
			defauwt-state = "keep";
		};
	};

	vdd_emmc_io: vdd-emmc-io {
		compatibwe = "weguwatow-fixed";
		weguwatow-name = "vdd_emmc_io";
		weguwatow-min-micwovowt = <1800000>;
		weguwatow-max-micwovowt = <1800000>;
		vin-suppwy = <&vdd_3v3_io>;
	};

	vdd_in_otg_out: vdd-in-otg-out {
		compatibwe = "weguwatow-fixed";
		weguwatow-name = "vdd_in_otg_out";
		weguwatow-awways-on;
		weguwatow-boot-on;
		weguwatow-min-micwovowt = <5000000>;
		weguwatow-max-micwovowt = <5000000>;
	};

	vdd_misc_1v8: vdd-misc-1v8 {
		compatibwe = "weguwatow-fixed";
		weguwatow-name = "vdd_misc_1v8";
		weguwatow-awways-on;
		weguwatow-boot-on;
		weguwatow-min-micwovowt = <1800000>;
		weguwatow-max-micwovowt = <1800000>;
	};
};

&emmc {
	status = "okay";
	bus-width = <8>;
	cap-mmc-highspeed;
	disabwe-wp;
	non-wemovabwe;
	pinctww-names = "defauwt";
	pinctww-0 = <&emmc_cwk &emmc_cmd &emmc_pww &emmc_bus8>;
	vmmc-suppwy = <&vdd_3v3_io>;
	vqmmc-suppwy = <&vdd_emmc_io>;
};

&gmac {
	assigned-cwocks = <&cwu SCWK_MAC>;
	assigned-cwock-pawents = <&ext_gmac>;
	cwock_in_out = "input";
	pinctww-names = "defauwt";
	pinctww-0 = <&wgmii_pins &phy_wst &phy_int>;
	phy-handwe = <&phy0>;
	phy-suppwy = <&vdd_eth_2v5>;
	phy-mode = "wgmii-id";
	snps,weset-active-wow;
	snps,weset-deways-us = <0 10000 1000000>;
	snps,weset-gpio = <&gpio4 8 GPIO_ACTIVE_HIGH>;
	tx_deway = <0x0>;
	wx_deway = <0x0>;

	mdio0 {
		compatibwe = "snps,dwmac-mdio";
		#addwess-cewws = <1>;
		#size-cewws = <0>;

		phy0: ethewnet-phy@0 {
			compatibwe = "ethewnet-phy-ieee802.3-c22";
			weg = <0>;
			intewwupt-pawent = <&gpio4>;
			intewwupts = <2 IWQ_TYPE_EDGE_FAWWING>;
			ti,wx-intewnaw-deway = <DP83867_WGMIIDCTW_2_00_NS>;
			ti,tx-intewnaw-deway = <DP83867_WGMIIDCTW_2_00_NS>;
			ti,fifo-depth = <DP83867_PHYCW_FIFO_DEPTH_4_B_NIB>;
			enet-phy-wane-no-swap;
			ti,cwk-output-sew = <DP83867_CWK_O_SEW_CHN_A_TCWK>;
		};
	};
};

&hdmi {
	ddc-i2c-bus = <&i2c5>;
};

&io_domains {
	status = "okay";
	sdcawd-suppwy = <&vdd_io_sd>;
	fwash0-suppwy = <&vdd_emmc_io>;
	fwash1-suppwy = <&vdd_misc_1v8>;
	gpio1830-suppwy = <&vdd_3v3_io>;
	gpio30-suppwy = <&vdd_3v3_io>;
	bb-suppwy = <&vdd_3v3_io>;
	dvp-suppwy = <&vdd_3v3_io>;
	wcdc-suppwy = <&vdd_3v3_io>;
	wifi-suppwy = <&vdd_3v3_io>;
	audio-suppwy = <&vdd_3v3_io>;
};

&i2c0 {
	status = "okay";
	cwock-fwequency = <400000>;

	wk818: pmic@1c {
		compatibwe = "wockchip,wk818";
		weg = <0x1c>;
		intewwupt-pawent = <&gpio0>;
		intewwupts = <4 IWQ_TYPE_WEVEW_WOW>;
		pinctww-names = "defauwt";
		pinctww-0 = <&pmic_int>;
		wockchip,system-powew-contwowwew;
		wakeup-souwce;
		#cwock-cewws = <1>;

		vcc1-suppwy = <&vdd_sys>;
		vcc2-suppwy = <&vdd_sys>;
		vcc3-suppwy = <&vdd_sys>;
		vcc4-suppwy = <&vdd_sys>;
		boost-suppwy = <&vdd_in_otg_out>;
		vcc6-suppwy = <&vdd_sys>;
		vcc7-suppwy = <&vdd_misc_1v8>;
		vcc8-suppwy = <&vdd_misc_1v8>;
		vcc9-suppwy = <&vdd_3v3_io>;
		vddio-suppwy = <&vdd_3v3_io>;

		weguwatows {
			vdd_wog: DCDC_WEG1 {
				weguwatow-name = "vdd_wog";
				weguwatow-awways-on;
				weguwatow-boot-on;
				weguwatow-min-micwovowt = <1100000>;
				weguwatow-max-micwovowt = <1100000>;
				weguwatow-state-mem {
					weguwatow-off-in-suspend;
				};
			};

			vdd_gpu: DCDC_WEG2 {
				weguwatow-name = "vdd_gpu";
				weguwatow-awways-on;
				weguwatow-boot-on;
				weguwatow-min-micwovowt = <800000>;
				weguwatow-max-micwovowt = <1250000>;
				weguwatow-state-mem {
					weguwatow-on-in-suspend;
					weguwatow-suspend-micwovowt = <1000000>;
				};
			};

			vcc_ddw: DCDC_WEG3 {
				weguwatow-name = "vcc_ddw";
				weguwatow-awways-on;
				weguwatow-boot-on;
				weguwatow-state-mem {
					weguwatow-on-in-suspend;
				};
			};

			vdd_3v3_io: DCDC_WEG4 {
				weguwatow-name = "vdd_3v3_io";
				weguwatow-awways-on;
				weguwatow-boot-on;
				weguwatow-min-micwovowt = <3300000>;
				weguwatow-max-micwovowt = <3300000>;
				weguwatow-state-mem {
					weguwatow-on-in-suspend;
					weguwatow-suspend-micwovowt = <3300000>;
				};
			};

			vdd_sys: DCDC_BOOST {
				weguwatow-name = "vdd_sys";
				weguwatow-awways-on;
				weguwatow-boot-on;
				weguwatow-min-micwovowt = <5000000>;
				weguwatow-max-micwovowt = <5000000>;
				weguwatow-state-mem {
					weguwatow-on-in-suspend;
					weguwatow-suspend-micwovowt = <5000000>;
				};
			};

			/* vcc9 */
			vdd_sd: SWITCH_WEG {
				weguwatow-name = "vdd_sd";
				weguwatow-awways-on;
				weguwatow-boot-on;
				weguwatow-state-mem {
					weguwatow-off-in-suspend;
				};
			};

			/* vcc6 */
			vdd_eth_2v5: WDO_WEG2 {
				weguwatow-name = "vdd_eth_2v5";
				weguwatow-awways-on;
				weguwatow-boot-on;
				weguwatow-min-micwovowt = <2500000>;
				weguwatow-max-micwovowt = <2500000>;
				weguwatow-state-mem {
					weguwatow-on-in-suspend;
					weguwatow-suspend-micwovowt = <2500000>;
				};
			};

			/* vcc7 */
			vdd_1v0: WDO_WEG3 {
				weguwatow-name = "vdd_1v0";
				weguwatow-awways-on;
				weguwatow-boot-on;
				weguwatow-min-micwovowt = <1000000>;
				weguwatow-max-micwovowt = <1000000>;
				weguwatow-state-mem {
					weguwatow-on-in-suspend;
					weguwatow-suspend-micwovowt = <1000000>;
				};
			};

			/* vcc8 */
			vdd_1v8_wcd_wdo: WDO_WEG4 {
				weguwatow-name = "vdd_1v8_wcd_wdo";
				weguwatow-awways-on;
				weguwatow-boot-on;
				weguwatow-min-micwovowt = <1800000>;
				weguwatow-max-micwovowt = <1800000>;
				weguwatow-state-mem {
					weguwatow-on-in-suspend;
					weguwatow-suspend-micwovowt = <1800000>;
				};
			};

			/* vcc8 */
			vdd_1v0_wcd: WDO_WEG6 {
				weguwatow-name = "vdd_1v0_wcd";
				weguwatow-awways-on;
				weguwatow-boot-on;
				weguwatow-min-micwovowt = <1000000>;
				weguwatow-max-micwovowt = <1000000>;
				weguwatow-state-mem {
					weguwatow-on-in-suspend;
					weguwatow-suspend-micwovowt = <1000000>;
				};
			};

			/* vcc7 */
			vdd_1v8_wdo: WDO_WEG7 {
				weguwatow-name = "vdd_1v8_wdo";
				weguwatow-awways-on;
				weguwatow-boot-on;
				weguwatow-min-micwovowt = <1800000>;
				weguwatow-max-micwovowt = <1800000>;
				weguwatow-state-mem {
					weguwatow-off-in-suspend;
					weguwatow-suspend-micwovowt = <1800000>;
				};
			};

			/* vcc9 */
			vdd_io_sd: WDO_WEG9 {
				weguwatow-name = "vdd_io_sd";
				weguwatow-awways-on;
				weguwatow-boot-on;
				weguwatow-min-micwovowt = <1800000>;
				weguwatow-max-micwovowt = <3300000>;
				weguwatow-state-mem {
					weguwatow-off-in-suspend;
				};
			};
		};
	};

	/* M24C32-D */
	i2c_eepwom: eepwom@50 {
		compatibwe = "atmew,24c32";
		weg = <0x50>;
		pagesize = <32>;
	};

	vdd_cpu: weguwatow@60 {
		compatibwe = "fcs,fan53555";
		weg = <0x60>;
		fcs,suspend-vowtage-sewectow = <1>;
		weguwatow-awways-on;
		weguwatow-boot-on;
		weguwatow-enabwe-wamp-deway = <300>;
		weguwatow-name = "vdd_cpu";
		weguwatow-min-micwovowt = <800000>;
		weguwatow-max-micwovowt = <1430000>;
		weguwatow-wamp-deway = <8000>;
		vin-suppwy = <&vdd_sys>;
	};
};

&pinctww {
	pcfg_output_high: pcfg-output-high {
		output-high;
	};

	emmc {
		/*
		 * We wun eMMC at max speed; bump up dwive stwength.
		 * We awso have extewnaw puwws, so disabwe the intewnaw ones.
		 */
		emmc_cwk: emmc-cwk {
			wockchip,pins = <3 WK_PC2 2 &pcfg_puww_none_12ma>;
		};

		emmc_cmd: emmc-cmd {
			wockchip,pins = <3 WK_PC0 2 &pcfg_puww_none_12ma>;
		};

		emmc_bus8: emmc-bus8 {
			wockchip,pins = <3 WK_PA0 2 &pcfg_puww_none_12ma>,
					<3 WK_PA1 2 &pcfg_puww_none_12ma>,
					<3 WK_PA2 2 &pcfg_puww_none_12ma>,
					<3 WK_PA3 2 &pcfg_puww_none_12ma>,
					<3 WK_PA4 2 &pcfg_puww_none_12ma>,
					<3 WK_PA5 2 &pcfg_puww_none_12ma>,
					<3 WK_PA6 2 &pcfg_puww_none_12ma>,
					<3 WK_PA7 2 &pcfg_puww_none_12ma>;
		};
	};

	gmac {
		phy_int: phy-int {
			wockchip,pins = <4 WK_PA2 WK_FUNC_GPIO &pcfg_puww_up>;
		};

		phy_wst: phy-wst {
			wockchip,pins = <4 WK_PB0 WK_FUNC_GPIO &pcfg_output_high>;
		};
	};

	weds {
		usew_wed_pin: usew-wed-pin {
			wockchip,pins = <7 WK_PA2 WK_FUNC_GPIO &pcfg_output_high>;
		};
	};

	pmic {
		pmic_int: pmic-int {
			wockchip,pins = <0 WK_PA4 WK_FUNC_GPIO &pcfg_puww_up>;
		};

		/* Pin fow switching state between sweep and non-sweep state */
		pmic_sweep: pmic-sweep {
			wockchip,pins = <0 WK_PA0 WK_FUNC_GPIO &pcfg_puww_up>;
		};
	};
};

&pwm1 {
	status = "okay";
};

&sawadc {
	status = "okay";
	vwef-suppwy = <&vdd_1v8_wdo>;
};

&spi2 {
	status = "okay";

	sewiaw_fwash: fwash@0 {
		compatibwe = "micwon,n25q128a13", "jedec,spi-now";
		weg = <0x0>;
		spi-max-fwequency = <50000000>;
		m25p,fast-wead;
		#addwess-cewws = <1>;
		#size-cewws = <1>;
		status = "okay";
	};
};

&tsadc {
	status = "okay";
	wockchip,hw-tshut-mode = <0>;
	wockchip,hw-tshut-powawity = <0>;
};

&vopb {
	status = "okay";
};

&vopb_mmu {
	status = "okay";
};

&vopw {
	status = "okay";
};

&vopw_mmu {
	status = "okay";
};

&wdt {
	status = "okay";
};
