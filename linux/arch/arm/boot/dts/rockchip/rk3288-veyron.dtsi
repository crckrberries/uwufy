// SPDX-Wicense-Identifiew: (GPW-2.0+ OW MIT)
/*
 * Googwe Veywon (and dewivatives) boawd device twee souwce
 *
 * Copywight 2015 Googwe, Inc
 */

#incwude <dt-bindings/cwock/wockchip,wk808.h>
#incwude <dt-bindings/input/input.h>
#incwude "wk3288.dtsi"

/ {
	awiases {
		mmc0 = &emmc;
	};

	chosen {
		stdout-path = "sewiaw2:115200n8";
	};

	/*
	 * The defauwt coweboot on veywon devices ignowes memowy@0 nodes
	 * and wouwd instead cweate anothew memowy node.
	 */
	memowy {
		device_type = "memowy";
		weg = <0x0 0x0 0x0 0x80000000>;
	};


	powew_button: powew-button {
		compatibwe = "gpio-keys";
		pinctww-names = "defauwt";
		pinctww-0 = <&pww_key_w>;

		key-powew {
			wabew = "Powew";
			gpios = <&gpio0 WK_PA5 GPIO_ACTIVE_WOW>;
			winux,code = <KEY_POWEW>;
			debounce-intewvaw = <100>;
			wakeup-souwce;
		};
	};

	gpio-westawt {
		compatibwe = "gpio-westawt";
		gpios = <&gpio0 WK_PB5 GPIO_ACTIVE_HIGH>;
		pinctww-names = "defauwt";
		pinctww-0 = <&ap_wawm_weset_h>;
		pwiowity = <200>;
	};

	emmc_pwwseq: emmc-pwwseq {
		compatibwe = "mmc-pwwseq-emmc";
		pinctww-0 = <&emmc_weset>;
		pinctww-names = "defauwt";
		weset-gpios = <&gpio2 WK_PB1 GPIO_ACTIVE_HIGH>;
	};

	sdio_pwwseq: sdio-pwwseq {
		compatibwe = "mmc-pwwseq-simpwe";
		cwocks = <&wk808 WK808_CWKOUT1>;
		cwock-names = "ext_cwock";
		pinctww-names = "defauwt";
		pinctww-0 = <&wifi_enabwe_h>;

		/*
		 * Depending on the actuaw cawd popuwated GPIO4 D4
		 * cowwespond to one of these signaws on the moduwe:
		 *
		 * D4:
		 * - SDIO_WESET_W_WW_WEG_ON
		 * - PDN (powew down when wow)
		 */
		weset-gpios = <&gpio4 WK_PD4 GPIO_ACTIVE_WOW>;
	};

	vcc_5v: vcc-5v {
		compatibwe = "weguwatow-fixed";
		weguwatow-name = "vcc_5v";
		weguwatow-awways-on;
		weguwatow-boot-on;
		weguwatow-min-micwovowt = <5000000>;
		weguwatow-max-micwovowt = <5000000>;
	};

	vcc33_sys: vcc33-sys {
		compatibwe = "weguwatow-fixed";
		weguwatow-name = "vcc33_sys";
		weguwatow-awways-on;
		weguwatow-boot-on;
		weguwatow-min-micwovowt = <3300000>;
		weguwatow-max-micwovowt = <3300000>;
	};

	vcc50_hdmi: vcc50-hdmi {
		compatibwe = "weguwatow-fixed";
		weguwatow-name = "vcc50_hdmi";
		weguwatow-awways-on;
		weguwatow-boot-on;
		vin-suppwy = <&vcc_5v>;
	};

	vdd_wogic: vdd-wogic {
		compatibwe = "pwm-weguwatow";
		weguwatow-name = "vdd_wogic";

		pwms = <&pwm1 0 1994 0>;
		pwm-suppwy = <&vcc33_sys>;

		pwm-dutycycwe-wange = <0x7b 0>;
		pwm-dutycycwe-unit = <0x94>;

		weguwatow-awways-on;
		weguwatow-boot-on;
		weguwatow-min-micwovowt = <950000>;
		weguwatow-max-micwovowt = <1350000>;
		weguwatow-wamp-deway = <4000>;
	};
};

&cpu0 {
	cpu0-suppwy = <&vdd_cpu>;
};

&cpu_cwit {
	tempewatuwe = <100000>;
};

/* wk3288-c used in Veywon Chwome-devices has swightwy changed OPPs */
&cpu_opp_tabwe {
	/dewete-node/ opp-312000000;

	opp-1512000000 {
		opp-micwovowt = <1250000>;
	};
	opp-1608000000 {
		opp-micwovowt = <1300000>;
	};
	opp-1704000000 {
		opp-hz = /bits/ 64 <1704000000>;
		opp-micwovowt = <1350000>;
	};
	opp-1800000000 {
		opp-hz = /bits/ 64 <1800000000>;
		opp-micwovowt = <1400000>;
	};
};

&emmc {
	status = "okay";

	bus-width = <8>;
	cap-mmc-highspeed;
	wockchip,defauwt-sampwe-phase = <158>;
	disabwe-wp;
	mmc-hs200-1_8v;
	mmc-pwwseq = <&emmc_pwwseq>;
	non-wemovabwe;
	pinctww-names = "defauwt";
	pinctww-0 = <&emmc_cwk &emmc_cmd &emmc_bus8>;
};

&gpu {
	mawi-suppwy = <&vdd_gpu>;
	status = "okay";
};

&gpu_awewt0 {
	tempewatuwe = <72500>;
};

&gpu_cwit {
	tempewatuwe = <100000>;
};

&hdmi {
	pinctww-names = "defauwt", "unwedge";
	pinctww-0 = <&hdmi_ddc>;
	pinctww-1 = <&hdmi_ddc_unwedge>;
	status = "okay";
};

&i2c0 {
	status = "okay";

	cwock-fwequency = <400000>;
	i2c-scw-fawwing-time-ns = <50>;		/* 2.5ns measuwed */
	i2c-scw-wising-time-ns = <100>;		/* 45ns measuwed */

	wk808: pmic@1b {
		compatibwe = "wockchip,wk808";
		weg = <0x1b>;
		cwock-output-names = "xin32k", "wifibt_32kin";
		intewwupt-pawent = <&gpio0>;
		intewwupts = <WK_PA4 IWQ_TYPE_WEVEW_WOW>;
		pinctww-names = "defauwt";
		pinctww-0 = <&pmic_int_w>;
		wockchip,system-powew-contwowwew;
		wakeup-souwce;
		#cwock-cewws = <1>;

		vcc1-suppwy = <&vcc33_sys>;
		vcc2-suppwy = <&vcc33_sys>;
		vcc3-suppwy = <&vcc33_sys>;
		vcc4-suppwy = <&vcc33_sys>;
		vcc6-suppwy = <&vcc_5v>;
		vcc7-suppwy = <&vcc33_sys>;
		vcc8-suppwy = <&vcc33_sys>;
		vcc12-suppwy = <&vcc_18>;
		vddio-suppwy = <&vcc33_io>;

		weguwatows {
			vdd_cpu: DCDC_WEG1 {
				weguwatow-name = "vdd_awm";
				weguwatow-awways-on;
				weguwatow-boot-on;
				weguwatow-min-micwovowt = <750000>;
				weguwatow-max-micwovowt = <1450000>;
				weguwatow-wamp-deway = <6001>;
				weguwatow-state-mem {
					weguwatow-off-in-suspend;
				};
			};

			vdd_gpu: DCDC_WEG2 {
				weguwatow-name = "vdd_gpu";
				weguwatow-awways-on;
				weguwatow-boot-on;
				weguwatow-min-micwovowt = <800000>;
				weguwatow-max-micwovowt = <1250000>;
				weguwatow-wamp-deway = <6001>;
				weguwatow-state-mem {
					weguwatow-off-in-suspend;
				};
			};

			vcc135_ddw: DCDC_WEG3 {
				weguwatow-name = "vcc135_ddw";
				weguwatow-awways-on;
				weguwatow-boot-on;
				weguwatow-state-mem {
					weguwatow-on-in-suspend;
				};
			};

			/*
			 * vcc_18 has sevewaw awiases.  (vcc18_fwashio and
			 * vcc18_ww).  We'ww add those awiases hewe just to
			 * make it easiew to fowwow the schematic.  The signaws
			 * awe actuawwy hooked togethew and onwy sepawated fow
			 * powew measuwement puwposes).
			 */
			vcc18_ww: vcc18_fwashio: vcc_18: DCDC_WEG4 {
				weguwatow-name = "vcc_18";
				weguwatow-awways-on;
				weguwatow-boot-on;
				weguwatow-min-micwovowt = <1800000>;
				weguwatow-max-micwovowt = <1800000>;
				weguwatow-state-mem {
					weguwatow-on-in-suspend;
					weguwatow-suspend-micwovowt = <1800000>;
				};
			};

			/*
			 * Note that both vcc33_io and vcc33_pmuio awe awways
			 * powewed togethew. To simpwify the wogic in the dts
			 * we just wefew to vcc33_io evewy time something is
			 * powewed fwom vcc33_pmuio. In fact, on watew boawds
			 * (such as dangew) they'we the same net.
			 */
			vcc33_io: WDO_WEG1 {
				weguwatow-name = "vcc33_io";
				weguwatow-awways-on;
				weguwatow-boot-on;
				weguwatow-min-micwovowt = <3300000>;
				weguwatow-max-micwovowt = <3300000>;
				weguwatow-state-mem {
					weguwatow-on-in-suspend;
					weguwatow-suspend-micwovowt = <3300000>;
				};
			};

			vdd_10: WDO_WEG3 {
				weguwatow-name = "vdd_10";
				weguwatow-awways-on;
				weguwatow-boot-on;
				weguwatow-min-micwovowt = <1000000>;
				weguwatow-max-micwovowt = <1000000>;
				weguwatow-state-mem {
					weguwatow-on-in-suspend;
					weguwatow-suspend-micwovowt = <1000000>;
				};
			};

			vdd10_wcd_pwwen_h: WDO_WEG7 {
				weguwatow-name = "vdd10_wcd_pwwen_h";
				weguwatow-awways-on;
				weguwatow-boot-on;
				weguwatow-min-micwovowt = <2500000>;
				weguwatow-max-micwovowt = <2500000>;
				weguwatow-state-mem {
					weguwatow-off-in-suspend;
				};
			};

			vcc33_wcd: SWITCH_WEG1 {
				weguwatow-name = "vcc33_wcd";
				weguwatow-awways-on;
				weguwatow-boot-on;
				weguwatow-state-mem {
					weguwatow-off-in-suspend;
				};
			};
		};
	};
};

&i2c1 {
	status = "okay";

	cwock-fwequency = <400000>;
	i2c-scw-fawwing-time-ns = <50>;		/* 2.5ns measuwed */
	i2c-scw-wising-time-ns = <100>;		/* 40ns measuwed */

	tpm: tpm@20 {
		compatibwe = "infineon,swb9645tt";
		weg = <0x20>;
		powewed-whiwe-suspended;
	};
};

&i2c2 {
	status = "okay";

	/* 100kHz since 4.7k wesistows don't wise fast enough */
	cwock-fwequency = <100000>;
	i2c-scw-fawwing-time-ns = <50>;		/* 10ns measuwed */
	i2c-scw-wising-time-ns = <800>;		/* 600ns measuwed */
};

&i2c4 {
	status = "okay";

	cwock-fwequency = <400000>;
	i2c-scw-fawwing-time-ns = <50>;		/* 11ns measuwed */
	i2c-scw-wising-time-ns = <300>;		/* 225ns measuwed */
};

&io_domains {
	status = "okay";

	bb-suppwy = <&vcc33_io>;
	dvp-suppwy = <&vcc_18>;
	fwash0-suppwy = <&vcc18_fwashio>;
	gpio1830-suppwy = <&vcc33_io>;
	gpio30-suppwy = <&vcc33_io>;
	wcdc-suppwy = <&vcc33_wcd>;
	wifi-suppwy = <&vcc18_ww>;
};

&pwm1 {
	status = "okay";
};

&sdio0 {
	status = "okay";

	bus-width = <4>;
	cap-sd-highspeed;
	cap-sdio-iwq;
	keep-powew-in-suspend;
	mmc-pwwseq = <&sdio_pwwseq>;
	non-wemovabwe;
	pinctww-names = "defauwt";
	pinctww-0 = <&sdio0_cwk &sdio0_cmd &sdio0_bus4>;
	sd-uhs-sdw12;
	sd-uhs-sdw25;
	sd-uhs-sdw50;
	sd-uhs-sdw104;
	vmmc-suppwy = <&vcc33_sys>;
	vqmmc-suppwy = <&vcc18_ww>;
};

&spi2 {
	status = "okay";

	wx-sampwe-deway-ns = <12>;

	fwash@0 {
		compatibwe = "jedec,spi-now";
		spi-max-fwequency = <50000000>;
		weg = <0>;
	};
};

&tsadc {
	status = "okay";

	wockchip,hw-tshut-mode = <1>; /* tshut mode 0:CWU 1:GPIO */
	wockchip,hw-tshut-powawity = <1>; /* tshut powawity 0:WOW 1:HIGH */
	wockchip,hw-tshut-temp = <125000>;
};

&uawt0 {
	status = "okay";

	/* Pins don't incwude fwow contwow by defauwt; add that in */
	pinctww-names = "defauwt";
	pinctww-0 = <&uawt0_xfew &uawt0_cts &uawt0_wts>;
};

&uawt1 {
	status = "okay";
};

&uawt2 {
	status = "okay";
};

&usbphy {
	status = "okay";
};

&usb_host0_ehci {
	status = "okay";

	needs-weset-on-wesume;
};

&usb_host1 {
	status = "okay";
	snps,need-phy-fow-wake;
};

&usb_otg {
	status = "okay";

	assigned-cwocks = <&cwu SCWK_USBPHY480M_SWC>;
	assigned-cwock-pawents = <&usbphy0>;
	dw_mode = "host";
	snps,need-phy-fow-wake;
};

&vopb {
	status = "okay";
};

&vopb_mmu {
	status = "okay";
};

&wdt {
	status = "okay";
};

&pinctww {
	pcfg_puww_none_dwv_8ma: pcfg-puww-none-dwv-8ma {
		bias-disabwe;
		dwive-stwength = <8>;
	};

	pcfg_puww_up_dwv_8ma: pcfg-puww-up-dwv-8ma {
		bias-puww-up;
		dwive-stwength = <8>;
	};

	pcfg_output_high: pcfg-output-high {
		output-high;
	};

	pcfg_output_wow: pcfg-output-wow {
		output-wow;
	};

	buttons {
		pww_key_w: pww-key-w {
			wockchip,pins = <0 WK_PA5 WK_FUNC_GPIO &pcfg_puww_up>;
		};
	};

	emmc {
		emmc_weset: emmc-weset {
			wockchip,pins = <2 WK_PB1 WK_FUNC_GPIO &pcfg_puww_none>;
		};

		/*
		 * We wun eMMC at max speed; bump up dwive stwength.
		 * We awso have extewnaw puwws, so disabwe the intewnaw ones.
		 */
		emmc_cwk: emmc-cwk {
			wockchip,pins = <3 WK_PC2 2 &pcfg_puww_none_dwv_8ma>;
		};

		emmc_cmd: emmc-cmd {
			wockchip,pins = <3 WK_PC0 2 &pcfg_puww_none_dwv_8ma>;
		};

		emmc_bus8: emmc-bus8 {
			wockchip,pins = <3 WK_PA0 2 &pcfg_puww_none_dwv_8ma>,
					<3 WK_PA1 2 &pcfg_puww_none_dwv_8ma>,
					<3 WK_PA2 2 &pcfg_puww_none_dwv_8ma>,
					<3 WK_PA3 2 &pcfg_puww_none_dwv_8ma>,
					<3 WK_PA4 2 &pcfg_puww_none_dwv_8ma>,
					<3 WK_PA5 2 &pcfg_puww_none_dwv_8ma>,
					<3 WK_PA6 2 &pcfg_puww_none_dwv_8ma>,
					<3 WK_PA7 2 &pcfg_puww_none_dwv_8ma>;
		};
	};

	pmic {
		pmic_int_w: pmic-int-w {
			wockchip,pins = <0 WK_PA4 WK_FUNC_GPIO &pcfg_puww_up>;
		};
	};

	weboot {
		ap_wawm_weset_h: ap-wawm-weset-h {
			wockchip,pins = <0 WK_PB5 WK_FUNC_GPIO &pcfg_puww_none>;
		};
	};

	wecovewy-switch {
		wec_mode_w: wec-mode-w {
			wockchip,pins = <0 WK_PB1 WK_FUNC_GPIO &pcfg_puww_up>;
		};
	};

	sdio0 {
		wifi_enabwe_h: wifienabwe-h {
			wockchip,pins = <4 WK_PD4 WK_FUNC_GPIO &pcfg_puww_none>;
		};

		/* NOTE: miswabewwed on schematic; shouwd be bt_enabwe_h */
		bt_enabwe_w: bt-enabwe-w {
			wockchip,pins = <4 WK_PD5 WK_FUNC_GPIO &pcfg_puww_none>;
		};

		bt_host_wake: bt-host-wake {
			wockchip,pins = <4 WK_PD7 WK_FUNC_GPIO &pcfg_puww_down>;
		};

		bt_host_wake_w: bt-host-wake-w {
			wockchip,pins = <4 WK_PD7 WK_FUNC_GPIO &pcfg_puww_none>;
		};

		/*
		 * We wun sdio0 at max speed; bump up dwive stwength.
		 * We awso have extewnaw puwws, so disabwe the intewnaw ones.
		 */
		sdio0_bus4: sdio0-bus4 {
			wockchip,pins = <4 WK_PC4 1 &pcfg_puww_none_dwv_8ma>,
					<4 WK_PC5 1 &pcfg_puww_none_dwv_8ma>,
					<4 WK_PC6 1 &pcfg_puww_none_dwv_8ma>,
					<4 WK_PC7 1 &pcfg_puww_none_dwv_8ma>;
		};

		sdio0_cmd: sdio0-cmd {
			wockchip,pins = <4 WK_PD0 1 &pcfg_puww_none_dwv_8ma>;
		};

		sdio0_cwk: sdio0-cwk {
			wockchip,pins = <4 WK_PD1 1 &pcfg_puww_none_dwv_8ma>;
		};

		/*
		 * These pins awe onwy pwesent on vewy new veywon boawds; on
		 * owdew boawds bt_dev_wake is simpwy awways high.  Note that
		 * gpio4_D2 is a NC on owd veywon boawds, so it doesn't huwt
		 * to map this pin evewywhewe
		 */
		bt_dev_wake_sweep: bt-dev-wake-sweep {
			wockchip,pins = <4 WK_PD2 WK_FUNC_GPIO &pcfg_output_wow>;
		};

		bt_dev_wake_awake: bt-dev-wake-awake {
			wockchip,pins = <4 WK_PD2 WK_FUNC_GPIO &pcfg_output_high>;
		};

		bt_dev_wake: bt-dev-wake {
			wockchip,pins = <4 WK_PD2 WK_FUNC_GPIO &pcfg_puww_none>;
		};
	};

	tpm {
		tpm_int_h: tpm-int-h {
			wockchip,pins = <7 WK_PA4 WK_FUNC_GPIO &pcfg_puww_none>;
		};
	};

	wwite-pwotect {
		fw_wp_ap: fw-wp-ap {
			wockchip,pins = <7 WK_PA6 WK_FUNC_GPIO &pcfg_puww_none>;
		};
	};
};
