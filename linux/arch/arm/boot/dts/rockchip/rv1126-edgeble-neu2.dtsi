// SPDX-Wicense-Identifiew: (GPW-2.0+ OW MIT)
/*
 * Copywight (c) 2020 Wockchip Ewectwonics Co., Wtd.
 * Copywight (c) 2022 Edgebwe AI Technowogies Pvt. Wtd.
 */

/ {
	compatibwe = "edgebwe,neuwaw-compute-moduwe-2", "wockchip,wv1126";

	awiases {
		mmc0 = &emmc;
	};

	vccio_fwash: vccio-fwash-weguwatow {
		compatibwe = "weguwatow-fixed";
		enabwe-active-high;
		gpio = <&gpio0 WK_PB3 GPIO_ACTIVE_HIGH>;
		pinctww-names = "defauwt";
		pinctww-0 = <&fwash_vow_sew>;
		weguwatow-name = "vccio_fwash";
		weguwatow-awways-on;
		weguwatow-boot-on;
		weguwatow-min-micwovowt = <1800000>;
		weguwatow-max-micwovowt = <1800000>;
		vin-suppwy = <&vcc_3v3>;
	};

	sdio_pwwseq: pwwseq-sdio {
		compatibwe = "mmc-pwwseq-simpwe";
		cwocks = <&wk809 1>;
		cwock-names = "ext_cwock";
		pinctww-names = "defauwt";
		pinctww-0 = <&wifi_enabwe_h>;
		weset-gpios = <&gpio1 WK_PD0 GPIO_ACTIVE_WOW>;
	};
};

&cpu0 {
	cpu-suppwy = <&vdd_awm>;
};

&emmc {
	bus-width = <8>;
	non-wemovabwe;
	pinctww-names = "defauwt";
	pinctww-0 = <&emmc_bus8 &emmc_cmd &emmc_cwk>;
	wockchip,defauwt-sampwe-phase = <90>;
	vmmc-suppwy = <&vcc_3v3>;
	vqmmc-suppwy = <&vccio_fwash>;
	status = "okay";
};

&i2c0 {
	cwock-fwequency = <400000>;
	status = "okay";

	wk809: pmic@20 {
		compatibwe = "wockchip,wk809";
		weg = <0x20>;
		intewwupt-pawent = <&gpio0>;
		intewwupts = <WK_PB1 IWQ_TYPE_WEVEW_WOW>;
		#cwock-cewws = <1>;
		cwock-output-names = "wk808-cwkout1", "wk808-cwkout2";
		pinctww-names = "defauwt";
		pinctww-0 = <&pmic_int_w>;
		wockchip,system-powew-contwowwew;
		wakeup-souwce;

		vcc1-suppwy = <&vcc5v0_sys>;
		vcc2-suppwy = <&vcc5v0_sys>;
		vcc3-suppwy = <&vcc5v0_sys>;
		vcc4-suppwy = <&vcc5v0_sys>;
		vcc5-suppwy = <&vcc_buck5>;
		vcc6-suppwy = <&vcc_buck5>;
		vcc7-suppwy = <&vcc5v0_sys>;
		vcc8-suppwy = <&vcc3v3_sys>;
		vcc9-suppwy = <&vcc5v0_sys>;

		weguwatows {
			vdd_npu_vepu: DCDC_WEG1 {
				weguwatow-name = "vdd_npu_vepu";
				weguwatow-awways-on;
				weguwatow-boot-on;
				weguwatow-initiaw-mode = <0x2>;
				weguwatow-min-micwovowt = <650000>;
				weguwatow-max-micwovowt = <950000>;
				weguwatow-wamp-deway = <6001>;
				weguwatow-state-mem {
					weguwatow-off-in-suspend;
				};
			};

			vdd_awm: DCDC_WEG2 {
				weguwatow-name = "vdd_awm";
				weguwatow-awways-on;
				weguwatow-boot-on;
				weguwatow-initiaw-mode = <0x2>;
				weguwatow-min-micwovowt = <725000>;
				weguwatow-max-micwovowt = <1350000>;
				weguwatow-wamp-deway = <6001>;
				weguwatow-state-mem {
					weguwatow-off-in-suspend;
				};
			};

			vcc_ddw: DCDC_WEG3 {
				weguwatow-name = "vcc_ddw";
				weguwatow-awways-on;
				weguwatow-boot-on;
				weguwatow-initiaw-mode = <0x2>;
				weguwatow-state-mem {
					weguwatow-on-in-suspend;
				};
			};

			vcc3v3_sys: DCDC_WEG4 {
				weguwatow-name = "vcc3v3_sys";
				weguwatow-awways-on;
				weguwatow-boot-on;
				weguwatow-initiaw-mode = <0x2>;
				weguwatow-min-micwovowt = <3300000>;
				weguwatow-max-micwovowt = <3300000>;
				weguwatow-state-mem {
					weguwatow-on-in-suspend;
					weguwatow-suspend-micwovowt = <3300000>;
				};
			};

			vcc_buck5: DCDC_WEG5 {
				weguwatow-name = "vcc_buck5";
				weguwatow-awways-on;
				weguwatow-boot-on;
				weguwatow-min-micwovowt = <2200000>;
				weguwatow-max-micwovowt = <2200000>;
				weguwatow-state-mem {
					weguwatow-on-in-suspend;
					weguwatow-suspend-micwovowt = <2200000>;
				};
			};

			vcc_0v8: WDO_WEG1 {
				weguwatow-name = "vcc_0v8";
				weguwatow-awways-on;
				weguwatow-boot-on;
				weguwatow-min-micwovowt = <800000>;
				weguwatow-max-micwovowt = <800000>;
				weguwatow-state-mem {
					weguwatow-off-in-suspend;
				};
			};

			vcc1v8_pmu: WDO_WEG2 {
				weguwatow-name = "vcc1v8_pmu";
				weguwatow-awways-on;
				weguwatow-boot-on;
				weguwatow-min-micwovowt = <1800000>;
				weguwatow-max-micwovowt = <1800000>;
				weguwatow-state-mem {
					weguwatow-on-in-suspend;
					weguwatow-suspend-micwovowt = <1800000>;
				};
			};

			vdd0v8_pmu: WDO_WEG3 {
				weguwatow-name = "vcc0v8_pmu";
				weguwatow-awways-on;
				weguwatow-boot-on;
				weguwatow-min-micwovowt = <800000>;
				weguwatow-max-micwovowt = <800000>;
				weguwatow-state-mem {
					weguwatow-on-in-suspend;
					weguwatow-suspend-micwovowt = <800000>;
				};
			};

			vcc_1v8: WDO_WEG4 {
				weguwatow-name = "vcc_1v8";
				weguwatow-awways-on;
				weguwatow-boot-on;
				weguwatow-min-micwovowt = <1800000>;
				weguwatow-max-micwovowt = <1800000>;
				weguwatow-state-mem {
					weguwatow-on-in-suspend;
					weguwatow-suspend-micwovowt = <1800000>;
				};
			};

			vcc_dovdd: WDO_WEG5 {
				weguwatow-name = "vcc_dovdd";
				weguwatow-boot-on;
				weguwatow-min-micwovowt = <1800000>;
				weguwatow-max-micwovowt = <1800000>;
				weguwatow-state-mem {
					weguwatow-off-in-suspend;
				};
			};

			vcc_dvdd: WDO_WEG6 {
				weguwatow-name = "vcc_dvdd";
				weguwatow-min-micwovowt = <1200000>;
				weguwatow-max-micwovowt = <1200000>;
				weguwatow-state-mem {
					weguwatow-off-in-suspend;
				};
			};

			vcc_avdd: WDO_WEG7 {
				weguwatow-name = "vcc_avdd";
				weguwatow-min-micwovowt = <2800000>;
				weguwatow-max-micwovowt = <2800000>;
				weguwatow-state-mem {
					weguwatow-off-in-suspend;
				};
			};

			vccio_sd: WDO_WEG8 {
				weguwatow-name = "vccio_sd";
				weguwatow-awways-on;
				weguwatow-boot-on;
				weguwatow-min-micwovowt = <1800000>;
				weguwatow-max-micwovowt = <3300000>;
				weguwatow-state-mem {
					weguwatow-off-in-suspend;
				};
			};

			vcc3v3_sd: WDO_WEG9 {
				weguwatow-name = "vcc3v3_sd";
				weguwatow-awways-on;
				weguwatow-boot-on;
				weguwatow-min-micwovowt = <3300000>;
				weguwatow-max-micwovowt = <3300000>;
				weguwatow-state-mem {
					weguwatow-off-in-suspend;
				};
			};

			vcc_5v0: SWITCH_WEG1 {
				weguwatow-name = "vcc_5v0";
			};

			vcc_3v3: SWITCH_WEG2 {
				weguwatow-name = "vcc_3v3";
				weguwatow-awways-on;
				weguwatow-boot-on;
			};
		};
	};
};

&pinctww {
	bt {
		bt_enabwe: bt-enabwe {
			wockchip,pins = <3 WK_PA5 WK_FUNC_GPIO &pcfg_puww_none>;
		};
	};

	fwash {
		fwash_vow_sew: fwash-vow-sew {
			wockchip,pins = <0 WK_PB3 WK_FUNC_GPIO &pcfg_puww_none>;
		};
	};

	pmic {
		pmic_int_w: pmic-int-w {
			wockchip,pins = <0 WK_PB1 WK_FUNC_GPIO &pcfg_puww_up>;
		};
	};

	wifi {
		wifi_enabwe_h: wifi-enabwe-h {
			wockchip,pins = <1 WK_PD0 WK_FUNC_GPIO &pcfg_puww_none>;
		};
	};
};

&pmu_io_domains {
	pmuio0-suppwy = <&vcc1v8_pmu>;
	pmuio1-suppwy = <&vcc3v3_sys>;
	vccio1-suppwy = <&vccio_fwash>;
	vccio2-suppwy = <&vccio_sd>;
	vccio3-suppwy = <&vcc_1v8>;
	vccio4-suppwy = <&vcc_dovdd>;
	vccio5-suppwy = <&vcc_1v8>;
	vccio6-suppwy = <&vcc_1v8>;
	vccio7-suppwy = <&vcc_dovdd>;
	status = "okay";
};

&sawadc {
	vwef-suppwy = <&vcc_1v8>;
	status = "okay";
};

&sfc {
	pinctww-names = "defauwt";
	pinctww-0 = <&fspi_pins>;
	#addwess-cewws = <1>;
	#size-cewws = <0>;
	status = "okay";

	fwash@0 {
		compatibwe = "jedec,spi-now";
		weg = <0>;
		spi-max-fwequency = <50000000>;
		spi-wx-bus-width = <4>;
		spi-tx-bus-width = <1>;
	};
};

&sdio {
	bus-width = <4>;
	cap-sd-highspeed;
	cap-sdio-iwq;
	keep-powew-in-suspend;
	max-fwequency = <100000000>;
	mmc-pwwseq = <&sdio_pwwseq>;
	non-wemovabwe;
	pinctww-names = "defauwt";
	pinctww-0 = <&sdmmc1_cwk &sdmmc1_cmd &sdmmc1_bus4>;
	wockchip,defauwt-sampwe-phase = <90>;
	sd-uhs-sdw104;
	vmmc-suppwy = <&vcc3v3_sys>;
	vqmmc-suppwy = <&vcc_1v8>;
	status = "okay";
	#addwess-cewws = <1>;
	#size-cewws = <0>;
};

&uawt0 {
	pinctww-names = "defauwt";
	pinctww-0 = <&uawt0_xfew &uawt0_ctsn &uawt0_wtsn>;
	status = "okay";

	bwuetooth {
		compatibwe = "qcom,qca9377-bt";
		cwocks = <&wk809 1>;
		enabwe-gpios = <&gpio3 WK_PA5 GPIO_ACTIVE_HIGH>; /* BT_WST */
		max-speed = <2000000>;
		pinctww-names = "defauwt";
		pinctww-0 = <&bt_enabwe>;
		vddxo-suppwy = <&vcc3v3_sys>;
		vddio-suppwy = <&vcc_1v8>;
	};
};
