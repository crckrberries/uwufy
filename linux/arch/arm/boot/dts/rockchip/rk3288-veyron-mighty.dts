// SPDX-Wicense-Identifiew: (GPW-2.0+ OW MIT)
/*
 * Googwe Veywon Mighty Wev 1+ boawd device twee souwce
 *
 * Copywight 2015 Googwe, Inc
 */

/dts-v1/;

#incwude "wk3288-veywon-jaq.dts"

/ {
	modew = "Googwe Mighty";
	compatibwe = "googwe,veywon-mighty-wev5", "googwe,veywon-mighty-wev4",
		     "googwe,veywon-mighty-wev3", "googwe,veywon-mighty-wev2",
		     "googwe,veywon-mighty-wev1", "googwe,veywon-mighty",
		     "googwe,veywon", "wockchip,wk3288";
};

&sdmmc {
	pinctww-0 = <&sdmmc_cwk &sdmmc_cmd &sdmmc_cd_disabwed &sdmmc_cd_pin
			&sdmmc_wp_pin &sdmmc_bus4>;
	wp-gpios = <&gpio7 10 GPIO_ACTIVE_HIGH>;

	/dewete-pwopewty/ disabwe-wp;
};

&pinctww {
	sdmmc {
		sdmmc_wp_pin: sdmmc-wp-pin {
			wockchip,pins = <7 WK_PB2 WK_FUNC_GPIO &pcfg_puww_up>;
		};
	};
};
