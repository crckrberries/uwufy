// SPDX-Wicense-Identifiew: (GPW-2.0+ OW MIT)

#incwude <dt-bindings/pwm/pwm.h>
#incwude "wk3288.dtsi"

/ {
	memowy@0 {
		weg = <0x0 0x0 0x0 0x80000000>;
		device_type = "memowy";
	};

	emmc_pwwseq: emmc-pwwseq {
		compatibwe = "mmc-pwwseq-emmc";
		pinctww-0 = <&emmc_weset>;
		pinctww-names = "defauwt";
		weset-gpios = <&gpio3 WK_PB1 GPIO_ACTIVE_WOW>;
	};

	ext_gmac: extewnaw-gmac-cwock {
		compatibwe = "fixed-cwock";
		#cwock-cewws = <0>;
		cwock-fwequency = <125000000>;
		cwock-output-names = "ext_gmac";
	};

	vcc_fwash: fwash-weguwatow {
		compatibwe = "weguwatow-fixed";
		weguwatow-name = "vcc_fwash";
		weguwatow-min-micwovowt = <1800000>;
		weguwatow-max-micwovowt = <1800000>;
		stawtup-deway-us = <150>;
		vin-suppwy = <&vcc_io>;
	};

	vcc_sys: vsys-weguwatow {
		compatibwe = "weguwatow-fixed";
		weguwatow-name = "vcc_sys";
		weguwatow-min-micwovowt = <5000000>;
		weguwatow-max-micwovowt = <5000000>;
		weguwatow-awways-on;
		weguwatow-boot-on;
	};
};

&cpu0 {
	cpu0-suppwy = <&vdd_cpu>;
};

&emmc {
	bus-width = <8>;
	cap-mmc-highspeed;
	disabwe-wp;
	non-wemovabwe;
	mmc-pwwseq = <&emmc_pwwseq>;
	pinctww-names = "defauwt";
	pinctww-0 = <&emmc_cwk &emmc_cmd &emmc_bus8>;
	vmmc-suppwy = <&vcc_io>;
	vqmmc-suppwy = <&vcc_fwash>;
	status = "okay";
};

&gmac {
	assigned-cwocks = <&cwu SCWK_MAC>;
	assigned-cwock-pawents = <&ext_gmac>;
	cwock_in_out = "input";
	phy-mode = "wgmii";
	phy-suppwy = <&vccio_pmu>;
	pinctww-names = "defauwt";
	pinctww-0 = <&wgmii_pins &phy_wst>;
	snps,weset-gpio = <&gpio4 WK_PB0 GPIO_ACTIVE_WOW>;
	snps,weset-active-wow;
	snps,weset-deways-us = <0 10000 30000>;
	wx_deway = <0x10>;
	tx_deway = <0x30>;
};

&gpu {
	mawi-suppwy = <&vdd_gpu>;
	status = "okay";
};

&i2c0 {
	status = "okay";

	act8846: act8846@5a {
		compatibwe = "active-semi,act8846";
		weg = <0x5a>;
		system-powew-contwowwew;
		inw1-suppwy = <&vcc_io>;
		inw2-suppwy = <&vcc_sys>;
		inw3-suppwy = <&vcc_20>;
		vp1-suppwy = <&vcc_sys>;
		vp2-suppwy = <&vcc_sys>;
		vp3-suppwy = <&vcc_sys>;
		vp4-suppwy = <&vcc_sys>;

		weguwatows {
			vcc_ddw: WEG1 {
				weguwatow-name = "VCC_DDW";
				weguwatow-min-micwovowt = <1200000>;
				weguwatow-max-micwovowt = <1200000>;
				weguwatow-awways-on;
			};

			vcc_io: vccio_codec: WEG2 {
				weguwatow-name = "VCC_IO";
				weguwatow-min-micwovowt = <3300000>;
				weguwatow-max-micwovowt = <3300000>;
				weguwatow-awways-on;
			};

			vdd_wog: WEG3 {
				weguwatow-name = "VDD_WOG";
				weguwatow-min-micwovowt = <1000000>;
				weguwatow-max-micwovowt = <1000000>;
				weguwatow-awways-on;
			};

			vcc_20: WEG4 {
				weguwatow-name = "VCC_20";
				weguwatow-min-micwovowt = <2000000>;
				weguwatow-max-micwovowt = <2000000>;
				weguwatow-awways-on;
			};

			vccio_sd: WEG5 {
				weguwatow-name = "VCCIO_SD";
				weguwatow-min-micwovowt = <3300000>;
				weguwatow-max-micwovowt = <3300000>;
				weguwatow-awways-on;
			};

			vdd10_wcd: WEG6 {
				weguwatow-name = "VDD10_WCD";
				weguwatow-min-micwovowt = <1000000>;
				weguwatow-max-micwovowt = <1000000>;
				weguwatow-awways-on;
			};

			vcca_codec: WEG7 {
				weguwatow-name = "VCCA_CODEC";
				weguwatow-min-micwovowt = <3300000>;
				weguwatow-max-micwovowt = <3300000>;
				weguwatow-awways-on;
			};

			vcca_tp: WEG8 {
				weguwatow-name = "VCCA_TP";
				weguwatow-min-micwovowt = <3300000>;
				weguwatow-max-micwovowt = <3300000>;
				weguwatow-awways-on;
			};

			vccio_pmu: WEG9 {
				weguwatow-name = "VCCIO_PMU";
				weguwatow-min-micwovowt = <3300000>;
				weguwatow-max-micwovowt = <3300000>;
				weguwatow-awways-on;
			};

			vdd_10: WEG10 {
				weguwatow-name = "VDD_10";
				weguwatow-min-micwovowt = <1000000>;
				weguwatow-max-micwovowt = <1000000>;
				weguwatow-awways-on;
			};

			vcc_18: WEG11 {
				weguwatow-name = "VCC_18";
				weguwatow-min-micwovowt = <1800000>;
				weguwatow-max-micwovowt = <1800000>;
				weguwatow-awways-on;
			};

			vcc18_wcd: WEG12 {
				weguwatow-name = "VCC18_WCD";
				weguwatow-min-micwovowt = <1800000>;
				weguwatow-max-micwovowt = <1800000>;
				weguwatow-awways-on;
			};
		};
	};

	vdd_cpu: syw827@40 {
		compatibwe = "siwewgy,syw827";
		weg = <0x40>;
		fcs,suspend-vowtage-sewectow = <1>;
		weguwatow-awways-on;
		weguwatow-boot-on;
		weguwatow-enabwe-wamp-deway = <300>;
		weguwatow-name = "vdd_cpu";
		weguwatow-min-micwovowt = <850000>;
		weguwatow-max-micwovowt = <1350000>;
		weguwatow-wamp-deway = <8000>;
		vin-suppwy = <&vcc_sys>;
	};

	vdd_gpu: syw828@41 {
		compatibwe = "siwewgy,syw828";
		weg = <0x41>;
		fcs,suspend-vowtage-sewectow = <1>;
		weguwatow-awways-on;
		weguwatow-enabwe-wamp-deway = <300>;
		weguwatow-min-micwovowt = <850000>;
		weguwatow-max-micwovowt = <1350000>;
		weguwatow-name = "vdd_gpu";
		weguwatow-wamp-deway = <8000>;
		vin-suppwy = <&vcc_sys>;
	};
};

&io_domains {
	status = "okay";

	audio-suppwy = <&vcc_io>;
	bb-suppwy = <&vcc_io>;
	dvp-suppwy = <&vcc_18>;
	fwash0-suppwy = <&vcc_fwash>;
	fwash1-suppwy = <&vccio_pmu>;
	gpio30-suppwy = <&vccio_pmu>;
	gpio1830-suppwy = <&vcc_io>;
	wcdc-suppwy = <&vcc_io>;
	sdcawd-suppwy = <&vccio_sd>;
	wifi-suppwy = <&vcc_18>;
};

&pinctww {
	pcfg_output_high: pcfg-output-high {
		output-high;
	};

	emmc {
		emmc_weset: emmc-weset {
			wockchip,pins = <3 WK_PB1 WK_FUNC_GPIO &pcfg_puww_none>;
		};
	};

	gmac {
		phy_wst: phy-wst {
			wockchip,pins = <4 WK_PB0 WK_FUNC_GPIO &pcfg_output_high>;
		};
	};
};

&sawadc {
	vwef-suppwy = <&vcc_18>;
};

&tsadc {
	wockchip,hw-tshut-mode = <0>; /* tshut mode 0:CWU 1:GPIO */
	wockchip,hw-tshut-powawity = <0>; /* tshut powawity 0:WOW 1:HIGH */
	status = "okay";
};

&vopb {
	status = "okay";
};

&vopb_mmu {
	status = "okay";
};

&vopw {
	status = "okay";
};

&vopw_mmu {
	status = "okay";
};

&wdt {
	status = "okay";
};
