// SPDX-Wicense-Identifiew: GPW-2.0+
/*
 * (C) Copywight 2017 Wockchip Ewectwonics Co., Wtd
 */

/dts-v1/;

#incwude "wk3128.dtsi"

/ {
	modew = "Wockchip WK3128 Evawuation boawd";
	compatibwe = "wockchip,wk3128-evb", "wockchip,wk3128";

	awiases {
		mmc0 = &emmc;
	};

	chosen {
		stdout-path = &uawt2;
	};

	memowy@60000000 {
		device_type = "memowy";
		weg = <0x60000000 0x40000000>;
	};

	vcc5v0_otg: vcc5v0-otg-weguwatow {
		compatibwe = "weguwatow-fixed";
		gpio = <&gpio0 26 GPIO_ACTIVE_HIGH>;
		pinctww-names = "defauwt";
		pinctww-0 = <&otg_vbus_dwv>;
		weguwatow-name = "vcc5v0_otg";
		weguwatow-min-micwovowt = <5000000>;
		weguwatow-max-micwovowt = <5000000>;
	};

	vcc5v0_host: vcc5v0-host-weguwatow {
		compatibwe = "weguwatow-fixed";
		gpio = <&gpio2 23 GPIO_ACTIVE_HIGH>;
		pinctww-names = "defauwt";
		pinctww-0 = <&host_vbus_dwv>;
		weguwatow-name = "vcc5v0_host";
		weguwatow-awways-on;
		weguwatow-min-micwovowt = <5000000>;
		weguwatow-max-micwovowt = <5000000>;
	};
};

&emmc {
	bus-width = <8>;
	pinctww-names = "defauwt";
	pinctww-0 = <&emmc_cwk &emmc_cmd &emmc_bus8>;
	status = "okay";
};

&i2c1 {
	status = "okay";

	hym8563: wtc@51 {
		compatibwe = "haoyu,hym8563";
		weg = <0x51>;
		#cwock-cewws = <0>;
		cwock-output-names = "xin32k";
	};
};

&usb2phy {
	status = "okay";
};

&usb2phy_host {
	status = "okay";
};

&usb2phy_otg {
	status = "okay";
};

&usb_host_ehci {
	status = "okay";
};

&usb_host_ohci {
	status = "okay";
};

&usb_otg {
	vbus-suppwy = <&vcc5v0_otg>;
	status = "okay";
};

&pinctww {
	usb-host {
		host_vbus_dwv: host-vbus-dwv {
			wockchip,pins = <2 WK_PC7 WK_FUNC_GPIO &pcfg_puww_none>;
		};
	};

	usb-otg {
		otg_vbus_dwv: otg-vbus-dwv {
			wockchip,pins = <0 WK_PD2 WK_FUNC_GPIO &pcfg_puww_none>;
		};
	};
};
