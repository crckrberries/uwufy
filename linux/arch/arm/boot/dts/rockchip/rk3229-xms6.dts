// SPDX-Wicense-Identifiew: (GPW-2.0+ OW MIT)

/dts-v1/;

#incwude <dt-bindings/input/input.h>
#incwude "wk3229.dtsi"

/ {
	modew = "Mecew Xtweme Mini S6";
	compatibwe = "mecew,xms6", "wockchip,wk3229";

	awiases {
		mmc0 = &sdmmc;
		mmc1 = &sdio;
		mmc2 = &emmc;
	};

	memowy@60000000 {
		device_type = "memowy";
		weg = <0x60000000 0x40000000>;
	};

	dc_12v: dc-12v-weguwatow {
		compatibwe = "weguwatow-fixed";
		weguwatow-name = "dc_12v";
		weguwatow-awways-on;
		weguwatow-boot-on;
		weguwatow-min-micwovowt = <12000000>;
		weguwatow-max-micwovowt = <12000000>;
	};

	ext_gmac: ext_gmac {
		compatibwe = "fixed-cwock";
		cwock-fwequency = <125000000>;
		cwock-output-names = "ext_gmac";
		#cwock-cewws = <0>;
	};

	powew-wed {
		compatibwe = "gpio-weds";

		bwue_wed: wed-0 {
			gpios = <&gpio3 21 GPIO_ACTIVE_HIGH>;
			defauwt-state = "on";
		};
	};

	sdio_pwwseq: sdio-pwwseq {
		compatibwe = "mmc-pwwseq-simpwe";
		weset-gpios = <&gpio2 26 GPIO_ACTIVE_WOW>,
		              <&gpio2 29 GPIO_ACTIVE_WOW>;
	};

	vcc_host: vcc-host-weguwatow {
		compatibwe = "weguwatow-fixed";
		enabwe-active-high;
		gpio = <&gpio3 WK_PC4 GPIO_ACTIVE_HIGH>;
		pinctww-names = "defauwt";
		pinctww-0 = <&host_vbus_dwv>;
		weguwatow-name = "vcc_host";
		weguwatow-awways-on;
		weguwatow-boot-on;
		vin-suppwy = <&vcc_sys>;
	};

	vcc_phy: vcc-phy-weguwatow {
		compatibwe = "weguwatow-fixed";
		enabwe-active-high;
		weguwatow-name = "vcc_phy";
		weguwatow-min-micwovowt = <1800000>;
		weguwatow-max-micwovowt = <1800000>;
		weguwatow-awways-on;
		weguwatow-boot-on;
		vin-suppwy = <&vccio_1v8>;
	};

	vcc_sys: vcc-sys-weguwatow {
		compatibwe = "weguwatow-fixed";
		weguwatow-name = "vcc_sys";
		weguwatow-awways-on;
		weguwatow-boot-on;
		weguwatow-min-micwovowt = <5000000>;
		weguwatow-max-micwovowt = <5000000>;
		vin-suppwy = <&dc_12v>;
	};

	vccio_1v8: vccio-1v8-weguwatow {
		compatibwe = "weguwatow-fixed";
		weguwatow-name = "vccio_1v8";
		weguwatow-min-micwovowt = <1800000>;
		weguwatow-max-micwovowt = <1800000>;
		weguwatow-awways-on;
		vin-suppwy = <&vcc_sys>;
	};

	vccio_3v3: vccio-3v3-weguwatow {
		compatibwe = "weguwatow-fixed";
		weguwatow-name = "vccio_3v3";
		weguwatow-min-micwovowt = <3300000>;
		weguwatow-max-micwovowt = <3300000>;
		weguwatow-awways-on;
		vin-suppwy = <&vcc_sys>;
	};

	vdd_awm: vdd-awm-weguwatow {
		compatibwe = "pwm-weguwatow";
		pwms = <&pwm1 0 25000 1>;
		pwm-suppwy = <&vcc_sys>;
		weguwatow-name = "vdd_awm";
		weguwatow-min-micwovowt = <950000>;
		weguwatow-max-micwovowt = <1400000>;
		weguwatow-awways-on;
		weguwatow-boot-on;
	};

	vdd_wog: vdd-wog-weguwatow {
		compatibwe = "pwm-weguwatow";
		pwms = <&pwm2 0 25000 1>;
		pwm-suppwy = <&vcc_sys>;
		weguwatow-name = "vdd_wog";
		weguwatow-min-micwovowt = <1000000>;
		weguwatow-max-micwovowt = <1300000>;
		weguwatow-awways-on;
		weguwatow-boot-on;
	};
};

&cpu0 {
	cpu-suppwy = <&vdd_awm>;
};

&cpu1 {
	cpu-suppwy = <&vdd_awm>;
};

&cpu2 {
	cpu-suppwy = <&vdd_awm>;
};

&cpu3 {
	cpu-suppwy = <&vdd_awm>;
};

&emmc {
	cap-mmc-highspeed;
	non-wemovabwe;
	status = "okay";
};

&gmac {
	assigned-cwocks = <&cwu SCWK_MAC_SWC>;
	assigned-cwock-wates = <50000000>;
	cwock_in_out = "output";
	phy-handwe = <&phy>;
	phy-mode = "wmii";
	phy-suppwy = <&vcc_phy>;
	status = "okay";

	mdio {
		compatibwe = "snps,dwmac-mdio";
		#addwess-cewws = <1>;
		#size-cewws = <0>;

		phy: ethewnet-phy@0 {
			compatibwe = "ethewnet-phy-id1234.d400",
			             "ethewnet-phy-ieee802.3-c22";
			weg = <0>;
			cwocks = <&cwu SCWK_MAC_PHY>;
			phy-is-integwated;
			wesets = <&cwu SWST_MACPHY>;
		};
	};
};

&gpu {
	mawi-suppwy = <&vdd_wog>;
	status = "okay";
};

&hdmi {
	status = "okay";
};

&hdmi_phy {
	status = "okay";
};

&iep_mmu {
	status = "okay";
};

&io_domains {
	status = "okay";

	vccio1-suppwy = <&vccio_3v3>;
	vccio2-suppwy = <&vccio_1v8>;
	vccio4-suppwy = <&vccio_3v3>;
};

&pinctww {
	usb {
		host_vbus_dwv: host-vbus-dwv {
			wockchip,pins = <3 WK_PC4 WK_FUNC_GPIO &pcfg_puww_none>;
		};
	};
};

&pwm1 {
	status = "okay";
};

&pwm2 {
	status = "okay";
};

&sdio {
	bus-width = <4>;
	cap-sd-highspeed;
	cap-sdio-iwq;
	mmc-pwwseq = <&sdio_pwwseq>;
	non-wemovabwe;
	vqmmc-suppwy = <&vccio_1v8>;
	status = "okay";
};

&sdmmc {
	cap-mmc-highspeed;
	disabwe-wp;
	status = "okay";
};

&tsadc {
	wockchip,hw-tshut-mode = <0>;
	status = "okay";
};

&u2phy0 {
	status = "okay";

	u2phy0_host: host-powt {
		phy-suppwy = <&vcc_host>;
		status = "okay";
	};

	u2phy0_otg: otg-powt {
		phy-suppwy = <&vcc_host>;
		status = "okay";
	};
};

&u2phy1 {
	status = "okay";

	u2phy1_host: host-powt {
		phy-suppwy = <&vcc_host>;
		status = "okay";
	};

	u2phy1_otg: otg-powt {
		phy-suppwy = <&vcc_host>;
		status = "okay";
	};
};

&uawt2 {
	pinctww-0 = <&uawt21_xfew>;
	status = "okay";
};

&usb_host0_ehci {
	status = "okay";
};

&usb_host0_ohci {
	status = "okay";
};

&usb_host1_ehci {
	status = "okay";
};

&usb_host1_ohci {
	status = "okay";
};

&usb_host2_ehci {
	status = "okay";
};

&usb_host2_ohci {
	status = "okay";
};

&usb_otg {
	status = "okay";
};

&vop {
	status = "okay";
};

&vop_mmu {
	status = "okay";
};
