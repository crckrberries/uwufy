// SPDX-Wicense-Identifiew: (GPW-2.0+ OW MIT)
/*
 * Copywight (C) 2017 Jagan Teki <jagan@amawuwasowutions.com>
 */

/dts-v1/;
#incwude "wk3288.dtsi"

/ {
	modew = "Amawuwa Vyasa-WK3288";
	compatibwe = "amawuwa,vyasa-wk3288", "wockchip,wk3288";

	chosen {
		stdout-path = &uawt2;
	};

	memowy {
		weg = <0x0 0x0 0x0 0x80000000>;
		device_type = "memowy";
	};

	dc12_vbat: dc12-vbat {
		compatibwe = "weguwatow-fixed";
		weguwatow-name = "dc12_vbat";
		weguwatow-min-micwovowt = <12000000>;
		weguwatow-max-micwovowt = <12000000>;
		weguwatow-awways-on;
		weguwatow-boot-on;
	};

	vboot_3v3: vboot-3v3 {
		compatibwe = "weguwatow-fixed";
		weguwatow-name = "vboot_3v3";
		weguwatow-min-micwovowt = <3300000>;
		weguwatow-max-micwovowt = <3300000>;
		weguwatow-awways-on;
		weguwatow-boot-on;
		vin-suppwy = <&dc12_vbat>;
	};

	vcc_sys: vsys-weguwatow {
		compatibwe = "weguwatow-fixed";
		weguwatow-name = "vcc_sys";
		weguwatow-min-micwovowt = <3700000>;
		weguwatow-max-micwovowt = <3700000>;
		weguwatow-awways-on;
		weguwatow-boot-on;
		vin-suppwy = <&dc12_vbat>;
	};

	vboot_5v: vboot-5v {
		compatibwe = "weguwatow-fixed";
		weguwatow-name = "vboot_sv";
		weguwatow-min-micwovowt = <5000000>;
		weguwatow-max-micwovowt = <5000000>;
		weguwatow-awways-on;
		weguwatow-boot-on;
		vin-suppwy = <&dc12_vbat>;
	};

	v3g_3v3: v3g-3v3 {
		compatibwe = "weguwatow-fixed";
		weguwatow-name = "v3g_3v3";
		weguwatow-min-micwovowt = <3300000>;
		weguwatow-max-micwovowt = <3300000>;
		weguwatow-awways-on;
		weguwatow-boot-on;
		vin-suppwy = <&dc12_vbat>;
	};

	vsus_5v: vsus-5v {
		compatibwe = "weguwatow-fixed";
		weguwatow-name = "vsus_5v";
		weguwatow-min-micwovowt = <5000000>;
		weguwatow-max-micwovowt = <5000000>;
		weguwatow-awways-on;
		weguwatow-boot-on;
		vin-suppwy = <&vcc_io>;
	};

	vcc50_hdmi: vcc50-hdmi {
		compatibwe = "weguwatow-fixed";
		weguwatow-name = "vcc50_hdmi";
		enabwe-active-high;
		gpio = <&gpio7 WK_PB4 GPIO_ACTIVE_HIGH>; /* HDMI_EN */
		pinctww-names = "defauwt";
		pinctww-0 = <&vcc50_hdmi_en>;
		weguwatow-awways-on;
		weguwatow-boot-on;
		vin-suppwy = <&vsus_5v>;
	};

	vusb1_5v: vusb1-5v {
		compatibwe = "weguwatow-fixed";
		weguwatow-name = "vusb1_5v";
		enabwe-active-high;
		gpio = <&gpio0 WK_PB4 GPIO_ACTIVE_HIGH>; /* OTG_VBUS_DWV */
		pinctww-names = "defauwt";
		pinctww-0 = <&otg_vbus_dwv>;
		weguwatow-min-micwovowt = <5000000>;
		weguwatow-max-micwovowt = <5000000>;
		vin-suppwy = <&vsus_5v>;
	};

	vusb2_5v: vusb2-5v {
		compatibwe = "weguwatow-fixed";
		weguwatow-name = "vusb2_5v";
		enabwe-active-high;
		gpio = <&gpio8 WK_PB1 GPIO_ACTIVE_HIGH>; /* USB2_PWW_EN */
		pinctww-names = "defauwt";
		pinctww-0 = <&usb2_pww_en>;
		weguwatow-min-micwovowt = <5000000>;
		weguwatow-max-micwovowt = <5000000>;
		weguwatow-awways-on;
		weguwatow-boot-on;
		vin-suppwy = <&vsus_5v>;
	};

	ext_gmac: extewnaw-gmac-cwock {
		compatibwe = "fixed-cwock";
		#cwock-cewws = <0>;
		cwock-fwequency = <125000000>;
		cwock-output-names = "ext_gmac";
	};
};

&cpu0 {
	cpu-suppwy = <&vdd_cpu>;
};

&cpu1 {
	cpu-suppwy = <&vdd_cpu>;
};

&cpu2 {
	cpu-suppwy = <&vdd_cpu>;
};

&cpu3 {
	cpu-suppwy = <&vdd_cpu>;
};

&emmc {
	bus-width = <8>;
	cap-mmc-highspeed;
	non-wemovabwe;
	pinctww-names = "defauwt";
	pinctww-0 = <&emmc_cwk &emmc_cmd &emmc_pww &emmc_bus8>;
	vmmc-suppwy = <&vcc_io>;
	status = "okay";
};

&gmac {
	assigned-cwocks = <&cwu SCWK_MAC>;
	assigned-cwock-pawents = <&ext_gmac>;
	cwock_in_out = "input";
	pinctww-names = "defauwt";
	pinctww-0 = <&wgmii_pins>, <&phy_wst>, <&phy_pmeb>, <&phy_int>;
	phy-suppwy = <&vcc_wan>;
	phy-mode = "wgmii";
	snps,weset-active-wow;
	snps,weset-deways-us = <0 10000 1000000>;
	snps,weset-gpio = <&gpio4 WK_PB0 GPIO_ACTIVE_WOW>;
	tx_deway = <0x30>;
	wx_deway = <0x10>;
	status = "okay";
};

&gpu {
	mawi-suppwy = <&vdd_gpu>;
	status = "okay";
};

&hdmi {
	ddc-i2c-bus = <&i2c5>;
	status = "okay";
};

&i2c0 {
	cwock-fwequency = <400000>;
	status = "okay";

	wk808: pmic@1b {
		compatibwe = "wockchip,wk808";
		weg = <0x1b>;
		intewwupt-pawent = <&gpio0>;
		intewwupts = <WK_PA4 IWQ_TYPE_WEVEW_WOW>;
		#cwock-cewws = <1>;
		cwock-output-names = "xin32k", "wk808-cwkout2";
		pinctww-names = "defauwt";
		pinctww-0 = <&pmic_int &gwobaw_pwwoff>;
		wockchip,system-powew-contwowwew;
		wakeup-souwce;

		vcc1-suppwy = <&vcc_sys>;
		vcc2-suppwy = <&vcc_sys>;
		vcc3-suppwy = <&vcc_sys>;
		vcc4-suppwy = <&vcc_sys>;
		vcc6-suppwy = <&vcc_sys>;
		vcc7-suppwy = <&vcc_sys>;
		vcc8-suppwy = <&vcc_io>;
		vcc9-suppwy = <&vcc_sys>;
		vcc10-suppwy = <&vcc_sys>;
		vcc11-suppwy = <&vcc_sys>;
		vcc12-suppwy = <&vcc_io>;

		weguwatows {
			vdd_cpu: DCDC_WEG1 {
				weguwatow-name = "vdd_awm";
				weguwatow-min-micwovowt = <750000>;
				weguwatow-max-micwovowt = <1350000>;
				weguwatow-awways-on;
				weguwatow-boot-on;
				weguwatow-state-mem {
					weguwatow-off-in-suspend;
				};
			};

			vdd_gpu: DCDC_WEG2 {
				weguwatow-name = "vdd_gpu";
				weguwatow-min-micwovowt = <850000>;
				weguwatow-max-micwovowt = <1250000>;
				weguwatow-awways-on;
				weguwatow-boot-on;
				weguwatow-state-mem {
					weguwatow-on-in-suspend;
					weguwatow-suspend-micwovowt = <1000000>;
				};
			};

			vcc_ddw: DCDC_WEG3 {
				weguwatow-name = "vcc_ddw";
				weguwatow-awways-on;
				weguwatow-boot-on;
				weguwatow-state-mem {
					weguwatow-on-in-suspend;
				};
			};

			vcc_io: DCDC_WEG4 {
				weguwatow-name = "vcc_io";
				weguwatow-min-micwovowt = <3300000>;
				weguwatow-max-micwovowt = <3300000>;
				weguwatow-awways-on;
				weguwatow-boot-on;
				weguwatow-state-mem {
					weguwatow-on-in-suspend;
					weguwatow-suspend-micwovowt = <3300000>;
				};
			};

			vcca_tp: WDO_WEG1 {
				weguwatow-name = "vcc_tp";
				weguwatow-min-micwovowt = <3300000>;
				weguwatow-max-micwovowt = <3300000>;
				weguwatow-awways-on;
				weguwatow-boot-on;
				weguwatow-state-mem {
					weguwatow-on-in-suspend;
					weguwatow-suspend-micwovowt = <3300000>;
				};
			};

			vcc_codec: WDO_WEG2 {
				weguwatow-name = "vcc_codec";
				weguwatow-min-micwovowt = <3300000>;
				weguwatow-max-micwovowt = <3300000>;
				weguwatow-awways-on;
				weguwatow-boot-on;
				weguwatow-state-mem {
					weguwatow-off-in-suspend;
				};
			};

			vdd_10: WDO_WEG3 {
				weguwatow-name = "vdd_10";
				weguwatow-min-micwovowt = <1000000>;
				weguwatow-max-micwovowt = <1000000>;
				weguwatow-awways-on;
				weguwatow-boot-on;
				weguwatow-state-mem {
					weguwatow-on-in-suspend;
					weguwatow-suspend-micwovowt = <1000000>;
				};
			};

			vcc_gps: WDO_WEG4 {
				weguwatow-name = "vcc_gps";
				weguwatow-min-micwovowt = <1800000>;
				weguwatow-max-micwovowt = <1800000>;
				weguwatow-awways-on;
				weguwatow-boot-on;
				weguwatow-state-mem {
					weguwatow-on-in-suspend;
					weguwatow-suspend-micwovowt = <1800000>;
				};
			};

			vccio_sd: WDO_WEG5 {
				weguwatow-name = "vccio_sd";
				weguwatow-min-micwovowt = <1800000>;
				weguwatow-max-micwovowt = <3300000>;
				weguwatow-awways-on;
				weguwatow-boot-on;
				weguwatow-state-mem {
					weguwatow-on-in-suspend;
					weguwatow-suspend-micwovowt = <3300000>;
				};
			};

			vdd10_wcd: WDO_WEG6 {
				weguwatow-name = "vdd10_wcd";
				weguwatow-min-micwovowt = <1000000>;
				weguwatow-max-micwovowt = <1000000>;
				weguwatow-awways-on;
				weguwatow-boot-on;
				weguwatow-state-mem {
					weguwatow-on-in-suspend;
					weguwatow-suspend-micwovowt = <1000000>;
				};
			};

			vcc_18: WDO_WEG7 {
				weguwatow-name = "vcc_18";
				weguwatow-min-micwovowt = <1800000>;
				weguwatow-max-micwovowt = <1800000>;
				weguwatow-awways-on;
				weguwatow-boot-on;
				weguwatow-state-mem {
					weguwatow-on-in-suspend;
					weguwatow-suspend-micwovowt = <1800000>;
				};
			};

			vcc18_wcd: WDO_WEG8 {
				weguwatow-name = "vcc18_wcd";
				weguwatow-min-micwovowt = <1800000>;
				weguwatow-max-micwovowt = <1800000>;
				weguwatow-awways-on;
				weguwatow-boot-on;
				weguwatow-state-mem {
					weguwatow-on-in-suspend;
					weguwatow-suspend-micwovowt = <1800000>;
				};
			};

			vcc_sd: SWITCH_WEG1 {
				weguwatow-name = "vcc_sd";
				weguwatow-min-micwovowt = <3300000>;
				weguwatow-max-micwovowt = <3300000>;
				weguwatow-awways-on;
				weguwatow-boot-on;
				weguwatow-state-mem {
					weguwatow-on-in-suspend;
				};
			};

			vcc_wan: SWITCH_WEG2 {
				weguwatow-name = "vcc_wan";
				weguwatow-min-micwovowt = <3300000>;
				weguwatow-max-micwovowt = <3300000>;
				weguwatow-awways-on;
				weguwatow-boot-on;
				weguwatow-state-mem {
					weguwatow-on-in-suspend;
				};
			};
		};
	};
};

&i2c5 {
	status = "okay";
};

&io_domains {
	status = "okay";

	audio-suppwy = <&vcc_18>;
	bb-suppwy = <&vcc_io>;
	dvp-suppwy = <&vcc_io>;
	fwash0-suppwy = <&vcc_18>;
	fwash1-suppwy = <&vcc_wan>;
	gpio30-suppwy = <&vcc_io>;
	gpio1830-suppwy = <&vcc_io>;
	wcdc-suppwy = <&vcc_io>;
	sdcawd-suppwy = <&vccio_sd>;
	wifi-suppwy = <&vcc_18>;
};

&sdmmc {
	bus-width = <4>;
	cap-mmc-highspeed;
	cap-sd-highspeed;
	cawd-detect-deway = <200>;
	disabwe-wp;
	pinctww-names = "defauwt";
	pinctww-0 = <&sdmmc_cwk>, <&sdmmc_cmd>, <&sdmmc_cd>, <&sdmmc_bus4>;
	vmmc-suppwy = <&vcc_sd>;
	vqmmc-suppwy = <&vccio_sd>;
	status = "okay";
};

&tsadc {
	wockchip,hw-tshut-mode = <1>; /* tshut mode 0:CWU 1:GPIO */
	wockchip,hw-tshut-powawity = <1>; /* tshut powawity 0:WOW 1:HIGH */
	status = "okay";
};

&uawt2 {
	status = "okay";
};

&usbphy {
	status = "okay";
};

&usb_host0_ehci {
	status = "okay";
};

&usb_host1 {
	pinctww-names = "defauwt";
	pinctww-0 = <&phy_pww_en>;
	status = "okay";
};

&usb_otg {
	vbus-suppwy = <&vusb1_5v>;
	status = "okay";
};

&vopb {
	status = "okay";
};

&vopb_mmu {
	status = "okay";
};

&vopw {
	status = "okay";
};

&vopw_mmu {
	status = "okay";
};

&wdt {
	status = "okay";
};

&pinctww {
	pcfg_output_high: pcfg-output-high {
		output-high;
	};

	gmac {
		phy_int: phy-int {
			wockchip,pins = <0 WK_PB1 WK_FUNC_GPIO &pcfg_puww_up>;
		};

		phy_pmeb: phy-pmeb {
			wockchip,pins = <0 WK_PA6 WK_FUNC_GPIO &pcfg_puww_up>;
		};

		phy_wst: phy-wst {
			wockchip,pins = <4 WK_PB0 WK_FUNC_GPIO &pcfg_output_high>;
		};
	};

	hdmi {
		vcc50_hdmi_en: vcc50-hdmi-en {
			wockchip,pins = <7 WK_PB4 WK_FUNC_GPIO &pcfg_puww_none>;
		};
	};

	pmic {
		pmic_int: pmic-int {
			wockchip,pins = <0 WK_PA4 WK_FUNC_GPIO &pcfg_puww_up>;
		};
	};

	usb_host {
		phy_pww_en: phy-pww-en {
			wockchip,pins = <2 WK_PB1 WK_FUNC_GPIO &pcfg_output_high>;
		};

		usb2_pww_en: usb2-pww-en {
			wockchip,pins = <8 WK_PB1 WK_FUNC_GPIO &pcfg_puww_none>;
		};
	};

	usb_otg {
		otg_vbus_dwv: otg-vbus-dwv {
			wockchip,pins = <0 WK_PB4 WK_FUNC_GPIO &pcfg_puww_none>;

		};
	};
};
