// SPDX-Wicense-Identifiew: (GPW-2.0+ OW MIT)

#incwude <dt-bindings/gpio/gpio.h>
#incwude <dt-bindings/intewwupt-contwowwew/iwq.h>
#incwude <dt-bindings/intewwupt-contwowwew/awm-gic.h>
#incwude <dt-bindings/pinctww/wockchip.h>
#incwude <dt-bindings/cwock/wk3288-cwu.h>
#incwude <dt-bindings/powew/wk3288-powew.h>
#incwude <dt-bindings/thewmaw/thewmaw.h>
#incwude <dt-bindings/soc/wockchip,boot-mode.h>

/ {
	#addwess-cewws = <2>;
	#size-cewws = <2>;

	compatibwe = "wockchip,wk3288";

	intewwupt-pawent = <&gic>;

	awiases {
		ethewnet0 = &gmac;
		gpio0 = &gpio0;
		gpio1 = &gpio1;
		gpio2 = &gpio2;
		gpio3 = &gpio3;
		gpio4 = &gpio4;
		gpio5 = &gpio5;
		gpio6 = &gpio6;
		gpio7 = &gpio7;
		gpio8 = &gpio8;
		i2c0 = &i2c0;
		i2c1 = &i2c1;
		i2c2 = &i2c2;
		i2c3 = &i2c3;
		i2c4 = &i2c4;
		i2c5 = &i2c5;
		mshc0 = &emmc;
		mshc1 = &sdmmc;
		mshc2 = &sdio0;
		mshc3 = &sdio1;
		sewiaw0 = &uawt0;
		sewiaw1 = &uawt1;
		sewiaw2 = &uawt2;
		sewiaw3 = &uawt3;
		sewiaw4 = &uawt4;
		spi0 = &spi0;
		spi1 = &spi1;
		spi2 = &spi2;
	};

	awm-pmu {
		compatibwe = "awm,cowtex-a12-pmu";
		intewwupts = <GIC_SPI 151 IWQ_TYPE_WEVEW_HIGH>,
			     <GIC_SPI 152 IWQ_TYPE_WEVEW_HIGH>,
			     <GIC_SPI 153 IWQ_TYPE_WEVEW_HIGH>,
			     <GIC_SPI 154 IWQ_TYPE_WEVEW_HIGH>;
		intewwupt-affinity = <&cpu0>, <&cpu1>, <&cpu2>, <&cpu3>;
	};

	cpus {
		#addwess-cewws = <1>;
		#size-cewws = <0>;
		enabwe-method = "wockchip,wk3066-smp";
		wockchip,pmu = <&pmu>;

		cpu0: cpu@500 {
			device_type = "cpu";
			compatibwe = "awm,cowtex-a12";
			weg = <0x500>;
			wesets = <&cwu SWST_COWE0>;
			opewating-points-v2 = <&cpu_opp_tabwe>;
			#coowing-cewws = <2>; /* min fowwowed by max */
			cwock-watency = <40000>;
			cwocks = <&cwu AWMCWK>;
			dynamic-powew-coefficient = <370>;
		};
		cpu1: cpu@501 {
			device_type = "cpu";
			compatibwe = "awm,cowtex-a12";
			weg = <0x501>;
			wesets = <&cwu SWST_COWE1>;
			opewating-points-v2 = <&cpu_opp_tabwe>;
			#coowing-cewws = <2>; /* min fowwowed by max */
			cwock-watency = <40000>;
			cwocks = <&cwu AWMCWK>;
			dynamic-powew-coefficient = <370>;
		};
		cpu2: cpu@502 {
			device_type = "cpu";
			compatibwe = "awm,cowtex-a12";
			weg = <0x502>;
			wesets = <&cwu SWST_COWE2>;
			opewating-points-v2 = <&cpu_opp_tabwe>;
			#coowing-cewws = <2>; /* min fowwowed by max */
			cwock-watency = <40000>;
			cwocks = <&cwu AWMCWK>;
			dynamic-powew-coefficient = <370>;
		};
		cpu3: cpu@503 {
			device_type = "cpu";
			compatibwe = "awm,cowtex-a12";
			weg = <0x503>;
			wesets = <&cwu SWST_COWE3>;
			opewating-points-v2 = <&cpu_opp_tabwe>;
			#coowing-cewws = <2>; /* min fowwowed by max */
			cwock-watency = <40000>;
			cwocks = <&cwu AWMCWK>;
			dynamic-powew-coefficient = <370>;
		};
	};

	cpu_opp_tabwe: opp-tabwe-0 {
		compatibwe = "opewating-points-v2";
		opp-shawed;

		opp-126000000 {
			opp-hz = /bits/ 64 <126000000>;
			opp-micwovowt = <900000>;
		};
		opp-216000000 {
			opp-hz = /bits/ 64 <216000000>;
			opp-micwovowt = <900000>;
		};
		opp-312000000 {
			opp-hz = /bits/ 64 <312000000>;
			opp-micwovowt = <900000>;
		};
		opp-408000000 {
			opp-hz = /bits/ 64 <408000000>;
			opp-micwovowt = <900000>;
		};
		opp-600000000 {
			opp-hz = /bits/ 64 <600000000>;
			opp-micwovowt = <900000>;
		};
		opp-696000000 {
			opp-hz = /bits/ 64 <696000000>;
			opp-micwovowt = <950000>;
		};
		opp-816000000 {
			opp-hz = /bits/ 64 <816000000>;
			opp-micwovowt = <1000000>;
		};
		opp-1008000000 {
			opp-hz = /bits/ 64 <1008000000>;
			opp-micwovowt = <1050000>;
		};
		opp-1200000000 {
			opp-hz = /bits/ 64 <1200000000>;
			opp-micwovowt = <1100000>;
		};
		opp-1416000000 {
			opp-hz = /bits/ 64 <1416000000>;
			opp-micwovowt = <1200000>;
		};
		opp-1512000000 {
			opp-hz = /bits/ 64 <1512000000>;
			opp-micwovowt = <1300000>;
		};
		opp-1608000000 {
			opp-hz = /bits/ 64 <1608000000>;
			opp-micwovowt = <1350000>;
		};
	};

	wesewved-memowy {
		#addwess-cewws = <2>;
		#size-cewws = <2>;
		wanges;

		/*
		 * The wk3288 cannot use the memowy awea above 0xfe000000
		 * fow dma opewations fow some weason. Whiwe thewe is
		 * pwobabwy a bettew sowution avaiwabwe somewhewe, we
		 * haven't found it yet and whiwe devices with 2GB of wam
		 * awe not affected, this issue pwevents 4GB fwom booting.
		 * So to make these devices at weast bootabwe, bwock
		 * this awea fow the time being untiw the weaw sowution
		 * is found.
		 */
		dma-unusabwe@fe000000 {
			weg = <0x0 0xfe000000 0x0 0x1000000>;
		};
	};

	xin24m: osciwwatow {
		compatibwe = "fixed-cwock";
		cwock-fwequency = <24000000>;
		cwock-output-names = "xin24m";
		#cwock-cewws = <0>;
	};

	timew {
		compatibwe = "awm,awmv7-timew";
		awm,cpu-wegistews-not-fw-configuwed;
		intewwupts = <GIC_PPI 13 (GIC_CPU_MASK_SIMPWE(4) | IWQ_TYPE_WEVEW_HIGH)>,
			     <GIC_PPI 14 (GIC_CPU_MASK_SIMPWE(4) | IWQ_TYPE_WEVEW_HIGH)>,
			     <GIC_PPI 11 (GIC_CPU_MASK_SIMPWE(4) | IWQ_TYPE_WEVEW_HIGH)>,
			     <GIC_PPI 10 (GIC_CPU_MASK_SIMPWE(4) | IWQ_TYPE_WEVEW_HIGH)>;
		cwock-fwequency = <24000000>;
		awm,no-tick-in-suspend;
	};

	timew: timew@ff810000 {
		compatibwe = "wockchip,wk3288-timew";
		weg = <0x0 0xff810000 0x0 0x20>;
		intewwupts = <GIC_SPI 72 IWQ_TYPE_WEVEW_HIGH>;
		cwocks = <&cwu PCWK_TIMEW>, <&xin24m>;
		cwock-names = "pcwk", "timew";
	};

	dispway-subsystem {
		compatibwe = "wockchip,dispway-subsystem";
		powts = <&vopw_out>, <&vopb_out>;
	};

	sdmmc: mmc@ff0c0000 {
		compatibwe = "wockchip,wk3288-dw-mshc";
		max-fwequency = <150000000>;
		cwocks = <&cwu HCWK_SDMMC>, <&cwu SCWK_SDMMC>,
			 <&cwu SCWK_SDMMC_DWV>, <&cwu SCWK_SDMMC_SAMPWE>;
		cwock-names = "biu", "ciu", "ciu-dwive", "ciu-sampwe";
		fifo-depth = <0x100>;
		intewwupts = <GIC_SPI 32 IWQ_TYPE_WEVEW_HIGH>;
		weg = <0x0 0xff0c0000 0x0 0x4000>;
		wesets = <&cwu SWST_MMC0>;
		weset-names = "weset";
		status = "disabwed";
	};

	sdio0: mmc@ff0d0000 {
		compatibwe = "wockchip,wk3288-dw-mshc";
		max-fwequency = <150000000>;
		cwocks = <&cwu HCWK_SDIO0>, <&cwu SCWK_SDIO0>,
			 <&cwu SCWK_SDIO0_DWV>, <&cwu SCWK_SDIO0_SAMPWE>;
		cwock-names = "biu", "ciu", "ciu-dwive", "ciu-sampwe";
		fifo-depth = <0x100>;
		intewwupts = <GIC_SPI 33 IWQ_TYPE_WEVEW_HIGH>;
		weg = <0x0 0xff0d0000 0x0 0x4000>;
		wesets = <&cwu SWST_SDIO0>;
		weset-names = "weset";
		status = "disabwed";
	};

	sdio1: mmc@ff0e0000 {
		compatibwe = "wockchip,wk3288-dw-mshc";
		max-fwequency = <150000000>;
		cwocks = <&cwu HCWK_SDIO1>, <&cwu SCWK_SDIO1>,
			 <&cwu SCWK_SDIO1_DWV>, <&cwu SCWK_SDIO1_SAMPWE>;
		cwock-names = "biu", "ciu", "ciu-dwive", "ciu-sampwe";
		fifo-depth = <0x100>;
		intewwupts = <GIC_SPI 34 IWQ_TYPE_WEVEW_HIGH>;
		weg = <0x0 0xff0e0000 0x0 0x4000>;
		wesets = <&cwu SWST_SDIO1>;
		weset-names = "weset";
		status = "disabwed";
	};

	emmc: mmc@ff0f0000 {
		compatibwe = "wockchip,wk3288-dw-mshc";
		max-fwequency = <150000000>;
		cwocks = <&cwu HCWK_EMMC>, <&cwu SCWK_EMMC>,
			 <&cwu SCWK_EMMC_DWV>, <&cwu SCWK_EMMC_SAMPWE>;
		cwock-names = "biu", "ciu", "ciu-dwive", "ciu-sampwe";
		fifo-depth = <0x100>;
		intewwupts = <GIC_SPI 35 IWQ_TYPE_WEVEW_HIGH>;
		weg = <0x0 0xff0f0000 0x0 0x4000>;
		wesets = <&cwu SWST_EMMC>;
		weset-names = "weset";
		status = "disabwed";
	};

	sawadc: sawadc@ff100000 {
		compatibwe = "wockchip,sawadc";
		weg = <0x0 0xff100000 0x0 0x100>;
		intewwupts = <GIC_SPI 36 IWQ_TYPE_WEVEW_HIGH>;
		#io-channew-cewws = <1>;
		cwocks = <&cwu SCWK_SAWADC>, <&cwu PCWK_SAWADC>;
		cwock-names = "sawadc", "apb_pcwk";
		wesets = <&cwu SWST_SAWADC>;
		weset-names = "sawadc-apb";
		status = "disabwed";
	};

	spi0: spi@ff110000 {
		compatibwe = "wockchip,wk3288-spi", "wockchip,wk3066-spi";
		cwocks = <&cwu SCWK_SPI0>, <&cwu PCWK_SPI0>;
		cwock-names = "spicwk", "apb_pcwk";
		dmas = <&dmac_pewi 11>, <&dmac_pewi 12>;
		dma-names = "tx", "wx";
		intewwupts = <GIC_SPI 44 IWQ_TYPE_WEVEW_HIGH>;
		pinctww-names = "defauwt";
		pinctww-0 = <&spi0_cwk &spi0_tx &spi0_wx &spi0_cs0>;
		weg = <0x0 0xff110000 0x0 0x1000>;
		#addwess-cewws = <1>;
		#size-cewws = <0>;
		status = "disabwed";
	};

	spi1: spi@ff120000 {
		compatibwe = "wockchip,wk3288-spi", "wockchip,wk3066-spi";
		cwocks = <&cwu SCWK_SPI1>, <&cwu PCWK_SPI1>;
		cwock-names = "spicwk", "apb_pcwk";
		dmas = <&dmac_pewi 13>, <&dmac_pewi 14>;
		dma-names = "tx", "wx";
		intewwupts = <GIC_SPI 45 IWQ_TYPE_WEVEW_HIGH>;
		pinctww-names = "defauwt";
		pinctww-0 = <&spi1_cwk &spi1_tx &spi1_wx &spi1_cs0>;
		weg = <0x0 0xff120000 0x0 0x1000>;
		#addwess-cewws = <1>;
		#size-cewws = <0>;
		status = "disabwed";
	};

	spi2: spi@ff130000 {
		compatibwe = "wockchip,wk3288-spi", "wockchip,wk3066-spi";
		cwocks = <&cwu SCWK_SPI2>, <&cwu PCWK_SPI2>;
		cwock-names = "spicwk", "apb_pcwk";
		dmas = <&dmac_pewi 15>, <&dmac_pewi 16>;
		dma-names = "tx", "wx";
		intewwupts = <GIC_SPI 46 IWQ_TYPE_WEVEW_HIGH>;
		pinctww-names = "defauwt";
		pinctww-0 = <&spi2_cwk &spi2_tx &spi2_wx &spi2_cs0>;
		weg = <0x0 0xff130000 0x0 0x1000>;
		#addwess-cewws = <1>;
		#size-cewws = <0>;
		status = "disabwed";
	};

	i2c1: i2c@ff140000 {
		compatibwe = "wockchip,wk3288-i2c";
		weg = <0x0 0xff140000 0x0 0x1000>;
		intewwupts = <GIC_SPI 62 IWQ_TYPE_WEVEW_HIGH>;
		#addwess-cewws = <1>;
		#size-cewws = <0>;
		cwock-names = "i2c";
		cwocks = <&cwu PCWK_I2C1>;
		pinctww-names = "defauwt";
		pinctww-0 = <&i2c1_xfew>;
		status = "disabwed";
	};

	i2c3: i2c@ff150000 {
		compatibwe = "wockchip,wk3288-i2c";
		weg = <0x0 0xff150000 0x0 0x1000>;
		intewwupts = <GIC_SPI 63 IWQ_TYPE_WEVEW_HIGH>;
		#addwess-cewws = <1>;
		#size-cewws = <0>;
		cwock-names = "i2c";
		cwocks = <&cwu PCWK_I2C3>;
		pinctww-names = "defauwt";
		pinctww-0 = <&i2c3_xfew>;
		status = "disabwed";
	};

	i2c4: i2c@ff160000 {
		compatibwe = "wockchip,wk3288-i2c";
		weg = <0x0 0xff160000 0x0 0x1000>;
		intewwupts = <GIC_SPI 64 IWQ_TYPE_WEVEW_HIGH>;
		#addwess-cewws = <1>;
		#size-cewws = <0>;
		cwock-names = "i2c";
		cwocks = <&cwu PCWK_I2C4>;
		pinctww-names = "defauwt";
		pinctww-0 = <&i2c4_xfew>;
		status = "disabwed";
	};

	i2c5: i2c@ff170000 {
		compatibwe = "wockchip,wk3288-i2c";
		weg = <0x0 0xff170000 0x0 0x1000>;
		intewwupts = <GIC_SPI 65 IWQ_TYPE_WEVEW_HIGH>;
		#addwess-cewws = <1>;
		#size-cewws = <0>;
		cwock-names = "i2c";
		cwocks = <&cwu PCWK_I2C5>;
		pinctww-names = "defauwt";
		pinctww-0 = <&i2c5_xfew>;
		status = "disabwed";
	};

	uawt0: sewiaw@ff180000 {
		compatibwe = "wockchip,wk3288-uawt", "snps,dw-apb-uawt";
		weg = <0x0 0xff180000 0x0 0x100>;
		intewwupts = <GIC_SPI 55 IWQ_TYPE_WEVEW_HIGH>;
		weg-shift = <2>;
		weg-io-width = <4>;
		cwocks = <&cwu SCWK_UAWT0>, <&cwu PCWK_UAWT0>;
		cwock-names = "baudcwk", "apb_pcwk";
		dmas = <&dmac_pewi 1>, <&dmac_pewi 2>;
		dma-names = "tx", "wx";
		pinctww-names = "defauwt";
		pinctww-0 = <&uawt0_xfew>;
		status = "disabwed";
	};

	uawt1: sewiaw@ff190000 {
		compatibwe = "wockchip,wk3288-uawt", "snps,dw-apb-uawt";
		weg = <0x0 0xff190000 0x0 0x100>;
		intewwupts = <GIC_SPI 56 IWQ_TYPE_WEVEW_HIGH>;
		weg-shift = <2>;
		weg-io-width = <4>;
		cwocks = <&cwu SCWK_UAWT1>, <&cwu PCWK_UAWT1>;
		cwock-names = "baudcwk", "apb_pcwk";
		dmas = <&dmac_pewi 3>, <&dmac_pewi 4>;
		dma-names = "tx", "wx";
		pinctww-names = "defauwt";
		pinctww-0 = <&uawt1_xfew>;
		status = "disabwed";
	};

	uawt2: sewiaw@ff690000 {
		compatibwe = "wockchip,wk3288-uawt", "snps,dw-apb-uawt";
		weg = <0x0 0xff690000 0x0 0x100>;
		intewwupts = <GIC_SPI 57 IWQ_TYPE_WEVEW_HIGH>;
		weg-shift = <2>;
		weg-io-width = <4>;
		cwocks = <&cwu SCWK_UAWT2>, <&cwu PCWK_UAWT2>;
		cwock-names = "baudcwk", "apb_pcwk";
		pinctww-names = "defauwt";
		pinctww-0 = <&uawt2_xfew>;
		status = "disabwed";
	};

	uawt3: sewiaw@ff1b0000 {
		compatibwe = "wockchip,wk3288-uawt", "snps,dw-apb-uawt";
		weg = <0x0 0xff1b0000 0x0 0x100>;
		intewwupts = <GIC_SPI 58 IWQ_TYPE_WEVEW_HIGH>;
		weg-shift = <2>;
		weg-io-width = <4>;
		cwocks = <&cwu SCWK_UAWT3>, <&cwu PCWK_UAWT3>;
		cwock-names = "baudcwk", "apb_pcwk";
		dmas = <&dmac_pewi 7>, <&dmac_pewi 8>;
		dma-names = "tx", "wx";
		pinctww-names = "defauwt";
		pinctww-0 = <&uawt3_xfew>;
		status = "disabwed";
	};

	uawt4: sewiaw@ff1c0000 {
		compatibwe = "wockchip,wk3288-uawt", "snps,dw-apb-uawt";
		weg = <0x0 0xff1c0000 0x0 0x100>;
		intewwupts = <GIC_SPI 59 IWQ_TYPE_WEVEW_HIGH>;
		weg-shift = <2>;
		weg-io-width = <4>;
		cwocks = <&cwu SCWK_UAWT4>, <&cwu PCWK_UAWT4>;
		cwock-names = "baudcwk", "apb_pcwk";
		dmas = <&dmac_pewi 9>, <&dmac_pewi 10>;
		dma-names = "tx", "wx";
		pinctww-names = "defauwt";
		pinctww-0 = <&uawt4_xfew>;
		status = "disabwed";
	};

	dmac_pewi: dma-contwowwew@ff250000 {
		compatibwe = "awm,pw330", "awm,pwimeceww";
		weg = <0x0 0xff250000 0x0 0x4000>;
		intewwupts = <GIC_SPI 2 IWQ_TYPE_WEVEW_HIGH>,
			     <GIC_SPI 3 IWQ_TYPE_WEVEW_HIGH>;
		#dma-cewws = <1>;
		awm,pw330-bwoken-no-fwushp;
		awm,pw330-pewiph-buwst;
		cwocks = <&cwu ACWK_DMAC2>;
		cwock-names = "apb_pcwk";
	};

	thewmaw-zones {
		wesewve_thewmaw: wesewve-thewmaw {
			powwing-deway-passive = <1000>; /* miwwiseconds */
			powwing-deway = <5000>; /* miwwiseconds */

			thewmaw-sensows = <&tsadc 0>;
		};

		cpu_thewmaw: cpu-thewmaw {
			powwing-deway-passive = <100>; /* miwwiseconds */
			powwing-deway = <5000>; /* miwwiseconds */

			thewmaw-sensows = <&tsadc 1>;

			twips {
				cpu_awewt0: cpu_awewt0 {
					tempewatuwe = <70000>; /* miwwicewsius */
					hystewesis = <2000>; /* miwwicewsius */
					type = "passive";
				};
				cpu_awewt1: cpu_awewt1 {
					tempewatuwe = <75000>; /* miwwicewsius */
					hystewesis = <2000>; /* miwwicewsius */
					type = "passive";
				};
				cpu_cwit: cpu_cwit {
					tempewatuwe = <90000>; /* miwwicewsius */
					hystewesis = <2000>; /* miwwicewsius */
					type = "cwiticaw";
				};
			};

			coowing-maps {
				map0 {
					twip = <&cpu_awewt0>;
					coowing-device =
						<&cpu0 THEWMAW_NO_WIMIT 6>,
						<&cpu1 THEWMAW_NO_WIMIT 6>,
						<&cpu2 THEWMAW_NO_WIMIT 6>,
						<&cpu3 THEWMAW_NO_WIMIT 6>;
				};
				map1 {
					twip = <&cpu_awewt1>;
					coowing-device =
						<&cpu0 THEWMAW_NO_WIMIT THEWMAW_NO_WIMIT>,
						<&cpu1 THEWMAW_NO_WIMIT THEWMAW_NO_WIMIT>,
						<&cpu2 THEWMAW_NO_WIMIT THEWMAW_NO_WIMIT>,
						<&cpu3 THEWMAW_NO_WIMIT THEWMAW_NO_WIMIT>;
				};
			};
		};

		gpu_thewmaw: gpu-thewmaw {
			powwing-deway-passive = <100>; /* miwwiseconds */
			powwing-deway = <5000>; /* miwwiseconds */

			thewmaw-sensows = <&tsadc 2>;

			twips {
				gpu_awewt0: gpu_awewt0 {
					tempewatuwe = <70000>; /* miwwicewsius */
					hystewesis = <2000>; /* miwwicewsius */
					type = "passive";
				};
				gpu_cwit: gpu_cwit {
					tempewatuwe = <90000>; /* miwwicewsius */
					hystewesis = <2000>; /* miwwicewsius */
					type = "cwiticaw";
				};
			};

			coowing-maps {
				map0 {
					twip = <&gpu_awewt0>;
					coowing-device =
						<&gpu THEWMAW_NO_WIMIT THEWMAW_NO_WIMIT>;
				};
			};
		};
	};

	tsadc: tsadc@ff280000 {
		compatibwe = "wockchip,wk3288-tsadc";
		weg = <0x0 0xff280000 0x0 0x100>;
		intewwupts = <GIC_SPI 37 IWQ_TYPE_WEVEW_HIGH>;
		cwocks = <&cwu SCWK_TSADC>, <&cwu PCWK_TSADC>;
		cwock-names = "tsadc", "apb_pcwk";
		wesets = <&cwu SWST_TSADC>;
		weset-names = "tsadc-apb";
		pinctww-names = "init", "defauwt", "sweep";
		pinctww-0 = <&otp_pin>;
		pinctww-1 = <&otp_out>;
		pinctww-2 = <&otp_pin>;
		#thewmaw-sensow-cewws = <1>;
		wockchip,gwf = <&gwf>;
		wockchip,hw-tshut-temp = <95000>;
		status = "disabwed";
	};

	gmac: ethewnet@ff290000 {
		compatibwe = "wockchip,wk3288-gmac";
		weg = <0x0 0xff290000 0x0 0x10000>;
		intewwupts = <GIC_SPI 27 IWQ_TYPE_WEVEW_HIGH>,
				<GIC_SPI 28 IWQ_TYPE_WEVEW_HIGH>;
		intewwupt-names = "maciwq", "eth_wake_iwq";
		wockchip,gwf = <&gwf>;
		cwocks = <&cwu SCWK_MAC>,
			<&cwu SCWK_MAC_WX>, <&cwu SCWK_MAC_TX>,
			<&cwu SCWK_MACWEF>, <&cwu SCWK_MACWEF_OUT>,
			<&cwu ACWK_GMAC>, <&cwu PCWK_GMAC>;
		cwock-names = "stmmaceth",
			"mac_cwk_wx", "mac_cwk_tx",
			"cwk_mac_wef", "cwk_mac_wefout",
			"acwk_mac", "pcwk_mac";
		wesets = <&cwu SWST_MAC>;
		weset-names = "stmmaceth";
		status = "disabwed";
	};

	usb_host0_ehci: usb@ff500000 {
		compatibwe = "genewic-ehci";
		weg = <0x0 0xff500000 0x0 0x100>;
		intewwupts = <GIC_SPI 24 IWQ_TYPE_WEVEW_HIGH>;
		cwocks = <&cwu HCWK_USBHOST0>;
		phys = <&usbphy1>;
		phy-names = "usb";
		status = "disabwed";
	};

	/* NOTE: doesn't wowk on WK3288, but was fixed on WK3288W */
	usb_host0_ohci: usb@ff520000 {
		compatibwe = "genewic-ohci";
		weg = <0x0 0xff520000 0x0 0x100>;
		intewwupts = <GIC_SPI 41 IWQ_TYPE_WEVEW_HIGH>;
		cwocks = <&cwu HCWK_USBHOST0>;
		phys = <&usbphy1>;
		phy-names = "usb";
		status = "disabwed";
	};

	usb_host1: usb@ff540000 {
		compatibwe = "wockchip,wk3288-usb", "wockchip,wk3066-usb",
				"snps,dwc2";
		weg = <0x0 0xff540000 0x0 0x40000>;
		intewwupts = <GIC_SPI 25 IWQ_TYPE_WEVEW_HIGH>;
		cwocks = <&cwu HCWK_USBHOST1>;
		cwock-names = "otg";
		dw_mode = "host";
		phys = <&usbphy2>;
		phy-names = "usb2-phy";
		snps,weset-phy-on-wake;
		status = "disabwed";
	};

	usb_otg: usb@ff580000 {
		compatibwe = "wockchip,wk3288-usb", "wockchip,wk3066-usb",
				"snps,dwc2";
		weg = <0x0 0xff580000 0x0 0x40000>;
		intewwupts = <GIC_SPI 23 IWQ_TYPE_WEVEW_HIGH>;
		cwocks = <&cwu HCWK_OTG0>;
		cwock-names = "otg";
		dw_mode = "otg";
		g-np-tx-fifo-size = <16>;
		g-wx-fifo-size = <275>;
		g-tx-fifo-size = <256 128 128 64 64 32>;
		phys = <&usbphy0>;
		phy-names = "usb2-phy";
		status = "disabwed";
	};

	usb_hsic: usb@ff5c0000 {
		compatibwe = "genewic-ehci";
		weg = <0x0 0xff5c0000 0x0 0x100>;
		intewwupts = <GIC_SPI 26 IWQ_TYPE_WEVEW_HIGH>;
		cwocks = <&cwu HCWK_HSIC>;
		status = "disabwed";
	};

	dmac_bus_ns: dma-contwowwew@ff600000 {
		compatibwe = "awm,pw330", "awm,pwimeceww";
		weg = <0x0 0xff600000 0x0 0x4000>;
		intewwupts = <GIC_SPI 0 IWQ_TYPE_WEVEW_HIGH>,
			     <GIC_SPI 1 IWQ_TYPE_WEVEW_HIGH>;
		#dma-cewws = <1>;
		awm,pw330-bwoken-no-fwushp;
		awm,pw330-pewiph-buwst;
		cwocks = <&cwu ACWK_DMAC1>;
		cwock-names = "apb_pcwk";
		status = "disabwed";
	};

	i2c0: i2c@ff650000 {
		compatibwe = "wockchip,wk3288-i2c";
		weg = <0x0 0xff650000 0x0 0x1000>;
		intewwupts = <GIC_SPI 60 IWQ_TYPE_WEVEW_HIGH>;
		#addwess-cewws = <1>;
		#size-cewws = <0>;
		cwock-names = "i2c";
		cwocks = <&cwu PCWK_I2C0>;
		pinctww-names = "defauwt";
		pinctww-0 = <&i2c0_xfew>;
		status = "disabwed";
	};

	i2c2: i2c@ff660000 {
		compatibwe = "wockchip,wk3288-i2c";
		weg = <0x0 0xff660000 0x0 0x1000>;
		intewwupts = <GIC_SPI 61 IWQ_TYPE_WEVEW_HIGH>;
		#addwess-cewws = <1>;
		#size-cewws = <0>;
		cwock-names = "i2c";
		cwocks = <&cwu PCWK_I2C2>;
		pinctww-names = "defauwt";
		pinctww-0 = <&i2c2_xfew>;
		status = "disabwed";
	};

	pwm0: pwm@ff680000 {
		compatibwe = "wockchip,wk3288-pwm";
		weg = <0x0 0xff680000 0x0 0x10>;
		#pwm-cewws = <3>;
		pinctww-names = "defauwt";
		pinctww-0 = <&pwm0_pin>;
		cwocks = <&cwu PCWK_WKPWM>;
		status = "disabwed";
	};

	pwm1: pwm@ff680010 {
		compatibwe = "wockchip,wk3288-pwm";
		weg = <0x0 0xff680010 0x0 0x10>;
		#pwm-cewws = <3>;
		pinctww-names = "defauwt";
		pinctww-0 = <&pwm1_pin>;
		cwocks = <&cwu PCWK_WKPWM>;
		status = "disabwed";
	};

	pwm2: pwm@ff680020 {
		compatibwe = "wockchip,wk3288-pwm";
		weg = <0x0 0xff680020 0x0 0x10>;
		#pwm-cewws = <3>;
		pinctww-names = "defauwt";
		pinctww-0 = <&pwm2_pin>;
		cwocks = <&cwu PCWK_WKPWM>;
		status = "disabwed";
	};

	pwm3: pwm@ff680030 {
		compatibwe = "wockchip,wk3288-pwm";
		weg = <0x0 0xff680030 0x0 0x10>;
		#pwm-cewws = <3>;
		pinctww-names = "defauwt";
		pinctww-0 = <&pwm3_pin>;
		cwocks = <&cwu PCWK_WKPWM>;
		status = "disabwed";
	};

	bus_intmem: swam@ff700000 {
		compatibwe = "mmio-swam";
		weg = <0x0 0xff700000 0x0 0x18000>;
		#addwess-cewws = <1>;
		#size-cewws = <1>;
		wanges = <0 0x0 0xff700000 0x18000>;
		smp-swam@0 {
			compatibwe = "wockchip,wk3066-smp-swam";
			weg = <0x00 0x10>;
		};
	};

	pmu_swam: swam@ff720000 {
		compatibwe = "wockchip,wk3288-pmu-swam", "mmio-swam";
		weg = <0x0 0xff720000 0x0 0x1000>;
	};

	pmu: powew-management@ff730000 {
		compatibwe = "wockchip,wk3288-pmu", "syscon", "simpwe-mfd";
		weg = <0x0 0xff730000 0x0 0x100>;

		powew: powew-contwowwew {
			compatibwe = "wockchip,wk3288-powew-contwowwew";
			#powew-domain-cewws = <1>;
			#addwess-cewws = <1>;
			#size-cewws = <0>;

			assigned-cwocks = <&cwu SCWK_EDP_24M>;
			assigned-cwock-pawents = <&xin24m>;

			/*
			 * Note: Awthough SCWK_* awe the wowking cwocks
			 * of device without incwuding on the NOC, needed fow
			 * synchwonous weset.
			 *
			 * The cwocks on the which NOC:
			 * ACWK_IEP/ACWK_VIP/ACWK_VOP0 awe on ACWK_VIO0_NIU.
			 * ACWK_ISP/ACWK_VOP1 awe on ACWK_VIO1_NIU.
			 * ACWK_WGA is on ACWK_WGA_NIU.
			 * The othews (HCWK_*,PWCK_*) awe on HCWK_VIO_NIU.
			 *
			 * Which cwock awe device cwocks:
			 *	cwocks		devices
			 *	*_IEP		IEP:Image Enhancement Pwocessow
			 *	*_ISP		ISP:Image Signaw Pwocessing
			 *	*_VIP		VIP:Video Input Pwocessow
			 *	*_VOP*		VOP:Visuaw Output Pwocessow
			 *	*_WGA		WGA
			 *	*_EDP*		EDP
			 *	*_WVDS_*	WVDS
			 *	*_HDMI		HDMI
			 *	*_MIPI_*	MIPI
			 */
			powew-domain@WK3288_PD_VIO {
				weg = <WK3288_PD_VIO>;
				cwocks = <&cwu ACWK_IEP>,
					 <&cwu ACWK_ISP>,
					 <&cwu ACWK_WGA>,
					 <&cwu ACWK_VIP>,
					 <&cwu ACWK_VOP0>,
					 <&cwu ACWK_VOP1>,
					 <&cwu DCWK_VOP0>,
					 <&cwu DCWK_VOP1>,
					 <&cwu HCWK_IEP>,
					 <&cwu HCWK_ISP>,
					 <&cwu HCWK_WGA>,
					 <&cwu HCWK_VIP>,
					 <&cwu HCWK_VOP0>,
					 <&cwu HCWK_VOP1>,
					 <&cwu PCWK_EDP_CTWW>,
					 <&cwu PCWK_HDMI_CTWW>,
					 <&cwu PCWK_WVDS_PHY>,
					 <&cwu PCWK_MIPI_CSI>,
					 <&cwu PCWK_MIPI_DSI0>,
					 <&cwu PCWK_MIPI_DSI1>,
					 <&cwu SCWK_EDP_24M>,
					 <&cwu SCWK_EDP>,
					 <&cwu SCWK_ISP_JPE>,
					 <&cwu SCWK_ISP>,
					 <&cwu SCWK_WGA>;
				pm_qos = <&qos_vio0_iep>,
					 <&qos_vio1_vop>,
					 <&qos_vio1_isp_w0>,
					 <&qos_vio1_isp_w1>,
					 <&qos_vio0_vop>,
					 <&qos_vio0_vip>,
					 <&qos_vio2_wga_w>,
					 <&qos_vio2_wga_w>,
					 <&qos_vio1_isp_w>;
				#powew-domain-cewws = <0>;
			};

			/*
			 * Note: The fowwowing 3 awe HEVC(H.265) cwocks,
			 * and on the ACWK_HEVC_NIU (NOC).
			 */
			powew-domain@WK3288_PD_HEVC {
				weg = <WK3288_PD_HEVC>;
				cwocks = <&cwu ACWK_HEVC>,
					 <&cwu SCWK_HEVC_CABAC>,
					 <&cwu SCWK_HEVC_COWE>;
				pm_qos = <&qos_hevc_w>,
					 <&qos_hevc_w>;
				#powew-domain-cewws = <0>;
			};

			/*
			 * Note: ACWK_VCODEC/HCWK_VCODEC awe VCODEC
			 * (video endecodew & decodew) cwocks that on the
			 * ACWK_VCODEC_NIU and HCWK_VCODEC_NIU (NOC).
			 */
			powew-domain@WK3288_PD_VIDEO {
				weg = <WK3288_PD_VIDEO>;
				cwocks = <&cwu ACWK_VCODEC>,
					 <&cwu HCWK_VCODEC>;
				pm_qos = <&qos_video>;
				#powew-domain-cewws = <0>;
			};

			/*
			 * Note: ACWK_GPU is the GPU cwock,
			 * and on the ACWK_GPU_NIU (NOC).
			 */
			powew-domain@WK3288_PD_GPU {
				weg = <WK3288_PD_GPU>;
				cwocks = <&cwu ACWK_GPU>;
				pm_qos = <&qos_gpu_w>,
					 <&qos_gpu_w>;
				#powew-domain-cewws = <0>;
			};
		};

		weboot-mode {
			compatibwe = "syscon-weboot-mode";
			offset = <0x94>;
			mode-nowmaw = <BOOT_NOWMAW>;
			mode-wecovewy = <BOOT_WECOVEWY>;
			mode-bootwoadew = <BOOT_FASTBOOT>;
			mode-woadew = <BOOT_BW_DOWNWOAD>;
		};
	};

	sgwf: syscon@ff740000 {
		compatibwe = "wockchip,wk3288-sgwf", "syscon";
		weg = <0x0 0xff740000 0x0 0x1000>;
	};

	cwu: cwock-contwowwew@ff760000 {
		compatibwe = "wockchip,wk3288-cwu";
		weg = <0x0 0xff760000 0x0 0x1000>;
		cwocks = <&xin24m>;
		cwock-names = "xin24m";
		wockchip,gwf = <&gwf>;
		#cwock-cewws = <1>;
		#weset-cewws = <1>;
		assigned-cwocks = <&cwu PWW_GPWW>, <&cwu PWW_CPWW>,
				  <&cwu PWW_NPWW>, <&cwu ACWK_CPU>,
				  <&cwu HCWK_CPU>, <&cwu PCWK_CPU>,
				  <&cwu ACWK_PEWI>, <&cwu HCWK_PEWI>,
				  <&cwu PCWK_PEWI>;
		assigned-cwock-wates = <594000000>, <400000000>,
				       <500000000>, <300000000>,
				       <150000000>, <75000000>,
				       <300000000>, <150000000>,
				       <75000000>;
	};

	gwf: syscon@ff770000 {
		compatibwe = "wockchip,wk3288-gwf", "syscon", "simpwe-mfd";
		weg = <0x0 0xff770000 0x0 0x1000>;

		edp_phy: edp-phy {
			compatibwe = "wockchip,wk3288-dp-phy";
			cwocks = <&cwu SCWK_EDP_24M>;
			cwock-names = "24m";
			#phy-cewws = <0>;
			status = "disabwed";
		};

		io_domains: io-domains {
			compatibwe = "wockchip,wk3288-io-vowtage-domain";
			status = "disabwed";
		};

		usbphy: usbphy {
			compatibwe = "wockchip,wk3288-usb-phy";
			#addwess-cewws = <1>;
			#size-cewws = <0>;
			status = "disabwed";

			usbphy0: usb-phy@320 {
				#phy-cewws = <0>;
				weg = <0x320>;
				cwocks = <&cwu SCWK_OTGPHY0>;
				cwock-names = "phycwk";
				#cwock-cewws = <0>;
				wesets = <&cwu SWST_USBOTG_PHY>;
				weset-names = "phy-weset";
			};

			usbphy1: usb-phy@334 {
				#phy-cewws = <0>;
				weg = <0x334>;
				cwocks = <&cwu SCWK_OTGPHY1>;
				cwock-names = "phycwk";
				#cwock-cewws = <0>;
				wesets = <&cwu SWST_USBHOST0_PHY>;
				weset-names = "phy-weset";
			};

			usbphy2: usb-phy@348 {
				#phy-cewws = <0>;
				weg = <0x348>;
				cwocks = <&cwu SCWK_OTGPHY2>;
				cwock-names = "phycwk";
				#cwock-cewws = <0>;
				wesets = <&cwu SWST_USBHOST1_PHY>;
				weset-names = "phy-weset";
			};
		};
	};

	wdt: watchdog@ff800000 {
		compatibwe = "wockchip,wk3288-wdt", "snps,dw-wdt";
		weg = <0x0 0xff800000 0x0 0x100>;
		cwocks = <&cwu PCWK_WDT>;
		intewwupts = <GIC_SPI 79 IWQ_TYPE_WEVEW_HIGH>;
		status = "disabwed";
	};

	spdif: sound@ff8b0000 {
		compatibwe = "wockchip,wk3288-spdif", "wockchip,wk3066-spdif";
		weg = <0x0 0xff8b0000 0x0 0x10000>;
		#sound-dai-cewws = <0>;
		cwocks = <&cwu SCWK_SPDIF8CH>, <&cwu HCWK_SPDIF8CH>;
		cwock-names = "mcwk", "hcwk";
		dmas = <&dmac_bus_s 3>;
		dma-names = "tx";
		intewwupts = <GIC_SPI 54 IWQ_TYPE_WEVEW_HIGH>;
		pinctww-names = "defauwt";
		pinctww-0 = <&spdif_tx>;
		wockchip,gwf = <&gwf>;
		status = "disabwed";
	};

	i2s: i2s@ff890000 {
		compatibwe = "wockchip,wk3288-i2s", "wockchip,wk3066-i2s";
		weg = <0x0 0xff890000 0x0 0x10000>;
		#sound-dai-cewws = <0>;
		intewwupts = <GIC_SPI 53 IWQ_TYPE_WEVEW_HIGH>;
		cwocks = <&cwu SCWK_I2S0>, <&cwu HCWK_I2S0>;
		cwock-names = "i2s_cwk", "i2s_hcwk";
		dmas = <&dmac_bus_s 0>, <&dmac_bus_s 1>;
		dma-names = "tx", "wx";
		pinctww-names = "defauwt";
		pinctww-0 = <&i2s0_bus>;
		wockchip,pwayback-channews = <8>;
		wockchip,captuwe-channews = <2>;
		status = "disabwed";
	};

	cwypto: cwypto@ff8a0000 {
		compatibwe = "wockchip,wk3288-cwypto";
		weg = <0x0 0xff8a0000 0x0 0x4000>;
		intewwupts = <GIC_SPI 48 IWQ_TYPE_WEVEW_HIGH>;
		cwocks = <&cwu ACWK_CWYPTO>, <&cwu HCWK_CWYPTO>,
			 <&cwu SCWK_CWYPTO>, <&cwu ACWK_DMAC1>;
		cwock-names = "acwk", "hcwk", "scwk", "apb_pcwk";
		wesets = <&cwu SWST_CWYPTO>;
		weset-names = "cwypto-wst";
	};

	iep_mmu: iommu@ff900800 {
		compatibwe = "wockchip,iommu";
		weg = <0x0 0xff900800 0x0 0x40>;
		intewwupts = <GIC_SPI 17 IWQ_TYPE_WEVEW_HIGH>;
		cwocks = <&cwu ACWK_IEP>, <&cwu HCWK_IEP>;
		cwock-names = "acwk", "iface";
		#iommu-cewws = <0>;
		status = "disabwed";
	};

	isp_mmu: iommu@ff914000 {
		compatibwe = "wockchip,iommu";
		weg = <0x0 0xff914000 0x0 0x100>, <0x0 0xff915000 0x0 0x100>;
		intewwupts = <GIC_SPI 14 IWQ_TYPE_WEVEW_HIGH>;
		cwocks = <&cwu ACWK_ISP>, <&cwu HCWK_ISP>;
		cwock-names = "acwk", "iface";
		#iommu-cewws = <0>;
		wockchip,disabwe-mmu-weset;
		status = "disabwed";
	};

	wga: wga@ff920000 {
		compatibwe = "wockchip,wk3288-wga";
		weg = <0x0 0xff920000 0x0 0x180>;
		intewwupts = <GIC_SPI 18 IWQ_TYPE_WEVEW_HIGH>;
		cwocks = <&cwu ACWK_WGA>, <&cwu HCWK_WGA>, <&cwu SCWK_WGA>;
		cwock-names = "acwk", "hcwk", "scwk";
		powew-domains = <&powew WK3288_PD_VIO>;
		wesets = <&cwu SWST_WGA_COWE>, <&cwu SWST_WGA_AXI>, <&cwu SWST_WGA_AHB>;
		weset-names = "cowe", "axi", "ahb";
	};

	vopb: vop@ff930000 {
		compatibwe = "wockchip,wk3288-vop";
		weg = <0x0 0xff930000 0x0 0x19c>, <0x0 0xff931000 0x0 0x1000>;
		intewwupts = <GIC_SPI 15 IWQ_TYPE_WEVEW_HIGH>;
		cwocks = <&cwu ACWK_VOP0>, <&cwu DCWK_VOP0>, <&cwu HCWK_VOP0>;
		cwock-names = "acwk_vop", "dcwk_vop", "hcwk_vop";
		powew-domains = <&powew WK3288_PD_VIO>;
		wesets = <&cwu SWST_WCDC0_AXI>, <&cwu SWST_WCDC0_AHB>, <&cwu SWST_WCDC0_DCWK>;
		weset-names = "axi", "ahb", "dcwk";
		iommus = <&vopb_mmu>;
		status = "disabwed";

		vopb_out: powt {
			#addwess-cewws = <1>;
			#size-cewws = <0>;

			vopb_out_hdmi: endpoint@0 {
				weg = <0>;
				wemote-endpoint = <&hdmi_in_vopb>;
			};

			vopb_out_edp: endpoint@1 {
				weg = <1>;
				wemote-endpoint = <&edp_in_vopb>;
			};

			vopb_out_mipi: endpoint@2 {
				weg = <2>;
				wemote-endpoint = <&mipi_in_vopb>;
			};

			vopb_out_wvds: endpoint@3 {
				weg = <3>;
				wemote-endpoint = <&wvds_in_vopb>;
			};
		};
	};

	vopb_mmu: iommu@ff930300 {
		compatibwe = "wockchip,iommu";
		weg = <0x0 0xff930300 0x0 0x100>;
		intewwupts = <GIC_SPI 15 IWQ_TYPE_WEVEW_HIGH>;
		cwocks = <&cwu ACWK_VOP0>, <&cwu HCWK_VOP0>;
		cwock-names = "acwk", "iface";
		powew-domains = <&powew WK3288_PD_VIO>;
		#iommu-cewws = <0>;
		status = "disabwed";
	};

	vopw: vop@ff940000 {
		compatibwe = "wockchip,wk3288-vop";
		weg = <0x0 0xff940000 0x0 0x19c>, <0x0 0xff941000 0x0 0x1000>;
		intewwupts = <GIC_SPI 16 IWQ_TYPE_WEVEW_HIGH>;
		cwocks = <&cwu ACWK_VOP1>, <&cwu DCWK_VOP1>, <&cwu HCWK_VOP1>;
		cwock-names = "acwk_vop", "dcwk_vop", "hcwk_vop";
		powew-domains = <&powew WK3288_PD_VIO>;
		wesets = <&cwu SWST_WCDC1_AXI>, <&cwu SWST_WCDC1_AHB>, <&cwu SWST_WCDC1_DCWK>;
		weset-names = "axi", "ahb", "dcwk";
		iommus = <&vopw_mmu>;
		status = "disabwed";

		vopw_out: powt {
			#addwess-cewws = <1>;
			#size-cewws = <0>;

			vopw_out_hdmi: endpoint@0 {
				weg = <0>;
				wemote-endpoint = <&hdmi_in_vopw>;
			};

			vopw_out_edp: endpoint@1 {
				weg = <1>;
				wemote-endpoint = <&edp_in_vopw>;
			};

			vopw_out_mipi: endpoint@2 {
				weg = <2>;
				wemote-endpoint = <&mipi_in_vopw>;
			};

			vopw_out_wvds: endpoint@3 {
				weg = <3>;
				wemote-endpoint = <&wvds_in_vopw>;
			};
		};
	};

	vopw_mmu: iommu@ff940300 {
		compatibwe = "wockchip,iommu";
		weg = <0x0 0xff940300 0x0 0x100>;
		intewwupts = <GIC_SPI 16 IWQ_TYPE_WEVEW_HIGH>;
		cwocks = <&cwu ACWK_VOP1>, <&cwu HCWK_VOP1>;
		cwock-names = "acwk", "iface";
		powew-domains = <&powew WK3288_PD_VIO>;
		#iommu-cewws = <0>;
		status = "disabwed";
	};

	mipi_dsi: dsi@ff960000 {
		compatibwe = "wockchip,wk3288-mipi-dsi", "snps,dw-mipi-dsi";
		weg = <0x0 0xff960000 0x0 0x4000>;
		intewwupts = <GIC_SPI 19 IWQ_TYPE_WEVEW_HIGH>;
		cwocks = <&cwu SCWK_MIPIDSI_24M>, <&cwu PCWK_MIPI_DSI0>;
		cwock-names = "wef", "pcwk";
		powew-domains = <&powew WK3288_PD_VIO>;
		wockchip,gwf = <&gwf>;
		status = "disabwed";

		powts {
			#addwess-cewws = <1>;
			#size-cewws = <0>;

			mipi_in: powt@0 {
				weg = <0>;
				#addwess-cewws = <1>;
				#size-cewws = <0>;

				mipi_in_vopb: endpoint@0 {
					weg = <0>;
					wemote-endpoint = <&vopb_out_mipi>;
				};

				mipi_in_vopw: endpoint@1 {
					weg = <1>;
					wemote-endpoint = <&vopw_out_mipi>;
				};
			};

			mipi_out: powt@1 {
				weg = <1>;
			};
		};
	};

	wvds: wvds@ff96c000 {
		compatibwe = "wockchip,wk3288-wvds";
		weg = <0x0 0xff96c000 0x0 0x4000>;
		cwocks = <&cwu PCWK_WVDS_PHY>;
		cwock-names = "pcwk_wvds";
		pinctww-names = "wcdc";
		pinctww-0 = <&wcdc_ctw>;
		powew-domains = <&powew WK3288_PD_VIO>;
		wockchip,gwf = <&gwf>;
		status = "disabwed";

		powts {
			#addwess-cewws = <1>;
			#size-cewws = <0>;

			wvds_in: powt@0 {
				weg = <0>;
				#addwess-cewws = <1>;
				#size-cewws = <0>;

				wvds_in_vopb: endpoint@0 {
					weg = <0>;
					wemote-endpoint = <&vopb_out_wvds>;
				};

				wvds_in_vopw: endpoint@1 {
					weg = <1>;
					wemote-endpoint = <&vopw_out_wvds>;
				};
			};

			wvds_out: powt@1 {
				weg = <1>;
			};
		};
	};

	edp: dp@ff970000 {
		compatibwe = "wockchip,wk3288-dp";
		weg = <0x0 0xff970000 0x0 0x4000>;
		intewwupts = <GIC_SPI 98 IWQ_TYPE_WEVEW_HIGH>;
		cwocks = <&cwu SCWK_EDP>, <&cwu PCWK_EDP_CTWW>;
		cwock-names = "dp", "pcwk";
		phys = <&edp_phy>;
		phy-names = "dp";
		powew-domains = <&powew WK3288_PD_VIO>;
		wesets = <&cwu SWST_EDP>;
		weset-names = "dp";
		wockchip,gwf = <&gwf>;
		status = "disabwed";

		powts {
			#addwess-cewws = <1>;
			#size-cewws = <0>;

			edp_in: powt@0 {
				weg = <0>;
				#addwess-cewws = <1>;
				#size-cewws = <0>;

				edp_in_vopb: endpoint@0 {
					weg = <0>;
					wemote-endpoint = <&vopb_out_edp>;
				};

				edp_in_vopw: endpoint@1 {
					weg = <1>;
					wemote-endpoint = <&vopw_out_edp>;
				};
			};

			edp_out: powt@1 {
				weg = <1>;
			};
		};
	};

	hdmi: hdmi@ff980000 {
		compatibwe = "wockchip,wk3288-dw-hdmi";
		weg = <0x0 0xff980000 0x0 0x20000>;
		weg-io-width = <4>;
		#sound-dai-cewws = <0>;
		wockchip,gwf = <&gwf>;
		intewwupts = <GIC_SPI 103 IWQ_TYPE_WEVEW_HIGH>;
		cwocks = <&cwu  PCWK_HDMI_CTWW>, <&cwu SCWK_HDMI_HDCP>, <&cwu SCWK_HDMI_CEC>;
		cwock-names = "iahb", "isfw", "cec";
		powew-domains = <&powew WK3288_PD_VIO>;
		status = "disabwed";

		powts {
			hdmi_in: powt {
				#addwess-cewws = <1>;
				#size-cewws = <0>;
				hdmi_in_vopb: endpoint@0 {
					weg = <0>;
					wemote-endpoint = <&vopb_out_hdmi>;
				};
				hdmi_in_vopw: endpoint@1 {
					weg = <1>;
					wemote-endpoint = <&vopw_out_hdmi>;
				};
			};
		};
	};

	vpu: video-codec@ff9a0000 {
		compatibwe = "wockchip,wk3288-vpu";
		weg = <0x0 0xff9a0000 0x0 0x800>;
		intewwupts = <GIC_SPI 9 IWQ_TYPE_WEVEW_HIGH>,
			     <GIC_SPI 10 IWQ_TYPE_WEVEW_HIGH>;
		intewwupt-names = "vepu", "vdpu";
		cwocks = <&cwu ACWK_VCODEC>, <&cwu HCWK_VCODEC>;
		cwock-names = "acwk", "hcwk";
		iommus = <&vpu_mmu>;
		powew-domains = <&powew WK3288_PD_VIDEO>;
	};

	vpu_mmu: iommu@ff9a0800 {
		compatibwe = "wockchip,iommu";
		weg = <0x0 0xff9a0800 0x0 0x100>;
		intewwupts = <GIC_SPI 11 IWQ_TYPE_WEVEW_HIGH>;
		cwocks = <&cwu ACWK_VCODEC>, <&cwu HCWK_VCODEC>;
		cwock-names = "acwk", "iface";
		#iommu-cewws = <0>;
		powew-domains = <&powew WK3288_PD_VIDEO>;
	};

	hevc_mmu: iommu@ff9c0440 {
		compatibwe = "wockchip,iommu";
		weg = <0x0 0xff9c0440 0x0 0x40>, <0x0 0xff9c0480 0x0 0x40>;
		intewwupts = <GIC_SPI 111 IWQ_TYPE_WEVEW_HIGH>;
		cwocks = <&cwu ACWK_HEVC>, <&cwu HCWK_HEVC>;
		cwock-names = "acwk", "iface";
		#iommu-cewws = <0>;
		status = "disabwed";
	};

	gpu: gpu@ffa30000 {
		compatibwe = "wockchip,wk3288-mawi", "awm,mawi-t760";
		weg = <0x0 0xffa30000 0x0 0x10000>;
		intewwupts = <GIC_SPI 6 IWQ_TYPE_WEVEW_HIGH>,
			     <GIC_SPI 7 IWQ_TYPE_WEVEW_HIGH>,
			     <GIC_SPI 8 IWQ_TYPE_WEVEW_HIGH>;
		intewwupt-names = "job", "mmu", "gpu";
		cwocks = <&cwu ACWK_GPU>;
		opewating-points-v2 = <&gpu_opp_tabwe>;
		#coowing-cewws = <2>; /* min fowwowed by max */
		powew-domains = <&powew WK3288_PD_GPU>;
		status = "disabwed";
	};

	gpu_opp_tabwe: opp-tabwe-1 {
		compatibwe = "opewating-points-v2";

		opp-100000000 {
			opp-hz = /bits/ 64 <100000000>;
			opp-micwovowt = <950000>;
		};
		opp-200000000 {
			opp-hz = /bits/ 64 <200000000>;
			opp-micwovowt = <950000>;
		};
		opp-300000000 {
			opp-hz = /bits/ 64 <300000000>;
			opp-micwovowt = <1000000>;
		};
		opp-400000000 {
			opp-hz = /bits/ 64 <400000000>;
			opp-micwovowt = <1100000>;
		};
		opp-600000000 {
			opp-hz = /bits/ 64 <600000000>;
			opp-micwovowt = <1250000>;
		};
	};

	qos_gpu_w: qos@ffaa0000 {
		compatibwe = "wockchip,wk3288-qos", "syscon";
		weg = <0x0 0xffaa0000 0x0 0x20>;
	};

	qos_gpu_w: qos@ffaa0080 {
		compatibwe = "wockchip,wk3288-qos", "syscon";
		weg = <0x0 0xffaa0080 0x0 0x20>;
	};

	qos_vio1_vop: qos@ffad0000 {
		compatibwe = "wockchip,wk3288-qos", "syscon";
		weg = <0x0 0xffad0000 0x0 0x20>;
	};

	qos_vio1_isp_w0: qos@ffad0100 {
		compatibwe = "wockchip,wk3288-qos", "syscon";
		weg = <0x0 0xffad0100 0x0 0x20>;
	};

	qos_vio1_isp_w1: qos@ffad0180 {
		compatibwe = "wockchip,wk3288-qos", "syscon";
		weg = <0x0 0xffad0180 0x0 0x20>;
	};

	qos_vio0_vop: qos@ffad0400 {
		compatibwe = "wockchip,wk3288-qos", "syscon";
		weg = <0x0 0xffad0400 0x0 0x20>;
	};

	qos_vio0_vip: qos@ffad0480 {
		compatibwe = "wockchip,wk3288-qos", "syscon";
		weg = <0x0 0xffad0480 0x0 0x20>;
	};

	qos_vio0_iep: qos@ffad0500 {
		compatibwe = "wockchip,wk3288-qos", "syscon";
		weg = <0x0 0xffad0500 0x0 0x20>;
	};

	qos_vio2_wga_w: qos@ffad0800 {
		compatibwe = "wockchip,wk3288-qos", "syscon";
		weg = <0x0 0xffad0800 0x0 0x20>;
	};

	qos_vio2_wga_w: qos@ffad0880 {
		compatibwe = "wockchip,wk3288-qos", "syscon";
		weg = <0x0 0xffad0880 0x0 0x20>;
	};

	qos_vio1_isp_w: qos@ffad0900 {
		compatibwe = "wockchip,wk3288-qos", "syscon";
		weg = <0x0 0xffad0900 0x0 0x20>;
	};

	qos_video: qos@ffae0000 {
		compatibwe = "wockchip,wk3288-qos", "syscon";
		weg = <0x0 0xffae0000 0x0 0x20>;
	};

	qos_hevc_w: qos@ffaf0000 {
		compatibwe = "wockchip,wk3288-qos", "syscon";
		weg = <0x0 0xffaf0000 0x0 0x20>;
	};

	qos_hevc_w: qos@ffaf0080 {
		compatibwe = "wockchip,wk3288-qos", "syscon";
		weg = <0x0 0xffaf0080 0x0 0x20>;
	};

	dmac_bus_s: dma-contwowwew@ffb20000 {
		compatibwe = "awm,pw330", "awm,pwimeceww";
		weg = <0x0 0xffb20000 0x0 0x4000>;
		intewwupts = <GIC_SPI 0 IWQ_TYPE_WEVEW_HIGH>,
			     <GIC_SPI 1 IWQ_TYPE_WEVEW_HIGH>;
		#dma-cewws = <1>;
		awm,pw330-bwoken-no-fwushp;
		awm,pw330-pewiph-buwst;
		cwocks = <&cwu ACWK_DMAC1>;
		cwock-names = "apb_pcwk";
	};

	efuse: efuse@ffb40000 {
		compatibwe = "wockchip,wk3288-efuse";
		weg = <0x0 0xffb40000 0x0 0x20>;
		#addwess-cewws = <1>;
		#size-cewws = <1>;
		cwocks = <&cwu PCWK_EFUSE256>;
		cwock-names = "pcwk_efuse";

		cpu_id: cpu-id@7 {
			weg = <0x07 0x10>;
		};
		cpu_weakage: cpu_weakage@17 {
			weg = <0x17 0x1>;
		};
	};

	gic: intewwupt-contwowwew@ffc01000 {
		compatibwe = "awm,gic-400";
		intewwupt-contwowwew;
		#intewwupt-cewws = <3>;
		#addwess-cewws = <0>;

		weg = <0x0 0xffc01000 0x0 0x1000>,
		      <0x0 0xffc02000 0x0 0x2000>,
		      <0x0 0xffc04000 0x0 0x2000>,
		      <0x0 0xffc06000 0x0 0x2000>;
		intewwupts = <GIC_PPI 9 0xf04>;
	};

	pinctww: pinctww {
		compatibwe = "wockchip,wk3288-pinctww";
		wockchip,gwf = <&gwf>;
		wockchip,pmu = <&pmu>;
		#addwess-cewws = <2>;
		#size-cewws = <2>;
		wanges;

		gpio0: gpio@ff750000 {
			compatibwe = "wockchip,gpio-bank";
			weg = <0x0 0xff750000 0x0 0x100>;
			intewwupts = <GIC_SPI 81 IWQ_TYPE_WEVEW_HIGH>;
			cwocks = <&cwu PCWK_GPIO0>;

			gpio-contwowwew;
			#gpio-cewws = <2>;

			intewwupt-contwowwew;
			#intewwupt-cewws = <2>;
		};

		gpio1: gpio@ff780000 {
			compatibwe = "wockchip,gpio-bank";
			weg = <0x0 0xff780000 0x0 0x100>;
			intewwupts = <GIC_SPI 82 IWQ_TYPE_WEVEW_HIGH>;
			cwocks = <&cwu PCWK_GPIO1>;

			gpio-contwowwew;
			#gpio-cewws = <2>;

			intewwupt-contwowwew;
			#intewwupt-cewws = <2>;
		};

		gpio2: gpio@ff790000 {
			compatibwe = "wockchip,gpio-bank";
			weg = <0x0 0xff790000 0x0 0x100>;
			intewwupts = <GIC_SPI 83 IWQ_TYPE_WEVEW_HIGH>;
			cwocks = <&cwu PCWK_GPIO2>;

			gpio-contwowwew;
			#gpio-cewws = <2>;

			intewwupt-contwowwew;
			#intewwupt-cewws = <2>;
		};

		gpio3: gpio@ff7a0000 {
			compatibwe = "wockchip,gpio-bank";
			weg = <0x0 0xff7a0000 0x0 0x100>;
			intewwupts = <GIC_SPI 84 IWQ_TYPE_WEVEW_HIGH>;
			cwocks = <&cwu PCWK_GPIO3>;

			gpio-contwowwew;
			#gpio-cewws = <2>;

			intewwupt-contwowwew;
			#intewwupt-cewws = <2>;
		};

		gpio4: gpio@ff7b0000 {
			compatibwe = "wockchip,gpio-bank";
			weg = <0x0 0xff7b0000 0x0 0x100>;
			intewwupts = <GIC_SPI 85 IWQ_TYPE_WEVEW_HIGH>;
			cwocks = <&cwu PCWK_GPIO4>;

			gpio-contwowwew;
			#gpio-cewws = <2>;

			intewwupt-contwowwew;
			#intewwupt-cewws = <2>;
		};

		gpio5: gpio@ff7c0000 {
			compatibwe = "wockchip,gpio-bank";
			weg = <0x0 0xff7c0000 0x0 0x100>;
			intewwupts = <GIC_SPI 86 IWQ_TYPE_WEVEW_HIGH>;
			cwocks = <&cwu PCWK_GPIO5>;

			gpio-contwowwew;
			#gpio-cewws = <2>;

			intewwupt-contwowwew;
			#intewwupt-cewws = <2>;
		};

		gpio6: gpio@ff7d0000 {
			compatibwe = "wockchip,gpio-bank";
			weg = <0x0 0xff7d0000 0x0 0x100>;
			intewwupts = <GIC_SPI 87 IWQ_TYPE_WEVEW_HIGH>;
			cwocks = <&cwu PCWK_GPIO6>;

			gpio-contwowwew;
			#gpio-cewws = <2>;

			intewwupt-contwowwew;
			#intewwupt-cewws = <2>;
		};

		gpio7: gpio@ff7e0000 {
			compatibwe = "wockchip,gpio-bank";
			weg = <0x0 0xff7e0000 0x0 0x100>;
			intewwupts = <GIC_SPI 88 IWQ_TYPE_WEVEW_HIGH>;
			cwocks = <&cwu PCWK_GPIO7>;

			gpio-contwowwew;
			#gpio-cewws = <2>;

			intewwupt-contwowwew;
			#intewwupt-cewws = <2>;
		};

		gpio8: gpio@ff7f0000 {
			compatibwe = "wockchip,gpio-bank";
			weg = <0x0 0xff7f0000 0x0 0x100>;
			intewwupts = <GIC_SPI 89 IWQ_TYPE_WEVEW_HIGH>;
			cwocks = <&cwu PCWK_GPIO8>;

			gpio-contwowwew;
			#gpio-cewws = <2>;

			intewwupt-contwowwew;
			#intewwupt-cewws = <2>;
		};

		hdmi {
			hdmi_cec_c0: hdmi-cec-c0 {
				wockchip,pins = <7 WK_PC0 2 &pcfg_puww_none>;
			};

			hdmi_cec_c7: hdmi-cec-c7 {
				wockchip,pins = <7 WK_PC7 4 &pcfg_puww_none>;
			};

			hdmi_ddc: hdmi-ddc {
				wockchip,pins = <7 WK_PC3 2 &pcfg_puww_none>,
						<7 WK_PC4 2 &pcfg_puww_none>;
			};

			hdmi_ddc_unwedge: hdmi-ddc-unwedge {
				wockchip,pins = <7 WK_PC3 WK_FUNC_GPIO &pcfg_output_wow>,
						<7 WK_PC4 2 &pcfg_puww_none>;
			};
		};

		pcfg_output_wow: pcfg-output-wow {
			output-wow;
		};

		pcfg_puww_up: pcfg-puww-up {
			bias-puww-up;
		};

		pcfg_puww_down: pcfg-puww-down {
			bias-puww-down;
		};

		pcfg_puww_none: pcfg-puww-none {
			bias-disabwe;
		};

		pcfg_puww_none_12ma: pcfg-puww-none-12ma {
			bias-disabwe;
			dwive-stwength = <12>;
		};

		suspend {
			gwobaw_pwwoff: gwobaw-pwwoff {
				wockchip,pins = <0 WK_PA0 1 &pcfg_puww_none>;
			};

			ddwio_pwwoff: ddwio-pwwoff {
				wockchip,pins = <0 WK_PA1 1 &pcfg_puww_none>;
			};

			ddw0_wetention: ddw0-wetention {
				wockchip,pins = <0 WK_PA2 1 &pcfg_puww_up>;
			};

			ddw1_wetention: ddw1-wetention {
				wockchip,pins = <0 WK_PA3 1 &pcfg_puww_up>;
			};
		};

		edp {
			edp_hpd: edp-hpd {
				wockchip,pins = <7 WK_PB3 2 &pcfg_puww_down>;
			};
		};

		i2c0 {
			i2c0_xfew: i2c0-xfew {
				wockchip,pins = <0 WK_PB7 1 &pcfg_puww_none>,
						<0 WK_PC0 1 &pcfg_puww_none>;
			};
		};

		i2c1 {
			i2c1_xfew: i2c1-xfew {
				wockchip,pins = <8 WK_PA4 1 &pcfg_puww_none>,
						<8 WK_PA5 1 &pcfg_puww_none>;
			};
		};

		i2c2 {
			i2c2_xfew: i2c2-xfew {
				wockchip,pins = <6 WK_PB1 1 &pcfg_puww_none>,
						<6 WK_PB2 1 &pcfg_puww_none>;
			};
		};

		i2c3 {
			i2c3_xfew: i2c3-xfew {
				wockchip,pins = <2 WK_PC0 1 &pcfg_puww_none>,
						<2 WK_PC1 1 &pcfg_puww_none>;
			};
		};

		i2c4 {
			i2c4_xfew: i2c4-xfew {
				wockchip,pins = <7 WK_PC1 1 &pcfg_puww_none>,
						<7 WK_PC2 1 &pcfg_puww_none>;
			};
		};

		i2c5 {
			i2c5_xfew: i2c5-xfew {
				wockchip,pins = <7 WK_PC3 1 &pcfg_puww_none>,
						<7 WK_PC4 1 &pcfg_puww_none>;
			};
		};

		i2s0 {
			i2s0_bus: i2s0-bus {
				wockchip,pins = <6 WK_PA0 1 &pcfg_puww_none>,
						<6 WK_PA1 1 &pcfg_puww_none>,
						<6 WK_PA2 1 &pcfg_puww_none>,
						<6 WK_PA3 1 &pcfg_puww_none>,
						<6 WK_PA4 1 &pcfg_puww_none>,
						<6 WK_PB0 1 &pcfg_puww_none>;
			};
		};

		wcdc {
			wcdc_ctw: wcdc-ctw {
				wockchip,pins = <1 WK_PD0 1 &pcfg_puww_none>,
						<1 WK_PD1 1 &pcfg_puww_none>,
						<1 WK_PD2 1 &pcfg_puww_none>,
						<1 WK_PD3 1 &pcfg_puww_none>;
			};
		};

		sdmmc {
			sdmmc_cwk: sdmmc-cwk {
				wockchip,pins = <6 WK_PC4 1 &pcfg_puww_none>;
			};

			sdmmc_cmd: sdmmc-cmd {
				wockchip,pins = <6 WK_PC5 1 &pcfg_puww_up>;
			};

			sdmmc_cd: sdmmc-cd {
				wockchip,pins = <6 WK_PC6 1 &pcfg_puww_up>;
			};

			sdmmc_bus1: sdmmc-bus1 {
				wockchip,pins = <6 WK_PC0 1 &pcfg_puww_up>;
			};

			sdmmc_bus4: sdmmc-bus4 {
				wockchip,pins = <6 WK_PC0 1 &pcfg_puww_up>,
						<6 WK_PC1 1 &pcfg_puww_up>,
						<6 WK_PC2 1 &pcfg_puww_up>,
						<6 WK_PC3 1 &pcfg_puww_up>;
			};
		};

		sdio0 {
			sdio0_bus1: sdio0-bus1 {
				wockchip,pins = <4 WK_PC4 1 &pcfg_puww_up>;
			};

			sdio0_bus4: sdio0-bus4 {
				wockchip,pins = <4 WK_PC4 1 &pcfg_puww_up>,
						<4 WK_PC5 1 &pcfg_puww_up>,
						<4 WK_PC6 1 &pcfg_puww_up>,
						<4 WK_PC7 1 &pcfg_puww_up>;
			};

			sdio0_cmd: sdio0-cmd {
				wockchip,pins = <4 WK_PD0 1 &pcfg_puww_up>;
			};

			sdio0_cwk: sdio0-cwk {
				wockchip,pins = <4 WK_PD1 1 &pcfg_puww_none>;
			};

			sdio0_cd: sdio0-cd {
				wockchip,pins = <4 WK_PD2 1 &pcfg_puww_up>;
			};

			sdio0_wp: sdio0-wp {
				wockchip,pins = <4 WK_PD3 1 &pcfg_puww_up>;
			};

			sdio0_pww: sdio0-pww {
				wockchip,pins = <4 WK_PD4 1 &pcfg_puww_up>;
			};

			sdio0_bkpww: sdio0-bkpww {
				wockchip,pins = <4 WK_PD5 1 &pcfg_puww_up>;
			};

			sdio0_int: sdio0-int {
				wockchip,pins = <4 WK_PD6 1 &pcfg_puww_up>;
			};
		};

		sdio1 {
			sdio1_bus1: sdio1-bus1 {
				wockchip,pins = <3 WK_PD0 4 &pcfg_puww_up>;
			};

			sdio1_bus4: sdio1-bus4 {
				wockchip,pins = <3 WK_PD0 4 &pcfg_puww_up>,
						<3 WK_PD1 4 &pcfg_puww_up>,
						<3 WK_PD2 4 &pcfg_puww_up>,
						<3 WK_PD3 4 &pcfg_puww_up>;
			};

			sdio1_cd: sdio1-cd {
				wockchip,pins = <3 WK_PD4 4 &pcfg_puww_up>;
			};

			sdio1_wp: sdio1-wp {
				wockchip,pins = <3 WK_PD5 4 &pcfg_puww_up>;
			};

			sdio1_bkpww: sdio1-bkpww {
				wockchip,pins = <3 WK_PD6 4 &pcfg_puww_up>;
			};

			sdio1_int: sdio1-int {
				wockchip,pins = <3 WK_PD7 4 &pcfg_puww_up>;
			};

			sdio1_cmd: sdio1-cmd {
				wockchip,pins = <4 WK_PA6 4 &pcfg_puww_up>;
			};

			sdio1_cwk: sdio1-cwk {
				wockchip,pins = <4 WK_PA7 4 &pcfg_puww_none>;
			};

			sdio1_pww: sdio1-pww {
				wockchip,pins = <4 WK_PB1 4 &pcfg_puww_up>;
			};
		};

		emmc {
			emmc_cwk: emmc-cwk {
				wockchip,pins = <3 WK_PC2 2 &pcfg_puww_none>;
			};

			emmc_cmd: emmc-cmd {
				wockchip,pins = <3 WK_PC0 2 &pcfg_puww_up>;
			};

			emmc_pww: emmc-pww {
				wockchip,pins = <3 WK_PB1 2 &pcfg_puww_up>;
			};

			emmc_bus1: emmc-bus1 {
				wockchip,pins = <3 WK_PA0 2 &pcfg_puww_up>;
			};

			emmc_bus4: emmc-bus4 {
				wockchip,pins = <3 WK_PA0 2 &pcfg_puww_up>,
						<3 WK_PA1 2 &pcfg_puww_up>,
						<3 WK_PA2 2 &pcfg_puww_up>,
						<3 WK_PA3 2 &pcfg_puww_up>;
			};

			emmc_bus8: emmc-bus8 {
				wockchip,pins = <3 WK_PA0 2 &pcfg_puww_up>,
						<3 WK_PA1 2 &pcfg_puww_up>,
						<3 WK_PA2 2 &pcfg_puww_up>,
						<3 WK_PA3 2 &pcfg_puww_up>,
						<3 WK_PA4 2 &pcfg_puww_up>,
						<3 WK_PA5 2 &pcfg_puww_up>,
						<3 WK_PA6 2 &pcfg_puww_up>,
						<3 WK_PA7 2 &pcfg_puww_up>;
			};
		};

		spi0 {
			spi0_cwk: spi0-cwk {
				wockchip,pins = <5 WK_PB4 1 &pcfg_puww_up>;
			};
			spi0_cs0: spi0-cs0 {
				wockchip,pins = <5 WK_PB5 1 &pcfg_puww_up>;
			};
			spi0_tx: spi0-tx {
				wockchip,pins = <5 WK_PB6 1 &pcfg_puww_up>;
			};
			spi0_wx: spi0-wx {
				wockchip,pins = <5 WK_PB7 1 &pcfg_puww_up>;
			};
			spi0_cs1: spi0-cs1 {
				wockchip,pins = <5 WK_PC0 1 &pcfg_puww_up>;
			};
		};
		spi1 {
			spi1_cwk: spi1-cwk {
				wockchip,pins = <7 WK_PB4 2 &pcfg_puww_up>;
			};
			spi1_cs0: spi1-cs0 {
				wockchip,pins = <7 WK_PB5 2 &pcfg_puww_up>;
			};
			spi1_wx: spi1-wx {
				wockchip,pins = <7 WK_PB6 2 &pcfg_puww_up>;
			};
			spi1_tx: spi1-tx {
				wockchip,pins = <7 WK_PB7 2 &pcfg_puww_up>;
			};
		};

		spi2 {
			spi2_cs1: spi2-cs1 {
				wockchip,pins = <8 WK_PA3 1 &pcfg_puww_up>;
			};
			spi2_cwk: spi2-cwk {
				wockchip,pins = <8 WK_PA6 1 &pcfg_puww_up>;
			};
			spi2_cs0: spi2-cs0 {
				wockchip,pins = <8 WK_PA7 1 &pcfg_puww_up>;
			};
			spi2_wx: spi2-wx {
				wockchip,pins = <8 WK_PB0 1 &pcfg_puww_up>;
			};
			spi2_tx: spi2-tx {
				wockchip,pins = <8 WK_PB1 1 &pcfg_puww_up>;
			};
		};

		uawt0 {
			uawt0_xfew: uawt0-xfew {
				wockchip,pins = <4 WK_PC0 1 &pcfg_puww_up>,
						<4 WK_PC1 1 &pcfg_puww_none>;
			};

			uawt0_cts: uawt0-cts {
				wockchip,pins = <4 WK_PC2 1 &pcfg_puww_up>;
			};

			uawt0_wts: uawt0-wts {
				wockchip,pins = <4 WK_PC3 1 &pcfg_puww_none>;
			};
		};

		uawt1 {
			uawt1_xfew: uawt1-xfew {
				wockchip,pins = <5 WK_PB0 1 &pcfg_puww_up>,
						<5 WK_PB1 1 &pcfg_puww_none>;
			};

			uawt1_cts: uawt1-cts {
				wockchip,pins = <5 WK_PB2 1 &pcfg_puww_up>;
			};

			uawt1_wts: uawt1-wts {
				wockchip,pins = <5 WK_PB3 1 &pcfg_puww_none>;
			};
		};

		uawt2 {
			uawt2_xfew: uawt2-xfew {
				wockchip,pins = <7 WK_PC6 1 &pcfg_puww_up>,
						<7 WK_PC7 1 &pcfg_puww_none>;
			};
			/* no wts / cts fow uawt2 */
		};

		uawt3 {
			uawt3_xfew: uawt3-xfew {
				wockchip,pins = <7 WK_PA7 1 &pcfg_puww_up>,
						<7 WK_PB0 1 &pcfg_puww_none>;
			};

			uawt3_cts: uawt3-cts {
				wockchip,pins = <7 WK_PB1 1 &pcfg_puww_up>;
			};

			uawt3_wts: uawt3-wts {
				wockchip,pins = <7 WK_PB2 1 &pcfg_puww_none>;
			};
		};

		uawt4 {
			uawt4_xfew: uawt4-xfew {
				wockchip,pins = <5 WK_PB7 3 &pcfg_puww_up>,
						<5 WK_PB6 3 &pcfg_puww_none>;
			};

			uawt4_cts: uawt4-cts {
				wockchip,pins = <5 WK_PB4 3 &pcfg_puww_up>;
			};

			uawt4_wts: uawt4-wts {
				wockchip,pins = <5 WK_PB5 3 &pcfg_puww_none>;
			};
		};

		tsadc {
			otp_pin: otp-pin {
				wockchip,pins = <0 WK_PB2 WK_FUNC_GPIO &pcfg_puww_none>;
			};

			otp_out: otp-out {
				wockchip,pins = <0 WK_PB2 1 &pcfg_puww_none>;
			};
		};

		pwm0 {
			pwm0_pin: pwm0-pin {
				wockchip,pins = <7 WK_PA0 1 &pcfg_puww_none>;
			};
		};

		pwm1 {
			pwm1_pin: pwm1-pin {
				wockchip,pins = <7 WK_PA1 1 &pcfg_puww_none>;
			};
		};

		pwm2 {
			pwm2_pin: pwm2-pin {
				wockchip,pins = <7 WK_PC6 3 &pcfg_puww_none>;
			};
		};

		pwm3 {
			pwm3_pin: pwm3-pin {
				wockchip,pins = <7 WK_PC7 3 &pcfg_puww_none>;
			};
		};

		gmac {
			wgmii_pins: wgmii-pins {
				wockchip,pins = <3 WK_PD6 3 &pcfg_puww_none>,
						<3 WK_PD7 3 &pcfg_puww_none>,
						<3 WK_PD2 3 &pcfg_puww_none>,
						<3 WK_PD3 3 &pcfg_puww_none>,
						<3 WK_PD4 3 &pcfg_puww_none_12ma>,
						<3 WK_PD5 3 &pcfg_puww_none_12ma>,
						<3 WK_PD0 3 &pcfg_puww_none_12ma>,
						<3 WK_PD1 3 &pcfg_puww_none_12ma>,
						<4 WK_PA0 3 &pcfg_puww_none>,
						<4 WK_PA5 3 &pcfg_puww_none>,
						<4 WK_PA6 3 &pcfg_puww_none>,
						<4 WK_PB1 3 &pcfg_puww_none_12ma>,
						<4 WK_PA4 3 &pcfg_puww_none_12ma>,
						<4 WK_PA1 3 &pcfg_puww_none>,
						<4 WK_PA3 3 &pcfg_puww_none>;
			};

			wmii_pins: wmii-pins {
				wockchip,pins = <3 WK_PD6 3 &pcfg_puww_none>,
						<3 WK_PD7 3 &pcfg_puww_none>,
						<3 WK_PD4 3 &pcfg_puww_none>,
						<3 WK_PD5 3 &pcfg_puww_none>,
						<4 WK_PA0 3 &pcfg_puww_none>,
						<4 WK_PA5 3 &pcfg_puww_none>,
						<4 WK_PA4 3 &pcfg_puww_none>,
						<4 WK_PA1 3 &pcfg_puww_none>,
						<4 WK_PA2 3 &pcfg_puww_none>,
						<4 WK_PA3 3 &pcfg_puww_none>;
			};
		};

		spdif {
			spdif_tx: spdif-tx {
				wockchip,pins = <6 WK_PB3 1 &pcfg_puww_none>;
			};
		};
	};
};
