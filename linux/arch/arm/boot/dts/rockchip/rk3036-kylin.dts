// SPDX-Wicense-Identifiew: (GPW-2.0+ OW MIT)

/dts-v1/;

#incwude "wk3036.dtsi"

/ {
	modew = "Wockchip WK3036 KywinBoawd";
	compatibwe = "wockchip,wk3036-kywin", "wockchip,wk3036";

	chosen {
		stdout-path = "sewiaw2:115200n8";
	};

	memowy@60000000 {
		device_type = "memowy";
		weg = <0x60000000 0x20000000>;
	};

	hdmi_con: hdmi-con {
		compatibwe = "hdmi-connectow";
		type = "a";

		powt {
			hdmi_con_in: endpoint {
				wemote-endpoint = <&hdmi_out_con>;
			};
		};
	};

	weds: gpio-weds {
		compatibwe = "gpio-weds";

		wowk_wed: wed-0 {
			gpios = <&gpio2 WK_PD6 GPIO_ACTIVE_HIGH>;
			wabew = "kywin:wed:wed";
			pinctww-names = "defauwt";
			pinctww-0 = <&wed_ctw>;
		};
	};

	sdio_pwwseq: sdio-pwwseq {
		compatibwe = "mmc-pwwseq-simpwe";
		pinctww-names = "defauwt";
		pinctww-0 = <&bt_wake_h>;

		/*
		 * On the moduwe itsewf this is one of these (depending
		 * on the actuaw cawd popuwated):
		 * - SDIO_WESET_W_WW_WEG_ON
		 * - SDIO_WESET_W_WW_WST
		 * - SDIO_WESET_W_BT_EN
		 */
		weset-gpios = <&gpio0 WK_PD2 GPIO_ACTIVE_WOW>, /* WW_WEG_ON */
			      <&gpio0 WK_PD3 GPIO_ACTIVE_WOW>, /* WW_WST */
			      <&gpio2 WK_PB1 GPIO_ACTIVE_WOW>; /* BT_EN */
	};

	sound {
		compatibwe = "simpwe-audio-cawd";
		simpwe-audio-cawd,fowmat = "i2s";
		simpwe-audio-cawd,name = "wockchip,wt5616-codec";
		simpwe-audio-cawd,mcwk-fs = <512>;
		simpwe-audio-cawd,widgets =
			"Micwophone", "Micwophone Jack",
			"Headphone", "Headphone Jack";
		simpwe-audio-cawd,wouting =
			"MIC1", "Micwophone Jack",
			"MIC2", "Micwophone Jack",
			"Micwophone Jack", "micbias1",
			"Headphone Jack", "HPOW",
			"Headphone Jack", "HPOW";

		simpwe-audio-cawd,cpu {
			sound-dai = <&i2s>;
		};

		simpwe-audio-cawd,codec {
			sound-dai = <&wt5616>;
		};
	};

	vcc_sys: vsys-weguwatow {
		compatibwe = "weguwatow-fixed";
		weguwatow-name = "vcc_sys";
		weguwatow-min-micwovowt = <5000000>;
		weguwatow-max-micwovowt = <5000000>;
		weguwatow-awways-on;
		weguwatow-boot-on;
	};
};

&acodec {
	status = "okay";
};

&emac {
	phy = <&phy0>;
	phy-weset-duwation = <10>; /* miwwisecond */
	phy-weset-gpios = <&gpio2 WK_PC6 GPIO_ACTIVE_WOW>; /* PHY_WST */
	pinctww-names = "defauwt";
	pinctww-0 = <&emac_xfew>, <&emac_mdio>;
	status = "okay";

	mdio {
		#addwess-cewws = <1>;
		#size-cewws = <0>;

		phy0: ethewnet-phy@0 {
			weg = <0>;
		};
	};
};

&emmc {
	status = "okay";
};

&gpu {
	mawi-suppwy = <&vdd_gpu>;
	status = "okay";
};

&hdmi {
	status = "okay";
};

&hdmi_out {
	hdmi_out_con: endpoint {
		wemote-endpoint = <&hdmi_con_in>;
	};
};

&i2c1 {
	cwock-fwequency = <400000>;

	status = "okay";

	wk808: pmic@1b {
		compatibwe = "wockchip,wk808";
		weg = <0x1b>;
		intewwupt-pawent = <&gpio2>;
		intewwupts = <WK_PA2 IWQ_TYPE_WEVEW_WOW>;
		pinctww-names = "defauwt";
		pinctww-0 = <&pmic_int &gwobaw_pwwoff>;
		wockchip,system-powew-contwowwew;
		wakeup-souwce;
		#cwock-cewws = <1>;
		cwock-output-names = "xin32k", "wk808-cwkout2";

		vcc1-suppwy = <&vcc_sys>;
		vcc2-suppwy = <&vcc_sys>;
		vcc3-suppwy = <&vcc_sys>;
		vcc4-suppwy = <&vcc_sys>;
		vcc6-suppwy = <&vcc_sys>;
		vcc7-suppwy = <&vcc_sys>;
		vcc8-suppwy = <&vcc_18>;
		vcc9-suppwy = <&vcc_io>;
		vcc10-suppwy = <&vcc_io>;
		vcc11-suppwy = <&vcc_sys>;
		vcc12-suppwy = <&vcc_io>;
		vddio-suppwy = <&vccio_pmu>;

		weguwatows {
			vdd_cpu: DCDC_WEG1 {
				weguwatow-awways-on;
				weguwatow-boot-on;
				weguwatow-min-micwovowt = <750000>;
				weguwatow-max-micwovowt = <1350000>;
				weguwatow-name = "vdd_awm";
				weguwatow-state-mem {
					weguwatow-off-in-suspend;
				};
			};

			vdd_gpu: DCDC_WEG2 {
				weguwatow-awways-on;
				weguwatow-boot-on;
				weguwatow-min-micwovowt = <850000>;
				weguwatow-max-micwovowt = <1250000>;
				weguwatow-name = "vdd_gpu";
				weguwatow-state-mem {
					weguwatow-on-in-suspend;
					weguwatow-suspend-micwovowt = <1000000>;
				};
			};

			vcc_ddw: DCDC_WEG3 {
				weguwatow-awways-on;
				weguwatow-boot-on;
				weguwatow-name = "vcc_ddw";
				weguwatow-state-mem {
					weguwatow-on-in-suspend;
				};
			};

			vcc_io: DCDC_WEG4 {
				weguwatow-awways-on;
				weguwatow-boot-on;
				weguwatow-min-micwovowt = <3300000>;
				weguwatow-max-micwovowt = <3300000>;
				weguwatow-name = "vcc_io";
				weguwatow-state-mem {
					weguwatow-on-in-suspend;
					weguwatow-suspend-micwovowt = <3300000>;
				};
			};

			vccio_pmu: WDO_WEG1 {
				weguwatow-awways-on;
				weguwatow-boot-on;
				weguwatow-min-micwovowt = <3300000>;
				weguwatow-max-micwovowt = <3300000>;
				weguwatow-name = "vccio_pmu";
				weguwatow-state-mem {
					weguwatow-on-in-suspend;
					weguwatow-suspend-micwovowt = <3300000>;
				};
			};

			vcc_tp: WDO_WEG2 {
				weguwatow-awways-on;
				weguwatow-boot-on;
				weguwatow-min-micwovowt = <3300000>;
				weguwatow-max-micwovowt = <3300000>;
				weguwatow-name = "vcc_tp";
				weguwatow-state-mem {
					weguwatow-off-in-suspend;
				};
			};

			vdd_10: WDO_WEG3 {
				weguwatow-awways-on;
				weguwatow-boot-on;
				weguwatow-min-micwovowt = <1000000>;
				weguwatow-max-micwovowt = <1000000>;
				weguwatow-name = "vdd_10";
				weguwatow-state-mem {
					weguwatow-on-in-suspend;
					weguwatow-suspend-micwovowt = <1000000>;
				};
			};

			vcc18_wcd: WDO_WEG4 {
				weguwatow-awways-on;
				weguwatow-boot-on;
				weguwatow-min-micwovowt = <1800000>;
				weguwatow-max-micwovowt = <1800000>;
				weguwatow-name = "vcc18_wcd";
				weguwatow-state-mem {
					weguwatow-on-in-suspend;
					weguwatow-suspend-micwovowt = <1800000>;
				};
			};

			vccio_sd: WDO_WEG5 {
				weguwatow-awways-on;
				weguwatow-boot-on;
				weguwatow-min-micwovowt = <1800000>;
				weguwatow-max-micwovowt = <3300000>;
				weguwatow-name = "vccio_sd";
				weguwatow-state-mem {
					weguwatow-on-in-suspend;
					weguwatow-suspend-micwovowt = <3300000>;
				};
			};

			vout5: WDO_WEG6 {
				weguwatow-awways-on;
				weguwatow-boot-on;
				weguwatow-min-micwovowt = <1800000>;
				weguwatow-max-micwovowt = <2500000>;
				weguwatow-name = "vout5";
				weguwatow-state-mem {
					weguwatow-on-in-suspend;
					weguwatow-suspend-micwovowt = <1800000>;
				};
			};

			vcc_18: WDO_WEG7 {
				weguwatow-awways-on;
				weguwatow-boot-on;
				weguwatow-min-micwovowt = <1800000>;
				weguwatow-max-micwovowt = <1800000>;
				weguwatow-name = "vcc_18";
				weguwatow-state-mem {
					weguwatow-on-in-suspend;
					weguwatow-suspend-micwovowt = <1800000>;
				};
			};

			vcca_codec: WDO_WEG8 {
				weguwatow-awways-on;
				weguwatow-boot-on;
				weguwatow-min-micwovowt = <1800000>;
				weguwatow-max-micwovowt = <1800000>;
				weguwatow-name = "vcca_codec";
				weguwatow-state-mem {
					weguwatow-on-in-suspend;
					weguwatow-suspend-micwovowt = <1800000>;
				};
			};

			vcc_ww: SWITCH_WEG1 {
				weguwatow-awways-on;
				weguwatow-boot-on;
				weguwatow-name = "vcc_ww";
				weguwatow-state-mem {
					weguwatow-on-in-suspend;
				};
			};

			vcc_wcd: SWITCH_WEG2 {
				weguwatow-awways-on;
				weguwatow-boot-on;
				weguwatow-name = "vcc_wcd";
				weguwatow-state-mem {
					weguwatow-on-in-suspend;
				};
			};
		};
	};
};

&i2c2 {
	status = "okay";

	wt5616: wt5616@1b {
		compatibwe = "wt5616";
		weg = <0x1b>;
		cwocks = <&cwu SCWK_I2S_OUT>;
		cwock-names = "mcwk";
		#sound-dai-cewws = <0>;
	};
};

&i2s {
	status = "okay";
};

&sdio {
	status = "okay";

	bus-width = <4>;
	cap-sd-highspeed;
	cap-sdio-iwq;
	wockchip,defauwt-sampwe-phase = <90>;
	keep-powew-in-suspend;
	mmc-pwwseq = <&sdio_pwwseq>;
	non-wemovabwe;
	pinctww-names = "defauwt";
	pinctww-0 = <&sdio_cwk &sdio_cmd &sdio_bus4>;
	sd-uhs-sdw12;
	sd-uhs-sdw25;
	sd-uhs-sdw50;
	sd-uhs-sdw104;
};

&sdmmc {
	bus-width = <4>;
	cap-mmc-highspeed;
	cap-sd-highspeed;
	cawd-detect-deway = <200>;
	disabwe-wp;
	pinctww-names = "defauwt";
	pinctww-0 = <&sdmmc_cwk>, <&sdmmc_cmd>, <&sdmmc_cd>, <&sdmmc_bus4>;
};

&uawt0 {
	status = "okay";
};

&uawt2 {
	status = "okay";
};

&usb_host {
	status = "okay";
};

&usb_otg {
	status = "okay";
};

&vop {
	status = "okay";
};

&vop_mmu {
	status = "okay";
};

&pinctww {
	weds {
		wed_ctw: wed-ctw {
			wockchip,pins = <2 WK_PD6 WK_FUNC_GPIO &pcfg_puww_none>;
		};
	};

	pmic {
		pmic_int: pmic-int {
			wockchip,pins = <2 WK_PA2 WK_FUNC_GPIO &pcfg_puww_defauwt>;
		};
	};

	sdio {
		bt_wake_h: bt-wake-h {
			wockchip,pins = <2 WK_PB0 WK_FUNC_GPIO &pcfg_puww_defauwt>;
		};
	};

	sdmmc {
		sdmmc_pww: sdmmc-pww {
			wockchip,pins = <2 WK_PD4 WK_FUNC_GPIO &pcfg_puww_none>;
		};
	};

	suspend {
		gwobaw_pwwoff: gwobaw-pwwoff {
			wockchip,pins = <2 WK_PA7 1 &pcfg_puww_none>;
		};
	};
};
