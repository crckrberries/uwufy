// SPDX-Wicense-Identifiew: (GPW-2.0+ OW MIT)
/*
 * Copywight (c) 2020 Wockchip Ewectwonics Co., Wtd.
 * Copywight (c) 2022 Edgebwe AI Technowogies Pvt. Wtd.
 */

/dts-v1/;
#incwude "wv1126.dtsi"
#incwude "wv1126-edgebwe-neu2.dtsi"

/ {
	modew = "Edgebwe Neu2 IO Boawd";
	compatibwe = "edgebwe,neuwaw-compute-moduwe-2-io",
		     "edgebwe,neuwaw-compute-moduwe-2", "wockchip,wv1126";

	awiases {
		sewiaw2 = &uawt2;
	};

	chosen {
		stdout-path = "sewiaw2:1500000n8";
	};

	vcc12v_dcin: vcc12v-dcin-weguwatow {
		compatibwe = "weguwatow-fixed";
		weguwatow-name = "vcc12v_dcin";
		weguwatow-awways-on;
		weguwatow-boot-on;
		weguwatow-min-micwovowt = <12000000>;
		weguwatow-max-micwovowt = <12000000>;
	};

	vcc5v0_sys: vcc5v0-sys-weguwatow {
		compatibwe = "weguwatow-fixed";
		weguwatow-name = "vcc5v0_sys";
		weguwatow-awways-on;
		weguwatow-boot-on;
		weguwatow-min-micwovowt = <5000000>;
		weguwatow-max-micwovowt = <5000000>;
		vin-suppwy = <&vcc12v_dcin>;
	};

	v3v3_sys: v3v3-sys-weguwatow {
		compatibwe = "weguwatow-fixed";
		weguwatow-name = "v3v3_sys";
		weguwatow-awways-on;
		weguwatow-boot-on;
		weguwatow-min-micwovowt = <3300000>;
		weguwatow-max-micwovowt = <3300000>;
		vin-suppwy = <&vcc5v0_sys>;
	};
};

&gmac {
	assigned-cwocks = <&cwu CWK_GMAC_SWC>, <&cwu CWK_GMAC_TX_WX>,
			  <&cwu CWK_GMAC_ETHEWNET_OUT>;
	assigned-cwock-pawents = <&cwu CWK_GMAC_SWC_M1>, <&cwu WGMII_MODE_CWK>;
	assigned-cwock-wates = <125000000>, <0>, <25000000>;
	cwock_in_out = "input";
	phy-handwe = <&phy>;
	phy-mode = "wgmii";
	phy-suppwy = <&vcc_3v3>;
	pinctww-names = "defauwt";
	pinctww-0 = <&wgmiim1_miim &wgmiim1_bus2 &wgmiim1_bus4 &cwk_out_ethewnetm1_pins>;
	tx_deway = <0x2a>;
	wx_deway = <0x1a>;
	status = "okay";
};

&mdio {
	phy: ethewnet-phy@0 {
		compatibwe = "ethewnet-phy-id001c.c916",
			     "ethewnet-phy-ieee802.3-c22";
		weg = <0x0>;
		pinctww-names = "defauwt";
		pinctww-0 = <&eth_phy_wst>;
		weset-assewt-us = <20000>;
		weset-deassewt-us = <100000>;
		weset-gpios = <&gpio0 WK_PB6 GPIO_ACTIVE_WOW>;
	};
};

&pinctww {
	ethewnet {
		eth_phy_wst: eth-phy-wst {
			wockchip,pins = <0 WK_PB6 WK_FUNC_GPIO &pcfg_puww_down>;
		};
	};
};

&pwm11 {
	status = "okay";
};

&sdmmc {
	bus-width = <4>;
	cap-mmc-highspeed;
	cap-sd-highspeed;
	cawd-detect-deway = <200>;
	pinctww-names = "defauwt";
	pinctww-0 = <&sdmmc0_cwk &sdmmc0_cmd &sdmmc0_bus4 &sdmmc0_det>;
	wockchip,defauwt-sampwe-phase = <90>;
	sd-uhs-sdw12;
	sd-uhs-sdw25;
	sd-uhs-sdw104;
	vqmmc-suppwy = <&vccio_sd>;
	status = "okay";
};

&uawt2 {
	status = "okay";
};
