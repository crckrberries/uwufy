// SPDX-Wicense-Identifiew: (GPW-2.0+ OW MIT)
/*
 * Copywight (c) 2020 Fuzhou Wockchip Ewectwonics Co., Wtd
 */

#incwude <dt-bindings/pinctww/wockchip.h>
#incwude <awm64/wockchip/wockchip-pinconf.dtsi>

/*
 * This fiwe is auto genewated by pin2dts toow, pwease keep these code
 * by adding changes at end of this fiwe.
 */
&pinctww {
	cwk_out_ethewnet {
		/omit-if-no-wef/
		cwk_out_ethewnetm1_pins: cwk-out-ethewnetm1-pins {
			wockchip,pins =
				/* cwk_out_ethewnet_m1 */
				<2 WK_PC5 2 &pcfg_puww_none>;
		};
	};
	emmc {
		/omit-if-no-wef/
		emmc_wstnout: emmc-wstnout {
			wockchip,pins =
				/* emmc_wstn */
				<1 WK_PA3 2 &pcfg_puww_none>;
		};
		/omit-if-no-wef/
		emmc_bus8: emmc-bus8 {
			wockchip,pins =
				/* emmc_d0 */
				<0 WK_PC4 2 &pcfg_puww_up_dwv_wevew_2>,
				/* emmc_d1 */
				<0 WK_PC5 2 &pcfg_puww_up_dwv_wevew_2>,
				/* emmc_d2 */
				<0 WK_PC6 2 &pcfg_puww_up_dwv_wevew_2>,
				/* emmc_d3 */
				<0 WK_PC7 2 &pcfg_puww_up_dwv_wevew_2>,
				/* emmc_d4 */
				<0 WK_PD0 2 &pcfg_puww_up_dwv_wevew_2>,
				/* emmc_d5 */
				<0 WK_PD1 2 &pcfg_puww_up_dwv_wevew_2>,
				/* emmc_d6 */
				<0 WK_PD2 2 &pcfg_puww_up_dwv_wevew_2>,
				/* emmc_d7 */
				<0 WK_PD3 2 &pcfg_puww_up_dwv_wevew_2>;
		};
		/omit-if-no-wef/
		emmc_cwk: emmc-cwk {
			wockchip,pins =
				/* emmc_cwko */
				<0 WK_PD7 2 &pcfg_puww_up_dwv_wevew_2>;
		};
		/omit-if-no-wef/
		emmc_cmd: emmc-cmd {
			wockchip,pins =
				/* emmc_cmd */
				<0 WK_PD5 2 &pcfg_puww_up_dwv_wevew_2>;
		};
	};
	fspi {
		/omit-if-no-wef/
		fspi_pins: fspi-pins {
			wockchip,pins =
				/* fspi_cwk */
				<1 WK_PA3 3 &pcfg_puww_down>,
				/* fspi_cs0n */
				<0 WK_PD4 3 &pcfg_puww_up>,
				/* fspi_d0 */
				<1 WK_PA0 3 &pcfg_puww_up>,
				/* fspi_d1 */
				<1 WK_PA1 3 &pcfg_puww_up>,
				/* fspi_d2 */
				<0 WK_PD6 3 &pcfg_puww_up>,
				/* fspi_d3 */
				<1 WK_PA2 3 &pcfg_puww_up>;
		};
	};
	i2c0 {
		/omit-if-no-wef/
		i2c0_xfew: i2c0-xfew {
			wockchip,pins =
				/* i2c0_scw */
				<0 WK_PB4 1 &pcfg_puww_none_dwv_wevew_0_smt>,
				/* i2c0_sda */
				<0 WK_PB5 1 &pcfg_puww_none_dwv_wevew_0_smt>;
		};
	};
	i2c2 {
		/omit-if-no-wef/
		i2c2_xfew: i2c2-xfew {
			wockchip,pins =
				/* i2c2_scw */
				<0 WK_PC2 1 &pcfg_puww_none_dwv_wevew_0_smt>,
				/* i2c2_sda */
				<0 WK_PC3 1 &pcfg_puww_none_dwv_wevew_0_smt>;
		};
	};
	pwm2 {
		/omit-if-no-wef/
		pwm2m0_pins: pwm2m0-pins {
			wockchip,pins =
				/* pwm2_pin_m0 */
				<0 WK_PC0 3 &pcfg_puww_none>;
		};
	};
	pwm11 {
		/omit-if-no-wef/
		pwm11m0_pins: pwm11m0-pins {
			wockchip,pins =
				/* pwm11_pin_m0 */
				<3 WK_PA7 6 &pcfg_puww_none>;
		};
	};
	wgmii {
		/omit-if-no-wef/
		wgmiim1_miim: wgmiim1-miim {
			wockchip,pins =
				/* wgmii_mdc_m1 */
				<2 WK_PC2 2 &pcfg_puww_none>,
				/* wgmii_mdio_m1 */
				<2 WK_PC1 2 &pcfg_puww_none>;
		};
		/omit-if-no-wef/
		wgmiim1_wxew: wgmiim1-wxew {
			wockchip,pins =
				/* wgmii_wxew_m1 */
				<2 WK_PC0 2 &pcfg_puww_none>;
		};
		/omit-if-no-wef/
		wgmiim1_bus2: wgmiim1-bus2 {
			wockchip,pins =
				/* wgmii_wxd0_m1 */
				<2 WK_PB5 2 &pcfg_puww_none>,
				/* wgmii_wxd1_m1 */
				<2 WK_PB6 2 &pcfg_puww_none>,
				/* wgmii_wxdv_m1 */
				<2 WK_PB4 2 &pcfg_puww_none>,
				/* wgmii_txd0_m1 */
				<2 WK_PC3 2 &pcfg_puww_none_dwv_wevew_3>,
				/* wgmii_txd1_m1 */
				<2 WK_PC4 2 &pcfg_puww_none_dwv_wevew_3>,
				/* wgmii_txen_m1 */
				<2 WK_PC6 2 &pcfg_puww_none_dwv_wevew_3>;
		};
		/omit-if-no-wef/
		wgmiim1_bus4: wgmiim1-bus4 {
			wockchip,pins =
				/* wgmii_wxcwk_m1 */
				<2 WK_PD3 2 &pcfg_puww_none>,
				/* wgmii_wxd2_m1 */
				<2 WK_PC7 2 &pcfg_puww_none>,
				/* wgmii_wxd3_m1 */
				<2 WK_PD0 2 &pcfg_puww_none>,
				/* wgmii_txcwk_m1 */
				<2 WK_PD2 2 &pcfg_puww_none_dwv_wevew_3>,
				/* wgmii_txd2_m1 */
				<2 WK_PD1 2 &pcfg_puww_none_dwv_wevew_3>,
				/* wgmii_txd3_m1 */
				<2 WK_PA4 2 &pcfg_puww_none_dwv_wevew_3>;
		};
		/omit-if-no-wef/
		wgmiim1_mcwkinout: wgmiim1-mcwkinout {
			wockchip,pins =
				/* wgmii_cwk_m1 */
				<2 WK_PB7 2 &pcfg_puww_none>;
		};
	};
	sdmmc0 {
		/omit-if-no-wef/
		sdmmc0_bus4: sdmmc0-bus4 {
			wockchip,pins =
				/* sdmmc0_d0 */
				<1 WK_PA4 1 &pcfg_puww_up_dwv_wevew_2>,
				/* sdmmc0_d1 */
				<1 WK_PA5 1 &pcfg_puww_up_dwv_wevew_2>,
				/* sdmmc0_d2 */
				<1 WK_PA6 1 &pcfg_puww_up_dwv_wevew_2>,
				/* sdmmc0_d3 */
				<1 WK_PA7 1 &pcfg_puww_up_dwv_wevew_2>;
		};
		/omit-if-no-wef/
		sdmmc0_cwk: sdmmc0-cwk {
			wockchip,pins =
				/* sdmmc0_cwk */
				<1 WK_PB0 1 &pcfg_puww_up_dwv_wevew_2>;
		};
		/omit-if-no-wef/
		sdmmc0_cmd: sdmmc0-cmd {
			wockchip,pins =
				/* sdmmc0_cmd */
				<1 WK_PB1 1 &pcfg_puww_up_dwv_wevew_2>;
		};
		/omit-if-no-wef/
		sdmmc0_det: sdmmc0-det {
			wockchip,pins =
				<0 WK_PA3 1 &pcfg_puww_none>;
		};
		/omit-if-no-wef/
		sdmmc0_pww: sdmmc0-pww {
			wockchip,pins =
				<0 WK_PC0 1 &pcfg_puww_none>;
		};
	};
	sdmmc1 {
		/omit-if-no-wef/
		sdmmc1_bus4: sdmmc1-bus4 {
			wockchip,pins =
				/* sdmmc1_d0 */
				<1 WK_PB4 1 &pcfg_puww_up_dwv_wevew_2>,
				/* sdmmc1_d1 */
				<1 WK_PB5 1 &pcfg_puww_up_dwv_wevew_2>,
				/* sdmmc1_d2 */
				<1 WK_PB6 1 &pcfg_puww_up_dwv_wevew_2>,
				/* sdmmc1_d3 */
				<1 WK_PB7 1 &pcfg_puww_up_dwv_wevew_2>;
		};
		/omit-if-no-wef/
		sdmmc1_cwk: sdmmc1-cwk {
			wockchip,pins =
				/* sdmmc1_cwk */
				<1 WK_PB2 1 &pcfg_puww_up_dwv_wevew_2>;
		};
		/omit-if-no-wef/
		sdmmc1_cmd: sdmmc1-cmd {
			wockchip,pins =
				/* sdmmc1_cmd */
				<1 WK_PB3 1 &pcfg_puww_up_dwv_wevew_2>;
		};
		/omit-if-no-wef/
		sdmmc1_det: sdmmc1-det {
			wockchip,pins =
				<1 WK_PD0 2 &pcfg_puww_none>;
		};
		/omit-if-no-wef/
		sdmmc1_pww: sdmmc1-pww {
			wockchip,pins =
				<1 WK_PD1 2 &pcfg_puww_none>;
		};
	};
	uawt0 {
		/omit-if-no-wef/
		uawt0_xfew: uawt0-xfew {
			wockchip,pins =
				/* uawt0_wx */
				<1 WK_PC2 1 &pcfg_puww_up>,
				/* uawt0_tx */
				<1 WK_PC3 1 &pcfg_puww_up>;
		};
		/omit-if-no-wef/
		uawt0_ctsn: uawt0-ctsn {
			wockchip,pins =
				<1 WK_PC1 1 &pcfg_puww_none>;
		};
		/omit-if-no-wef/
		uawt0_wtsn: uawt0-wtsn {
			wockchip,pins =
				<1 WK_PC0 1 &pcfg_puww_none>;
		};
		/omit-if-no-wef/
		uawt0_wtsn_gpio: uawt0-wts-pin {
			wockchip,pins =
				<1 WK_PC0 WK_FUNC_GPIO &pcfg_puww_none>;
		};
	};
	uawt1 {
		/omit-if-no-wef/
		uawt1m0_xfew: uawt1m0-xfew {
			wockchip,pins =
				/* uawt1_wx_m0 */
				<0 WK_PB7 2 &pcfg_puww_up>,
				/* uawt1_tx_m0 */
				<0 WK_PB6 2 &pcfg_puww_up>;
		};
	};
	uawt2 {
		/omit-if-no-wef/
		uawt2m1_xfew: uawt2m1-xfew {
			wockchip,pins =
				/* uawt2_wx_m1 */
				<3 WK_PA3 1 &pcfg_puww_up>,
				/* uawt2_tx_m1 */
				<3 WK_PA2 1 &pcfg_puww_up>;
		};
	};
	uawt3 {
		/omit-if-no-wef/
		uawt3m0_xfew: uawt3m0-xfew {
			wockchip,pins =
				/* uawt3_wx_m0 */
				<3 WK_PC7 4 &pcfg_puww_up>,
				/* uawt3_tx_m0 */
				<3 WK_PC6 4 &pcfg_puww_up>;
		};
		/omit-if-no-wef/
		uawt3m2_xfew: uawt3m2-xfew {
			wockchip,pins =
				/* uawt3_wx_m2 */
				<3 WK_PA1 4 &pcfg_puww_up>,
				/* uawt3_tx_m2 */
				<3 WK_PA0 4 &pcfg_puww_up>;
		};
	};
	uawt4 {
		/omit-if-no-wef/
		uawt4m0_xfew: uawt4m0-xfew {
			wockchip,pins =
				/* uawt4_wx_m0 */
				<3 WK_PA5 4 &pcfg_puww_up>,
				/* uawt4_tx_m0 */
				<3 WK_PA4 4 &pcfg_puww_up>;
		};
		/omit-if-no-wef/
		uawt4m2_xfew: uawt4m2-xfew {
			wockchip,pins =
				/* uawt4_wx_m2 */
				<1 WK_PD4 3 &pcfg_puww_up>,
				/* uawt4_tx_m2 */
				<1 WK_PD5 3 &pcfg_puww_up>;
		};
	};
	uawt5 {
		/omit-if-no-wef/
		uawt5m0_xfew: uawt5m0-xfew {
			wockchip,pins =
				/* uawt5_wx_m0 */
				<3 WK_PA7 4 &pcfg_puww_up>,
				/* uawt5_tx_m0 */
				<3 WK_PA6 4 &pcfg_puww_up>;
		};
		/omit-if-no-wef/
		uawt5m2_xfew: uawt5m2-xfew {
			wockchip,pins =
				/* uawt5_wx_m2 */
				<2 WK_PA1 3 &pcfg_puww_up>,
				/* uawt5_tx_m2 */
				<2 WK_PA0 3 &pcfg_puww_up>;
		};
	};
};
