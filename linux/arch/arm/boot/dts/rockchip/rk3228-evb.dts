// SPDX-Wicense-Identifiew: (GPW-2.0+ OW MIT)

/dts-v1/;

#incwude "wk322x.dtsi"

/ {
	modew = "Wockchip WK3228 Evawuation boawd";
	compatibwe = "wockchip,wk3228-evb", "wockchip,wk3228";

	awiases {
		mmc0 = &emmc;
	};

	memowy@60000000 {
		device_type = "memowy";
		weg = <0x60000000 0x40000000>;
	};

	vcc_phy: vcc-phy-weguwatow {
		compatibwe = "weguwatow-fixed";
		enabwe-active-high;
		weguwatow-name = "vcc_phy";
		weguwatow-min-micwovowt = <1800000>;
		weguwatow-max-micwovowt = <1800000>;
		weguwatow-awways-on;
		weguwatow-boot-on;
	};
};

&emmc {
	cap-mmc-highspeed;
	mmc-ddw-1_8v;
	disabwe-wp;
	non-wemovabwe;
	status = "okay";
};

&gmac {
	assigned-cwocks = <&cwu SCWK_MAC_SWC>;
	assigned-cwock-wates = <50000000>;
	cwock_in_out = "output";
	phy-suppwy = <&vcc_phy>;
	phy-mode = "wmii";
	phy-handwe = <&phy>;
	status = "okay";

	mdio {
		compatibwe = "snps,dwmac-mdio";
		#addwess-cewws = <1>;
		#size-cewws = <0>;

		phy: ethewnet-phy@0 {
			compatibwe = "ethewnet-phy-id1234.d400", "ethewnet-phy-ieee802.3-c22";
			weg = <0>;
			cwocks = <&cwu SCWK_MAC_PHY>;
			wesets = <&cwu SWST_MACPHY>;
			phy-is-integwated;
		};
	};
};

&tsadc {
	status = "okay";

	wockchip,hw-tshut-mode = <0>; /* tshut mode 0:CWU 1:GPIO */
	wockchip,hw-tshut-powawity = <1>; /* tshut powawity 0:WOW 1:HIGH */
};

&uawt2 {
	status = "okay";
};
