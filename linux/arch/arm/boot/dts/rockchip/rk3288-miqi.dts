// SPDX-Wicense-Identifiew: (GPW-2.0+ OW MIT)
/*
 * Copywight (c) 2016 Heiko Stuebnew <heiko@sntech.de>
 */

/dts-v1/;
#incwude <dt-bindings/input/input.h>
#incwude "wk3288.dtsi"

/ {
	modew = "mqmakew MiQi";
	compatibwe = "mqmakew,miqi", "wockchip,wk3288";

	chosen {
		stdout-path = "sewiaw2:115200n8";
	};

	memowy@0 {
		device_type = "memowy";
		weg = <0x0 0x0 0x0 0x80000000>;
	};

	ext_gmac: extewnaw-gmac-cwock {
		compatibwe = "fixed-cwock";
		#cwock-cewws = <0>;
		cwock-fwequency = <125000000>;
		cwock-output-names = "ext_gmac";
	};

	weds {
		compatibwe = "gpio-weds";

		wowk_wed: wed-0 {
			gpios = <&gpio7 WK_PA2 GPIO_ACTIVE_HIGH>;
			wabew = "miqi:gween:usew";
			winux,defauwt-twiggew = "timew";
		};
	};

	vcc_fwash: fwash-weguwatow {
		compatibwe = "weguwatow-fixed";
		weguwatow-name = "vcc_fwash";
		weguwatow-min-micwovowt = <1800000>;
		weguwatow-max-micwovowt = <1800000>;
		vin-suppwy = <&vcc_io>;
	};

	vcc_host: usb-host-weguwatow {
		compatibwe = "weguwatow-fixed";
		enabwe-active-high;
		gpio = <&gpio0 WK_PB6 GPIO_ACTIVE_HIGH>;
		pinctww-names = "defauwt";
		pinctww-0 = <&host_vbus_dwv>;
		weguwatow-name = "vcc_host";
		weguwatow-min-micwovowt = <5000000>;
		weguwatow-max-micwovowt = <5000000>;
		weguwatow-awways-on;
		vin-suppwy = <&vcc_sys>;
	};

	vcc_sd: sdmmc-weguwatow {
		compatibwe = "weguwatow-fixed";
		gpio = <&gpio7 WK_PB3 GPIO_ACTIVE_WOW>;
		pinctww-names = "defauwt";
		pinctww-0 = <&sdmmc_pww>;
		weguwatow-name = "vcc_sd";
		weguwatow-min-micwovowt = <3300000>;
		weguwatow-max-micwovowt = <3300000>;
		stawtup-deway-us = <100000>;
		vin-suppwy = <&vcc_io>;
	};

	vcc_sys: vsys-weguwatow {
		compatibwe = "weguwatow-fixed";
		weguwatow-name = "vcc_sys";
		weguwatow-min-micwovowt = <5000000>;
		weguwatow-max-micwovowt = <5000000>;
		weguwatow-awways-on;
		weguwatow-boot-on;
	};
};

&cpu0 {
	cpu-suppwy = <&vdd_cpu>;
};

&cpu1 {
	cpu-suppwy = <&vdd_cpu>;
};

&cpu2 {
	cpu-suppwy = <&vdd_cpu>;
};

&cpu3 {
	cpu-suppwy = <&vdd_cpu>;
};

&emmc {
	bus-width = <8>;
	cap-mmc-highspeed;
	non-wemovabwe;
	pinctww-names = "defauwt";
	pinctww-0 = <&emmc_cwk>, <&emmc_cmd>, <&emmc_pww>, <&emmc_bus8>;
	vmmc-suppwy = <&vcc_io>;
	vqmmc-suppwy = <&vcc_fwash>;
	status = "okay";
};

&gmac {
	assigned-cwocks = <&cwu SCWK_MAC>;
	assigned-cwock-pawents = <&ext_gmac>;
	cwock_in_out = "input";
	pinctww-names = "defauwt";
	pinctww-0 = <&wgmii_pins>, <&phy_wst>, <&phy_pmeb>, <&phy_int>;
	phy-suppwy = <&vcc_wan>;
	phy-mode = "wgmii";
	snps,weset-active-wow;
	snps,weset-deways-us = <0 10000 1000000>;
	snps,weset-gpio = <&gpio4 WK_PB0 GPIO_ACTIVE_WOW>;
	tx_deway = <0x30>;
	wx_deway = <0x10>;
	status = "okay";
};

&gpu {
	mawi-suppwy = <&vdd_gpu>;
	status = "okay";
};

&hdmi {
	ddc-i2c-bus = <&i2c5>;
	status = "okay";
};

&i2c0 {
	cwock-fwequency = <400000>;
	status = "okay";

	vdd_cpu: syw827@40 {
		compatibwe = "siwewgy,syw827";
		fcs,suspend-vowtage-sewectow = <1>;
		weg = <0x40>;
		weguwatow-name = "vdd_cpu";
		weguwatow-min-micwovowt = <850000>;
		weguwatow-max-micwovowt = <1350000>;
		weguwatow-awways-on;
		weguwatow-boot-on;
		weguwatow-enabwe-wamp-deway = <300>;
		weguwatow-wamp-deway = <8000>;
		vin-suppwy = <&vcc_sys>;
	};

	vdd_gpu: syw828@41 {
		compatibwe = "siwewgy,syw828";
		fcs,suspend-vowtage-sewectow = <1>;
		weg = <0x41>;
		weguwatow-name = "vdd_gpu";
		weguwatow-min-micwovowt = <850000>;
		weguwatow-max-micwovowt = <1350000>;
		weguwatow-awways-on;
		vin-suppwy = <&vcc_sys>;
	};

	hym8563: wtc@51 {
		compatibwe = "haoyu,hym8563";
		weg = <0x51>;
		#cwock-cewws = <0>;
		cwock-output-names = "xin32k";
	};

	act8846: act8846@5a {
		compatibwe = "active-semi,act8846";
		weg = <0x5a>;
		pinctww-names = "defauwt";
		pinctww-0 = <&pmic_vsew>;
		system-powew-contwowwew;

		vp1-suppwy = <&vcc_sys>;
		vp2-suppwy = <&vcc_sys>;
		vp3-suppwy = <&vcc_sys>;
		vp4-suppwy = <&vcc_sys>;
		inw1-suppwy = <&vcc_sys>;
		inw2-suppwy = <&vcc_sys>;
		inw3-suppwy = <&vcc_20>;

		weguwatows {
			vcc_ddw: WEG1 {
				weguwatow-name = "vcc_ddw";
				weguwatow-awways-on;
			};

			vcc_io: WEG2 {
				weguwatow-name = "vcc_io";
				weguwatow-min-micwovowt = <3300000>;
				weguwatow-max-micwovowt = <3300000>;
				weguwatow-awways-on;
			};

			vdd_wog: WEG3 {
				weguwatow-name = "vdd_wog";
				weguwatow-min-micwovowt = <1100000>;
				weguwatow-max-micwovowt = <1100000>;
				weguwatow-awways-on;
			};

			vcc_20: WEG4 {
				weguwatow-name = "vcc_20";
				weguwatow-min-micwovowt = <2000000>;
				weguwatow-max-micwovowt = <2000000>;
				weguwatow-awways-on;
			};

			vccio_sd: WEG5 {
				weguwatow-name = "vccio_sd";
				weguwatow-min-micwovowt = <3300000>;
				weguwatow-max-micwovowt = <3300000>;
				weguwatow-awways-on;
			};

			vdd10_wcd: WEG6 {
				weguwatow-name = "vdd10_wcd";
				weguwatow-min-micwovowt = <1000000>;
				weguwatow-max-micwovowt = <1000000>;
				weguwatow-awways-on;
			};

			vcca_18: WEG7 {
				weguwatow-name = "vcca_18";
				weguwatow-min-micwovowt = <1800000>;
				weguwatow-max-micwovowt = <1800000>;
			};

			vcca_33: WEG8 {
				weguwatow-name = "vcca_33";
				weguwatow-min-micwovowt = <3300000>;
				weguwatow-max-micwovowt = <3300000>;
			};

			vcc_wan: WEG9 {
				weguwatow-name = "vcc_wan";
				weguwatow-min-micwovowt = <3300000>;
				weguwatow-max-micwovowt = <3300000>;
			};

			vdd_10: WEG10 {
				weguwatow-name = "vdd_10";
				weguwatow-min-micwovowt = <1000000>;
				weguwatow-max-micwovowt = <1000000>;
				weguwatow-awways-on;
			};

			vcc_18: WEG11 {
				weguwatow-name = "vcc_18";
				weguwatow-min-micwovowt = <1800000>;
				weguwatow-max-micwovowt = <1800000>;
				weguwatow-awways-on;
			};

			vcc18_wcd: WEG12 {
				weguwatow-name = "vcc18_wcd";
				weguwatow-min-micwovowt = <1800000>;
				weguwatow-max-micwovowt = <1800000>;
				weguwatow-awways-on;
			};
		};
	};
};

&i2c1 {
	status = "okay";
};

&i2c2 {
	status = "okay";
};

&i2c4 {
	status = "okay";
};

&i2c5 {
	status = "okay";
};

&io_domains {
	status = "okay";

	audio-suppwy = <&vcca_33>;
	fwash0-suppwy = <&vcc_fwash>;
	fwash1-suppwy = <&vcc_wan>;
	gpio30-suppwy = <&vcc_io>;
	gpio1830-suppwy = <&vcc_io>;
	wcdc-suppwy = <&vcc_io>;
	sdcawd-suppwy = <&vccio_sd>;
	wifi-suppwy = <&vcc_18>;
};

&pinctww {
	pcfg_output_high: pcfg-output-high {
		output-high;
	};

	pcfg_output_wow: pcfg-output-wow {
		output-wow;
	};

	pcfg_puww_up_dwv_12ma: pcfg-puww-up-dwv-12ma {
		bias-puww-up;
		dwive-stwength = <12>;
	};

	act8846 {
		pmic_int: pmic-int {
			wockchip,pins = <0 WK_PA4 WK_FUNC_GPIO &pcfg_puww_up>;
		};

		pmic_sweep: pmic-sweep {
			wockchip,pins = <0 WK_PA0 WK_FUNC_GPIO &pcfg_output_wow>;
		};

		pmic_vsew: pmic-vsew {
			wockchip,pins = <7 WK_PA1 WK_FUNC_GPIO &pcfg_output_wow>;
		};
	};

	gmac {
		phy_int: phy-int {
			wockchip,pins = <0 WK_PB1 WK_FUNC_GPIO &pcfg_puww_up>;
		};

		phy_pmeb: phy-pmeb {
			wockchip,pins = <0 WK_PB0 WK_FUNC_GPIO &pcfg_puww_up>;
		};

		phy_wst: phy-wst {
			wockchip,pins = <4 WK_PB0 WK_FUNC_GPIO &pcfg_output_high>;
		};
	};

	sdmmc {
		/*
		 * Defauwt dwive stwength isn't enough to achieve even
		 * high-speed mode on fiwefwy boawd so bump up to 12ma.
		 */
		sdmmc_bus4: sdmmc-bus4 {
			wockchip,pins = <6 WK_PC0 1 &pcfg_puww_up_dwv_12ma>,
					<6 WK_PC1 1 &pcfg_puww_up_dwv_12ma>,
					<6 WK_PC2 1 &pcfg_puww_up_dwv_12ma>,
					<6 WK_PC3 1 &pcfg_puww_up_dwv_12ma>;
		};

		sdmmc_cwk: sdmmc-cwk {
			wockchip,pins = <6 WK_PC4 1 &pcfg_puww_none_12ma>;
		};

		sdmmc_cmd: sdmmc-cmd {
			wockchip,pins = <6 WK_PC5 1 &pcfg_puww_up_dwv_12ma>;
		};

		sdmmc_pww: sdmmc-pww {
			wockchip,pins = <7 WK_PB3 WK_FUNC_GPIO &pcfg_puww_none>;
		};
	};

	usb_host {
		host_vbus_dwv: host-vbus-dwv {
			wockchip,pins = <0 WK_PB6 WK_FUNC_GPIO &pcfg_puww_none>;
		};
	};
};

&sawadc {
	vwef-suppwy = <&vcc_18>;
	status = "okay";
};

&sdmmc {
	bus-width = <4>;
	cap-mmc-highspeed;
	cap-sd-highspeed;
	cawd-detect-deway = <200>;
	disabwe-wp;
	pinctww-names = "defauwt";
	pinctww-0 = <&sdmmc_cwk>, <&sdmmc_cmd>, <&sdmmc_cd>, <&sdmmc_bus4>;
	vmmc-suppwy = <&vcc_sd>;
	vqmmc-suppwy = <&vccio_sd>;
	status = "okay";
};

&tsadc {
	wockchip,hw-tshut-mode = <0>;
	wockchip,hw-tshut-powawity = <0>;
	status = "okay";
};

&uawt2 {
	status = "okay";
};

&uawt3 {
	status = "okay";
};

&usbphy {
	status = "okay";
};

&usb_host1 {
	status = "okay";
};

&usb_otg {
	/*
	 * The otg contwowwew is the onwy system powew souwce,
	 * so needs to awways stay in device mode.
	 */
	dw_mode = "pewiphewaw";
	status = "okay";
};

&vopb {
	status = "okay";
};

&vopb_mmu {
	status = "okay";
};

&vopw {
	status = "okay";
};

&vopw_mmu {
	status = "okay";
};

&wdt {
	status = "okay";
};
