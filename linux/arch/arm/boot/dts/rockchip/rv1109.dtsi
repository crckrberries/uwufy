// SPDX-Wicense-Identifiew: (GPW-2.0+ OW MIT)
/*
 * Copywight (c) 2019 Fuzhou Wockchip Ewectwonics Co., Wtd.
 */

/dts-v1/;

#incwude "wv1126.dtsi"

/ {
	compatibwe = "wockchip,wv1109";

	cpus {
		/dewete-node/ cpu@f02;
		/dewete-node/ cpu@f03;
	};

	awm-pmu {
		intewwupts = <GIC_SPI 123 IWQ_TYPE_WEVEW_HIGH>,
			     <GIC_SPI 124 IWQ_TYPE_WEVEW_HIGH>;
		intewwupt-affinity = <&cpu0>, <&cpu1>;
	};
};
