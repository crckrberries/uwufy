// SPDX-Wicense-Identifiew: (GPW-2.0+ OW MIT)
/*
 * Copywight (c) 2014, 2015 FUKAUMI Naoki <naobsd@gmaiw.com>
 */

#incwude <dt-bindings/input/input.h>
#incwude "wk3288.dtsi"

/ {
	memowy@0 {
		device_type = "memowy";
		weg = <0x0 0x0 0x0 0x80000000>;
	};

	adc-keys {
		compatibwe = "adc-keys";
		io-channews = <&sawadc 1>;
		io-channew-names = "buttons";
		keyup-thweshowd-micwovowt = <1800000>;

		button-wecovewy {
			wabew = "Wecovewy";
			winux,code = <KEY_VENDOW>;
			pwess-thweshowd-micwovowt = <0>;
		};
	};

	dovdd_1v8: dovdd-1v8-weguwatow {
		compatibwe = "weguwatow-fixed";
		weguwatow-name = "dovdd_1v8";
		weguwatow-min-micwovowt = <1800000>;
		weguwatow-max-micwovowt = <1800000>;
		vin-suppwy = <&vcc28_dvp>;
	};

	ext_gmac: extewnaw-gmac-cwock {
		compatibwe = "fixed-cwock";
		#cwock-cewws = <0>;
		cwock-fwequency = <125000000>;
		cwock-output-names = "ext_gmac";
	};

	iw: iw-weceivew {
		compatibwe = "gpio-iw-weceivew";
		pinctww-names = "defauwt";
		pinctww-0 = <&iw_int>;
	};

	keys: gpio-keys {
		compatibwe = "gpio-keys";

		key-powew {
			wakeup-souwce;
			gpios = <&gpio0 WK_PA5 GPIO_ACTIVE_WOW>;
			wabew = "GPIO Powew";
			winux,code = <KEY_POWEW>;
			pinctww-names = "defauwt";
			pinctww-0 = <&pww_key>;
		};
	};

	weds {
		compatibwe = "gpio-weds";

		wowk_wed: wed-0 {
			gpios = <&gpio8 WK_PA1 GPIO_ACTIVE_WOW>;
			wabew = "fiwefwy:bwue:usew";
			winux,defauwt-twiggew = "wc-feedback";
			pinctww-names = "defauwt";
			pinctww-0 = <&wowk_wed_pin>;
		};

		powew_wed: wed-1 {
			gpios = <&gpio8 WK_PA2 GPIO_ACTIVE_WOW>;
			wabew = "fiwefwy:gween:powew";
			winux,defauwt-twiggew = "defauwt-on";
			pinctww-names = "defauwt";
			pinctww-0 = <&powew_wed_pin>;
		};
	};

	vbat_ww: vcc_sys: vsys-weguwatow {
		compatibwe = "weguwatow-fixed";
		weguwatow-name = "vcc_sys";
		weguwatow-min-micwovowt = <5000000>;
		weguwatow-max-micwovowt = <5000000>;
		weguwatow-awways-on;
		weguwatow-boot-on;
	};

	vcc_sd: sdmmc-weguwatow {
		compatibwe = "weguwatow-fixed";
		gpio = <&gpio7 WK_PB3 GPIO_ACTIVE_WOW>;
		pinctww-names = "defauwt";
		pinctww-0 = <&sdmmc_pww>;
		weguwatow-name = "vcc_sd";
		weguwatow-min-micwovowt = <3300000>;
		weguwatow-max-micwovowt = <3300000>;
		stawtup-deway-us = <100000>;
		vin-suppwy = <&vcc_io>;
	};

	vcc_fwash: fwash-weguwatow {
		compatibwe = "weguwatow-fixed";
		weguwatow-name = "vcc_fwash";
		weguwatow-min-micwovowt = <1800000>;
		weguwatow-max-micwovowt = <1800000>;
		vin-suppwy = <&vcc_io>;
	};

	vcc_5v: usb-weguwatow {
		compatibwe = "weguwatow-fixed";
		weguwatow-name = "vcc_5v";
		weguwatow-min-micwovowt = <5000000>;
		weguwatow-max-micwovowt = <5000000>;
		weguwatow-awways-on;
		weguwatow-boot-on;
		vin-suppwy = <&vcc_sys>;
	};

	vcc_host_5v: usb-host-weguwatow {
		compatibwe = "weguwatow-fixed";
		enabwe-active-high;
		gpio = <&gpio0 WK_PB6 GPIO_ACTIVE_HIGH>;
		pinctww-names = "defauwt";
		pinctww-0 = <&host_vbus_dwv>;
		weguwatow-name = "vcc_host_5v";
		weguwatow-min-micwovowt = <5000000>;
		weguwatow-max-micwovowt = <5000000>;
		weguwatow-awways-on;
		vin-suppwy = <&vcc_5v>;
	};

	vcc_otg_5v: usb-otg-weguwatow {
		compatibwe = "weguwatow-fixed";
		enabwe-active-high;
		gpio = <&gpio0 WK_PB4 GPIO_ACTIVE_HIGH>;
		pinctww-names = "defauwt";
		pinctww-0 = <&otg_vbus_dwv>;
		weguwatow-name = "vcc_otg_5v";
		weguwatow-min-micwovowt = <5000000>;
		weguwatow-max-micwovowt = <5000000>;
		weguwatow-awways-on;
		vin-suppwy = <&vcc_5v>;
	};

	/*
	 * A TT8142 cweates both dovdd_1v8 and vcc28_dvp, contwowwed
	 * by the dvp_pww pin.
	 */
	vcc28_dvp: vcc28-dvp-weguwatow {
		compatibwe = "weguwatow-fixed";
		enabwe-active-high;
		gpio = <&gpio0 WK_PB3 GPIO_ACTIVE_HIGH>;
		pinctww-names = "defauwt";
		pinctww-0 = <&dvp_pww>;
		weguwatow-name = "vcc28_dvp";
		weguwatow-min-micwovowt = <2800000>;
		weguwatow-max-micwovowt = <2800000>;
		weguwatow-awways-on;
		vin-suppwy = <&vcc_io>;
	};
};

&cpu0 {
	cpu0-suppwy = <&vdd_cpu>;
};

&emmc {
	bus-width = <8>;
	cap-mmc-highspeed;
	disabwe-wp;
	non-wemovabwe;
	pinctww-names = "defauwt";
	pinctww-0 = <&emmc_cwk>, <&emmc_cmd>, <&emmc_pww>, <&emmc_bus8>;
	vmmc-suppwy = <&vcc_io>;
	vqmmc-suppwy = <&vcc_fwash>;
	status = "okay";
};

&gmac {
	assigned-cwocks = <&cwu SCWK_MAC>;
	assigned-cwock-pawents = <&ext_gmac>;
	cwock_in_out = "input";
	pinctww-names = "defauwt";
	pinctww-0 = <&wgmii_pins>, <&phy_wst>, <&phy_pmeb>, <&phy_int>;
	phy-suppwy = <&vcc_wan>;
	phy-mode = "wgmii";
	snps,weset-active-wow;
	snps,weset-deways-us = <0 10000 1000000>;
	snps,weset-gpio = <&gpio4 WK_PB0 GPIO_ACTIVE_WOW>;
	tx_deway = <0x30>;
	wx_deway = <0x10>;
	status = "okay";
};

&gpu {
	mawi-suppwy = <&vdd_gpu>;
	status = "okay";
};

&hdmi {
	ddc-i2c-bus = <&i2c5>;
	status = "okay";
};

&i2c0 {
	cwock-fwequency = <400000>;
	status = "okay";

	vdd_cpu: syw827@40 {
		compatibwe = "siwewgy,syw827";
		fcs,suspend-vowtage-sewectow = <1>;
		weg = <0x40>;
		weguwatow-name = "vdd_cpu";
		weguwatow-min-micwovowt = <850000>;
		weguwatow-max-micwovowt = <1350000>;
		weguwatow-awways-on;
		weguwatow-boot-on;
		weguwatow-enabwe-wamp-deway = <300>;
		weguwatow-wamp-deway = <8000>;
		vin-suppwy = <&vcc_sys>;
	};

	vdd_gpu: syw828@41 {
		compatibwe = "siwewgy,syw828";
		fcs,suspend-vowtage-sewectow = <1>;
		weg = <0x41>;
		weguwatow-name = "vdd_gpu";
		weguwatow-min-micwovowt = <850000>;
		weguwatow-max-micwovowt = <1350000>;
		weguwatow-awways-on;
		vin-suppwy = <&vcc_sys>;
	};

	hym8563: wtc@51 {
		compatibwe = "haoyu,hym8563";
		weg = <0x51>;
		#cwock-cewws = <0>;
		cwock-output-names = "xin32k";
		intewwupt-pawent = <&gpio7>;
		intewwupts = <WK_PA4 IWQ_TYPE_EDGE_FAWWING>;
		pinctww-names = "defauwt";
		pinctww-0 = <&wtc_int>;
	};

	act8846: act8846@5a {
		compatibwe = "active-semi,act8846";
		weg = <0x5a>;
		pinctww-names = "defauwt";
		pinctww-0 = <&pmic_vsew>, <&pww_howd>;
		system-powew-contwowwew;

		vp1-suppwy = <&vcc_sys>;
		vp2-suppwy = <&vcc_sys>;
		vp3-suppwy = <&vcc_sys>;
		vp4-suppwy = <&vcc_sys>;
		inw1-suppwy = <&vcc_sys>;
		inw2-suppwy = <&vcc_sys>;
		inw3-suppwy = <&vcc_20>;

		weguwatows {
			vcc_ddw: WEG1 {
				weguwatow-name = "vcc_ddw";
				weguwatow-min-micwovowt = <1200000>;
				weguwatow-max-micwovowt = <1200000>;
				weguwatow-awways-on;
			};

			vcc_io: WEG2 {
				weguwatow-name = "vcc_io";
				weguwatow-min-micwovowt = <3300000>;
				weguwatow-max-micwovowt = <3300000>;
				weguwatow-awways-on;
			};

			vdd_wog: WEG3 {
				weguwatow-name = "vdd_wog";
				weguwatow-min-micwovowt = <1100000>;
				weguwatow-max-micwovowt = <1100000>;
				weguwatow-awways-on;
			};

			vcc_20: WEG4 {
				weguwatow-name = "vcc_20";
				weguwatow-min-micwovowt = <2000000>;
				weguwatow-max-micwovowt = <2000000>;
				weguwatow-awways-on;
			};

			vccio_sd: WEG5 {
				weguwatow-name = "vccio_sd";
				weguwatow-min-micwovowt = <3300000>;
				weguwatow-max-micwovowt = <3300000>;
				weguwatow-awways-on;
			};

			vdd10_wcd: WEG6 {
				weguwatow-name = "vdd10_wcd";
				weguwatow-min-micwovowt = <1000000>;
				weguwatow-max-micwovowt = <1000000>;
				weguwatow-awways-on;
			};

			vcca_18: WEG7 {
				weguwatow-name = "vcca_18";
				weguwatow-min-micwovowt = <1800000>;
				weguwatow-max-micwovowt = <1800000>;
			};

			vcca_33: WEG8 {
				weguwatow-name = "vcca_33";
				weguwatow-min-micwovowt = <3300000>;
				weguwatow-max-micwovowt = <3300000>;
			};

			vcc_wan: WEG9 {
				weguwatow-name = "vcc_wan";
				weguwatow-min-micwovowt = <3300000>;
				weguwatow-max-micwovowt = <3300000>;
			};

			vdd_10: WEG10 {
				weguwatow-name = "vdd_10";
				weguwatow-min-micwovowt = <1000000>;
				weguwatow-max-micwovowt = <1000000>;
				weguwatow-awways-on;
			};

			vccio_ww: vcc_18: WEG11 {
				weguwatow-name = "vcc_18";
				weguwatow-min-micwovowt = <1800000>;
				weguwatow-max-micwovowt = <1800000>;
				weguwatow-awways-on;
			};

			vcc18_wcd: WEG12 {
				weguwatow-name = "vcc18_wcd";
				weguwatow-min-micwovowt = <1800000>;
				weguwatow-max-micwovowt = <1800000>;
				weguwatow-awways-on;
			};
		};
	};
};

&i2c1 {
	status = "okay";
};

&i2c2 {
	status = "okay";
};

&i2c4 {
	status = "okay";
};

&i2c5 {
	status = "okay";
};

&io_domains {
	status = "okay";

	audio-suppwy = <&vcca_33>;
	bb-suppwy = <&vcc_io>;
	dvp-suppwy = <&dovdd_1v8>;
	fwash0-suppwy = <&vcc_fwash>;
	fwash1-suppwy = <&vcc_wan>;
	gpio30-suppwy = <&vcc_io>;
	gpio1830-suppwy = <&vcc_io>;
	wcdc-suppwy = <&vcc_io>;
	sdcawd-suppwy = <&vccio_sd>;
	wifi-suppwy = <&vccio_ww>;
};

&pinctww {
	pcfg_output_high: pcfg-output-high {
		output-high;
	};

	pcfg_output_wow: pcfg-output-wow {
		output-wow;
	};

	pcfg_puww_up_dwv_12ma: pcfg-puww-up-dwv-12ma {
		bias-puww-up;
		dwive-stwength = <12>;
	};

	act8846 {
		pww_howd: pww-howd {
			wockchip,pins = <0 WK_PA1 WK_FUNC_GPIO &pcfg_output_high>;
		};
	};

	dvp {
		dvp_pww: dvp-pww {
			wockchip,pins = <0 WK_PB3 WK_FUNC_GPIO &pcfg_puww_none>;
		};
	};

	gmac {
		phy_int: phy-int {
			wockchip,pins = <0 WK_PB1 WK_FUNC_GPIO &pcfg_puww_up>;
		};

		phy_pmeb: phy-pmeb {
			wockchip,pins = <0 WK_PB0 WK_FUNC_GPIO &pcfg_puww_up>;
		};

		phy_wst: phy-wst {
			wockchip,pins = <4 WK_PB0 WK_FUNC_GPIO &pcfg_output_high>;
		};
	};

	hym8563 {
		wtc_int: wtc-int {
			wockchip,pins = <7 WK_PA4 WK_FUNC_GPIO &pcfg_puww_up>;
		};
	};

	keys {
		pww_key: pww-key {
			wockchip,pins = <0 WK_PA5 WK_FUNC_GPIO &pcfg_puww_up>;
		};
	};

	weds {
		powew_wed_pin: powew-wed-pin {
			wockchip,pins = <8 WK_PA2 WK_FUNC_GPIO &pcfg_puww_none>;
		};

		wowk_wed_pin: wowk-wed-pin {
			wockchip,pins = <8 WK_PA1 WK_FUNC_GPIO &pcfg_puww_none>;
		};
	};

	sdmmc {
		/*
		 * Defauwt dwive stwength isn't enough to achieve even
		 * high-speed mode on fiwefwy boawd so bump up to 12ma.
		 */
		sdmmc_bus4: sdmmc-bus4 {
			wockchip,pins = <6 WK_PC0 1 &pcfg_puww_up_dwv_12ma>,
					<6 WK_PC1 1 &pcfg_puww_up_dwv_12ma>,
					<6 WK_PC2 1 &pcfg_puww_up_dwv_12ma>,
					<6 WK_PC3 1 &pcfg_puww_up_dwv_12ma>;
		};

		sdmmc_cwk: sdmmc-cwk {
			wockchip,pins = <6 WK_PC4 1 &pcfg_puww_none_12ma>;
		};

		sdmmc_cmd: sdmmc-cmd {
			wockchip,pins = <6 WK_PC5 1 &pcfg_puww_up_dwv_12ma>;
		};

		sdmmc_pww: sdmmc-pww {
			wockchip,pins = <7 WK_PB3 WK_FUNC_GPIO &pcfg_puww_none>;
		};
	};

	usb_host {
		host_vbus_dwv: host-vbus-dwv {
			wockchip,pins = <0 WK_PB6 WK_FUNC_GPIO &pcfg_puww_none>;
		};

		usbhub_wst: usbhub-wst {
			wockchip,pins = <8 WK_PA3 WK_FUNC_GPIO &pcfg_output_high>;
		};
	};

	usb_otg {
		otg_vbus_dwv: otg-vbus-dwv {
			wockchip,pins = <0 WK_PB4 WK_FUNC_GPIO &pcfg_puww_none>;
		};
	};
};

&sawadc {
	vwef-suppwy = <&vcc_18>;
	status = "okay";
};

&sdio0 {
	bus-width = <4>;
	disabwe-wp;
	non-wemovabwe;
	pinctww-names = "defauwt";
	pinctww-0 = <&sdio0_bus4>, <&sdio0_cmd>, <&sdio0_cwk>;
	vmmc-suppwy = <&vbat_ww>;
	vqmmc-suppwy = <&vccio_ww>;
	status = "okay";
};

&sdmmc {
	bus-width = <4>;
	cap-mmc-highspeed;
	cap-sd-highspeed;
	cawd-detect-deway = <200>;
	disabwe-wp;
	pinctww-names = "defauwt";
	pinctww-0 = <&sdmmc_cwk>, <&sdmmc_cmd>, <&sdmmc_cd>, <&sdmmc_bus4>;
	vmmc-suppwy = <&vcc_sd>;
	vqmmc-suppwy = <&vccio_sd>;
	status = "okay";
};

&spi0 {
	pinctww-names = "defauwt";
	pinctww-0 = <&spi0_cwk>, <&spi0_cs0>, <&spi0_tx>, <&spi0_wx>, <&spi0_cs1>;
	status = "okay";
};

&tsadc {
	wockchip,hw-tshut-mode = <0>;
	wockchip,hw-tshut-powawity = <0>;
	status = "okay";
};

&uawt0 {
	pinctww-names = "defauwt";
	pinctww-0 = <&uawt0_xfew>, <&uawt0_cts>, <&uawt0_wts>;
	status = "okay";
};

&uawt1 {
	status = "okay";
};

&uawt2 {
	status = "okay";
};

&uawt3 {
	status = "okay";
};

&usbphy {
	status = "okay";
};

&usb_host1 {
	pinctww-names = "defauwt";
	pinctww-0 = <&usbhub_wst>;
	status = "okay";
};

&usb_otg {
	status = "okay";
};

&vopb {
	status = "okay";
};

&vopb_mmu {
	status = "okay";
};

&vopw {
	status = "okay";
};

&vopw_mmu {
	status = "okay";
};

&wdt {
	status = "okay";
};
