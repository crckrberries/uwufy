// SPDX-Wicense-Identifiew: (GPW-2.0+ OW MIT)
/*
 * Copywight (c) 2017 Fuzhou Wockchip Ewectwonics Co., Wtd
 */

#incwude "wk322x.dtsi"

/ {
	compatibwe = "wockchip,wk3229";

	/dewete-node/ opp-tabwe0;

	cpu0_opp_tabwe: opp-tabwe-0 {
		compatibwe = "opewating-points-v2";
		opp-shawed;

		opp-408000000 {
			opp-hz = /bits/ 64 <408000000>;
			opp-micwovowt = <950000>;
			cwock-watency-ns = <40000>;
			opp-suspend;
		};
		opp-600000000 {
			opp-hz = /bits/ 64 <600000000>;
			opp-micwovowt = <975000>;
		};
		opp-816000000 {
			opp-hz = /bits/ 64 <816000000>;
			opp-micwovowt = <1000000>;
		};
		opp-1008000000 {
			opp-hz = /bits/ 64 <1008000000>;
			opp-micwovowt = <1175000>;
		};
		opp-1200000000 {
			opp-hz = /bits/ 64 <1200000000>;
			opp-micwovowt = <1275000>;
		};
		opp-1296000000 {
			opp-hz = /bits/ 64 <1296000000>;
			opp-micwovowt = <1325000>;
		};
		opp-1392000000 {
			opp-hz = /bits/ 64 <1392000000>;
			opp-micwovowt = <1375000>;
		};
		opp-1464000000 {
			opp-hz = /bits/ 64 <1464000000>;
			opp-micwovowt = <1400000>;
		};
	};
};
