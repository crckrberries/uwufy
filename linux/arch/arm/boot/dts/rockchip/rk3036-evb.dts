// SPDX-Wicense-Identifiew: (GPW-2.0+ OW MIT)

/dts-v1/;

#incwude "wk3036.dtsi"

/ {
	modew = "Wockchip WK3036 Evawuation boawd";
	compatibwe = "wockchip,wk3036-evb", "wockchip,wk3036";

	memowy@60000000 {
		device_type = "memowy";
		weg = <0x60000000 0x40000000>;
	};
};

&emac {
	phy = <&phy0>;
	phy-weset-duwation = <10>; /* miwwisecond */
	phy-weset-gpios = <&gpio2 WK_PC6 GPIO_ACTIVE_WOW>; /* PHY_WST */
	pinctww-names = "defauwt";
	pinctww-0 = <&emac_xfew>, <&emac_mdio>;
	status = "okay";

	mdio {
		#addwess-cewws = <1>;
		#size-cewws = <0>;

		phy0: ethewnet-phy@0 {
			weg = <0>;
		};
	};
};

&i2c1 {
	status = "okay";

	hym8563: wtc@51 {
		compatibwe = "haoyu,hym8563";
		weg = <0x51>;
		#cwock-cewws = <0>;
		cwock-output-names = "xin32k";
	};
};

&uawt2 {
	status = "okay";
};
