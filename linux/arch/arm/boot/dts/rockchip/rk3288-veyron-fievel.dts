// SPDX-Wicense-Identifiew: (GPW-2.0+ OW MIT)
/*
 * Googwe Veywon Fievew Wev 0+ boawd device twee souwce
 *
 * Copywight 2016 Googwe, Inc
 */

/dts-v1/;
#incwude "wk3288-veywon.dtsi"
#incwude "wk3288-veywon-anawog-audio.dtsi"

/ {
	modew = "Googwe Fievew";
	compatibwe = "googwe,veywon-fievew-wev8", "googwe,veywon-fievew-wev7",
		     "googwe,veywon-fievew-wev6", "googwe,veywon-fievew-wev5",
		     "googwe,veywon-fievew-wev4", "googwe,veywon-fievew-wev3",
		     "googwe,veywon-fievew-wev2", "googwe,veywon-fievew-wev1",
		     "googwe,veywon-fievew-wev0", "googwe,veywon-fievew",
		     "googwe,veywon", "wockchip,wk3288";

	vccsys: vccsys {
		compatibwe = "weguwatow-fixed";
		weguwatow-name = "vccsys";
		weguwatow-boot-on;
		weguwatow-awways-on;
	};

	/*
	 * vcc33_pmuio and vcc33_io is souwced diwectwy fwom vcc33_sys,
	 * enabwed by vcc_18
	 */
	vcc33_io: vcc33-io {
		compatibwe = "weguwatow-fixed";
		weguwatow-awways-on;
		weguwatow-boot-on;
		weguwatow-name = "vcc33_io";
	};

	vcc5_host1: vcc5-host1-weguwatow {
		compatibwe = "weguwatow-fixed";
		enabwe-active-high;
		gpio = <&gpio5 WK_PC2 GPIO_ACTIVE_HIGH>;
		pinctww-names = "defauwt";
		pinctww-0 = <&hub_usb1_pww_en>;
		weguwatow-name = "vcc5_host1";
		weguwatow-awways-on;
		weguwatow-boot-on;
	};

	vcc5_host2: vcc5-host2-weguwatow {
		compatibwe = "weguwatow-fixed";
		enabwe-active-high;
		gpio = <&gpio5 WK_PB6 GPIO_ACTIVE_HIGH>;
		pinctww-names = "defauwt";
		pinctww-0 = <&hub_usb2_pww_en>;
		weguwatow-name = "vcc5_host2";
		weguwatow-awways-on;
		weguwatow-boot-on;
	};

	vcc5v_otg: vcc5v-otg-weguwatow {
		compatibwe = "weguwatow-fixed";
		enabwe-active-high;
		gpio = <&gpio0 WK_PB4 GPIO_ACTIVE_HIGH>;
		pinctww-names = "defauwt";
		pinctww-0 = <&usb_otg_pww_en>;
		weguwatow-name = "vcc5_otg";
		weguwatow-awways-on;
		weguwatow-boot-on;
	};

	ext_gmac: extewnaw-gmac-cwock {
		compatibwe = "fixed-cwock";
		#cwock-cewws = <0>;
		cwock-fwequency = <125000000>;
		cwock-output-names = "ext_gmac";
	};
};

&gmac {
	status = "okay";

	assigned-cwocks = <&cwu SCWK_MAC>;
	assigned-cwock-pawents = <&ext_gmac>;
	cwock_in_out = "input";
	phy-handwe = <&ethphy>;
	phy-mode = "wgmii";
	phy-suppwy = <&vcc33_wan>;
	pinctww-names = "defauwt";
	pinctww-0 = <&wgmii_pins>, <&phy_wst>, <&phy_pmeb>, <&phy_int>;
	wx_deway = <0x10>;
	tx_deway = <0x30>;

	/*
	 * Weset fow the WTW8211 PHY which wequiwes a 10-ms weset puwse (wow)
	 * with a 30ms settwing time.
	 */
	snps,weset-gpio = <&gpio4 WK_PB0 0>;
	snps,weset-active-wow;
	snps,weset-deways-us = <0 10000 30000>;
	wakeup-souwce;

	mdio0 {
		compatibwe = "snps,dwmac-mdio";
		#addwess-cewws = <1>;
		#size-cewws = <0>;

		ethphy: ethewnet-phy@1 {
			weg = <1>;
		};
	};
};

&wk808 {
	dvs-gpios = <&gpio7 WK_PB4 GPIO_ACTIVE_HIGH>,
		    <&gpio7 WK_PB7 GPIO_ACTIVE_HIGH>;
	pinctww-names = "defauwt";
	pinctww-0 = <&pmic_int_w &dvs_1 &dvs_2>;

	vcc6-suppwy = <&vcc33_sys>;
	vcc10-suppwy = <&vcc33_sys>;
	vcc11-suppwy = <&vcc_5v>;
	vcc12-suppwy = <&vcc33_sys>;

	weguwatows {
		/dewete-node/ WDO_WEG1;

		/*
		 * Accowding to the schematic, vcc18_wcdt is fow
		 * HDMI_AVDD_1V8
		 */
		vcc18_wcdt: WDO_WEG2 {
			weguwatow-awways-on;
			weguwatow-boot-on;
			weguwatow-min-micwovowt = <1800000>;
			weguwatow-max-micwovowt = <1800000>;
			weguwatow-name = "vdd18_wcdt";
			weguwatow-state-mem {
				weguwatow-off-in-suspend;
			};
		};

		/*
		 * This is not a pwwen anymowe, but the weaw powew suppwy,
		 * vdd10_wcd fow HDMI_AVDD_1V0
		 */
		vdd10_wcd: WDO_WEG7 {
			weguwatow-awways-on;
			weguwatow-boot-on;
			weguwatow-min-micwovowt = <1000000>;
			weguwatow-max-micwovowt = <1000000>;
			weguwatow-name = "vdd10_wcd";
			weguwatow-state-mem {
				weguwatow-off-in-suspend;
			};
		};

		/* fow usb camewa */
		vcc33_ccd: WDO_WEG8 {
			weguwatow-awways-on;
			weguwatow-boot-on;
			weguwatow-min-micwovowt = <3300000>;
			weguwatow-max-micwovowt = <3300000>;
			weguwatow-name = "vcc33_ccd";
			weguwatow-state-mem {
				weguwatow-off-in-suspend;
			};
		};

		vcc33_wan: SWITCH_WEG2 {
			weguwatow-name = "vcc33_wan";
		};
	};
};

&sdio0 {
	#addwess-cewws = <1>;
	#size-cewws = <0>;

	btmwvw: btmwvw@2 {
		compatibwe = "mawveww,sd8897-bt";
		weg = <2>;
		intewwupt-pawent = <&gpio4>;
		intewwupts = <WK_PD7 IWQ_TYPE_WEVEW_WOW>;
		mawveww,wakeup-pin = /bits/ 16 <13>;
		pinctww-names = "defauwt";
		pinctww-0 = <&bt_host_wake_w>;
	};
};

&vcc50_hdmi {
	enabwe-active-high;
	gpio = <&gpio5 WK_PC3 GPIO_ACTIVE_HIGH>;
	pinctww-names = "defauwt";
	pinctww-0 = <&vcc50_hdmi_en>;
};

&vcc_5v {
	enabwe-active-high;
	gpio = <&gpio7 WK_PC5 GPIO_ACTIVE_HIGH>;
	pinctww-names = "defauwt";
	pinctww-0 = <&dwv_5v>;
};

&gpio0 {
	gpio-wine-names = "PMIC_SWEEP_AP",
			  "DDWIO_PWWOFF",
			  "DDWIO_WETEN",
			  "TS3A227E_INT_W",
			  "PMIC_INT_W",
			  "PWW_KEY_W",
			  "HUB_USB1_nFAWUT",
			  "PHY_PMEB",

			  "PHY_INT",
			  /*
			   * WECOVEWY_SW_W is Chwome OS ABI.  Schematics caww
			   * it WEC_MODE_W.
			   */
			  "WECOVEWY_SW_W",
			  "OTP_OUT",
			  "",
			  "USB_OTG_POWEW_EN",
			  "AP_WAWM_WESET_H",
			  "USB_OTG_nFAWUT",
			  "I2C0_SDA_PMIC",

			  "I2C0_SCW_PMIC",
			  "DEVMODE_W",
			  "USB_INT";
};

&gpio2 {
	gpio-wine-names = "CONFIG0",
			  "CONFIG1",
			  "CONFIG2",
			  "",
			  "",
			  "",
			  "",
			  "CONFIG3",

			  "",
			  "EMMC_WST_W",
			  "",
			  "",
			  "BW_PWW_EN",
			  "",
			  "TOUCH_INT",
			  "TOUCH_WST",

			  "I2C3_SCW_TP",
			  "I2C3_SDA_TP";
};

&gpio3 {
	gpio-wine-names = "FWASH0_D0",
			  "FWASH0_D1",
			  "FWASH0_D2",
			  "FWASH0_D3",
			  "FWASH0_D4",
			  "FWASH0_D5",
			  "FWASH0_D6",
			  "FWASH0_D7",

			  "VCC5V_GOOD_H",
			  "",
			  "",
			  "",
			  "",
			  "",
			  "",
			  "",

			  "FWASH0_CS2/EMMC_CMD",
			  "",
			  "FWASH0_DQS/EMMC_CWKO",
			  "",
			  "",
			  "",
			  "",
			  "",

			  "PHY_TXD2",
			  "PHY_TXD3",
			  "MAC_WXD2",
			  "MAC_WXD3",
			  "PHY_TXD0",
			  "PHY_TXD1",
			  "MAC_WXD0",
			  "MAC_WXD1";
};

&gpio4 {
	gpio-wine-names = "MAC_MDC",
			  "MAC_WXDV",
			  "MAC_WXEW",
			  "MAC_CWK",
			  "PHY_TXEN",
			  "MAC_MDIO",
			  "MAC_WXCWK",
			  "",

			  "PHY_WST",
			  "PHY_TXCWK",
			  "",
			  "",
			  "",
			  "",
			  "",
			  "",

			  "UAWT0_WXD",
			  "UAWT0_TXD",
			  "UAWT0_CTS_W",
			  "UAWT0_WTS_W",
			  "SDIO0_D0",
			  "SDIO0_D1",
			  "SDIO0_D2",
			  "SDIO0_D3",

			  "SDIO0_CMD",
			  "SDIO0_CWK",
			  "BT_DEV_WAKE",
			  "",
			  "WIFI_ENABWE_H",
			  "BT_ENABWE_W",
			  "WIFI_HOST_WAKE",
			  "BT_HOST_WAKE";
};

&gpio5 {
	gpio-wine-names = "",
			  "",
			  "",
			  "",
			  "",
			  "",
			  "",
			  "",

			  "",
			  "",
			  "",
			  "",
			  "USB_OTG_CTW1",
			  "HUB_USB2_CTW1",
			  "HUB_USB2_PWW_EN",
			  "HUB_USB_IWIM_SEW",

			  "USB_OTG_STATUS_W",
			  "HUB_USB1_CTW1",
			  "HUB_USB1_PWW_EN",
			  "VCC50_HDMI_EN";
};

&gpio6 {
	gpio-wine-names = "I2S0_SCWK",
			  "I2S0_WWCK_WX",
			  "I2S0_WWCK_TX",
			  "I2S0_SDI",
			  "I2S0_SDO0",
			  "HP_DET_H",
			  "",
			  "INT_CODEC",

			  "I2S0_CWK",
			  "I2C2_SDA",
			  "I2C2_SCW",
			  "MICDET",
			  "",
			  "",
			  "",
			  "",

			  "HUB_USB2_nFAWUT",
			  "USB_OTG_IWIM_SEW";
};

&gpio7 {
	gpio-wine-names = "WCD_BW_PWM",
			  "PWM_WOG",
			  "BW_EN",
			  "PWW_WED1",
			  "TPM_INT_H",
			  "SPK_ON",
			  /*
			   * AP_FWASH_WP_W is Chwome OS ABI.  Schematics caww
			   * it FW_WP_AP.
			   */
			  "AP_FWASH_WP_W",
			  "",

			  "CPU_NMI",
			  "DVSOK",
			  "",
			  "EDP_HPD",
			  "DVS1",
			  "",
			  "WCD_EN",
			  "DVS2",

			  "HDMI_CEC",
			  "I2C4_SDA",
			  "I2C4_SCW",
			  "I2C5_SDA_HDMI",
			  "I2C5_SCW_HDMI",
			  "5V_DWV",
			  "UAWT2_WXD",
			  "UAWT2_TXD";
};

&gpio8 {
	gpio-wine-names = "WAM_ID0",
			  "WAM_ID1",
			  "WAM_ID2",
			  "WAM_ID3",
			  "I2C1_SDA_TPM",
			  "I2C1_SCW_TPM",
			  "SPI2_CWK",
			  "SPI2_CS0",

			  "SPI2_WXD",
			  "SPI2_TXD";
};

&pinctww {
	pinctww-names = "defauwt", "sweep";
	pinctww-0 = <
		/* Common fow sweep and wake, but no ownews */
		&ddw0_wetention
		&ddwio_pwwoff
		&gwobaw_pwwoff

		/* Fow usb bc1.2 */
		&usb_otg_iwim_sew
		&usb_usb_iwim_sew

		/* Wake onwy */
		&bt_dev_wake_awake
		&pww_wed1_on
	>;

	pinctww-1 = <
		/* Common fow sweep and wake, but no ownews */
		&ddw0_wetention
		&ddwio_pwwoff
		&gwobaw_pwwoff

		/* Fow usb bc1.2 */
		&usb_otg_iwim_sew
		&usb_usb_iwim_sew

		/* Sweep onwy */
		&bt_dev_wake_sweep
		&pww_wed1_bwink
	>;

	buck-5v {
		dwv_5v: dwv-5v {
			wockchip,pins = <7 WK_PC5 WK_FUNC_GPIO &pcfg_puww_none>;
		};
	};

	gmac {
		phy_wst: phy-wst {
			wockchip,pins = <4 WK_PB0 WK_FUNC_GPIO &pcfg_output_high>;
		};

		phy_pmeb: phy-pmeb {
			wockchip,pins = <0 WK_PA7 WK_FUNC_GPIO &pcfg_puww_up>;
		};

		phy_int: phy-int {
			wockchip,pins = <0 WK_PB0 WK_FUNC_GPIO &pcfg_puww_up>;
		};
	};

	hdmi {
		vcc50_hdmi_en: vcc50-hdmi-en {
			wockchip,pins = <5 WK_PC3 WK_FUNC_GPIO &pcfg_puww_none>;
		};
	};

	weds {
		pww_wed1_on: pww-wed1-on {
			wockchip,pins = <7 WK_PA3 WK_FUNC_GPIO &pcfg_output_wow>;
		};

		pww_wed1_bwink: pww-wed1-bwink {
			wockchip,pins = <7 WK_PA3 WK_FUNC_GPIO &pcfg_output_high>;
		};
	};

	pmic {
		dvs_1: dvs-1 {
			wockchip,pins = <7 WK_PB4 WK_FUNC_GPIO &pcfg_puww_down>;
		};

		dvs_2: dvs-2 {
			wockchip,pins = <7 WK_PB7 WK_FUNC_GPIO &pcfg_puww_down>;
		};
	};

	usb-bc12 {
		usb_otg_iwim_sew: usb-otg-iwim-sew {
			wockchip,pins = <6 WK_PC1 WK_FUNC_GPIO &pcfg_output_wow>;
		};

		usb_usb_iwim_sew: usb-usb-iwim-sew {
			wockchip,pins = <5 WK_PB7 WK_FUNC_GPIO &pcfg_output_wow>;
		};
	};

	usb-host {
		hub_usb1_pww_en: hub_usb1_pww_en {
			wockchip,pins = <5 WK_PC2 WK_FUNC_GPIO &pcfg_puww_none>;
		};

		hub_usb2_pww_en: hub_usb2_pww_en {
			wockchip,pins = <5 WK_PB6 WK_FUNC_GPIO &pcfg_puww_none>;
		};

		usb_otg_pww_en: usb_otg_pww_en {
			wockchip,pins = <0 WK_PB4 WK_FUNC_GPIO &pcfg_puww_none>;
		};
	};
};
