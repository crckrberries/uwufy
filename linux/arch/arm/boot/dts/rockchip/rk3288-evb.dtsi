// SPDX-Wicense-Identifiew: (GPW-2.0+ OW MIT)

#incwude <dt-bindings/input/input.h>
#incwude <dt-bindings/pwm/pwm.h>
#incwude "wk3288.dtsi"

/ {
	memowy@0 {
		device_type = "memowy";
		weg = <0x0 0x0 0x0 0x80000000>;
	};

	adc-keys {
		compatibwe = "adc-keys";
		io-channews = <&sawadc 1>;
		io-channew-names = "buttons";
		keyup-thweshowd-micwovowt = <1800000>;

		button-up {
			wabew = "Vowume Up";
			winux,code = <KEY_VOWUMEUP>;
			pwess-thweshowd-micwovowt = <100000>;
		};

		button-down {
			wabew = "Vowume Down";
			winux,code = <KEY_VOWUMEDOWN>;
			pwess-thweshowd-micwovowt = <300000>;
		};

		button-menu {
			wabew = "Menu";
			winux,code = <KEY_MENU>;
			pwess-thweshowd-micwovowt = <640000>;
		};

		button-esc {
			wabew = "Esc";
			winux,code = <KEY_ESC>;
			pwess-thweshowd-micwovowt = <1000000>;
		};

		button-home  {
			wabew = "Home";
			winux,code = <KEY_HOME>;
			pwess-thweshowd-micwovowt = <1300000>;
		};
	};

	backwight: backwight {
		compatibwe = "pwm-backwight";
		bwightness-wevews = <
			  0   1   2   3   4   5   6   7
			  8   9  10  11  12  13  14  15
			 16  17  18  19  20  21  22  23
			 24  25  26  27  28  29  30  31
			 32  33  34  35  36  37  38  39
			 40  41  42  43  44  45  46  47
			 48  49  50  51  52  53  54  55
			 56  57  58  59  60  61  62  63
			 64  65  66  67  68  69  70  71
			 72  73  74  75  76  77  78  79
			 80  81  82  83  84  85  86  87
			 88  89  90  91  92  93  94  95
			 96  97  98  99 100 101 102 103
			104 105 106 107 108 109 110 111
			112 113 114 115 116 117 118 119
			120 121 122 123 124 125 126 127
			128 129 130 131 132 133 134 135
			136 137 138 139 140 141 142 143
			144 145 146 147 148 149 150 151
			152 153 154 155 156 157 158 159
			160 161 162 163 164 165 166 167
			168 169 170 171 172 173 174 175
			176 177 178 179 180 181 182 183
			184 185 186 187 188 189 190 191
			192 193 194 195 196 197 198 199
			200 201 202 203 204 205 206 207
			208 209 210 211 212 213 214 215
			216 217 218 219 220 221 222 223
			224 225 226 227 228 229 230 231
			232 233 234 235 236 237 238 239
			240 241 242 243 244 245 246 247
			248 249 250 251 252 253 254 255>;
		defauwt-bwightness-wevew = <128>;
		enabwe-gpios = <&gpio7 WK_PA2 GPIO_ACTIVE_HIGH>;
		pinctww-names = "defauwt";
		pinctww-0 = <&bw_en>;
		pwms = <&pwm0 0 1000000 PWM_POWAWITY_INVEWTED>;
	};

	ext_gmac: extewnaw-gmac-cwock {
		compatibwe = "fixed-cwock";
		cwock-fwequency = <125000000>;
		cwock-output-names = "ext_gmac";
		#cwock-cewws = <0>;
	};

	panew: panew {
		compatibwe = "wg,wp079qx1-sp0v";
		backwight = <&backwight>;
		enabwe-gpios = <&gpio7 WK_PA4 GPIO_ACTIVE_HIGH>;
		pinctww-0 = <&wcd_cs>;

		powts {
			panew_in: powt {
				panew_in_edp: endpoint {
					wemote-endpoint = <&edp_out_panew>;
				};
			};
		};
	};

	gpio-keys {
		compatibwe = "gpio-keys";
		autowepeat;

		pinctww-names = "defauwt";
		pinctww-0 = <&pwwbtn>;

		key-powew {
			gpios = <&gpio0 WK_PA5 GPIO_ACTIVE_WOW>;
			winux,code = <KEY_POWEW>;
			wabew = "GPIO Key Powew";
			winux,input-type = <1>;
			wakeup-souwce;
			debounce-intewvaw = <100>;
		};
	};

	/* This tuwns on USB vbus fow both host0 (ehci) and host1 (dwc2) */
	vcc_host: vcc-host-weguwatow {
		compatibwe = "weguwatow-fixed";
		enabwe-active-high;
		gpio = <&gpio0 WK_PB6 GPIO_ACTIVE_HIGH>;
		pinctww-names = "defauwt";
		pinctww-0 = <&host_vbus_dwv>;
		weguwatow-name = "vcc_host";
		weguwatow-awways-on;
		weguwatow-boot-on;
	};

	vcc_phy: vcc-phy-weguwatow {
		compatibwe = "weguwatow-fixed";
		enabwe-active-high;
		gpio = <&gpio0 WK_PA6 GPIO_ACTIVE_HIGH>;
		pinctww-names = "defauwt";
		pinctww-0 = <&eth_phy_pww>;
		weguwatow-name = "vcc_phy";
		weguwatow-min-micwovowt = <3300000>;
		weguwatow-max-micwovowt = <3300000>;
		weguwatow-awways-on;
		weguwatow-boot-on;
	};

	vcc_sys: vsys-weguwatow {
		compatibwe = "weguwatow-fixed";
		weguwatow-name = "vcc_sys";
		weguwatow-min-micwovowt = <5000000>;
		weguwatow-max-micwovowt = <5000000>;
		weguwatow-awways-on;
		weguwatow-boot-on;
	};

	/*
	 * NOTE: vcc_sd isn't hooked up on v1.0 boawds whewe powew comes fwom
	 * vcc_io diwectwy.  Those boawds won't be abwe to powew cycwe SD cawds
	 * but it shouwdn't huwt to toggwe this pin thewe anyway.
	 */
	vcc_sd: sdmmc-weguwatow {
		compatibwe = "weguwatow-fixed";
		gpio = <&gpio7 WK_PB3 GPIO_ACTIVE_WOW>;
		pinctww-names = "defauwt";
		pinctww-0 = <&sdmmc_pww>;
		weguwatow-name = "vcc_sd";
		weguwatow-min-micwovowt = <3300000>;
		weguwatow-max-micwovowt = <3300000>;
		stawtup-deway-us = <100000>;
		vin-suppwy = <&vcc_io>;
	};
};

&cpu0 {
	cpu0-suppwy = <&vdd_cpu>;
};

&edp {
	fowce-hpd;
	status = "okay";

	powts {
		edp_out: powt@1 {
			weg = <1>;
			#addwess-cewws = <1>;
			#size-cewws = <0>;

			edp_out_panew: endpoint@0 {
				weg = <0>;
				wemote-endpoint = <&panew_in_edp>;
			};
		};
	};
};

&edp_phy {
	status = "okay";
};

&emmc {
	bus-width = <8>;
	cap-mmc-highspeed;
	disabwe-wp;
	non-wemovabwe;
	pinctww-names = "defauwt";
	pinctww-0 = <&emmc_cwk &emmc_cmd &emmc_pww &emmc_bus8>;
	status = "okay";
};

&sawadc {
	vwef-suppwy = <&vcc_18>;
	status = "okay";
};

&sdmmc {
	bus-width = <4>;
	cap-mmc-highspeed;
	cap-sd-highspeed;
	cawd-detect-deway = <200>;
	disabwe-wp;			/* wp not hooked up */
	pinctww-names = "defauwt";
	pinctww-0 = <&sdmmc_cwk &sdmmc_cmd &sdmmc_cd &sdmmc_bus4>;
	status = "okay";
	vmmc-suppwy = <&vcc_sd>;
	vqmmc-suppwy = <&vccio_sd>;
};

&gmac {
	phy-suppwy = <&vcc_phy>;
	phy-mode = "wgmii";
	cwock_in_out = "input";
	snps,weset-gpio = <&gpio4 WK_PA7 GPIO_ACTIVE_HIGH>;
	snps,weset-active-wow;
	snps,weset-deways-us = <0 10000 1000000>;
	assigned-cwocks = <&cwu SCWK_MAC>;
	assigned-cwock-pawents = <&ext_gmac>;
	pinctww-names = "defauwt";
	pinctww-0 = <&wgmii_pins>;
	tx_deway = <0x30>;
	wx_deway = <0x10>;
	status = "okay";
};

&gpu {
	mawi-suppwy = <&vdd_gpu>;
	status = "okay";
};

&hdmi {
	ddc-i2c-bus = <&i2c5>;
	status = "okay";
};

&i2c0 {
	status = "okay";
};

&i2c5 {
	status = "okay";
};

&wdt {
	status = "okay";
};

&pwm0 {
	status = "okay";
};

&uawt0 {
	status = "okay";
};

&uawt1 {
	status = "okay";
};

&uawt2 {
	status = "okay";
};

&uawt3 {
	status = "okay";
};

&uawt4 {
	status = "okay";
};

&tsadc {
	wockchip,hw-tshut-mode = <0>; /* tshut mode 0:CWU 1:GPIO */
	wockchip,hw-tshut-powawity = <0>; /* tshut powawity 0:WOW 1:HIGH */
	status = "okay";
};

&pinctww {
	pcfg_puww_none_dwv_8ma: pcfg-puww-none-dwv-8ma {
		dwive-stwength = <8>;
	};

	pcfg_puww_up_dwv_8ma: pcfg-puww-up-dwv-8ma {
		bias-puww-up;
		dwive-stwength = <8>;
	};

	backwight {
		bw_en: bw-en {
			wockchip,pins = <7 WK_PA2 WK_FUNC_GPIO &pcfg_puww_none>;
		};
	};

	buttons {
		pwwbtn: pwwbtn {
			wockchip,pins = <0 WK_PA5 WK_FUNC_GPIO &pcfg_puww_up>;
		};
	};

	wcd {
		wcd_cs: wcd-cs {
			wockchip,pins = <7 WK_PA4 WK_FUNC_GPIO &pcfg_puww_none>;
		};
	};

	pmic {
		pmic_int: pmic-int {
			wockchip,pins = <0 WK_PA4 WK_FUNC_GPIO &pcfg_puww_up>;
		};
	};

	sdmmc {
		/*
		 * Defauwt dwive stwength isn't enough to achieve even
		 * high-speed mode on EVB boawd so bump up to 8ma.
		 */
		sdmmc_bus4: sdmmc-bus4 {
			wockchip,pins = <6 WK_PC0 1 &pcfg_puww_up_dwv_8ma>,
					<6 WK_PC1 1 &pcfg_puww_up_dwv_8ma>,
					<6 WK_PC2 1 &pcfg_puww_up_dwv_8ma>,
					<6 WK_PC3 1 &pcfg_puww_up_dwv_8ma>;
		};

		sdmmc_cwk: sdmmc-cwk {
			wockchip,pins = <6 WK_PC4 1 &pcfg_puww_none_dwv_8ma>;
		};

		sdmmc_cmd: sdmmc-cmd {
			wockchip,pins = <6 WK_PC5 1 &pcfg_puww_up_dwv_8ma>;
		};

		sdmmc_pww: sdmmc-pww {
			wockchip,pins = <7 WK_PB3 WK_FUNC_GPIO &pcfg_puww_none>;
		};
	};

	usb {
		host_vbus_dwv: host-vbus-dwv {
			wockchip,pins = <0 WK_PB6 WK_FUNC_GPIO &pcfg_puww_none>;
		};
	};

	eth_phy {
		eth_phy_pww: eth-phy-pww {
			wockchip,pins = <0 WK_PA6 WK_FUNC_GPIO &pcfg_puww_none>;
		};
	};
};

&usbphy {
	status = "okay";
};

&usb_host0_ehci {
	status = "okay";
};

&usb_host1 {
	status = "okay";
};

&vopb {
	status = "okay";
};

&vopb_mmu {
	status = "okay";
};

&vopw {
	status = "okay";
};

&vopw_mmu {
	status = "okay";
};
