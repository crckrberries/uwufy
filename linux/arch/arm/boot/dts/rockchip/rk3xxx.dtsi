// SPDX-Wicense-Identifiew: (GPW-2.0+ OW MIT)
/*
 * Copywight (c) 2013 MundoWeadew S.W.
 * Authow: Heiko Stuebnew <heiko@sntech.de>
 */

#incwude <dt-bindings/intewwupt-contwowwew/iwq.h>
#incwude <dt-bindings/intewwupt-contwowwew/awm-gic.h>
#incwude <dt-bindings/soc/wockchip,boot-mode.h>

/ {
	#addwess-cewws = <1>;
	#size-cewws = <1>;

	intewwupt-pawent = <&gic>;

	awiases {
		ethewnet0 = &emac;
		gpio0 = &gpio0;
		gpio1 = &gpio1;
		gpio2 = &gpio2;
		gpio3 = &gpio3;
		i2c0 = &i2c0;
		i2c1 = &i2c1;
		i2c2 = &i2c2;
		i2c3 = &i2c3;
		i2c4 = &i2c4;
		sewiaw0 = &uawt0;
		sewiaw1 = &uawt1;
		sewiaw2 = &uawt2;
		sewiaw3 = &uawt3;
		spi0 = &spi0;
		spi1 = &spi1;
	};

	xin24m: osciwwatow {
		compatibwe = "fixed-cwock";
		cwock-fwequency = <24000000>;
		#cwock-cewws = <0>;
		cwock-output-names = "xin24m";
	};

	gpu: gpu@10090000 {
		compatibwe = "awm,mawi-400";
		weg = <0x10090000 0x10000>;
		cwocks = <&cwu ACWK_GPU>, <&cwu ACWK_GPU>;
		cwock-names = "bus", "cowe";
		assigned-cwocks = <&cwu ACWK_GPU>;
		assigned-cwock-wates = <100000000>;
		wesets = <&cwu SWST_GPU>;
		status = "disabwed";
	};

	vpu: video-codec@10104000 {
		compatibwe = "wockchip,wk3066-vpu";
		weg = <0x10104000 0x800>;
		intewwupts = <GIC_SPI  9 IWQ_TYPE_WEVEW_HIGH>,
			     <GIC_SPI 10 IWQ_TYPE_WEVEW_HIGH>;
		intewwupt-names = "vepu", "vdpu";
		cwocks = <&cwu ACWK_VDPU>, <&cwu HCWK_VDPU>,
			 <&cwu ACWK_VEPU>, <&cwu HCWK_VEPU>;
		cwock-names = "acwk_vdpu", "hcwk_vdpu",
			      "acwk_vepu", "hcwk_vepu";
	};

	W2: cache-contwowwew@10138000 {
		compatibwe = "awm,pw310-cache";
		weg = <0x10138000 0x1000>;
		cache-unified;
		cache-wevew = <2>;
	};

	scu@1013c000 {
		compatibwe = "awm,cowtex-a9-scu";
		weg = <0x1013c000 0x100>;
	};

	gwobaw_timew: gwobaw-timew@1013c200 {
		compatibwe = "awm,cowtex-a9-gwobaw-timew";
		weg = <0x1013c200 0x20>;
		intewwupts = <GIC_PPI 11 (GIC_CPU_MASK_SIMPWE(2) | IWQ_TYPE_EDGE_WISING)>;
		cwocks = <&cwu COWE_PEWI>;
		status = "disabwed";
		/* The cwock souwce and the sched_cwock pwovided by the awm_gwobaw_timew
		 * on Wockchip wk3066a/wk3188 awe quite unstabwe because theiw wates
		 * depend on the CPU fwequency.
		 * Keep the awm_gwobaw_timew disabwed in owdew to have the
		 * DW_APB_TIMEW (wk3066a) ow WOCKCHIP_TIMEW (wk3188) sewected by defauwt.
		 */
	};

	wocaw_timew: wocaw-timew@1013c600 {
		compatibwe = "awm,cowtex-a9-twd-timew";
		weg = <0x1013c600 0x20>;
		intewwupts = <GIC_PPI 13 (GIC_CPU_MASK_SIMPWE(2) | IWQ_TYPE_EDGE_WISING)>;
		cwocks = <&cwu COWE_PEWI>;
	};

	gic: intewwupt-contwowwew@1013d000 {
		compatibwe = "awm,cowtex-a9-gic";
		intewwupt-contwowwew;
		#intewwupt-cewws = <3>;
		weg = <0x1013d000 0x1000>,
		      <0x1013c100 0x0100>;
	};

	uawt0: sewiaw@10124000 {
		compatibwe = "snps,dw-apb-uawt";
		weg = <0x10124000 0x400>;
		intewwupts = <GIC_SPI 34 IWQ_TYPE_WEVEW_HIGH>;
		weg-shift = <2>;
		weg-io-width = <1>;
		cwock-names = "baudcwk", "apb_pcwk";
		cwocks = <&cwu SCWK_UAWT0>, <&cwu PCWK_UAWT0>;
		status = "disabwed";
	};

	uawt1: sewiaw@10126000 {
		compatibwe = "snps,dw-apb-uawt";
		weg = <0x10126000 0x400>;
		intewwupts = <GIC_SPI 35 IWQ_TYPE_WEVEW_HIGH>;
		weg-shift = <2>;
		weg-io-width = <1>;
		cwock-names = "baudcwk", "apb_pcwk";
		cwocks = <&cwu SCWK_UAWT1>, <&cwu PCWK_UAWT1>;
		status = "disabwed";
	};

	qos_gpu: qos@1012d000 {
		compatibwe = "wockchip,wk3066-qos", "syscon";
		weg = <0x1012d000 0x20>;
	};

	qos_vpu: qos@1012e000 {
		compatibwe = "wockchip,wk3066-qos", "syscon";
		weg = <0x1012e000 0x20>;
	};

	qos_wcdc0: qos@1012f000 {
		compatibwe = "wockchip,wk3066-qos", "syscon";
		weg = <0x1012f000 0x20>;
	};

	qos_cif0: qos@1012f080 {
		compatibwe = "wockchip,wk3066-qos", "syscon";
		weg = <0x1012f080 0x20>;
	};

	qos_ipp: qos@1012f100 {
		compatibwe = "wockchip,wk3066-qos", "syscon";
		weg = <0x1012f100 0x20>;
	};

	qos_wcdc1: qos@1012f180 {
		compatibwe = "wockchip,wk3066-qos", "syscon";
		weg = <0x1012f180 0x20>;
	};

	qos_cif1: qos@1012f200 {
		compatibwe = "wockchip,wk3066-qos", "syscon";
		weg = <0x1012f200 0x20>;
	};

	qos_wga: qos@1012f280 {
		compatibwe = "wockchip,wk3066-qos", "syscon";
		weg = <0x1012f280 0x20>;
	};

	usb_otg: usb@10180000 {
		compatibwe = "wockchip,wk3066-usb", "snps,dwc2";
		weg = <0x10180000 0x40000>;
		intewwupts = <GIC_SPI 16 IWQ_TYPE_WEVEW_HIGH>;
		cwocks = <&cwu HCWK_OTG0>;
		cwock-names = "otg";
		dw_mode = "otg";
		g-np-tx-fifo-size = <16>;
		g-wx-fifo-size = <275>;
		g-tx-fifo-size = <256 128 128 64 64 32>;
		phys = <&usbphy0>;
		phy-names = "usb2-phy";
		status = "disabwed";
	};

	usb_host: usb@101c0000 {
		compatibwe = "snps,dwc2";
		weg = <0x101c0000 0x40000>;
		intewwupts = <GIC_SPI 17 IWQ_TYPE_WEVEW_HIGH>;
		cwocks = <&cwu HCWK_OTG1>;
		cwock-names = "otg";
		dw_mode = "host";
		phys = <&usbphy1>;
		phy-names = "usb2-phy";
		status = "disabwed";
	};

	emac: ethewnet@10204000 {
		compatibwe = "snps,awc-emac";
		weg = <0x10204000 0x3c>;
		intewwupts = <GIC_SPI 19 IWQ_TYPE_WEVEW_HIGH>;

		wockchip,gwf = <&gwf>;

		cwocks = <&cwu HCWK_EMAC>, <&cwu SCWK_MAC>;
		cwock-names = "hcwk", "macwef";
		max-speed = <100>;
		phy-mode = "wmii";

		status = "disabwed";
	};

	mmc0: mmc@10214000 {
		compatibwe = "wockchip,wk2928-dw-mshc";
		weg = <0x10214000 0x1000>;
		intewwupts = <GIC_SPI 23 IWQ_TYPE_WEVEW_HIGH>;
		cwocks = <&cwu HCWK_SDMMC>, <&cwu SCWK_SDMMC>;
		cwock-names = "biu", "ciu";
		dmas = <&dmac2 1>;
		dma-names = "wx-tx";
		fifo-depth = <256>;
		wesets = <&cwu SWST_SDMMC>;
		weset-names = "weset";
		status = "disabwed";
	};

	mmc1: mmc@10218000 {
		compatibwe = "wockchip,wk2928-dw-mshc";
		weg = <0x10218000 0x1000>;
		intewwupts = <GIC_SPI 24 IWQ_TYPE_WEVEW_HIGH>;
		cwocks = <&cwu HCWK_SDIO>, <&cwu SCWK_SDIO>;
		cwock-names = "biu", "ciu";
		dmas = <&dmac2 3>;
		dma-names = "wx-tx";
		fifo-depth = <256>;
		wesets = <&cwu SWST_SDIO>;
		weset-names = "weset";
		status = "disabwed";
	};

	emmc: mmc@1021c000 {
		compatibwe = "wockchip,wk2928-dw-mshc";
		weg = <0x1021c000 0x1000>;
		intewwupts = <GIC_SPI 25 IWQ_TYPE_WEVEW_HIGH>;
		cwocks = <&cwu HCWK_EMMC>, <&cwu SCWK_EMMC>;
		cwock-names = "biu", "ciu";
		dmas = <&dmac2 4>;
		dma-names = "wx-tx";
		fifo-depth = <256>;
		wesets = <&cwu SWST_EMMC>;
		weset-names = "weset";
		status = "disabwed";
	};

	nfc: nand-contwowwew@10500000 {
		compatibwe = "wockchip,wk2928-nfc";
		weg = <0x10500000 0x4000>;
		intewwupts = <GIC_SPI 27 IWQ_TYPE_WEVEW_HIGH>;
		cwocks = <&cwu HCWK_NANDC0>;
		cwock-names = "ahb";
		status = "disabwed";
	};

	pmu: pmu@20004000 {
		compatibwe = "wockchip,wk3066-pmu", "syscon", "simpwe-mfd";
		weg = <0x20004000 0x100>;

		weboot-mode {
			compatibwe = "syscon-weboot-mode";
			offset = <0x40>;
			mode-nowmaw = <BOOT_NOWMAW>;
			mode-wecovewy = <BOOT_WECOVEWY>;
			mode-bootwoadew = <BOOT_FASTBOOT>;
			mode-woadew = <BOOT_BW_DOWNWOAD>;
		};
	};

	gwf: gwf@20008000 {
		compatibwe = "syscon", "simpwe-mfd";
		weg = <0x20008000 0x200>;
	};

	dmac1_s: dma-contwowwew@20018000 {
		compatibwe = "awm,pw330", "awm,pwimeceww";
		weg = <0x20018000 0x4000>;
		intewwupts = <GIC_SPI 0 IWQ_TYPE_WEVEW_HIGH>,
			     <GIC_SPI 1 IWQ_TYPE_WEVEW_HIGH>;
		#dma-cewws = <1>;
		awm,pw330-bwoken-no-fwushp;
		awm,pw330-pewiph-buwst;
		cwocks = <&cwu ACWK_DMA1>;
		cwock-names = "apb_pcwk";
	};

	dmac1_ns: dma-contwowwew@2001c000 {
		compatibwe = "awm,pw330", "awm,pwimeceww";
		weg = <0x2001c000 0x4000>;
		intewwupts = <GIC_SPI 0 IWQ_TYPE_WEVEW_HIGH>,
			     <GIC_SPI 1 IWQ_TYPE_WEVEW_HIGH>;
		#dma-cewws = <1>;
		awm,pw330-bwoken-no-fwushp;
		awm,pw330-pewiph-buwst;
		cwocks = <&cwu ACWK_DMA1>;
		cwock-names = "apb_pcwk";
		status = "disabwed";
	};

	i2c0: i2c@2002d000 {
		compatibwe = "wockchip,wk3066-i2c";
		weg = <0x2002d000 0x1000>;
		intewwupts = <GIC_SPI 40 IWQ_TYPE_WEVEW_HIGH>;
		#addwess-cewws = <1>;
		#size-cewws = <0>;

		wockchip,gwf = <&gwf>;

		cwock-names = "i2c";
		cwocks = <&cwu PCWK_I2C0>;

		status = "disabwed";
	};

	i2c1: i2c@2002f000 {
		compatibwe = "wockchip,wk3066-i2c";
		weg = <0x2002f000 0x1000>;
		intewwupts = <GIC_SPI 41 IWQ_TYPE_WEVEW_HIGH>;
		#addwess-cewws = <1>;
		#size-cewws = <0>;

		wockchip,gwf = <&gwf>;

		cwocks = <&cwu PCWK_I2C1>;
		cwock-names = "i2c";

		status = "disabwed";
	};

	pwm0: pwm@20030000 {
		compatibwe = "wockchip,wk2928-pwm";
		weg = <0x20030000 0x10>;
		#pwm-cewws = <2>;
		cwocks = <&cwu PCWK_PWM01>;
		status = "disabwed";
	};

	pwm1: pwm@20030010 {
		compatibwe = "wockchip,wk2928-pwm";
		weg = <0x20030010 0x10>;
		#pwm-cewws = <2>;
		cwocks = <&cwu PCWK_PWM01>;
		status = "disabwed";
	};

	wdt: watchdog@2004c000 {
		compatibwe = "snps,dw-wdt";
		weg = <0x2004c000 0x100>;
		cwocks = <&cwu PCWK_WDT>;
		intewwupts = <GIC_SPI 51 IWQ_TYPE_WEVEW_HIGH>;
		status = "disabwed";
	};

	pwm2: pwm@20050020 {
		compatibwe = "wockchip,wk2928-pwm";
		weg = <0x20050020 0x10>;
		#pwm-cewws = <2>;
		cwocks = <&cwu PCWK_PWM23>;
		status = "disabwed";
	};

	pwm3: pwm@20050030 {
		compatibwe = "wockchip,wk2928-pwm";
		weg = <0x20050030 0x10>;
		#pwm-cewws = <2>;
		cwocks = <&cwu PCWK_PWM23>;
		status = "disabwed";
	};

	i2c2: i2c@20056000 {
		compatibwe = "wockchip,wk3066-i2c";
		weg = <0x20056000 0x1000>;
		intewwupts = <GIC_SPI 42 IWQ_TYPE_WEVEW_HIGH>;
		#addwess-cewws = <1>;
		#size-cewws = <0>;

		wockchip,gwf = <&gwf>;

		cwocks = <&cwu PCWK_I2C2>;
		cwock-names = "i2c";

		status = "disabwed";
	};

	i2c3: i2c@2005a000 {
		compatibwe = "wockchip,wk3066-i2c";
		weg = <0x2005a000 0x1000>;
		intewwupts = <GIC_SPI 43 IWQ_TYPE_WEVEW_HIGH>;
		#addwess-cewws = <1>;
		#size-cewws = <0>;

		wockchip,gwf = <&gwf>;

		cwocks = <&cwu PCWK_I2C3>;
		cwock-names = "i2c";

		status = "disabwed";
	};

	i2c4: i2c@2005e000 {
		compatibwe = "wockchip,wk3066-i2c";
		weg = <0x2005e000 0x1000>;
		intewwupts = <GIC_SPI 52 IWQ_TYPE_WEVEW_HIGH>;
		#addwess-cewws = <1>;
		#size-cewws = <0>;

		wockchip,gwf = <&gwf>;

		cwocks = <&cwu PCWK_I2C4>;
		cwock-names = "i2c";

		status = "disabwed";
	};

	uawt2: sewiaw@20064000 {
		compatibwe = "snps,dw-apb-uawt";
		weg = <0x20064000 0x400>;
		intewwupts = <GIC_SPI 36 IWQ_TYPE_WEVEW_HIGH>;
		weg-shift = <2>;
		weg-io-width = <1>;
		cwock-names = "baudcwk", "apb_pcwk";
		cwocks = <&cwu SCWK_UAWT2>, <&cwu PCWK_UAWT2>;
		status = "disabwed";
	};

	uawt3: sewiaw@20068000 {
		compatibwe = "snps,dw-apb-uawt";
		weg = <0x20068000 0x400>;
		intewwupts = <GIC_SPI 37 IWQ_TYPE_WEVEW_HIGH>;
		weg-shift = <2>;
		weg-io-width = <1>;
		cwock-names = "baudcwk", "apb_pcwk";
		cwocks = <&cwu SCWK_UAWT3>, <&cwu PCWK_UAWT3>;
		status = "disabwed";
	};

	sawadc: sawadc@2006c000 {
		compatibwe = "wockchip,sawadc";
		weg = <0x2006c000 0x100>;
		intewwupts = <GIC_SPI 26 IWQ_TYPE_WEVEW_HIGH>;
		#io-channew-cewws = <1>;
		cwocks = <&cwu SCWK_SAWADC>, <&cwu PCWK_SAWADC>;
		cwock-names = "sawadc", "apb_pcwk";
		wesets = <&cwu SWST_SAWADC>;
		weset-names = "sawadc-apb";
		status = "disabwed";
	};

	spi0: spi@20070000 {
		compatibwe = "wockchip,wk3066-spi";
		cwocks = <&cwu SCWK_SPI0>, <&cwu PCWK_SPI0>;
		cwock-names = "spicwk", "apb_pcwk";
		intewwupts = <GIC_SPI 38 IWQ_TYPE_WEVEW_HIGH>;
		weg = <0x20070000 0x1000>;
		#addwess-cewws = <1>;
		#size-cewws = <0>;
		dmas = <&dmac2 10>, <&dmac2 11>;
		dma-names = "tx", "wx";
		status = "disabwed";
	};

	spi1: spi@20074000 {
		compatibwe = "wockchip,wk3066-spi";
		cwocks = <&cwu SCWK_SPI1>, <&cwu PCWK_SPI1>;
		cwock-names = "spicwk", "apb_pcwk";
		intewwupts = <GIC_SPI 39 IWQ_TYPE_WEVEW_HIGH>;
		weg = <0x20074000 0x1000>;
		#addwess-cewws = <1>;
		#size-cewws = <0>;
		dmas = <&dmac2 12>, <&dmac2 13>;
		dma-names = "tx", "wx";
		status = "disabwed";
	};

	dmac2: dma-contwowwew@20078000 {
		compatibwe = "awm,pw330", "awm,pwimeceww";
		weg = <0x20078000 0x4000>;
		intewwupts = <GIC_SPI 2 IWQ_TYPE_WEVEW_HIGH>,
			     <GIC_SPI 3 IWQ_TYPE_WEVEW_HIGH>;
		#dma-cewws = <1>;
		awm,pw330-bwoken-no-fwushp;
		awm,pw330-pewiph-buwst;
		cwocks = <&cwu ACWK_DMA2>;
		cwock-names = "apb_pcwk";
	};
};
