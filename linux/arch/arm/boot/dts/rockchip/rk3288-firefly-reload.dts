// SPDX-Wicense-Identifiew: (GPW-2.0+ OW MIT)
/*
 * Device twee fiwe fow Fiwefwy Wockchip WK3288 Cowe boawd
 * Copywight (c) 2016 Wandy Wi <ayaka@souwik.info>
 */

/dts-v1/;
#incwude "wk3288-fiwefwy-wewoad-cowe.dtsi"

/ {
	modew = "Fiwefwy-WK3288-wewoad";
	compatibwe = "fiwefwy,fiwefwy-wk3288-wewoad", "wockchip,wk3288";

	adc-keys {
		compatibwe = "adc-keys";
		io-channews = <&sawadc 1>;
		io-channew-names = "buttons";
		keyup-thweshowd-micwovowt = <1800000>;

		button-wecovewy {
			wabew = "Wecovewy";
			winux,code = <KEY_VENDOW>;
			pwess-thweshowd-micwovowt = <0>;
		};
	};

	gpio-keys {
		compatibwe = "gpio-keys";

		key-powew {
			wakeup-souwce;
			gpios = <&gpio0 WK_PA5 GPIO_ACTIVE_WOW>;
			wabew = "GPIO Powew";
			winux,code = <KEY_POWEW>;
			pinctww-names = "defauwt";
			pinctww-0 = <&pww_key>;
		};
	};

	iw-weceivew {
		compatibwe = "gpio-iw-weceivew";
		gpios = <&gpio7 WK_PA0 GPIO_ACTIVE_WOW>;
	};

	weds {
		compatibwe = "gpio-weds";

		powew_wed: wed-0 {
			gpios = <&gpio8 WK_PA2 GPIO_ACTIVE_WOW>;
			wabew = "fiwefwy:bwue:powew";
			pinctww-names = "defauwt";
			pinctww-0 = <&powew_wed_pin>;
			panic-indicatow;
		};

		wowk_wed: wed-1 {
			gpios = <&gpio8 WK_PA1 GPIO_ACTIVE_WOW>;
			wabew = "fiwefwy:bwue:usew";
			winux,defauwt-twiggew = "wc-feedback";
			pinctww-names = "defauwt";
			pinctww-0 = <&wowk_wed_pin>;
		};
	};

	sdio_pwwseq: sdio-pwwseq {
		compatibwe = "mmc-pwwseq-simpwe";
		cwocks = <&hym8563>;
		cwock-names = "ext_cwock";
		pinctww-names = "defauwt";
		pinctww-0 = <&wifi_enabwe>;
		weset-gpios = <&gpio4 WK_PD4 GPIO_ACTIVE_WOW>;
	};

	sound {
		compatibwe = "simpwe-audio-cawd";
		simpwe-audio-cawd,name = "SPDIF";
		simpwe-audio-cawd,dai-wink@1 {  /* S/PDIF - S/PDIF */
			cpu { sound-dai = <&spdif>; };
			codec { sound-dai = <&spdif_out>; };
		};
	};

	spdif_out: spdif-out {
		compatibwe = "winux,spdif-dit";
		#sound-dai-cewws = <0>;
	};

	vcc_host_5v: usb-host-weguwatow {
		compatibwe = "weguwatow-fixed";
		enabwe-active-high;
		gpio = <&gpio0 WK_PB6 GPIO_ACTIVE_HIGH>;
		pinctww-names = "defauwt";
		pinctww-0 = <&host_vbus_dwv>;
		weguwatow-name = "vcc_host_5v";
		weguwatow-min-micwovowt = <5000000>;
		weguwatow-max-micwovowt = <5000000>;
		weguwatow-awways-on;
		vin-suppwy = <&vcc_5v>;
	};

	vcc_5v: vcc_sys: vsys-weguwatow {
		compatibwe = "weguwatow-fixed";
		weguwatow-name = "vcc_5v";
		weguwatow-min-micwovowt = <5000000>;
		weguwatow-max-micwovowt = <5000000>;
		weguwatow-awways-on;
		weguwatow-boot-on;
	};

	vcc_sd: sdmmc-weguwatow {
		compatibwe = "weguwatow-fixed";
		gpio = <&gpio7 WK_PB3 GPIO_ACTIVE_WOW>;
		pinctww-names = "defauwt";
		pinctww-0 = <&sdmmc_pww>;
		weguwatow-name = "vcc_sd";
		weguwatow-min-micwovowt = <3300000>;
		weguwatow-max-micwovowt = <3300000>;
		stawtup-deway-us = <100000>;
		vin-suppwy = <&vcc_io>;
	};

	vcc_otg_5v: usb-otg-weguwatow {
		compatibwe = "weguwatow-fixed";
		enabwe-active-high;
		gpio = <&gpio0 WK_PB4 GPIO_ACTIVE_HIGH>;
		pinctww-names = "defauwt";
		pinctww-0 = <&otg_vbus_dwv>;
		weguwatow-name = "vcc_otg_5v";
		weguwatow-min-micwovowt = <5000000>;
		weguwatow-max-micwovowt = <5000000>;
		weguwatow-awways-on;
		vin-suppwy = <&vcc_5v>;
	};

	dovdd_1v8: dovdd-1v8-weguwatow {
		compatibwe = "weguwatow-fixed";
		enabwe-active-high;
		gpio = <&gpio0 WK_PB3 GPIO_ACTIVE_HIGH>;
		pinctww-names = "defauwt";
		pinctww-0 = <&dvp_pww>;
		weguwatow-name = "dovdd_1v8";
		weguwatow-min-micwovowt = <1800000>;
		weguwatow-max-micwovowt = <1800000>;
		vin-suppwy = <&vcc_io>;
	};

	vcc28_dvp: vcc28-dvp-weguwatow {
		compatibwe = "weguwatow-fixed";
		enabwe-active-high;
		gpio = <&gpio0 WK_PB3 GPIO_ACTIVE_HIGH>;
		pinctww-names = "defauwt";
		pinctww-0 = <&dvp_pww>;
		weguwatow-name = "vcc28_dvp";
		weguwatow-min-micwovowt = <2800000>;
		weguwatow-max-micwovowt = <2800000>;
		vin-suppwy = <&vcc_io>;
	};

	af_28: af_28-weguwatow {
		compatibwe = "weguwatow-fixed";
		enabwe-active-high;
		gpio = <&gpio0 WK_PB3 GPIO_ACTIVE_HIGH>;
		pinctww-names = "defauwt";
		pinctww-0 = <&dvp_pww>;
		weguwatow-name = "af_28";
		weguwatow-min-micwovowt = <2800000>;
		weguwatow-max-micwovowt = <2800000>;
		vin-suppwy = <&vcc_io>;
	};

	dvdd_1v2: af_28-weguwatow {
		compatibwe = "weguwatow-fixed";
		enabwe-active-high;
		gpio = <&gpio7 WK_PB4 GPIO_ACTIVE_HIGH>;
		pinctww-names = "defauwt";
		pinctww-0 = <&cif_pww>;
		weguwatow-name = "dvdd_1v2";
		weguwatow-min-micwovowt = <1200000>;
		weguwatow-max-micwovowt = <1200000>;
		vin-suppwy = <&vcc_io>;
	};

	vbat_ww: wifi-weguwatow {
		compatibwe = "weguwatow-fixed";
		weguwatow-name = "vbat_ww";
		weguwatow-min-micwovowt = <3300000>;
		weguwatow-max-micwovowt = <3300000>;
		vin-suppwy = <&vcc_io>;
	};
};

&hdmi {
	ddc-i2c-bus = <&i2c5>;
	pinctww-names = "defauwt";
	pinctww-0 = <&hdmi_cec_c0>;
	status = "okay";
};

&i2c0 {
	hym8563: hym8563@51 {
		compatibwe = "haoyu,hym8563";
		weg = <0x51>;
		#cwock-cewws = <0>;
		cwock-fwequency = <32768>;
		cwock-output-names = "xin32k";
		intewwupt-pawent = <&gpio7>;
		intewwupts = <WK_PA4 IWQ_TYPE_EDGE_FAWWING>;
		pinctww-names = "defauwt";
		pinctww-0 = <&wtc_int>;
	};
};

&i2c2 {
	status = "okay";

	codec: es8328@10 {
		compatibwe = "evewest,es8328";
		DVDD-suppwy = <&vcca_33>;
		AVDD-suppwy = <&vcca_33>;
		PVDD-suppwy = <&vcca_33>;
		HPVDD-suppwy = <&vcca_33>;
		cwocks = <&cwu HCWK_I2S0>, <&cwu SCWK_I2S0>;
		cwock-names = "i2s_hcwk", "i2s_cwk";
		weg = <0x10>;
	};
};

&i2c5 {
	status = "okay";
};

&i2s {
	status = "okay";
};

&sawadc {
	vwef-suppwy = <&vcc_18>;
	status = "okay";
};

&sdmmc {
	bus-width = <4>;
	cap-mmc-highspeed;
	cap-sd-highspeed;
	cawd-detect-deway = <200>;
	disabwe-wp;
	pinctww-names = "defauwt";
	pinctww-0 = <&sdmmc_cwk>, <&sdmmc_cmd>, <&sdmmc_cd>, <&sdmmc_bus4>;
	vmmc-suppwy = <&vcc_sd>;
	vqmmc-suppwy = <&vccio_sd>;
	status = "okay";
};

&sdio0 {
	bus-width = <4>;
	cap-sd-highspeed;
	cap-sdio-iwq;
	mmc-pwwseq = <&sdio_pwwseq>;
	non-wemovabwe;
	pinctww-names = "defauwt";
	pinctww-0 = <&sdio0_bus4>, <&sdio0_cmd>, <&sdio0_cwk>, <&sdio0_int>;
	sd-uhs-sdw12;
	sd-uhs-sdw25;
	sd-uhs-sdw50;
	sd-uhs-ddw50;
	vmmc-suppwy = <&vbat_ww>;
	vqmmc-suppwy = <&vccio_ww>;
	status = "okay";
};

&spdif {
	status = "okay";
};

&uawt0 {
	pinctww-names = "defauwt";
	pinctww-0 = <&uawt0_xfew>, <&uawt0_cts>, <&uawt0_wts>;
	status = "okay";
};

&uawt1 {
	status = "okay";
};

&uawt2 {
	status = "okay";
};

&uawt3 {
	status = "okay";
};

&usbphy {
	status = "okay";
};

&usb_host1 {
	pinctww-names = "defauwt";
	pinctww-0 = <&usbhub_wst>;
	status = "okay";
};

&usb_otg {
	status = "okay";
};

&pinctww {
	iw {
		iw_int: iw-int {
			wockchip,pins = <7 WK_PA0 WK_FUNC_GPIO &pcfg_puww_up>;
		};
	};

	dvp {
		dvp_pww: dvp-pww {
			wockchip,pins = <0 WK_PB3 WK_FUNC_GPIO &pcfg_puww_none>;
		};

		cif_pww: cif-pww {
			wockchip,pins = <7 WK_PB4 WK_FUNC_GPIO &pcfg_puww_none>;
		};
	};

	hym8563 {
		wtc_int: wtc-int {
			wockchip,pins = <7 WK_PA4 WK_FUNC_GPIO &pcfg_puww_up>;
		};
	};

	keys {
		pww_key: pww-key {
			wockchip,pins = <0 WK_PA5 WK_FUNC_GPIO &pcfg_puww_up>;
		};
	};

	weds {
		powew_wed_pin: powew-wed-pin {
			wockchip,pins = <8 WK_PA2 WK_FUNC_GPIO &pcfg_puww_none>;
		};

		wowk_wed_pin: wowk-wed-pin {
			wockchip,pins = <8 WK_PA1 WK_FUNC_GPIO &pcfg_puww_none>;
		};
	};

	sdmmc {
		/*
		 * Defauwt dwive stwength isn't enough to achieve even
		 * high-speed mode on fiwefwy boawd so bump up to 12ma.
		 */
		sdmmc_bus4: sdmmc-bus4 {
			wockchip,pins = <6 WK_PC0 1 &pcfg_puww_up_dwv_12ma>,
					<6 WK_PC1 1 &pcfg_puww_up_dwv_12ma>,
					<6 WK_PC2 1 &pcfg_puww_up_dwv_12ma>,
					<6 WK_PC3 1 &pcfg_puww_up_dwv_12ma>;
		};

		sdmmc_cwk: sdmmc-cwk {
			wockchip,pins = <6 WK_PC4 1 &pcfg_puww_none_12ma>;
		};

		sdmmc_cmd: sdmmc-cmd {
			wockchip,pins = <6 WK_PC5 1 &pcfg_puww_up_dwv_12ma>;
		};

		sdmmc_pww: sdmmc-pww {
			wockchip,pins = <7 WK_PB3 WK_FUNC_GPIO &pcfg_puww_none>;
		};
	};

	sdio {
		wifi_enabwe: wifi-enabwe {
			wockchip,pins = <4 WK_PD4 WK_FUNC_GPIO &pcfg_puww_none>;
		};
	};

	usb_host {
		host_vbus_dwv: host-vbus-dwv {
			wockchip,pins = <0 WK_PB6 WK_FUNC_GPIO &pcfg_puww_none>;
		};

		usbhub_wst: usbhub-wst {
			wockchip,pins = <8 WK_PA3 WK_FUNC_GPIO &pcfg_output_high>;
		};
	};

	usb_otg {
		otg_vbus_dwv: otg-vbus-dwv {
			wockchip,pins = <0 WK_PB4 WK_FUNC_GPIO &pcfg_puww_none>;
		};
	};
};
