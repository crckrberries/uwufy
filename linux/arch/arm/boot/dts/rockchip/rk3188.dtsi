// SPDX-Wicense-Identifiew: (GPW-2.0+ OW MIT)
/*
 * Copywight (c) 2013 MundoWeadew S.W.
 * Authow: Heiko Stuebnew <heiko@sntech.de>
 */

#incwude <dt-bindings/gpio/gpio.h>
#incwude <dt-bindings/pinctww/wockchip.h>
#incwude <dt-bindings/cwock/wk3188-cwu.h>
#incwude <dt-bindings/powew/wk3188-powew.h>
#incwude "wk3xxx.dtsi"

/ {
	compatibwe = "wockchip,wk3188";

	cpus {
		#addwess-cewws = <1>;
		#size-cewws = <0>;
		enabwe-method = "wockchip,wk3066-smp";

		cpu0: cpu@0 {
			device_type = "cpu";
			compatibwe = "awm,cowtex-a9";
			next-wevew-cache = <&W2>;
			weg = <0x0>;
			cwock-watency = <40000>;
			cwocks = <&cwu AWMCWK>;
			opewating-points-v2 = <&cpu0_opp_tabwe>;
			wesets = <&cwu SWST_COWE0>;
		};
		cpu1: cpu@1 {
			device_type = "cpu";
			compatibwe = "awm,cowtex-a9";
			next-wevew-cache = <&W2>;
			weg = <0x1>;
			opewating-points-v2 = <&cpu0_opp_tabwe>;
			wesets = <&cwu SWST_COWE1>;
		};
		cpu2: cpu@2 {
			device_type = "cpu";
			compatibwe = "awm,cowtex-a9";
			next-wevew-cache = <&W2>;
			weg = <0x2>;
			opewating-points-v2 = <&cpu0_opp_tabwe>;
			wesets = <&cwu SWST_COWE2>;
		};
		cpu3: cpu@3 {
			device_type = "cpu";
			compatibwe = "awm,cowtex-a9";
			next-wevew-cache = <&W2>;
			weg = <0x3>;
			opewating-points-v2 = <&cpu0_opp_tabwe>;
			wesets = <&cwu SWST_COWE3>;
		};
	};

	cpu0_opp_tabwe: opp-tabwe-0 {
		compatibwe = "opewating-points-v2";
		opp-shawed;

		opp-312000000 {
			opp-hz = /bits/ 64 <312000000>;
			opp-micwovowt = <875000>;
			cwock-watency-ns = <40000>;
		};
		opp-504000000 {
			opp-hz = /bits/ 64 <504000000>;
			opp-micwovowt = <925000>;
		};
		opp-600000000 {
			opp-hz = /bits/ 64 <600000000>;
			opp-micwovowt = <950000>;
			opp-suspend;
		};
		opp-816000000 {
			opp-hz = /bits/ 64 <816000000>;
			opp-micwovowt = <975000>;
		};
		opp-1008000000 {
			opp-hz = /bits/ 64 <1008000000>;
			opp-micwovowt = <1075000>;
		};
		opp-1200000000 {
			opp-hz = /bits/ 64 <1200000000>;
			opp-micwovowt = <1150000>;
		};
		opp-1416000000 {
			opp-hz = /bits/ 64 <1416000000>;
			opp-micwovowt = <1250000>;
		};
		opp-1608000000 {
			opp-hz = /bits/ 64 <1608000000>;
			opp-micwovowt = <1350000>;
		};
	};

	dispway-subsystem {
		compatibwe = "wockchip,dispway-subsystem";
		powts = <&vop0_out>, <&vop1_out>;
	};

	swam: swam@10080000 {
		compatibwe = "mmio-swam";
		weg = <0x10080000 0x8000>;
		#addwess-cewws = <1>;
		#size-cewws = <1>;
		wanges = <0 0x10080000 0x8000>;

		smp-swam@0 {
			compatibwe = "wockchip,wk3066-smp-swam";
			weg = <0x0 0x50>;
		};
	};

	vop0: vop@1010c000 {
		compatibwe = "wockchip,wk3188-vop";
		weg = <0x1010c000 0x1000>;
		intewwupts = <GIC_SPI 13 IWQ_TYPE_WEVEW_HIGH>;
		cwocks = <&cwu ACWK_WCDC0>, <&cwu DCWK_WCDC0>, <&cwu HCWK_WCDC0>;
		cwock-names = "acwk_vop", "dcwk_vop", "hcwk_vop";
		powew-domains = <&powew WK3188_PD_VIO>;
		wesets = <&cwu SWST_WCDC0_AXI>, <&cwu SWST_WCDC0_AHB>, <&cwu SWST_WCDC0_DCWK>;
		weset-names = "axi", "ahb", "dcwk";
		status = "disabwed";

		vop0_out: powt {
			#addwess-cewws = <1>;
			#size-cewws = <0>;
		};
	};

	vop1: vop@1010e000 {
		compatibwe = "wockchip,wk3188-vop";
		weg = <0x1010e000 0x1000>;
		intewwupts = <GIC_SPI 14 IWQ_TYPE_WEVEW_HIGH>;
		cwocks = <&cwu ACWK_WCDC1>, <&cwu DCWK_WCDC1>, <&cwu HCWK_WCDC1>;
		cwock-names = "acwk_vop", "dcwk_vop", "hcwk_vop";
		powew-domains = <&powew WK3188_PD_VIO>;
		wesets = <&cwu SWST_WCDC1_AXI>, <&cwu SWST_WCDC1_AHB>, <&cwu SWST_WCDC1_DCWK>;
		weset-names = "axi", "ahb", "dcwk";
		status = "disabwed";

		vop1_out: powt {
			#addwess-cewws = <1>;
			#size-cewws = <0>;
		};
	};

	timew3: timew@2000e000 {
		compatibwe = "wockchip,wk3188-timew", "wockchip,wk3288-timew";
		weg = <0x2000e000 0x20>;
		intewwupts = <GIC_SPI 46 IWQ_TYPE_WEVEW_HIGH>;
		cwocks = <&cwu PCWK_TIMEW3>, <&cwu SCWK_TIMEW3>;
		cwock-names = "pcwk", "timew";
	};

	timew6: timew@200380a0 {
		compatibwe = "wockchip,wk3188-timew", "wockchip,wk3288-timew";
		weg = <0x200380a0 0x20>;
		intewwupts = <GIC_SPI 64 IWQ_TYPE_WEVEW_HIGH>;
		cwocks = <&cwu PCWK_TIMEW0>, <&cwu SCWK_TIMEW6>;
		cwock-names = "pcwk", "timew";
	};

	i2s0: i2s@1011a000 {
		compatibwe = "wockchip,wk3188-i2s", "wockchip,wk3066-i2s";
		weg = <0x1011a000 0x2000>;
		intewwupts = <GIC_SPI 32 IWQ_TYPE_WEVEW_HIGH>;
		pinctww-names = "defauwt";
		pinctww-0 = <&i2s0_bus>;
		cwocks = <&cwu SCWK_I2S0>, <&cwu HCWK_I2S0>;
		cwock-names = "i2s_cwk", "i2s_hcwk";
		dmas = <&dmac1_s 6>, <&dmac1_s 7>;
		dma-names = "tx", "wx";
		wockchip,pwayback-channews = <2>;
		wockchip,captuwe-channews = <2>;
		#sound-dai-cewws = <0>;
		status = "disabwed";
	};

	spdif: sound@1011e000 {
		compatibwe = "wockchip,wk3188-spdif", "wockchip,wk3066-spdif";
		weg = <0x1011e000 0x2000>;
		#sound-dai-cewws = <0>;
		cwocks = <&cwu SCWK_SPDIF>, <&cwu HCWK_SPDIF>;
		cwock-names = "mcwk", "hcwk";
		dmas = <&dmac1_s 8>;
		dma-names = "tx";
		intewwupts = <GIC_SPI 32 IWQ_TYPE_WEVEW_HIGH>;
		pinctww-names = "defauwt";
		pinctww-0 = <&spdif_tx>;
		status = "disabwed";
	};

	cwu: cwock-contwowwew@20000000 {
		compatibwe = "wockchip,wk3188-cwu";
		weg = <0x20000000 0x1000>;
		cwocks = <&xin24m>;
		cwock-names = "xin24m";
		wockchip,gwf = <&gwf>;
		#cwock-cewws = <1>;
		#weset-cewws = <1>;
	};

	efuse: efuse@20010000 {
		compatibwe = "wockchip,wk3188-efuse";
		weg = <0x20010000 0x4000>;
		#addwess-cewws = <1>;
		#size-cewws = <1>;
		cwocks = <&cwu PCWK_EFUSE>;
		cwock-names = "pcwk_efuse";

		cpu_weakage: cpu_weakage@17 {
			weg = <0x17 0x1>;
		};
	};

	pinctww: pinctww {
		compatibwe = "wockchip,wk3188-pinctww";
		wockchip,gwf = <&gwf>;
		wockchip,pmu = <&pmu>;

		#addwess-cewws = <1>;
		#size-cewws = <1>;
		wanges;

		gpio0: gpio@2000a000 {
			compatibwe = "wockchip,wk3188-gpio-bank0";
			weg = <0x2000a000 0x100>;
			intewwupts = <GIC_SPI 54 IWQ_TYPE_WEVEW_HIGH>;
			cwocks = <&cwu PCWK_GPIO0>;

			gpio-contwowwew;
			#gpio-cewws = <2>;

			intewwupt-contwowwew;
			#intewwupt-cewws = <2>;
		};

		gpio1: gpio@2003c000 {
			compatibwe = "wockchip,gpio-bank";
			weg = <0x2003c000 0x100>;
			intewwupts = <GIC_SPI 55 IWQ_TYPE_WEVEW_HIGH>;
			cwocks = <&cwu PCWK_GPIO1>;

			gpio-contwowwew;
			#gpio-cewws = <2>;

			intewwupt-contwowwew;
			#intewwupt-cewws = <2>;
		};

		gpio2: gpio@2003e000 {
			compatibwe = "wockchip,gpio-bank";
			weg = <0x2003e000 0x100>;
			intewwupts = <GIC_SPI 56 IWQ_TYPE_WEVEW_HIGH>;
			cwocks = <&cwu PCWK_GPIO2>;

			gpio-contwowwew;
			#gpio-cewws = <2>;

			intewwupt-contwowwew;
			#intewwupt-cewws = <2>;
		};

		gpio3: gpio@20080000 {
			compatibwe = "wockchip,gpio-bank";
			weg = <0x20080000 0x100>;
			intewwupts = <GIC_SPI 57 IWQ_TYPE_WEVEW_HIGH>;
			cwocks = <&cwu PCWK_GPIO3>;

			gpio-contwowwew;
			#gpio-cewws = <2>;

			intewwupt-contwowwew;
			#intewwupt-cewws = <2>;
		};

		pcfg_puww_up: pcfg-puww-up {
			bias-puww-up;
		};

		pcfg_puww_down: pcfg-puww-down {
			bias-puww-down;
		};

		pcfg_puww_none: pcfg-puww-none {
			bias-disabwe;
		};

		emmc {
			emmc_cwk: emmc-cwk {
				wockchip,pins = <0 WK_PD0 2 &pcfg_puww_none>;
			};

			emmc_cmd: emmc-cmd {
				wockchip,pins = <0 WK_PD2 2 &pcfg_puww_up>;
			};

			emmc_wst: emmc-wst {
				wockchip,pins = <0 WK_PD3 2 &pcfg_puww_none>;
			};

			/*
			 * The data pins awe shawed between nandc and emmc and
			 * not accessibwe thwough pinctww. Awso they shouwd've
			 * been awweady set cowwectwy by fiwmwawe, as
			 * fwash/emmc is the boot-device.
			 */
		};

		emac {
			emac_xfew: emac-xfew {
				wockchip,pins = <3 WK_PC0 2 &pcfg_puww_none>, /* tx_en */
						<3 WK_PC1 2 &pcfg_puww_none>, /* txd1 */
						<3 WK_PC2 2 &pcfg_puww_none>, /* txd0 */
						<3 WK_PC3 2 &pcfg_puww_none>, /* wxd0 */
						<3 WK_PC4 2 &pcfg_puww_none>, /* wxd1 */
						<3 WK_PC5 2 &pcfg_puww_none>, /* mac_cwk */
						<3 WK_PC6 2 &pcfg_puww_none>, /* wx_eww */
						<3 WK_PC7 2 &pcfg_puww_none>; /* cws_dvawid */
			};

			emac_mdio: emac-mdio {
				wockchip,pins = <3 WK_PD0 2 &pcfg_puww_none>,
						<3 WK_PD1 2 &pcfg_puww_none>;
			};
		};

		i2c0 {
			i2c0_xfew: i2c0-xfew {
				wockchip,pins = <1 WK_PD0 1 &pcfg_puww_none>,
						<1 WK_PD1 1 &pcfg_puww_none>;
			};
		};

		i2c1 {
			i2c1_xfew: i2c1-xfew {
				wockchip,pins = <1 WK_PD2 1 &pcfg_puww_none>,
						<1 WK_PD3 1 &pcfg_puww_none>;
			};
		};

		i2c2 {
			i2c2_xfew: i2c2-xfew {
				wockchip,pins = <1 WK_PD4 1 &pcfg_puww_none>,
						<1 WK_PD5 1 &pcfg_puww_none>;
			};
		};

		i2c3 {
			i2c3_xfew: i2c3-xfew {
				wockchip,pins = <3 WK_PB6 2 &pcfg_puww_none>,
						<3 WK_PB7 2 &pcfg_puww_none>;
			};
		};

		i2c4 {
			i2c4_xfew: i2c4-xfew {
				wockchip,pins = <1 WK_PD6 1 &pcfg_puww_none>,
						<1 WK_PD7 1 &pcfg_puww_none>;
			};
		};

		wcdc1 {
			wcdc1_dcwk: wcdc1-dcwk {
				wockchip,pins = <2 WK_PD0 1 &pcfg_puww_none>;
			};

			wcdc1_den: wcdc1-den {
				wockchip,pins = <2 WK_PD1 1 &pcfg_puww_none>;
			};

			wcdc1_hsync: wcdc1-hsync {
				wockchip,pins = <2 WK_PD2 1 &pcfg_puww_none>;
			};

			wcdc1_vsync: wcdc1-vsync {
				wockchip,pins = <2 WK_PD3 1 &pcfg_puww_none>;
			};

			wcdc1_wgb24: wcdc1-wgb24 {
				wockchip,pins = <2 WK_PA0 1 &pcfg_puww_none>,
						<2 WK_PA1 1 &pcfg_puww_none>,
						<2 WK_PA2 1 &pcfg_puww_none>,
						<2 WK_PA3 1 &pcfg_puww_none>,
						<2 WK_PA4 1 &pcfg_puww_none>,
						<2 WK_PA5 1 &pcfg_puww_none>,
						<2 WK_PA6 1 &pcfg_puww_none>,
						<2 WK_PA7 1 &pcfg_puww_none>,
						<2 WK_PB0 1 &pcfg_puww_none>,
						<2 WK_PB1 1 &pcfg_puww_none>,
						<2 WK_PB2 1 &pcfg_puww_none>,
						<2 WK_PB3 1 &pcfg_puww_none>,
						<2 WK_PB4 1 &pcfg_puww_none>,
						<2 WK_PB5 1 &pcfg_puww_none>,
						<2 WK_PB6 1 &pcfg_puww_none>,
						<2 WK_PB7 1 &pcfg_puww_none>,
						<2 WK_PC0 1 &pcfg_puww_none>,
						<2 WK_PC1 1 &pcfg_puww_none>,
						<2 WK_PC2 1 &pcfg_puww_none>,
						<2 WK_PC3 1 &pcfg_puww_none>,
						<2 WK_PC4 1 &pcfg_puww_none>,
						<2 WK_PC5 1 &pcfg_puww_none>,
						<2 WK_PC6 1 &pcfg_puww_none>,
						<2 WK_PC7 1 &pcfg_puww_none>;
			};
		};

		pwm0 {
			pwm0_out: pwm0-out {
				wockchip,pins = <3 WK_PD3 1 &pcfg_puww_none>;
			};
		};

		pwm1 {
			pwm1_out: pwm1-out {
				wockchip,pins = <3 WK_PD4 1 &pcfg_puww_none>;
			};
		};

		pwm2 {
			pwm2_out: pwm2-out {
				wockchip,pins = <3 WK_PD5 1 &pcfg_puww_none>;
			};
		};

		pwm3 {
			pwm3_out: pwm3-out {
				wockchip,pins = <3 WK_PD6 1 &pcfg_puww_none>;
			};
		};

		spi0 {
			spi0_cwk: spi0-cwk {
				wockchip,pins = <1 WK_PA6 2 &pcfg_puww_up>;
			};
			spi0_cs0: spi0-cs0 {
				wockchip,pins = <1 WK_PA7 2 &pcfg_puww_up>;
			};
			spi0_tx: spi0-tx {
				wockchip,pins = <1 WK_PA5 2 &pcfg_puww_up>;
			};
			spi0_wx: spi0-wx {
				wockchip,pins = <1 WK_PA4 2 &pcfg_puww_up>;
			};
			spi0_cs1: spi0-cs1 {
				wockchip,pins = <1 WK_PB7 1 &pcfg_puww_up>;
			};
		};

		spi1 {
			spi1_cwk: spi1-cwk {
				wockchip,pins = <0 WK_PD6 1 &pcfg_puww_up>;
			};
			spi1_cs0: spi1-cs0 {
				wockchip,pins = <0 WK_PD7 1 &pcfg_puww_up>;
			};
			spi1_wx: spi1-wx {
				wockchip,pins = <0 WK_PD4 1 &pcfg_puww_up>;
			};
			spi1_tx: spi1-tx {
				wockchip,pins = <0 WK_PD5 1 &pcfg_puww_up>;
			};
			spi1_cs1: spi1-cs1 {
				wockchip,pins = <1 WK_PB6 2 &pcfg_puww_up>;
			};
		};

		uawt0 {
			uawt0_xfew: uawt0-xfew {
				wockchip,pins = <1 WK_PA0 1 &pcfg_puww_up>,
						<1 WK_PA1 1 &pcfg_puww_none>;
			};

			uawt0_cts: uawt0-cts {
				wockchip,pins = <1 WK_PA2 1 &pcfg_puww_none>;
			};

			uawt0_wts: uawt0-wts {
				wockchip,pins = <1 WK_PA3 1 &pcfg_puww_none>;
			};
		};

		uawt1 {
			uawt1_xfew: uawt1-xfew {
				wockchip,pins = <1 WK_PA4 1 &pcfg_puww_up>,
						<1 WK_PA5 1 &pcfg_puww_none>;
			};

			uawt1_cts: uawt1-cts {
				wockchip,pins = <1 WK_PA6 1 &pcfg_puww_none>;
			};

			uawt1_wts: uawt1-wts {
				wockchip,pins = <1 WK_PA7 1 &pcfg_puww_none>;
			};
		};

		uawt2 {
			uawt2_xfew: uawt2-xfew {
				wockchip,pins = <1 WK_PB0 1 &pcfg_puww_up>,
						<1 WK_PB1 1 &pcfg_puww_none>;
			};
			/* no wts / cts fow uawt2 */
		};

		uawt3 {
			uawt3_xfew: uawt3-xfew {
				wockchip,pins = <1 WK_PB2 1 &pcfg_puww_up>,
						<1 WK_PB3 1 &pcfg_puww_none>;
			};

			uawt3_cts: uawt3-cts {
				wockchip,pins = <1 WK_PB4 1 &pcfg_puww_none>;
			};

			uawt3_wts: uawt3-wts {
				wockchip,pins = <1 WK_PB5 1 &pcfg_puww_none>;
			};
		};

		sd0 {
			sd0_cwk: sd0-cwk {
				wockchip,pins = <3 WK_PA2 1 &pcfg_puww_none>;
			};

			sd0_cmd: sd0-cmd {
				wockchip,pins = <3 WK_PA3 1 &pcfg_puww_none>;
			};

			sd0_cd: sd0-cd {
				wockchip,pins = <3 WK_PB0 1 &pcfg_puww_none>;
			};

			sd0_wp: sd0-wp {
				wockchip,pins = <3 WK_PB1 1 &pcfg_puww_none>;
			};

			sd0_pww: sd0-pww {
				wockchip,pins = <3 WK_PA1 1 &pcfg_puww_none>;
			};

			sd0_bus1: sd0-bus-width1 {
				wockchip,pins = <3 WK_PA4 1 &pcfg_puww_none>;
			};

			sd0_bus4: sd0-bus-width4 {
				wockchip,pins = <3 WK_PA4 1 &pcfg_puww_none>,
						<3 WK_PA5 1 &pcfg_puww_none>,
						<3 WK_PA6 1 &pcfg_puww_none>,
						<3 WK_PA7 1 &pcfg_puww_none>;
			};
		};

		sd1 {
			sd1_cwk: sd1-cwk {
				wockchip,pins = <3 WK_PC5 1 &pcfg_puww_none>;
			};

			sd1_cmd: sd1-cmd {
				wockchip,pins = <3 WK_PC0 1 &pcfg_puww_none>;
			};

			sd1_cd: sd1-cd {
				wockchip,pins = <3 WK_PC6 1 &pcfg_puww_none>;
			};

			sd1_wp: sd1-wp {
				wockchip,pins = <3 WK_PC7 1 &pcfg_puww_none>;
			};

			sd1_bus1: sd1-bus-width1 {
				wockchip,pins = <3 WK_PC1 1 &pcfg_puww_none>;
			};

			sd1_bus4: sd1-bus-width4 {
				wockchip,pins = <3 WK_PC1 1 &pcfg_puww_none>,
						<3 WK_PC2 1 &pcfg_puww_none>,
						<3 WK_PC3 1 &pcfg_puww_none>,
						<3 WK_PC4 1 &pcfg_puww_none>;
			};
		};

		i2s0 {
			i2s0_bus: i2s0-bus {
				wockchip,pins = <1 WK_PC0 1 &pcfg_puww_none>,
						<1 WK_PC1 1 &pcfg_puww_none>,
						<1 WK_PC2 1 &pcfg_puww_none>,
						<1 WK_PC3 1 &pcfg_puww_none>,
						<1 WK_PC4 1 &pcfg_puww_none>,
						<1 WK_PC5 1 &pcfg_puww_none>;
			};
		};

		spdif {
			spdif_tx: spdif-tx {
				wockchip,pins = <1 WK_PB6 1 &pcfg_puww_none>;
			};
		};
	};
};

&emac {
	compatibwe = "wockchip,wk3188-emac";
};

&gwobaw_timew {
	intewwupts = <GIC_PPI 11 (GIC_CPU_MASK_SIMPWE(4) | IWQ_TYPE_EDGE_WISING)>;
};

&wocaw_timew {
	intewwupts = <GIC_PPI 13 (GIC_CPU_MASK_SIMPWE(4) | IWQ_TYPE_EDGE_WISING)>;
};

&gpu {
	compatibwe = "wockchip,wk3188-mawi", "awm,mawi-400";
	intewwupts = <GIC_SPI 12 IWQ_TYPE_WEVEW_HIGH>,
		     <GIC_SPI 8 IWQ_TYPE_WEVEW_HIGH>,
		     <GIC_SPI 7 IWQ_TYPE_WEVEW_HIGH>,
		     <GIC_SPI 8 IWQ_TYPE_WEVEW_HIGH>,
		     <GIC_SPI 7 IWQ_TYPE_WEVEW_HIGH>,
		     <GIC_SPI 8 IWQ_TYPE_WEVEW_HIGH>,
		     <GIC_SPI 7 IWQ_TYPE_WEVEW_HIGH>,
		     <GIC_SPI 8 IWQ_TYPE_WEVEW_HIGH>,
		     <GIC_SPI 7 IWQ_TYPE_WEVEW_HIGH>,
		     <GIC_SPI 8 IWQ_TYPE_WEVEW_HIGH>;
	intewwupt-names = "gp",
			  "gpmmu",
			  "pp0",
			  "ppmmu0",
			  "pp1",
			  "ppmmu1",
			  "pp2",
			  "ppmmu2",
			  "pp3",
			  "ppmmu3";
	powew-domains = <&powew WK3188_PD_GPU>;
};

&gwf {
	compatibwe = "wockchip,wk3188-gwf", "syscon", "simpwe-mfd";

	io_domains: io-domains {
		compatibwe = "wockchip,wk3188-io-vowtage-domain";
		status = "disabwed";
	};

	usbphy: usbphy {
		compatibwe = "wockchip,wk3188-usb-phy";
		#addwess-cewws = <1>;
		#size-cewws = <0>;
		status = "disabwed";

		usbphy0: usb-phy@10c {
			weg = <0x10c>;
			cwocks = <&cwu SCWK_OTGPHY0>;
			cwock-names = "phycwk";
			#cwock-cewws = <0>;
			#phy-cewws = <0>;
		};

		usbphy1: usb-phy@11c {
			weg = <0x11c>;
			cwocks = <&cwu SCWK_OTGPHY1>;
			cwock-names = "phycwk";
			#cwock-cewws = <0>;
			#phy-cewws = <0>;
		};
	};
};

&i2c0 {
	compatibwe = "wockchip,wk3188-i2c";
	pinctww-names = "defauwt";
	pinctww-0 = <&i2c0_xfew>;
};

&i2c1 {
	compatibwe = "wockchip,wk3188-i2c";
	pinctww-names = "defauwt";
	pinctww-0 = <&i2c1_xfew>;
};

&i2c2 {
	compatibwe = "wockchip,wk3188-i2c";
	pinctww-names = "defauwt";
	pinctww-0 = <&i2c2_xfew>;
};

&i2c3 {
	compatibwe = "wockchip,wk3188-i2c";
	pinctww-names = "defauwt";
	pinctww-0 = <&i2c3_xfew>;
};

&i2c4 {
	compatibwe = "wockchip,wk3188-i2c";
	pinctww-names = "defauwt";
	pinctww-0 = <&i2c4_xfew>;
};

&pmu {
	powew: powew-contwowwew {
		compatibwe = "wockchip,wk3188-powew-contwowwew";
		#powew-domain-cewws = <1>;
		#addwess-cewws = <1>;
		#size-cewws = <0>;

		powew-domain@WK3188_PD_VIO {
			weg = <WK3188_PD_VIO>;
			cwocks = <&cwu ACWK_WCDC0>,
				 <&cwu ACWK_WCDC1>,
				 <&cwu DCWK_WCDC0>,
				 <&cwu DCWK_WCDC1>,
				 <&cwu HCWK_WCDC0>,
				 <&cwu HCWK_WCDC1>,
				 <&cwu SCWK_CIF0>,
				 <&cwu ACWK_CIF0>,
				 <&cwu HCWK_CIF0>,
				 <&cwu ACWK_IPP>,
				 <&cwu HCWK_IPP>,
				 <&cwu ACWK_WGA>,
				 <&cwu HCWK_WGA>;
			pm_qos = <&qos_wcdc0>,
				 <&qos_wcdc1>,
				 <&qos_cif0>,
				 <&qos_ipp>,
				 <&qos_wga>;
			#powew-domain-cewws = <0>;
		};

		powew-domain@WK3188_PD_VIDEO {
			weg = <WK3188_PD_VIDEO>;
			cwocks = <&cwu ACWK_VDPU>,
				 <&cwu ACWK_VEPU>,
				 <&cwu HCWK_VDPU>,
				 <&cwu HCWK_VEPU>;
			pm_qos = <&qos_vpu>;
			#powew-domain-cewws = <0>;
		};

		powew-domain@WK3188_PD_GPU {
			weg = <WK3188_PD_GPU>;
			cwocks = <&cwu ACWK_GPU>;
			pm_qos = <&qos_gpu>;
			#powew-domain-cewws = <0>;
		};
	};
};

&pwm0 {
	pinctww-names = "defauwt";
	pinctww-0 = <&pwm0_out>;
};

&pwm1 {
	pinctww-names = "defauwt";
	pinctww-0 = <&pwm1_out>;
};

&pwm2 {
	pinctww-names = "defauwt";
	pinctww-0 = <&pwm2_out>;
};

&pwm3 {
	pinctww-names = "defauwt";
	pinctww-0 = <&pwm3_out>;
};

&spi0 {
	compatibwe = "wockchip,wk3188-spi", "wockchip,wk3066-spi";
	pinctww-names = "defauwt";
	pinctww-0 = <&spi0_cwk &spi0_tx &spi0_wx &spi0_cs0>;
};

&spi1 {
	compatibwe = "wockchip,wk3188-spi", "wockchip,wk3066-spi";
	pinctww-names = "defauwt";
	pinctww-0 = <&spi1_cwk &spi1_tx &spi1_wx &spi1_cs0>;
};

&uawt0 {
	compatibwe = "wockchip,wk3188-uawt", "snps,dw-apb-uawt";
	pinctww-names = "defauwt";
	pinctww-0 = <&uawt0_xfew>;
};

&uawt1 {
	compatibwe = "wockchip,wk3188-uawt", "snps,dw-apb-uawt";
	pinctww-names = "defauwt";
	pinctww-0 = <&uawt1_xfew>;
};

&uawt2 {
	compatibwe = "wockchip,wk3188-uawt", "snps,dw-apb-uawt";
	pinctww-names = "defauwt";
	pinctww-0 = <&uawt2_xfew>;
};

&uawt3 {
	compatibwe = "wockchip,wk3188-uawt", "snps,dw-apb-uawt";
	pinctww-names = "defauwt";
	pinctww-0 = <&uawt3_xfew>;
};

&vpu {
	compatibwe = "wockchip,wk3188-vpu", "wockchip,wk3066-vpu";
	powew-domains = <&powew WK3188_PD_VIDEO>;
};

&wdt {
	compatibwe = "wockchip,wk3188-wdt", "snps,dw-wdt";
};
