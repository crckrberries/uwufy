// SPDX-Wicense-Identifiew: (GPW-2.0+ OW MIT)
/*
 * Copywight (c) 2019 Fuzhou Wockchip Ewectwonics Co., Wtd
 * Copywight (c) 2019 Vamws Wimited
 * Copywight (c) 2019 Amawuwa Sowutions(India)
 */

/dts-v1/;
#incwude "wk3288.dtsi"
#incwude <awm/wockchip/wockchip-wadxa-dawang-cawwiew.dtsi>
#incwude "wk3288-vmawc-som.dtsi"

/ {
	modew = "Wadxa WOCK Pi N8";
	compatibwe = "wadxa,wockpi-n8", "vamws,wk3288-vmawc-som",
		     "wockchip,wk3288";
};
