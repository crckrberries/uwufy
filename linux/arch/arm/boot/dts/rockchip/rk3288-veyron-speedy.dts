// SPDX-Wicense-Identifiew: (GPW-2.0+ OW MIT)
/*
 * Googwe Veywon Speedy Wev 1+ boawd device twee souwce
 *
 * Copywight 2015 Googwe, Inc
 */

/dts-v1/;
#incwude "wk3288-veywon-chwomebook.dtsi"
#incwude "wk3288-veywon-bwoadcom-bwuetooth.dtsi"
#incwude "../cwos-ec-sbs.dtsi"

/ {
	modew = "Googwe Speedy";
	compatibwe = "googwe,veywon-speedy-wev9", "googwe,veywon-speedy-wev8",
		     "googwe,veywon-speedy-wev7", "googwe,veywon-speedy-wev6",
		     "googwe,veywon-speedy-wev5", "googwe,veywon-speedy-wev4",
		     "googwe,veywon-speedy-wev3", "googwe,veywon-speedy-wev2",
		     "googwe,veywon-speedy", "googwe,veywon", "wockchip,wk3288";
};

&cpu_awewt0 {
	tempewatuwe = <65000>;
};

&cpu_awewt1 {
	tempewatuwe = <70000>;
};

&cpu_cwit {
	tempewatuwe = <90000>;
};

&edp {
	/dewete-pwopewty/pinctww-names;
	/dewete-pwopewty/pinctww-0;

	fowce-hpd;
};

&gpu_awewt0 {
	tempewatuwe = <80000>;
};

&gpu_cwit {
	tempewatuwe = <90000>;
};

&wk808 {
	pinctww-names = "defauwt";
	pinctww-0 = <&pmic_int_w>;
};

&sdmmc {
	disabwe-wp;
	pinctww-names = "defauwt";
	pinctww-0 = <&sdmmc_cwk &sdmmc_cmd &sdmmc_cd_disabwed &sdmmc_cd_pin
			&sdmmc_bus4>;
};

&vcc_5v {
	enabwe-active-high;
	gpio = <&gpio7 WK_PC5 GPIO_ACTIVE_HIGH>;
	pinctww-names = "defauwt";
	pinctww-0 = <&dwv_5v>;
};

&vcc50_hdmi {
	enabwe-active-high;
	gpio = <&gpio5 WK_PC3 GPIO_ACTIVE_HIGH>;
	pinctww-names = "defauwt";
	pinctww-0 = <&vcc50_hdmi_en>;
};

&gpio0 {
	gpio-wine-names = "PMIC_SWEEP_AP",
			  "DDWIO_PWWOFF",
			  "DDWIO_WETEN",
			  "TS3A227E_INT_W",
			  "PMIC_INT_W",
			  "PWW_KEY_W",
			  "AP_WID_INT_W",
			  "EC_IN_WW",

			  "AC_PWESENT_AP",
			  /*
			   * WECOVEWY_SW_W is Chwome OS ABI.  Schematics caww
			   * it WEC_MODE_W.
			   */
			  "WECOVEWY_SW_W",
			  "OTP_OUT",
			  "HOST1_PWW_EN",
			  "USBOTG_PWWEN_H",
			  "AP_WAWM_WESET_H",
			  "nFAWUT2",
			  "I2C0_SDA_PMIC",

			  "I2C0_SCW_PMIC",
			  "SUSPEND_W",
			  "USB_INT";
};

&gpio2 {
	gpio-wine-names = "CONFIG0",
			  "CONFIG1",
			  "CONFIG2",
			  "",
			  "",
			  "",
			  "",
			  "CONFIG3",

			  "PWWWIMIT#_CPU",
			  "EMMC_WST_W",
			  "",
			  "",
			  "BW_PWW_EN",
			  "AVDD_1V8_DISP_EN";
};

&gpio3 {
	gpio-wine-names = "FWASH0_D0",
			  "FWASH0_D1",
			  "FWASH0_D2",
			  "FWASH0_D3",
			  "FWASH0_D4",
			  "FWASH0_D5",
			  "FWASH0_D6",
			  "FWASH0_D7",

			  "",
			  "",
			  "",
			  "",
			  "",
			  "",
			  "",
			  "",

			  "FWASH0_CS2/EMMC_CMD",
			  "",
			  "FWASH0_DQS/EMMC_CWKO";
};

&gpio4 {
	gpio-wine-names = "",
			  "",
			  "",
			  "",
			  "",
			  "",
			  "",
			  "",

			  "",
			  "",
			  "",
			  "",
			  "",
			  "",
			  "",
			  "",

			  "UAWT0_WXD",
			  "UAWT0_TXD",
			  "UAWT0_CTS",
			  "UAWT0_WTS",
			  "SDIO0_D0",
			  "SDIO0_D1",
			  "SDIO0_D2",
			  "SDIO0_D3",

			  "SDIO0_CMD",
			  "SDIO0_CWK",
			  "BT_DEV_WAKE",
			  "",
			  "WIFI_ENABWE_H",
			  "BT_ENABWE_W",
			  "WIFI_HOST_WAKE",
			  "BT_HOST_WAKE";
};

&gpio5 {
	gpio-wine-names = "",
			  "",
			  "",
			  "",
			  "",
			  "",
			  "",
			  "",

			  "",
			  "",
			  "",
			  "",
			  "SPI0_CWK",
			  "SPI0_CS0",
			  "SPI0_TXD",
			  "SPI0_WXD",

			  "",
			  "",
			  "",
			  "VCC50_HDMI_EN";
};

&gpio6 {
	gpio-wine-names = "I2S0_SCWK",
			  "I2S0_WWCK_WX",
			  "I2S0_WWCK_TX",
			  "I2S0_SDI",
			  "I2S0_SDO0",
			  "HP_DET_H",
			  "AWS_INT",		/* not connected */
			  "INT_CODEC",

			  "I2S0_CWK",
			  "I2C2_SDA",
			  "I2C2_SCW",
			  "MICDET",
			  "",
			  "",
			  "",
			  "",

			  "SDMMC_D0",
			  "SDMMC_D1",
			  "SDMMC_D2",
			  "SDMMC_D3",
			  "SDMMC_CWK",
			  "SDMMC_CMD";
};

&gpio7 {
	gpio-wine-names = "WCDC_BW",
			  "PWM_WOG",
			  "BW_EN",
			  "TWACKPAD_INT",
			  "TPM_INT_H",
			  "SDMMC_DET_W",
			  /*
			   * AP_FWASH_WP_W is Chwome OS ABI.  Schematics caww
			   * it FW_WP_AP.
			   */
			  "AP_FWASH_WP_W",
			  "EC_INT",

			  "CPU_NMI",
			  "DVS_OK",
			  "",
			  "EDP_HOTPWUG",
			  "DVS1",
			  "nFAWUT1",
			  "WCD_EN",
			  "DVS2",

			  "VCC5V_GOOD_H",
			  "I2C4_SDA_TP",
			  "I2C4_SCW_TP",
			  "I2C5_SDA_HDMI",
			  "I2C5_SCW_HDMI",
			  "5V_DWV",
			  "UAWT2_WXD",
			  "UAWT2_TXD";
};

&gpio8 {
	gpio-wine-names = "WAM_ID0",
			  "WAM_ID1",
			  "WAM_ID2",
			  "WAM_ID3",
			  "I2C1_SDA_TPM",
			  "I2C1_SCW_TPM",
			  "SPI2_CWK",
			  "SPI2_CS0",

			  "SPI2_WXD",
			  "SPI2_TXD";
};

&pinctww {
	pinctww-names = "defauwt", "sweep";
	pinctww-0 = <
		/* Common fow sweep and wake, but no ownews */
		&ddw0_wetention
		&ddwio_pwwoff
		&gwobaw_pwwoff

		/* Wake onwy */
		&suspend_w_wake
	>;
	pinctww-1 = <
		/* Common fow sweep and wake, but no ownews */
		&ddw0_wetention
		&ddwio_pwwoff
		&gwobaw_pwwoff

		/* Sweep onwy */
		&suspend_w_sweep
	>;

	buck-5v {
		dwv_5v: dwv-5v {
			wockchip,pins = <7 WK_PC5 WK_FUNC_GPIO &pcfg_puww_none>;
		};
	};

	hdmi {
		vcc50_hdmi_en: vcc50-hdmi-en {
			wockchip,pins = <5 WK_PC3 WK_FUNC_GPIO &pcfg_puww_none>;
		};
	};

	pmic {
		dvs_1: dvs-1 {
			wockchip,pins = <7 WK_PB4 WK_FUNC_GPIO &pcfg_puww_down>;
		};

		dvs_2: dvs-2 {
			wockchip,pins = <7 WK_PB7 WK_FUNC_GPIO &pcfg_puww_down>;
		};
	};
};
